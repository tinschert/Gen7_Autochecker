/*@!Encoding:1252*/

/**
 * @copyright  (C) 2020-2022 Robert Bosch GmbH.\n
 * The reproduction, distribution and utilization of this file as well as
 * the communication of its contents to others without express authorization
 * is prohibited.\n
 * Offenders will be held liable for the payment of damages.\n
 * All rights reserved in the event of the grant of a patent, utility model or design.
 *
 * @file         Definitions.cin
 *                                            
 * @author       Manfred Rast (XC-DX/EET4)
 * @date         21.04.2022
 * @version      0.2
 *
 * @brief Common definitions for diagnostics.
 *
 * @details ToDo
 *
 * @attention THIS IS A COMMON LIBRARY FILE AND MAY ONLY BE EDITED BY THOSE RESPONSIBLE FOR THE LIBRARY.
 */

variables
{

  //! @enum def_truefalse
  /**
  * Enumeration for boolean type.
  */
  enum def_truefalse
  {
    def_FALSE = 0,
    def_TRUE = 1
  };

  //! @enum def_verdict
  /**
  * Enumeration for test verdict.
  */
  enum def_verdict
  {
    def_PASS = 0,
    def_FAIL = 1
  };  

  //! @enum def_OnOff
  /**
  * Enumeration for On/Off type.
  */
  enum def_OnOff
  {
    def_Off = 0,
    def_On  = 1
  };
  
  char def_OnOffStr[2][4] = {"off", "on"};
}

