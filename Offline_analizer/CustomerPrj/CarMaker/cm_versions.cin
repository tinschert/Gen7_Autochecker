/*@!Encoding:1252*/
includes
{
	
}

variables
{
  char cm_version_matrix[2][2][20] = {
      {"12.0.2", "CM.exe"},
	  {"13.1.2", "CM_Office.exe"} 
    };
}