/*@!Encoding:1252*/
includes
{
	
}

variables
{
  char vehicle_variant_matrix[4][30] = {
      "VW_GOLF_VII",
	  "VW_GOLF_VII_W3",
	  "F150_OD",
	  "VW_GOLF_VII_ROTA"
    };
}