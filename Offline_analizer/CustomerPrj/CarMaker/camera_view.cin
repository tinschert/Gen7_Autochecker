/*@!Encoding:1252*/
includes
{
	
}

variables
{
  char camera_view_matrix[1][10] = {
      "FVideo"
    };
}