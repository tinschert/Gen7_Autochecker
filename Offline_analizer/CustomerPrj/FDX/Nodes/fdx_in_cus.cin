/*@!Encoding:1252*/
/**
 * @file fdx_in_cus.cin
 * @author ADAS_HIL_TEAM
 * @date 10-04-2022
 * @brief  handles the conversion from FDX received variables to restbus variables with customer specific logic manually coded.
 *
 * ################################################################
 * C O P Y R I G H T S
 * ----------------------------------------------------------------
 * Copyright (c) 2022-2023 by Robert Bosch GmbH. All rights reserved.
 
 * The reproduction, distribution and utilization of this file as
 * well as the communication of its contents to others without express
 * authorization is prohibited. Offenders will be held liable for the
 * payment of damages. All rights reserved in the event of the grant
 * of a patent, utility model or design.
 *
 * ################################################################
*/


variables {
}

on start {
}

on stopMeasurement {
}

