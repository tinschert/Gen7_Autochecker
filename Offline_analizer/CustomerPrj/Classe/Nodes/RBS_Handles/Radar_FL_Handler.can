/*@!Encoding:65001*/
includes
{
  #define ADAS_HIL
  #include "..\..\..\Restbus\Nodes\CRadarFL_CAN_RadarFL.can"
}

variables
{
  
}

