/*@!Encoding:65001*/
includes
{
  #define ADAS_HIL
  #include "..\..\..\Restbus\Nodes\CRadarFR_CAN_RadarFR.can"
}

variables
{
  
}

