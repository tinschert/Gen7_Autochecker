/*@!Encoding:65001*/
includes
{
  #define ADAS_HIL
  #include "..\..\..\Restbus\Nodes\CRadarFC_CAN_RadarFC.can"
}

variables
{
  
}

