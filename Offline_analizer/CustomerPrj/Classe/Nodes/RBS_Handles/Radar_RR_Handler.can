/*@!Encoding:65001*/
includes
{
  #define ADAS_HIL
  #include "..\..\..\Restbus\Nodes\CRadarRR_CAN_RadarRR.can"
}

variables
{
  
}

