/*@!Encoding:65001*/
includes
{
  #define ADAS_HIL
  #include "..\..\..\Restbus\Nodes\CRadarRL_CAN_RadarRL.can"
}

variables
{
  
}

