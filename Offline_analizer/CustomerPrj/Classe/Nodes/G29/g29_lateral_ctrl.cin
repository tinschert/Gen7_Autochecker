/*@!Encoding:65001*/
/**
 * @file g29_lateral_ctrl.cin
 * @author ADAS_HIL_TEAM
 * @date 29.01.2025
 * @brief  Assigns G29 buttons to the customer specific functions
 *
 * ################################################################
 * C O P Y R I G H T S
 * ----------------------------------------------------------------
 * Copyright (c) 2023 by Robert Bosch GmbH. All rights reserved.
 
 * The reproduction, distribution and utilization of this file as
 * well as the communication of its contents to others without express
 * authorization is prohibited. Offenders will be held liable for the
 * payment of damages. All rights reserved in the event of the grant
 * of a patent, utility model or design.
 *
 * ################################################################
*/
 

 /**
  * @brief contains the button array event handler received from the g29 and maps the inputs towards Classe system variables
  * 
  */
  
includes
{
}

variables
{
  enum e_wheel_ctrl_status
  {
    WCS_G29_IS_OUT_OF_USAGE_INIT_START = 0, // G29 is out of use; sync time has been started between G29 wheel pos and hvm steering wheel pos
    WCS_G29_IS_OUT_OF_USAGE_INIT_END = 1, // G29 is out of use; sync time has been ended
    WCS_G29_IS_READY_TO_USE = 2, // Read to detect driver interaction
    WCS_G29_IS_IN_USE = 3 // G29 is actively used by driver
  };
  
  msTimer g29_init_timer;
  
  double g_g29_drv_swa_prev_in_deg = 0;
  double g_g29_swa_req_prev_in_deg = 0;
  
  const long NBR_OF_SWA_SPEED_VALUES = 10;
  long g_idx_auto_swa_speed = 0;
  double g_drv_swa_speed_in_deg_p_s;
  double g_auto_swa_speed_in_deg_p_s[NBR_OF_SWA_SPEED_VALUES+1];
  
  double g_swa_diff_to_override_auto_steering = 0;
  
  double g_drv_delta_dir = 1;
  double g_auto_delta_dir = 1;
  double g_swa_time_stamp_in_s, g_swa_time_stamp_prev_in_s;
}

/**
* @brief contains the mapping of g29 steering wheel angle to sysvars. 
* 
*/

on sysvar hil_vehicle::wheel_angle_req_active
{
  if(@hil_vehicle::wheel_angle_req_active == @hil_vehicle::wheel_angle_req_active::notactive)
  {
    @hil_drv_g29::wheel_ctrl_status = @hil_drv_g29::wheel_ctrl_status::G29_IS_OUT_OF_USAGE_INIT_START;
    setTimer(g29_init_timer, 2000);
  }
}

on timer g29_init_timer
{
  @hil_drv_g29::wheel_ctrl_status = @hil_drv_g29::wheel_ctrl_status::G29_IS_OUT_OF_USAGE_INIT_END;
}

on sysvar hil_drv_g29::steering_wheel_angle_req 
{
  g_swa_time_stamp_in_s = timeNowFloat()/100000;
  
  if(@hil_vehicle::wheel_angle_req_active == @hil_vehicle::wheel_angle_req_active::active)
  {
    @hil_drv_g29::wheel_ctrl_status = @hil_drv_g29::wheel_ctrl_status::G29_IS_IN_USE;
  }
  
  if(@hil_drv_g29::wheel_ctrl_status != @hil_drv_g29::wheel_ctrl_status::G29_IS_IN_USE)
  {
    g_drv_swa_speed_in_deg_p_s = (@hil_drv_g29::steering_wheel_angle_req - g_g29_drv_swa_prev_in_deg) / (g_swa_time_stamp_in_s - g_swa_time_stamp_prev_in_s);
    g_auto_swa_speed_in_deg_p_s[g_idx_auto_swa_speed] = (@hil_drv_g29::auto_steering_wheel_angle_req - g_g29_swa_req_prev_in_deg) / (g_swa_time_stamp_in_s - g_swa_time_stamp_prev_in_s);
    
    if(g_drv_swa_speed_in_deg_p_s > 0)
    {
      g_drv_delta_dir = 1;
    }
    else if(g_drv_swa_speed_in_deg_p_s < 0)
    {
      g_drv_delta_dir = -1;
    }
    if(g_auto_swa_speed_in_deg_p_s[g_idx_auto_swa_speed] > 0)
    {
      g_auto_delta_dir = 1;
    }
    else if(g_auto_swa_speed_in_deg_p_s[g_idx_auto_swa_speed] < 0)
    {
      g_auto_delta_dir = -1;
    }
  }
  
  f_g29_calc_avg_auto_swa_speed();
  
  switch(@hil_drv_g29::wheel_ctrl_status)
  {
    case sysvar::hil_drv_g29::wheel_ctrl_status::G29_IS_OUT_OF_USAGE_INIT_START:
      break;
    case sysvar::hil_drv_g29::wheel_ctrl_status::G29_IS_OUT_OF_USAGE_INIT_END:
      @hil_drv_g29::wheel_ctrl_status = @hil_drv_g29::wheel_ctrl_status::G29_IS_READY_TO_USE;
      break;
    case sysvar::hil_drv_g29::wheel_ctrl_status::G29_IS_READY_TO_USE:
      g_swa_diff_to_override_auto_steering = (15 + _min(25, (long)((abs(g_auto_swa_speed_in_deg_p_s[NBR_OF_SWA_SPEED_VALUES])/120.0) * 25)));
      // driver steering in opposite direction
      if((g_drv_delta_dir / g_auto_delta_dir) == -1)
      {
        if(abs(@hil_drv_g29::auto_steering_wheel_angle_req - @hil_drv_g29::steering_wheel_angle_req) > g_swa_diff_to_override_auto_steering)
        {
          @hil_drv_g29::wheel_ctrl_status = @hil_drv_g29::wheel_ctrl_status::G29_IS_IN_USE;
          write("Driver interaction has been detected on G29 steering wheel at %ds (counter-steering; swa_req = %d, swa_drv = %d) !", timeNow()/100000, (long)@hil_drv_g29::auto_steering_wheel_angle_req, (long)@hil_drv_g29::steering_wheel_angle_req);
        }
      }
      // driver steering in same direction
      else
      {
        if(
          ((g_drv_swa_speed_in_deg_p_s > 0) && (@hil_drv_g29::steering_wheel_angle_req > @hil_drv_g29::auto_steering_wheel_angle_req + g_swa_diff_to_override_auto_steering)) ||
          ((g_drv_swa_speed_in_deg_p_s < 0) && (@hil_drv_g29::steering_wheel_angle_req < @hil_drv_g29::auto_steering_wheel_angle_req - g_swa_diff_to_override_auto_steering))
        )
        {
          @hil_drv_g29::wheel_ctrl_status = @hil_drv_g29::wheel_ctrl_status::G29_IS_IN_USE;
          write("Driver interaction has been detected on G29 steering wheel at %ds (steering same direction; swa_req = %d deg, swa_drv = %d deg) !", timeNow()/100000, (long)@hil_drv_g29::auto_steering_wheel_angle_req, (long)@hil_drv_g29::steering_wheel_angle_req);
        }
      }
      break;
    case sysvar::hil_drv_g29::wheel_ctrl_status::G29_IS_IN_USE:
      @hil_drv::steering_wheel_angle_req = -@hil_drv_g29::steering_wheel_angle_req;
      break;
    default:
      break;
  }
  
  g_g29_swa_req_prev_in_deg = @hil_drv_g29::auto_steering_wheel_angle_req;
  g_g29_drv_swa_prev_in_deg = @hil_drv_g29::steering_wheel_angle_req;
  g_swa_time_stamp_prev_in_s = g_swa_time_stamp_in_s;
  g_idx_auto_swa_speed = (g_idx_auto_swa_speed+1) % NBR_OF_SWA_SPEED_VALUES;
}

void f_g29_calc_avg_auto_swa_speed()
{
  long i;
  
  for(i=0;i<NBR_OF_SWA_SPEED_VALUES;i++)
  {
    g_auto_swa_speed_in_deg_p_s[NBR_OF_SWA_SPEED_VALUES] += g_auto_swa_speed_in_deg_p_s[i];
  }
  g_auto_swa_speed_in_deg_p_s[NBR_OF_SWA_SPEED_VALUES] = g_auto_swa_speed_in_deg_p_s[NBR_OF_SWA_SPEED_VALUES] / (double)NBR_OF_SWA_SPEED_VALUES; 
}

