/*@!Encoding:65001*/
/**
 * @file g29_tgt_ctrl_cus.cin
 * @author ADAS_HIL_TEAM
 * @date 03.09.2024
 * @brief  Assigns Target G29 buttons to the customer specific functions
 *
 * ################################################################
 * C O P Y R I G H T S
 * ----------------------------------------------------------------
 * Copyright (c) 2024 by Robert Bosch GmbH. All rights reserved.
 
 * The reproduction, distribution and utilization of this file as
 * well as the communication of its contents to others without express
 * authorization is prohibited. Offenders will be held liable for the
 * payment of damages. All rights reserved in the event of the grant
 * of a patent, utility model or design.
 *
 * ################################################################
*/

variables
{
  int step_count = 0;
  int select_target_id;
  int previous_target_id;
  int target_id;
}

/**
* @brief contains the mapping of "Traffic Object ID + 1 " selection 
* 
*/
on sysvar sysvar::hil_tgt_g29::clockwise
{
  if (@this == 1)
  {
    step_count = step_count + 1;

    // Wrap step_count between 0 and 23
    if (step_count > 20)
    {
      step_count = 0;
    }

    //write("step_counter : %d", step_count);

    if (step_count % 2 == 0)
    {
      @hil_tgt_g29::floating_target_id = step_count / 2;
      //write("Target id : %d", @hil_tgt_g29::floating_traget_id);
    }
  }
}


/**
* @brief contains the mapping of "Traffic Object ID - 1 " selection 
* 
*/
on sysvar sysvar::hil_tgt_g29::anti_clockwise
{
  if (@this == 1)
  {
    step_count = step_count - 1;

    if (step_count < 0)
    {
      step_count = 20;
    }

    //write("step_counter : %d", step_count);

    if (step_count % 2 == 0)
    {
      @hil_tgt_g29::floating_target_id = step_count / 2;
      //write("Target id : %d", @hil_tgt_g29::floating_traget_id);
    }
  }
}


/**
* @brief contains the mapping of resetting the Traffic id counter variable to 0
* 
*/
on sysvar sysvar::hil_tgt_g29::r3
{
  step_count = 0;
}

/**
* @brief contains the mapping checking into the Traffic object to overtake it's control 
*/
on sysvar sysvar::hil_tgt_g29::enter
{
  @hil_tgt_g29::selected_target_id = @hil_tgt_g29::floating_target_id;
  
  @Classe_Obj_Sim::obj_ctrl.ctrl_status_tgt_steering_wheel_angle[previous_target_id]  = 0;//Checks out the previously connected Traffic object
  @Classe_Obj_Sim::obj_ctrl.ctrl_status_velocity[previous_target_id] = 0;
  @Classe_Obj_Sim::obj_ctrl.autoslow_is_on[previous_target_id]  = 0;
  @Classe_Obj_Sim::obj_ctrl.dil_ctrl_is_on[previous_target_id] = 0;
  
  
  @Classe_Obj_Sim::obj_ctrl.ctrl_status_tgt_steering_wheel_angle[target_id]  = 1; //Checks into the new Traffic object
  @Classe_Obj_Sim::obj_ctrl.ctrl_status_velocity[@hil_tgt_g29::selected_target_id] = 1;
  @Classe_Obj_Sim::obj_ctrl.autoslow_is_on[@hil_tgt_g29::selected_target_id]  = 1;
  @Classe_Obj_Sim::obj_ctrl.dil_ctrl_is_on[@hil_tgt_g29::selected_target_id] = 1;
  //write("Checked into Traffic obj id  : %d", select_target_id);
  
  previous_target_id = @hil_tgt_g29::selected_target_id;
}

/**
* @brief contains the mapping to steer the traffic object selected
* 
*/
on sysvar_update sysvar::hil_tgt_g29::steering_wheel_angle_req
{
  @Classe_Obj_Sim::obj_ctrl.obj_tgt_steering_wheel_angle[target_id] = - @hil_tgt_g29::steering_wheel_angle_req * 0.1;
}



on sysvar sysvar::hil_tgt_g29::brake_pedal_position
{
  @Classe_Obj_Sim::obj_ctrl.obj_target_brake_pedal_position[target_id] = @this;
}

on sysvar_update sysvar::hil_tgt_g29::gas_pedal_position
{
  @Classe_Obj_Sim::obj_ctrl.obj_target_gas_pedal_position[target_id] = @this;
}

/**
* @brief contains the mapping to act as Drive Gear 
* 
*/
on sysvar sysvar::hil_tgt_g29::dpad_N
{
   @Classe_Obj_Sim::obj_ctrl.obj_gear[target_id] = 0;
}

/**
* @brief contains the mapping to Reverse the acceleration (acts as reverse gear) 
* 
*/
on sysvar sysvar::hil_tgt_g29::dpad_S
{
  @Classe_Obj_Sim::obj_ctrl.obj_gear[target_id] = 1;
}