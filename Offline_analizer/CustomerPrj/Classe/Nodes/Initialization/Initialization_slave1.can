/*@!Encoding:1252*/
/**
 * @file Initialization_slave1.can
 * @author ADAS_HIL_TEAM
 * @date 09-25-2023
 * @brief  contains code that initilizes variables to the correct init values for Classe	 includes the files necessary for initialization. Those files are mostly auto-generated based on the Excel-Tables! (RW)
 *
 * ################################################################
 * C O P Y R I G H T S
 * ----------------------------------------------------------------
 * Copyright (c) 2023 by Robert Bosch GmbH. All rights reserved.
 
 * The reproduction, distribution and utilization of this file as
 * well as the communication of its contents to others without express
 * authorization is prohibited. Offenders will be held liable for the
 * payment of damages. All rights reserved in the event of the grant
 * of a patent, utility model or design.
 *
 * ################################################################
*/


/**
  * @brief includes the files necessary for initialization. Those files are mostly auto-generated based on the Excel-Tables! (RW)
  * RBS: Contains the initialization of the RBS signals based on the variant.ini file.
  * FDX: Contains the initialization of the FDX signals. Initialize everything that can control the RBS (sets the values to 0) BUT DONT initialize the sensor set or anything that can control Classe
  *       -> The Values (0) are not that important, because: It's for the case that an event happens (e.g. on signal/on message/..) in which those values of the init are written onto the RBS. The RBS reading the ini file is the last part of the sequence which is why in the end of the init those values count, not the ones that are set here.
  * Classe: Contains the initialization of the Classe signals based on the variant.ini file and sets the object signals to zero. Initialization of the object signals is written manually.
  */
  
/************ Platform functions ************/
/****** To be Merged manually by Customer Project*****/  

includes
{
	#include "..\..\..\FDX\Nodes\fdx_init.cin"
	#include "Software_OD.cin"
	#include "..\..\..\..\Platform\Classe\Nodes\Initialization\classe_init_value.cin"
	#include "init_rbs_can_VW_GOLF_VII.cin"
	#include "init_rbs_can_VW_GOLF_VII_W3.cin"
	#include "init_rbs_can_F150_OD.cin"
	#include "..\..\..\..\CustomerPrj\Classe\Nodes\Initialization\customer_init_VW_GOLF_VII.cin"
	#include "..\..\..\..\CustomerPrj\Classe\Nodes\Initialization\customer_init_VW_GOLF_VII_W3.cin"
	#include "..\..\..\..\CustomerPrj\Classe\Nodes\Initialization\customer_init_F150_OD.cin"
}


/**
  * @brief enumeration which contains all nodes and important features which should be initialized from signal.ini file.
  * Member of this enum shall represent different section of signal.ini file
  */
  
variables {
  char absPath[256];

  // Init variables
  int init_count = 1;
  int initFlag = 0;
  int Update_Timer_Cycle = 10;
  int initcounter;
  int prestart_mode=1;  //1 - in on prestart function, 0 - not in prestart function anymore //this variable is used as a condition if the init_counter shall be set to 0 or not (in prestart mode is not needed)
  int previous_hil_mode;
  int previous_rendering_status;
  
  mstimer FDX_Update_Timer;
  mstimer delay_timer_MF4_renaming;
  
  msTimer Bus_Update_Timer;
  mstimer Classe_Update_Timer;
  msTimer waitOfftime;
  msTimer waitCMtime;
} 

/**
  * @brief This event procedure is called on the start of the measurement
  * Set the timers so that every 5ms 
  */
on start
{
  prestart_mode = 0;
}


/** \brief On Start This event procedure is called before the start of measurement (before the ON START event) 
 *  It initilizes all the environmental variables before the RED option to STOP measurement on the CANoe is enabled
*/
on prestart
{ 
  prestart_mode = 1;  //variable is used in the init functions (file init_rbs.cin) //note : auto code generation for init_rbs.cin has to be updated accordingly  
  initcounter = 1;
  init_sequence_without_timers();
} 


/** \brief On Pre Stop This event procedure is called before the stop of measurement 
 *  It sets the powerMode_Rv env var to value 0, so the ECUs can be shutdown correctly
*/
on preStop
{
  
}

on stopMeasurement
{
  
}

on sysvar sysvar::hil_ctrl::hil_mode
{
  if(@this == 0)
  {
    setTimer(waitOfftime,2000);
  }
}

on timer waitOfftime
{
  Stop();
}

/**
  * @brief If the button "Init All Signals" in Classe is pressed it will call init_all_signals function to re-init the environmental variables. (RW)
  */ 
on sysvar_change sysvar::hil_ctrl::init_all
{ 
  if(@this == 1)
  {  
    write("Initializing all signals.");
    setTimerCyclic(Bus_Update_Timer,Update_Timer_Cycle);
  }
}    

on sysvar hil_ctrl::init_rbs
{
  if(@this == 1)
  {
    initcounter = 0;
    initFlag = 0;
    init_count = 1;
    setTimerCyclic(Bus_Update_Timer,Update_Timer_Cycle);
  }
}

On timer Bus_Update_Timer
{
  rbs_init_with_timers();
}

/**
  * \fn void hand over to user
  * \brief reset of the init all signals button and sets the flag init done to true
  */
void hand_over_to_user()
{
  cancelTimer(Bus_Update_Timer);
  write("hand over to user slave1");
}

/************ Platform template functions ************/
/***** Automated code generation starts here *****/


/**
  * @brief Initializes the signals using the signal.ini. Order: 1. FDX, 2. Classe, 3. RBS.
  * In those functions the signals are split into groups of 25. So max number of signals is 25*125=3125. This is for CANoe so it does not get a big load peak. (RW)
  */
void init_sequence_without_timers()
{
	write("Start of Prestart...");
  /**
    * Initialize RBS
    */
  //Initializing to default as a_variant_veh_0
  //125 groups - should be enough for most cases :)
	for (init_count=0;init_count < 125;) init_CRadarFL_VW_GOLF_VII();
	for (init_count=0;init_count < 125;) init_CRadarFR_VW_GOLF_VII();
	for (init_count=0;init_count < 125;) init_CRadarRL_VW_GOLF_VII();
	for (init_count=0;init_count < 125;) init_CRadarRR_VW_GOLF_VII();
	write("Initializing RBS done.");

  /**
    * End of preStart initialization.
    */
  initcounter = 0;
  initFlag = 0;
  init_count = 1;
  hand_over_to_user();
  write("End of Prestart.");
}


/**
  * @brief Initialization of RBS using timers. This can be called on the run.
  */
void rbs_init_with_timers()
{
  if(initFlag==0)
  {
    initFlag=1;
    write("Start of initializing RBS variables...");
  }
	if ((@hil_ctrl::radar_fl_sim == 1) && (initFlag == 1)) {
		switch(@hil_ctrl::vehicle)
		{
			case VW_GOLF_VII:
				init_CRadarFL_VW_GOLF_VII();
				break;
			case VW_GOLF_VII_W3:
				init_CRadarFL_VW_GOLF_VII_W3();
				break;
			case F150_OD:
				init_CRadarFL_F150_OD();
				break;
			case VW_GOLF_VII_ROTA:
				init_CRadarFL_VW_GOLF_VII_ROTA();
				break;
		}
	}else if ((@hil_ctrl::radar_fr_sim == 1) && (initFlag == 2)) {
		switch(@hil_ctrl::vehicle)
		{
			case VW_GOLF_VII:
				init_CRadarFR_VW_GOLF_VII();
				break;
			case VW_GOLF_VII_W3:
				init_CRadarFR_VW_GOLF_VII_W3();
				break;
			case F150_OD:
				init_CRadarFR_F150_OD();
				break;
			case VW_GOLF_VII_ROTA:
				init_CRadarFR_VW_GOLF_VII_ROTA();
				break;
		}
	}else if ((@hil_ctrl::radar_rl_sim == 1) && (initFlag == 3)) {
		switch(@hil_ctrl::vehicle)
		{
			case VW_GOLF_VII:
				init_CRadarRL_VW_GOLF_VII();
				break;
			case VW_GOLF_VII_W3:
				init_CRadarRL_VW_GOLF_VII_W3();
				break;
			case F150_OD:
				init_CRadarRL_F150_OD();
				break;
			case VW_GOLF_VII_ROTA:
				init_CRadarRL_VW_GOLF_VII_ROTA();
				break;
		}
	}else if ((@hil_ctrl::radar_rr_sim == 1) && (initFlag == 4)) {
		switch(@hil_ctrl::vehicle)
		{
			case VW_GOLF_VII:
				init_CRadarRR_VW_GOLF_VII();
				break;
			case VW_GOLF_VII_W3:
				init_CRadarRR_VW_GOLF_VII_W3();
				break;
			case F150_OD:
				init_CRadarRR_F150_OD();
				break;
			case VW_GOLF_VII_ROTA:
				init_CRadarRR_VW_GOLF_VII_ROTA();
				break;
		}
	}else if(initFlag==1 || initFlag==2 || initFlag==3 || initFlag==4) {
    // In the case that one ECU has not to be initialized anymore increase the flag to skip that one
    write("%d skipped",initFlag);
    initFlag++;
    init_count = 1;
  }
  if(initFlag==5) {
    // End of the RBS initialization is reached
    initcounter = 0;
    initFlag = 0;
    init_count = 1;	
    hand_over_to_user();
    write("End of initializing RBS variables.");
  }
}
