/*@!Encoding:1252*/
// Autogenerated by -> Platform\Classe\Scripts\Rbs_Scripts\create_ininode.py 

includes
{
}

variables 
{
} 

void init_MPC3_F150_OD()
{
  if(init_count == 1)
  {
  $CAN_MPC3::ABS_UN_PR_11::ABSMode = 0;
  $CAN_MPC3::ABS_UN_PR_11::DSCActivityStatus = 0;
  $CAN_MPC3::ABS_UN_PR_11::TCSSwitchSports = 2;
  $CAN_MPC3::ABS_UN_PR_11::TractionControlActive = 0;
  $CAN_MPC3::ABS_UN_PR_11::TractionControlFault = 0;
  $CAN_MPC3::ABS_UN_PR_11::YawControlFault = 0;
  $CAN_MPC3::ABS_UN_PR_4::ABSFault = 0;
  $CAN_MPC3::ABS_UN_PR_4::YawRate = 0;
  $CAN_MPC3::ABS_UN_PR_6::GSAPosStatus = 0;
  $CAN_MPC3::ABS_UN_PR_GW_2::ABSEngVacReq = 0;
  $CAN_MPC3::ABS_UN_PR_GW_2::ABSPwrTrnTorqReq = 0;
  $CAN_MPC3::ABS_UN_PR_GW_2::BrakePressure = 39.8;
  $CAN_MPC3::ABS_UN_PR_GW_2::BrakePressureQF = 3;
  $CAN_MPC3::ABS_UN_PR_GW_2::VehicleSpeed = 0;
  $CAN_MPC3::ABS_UN_PR_GW_2::VehicleSpeedQF = 3;
  $CAN_MPC3::ABS_UN_PR_GW_3::HillDescentMode = 1;
  $CAN_MPC3::ABS_UN_PR_GW_3::VehMovementDirection = 2;
  $CAN_MPC3::ABS_UN_PR_GW_3::VehMovementStatus = 0;
  $CAN_MPC3::ABS_UN_PR_GW_3::WheelDirectionFL = 3;
  $CAN_MPC3::ABS_UN_PR_GW_3::WheelDirectionFR = 3;
  $CAN_MPC3::ABS_UN_PR_GW_3::WheelDirectionRL = 3;
  $CAN_MPC3::ABS_UN_PR_GW_3::WheelDirectionRR = 3;
  $CAN_MPC3::ABS_UN_PR_GW_5_1::WheelSpeedFrL = 0;
  $CAN_MPC3::ABS_UN_PR_GW_5_1::WheelSpeedFrLQF = 3;
  $CAN_MPC3::ABS_UN_PR_GW_5_1::WheelSpeedFrR = 0;
  }
  if(init_count == 2)
  {
  $CAN_MPC3::ABS_UN_PR_GW_5_1::WheelSpeedFrRQF = 3;
  $CAN_MPC3::ABS_UN_PR_GW_5_2::WheelSpeedReL = 0;
  $CAN_MPC3::ABS_UN_PR_GW_5_2::WheelSpeedReLQF = 3;
  $CAN_MPC3::ABS_UN_PR_GW_5_2::WheelSpeedReR = 0;
  $CAN_MPC3::ABS_UN_PR_GW_5_2::WheelSpeedReRQF = 3;
  $CAN_MPC3::ACC_01::AxrArbitrated = 0;
  $CAN_MPC3::ACC_01::ESP_NotAvailable = 0;
  $CAN_MPC3::AEB_01::ADAS_FwdWarnFltTxt = 0;
  $CAN_MPC3::AEB_01::ADAS_Sts_AEB = 0;
  $CAN_MPC3::AEB_01::ADAS_Sts_FCW = 0;
  $CAN_MPC3::AEB_01::ADAS_WarnTyp_FCWAEB = 0;
  $CAN_MPC3::AEB_01::ADAS_WarnType_FCW = 0;
  $CAN_MPC3::AEB_01::AEBFActive = 0;
  $CAN_MPC3::AEB_01::AEBOncomingFeatureStatus = 0;
  $CAN_MPC3::AEB_01::AEBPActive = 0;
  $CAN_MPC3::AEB_01::AebFunctionStatus = 0;
  $CAN_MPC3::BCM_PR_GW_16_UN::UserSetTimeDate = 2641467294753;
  $CAN_MPC3::BCM_PR_GW_1_UN::CarMode = 0;
  $CAN_MPC3::BCM_PR_GW_1_UN::DirectionIndicationSwitch = 0;
  $CAN_MPC3::BCM_PR_GW_1_UN::MainBeamIndication = 0;
  $CAN_MPC3::BCM_PR_GW_1_UN::PowerMode = 0;
  $CAN_MPC3::BCM_PR_GW_1_UN::PowerMode_UB = 1;
  $CAN_MPC3::BCM_PR_GW_1_UN::RunningStandby = 0;
  $CAN_MPC3::BCM_SP_GW_2_UN::DirectionIndication = 0;
  $CAN_MPC3::BCM_SP_GW_2_UN::DirectionIndication_UB = 1;
  }
  if(init_count == 3)
  {
  $CAN_MPC3::BCM_SP_GW_2_UN::LDWSwitchReq = 0;
  $CAN_MPC3::BCM_SP_GW_2_UN::LDWSwitchReq_UB = 1;
  $CAN_MPC3::BCM_SP_GW_2_UN::LowBeamIndication = 0;
  $CAN_MPC3::BCM_SP_GW_2_UN::LowBeamIndication_UB = 1;
  $CAN_MPC3::CHCM_FR_PR_GW_2_UN::SuspensionHeightFL = 4;
  $CAN_MPC3::CHCM_FR_PR_GW_2_UN::SuspensionHeightFR = 1;
  $CAN_MPC3::CHCM_FR_PR_GW_2_UN::SuspensionHeightRL = 2;
  $CAN_MPC3::CHCM_FR_PR_GW_2_UN::SuspensionHeightRR = 4;
  $CAN_MPC3::CHCM_FR_PR_GW_3_UN::AIR_ControlStatus = 0;
  $CAN_MPC3::CHCM_FR_PR_GW_3_UN::AIR_SuspensionMode = 3;
  $CAN_MPC3::DADCA_FR_PR_GW_4_UN::TSRCountry = 13;
  $CAN_MPC3::DADCA_FR_PR_GW_4_UN::TSRHandOfTraffic = 1;
  $CAN_MPC3::DADCA_UN_PR_3::DADCFuncStatus = 0;
  $CAN_MPC3::DADCA_UN_PR_GW_2::RWSAngleDmd = -15;
  $CAN_MPC3::DADCA_UN_PR_GW_2::RWSAngleDmdPDC = -15;
  $CAN_MPC3::DADCA_UN_PR_GW_2::RWSFaultAngle = 0;
  $CAN_MPC3::DADCA_UN_PR_GW_2::RWSFaultStraight = 0;
  $CAN_MPC3::DADCA_UN_PR_GW_2::RWSLinRngeAngleDmd = -15;
  $CAN_MPC3::DADCA_UN_PR_GW_2::RWSMotTypeServeLat = 0;
  $CAN_MPC3::DADCA_UN_PR_GW_2::RWSMotTypeServeLong = 0;
  $CAN_MPC3::DADCA_UN_PR_GW_2::RWSMotTypeServeLvl = 0;
  $CAN_MPC3::DADCA_UN_PR_GW_2::RWSMotTypeServeMode = 0;
  $CAN_MPC3::DADCA_UN_PR_GW_3::DADCRWSAngleReq = -15;
  $CAN_MPC3::DADCA_UN_PR_GW_3::DrvLimRWSAct = 0;
  $CAN_MPC3::DADCA_UN_PR_GW_3::RWSAngleAct = -15;
  }
  if(init_count == 4)
  {
  $CAN_MPC3::DADCA_UN_PR_GW_3::RWSStrkeDmd = -40;
  $CAN_MPC3::DADCA_UN_PR_GW_3::RWSSysStats = 0;
  $CAN_MPC3::DADCA_UN_PR_GW_3::RWSTRConfig = 0;
  $CAN_MPC3::DADCA_UN_PR_GW_3::RWSTerrChngModeStatus = 0;
  $CAN_MPC3::DADCA_UN_PR_GW_3::RWSTerrainModeExt = 0;
  $CAN_MPC3::DADCA_UN_SP_5::CustomerSymptomIPMA = 0;
  $CAN_MPC3::DADCA_UN_SP_5::CustomerSymptomIPMA_UB = 0;
  $CAN_MPC3::DBC_Version::DBC_VersionIdMajor = 3;
  $CAN_MPC3::DBC_Version::DBC_VersionIdMinor = 3;
  $CAN_MPC3::GSR_ISA_CAN_RX_01::ISA_OUTPUT_ENABLED = 0;
  $CAN_MPC3::GSR_ISA_CAN_RX_01::ISA_SLWF_OUTPUT_ENABLED = 0;
  $CAN_MPC3::GSR_ISA_CAN_RX_01::ISA_SLWF_TYPE = 0;
  $CAN_MPC3::GSR_ISA_CAN_RX_01::ISA_SL_CHNG_AUDIO_FEEDBACK = 0;
  $CAN_MPC3::GSR_ISA_CAN_RX_01::ISA_USER_TERMINATION = 0;
  $CAN_MPC3::GWM_UN_PR_1::TerrainModeReqExt = 0;
  $CAN_MPC3::HCMA_PR_1::HBSeg0LT = 0;
  $CAN_MPC3::HCMA_PR_1::HBSeg0RT = 0;
  $CAN_MPC3::HCMA_PR_1::HBSeg1LT = 0;
  $CAN_MPC3::HCMA_PR_1::HBSeg1RT = 0;
  $CAN_MPC3::HCMA_PR_1::HBSeg2LT = 0;
  $CAN_MPC3::HCMA_PR_1::HBSeg2RT = 0;
  $CAN_MPC3::HCMA_PR_1::HBSeg3LT = 0;
  $CAN_MPC3::HCMA_PR_1::HBSeg3RT = 0;
  $CAN_MPC3::HCMA_PR_1::HBSeg4LT = 0;
  $CAN_MPC3::HCMA_PR_1::HBSeg4RT = 0;
  }
  if(init_count == 5)
  {
  $CAN_MPC3::HCMA_PR_1::HBSeg5LT = 0;
  $CAN_MPC3::HCMA_PR_1::HBSeg5RT = 0;
  $CAN_MPC3::HCMA_PR_1::HBSeg6LT = 0;
  $CAN_MPC3::HCMA_PR_1::HBSeg6RT = 0;
  $CAN_MPC3::HCMA_PR_1::HBSeg7LT = 0;
  $CAN_MPC3::HCMA_PR_1::HBSeg7RT = 0;
  $CAN_MPC3::HCMA_PR_1::HBSeg8LT = 0;
  $CAN_MPC3::HCMA_PR_1::HBSeg8RT = 0;
  $CAN_MPC3::HCMA_PR_1::HBSeg9LT = 0;
  $CAN_MPC3::HCMA_PR_1::HBSeg9RT = 0;
  $CAN_MPC3::HCMA_PR_1::HighBeamStatus = 0;
  $CAN_MPC3::HCMA_PR_1::LowBeamStatus = 0;
  $CAN_MPC3::HCMA_PR_2::ADBHorEdgeLT = -30;
  $CAN_MPC3::HCMA_PR_2::ADBHorEdgeRT = -30;
  $CAN_MPC3::HCMA_PR_2::LBStatus = 0;
  $CAN_MPC3::HCMA_PR_2::LaserStatus = 1;
  $CAN_MPC3::HCMA_PR_2::LightDist = 5;
  $CAN_MPC3::HCMB_PR_1::AFSLightDist_b = 15;
  $CAN_MPC3::HCMB_PR_1::AFSPHBAngleLT_b = 0;
  $CAN_MPC3::HCMB_PR_1::AFSPHBAngleRT_b = 0;
  $CAN_MPC3::HCMB_PR_1::AFSStatus_b = 15;
  $CAN_MPC3::HCMB_PR_1::LaserStatus_b = 0;
  $CAN_MPC3::IGM_PR_GW_7_UN::DisttoNextJunct = 0;
  $CAN_MPC3::IGM_PR_GW_7_UN::HandOfTrafficReq = 0;
  $CAN_MPC3::IGM_PR_GW_7_UN::InBuiltArea = 0;
  }
  if(init_count == 6)
  {
  $CAN_MPC3::IGM_PR_GW_7_UN::NavCountryCode = 0;
  $CAN_MPC3::IGM_PR_GW_7_UN::NavCurrRoadType = 0;
  $CAN_MPC3::IGM_PR_GW_7_UN::NavCurrState = 0;
  $CAN_MPC3::IGM_PR_GW_7_UN::NavSpdLimit = 0;
  $CAN_MPC3::IGM_PR_GW_7_UN::NavSpdLimitStatus = 0;
  $CAN_MPC3::IGM_PR_GW_7_UN::NavSpdLimitUnits = 0;
  $CAN_MPC3::IGM_PR_GW_7_UN::NumberofExitLanes = 0;
  $CAN_MPC3::IGM_PR_GW_7_UN::NumberofLanes = 0;
  $CAN_MPC3::IGM_PR_GW_7_UN::RightOfWay = 0;
  $CAN_MPC3::IGM_SP_GW_10_UN::AutoHighBeamSAEModeReq = 0;
  $CAN_MPC3::IGM_SP_GW_10_UN::AutoHighBeamSAEModeReq_UB = 0;
  $CAN_MPC3::IMU_TX1::acc_x = 0;
  $CAN_MPC3::IMU_TX1::acc_y = 0;
  $CAN_MPC3::IMU_TX1::acc_z = 0;
  $CAN_MPC3::IMU_TX1::crc_tx1 = 0;
  $CAN_MPC3::IMU_TX1::msg_cnt_tx1 = 0;
  $CAN_MPC3::IMU_TX1::status_acc_x = 0;
  $CAN_MPC3::IMU_TX1::status_acc_y = 0;
  $CAN_MPC3::IMU_TX1::status_acc_z = 0;
  $CAN_MPC3::IMU_TX2::crc_tx2 = 0;
  $CAN_MPC3::IMU_TX2::msg_cnt_tx2 = 0;
  $CAN_MPC3::IMU_TX2::rate_x = 0;
  $CAN_MPC3::IMU_TX2::rate_y = 0;
  $CAN_MPC3::IMU_TX2::rate_z = 0;
  $CAN_MPC3::IMU_TX2::status_rate_x = 0;
  }
  if(init_count == 7)
  {
  $CAN_MPC3::IMU_TX2::status_rate_y = 0;
  $CAN_MPC3::IMU_TX2::status_rate_z = 0;
  $CAN_MPC3::LANE_02::ElkeStatus = 0;
  $CAN_MPC3::LANE_02::ElkoAdjustInterventionTime = 0;
  $CAN_MPC3::LANE_02::ElkoAdjustWarningType = 0;
  $CAN_MPC3::LANE_02::ElkoStatus = 0;
  $CAN_MPC3::LANE_02::ElkreAdjustInterventionTime = 0;
  $CAN_MPC3::LANE_02::ElkreAdjustWarningType = 0;
  $CAN_MPC3::LANE_02::FeatureInteraction = 0;
  $CAN_MPC3::LANE_02::LdwAdjustSensitivity = 0;
  $CAN_MPC3::LANE_02::LdwAdjustWarningTime = 0;
  $CAN_MPC3::LANE_02::LdwAdjustWarningType = 0;
  $CAN_MPC3::LANE_02::LdwStatus = 0;
  $CAN_MPC3::LANE_02::LksStatus = 0;
  $CAN_MPC3::LANE_02::RdpAdjustSensitivity = 0;
  $CAN_MPC3::LANE_02::RdpAdjustWarningTime = 0;
  $CAN_MPC3::LANE_02::RdpAdjustWarningType = 0;
  $CAN_MPC3::LANE_02::RdpStatus = 0;
  $CAN_MPC3::LANE_02::SteeringSystemState = 0;
  $CAN_MPC3::LANE_05::EPSSensorAvailable = 1;
  $CAN_MPC3::LANE_05::EPS_IntRPCMaxTrq = -20.48;
  $CAN_MPC3::LANE_05::EPS_IntRPCMinTrq = -20.48;
  $CAN_MPC3::LANE_05::EPS_LatDrvLvl12SrvAvl = 0;
  $CAN_MPC3::LANE_05::RoadWheelAngle = 0;
  $CAN_MPC3::LANE_05::RoadWheelAngleSensorAvailable = 1;
  }
  if(init_count == 8)
  {
  $CAN_MPC3::LANE_05::SteeringSystemTorqueUsed = 0;
  $CAN_MPC3::LANE_05::SteeringWheelCapacitive = 2;
  $CAN_MPC3::LANE_05::TorsionBarSensorAvailable = 1;
  $CAN_MPC3::LHSWS_PR_GW_1_UN::JoypadDownBtnStatus = 0;
  $CAN_MPC3::LHSWS_PR_GW_1_UN::JoypadLeftBtnStatus = 0;
  $CAN_MPC3::LHSWS_PR_GW_1_UN::JoypadOKBtnStatus = 0;
  $CAN_MPC3::LHSWS_PR_GW_1_UN::JoypadRightBtnStatus = 0;
  $CAN_MPC3::LHSWS_PR_GW_1_UN::JoypadUpBtnStatus = 0;
  $CAN_MPC3::LIGHT_01::ClfFeatureCoded = 1;
  $CAN_MPC3::LIGHT_01::ClfFeatureStatus = 1;
  $CAN_MPC3::PCM_FR_PR_Core_B_UN::BrakeSwitchStatus = 1;
  $CAN_MPC3::PCM_FR_PR_Core_B_UN::EngineSpeed = 0;
  $CAN_MPC3::PCM_FR_PR_Core_B_UN::EngineSpeedQF = 3;
  $CAN_MPC3::PCM_FR_PR_Core_B_UN::MHStopStartStatus = 4;
  $CAN_MPC3::PCM_FR_PR_Core_B_UN::PowerPackStatus = 5;
  $CAN_MPC3::PCM_FR_PR_PedalPos_UN::PedalPosPro = 0;
  $CAN_MPC3::PCM_FR_PR_PedalPos_UN::PedalPosProQF = 3;
  $CAN_MPC3::PCM_FR_PR_WhlTorqTgt_UN::VSCHoldRequest = 0;
  $CAN_MPC3::PCM_FR_PR_WhlTorqTgt_UN::WheelTorqTgtWoIntF = 0;
  $CAN_MPC3::PCM_FR_PR_WhlTorqTgt_UN::WheelTorqTgtWoIntR = 0;
  $CAN_MPC3::PSCM_FR_PR_GW_1_UN::EPASDrvDmdExcess_dup = 0;
  $CAN_MPC3::PSCM_FR_PR_GW_1_UN::TorsionBarTorque = 0.04;
  $CAN_MPC3::PSCM_FR_PR_GW_1_UN::TorsionBarTorqueQF = 3;
  $CAN_MPC3::PSCM_FR_PR_GW_1_UN::TorsionBarTorqueSign = 1;
  $CAN_MPC3::PSCM_FR_PR_GW_2_UN::ActRoadWheelAngState = 2;
  }
  if(init_count == 9)
  {
  $CAN_MPC3::PSCM_FR_PR_GW_2_UN::ActRoadWheelAngValue = 0;
  $CAN_MPC3::RCM_FR_PR_GW_1_UN::DrivSeatBeltBcklError = 0;
  $CAN_MPC3::RCM_FR_PR_GW_1_UN::DrivSeatBeltBcklState = 1;
  $CAN_MPC3::RCM_FR_PR_TXID1_UN::A1 = 0;
  $CAN_MPC3::RCM_FR_PR_TXID1_UN::A1_STAT = 0;
  $CAN_MPC3::RCM_FR_PR_TXID1_UN::CLU_STAT = 0;
  $CAN_MPC3::RCM_FR_PR_TXID1_UN::PSIP1 = 0;
  $CAN_MPC3::RCM_FR_PR_TXID1_UN::PSIP1_STAT = 0;
  $CAN_MPC3::RCM_FR_PR_TXID2_UN::A2 = 0;
  $CAN_MPC3::RCM_FR_PR_TXID2_UN::A2_STAT = 0;
  $CAN_MPC3::RCM_FR_PR_TXID2_UN::PSIPP1 = 0;
  $CAN_MPC3::RCM_FR_PR_TXID2_UN::PSIPP1_STAT = 1;
  $CAN_MPC3::SASM_FR_GW_1_UN::SteeringWheelAngle = 0;
  $CAN_MPC3::SASM_FR_GW_1_UN::SteeringWheelAngleSpeed = 0;
  $CAN_MPC3::SASM_FR_GW_1_UN::SteeringWheelAngleStatus = 3;
  $CAN_MPC3::SASM_FR_GW_1_UN::SteeringWheelRotDir = 0;
  $CAN_MPC3::SignalGW_PR_1_UN::DemandHeight = 0;
  $CAN_MPC3::SignalGW_PR_1_UN::EstimatedHeight = 0;
  $CAN_MPC3::SignalGW_PR_1_UN::THETAP = 0;
  $CAN_MPC3::SignalGW_PR_3_UN::CountryCode = 0;
  $CAN_MPC3::SignalGW_PR_3_UN::VCGStatus = 0;
  $CAN_MPC3::SignalGW_PR_4_UN::AmbTempImpr = 25;
  $CAN_MPC3::SignalGW_PR_4_UN::DoorStatus = 0;
  $CAN_MPC3::SignalGW_PR_4_UN::ExteriorLightSwitchPos2 = 0;
  $CAN_MPC3::SignalGW_PR_4_UN::FrontFogLightIndication = 0;
  }
  if(init_count == 10)
  {
  $CAN_MPC3::SignalGW_PR_4_UN::MainBeamSwitch = 0;
  $CAN_MPC3::SignalGW_PR_4_UN::WasherFrontCmd_EUCD = 0;
  $CAN_MPC3::SignalGW_PR_4_UN::WasherRearCmd = 0;
  $CAN_MPC3::SignalGW_PR_4_UN::WiperFrontCmd_EuCD = 1;
  $CAN_MPC3::SignalGW_PR_4_UN::WiperRearCmd = 0;
  $CAN_MPC3::SignalGW_PR_4_UN::WiperStatus = 0;
  $CAN_MPC3::SignalGW_PR_6_UN::ATPCProStatus = 0;
  $CAN_MPC3::Snapshot_Data::GlobalRealTime = 0;
  $CAN_MPC3::Snapshot_Data::InCarTemp = 0;
  $CAN_MPC3::Snapshot_Data::MainECUSuppVolt = 0;
  $CAN_MPC3::Snapshot_Data::OutdoorTemp = 0;
  $CAN_MPC3::Snapshot_Data::PowrModePKT = 0;
  $CAN_MPC3::Snapshot_Data::Snapshot_Data_PDU_0 = 0;
  $CAN_MPC3::Snapshot_Data::TotalDistance = 0;
  $CAN_MPC3::TPM_PR_GW_4::ActualTyrePressureFL = 266;
  $CAN_MPC3::TPM_PR_GW_4::ActualTyrePressureFR = 266;
  $CAN_MPC3::TPM_PR_GW_4::ActualTyrePressureRL = 266;
  $CAN_MPC3::TPM_PR_GW_4::ActualTyrePressureRR = 266;
  $CAN_MPC3::TransmissionControl_A_GW_UN::KeepNetInAfterRunTCM = 1;
  $CAN_MPC3::TransmissionControl_A_GW_UN::TCMLockETSReq = 3;
  $CAN_MPC3::TransmissionControl_A_GW_UN::TCMParkReqAck = 0;
  $CAN_MPC3::TransmissionControl_A_GW_UN::TCMPositionDisplay = 1024;
  $CAN_MPC3::TransmissionControl_A_GW_UN::TCMStartEnable = 0;
  $CAN_MPC3::TransmissionControl_A_GW_UN::TCMText = 0;
  $CAN_MPC3::TransmissionControl_A_GW_UN::TransTICStatus = 1;
  }
  if(init_count == 11)
  {
  $CAN_MPC3::VEHCONFIG_400UN_AS::CcfAHBCalibration = 0;
  $CAN_MPC3::VEHCONFIG_400UN_AS::CcfAHBSensitivtyMenu = 0;
  $CAN_MPC3::VEHCONFIG_400UN_AS::CcfAHBSystemStatus = 0;
  $CAN_MPC3::VEHCONFIG_400UN_AS::CcfAdapDrvBeamSeg = 0;
  $CAN_MPC3::VEHCONFIG_400UN_AS::CcfAdaptDrvBeam = 0;
  $CAN_MPC3::VEHCONFIG_400UN_AS::CcfAdasNCapESS = 0;
  $CAN_MPC3::VEHCONFIG_400UN_AS::CcfAllWheelSteer = 0;
  $CAN_MPC3::VEHCONFIG_400UN_AS::CcfDD00GlobalRealTime = 0;
  $CAN_MPC3::VEHCONFIG_400UN_AS::CcfDD01TotalDistance = 0;
  $CAN_MPC3::VEHCONFIG_400UN_AS::CcfDD02MainECUSupVolts = 0;
  $CAN_MPC3::VEHCONFIG_400UN_AS::CcfDD04InCarTemp = 0;
  $CAN_MPC3::VEHCONFIG_400UN_AS::CcfDD05OutdoorTemp = 0;
  $CAN_MPC3::VEHCONFIG_400UN_AS::CcfDD06PowerModePKT = 0;
  $CAN_MPC3::VEHCONFIG_400UN_AS::CcfGlassType = 0;
  $CAN_MPC3::VEHCONFIG_400UN_AS::CcfHUDSubType = 0;
  $CAN_MPC3::VEHCONFIG_400UN_AS::CcfHeatedWindscreen = 0;
  $CAN_MPC3::VEHCONFIG_400UN_AS::CcfParkAssistHMI = 0;
  $CAN_MPC3::VEHCONFIG_400UN_AS::CcfSportbrake = 0;
  $CAN_MPC3::VEHCONFIG_400UN_AS::CcfSteeringWheelPosn = 0;
  $CAN_MPC3::VEHCONFIG_400UN_AS::CcfSuspensionType = 0;
  $CAN_MPC3::VEHCONFIG_400UN_AS::CcfVINPart1 = 0;
  $CAN_MPC3::VEHCONFIG_400UN_AS::CcfVINPart2 = 0;
  $CAN_MPC3::VEHCONFIG_400UN_AS::CcfVINPart3 = 0;
  $CAN_MPC3::VEHCONFIG_400UN_AS::CcfVehClearGuidance = 0;
  $CAN_MPC3::VEHCONFIG_400UN_AS::CcfVehicleType = 0;
  }
  if(init_count == 12)
  {
  $CAN_MPC3::VEHCONFIG_400UN_AS::SF_VEHCONFIG_400UN_AUTOSAR_PDU = 0;
  $CAN_MPC3::VEHCONFIG_400UN_AS::ccfGenericWheelBase = 0;
  $CAN_MPC3::VLC_01::ENG_DRIVER_REQ_TRQ_130 = 0;
  $CAN_MPC3::VLC_01::ENG_ENG_TRQ_130 = 0;
  $CAN_MPC3::VLC_01::ENG_IDAS_MAXMUM_TORQUE = 0;
  $CAN_MPC3::VLC_01::ENG_IDAS_MINMUM_TORQUE = 0;
  $CAN_MPC3::VLC_02::CVT_RATIO_INFO_191 = 0;
  $CAN_MPC3::Vehicle_CAN_01::ADS_Intervention = 0;
  $CAN_MPC3::Vehicle_CAN_01::AcceleratorPedalGradient = 0;
  $CAN_MPC3::Vehicle_CAN_01::AebBrakeFeatureStatus = 1;
  $CAN_MPC3::Vehicle_CAN_01::AebWarnFeatureStatus = 1;
  $CAN_MPC3::Vehicle_CAN_01::BrakeLampOnStatus = 0;
  $CAN_MPC3::Vehicle_CAN_01::DriverSeatBeltPosition = 3;
  $CAN_MPC3::Vehicle_CAN_01::EngineRunningStatus = 0;
  $CAN_MPC3::Vehicle_CAN_01::GasPedalPressedInKickDownMode = 0;
  $CAN_MPC3::Vehicle_CAN_01::Mileage = 0;
  $CAN_MPC3::Vehicle_CAN_01::RequestedDeceleration = 0;
  $CAN_MPC3::Vehicle_CAN_01::SelectedDrivingGear = 0;
  $CAN_MPC3::Vehicle_CAN_01::TSRDisplayEnableSwitch = 0;
  $CAN_MPC3::Vehicle_CAN_01::TrailerConnection = 0;
  $CAN_MPC3::Vehicle_CAN_09::ENG_EM_TEST_MODE_ENABLE = 0;
  $CAN_MPC3::Vehicle_CAN_09::EngineControllerStatus = 3;
  $CAN_MPC3::Vehicle_CAN_09::EngineRPM = 0;
  $CAN_MPC3::Vehicle_CAN_09::EngineRPM_Qbit = 0;
  $CAN_MPC3::Vehicle_CAN_09::Gateway1Timeout = 0;
  }
  if(init_count == 13)
  {
  $CAN_MPC3::Vehicle_CAN_09::Gateway2Timeout = 0;
  $CAN_MPC3::Vehicle_CAN_09::Gateway3Timeout = 0;
  $CAN_MPC3::Vehicle_CAN_09::Gateway4Timeout = 0;
  $CAN_MPC3::Vehicle_CAN_09::Gateway5Timeout = 0;
  $CAN_MPC3::Vehicle_CAN_09::LimiterActive = 0;
  $CAN_MPC3::Vehicle_CAN_09::RoadSlope = 0;
  $CAN_MPC3::Vehicle_CAN_09::RoadSlope_Qbit = 0;
  $CAN_MPC3::Vehicle_CAN_09::StartStop_DriverRequest = 0;
  $CAN_MPC3::Vehicle_CAN_09::StartStop_EngineStarting = 0;
  $CAN_MPC3::Vehicle_CAN_09::StartStop_EngineStopping = 0;
  $CAN_MPC3::Vehicle_CAN_09::StartStop_Status = 0;
  $CAN_MPC3::Vehicle_CAN_09::ThrottleRaw_Qbit = 0;
  $CAN_MPC3::Vehicle_CAN_09::VehicleMass = 0;
  $CAN_MPC3::Vehicle_CAN_09::VehicleMass_Qbit = 0;
  $CAN_MPC3::Vehicle_CAN_15::ACC_CancelSwitch = 0;
  $CAN_MPC3::Vehicle_CAN_15::ACC_LimiterSwitch = 0;
  $CAN_MPC3::Vehicle_CAN_15::ACC_MainSwitch = 0;
  $CAN_MPC3::Vehicle_CAN_15::ACC_ResumeSwitch = 0;
  $CAN_MPC3::Vehicle_CAN_15::ACC_SetSwitch = 0;
  $CAN_MPC3::Vehicle_CAN_15::ACC_SwitchFailure = 0;
  $CAN_MPC3::Vehicle_CAN_15::ACC_TimegapSwitches = 0;
  $CAN_MPC3::Vehicle_CAN_15::ACC_VSetMinusSwitch = 0;
  $CAN_MPC3::Vehicle_CAN_15::ACC_VSetPlusSwitch = 0;
  $CAN_MPC3::Vehicle_CAN_15::DisplayACCScreenActive = 0;
  $CAN_MPC3::Vehicle_CAN_15::DisplayConsistentWithACC = 0;
  }
  if(init_count == 14)
  {
  $CAN_MPC3::Vehicle_CAN_15::DisplayFailure = 0;
  $CAN_MPC3::Vehicle_CAN_15::DisplayedSpeed = 0;
  $CAN_MPC3::Vehicle_CAN_15::DisplayedSpeedUnitType = 0;
  $CAN_MPC3::Vehicle_CAN_15::DriverSeatBeltStatus = 3;
  $CAN_MPC3::Vehicle_CAN_15::DriverSeatPositionSensor = 0;
  $CAN_MPC3::Vehicle_CAN_15::EPB_BrakeForce = 0;
  $CAN_MPC3::Vehicle_CAN_15::EPB_ErrorStatus = 0;
  $CAN_MPC3::Vehicle_CAN_15::EPB_Status = 0;
  $CAN_MPC3::Vehicle_CAN_15::EPB_SwitchPosition = 0;
  $CAN_MPC3::Vehicle_CAN_15::EPB_SwitchPosition_Qbit = 0;
  $CAN_MPC3::Vehicle_CAN_15::NoForwardGear = 0;
  $CAN_MPC3::Vehicle_CAN_15::ParkingBrakeActive = 0;
  $CAN_MPC3::Vehicle_CAN_15::RequestedDrivingProgram = 0;
  $CAN_MPC3::Vehicle_CAN_15::TrailerBrakeLampDefect = 0;
  $CAN_MPC3::Vehicle_CAN_15::VehicleBrakeLampsDefect = 0;
  $CAN_MPC3::Vehicle_CAN_15::VehicleDoorOpen = 0;
  $CAN_MPC3::Vehicle_CAN_17::Day = 0;
  $CAN_MPC3::Vehicle_CAN_17::Hour = 0;
  $CAN_MPC3::Vehicle_CAN_17::KeyNumber = 0;
  $CAN_MPC3::Vehicle_CAN_17::Minute = 0;
  $CAN_MPC3::Vehicle_CAN_17::Month = 0;
  $CAN_MPC3::Vehicle_CAN_17::OverSpdWarningOffset = 128;
  $CAN_MPC3::Vehicle_CAN_17::Second = 0;
  $CAN_MPC3::Vehicle_CAN_17::WheelRotationDirFrontLeft = 0;
  $CAN_MPC3::Vehicle_CAN_17::WheelRotationDirFrontRight = 0;
  }
  if(init_count == 15)
  {
  $CAN_MPC3::Vehicle_CAN_17::WheelRotationDirRearLeft = 0;
  $CAN_MPC3::Vehicle_CAN_17::WheelRotationDirRearRight = 0;
  $CAN_MPC3::Vehicle_CAN_17::Year = 0;
  $CAN_MPC3::Vehicle_CAN_21::ASR_Intervention = 0;
  $CAN_MPC3::Vehicle_CAN_21::AirbagCrashIntensity = 0;
  $CAN_MPC3::Vehicle_CAN_21::BrakePressure_Qbit = 0;
  $CAN_MPC3::Vehicle_CAN_21::BrakeTemperatureStatus = 0;
  $CAN_MPC3::Vehicle_CAN_21::ClutchPedal = 0;
  $CAN_MPC3::Vehicle_CAN_21::ClutchTemperatureStatus = 0;
  $CAN_MPC3::Vehicle_CAN_21::DecelerationEnable = 0;
  $CAN_MPC3::Vehicle_CAN_21::DriverBraked_Qbit = 0;
  $CAN_MPC3::Vehicle_CAN_21::EBV_Intervention = 0;
  $CAN_MPC3::Vehicle_CAN_21::ECD_Failure = 0;
  $CAN_MPC3::Vehicle_CAN_21::ECD_NotAvailable = 0;
  $CAN_MPC3::Vehicle_CAN_21::EDS_Intervention = 0;
  $CAN_MPC3::Vehicle_CAN_21::ESP_AutoholdActive = 0;
  $CAN_MPC3::Vehicle_CAN_21::ESP_ConsistentWithACC = 0;
  $CAN_MPC3::Vehicle_CAN_21::ESP_StandstillConfirmed = 0;
  $CAN_MPC3::Vehicle_CAN_21::ESP_StoppingProcessActive = 0;
  $CAN_MPC3::Vehicle_CAN_21::EmergencyBrakeActive = 0;
  $CAN_MPC3::Vehicle_CAN_21::MSR_Intervention = 0;
  $CAN_MPC3::Vehicle_CAN_21::NumberOfCogs = 0;
  $CAN_MPC3::Vehicle_CAN_21::SteeringAngularSpeed_Qbit = 0;
  $CAN_MPC3::Vehicle_CAN_21::SteeringWheelAngle_Qbit = 0;
  $CAN_MPC3::Vehicle_CAN_21::TSRFeatureEnableSwitch = 255;
  }
  if(init_count == 16)
  {
  $CAN_MPC3::Vehicle_CAN_21::Velocity_Qbit = 0;
  $CAN_MPC3::Vehicle_CAN_21::WheelCircumference = 0;
  $CAN_MPC3::Vehicle_CAN_21::WheelCircumference_QBit = 0;
  $CAN_MPC3::Vehicle_CAN_25::FoggingRiskWindscreen = 0;
  $CAN_MPC3::Vehicle_CAN_25::FrontCrash = 0;
  $CAN_MPC3::Vehicle_CAN_25::RearCrash = 0;
  $CAN_MPC3::Vehicle_CAN_25::RolloverCrash = 0;
  $CAN_MPC3::Vehicle_CAN_25::SideCrashCodriver = 0;
  $CAN_MPC3::Vehicle_CAN_25::SideCrashDriver = 0;
  $CAN_MPC3::Vehicle_CAN_25::WheelPulseIndicatorFL = 0;
  $CAN_MPC3::Vehicle_CAN_25::WheelPulseIndicatorFR = 0;
  $CAN_MPC3::Vehicle_CAN_25::WheelPulseIndicatorRL = 0;
  $CAN_MPC3::Vehicle_CAN_25::WheelPulseIndicatorRR = 0;
  $CAN_MPC3::Vehicle_CAN_25::WheelPulseSensorFL_Qbit = 0;
  $CAN_MPC3::Vehicle_CAN_25::WheelPulseSensorFR_Qbit = 0;
  $CAN_MPC3::Vehicle_CAN_25::WheelPulseSensorRL_Qbit = 0;
  $CAN_MPC3::Vehicle_CAN_25::WheelPulseSensorRR_Qbit = 0;
  $CAN_MPC3::Vehicle_CAN_29::ADAS_ProfLong_CtrlPoint = 0;
  $CAN_MPC3::Vehicle_CAN_29::ADAS_ProfLong_CycCnt = 0;
  $CAN_MPC3::Vehicle_CAN_29::ADAS_ProfLong_MsgType = 0;
  $CAN_MPC3::Vehicle_CAN_29::ADAS_ProfLong_Offset = 0;
  $CAN_MPC3::Vehicle_CAN_29::ADAS_ProfLong_PathIdx = 0;
  $CAN_MPC3::Vehicle_CAN_29::ADAS_ProfLong_ProfType = 0;
  $CAN_MPC3::Vehicle_CAN_29::ADAS_ProfLong_Retr = 0;
  $CAN_MPC3::Vehicle_CAN_29::ADAS_ProfLong_Update = 0;
  }
  if(init_count == 17)
  {
  $CAN_MPC3::Vehicle_CAN_29::ProfileLong_Value = 0;
  $CAN_MPC3::Vehicle_CAN_31::ADAS_Meta_CountryCode = 0;
  $CAN_MPC3::Vehicle_CAN_31::ADAS_Meta_CycCnt = 0;
  $CAN_MPC3::Vehicle_CAN_31::ADAS_Meta_DrvSide = 0;
  $CAN_MPC3::Vehicle_CAN_31::ADAS_Meta_HwVer = 0;
  $CAN_MPC3::Vehicle_CAN_31::ADAS_Meta_MapProvider = 0;
  $CAN_MPC3::Vehicle_CAN_31::ADAS_Meta_MapVerQtr = 0;
  $CAN_MPC3::Vehicle_CAN_31::ADAS_Meta_MapVerYear = 0;
  $CAN_MPC3::Vehicle_CAN_31::ADAS_Meta_MsgType = 0;
  $CAN_MPC3::Vehicle_CAN_31::ADAS_Meta_ProtVer_Major = 0;
  $CAN_MPC3::Vehicle_CAN_31::ADAS_Meta_ProtVer_Minor = 0;
  $CAN_MPC3::Vehicle_CAN_31::ADAS_Meta_ProtVer_MinorSub = 0;
  $CAN_MPC3::Vehicle_CAN_31::ADAS_Meta_RegionCode = 0;
  $CAN_MPC3::Vehicle_CAN_31::ADAS_Meta_SpdUnits = 0;
  $CAN_MPC3::Vehicle_CAN_37::ADAS_ProfShort_AccurClass = 0;
  $CAN_MPC3::Vehicle_CAN_37::ADAS_ProfShort_CtrlPoint = 0;
  $CAN_MPC3::Vehicle_CAN_37::ADAS_ProfShort_CycCnt = 0;
  $CAN_MPC3::Vehicle_CAN_37::ADAS_ProfShort_Dist1 = 0;
  $CAN_MPC3::Vehicle_CAN_37::ADAS_ProfShort_MsgType = 0;
  $CAN_MPC3::Vehicle_CAN_37::ADAS_ProfShort_Offset = 0;
  $CAN_MPC3::Vehicle_CAN_37::ADAS_ProfShort_PathIdx = 0;
  $CAN_MPC3::Vehicle_CAN_37::ADAS_ProfShort_ProfType = 0;
  $CAN_MPC3::Vehicle_CAN_37::ADAS_ProfShort_Retr = 0;
  $CAN_MPC3::Vehicle_CAN_37::ADAS_ProfShort_Update = 0;
  $CAN_MPC3::Vehicle_CAN_37::ADAS_ProfShort_Value0 = 0;
  }
  if(init_count == 18)
  {
  $CAN_MPC3::Vehicle_CAN_37::ADAS_ProfShort_Value1 = 0;
  $CAN_MPC3::Vehicle_CAN_41::ADAS_Stub_CmplxInsct = 0;
  $CAN_MPC3::Vehicle_CAN_41::ADAS_Stub_CycCnt = 0;
  $CAN_MPC3::Vehicle_CAN_41::ADAS_Stub_FormOfWay = 0;
  $CAN_MPC3::Vehicle_CAN_41::ADAS_Stub_FuncRoadClass = 0;
  $CAN_MPC3::Vehicle_CAN_41::ADAS_Stub_LastStub = 0;
  $CAN_MPC3::Vehicle_CAN_41::ADAS_Stub_MsgType = 0;
  $CAN_MPC3::Vehicle_CAN_41::ADAS_Stub_NumOfLaneDrvDir = 0;
  $CAN_MPC3::Vehicle_CAN_41::ADAS_Stub_NumOfLaneOppDir = 0;
  $CAN_MPC3::Vehicle_CAN_41::ADAS_Stub_Offset = 0;
  $CAN_MPC3::Vehicle_CAN_41::ADAS_Stub_PartOfCalcRoute = 0;
  $CAN_MPC3::Vehicle_CAN_41::ADAS_Stub_PathIdx = 0;
  $CAN_MPC3::Vehicle_CAN_41::ADAS_Stub_RelProbb = 0;
  $CAN_MPC3::Vehicle_CAN_41::ADAS_Stub_Retr = 0;
  $CAN_MPC3::Vehicle_CAN_41::ADAS_Stub_RtOfWay = 0;
  $CAN_MPC3::Vehicle_CAN_41::ADAS_Stub_SubPathIdx = 0;
  $CAN_MPC3::Vehicle_CAN_41::ADAS_Stub_TurnAngl = 0;
  $CAN_MPC3::Vehicle_CAN_41::ADAS_Stub_Update = 0;
  $CAN_MPC3::Vehicle_CAN_43::ADAS_Seg_Bridge = 0;
  $CAN_MPC3::Vehicle_CAN_43::ADAS_Seg_BuildUpArea = 0;
  $CAN_MPC3::Vehicle_CAN_43::ADAS_Seg_CmplxInsct = 0;
  $CAN_MPC3::Vehicle_CAN_43::ADAS_Seg_CycCnt = 0;
  $CAN_MPC3::Vehicle_CAN_43::ADAS_Seg_DividedRoad = 0;
  $CAN_MPC3::Vehicle_CAN_43::ADAS_Seg_EffSpdLmt = 0;
  $CAN_MPC3::Vehicle_CAN_43::ADAS_Seg_EffSpdLmtType = 0;
  }
  if(init_count == 19)
  {
  $CAN_MPC3::Vehicle_CAN_43::ADAS_Seg_FormOfWay = 0;
  $CAN_MPC3::Vehicle_CAN_43::ADAS_Seg_FuncRoadClass = 0;
  $CAN_MPC3::Vehicle_CAN_43::ADAS_Seg_MsgType = 0;
  $CAN_MPC3::Vehicle_CAN_43::ADAS_Seg_NumOfLaneDrvDir = 0;
  $CAN_MPC3::Vehicle_CAN_43::ADAS_Seg_NumOfLaneOppDir = 0;
  $CAN_MPC3::Vehicle_CAN_43::ADAS_Seg_Offset = 0;
  $CAN_MPC3::Vehicle_CAN_43::ADAS_Seg_PartOfCalcRoute = 0;
  $CAN_MPC3::Vehicle_CAN_43::ADAS_Seg_PathIdx = 0;
  $CAN_MPC3::Vehicle_CAN_43::ADAS_Seg_RelProbb = 0;
  $CAN_MPC3::Vehicle_CAN_43::ADAS_Seg_Retr = 0;
  $CAN_MPC3::Vehicle_CAN_43::ADAS_Seg_Tunnel = 0;
  $CAN_MPC3::Vehicle_CAN_43::ADAS_Seg_Update = 0;
  $CAN_MPC3::Vehicle_CAN_47::ADAS_Posn_Age = 0;
  $CAN_MPC3::Vehicle_CAN_47::ADAS_Posn_CurLane = 0;
  $CAN_MPC3::Vehicle_CAN_47::ADAS_Posn_CycCnt = 0;
  $CAN_MPC3::Vehicle_CAN_47::ADAS_Posn_Idx = 0;
  $CAN_MPC3::Vehicle_CAN_47::ADAS_Posn_MsgTyp = 0;
  $CAN_MPC3::Vehicle_CAN_47::ADAS_Posn_Offset = 0;
  $CAN_MPC3::Vehicle_CAN_47::ADAS_Posn_PathIdx = 0;
  $CAN_MPC3::Vehicle_CAN_47::ADAS_Posn_PosConfdc = 0;
  $CAN_MPC3::Vehicle_CAN_47::ADAS_Posn_PosProbb = 0;
  $CAN_MPC3::Vehicle_CAN_47::ADAS_Posn_RelHead = 0;
  $CAN_MPC3::Vehicle_CAN_47::ADAS_Posn_Spd = 0;
  $CAN_MPC3::Vehicle_CAN_48::RoadWheelAngleGradients = 0;
  $CAN_MPC3::Vehicle_CAN_48::YawRate_Qbit = 0;
  }
  if(init_count == 20)
  {
  $CAN_MPC3::Vehicle_CAN_48::isPitchRate = 0;
  $CAN_MPC3::Vehicle_CAN_48::isYawRate_Pf = 0;
  if (prestart_mode==0) init_count = 0;
  initFlag = 2;
  }
  init_count++;
}
void init_DASy_F150_OD()
{
  if(init_count == 1)
  {
  $CAN_ADAS::ACC_06_DASy::ACC_Minimale_Bremsung_D = 0;
  $CAN_ADAS::ACC_06_DASy::ACC_neg_Sollbeschl_Grad_02_D = 0;
  $CAN_ADAS::ACC_06_DASy::ACC_pos_Sollbeschl_Grad_02_D = 0;
  $CAN_ADAS::ACC_06_DASy::ACC_zul_Regelabw_oben_D = 0;
  $CAN_ADAS::ACC_06_DASy::ACC_zul_Regelabw_unten_D = 0;
  $CAN_ADAS::ACC_06_DASy::ADAS_CoastReq_ACC = 0;
  $CAN_ADAS::ACC_06_DASy::ADAS_EngStartRun_Req = 0;
  $CAN_ADAS::ACC_06_DASy::ADAS_LimActReq = 0;
  $CAN_ADAS::ACC_06_DASy::ADAS_LimAx_LIM = 0;
  $CAN_ADAS::ACC_06_DASy::ADAS_ShtDwnStrat_ACC = 0;
  $CAN_ADAS::ACC_06_DASy::ADAS_ShtDwnStrat_Lim = 0;
  $CAN_ADAS::ACC_06_DASy::ADAS_Sts_LIM = 0;
  $CAN_ADAS::ACC_06_DASy::ADAS_VehSecureReq = 0;
  $CAN_ADAS::ACC_06_DASy::LIM_neg_Sollbeschl_Grad_02_D = 0;
  $CAN_ADAS::ACC_06_DASy::LIM_pos_Sollbeschl_Grad_02_D = 0;
  $CAN_ADAS::ACC_06_DASy::LIM_zul_Regelabw_oben_D = 0;
  $CAN_ADAS::ACC_06_DASy::LIM_zul_Regelabw_unten_D = 0;
  $CAN_ADAS::ACC_06_DASy::YawTorqueRequest = 0;
  $CAN_ADAS::ACC_06_DASy::YawTorqueTarget = 0;
  $CAN_ADAS::ADAS2EPS_0x1C1::ADAS_ExtMaxRPCTrq = 0;
  $CAN_ADAS::ADAS2EPS_0x1C1::ADAS_ExtMinRPCTrq = 0;
  $CAN_ADAS::ADAS2EPS_0x1C1::ADAS_RdWhlAgReq = 0;
  $CAN_ADAS::ADAS2EPS_0x1C1::ADAS_RdWhlAgReqActive = 0;
  $CAN_ADAS::ADAS2EPS_0x1C1::DADCSteerTqReqActive = 0;
  $CAN_ADAS::ADAS_0x4BA_HMI::ACCTrafficLightReaction = 0;
  }
  if(init_count == 2)
  {
  $CAN_ADAS::ADAS_0x4BA_HMI::ACC_ICON_LADI = 0;
  $CAN_ADAS::ADAS_0x4BA_HMI::ALCFeatureStatus = 0;
  $CAN_ADAS::ADAS_0x4BA_HMI::AdcStateInformation = 0;
  $CAN_ADAS::ADAS_0x4BA_HMI::AlcEnhancedStatus = 0;
  $CAN_ADAS::ADAS_0x4BA_HMI::AlcPlusState = 0;
  $CAN_ADAS::ADAS_0x4BA_HMI::AlcPremiumState = 0;
  $CAN_ADAS::ADAS_0x4BA_HMI::AudioNotificationId = 0;
  $CAN_ADAS::ADAS_0x4BA_HMI::AuxiliarySymbol = 0;
  $CAN_ADAS::ADAS_0x4BA_HMI::CurvatureInformation = 0;
  $CAN_ADAS::ADAS_0x4BA_HMI::DisplayedEgoSpeed = 0;
  $CAN_ADAS::ADAS_0x4BA_HMI::DisplayedEgoSpeedColor = 0;
  $CAN_ADAS::ADAS_0x4BA_HMI::DisplayedLaneMarking1Color = 0;
  $CAN_ADAS::ADAS_0x4BA_HMI::DisplayedLaneMarking1Type = 0;
  $CAN_ADAS::ADAS_0x4BA_HMI::DisplayedLaneMarking1Y = 0;
  $CAN_ADAS::ADAS_0x4BA_HMI::DisplayedLaneMarking2Color = 0;
  $CAN_ADAS::ADAS_0x4BA_HMI::DisplayedLaneMarking2Type = 0;
  $CAN_ADAS::ADAS_0x4BA_HMI::DisplayedLaneMarking2Y = 0;
  $CAN_ADAS::ADAS_0x4BA_HMI::DisplayedLaneMarking3Color = 0;
  $CAN_ADAS::ADAS_0x4BA_HMI::DisplayedLaneMarking3Type = 0;
  $CAN_ADAS::ADAS_0x4BA_HMI::DisplayedLaneMarking3Y = 0;
  $CAN_ADAS::ADAS_0x4BA_HMI::DisplayedLaneMarking4Color = 0;
  $CAN_ADAS::ADAS_0x4BA_HMI::DisplayedLaneMarking4Type = 0;
  $CAN_ADAS::ADAS_0x4BA_HMI::DisplayedLaneMarking4Y = 0;
  $CAN_ADAS::ADAS_0x4BA_HMI::DisplayedLaneMarkingLeftColor = 0;
  $CAN_ADAS::ADAS_0x4BA_HMI::DisplayedLaneMarkingLeftType = 0;
  }
  if(init_count == 3)
  {
  $CAN_ADAS::ADAS_0x4BA_HMI::DisplayedLaneMarkingRightColor = 0;
  $CAN_ADAS::ADAS_0x4BA_HMI::DisplayedLaneMarkingRightType = 0;
  $CAN_ADAS::ADAS_0x4BA_HMI::DisplayedTextMessageId = 0;
  $CAN_ADAS::ADAS_0x4BA_HMI::ELKHREStatus = 0;
  $CAN_ADAS::ADAS_0x4BA_HMI::ELKOCVStatus = 0;
  $CAN_ADAS::ADAS_0x4BA_HMI::ELKOTStatus = 0;
  $CAN_ADAS::ADAS_0x4BA_HMI::ELKSLStatus = 0;
  $CAN_ADAS::ADAS_0x4BA_HMI::ELKVREStatus = 0;
  $CAN_ADAS::ADAS_0x4BA_HMI::EgoLaneAssignment = 0;
  $CAN_ADAS::ADAS_0x4BA_HMI::EgoLaneChange = 0;
  $CAN_ADAS::ADAS_0x4BA_HMI::HwaAccStatus = 0;
  $CAN_ADAS::ADAS_0x4BA_HMI::HwaHfStatus = 0;
  $CAN_ADAS::ADAS_0x4BA_HMI::HwaHonStatus = 0;
  $CAN_ADAS::ADAS_0x4BA_HMI::Indicator01 = 0;
  $CAN_ADAS::ADAS_0x4BA_HMI::Indicator02 = 0;
  $CAN_ADAS::ADAS_0x4BA_HMI::Indicator03 = 0;
  $CAN_ADAS::ADAS_0x4BA_HMI::Indicator04 = 0;
  $CAN_ADAS::ADAS_0x4BA_HMI::Indicator05 = 0;
  $CAN_ADAS::ADAS_0x4BA_HMI::Indicator06 = 0;
  $CAN_ADAS::ADAS_0x4BA_HMI::Indicator07 = 0;
  $CAN_ADAS::ADAS_0x4BA_HMI::Indicator08 = 0;
  $CAN_ADAS::ADAS_0x4BA_HMI::Indicator09 = 0;
  $CAN_ADAS::ADAS_0x4BA_HMI::Indicator10 = 0;
  $CAN_ADAS::ADAS_0x4BA_HMI::Indicator11 = 0;
  $CAN_ADAS::ADAS_0x4BA_HMI::Indicator12 = 0;
  }
  if(init_count == 4)
  {
  $CAN_ADAS::ADAS_0x4BA_HMI::Indicator13 = 0;
  $CAN_ADAS::ADAS_0x4BA_HMI::Indicator14 = 0;
  $CAN_ADAS::ADAS_0x4BA_HMI::Indicator15 = 0;
  $CAN_ADAS::ADAS_0x4BA_HMI::Indicator16 = 0;
  $CAN_ADAS::ADAS_0x4BA_HMI::LDWStatus = 0;
  $CAN_ADAS::ADAS_0x4BA_HMI::LKAStatus = 0;
  $CAN_ADAS::ADAS_0x4BA_HMI::LedHadState = 0;
  $CAN_ADAS::ADAS_0x4BA_HMI::NeighboringVehicle1AugmentedData = 0;
  $CAN_ADAS::ADAS_0x4BA_HMI::NeighboringVehicle1VehicleType = 0;
  $CAN_ADAS::ADAS_0x4BA_HMI::NeighboringVehicle1X = 0;
  $CAN_ADAS::ADAS_0x4BA_HMI::NeighboringVehicle1Y = 0;
  $CAN_ADAS::ADAS_0x4BA_HMI::NeighboringVehicle2AugmentedData = 0;
  $CAN_ADAS::ADAS_0x4BA_HMI::NeighboringVehicle2VehicleType = 0;
  $CAN_ADAS::ADAS_0x4BA_HMI::NeighboringVehicle2X = 0;
  $CAN_ADAS::ADAS_0x4BA_HMI::NeighboringVehicle2Y = 0;
  $CAN_ADAS::ADAS_0x4BA_HMI::NeighboringVehicle3AugmentedData = 0;
  $CAN_ADAS::ADAS_0x4BA_HMI::NeighboringVehicle3VehicleType = 0;
  $CAN_ADAS::ADAS_0x4BA_HMI::NeighboringVehicle3X = 0;
  $CAN_ADAS::ADAS_0x4BA_HMI::NeighboringVehicle3Y = 0;
  $CAN_ADAS::ADAS_0x4BA_HMI::NeighboringVehicle4AugmentedData = 0;
  $CAN_ADAS::ADAS_0x4BA_HMI::NeighboringVehicle4VehicleType = 0;
  $CAN_ADAS::ADAS_0x4BA_HMI::NeighboringVehicle4X = 0;
  $CAN_ADAS::ADAS_0x4BA_HMI::NeighboringVehicle4Y = 0;
  $CAN_ADAS::ADAS_0x4BA_HMI::NeighboringVehicle5AugmentedData = 0;
  $CAN_ADAS::ADAS_0x4BA_HMI::NeighboringVehicle5VehicleType = 0;
  }
  if(init_count == 5)
  {
  $CAN_ADAS::ADAS_0x4BA_HMI::NeighboringVehicle5X = 0;
  $CAN_ADAS::ADAS_0x4BA_HMI::NeighboringVehicle5Y = 0;
  $CAN_ADAS::ADAS_0x4BA_HMI::NeighboringVehicle6AugmentedData = 0;
  $CAN_ADAS::ADAS_0x4BA_HMI::NeighboringVehicle6VehicleType = 0;
  $CAN_ADAS::ADAS_0x4BA_HMI::NeighboringVehicle6X = 0;
  $CAN_ADAS::ADAS_0x4BA_HMI::NeighboringVehicle6Y = 0;
  $CAN_ADAS::ADAS_0x4BA_HMI::NeighboringVehicle7AugmentedData = 0;
  $CAN_ADAS::ADAS_0x4BA_HMI::NeighboringVehicle7VehicleType = 0;
  $CAN_ADAS::ADAS_0x4BA_HMI::NeighboringVehicle7X = 0;
  $CAN_ADAS::ADAS_0x4BA_HMI::NeighboringVehicle7Y = 0;
  $CAN_ADAS::ADAS_0x4BA_HMI::NeighboringVehicle8AugmentedData = 0;
  $CAN_ADAS::ADAS_0x4BA_HMI::NeighboringVehicle8VehicleType = 0;
  $CAN_ADAS::ADAS_0x4BA_HMI::NeighboringVehicle8X = 0;
  $CAN_ADAS::ADAS_0x4BA_HMI::NeighboringVehicle8Y = 0;
  $CAN_ADAS::ADAS_0x4BA_HMI::Number01 = 0;
  $CAN_ADAS::ADAS_0x4BA_HMI::Number02 = 0;
  $CAN_ADAS::ADAS_0x4BA_HMI::OffsetDirection = 0;
  $CAN_ADAS::ADAS_0x4BA_HMI::OffsetReason = 0;
  $CAN_ADAS::ADAS_0x4BA_HMI::PopupTextMessage = 0;
  $CAN_ADAS::ADAS_0x4BA_HMI::ReducedTimeGap = 0;
  $CAN_ADAS::ADAS_0x4BA_HMI::SensorConeFrontCenter = 0;
  $CAN_ADAS::ADAS_0x4BA_HMI::SetSpeed = 0;
  $CAN_ADAS::ADAS_0x4BA_HMI::SetSpeedColor = 0;
  $CAN_ADAS::ADAS_0x4BA_HMI::TimeGapColor = 0;
  $CAN_ADAS::ADAS_0x4BA_HMI::TimeGapSetValue = 0;
  }
  if(init_count == 6)
  {
  $CAN_ADAS::ADAS_0x4BA_HMI::TrafficLightDisplayRequest = 0;
  $CAN_ADAS::ADAS_0x4BA_HMI::TrafficLightDistance = 0;
  $CAN_ADAS::ADAS_0x4BA_HMI::TrafficLightStatus = 0;
  $CAN_ADAS::ADAS_0x4BA_HMI::TrafficSignSpeedLimit = 0;
  $CAN_ADAS::ADAS_0x4BA_HMI::TurnIndicatorSignal = 0;
  $CAN_ADAS::ADAS_0x4BC_HMI::ADAS_Curv_1_NumValidPoints = 0;
  $CAN_ADAS::ADAS_0x4BC_HMI::ADAS_Curv_1_dy_00 = 0;
  $CAN_ADAS::ADAS_0x4BC_HMI::ADAS_Curv_1_dy_01 = 0;
  $CAN_ADAS::ADAS_0x4BC_HMI::ADAS_Curv_1_dy_02 = 0;
  $CAN_ADAS::ADAS_0x4BC_HMI::ADAS_Curv_1_dy_03 = 0;
  $CAN_ADAS::ADAS_0x4BC_HMI::ADAS_Curv_1_dy_04 = 0;
  $CAN_ADAS::ADAS_0x4BC_HMI::ADAS_Curv_1_dy_05 = 0;
  $CAN_ADAS::ADAS_0x4BC_HMI::ADAS_Curv_1_dy_06 = 0;
  $CAN_ADAS::ADAS_0x4BC_HMI::ADAS_Curv_1_dy_07 = 0;
  $CAN_ADAS::ADAS_0x4BC_HMI::ADAS_Curv_1_dy_08 = 0;
  $CAN_ADAS::ADAS_0x4BC_HMI::ADAS_Curv_1_dy_09 = 0;
  $CAN_ADAS::ADAS_0x4BC_HMI::ADAS_Curv_1_dy_10 = 0;
  $CAN_ADAS::ADAS_0x4BC_HMI::ADAS_Curv_1_dy_11 = 0;
  $CAN_ADAS::ADAS_0x4BC_HMI::ADAS_Curv_1_dy_12 = 0;
  $CAN_ADAS::ADAS_0x4BC_HMI::ADAS_Curv_1_dy_13 = 0;
  $CAN_ADAS::ADAS_0x4BC_HMI::ADAS_Curv_1_dy_14 = 0;
  $CAN_ADAS::ADAS_0x4BC_HMI::ADAS_Curv_1_dy_15 = 0;
  $CAN_ADAS::ADAS_0x4BC_HMI::ADAS_Curv_2_NumValidPoints = 0;
  $CAN_ADAS::ADAS_0x4BC_HMI::ADAS_Curv_2_dy_00 = 0;
  $CAN_ADAS::ADAS_0x4BC_HMI::ADAS_Curv_2_dy_01 = 0;
  }
  if(init_count == 7)
  {
  $CAN_ADAS::ADAS_0x4BC_HMI::ADAS_Curv_2_dy_02 = 0;
  $CAN_ADAS::ADAS_0x4BC_HMI::ADAS_Curv_2_dy_03 = 0;
  $CAN_ADAS::ADAS_0x4BC_HMI::ADAS_Curv_2_dy_04 = 0;
  $CAN_ADAS::ADAS_0x4BC_HMI::ADAS_Curv_2_dy_05 = 0;
  $CAN_ADAS::ADAS_0x4BC_HMI::ADAS_Curv_2_dy_06 = 0;
  $CAN_ADAS::ADAS_0x4BC_HMI::ADAS_Curv_2_dy_07 = 0;
  $CAN_ADAS::ADAS_0x4BC_HMI::ADAS_Curv_2_dy_08 = 0;
  $CAN_ADAS::ADAS_0x4BC_HMI::ADAS_Curv_2_dy_09 = 0;
  $CAN_ADAS::ADAS_0x4BC_HMI::ADAS_Curv_2_dy_10 = 0;
  $CAN_ADAS::ADAS_0x4BC_HMI::ADAS_Curv_2_dy_11 = 0;
  $CAN_ADAS::ADAS_0x4BC_HMI::ADAS_Curv_2_dy_12 = 0;
  $CAN_ADAS::ADAS_0x4BC_HMI::ADAS_Curv_2_dy_13 = 0;
  $CAN_ADAS::ADAS_0x4BC_HMI::ADAS_Curv_2_dy_14 = 0;
  $CAN_ADAS::ADAS_0x4BC_HMI::ADAS_Curv_2_dy_15 = 0;
  $CAN_ADAS::ADAS_0x4BC_HMI::ADAS_Curv_3_NumValidPoints = 0;
  $CAN_ADAS::ADAS_0x4BC_HMI::ADAS_Curv_3_dy_00 = 0;
  $CAN_ADAS::ADAS_0x4BC_HMI::ADAS_Curv_3_dy_01 = 0;
  $CAN_ADAS::ADAS_0x4BC_HMI::ADAS_Curv_3_dy_02 = 0;
  $CAN_ADAS::ADAS_0x4BC_HMI::ADAS_Curv_3_dy_03 = 0;
  $CAN_ADAS::ADAS_0x4BC_HMI::ADAS_Curv_3_dy_04 = 0;
  $CAN_ADAS::ADAS_0x4BC_HMI::ADAS_Curv_3_dy_05 = 0;
  $CAN_ADAS::ADAS_0x4BC_HMI::ADAS_Curv_3_dy_06 = 0;
  $CAN_ADAS::ADAS_0x4BC_HMI::ADAS_Curv_3_dy_07 = 0;
  $CAN_ADAS::ADAS_0x4BC_HMI::ADAS_Curv_3_dy_08 = 0;
  $CAN_ADAS::ADAS_0x4BC_HMI::ADAS_Curv_3_dy_09 = 0;
  }
  if(init_count == 8)
  {
  $CAN_ADAS::ADAS_0x4BC_HMI::ADAS_Curv_3_dy_10 = 0;
  $CAN_ADAS::ADAS_0x4BC_HMI::ADAS_Curv_3_dy_11 = 0;
  $CAN_ADAS::ADAS_0x4BC_HMI::ADAS_Curv_3_dy_12 = 0;
  $CAN_ADAS::ADAS_0x4BC_HMI::ADAS_Curv_3_dy_13 = 0;
  $CAN_ADAS::ADAS_0x4BC_HMI::ADAS_Curv_3_dy_14 = 0;
  $CAN_ADAS::ADAS_0x4BC_HMI::ADAS_Curv_3_dy_15 = 0;
  $CAN_ADAS::ADAS_0x4BC_HMI::ADAS_RSF_Status = 0;
  $CAN_ADAS::ADAS_0x4BC_HMI::ADAS_TrafficSign1_AdditionalSign = 0;
  $CAN_ADAS::ADAS_0x4BC_HMI::ADAS_TrafficSign1_Distance = 0;
  $CAN_ADAS::ADAS_0x4BC_HMI::ADAS_TrafficSign1_Main = 0;
  $CAN_ADAS::ADAS_0x4BC_HMI::ADAS_TrafficSign1_Status = 0;
  $CAN_ADAS::ADAS_0x4BC_HMI::ADAS_TrafficSign2_AdditionalSign = 0;
  $CAN_ADAS::ADAS_0x4BC_HMI::ADAS_TrafficSign2_Distance = 0;
  $CAN_ADAS::ADAS_0x4BC_HMI::ADAS_TrafficSign2_Main = 0;
  $CAN_ADAS::ADAS_0x4BC_HMI::ADAS_TrafficSign2_Status = 0;
  $CAN_ADAS::ADAS_0x4BC_HMI::ADAS_TrafficSign3_AdditionalSign = 0;
  $CAN_ADAS::ADAS_0x4BC_HMI::ADAS_TrafficSign3_Distance = 0;
  $CAN_ADAS::ADAS_0x4BC_HMI::ADAS_TrafficSign3_Main = 0;
  $CAN_ADAS::ADAS_0x4BC_HMI::ADAS_TrafficSign3_Status = 0;
  $CAN_ADAS::ADAS_0x4BD_HMI::ADAS_Curv_4_NumValidPoints = 0;
  $CAN_ADAS::ADAS_0x4BD_HMI::ADAS_Curv_4_dy_00 = 0;
  $CAN_ADAS::ADAS_0x4BD_HMI::ADAS_Curv_4_dy_01 = 0;
  $CAN_ADAS::ADAS_0x4BD_HMI::ADAS_Curv_4_dy_02 = 0;
  $CAN_ADAS::ADAS_0x4BD_HMI::ADAS_Curv_4_dy_03 = 0;
  $CAN_ADAS::ADAS_0x4BD_HMI::ADAS_Curv_4_dy_04 = 0;
  }
  if(init_count == 9)
  {
  $CAN_ADAS::ADAS_0x4BD_HMI::ADAS_Curv_4_dy_05 = 0;
  $CAN_ADAS::ADAS_0x4BD_HMI::ADAS_Curv_4_dy_06 = 0;
  $CAN_ADAS::ADAS_0x4BD_HMI::ADAS_Curv_4_dy_07 = 0;
  $CAN_ADAS::ADAS_0x4BD_HMI::ADAS_Curv_4_dy_08 = 0;
  $CAN_ADAS::ADAS_0x4BD_HMI::ADAS_Curv_4_dy_09 = 0;
  $CAN_ADAS::ADAS_0x4BD_HMI::ADAS_Curv_4_dy_10 = 0;
  $CAN_ADAS::ADAS_0x4BD_HMI::ADAS_Curv_4_dy_11 = 0;
  $CAN_ADAS::ADAS_0x4BD_HMI::ADAS_Curv_4_dy_12 = 0;
  $CAN_ADAS::ADAS_0x4BD_HMI::ADAS_Curv_4_dy_13 = 0;
  $CAN_ADAS::ADAS_0x4BD_HMI::ADAS_Curv_4_dy_14 = 0;
  $CAN_ADAS::ADAS_0x4BD_HMI::ADAS_Curv_4_dy_15 = 0;
  $CAN_ADAS::ADAS_0x4BD_HMI::ADAS_Curv_RefLine_NumValidPoints = 0;
  $CAN_ADAS::ADAS_0x4BD_HMI::ADAS_Curv_RefLine_dy_00 = 0;
  $CAN_ADAS::ADAS_0x4BD_HMI::ADAS_Curv_RefLine_dy_01 = 0;
  $CAN_ADAS::ADAS_0x4BD_HMI::ADAS_Curv_RefLine_dy_02 = 0;
  $CAN_ADAS::ADAS_0x4BD_HMI::ADAS_Curv_RefLine_dy_03 = 0;
  $CAN_ADAS::ADAS_0x4BD_HMI::ADAS_Curv_RefLine_dy_04 = 0;
  $CAN_ADAS::ADAS_0x4BD_HMI::ADAS_Curv_RefLine_dy_05 = 0;
  $CAN_ADAS::ADAS_0x4BD_HMI::ADAS_Curv_RefLine_dy_06 = 0;
  $CAN_ADAS::ADAS_0x4BD_HMI::ADAS_Curv_RefLine_dy_07 = 0;
  $CAN_ADAS::ADAS_0x4BD_HMI::ADAS_Curv_RefLine_dy_08 = 0;
  $CAN_ADAS::ADAS_0x4BD_HMI::ADAS_Curv_RefLine_dy_09 = 0;
  $CAN_ADAS::ADAS_0x4BD_HMI::ADAS_Curv_RefLine_dy_10 = 0;
  $CAN_ADAS::ADAS_0x4BD_HMI::ADAS_Curv_RefLine_dy_11 = 0;
  $CAN_ADAS::ADAS_0x4BD_HMI::ADAS_Curv_RefLine_dy_12 = 0;
  }
  if(init_count == 10)
  {
  $CAN_ADAS::ADAS_0x4BD_HMI::ADAS_Curv_RefLine_dy_13 = 0;
  $CAN_ADAS::ADAS_0x4BD_HMI::ADAS_Curv_RefLine_dy_14 = 0;
  $CAN_ADAS::ADAS_0x4BD_HMI::ADAS_Curv_RefLine_dy_15 = 0;
  $CAN_ADAS::ADAS_0x4BE_HMI::ACCplusIsActiveSubfeatureFriction = 0;
  $CAN_ADAS::ADAS_0x4BE_HMI::ACCplusIsActiveSubfeatureSLA = 0;
  $CAN_ADAS::ADAS_0x4BE_HMI::ACCplusIsActiveSubfeatureSPA = 0;
  $CAN_ADAS::ADAS_0x4BE_HMI::ActiveADCParameterSet = 0;
  $CAN_ADAS::ADAS_0x4BE_HMI::FrontCollisionWarningSensitivitySelection = 0;
  $CAN_ADAS::ADAS_0x4BE_HMI::IsActiveACC = 0;
  $CAN_ADAS::ADAS_0x4BE_HMI::IsActiveACCplus = 0;
  $CAN_ADAS::ADAS_0x4BE_HMI::IsActiveADC = 0;
  $CAN_ADAS::ADAS_0x4BE_HMI::IsActiveTLR = 0;
  $CAN_ADAS::ADAS_0x4BE_HMI::IsAvailableACCplus0 = 0;
  $CAN_ADAS::ADAS_0x4BE_HMI::IsAvailableACCplus1 = 0;
  $CAN_ADAS::ADAS_0x4BE_HMI::IsAvailableADC = 0;
  $CAN_ADAS::ADAS_0x4BE_HMI::IsAvailableTLR = 0;
  $CAN_ADAS::ADAS_0x4BE_HMI::SelectedACFDrivingMode = 0;
  $CAN_ADAS::ADAS_0x4BE_HMI::SelectedADCVariant = 0;
  $CAN_ADAS::MCAM_VMI_01::McamLongState = 0;
  $CAN_ADAS::MCAM_VMI_01::PtFxLimActuationReq = 0;
  $CAN_ADAS::MCAM_VMI_01::PtFxLimit = 0;
  $CAN_ADAS::MCAM_VMI_01::PtFxTarActuationReq = 0;
  $CAN_ADAS::MCAM_VMI_01::PtFxTarget = 0;
  $CAN_ADAS::MRR_0x1C0::ADAS_LatMtnCtrlSts = 0;
  $CAN_ADAS::MRR_0x1C0::ADAS_LatMtnTypExed = 0;
  }
  if(init_count == 11)
  {
  $CAN_ADAS::MRR_0x1C0::ADAS_SteerTqReq = 0;
  $CAN_ADAS::MRR_0x1C0::ADAS_SteerWhlVibrAmp = 0;
  $CAN_ADAS::MRR_0x1C0::ADAS_SteerWhlVibrFrq = 0;
  $CAN_ADAS::MRR_0x1C0::ADAS_WarnVbrnReq = 0;
  $CAN_ADAS::MRR_0x254::ADAS_DecelToStopReq_ACC = 0;
  $CAN_ADAS::MRR_0x254::ADAS_DrvOffReq_ACC = 0;
  $CAN_ADAS::MRR_0x254::ADAS_Sts_ACC = 0;
  $CAN_ADAS::MRR_0x254::ADAS_TarAReq_ACC = 0;
  $CAN_ADAS::MRR_0x254::ADAS_TarA_ACC = 0;
  $CAN_ADAS::MRR_0x254::ADAS_TqReq_ACC = 0;
  $CAN_ADAS::MRR_0x254::ADAS_WhlTq_ACC = 0;
  $CAN_ADAS::MRR_0x25A::ADAS_DecelTyp_AEB = 0;
  $CAN_ADAS::MRR_0x25A::ADAS_Decel_AEB = 0;
  $CAN_ADAS::MRR_0x25A::ADAS_Lvl_AWB = 0;
  $CAN_ADAS::MRR_0x25A::ADAS_Lvl_HBA = 0;
  $CAN_ADAS::MRR_0x25A::ADAS_Req_AWB = 0;
  $CAN_ADAS::MRR_0x25A::ADAS_Req_HBA = 0;
  $CAN_ADAS::MRR_0x25A::ADAS_Req_Prefill = 0;
  $CAN_ADAS::MRR_0x25B::ADAS_Fwd_Safety_Func = 0;
  $CAN_ADAS::MRR_0x32C::ADAS_ADASSnvtySetFb = 0;
  $CAN_ADAS::MRR_0x32C::ADAS_AudioWarn = 0;
  $CAN_ADAS::MRR_0x32C::ADAS_DispReq = 0;
  $CAN_ADAS::MRR_0x32C::ADAS_EmergencyCallReq = 0;
  $CAN_ADAS::MRR_0x32C::ADAS_FCWSnvty = 0;
  $CAN_ADAS::MRR_0x32C::ADAS_HVACAutoMode = 0;
  }
  if(init_count == 12)
  {
  $CAN_ADAS::MRR_0x32C::ADAS_HandsOffTakeOverReq = 0;
  $CAN_ADAS::MRR_0x32C::ADAS_HazzardLightReq = 0;
  $CAN_ADAS::MRR_0x32C::ADAS_HeadLightReq = 0;
  $CAN_ADAS::MRR_0x32C::ADAS_HornReq = 0;
  $CAN_ADAS::MRR_0x32C::ADAS_InteriorLightReq = 0;
  $CAN_ADAS::MRR_0x32C::ADAS_IntvDir_ELK = 0;
  $CAN_ADAS::MRR_0x32C::ADAS_IntvMod_ELK = 0;
  $CAN_ADAS::MRR_0x32C::ADAS_LatMtnColor = 0;
  $CAN_ADAS::MRR_0x32C::ADAS_LeTrunLampReq = 0;
  $CAN_ADAS::MRR_0x32C::ADAS_RiTrunLampReq = 0;
  $CAN_ADAS::MRR_0x32C::ADAS_SeatBeltWindingReq = 0;
  $CAN_ADAS::MRR_0x32C::ADAS_Sts_ELK_oc = 0;
  $CAN_ADAS::MRR_0x32C::ADAS_Sts_ELK_ot = 0;
  $CAN_ADAS::MRR_0x32C::ADAS_Sts_ELK_re = 0;
  $CAN_ADAS::MRR_0x32C::ADAS_Sts_LDW = 0;
  $CAN_ADAS::MRR_0x32C::ADAS_Sts_LKA = 0;
  $CAN_ADAS::MRR_0x32C::ADAS_Sts_RDP = 0;
  $CAN_ADAS::MRR_0x32C::ADAS_Sts_TJAICA = 0;
  $CAN_ADAS::MRR_0x32C::ADAS_SysWarnTyp = 0;
  $CAN_ADAS::MRR_0x32C::ADAS_TailLightReq = 0;
  $CAN_ADAS::MRR_0x32C::ADAS_UnlockDoorReq = 0;
  $CAN_ADAS::MRR_0x33C::ADAS_Sts_AEB = 0;
  $CAN_ADAS::MRR_0x33C::ADAS_Sts_FCW = 0;
  $CAN_ADAS::MRR_0x33C::ADAS_WarnTyp_FCWAEB = 0;
  $CAN_ADAS::MRR_0x33C::ADAS_Warn_FCW = 0;
  }
  if(init_count == 13)
  {
  $CAN_ADAS::MRR_0x340::ADAS_ACCIconDisp = 0;
  $CAN_ADAS::MRR_0x340::ADAS_AEBFCTBSwtFb = 0;
  $CAN_ADAS::MRR_0x340::ADAS_ESSSwtFb = 0;
  $CAN_ADAS::MRR_0x340::ADAS_FCWFCTASwtFb = 0;
  $CAN_ADAS::MRR_0x340::ADAS_FltIndcr = 0;
  $CAN_ADAS::MRR_0x340::ADAS_FwdWarnFltTxt = 0;
  $CAN_ADAS::MRR_0x340::ADAS_IntecnFltTxt = 0;
  $CAN_ADAS::MRR_0x340::ADAS_IntegtCrsFltTxt = 0;
  $CAN_ADAS::MRR_0x340::ADAS_IntegtCrsModSetFb = 0;
  $CAN_ADAS::MRR_0x340::ADAS_IntegtCrsSwtFb = 0;
  $CAN_ADAS::MRR_0x340::ADAS_LaneCrvt = 0;
  $CAN_ADAS::MRR_0x340::ADAS_LaneSprtFltTxt = 0;
  $CAN_ADAS::MRR_0x340::ADAS_LaneSprtSwtFb = 0;
  $CAN_ADAS::MRR_0x340::ADAS_LaneSprtTypSetFb = 0;
  $CAN_ADAS::MRR_0x340::ADAS_LeLineColor = 0;
  $CAN_ADAS::MRR_0x340::ADAS_LeLineDst = 0;
  $CAN_ADAS::MRR_0x340::ADAS_LeLineFlash = 0;
  $CAN_ADAS::MRR_0x340::ADAS_LeLineTyp = 0;
  $CAN_ADAS::MRR_0x340::ADAS_RiLineColor = 0;
  $CAN_ADAS::MRR_0x340::ADAS_RiLineDst = 0;
  $CAN_ADAS::MRR_0x340::ADAS_RiLineFlash = 0;
  $CAN_ADAS::MRR_0x340::ADAS_RiLineTyp = 0;
  $CAN_ADAS::MRR_0x340::ADAS_VoiceSpdRglnFb = 0;
  $CAN_ADAS::MRR_0x347::ADAS_DispSpdUnit_ACC = 0;
  $CAN_ADAS::MRR_0x347::ADAS_DispSpd_ACC = 0;
  }
  if(init_count == 14)
  {
  $CAN_ADAS::MRR_0x347::ADAS_FrntTar1Typ_ACC = 0;
  $CAN_ADAS::MRR_0x347::ADAS_FrntTar2Typ_ACC = 0;
  $CAN_ADAS::MRR_0x347::ADAS_LeFrntTarTyp_ACC = 0;
  $CAN_ADAS::MRR_0x347::ADAS_OperTxt = 0;
  $CAN_ADAS::MRR_0x347::ADAS_RiFrntTarTyp_ACC = 0;
  $CAN_ADAS::MRR_0x347::ADAS_SpdLimSts_ASL = 0;
  $CAN_ADAS::MRR_0x347::ADAS_SpdLimUnit_ASL = 0;
  $CAN_ADAS::MRR_0x347::ADAS_SpdLim_ASL = 0;
  $CAN_ADAS::MRR_0x347::ADAS_Sts_ACC_ICC = 0;
  $CAN_ADAS::MRR_0x347::ADAS_TakeOverReq_ACC = 0;
  $CAN_ADAS::MRR_0x347::ADAS_TiGapSet_ACC = 0;
  $CAN_ADAS::VMCMain11::VMCMain11_BrakeBackupStgyReq = 0;
  $CAN_ADAS::VMCMain11::VMCMain11_BrakeFxActuationType = 0;
  $CAN_ADAS::VMCMain11::VMCMain11_BrakeFxTarget = 0;
  $CAN_ADAS::VMCMain11::VMCMain11_BrakeFxTargetGrad = 0;
  $CAN_ADAS::VMCMain11::VMCMain11_BrakePrepReq = 0;
  $CAN_ADAS::VMCMain11::VMCMain11_BrkCmptibiltyIndex = 0;
  $CAN_ADAS::VMCMain11::VMCMain11_EnableBrkFxTarGrad = 0;
  $CAN_ADAS::VMCMain11::VMCMain11_ParkBrakeRequest = 0;
  $CAN_ADAS::VMCMain11::VMCMain11_VehMotionCtrlAvl = 0;
  $CAN_ADAS::VMCMain11::VMCMain11_WarningJerkRequest = 0;
  $CAN_ADAS::VMCMain11::VMCMain11_isBrkReqProspective = 0;
  $CAN_ADAS::VMCMain12::VMCMain12_BrkSensDrvDtctnReq = 0;
  $CAN_ADAS::VMCMain12::VMCMain12_BrkSrvReqStandstill = 0;
  $CAN_ADAS::VMCMain12::VMCMain12_MinPumpRevolutionReq = 0;
  if (prestart_mode==0) init_count = 0;
  initFlag = 3;
  }
  init_count++;
}
void init_Rbs_F150_OD()
{
  if(init_count == 1)
  {
  $CAN_ADAS::ADASLong_Mux::ADASLONG_Mux_MsgTyp = 0;
  $CAN_ADAS::ADAS_0x4BB_HMI::TLF_Mode = 0;
  $CAN_ADAS::ADAS_0x4BB_HMI::TLF_functionState = 0;
  $CAN_ADAS::ADAS_0x4BB_HMI::TL_suggestedDriveAction = 0;
  $CAN_ADAS::ADAS_0x4BB_HMI::TL_warning = 0;
  $CAN_ADAS::ADAS_Metadata::ADAS_Meta_CountryCode = 0;
  $CAN_ADAS::ADAS_Metadata::ADAS_Meta_CycCnt = 0;
  $CAN_ADAS::ADAS_Metadata::ADAS_Meta_DrvSide = 0;
  $CAN_ADAS::ADAS_Metadata::ADAS_Meta_HwVer = 0;
  $CAN_ADAS::ADAS_Metadata::ADAS_Meta_MapProvider = 0;
  $CAN_ADAS::ADAS_Metadata::ADAS_Meta_MapVerQtr = 0;
  $CAN_ADAS::ADAS_Metadata::ADAS_Meta_MapVerYear = 0;
  $CAN_ADAS::ADAS_Metadata::ADAS_Meta_MsgType = 0;
  $CAN_ADAS::ADAS_Metadata::ADAS_Meta_ProtVer_Major = 0;
  $CAN_ADAS::ADAS_Metadata::ADAS_Meta_ProtVer_Minor = 0;
  $CAN_ADAS::ADAS_Metadata::ADAS_Meta_ProtVer_MinorSub = 0;
  $CAN_ADAS::ADAS_Metadata::ADAS_Meta_RegionCode = 0;
  $CAN_ADAS::ADAS_Metadata::ADAS_Meta_SpdUnits = 0;
  $CAN_ADAS::ADAS_Position::ADAS_Posn_Age = 0;
  $CAN_ADAS::ADAS_Position::ADAS_Posn_CurLane = 0;
  $CAN_ADAS::ADAS_Position::ADAS_Posn_CycCnt = 0;
  $CAN_ADAS::ADAS_Position::ADAS_Posn_Idx = 0;
  $CAN_ADAS::ADAS_Position::ADAS_Posn_MsgTyp = 0;
  $CAN_ADAS::ADAS_Position::ADAS_Posn_Offset = 0;
  $CAN_ADAS::ADAS_Position::ADAS_Posn_PathIdx = 0;
  }
  if(init_count == 2)
  {
  $CAN_ADAS::ADAS_Position::ADAS_Posn_PosConfdc = 0;
  $CAN_ADAS::ADAS_Position::ADAS_Posn_PosProbb = 0;
  $CAN_ADAS::ADAS_Position::ADAS_Posn_RelHead = 0;
  $CAN_ADAS::ADAS_Position::ADAS_Posn_Spd = 0;
  $CAN_ADAS::ADAS_Profile_Long::ADAS_ProfLong_CtrlPoint = 0;
  $CAN_ADAS::ADAS_Profile_Long::ADAS_ProfLong_CycCnt = 0;
  $CAN_ADAS::ADAS_Profile_Long::ADAS_ProfLong_MsgType = 0;
  $CAN_ADAS::ADAS_Profile_Long::ADAS_ProfLong_Offset = 0;
  $CAN_ADAS::ADAS_Profile_Long::ADAS_ProfLong_PathIdx = 0;
  $CAN_ADAS::ADAS_Profile_Long::ADAS_ProfLong_ProfType = 0;
  $CAN_ADAS::ADAS_Profile_Long::ADAS_ProfLong_Retr = 0;
  $CAN_ADAS::ADAS_Profile_Long::ADAS_ProfLong_Update = 0;
  $CAN_ADAS::ADAS_Profile_Long::ProfileLong_Value = 0;
  $CAN_ADAS::ADAS_Profile_Short::ADAS_ProfShort_AccurClass = 0;
  $CAN_ADAS::ADAS_Profile_Short::ADAS_ProfShort_CtrlPoint = 0;
  $CAN_ADAS::ADAS_Profile_Short::ADAS_ProfShort_CycCnt = 0;
  $CAN_ADAS::ADAS_Profile_Short::ADAS_ProfShort_Dist1 = 0;
  $CAN_ADAS::ADAS_Profile_Short::ADAS_ProfShort_MsgType = 0;
  $CAN_ADAS::ADAS_Profile_Short::ADAS_ProfShort_Offset = 0;
  $CAN_ADAS::ADAS_Profile_Short::ADAS_ProfShort_PathIdx = 0;
  $CAN_ADAS::ADAS_Profile_Short::ADAS_ProfShort_ProfType = 0;
  $CAN_ADAS::ADAS_Profile_Short::ADAS_ProfShort_Retr = 0;
  $CAN_ADAS::ADAS_Profile_Short::ADAS_ProfShort_Update = 0;
  $CAN_ADAS::ADAS_Profile_Short::ADAS_ProfShort_Value0 = 0;
  $CAN_ADAS::ADAS_Profile_Short::ADAS_ProfShort_Value1 = 0;
  }
  if(init_count == 3)
  {
  $CAN_ADAS::ADAS_Segment::ADAS_Seg_Bridge = 0;
  $CAN_ADAS::ADAS_Segment::ADAS_Seg_BuildUpArea = 0;
  $CAN_ADAS::ADAS_Segment::ADAS_Seg_CmplxInsct = 0;
  $CAN_ADAS::ADAS_Segment::ADAS_Seg_CycCnt = 0;
  $CAN_ADAS::ADAS_Segment::ADAS_Seg_DividedRoad = 0;
  $CAN_ADAS::ADAS_Segment::ADAS_Seg_EffSpdLmt = 0;
  $CAN_ADAS::ADAS_Segment::ADAS_Seg_EffSpdLmtType = 0;
  $CAN_ADAS::ADAS_Segment::ADAS_Seg_FormOfWay = 0;
  $CAN_ADAS::ADAS_Segment::ADAS_Seg_FuncRoadClass = 0;
  $CAN_ADAS::ADAS_Segment::ADAS_Seg_MsgType = 0;
  $CAN_ADAS::ADAS_Segment::ADAS_Seg_NumOfLaneDrvDir = 0;
  $CAN_ADAS::ADAS_Segment::ADAS_Seg_NumOfLaneOppDir = 0;
  $CAN_ADAS::ADAS_Segment::ADAS_Seg_Offset = 0;
  $CAN_ADAS::ADAS_Segment::ADAS_Seg_PartOfCalcRoute = 0;
  $CAN_ADAS::ADAS_Segment::ADAS_Seg_PathIdx = 0;
  $CAN_ADAS::ADAS_Segment::ADAS_Seg_RelProbb = 0;
  $CAN_ADAS::ADAS_Segment::ADAS_Seg_Retr = 0;
  $CAN_ADAS::ADAS_Segment::ADAS_Seg_Tunnel = 0;
  $CAN_ADAS::ADAS_Segment::ADAS_Seg_Update = 0;
  $CAN_ADAS::ADAS_Stub::ADAS_Stub_CmplxInsct = 0;
  $CAN_ADAS::ADAS_Stub::ADAS_Stub_CycCnt = 0;
  $CAN_ADAS::ADAS_Stub::ADAS_Stub_FormOfWay = 0;
  $CAN_ADAS::ADAS_Stub::ADAS_Stub_FuncRoadClass = 0;
  $CAN_ADAS::ADAS_Stub::ADAS_Stub_LastStub = 0;
  $CAN_ADAS::ADAS_Stub::ADAS_Stub_MsgType = 0;
  }
  if(init_count == 4)
  {
  $CAN_ADAS::ADAS_Stub::ADAS_Stub_NumOfLaneDrvDir = 0;
  $CAN_ADAS::ADAS_Stub::ADAS_Stub_NumOfLaneOppDir = 0;
  $CAN_ADAS::ADAS_Stub::ADAS_Stub_Offset = 0;
  $CAN_ADAS::ADAS_Stub::ADAS_Stub_PartOfCalcRoute = 0;
  $CAN_ADAS::ADAS_Stub::ADAS_Stub_PathIdx = 0;
  $CAN_ADAS::ADAS_Stub::ADAS_Stub_RelProbb = 0;
  $CAN_ADAS::ADAS_Stub::ADAS_Stub_Retr = 0;
  $CAN_ADAS::ADAS_Stub::ADAS_Stub_RtOfWay = 0;
  $CAN_ADAS::ADAS_Stub::ADAS_Stub_SubPathIdx = 0;
  $CAN_ADAS::ADAS_Stub::ADAS_Stub_TurnAngl = 0;
  $CAN_ADAS::ADAS_Stub::ADAS_Stub_Update = 0;
  $CAN_ADAS::AEB_Status_0x5A0::AEB_Status = 0;
  $CAN_ADAS::AFB_0x1BB::ShiftInProgress = 0;
  $CAN_ADAS::AFB_0x1BB::WhlTqMin = 0;
  $CAN_ADAS::APA_0x1B0::APA_Sts = 0;
  $CAN_ADAS::BCM_0x335::BCM_DangerAlrmLampSwtSts = 0;
  $CAN_ADAS::BCM_0x335::BCM_HiBeamOutpCmd = 0;
  $CAN_ADAS::BCM_0x335::BCM_LeTrunLampOutpCmd = 0;
  $CAN_ADAS::BCM_0x335::BCM_LoBeamOutpCmd = 1;
  $CAN_ADAS::BCM_0x335::BCM_ReFogLampSwtSts = 0;
  $CAN_ADAS::BCM_0x335::BCM_ReWiprOutpCmd = 0;
  $CAN_ADAS::BCM_0x335::BCM_RiTrunLampOutpCmd = 0;
  $CAN_ADAS::BCM_0x343::BCM_FrntHoodLidSts = 0;
  $CAN_ADAS::BCM_0x343::BCM_LeFrntDoorSts = 0;
  $CAN_ADAS::BCM_0x343::BCM_LeReDoorSts = 0;
  }
  if(init_count == 5)
  {
  $CAN_ADAS::BCM_0x343::BCM_RiFrntDoorSts = 0;
  $CAN_ADAS::BCM_0x343::BCM_RiReDoorSts = 0;
  $CAN_ADAS::BCM_0x343::BCM_TrailerConnection = 0;
  $CAN_ADAS::CIM_0x310::CIM_Cncl_ADAS = 0;
  $CAN_ADAS::CIM_0x310::CIM_DstWithCarFrntAdj = 3;
  $CAN_ADAS::CIM_0x310::CIM_FrntWiprSwtSts = 0;
  $CAN_ADAS::CIM_0x310::CIM_FrntWshrSwtSts = 0;
  $CAN_ADAS::CIM_0x310::CIM_HiBeamSwtSts = 0;
  $CAN_ADAS::CIM_0x310::CIM_MainSwitchCC = 0;
  $CAN_ADAS::CIM_0x310::CIM_MainSwitchLimiter = 0;
  $CAN_ADAS::CIM_0x310::CIM_ReWshrSwtSts = 0;
  $CAN_ADAS::CIM_0x310::CIM_SpdLim_ADAS = 0;
  $CAN_ADAS::CIM_0x310::CIM_SpdRglnVld_ADAS = 1;
  $CAN_ADAS::CIM_0x310::CIM_SpdRgln_ADAS = 0;
  $CAN_ADAS::CIM_0x310::CIM_SwtVld_ADAS = 1;
  $CAN_ADAS::CIM_0x310::CIM_Swt_ADAS = 0;
  $CAN_ADAS::CIM_0x310::CIM_TurnLampSwtSts = 0;
  $CAN_ADAS::DBC_Version::DBC_VersionIdMajor = 0;
  $CAN_ADAS::DBC_Version::DBC_VersionIdMinor = 0;
  $CAN_ADAS::ECC_0x373::ECC_OutdT = 0;
  $CAN_ADAS::ECC_0x373::ECC_OutdTVld = 1;
  $CAN_ADAS::EPS2ADAS_0x1C5::EPS_ActRPCTrq = 0;
  $CAN_ADAS::EPS2ADAS_0x1C5::EPS_ActRoadWheelAngState = 2;
  $CAN_ADAS::EPS2ADAS_0x1C5::EPS_ActRoadWheelAngValue = 0;
  $CAN_ADAS::EPS2ADAS_0x1C5::EPS_IntRPCMaxTrq = 0;
  }
  if(init_count == 6)
  {
  $CAN_ADAS::EPS2ADAS_0x1C5::EPS_IntRPCMinTrq = 0;
  $CAN_ADAS::EPS2ADAS_0x1C5::EPS_LatDrvLvl12SrvAvl = 0;
  $CAN_ADAS::EPS2ADAS_0x1C5::EPS_LatMCHptcWrnSrvAvl = 0;
  $CAN_ADAS::EPS2ADAS_0x1C5::EPS_LatMCRoadWheelAngActive = 0;
  $CAN_ADAS::EPS_0x1C2::EPS_MaxSftyTq = 0;
  $CAN_ADAS::EPS_0x1C2::EPS_SteerAgSnsrCalSts = 1;
  $CAN_ADAS::EPS_0x1C2::EPS_SteerWhlAgSig = 0;
  $CAN_ADAS::EPS_0x1C2::EPS_SteerWhlAgSigVld = 1;
  $CAN_ADAS::EPS_0x1C2::EPS_SteerWhlRotSpd = 0;
  $CAN_ADAS::EPS_0x1C2::EPS_SteerWhlRotSpdVld = 1;
  $CAN_ADAS::EPS_0x1C2::EPS_SteerWhlVbrnAlrmAvl = 0;
  $CAN_ADAS::EPS_0x1C2::EPS_WarnVbrnSts = 0;
  $CAN_ADAS::EPS_0x1C4::EPS_DrvrSteerTq = 0;
  $CAN_ADAS::EPS_0x1C4::EPS_DrvrSteerTqDir = 0;
  $CAN_ADAS::EPS_0x1C4::EPS_DrvrSteerTqVld = 1;
  $CAN_ADAS::EPS_0x1C4::EPS_EPSAvl = 1;
  $CAN_ADAS::EPS_0x1C4::EPS_EmgyCtrlSts = 0;
  $CAN_ADAS::EPS_0x1C4::EPS_LatMtnCtrlSts = 0;
  $CAN_ADAS::EPS_0x1C4::EPS_MinSftyTq = 0;
  $CAN_ADAS::EPS_0x1C4::EPS_PinionAg = 0;
  $CAN_ADAS::EPS_0x1C4::EPS_SteerSnsrSts = 0;
  $CAN_ADAS::EPS_0x475::EPS_ModSts = 2;
  $CAN_ADAS::ESP_0x116::ESP_QBit_Wegimpuls_HL = 0;
  $CAN_ADAS::ESP_0x116::ESP_QBit_Wegimpuls_HR = 0;
  $CAN_ADAS::ESP_0x116::ESP_QBit_Wegimpuls_VL = 0;
  }
  if(init_count == 7)
  {
  $CAN_ADAS::ESP_0x116::ESP_QBit_Wegimpuls_VR = 0;
  $CAN_ADAS::ESP_0x116::ESP_Wegimpuls_HL = 0;
  $CAN_ADAS::ESP_0x116::ESP_Wegimpuls_HR = 0;
  $CAN_ADAS::ESP_0x116::ESP_Wegimpuls_VL = 0;
  $CAN_ADAS::ESP_0x116::ESP_Wegimpuls_VR = 0;
  $CAN_ADAS::ESP_0x120::ESP_ActvSig_ABS = 0;
  $CAN_ADAS::ESP_0x120::ESP_MstCylP = 0;
  $CAN_ADAS::ESP_0x120::ESP_MstCylPOffs = 0;
  $CAN_ADAS::ESP_0x120::ESP_MstCylPOffsVld = 1;
  $CAN_ADAS::ESP_0x120::ESP_MstCylPVld = 1;
  $CAN_ADAS::ESP_0x120::ESP_RoadSlope = 0;
  $CAN_ADAS::ESP_0x120::ESP_VmcVseSasAvlCpby = 4;
  $CAN_ADAS::ESP_0x120::ESP_VmcVseYawRateAvlCpby = 4;
  $CAN_ADAS::ESP_0x261::ESP_ActvIndcn_ABA = 0;
  $CAN_ADAS::ESP_0x261::ESP_ActvIndcn_ABP = 0;
  $CAN_ADAS::ESP_0x261::ESP_ActvIndcn_AEB = 0;
  $CAN_ADAS::ESP_0x261::ESP_ActvIndcn_AWB = 0;
  $CAN_ADAS::ESP_0x261::ESP_ActvSig = 0;
  $CAN_ADAS::ESP_0x261::ESP_ActvSig_DTC = 0;
  $CAN_ADAS::ESP_0x261::ESP_ActvSig_EBD = 0;
  $CAN_ADAS::ESP_0x261::ESP_ActvSig_TCS = 0;
  $CAN_ADAS::ESP_0x261::ESP_Actvndcn_CDD = 0;
  $CAN_ADAS::ESP_0x261::ESP_BrkOverTIndcn = 0;
  $CAN_ADAS::ESP_0x261::ESP_FadeoutFinished = 0;
  $CAN_ADAS::ESP_0x261::ESP_FltIndcn_ABA = 0;
  }
  if(init_count == 8)
  {
  $CAN_ADAS::ESP_0x261::ESP_FltIndcn_ABP = 0;
  $CAN_ADAS::ESP_0x261::ESP_FltIndcn_AEB = 0;
  $CAN_ADAS::ESP_0x261::ESP_FltIndcn_AWB = 0;
  $CAN_ADAS::ESP_0x261::ESP_FltIndcn_CDD = 0;
  $CAN_ADAS::ESP_0x261::ESP_VehStandstillIndcn = 1;
  $CAN_ADAS::ESP_0x268::ESP_EPBSwtichPosition = 0;
  $CAN_ADAS::ESP_0x268::ESP_FltIndcn_EPB = 0;
  $CAN_ADAS::ESP_0x268::ESP_SysSts_EPB = 1;
  $CAN_ADAS::ESP_0x268::ESP_YawRateStabnAvl = 1;
  $CAN_ADAS::ESP_0x268::YawTorque = 0;
  $CAN_ADAS::ESP_0x305::ESP_WhlMovgDir_LF = 3;
  $CAN_ADAS::ESP_0x305::ESP_WhlMovgDir_RF = 3;
  $CAN_ADAS::ESP_0x305::ESP_WhlSpdVld_LF = 1;
  $CAN_ADAS::ESP_0x305::ESP_WhlSpdVld_RF = 1;
  $CAN_ADAS::ESP_0x305::ESP_WhlSpd_LF = 0;
  $CAN_ADAS::ESP_0x305::ESP_WhlSpd_RF = 0;
  $CAN_ADAS::ESP_0x306::ESP_WhlMovgDir_RL = 3;
  $CAN_ADAS::ESP_0x306::ESP_WhlMovgDir_RR = 3;
  $CAN_ADAS::ESP_0x306::ESP_WhlSpdVld_RL = 1;
  $CAN_ADAS::ESP_0x306::ESP_WhlSpdVld_RR = 1;
  $CAN_ADAS::ESP_0x306::ESP_WhlSpd_RL = 0;
  $CAN_ADAS::ESP_0x306::ESP_WhlSpd_RR = 0;
  $CAN_ADAS::ESP_0x318::ESP_CtrlSts_HDC = 0;
  $CAN_ADAS::ESP_0x318::ESP_FltIndcn_ABS = 0;
  $CAN_ADAS::ESP_0x318::ESP_FltIndcn_TCS = 0;
  }
  if(init_count == 9)
  {
  $CAN_ADAS::ESP_0x318::ESP_LampSwtOffIndcn = 0;
  $CAN_ADAS::ESP_0x318::ESP_NoBrkP = 1;
  $CAN_ADAS::ESP_0x318::ESP_SwtOff_TCS = 0;
  $CAN_ADAS::ESP_0x318::ESP_VehSpd = 0;
  $CAN_ADAS::ESP_0x318::ESP_VehSpdVld = 1;
  $CAN_ADAS::GW_HSC8_FrP16::HODDetnSts_h8HSC8 = 0;
  $CAN_ADAS::GW_HSC8_FrP16::HODSysSts_h8HSC8 = 0;
  $CAN_ADAS::GW_HSC8_FrP16::HODTchZone1Sts_h8HSC8 = 0;
  $CAN_ADAS::GW_HSC8_FrP16::HODTchZone1Val_h8HSC8 = 0;
  $CAN_ADAS::GW_HSC8_FrP16::HODTchZone2Sts_h8HSC8 = 0;
  $CAN_ADAS::GW_HSC8_FrP16::HODTchZone2Val_h8HSC8 = 0;
  $CAN_ADAS::GW_HSC8_FrP16::HODTchZone3Sts_h8HSC8 = 0;
  $CAN_ADAS::GW_HSC8_FrP16::HODTchZone3Val_h8HSC8 = 0;
  $CAN_ADAS::GW_HSC8_FrP16::HODdiagSts_h8HSC8 = 0;
  $CAN_ADAS::HMI_0x4BF_ADAS::ACCDriverInputConfirmation = 0;
  $CAN_ADAS::HMI_0x4BF_ADAS::ACCDriverInputResume = 0;
  $CAN_ADAS::HMI_0x4BF_ADAS::ACCDriverInputSet = 0;
  $CAN_ADAS::HMI_0x4BF_ADAS::ACCDriverInputSetSpeedDecrease = 0;
  $CAN_ADAS::HMI_0x4BF_ADAS::ACCDriverInputSetSpeedIncrease = 0;
  $CAN_ADAS::HMI_0x4BF_ADAS::ACCDriverInputTimeGapChange = 0;
  $CAN_ADAS::HMI_0x4BF_ADAS::ACCplusActivationSubfeatureFriction = 0;
  $CAN_ADAS::HMI_0x4BF_ADAS::ACCplusActivationSubfeatureSPA = 0;
  $CAN_ADAS::HMI_0x4BF_ADAS::ACCplusActivationSubfeature_SLA = 0;
  $CAN_ADAS::HMI_0x4BF_ADAS::ACFDrivingMode = 0;
  $CAN_ADAS::HMI_0x4BF_ADAS::ADCDriverInputActivationDeactivation = 0;
  }
  if(init_count == 10)
  {
  $CAN_ADAS::HMI_0x4BF_ADAS::ADCParameterSelection = 0;
  $CAN_ADAS::HMI_0x4BF_ADAS::ADCVariantSelection = 0;
  $CAN_ADAS::HMI_0x4BF_ADAS::FrontCollisionWarningSensitivity = 0;
  $CAN_ADAS::HMI_0x4BF_ADAS::MainSwitchACC = 0;
  $CAN_ADAS::HMI_0x4BF_ADAS::MainSwitchACCplus = 0;
  $CAN_ADAS::HMI_0x4BF_ADAS::MainSwitchADC = 0;
  $CAN_ADAS::HMI_0x4BF_ADAS::MainSwitchTLR = 0;
  $CAN_ADAS::HMI_0x4BF_ADAS::Measurement_label = 0;
  $CAN_ADAS::ICC_0x526::EHU_ADASSnvtySet = 2;
  $CAN_ADAS::ICC_0x526::EHU_AEBFCTBSwt = 0;
  $CAN_ADAS::ICC_0x526::EHU_ESSSwt = 0;
  $CAN_ADAS::ICC_0x526::EHU_FCWFCTASwt = 0;
  $CAN_ADAS::ICC_0x526::EHU_HiwayExitAuxReq = 0;
  $CAN_ADAS::ICC_0x526::EHU_HiwayExitAuxSwt = 0;
  $CAN_ADAS::ICC_0x526::EHU_IntegtCrsModSet = 0;
  $CAN_ADAS::ICC_0x526::EHU_IntegtCrsSwt = 2;
  $CAN_ADAS::ICC_0x526::EHU_LDWAlrmTypReq = 1;
  $CAN_ADAS::ICC_0x526::EHU_LaneSprtSwt = 1;
  $CAN_ADAS::ICC_0x526::EHU_LaneSprtTypSet = 0;
  $CAN_ADAS::ICC_0x526::EHU_VoiceSpdRgln_ADAS = 40;
  $CAN_ADAS::ICC_0x531::ICM_ADASSigFlt = 0;
  $CAN_ADAS::ICC_0x531::ICM_DispFlt = 0;
  $CAN_ADAS::ICC_0x531::ICM_DispVehSpd = 0;
  $CAN_ADAS::ICC_0x531::ICM_DispVehSpdUnit = 0;
  $CAN_ADAS::ICC_0x531::ICM_TotMilgVld_ODO = 0;
  }
  if(init_count == 11)
  {
  $CAN_ADAS::ICC_0x531::ICM_TotMilg_ODO = 122692;
  $CAN_ADAS::MCU_F_0x150::MCU_F_CrtSpd = 740;
  $CAN_ADAS::MCU_F_0x150::MCU_F_CrtSpdSigVld = 1;
  $CAN_ADAS::MCU_R_0x151::MCU_R_CrtSpd = 740;
  $CAN_ADAS::MCU_R_0x151::MCU_R_CrtSpdSigVld = 1;
  $CAN_ADAS::PEPS_0x333::PEPS_PwrMod = 2;
  $CAN_ADAS::PEPS_0x333::PEPS_PwrModVld = 1;
  $CAN_ADAS::PT_VMI_01::DriverRqPtFxDominant = 0;
  $CAN_ADAS::PT_VMI_01::PtFxActual = 0;
  $CAN_ADAS::PT_VMI_01::PtFxMax = 0;
  $CAN_ADAS::PT_VMI_01::PtFxMin = 0;
  $CAN_ADAS::PT_VMI_01::PtFxRequested = 0;
  $CAN_ADAS::RBFMain11::RBFMain11_AccStabActivity = 0;
  $CAN_ADAS::RBFMain11::RBFMain11_AccStabAvail = 0;
  $CAN_ADAS::RBFMain11::RBFMain11_BrakeFxActual = 0;
  $CAN_ADAS::RBFMain11::RBFMain11_BrakeFxAvailability = 0;
  $CAN_ADAS::RBFMain11::RBFMain11_BrakeFxCapability = 0;
  $CAN_ADAS::RBFMain11::RBFMain11_DecStabActivity = 0;
  $CAN_ADAS::RBFMain11::RBFMain11_DecStabAvail = 0;
  $CAN_ADAS::RBFMain11::RBFMain11_DecStabAvlForDriver = 0;
  $CAN_ADAS::RBFMain11::RBFMain11_DecStabCpblty = 0;
  $CAN_ADAS::RBFMain11::RBFMain11_DecStabCpbltyForDrvr = 0;
  $CAN_ADAS::RBFMain11::RBFMain11_ParkBrakeAvl = 0;
  $CAN_ADAS::RBFMain11::RBFMain11_ParkBrakeCapability = 0;
  $CAN_ADAS::RBFMain11::RBFMain11_ParkBrakeState = 0;
  }
  if(init_count == 12)
  {
  $CAN_ADAS::RBFMain11::RBFMain11_ParkBrakeSupportReq = 0;
  $CAN_ADAS::RBFMain11::RBFMain11_YawRateStabActivity = 0;
  $CAN_ADAS::RBFMain11::RBFMain11_YawRateStabAvl = 2;
  $CAN_ADAS::RBFMain11::RBFMain11_isBrkFctReqFxBrkDom = 0;
  $CAN_ADAS::RBFMain11::RBFMain11_isBrkFctReqPrkBrkDom = 0;
  $CAN_ADAS::RBFMain11::RBFMain11_usedChannel = 0;
  $CAN_ADAS::RBFMain12::RBFMain12_BrakeBckpStratState = 0;
  $CAN_ADAS::RBFMain12::RBFMain12_BrkBckStgyVehStopAvl = 0;
  $CAN_ADAS::RBFMain12::RBFMain12_BrkBckStratFxCtrlAvl = 0;
  $CAN_ADAS::RBFMain12::RBFMain12_BrkDiscTempStatus = 0;
  $CAN_ADAS::RBFMain12::RBFMain12_BrkDiscTempStatusAvl = 0;
  $CAN_ADAS::RBFMain12::RBFMain12_CurrentPumpRev = 0;
  $CAN_ADAS::RBFMain12::RBFMain12_DriverReqParkBrake = 0;
  $CAN_ADAS::RBFMain12::RBFMain12_DrvPressBrkPedalAvl = 0;
  $CAN_ADAS::RBFMain12::RBFMain12_DrvReqFxBrkDomAvail = 0;
  $CAN_ADAS::RBFMain12::RBFMain12_DrvReqParkBrakeAvail = 0;
  $CAN_ADAS::RBFMain12::RBFMain12_DrvReqTarFxBrake = 0;
  $CAN_ADAS::RBFMain12::RBFMain12_DrvReqTarFxBrakeAvl = 0;
  $CAN_ADAS::RBFMain12::RBFMain12_isDrvPressBrkPedal = 0;
  $CAN_ADAS::RBFMain12::RBFMain12_isDrvReqFxBrakeDom = 0;
  $CAN_ADAS::RBFMain12::RBFMain12_isDrvReqParkBrkDom = 0;
  $CAN_ADAS::SDM_0x319::SDM_AirBagSysAlrmLampSts = 0;
  $CAN_ADAS::SDM_0x319::SDM_CllsnSig = 0;
  $CAN_ADAS::SDM_0x319::SDM_DrverSecuBltAlrmSts = 0;
  $CAN_ADAS::SDM_0x319::SDM_FrntCllsn = 0;
  }
  if(init_count == 13)
  {
  $CAN_ADAS::SDM_0x319::SDM_LeSideCllsn = 0;
  $CAN_ADAS::SDM_0x319::SDM_PassSecuBltAlrmSts = 0;
  $CAN_ADAS::SDM_0x319::SDM_ReCllsn = 0;
  $CAN_ADAS::SDM_0x319::SDM_RiSideCllsn = 0;
  $CAN_ADAS::VCU_0x1BA::ESP_LmcAxTrgt = 0;
  $CAN_ADAS::VCU_0x1BA::PwrTrnDrvDmdSts = 0;
  $CAN_ADAS::VCU_0x1BA::VCU_DrvrAPSPerc = 0;
  $CAN_ADAS::VCU_0x1BA::VCU_DrvrAPSPercVld = 1;
  $CAN_ADAS::VCU_0x1BA::VCU_WhlTqAct = 180;
  $CAN_ADAS::VCU_0x1BA::VCU_WhlTqActVld = 1;
  $CAN_ADAS::VCU_0x214::VCU_DrvModSig = 0;
  $CAN_ADAS::VCU_0x214::VCU_GearSig = 1;
  $CAN_ADAS::VCU_0x214::VCU_GearSigVld = 1;
  $CAN_ADAS::VCU_0x214::VCU_RdyLamp = 1;
  $CAN_ADAS::VCU_0x225::VCU_MotChkACCFltFbFlg = 0;
  $CAN_ADAS::VCU_0x225::VCU_OverMod = 0;
  $CAN_ADAS::VCU_0x225::VCU_VehMaxWhlTq = 32767;
  $CAN_ADAS::VCU_0x225::VCU_VehTqFltSts = 0;
  $CAN_ADAS::VariantCoding::Vehicle_Variant = 0;
  $CAN_ADAS::YRS_0x242::YRS_LatAcce = 0.01900000000000013;
  $CAN_ADAS::YRS_0x242::YRS_LatSnsrSts = 1;
  $CAN_ADAS::YRS_0x242::YRS_YawRate = 0.009999999999990905;
  $CAN_ADAS::YRS_0x242::YRS_YawRateCalSts = 1;
  $CAN_ADAS::YRS_0x242::YRS_YawRateSnsrSts = 1;
  $CAN_ADAS::YRS_0x246::YRS_LgtAcce = 0.008999999999999897;
  }
  if(init_count == 14)
  {
  $CAN_ADAS::YRS_0x246::YRS_LgtSnsrSts = 1;
  $CAN_ADAS::iBooster_0x271::iBooster_BrkPedlAppldFlg = 0;
  $CAN_ADAS::iBooster_0x271::iBooster_BrkPedlAppldVld = 1;
  if (prestart_mode==0) init_count = 0;
  initFlag = 4;
  }
  init_count++;
}
void init_DMS_F150_OD()
{
  if(init_count == 1)
  {
  $CAN_ADAS::DMS_HSC4_FrP01::DMSAdoWrnngDspCmdHSC4 = 0;
  $CAN_ADAS::DMS_HSC4_FrP01::DMSAudReqHSC4 = 0;
  $CAN_ADAS::DMS_HSC4_FrP01::DMSDspCmdHSC4 = 0;
  $CAN_ADAS::DMS_HSC4_FrP01::DMSHapticWrnngDspCmdHSC4 = 0;
  $CAN_ADAS::DMS_HSC4_FrP01::DMSStsHSC4 = 0;
  $CAN_ADAS::DMS_HSC4_FrP01::DMSVbnLvlReqHSC4 = 0;
  $CAN_ADAS::DMS_HSC4_FrP01::DMSWrnngReqHSC4 = 0;
  $CAN_ADAS::DMS_HSC4_FrP01::DrvrAbnormBehvorHSC4 = 0;
  $CAN_ADAS::DMS_HSC4_FrP01::DrvrDstcnStsHSC4 = 0;
  $CAN_ADAS::DMS_HSC4_FrP01::DrvrFtgLvlHSC4 = 0;
  $CAN_ADAS::DMS_HSC4_FrP01::DrvrGazeRgnHSC4 = 0;
  $CAN_ADAS::DMS_HSC4_FrP01::DrvrPrstHSC4 = 0;
  $CAN_ADAS::DMS_HSC4_FrP01::EyeOnRoadHSC4 = 0;
  $CAN_ADAS::DMS_HSC4_FrP01::SpfngDetHSC4 = 0;
  if (prestart_mode==0) init_count = 0;
  initFlag = 5;
  }
  init_count++;
}
void init_Map_F150_OD()
{
  if(init_count == 1)
  {
  $CAN_ADAS::EHR_Ego_Lane_Info1_0x4CC::Ego_Lane_CurrBoundary_Type_L = 0;
  $CAN_ADAS::EHR_Ego_Lane_Info1_0x4CC::Ego_Lane_CurrBoundary_Type_R = 0;
  $CAN_ADAS::EHR_Ego_Lane_Info1_0x4CC::Ego_Lane_CurrentSpeedLimit = 0;
  $CAN_ADAS::EHR_Ego_Lane_Info1_0x4CC::Ego_Lane_CurrentSpeedLimit_Type = 0;
  $CAN_ADAS::EHR_Ego_Lane_Info1_0x4CC::Ego_Lane_Info1_TimeStamp = 0;
  $CAN_ADAS::EHR_Ego_Lane_Info1_0x4CC::Ego_Lane_Map_Status = 0;
  $CAN_ADAS::EHR_Ego_Lane_Info1_0x4CC::Ego_Lane_NextBoundary_Loc_L_1 = 0;
  $CAN_ADAS::EHR_Ego_Lane_Info1_0x4CC::Ego_Lane_NextBoundary_Loc_L_2 = 0;
  $CAN_ADAS::EHR_Ego_Lane_Info1_0x4CC::Ego_Lane_NextBoundary_Loc_L_3 = 0;
  $CAN_ADAS::EHR_Ego_Lane_Info1_0x4CC::Ego_Lane_NextBoundary_Loc_L_4 = 0;
  $CAN_ADAS::EHR_Ego_Lane_Info1_0x4CC::Ego_Lane_NextBoundary_Loc_R_1 = 0;
  $CAN_ADAS::EHR_Ego_Lane_Info1_0x4CC::Ego_Lane_NextBoundary_Loc_R_2 = 0;
  $CAN_ADAS::EHR_Ego_Lane_Info1_0x4CC::Ego_Lane_NextBoundary_Loc_R_3 = 0;
  $CAN_ADAS::EHR_Ego_Lane_Info1_0x4CC::Ego_Lane_NextBoundary_Loc_R_4 = 0;
  $CAN_ADAS::EHR_Ego_Lane_Info1_0x4CC::Ego_Lane_NextBoundary_Type_L_1 = 0;
  $CAN_ADAS::EHR_Ego_Lane_Info1_0x4CC::Ego_Lane_NextBoundary_Type_L_2 = 0;
  $CAN_ADAS::EHR_Ego_Lane_Info1_0x4CC::Ego_Lane_NextBoundary_Type_L_3 = 0;
  $CAN_ADAS::EHR_Ego_Lane_Info1_0x4CC::Ego_Lane_NextBoundary_Type_L_4 = 0;
  $CAN_ADAS::EHR_Ego_Lane_Info1_0x4CC::Ego_Lane_NextBoundary_Type_R_1 = 0;
  $CAN_ADAS::EHR_Ego_Lane_Info1_0x4CC::Ego_Lane_NextBoundary_Type_R_2 = 0;
  $CAN_ADAS::EHR_Ego_Lane_Info1_0x4CC::Ego_Lane_NextBoundary_Type_R_3 = 0;
  $CAN_ADAS::EHR_Ego_Lane_Info1_0x4CC::Ego_Lane_NextBoundary_Type_R_4 = 0;
  $CAN_ADAS::EHR_Ego_Lane_Info1_0x4CC::Ego_Lane_NextSpeedLimit_Loc_1 = 0;
  $CAN_ADAS::EHR_Ego_Lane_Info1_0x4CC::Ego_Lane_NextSpeedLimit_Loc_2 = 0;
  $CAN_ADAS::EHR_Ego_Lane_Info1_0x4CC::Ego_Lane_NextSpeedLimit_Loc_3 = 0;
  }
  if(init_count == 2)
  {
  $CAN_ADAS::EHR_Ego_Lane_Info1_0x4CC::Ego_Lane_NextSpeedLimit_Loc_4 = 0;
  $CAN_ADAS::EHR_Ego_Lane_Info1_0x4CC::Ego_Lane_NextSpeedLimit_Type_1 = 0;
  $CAN_ADAS::EHR_Ego_Lane_Info1_0x4CC::Ego_Lane_NextSpeedLimit_Type_2 = 0;
  $CAN_ADAS::EHR_Ego_Lane_Info1_0x4CC::Ego_Lane_NextSpeedLimit_Type_3 = 0;
  $CAN_ADAS::EHR_Ego_Lane_Info1_0x4CC::Ego_Lane_NextSpeedLimit_Type_4 = 0;
  $CAN_ADAS::EHR_Ego_Lane_Info1_0x4CC::Ego_Lane_NextSpeedLimit_Value_1 = 0;
  $CAN_ADAS::EHR_Ego_Lane_Info1_0x4CC::Ego_Lane_NextSpeedLimit_Value_2 = 0;
  $CAN_ADAS::EHR_Ego_Lane_Info1_0x4CC::Ego_Lane_NextSpeedLimit_Value_3 = 0;
  $CAN_ADAS::EHR_Ego_Lane_Info1_0x4CC::Ego_Lane_NextSpeedLimit_Value_4 = 0;
  $CAN_ADAS::EHR_Ego_Lane_Info1_0x4CC::Ego_Lane_NextTopoLocation_1 = 0;
  $CAN_ADAS::EHR_Ego_Lane_Info1_0x4CC::Ego_Lane_NextTopoLocation_2 = 0;
  $CAN_ADAS::EHR_Ego_Lane_Info1_0x4CC::Ego_Lane_NextTopoLocation_3 = 0;
  $CAN_ADAS::EHR_Ego_Lane_Info1_0x4CC::Ego_Lane_NextTopoLocation_4 = 0;
  $CAN_ADAS::EHR_Ego_Lane_Info1_0x4CC::Ego_Lane_NextTopoSide_1 = 0;
  $CAN_ADAS::EHR_Ego_Lane_Info1_0x4CC::Ego_Lane_NextTopoSide_2 = 0;
  $CAN_ADAS::EHR_Ego_Lane_Info1_0x4CC::Ego_Lane_NextTopoSide_3 = 0;
  $CAN_ADAS::EHR_Ego_Lane_Info1_0x4CC::Ego_Lane_NextTopoSide_4 = 0;
  $CAN_ADAS::EHR_Ego_Lane_Info1_0x4CC::Ego_Lane_NextTopoType_1 = 0;
  $CAN_ADAS::EHR_Ego_Lane_Info1_0x4CC::Ego_Lane_NextTopoType_2 = 0;
  $CAN_ADAS::EHR_Ego_Lane_Info1_0x4CC::Ego_Lane_NextTopoType_3 = 0;
  $CAN_ADAS::EHR_Ego_Lane_Info1_0x4CC::Ego_Lane_NextTopoType_4 = 0;
  $CAN_ADAS::EHR_Ego_Lane_Info2_0x4CD::Ego_Lane_Info2_TimeStamp = 0;
  $CAN_ADAS::EHR_Ego_Lane_Info2_0x4CD::Ego_Lane_NextHotspot_Int_1 = 0;
  $CAN_ADAS::EHR_Ego_Lane_Info2_0x4CD::Ego_Lane_NextHotspot_Int_2 = 0;
  $CAN_ADAS::EHR_Ego_Lane_Info2_0x4CD::Ego_Lane_NextHotspot_Int_3 = 0;
  }
  if(init_count == 3)
  {
  $CAN_ADAS::EHR_Ego_Lane_Info2_0x4CD::Ego_Lane_NextHotspot_Int_4 = 0;
  $CAN_ADAS::EHR_Ego_Lane_Info2_0x4CD::Ego_Lane_NextHotspot_Length_1 = 0;
  $CAN_ADAS::EHR_Ego_Lane_Info2_0x4CD::Ego_Lane_NextHotspot_Length_2 = 0;
  $CAN_ADAS::EHR_Ego_Lane_Info2_0x4CD::Ego_Lane_NextHotspot_Length_3 = 0;
  $CAN_ADAS::EHR_Ego_Lane_Info2_0x4CD::Ego_Lane_NextHotspot_Length_4 = 0;
  $CAN_ADAS::EHR_Ego_Lane_Info2_0x4CD::Ego_Lane_NextHotspot_Loc_1 = 0;
  $CAN_ADAS::EHR_Ego_Lane_Info2_0x4CD::Ego_Lane_NextHotspot_Loc_2 = 0;
  $CAN_ADAS::EHR_Ego_Lane_Info2_0x4CD::Ego_Lane_NextHotspot_Loc_3 = 0;
  $CAN_ADAS::EHR_Ego_Lane_Info2_0x4CD::Ego_Lane_NextHotspot_Loc_4 = 0;
  $CAN_ADAS::EHR_Ego_Lane_Info2_0x4CD::Ego_Lane_NextHotspot_Prob_1 = 0;
  $CAN_ADAS::EHR_Ego_Lane_Info2_0x4CD::Ego_Lane_NextHotspot_Prob_2 = 0;
  $CAN_ADAS::EHR_Ego_Lane_Info2_0x4CD::Ego_Lane_NextHotspot_Prob_3 = 0;
  $CAN_ADAS::EHR_Ego_Lane_Info2_0x4CD::Ego_Lane_NextHotspot_Prob_4 = 0;
  $CAN_ADAS::EHR_Ego_Lane_Info2_0x4CD::Ego_Lane_NextHotspot_Side_1 = 0;
  $CAN_ADAS::EHR_Ego_Lane_Info2_0x4CD::Ego_Lane_NextHotspot_Side_2 = 0;
  $CAN_ADAS::EHR_Ego_Lane_Info2_0x4CD::Ego_Lane_NextHotspot_Side_3 = 0;
  $CAN_ADAS::EHR_Ego_Lane_Info2_0x4CD::Ego_Lane_NextHotspot_Side_4 = 0;
  $CAN_ADAS::EHR_Ego_Lane_Info2_0x4CD::Ego_Lane_NextHotspot_Type_1 = 0;
  $CAN_ADAS::EHR_Ego_Lane_Info2_0x4CD::Ego_Lane_NextHotspot_Type_2 = 0;
  $CAN_ADAS::EHR_Ego_Lane_Info2_0x4CD::Ego_Lane_NextHotspot_Type_3 = 0;
  $CAN_ADAS::EHR_Ego_Lane_Info2_0x4CD::Ego_Lane_NextHotspot_Type_4 = 0;
  $CAN_ADAS::EHR_Ego_Lane_Info2_0x4CD::Ego_Lane_SpeedProfile_Far_00 = 0;
  $CAN_ADAS::EHR_Ego_Lane_Info2_0x4CD::Ego_Lane_SpeedProfile_Far_01 = 0;
  $CAN_ADAS::EHR_Ego_Lane_Info2_0x4CD::Ego_Lane_SpeedProfile_Far_02 = 0;
  $CAN_ADAS::EHR_Ego_Lane_Info2_0x4CD::Ego_Lane_SpeedProfile_Far_03 = 0;
  }
  if(init_count == 4)
  {
  $CAN_ADAS::EHR_Ego_Lane_Info2_0x4CD::Ego_Lane_SpeedProfile_Far_04 = 0;
  $CAN_ADAS::EHR_Ego_Lane_Info2_0x4CD::Ego_Lane_SpeedProfile_Far_05 = 0;
  $CAN_ADAS::EHR_Ego_Lane_Info2_0x4CD::Ego_Lane_SpeedProfile_Far_06 = 0;
  $CAN_ADAS::EHR_Ego_Lane_Info2_0x4CD::Ego_Lane_SpeedProfile_Far_07 = 0;
  $CAN_ADAS::EHR_Ego_Lane_Info2_0x4CD::Ego_Lane_SpeedProfile_Far_08 = 0;
  $CAN_ADAS::EHR_Ego_Lane_Info2_0x4CD::Ego_Lane_SpeedProfile_Far_09 = 0;
  $CAN_ADAS::EHR_Ego_Lane_Info2_0x4CD::Ego_Lane_SpeedProfile_Far_10 = 0;
  $CAN_ADAS::EHR_Ego_Lane_Info2_0x4CD::Ego_Lane_SpeedProfile_Far_11 = 0;
  $CAN_ADAS::EHR_Ego_Lane_Info2_0x4CD::Ego_Lane_SpeedProfile_Far_12 = 0;
  $CAN_ADAS::EHR_Ego_Lane_Info2_0x4CD::Ego_Lane_SpeedProfile_Far_13 = 0;
  $CAN_ADAS::EHR_Ego_Lane_Info2_0x4CD::Ego_Lane_SpeedProfile_Far_14 = 0;
  $CAN_ADAS::EHR_Ego_Lane_Info2_0x4CD::Ego_Lane_SpeedProfile_Far_15 = 0;
  $CAN_ADAS::EHR_Ego_Lane_Info2_0x4CD::Ego_Lane_SpeedProfile_Far_16 = 0;
  $CAN_ADAS::EHR_Ego_Lane_Info2_0x4CD::Ego_Lane_SpeedProfile_Far_N = 0;
  $CAN_ADAS::EHR_Ego_Lane_Info2_0x4CD::Ego_Lane_SpeedProfile_Near_00 = 0;
  $CAN_ADAS::EHR_Ego_Lane_Info2_0x4CD::Ego_Lane_SpeedProfile_Near_01 = 0;
  $CAN_ADAS::EHR_Ego_Lane_Info2_0x4CD::Ego_Lane_SpeedProfile_Near_02 = 0;
  $CAN_ADAS::EHR_Ego_Lane_Info2_0x4CD::Ego_Lane_SpeedProfile_Near_03 = 0;
  $CAN_ADAS::EHR_Ego_Lane_Info2_0x4CD::Ego_Lane_SpeedProfile_Near_04 = 0;
  $CAN_ADAS::EHR_Ego_Lane_Info2_0x4CD::Ego_Lane_SpeedProfile_Near_05 = 0;
  $CAN_ADAS::EHR_Ego_Lane_Info2_0x4CD::Ego_Lane_SpeedProfile_Near_06 = 0;
  $CAN_ADAS::EHR_Ego_Lane_Info2_0x4CD::Ego_Lane_SpeedProfile_Near_07 = 0;
  $CAN_ADAS::EHR_Ego_Lane_Info2_0x4CD::Ego_Lane_SpeedProfile_Near_08 = 0;
  $CAN_ADAS::EHR_Ego_Lane_Info2_0x4CD::Ego_Lane_SpeedProfile_Near_09 = 0;
  $CAN_ADAS::EHR_Ego_Lane_Info2_0x4CD::Ego_Lane_SpeedProfile_Near_10 = 0;
  }
  if(init_count == 5)
  {
  $CAN_ADAS::EHR_Ego_Lane_Info2_0x4CD::Ego_Lane_SpeedProfile_Near_11 = 0;
  $CAN_ADAS::EHR_Ego_Lane_Info2_0x4CD::Ego_Lane_SpeedProfile_Near_12 = 0;
  $CAN_ADAS::EHR_Ego_Lane_Info2_0x4CD::Ego_Lane_SpeedProfile_Near_13 = 0;
  $CAN_ADAS::EHR_Ego_Lane_Info2_0x4CD::Ego_Lane_SpeedProfile_Near_14 = 0;
  $CAN_ADAS::EHR_Ego_Lane_Info2_0x4CD::Ego_Lane_SpeedProfile_Near_15 = 0;
  $CAN_ADAS::EHR_Ego_Lane_Info2_0x4CD::Ego_Lane_SpeedProfile_Near_16 = 0;
  $CAN_ADAS::EHR_Ego_Lane_Info2_0x4CD::Ego_Lane_SpeedProfile_Near_17 = 0;
  $CAN_ADAS::EHR_Ego_Lane_Info2_0x4CD::Ego_Lane_SpeedProfile_Near_18 = 0;
  $CAN_ADAS::EHR_Ego_Lane_Info2_0x4CD::Ego_Lane_SpeedProfile_Near_19 = 0;
  $CAN_ADAS::EHR_Ego_Lane_Info2_0x4CD::Ego_Lane_SpeedProfile_Near_20 = 0;
  $CAN_ADAS::EHR_Ego_Lane_Info2_0x4CD::Ego_Lane_SpeedProfile_Near_21 = 0;
  $CAN_ADAS::EHR_Ego_Lane_Info2_0x4CD::Ego_Lane_SpeedProfile_Near_22 = 0;
  $CAN_ADAS::EHR_Ego_Lane_Info2_0x4CD::Ego_Lane_SpeedProfile_Near_N = 0;
  $CAN_ADAS::EHR_GNSS_POS::EHR_GNSS_POS_LAT = 0;
  $CAN_ADAS::EHR_GNSS_POS::EHR_GNSS_POS_LONG = 0;
  $CAN_ADAS::EHR_GNSS_POS::EHR_GNSS_Stddev_lat = 0;
  $CAN_ADAS::EHR_GNSS_POS::EHR_GNSS_Stddev_long = 0;
  $CAN_ADAS::EHR_LOC_POSE::EHR_LOC_POSE_LAT = 0;
  $CAN_ADAS::EHR_LOC_POSE::EHR_LOC_POSE_LONG = 0;
  $CAN_ADAS::EHR_LOC_POSE::EHR_LOC_POSE_YAW = 0;
  $CAN_ADAS::EHR_LOC_POSE::EHR_LOC_Status = 0;
  $CAN_ADAS::EHR_Left_Lane_info_0x4CE::Left_CurrentSpeedLimit = 0;
  $CAN_ADAS::EHR_Left_Lane_info_0x4CE::Left_CurrentSpeedLimit_Type = 0;
  $CAN_ADAS::EHR_Left_Lane_info_0x4CE::Left_Lane_Exists = 0;
  $CAN_ADAS::EHR_Left_Lane_info_0x4CE::Left_Lane_Info_TimeStamp = 0;
  }
  if(init_count == 6)
  {
  $CAN_ADAS::EHR_Left_Lane_info_0x4CE::Left_Lane_Start_dx = 0;
  $CAN_ADAS::EHR_Left_Lane_info_0x4CE::Left_Lane_isOvertakeLane = 0;
  $CAN_ADAS::EHR_Left_Lane_info_0x4CE::Left_NextSpeedLimit_Location_1 = 0;
  $CAN_ADAS::EHR_Left_Lane_info_0x4CE::Left_NextSpeedLimit_Location_2 = 0;
  $CAN_ADAS::EHR_Left_Lane_info_0x4CE::Left_NextSpeedLimit_Location_3 = 0;
  $CAN_ADAS::EHR_Left_Lane_info_0x4CE::Left_NextSpeedLimit_Location_4 = 0;
  $CAN_ADAS::EHR_Left_Lane_info_0x4CE::Left_NextSpeedLimit_Type_1 = 0;
  $CAN_ADAS::EHR_Left_Lane_info_0x4CE::Left_NextSpeedLimit_Type_2 = 0;
  $CAN_ADAS::EHR_Left_Lane_info_0x4CE::Left_NextSpeedLimit_Type_3 = 0;
  $CAN_ADAS::EHR_Left_Lane_info_0x4CE::Left_NextSpeedLimit_Type_4 = 0;
  $CAN_ADAS::EHR_Left_Lane_info_0x4CE::Left_NextSpeedLimit_Value_1 = 0;
  $CAN_ADAS::EHR_Left_Lane_info_0x4CE::Left_NextSpeedLimit_Value_2 = 0;
  $CAN_ADAS::EHR_Left_Lane_info_0x4CE::Left_NextSpeedLimit_Value_3 = 0;
  $CAN_ADAS::EHR_Left_Lane_info_0x4CE::Left_NextSpeedLimit_Value_4 = 0;
  $CAN_ADAS::EHR_Left_Lane_info_0x4CE::Left_NextTopo_Loc_1 = 0;
  $CAN_ADAS::EHR_Left_Lane_info_0x4CE::Left_NextTopo_Loc_2 = 0;
  $CAN_ADAS::EHR_Left_Lane_info_0x4CE::Left_NextTopo_Loc_3 = 0;
  $CAN_ADAS::EHR_Left_Lane_info_0x4CE::Left_NextTopo_Loc_4 = 0;
  $CAN_ADAS::EHR_Left_Lane_info_0x4CE::Left_NextTopo_Side_1 = 0;
  $CAN_ADAS::EHR_Left_Lane_info_0x4CE::Left_NextTopo_Side_2 = 0;
  $CAN_ADAS::EHR_Left_Lane_info_0x4CE::Left_NextTopo_Side_3 = 0;
  $CAN_ADAS::EHR_Left_Lane_info_0x4CE::Left_NextTopo_Side_4 = 0;
  $CAN_ADAS::EHR_Left_Lane_info_0x4CE::Left_NextTopo_Type_1 = 0;
  $CAN_ADAS::EHR_Left_Lane_info_0x4CE::Left_NextTopo_Type_2 = 0;
  $CAN_ADAS::EHR_Left_Lane_info_0x4CE::Left_NextTopo_Type_3 = 0;
  }
  if(init_count == 7)
  {
  $CAN_ADAS::EHR_Left_Lane_info_0x4CE::Left_NextTopo_Type_4 = 0;
  $CAN_ADAS::EHR_Left_Lane_info_0x4CE::Left_SpeedProfile_Far_00 = 0;
  $CAN_ADAS::EHR_Left_Lane_info_0x4CE::Left_SpeedProfile_Far_01 = 0;
  $CAN_ADAS::EHR_Left_Lane_info_0x4CE::Left_SpeedProfile_Far_02 = 0;
  $CAN_ADAS::EHR_Left_Lane_info_0x4CE::Left_SpeedProfile_Far_03 = 0;
  $CAN_ADAS::EHR_Left_Lane_info_0x4CE::Left_SpeedProfile_Far_04 = 0;
  $CAN_ADAS::EHR_Left_Lane_info_0x4CE::Left_SpeedProfile_Far_05 = 0;
  $CAN_ADAS::EHR_Left_Lane_info_0x4CE::Left_SpeedProfile_Far_06 = 0;
  $CAN_ADAS::EHR_Left_Lane_info_0x4CE::Left_SpeedProfile_Far_07 = 0;
  $CAN_ADAS::EHR_Left_Lane_info_0x4CE::Left_SpeedProfile_Far_08 = 0;
  $CAN_ADAS::EHR_Left_Lane_info_0x4CE::Left_SpeedProfile_Far_09 = 0;
  $CAN_ADAS::EHR_Left_Lane_info_0x4CE::Left_SpeedProfile_Far_10 = 0;
  $CAN_ADAS::EHR_Left_Lane_info_0x4CE::Left_SpeedProfile_Far_11 = 0;
  $CAN_ADAS::EHR_Left_Lane_info_0x4CE::Left_SpeedProfile_Far_12 = 0;
  $CAN_ADAS::EHR_Left_Lane_info_0x4CE::Left_SpeedProfile_Far_13 = 0;
  $CAN_ADAS::EHR_Left_Lane_info_0x4CE::Left_SpeedProfile_Far_14 = 0;
  $CAN_ADAS::EHR_Left_Lane_info_0x4CE::Left_SpeedProfile_Far_15 = 0;
  $CAN_ADAS::EHR_Left_Lane_info_0x4CE::Left_SpeedProfile_Far_16 = 0;
  $CAN_ADAS::EHR_Left_Lane_info_0x4CE::Left_SpeedProfile_Far_N = 0;
  $CAN_ADAS::EHR_ReferenceLine1_0x4CA::ReferenceLine1_TimeStamp = 0;
  $CAN_ADAS::EHR_ReferenceLine1_0x4CA::ReferenceLine_dx_00 = 0;
  $CAN_ADAS::EHR_ReferenceLine1_0x4CA::ReferenceLine_dx_01 = 0;
  $CAN_ADAS::EHR_ReferenceLine1_0x4CA::ReferenceLine_dx_02 = 0;
  $CAN_ADAS::EHR_ReferenceLine1_0x4CA::ReferenceLine_dx_03 = 0;
  $CAN_ADAS::EHR_ReferenceLine1_0x4CA::ReferenceLine_dx_04 = 0;
  }
  if(init_count == 8)
  {
  $CAN_ADAS::EHR_ReferenceLine1_0x4CA::ReferenceLine_dx_05 = 0;
  $CAN_ADAS::EHR_ReferenceLine1_0x4CA::ReferenceLine_dx_06 = 0;
  $CAN_ADAS::EHR_ReferenceLine1_0x4CA::ReferenceLine_dx_07 = 0;
  $CAN_ADAS::EHR_ReferenceLine1_0x4CA::ReferenceLine_dx_08 = 0;
  $CAN_ADAS::EHR_ReferenceLine1_0x4CA::ReferenceLine_dx_09 = 0;
  $CAN_ADAS::EHR_ReferenceLine1_0x4CA::ReferenceLine_dx_10 = 0;
  $CAN_ADAS::EHR_ReferenceLine1_0x4CA::ReferenceLine_dx_11 = 0;
  $CAN_ADAS::EHR_ReferenceLine1_0x4CA::ReferenceLine_dx_12 = 0;
  $CAN_ADAS::EHR_ReferenceLine1_0x4CA::ReferenceLine_dx_13 = 0;
  $CAN_ADAS::EHR_ReferenceLine1_0x4CA::ReferenceLine_dx_14 = 0;
  $CAN_ADAS::EHR_ReferenceLine1_0x4CA::ReferenceLine_dx_15 = 0;
  $CAN_ADAS::EHR_ReferenceLine1_0x4CA::ReferenceLine_dx_16 = 0;
  $CAN_ADAS::EHR_ReferenceLine1_0x4CA::ReferenceLine_dx_17 = 0;
  $CAN_ADAS::EHR_ReferenceLine1_0x4CA::ReferenceLine_dx_18 = 0;
  $CAN_ADAS::EHR_ReferenceLine1_0x4CA::ReferenceLine_dy_00 = 0;
  $CAN_ADAS::EHR_ReferenceLine1_0x4CA::ReferenceLine_dy_01 = 0;
  $CAN_ADAS::EHR_ReferenceLine1_0x4CA::ReferenceLine_dy_02 = 0;
  $CAN_ADAS::EHR_ReferenceLine1_0x4CA::ReferenceLine_dy_03 = 0;
  $CAN_ADAS::EHR_ReferenceLine1_0x4CA::ReferenceLine_dy_04 = 0;
  $CAN_ADAS::EHR_ReferenceLine1_0x4CA::ReferenceLine_dy_05 = 0;
  $CAN_ADAS::EHR_ReferenceLine1_0x4CA::ReferenceLine_dy_06 = 0;
  $CAN_ADAS::EHR_ReferenceLine1_0x4CA::ReferenceLine_dy_07 = 0;
  $CAN_ADAS::EHR_ReferenceLine1_0x4CA::ReferenceLine_dy_08 = 0;
  $CAN_ADAS::EHR_ReferenceLine1_0x4CA::ReferenceLine_dy_09 = 0;
  $CAN_ADAS::EHR_ReferenceLine1_0x4CA::ReferenceLine_dy_10 = 0;
  }
  if(init_count == 9)
  {
  $CAN_ADAS::EHR_ReferenceLine1_0x4CA::ReferenceLine_dy_11 = 0;
  $CAN_ADAS::EHR_ReferenceLine1_0x4CA::ReferenceLine_dy_12 = 0;
  $CAN_ADAS::EHR_ReferenceLine1_0x4CA::ReferenceLine_dy_13 = 0;
  $CAN_ADAS::EHR_ReferenceLine1_0x4CA::ReferenceLine_dy_14 = 0;
  $CAN_ADAS::EHR_ReferenceLine1_0x4CA::ReferenceLine_dy_15 = 0;
  $CAN_ADAS::EHR_ReferenceLine1_0x4CA::ReferenceLine_dy_16 = 0;
  $CAN_ADAS::EHR_ReferenceLine1_0x4CA::ReferenceLine_dy_17 = 0;
  $CAN_ADAS::EHR_ReferenceLine1_0x4CA::ReferenceLine_dy_18 = 0;
  $CAN_ADAS::EHR_ReferenceLine1_0x4CA::ReferenceLine_point_N = 0;
  $CAN_ADAS::EHR_ReferenceLine2_0x4CB::ReferenceLine2_TimeStamp = 0;
  $CAN_ADAS::EHR_ReferenceLine2_0x4CB::ReferenceLine_dx_19 = 0;
  $CAN_ADAS::EHR_ReferenceLine2_0x4CB::ReferenceLine_dx_20 = 0;
  $CAN_ADAS::EHR_ReferenceLine2_0x4CB::ReferenceLine_dx_21 = 0;
  $CAN_ADAS::EHR_ReferenceLine2_0x4CB::ReferenceLine_dx_22 = 0;
  $CAN_ADAS::EHR_ReferenceLine2_0x4CB::ReferenceLine_dx_23 = 0;
  $CAN_ADAS::EHR_ReferenceLine2_0x4CB::ReferenceLine_dx_24 = 0;
  $CAN_ADAS::EHR_ReferenceLine2_0x4CB::ReferenceLine_dx_25 = 0;
  $CAN_ADAS::EHR_ReferenceLine2_0x4CB::ReferenceLine_dx_26 = 0;
  $CAN_ADAS::EHR_ReferenceLine2_0x4CB::ReferenceLine_dx_27 = 0;
  $CAN_ADAS::EHR_ReferenceLine2_0x4CB::ReferenceLine_dx_28 = 0;
  $CAN_ADAS::EHR_ReferenceLine2_0x4CB::ReferenceLine_dx_29 = 0;
  $CAN_ADAS::EHR_ReferenceLine2_0x4CB::ReferenceLine_dx_30 = 0;
  $CAN_ADAS::EHR_ReferenceLine2_0x4CB::ReferenceLine_dx_31 = 0;
  $CAN_ADAS::EHR_ReferenceLine2_0x4CB::ReferenceLine_dx_32 = 0;
  $CAN_ADAS::EHR_ReferenceLine2_0x4CB::ReferenceLine_dx_33 = 0;
  }
  if(init_count == 10)
  {
  $CAN_ADAS::EHR_ReferenceLine2_0x4CB::ReferenceLine_dx_34 = 0;
  $CAN_ADAS::EHR_ReferenceLine2_0x4CB::ReferenceLine_dy_19 = 0;
  $CAN_ADAS::EHR_ReferenceLine2_0x4CB::ReferenceLine_dy_20 = 0;
  $CAN_ADAS::EHR_ReferenceLine2_0x4CB::ReferenceLine_dy_21 = 0;
  $CAN_ADAS::EHR_ReferenceLine2_0x4CB::ReferenceLine_dy_22 = 0;
  $CAN_ADAS::EHR_ReferenceLine2_0x4CB::ReferenceLine_dy_23 = 0;
  $CAN_ADAS::EHR_ReferenceLine2_0x4CB::ReferenceLine_dy_24 = 0;
  $CAN_ADAS::EHR_ReferenceLine2_0x4CB::ReferenceLine_dy_25 = 0;
  $CAN_ADAS::EHR_ReferenceLine2_0x4CB::ReferenceLine_dy_26 = 0;
  $CAN_ADAS::EHR_ReferenceLine2_0x4CB::ReferenceLine_dy_27 = 0;
  $CAN_ADAS::EHR_ReferenceLine2_0x4CB::ReferenceLine_dy_28 = 0;
  $CAN_ADAS::EHR_ReferenceLine2_0x4CB::ReferenceLine_dy_29 = 0;
  $CAN_ADAS::EHR_ReferenceLine2_0x4CB::ReferenceLine_dy_30 = 0;
  $CAN_ADAS::EHR_ReferenceLine2_0x4CB::ReferenceLine_dy_31 = 0;
  $CAN_ADAS::EHR_ReferenceLine2_0x4CB::ReferenceLine_dy_32 = 0;
  $CAN_ADAS::EHR_ReferenceLine2_0x4CB::ReferenceLine_dy_33 = 0;
  $CAN_ADAS::EHR_ReferenceLine2_0x4CB::ReferenceLine_dy_34 = 0;
  $CAN_ADAS::EHR_Right_Lane_info_0x4CF::Right_CurrentSpeedLimit = 0;
  $CAN_ADAS::EHR_Right_Lane_info_0x4CF::Right_CurrentSpeedLimit_Type = 0;
  $CAN_ADAS::EHR_Right_Lane_info_0x4CF::Right_Lane_Exists = 0;
  $CAN_ADAS::EHR_Right_Lane_info_0x4CF::Right_Lane_Info_TimeStamp = 0;
  $CAN_ADAS::EHR_Right_Lane_info_0x4CF::Right_Lane_Start_dx = 0;
  $CAN_ADAS::EHR_Right_Lane_info_0x4CF::Right_Lane_isOvertakeLane = 0;
  $CAN_ADAS::EHR_Right_Lane_info_0x4CF::Right_NextSpeedLimit_Location_1 = 0;
  $CAN_ADAS::EHR_Right_Lane_info_0x4CF::Right_NextSpeedLimit_Location_2 = 0;
  }
  if(init_count == 11)
  {
  $CAN_ADAS::EHR_Right_Lane_info_0x4CF::Right_NextSpeedLimit_Location_3 = 0;
  $CAN_ADAS::EHR_Right_Lane_info_0x4CF::Right_NextSpeedLimit_Location_4 = 0;
  $CAN_ADAS::EHR_Right_Lane_info_0x4CF::Right_NextSpeedLimit_Type_1 = 0;
  $CAN_ADAS::EHR_Right_Lane_info_0x4CF::Right_NextSpeedLimit_Type_2 = 0;
  $CAN_ADAS::EHR_Right_Lane_info_0x4CF::Right_NextSpeedLimit_Type_3 = 0;
  $CAN_ADAS::EHR_Right_Lane_info_0x4CF::Right_NextSpeedLimit_Type_4 = 0;
  $CAN_ADAS::EHR_Right_Lane_info_0x4CF::Right_NextSpeedLimit_Value_1 = 0;
  $CAN_ADAS::EHR_Right_Lane_info_0x4CF::Right_NextSpeedLimit_Value_2 = 0;
  $CAN_ADAS::EHR_Right_Lane_info_0x4CF::Right_NextSpeedLimit_Value_3 = 0;
  $CAN_ADAS::EHR_Right_Lane_info_0x4CF::Right_NextSpeedLimit_Value_4 = 0;
  $CAN_ADAS::EHR_Right_Lane_info_0x4CF::Right_NextTopo_Loc_1 = 0;
  $CAN_ADAS::EHR_Right_Lane_info_0x4CF::Right_NextTopo_Loc_2 = 0;
  $CAN_ADAS::EHR_Right_Lane_info_0x4CF::Right_NextTopo_Loc_3 = 0;
  $CAN_ADAS::EHR_Right_Lane_info_0x4CF::Right_NextTopo_Loc_4 = 0;
  $CAN_ADAS::EHR_Right_Lane_info_0x4CF::Right_NextTopo_Side_1 = 0;
  $CAN_ADAS::EHR_Right_Lane_info_0x4CF::Right_NextTopo_Side_2 = 0;
  $CAN_ADAS::EHR_Right_Lane_info_0x4CF::Right_NextTopo_Side_3 = 0;
  $CAN_ADAS::EHR_Right_Lane_info_0x4CF::Right_NextTopo_Side_4 = 0;
  $CAN_ADAS::EHR_Right_Lane_info_0x4CF::Right_NextTopo_Type_1 = 0;
  $CAN_ADAS::EHR_Right_Lane_info_0x4CF::Right_NextTopo_Type_2 = 0;
  $CAN_ADAS::EHR_Right_Lane_info_0x4CF::Right_NextTopo_Type_3 = 0;
  $CAN_ADAS::EHR_Right_Lane_info_0x4CF::Right_NextTopo_Type_4 = 0;
  $CAN_ADAS::EHR_Right_Lane_info_0x4CF::Right_SpeedProfile_Far_00 = 0;
  $CAN_ADAS::EHR_Right_Lane_info_0x4CF::Right_SpeedProfile_Far_01 = 0;
  $CAN_ADAS::EHR_Right_Lane_info_0x4CF::Right_SpeedProfile_Far_02 = 0;
  }
  if(init_count == 12)
  {
  $CAN_ADAS::EHR_Right_Lane_info_0x4CF::Right_SpeedProfile_Far_03 = 0;
  $CAN_ADAS::EHR_Right_Lane_info_0x4CF::Right_SpeedProfile_Far_04 = 0;
  $CAN_ADAS::EHR_Right_Lane_info_0x4CF::Right_SpeedProfile_Far_05 = 0;
  $CAN_ADAS::EHR_Right_Lane_info_0x4CF::Right_SpeedProfile_Far_06 = 0;
  $CAN_ADAS::EHR_Right_Lane_info_0x4CF::Right_SpeedProfile_Far_07 = 0;
  $CAN_ADAS::EHR_Right_Lane_info_0x4CF::Right_SpeedProfile_Far_08 = 0;
  $CAN_ADAS::EHR_Right_Lane_info_0x4CF::Right_SpeedProfile_Far_09 = 0;
  $CAN_ADAS::EHR_Right_Lane_info_0x4CF::Right_SpeedProfile_Far_10 = 0;
  $CAN_ADAS::EHR_Right_Lane_info_0x4CF::Right_SpeedProfile_Far_11 = 0;
  $CAN_ADAS::EHR_Right_Lane_info_0x4CF::Right_SpeedProfile_Far_12 = 0;
  $CAN_ADAS::EHR_Right_Lane_info_0x4CF::Right_SpeedProfile_Far_13 = 0;
  $CAN_ADAS::EHR_Right_Lane_info_0x4CF::Right_SpeedProfile_Far_14 = 0;
  $CAN_ADAS::EHR_Right_Lane_info_0x4CF::Right_SpeedProfile_Far_15 = 0;
  $CAN_ADAS::EHR_Right_Lane_info_0x4CF::Right_SpeedProfile_Far_16 = 0;
  $CAN_ADAS::EHR_Right_Lane_info_0x4CF::Right_SpeedProfile_Far_N = 0;
  $CAN_ADAS::HDM_Centerline_1::CenterPoint_dx_00 = 0;
  $CAN_ADAS::HDM_Centerline_1::CenterPoint_dx_01 = 0;
  $CAN_ADAS::HDM_Centerline_1::CenterPoint_dx_02 = 0;
  $CAN_ADAS::HDM_Centerline_1::CenterPoint_dx_03 = 0;
  $CAN_ADAS::HDM_Centerline_1::CenterPoint_dx_04 = 0;
  $CAN_ADAS::HDM_Centerline_1::CenterPoint_dx_05 = 0;
  $CAN_ADAS::HDM_Centerline_1::CenterPoint_dx_06 = 0;
  $CAN_ADAS::HDM_Centerline_1::CenterPoint_dx_07 = 0;
  $CAN_ADAS::HDM_Centerline_1::CenterPoint_dx_08 = 0;
  $CAN_ADAS::HDM_Centerline_1::CenterPoint_dx_09 = 0;
  }
  if(init_count == 13)
  {
  $CAN_ADAS::HDM_Centerline_1::CenterPoint_dx_10 = 0;
  $CAN_ADAS::HDM_Centerline_1::CenterPoint_dx_11 = 0;
  $CAN_ADAS::HDM_Centerline_1::CenterPoint_dx_12 = 0;
  $CAN_ADAS::HDM_Centerline_1::CenterPoint_dx_13 = 0;
  $CAN_ADAS::HDM_Centerline_1::CenterPoint_dx_14 = 0;
  $CAN_ADAS::HDM_Centerline_1::CenterPoint_dx_15 = 0;
  $CAN_ADAS::HDM_Centerline_1::CenterPoint_dx_16 = 0;
  $CAN_ADAS::HDM_Centerline_1::CenterPoint_dx_17 = 0;
  $CAN_ADAS::HDM_Centerline_1::CenterPoint_dx_18 = 0;
  $CAN_ADAS::HDM_Centerline_1::CenterPoint_dx_19 = 0;
  $CAN_ADAS::HDM_Centerline_1::CenterPoint_dy_00 = 0;
  $CAN_ADAS::HDM_Centerline_1::CenterPoint_dy_01 = 0;
  $CAN_ADAS::HDM_Centerline_1::CenterPoint_dy_02 = 0;
  $CAN_ADAS::HDM_Centerline_1::CenterPoint_dy_03 = 0;
  $CAN_ADAS::HDM_Centerline_1::CenterPoint_dy_04 = 0;
  $CAN_ADAS::HDM_Centerline_1::CenterPoint_dy_05 = 0;
  $CAN_ADAS::HDM_Centerline_1::CenterPoint_dy_06 = 0;
  $CAN_ADAS::HDM_Centerline_1::CenterPoint_dy_07 = 0;
  $CAN_ADAS::HDM_Centerline_1::CenterPoint_dy_08 = 0;
  $CAN_ADAS::HDM_Centerline_1::CenterPoint_dy_09 = 0;
  $CAN_ADAS::HDM_Centerline_1::CenterPoint_dy_10 = 0;
  $CAN_ADAS::HDM_Centerline_1::CenterPoint_dy_11 = 0;
  $CAN_ADAS::HDM_Centerline_1::CenterPoint_dy_12 = 0;
  $CAN_ADAS::HDM_Centerline_1::CenterPoint_dy_13 = 0;
  $CAN_ADAS::HDM_Centerline_1::CenterPoint_dy_14 = 0;
  }
  if(init_count == 14)
  {
  $CAN_ADAS::HDM_Centerline_1::CenterPoint_dy_15 = 0;
  $CAN_ADAS::HDM_Centerline_1::CenterPoint_dy_16 = 0;
  $CAN_ADAS::HDM_Centerline_1::CenterPoint_dy_17 = 0;
  $CAN_ADAS::HDM_Centerline_1::CenterPoint_dy_18 = 0;
  $CAN_ADAS::HDM_Centerline_1::CenterPoint_dy_19 = 0;
  $CAN_ADAS::HDM_Centerline_2::CenterPoint_dx_20 = 0;
  $CAN_ADAS::HDM_Centerline_2::CenterPoint_dx_21 = 0;
  $CAN_ADAS::HDM_Centerline_2::CenterPoint_dx_22 = 0;
  $CAN_ADAS::HDM_Centerline_2::CenterPoint_dx_23 = 0;
  $CAN_ADAS::HDM_Centerline_2::CenterPoint_dx_24 = 0;
  $CAN_ADAS::HDM_Centerline_2::CenterPoint_dx_25 = 0;
  $CAN_ADAS::HDM_Centerline_2::CenterPoint_dx_26 = 0;
  $CAN_ADAS::HDM_Centerline_2::CenterPoint_dx_27 = 0;
  $CAN_ADAS::HDM_Centerline_2::CenterPoint_dx_28 = 0;
  $CAN_ADAS::HDM_Centerline_2::CenterPoint_dx_29 = 0;
  $CAN_ADAS::HDM_Centerline_2::CenterPoint_dx_30 = 0;
  $CAN_ADAS::HDM_Centerline_2::CenterPoint_dx_31 = 0;
  $CAN_ADAS::HDM_Centerline_2::CenterPoint_dx_32 = 0;
  $CAN_ADAS::HDM_Centerline_2::CenterPoint_dx_33 = 0;
  $CAN_ADAS::HDM_Centerline_2::CenterPoint_dx_34 = 0;
  $CAN_ADAS::HDM_Centerline_2::CenterPoint_dy_20 = 0;
  $CAN_ADAS::HDM_Centerline_2::CenterPoint_dy_21 = 0;
  $CAN_ADAS::HDM_Centerline_2::CenterPoint_dy_22 = 0;
  $CAN_ADAS::HDM_Centerline_2::CenterPoint_dy_23 = 0;
  $CAN_ADAS::HDM_Centerline_2::CenterPoint_dy_24 = 0;
  }
  if(init_count == 15)
  {
  $CAN_ADAS::HDM_Centerline_2::CenterPoint_dy_25 = 0;
  $CAN_ADAS::HDM_Centerline_2::CenterPoint_dy_26 = 0;
  $CAN_ADAS::HDM_Centerline_2::CenterPoint_dy_27 = 0;
  $CAN_ADAS::HDM_Centerline_2::CenterPoint_dy_28 = 0;
  $CAN_ADAS::HDM_Centerline_2::CenterPoint_dy_29 = 0;
  $CAN_ADAS::HDM_Centerline_2::CenterPoint_dy_30 = 0;
  $CAN_ADAS::HDM_Centerline_2::CenterPoint_dy_31 = 0;
  $CAN_ADAS::HDM_Centerline_2::CenterPoint_dy_32 = 0;
  $CAN_ADAS::HDM_Centerline_2::CenterPoint_dy_33 = 0;
  $CAN_ADAS::HDM_Centerline_2::CenterPoint_dy_34 = 0;
  $CAN_ADAS::HDM_Centerline_2::Timestamp = 0;
  $CAN_ADAS::HDM_Centerline_2::centerline_LaneWidth = 0;
  $CAN_ADAS::HDM_Centerline_2::localization_heading_StdDev = 0;
  $CAN_ADAS::HDM_Centerline_2::localization_lat_StdDev = 0;
  $CAN_ADAS::HDM_Centerline_2::localization_long_StdDev = 0;
  $CAN_ADAS::HDM_Centerline_2::map_position_accuracy = 0;
  $CAN_ADAS::HDM_Centerline_2::map_position_deviation = 0;
  $CAN_ADAS::HDM_Central_Line_HighR::CenterPoint_dx_00_HighR = 0;
  $CAN_ADAS::HDM_Central_Line_HighR::CenterPoint_dx_01_HighR = 0;
  $CAN_ADAS::HDM_Central_Line_HighR::CenterPoint_dx_02_HighR = 0;
  $CAN_ADAS::HDM_Central_Line_HighR::CenterPoint_dx_03_HighR = 0;
  $CAN_ADAS::HDM_Central_Line_HighR::CenterPoint_dx_04_HighR = 0;
  $CAN_ADAS::HDM_Central_Line_HighR::CenterPoint_dx_05_HighR = 0;
  $CAN_ADAS::HDM_Central_Line_HighR::CenterPoint_dx_06_HighR = 0;
  $CAN_ADAS::HDM_Central_Line_HighR::CenterPoint_dx_07_HighR = 0;
  }
  if(init_count == 16)
  {
  $CAN_ADAS::HDM_Central_Line_HighR::CenterPoint_dx_08_HighR = 0;
  $CAN_ADAS::HDM_Central_Line_HighR::CenterPoint_dx_09_HighR = 0;
  $CAN_ADAS::HDM_Central_Line_HighR::CenterPoint_dx_10_HighR = 0;
  $CAN_ADAS::HDM_Central_Line_HighR::CenterPoint_dx_11_HighR = 0;
  $CAN_ADAS::HDM_Central_Line_HighR::CenterPoint_dx_12_HighR = 0;
  $CAN_ADAS::HDM_Central_Line_HighR::CenterPoint_dx_13_HighR = 0;
  $CAN_ADAS::HDM_Central_Line_HighR::CenterPoint_dx_14_HighR = 0;
  $CAN_ADAS::HDM_Central_Line_HighR::CenterPoint_dx_15_HighR = 0;
  $CAN_ADAS::HDM_Central_Line_HighR::CenterPoint_dx_16_HighR = 0;
  $CAN_ADAS::HDM_Central_Line_HighR::CenterPoint_dx_17_HighR = 0;
  $CAN_ADAS::HDM_Central_Line_HighR::CenterPoint_dx_18_HighR = 0;
  $CAN_ADAS::HDM_Central_Line_HighR::CenterPoint_dx_19_HighR = 0;
  $CAN_ADAS::HDM_Central_Line_HighR::CenterPoint_dx_20_HighR = 0;
  $CAN_ADAS::HDM_Central_Line_HighR::CenterPoint_dx_21_HighR = 0;
  $CAN_ADAS::HDM_Central_Line_HighR::CenterPoint_dx_22_HighR = 0;
  $CAN_ADAS::HDM_Central_Line_HighR::CenterPoint_dx_23_HighR = 0;
  $CAN_ADAS::HDM_Central_Line_HighR::CenterPoint_dx_24_HighR = 0;
  $CAN_ADAS::HDM_Central_Line_HighR::CenterPoint_dx_25_HighR = 0;
  $CAN_ADAS::HDM_Central_Line_HighR::CenterPoint_dx_26_HighR = 0;
  $CAN_ADAS::HDM_Central_Line_HighR::CenterPoint_dx_27_HighR = 0;
  $CAN_ADAS::HDM_Central_Line_HighR::CenterPoint_dx_28_HighR = 0;
  $CAN_ADAS::HDM_Central_Line_HighR::CenterPoint_dx_29_HighR = 0;
  $CAN_ADAS::HDM_Central_Line_HighR::CenterPoint_dx_30_HighR = 0;
  $CAN_ADAS::HDM_Central_Line_HighR::CenterPoint_dx_31_HighR = 0;
  $CAN_ADAS::HDM_Central_Line_HighR::CenterPoint_dx_32_HighR = 0;
  }
  if(init_count == 17)
  {
  $CAN_ADAS::HDM_Central_Line_HighR::CenterPoint_dx_33_HighR = 0;
  $CAN_ADAS::HDM_Central_Line_HighR::CenterPoint_dx_34_HighR = 0;
  $CAN_ADAS::HDM_Central_Line_HighR::CenterPoint_dx_m01_HighR = 0;
  $CAN_ADAS::HDM_Central_Line_HighR::CenterPoint_dx_m02_HighR = 0;
  $CAN_ADAS::HDM_Central_Line_HighR::CenterPoint_dx_m03_HighR = 0;
  $CAN_ADAS::HDM_Central_Line_HighR::CenterPoint_dx_m04_HighR = 0;
  $CAN_ADAS::HDM_Central_Line_HighR::CenterPoint_dy_00_HighR = 0;
  $CAN_ADAS::HDM_Central_Line_HighR::CenterPoint_dy_01_HighR = 0;
  $CAN_ADAS::HDM_Central_Line_HighR::CenterPoint_dy_02_HighR = 0;
  $CAN_ADAS::HDM_Central_Line_HighR::CenterPoint_dy_03_HighR = 0;
  $CAN_ADAS::HDM_Central_Line_HighR::CenterPoint_dy_04_HighR = 0;
  $CAN_ADAS::HDM_Central_Line_HighR::CenterPoint_dy_05_HighR = 0;
  $CAN_ADAS::HDM_Central_Line_HighR::CenterPoint_dy_06_HighR = 0;
  $CAN_ADAS::HDM_Central_Line_HighR::CenterPoint_dy_07_HighR = 0;
  $CAN_ADAS::HDM_Central_Line_HighR::CenterPoint_dy_08_HighR = 0;
  $CAN_ADAS::HDM_Central_Line_HighR::CenterPoint_dy_09_HighR = 0;
  $CAN_ADAS::HDM_Central_Line_HighR::CenterPoint_dy_10_HighR = 0;
  $CAN_ADAS::HDM_Central_Line_HighR::CenterPoint_dy_11_HighR = 0;
  $CAN_ADAS::HDM_Central_Line_HighR::CenterPoint_dy_12_HighR = 0;
  $CAN_ADAS::HDM_Central_Line_HighR::CenterPoint_dy_13_HighR = 0;
  $CAN_ADAS::HDM_Central_Line_HighR::CenterPoint_dy_14_HighR = 0;
  $CAN_ADAS::HDM_Central_Line_HighR::CenterPoint_dy_15_HighR = 0;
  $CAN_ADAS::HDM_Central_Line_HighR::CenterPoint_dy_16_HighR = 0;
  $CAN_ADAS::HDM_Central_Line_HighR::CenterPoint_dy_17_HighR = 0;
  $CAN_ADAS::HDM_Central_Line_HighR::CenterPoint_dy_18_HighR = 0;
  }
  if(init_count == 18)
  {
  $CAN_ADAS::HDM_Central_Line_HighR::CenterPoint_dy_19_HighR = 0;
  $CAN_ADAS::HDM_Central_Line_HighR::CenterPoint_dy_20_HighR = 0;
  $CAN_ADAS::HDM_Central_Line_HighR::CenterPoint_dy_21_HighR = 0;
  $CAN_ADAS::HDM_Central_Line_HighR::CenterPoint_dy_22_HighR = 0;
  $CAN_ADAS::HDM_Central_Line_HighR::CenterPoint_dy_23_HighR = 0;
  $CAN_ADAS::HDM_Central_Line_HighR::CenterPoint_dy_24_HighR = 0;
  $CAN_ADAS::HDM_Central_Line_HighR::CenterPoint_dy_25_HighR = 0;
  $CAN_ADAS::HDM_Central_Line_HighR::CenterPoint_dy_26_HighR = 0;
  $CAN_ADAS::HDM_Central_Line_HighR::CenterPoint_dy_27_HighR = 0;
  $CAN_ADAS::HDM_Central_Line_HighR::CenterPoint_dy_28_HighR = 0;
  $CAN_ADAS::HDM_Central_Line_HighR::CenterPoint_dy_29_HighR = 0;
  $CAN_ADAS::HDM_Central_Line_HighR::CenterPoint_dy_30_HighR = 0;
  $CAN_ADAS::HDM_Central_Line_HighR::CenterPoint_dy_31_HighR = 0;
  $CAN_ADAS::HDM_Central_Line_HighR::CenterPoint_dy_32_HighR = 0;
  $CAN_ADAS::HDM_Central_Line_HighR::CenterPoint_dy_33_HighR = 0;
  $CAN_ADAS::HDM_Central_Line_HighR::CenterPoint_dy_34_HighR = 0;
  $CAN_ADAS::HDM_Central_Line_HighR::CenterPoint_dy_m01_HighR = 0;
  $CAN_ADAS::HDM_Central_Line_HighR::CenterPoint_dy_m02_HighR = 0;
  $CAN_ADAS::HDM_Central_Line_HighR::CenterPoint_dy_m03_HighR = 0;
  $CAN_ADAS::HDM_Central_Line_HighR::CenterPoint_dy_m04_HighR = 0;
  $CAN_ADAS::HDM_Central_Line_M::CenterPoint_dx_m01 = 0;
  $CAN_ADAS::HDM_Central_Line_M::CenterPoint_dx_m02 = 0;
  $CAN_ADAS::HDM_Central_Line_M::CenterPoint_dx_m03 = 0;
  $CAN_ADAS::HDM_Central_Line_M::CenterPoint_dx_m04 = 0;
  $CAN_ADAS::HDM_Central_Line_M::CenterPoint_dy_m01 = 0;
  }
  if(init_count == 19)
  {
  $CAN_ADAS::HDM_Central_Line_M::CenterPoint_dy_m02 = 0;
  $CAN_ADAS::HDM_Central_Line_M::CenterPoint_dy_m03 = 0;
  $CAN_ADAS::HDM_Central_Line_M::CenterPoint_dy_m04 = 0;
  $CAN_ADAS::HDM_Central_Line_M::MAP_TimeSync = 0;
  $CAN_ADAS::HDM_Curv::Cv_Offset_Seg00 = 0;
  $CAN_ADAS::HDM_Curv::Cv_Offset_Seg01 = 0;
  $CAN_ADAS::HDM_Curv::Cv_Offset_Seg02 = 0;
  $CAN_ADAS::HDM_Curv::Cv_Offset_Seg03 = 0;
  $CAN_ADAS::HDM_Curv::Cv_Offset_Seg04 = 0;
  $CAN_ADAS::HDM_Curv::Cv_Offset_Seg05 = 0;
  $CAN_ADAS::HDM_Curv::Cv_Offset_Seg06 = 0;
  $CAN_ADAS::HDM_Curv::Cv_Offset_Seg07 = 0;
  $CAN_ADAS::HDM_Curv::Cv_Offset_Seg08 = 0;
  $CAN_ADAS::HDM_Curv::Cv_Offset_Seg09 = 0;
  $CAN_ADAS::HDM_Curv::Cv_Offset_Seg10 = 0;
  $CAN_ADAS::HDM_Curv::Cv_Offset_Seg11 = 0;
  $CAN_ADAS::HDM_Curv::Cv_Offset_Seg12 = 0;
  $CAN_ADAS::HDM_Curv::Cv_Offset_Seg13 = 0;
  $CAN_ADAS::HDM_Curv::Cv_Offset_Seg14 = 0;
  $CAN_ADAS::HDM_Curv::Cv_Offset_Seg15 = 0;
  $CAN_ADAS::HDM_Curv::Cv_Offset_Seg16 = 0;
  $CAN_ADAS::HDM_Curv::Cv_Offset_Seg17 = 0;
  $CAN_ADAS::HDM_Curv::Cv_Offset_Seg18 = 0;
  $CAN_ADAS::HDM_Curv::Cv_Offset_Seg19 = 0;
  $CAN_ADAS::HDM_Curv::Cv_Value_Seg00 = 0;
  }
  if(init_count == 20)
  {
  $CAN_ADAS::HDM_Curv::Cv_Value_Seg01 = 0;
  $CAN_ADAS::HDM_Curv::Cv_Value_Seg02 = 0;
  $CAN_ADAS::HDM_Curv::Cv_Value_Seg03 = 0;
  $CAN_ADAS::HDM_Curv::Cv_Value_Seg04 = 0;
  $CAN_ADAS::HDM_Curv::Cv_Value_Seg05 = 0;
  $CAN_ADAS::HDM_Curv::Cv_Value_Seg06 = 0;
  $CAN_ADAS::HDM_Curv::Cv_Value_Seg07 = 0;
  $CAN_ADAS::HDM_Curv::Cv_Value_Seg08 = 0;
  $CAN_ADAS::HDM_Curv::Cv_Value_Seg09 = 0;
  $CAN_ADAS::HDM_Curv::Cv_Value_Seg10 = 0;
  $CAN_ADAS::HDM_Curv::Cv_Value_Seg11 = 0;
  $CAN_ADAS::HDM_Curv::Cv_Value_Seg12 = 0;
  $CAN_ADAS::HDM_Curv::Cv_Value_Seg13 = 0;
  $CAN_ADAS::HDM_Curv::Cv_Value_Seg14 = 0;
  $CAN_ADAS::HDM_Curv::Cv_Value_Seg15 = 0;
  $CAN_ADAS::HDM_Curv::Cv_Value_Seg16 = 0;
  $CAN_ADAS::HDM_Curv::Cv_Value_Seg17 = 0;
  $CAN_ADAS::HDM_Curv::Cv_Value_Seg18 = 0;
  $CAN_ADAS::HDM_Curv::Cv_Value_Seg19 = 0;
  $CAN_ADAS::HDM_GF::GF_ActiveSpeedLimit = 0;
  $CAN_ADAS::HDM_GF::GF_BlackListedSegment_offset = 0;
  $CAN_ADAS::HDM_GF::GF_Country_outOfODD_offset = 0;
  $CAN_ADAS::HDM_GF::GF_Currentlane_Index = 0;
  $CAN_ADAS::HDM_GF::GF_Curvature_outOfODD_offset = 0;
  $CAN_ADAS::HDM_GF::GF_FormOfWay_outOfODD_offset = 0;
  }
  if(init_count == 21)
  {
  $CAN_ADAS::HDM_GF::GF_Intersection_offset = 0;
  $CAN_ADAS::HDM_GF::GF_LaneTrans_outOfODD_offset = 0;
  $CAN_ADAS::HDM_GF::GF_LaneType_outOfODD_offset = 0;
  $CAN_ADAS::HDM_GF::GF_LaneWidth_outOfODD_offset = 0;
  $CAN_ADAS::HDM_GF::GF_MapExpired = 0;
  $CAN_ADAS::HDM_GF::GF_MapStatus = 0;
  $CAN_ADAS::HDM_GF::GF_NumberOfLanes = 0;
  $CAN_ADAS::HDM_GF::GF_Region_outOfODD_offset = 0;
  $CAN_ADAS::HDM_GF::GF_RoadSlope_outOfODD_offset = 0;
  $CAN_ADAS::HDM_GF::GF_SideWind_offset = 0;
  $CAN_ADAS::HDM_GF::GF_TollGate_offset = 0;
  $CAN_ADAS::HDM_GF::GF_TrafficLight_offset = 0;
  $CAN_ADAS::HDM_GF::GF_Tunnel_Offset = 0;
  $CAN_ADAS::HDM_GF::GF_map_position_accuracy = 0;
  $CAN_ADAS::HDM_GF::GF_map_position_deviation = 0;
  if (prestart_mode==0) init_count = 0;
  initFlag = 6;
  }
  init_count++;
}
void init_IMU_F150_OD()
{
  if(init_count == 1)
  {
  $CAN_ADAS::IMU_TX1::acc_x = 0;
  $CAN_ADAS::IMU_TX1::acc_y = 0;
  $CAN_ADAS::IMU_TX1::acc_z = 0;
  $CAN_ADAS::IMU_TX1::crc_tx1 = 0;
  $CAN_ADAS::IMU_TX1::msg_cnt_tx1 = 0;
  $CAN_ADAS::IMU_TX1::status_acc_x = 0;
  $CAN_ADAS::IMU_TX1::status_acc_y = 0;
  $CAN_ADAS::IMU_TX1::status_acc_z = 0;
  $CAN_ADAS::IMU_TX2::crc_tx2 = 0;
  $CAN_ADAS::IMU_TX2::msg_cnt_tx2 = 0;
  $CAN_ADAS::IMU_TX2::rate_x = 0;
  $CAN_ADAS::IMU_TX2::rate_y = 0;
  $CAN_ADAS::IMU_TX2::rate_z = 0;
  $CAN_ADAS::IMU_TX2::status_rate_x = 0;
  $CAN_ADAS::IMU_TX2::status_rate_y = 0;
  $CAN_ADAS::IMU_TX2::status_rate_z = 0;
  if (prestart_mode==0) init_count = 0;
  initFlag = 7;
  }
  init_count++;
}
void init_CRadarFC_F150_OD()
{
  if(init_count == 1)
  {
  $CAN_RadarFC::RFC_CornerFunctions::RFC_CF_AEx_revEgoBrakingStatus = 0;
  $CAN_RadarFC::RFC_CornerFunctions::RFC_CF_AEx_revEgoWarnStatus = 0;
  $CAN_RadarFC::RFC_CornerFunctions::RFC_CF_AEx_revEgo_BrakeRequest = 0;
  $CAN_RadarFC::RFC_CornerFunctions::RFC_CF_AEx_revEgo_TargetDec = 0;
  $CAN_RadarFC::RFC_CornerFunctions::RFC_CF_AEx_revEgo_WarningLevel = 0;
  $CAN_RadarFC::RFC_CornerFunctions::RFC_CF_BsdLca_Status = 0;
  $CAN_RadarFC::RFC_CornerFunctions::RFC_CF_BsdLca_WarningLevel = 0;
  $CAN_RadarFC::RFC_CornerFunctions::RFC_CF_DOx_PrevStatus = 0;
  $CAN_RadarFC::RFC_CornerFunctions::RFC_CF_DOx_WarnStatus = 0;
  $CAN_RadarFC::RFC_CornerFunctions::RFC_CF_DOx_WarningLevel = 0;
  sysSetVariableData(sysvar::CAN_RadarFC::RFC_FieldDataCollection::RFC_FieldDataCollection::SignalValue, RFC_FieldDataCollection_byte_Array, 5000);
  @CAN_RadarFC::RFC_Object::RFC_Object_E2E_p44_dataId = 0;
  @CAN_RadarFC::RFC_Object::RFC_Object_E2E_p44_length = 0;
  @CAN_RadarFC::RFC_Object::RFC_Object_Obj10.Age = 0;
  @CAN_RadarFC::RFC_Object::RFC_Object_Obj10.Ax = 0;
  @CAN_RadarFC::RFC_Object::RFC_Object_Obj10.AxAyCoVnce = 0;
  @CAN_RadarFC::RFC_Object::RFC_Object_Obj10.AxVnce = 0;
  @CAN_RadarFC::RFC_Object::RFC_Object_Obj10.Ay = 0;
  @CAN_RadarFC::RFC_Object::RFC_Object_Obj10.AyVnce = 0;
  @CAN_RadarFC::RFC_Object::RFC_Object_Obj10.ExistProb = 0;
  @CAN_RadarFC::RFC_Object::RFC_Object_Obj10.FilterInformation = 0;
  @CAN_RadarFC::RFC_Object::RFC_Object_Obj10.Length = 0;
  @CAN_RadarFC::RFC_Object::RFC_Object_Obj10.LengthVnce = 0;
  @CAN_RadarFC::RFC_Object::RFC_Object_Obj10.MeasurementStatus = 0;
  @CAN_RadarFC::RFC_Object::RFC_Object_Obj10.MovingStatus = 0;
  }
  if(init_count == 2)
  {
  @CAN_RadarFC::RFC_Object::RFC_Object_Obj10.ObjId = 0;
  @CAN_RadarFC::RFC_Object::RFC_Object_Obj10.OrientationYaw = 0;
  @CAN_RadarFC::RFC_Object::RFC_Object_Obj10.OrientationYawVnce = 0;
  @CAN_RadarFC::RFC_Object::RFC_Object_Obj10.ProbClassConfidence = 0;
  @CAN_RadarFC::RFC_Object::RFC_Object_Obj10.ProbClassType = 0;
  @CAN_RadarFC::RFC_Object::RFC_Object_Obj10.Px = 0;
  @CAN_RadarFC::RFC_Object::RFC_Object_Obj10.PxAxCoVnce = 0;
  @CAN_RadarFC::RFC_Object::RFC_Object_Obj10.PxAyCoVnce = 0;
  @CAN_RadarFC::RFC_Object::RFC_Object_Obj10.PxPyCoVnce = 0;
  @CAN_RadarFC::RFC_Object::RFC_Object_Obj10.PxVnce = 0;
  @CAN_RadarFC::RFC_Object::RFC_Object_Obj10.PxVxCoVnce = 0;
  @CAN_RadarFC::RFC_Object::RFC_Object_Obj10.PxVyCoVnce = 0;
  @CAN_RadarFC::RFC_Object::RFC_Object_Obj10.Py = 0;
  @CAN_RadarFC::RFC_Object::RFC_Object_Obj10.PyAxCoVnce = 0;
  @CAN_RadarFC::RFC_Object::RFC_Object_Obj10.PyAyCoVnce = 0;
  @CAN_RadarFC::RFC_Object::RFC_Object_Obj10.PyVnce = 0;
  @CAN_RadarFC::RFC_Object::RFC_Object_Obj10.PyVxCoVnce = 0;
  @CAN_RadarFC::RFC_Object::RFC_Object_Obj10.PyVyCoVnce = 0;
  @CAN_RadarFC::RFC_Object::RFC_Object_Obj10.ReferencePoint = 0;
  @CAN_RadarFC::RFC_Object::RFC_Object_Obj10.Vx = 0;
  @CAN_RadarFC::RFC_Object::RFC_Object_Obj10.VxAxCoVnce = 0;
  @CAN_RadarFC::RFC_Object::RFC_Object_Obj10.VxAyCoVnce = 0;
  @CAN_RadarFC::RFC_Object::RFC_Object_Obj10.VxVnce = 0;
  @CAN_RadarFC::RFC_Object::RFC_Object_Obj10.VxVyCoVnce = 0;
  @CAN_RadarFC::RFC_Object::RFC_Object_Obj10.Vy = 0;
  }
  if(init_count == 3)
  {
  @CAN_RadarFC::RFC_Object::RFC_Object_Obj10.VyAxCoVnce = 0;
  @CAN_RadarFC::RFC_Object::RFC_Object_Obj10.VyAyCoVnce = 0;
  @CAN_RadarFC::RFC_Object::RFC_Object_Obj10.VyVnce = 0;
  @CAN_RadarFC::RFC_Object::RFC_Object_Obj10.Width = 0;
  @CAN_RadarFC::RFC_Object::RFC_Object_Obj10.WidthVnce = 0;
  @CAN_RadarFC::RFC_Object::RFC_Object_Obj11.Age = 0;
  @CAN_RadarFC::RFC_Object::RFC_Object_Obj11.Ax = 0;
  @CAN_RadarFC::RFC_Object::RFC_Object_Obj11.AxAyCoVnce = 0;
  @CAN_RadarFC::RFC_Object::RFC_Object_Obj11.AxVnce = 0;
  @CAN_RadarFC::RFC_Object::RFC_Object_Obj11.Ay = 0;
  @CAN_RadarFC::RFC_Object::RFC_Object_Obj11.AyVnce = 0;
  @CAN_RadarFC::RFC_Object::RFC_Object_Obj11.ExistProb = 0;
  @CAN_RadarFC::RFC_Object::RFC_Object_Obj11.FilterInformation = 0;
  @CAN_RadarFC::RFC_Object::RFC_Object_Obj11.Length = 0;
  @CAN_RadarFC::RFC_Object::RFC_Object_Obj11.LengthVnce = 0;
  @CAN_RadarFC::RFC_Object::RFC_Object_Obj11.MeasurementStatus = 0;
  @CAN_RadarFC::RFC_Object::RFC_Object_Obj11.MovingStatus = 0;
  @CAN_RadarFC::RFC_Object::RFC_Object_Obj11.ObjId = 0;
  @CAN_RadarFC::RFC_Object::RFC_Object_Obj11.OrientationYaw = 0;
  @CAN_RadarFC::RFC_Object::RFC_Object_Obj11.OrientationYawVnce = 0;
  @CAN_RadarFC::RFC_Object::RFC_Object_Obj11.ProbClassConfidence = 0;
  @CAN_RadarFC::RFC_Object::RFC_Object_Obj11.ProbClassType = 0;
  @CAN_RadarFC::RFC_Object::RFC_Object_Obj11.Px = 0;
  @CAN_RadarFC::RFC_Object::RFC_Object_Obj11.PxAxCoVnce = 0;
  @CAN_RadarFC::RFC_Object::RFC_Object_Obj11.PxAyCoVnce = 0;
  }
  if(init_count == 4)
  {
  @CAN_RadarFC::RFC_Object::RFC_Object_Obj11.PxPyCoVnce = 0;
  @CAN_RadarFC::RFC_Object::RFC_Object_Obj11.PxVnce = 0;
  @CAN_RadarFC::RFC_Object::RFC_Object_Obj11.PxVxCoVnce = 0;
  @CAN_RadarFC::RFC_Object::RFC_Object_Obj11.PxVyCoVnce = 0;
  @CAN_RadarFC::RFC_Object::RFC_Object_Obj11.Py = 0;
  @CAN_RadarFC::RFC_Object::RFC_Object_Obj11.PyAxCoVnce = 0;
  @CAN_RadarFC::RFC_Object::RFC_Object_Obj11.PyAyCoVnce = 0;
  @CAN_RadarFC::RFC_Object::RFC_Object_Obj11.PyVnce = 0;
  @CAN_RadarFC::RFC_Object::RFC_Object_Obj11.PyVxCoVnce = 0;
  @CAN_RadarFC::RFC_Object::RFC_Object_Obj11.PyVyCoVnce = 0;
  @CAN_RadarFC::RFC_Object::RFC_Object_Obj11.ReferencePoint = 0;
  @CAN_RadarFC::RFC_Object::RFC_Object_Obj11.Vx = 0;
  @CAN_RadarFC::RFC_Object::RFC_Object_Obj11.VxAxCoVnce = 0;
  @CAN_RadarFC::RFC_Object::RFC_Object_Obj11.VxAyCoVnce = 0;
  @CAN_RadarFC::RFC_Object::RFC_Object_Obj11.VxVnce = 0;
  @CAN_RadarFC::RFC_Object::RFC_Object_Obj11.VxVyCoVnce = 0;
  @CAN_RadarFC::RFC_Object::RFC_Object_Obj11.Vy = 0;
  @CAN_RadarFC::RFC_Object::RFC_Object_Obj11.VyAxCoVnce = 0;
  @CAN_RadarFC::RFC_Object::RFC_Object_Obj11.VyAyCoVnce = 0;
  @CAN_RadarFC::RFC_Object::RFC_Object_Obj11.VyVnce = 0;
  @CAN_RadarFC::RFC_Object::RFC_Object_Obj11.Width = 0;
  @CAN_RadarFC::RFC_Object::RFC_Object_Obj11.WidthVnce = 0;
  @CAN_RadarFC::RFC_Object::RFC_Object_Obj12.Age = 0;
  @CAN_RadarFC::RFC_Object::RFC_Object_Obj12.Ax = 0;
  @CAN_RadarFC::RFC_Object::RFC_Object_Obj12.AxAyCoVnce = 0;
  }
  if(init_count == 5)
  {
  @CAN_RadarFC::RFC_Object::RFC_Object_Obj12.AxVnce = 0;
  @CAN_RadarFC::RFC_Object::RFC_Object_Obj12.Ay = 0;
  @CAN_RadarFC::RFC_Object::RFC_Object_Obj12.AyVnce = 0;
  @CAN_RadarFC::RFC_Object::RFC_Object_Obj12.ExistProb = 0;
  @CAN_RadarFC::RFC_Object::RFC_Object_Obj12.FilterInformation = 0;
  @CAN_RadarFC::RFC_Object::RFC_Object_Obj12.Length = 0;
  @CAN_RadarFC::RFC_Object::RFC_Object_Obj12.LengthVnce = 0;
  @CAN_RadarFC::RFC_Object::RFC_Object_Obj12.MeasurementStatus = 0;
  @CAN_RadarFC::RFC_Object::RFC_Object_Obj12.MovingStatus = 0;
  @CAN_RadarFC::RFC_Object::RFC_Object_Obj12.ObjId = 0;
  @CAN_RadarFC::RFC_Object::RFC_Object_Obj12.OrientationYaw = 0;
  @CAN_RadarFC::RFC_Object::RFC_Object_Obj12.OrientationYawVnce = 0;
  @CAN_RadarFC::RFC_Object::RFC_Object_Obj12.ProbClassConfidence = 0;
  @CAN_RadarFC::RFC_Object::RFC_Object_Obj12.ProbClassType = 0;
  @CAN_RadarFC::RFC_Object::RFC_Object_Obj12.Px = 0;
  @CAN_RadarFC::RFC_Object::RFC_Object_Obj12.PxAxCoVnce = 0;
  @CAN_RadarFC::RFC_Object::RFC_Object_Obj12.PxAyCoVnce = 0;
  @CAN_RadarFC::RFC_Object::RFC_Object_Obj12.PxPyCoVnce = 0;
  @CAN_RadarFC::RFC_Object::RFC_Object_Obj12.PxVnce = 0;
  @CAN_RadarFC::RFC_Object::RFC_Object_Obj12.PxVxCoVnce = 0;
  @CAN_RadarFC::RFC_Object::RFC_Object_Obj12.PxVyCoVnce = 0;
  @CAN_RadarFC::RFC_Object::RFC_Object_Obj12.Py = 0;
  @CAN_RadarFC::RFC_Object::RFC_Object_Obj12.PyAxCoVnce = 0;
  @CAN_RadarFC::RFC_Object::RFC_Object_Obj12.PyAyCoVnce = 0;
  @CAN_RadarFC::RFC_Object::RFC_Object_Obj12.PyVnce = 0;
  }
  if(init_count == 6)
  {
  @CAN_RadarFC::RFC_Object::RFC_Object_Obj12.PyVxCoVnce = 0;
  @CAN_RadarFC::RFC_Object::RFC_Object_Obj12.PyVyCoVnce = 0;
  @CAN_RadarFC::RFC_Object::RFC_Object_Obj12.ReferencePoint = 0;
  @CAN_RadarFC::RFC_Object::RFC_Object_Obj12.Vx = 0;
  @CAN_RadarFC::RFC_Object::RFC_Object_Obj12.VxAxCoVnce = 0;
  @CAN_RadarFC::RFC_Object::RFC_Object_Obj12.VxAyCoVnce = 0;
  @CAN_RadarFC::RFC_Object::RFC_Object_Obj12.VxVnce = 0;
  @CAN_RadarFC::RFC_Object::RFC_Object_Obj12.VxVyCoVnce = 0;
  @CAN_RadarFC::RFC_Object::RFC_Object_Obj12.Vy = 0;
  @CAN_RadarFC::RFC_Object::RFC_Object_Obj12.VyAxCoVnce = 0;
  @CAN_RadarFC::RFC_Object::RFC_Object_Obj12.VyAyCoVnce = 0;
  @CAN_RadarFC::RFC_Object::RFC_Object_Obj12.VyVnce = 0;
  @CAN_RadarFC::RFC_Object::RFC_Object_Obj12.Width = 0;
  @CAN_RadarFC::RFC_Object::RFC_Object_Obj12.WidthVnce = 0;
  @CAN_RadarFC::RFC_Object::RFC_Object_Obj13.Age = 0;
  @CAN_RadarFC::RFC_Object::RFC_Object_Obj13.Ax = 0;
  @CAN_RadarFC::RFC_Object::RFC_Object_Obj13.AxAyCoVnce = 0;
  @CAN_RadarFC::RFC_Object::RFC_Object_Obj13.AxVnce = 0;
  @CAN_RadarFC::RFC_Object::RFC_Object_Obj13.Ay = 0;
  @CAN_RadarFC::RFC_Object::RFC_Object_Obj13.AyVnce = 0;
  @CAN_RadarFC::RFC_Object::RFC_Object_Obj13.ExistProb = 0;
  @CAN_RadarFC::RFC_Object::RFC_Object_Obj13.FilterInformation = 0;
  @CAN_RadarFC::RFC_Object::RFC_Object_Obj13.Length = 0;
  @CAN_RadarFC::RFC_Object::RFC_Object_Obj13.LengthVnce = 0;
  @CAN_RadarFC::RFC_Object::RFC_Object_Obj13.MeasurementStatus = 0;
  }
  if(init_count == 7)
  {
  @CAN_RadarFC::RFC_Object::RFC_Object_Obj13.MovingStatus = 0;
  @CAN_RadarFC::RFC_Object::RFC_Object_Obj13.ObjId = 0;
  @CAN_RadarFC::RFC_Object::RFC_Object_Obj13.OrientationYaw = 0;
  @CAN_RadarFC::RFC_Object::RFC_Object_Obj13.OrientationYawVnce = 0;
  @CAN_RadarFC::RFC_Object::RFC_Object_Obj13.ProbClassConfidence = 0;
  @CAN_RadarFC::RFC_Object::RFC_Object_Obj13.ProbClassType = 0;
  @CAN_RadarFC::RFC_Object::RFC_Object_Obj13.Px = 0;
  @CAN_RadarFC::RFC_Object::RFC_Object_Obj13.PxAxCoVnce = 0;
  @CAN_RadarFC::RFC_Object::RFC_Object_Obj13.PxAyCoVnce = 0;
  @CAN_RadarFC::RFC_Object::RFC_Object_Obj13.PxPyCoVnce = 0;
  @CAN_RadarFC::RFC_Object::RFC_Object_Obj13.PxVnce = 0;
  @CAN_RadarFC::RFC_Object::RFC_Object_Obj13.PxVxCoVnce = 0;
  @CAN_RadarFC::RFC_Object::RFC_Object_Obj13.PxVyCoVnce = 0;
  @CAN_RadarFC::RFC_Object::RFC_Object_Obj13.Py = 0;
  @CAN_RadarFC::RFC_Object::RFC_Object_Obj13.PyAxCoVnce = 0;
  @CAN_RadarFC::RFC_Object::RFC_Object_Obj13.PyAyCoVnce = 0;
  @CAN_RadarFC::RFC_Object::RFC_Object_Obj13.PyVnce = 0;
  @CAN_RadarFC::RFC_Object::RFC_Object_Obj13.PyVxCoVnce = 0;
  @CAN_RadarFC::RFC_Object::RFC_Object_Obj13.PyVyCoVnce = 0;
  @CAN_RadarFC::RFC_Object::RFC_Object_Obj13.ReferencePoint = 0;
  @CAN_RadarFC::RFC_Object::RFC_Object_Obj13.Vx = 0;
  @CAN_RadarFC::RFC_Object::RFC_Object_Obj13.VxAxCoVnce = 0;
  @CAN_RadarFC::RFC_Object::RFC_Object_Obj13.VxAyCoVnce = 0;
  @CAN_RadarFC::RFC_Object::RFC_Object_Obj13.VxVnce = 0;
  @CAN_RadarFC::RFC_Object::RFC_Object_Obj13.VxVyCoVnce = 0;
  }
  if(init_count == 8)
  {
  @CAN_RadarFC::RFC_Object::RFC_Object_Obj13.Vy = 0;
  @CAN_RadarFC::RFC_Object::RFC_Object_Obj13.VyAxCoVnce = 0;
  @CAN_RadarFC::RFC_Object::RFC_Object_Obj13.VyAyCoVnce = 0;
  @CAN_RadarFC::RFC_Object::RFC_Object_Obj13.VyVnce = 0;
  @CAN_RadarFC::RFC_Object::RFC_Object_Obj13.Width = 0;
  @CAN_RadarFC::RFC_Object::RFC_Object_Obj13.WidthVnce = 0;
  @CAN_RadarFC::RFC_Object::RFC_Object_Obj14.Age = 0;
  @CAN_RadarFC::RFC_Object::RFC_Object_Obj14.Ax = 0;
  @CAN_RadarFC::RFC_Object::RFC_Object_Obj14.AxAyCoVnce = 0;
  @CAN_RadarFC::RFC_Object::RFC_Object_Obj14.AxVnce = 0;
  @CAN_RadarFC::RFC_Object::RFC_Object_Obj14.Ay = 0;
  @CAN_RadarFC::RFC_Object::RFC_Object_Obj14.AyVnce = 0;
  @CAN_RadarFC::RFC_Object::RFC_Object_Obj14.ExistProb = 0;
  @CAN_RadarFC::RFC_Object::RFC_Object_Obj14.FilterInformation = 0;
  @CAN_RadarFC::RFC_Object::RFC_Object_Obj14.Length = 0;
  @CAN_RadarFC::RFC_Object::RFC_Object_Obj14.LengthVnce = 0;
  @CAN_RadarFC::RFC_Object::RFC_Object_Obj14.MeasurementStatus = 0;
  @CAN_RadarFC::RFC_Object::RFC_Object_Obj14.MovingStatus = 0;
  @CAN_RadarFC::RFC_Object::RFC_Object_Obj14.ObjId = 0;
  @CAN_RadarFC::RFC_Object::RFC_Object_Obj14.OrientationYaw = 0;
  @CAN_RadarFC::RFC_Object::RFC_Object_Obj14.OrientationYawVnce = 0;
  @CAN_RadarFC::RFC_Object::RFC_Object_Obj14.ProbClassConfidence = 0;
  @CAN_RadarFC::RFC_Object::RFC_Object_Obj14.ProbClassType = 0;
  @CAN_RadarFC::RFC_Object::RFC_Object_Obj14.Px = 0;
  @CAN_RadarFC::RFC_Object::RFC_Object_Obj14.PxAxCoVnce = 0;
  }
  if(init_count == 9)
  {
  @CAN_RadarFC::RFC_Object::RFC_Object_Obj14.PxAyCoVnce = 0;
  @CAN_RadarFC::RFC_Object::RFC_Object_Obj14.PxPyCoVnce = 0;
  @CAN_RadarFC::RFC_Object::RFC_Object_Obj14.PxVnce = 0;
  @CAN_RadarFC::RFC_Object::RFC_Object_Obj14.PxVxCoVnce = 0;
  @CAN_RadarFC::RFC_Object::RFC_Object_Obj14.PxVyCoVnce = 0;
  @CAN_RadarFC::RFC_Object::RFC_Object_Obj14.Py = 0;
  @CAN_RadarFC::RFC_Object::RFC_Object_Obj14.PyAxCoVnce = 0;
  @CAN_RadarFC::RFC_Object::RFC_Object_Obj14.PyAyCoVnce = 0;
  @CAN_RadarFC::RFC_Object::RFC_Object_Obj14.PyVnce = 0;
  @CAN_RadarFC::RFC_Object::RFC_Object_Obj14.PyVxCoVnce = 0;
  @CAN_RadarFC::RFC_Object::RFC_Object_Obj14.PyVyCoVnce = 0;
  @CAN_RadarFC::RFC_Object::RFC_Object_Obj14.ReferencePoint = 0;
  @CAN_RadarFC::RFC_Object::RFC_Object_Obj14.Vx = 0;
  @CAN_RadarFC::RFC_Object::RFC_Object_Obj14.VxAxCoVnce = 0;
  @CAN_RadarFC::RFC_Object::RFC_Object_Obj14.VxAyCoVnce = 0;
  @CAN_RadarFC::RFC_Object::RFC_Object_Obj14.VxVnce = 0;
  @CAN_RadarFC::RFC_Object::RFC_Object_Obj14.VxVyCoVnce = 0;
  @CAN_RadarFC::RFC_Object::RFC_Object_Obj14.Vy = 0;
  @CAN_RadarFC::RFC_Object::RFC_Object_Obj14.VyAxCoVnce = 0;
  @CAN_RadarFC::RFC_Object::RFC_Object_Obj14.VyAyCoVnce = 0;
  @CAN_RadarFC::RFC_Object::RFC_Object_Obj14.VyVnce = 0;
  @CAN_RadarFC::RFC_Object::RFC_Object_Obj14.Width = 0;
  @CAN_RadarFC::RFC_Object::RFC_Object_Obj14.WidthVnce = 0;
  @CAN_RadarFC::RFC_Object::RFC_Object_Obj15.Age = 0;
  @CAN_RadarFC::RFC_Object::RFC_Object_Obj15.Ax = 0;
  }
  if(init_count == 10)
  {
  @CAN_RadarFC::RFC_Object::RFC_Object_Obj15.AxAyCoVnce = 0;
  @CAN_RadarFC::RFC_Object::RFC_Object_Obj15.AxVnce = 0;
  @CAN_RadarFC::RFC_Object::RFC_Object_Obj15.Ay = 0;
  @CAN_RadarFC::RFC_Object::RFC_Object_Obj15.AyVnce = 0;
  @CAN_RadarFC::RFC_Object::RFC_Object_Obj15.ExistProb = 0;
  @CAN_RadarFC::RFC_Object::RFC_Object_Obj15.FilterInformation = 0;
  @CAN_RadarFC::RFC_Object::RFC_Object_Obj15.Length = 0;
  @CAN_RadarFC::RFC_Object::RFC_Object_Obj15.LengthVnce = 0;
  @CAN_RadarFC::RFC_Object::RFC_Object_Obj15.MeasurementStatus = 0;
  @CAN_RadarFC::RFC_Object::RFC_Object_Obj15.MovingStatus = 0;
  @CAN_RadarFC::RFC_Object::RFC_Object_Obj15.ObjId = 0;
  @CAN_RadarFC::RFC_Object::RFC_Object_Obj15.OrientationYaw = 0;
  @CAN_RadarFC::RFC_Object::RFC_Object_Obj15.OrientationYawVnce = 0;
  @CAN_RadarFC::RFC_Object::RFC_Object_Obj15.ProbClassConfidence = 0;
  @CAN_RadarFC::RFC_Object::RFC_Object_Obj15.ProbClassType = 0;
  @CAN_RadarFC::RFC_Object::RFC_Object_Obj15.Px = 0;
  @CAN_RadarFC::RFC_Object::RFC_Object_Obj15.PxAxCoVnce = 0;
  @CAN_RadarFC::RFC_Object::RFC_Object_Obj15.PxAyCoVnce = 0;
  @CAN_RadarFC::RFC_Object::RFC_Object_Obj15.PxPyCoVnce = 0;
  @CAN_RadarFC::RFC_Object::RFC_Object_Obj15.PxVnce = 0;
  @CAN_RadarFC::RFC_Object::RFC_Object_Obj15.PxVxCoVnce = 0;
  @CAN_RadarFC::RFC_Object::RFC_Object_Obj15.PxVyCoVnce = 0;
  @CAN_RadarFC::RFC_Object::RFC_Object_Obj15.Py = 0;
  @CAN_RadarFC::RFC_Object::RFC_Object_Obj15.PyAxCoVnce = 0;
  @CAN_RadarFC::RFC_Object::RFC_Object_Obj15.PyAyCoVnce = 0;
  }
  if(init_count == 11)
  {
  @CAN_RadarFC::RFC_Object::RFC_Object_Obj15.PyVnce = 0;
  @CAN_RadarFC::RFC_Object::RFC_Object_Obj15.PyVxCoVnce = 0;
  @CAN_RadarFC::RFC_Object::RFC_Object_Obj15.PyVyCoVnce = 0;
  @CAN_RadarFC::RFC_Object::RFC_Object_Obj15.ReferencePoint = 0;
  @CAN_RadarFC::RFC_Object::RFC_Object_Obj15.Vx = 0;
  @CAN_RadarFC::RFC_Object::RFC_Object_Obj15.VxAxCoVnce = 0;
  @CAN_RadarFC::RFC_Object::RFC_Object_Obj15.VxAyCoVnce = 0;
  @CAN_RadarFC::RFC_Object::RFC_Object_Obj15.VxVnce = 0;
  @CAN_RadarFC::RFC_Object::RFC_Object_Obj15.VxVyCoVnce = 0;
  @CAN_RadarFC::RFC_Object::RFC_Object_Obj15.Vy = 0;
  @CAN_RadarFC::RFC_Object::RFC_Object_Obj15.VyAxCoVnce = 0;
  @CAN_RadarFC::RFC_Object::RFC_Object_Obj15.VyAyCoVnce = 0;
  @CAN_RadarFC::RFC_Object::RFC_Object_Obj15.VyVnce = 0;
  @CAN_RadarFC::RFC_Object::RFC_Object_Obj15.Width = 0;
  @CAN_RadarFC::RFC_Object::RFC_Object_Obj15.WidthVnce = 0;
  @CAN_RadarFC::RFC_Object::RFC_Object_Obj16.Age = 0;
  @CAN_RadarFC::RFC_Object::RFC_Object_Obj16.Ax = 0;
  @CAN_RadarFC::RFC_Object::RFC_Object_Obj16.AxAyCoVnce = 0;
  @CAN_RadarFC::RFC_Object::RFC_Object_Obj16.AxVnce = 0;
  @CAN_RadarFC::RFC_Object::RFC_Object_Obj16.Ay = 0;
  @CAN_RadarFC::RFC_Object::RFC_Object_Obj16.AyVnce = 0;
  @CAN_RadarFC::RFC_Object::RFC_Object_Obj16.ExistProb = 0;
  @CAN_RadarFC::RFC_Object::RFC_Object_Obj16.FilterInformation = 0;
  @CAN_RadarFC::RFC_Object::RFC_Object_Obj16.Length = 0;
  @CAN_RadarFC::RFC_Object::RFC_Object_Obj16.LengthVnce = 0;
  }
  if(init_count == 12)
  {
  @CAN_RadarFC::RFC_Object::RFC_Object_Obj16.MeasurementStatus = 0;
  @CAN_RadarFC::RFC_Object::RFC_Object_Obj16.MovingStatus = 0;
  @CAN_RadarFC::RFC_Object::RFC_Object_Obj16.ObjId = 0;
  @CAN_RadarFC::RFC_Object::RFC_Object_Obj16.OrientationYaw = 0;
  @CAN_RadarFC::RFC_Object::RFC_Object_Obj16.OrientationYawVnce = 0;
  @CAN_RadarFC::RFC_Object::RFC_Object_Obj16.ProbClassConfidence = 0;
  @CAN_RadarFC::RFC_Object::RFC_Object_Obj16.ProbClassType = 0;
  @CAN_RadarFC::RFC_Object::RFC_Object_Obj16.Px = 0;
  @CAN_RadarFC::RFC_Object::RFC_Object_Obj16.PxAxCoVnce = 0;
  @CAN_RadarFC::RFC_Object::RFC_Object_Obj16.PxAyCoVnce = 0;
  @CAN_RadarFC::RFC_Object::RFC_Object_Obj16.PxPyCoVnce = 0;
  @CAN_RadarFC::RFC_Object::RFC_Object_Obj16.PxVnce = 0;
  @CAN_RadarFC::RFC_Object::RFC_Object_Obj16.PxVxCoVnce = 0;
  @CAN_RadarFC::RFC_Object::RFC_Object_Obj16.PxVyCoVnce = 0;
  @CAN_RadarFC::RFC_Object::RFC_Object_Obj16.Py = 0;
  @CAN_RadarFC::RFC_Object::RFC_Object_Obj16.PyAxCoVnce = 0;
  @CAN_RadarFC::RFC_Object::RFC_Object_Obj16.PyAyCoVnce = 0;
  @CAN_RadarFC::RFC_Object::RFC_Object_Obj16.PyVnce = 0;
  @CAN_RadarFC::RFC_Object::RFC_Object_Obj16.PyVxCoVnce = 0;
  @CAN_RadarFC::RFC_Object::RFC_Object_Obj16.PyVyCoVnce = 0;
  @CAN_RadarFC::RFC_Object::RFC_Object_Obj16.ReferencePoint = 0;
  @CAN_RadarFC::RFC_Object::RFC_Object_Obj16.Vx = 0;
  @CAN_RadarFC::RFC_Object::RFC_Object_Obj16.VxAxCoVnce = 0;
  @CAN_RadarFC::RFC_Object::RFC_Object_Obj16.VxAyCoVnce = 0;
  @CAN_RadarFC::RFC_Object::RFC_Object_Obj16.VxVnce = 0;
  }
  if(init_count == 13)
  {
  @CAN_RadarFC::RFC_Object::RFC_Object_Obj16.VxVyCoVnce = 0;
  @CAN_RadarFC::RFC_Object::RFC_Object_Obj16.Vy = 0;
  @CAN_RadarFC::RFC_Object::RFC_Object_Obj16.VyAxCoVnce = 0;
  @CAN_RadarFC::RFC_Object::RFC_Object_Obj16.VyAyCoVnce = 0;
  @CAN_RadarFC::RFC_Object::RFC_Object_Obj16.VyVnce = 0;
  @CAN_RadarFC::RFC_Object::RFC_Object_Obj16.Width = 0;
  @CAN_RadarFC::RFC_Object::RFC_Object_Obj16.WidthVnce = 0;
  @CAN_RadarFC::RFC_Object::RFC_Object_Obj17.Age = 0;
  @CAN_RadarFC::RFC_Object::RFC_Object_Obj17.Ax = 0;
  @CAN_RadarFC::RFC_Object::RFC_Object_Obj17.AxAyCoVnce = 0;
  @CAN_RadarFC::RFC_Object::RFC_Object_Obj17.AxVnce = 0;
  @CAN_RadarFC::RFC_Object::RFC_Object_Obj17.Ay = 0;
  @CAN_RadarFC::RFC_Object::RFC_Object_Obj17.AyVnce = 0;
  @CAN_RadarFC::RFC_Object::RFC_Object_Obj17.ExistProb = 0;
  @CAN_RadarFC::RFC_Object::RFC_Object_Obj17.FilterInformation = 0;
  @CAN_RadarFC::RFC_Object::RFC_Object_Obj17.Length = 0;
  @CAN_RadarFC::RFC_Object::RFC_Object_Obj17.LengthVnce = 0;
  @CAN_RadarFC::RFC_Object::RFC_Object_Obj17.MeasurementStatus = 0;
  @CAN_RadarFC::RFC_Object::RFC_Object_Obj17.MovingStatus = 0;
  @CAN_RadarFC::RFC_Object::RFC_Object_Obj17.ObjId = 0;
  @CAN_RadarFC::RFC_Object::RFC_Object_Obj17.OrientationYaw = 0;
  @CAN_RadarFC::RFC_Object::RFC_Object_Obj17.OrientationYawVnce = 0;
  @CAN_RadarFC::RFC_Object::RFC_Object_Obj17.ProbClassConfidence = 0;
  @CAN_RadarFC::RFC_Object::RFC_Object_Obj17.ProbClassType = 0;
  @CAN_RadarFC::RFC_Object::RFC_Object_Obj17.Px = 0;
  }
  if(init_count == 14)
  {
  @CAN_RadarFC::RFC_Object::RFC_Object_Obj17.PxAxCoVnce = 0;
  @CAN_RadarFC::RFC_Object::RFC_Object_Obj17.PxAyCoVnce = 0;
  @CAN_RadarFC::RFC_Object::RFC_Object_Obj17.PxPyCoVnce = 0;
  @CAN_RadarFC::RFC_Object::RFC_Object_Obj17.PxVnce = 0;
  @CAN_RadarFC::RFC_Object::RFC_Object_Obj17.PxVxCoVnce = 0;
  @CAN_RadarFC::RFC_Object::RFC_Object_Obj17.PxVyCoVnce = 0;
  @CAN_RadarFC::RFC_Object::RFC_Object_Obj17.Py = 0;
  @CAN_RadarFC::RFC_Object::RFC_Object_Obj17.PyAxCoVnce = 0;
  @CAN_RadarFC::RFC_Object::RFC_Object_Obj17.PyAyCoVnce = 0;
  @CAN_RadarFC::RFC_Object::RFC_Object_Obj17.PyVnce = 0;
  @CAN_RadarFC::RFC_Object::RFC_Object_Obj17.PyVxCoVnce = 0;
  @CAN_RadarFC::RFC_Object::RFC_Object_Obj17.PyVyCoVnce = 0;
  @CAN_RadarFC::RFC_Object::RFC_Object_Obj17.ReferencePoint = 0;
  @CAN_RadarFC::RFC_Object::RFC_Object_Obj17.Vx = 0;
  @CAN_RadarFC::RFC_Object::RFC_Object_Obj17.VxAxCoVnce = 0;
  @CAN_RadarFC::RFC_Object::RFC_Object_Obj17.VxAyCoVnce = 0;
  @CAN_RadarFC::RFC_Object::RFC_Object_Obj17.VxVnce = 0;
  @CAN_RadarFC::RFC_Object::RFC_Object_Obj17.VxVyCoVnce = 0;
  @CAN_RadarFC::RFC_Object::RFC_Object_Obj17.Vy = 0;
  @CAN_RadarFC::RFC_Object::RFC_Object_Obj17.VyAxCoVnce = 0;
  @CAN_RadarFC::RFC_Object::RFC_Object_Obj17.VyAyCoVnce = 0;
  @CAN_RadarFC::RFC_Object::RFC_Object_Obj17.VyVnce = 0;
  @CAN_RadarFC::RFC_Object::RFC_Object_Obj17.Width = 0;
  @CAN_RadarFC::RFC_Object::RFC_Object_Obj17.WidthVnce = 0;
  @CAN_RadarFC::RFC_Object::RFC_Object_Obj18.Age = 0;
  }
  if(init_count == 15)
  {
  @CAN_RadarFC::RFC_Object::RFC_Object_Obj18.Ax = 0;
  @CAN_RadarFC::RFC_Object::RFC_Object_Obj18.AxAyCoVnce = 0;
  @CAN_RadarFC::RFC_Object::RFC_Object_Obj18.AxVnce = 0;
  @CAN_RadarFC::RFC_Object::RFC_Object_Obj18.Ay = 0;
  @CAN_RadarFC::RFC_Object::RFC_Object_Obj18.AyVnce = 0;
  @CAN_RadarFC::RFC_Object::RFC_Object_Obj18.ExistProb = 0;
  @CAN_RadarFC::RFC_Object::RFC_Object_Obj18.FilterInformation = 0;
  @CAN_RadarFC::RFC_Object::RFC_Object_Obj18.Length = 0;
  @CAN_RadarFC::RFC_Object::RFC_Object_Obj18.LengthVnce = 0;
  @CAN_RadarFC::RFC_Object::RFC_Object_Obj18.MeasurementStatus = 0;
  @CAN_RadarFC::RFC_Object::RFC_Object_Obj18.MovingStatus = 0;
  @CAN_RadarFC::RFC_Object::RFC_Object_Obj18.ObjId = 0;
  @CAN_RadarFC::RFC_Object::RFC_Object_Obj18.OrientationYaw = 0;
  @CAN_RadarFC::RFC_Object::RFC_Object_Obj18.OrientationYawVnce = 0;
  @CAN_RadarFC::RFC_Object::RFC_Object_Obj18.ProbClassConfidence = 0;
  @CAN_RadarFC::RFC_Object::RFC_Object_Obj18.ProbClassType = 0;
  @CAN_RadarFC::RFC_Object::RFC_Object_Obj18.Px = 0;
  @CAN_RadarFC::RFC_Object::RFC_Object_Obj18.PxAxCoVnce = 0;
  @CAN_RadarFC::RFC_Object::RFC_Object_Obj18.PxAyCoVnce = 0;
  @CAN_RadarFC::RFC_Object::RFC_Object_Obj18.PxPyCoVnce = 0;
  @CAN_RadarFC::RFC_Object::RFC_Object_Obj18.PxVnce = 0;
  @CAN_RadarFC::RFC_Object::RFC_Object_Obj18.PxVxCoVnce = 0;
  @CAN_RadarFC::RFC_Object::RFC_Object_Obj18.PxVyCoVnce = 0;
  @CAN_RadarFC::RFC_Object::RFC_Object_Obj18.Py = 0;
  @CAN_RadarFC::RFC_Object::RFC_Object_Obj18.PyAxCoVnce = 0;
  }
  if(init_count == 16)
  {
  @CAN_RadarFC::RFC_Object::RFC_Object_Obj18.PyAyCoVnce = 0;
  @CAN_RadarFC::RFC_Object::RFC_Object_Obj18.PyVnce = 0;
  @CAN_RadarFC::RFC_Object::RFC_Object_Obj18.PyVxCoVnce = 0;
  @CAN_RadarFC::RFC_Object::RFC_Object_Obj18.PyVyCoVnce = 0;
  @CAN_RadarFC::RFC_Object::RFC_Object_Obj18.ReferencePoint = 0;
  @CAN_RadarFC::RFC_Object::RFC_Object_Obj18.Vx = 0;
  @CAN_RadarFC::RFC_Object::RFC_Object_Obj18.VxAxCoVnce = 0;
  @CAN_RadarFC::RFC_Object::RFC_Object_Obj18.VxAyCoVnce = 0;
  @CAN_RadarFC::RFC_Object::RFC_Object_Obj18.VxVnce = 0;
  @CAN_RadarFC::RFC_Object::RFC_Object_Obj18.VxVyCoVnce = 0;
  @CAN_RadarFC::RFC_Object::RFC_Object_Obj18.Vy = 0;
  @CAN_RadarFC::RFC_Object::RFC_Object_Obj18.VyAxCoVnce = 0;
  @CAN_RadarFC::RFC_Object::RFC_Object_Obj18.VyAyCoVnce = 0;
  @CAN_RadarFC::RFC_Object::RFC_Object_Obj18.VyVnce = 0;
  @CAN_RadarFC::RFC_Object::RFC_Object_Obj18.Width = 0;
  @CAN_RadarFC::RFC_Object::RFC_Object_Obj18.WidthVnce = 0;
  @CAN_RadarFC::RFC_Object::RFC_Object_Obj19.Age = 0;
  @CAN_RadarFC::RFC_Object::RFC_Object_Obj19.Ax = 0;
  @CAN_RadarFC::RFC_Object::RFC_Object_Obj19.AxAyCoVnce = 0;
  @CAN_RadarFC::RFC_Object::RFC_Object_Obj19.AxVnce = 0;
  @CAN_RadarFC::RFC_Object::RFC_Object_Obj19.Ay = 0;
  @CAN_RadarFC::RFC_Object::RFC_Object_Obj19.AyVnce = 0;
  @CAN_RadarFC::RFC_Object::RFC_Object_Obj19.ExistProb = 0;
  @CAN_RadarFC::RFC_Object::RFC_Object_Obj19.FilterInformation = 0;
  @CAN_RadarFC::RFC_Object::RFC_Object_Obj19.Length = 0;
  }
  if(init_count == 17)
  {
  @CAN_RadarFC::RFC_Object::RFC_Object_Obj19.LengthVnce = 0;
  @CAN_RadarFC::RFC_Object::RFC_Object_Obj19.MeasurementStatus = 0;
  @CAN_RadarFC::RFC_Object::RFC_Object_Obj19.MovingStatus = 0;
  @CAN_RadarFC::RFC_Object::RFC_Object_Obj19.ObjId = 0;
  @CAN_RadarFC::RFC_Object::RFC_Object_Obj19.OrientationYaw = 0;
  @CAN_RadarFC::RFC_Object::RFC_Object_Obj19.OrientationYawVnce = 0;
  @CAN_RadarFC::RFC_Object::RFC_Object_Obj19.ProbClassConfidence = 0;
  @CAN_RadarFC::RFC_Object::RFC_Object_Obj19.ProbClassType = 0;
  @CAN_RadarFC::RFC_Object::RFC_Object_Obj19.Px = 0;
  @CAN_RadarFC::RFC_Object::RFC_Object_Obj19.PxAxCoVnce = 0;
  @CAN_RadarFC::RFC_Object::RFC_Object_Obj19.PxAyCoVnce = 0;
  @CAN_RadarFC::RFC_Object::RFC_Object_Obj19.PxPyCoVnce = 0;
  @CAN_RadarFC::RFC_Object::RFC_Object_Obj19.PxVnce = 0;
  @CAN_RadarFC::RFC_Object::RFC_Object_Obj19.PxVxCoVnce = 0;
  @CAN_RadarFC::RFC_Object::RFC_Object_Obj19.PxVyCoVnce = 0;
  @CAN_RadarFC::RFC_Object::RFC_Object_Obj19.Py = 0;
  @CAN_RadarFC::RFC_Object::RFC_Object_Obj19.PyAxCoVnce = 0;
  @CAN_RadarFC::RFC_Object::RFC_Object_Obj19.PyAyCoVnce = 0;
  @CAN_RadarFC::RFC_Object::RFC_Object_Obj19.PyVnce = 0;
  @CAN_RadarFC::RFC_Object::RFC_Object_Obj19.PyVxCoVnce = 0;
  @CAN_RadarFC::RFC_Object::RFC_Object_Obj19.PyVyCoVnce = 0;
  @CAN_RadarFC::RFC_Object::RFC_Object_Obj19.ReferencePoint = 0;
  @CAN_RadarFC::RFC_Object::RFC_Object_Obj19.Vx = 0;
  @CAN_RadarFC::RFC_Object::RFC_Object_Obj19.VxAxCoVnce = 0;
  @CAN_RadarFC::RFC_Object::RFC_Object_Obj19.VxAyCoVnce = 0;
  }
  if(init_count == 18)
  {
  @CAN_RadarFC::RFC_Object::RFC_Object_Obj19.VxVnce = 0;
  @CAN_RadarFC::RFC_Object::RFC_Object_Obj19.VxVyCoVnce = 0;
  @CAN_RadarFC::RFC_Object::RFC_Object_Obj19.Vy = 0;
  @CAN_RadarFC::RFC_Object::RFC_Object_Obj19.VyAxCoVnce = 0;
  @CAN_RadarFC::RFC_Object::RFC_Object_Obj19.VyAyCoVnce = 0;
  @CAN_RadarFC::RFC_Object::RFC_Object_Obj19.VyVnce = 0;
  @CAN_RadarFC::RFC_Object::RFC_Object_Obj19.Width = 0;
  @CAN_RadarFC::RFC_Object::RFC_Object_Obj19.WidthVnce = 0;
  @CAN_RadarFC::RFC_Object::RFC_Object_Obj1.Age = 0;
  @CAN_RadarFC::RFC_Object::RFC_Object_Obj1.Ax = 0;
  @CAN_RadarFC::RFC_Object::RFC_Object_Obj1.AxAyCoVnce = 0;
  @CAN_RadarFC::RFC_Object::RFC_Object_Obj1.AxVnce = 0;
  @CAN_RadarFC::RFC_Object::RFC_Object_Obj1.Ay = 0;
  @CAN_RadarFC::RFC_Object::RFC_Object_Obj1.AyVnce = 0;
  @CAN_RadarFC::RFC_Object::RFC_Object_Obj1.ExistProb = 0;
  @CAN_RadarFC::RFC_Object::RFC_Object_Obj1.FilterInformation = 0;
  @CAN_RadarFC::RFC_Object::RFC_Object_Obj1.Length = 0;
  @CAN_RadarFC::RFC_Object::RFC_Object_Obj1.LengthVnce = 0;
  @CAN_RadarFC::RFC_Object::RFC_Object_Obj1.MeasurementStatus = 0;
  @CAN_RadarFC::RFC_Object::RFC_Object_Obj1.MovingStatus = 0;
  @CAN_RadarFC::RFC_Object::RFC_Object_Obj1.ObjId = 0;
  @CAN_RadarFC::RFC_Object::RFC_Object_Obj1.OrientationYaw = 0;
  @CAN_RadarFC::RFC_Object::RFC_Object_Obj1.OrientationYawVnce = 0;
  @CAN_RadarFC::RFC_Object::RFC_Object_Obj1.ProbClassConfidence = 0;
  @CAN_RadarFC::RFC_Object::RFC_Object_Obj1.ProbClassType = 0;
  }
  if(init_count == 19)
  {
  @CAN_RadarFC::RFC_Object::RFC_Object_Obj1.Px = 0;
  @CAN_RadarFC::RFC_Object::RFC_Object_Obj1.PxAxCoVnce = 0;
  @CAN_RadarFC::RFC_Object::RFC_Object_Obj1.PxAyCoVnce = 0;
  @CAN_RadarFC::RFC_Object::RFC_Object_Obj1.PxPyCoVnce = 0;
  @CAN_RadarFC::RFC_Object::RFC_Object_Obj1.PxVnce = 0;
  @CAN_RadarFC::RFC_Object::RFC_Object_Obj1.PxVxCoVnce = 0;
  @CAN_RadarFC::RFC_Object::RFC_Object_Obj1.PxVyCoVnce = 0;
  @CAN_RadarFC::RFC_Object::RFC_Object_Obj1.Py = 0;
  @CAN_RadarFC::RFC_Object::RFC_Object_Obj1.PyAxCoVnce = 0;
  @CAN_RadarFC::RFC_Object::RFC_Object_Obj1.PyAyCoVnce = 0;
  @CAN_RadarFC::RFC_Object::RFC_Object_Obj1.PyVnce = 0;
  @CAN_RadarFC::RFC_Object::RFC_Object_Obj1.PyVxCoVnce = 0;
  @CAN_RadarFC::RFC_Object::RFC_Object_Obj1.PyVyCoVnce = 0;
  @CAN_RadarFC::RFC_Object::RFC_Object_Obj1.ReferencePoint = 0;
  @CAN_RadarFC::RFC_Object::RFC_Object_Obj1.Vx = 0;
  @CAN_RadarFC::RFC_Object::RFC_Object_Obj1.VxAxCoVnce = 0;
  @CAN_RadarFC::RFC_Object::RFC_Object_Obj1.VxAyCoVnce = 0;
  @CAN_RadarFC::RFC_Object::RFC_Object_Obj1.VxVnce = 0;
  @CAN_RadarFC::RFC_Object::RFC_Object_Obj1.VxVyCoVnce = 0;
  @CAN_RadarFC::RFC_Object::RFC_Object_Obj1.Vy = 0;
  @CAN_RadarFC::RFC_Object::RFC_Object_Obj1.VyAxCoVnce = 0;
  @CAN_RadarFC::RFC_Object::RFC_Object_Obj1.VyAyCoVnce = 0;
  @CAN_RadarFC::RFC_Object::RFC_Object_Obj1.VyVnce = 0;
  @CAN_RadarFC::RFC_Object::RFC_Object_Obj1.Width = 0;
  @CAN_RadarFC::RFC_Object::RFC_Object_Obj1.WidthVnce = 0;
  }
  if(init_count == 20)
  {
  @CAN_RadarFC::RFC_Object::RFC_Object_Obj20.Age = 0;
  @CAN_RadarFC::RFC_Object::RFC_Object_Obj20.Ax = 0;
  @CAN_RadarFC::RFC_Object::RFC_Object_Obj20.AxAyCoVnce = 0;
  @CAN_RadarFC::RFC_Object::RFC_Object_Obj20.AxVnce = 0;
  @CAN_RadarFC::RFC_Object::RFC_Object_Obj20.Ay = 0;
  @CAN_RadarFC::RFC_Object::RFC_Object_Obj20.AyVnce = 0;
  @CAN_RadarFC::RFC_Object::RFC_Object_Obj20.ExistProb = 0;
  @CAN_RadarFC::RFC_Object::RFC_Object_Obj20.FilterInformation = 0;
  @CAN_RadarFC::RFC_Object::RFC_Object_Obj20.Length = 0;
  @CAN_RadarFC::RFC_Object::RFC_Object_Obj20.LengthVnce = 0;
  @CAN_RadarFC::RFC_Object::RFC_Object_Obj20.MeasurementStatus = 0;
  @CAN_RadarFC::RFC_Object::RFC_Object_Obj20.MovingStatus = 0;
  @CAN_RadarFC::RFC_Object::RFC_Object_Obj20.ObjId = 0;
  @CAN_RadarFC::RFC_Object::RFC_Object_Obj20.OrientationYaw = 0;
  @CAN_RadarFC::RFC_Object::RFC_Object_Obj20.OrientationYawVnce = 0;
  @CAN_RadarFC::RFC_Object::RFC_Object_Obj20.ProbClassConfidence = 0;
  @CAN_RadarFC::RFC_Object::RFC_Object_Obj20.ProbClassType = 0;
  @CAN_RadarFC::RFC_Object::RFC_Object_Obj20.Px = 0;
  @CAN_RadarFC::RFC_Object::RFC_Object_Obj20.PxAxCoVnce = 0;
  @CAN_RadarFC::RFC_Object::RFC_Object_Obj20.PxAyCoVnce = 0;
  @CAN_RadarFC::RFC_Object::RFC_Object_Obj20.PxPyCoVnce = 0;
  @CAN_RadarFC::RFC_Object::RFC_Object_Obj20.PxVnce = 0;
  @CAN_RadarFC::RFC_Object::RFC_Object_Obj20.PxVxCoVnce = 0;
  @CAN_RadarFC::RFC_Object::RFC_Object_Obj20.PxVyCoVnce = 0;
  @CAN_RadarFC::RFC_Object::RFC_Object_Obj20.Py = 0;
  }
  if(init_count == 21)
  {
  @CAN_RadarFC::RFC_Object::RFC_Object_Obj20.PyAxCoVnce = 0;
  @CAN_RadarFC::RFC_Object::RFC_Object_Obj20.PyAyCoVnce = 0;
  @CAN_RadarFC::RFC_Object::RFC_Object_Obj20.PyVnce = 0;
  @CAN_RadarFC::RFC_Object::RFC_Object_Obj20.PyVxCoVnce = 0;
  @CAN_RadarFC::RFC_Object::RFC_Object_Obj20.PyVyCoVnce = 0;
  @CAN_RadarFC::RFC_Object::RFC_Object_Obj20.ReferencePoint = 0;
  @CAN_RadarFC::RFC_Object::RFC_Object_Obj20.Vx = 0;
  @CAN_RadarFC::RFC_Object::RFC_Object_Obj20.VxAxCoVnce = 0;
  @CAN_RadarFC::RFC_Object::RFC_Object_Obj20.VxAyCoVnce = 0;
  @CAN_RadarFC::RFC_Object::RFC_Object_Obj20.VxVnce = 0;
  @CAN_RadarFC::RFC_Object::RFC_Object_Obj20.VxVyCoVnce = 0;
  @CAN_RadarFC::RFC_Object::RFC_Object_Obj20.Vy = 0;
  @CAN_RadarFC::RFC_Object::RFC_Object_Obj20.VyAxCoVnce = 0;
  @CAN_RadarFC::RFC_Object::RFC_Object_Obj20.VyAyCoVnce = 0;
  @CAN_RadarFC::RFC_Object::RFC_Object_Obj20.VyVnce = 0;
  @CAN_RadarFC::RFC_Object::RFC_Object_Obj20.Width = 0;
  @CAN_RadarFC::RFC_Object::RFC_Object_Obj20.WidthVnce = 0;
  @CAN_RadarFC::RFC_Object::RFC_Object_Obj21.Age = 0;
  @CAN_RadarFC::RFC_Object::RFC_Object_Obj21.Ax = 0;
  @CAN_RadarFC::RFC_Object::RFC_Object_Obj21.AxAyCoVnce = 0;
  @CAN_RadarFC::RFC_Object::RFC_Object_Obj21.AxVnce = 0;
  @CAN_RadarFC::RFC_Object::RFC_Object_Obj21.Ay = 0;
  @CAN_RadarFC::RFC_Object::RFC_Object_Obj21.AyVnce = 0;
  @CAN_RadarFC::RFC_Object::RFC_Object_Obj21.ExistProb = 0;
  @CAN_RadarFC::RFC_Object::RFC_Object_Obj21.FilterInformation = 0;
  }
  if(init_count == 22)
  {
  @CAN_RadarFC::RFC_Object::RFC_Object_Obj21.Length = 0;
  @CAN_RadarFC::RFC_Object::RFC_Object_Obj21.LengthVnce = 0;
  @CAN_RadarFC::RFC_Object::RFC_Object_Obj21.MeasurementStatus = 0;
  @CAN_RadarFC::RFC_Object::RFC_Object_Obj21.MovingStatus = 0;
  @CAN_RadarFC::RFC_Object::RFC_Object_Obj21.ObjId = 0;
  @CAN_RadarFC::RFC_Object::RFC_Object_Obj21.OrientationYaw = 0;
  @CAN_RadarFC::RFC_Object::RFC_Object_Obj21.OrientationYawVnce = 0;
  @CAN_RadarFC::RFC_Object::RFC_Object_Obj21.ProbClassConfidence = 0;
  @CAN_RadarFC::RFC_Object::RFC_Object_Obj21.ProbClassType = 0;
  @CAN_RadarFC::RFC_Object::RFC_Object_Obj21.Px = 0;
  @CAN_RadarFC::RFC_Object::RFC_Object_Obj21.PxAxCoVnce = 0;
  @CAN_RadarFC::RFC_Object::RFC_Object_Obj21.PxAyCoVnce = 0;
  @CAN_RadarFC::RFC_Object::RFC_Object_Obj21.PxPyCoVnce = 0;
  @CAN_RadarFC::RFC_Object::RFC_Object_Obj21.PxVnce = 0;
  @CAN_RadarFC::RFC_Object::RFC_Object_Obj21.PxVxCoVnce = 0;
  @CAN_RadarFC::RFC_Object::RFC_Object_Obj21.PxVyCoVnce = 0;
  @CAN_RadarFC::RFC_Object::RFC_Object_Obj21.Py = 0;
  @CAN_RadarFC::RFC_Object::RFC_Object_Obj21.PyAxCoVnce = 0;
  @CAN_RadarFC::RFC_Object::RFC_Object_Obj21.PyAyCoVnce = 0;
  @CAN_RadarFC::RFC_Object::RFC_Object_Obj21.PyVnce = 0;
  @CAN_RadarFC::RFC_Object::RFC_Object_Obj21.PyVxCoVnce = 0;
  @CAN_RadarFC::RFC_Object::RFC_Object_Obj21.PyVyCoVnce = 0;
  @CAN_RadarFC::RFC_Object::RFC_Object_Obj21.ReferencePoint = 0;
  @CAN_RadarFC::RFC_Object::RFC_Object_Obj21.Vx = 0;
  @CAN_RadarFC::RFC_Object::RFC_Object_Obj21.VxAxCoVnce = 0;
  }
  if(init_count == 23)
  {
  @CAN_RadarFC::RFC_Object::RFC_Object_Obj21.VxAyCoVnce = 0;
  @CAN_RadarFC::RFC_Object::RFC_Object_Obj21.VxVnce = 0;
  @CAN_RadarFC::RFC_Object::RFC_Object_Obj21.VxVyCoVnce = 0;
  @CAN_RadarFC::RFC_Object::RFC_Object_Obj21.Vy = 0;
  @CAN_RadarFC::RFC_Object::RFC_Object_Obj21.VyAxCoVnce = 0;
  @CAN_RadarFC::RFC_Object::RFC_Object_Obj21.VyAyCoVnce = 0;
  @CAN_RadarFC::RFC_Object::RFC_Object_Obj21.VyVnce = 0;
  @CAN_RadarFC::RFC_Object::RFC_Object_Obj21.Width = 0;
  @CAN_RadarFC::RFC_Object::RFC_Object_Obj21.WidthVnce = 0;
  @CAN_RadarFC::RFC_Object::RFC_Object_Obj22.Age = 0;
  @CAN_RadarFC::RFC_Object::RFC_Object_Obj22.Ax = 0;
  @CAN_RadarFC::RFC_Object::RFC_Object_Obj22.AxAyCoVnce = 0;
  @CAN_RadarFC::RFC_Object::RFC_Object_Obj22.AxVnce = 0;
  @CAN_RadarFC::RFC_Object::RFC_Object_Obj22.Ay = 0;
  @CAN_RadarFC::RFC_Object::RFC_Object_Obj22.AyVnce = 0;
  @CAN_RadarFC::RFC_Object::RFC_Object_Obj22.ExistProb = 0;
  @CAN_RadarFC::RFC_Object::RFC_Object_Obj22.FilterInformation = 0;
  @CAN_RadarFC::RFC_Object::RFC_Object_Obj22.Length = 0;
  @CAN_RadarFC::RFC_Object::RFC_Object_Obj22.LengthVnce = 0;
  @CAN_RadarFC::RFC_Object::RFC_Object_Obj22.MeasurementStatus = 0;
  @CAN_RadarFC::RFC_Object::RFC_Object_Obj22.MovingStatus = 0;
  @CAN_RadarFC::RFC_Object::RFC_Object_Obj22.ObjId = 0;
  @CAN_RadarFC::RFC_Object::RFC_Object_Obj22.OrientationYaw = 0;
  @CAN_RadarFC::RFC_Object::RFC_Object_Obj22.OrientationYawVnce = 0;
  @CAN_RadarFC::RFC_Object::RFC_Object_Obj22.ProbClassConfidence = 0;
  }
  if(init_count == 24)
  {
  @CAN_RadarFC::RFC_Object::RFC_Object_Obj22.ProbClassType = 0;
  @CAN_RadarFC::RFC_Object::RFC_Object_Obj22.Px = 0;
  @CAN_RadarFC::RFC_Object::RFC_Object_Obj22.PxAxCoVnce = 0;
  @CAN_RadarFC::RFC_Object::RFC_Object_Obj22.PxAyCoVnce = 0;
  @CAN_RadarFC::RFC_Object::RFC_Object_Obj22.PxPyCoVnce = 0;
  @CAN_RadarFC::RFC_Object::RFC_Object_Obj22.PxVnce = 0;
  @CAN_RadarFC::RFC_Object::RFC_Object_Obj22.PxVxCoVnce = 0;
  @CAN_RadarFC::RFC_Object::RFC_Object_Obj22.PxVyCoVnce = 0;
  @CAN_RadarFC::RFC_Object::RFC_Object_Obj22.Py = 0;
  @CAN_RadarFC::RFC_Object::RFC_Object_Obj22.PyAxCoVnce = 0;
  @CAN_RadarFC::RFC_Object::RFC_Object_Obj22.PyAyCoVnce = 0;
  @CAN_RadarFC::RFC_Object::RFC_Object_Obj22.PyVnce = 0;
  @CAN_RadarFC::RFC_Object::RFC_Object_Obj22.PyVxCoVnce = 0;
  @CAN_RadarFC::RFC_Object::RFC_Object_Obj22.PyVyCoVnce = 0;
  @CAN_RadarFC::RFC_Object::RFC_Object_Obj22.ReferencePoint = 0;
  @CAN_RadarFC::RFC_Object::RFC_Object_Obj22.Vx = 0;
  @CAN_RadarFC::RFC_Object::RFC_Object_Obj22.VxAxCoVnce = 0;
  @CAN_RadarFC::RFC_Object::RFC_Object_Obj22.VxAyCoVnce = 0;
  @CAN_RadarFC::RFC_Object::RFC_Object_Obj22.VxVnce = 0;
  @CAN_RadarFC::RFC_Object::RFC_Object_Obj22.VxVyCoVnce = 0;
  @CAN_RadarFC::RFC_Object::RFC_Object_Obj22.Vy = 0;
  @CAN_RadarFC::RFC_Object::RFC_Object_Obj22.VyAxCoVnce = 0;
  @CAN_RadarFC::RFC_Object::RFC_Object_Obj22.VyAyCoVnce = 0;
  @CAN_RadarFC::RFC_Object::RFC_Object_Obj22.VyVnce = 0;
  @CAN_RadarFC::RFC_Object::RFC_Object_Obj22.Width = 0;
  }
  if(init_count == 25)
  {
  @CAN_RadarFC::RFC_Object::RFC_Object_Obj22.WidthVnce = 0;
  @CAN_RadarFC::RFC_Object::RFC_Object_Obj23.Age = 0;
  @CAN_RadarFC::RFC_Object::RFC_Object_Obj23.Ax = 0;
  @CAN_RadarFC::RFC_Object::RFC_Object_Obj23.AxAyCoVnce = 0;
  @CAN_RadarFC::RFC_Object::RFC_Object_Obj23.AxVnce = 0;
  @CAN_RadarFC::RFC_Object::RFC_Object_Obj23.Ay = 0;
  @CAN_RadarFC::RFC_Object::RFC_Object_Obj23.AyVnce = 0;
  @CAN_RadarFC::RFC_Object::RFC_Object_Obj23.ExistProb = 0;
  @CAN_RadarFC::RFC_Object::RFC_Object_Obj23.FilterInformation = 0;
  @CAN_RadarFC::RFC_Object::RFC_Object_Obj23.Length = 0;
  @CAN_RadarFC::RFC_Object::RFC_Object_Obj23.LengthVnce = 0;
  @CAN_RadarFC::RFC_Object::RFC_Object_Obj23.MeasurementStatus = 0;
  @CAN_RadarFC::RFC_Object::RFC_Object_Obj23.MovingStatus = 0;
  @CAN_RadarFC::RFC_Object::RFC_Object_Obj23.ObjId = 0;
  @CAN_RadarFC::RFC_Object::RFC_Object_Obj23.OrientationYaw = 0;
  @CAN_RadarFC::RFC_Object::RFC_Object_Obj23.OrientationYawVnce = 0;
  @CAN_RadarFC::RFC_Object::RFC_Object_Obj23.ProbClassConfidence = 0;
  @CAN_RadarFC::RFC_Object::RFC_Object_Obj23.ProbClassType = 0;
  @CAN_RadarFC::RFC_Object::RFC_Object_Obj23.Px = 0;
  @CAN_RadarFC::RFC_Object::RFC_Object_Obj23.PxAxCoVnce = 0;
  @CAN_RadarFC::RFC_Object::RFC_Object_Obj23.PxAyCoVnce = 0;
  @CAN_RadarFC::RFC_Object::RFC_Object_Obj23.PxPyCoVnce = 0;
  @CAN_RadarFC::RFC_Object::RFC_Object_Obj23.PxVnce = 0;
  @CAN_RadarFC::RFC_Object::RFC_Object_Obj23.PxVxCoVnce = 0;
  @CAN_RadarFC::RFC_Object::RFC_Object_Obj23.PxVyCoVnce = 0;
  }
  if(init_count == 26)
  {
  @CAN_RadarFC::RFC_Object::RFC_Object_Obj23.Py = 0;
  @CAN_RadarFC::RFC_Object::RFC_Object_Obj23.PyAxCoVnce = 0;
  @CAN_RadarFC::RFC_Object::RFC_Object_Obj23.PyAyCoVnce = 0;
  @CAN_RadarFC::RFC_Object::RFC_Object_Obj23.PyVnce = 0;
  @CAN_RadarFC::RFC_Object::RFC_Object_Obj23.PyVxCoVnce = 0;
  @CAN_RadarFC::RFC_Object::RFC_Object_Obj23.PyVyCoVnce = 0;
  @CAN_RadarFC::RFC_Object::RFC_Object_Obj23.ReferencePoint = 0;
  @CAN_RadarFC::RFC_Object::RFC_Object_Obj23.Vx = 0;
  @CAN_RadarFC::RFC_Object::RFC_Object_Obj23.VxAxCoVnce = 0;
  @CAN_RadarFC::RFC_Object::RFC_Object_Obj23.VxAyCoVnce = 0;
  @CAN_RadarFC::RFC_Object::RFC_Object_Obj23.VxVnce = 0;
  @CAN_RadarFC::RFC_Object::RFC_Object_Obj23.VxVyCoVnce = 0;
  @CAN_RadarFC::RFC_Object::RFC_Object_Obj23.Vy = 0;
  @CAN_RadarFC::RFC_Object::RFC_Object_Obj23.VyAxCoVnce = 0;
  @CAN_RadarFC::RFC_Object::RFC_Object_Obj23.VyAyCoVnce = 0;
  @CAN_RadarFC::RFC_Object::RFC_Object_Obj23.VyVnce = 0;
  @CAN_RadarFC::RFC_Object::RFC_Object_Obj23.Width = 0;
  @CAN_RadarFC::RFC_Object::RFC_Object_Obj23.WidthVnce = 0;
  @CAN_RadarFC::RFC_Object::RFC_Object_Obj24.Age = 0;
  @CAN_RadarFC::RFC_Object::RFC_Object_Obj24.Ax = 0;
  @CAN_RadarFC::RFC_Object::RFC_Object_Obj24.AxAyCoVnce = 0;
  @CAN_RadarFC::RFC_Object::RFC_Object_Obj24.AxVnce = 0;
  @CAN_RadarFC::RFC_Object::RFC_Object_Obj24.Ay = 0;
  @CAN_RadarFC::RFC_Object::RFC_Object_Obj24.AyVnce = 0;
  @CAN_RadarFC::RFC_Object::RFC_Object_Obj24.ExistProb = 0;
  }
  if(init_count == 27)
  {
  @CAN_RadarFC::RFC_Object::RFC_Object_Obj24.FilterInformation = 0;
  @CAN_RadarFC::RFC_Object::RFC_Object_Obj24.Length = 0;
  @CAN_RadarFC::RFC_Object::RFC_Object_Obj24.LengthVnce = 0;
  @CAN_RadarFC::RFC_Object::RFC_Object_Obj24.MeasurementStatus = 0;
  @CAN_RadarFC::RFC_Object::RFC_Object_Obj24.MovingStatus = 0;
  @CAN_RadarFC::RFC_Object::RFC_Object_Obj24.ObjId = 0;
  @CAN_RadarFC::RFC_Object::RFC_Object_Obj24.OrientationYaw = 0;
  @CAN_RadarFC::RFC_Object::RFC_Object_Obj24.OrientationYawVnce = 0;
  @CAN_RadarFC::RFC_Object::RFC_Object_Obj24.ProbClassConfidence = 0;
  @CAN_RadarFC::RFC_Object::RFC_Object_Obj24.ProbClassType = 0;
  @CAN_RadarFC::RFC_Object::RFC_Object_Obj24.Px = 0;
  @CAN_RadarFC::RFC_Object::RFC_Object_Obj24.PxAxCoVnce = 0;
  @CAN_RadarFC::RFC_Object::RFC_Object_Obj24.PxAyCoVnce = 0;
  @CAN_RadarFC::RFC_Object::RFC_Object_Obj24.PxPyCoVnce = 0;
  @CAN_RadarFC::RFC_Object::RFC_Object_Obj24.PxVnce = 0;
  @CAN_RadarFC::RFC_Object::RFC_Object_Obj24.PxVxCoVnce = 0;
  @CAN_RadarFC::RFC_Object::RFC_Object_Obj24.PxVyCoVnce = 0;
  @CAN_RadarFC::RFC_Object::RFC_Object_Obj24.Py = 0;
  @CAN_RadarFC::RFC_Object::RFC_Object_Obj24.PyAxCoVnce = 0;
  @CAN_RadarFC::RFC_Object::RFC_Object_Obj24.PyAyCoVnce = 0;
  @CAN_RadarFC::RFC_Object::RFC_Object_Obj24.PyVnce = 0;
  @CAN_RadarFC::RFC_Object::RFC_Object_Obj24.PyVxCoVnce = 0;
  @CAN_RadarFC::RFC_Object::RFC_Object_Obj24.PyVyCoVnce = 0;
  @CAN_RadarFC::RFC_Object::RFC_Object_Obj24.ReferencePoint = 0;
  @CAN_RadarFC::RFC_Object::RFC_Object_Obj24.Vx = 0;
  }
  if(init_count == 28)
  {
  @CAN_RadarFC::RFC_Object::RFC_Object_Obj24.VxAxCoVnce = 0;
  @CAN_RadarFC::RFC_Object::RFC_Object_Obj24.VxAyCoVnce = 0;
  @CAN_RadarFC::RFC_Object::RFC_Object_Obj24.VxVnce = 0;
  @CAN_RadarFC::RFC_Object::RFC_Object_Obj24.VxVyCoVnce = 0;
  @CAN_RadarFC::RFC_Object::RFC_Object_Obj24.Vy = 0;
  @CAN_RadarFC::RFC_Object::RFC_Object_Obj24.VyAxCoVnce = 0;
  @CAN_RadarFC::RFC_Object::RFC_Object_Obj24.VyAyCoVnce = 0;
  @CAN_RadarFC::RFC_Object::RFC_Object_Obj24.VyVnce = 0;
  @CAN_RadarFC::RFC_Object::RFC_Object_Obj24.Width = 0;
  @CAN_RadarFC::RFC_Object::RFC_Object_Obj24.WidthVnce = 0;
  @CAN_RadarFC::RFC_Object::RFC_Object_Obj25.Age = 0;
  @CAN_RadarFC::RFC_Object::RFC_Object_Obj25.Ax = 0;
  @CAN_RadarFC::RFC_Object::RFC_Object_Obj25.AxAyCoVnce = 0;
  @CAN_RadarFC::RFC_Object::RFC_Object_Obj25.AxVnce = 0;
  @CAN_RadarFC::RFC_Object::RFC_Object_Obj25.Ay = 0;
  @CAN_RadarFC::RFC_Object::RFC_Object_Obj25.AyVnce = 0;
  @CAN_RadarFC::RFC_Object::RFC_Object_Obj25.ExistProb = 0;
  @CAN_RadarFC::RFC_Object::RFC_Object_Obj25.FilterInformation = 0;
  @CAN_RadarFC::RFC_Object::RFC_Object_Obj25.Length = 0;
  @CAN_RadarFC::RFC_Object::RFC_Object_Obj25.LengthVnce = 0;
  @CAN_RadarFC::RFC_Object::RFC_Object_Obj25.MeasurementStatus = 0;
  @CAN_RadarFC::RFC_Object::RFC_Object_Obj25.MovingStatus = 0;
  @CAN_RadarFC::RFC_Object::RFC_Object_Obj25.ObjId = 0;
  @CAN_RadarFC::RFC_Object::RFC_Object_Obj25.OrientationYaw = 0;
  @CAN_RadarFC::RFC_Object::RFC_Object_Obj25.OrientationYawVnce = 0;
  }
  if(init_count == 29)
  {
  @CAN_RadarFC::RFC_Object::RFC_Object_Obj25.ProbClassConfidence = 0;
  @CAN_RadarFC::RFC_Object::RFC_Object_Obj25.ProbClassType = 0;
  @CAN_RadarFC::RFC_Object::RFC_Object_Obj25.Px = 0;
  @CAN_RadarFC::RFC_Object::RFC_Object_Obj25.PxAxCoVnce = 0;
  @CAN_RadarFC::RFC_Object::RFC_Object_Obj25.PxAyCoVnce = 0;
  @CAN_RadarFC::RFC_Object::RFC_Object_Obj25.PxPyCoVnce = 0;
  @CAN_RadarFC::RFC_Object::RFC_Object_Obj25.PxVnce = 0;
  @CAN_RadarFC::RFC_Object::RFC_Object_Obj25.PxVxCoVnce = 0;
  @CAN_RadarFC::RFC_Object::RFC_Object_Obj25.PxVyCoVnce = 0;
  @CAN_RadarFC::RFC_Object::RFC_Object_Obj25.Py = 0;
  @CAN_RadarFC::RFC_Object::RFC_Object_Obj25.PyAxCoVnce = 0;
  @CAN_RadarFC::RFC_Object::RFC_Object_Obj25.PyAyCoVnce = 0;
  @CAN_RadarFC::RFC_Object::RFC_Object_Obj25.PyVnce = 0;
  @CAN_RadarFC::RFC_Object::RFC_Object_Obj25.PyVxCoVnce = 0;
  @CAN_RadarFC::RFC_Object::RFC_Object_Obj25.PyVyCoVnce = 0;
  @CAN_RadarFC::RFC_Object::RFC_Object_Obj25.ReferencePoint = 0;
  @CAN_RadarFC::RFC_Object::RFC_Object_Obj25.Vx = 0;
  @CAN_RadarFC::RFC_Object::RFC_Object_Obj25.VxAxCoVnce = 0;
  @CAN_RadarFC::RFC_Object::RFC_Object_Obj25.VxAyCoVnce = 0;
  @CAN_RadarFC::RFC_Object::RFC_Object_Obj25.VxVnce = 0;
  @CAN_RadarFC::RFC_Object::RFC_Object_Obj25.VxVyCoVnce = 0;
  @CAN_RadarFC::RFC_Object::RFC_Object_Obj25.Vy = 0;
  @CAN_RadarFC::RFC_Object::RFC_Object_Obj25.VyAxCoVnce = 0;
  @CAN_RadarFC::RFC_Object::RFC_Object_Obj25.VyAyCoVnce = 0;
  @CAN_RadarFC::RFC_Object::RFC_Object_Obj25.VyVnce = 0;
  }
  if(init_count == 30)
  {
  @CAN_RadarFC::RFC_Object::RFC_Object_Obj25.Width = 0;
  @CAN_RadarFC::RFC_Object::RFC_Object_Obj25.WidthVnce = 0;
  @CAN_RadarFC::RFC_Object::RFC_Object_Obj26.Age = 0;
  @CAN_RadarFC::RFC_Object::RFC_Object_Obj26.Ax = 0;
  @CAN_RadarFC::RFC_Object::RFC_Object_Obj26.AxAyCoVnce = 0;
  @CAN_RadarFC::RFC_Object::RFC_Object_Obj26.AxVnce = 0;
  @CAN_RadarFC::RFC_Object::RFC_Object_Obj26.Ay = 0;
  @CAN_RadarFC::RFC_Object::RFC_Object_Obj26.AyVnce = 0;
  @CAN_RadarFC::RFC_Object::RFC_Object_Obj26.ExistProb = 0;
  @CAN_RadarFC::RFC_Object::RFC_Object_Obj26.FilterInformation = 0;
  @CAN_RadarFC::RFC_Object::RFC_Object_Obj26.Length = 0;
  @CAN_RadarFC::RFC_Object::RFC_Object_Obj26.LengthVnce = 0;
  @CAN_RadarFC::RFC_Object::RFC_Object_Obj26.MeasurementStatus = 0;
  @CAN_RadarFC::RFC_Object::RFC_Object_Obj26.MovingStatus = 0;
  @CAN_RadarFC::RFC_Object::RFC_Object_Obj26.ObjId = 0;
  @CAN_RadarFC::RFC_Object::RFC_Object_Obj26.OrientationYaw = 0;
  @CAN_RadarFC::RFC_Object::RFC_Object_Obj26.OrientationYawVnce = 0;
  @CAN_RadarFC::RFC_Object::RFC_Object_Obj26.ProbClassConfidence = 0;
  @CAN_RadarFC::RFC_Object::RFC_Object_Obj26.ProbClassType = 0;
  @CAN_RadarFC::RFC_Object::RFC_Object_Obj26.Px = 0;
  @CAN_RadarFC::RFC_Object::RFC_Object_Obj26.PxAxCoVnce = 0;
  @CAN_RadarFC::RFC_Object::RFC_Object_Obj26.PxAyCoVnce = 0;
  @CAN_RadarFC::RFC_Object::RFC_Object_Obj26.PxPyCoVnce = 0;
  @CAN_RadarFC::RFC_Object::RFC_Object_Obj26.PxVnce = 0;
  @CAN_RadarFC::RFC_Object::RFC_Object_Obj26.PxVxCoVnce = 0;
  }
  if(init_count == 31)
  {
  @CAN_RadarFC::RFC_Object::RFC_Object_Obj26.PxVyCoVnce = 0;
  @CAN_RadarFC::RFC_Object::RFC_Object_Obj26.Py = 0;
  @CAN_RadarFC::RFC_Object::RFC_Object_Obj26.PyAxCoVnce = 0;
  @CAN_RadarFC::RFC_Object::RFC_Object_Obj26.PyAyCoVnce = 0;
  @CAN_RadarFC::RFC_Object::RFC_Object_Obj26.PyVnce = 0;
  @CAN_RadarFC::RFC_Object::RFC_Object_Obj26.PyVxCoVnce = 0;
  @CAN_RadarFC::RFC_Object::RFC_Object_Obj26.PyVyCoVnce = 0;
  @CAN_RadarFC::RFC_Object::RFC_Object_Obj26.ReferencePoint = 0;
  @CAN_RadarFC::RFC_Object::RFC_Object_Obj26.Vx = 0;
  @CAN_RadarFC::RFC_Object::RFC_Object_Obj26.VxAxCoVnce = 0;
  @CAN_RadarFC::RFC_Object::RFC_Object_Obj26.VxAyCoVnce = 0;
  @CAN_RadarFC::RFC_Object::RFC_Object_Obj26.VxVnce = 0;
  @CAN_RadarFC::RFC_Object::RFC_Object_Obj26.VxVyCoVnce = 0;
  @CAN_RadarFC::RFC_Object::RFC_Object_Obj26.Vy = 0;
  @CAN_RadarFC::RFC_Object::RFC_Object_Obj26.VyAxCoVnce = 0;
  @CAN_RadarFC::RFC_Object::RFC_Object_Obj26.VyAyCoVnce = 0;
  @CAN_RadarFC::RFC_Object::RFC_Object_Obj26.VyVnce = 0;
  @CAN_RadarFC::RFC_Object::RFC_Object_Obj26.Width = 0;
  @CAN_RadarFC::RFC_Object::RFC_Object_Obj26.WidthVnce = 0;
  @CAN_RadarFC::RFC_Object::RFC_Object_Obj27.Age = 0;
  @CAN_RadarFC::RFC_Object::RFC_Object_Obj27.Ax = 0;
  @CAN_RadarFC::RFC_Object::RFC_Object_Obj27.AxAyCoVnce = 0;
  @CAN_RadarFC::RFC_Object::RFC_Object_Obj27.AxVnce = 0;
  @CAN_RadarFC::RFC_Object::RFC_Object_Obj27.Ay = 0;
  @CAN_RadarFC::RFC_Object::RFC_Object_Obj27.AyVnce = 0;
  }
  if(init_count == 32)
  {
  @CAN_RadarFC::RFC_Object::RFC_Object_Obj27.ExistProb = 0;
  @CAN_RadarFC::RFC_Object::RFC_Object_Obj27.FilterInformation = 0;
  @CAN_RadarFC::RFC_Object::RFC_Object_Obj27.Length = 0;
  @CAN_RadarFC::RFC_Object::RFC_Object_Obj27.LengthVnce = 0;
  @CAN_RadarFC::RFC_Object::RFC_Object_Obj27.MeasurementStatus = 0;
  @CAN_RadarFC::RFC_Object::RFC_Object_Obj27.MovingStatus = 0;
  @CAN_RadarFC::RFC_Object::RFC_Object_Obj27.ObjId = 0;
  @CAN_RadarFC::RFC_Object::RFC_Object_Obj27.OrientationYaw = 0;
  @CAN_RadarFC::RFC_Object::RFC_Object_Obj27.OrientationYawVnce = 0;
  @CAN_RadarFC::RFC_Object::RFC_Object_Obj27.ProbClassConfidence = 0;
  @CAN_RadarFC::RFC_Object::RFC_Object_Obj27.ProbClassType = 0;
  @CAN_RadarFC::RFC_Object::RFC_Object_Obj27.Px = 0;
  @CAN_RadarFC::RFC_Object::RFC_Object_Obj27.PxAxCoVnce = 0;
  @CAN_RadarFC::RFC_Object::RFC_Object_Obj27.PxAyCoVnce = 0;
  @CAN_RadarFC::RFC_Object::RFC_Object_Obj27.PxPyCoVnce = 0;
  @CAN_RadarFC::RFC_Object::RFC_Object_Obj27.PxVnce = 0;
  @CAN_RadarFC::RFC_Object::RFC_Object_Obj27.PxVxCoVnce = 0;
  @CAN_RadarFC::RFC_Object::RFC_Object_Obj27.PxVyCoVnce = 0;
  @CAN_RadarFC::RFC_Object::RFC_Object_Obj27.Py = 0;
  @CAN_RadarFC::RFC_Object::RFC_Object_Obj27.PyAxCoVnce = 0;
  @CAN_RadarFC::RFC_Object::RFC_Object_Obj27.PyAyCoVnce = 0;
  @CAN_RadarFC::RFC_Object::RFC_Object_Obj27.PyVnce = 0;
  @CAN_RadarFC::RFC_Object::RFC_Object_Obj27.PyVxCoVnce = 0;
  @CAN_RadarFC::RFC_Object::RFC_Object_Obj27.PyVyCoVnce = 0;
  @CAN_RadarFC::RFC_Object::RFC_Object_Obj27.ReferencePoint = 0;
  }
  if(init_count == 33)
  {
  @CAN_RadarFC::RFC_Object::RFC_Object_Obj27.Vx = 0;
  @CAN_RadarFC::RFC_Object::RFC_Object_Obj27.VxAxCoVnce = 0;
  @CAN_RadarFC::RFC_Object::RFC_Object_Obj27.VxAyCoVnce = 0;
  @CAN_RadarFC::RFC_Object::RFC_Object_Obj27.VxVnce = 0;
  @CAN_RadarFC::RFC_Object::RFC_Object_Obj27.VxVyCoVnce = 0;
  @CAN_RadarFC::RFC_Object::RFC_Object_Obj27.Vy = 0;
  @CAN_RadarFC::RFC_Object::RFC_Object_Obj27.VyAxCoVnce = 0;
  @CAN_RadarFC::RFC_Object::RFC_Object_Obj27.VyAyCoVnce = 0;
  @CAN_RadarFC::RFC_Object::RFC_Object_Obj27.VyVnce = 0;
  @CAN_RadarFC::RFC_Object::RFC_Object_Obj27.Width = 0;
  @CAN_RadarFC::RFC_Object::RFC_Object_Obj27.WidthVnce = 0;
  @CAN_RadarFC::RFC_Object::RFC_Object_Obj28.Age = 0;
  @CAN_RadarFC::RFC_Object::RFC_Object_Obj28.Ax = 0;
  @CAN_RadarFC::RFC_Object::RFC_Object_Obj28.AxAyCoVnce = 0;
  @CAN_RadarFC::RFC_Object::RFC_Object_Obj28.AxVnce = 0;
  @CAN_RadarFC::RFC_Object::RFC_Object_Obj28.Ay = 0;
  @CAN_RadarFC::RFC_Object::RFC_Object_Obj28.AyVnce = 0;
  @CAN_RadarFC::RFC_Object::RFC_Object_Obj28.ExistProb = 0;
  @CAN_RadarFC::RFC_Object::RFC_Object_Obj28.FilterInformation = 0;
  @CAN_RadarFC::RFC_Object::RFC_Object_Obj28.Length = 0;
  @CAN_RadarFC::RFC_Object::RFC_Object_Obj28.LengthVnce = 0;
  @CAN_RadarFC::RFC_Object::RFC_Object_Obj28.MeasurementStatus = 0;
  @CAN_RadarFC::RFC_Object::RFC_Object_Obj28.MovingStatus = 0;
  @CAN_RadarFC::RFC_Object::RFC_Object_Obj28.ObjId = 0;
  @CAN_RadarFC::RFC_Object::RFC_Object_Obj28.OrientationYaw = 0;
  }
  if(init_count == 34)
  {
  @CAN_RadarFC::RFC_Object::RFC_Object_Obj28.OrientationYawVnce = 0;
  @CAN_RadarFC::RFC_Object::RFC_Object_Obj28.ProbClassConfidence = 0;
  @CAN_RadarFC::RFC_Object::RFC_Object_Obj28.ProbClassType = 0;
  @CAN_RadarFC::RFC_Object::RFC_Object_Obj28.Px = 0;
  @CAN_RadarFC::RFC_Object::RFC_Object_Obj28.PxAxCoVnce = 0;
  @CAN_RadarFC::RFC_Object::RFC_Object_Obj28.PxAyCoVnce = 0;
  @CAN_RadarFC::RFC_Object::RFC_Object_Obj28.PxPyCoVnce = 0;
  @CAN_RadarFC::RFC_Object::RFC_Object_Obj28.PxVnce = 0;
  @CAN_RadarFC::RFC_Object::RFC_Object_Obj28.PxVxCoVnce = 0;
  @CAN_RadarFC::RFC_Object::RFC_Object_Obj28.PxVyCoVnce = 0;
  @CAN_RadarFC::RFC_Object::RFC_Object_Obj28.Py = 0;
  @CAN_RadarFC::RFC_Object::RFC_Object_Obj28.PyAxCoVnce = 0;
  @CAN_RadarFC::RFC_Object::RFC_Object_Obj28.PyAyCoVnce = 0;
  @CAN_RadarFC::RFC_Object::RFC_Object_Obj28.PyVnce = 0;
  @CAN_RadarFC::RFC_Object::RFC_Object_Obj28.PyVxCoVnce = 0;
  @CAN_RadarFC::RFC_Object::RFC_Object_Obj28.PyVyCoVnce = 0;
  @CAN_RadarFC::RFC_Object::RFC_Object_Obj28.ReferencePoint = 0;
  @CAN_RadarFC::RFC_Object::RFC_Object_Obj28.Vx = 0;
  @CAN_RadarFC::RFC_Object::RFC_Object_Obj28.VxAxCoVnce = 0;
  @CAN_RadarFC::RFC_Object::RFC_Object_Obj28.VxAyCoVnce = 0;
  @CAN_RadarFC::RFC_Object::RFC_Object_Obj28.VxVnce = 0;
  @CAN_RadarFC::RFC_Object::RFC_Object_Obj28.VxVyCoVnce = 0;
  @CAN_RadarFC::RFC_Object::RFC_Object_Obj28.Vy = 0;
  @CAN_RadarFC::RFC_Object::RFC_Object_Obj28.VyAxCoVnce = 0;
  @CAN_RadarFC::RFC_Object::RFC_Object_Obj28.VyAyCoVnce = 0;
  }
  if(init_count == 35)
  {
  @CAN_RadarFC::RFC_Object::RFC_Object_Obj28.VyVnce = 0;
  @CAN_RadarFC::RFC_Object::RFC_Object_Obj28.Width = 0;
  @CAN_RadarFC::RFC_Object::RFC_Object_Obj28.WidthVnce = 0;
  @CAN_RadarFC::RFC_Object::RFC_Object_Obj29.Age = 0;
  @CAN_RadarFC::RFC_Object::RFC_Object_Obj29.Ax = 0;
  @CAN_RadarFC::RFC_Object::RFC_Object_Obj29.AxAyCoVnce = 0;
  @CAN_RadarFC::RFC_Object::RFC_Object_Obj29.AxVnce = 0;
  @CAN_RadarFC::RFC_Object::RFC_Object_Obj29.Ay = 0;
  @CAN_RadarFC::RFC_Object::RFC_Object_Obj29.AyVnce = 0;
  @CAN_RadarFC::RFC_Object::RFC_Object_Obj29.ExistProb = 0;
  @CAN_RadarFC::RFC_Object::RFC_Object_Obj29.FilterInformation = 0;
  @CAN_RadarFC::RFC_Object::RFC_Object_Obj29.Length = 0;
  @CAN_RadarFC::RFC_Object::RFC_Object_Obj29.LengthVnce = 0;
  @CAN_RadarFC::RFC_Object::RFC_Object_Obj29.MeasurementStatus = 0;
  @CAN_RadarFC::RFC_Object::RFC_Object_Obj29.MovingStatus = 0;
  @CAN_RadarFC::RFC_Object::RFC_Object_Obj29.ObjId = 0;
  @CAN_RadarFC::RFC_Object::RFC_Object_Obj29.OrientationYaw = 0;
  @CAN_RadarFC::RFC_Object::RFC_Object_Obj29.OrientationYawVnce = 0;
  @CAN_RadarFC::RFC_Object::RFC_Object_Obj29.ProbClassConfidence = 0;
  @CAN_RadarFC::RFC_Object::RFC_Object_Obj29.ProbClassType = 0;
  @CAN_RadarFC::RFC_Object::RFC_Object_Obj29.Px = 0;
  @CAN_RadarFC::RFC_Object::RFC_Object_Obj29.PxAxCoVnce = 0;
  @CAN_RadarFC::RFC_Object::RFC_Object_Obj29.PxAyCoVnce = 0;
  @CAN_RadarFC::RFC_Object::RFC_Object_Obj29.PxPyCoVnce = 0;
  @CAN_RadarFC::RFC_Object::RFC_Object_Obj29.PxVnce = 0;
  }
  if(init_count == 36)
  {
  @CAN_RadarFC::RFC_Object::RFC_Object_Obj29.PxVxCoVnce = 0;
  @CAN_RadarFC::RFC_Object::RFC_Object_Obj29.PxVyCoVnce = 0;
  @CAN_RadarFC::RFC_Object::RFC_Object_Obj29.Py = 0;
  @CAN_RadarFC::RFC_Object::RFC_Object_Obj29.PyAxCoVnce = 0;
  @CAN_RadarFC::RFC_Object::RFC_Object_Obj29.PyAyCoVnce = 0;
  @CAN_RadarFC::RFC_Object::RFC_Object_Obj29.PyVnce = 0;
  @CAN_RadarFC::RFC_Object::RFC_Object_Obj29.PyVxCoVnce = 0;
  @CAN_RadarFC::RFC_Object::RFC_Object_Obj29.PyVyCoVnce = 0;
  @CAN_RadarFC::RFC_Object::RFC_Object_Obj29.ReferencePoint = 0;
  @CAN_RadarFC::RFC_Object::RFC_Object_Obj29.Vx = 0;
  @CAN_RadarFC::RFC_Object::RFC_Object_Obj29.VxAxCoVnce = 0;
  @CAN_RadarFC::RFC_Object::RFC_Object_Obj29.VxAyCoVnce = 0;
  @CAN_RadarFC::RFC_Object::RFC_Object_Obj29.VxVnce = 0;
  @CAN_RadarFC::RFC_Object::RFC_Object_Obj29.VxVyCoVnce = 0;
  @CAN_RadarFC::RFC_Object::RFC_Object_Obj29.Vy = 0;
  @CAN_RadarFC::RFC_Object::RFC_Object_Obj29.VyAxCoVnce = 0;
  @CAN_RadarFC::RFC_Object::RFC_Object_Obj29.VyAyCoVnce = 0;
  @CAN_RadarFC::RFC_Object::RFC_Object_Obj29.VyVnce = 0;
  @CAN_RadarFC::RFC_Object::RFC_Object_Obj29.Width = 0;
  @CAN_RadarFC::RFC_Object::RFC_Object_Obj29.WidthVnce = 0;
  @CAN_RadarFC::RFC_Object::RFC_Object_Obj2.Age = 0;
  @CAN_RadarFC::RFC_Object::RFC_Object_Obj2.Ax = 0;
  @CAN_RadarFC::RFC_Object::RFC_Object_Obj2.AxAyCoVnce = 0;
  @CAN_RadarFC::RFC_Object::RFC_Object_Obj2.AxVnce = 0;
  @CAN_RadarFC::RFC_Object::RFC_Object_Obj2.Ay = 0;
  }
  if(init_count == 37)
  {
  @CAN_RadarFC::RFC_Object::RFC_Object_Obj2.AyVnce = 0;
  @CAN_RadarFC::RFC_Object::RFC_Object_Obj2.ExistProb = 0;
  @CAN_RadarFC::RFC_Object::RFC_Object_Obj2.FilterInformation = 0;
  @CAN_RadarFC::RFC_Object::RFC_Object_Obj2.Length = 0;
  @CAN_RadarFC::RFC_Object::RFC_Object_Obj2.LengthVnce = 0;
  @CAN_RadarFC::RFC_Object::RFC_Object_Obj2.MeasurementStatus = 0;
  @CAN_RadarFC::RFC_Object::RFC_Object_Obj2.MovingStatus = 0;
  @CAN_RadarFC::RFC_Object::RFC_Object_Obj2.ObjId = 0;
  @CAN_RadarFC::RFC_Object::RFC_Object_Obj2.OrientationYaw = 0;
  @CAN_RadarFC::RFC_Object::RFC_Object_Obj2.OrientationYawVnce = 0;
  @CAN_RadarFC::RFC_Object::RFC_Object_Obj2.ProbClassConfidence = 0;
  @CAN_RadarFC::RFC_Object::RFC_Object_Obj2.ProbClassType = 0;
  @CAN_RadarFC::RFC_Object::RFC_Object_Obj2.Px = 0;
  @CAN_RadarFC::RFC_Object::RFC_Object_Obj2.PxAxCoVnce = 0;
  @CAN_RadarFC::RFC_Object::RFC_Object_Obj2.PxAyCoVnce = 0;
  @CAN_RadarFC::RFC_Object::RFC_Object_Obj2.PxPyCoVnce = 0;
  @CAN_RadarFC::RFC_Object::RFC_Object_Obj2.PxVnce = 0;
  @CAN_RadarFC::RFC_Object::RFC_Object_Obj2.PxVxCoVnce = 0;
  @CAN_RadarFC::RFC_Object::RFC_Object_Obj2.PxVyCoVnce = 0;
  @CAN_RadarFC::RFC_Object::RFC_Object_Obj2.Py = 0;
  @CAN_RadarFC::RFC_Object::RFC_Object_Obj2.PyAxCoVnce = 0;
  @CAN_RadarFC::RFC_Object::RFC_Object_Obj2.PyAyCoVnce = 0;
  @CAN_RadarFC::RFC_Object::RFC_Object_Obj2.PyVnce = 0;
  @CAN_RadarFC::RFC_Object::RFC_Object_Obj2.PyVxCoVnce = 0;
  @CAN_RadarFC::RFC_Object::RFC_Object_Obj2.PyVyCoVnce = 0;
  }
  if(init_count == 38)
  {
  @CAN_RadarFC::RFC_Object::RFC_Object_Obj2.ReferencePoint = 0;
  @CAN_RadarFC::RFC_Object::RFC_Object_Obj2.Vx = 0;
  @CAN_RadarFC::RFC_Object::RFC_Object_Obj2.VxAxCoVnce = 0;
  @CAN_RadarFC::RFC_Object::RFC_Object_Obj2.VxAyCoVnce = 0;
  @CAN_RadarFC::RFC_Object::RFC_Object_Obj2.VxVnce = 0;
  @CAN_RadarFC::RFC_Object::RFC_Object_Obj2.VxVyCoVnce = 0;
  @CAN_RadarFC::RFC_Object::RFC_Object_Obj2.Vy = 0;
  @CAN_RadarFC::RFC_Object::RFC_Object_Obj2.VyAxCoVnce = 0;
  @CAN_RadarFC::RFC_Object::RFC_Object_Obj2.VyAyCoVnce = 0;
  @CAN_RadarFC::RFC_Object::RFC_Object_Obj2.VyVnce = 0;
  @CAN_RadarFC::RFC_Object::RFC_Object_Obj2.Width = 0;
  @CAN_RadarFC::RFC_Object::RFC_Object_Obj2.WidthVnce = 0;
  @CAN_RadarFC::RFC_Object::RFC_Object_Obj30.Age = 0;
  @CAN_RadarFC::RFC_Object::RFC_Object_Obj30.Ax = 0;
  @CAN_RadarFC::RFC_Object::RFC_Object_Obj30.AxAyCoVnce = 0;
  @CAN_RadarFC::RFC_Object::RFC_Object_Obj30.AxVnce = 0;
  @CAN_RadarFC::RFC_Object::RFC_Object_Obj30.Ay = 0;
  @CAN_RadarFC::RFC_Object::RFC_Object_Obj30.AyVnce = 0;
  @CAN_RadarFC::RFC_Object::RFC_Object_Obj30.ExistProb = 0;
  @CAN_RadarFC::RFC_Object::RFC_Object_Obj30.FilterInformation = 0;
  @CAN_RadarFC::RFC_Object::RFC_Object_Obj30.Length = 0;
  @CAN_RadarFC::RFC_Object::RFC_Object_Obj30.LengthVnce = 0;
  @CAN_RadarFC::RFC_Object::RFC_Object_Obj30.MeasurementStatus = 0;
  @CAN_RadarFC::RFC_Object::RFC_Object_Obj30.MovingStatus = 0;
  @CAN_RadarFC::RFC_Object::RFC_Object_Obj30.ObjId = 0;
  }
  if(init_count == 39)
  {
  @CAN_RadarFC::RFC_Object::RFC_Object_Obj30.OrientationYaw = 0;
  @CAN_RadarFC::RFC_Object::RFC_Object_Obj30.OrientationYawVnce = 0;
  @CAN_RadarFC::RFC_Object::RFC_Object_Obj30.ProbClassConfidence = 0;
  @CAN_RadarFC::RFC_Object::RFC_Object_Obj30.ProbClassType = 0;
  @CAN_RadarFC::RFC_Object::RFC_Object_Obj30.Px = 0;
  @CAN_RadarFC::RFC_Object::RFC_Object_Obj30.PxAxCoVnce = 0;
  @CAN_RadarFC::RFC_Object::RFC_Object_Obj30.PxAyCoVnce = 0;
  @CAN_RadarFC::RFC_Object::RFC_Object_Obj30.PxPyCoVnce = 0;
  @CAN_RadarFC::RFC_Object::RFC_Object_Obj30.PxVnce = 0;
  @CAN_RadarFC::RFC_Object::RFC_Object_Obj30.PxVxCoVnce = 0;
  @CAN_RadarFC::RFC_Object::RFC_Object_Obj30.PxVyCoVnce = 0;
  @CAN_RadarFC::RFC_Object::RFC_Object_Obj30.Py = 0;
  @CAN_RadarFC::RFC_Object::RFC_Object_Obj30.PyAxCoVnce = 0;
  @CAN_RadarFC::RFC_Object::RFC_Object_Obj30.PyAyCoVnce = 0;
  @CAN_RadarFC::RFC_Object::RFC_Object_Obj30.PyVnce = 0;
  @CAN_RadarFC::RFC_Object::RFC_Object_Obj30.PyVxCoVnce = 0;
  @CAN_RadarFC::RFC_Object::RFC_Object_Obj30.PyVyCoVnce = 0;
  @CAN_RadarFC::RFC_Object::RFC_Object_Obj30.ReferencePoint = 0;
  @CAN_RadarFC::RFC_Object::RFC_Object_Obj30.Vx = 0;
  @CAN_RadarFC::RFC_Object::RFC_Object_Obj30.VxAxCoVnce = 0;
  @CAN_RadarFC::RFC_Object::RFC_Object_Obj30.VxAyCoVnce = 0;
  @CAN_RadarFC::RFC_Object::RFC_Object_Obj30.VxVnce = 0;
  @CAN_RadarFC::RFC_Object::RFC_Object_Obj30.VxVyCoVnce = 0;
  @CAN_RadarFC::RFC_Object::RFC_Object_Obj30.Vy = 0;
  @CAN_RadarFC::RFC_Object::RFC_Object_Obj30.VyAxCoVnce = 0;
  }
  if(init_count == 40)
  {
  @CAN_RadarFC::RFC_Object::RFC_Object_Obj30.VyAyCoVnce = 0;
  @CAN_RadarFC::RFC_Object::RFC_Object_Obj30.VyVnce = 0;
  @CAN_RadarFC::RFC_Object::RFC_Object_Obj30.Width = 0;
  @CAN_RadarFC::RFC_Object::RFC_Object_Obj30.WidthVnce = 0;
  @CAN_RadarFC::RFC_Object::RFC_Object_Obj31.Age = 0;
  @CAN_RadarFC::RFC_Object::RFC_Object_Obj31.Ax = 0;
  @CAN_RadarFC::RFC_Object::RFC_Object_Obj31.AxAyCoVnce = 0;
  @CAN_RadarFC::RFC_Object::RFC_Object_Obj31.AxVnce = 0;
  @CAN_RadarFC::RFC_Object::RFC_Object_Obj31.Ay = 0;
  @CAN_RadarFC::RFC_Object::RFC_Object_Obj31.AyVnce = 0;
  @CAN_RadarFC::RFC_Object::RFC_Object_Obj31.ExistProb = 0;
  @CAN_RadarFC::RFC_Object::RFC_Object_Obj31.FilterInformation = 0;
  @CAN_RadarFC::RFC_Object::RFC_Object_Obj31.Length = 0;
  @CAN_RadarFC::RFC_Object::RFC_Object_Obj31.LengthVnce = 0;
  @CAN_RadarFC::RFC_Object::RFC_Object_Obj31.MeasurementStatus = 0;
  @CAN_RadarFC::RFC_Object::RFC_Object_Obj31.MovingStatus = 0;
  @CAN_RadarFC::RFC_Object::RFC_Object_Obj31.ObjId = 0;
  @CAN_RadarFC::RFC_Object::RFC_Object_Obj31.OrientationYaw = 0;
  @CAN_RadarFC::RFC_Object::RFC_Object_Obj31.OrientationYawVnce = 0;
  @CAN_RadarFC::RFC_Object::RFC_Object_Obj31.ProbClassConfidence = 0;
  @CAN_RadarFC::RFC_Object::RFC_Object_Obj31.ProbClassType = 0;
  @CAN_RadarFC::RFC_Object::RFC_Object_Obj31.Px = 0;
  @CAN_RadarFC::RFC_Object::RFC_Object_Obj31.PxAxCoVnce = 0;
  @CAN_RadarFC::RFC_Object::RFC_Object_Obj31.PxAyCoVnce = 0;
  @CAN_RadarFC::RFC_Object::RFC_Object_Obj31.PxPyCoVnce = 0;
  }
  if(init_count == 41)
  {
  @CAN_RadarFC::RFC_Object::RFC_Object_Obj31.PxVnce = 0;
  @CAN_RadarFC::RFC_Object::RFC_Object_Obj31.PxVxCoVnce = 0;
  @CAN_RadarFC::RFC_Object::RFC_Object_Obj31.PxVyCoVnce = 0;
  @CAN_RadarFC::RFC_Object::RFC_Object_Obj31.Py = 0;
  @CAN_RadarFC::RFC_Object::RFC_Object_Obj31.PyAxCoVnce = 0;
  @CAN_RadarFC::RFC_Object::RFC_Object_Obj31.PyAyCoVnce = 0;
  @CAN_RadarFC::RFC_Object::RFC_Object_Obj31.PyVnce = 0;
  @CAN_RadarFC::RFC_Object::RFC_Object_Obj31.PyVxCoVnce = 0;
  @CAN_RadarFC::RFC_Object::RFC_Object_Obj31.PyVyCoVnce = 0;
  @CAN_RadarFC::RFC_Object::RFC_Object_Obj31.ReferencePoint = 0;
  @CAN_RadarFC::RFC_Object::RFC_Object_Obj31.Vx = 0;
  @CAN_RadarFC::RFC_Object::RFC_Object_Obj31.VxAxCoVnce = 0;
  @CAN_RadarFC::RFC_Object::RFC_Object_Obj31.VxAyCoVnce = 0;
  @CAN_RadarFC::RFC_Object::RFC_Object_Obj31.VxVnce = 0;
  @CAN_RadarFC::RFC_Object::RFC_Object_Obj31.VxVyCoVnce = 0;
  @CAN_RadarFC::RFC_Object::RFC_Object_Obj31.Vy = 0;
  @CAN_RadarFC::RFC_Object::RFC_Object_Obj31.VyAxCoVnce = 0;
  @CAN_RadarFC::RFC_Object::RFC_Object_Obj31.VyAyCoVnce = 0;
  @CAN_RadarFC::RFC_Object::RFC_Object_Obj31.VyVnce = 0;
  @CAN_RadarFC::RFC_Object::RFC_Object_Obj31.Width = 0;
  @CAN_RadarFC::RFC_Object::RFC_Object_Obj31.WidthVnce = 0;
  @CAN_RadarFC::RFC_Object::RFC_Object_Obj32.Age = 0;
  @CAN_RadarFC::RFC_Object::RFC_Object_Obj32.Ax = 0;
  @CAN_RadarFC::RFC_Object::RFC_Object_Obj32.AxAyCoVnce = 0;
  @CAN_RadarFC::RFC_Object::RFC_Object_Obj32.AxVnce = 0;
  }
  if(init_count == 42)
  {
  @CAN_RadarFC::RFC_Object::RFC_Object_Obj32.Ay = 0;
  @CAN_RadarFC::RFC_Object::RFC_Object_Obj32.AyVnce = 0;
  @CAN_RadarFC::RFC_Object::RFC_Object_Obj32.ExistProb = 0;
  @CAN_RadarFC::RFC_Object::RFC_Object_Obj32.FilterInformation = 0;
  @CAN_RadarFC::RFC_Object::RFC_Object_Obj32.Length = 0;
  @CAN_RadarFC::RFC_Object::RFC_Object_Obj32.LengthVnce = 0;
  @CAN_RadarFC::RFC_Object::RFC_Object_Obj32.MeasurementStatus = 0;
  @CAN_RadarFC::RFC_Object::RFC_Object_Obj32.MovingStatus = 0;
  @CAN_RadarFC::RFC_Object::RFC_Object_Obj32.ObjId = 0;
  @CAN_RadarFC::RFC_Object::RFC_Object_Obj32.OrientationYaw = 0;
  @CAN_RadarFC::RFC_Object::RFC_Object_Obj32.OrientationYawVnce = 0;
  @CAN_RadarFC::RFC_Object::RFC_Object_Obj32.ProbClassConfidence = 0;
  @CAN_RadarFC::RFC_Object::RFC_Object_Obj32.ProbClassType = 0;
  @CAN_RadarFC::RFC_Object::RFC_Object_Obj32.Px = 0;
  @CAN_RadarFC::RFC_Object::RFC_Object_Obj32.PxAxCoVnce = 0;
  @CAN_RadarFC::RFC_Object::RFC_Object_Obj32.PxAyCoVnce = 0;
  @CAN_RadarFC::RFC_Object::RFC_Object_Obj32.PxPyCoVnce = 0;
  @CAN_RadarFC::RFC_Object::RFC_Object_Obj32.PxVnce = 0;
  @CAN_RadarFC::RFC_Object::RFC_Object_Obj32.PxVxCoVnce = 0;
  @CAN_RadarFC::RFC_Object::RFC_Object_Obj32.PxVyCoVnce = 0;
  @CAN_RadarFC::RFC_Object::RFC_Object_Obj32.Py = 0;
  @CAN_RadarFC::RFC_Object::RFC_Object_Obj32.PyAxCoVnce = 0;
  @CAN_RadarFC::RFC_Object::RFC_Object_Obj32.PyAyCoVnce = 0;
  @CAN_RadarFC::RFC_Object::RFC_Object_Obj32.PyVnce = 0;
  @CAN_RadarFC::RFC_Object::RFC_Object_Obj32.PyVxCoVnce = 0;
  }
  if(init_count == 43)
  {
  @CAN_RadarFC::RFC_Object::RFC_Object_Obj32.PyVyCoVnce = 0;
  @CAN_RadarFC::RFC_Object::RFC_Object_Obj32.ReferencePoint = 0;
  @CAN_RadarFC::RFC_Object::RFC_Object_Obj32.Vx = 0;
  @CAN_RadarFC::RFC_Object::RFC_Object_Obj32.VxAxCoVnce = 0;
  @CAN_RadarFC::RFC_Object::RFC_Object_Obj32.VxAyCoVnce = 0;
  @CAN_RadarFC::RFC_Object::RFC_Object_Obj32.VxVnce = 0;
  @CAN_RadarFC::RFC_Object::RFC_Object_Obj32.VxVyCoVnce = 0;
  @CAN_RadarFC::RFC_Object::RFC_Object_Obj32.Vy = 0;
  @CAN_RadarFC::RFC_Object::RFC_Object_Obj32.VyAxCoVnce = 0;
  @CAN_RadarFC::RFC_Object::RFC_Object_Obj32.VyAyCoVnce = 0;
  @CAN_RadarFC::RFC_Object::RFC_Object_Obj32.VyVnce = 0;
  @CAN_RadarFC::RFC_Object::RFC_Object_Obj32.Width = 0;
  @CAN_RadarFC::RFC_Object::RFC_Object_Obj32.WidthVnce = 0;
  @CAN_RadarFC::RFC_Object::RFC_Object_Obj33.Age = 0;
  @CAN_RadarFC::RFC_Object::RFC_Object_Obj33.Ax = 0;
  @CAN_RadarFC::RFC_Object::RFC_Object_Obj33.AxAyCoVnce = 0;
  @CAN_RadarFC::RFC_Object::RFC_Object_Obj33.AxVnce = 0;
  @CAN_RadarFC::RFC_Object::RFC_Object_Obj33.Ay = 0;
  @CAN_RadarFC::RFC_Object::RFC_Object_Obj33.AyVnce = 0;
  @CAN_RadarFC::RFC_Object::RFC_Object_Obj33.ExistProb = 0;
  @CAN_RadarFC::RFC_Object::RFC_Object_Obj33.FilterInformation = 0;
  @CAN_RadarFC::RFC_Object::RFC_Object_Obj33.Length = 0;
  @CAN_RadarFC::RFC_Object::RFC_Object_Obj33.LengthVnce = 0;
  @CAN_RadarFC::RFC_Object::RFC_Object_Obj33.MeasurementStatus = 0;
  @CAN_RadarFC::RFC_Object::RFC_Object_Obj33.MovingStatus = 0;
  }
  if(init_count == 44)
  {
  @CAN_RadarFC::RFC_Object::RFC_Object_Obj33.ObjId = 0;
  @CAN_RadarFC::RFC_Object::RFC_Object_Obj33.OrientationYaw = 0;
  @CAN_RadarFC::RFC_Object::RFC_Object_Obj33.OrientationYawVnce = 0;
  @CAN_RadarFC::RFC_Object::RFC_Object_Obj33.ProbClassConfidence = 0;
  @CAN_RadarFC::RFC_Object::RFC_Object_Obj33.ProbClassType = 0;
  @CAN_RadarFC::RFC_Object::RFC_Object_Obj33.Px = 0;
  @CAN_RadarFC::RFC_Object::RFC_Object_Obj33.PxAxCoVnce = 0;
  @CAN_RadarFC::RFC_Object::RFC_Object_Obj33.PxAyCoVnce = 0;
  @CAN_RadarFC::RFC_Object::RFC_Object_Obj33.PxPyCoVnce = 0;
  @CAN_RadarFC::RFC_Object::RFC_Object_Obj33.PxVnce = 0;
  @CAN_RadarFC::RFC_Object::RFC_Object_Obj33.PxVxCoVnce = 0;
  @CAN_RadarFC::RFC_Object::RFC_Object_Obj33.PxVyCoVnce = 0;
  @CAN_RadarFC::RFC_Object::RFC_Object_Obj33.Py = 0;
  @CAN_RadarFC::RFC_Object::RFC_Object_Obj33.PyAxCoVnce = 0;
  @CAN_RadarFC::RFC_Object::RFC_Object_Obj33.PyAyCoVnce = 0;
  @CAN_RadarFC::RFC_Object::RFC_Object_Obj33.PyVnce = 0;
  @CAN_RadarFC::RFC_Object::RFC_Object_Obj33.PyVxCoVnce = 0;
  @CAN_RadarFC::RFC_Object::RFC_Object_Obj33.PyVyCoVnce = 0;
  @CAN_RadarFC::RFC_Object::RFC_Object_Obj33.ReferencePoint = 0;
  @CAN_RadarFC::RFC_Object::RFC_Object_Obj33.Vx = 0;
  @CAN_RadarFC::RFC_Object::RFC_Object_Obj33.VxAxCoVnce = 0;
  @CAN_RadarFC::RFC_Object::RFC_Object_Obj33.VxAyCoVnce = 0;
  @CAN_RadarFC::RFC_Object::RFC_Object_Obj33.VxVnce = 0;
  @CAN_RadarFC::RFC_Object::RFC_Object_Obj33.VxVyCoVnce = 0;
  @CAN_RadarFC::RFC_Object::RFC_Object_Obj33.Vy = 0;
  }
  if(init_count == 45)
  {
  @CAN_RadarFC::RFC_Object::RFC_Object_Obj33.VyAxCoVnce = 0;
  @CAN_RadarFC::RFC_Object::RFC_Object_Obj33.VyAyCoVnce = 0;
  @CAN_RadarFC::RFC_Object::RFC_Object_Obj33.VyVnce = 0;
  @CAN_RadarFC::RFC_Object::RFC_Object_Obj33.Width = 0;
  @CAN_RadarFC::RFC_Object::RFC_Object_Obj33.WidthVnce = 0;
  @CAN_RadarFC::RFC_Object::RFC_Object_Obj34.Age = 0;
  @CAN_RadarFC::RFC_Object::RFC_Object_Obj34.Ax = 0;
  @CAN_RadarFC::RFC_Object::RFC_Object_Obj34.AxAyCoVnce = 0;
  @CAN_RadarFC::RFC_Object::RFC_Object_Obj34.AxVnce = 0;
  @CAN_RadarFC::RFC_Object::RFC_Object_Obj34.Ay = 0;
  @CAN_RadarFC::RFC_Object::RFC_Object_Obj34.AyVnce = 0;
  @CAN_RadarFC::RFC_Object::RFC_Object_Obj34.ExistProb = 0;
  @CAN_RadarFC::RFC_Object::RFC_Object_Obj34.FilterInformation = 0;
  @CAN_RadarFC::RFC_Object::RFC_Object_Obj34.Length = 0;
  @CAN_RadarFC::RFC_Object::RFC_Object_Obj34.LengthVnce = 0;
  @CAN_RadarFC::RFC_Object::RFC_Object_Obj34.MeasurementStatus = 0;
  @CAN_RadarFC::RFC_Object::RFC_Object_Obj34.MovingStatus = 0;
  @CAN_RadarFC::RFC_Object::RFC_Object_Obj34.ObjId = 0;
  @CAN_RadarFC::RFC_Object::RFC_Object_Obj34.OrientationYaw = 0;
  @CAN_RadarFC::RFC_Object::RFC_Object_Obj34.OrientationYawVnce = 0;
  @CAN_RadarFC::RFC_Object::RFC_Object_Obj34.ProbClassConfidence = 0;
  @CAN_RadarFC::RFC_Object::RFC_Object_Obj34.ProbClassType = 0;
  @CAN_RadarFC::RFC_Object::RFC_Object_Obj34.Px = 0;
  @CAN_RadarFC::RFC_Object::RFC_Object_Obj34.PxAxCoVnce = 0;
  @CAN_RadarFC::RFC_Object::RFC_Object_Obj34.PxAyCoVnce = 0;
  }
  if(init_count == 46)
  {
  @CAN_RadarFC::RFC_Object::RFC_Object_Obj34.PxPyCoVnce = 0;
  @CAN_RadarFC::RFC_Object::RFC_Object_Obj34.PxVnce = 0;
  @CAN_RadarFC::RFC_Object::RFC_Object_Obj34.PxVxCoVnce = 0;
  @CAN_RadarFC::RFC_Object::RFC_Object_Obj34.PxVyCoVnce = 0;
  @CAN_RadarFC::RFC_Object::RFC_Object_Obj34.Py = 0;
  @CAN_RadarFC::RFC_Object::RFC_Object_Obj34.PyAxCoVnce = 0;
  @CAN_RadarFC::RFC_Object::RFC_Object_Obj34.PyAyCoVnce = 0;
  @CAN_RadarFC::RFC_Object::RFC_Object_Obj34.PyVnce = 0;
  @CAN_RadarFC::RFC_Object::RFC_Object_Obj34.PyVxCoVnce = 0;
  @CAN_RadarFC::RFC_Object::RFC_Object_Obj34.PyVyCoVnce = 0;
  @CAN_RadarFC::RFC_Object::RFC_Object_Obj34.ReferencePoint = 0;
  @CAN_RadarFC::RFC_Object::RFC_Object_Obj34.Vx = 0;
  @CAN_RadarFC::RFC_Object::RFC_Object_Obj34.VxAxCoVnce = 0;
  @CAN_RadarFC::RFC_Object::RFC_Object_Obj34.VxAyCoVnce = 0;
  @CAN_RadarFC::RFC_Object::RFC_Object_Obj34.VxVnce = 0;
  @CAN_RadarFC::RFC_Object::RFC_Object_Obj34.VxVyCoVnce = 0;
  @CAN_RadarFC::RFC_Object::RFC_Object_Obj34.Vy = 0;
  @CAN_RadarFC::RFC_Object::RFC_Object_Obj34.VyAxCoVnce = 0;
  @CAN_RadarFC::RFC_Object::RFC_Object_Obj34.VyAyCoVnce = 0;
  @CAN_RadarFC::RFC_Object::RFC_Object_Obj34.VyVnce = 0;
  @CAN_RadarFC::RFC_Object::RFC_Object_Obj34.Width = 0;
  @CAN_RadarFC::RFC_Object::RFC_Object_Obj34.WidthVnce = 0;
  @CAN_RadarFC::RFC_Object::RFC_Object_Obj35.Age = 0;
  @CAN_RadarFC::RFC_Object::RFC_Object_Obj35.Ax = 0;
  @CAN_RadarFC::RFC_Object::RFC_Object_Obj35.AxAyCoVnce = 0;
  }
  if(init_count == 47)
  {
  @CAN_RadarFC::RFC_Object::RFC_Object_Obj35.AxVnce = 0;
  @CAN_RadarFC::RFC_Object::RFC_Object_Obj35.Ay = 0;
  @CAN_RadarFC::RFC_Object::RFC_Object_Obj35.AyVnce = 0;
  @CAN_RadarFC::RFC_Object::RFC_Object_Obj35.ExistProb = 0;
  @CAN_RadarFC::RFC_Object::RFC_Object_Obj35.FilterInformation = 0;
  @CAN_RadarFC::RFC_Object::RFC_Object_Obj35.Length = 0;
  @CAN_RadarFC::RFC_Object::RFC_Object_Obj35.LengthVnce = 0;
  @CAN_RadarFC::RFC_Object::RFC_Object_Obj35.MeasurementStatus = 0;
  @CAN_RadarFC::RFC_Object::RFC_Object_Obj35.MovingStatus = 0;
  @CAN_RadarFC::RFC_Object::RFC_Object_Obj35.ObjId = 0;
  @CAN_RadarFC::RFC_Object::RFC_Object_Obj35.OrientationYaw = 0;
  @CAN_RadarFC::RFC_Object::RFC_Object_Obj35.OrientationYawVnce = 0;
  @CAN_RadarFC::RFC_Object::RFC_Object_Obj35.ProbClassConfidence = 0;
  @CAN_RadarFC::RFC_Object::RFC_Object_Obj35.ProbClassType = 0;
  @CAN_RadarFC::RFC_Object::RFC_Object_Obj35.Px = 0;
  @CAN_RadarFC::RFC_Object::RFC_Object_Obj35.PxAxCoVnce = 0;
  @CAN_RadarFC::RFC_Object::RFC_Object_Obj35.PxAyCoVnce = 0;
  @CAN_RadarFC::RFC_Object::RFC_Object_Obj35.PxPyCoVnce = 0;
  @CAN_RadarFC::RFC_Object::RFC_Object_Obj35.PxVnce = 0;
  @CAN_RadarFC::RFC_Object::RFC_Object_Obj35.PxVxCoVnce = 0;
  @CAN_RadarFC::RFC_Object::RFC_Object_Obj35.PxVyCoVnce = 0;
  @CAN_RadarFC::RFC_Object::RFC_Object_Obj35.Py = 0;
  @CAN_RadarFC::RFC_Object::RFC_Object_Obj35.PyAxCoVnce = 0;
  @CAN_RadarFC::RFC_Object::RFC_Object_Obj35.PyAyCoVnce = 0;
  @CAN_RadarFC::RFC_Object::RFC_Object_Obj35.PyVnce = 0;
  }
  if(init_count == 48)
  {
  @CAN_RadarFC::RFC_Object::RFC_Object_Obj35.PyVxCoVnce = 0;
  @CAN_RadarFC::RFC_Object::RFC_Object_Obj35.PyVyCoVnce = 0;
  @CAN_RadarFC::RFC_Object::RFC_Object_Obj35.ReferencePoint = 0;
  @CAN_RadarFC::RFC_Object::RFC_Object_Obj35.Vx = 0;
  @CAN_RadarFC::RFC_Object::RFC_Object_Obj35.VxAxCoVnce = 0;
  @CAN_RadarFC::RFC_Object::RFC_Object_Obj35.VxAyCoVnce = 0;
  @CAN_RadarFC::RFC_Object::RFC_Object_Obj35.VxVnce = 0;
  @CAN_RadarFC::RFC_Object::RFC_Object_Obj35.VxVyCoVnce = 0;
  @CAN_RadarFC::RFC_Object::RFC_Object_Obj35.Vy = 0;
  @CAN_RadarFC::RFC_Object::RFC_Object_Obj35.VyAxCoVnce = 0;
  @CAN_RadarFC::RFC_Object::RFC_Object_Obj35.VyAyCoVnce = 0;
  @CAN_RadarFC::RFC_Object::RFC_Object_Obj35.VyVnce = 0;
  @CAN_RadarFC::RFC_Object::RFC_Object_Obj35.Width = 0;
  @CAN_RadarFC::RFC_Object::RFC_Object_Obj35.WidthVnce = 0;
  @CAN_RadarFC::RFC_Object::RFC_Object_Obj36.Age = 0;
  @CAN_RadarFC::RFC_Object::RFC_Object_Obj36.Ax = 0;
  @CAN_RadarFC::RFC_Object::RFC_Object_Obj36.AxAyCoVnce = 0;
  @CAN_RadarFC::RFC_Object::RFC_Object_Obj36.AxVnce = 0;
  @CAN_RadarFC::RFC_Object::RFC_Object_Obj36.Ay = 0;
  @CAN_RadarFC::RFC_Object::RFC_Object_Obj36.AyVnce = 0;
  @CAN_RadarFC::RFC_Object::RFC_Object_Obj36.ExistProb = 0;
  @CAN_RadarFC::RFC_Object::RFC_Object_Obj36.FilterInformation = 0;
  @CAN_RadarFC::RFC_Object::RFC_Object_Obj36.Length = 0;
  @CAN_RadarFC::RFC_Object::RFC_Object_Obj36.LengthVnce = 0;
  @CAN_RadarFC::RFC_Object::RFC_Object_Obj36.MeasurementStatus = 0;
  }
  if(init_count == 49)
  {
  @CAN_RadarFC::RFC_Object::RFC_Object_Obj36.MovingStatus = 0;
  @CAN_RadarFC::RFC_Object::RFC_Object_Obj36.ObjId = 0;
  @CAN_RadarFC::RFC_Object::RFC_Object_Obj36.OrientationYaw = 0;
  @CAN_RadarFC::RFC_Object::RFC_Object_Obj36.OrientationYawVnce = 0;
  @CAN_RadarFC::RFC_Object::RFC_Object_Obj36.ProbClassConfidence = 0;
  @CAN_RadarFC::RFC_Object::RFC_Object_Obj36.ProbClassType = 0;
  @CAN_RadarFC::RFC_Object::RFC_Object_Obj36.Px = 0;
  @CAN_RadarFC::RFC_Object::RFC_Object_Obj36.PxAxCoVnce = 0;
  @CAN_RadarFC::RFC_Object::RFC_Object_Obj36.PxAyCoVnce = 0;
  @CAN_RadarFC::RFC_Object::RFC_Object_Obj36.PxPyCoVnce = 0;
  @CAN_RadarFC::RFC_Object::RFC_Object_Obj36.PxVnce = 0;
  @CAN_RadarFC::RFC_Object::RFC_Object_Obj36.PxVxCoVnce = 0;
  @CAN_RadarFC::RFC_Object::RFC_Object_Obj36.PxVyCoVnce = 0;
  @CAN_RadarFC::RFC_Object::RFC_Object_Obj36.Py = 0;
  @CAN_RadarFC::RFC_Object::RFC_Object_Obj36.PyAxCoVnce = 0;
  @CAN_RadarFC::RFC_Object::RFC_Object_Obj36.PyAyCoVnce = 0;
  @CAN_RadarFC::RFC_Object::RFC_Object_Obj36.PyVnce = 0;
  @CAN_RadarFC::RFC_Object::RFC_Object_Obj36.PyVxCoVnce = 0;
  @CAN_RadarFC::RFC_Object::RFC_Object_Obj36.PyVyCoVnce = 0;
  @CAN_RadarFC::RFC_Object::RFC_Object_Obj36.ReferencePoint = 0;
  @CAN_RadarFC::RFC_Object::RFC_Object_Obj36.Vx = 0;
  @CAN_RadarFC::RFC_Object::RFC_Object_Obj36.VxAxCoVnce = 0;
  @CAN_RadarFC::RFC_Object::RFC_Object_Obj36.VxAyCoVnce = 0;
  @CAN_RadarFC::RFC_Object::RFC_Object_Obj36.VxVnce = 0;
  @CAN_RadarFC::RFC_Object::RFC_Object_Obj36.VxVyCoVnce = 0;
  }
  if(init_count == 50)
  {
  @CAN_RadarFC::RFC_Object::RFC_Object_Obj36.Vy = 0;
  @CAN_RadarFC::RFC_Object::RFC_Object_Obj36.VyAxCoVnce = 0;
  @CAN_RadarFC::RFC_Object::RFC_Object_Obj36.VyAyCoVnce = 0;
  @CAN_RadarFC::RFC_Object::RFC_Object_Obj36.VyVnce = 0;
  @CAN_RadarFC::RFC_Object::RFC_Object_Obj36.Width = 0;
  @CAN_RadarFC::RFC_Object::RFC_Object_Obj36.WidthVnce = 0;
  @CAN_RadarFC::RFC_Object::RFC_Object_Obj37.Age = 0;
  @CAN_RadarFC::RFC_Object::RFC_Object_Obj37.Ax = 0;
  @CAN_RadarFC::RFC_Object::RFC_Object_Obj37.AxAyCoVnce = 0;
  @CAN_RadarFC::RFC_Object::RFC_Object_Obj37.AxVnce = 0;
  @CAN_RadarFC::RFC_Object::RFC_Object_Obj37.Ay = 0;
  @CAN_RadarFC::RFC_Object::RFC_Object_Obj37.AyVnce = 0;
  @CAN_RadarFC::RFC_Object::RFC_Object_Obj37.ExistProb = 0;
  @CAN_RadarFC::RFC_Object::RFC_Object_Obj37.FilterInformation = 0;
  @CAN_RadarFC::RFC_Object::RFC_Object_Obj37.Length = 0;
  @CAN_RadarFC::RFC_Object::RFC_Object_Obj37.LengthVnce = 0;
  @CAN_RadarFC::RFC_Object::RFC_Object_Obj37.MeasurementStatus = 0;
  @CAN_RadarFC::RFC_Object::RFC_Object_Obj37.MovingStatus = 0;
  @CAN_RadarFC::RFC_Object::RFC_Object_Obj37.ObjId = 0;
  @CAN_RadarFC::RFC_Object::RFC_Object_Obj37.OrientationYaw = 0;
  @CAN_RadarFC::RFC_Object::RFC_Object_Obj37.OrientationYawVnce = 0;
  @CAN_RadarFC::RFC_Object::RFC_Object_Obj37.ProbClassConfidence = 0;
  @CAN_RadarFC::RFC_Object::RFC_Object_Obj37.ProbClassType = 0;
  @CAN_RadarFC::RFC_Object::RFC_Object_Obj37.Px = 0;
  @CAN_RadarFC::RFC_Object::RFC_Object_Obj37.PxAxCoVnce = 0;
  }
  if(init_count == 51)
  {
  @CAN_RadarFC::RFC_Object::RFC_Object_Obj37.PxAyCoVnce = 0;
  @CAN_RadarFC::RFC_Object::RFC_Object_Obj37.PxPyCoVnce = 0;
  @CAN_RadarFC::RFC_Object::RFC_Object_Obj37.PxVnce = 0;
  @CAN_RadarFC::RFC_Object::RFC_Object_Obj37.PxVxCoVnce = 0;
  @CAN_RadarFC::RFC_Object::RFC_Object_Obj37.PxVyCoVnce = 0;
  @CAN_RadarFC::RFC_Object::RFC_Object_Obj37.Py = 0;
  @CAN_RadarFC::RFC_Object::RFC_Object_Obj37.PyAxCoVnce = 0;
  @CAN_RadarFC::RFC_Object::RFC_Object_Obj37.PyAyCoVnce = 0;
  @CAN_RadarFC::RFC_Object::RFC_Object_Obj37.PyVnce = 0;
  @CAN_RadarFC::RFC_Object::RFC_Object_Obj37.PyVxCoVnce = 0;
  @CAN_RadarFC::RFC_Object::RFC_Object_Obj37.PyVyCoVnce = 0;
  @CAN_RadarFC::RFC_Object::RFC_Object_Obj37.ReferencePoint = 0;
  @CAN_RadarFC::RFC_Object::RFC_Object_Obj37.Vx = 0;
  @CAN_RadarFC::RFC_Object::RFC_Object_Obj37.VxAxCoVnce = 0;
  @CAN_RadarFC::RFC_Object::RFC_Object_Obj37.VxAyCoVnce = 0;
  @CAN_RadarFC::RFC_Object::RFC_Object_Obj37.VxVnce = 0;
  @CAN_RadarFC::RFC_Object::RFC_Object_Obj37.VxVyCoVnce = 0;
  @CAN_RadarFC::RFC_Object::RFC_Object_Obj37.Vy = 0;
  @CAN_RadarFC::RFC_Object::RFC_Object_Obj37.VyAxCoVnce = 0;
  @CAN_RadarFC::RFC_Object::RFC_Object_Obj37.VyAyCoVnce = 0;
  @CAN_RadarFC::RFC_Object::RFC_Object_Obj37.VyVnce = 0;
  @CAN_RadarFC::RFC_Object::RFC_Object_Obj37.Width = 0;
  @CAN_RadarFC::RFC_Object::RFC_Object_Obj37.WidthVnce = 0;
  @CAN_RadarFC::RFC_Object::RFC_Object_Obj38.Age = 0;
  @CAN_RadarFC::RFC_Object::RFC_Object_Obj38.Ax = 0;
  }
  if(init_count == 52)
  {
  @CAN_RadarFC::RFC_Object::RFC_Object_Obj38.AxAyCoVnce = 0;
  @CAN_RadarFC::RFC_Object::RFC_Object_Obj38.AxVnce = 0;
  @CAN_RadarFC::RFC_Object::RFC_Object_Obj38.Ay = 0;
  @CAN_RadarFC::RFC_Object::RFC_Object_Obj38.AyVnce = 0;
  @CAN_RadarFC::RFC_Object::RFC_Object_Obj38.ExistProb = 0;
  @CAN_RadarFC::RFC_Object::RFC_Object_Obj38.FilterInformation = 0;
  @CAN_RadarFC::RFC_Object::RFC_Object_Obj38.Length = 0;
  @CAN_RadarFC::RFC_Object::RFC_Object_Obj38.LengthVnce = 0;
  @CAN_RadarFC::RFC_Object::RFC_Object_Obj38.MeasurementStatus = 0;
  @CAN_RadarFC::RFC_Object::RFC_Object_Obj38.MovingStatus = 0;
  @CAN_RadarFC::RFC_Object::RFC_Object_Obj38.ObjId = 0;
  @CAN_RadarFC::RFC_Object::RFC_Object_Obj38.OrientationYaw = 0;
  @CAN_RadarFC::RFC_Object::RFC_Object_Obj38.OrientationYawVnce = 0;
  @CAN_RadarFC::RFC_Object::RFC_Object_Obj38.ProbClassConfidence = 0;
  @CAN_RadarFC::RFC_Object::RFC_Object_Obj38.ProbClassType = 0;
  @CAN_RadarFC::RFC_Object::RFC_Object_Obj38.Px = 0;
  @CAN_RadarFC::RFC_Object::RFC_Object_Obj38.PxAxCoVnce = 0;
  @CAN_RadarFC::RFC_Object::RFC_Object_Obj38.PxAyCoVnce = 0;
  @CAN_RadarFC::RFC_Object::RFC_Object_Obj38.PxPyCoVnce = 0;
  @CAN_RadarFC::RFC_Object::RFC_Object_Obj38.PxVnce = 0;
  @CAN_RadarFC::RFC_Object::RFC_Object_Obj38.PxVxCoVnce = 0;
  @CAN_RadarFC::RFC_Object::RFC_Object_Obj38.PxVyCoVnce = 0;
  @CAN_RadarFC::RFC_Object::RFC_Object_Obj38.Py = 0;
  @CAN_RadarFC::RFC_Object::RFC_Object_Obj38.PyAxCoVnce = 0;
  @CAN_RadarFC::RFC_Object::RFC_Object_Obj38.PyAyCoVnce = 0;
  }
  if(init_count == 53)
  {
  @CAN_RadarFC::RFC_Object::RFC_Object_Obj38.PyVnce = 0;
  @CAN_RadarFC::RFC_Object::RFC_Object_Obj38.PyVxCoVnce = 0;
  @CAN_RadarFC::RFC_Object::RFC_Object_Obj38.PyVyCoVnce = 0;
  @CAN_RadarFC::RFC_Object::RFC_Object_Obj38.ReferencePoint = 0;
  @CAN_RadarFC::RFC_Object::RFC_Object_Obj38.Vx = 0;
  @CAN_RadarFC::RFC_Object::RFC_Object_Obj38.VxAxCoVnce = 0;
  @CAN_RadarFC::RFC_Object::RFC_Object_Obj38.VxAyCoVnce = 0;
  @CAN_RadarFC::RFC_Object::RFC_Object_Obj38.VxVnce = 0;
  @CAN_RadarFC::RFC_Object::RFC_Object_Obj38.VxVyCoVnce = 0;
  @CAN_RadarFC::RFC_Object::RFC_Object_Obj38.Vy = 0;
  @CAN_RadarFC::RFC_Object::RFC_Object_Obj38.VyAxCoVnce = 0;
  @CAN_RadarFC::RFC_Object::RFC_Object_Obj38.VyAyCoVnce = 0;
  @CAN_RadarFC::RFC_Object::RFC_Object_Obj38.VyVnce = 0;
  @CAN_RadarFC::RFC_Object::RFC_Object_Obj38.Width = 0;
  @CAN_RadarFC::RFC_Object::RFC_Object_Obj38.WidthVnce = 0;
  @CAN_RadarFC::RFC_Object::RFC_Object_Obj39.Age = 0;
  @CAN_RadarFC::RFC_Object::RFC_Object_Obj39.Ax = 0;
  @CAN_RadarFC::RFC_Object::RFC_Object_Obj39.AxAyCoVnce = 0;
  @CAN_RadarFC::RFC_Object::RFC_Object_Obj39.AxVnce = 0;
  @CAN_RadarFC::RFC_Object::RFC_Object_Obj39.Ay = 0;
  @CAN_RadarFC::RFC_Object::RFC_Object_Obj39.AyVnce = 0;
  @CAN_RadarFC::RFC_Object::RFC_Object_Obj39.ExistProb = 0;
  @CAN_RadarFC::RFC_Object::RFC_Object_Obj39.FilterInformation = 0;
  @CAN_RadarFC::RFC_Object::RFC_Object_Obj39.Length = 0;
  @CAN_RadarFC::RFC_Object::RFC_Object_Obj39.LengthVnce = 0;
  }
  if(init_count == 54)
  {
  @CAN_RadarFC::RFC_Object::RFC_Object_Obj39.MeasurementStatus = 0;
  @CAN_RadarFC::RFC_Object::RFC_Object_Obj39.MovingStatus = 0;
  @CAN_RadarFC::RFC_Object::RFC_Object_Obj39.ObjId = 0;
  @CAN_RadarFC::RFC_Object::RFC_Object_Obj39.OrientationYaw = 0;
  @CAN_RadarFC::RFC_Object::RFC_Object_Obj39.OrientationYawVnce = 0;
  @CAN_RadarFC::RFC_Object::RFC_Object_Obj39.ProbClassConfidence = 0;
  @CAN_RadarFC::RFC_Object::RFC_Object_Obj39.ProbClassType = 0;
  @CAN_RadarFC::RFC_Object::RFC_Object_Obj39.Px = 0;
  @CAN_RadarFC::RFC_Object::RFC_Object_Obj39.PxAxCoVnce = 0;
  @CAN_RadarFC::RFC_Object::RFC_Object_Obj39.PxAyCoVnce = 0;
  @CAN_RadarFC::RFC_Object::RFC_Object_Obj39.PxPyCoVnce = 0;
  @CAN_RadarFC::RFC_Object::RFC_Object_Obj39.PxVnce = 0;
  @CAN_RadarFC::RFC_Object::RFC_Object_Obj39.PxVxCoVnce = 0;
  @CAN_RadarFC::RFC_Object::RFC_Object_Obj39.PxVyCoVnce = 0;
  @CAN_RadarFC::RFC_Object::RFC_Object_Obj39.Py = 0;
  @CAN_RadarFC::RFC_Object::RFC_Object_Obj39.PyAxCoVnce = 0;
  @CAN_RadarFC::RFC_Object::RFC_Object_Obj39.PyAyCoVnce = 0;
  @CAN_RadarFC::RFC_Object::RFC_Object_Obj39.PyVnce = 0;
  @CAN_RadarFC::RFC_Object::RFC_Object_Obj39.PyVxCoVnce = 0;
  @CAN_RadarFC::RFC_Object::RFC_Object_Obj39.PyVyCoVnce = 0;
  @CAN_RadarFC::RFC_Object::RFC_Object_Obj39.ReferencePoint = 0;
  @CAN_RadarFC::RFC_Object::RFC_Object_Obj39.Vx = 0;
  @CAN_RadarFC::RFC_Object::RFC_Object_Obj39.VxAxCoVnce = 0;
  @CAN_RadarFC::RFC_Object::RFC_Object_Obj39.VxAyCoVnce = 0;
  @CAN_RadarFC::RFC_Object::RFC_Object_Obj39.VxVnce = 0;
  }
  if(init_count == 55)
  {
  @CAN_RadarFC::RFC_Object::RFC_Object_Obj39.VxVyCoVnce = 0;
  @CAN_RadarFC::RFC_Object::RFC_Object_Obj39.Vy = 0;
  @CAN_RadarFC::RFC_Object::RFC_Object_Obj39.VyAxCoVnce = 0;
  @CAN_RadarFC::RFC_Object::RFC_Object_Obj39.VyAyCoVnce = 0;
  @CAN_RadarFC::RFC_Object::RFC_Object_Obj39.VyVnce = 0;
  @CAN_RadarFC::RFC_Object::RFC_Object_Obj39.Width = 0;
  @CAN_RadarFC::RFC_Object::RFC_Object_Obj39.WidthVnce = 0;
  @CAN_RadarFC::RFC_Object::RFC_Object_Obj3.Age = 0;
  @CAN_RadarFC::RFC_Object::RFC_Object_Obj3.Ax = 0;
  @CAN_RadarFC::RFC_Object::RFC_Object_Obj3.AxAyCoVnce = 0;
  @CAN_RadarFC::RFC_Object::RFC_Object_Obj3.AxVnce = 0;
  @CAN_RadarFC::RFC_Object::RFC_Object_Obj3.Ay = 0;
  @CAN_RadarFC::RFC_Object::RFC_Object_Obj3.AyVnce = 0;
  @CAN_RadarFC::RFC_Object::RFC_Object_Obj3.ExistProb = 0;
  @CAN_RadarFC::RFC_Object::RFC_Object_Obj3.FilterInformation = 0;
  @CAN_RadarFC::RFC_Object::RFC_Object_Obj3.Length = 0;
  @CAN_RadarFC::RFC_Object::RFC_Object_Obj3.LengthVnce = 0;
  @CAN_RadarFC::RFC_Object::RFC_Object_Obj3.MeasurementStatus = 0;
  @CAN_RadarFC::RFC_Object::RFC_Object_Obj3.MovingStatus = 0;
  @CAN_RadarFC::RFC_Object::RFC_Object_Obj3.ObjId = 0;
  @CAN_RadarFC::RFC_Object::RFC_Object_Obj3.OrientationYaw = 0;
  @CAN_RadarFC::RFC_Object::RFC_Object_Obj3.OrientationYawVnce = 0;
  @CAN_RadarFC::RFC_Object::RFC_Object_Obj3.ProbClassConfidence = 0;
  @CAN_RadarFC::RFC_Object::RFC_Object_Obj3.ProbClassType = 0;
  @CAN_RadarFC::RFC_Object::RFC_Object_Obj3.Px = 0;
  }
  if(init_count == 56)
  {
  @CAN_RadarFC::RFC_Object::RFC_Object_Obj3.PxAxCoVnce = 0;
  @CAN_RadarFC::RFC_Object::RFC_Object_Obj3.PxAyCoVnce = 0;
  @CAN_RadarFC::RFC_Object::RFC_Object_Obj3.PxPyCoVnce = 0;
  @CAN_RadarFC::RFC_Object::RFC_Object_Obj3.PxVnce = 0;
  @CAN_RadarFC::RFC_Object::RFC_Object_Obj3.PxVxCoVnce = 0;
  @CAN_RadarFC::RFC_Object::RFC_Object_Obj3.PxVyCoVnce = 0;
  @CAN_RadarFC::RFC_Object::RFC_Object_Obj3.Py = 0;
  @CAN_RadarFC::RFC_Object::RFC_Object_Obj3.PyAxCoVnce = 0;
  @CAN_RadarFC::RFC_Object::RFC_Object_Obj3.PyAyCoVnce = 0;
  @CAN_RadarFC::RFC_Object::RFC_Object_Obj3.PyVnce = 0;
  @CAN_RadarFC::RFC_Object::RFC_Object_Obj3.PyVxCoVnce = 0;
  @CAN_RadarFC::RFC_Object::RFC_Object_Obj3.PyVyCoVnce = 0;
  @CAN_RadarFC::RFC_Object::RFC_Object_Obj3.ReferencePoint = 0;
  @CAN_RadarFC::RFC_Object::RFC_Object_Obj3.Vx = 0;
  @CAN_RadarFC::RFC_Object::RFC_Object_Obj3.VxAxCoVnce = 0;
  @CAN_RadarFC::RFC_Object::RFC_Object_Obj3.VxAyCoVnce = 0;
  @CAN_RadarFC::RFC_Object::RFC_Object_Obj3.VxVnce = 0;
  @CAN_RadarFC::RFC_Object::RFC_Object_Obj3.VxVyCoVnce = 0;
  @CAN_RadarFC::RFC_Object::RFC_Object_Obj3.Vy = 0;
  @CAN_RadarFC::RFC_Object::RFC_Object_Obj3.VyAxCoVnce = 0;
  @CAN_RadarFC::RFC_Object::RFC_Object_Obj3.VyAyCoVnce = 0;
  @CAN_RadarFC::RFC_Object::RFC_Object_Obj3.VyVnce = 0;
  @CAN_RadarFC::RFC_Object::RFC_Object_Obj3.Width = 0;
  @CAN_RadarFC::RFC_Object::RFC_Object_Obj3.WidthVnce = 0;
  @CAN_RadarFC::RFC_Object::RFC_Object_Obj40.Age = 0;
  }
  if(init_count == 57)
  {
  @CAN_RadarFC::RFC_Object::RFC_Object_Obj40.Ax = 0;
  @CAN_RadarFC::RFC_Object::RFC_Object_Obj40.AxAyCoVnce = 0;
  @CAN_RadarFC::RFC_Object::RFC_Object_Obj40.AxVnce = 0;
  @CAN_RadarFC::RFC_Object::RFC_Object_Obj40.Ay = 0;
  @CAN_RadarFC::RFC_Object::RFC_Object_Obj40.AyVnce = 0;
  @CAN_RadarFC::RFC_Object::RFC_Object_Obj40.ExistProb = 0;
  @CAN_RadarFC::RFC_Object::RFC_Object_Obj40.FilterInformation = 0;
  @CAN_RadarFC::RFC_Object::RFC_Object_Obj40.Length = 0;
  @CAN_RadarFC::RFC_Object::RFC_Object_Obj40.LengthVnce = 0;
  @CAN_RadarFC::RFC_Object::RFC_Object_Obj40.MeasurementStatus = 0;
  @CAN_RadarFC::RFC_Object::RFC_Object_Obj40.MovingStatus = 0;
  @CAN_RadarFC::RFC_Object::RFC_Object_Obj40.ObjId = 0;
  @CAN_RadarFC::RFC_Object::RFC_Object_Obj40.OrientationYaw = 0;
  @CAN_RadarFC::RFC_Object::RFC_Object_Obj40.OrientationYawVnce = 0;
  @CAN_RadarFC::RFC_Object::RFC_Object_Obj40.ProbClassConfidence = 0;
  @CAN_RadarFC::RFC_Object::RFC_Object_Obj40.ProbClassType = 0;
  @CAN_RadarFC::RFC_Object::RFC_Object_Obj40.Px = 0;
  @CAN_RadarFC::RFC_Object::RFC_Object_Obj40.PxAxCoVnce = 0;
  @CAN_RadarFC::RFC_Object::RFC_Object_Obj40.PxAyCoVnce = 0;
  @CAN_RadarFC::RFC_Object::RFC_Object_Obj40.PxPyCoVnce = 0;
  @CAN_RadarFC::RFC_Object::RFC_Object_Obj40.PxVnce = 0;
  @CAN_RadarFC::RFC_Object::RFC_Object_Obj40.PxVxCoVnce = 0;
  @CAN_RadarFC::RFC_Object::RFC_Object_Obj40.PxVyCoVnce = 0;
  @CAN_RadarFC::RFC_Object::RFC_Object_Obj40.Py = 0;
  @CAN_RadarFC::RFC_Object::RFC_Object_Obj40.PyAxCoVnce = 0;
  }
  if(init_count == 58)
  {
  @CAN_RadarFC::RFC_Object::RFC_Object_Obj40.PyAyCoVnce = 0;
  @CAN_RadarFC::RFC_Object::RFC_Object_Obj40.PyVnce = 0;
  @CAN_RadarFC::RFC_Object::RFC_Object_Obj40.PyVxCoVnce = 0;
  @CAN_RadarFC::RFC_Object::RFC_Object_Obj40.PyVyCoVnce = 0;
  @CAN_RadarFC::RFC_Object::RFC_Object_Obj40.ReferencePoint = 0;
  @CAN_RadarFC::RFC_Object::RFC_Object_Obj40.Vx = 0;
  @CAN_RadarFC::RFC_Object::RFC_Object_Obj40.VxAxCoVnce = 0;
  @CAN_RadarFC::RFC_Object::RFC_Object_Obj40.VxAyCoVnce = 0;
  @CAN_RadarFC::RFC_Object::RFC_Object_Obj40.VxVnce = 0;
  @CAN_RadarFC::RFC_Object::RFC_Object_Obj40.VxVyCoVnce = 0;
  @CAN_RadarFC::RFC_Object::RFC_Object_Obj40.Vy = 0;
  @CAN_RadarFC::RFC_Object::RFC_Object_Obj40.VyAxCoVnce = 0;
  @CAN_RadarFC::RFC_Object::RFC_Object_Obj40.VyAyCoVnce = 0;
  @CAN_RadarFC::RFC_Object::RFC_Object_Obj40.VyVnce = 0;
  @CAN_RadarFC::RFC_Object::RFC_Object_Obj40.Width = 0;
  @CAN_RadarFC::RFC_Object::RFC_Object_Obj40.WidthVnce = 0;
  @CAN_RadarFC::RFC_Object::RFC_Object_Obj41.Age = 0;
  @CAN_RadarFC::RFC_Object::RFC_Object_Obj41.Ax = 0;
  @CAN_RadarFC::RFC_Object::RFC_Object_Obj41.AxAyCoVnce = 0;
  @CAN_RadarFC::RFC_Object::RFC_Object_Obj41.AxVnce = 0;
  @CAN_RadarFC::RFC_Object::RFC_Object_Obj41.Ay = 0;
  @CAN_RadarFC::RFC_Object::RFC_Object_Obj41.AyVnce = 0;
  @CAN_RadarFC::RFC_Object::RFC_Object_Obj41.ExistProb = 0;
  @CAN_RadarFC::RFC_Object::RFC_Object_Obj41.FilterInformation = 0;
  @CAN_RadarFC::RFC_Object::RFC_Object_Obj41.Length = 0;
  }
  if(init_count == 59)
  {
  @CAN_RadarFC::RFC_Object::RFC_Object_Obj41.LengthVnce = 0;
  @CAN_RadarFC::RFC_Object::RFC_Object_Obj41.MeasurementStatus = 0;
  @CAN_RadarFC::RFC_Object::RFC_Object_Obj41.MovingStatus = 0;
  @CAN_RadarFC::RFC_Object::RFC_Object_Obj41.ObjId = 0;
  @CAN_RadarFC::RFC_Object::RFC_Object_Obj41.OrientationYaw = 0;
  @CAN_RadarFC::RFC_Object::RFC_Object_Obj41.OrientationYawVnce = 0;
  @CAN_RadarFC::RFC_Object::RFC_Object_Obj41.ProbClassConfidence = 0;
  @CAN_RadarFC::RFC_Object::RFC_Object_Obj41.ProbClassType = 0;
  @CAN_RadarFC::RFC_Object::RFC_Object_Obj41.Px = 0;
  @CAN_RadarFC::RFC_Object::RFC_Object_Obj41.PxAxCoVnce = 0;
  @CAN_RadarFC::RFC_Object::RFC_Object_Obj41.PxAyCoVnce = 0;
  @CAN_RadarFC::RFC_Object::RFC_Object_Obj41.PxPyCoVnce = 0;
  @CAN_RadarFC::RFC_Object::RFC_Object_Obj41.PxVnce = 0;
  @CAN_RadarFC::RFC_Object::RFC_Object_Obj41.PxVxCoVnce = 0;
  @CAN_RadarFC::RFC_Object::RFC_Object_Obj41.PxVyCoVnce = 0;
  @CAN_RadarFC::RFC_Object::RFC_Object_Obj41.Py = 0;
  @CAN_RadarFC::RFC_Object::RFC_Object_Obj41.PyAxCoVnce = 0;
  @CAN_RadarFC::RFC_Object::RFC_Object_Obj41.PyAyCoVnce = 0;
  @CAN_RadarFC::RFC_Object::RFC_Object_Obj41.PyVnce = 0;
  @CAN_RadarFC::RFC_Object::RFC_Object_Obj41.PyVxCoVnce = 0;
  @CAN_RadarFC::RFC_Object::RFC_Object_Obj41.PyVyCoVnce = 0;
  @CAN_RadarFC::RFC_Object::RFC_Object_Obj41.ReferencePoint = 0;
  @CAN_RadarFC::RFC_Object::RFC_Object_Obj41.Vx = 0;
  @CAN_RadarFC::RFC_Object::RFC_Object_Obj41.VxAxCoVnce = 0;
  @CAN_RadarFC::RFC_Object::RFC_Object_Obj41.VxAyCoVnce = 0;
  }
  if(init_count == 60)
  {
  @CAN_RadarFC::RFC_Object::RFC_Object_Obj41.VxVnce = 0;
  @CAN_RadarFC::RFC_Object::RFC_Object_Obj41.VxVyCoVnce = 0;
  @CAN_RadarFC::RFC_Object::RFC_Object_Obj41.Vy = 0;
  @CAN_RadarFC::RFC_Object::RFC_Object_Obj41.VyAxCoVnce = 0;
  @CAN_RadarFC::RFC_Object::RFC_Object_Obj41.VyAyCoVnce = 0;
  @CAN_RadarFC::RFC_Object::RFC_Object_Obj41.VyVnce = 0;
  @CAN_RadarFC::RFC_Object::RFC_Object_Obj41.Width = 0;
  @CAN_RadarFC::RFC_Object::RFC_Object_Obj41.WidthVnce = 0;
  @CAN_RadarFC::RFC_Object::RFC_Object_Obj42.Age = 0;
  @CAN_RadarFC::RFC_Object::RFC_Object_Obj42.Ax = 0;
  @CAN_RadarFC::RFC_Object::RFC_Object_Obj42.AxAyCoVnce = 0;
  @CAN_RadarFC::RFC_Object::RFC_Object_Obj42.AxVnce = 0;
  @CAN_RadarFC::RFC_Object::RFC_Object_Obj42.Ay = 0;
  @CAN_RadarFC::RFC_Object::RFC_Object_Obj42.AyVnce = 0;
  @CAN_RadarFC::RFC_Object::RFC_Object_Obj42.ExistProb = 0;
  @CAN_RadarFC::RFC_Object::RFC_Object_Obj42.FilterInformation = 0;
  @CAN_RadarFC::RFC_Object::RFC_Object_Obj42.Length = 0;
  @CAN_RadarFC::RFC_Object::RFC_Object_Obj42.LengthVnce = 0;
  @CAN_RadarFC::RFC_Object::RFC_Object_Obj42.MeasurementStatus = 0;
  @CAN_RadarFC::RFC_Object::RFC_Object_Obj42.MovingStatus = 0;
  @CAN_RadarFC::RFC_Object::RFC_Object_Obj42.ObjId = 0;
  @CAN_RadarFC::RFC_Object::RFC_Object_Obj42.OrientationYaw = 0;
  @CAN_RadarFC::RFC_Object::RFC_Object_Obj42.OrientationYawVnce = 0;
  @CAN_RadarFC::RFC_Object::RFC_Object_Obj42.ProbClassConfidence = 0;
  @CAN_RadarFC::RFC_Object::RFC_Object_Obj42.ProbClassType = 0;
  }
  if(init_count == 61)
  {
  @CAN_RadarFC::RFC_Object::RFC_Object_Obj42.Px = 0;
  @CAN_RadarFC::RFC_Object::RFC_Object_Obj42.PxAxCoVnce = 0;
  @CAN_RadarFC::RFC_Object::RFC_Object_Obj42.PxAyCoVnce = 0;
  @CAN_RadarFC::RFC_Object::RFC_Object_Obj42.PxPyCoVnce = 0;
  @CAN_RadarFC::RFC_Object::RFC_Object_Obj42.PxVnce = 0;
  @CAN_RadarFC::RFC_Object::RFC_Object_Obj42.PxVxCoVnce = 0;
  @CAN_RadarFC::RFC_Object::RFC_Object_Obj42.PxVyCoVnce = 0;
  @CAN_RadarFC::RFC_Object::RFC_Object_Obj42.Py = 0;
  @CAN_RadarFC::RFC_Object::RFC_Object_Obj42.PyAxCoVnce = 0;
  @CAN_RadarFC::RFC_Object::RFC_Object_Obj42.PyAyCoVnce = 0;
  @CAN_RadarFC::RFC_Object::RFC_Object_Obj42.PyVnce = 0;
  @CAN_RadarFC::RFC_Object::RFC_Object_Obj42.PyVxCoVnce = 0;
  @CAN_RadarFC::RFC_Object::RFC_Object_Obj42.PyVyCoVnce = 0;
  @CAN_RadarFC::RFC_Object::RFC_Object_Obj42.ReferencePoint = 0;
  @CAN_RadarFC::RFC_Object::RFC_Object_Obj42.Vx = 0;
  @CAN_RadarFC::RFC_Object::RFC_Object_Obj42.VxAxCoVnce = 0;
  @CAN_RadarFC::RFC_Object::RFC_Object_Obj42.VxAyCoVnce = 0;
  @CAN_RadarFC::RFC_Object::RFC_Object_Obj42.VxVnce = 0;
  @CAN_RadarFC::RFC_Object::RFC_Object_Obj42.VxVyCoVnce = 0;
  @CAN_RadarFC::RFC_Object::RFC_Object_Obj42.Vy = 0;
  @CAN_RadarFC::RFC_Object::RFC_Object_Obj42.VyAxCoVnce = 0;
  @CAN_RadarFC::RFC_Object::RFC_Object_Obj42.VyAyCoVnce = 0;
  @CAN_RadarFC::RFC_Object::RFC_Object_Obj42.VyVnce = 0;
  @CAN_RadarFC::RFC_Object::RFC_Object_Obj42.Width = 0;
  @CAN_RadarFC::RFC_Object::RFC_Object_Obj42.WidthVnce = 0;
  }
  if(init_count == 62)
  {
  @CAN_RadarFC::RFC_Object::RFC_Object_Obj43.Age = 0;
  @CAN_RadarFC::RFC_Object::RFC_Object_Obj43.Ax = 0;
  @CAN_RadarFC::RFC_Object::RFC_Object_Obj43.AxAyCoVnce = 0;
  @CAN_RadarFC::RFC_Object::RFC_Object_Obj43.AxVnce = 0;
  @CAN_RadarFC::RFC_Object::RFC_Object_Obj43.Ay = 0;
  @CAN_RadarFC::RFC_Object::RFC_Object_Obj43.AyVnce = 0;
  @CAN_RadarFC::RFC_Object::RFC_Object_Obj43.ExistProb = 0;
  @CAN_RadarFC::RFC_Object::RFC_Object_Obj43.FilterInformation = 0;
  @CAN_RadarFC::RFC_Object::RFC_Object_Obj43.Length = 0;
  @CAN_RadarFC::RFC_Object::RFC_Object_Obj43.LengthVnce = 0;
  @CAN_RadarFC::RFC_Object::RFC_Object_Obj43.MeasurementStatus = 0;
  @CAN_RadarFC::RFC_Object::RFC_Object_Obj43.MovingStatus = 0;
  @CAN_RadarFC::RFC_Object::RFC_Object_Obj43.ObjId = 0;
  @CAN_RadarFC::RFC_Object::RFC_Object_Obj43.OrientationYaw = 0;
  @CAN_RadarFC::RFC_Object::RFC_Object_Obj43.OrientationYawVnce = 0;
  @CAN_RadarFC::RFC_Object::RFC_Object_Obj43.ProbClassConfidence = 0;
  @CAN_RadarFC::RFC_Object::RFC_Object_Obj43.ProbClassType = 0;
  @CAN_RadarFC::RFC_Object::RFC_Object_Obj43.Px = 0;
  @CAN_RadarFC::RFC_Object::RFC_Object_Obj43.PxAxCoVnce = 0;
  @CAN_RadarFC::RFC_Object::RFC_Object_Obj43.PxAyCoVnce = 0;
  @CAN_RadarFC::RFC_Object::RFC_Object_Obj43.PxPyCoVnce = 0;
  @CAN_RadarFC::RFC_Object::RFC_Object_Obj43.PxVnce = 0;
  @CAN_RadarFC::RFC_Object::RFC_Object_Obj43.PxVxCoVnce = 0;
  @CAN_RadarFC::RFC_Object::RFC_Object_Obj43.PxVyCoVnce = 0;
  @CAN_RadarFC::RFC_Object::RFC_Object_Obj43.Py = 0;
  }
  if(init_count == 63)
  {
  @CAN_RadarFC::RFC_Object::RFC_Object_Obj43.PyAxCoVnce = 0;
  @CAN_RadarFC::RFC_Object::RFC_Object_Obj43.PyAyCoVnce = 0;
  @CAN_RadarFC::RFC_Object::RFC_Object_Obj43.PyVnce = 0;
  @CAN_RadarFC::RFC_Object::RFC_Object_Obj43.PyVxCoVnce = 0;
  @CAN_RadarFC::RFC_Object::RFC_Object_Obj43.PyVyCoVnce = 0;
  @CAN_RadarFC::RFC_Object::RFC_Object_Obj43.ReferencePoint = 0;
  @CAN_RadarFC::RFC_Object::RFC_Object_Obj43.Vx = 0;
  @CAN_RadarFC::RFC_Object::RFC_Object_Obj43.VxAxCoVnce = 0;
  @CAN_RadarFC::RFC_Object::RFC_Object_Obj43.VxAyCoVnce = 0;
  @CAN_RadarFC::RFC_Object::RFC_Object_Obj43.VxVnce = 0;
  @CAN_RadarFC::RFC_Object::RFC_Object_Obj43.VxVyCoVnce = 0;
  @CAN_RadarFC::RFC_Object::RFC_Object_Obj43.Vy = 0;
  @CAN_RadarFC::RFC_Object::RFC_Object_Obj43.VyAxCoVnce = 0;
  @CAN_RadarFC::RFC_Object::RFC_Object_Obj43.VyAyCoVnce = 0;
  @CAN_RadarFC::RFC_Object::RFC_Object_Obj43.VyVnce = 0;
  @CAN_RadarFC::RFC_Object::RFC_Object_Obj43.Width = 0;
  @CAN_RadarFC::RFC_Object::RFC_Object_Obj43.WidthVnce = 0;
  @CAN_RadarFC::RFC_Object::RFC_Object_Obj44.Age = 0;
  @CAN_RadarFC::RFC_Object::RFC_Object_Obj44.Ax = 0;
  @CAN_RadarFC::RFC_Object::RFC_Object_Obj44.AxAyCoVnce = 0;
  @CAN_RadarFC::RFC_Object::RFC_Object_Obj44.AxVnce = 0;
  @CAN_RadarFC::RFC_Object::RFC_Object_Obj44.Ay = 0;
  @CAN_RadarFC::RFC_Object::RFC_Object_Obj44.AyVnce = 0;
  @CAN_RadarFC::RFC_Object::RFC_Object_Obj44.ExistProb = 0;
  @CAN_RadarFC::RFC_Object::RFC_Object_Obj44.FilterInformation = 0;
  }
  if(init_count == 64)
  {
  @CAN_RadarFC::RFC_Object::RFC_Object_Obj44.Length = 0;
  @CAN_RadarFC::RFC_Object::RFC_Object_Obj44.LengthVnce = 0;
  @CAN_RadarFC::RFC_Object::RFC_Object_Obj44.MeasurementStatus = 0;
  @CAN_RadarFC::RFC_Object::RFC_Object_Obj44.MovingStatus = 0;
  @CAN_RadarFC::RFC_Object::RFC_Object_Obj44.ObjId = 0;
  @CAN_RadarFC::RFC_Object::RFC_Object_Obj44.OrientationYaw = 0;
  @CAN_RadarFC::RFC_Object::RFC_Object_Obj44.OrientationYawVnce = 0;
  @CAN_RadarFC::RFC_Object::RFC_Object_Obj44.ProbClassConfidence = 0;
  @CAN_RadarFC::RFC_Object::RFC_Object_Obj44.ProbClassType = 0;
  @CAN_RadarFC::RFC_Object::RFC_Object_Obj44.Px = 0;
  @CAN_RadarFC::RFC_Object::RFC_Object_Obj44.PxAxCoVnce = 0;
  @CAN_RadarFC::RFC_Object::RFC_Object_Obj44.PxAyCoVnce = 0;
  @CAN_RadarFC::RFC_Object::RFC_Object_Obj44.PxPyCoVnce = 0;
  @CAN_RadarFC::RFC_Object::RFC_Object_Obj44.PxVnce = 0;
  @CAN_RadarFC::RFC_Object::RFC_Object_Obj44.PxVxCoVnce = 0;
  @CAN_RadarFC::RFC_Object::RFC_Object_Obj44.PxVyCoVnce = 0;
  @CAN_RadarFC::RFC_Object::RFC_Object_Obj44.Py = 0;
  @CAN_RadarFC::RFC_Object::RFC_Object_Obj44.PyAxCoVnce = 0;
  @CAN_RadarFC::RFC_Object::RFC_Object_Obj44.PyAyCoVnce = 0;
  @CAN_RadarFC::RFC_Object::RFC_Object_Obj44.PyVnce = 0;
  @CAN_RadarFC::RFC_Object::RFC_Object_Obj44.PyVxCoVnce = 0;
  @CAN_RadarFC::RFC_Object::RFC_Object_Obj44.PyVyCoVnce = 0;
  @CAN_RadarFC::RFC_Object::RFC_Object_Obj44.ReferencePoint = 0;
  @CAN_RadarFC::RFC_Object::RFC_Object_Obj44.Vx = 0;
  @CAN_RadarFC::RFC_Object::RFC_Object_Obj44.VxAxCoVnce = 0;
  }
  if(init_count == 65)
  {
  @CAN_RadarFC::RFC_Object::RFC_Object_Obj44.VxAyCoVnce = 0;
  @CAN_RadarFC::RFC_Object::RFC_Object_Obj44.VxVnce = 0;
  @CAN_RadarFC::RFC_Object::RFC_Object_Obj44.VxVyCoVnce = 0;
  @CAN_RadarFC::RFC_Object::RFC_Object_Obj44.Vy = 0;
  @CAN_RadarFC::RFC_Object::RFC_Object_Obj44.VyAxCoVnce = 0;
  @CAN_RadarFC::RFC_Object::RFC_Object_Obj44.VyAyCoVnce = 0;
  @CAN_RadarFC::RFC_Object::RFC_Object_Obj44.VyVnce = 0;
  @CAN_RadarFC::RFC_Object::RFC_Object_Obj44.Width = 0;
  @CAN_RadarFC::RFC_Object::RFC_Object_Obj44.WidthVnce = 0;
  @CAN_RadarFC::RFC_Object::RFC_Object_Obj45.Age = 0;
  @CAN_RadarFC::RFC_Object::RFC_Object_Obj45.Ax = 0;
  @CAN_RadarFC::RFC_Object::RFC_Object_Obj45.AxAyCoVnce = 0;
  @CAN_RadarFC::RFC_Object::RFC_Object_Obj45.AxVnce = 0;
  @CAN_RadarFC::RFC_Object::RFC_Object_Obj45.Ay = 0;
  @CAN_RadarFC::RFC_Object::RFC_Object_Obj45.AyVnce = 0;
  @CAN_RadarFC::RFC_Object::RFC_Object_Obj45.ExistProb = 0;
  @CAN_RadarFC::RFC_Object::RFC_Object_Obj45.FilterInformation = 0;
  @CAN_RadarFC::RFC_Object::RFC_Object_Obj45.Length = 0;
  @CAN_RadarFC::RFC_Object::RFC_Object_Obj45.LengthVnce = 0;
  @CAN_RadarFC::RFC_Object::RFC_Object_Obj45.MeasurementStatus = 0;
  @CAN_RadarFC::RFC_Object::RFC_Object_Obj45.MovingStatus = 0;
  @CAN_RadarFC::RFC_Object::RFC_Object_Obj45.ObjId = 0;
  @CAN_RadarFC::RFC_Object::RFC_Object_Obj45.OrientationYaw = 0;
  @CAN_RadarFC::RFC_Object::RFC_Object_Obj45.OrientationYawVnce = 0;
  @CAN_RadarFC::RFC_Object::RFC_Object_Obj45.ProbClassConfidence = 0;
  }
  if(init_count == 66)
  {
  @CAN_RadarFC::RFC_Object::RFC_Object_Obj45.ProbClassType = 0;
  @CAN_RadarFC::RFC_Object::RFC_Object_Obj45.Px = 0;
  @CAN_RadarFC::RFC_Object::RFC_Object_Obj45.PxAxCoVnce = 0;
  @CAN_RadarFC::RFC_Object::RFC_Object_Obj45.PxAyCoVnce = 0;
  @CAN_RadarFC::RFC_Object::RFC_Object_Obj45.PxPyCoVnce = 0;
  @CAN_RadarFC::RFC_Object::RFC_Object_Obj45.PxVnce = 0;
  @CAN_RadarFC::RFC_Object::RFC_Object_Obj45.PxVxCoVnce = 0;
  @CAN_RadarFC::RFC_Object::RFC_Object_Obj45.PxVyCoVnce = 0;
  @CAN_RadarFC::RFC_Object::RFC_Object_Obj45.Py = 0;
  @CAN_RadarFC::RFC_Object::RFC_Object_Obj45.PyAxCoVnce = 0;
  @CAN_RadarFC::RFC_Object::RFC_Object_Obj45.PyAyCoVnce = 0;
  @CAN_RadarFC::RFC_Object::RFC_Object_Obj45.PyVnce = 0;
  @CAN_RadarFC::RFC_Object::RFC_Object_Obj45.PyVxCoVnce = 0;
  @CAN_RadarFC::RFC_Object::RFC_Object_Obj45.PyVyCoVnce = 0;
  @CAN_RadarFC::RFC_Object::RFC_Object_Obj45.ReferencePoint = 0;
  @CAN_RadarFC::RFC_Object::RFC_Object_Obj45.Vx = 0;
  @CAN_RadarFC::RFC_Object::RFC_Object_Obj45.VxAxCoVnce = 0;
  @CAN_RadarFC::RFC_Object::RFC_Object_Obj45.VxAyCoVnce = 0;
  @CAN_RadarFC::RFC_Object::RFC_Object_Obj45.VxVnce = 0;
  @CAN_RadarFC::RFC_Object::RFC_Object_Obj45.VxVyCoVnce = 0;
  @CAN_RadarFC::RFC_Object::RFC_Object_Obj45.Vy = 0;
  @CAN_RadarFC::RFC_Object::RFC_Object_Obj45.VyAxCoVnce = 0;
  @CAN_RadarFC::RFC_Object::RFC_Object_Obj45.VyAyCoVnce = 0;
  @CAN_RadarFC::RFC_Object::RFC_Object_Obj45.VyVnce = 0;
  @CAN_RadarFC::RFC_Object::RFC_Object_Obj45.Width = 0;
  }
  if(init_count == 67)
  {
  @CAN_RadarFC::RFC_Object::RFC_Object_Obj45.WidthVnce = 0;
  @CAN_RadarFC::RFC_Object::RFC_Object_Obj46.Age = 0;
  @CAN_RadarFC::RFC_Object::RFC_Object_Obj46.Ax = 0;
  @CAN_RadarFC::RFC_Object::RFC_Object_Obj46.AxAyCoVnce = 0;
  @CAN_RadarFC::RFC_Object::RFC_Object_Obj46.AxVnce = 0;
  @CAN_RadarFC::RFC_Object::RFC_Object_Obj46.Ay = 0;
  @CAN_RadarFC::RFC_Object::RFC_Object_Obj46.AyVnce = 0;
  @CAN_RadarFC::RFC_Object::RFC_Object_Obj46.ExistProb = 0;
  @CAN_RadarFC::RFC_Object::RFC_Object_Obj46.FilterInformation = 0;
  @CAN_RadarFC::RFC_Object::RFC_Object_Obj46.Length = 0;
  @CAN_RadarFC::RFC_Object::RFC_Object_Obj46.LengthVnce = 0;
  @CAN_RadarFC::RFC_Object::RFC_Object_Obj46.MeasurementStatus = 0;
  @CAN_RadarFC::RFC_Object::RFC_Object_Obj46.MovingStatus = 0;
  @CAN_RadarFC::RFC_Object::RFC_Object_Obj46.ObjId = 0;
  @CAN_RadarFC::RFC_Object::RFC_Object_Obj46.OrientationYaw = 0;
  @CAN_RadarFC::RFC_Object::RFC_Object_Obj46.OrientationYawVnce = 0;
  @CAN_RadarFC::RFC_Object::RFC_Object_Obj46.ProbClassConfidence = 0;
  @CAN_RadarFC::RFC_Object::RFC_Object_Obj46.ProbClassType = 0;
  @CAN_RadarFC::RFC_Object::RFC_Object_Obj46.Px = 0;
  @CAN_RadarFC::RFC_Object::RFC_Object_Obj46.PxAxCoVnce = 0;
  @CAN_RadarFC::RFC_Object::RFC_Object_Obj46.PxAyCoVnce = 0;
  @CAN_RadarFC::RFC_Object::RFC_Object_Obj46.PxPyCoVnce = 0;
  @CAN_RadarFC::RFC_Object::RFC_Object_Obj46.PxVnce = 0;
  @CAN_RadarFC::RFC_Object::RFC_Object_Obj46.PxVxCoVnce = 0;
  @CAN_RadarFC::RFC_Object::RFC_Object_Obj46.PxVyCoVnce = 0;
  }
  if(init_count == 68)
  {
  @CAN_RadarFC::RFC_Object::RFC_Object_Obj46.Py = 0;
  @CAN_RadarFC::RFC_Object::RFC_Object_Obj46.PyAxCoVnce = 0;
  @CAN_RadarFC::RFC_Object::RFC_Object_Obj46.PyAyCoVnce = 0;
  @CAN_RadarFC::RFC_Object::RFC_Object_Obj46.PyVnce = 0;
  @CAN_RadarFC::RFC_Object::RFC_Object_Obj46.PyVxCoVnce = 0;
  @CAN_RadarFC::RFC_Object::RFC_Object_Obj46.PyVyCoVnce = 0;
  @CAN_RadarFC::RFC_Object::RFC_Object_Obj46.ReferencePoint = 0;
  @CAN_RadarFC::RFC_Object::RFC_Object_Obj46.Vx = 0;
  @CAN_RadarFC::RFC_Object::RFC_Object_Obj46.VxAxCoVnce = 0;
  @CAN_RadarFC::RFC_Object::RFC_Object_Obj46.VxAyCoVnce = 0;
  @CAN_RadarFC::RFC_Object::RFC_Object_Obj46.VxVnce = 0;
  @CAN_RadarFC::RFC_Object::RFC_Object_Obj46.VxVyCoVnce = 0;
  @CAN_RadarFC::RFC_Object::RFC_Object_Obj46.Vy = 0;
  @CAN_RadarFC::RFC_Object::RFC_Object_Obj46.VyAxCoVnce = 0;
  @CAN_RadarFC::RFC_Object::RFC_Object_Obj46.VyAyCoVnce = 0;
  @CAN_RadarFC::RFC_Object::RFC_Object_Obj46.VyVnce = 0;
  @CAN_RadarFC::RFC_Object::RFC_Object_Obj46.Width = 0;
  @CAN_RadarFC::RFC_Object::RFC_Object_Obj46.WidthVnce = 0;
  @CAN_RadarFC::RFC_Object::RFC_Object_Obj47.Age = 0;
  @CAN_RadarFC::RFC_Object::RFC_Object_Obj47.Ax = 0;
  @CAN_RadarFC::RFC_Object::RFC_Object_Obj47.AxAyCoVnce = 0;
  @CAN_RadarFC::RFC_Object::RFC_Object_Obj47.AxVnce = 0;
  @CAN_RadarFC::RFC_Object::RFC_Object_Obj47.Ay = 0;
  @CAN_RadarFC::RFC_Object::RFC_Object_Obj47.AyVnce = 0;
  @CAN_RadarFC::RFC_Object::RFC_Object_Obj47.ExistProb = 0;
  }
  if(init_count == 69)
  {
  @CAN_RadarFC::RFC_Object::RFC_Object_Obj47.FilterInformation = 0;
  @CAN_RadarFC::RFC_Object::RFC_Object_Obj47.Length = 0;
  @CAN_RadarFC::RFC_Object::RFC_Object_Obj47.LengthVnce = 0;
  @CAN_RadarFC::RFC_Object::RFC_Object_Obj47.MeasurementStatus = 0;
  @CAN_RadarFC::RFC_Object::RFC_Object_Obj47.MovingStatus = 0;
  @CAN_RadarFC::RFC_Object::RFC_Object_Obj47.ObjId = 0;
  @CAN_RadarFC::RFC_Object::RFC_Object_Obj47.OrientationYaw = 0;
  @CAN_RadarFC::RFC_Object::RFC_Object_Obj47.OrientationYawVnce = 0;
  @CAN_RadarFC::RFC_Object::RFC_Object_Obj47.ProbClassConfidence = 0;
  @CAN_RadarFC::RFC_Object::RFC_Object_Obj47.ProbClassType = 0;
  @CAN_RadarFC::RFC_Object::RFC_Object_Obj47.Px = 0;
  @CAN_RadarFC::RFC_Object::RFC_Object_Obj47.PxAxCoVnce = 0;
  @CAN_RadarFC::RFC_Object::RFC_Object_Obj47.PxAyCoVnce = 0;
  @CAN_RadarFC::RFC_Object::RFC_Object_Obj47.PxPyCoVnce = 0;
  @CAN_RadarFC::RFC_Object::RFC_Object_Obj47.PxVnce = 0;
  @CAN_RadarFC::RFC_Object::RFC_Object_Obj47.PxVxCoVnce = 0;
  @CAN_RadarFC::RFC_Object::RFC_Object_Obj47.PxVyCoVnce = 0;
  @CAN_RadarFC::RFC_Object::RFC_Object_Obj47.Py = 0;
  @CAN_RadarFC::RFC_Object::RFC_Object_Obj47.PyAxCoVnce = 0;
  @CAN_RadarFC::RFC_Object::RFC_Object_Obj47.PyAyCoVnce = 0;
  @CAN_RadarFC::RFC_Object::RFC_Object_Obj47.PyVnce = 0;
  @CAN_RadarFC::RFC_Object::RFC_Object_Obj47.PyVxCoVnce = 0;
  @CAN_RadarFC::RFC_Object::RFC_Object_Obj47.PyVyCoVnce = 0;
  @CAN_RadarFC::RFC_Object::RFC_Object_Obj47.ReferencePoint = 0;
  @CAN_RadarFC::RFC_Object::RFC_Object_Obj47.Vx = 0;
  }
  if(init_count == 70)
  {
  @CAN_RadarFC::RFC_Object::RFC_Object_Obj47.VxAxCoVnce = 0;
  @CAN_RadarFC::RFC_Object::RFC_Object_Obj47.VxAyCoVnce = 0;
  @CAN_RadarFC::RFC_Object::RFC_Object_Obj47.VxVnce = 0;
  @CAN_RadarFC::RFC_Object::RFC_Object_Obj47.VxVyCoVnce = 0;
  @CAN_RadarFC::RFC_Object::RFC_Object_Obj47.Vy = 0;
  @CAN_RadarFC::RFC_Object::RFC_Object_Obj47.VyAxCoVnce = 0;
  @CAN_RadarFC::RFC_Object::RFC_Object_Obj47.VyAyCoVnce = 0;
  @CAN_RadarFC::RFC_Object::RFC_Object_Obj47.VyVnce = 0;
  @CAN_RadarFC::RFC_Object::RFC_Object_Obj47.Width = 0;
  @CAN_RadarFC::RFC_Object::RFC_Object_Obj47.WidthVnce = 0;
  @CAN_RadarFC::RFC_Object::RFC_Object_Obj48.Age = 0;
  @CAN_RadarFC::RFC_Object::RFC_Object_Obj48.Ax = 0;
  @CAN_RadarFC::RFC_Object::RFC_Object_Obj48.AxAyCoVnce = 0;
  @CAN_RadarFC::RFC_Object::RFC_Object_Obj48.AxVnce = 0;
  @CAN_RadarFC::RFC_Object::RFC_Object_Obj48.Ay = 0;
  @CAN_RadarFC::RFC_Object::RFC_Object_Obj48.AyVnce = 0;
  @CAN_RadarFC::RFC_Object::RFC_Object_Obj48.ExistProb = 0;
  @CAN_RadarFC::RFC_Object::RFC_Object_Obj48.FilterInformation = 0;
  @CAN_RadarFC::RFC_Object::RFC_Object_Obj48.Length = 0;
  @CAN_RadarFC::RFC_Object::RFC_Object_Obj48.LengthVnce = 0;
  @CAN_RadarFC::RFC_Object::RFC_Object_Obj48.MeasurementStatus = 0;
  @CAN_RadarFC::RFC_Object::RFC_Object_Obj48.MovingStatus = 0;
  @CAN_RadarFC::RFC_Object::RFC_Object_Obj48.ObjId = 0;
  @CAN_RadarFC::RFC_Object::RFC_Object_Obj48.OrientationYaw = 0;
  @CAN_RadarFC::RFC_Object::RFC_Object_Obj48.OrientationYawVnce = 0;
  }
  if(init_count == 71)
  {
  @CAN_RadarFC::RFC_Object::RFC_Object_Obj48.ProbClassConfidence = 0;
  @CAN_RadarFC::RFC_Object::RFC_Object_Obj48.ProbClassType = 0;
  @CAN_RadarFC::RFC_Object::RFC_Object_Obj48.Px = 0;
  @CAN_RadarFC::RFC_Object::RFC_Object_Obj48.PxAxCoVnce = 0;
  @CAN_RadarFC::RFC_Object::RFC_Object_Obj48.PxAyCoVnce = 0;
  @CAN_RadarFC::RFC_Object::RFC_Object_Obj48.PxPyCoVnce = 0;
  @CAN_RadarFC::RFC_Object::RFC_Object_Obj48.PxVnce = 0;
  @CAN_RadarFC::RFC_Object::RFC_Object_Obj48.PxVxCoVnce = 0;
  @CAN_RadarFC::RFC_Object::RFC_Object_Obj48.PxVyCoVnce = 0;
  @CAN_RadarFC::RFC_Object::RFC_Object_Obj48.Py = 0;
  @CAN_RadarFC::RFC_Object::RFC_Object_Obj48.PyAxCoVnce = 0;
  @CAN_RadarFC::RFC_Object::RFC_Object_Obj48.PyAyCoVnce = 0;
  @CAN_RadarFC::RFC_Object::RFC_Object_Obj48.PyVnce = 0;
  @CAN_RadarFC::RFC_Object::RFC_Object_Obj48.PyVxCoVnce = 0;
  @CAN_RadarFC::RFC_Object::RFC_Object_Obj48.PyVyCoVnce = 0;
  @CAN_RadarFC::RFC_Object::RFC_Object_Obj48.ReferencePoint = 0;
  @CAN_RadarFC::RFC_Object::RFC_Object_Obj48.Vx = 0;
  @CAN_RadarFC::RFC_Object::RFC_Object_Obj48.VxAxCoVnce = 0;
  @CAN_RadarFC::RFC_Object::RFC_Object_Obj48.VxAyCoVnce = 0;
  @CAN_RadarFC::RFC_Object::RFC_Object_Obj48.VxVnce = 0;
  @CAN_RadarFC::RFC_Object::RFC_Object_Obj48.VxVyCoVnce = 0;
  @CAN_RadarFC::RFC_Object::RFC_Object_Obj48.Vy = 0;
  @CAN_RadarFC::RFC_Object::RFC_Object_Obj48.VyAxCoVnce = 0;
  @CAN_RadarFC::RFC_Object::RFC_Object_Obj48.VyAyCoVnce = 0;
  @CAN_RadarFC::RFC_Object::RFC_Object_Obj48.VyVnce = 0;
  }
  if(init_count == 72)
  {
  @CAN_RadarFC::RFC_Object::RFC_Object_Obj48.Width = 0;
  @CAN_RadarFC::RFC_Object::RFC_Object_Obj48.WidthVnce = 0;
  @CAN_RadarFC::RFC_Object::RFC_Object_Obj4.Age = 0;
  @CAN_RadarFC::RFC_Object::RFC_Object_Obj4.Ax = 0;
  @CAN_RadarFC::RFC_Object::RFC_Object_Obj4.AxAyCoVnce = 0;
  @CAN_RadarFC::RFC_Object::RFC_Object_Obj4.AxVnce = 0;
  @CAN_RadarFC::RFC_Object::RFC_Object_Obj4.Ay = 0;
  @CAN_RadarFC::RFC_Object::RFC_Object_Obj4.AyVnce = 0;
  @CAN_RadarFC::RFC_Object::RFC_Object_Obj4.ExistProb = 0;
  @CAN_RadarFC::RFC_Object::RFC_Object_Obj4.FilterInformation = 0;
  @CAN_RadarFC::RFC_Object::RFC_Object_Obj4.Length = 0;
  @CAN_RadarFC::RFC_Object::RFC_Object_Obj4.LengthVnce = 0;
  @CAN_RadarFC::RFC_Object::RFC_Object_Obj4.MeasurementStatus = 0;
  @CAN_RadarFC::RFC_Object::RFC_Object_Obj4.MovingStatus = 0;
  @CAN_RadarFC::RFC_Object::RFC_Object_Obj4.ObjId = 0;
  @CAN_RadarFC::RFC_Object::RFC_Object_Obj4.OrientationYaw = 0;
  @CAN_RadarFC::RFC_Object::RFC_Object_Obj4.OrientationYawVnce = 0;
  @CAN_RadarFC::RFC_Object::RFC_Object_Obj4.ProbClassConfidence = 0;
  @CAN_RadarFC::RFC_Object::RFC_Object_Obj4.ProbClassType = 0;
  @CAN_RadarFC::RFC_Object::RFC_Object_Obj4.Px = 0;
  @CAN_RadarFC::RFC_Object::RFC_Object_Obj4.PxAxCoVnce = 0;
  @CAN_RadarFC::RFC_Object::RFC_Object_Obj4.PxAyCoVnce = 0;
  @CAN_RadarFC::RFC_Object::RFC_Object_Obj4.PxPyCoVnce = 0;
  @CAN_RadarFC::RFC_Object::RFC_Object_Obj4.PxVnce = 0;
  @CAN_RadarFC::RFC_Object::RFC_Object_Obj4.PxVxCoVnce = 0;
  }
  if(init_count == 73)
  {
  @CAN_RadarFC::RFC_Object::RFC_Object_Obj4.PxVyCoVnce = 0;
  @CAN_RadarFC::RFC_Object::RFC_Object_Obj4.Py = 0;
  @CAN_RadarFC::RFC_Object::RFC_Object_Obj4.PyAxCoVnce = 0;
  @CAN_RadarFC::RFC_Object::RFC_Object_Obj4.PyAyCoVnce = 0;
  @CAN_RadarFC::RFC_Object::RFC_Object_Obj4.PyVnce = 0;
  @CAN_RadarFC::RFC_Object::RFC_Object_Obj4.PyVxCoVnce = 0;
  @CAN_RadarFC::RFC_Object::RFC_Object_Obj4.PyVyCoVnce = 0;
  @CAN_RadarFC::RFC_Object::RFC_Object_Obj4.ReferencePoint = 0;
  @CAN_RadarFC::RFC_Object::RFC_Object_Obj4.Vx = 0;
  @CAN_RadarFC::RFC_Object::RFC_Object_Obj4.VxAxCoVnce = 0;
  @CAN_RadarFC::RFC_Object::RFC_Object_Obj4.VxAyCoVnce = 0;
  @CAN_RadarFC::RFC_Object::RFC_Object_Obj4.VxVnce = 0;
  @CAN_RadarFC::RFC_Object::RFC_Object_Obj4.VxVyCoVnce = 0;
  @CAN_RadarFC::RFC_Object::RFC_Object_Obj4.Vy = 0;
  @CAN_RadarFC::RFC_Object::RFC_Object_Obj4.VyAxCoVnce = 0;
  @CAN_RadarFC::RFC_Object::RFC_Object_Obj4.VyAyCoVnce = 0;
  @CAN_RadarFC::RFC_Object::RFC_Object_Obj4.VyVnce = 0;
  @CAN_RadarFC::RFC_Object::RFC_Object_Obj4.Width = 0;
  @CAN_RadarFC::RFC_Object::RFC_Object_Obj4.WidthVnce = 0;
  @CAN_RadarFC::RFC_Object::RFC_Object_Obj5.Age = 0;
  @CAN_RadarFC::RFC_Object::RFC_Object_Obj5.Ax = 0;
  @CAN_RadarFC::RFC_Object::RFC_Object_Obj5.AxAyCoVnce = 0;
  @CAN_RadarFC::RFC_Object::RFC_Object_Obj5.AxVnce = 0;
  @CAN_RadarFC::RFC_Object::RFC_Object_Obj5.Ay = 0;
  @CAN_RadarFC::RFC_Object::RFC_Object_Obj5.AyVnce = 0;
  }
  if(init_count == 74)
  {
  @CAN_RadarFC::RFC_Object::RFC_Object_Obj5.ExistProb = 0;
  @CAN_RadarFC::RFC_Object::RFC_Object_Obj5.FilterInformation = 0;
  @CAN_RadarFC::RFC_Object::RFC_Object_Obj5.Length = 0;
  @CAN_RadarFC::RFC_Object::RFC_Object_Obj5.LengthVnce = 0;
  @CAN_RadarFC::RFC_Object::RFC_Object_Obj5.MeasurementStatus = 0;
  @CAN_RadarFC::RFC_Object::RFC_Object_Obj5.MovingStatus = 0;
  @CAN_RadarFC::RFC_Object::RFC_Object_Obj5.ObjId = 0;
  @CAN_RadarFC::RFC_Object::RFC_Object_Obj5.OrientationYaw = 0;
  @CAN_RadarFC::RFC_Object::RFC_Object_Obj5.OrientationYawVnce = 0;
  @CAN_RadarFC::RFC_Object::RFC_Object_Obj5.ProbClassConfidence = 0;
  @CAN_RadarFC::RFC_Object::RFC_Object_Obj5.ProbClassType = 0;
  @CAN_RadarFC::RFC_Object::RFC_Object_Obj5.Px = 0;
  @CAN_RadarFC::RFC_Object::RFC_Object_Obj5.PxAxCoVnce = 0;
  @CAN_RadarFC::RFC_Object::RFC_Object_Obj5.PxAyCoVnce = 0;
  @CAN_RadarFC::RFC_Object::RFC_Object_Obj5.PxPyCoVnce = 0;
  @CAN_RadarFC::RFC_Object::RFC_Object_Obj5.PxVnce = 0;
  @CAN_RadarFC::RFC_Object::RFC_Object_Obj5.PxVxCoVnce = 0;
  @CAN_RadarFC::RFC_Object::RFC_Object_Obj5.PxVyCoVnce = 0;
  @CAN_RadarFC::RFC_Object::RFC_Object_Obj5.Py = 0;
  @CAN_RadarFC::RFC_Object::RFC_Object_Obj5.PyAxCoVnce = 0;
  @CAN_RadarFC::RFC_Object::RFC_Object_Obj5.PyAyCoVnce = 0;
  @CAN_RadarFC::RFC_Object::RFC_Object_Obj5.PyVnce = 0;
  @CAN_RadarFC::RFC_Object::RFC_Object_Obj5.PyVxCoVnce = 0;
  @CAN_RadarFC::RFC_Object::RFC_Object_Obj5.PyVyCoVnce = 0;
  @CAN_RadarFC::RFC_Object::RFC_Object_Obj5.ReferencePoint = 0;
  }
  if(init_count == 75)
  {
  @CAN_RadarFC::RFC_Object::RFC_Object_Obj5.Vx = 0;
  @CAN_RadarFC::RFC_Object::RFC_Object_Obj5.VxAxCoVnce = 0;
  @CAN_RadarFC::RFC_Object::RFC_Object_Obj5.VxAyCoVnce = 0;
  @CAN_RadarFC::RFC_Object::RFC_Object_Obj5.VxVnce = 0;
  @CAN_RadarFC::RFC_Object::RFC_Object_Obj5.VxVyCoVnce = 0;
  @CAN_RadarFC::RFC_Object::RFC_Object_Obj5.Vy = 0;
  @CAN_RadarFC::RFC_Object::RFC_Object_Obj5.VyAxCoVnce = 0;
  @CAN_RadarFC::RFC_Object::RFC_Object_Obj5.VyAyCoVnce = 0;
  @CAN_RadarFC::RFC_Object::RFC_Object_Obj5.VyVnce = 0;
  @CAN_RadarFC::RFC_Object::RFC_Object_Obj5.Width = 0;
  @CAN_RadarFC::RFC_Object::RFC_Object_Obj5.WidthVnce = 0;
  @CAN_RadarFC::RFC_Object::RFC_Object_Obj6.Age = 0;
  @CAN_RadarFC::RFC_Object::RFC_Object_Obj6.Ax = 0;
  @CAN_RadarFC::RFC_Object::RFC_Object_Obj6.AxAyCoVnce = 0;
  @CAN_RadarFC::RFC_Object::RFC_Object_Obj6.AxVnce = 0;
  @CAN_RadarFC::RFC_Object::RFC_Object_Obj6.Ay = 0;
  @CAN_RadarFC::RFC_Object::RFC_Object_Obj6.AyVnce = 0;
  @CAN_RadarFC::RFC_Object::RFC_Object_Obj6.ExistProb = 0;
  @CAN_RadarFC::RFC_Object::RFC_Object_Obj6.FilterInformation = 0;
  @CAN_RadarFC::RFC_Object::RFC_Object_Obj6.Length = 0;
  @CAN_RadarFC::RFC_Object::RFC_Object_Obj6.LengthVnce = 0;
  @CAN_RadarFC::RFC_Object::RFC_Object_Obj6.MeasurementStatus = 0;
  @CAN_RadarFC::RFC_Object::RFC_Object_Obj6.MovingStatus = 0;
  @CAN_RadarFC::RFC_Object::RFC_Object_Obj6.ObjId = 0;
  @CAN_RadarFC::RFC_Object::RFC_Object_Obj6.OrientationYaw = 0;
  }
  if(init_count == 76)
  {
  @CAN_RadarFC::RFC_Object::RFC_Object_Obj6.OrientationYawVnce = 0;
  @CAN_RadarFC::RFC_Object::RFC_Object_Obj6.ProbClassConfidence = 0;
  @CAN_RadarFC::RFC_Object::RFC_Object_Obj6.ProbClassType = 0;
  @CAN_RadarFC::RFC_Object::RFC_Object_Obj6.Px = 0;
  @CAN_RadarFC::RFC_Object::RFC_Object_Obj6.PxAxCoVnce = 0;
  @CAN_RadarFC::RFC_Object::RFC_Object_Obj6.PxAyCoVnce = 0;
  @CAN_RadarFC::RFC_Object::RFC_Object_Obj6.PxPyCoVnce = 0;
  @CAN_RadarFC::RFC_Object::RFC_Object_Obj6.PxVnce = 0;
  @CAN_RadarFC::RFC_Object::RFC_Object_Obj6.PxVxCoVnce = 0;
  @CAN_RadarFC::RFC_Object::RFC_Object_Obj6.PxVyCoVnce = 0;
  @CAN_RadarFC::RFC_Object::RFC_Object_Obj6.Py = 0;
  @CAN_RadarFC::RFC_Object::RFC_Object_Obj6.PyAxCoVnce = 0;
  @CAN_RadarFC::RFC_Object::RFC_Object_Obj6.PyAyCoVnce = 0;
  @CAN_RadarFC::RFC_Object::RFC_Object_Obj6.PyVnce = 0;
  @CAN_RadarFC::RFC_Object::RFC_Object_Obj6.PyVxCoVnce = 0;
  @CAN_RadarFC::RFC_Object::RFC_Object_Obj6.PyVyCoVnce = 0;
  @CAN_RadarFC::RFC_Object::RFC_Object_Obj6.ReferencePoint = 0;
  @CAN_RadarFC::RFC_Object::RFC_Object_Obj6.Vx = 0;
  @CAN_RadarFC::RFC_Object::RFC_Object_Obj6.VxAxCoVnce = 0;
  @CAN_RadarFC::RFC_Object::RFC_Object_Obj6.VxAyCoVnce = 0;
  @CAN_RadarFC::RFC_Object::RFC_Object_Obj6.VxVnce = 0;
  @CAN_RadarFC::RFC_Object::RFC_Object_Obj6.VxVyCoVnce = 0;
  @CAN_RadarFC::RFC_Object::RFC_Object_Obj6.Vy = 0;
  @CAN_RadarFC::RFC_Object::RFC_Object_Obj6.VyAxCoVnce = 0;
  @CAN_RadarFC::RFC_Object::RFC_Object_Obj6.VyAyCoVnce = 0;
  }
  if(init_count == 77)
  {
  @CAN_RadarFC::RFC_Object::RFC_Object_Obj6.VyVnce = 0;
  @CAN_RadarFC::RFC_Object::RFC_Object_Obj6.Width = 0;
  @CAN_RadarFC::RFC_Object::RFC_Object_Obj6.WidthVnce = 0;
  @CAN_RadarFC::RFC_Object::RFC_Object_Obj7.Age = 0;
  @CAN_RadarFC::RFC_Object::RFC_Object_Obj7.Ax = 0;
  @CAN_RadarFC::RFC_Object::RFC_Object_Obj7.AxAyCoVnce = 0;
  @CAN_RadarFC::RFC_Object::RFC_Object_Obj7.AxVnce = 0;
  @CAN_RadarFC::RFC_Object::RFC_Object_Obj7.Ay = 0;
  @CAN_RadarFC::RFC_Object::RFC_Object_Obj7.AyVnce = 0;
  @CAN_RadarFC::RFC_Object::RFC_Object_Obj7.ExistProb = 0;
  @CAN_RadarFC::RFC_Object::RFC_Object_Obj7.FilterInformation = 0;
  @CAN_RadarFC::RFC_Object::RFC_Object_Obj7.Length = 0;
  @CAN_RadarFC::RFC_Object::RFC_Object_Obj7.LengthVnce = 0;
  @CAN_RadarFC::RFC_Object::RFC_Object_Obj7.MeasurementStatus = 0;
  @CAN_RadarFC::RFC_Object::RFC_Object_Obj7.MovingStatus = 0;
  @CAN_RadarFC::RFC_Object::RFC_Object_Obj7.ObjId = 0;
  @CAN_RadarFC::RFC_Object::RFC_Object_Obj7.OrientationYaw = 0;
  @CAN_RadarFC::RFC_Object::RFC_Object_Obj7.OrientationYawVnce = 0;
  @CAN_RadarFC::RFC_Object::RFC_Object_Obj7.ProbClassConfidence = 0;
  @CAN_RadarFC::RFC_Object::RFC_Object_Obj7.ProbClassType = 0;
  @CAN_RadarFC::RFC_Object::RFC_Object_Obj7.Px = 0;
  @CAN_RadarFC::RFC_Object::RFC_Object_Obj7.PxAxCoVnce = 0;
  @CAN_RadarFC::RFC_Object::RFC_Object_Obj7.PxAyCoVnce = 0;
  @CAN_RadarFC::RFC_Object::RFC_Object_Obj7.PxPyCoVnce = 0;
  @CAN_RadarFC::RFC_Object::RFC_Object_Obj7.PxVnce = 0;
  }
  if(init_count == 78)
  {
  @CAN_RadarFC::RFC_Object::RFC_Object_Obj7.PxVxCoVnce = 0;
  @CAN_RadarFC::RFC_Object::RFC_Object_Obj7.PxVyCoVnce = 0;
  @CAN_RadarFC::RFC_Object::RFC_Object_Obj7.Py = 0;
  @CAN_RadarFC::RFC_Object::RFC_Object_Obj7.PyAxCoVnce = 0;
  @CAN_RadarFC::RFC_Object::RFC_Object_Obj7.PyAyCoVnce = 0;
  @CAN_RadarFC::RFC_Object::RFC_Object_Obj7.PyVnce = 0;
  @CAN_RadarFC::RFC_Object::RFC_Object_Obj7.PyVxCoVnce = 0;
  @CAN_RadarFC::RFC_Object::RFC_Object_Obj7.PyVyCoVnce = 0;
  @CAN_RadarFC::RFC_Object::RFC_Object_Obj7.ReferencePoint = 0;
  @CAN_RadarFC::RFC_Object::RFC_Object_Obj7.Vx = 0;
  @CAN_RadarFC::RFC_Object::RFC_Object_Obj7.VxAxCoVnce = 0;
  @CAN_RadarFC::RFC_Object::RFC_Object_Obj7.VxAyCoVnce = 0;
  @CAN_RadarFC::RFC_Object::RFC_Object_Obj7.VxVnce = 0;
  @CAN_RadarFC::RFC_Object::RFC_Object_Obj7.VxVyCoVnce = 0;
  @CAN_RadarFC::RFC_Object::RFC_Object_Obj7.Vy = 0;
  @CAN_RadarFC::RFC_Object::RFC_Object_Obj7.VyAxCoVnce = 0;
  @CAN_RadarFC::RFC_Object::RFC_Object_Obj7.VyAyCoVnce = 0;
  @CAN_RadarFC::RFC_Object::RFC_Object_Obj7.VyVnce = 0;
  @CAN_RadarFC::RFC_Object::RFC_Object_Obj7.Width = 0;
  @CAN_RadarFC::RFC_Object::RFC_Object_Obj7.WidthVnce = 0;
  @CAN_RadarFC::RFC_Object::RFC_Object_Obj8.Age = 0;
  @CAN_RadarFC::RFC_Object::RFC_Object_Obj8.Ax = 0;
  @CAN_RadarFC::RFC_Object::RFC_Object_Obj8.AxAyCoVnce = 0;
  @CAN_RadarFC::RFC_Object::RFC_Object_Obj8.AxVnce = 0;
  @CAN_RadarFC::RFC_Object::RFC_Object_Obj8.Ay = 0;
  }
  if(init_count == 79)
  {
  @CAN_RadarFC::RFC_Object::RFC_Object_Obj8.AyVnce = 0;
  @CAN_RadarFC::RFC_Object::RFC_Object_Obj8.ExistProb = 0;
  @CAN_RadarFC::RFC_Object::RFC_Object_Obj8.FilterInformation = 0;
  @CAN_RadarFC::RFC_Object::RFC_Object_Obj8.Length = 0;
  @CAN_RadarFC::RFC_Object::RFC_Object_Obj8.LengthVnce = 0;
  @CAN_RadarFC::RFC_Object::RFC_Object_Obj8.MeasurementStatus = 0;
  @CAN_RadarFC::RFC_Object::RFC_Object_Obj8.MovingStatus = 0;
  @CAN_RadarFC::RFC_Object::RFC_Object_Obj8.ObjId = 0;
  @CAN_RadarFC::RFC_Object::RFC_Object_Obj8.OrientationYaw = 0;
  @CAN_RadarFC::RFC_Object::RFC_Object_Obj8.OrientationYawVnce = 0;
  @CAN_RadarFC::RFC_Object::RFC_Object_Obj8.ProbClassConfidence = 0;
  @CAN_RadarFC::RFC_Object::RFC_Object_Obj8.ProbClassType = 0;
  @CAN_RadarFC::RFC_Object::RFC_Object_Obj8.Px = 0;
  @CAN_RadarFC::RFC_Object::RFC_Object_Obj8.PxAxCoVnce = 0;
  @CAN_RadarFC::RFC_Object::RFC_Object_Obj8.PxAyCoVnce = 0;
  @CAN_RadarFC::RFC_Object::RFC_Object_Obj8.PxPyCoVnce = 0;
  @CAN_RadarFC::RFC_Object::RFC_Object_Obj8.PxVnce = 0;
  @CAN_RadarFC::RFC_Object::RFC_Object_Obj8.PxVxCoVnce = 0;
  @CAN_RadarFC::RFC_Object::RFC_Object_Obj8.PxVyCoVnce = 0;
  @CAN_RadarFC::RFC_Object::RFC_Object_Obj8.Py = 0;
  @CAN_RadarFC::RFC_Object::RFC_Object_Obj8.PyAxCoVnce = 0;
  @CAN_RadarFC::RFC_Object::RFC_Object_Obj8.PyAyCoVnce = 0;
  @CAN_RadarFC::RFC_Object::RFC_Object_Obj8.PyVnce = 0;
  @CAN_RadarFC::RFC_Object::RFC_Object_Obj8.PyVxCoVnce = 0;
  @CAN_RadarFC::RFC_Object::RFC_Object_Obj8.PyVyCoVnce = 0;
  }
  if(init_count == 80)
  {
  @CAN_RadarFC::RFC_Object::RFC_Object_Obj8.ReferencePoint = 0;
  @CAN_RadarFC::RFC_Object::RFC_Object_Obj8.Vx = 0;
  @CAN_RadarFC::RFC_Object::RFC_Object_Obj8.VxAxCoVnce = 0;
  @CAN_RadarFC::RFC_Object::RFC_Object_Obj8.VxAyCoVnce = 0;
  @CAN_RadarFC::RFC_Object::RFC_Object_Obj8.VxVnce = 0;
  @CAN_RadarFC::RFC_Object::RFC_Object_Obj8.VxVyCoVnce = 0;
  @CAN_RadarFC::RFC_Object::RFC_Object_Obj8.Vy = 0;
  @CAN_RadarFC::RFC_Object::RFC_Object_Obj8.VyAxCoVnce = 0;
  @CAN_RadarFC::RFC_Object::RFC_Object_Obj8.VyAyCoVnce = 0;
  @CAN_RadarFC::RFC_Object::RFC_Object_Obj8.VyVnce = 0;
  @CAN_RadarFC::RFC_Object::RFC_Object_Obj8.Width = 0;
  @CAN_RadarFC::RFC_Object::RFC_Object_Obj8.WidthVnce = 0;
  @CAN_RadarFC::RFC_Object::RFC_Object_Obj9.Age = 0;
  @CAN_RadarFC::RFC_Object::RFC_Object_Obj9.Ax = 0;
  @CAN_RadarFC::RFC_Object::RFC_Object_Obj9.AxAyCoVnce = 0;
  @CAN_RadarFC::RFC_Object::RFC_Object_Obj9.AxVnce = 0;
  @CAN_RadarFC::RFC_Object::RFC_Object_Obj9.Ay = 0;
  @CAN_RadarFC::RFC_Object::RFC_Object_Obj9.AyVnce = 0;
  @CAN_RadarFC::RFC_Object::RFC_Object_Obj9.ExistProb = 0;
  @CAN_RadarFC::RFC_Object::RFC_Object_Obj9.FilterInformation = 0;
  @CAN_RadarFC::RFC_Object::RFC_Object_Obj9.Length = 0;
  @CAN_RadarFC::RFC_Object::RFC_Object_Obj9.LengthVnce = 0;
  @CAN_RadarFC::RFC_Object::RFC_Object_Obj9.MeasurementStatus = 0;
  @CAN_RadarFC::RFC_Object::RFC_Object_Obj9.MovingStatus = 0;
  @CAN_RadarFC::RFC_Object::RFC_Object_Obj9.ObjId = 0;
  }
  if(init_count == 81)
  {
  @CAN_RadarFC::RFC_Object::RFC_Object_Obj9.OrientationYaw = 0;
  @CAN_RadarFC::RFC_Object::RFC_Object_Obj9.OrientationYawVnce = 0;
  @CAN_RadarFC::RFC_Object::RFC_Object_Obj9.ProbClassConfidence = 0;
  @CAN_RadarFC::RFC_Object::RFC_Object_Obj9.ProbClassType = 0;
  @CAN_RadarFC::RFC_Object::RFC_Object_Obj9.Px = 0;
  @CAN_RadarFC::RFC_Object::RFC_Object_Obj9.PxAxCoVnce = 0;
  @CAN_RadarFC::RFC_Object::RFC_Object_Obj9.PxAyCoVnce = 0;
  @CAN_RadarFC::RFC_Object::RFC_Object_Obj9.PxPyCoVnce = 0;
  @CAN_RadarFC::RFC_Object::RFC_Object_Obj9.PxVnce = 0;
  @CAN_RadarFC::RFC_Object::RFC_Object_Obj9.PxVxCoVnce = 0;
  @CAN_RadarFC::RFC_Object::RFC_Object_Obj9.PxVyCoVnce = 0;
  @CAN_RadarFC::RFC_Object::RFC_Object_Obj9.Py = 0;
  @CAN_RadarFC::RFC_Object::RFC_Object_Obj9.PyAxCoVnce = 0;
  @CAN_RadarFC::RFC_Object::RFC_Object_Obj9.PyAyCoVnce = 0;
  @CAN_RadarFC::RFC_Object::RFC_Object_Obj9.PyVnce = 0;
  @CAN_RadarFC::RFC_Object::RFC_Object_Obj9.PyVxCoVnce = 0;
  @CAN_RadarFC::RFC_Object::RFC_Object_Obj9.PyVyCoVnce = 0;
  @CAN_RadarFC::RFC_Object::RFC_Object_Obj9.ReferencePoint = 0;
  @CAN_RadarFC::RFC_Object::RFC_Object_Obj9.Vx = 0;
  @CAN_RadarFC::RFC_Object::RFC_Object_Obj9.VxAxCoVnce = 0;
  @CAN_RadarFC::RFC_Object::RFC_Object_Obj9.VxAyCoVnce = 0;
  @CAN_RadarFC::RFC_Object::RFC_Object_Obj9.VxVnce = 0;
  @CAN_RadarFC::RFC_Object::RFC_Object_Obj9.VxVyCoVnce = 0;
  @CAN_RadarFC::RFC_Object::RFC_Object_Obj9.Vy = 0;
  @CAN_RadarFC::RFC_Object::RFC_Object_Obj9.VyAxCoVnce = 0;
  }
  if(init_count == 82)
  {
  @CAN_RadarFC::RFC_Object::RFC_Object_Obj9.VyAyCoVnce = 0;
  @CAN_RadarFC::RFC_Object::RFC_Object_Obj9.VyVnce = 0;
  @CAN_RadarFC::RFC_Object::RFC_Object_Obj9.Width = 0;
  @CAN_RadarFC::RFC_Object::RFC_Object_Obj9.WidthVnce = 0;
  @CAN_RadarFC::RFC_Object::RFC_Object_ObjHdr_NumValidObjects = 0;
  @CAN_RadarFC::RFC_Object::RFC_Object_ObjHdr_TimeStamp = 0;
  @CAN_RadarFC::RFC_Object::RFC_Object_ObjHdr_TimeStampStatus = 0;
  @CAN_RadarFC::RFC_Object::RFC_Object_ObjHdr_VersionIdMajor = 0;
  @CAN_RadarFC::RFC_Object::RFC_Object_ObjHdr_VersionIdMinor = 0;
  @CAN_RadarFC::RFC_Object::RFC_Object_ObjHdr_VersionPatch = 0;
  @CAN_RadarFC::RFC_Object::RFC_Object_ObjHdr_content_type = 0;
  @CAN_RadarFC::RFC_Object::RFC_Object_ShiiHdr_DataMeasured = 0;
  @CAN_RadarFC::RFC_Object::RFC_Object_ShiiHdr_MisAzOOPCause = 0;
  @CAN_RadarFC::RFC_Object::RFC_Object_ShiiHdr_MisElOOPCause = 0;
  @CAN_RadarFC::RFC_Object::RFC_Object_ShiiHdr_RatioAdvProcListProc = 0;
  @CAN_RadarFC::RFC_Object::RFC_Object_ShiiHdr_SensorCalExtStat = 0;
  @CAN_RadarFC::RFC_Object::RFC_Object_ShiiHdr_SensorCalIntStat = 0;
  @CAN_RadarFC::RFC_Object::RFC_Object_ShiiHdr_SensorCalOnlStat = 0;
  @CAN_RadarFC::RFC_Object::RFC_Object_ShiiHdr_SensorFailureReas = 0;
  @CAN_RadarFC::RFC_Object::RFC_Object_ShiiHdr_SensorHeatingStatus = 0;
  @CAN_RadarFC::RFC_Object::RFC_Object_ShiiHdr_SensorOmmOpMode = 0;
  @CAN_RadarFC::RFC_Object::RFC_Object_ShiiHdr_ThermalDegr = 0;
  @CAN_RadarFC::RFC_Object::RFC_Object_SpiHdr_BldFov_Confidence = 0;
  @CAN_RadarFC::RFC_Object::RFC_Object_SpiHdr_BldFov_Status = 0;
  @CAN_RadarFC::RFC_Object::RFC_Object_SpiHdr_BldOperationMode = 0;
  }
  if(init_count == 83)
  {
  @CAN_RadarFC::RFC_Object::RFC_Object_SpiHdr_DistMaxProc = 0;
  @CAN_RadarFC::RFC_Object::RFC_Object_SpiHdr_DistMeasMaxMod = 0;
  @CAN_RadarFC::RFC_Object::RFC_Object_SpiHdr_DistMeasMinMod = 0;
  @CAN_RadarFC::RFC_Object::RFC_Object_SpiHdr_DistPrec = 0;
  @CAN_RadarFC::RFC_Object::RFC_Object_SpiHdr_DistSep = 0;
  @CAN_RadarFC::RFC_Object::RFC_Object_SpiHdr_DistStartProcDegraded = 0;
  @CAN_RadarFC::RFC_Object::RFC_Object_SpiHdr_DmpId = 0;
  @CAN_RadarFC::RFC_Object::RFC_Object_SpiHdr_FovRtrAzDetRng00 = 0;
  @CAN_RadarFC::RFC_Object::RFC_Object_SpiHdr_FovRtrAzDetRng01 = 0;
  @CAN_RadarFC::RFC_Object::RFC_Object_SpiHdr_FovRtrAzDetRng02 = 0;
  @CAN_RadarFC::RFC_Object::RFC_Object_SpiHdr_FovRtrAzDetRng03 = 0;
  @CAN_RadarFC::RFC_Object::RFC_Object_SpiHdr_FovRtrAzDetRng04 = 0;
  @CAN_RadarFC::RFC_Object::RFC_Object_SpiHdr_FovRtrAzDetRng05 = 0;
  @CAN_RadarFC::RFC_Object::RFC_Object_SpiHdr_FovRtrAzDetRng06 = 0;
  @CAN_RadarFC::RFC_Object::RFC_Object_SpiHdr_FovRtrAzDetRng07 = 0;
  @CAN_RadarFC::RFC_Object::RFC_Object_SpiHdr_FovRtrAzDetRng08 = 0;
  @CAN_RadarFC::RFC_Object::RFC_Object_SpiHdr_FovRtrAzDetRng09 = 0;
  @CAN_RadarFC::RFC_Object::RFC_Object_SpiHdr_FovRtrAzDetRng10 = 0;
  @CAN_RadarFC::RFC_Object::RFC_Object_SpiHdr_FovRtrAzDetRng11 = 0;
  @CAN_RadarFC::RFC_Object::RFC_Object_SpiHdr_FovRtrAzDetRng12 = 0;
  @CAN_RadarFC::RFC_Object::RFC_Object_SpiHdr_FovRtrAzDetRng13 = 0;
  @CAN_RadarFC::RFC_Object::RFC_Object_SpiHdr_FovRtrAzDetRng14 = 0;
  @CAN_RadarFC::RFC_Object::RFC_Object_SpiHdr_FovRtrAzDetRng15 = 0;
  @CAN_RadarFC::RFC_Object::RFC_Object_SpiHdr_FovRtrAzDetRng16 = 0;
  @CAN_RadarFC::RFC_Object::RFC_Object_SpiHdr_FovRtrAzDetRng17 = 0;
  }
  if(init_count == 84)
  {
  @CAN_RadarFC::RFC_Object::RFC_Object_SpiHdr_FovRtrAzDetRng18 = 0;
  @CAN_RadarFC::RFC_Object::RFC_Object_SpiHdr_FovRtrAzDetRng19 = 0;
  @CAN_RadarFC::RFC_Object::RFC_Object_SpiHdr_FovRtrAzDetRng20 = 0;
  @CAN_RadarFC::RFC_Object::RFC_Object_SpiHdr_FovRtrAzDetRng21 = 0;
  @CAN_RadarFC::RFC_Object::RFC_Object_SpiHdr_FovRtrAzDetRng22 = 0;
  @CAN_RadarFC::RFC_Object::RFC_Object_SpiHdr_FovRtrAzDetRng23 = 0;
  @CAN_RadarFC::RFC_Object::RFC_Object_SpiHdr_FovRtrAzDetRng24 = 0;
  @CAN_RadarFC::RFC_Object::RFC_Object_SpiHdr_FovRtrAzSegBrdr00 = 0;
  @CAN_RadarFC::RFC_Object::RFC_Object_SpiHdr_FovRtrAzSegBrdr01 = 0;
  @CAN_RadarFC::RFC_Object::RFC_Object_SpiHdr_FovRtrAzSegBrdr02 = 0;
  @CAN_RadarFC::RFC_Object::RFC_Object_SpiHdr_FovRtrAzSegBrdr03 = 0;
  @CAN_RadarFC::RFC_Object::RFC_Object_SpiHdr_FovRtrAzSegBrdr04 = 0;
  @CAN_RadarFC::RFC_Object::RFC_Object_SpiHdr_FovRtrAzSegBrdr05 = 0;
  @CAN_RadarFC::RFC_Object::RFC_Object_SpiHdr_FovRtrAzSegBrdr06 = 0;
  @CAN_RadarFC::RFC_Object::RFC_Object_SpiHdr_FovRtrAzSegBrdr07 = 0;
  @CAN_RadarFC::RFC_Object::RFC_Object_SpiHdr_FovRtrAzSegBrdr08 = 0;
  @CAN_RadarFC::RFC_Object::RFC_Object_SpiHdr_FovRtrAzSegBrdr09 = 0;
  @CAN_RadarFC::RFC_Object::RFC_Object_SpiHdr_FovRtrAzSegBrdr10 = 0;
  @CAN_RadarFC::RFC_Object::RFC_Object_SpiHdr_FovRtrAzSegBrdr11 = 0;
  @CAN_RadarFC::RFC_Object::RFC_Object_SpiHdr_FovRtrAzSegBrdr12 = 0;
  @CAN_RadarFC::RFC_Object::RFC_Object_SpiHdr_FovRtrAzSegBrdr13 = 0;
  @CAN_RadarFC::RFC_Object::RFC_Object_SpiHdr_FovRtrAzSegBrdr14 = 0;
  @CAN_RadarFC::RFC_Object::RFC_Object_SpiHdr_FovRtrAzSegBrdr15 = 0;
  @CAN_RadarFC::RFC_Object::RFC_Object_SpiHdr_FovRtrAzSegBrdr16 = 0;
  @CAN_RadarFC::RFC_Object::RFC_Object_SpiHdr_FovRtrAzSegBrdr17 = 0;
  }
  if(init_count == 85)
  {
  @CAN_RadarFC::RFC_Object::RFC_Object_SpiHdr_FovRtrAzSegBrdr18 = 0;
  @CAN_RadarFC::RFC_Object::RFC_Object_SpiHdr_FovRtrAzSegBrdr19 = 0;
  @CAN_RadarFC::RFC_Object::RFC_Object_SpiHdr_FovRtrAzSegBrdr20 = 0;
  @CAN_RadarFC::RFC_Object::RFC_Object_SpiHdr_FovRtrAzSegBrdr21 = 0;
  @CAN_RadarFC::RFC_Object::RFC_Object_SpiHdr_FovRtrAzSegBrdr22 = 0;
  @CAN_RadarFC::RFC_Object::RFC_Object_SpiHdr_FovRtrAzSegBrdr23 = 0;
  @CAN_RadarFC::RFC_Object::RFC_Object_SpiHdr_FovRtrAzSegBrdr24 = 0;
  @CAN_RadarFC::RFC_Object::RFC_Object_SpiHdr_FovRtrElRngGEnd00 = 0;
  @CAN_RadarFC::RFC_Object::RFC_Object_SpiHdr_FovRtrElRngGEnd01 = 0;
  @CAN_RadarFC::RFC_Object::RFC_Object_SpiHdr_FovRtrElRngGEnd02 = 0;
  @CAN_RadarFC::RFC_Object::RFC_Object_SpiHdr_FovRtrElRngGEnd03 = 0;
  @CAN_RadarFC::RFC_Object::RFC_Object_SpiHdr_FovRtrElRngGEnd04 = 0;
  @CAN_RadarFC::RFC_Object::RFC_Object_SpiHdr_FovRtrElRngGEnd05 = 0;
  @CAN_RadarFC::RFC_Object::RFC_Object_SpiHdr_FovRtrElRngGEnd06 = 0;
  @CAN_RadarFC::RFC_Object::RFC_Object_SpiHdr_FovRtrElRngGEnd07 = 0;
  @CAN_RadarFC::RFC_Object::RFC_Object_SpiHdr_FovRtrElRngGEnd08 = 0;
  @CAN_RadarFC::RFC_Object::RFC_Object_SpiHdr_FovRtrElRngGEnd09 = 0;
  @CAN_RadarFC::RFC_Object::RFC_Object_SpiHdr_FovRtrElRngGEnd10 = 0;
  @CAN_RadarFC::RFC_Object::RFC_Object_SpiHdr_FovRtrElSegBrdr00 = 0;
  @CAN_RadarFC::RFC_Object::RFC_Object_SpiHdr_FovRtrElSegBrdr01 = 0;
  @CAN_RadarFC::RFC_Object::RFC_Object_SpiHdr_FovRtrElSegBrdr02 = 0;
  @CAN_RadarFC::RFC_Object::RFC_Object_SpiHdr_FovRtrElSegBrdr03 = 0;
  @CAN_RadarFC::RFC_Object::RFC_Object_SpiHdr_FovRtrElSegBrdr04 = 0;
  @CAN_RadarFC::RFC_Object::RFC_Object_SpiHdr_FovRtrElSegBrdr05 = 0;
  @CAN_RadarFC::RFC_Object::RFC_Object_SpiHdr_FovRtrElSegBrdr06 = 0;
  }
  if(init_count == 86)
  {
  @CAN_RadarFC::RFC_Object::RFC_Object_SpiHdr_FovRtrElSegBrdr07 = 0;
  @CAN_RadarFC::RFC_Object::RFC_Object_SpiHdr_FovRtrElSegBrdr08 = 0;
  @CAN_RadarFC::RFC_Object::RFC_Object_SpiHdr_FovRtrElSegBrdr09 = 0;
  @CAN_RadarFC::RFC_Object::RFC_Object_SpiHdr_FovRtrElSegBrdr10 = 0;
  @CAN_RadarFC::RFC_Object::RFC_Object_SpiHdr_ModId = 0;
  @CAN_RadarFC::RFC_Object::RFC_Object_SpiHdr_RngGainRfInterfere = 0;
  @CAN_RadarFC::RFC_Object::RFC_Object_SpiHdr_SensorExtDisturbed = 0;
  @CAN_RadarFC::RFC_Object::RFC_Object_SpiHdr_SensorOrientPitch = 0;
  @CAN_RadarFC::RFC_Object::RFC_Object_SpiHdr_SensorOrientYaw = 0;
  @CAN_RadarFC::RFC_Object::RFC_Object_SpiHdr_SensorOrientation = 0;
  @CAN_RadarFC::RFC_Object::RFC_Object_SpiHdr_SensorOriginPointX = 0;
  @CAN_RadarFC::RFC_Object::RFC_Object_SpiHdr_SensorOriginPointY = 0;
  @CAN_RadarFC::RFC_Object::RFC_Object_SpiHdr_SensorOriginPointZ = 0;
  @CAN_RadarFC::RFC_Object::RFC_Object_SpiHdr_VelMeasMax = 0;
  @CAN_RadarFC::RFC_Object::RFC_Object_SpiHdr_VelMeasMin = 0;
  @CAN_RadarFC::RFC_Object::RFC_Object_SpiHdr_VelPrec = 0;
  @CAN_RadarFC::RFC_Object::RFC_Object_SpiHdr_VelSep = 0;
  sysSetVariableData(sysvar::CAN_RadarFC::RFC_RoadSideBoundaries::RFC_RoadSideBoundaries::SignalValue, RFC_RoadSideBoundaries_byte_Array, 1000);
  $CAN_RadarFC::RFC_SensorOutput::RFC_Veh_SenOut_VehConfParamStatus = 0;
  if (prestart_mode==0) init_count = 0;
  initFlag = 8;
  }
  init_count++;
}
void init_Toliman_F150_OD()
{
  if(init_count == 1)
  {
  sysSetVariableData(sysvar::CAN_RadarFC::RFC_Veh_ConfigMgmt::RFC_Veh_ConfigMgmt::SignalValue, RFC_Veh_ConfigMgmt_byte_Array, 20);
  $CAN_RadarFC::RFC_Veh_SensorConfig::RFC_Veh_SenConfig_AccLongSensPos = 0.16;
  $CAN_RadarFC::RFC_Veh_SensorConfig::RFC_Veh_SenConfig_ConfigData = 1;
  $CAN_RadarFC::RFC_Veh_SensorConfig::RFC_Veh_SenConfig_CountryCode = 0;
  $CAN_RadarFC::RFC_Veh_SensorConfig::RFC_Veh_SenConfig_GradSideSlipAng = 0.004;
  $CAN_RadarFC::RFC_Veh_SensorConfig::RFC_Veh_SenConfig_PosX = 3.84;
  $CAN_RadarFC::RFC_Veh_SensorConfig::RFC_Veh_SenConfig_PosY = 0.23;
  $CAN_RadarFC::RFC_Veh_SensorConfig::RFC_Veh_SenConfig_PosZ = 0.65;
  $CAN_RadarFC::RFC_Veh_SensorConfig::RFC_Veh_SenConfig_SnsTimeOffset = 35;
  $CAN_RadarFC::RFC_Veh_SensorConfig::RFC_Veh_SenConfig_SnsrOrientNomPitch = 0;
  $CAN_RadarFC::RFC_Veh_SensorConfig::RFC_Veh_SenConfig_SnsrOrientNomYaw = -0.002;
  $CAN_RadarFC::RFC_Veh_SensorConfig::RFC_Veh_SenConfig_SnsrOrientation = 0;
  $CAN_RadarFC::RFC_Veh_SensorConfig::RFC_Veh_SenConfig_StrRackRatio = 18;
  $CAN_RadarFC::RFC_Veh_SensorConfig::RFC_Veh_SenConfig_SyncType = 1;
  $CAN_RadarFC::RFC_Veh_SensorConfig::RFC_Veh_SenConfig_VehicleWidthMax = 2.1;
  $CAN_RadarFC::RFC_Veh_SensorConfig::RFC_Veh_SenConfig_VehicleWidthMin = 2;
  $CAN_RadarFC::RFC_Veh_SensorConfig::RFC_Veh_SenConfig_WheelBase = 3;
  $CAN_RadarFC::RFC_Veh_SensorConfig::RFC_Veh_SenConfig_WheelCircFL = 2.53;
  $CAN_RadarFC::RFC_Veh_SensorConfig::RFC_Veh_SenConfig_WheelCircFR = 2.53;
  $CAN_RadarFC::RFC_Veh_SensorConfig::RFC_Veh_SenConfig_WheelCircRL = 2.53;
  $CAN_RadarFC::RFC_Veh_SensorConfig::RFC_Veh_SenConfig_WheelCircRR = 2.53;
  $CAN_RadarFC::RFC_Veh_SensorConfig::RFC_Veh_SenConfig_WheelTrack = 1.7;
  $CAN_RadarFC::RFC_Veh_SensorConfig::RFC_Veh_SenConfig_dxvFrontBumper = 3.85;
  $CAN_RadarFC::RFC_Veh_SensorConfig::RFC_Veh_SenConfig_dxvRearBumper = -0.95;
  $CAN_RadarFC::RFC_Veh_SensorConfig::RFC_Veh_SenConfig_vCh = 30;
  }
  if(init_count == 2)
  {
  sysSetVariableData(sysvar::CAN_RadarFL::RFL_Veh_ConfigMgmt::RFL_Veh_ConfigMgmt::SignalValue, RFL_Veh_ConfigMgmt_byte_Array, 20);
  $CAN_RadarFL::RFL_Veh_SensorConfig::RFL_Veh_SenConfig_AccLongSensPos = 0.16;
  $CAN_RadarFL::RFL_Veh_SensorConfig::RFL_Veh_SenConfig_ConfigData = 2;
  $CAN_RadarFL::RFL_Veh_SensorConfig::RFL_Veh_SenConfig_CountryCode = 0;
  $CAN_RadarFL::RFL_Veh_SensorConfig::RFL_Veh_SenConfig_GradSideSlipAng = 0.004;
  $CAN_RadarFL::RFL_Veh_SensorConfig::RFL_Veh_SenConfig_PosX = 3.58;
  $CAN_RadarFL::RFL_Veh_SensorConfig::RFL_Veh_SenConfig_PosY = 0.89;
  $CAN_RadarFL::RFL_Veh_SensorConfig::RFL_Veh_SenConfig_PosZ = 0.65;
  $CAN_RadarFL::RFL_Veh_SensorConfig::RFL_Veh_SenConfig_SnsTimeOffset = 11;
  $CAN_RadarFL::RFL_Veh_SensorConfig::RFL_Veh_SenConfig_SnsrOrientNomPitch = 0;
  $CAN_RadarFL::RFL_Veh_SensorConfig::RFL_Veh_SenConfig_SnsrOrientNomYaw = 1.0472;
  $CAN_RadarFL::RFL_Veh_SensorConfig::RFL_Veh_SenConfig_SnsrOrientation = 0;
  $CAN_RadarFL::RFL_Veh_SensorConfig::RFL_Veh_SenConfig_StrRackRatio = 18;
  $CAN_RadarFL::RFL_Veh_SensorConfig::RFL_Veh_SenConfig_SyncType = 1;
  $CAN_RadarFL::RFL_Veh_SensorConfig::RFL_Veh_SenConfig_VehicleWidthMax = 2.1;
  $CAN_RadarFL::RFL_Veh_SensorConfig::RFL_Veh_SenConfig_VehicleWidthMin = 2;
  $CAN_RadarFL::RFL_Veh_SensorConfig::RFL_Veh_SenConfig_WheelBase = 3;
  $CAN_RadarFL::RFL_Veh_SensorConfig::RFL_Veh_SenConfig_WheelCircFL = 2.53;
  $CAN_RadarFL::RFL_Veh_SensorConfig::RFL_Veh_SenConfig_WheelCircFR = 2.53;
  $CAN_RadarFL::RFL_Veh_SensorConfig::RFL_Veh_SenConfig_WheelCircRL = 2.53;
  $CAN_RadarFL::RFL_Veh_SensorConfig::RFL_Veh_SenConfig_WheelCircRR = 2.53;
  $CAN_RadarFL::RFL_Veh_SensorConfig::RFL_Veh_SenConfig_WheelTrack = 1.7;
  $CAN_RadarFL::RFL_Veh_SensorConfig::RFL_Veh_SenConfig_dxvFrontBumper = 3.85;
  $CAN_RadarFL::RFL_Veh_SensorConfig::RFL_Veh_SenConfig_dxvRearBumper = -0.95;
  $CAN_RadarFL::RFL_Veh_SensorConfig::RFL_Veh_SenConfig_vCh = 30;
  }
  if(init_count == 3)
  {
  sysSetVariableData(sysvar::CAN_RadarFR::RFR_Veh_ConfigMgmt::RFR_Veh_ConfigMgmt::SignalValue, RFR_Veh_ConfigMgmt_byte_Array, 20);
  $CAN_RadarFR::RFR_Veh_SensorConfig::RFR_Veh_SenConfig_AccLongSensPos = 0.16;
  $CAN_RadarFR::RFR_Veh_SensorConfig::RFR_Veh_SenConfig_ConfigData = 3;
  $CAN_RadarFR::RFR_Veh_SensorConfig::RFR_Veh_SenConfig_CountryCode = 0;
  $CAN_RadarFR::RFR_Veh_SensorConfig::RFR_Veh_SenConfig_GradSideSlipAng = 0.004;
  $CAN_RadarFR::RFR_Veh_SensorConfig::RFR_Veh_SenConfig_PosX = 3.58;
  $CAN_RadarFR::RFR_Veh_SensorConfig::RFR_Veh_SenConfig_PosY = -0.9;
  $CAN_RadarFR::RFR_Veh_SensorConfig::RFR_Veh_SenConfig_PosZ = 0.65;
  $CAN_RadarFR::RFR_Veh_SensorConfig::RFR_Veh_SenConfig_SnsTimeOffset = 23;
  $CAN_RadarFR::RFR_Veh_SensorConfig::RFR_Veh_SenConfig_SnsrOrientNomPitch = 0;
  $CAN_RadarFR::RFR_Veh_SensorConfig::RFR_Veh_SenConfig_SnsrOrientNomYaw = -1.0472;
  $CAN_RadarFR::RFR_Veh_SensorConfig::RFR_Veh_SenConfig_SnsrOrientation = 0;
  $CAN_RadarFR::RFR_Veh_SensorConfig::RFR_Veh_SenConfig_StrRackRatio = 18;
  $CAN_RadarFR::RFR_Veh_SensorConfig::RFR_Veh_SenConfig_SyncType = 1;
  $CAN_RadarFR::RFR_Veh_SensorConfig::RFR_Veh_SenConfig_VehicleWidthMax = 2.1;
  $CAN_RadarFR::RFR_Veh_SensorConfig::RFR_Veh_SenConfig_VehicleWidthMin = 2;
  $CAN_RadarFR::RFR_Veh_SensorConfig::RFR_Veh_SenConfig_WheelBase = 3;
  $CAN_RadarFR::RFR_Veh_SensorConfig::RFR_Veh_SenConfig_WheelCircFL = 2.53;
  $CAN_RadarFR::RFR_Veh_SensorConfig::RFR_Veh_SenConfig_WheelCircFR = 2.53;
  $CAN_RadarFR::RFR_Veh_SensorConfig::RFR_Veh_SenConfig_WheelCircRL = 2.53;
  $CAN_RadarFR::RFR_Veh_SensorConfig::RFR_Veh_SenConfig_WheelCircRR = 2.53;
  $CAN_RadarFR::RFR_Veh_SensorConfig::RFR_Veh_SenConfig_WheelTrack = 1.7;
  $CAN_RadarFR::RFR_Veh_SensorConfig::RFR_Veh_SenConfig_dxvFrontBumper = 3.85;
  $CAN_RadarFR::RFR_Veh_SensorConfig::RFR_Veh_SenConfig_dxvRearBumper = -0.95;
  $CAN_RadarFR::RFR_Veh_SensorConfig::RFR_Veh_SenConfig_vCh = 30;
  }
  if(init_count == 4)
  {
  sysSetVariableData(sysvar::CAN_RadarRL::RRL_Veh_ConfigMgmt::RRL_Veh_ConfigMgmt::SignalValue, RRL_Veh_ConfigMgmt_byte_Array, 20);
  $CAN_RadarRL::RRL_Veh_SensorConfig::RRL_Veh_SenConfig_AccLongSensPos = 0.16;
  $CAN_RadarRL::RRL_Veh_SensorConfig::RRL_Veh_SenConfig_ConfigData = 4;
  $CAN_RadarRL::RRL_Veh_SensorConfig::RRL_Veh_SenConfig_CountryCode = 0;
  $CAN_RadarRL::RRL_Veh_SensorConfig::RRL_Veh_SenConfig_GradSideSlipAng = 0.004;
  $CAN_RadarRL::RRL_Veh_SensorConfig::RRL_Veh_SenConfig_PosX = -0.68;
  $CAN_RadarRL::RRL_Veh_SensorConfig::RRL_Veh_SenConfig_PosY = 0.89;
  $CAN_RadarRL::RRL_Veh_SensorConfig::RRL_Veh_SenConfig_PosZ = 0.65;
  $CAN_RadarRL::RRL_Veh_SensorConfig::RRL_Veh_SenConfig_SnsTimeOffset = 23;
  $CAN_RadarRL::RRL_Veh_SensorConfig::RRL_Veh_SenConfig_SnsrOrientNomPitch = 0;
  $CAN_RadarRL::RRL_Veh_SensorConfig::RRL_Veh_SenConfig_SnsrOrientNomYaw = 2.0942;
  $CAN_RadarRL::RRL_Veh_SensorConfig::RRL_Veh_SenConfig_SnsrOrientation = 0;
  $CAN_RadarRL::RRL_Veh_SensorConfig::RRL_Veh_SenConfig_StrRackRatio = 18;
  $CAN_RadarRL::RRL_Veh_SensorConfig::RRL_Veh_SenConfig_SyncType = 1;
  $CAN_RadarRL::RRL_Veh_SensorConfig::RRL_Veh_SenConfig_VehicleWidthMax = 2.1;
  $CAN_RadarRL::RRL_Veh_SensorConfig::RRL_Veh_SenConfig_VehicleWidthMin = 2;
  $CAN_RadarRL::RRL_Veh_SensorConfig::RRL_Veh_SenConfig_WheelBase = 3;
  $CAN_RadarRL::RRL_Veh_SensorConfig::RRL_Veh_SenConfig_WheelCircFL = 2.53;
  $CAN_RadarRL::RRL_Veh_SensorConfig::RRL_Veh_SenConfig_WheelCircFR = 2.53;
  $CAN_RadarRL::RRL_Veh_SensorConfig::RRL_Veh_SenConfig_WheelCircRL = 2.53;
  $CAN_RadarRL::RRL_Veh_SensorConfig::RRL_Veh_SenConfig_WheelCircRR = 2.53;
  $CAN_RadarRL::RRL_Veh_SensorConfig::RRL_Veh_SenConfig_WheelTrack = 1.7;
  $CAN_RadarRL::RRL_Veh_SensorConfig::RRL_Veh_SenConfig_dxvFrontBumper = 3.85;
  $CAN_RadarRL::RRL_Veh_SensorConfig::RRL_Veh_SenConfig_dxvRearBumper = -0.95;
  $CAN_RadarRL::RRL_Veh_SensorConfig::RRL_Veh_SenConfig_vCh = 30;
  }
  if(init_count == 5)
  {
  sysSetVariableData(sysvar::CAN_RadarRR::RRR_Veh_ConfigMgmt::RRR_Veh_ConfigMgmt::SignalValue, RRR_Veh_ConfigMgmt_byte_Array, 20);
  $CAN_RadarRR::RRR_Veh_SensorConfig::RRR_Veh_SenConfig_AccLongSensPos = 0.16;
  $CAN_RadarRR::RRR_Veh_SensorConfig::RRR_Veh_SenConfig_ConfigData = 5;
  $CAN_RadarRR::RRR_Veh_SensorConfig::RRR_Veh_SenConfig_CountryCode = 0;
  $CAN_RadarRR::RRR_Veh_SensorConfig::RRR_Veh_SenConfig_GradSideSlipAng = 0.004;
  $CAN_RadarRR::RRR_Veh_SensorConfig::RRR_Veh_SenConfig_PosX = -0.68;
  $CAN_RadarRR::RRR_Veh_SensorConfig::RRR_Veh_SenConfig_PosY = -0.89;
  $CAN_RadarRR::RRR_Veh_SensorConfig::RRR_Veh_SenConfig_PosZ = 0.65;
  $CAN_RadarRR::RRR_Veh_SensorConfig::RRR_Veh_SenConfig_SnsTimeOffset = 11;
  $CAN_RadarRR::RRR_Veh_SensorConfig::RRR_Veh_SenConfig_SnsrOrientNomPitch = 0;
  $CAN_RadarRR::RRR_Veh_SensorConfig::RRR_Veh_SenConfig_SnsrOrientNomYaw = -2.0944;
  $CAN_RadarRR::RRR_Veh_SensorConfig::RRR_Veh_SenConfig_SnsrOrientation = 1;
  $CAN_RadarRR::RRR_Veh_SensorConfig::RRR_Veh_SenConfig_StrRackRatio = 18;
  $CAN_RadarRR::RRR_Veh_SensorConfig::RRR_Veh_SenConfig_SyncType = 1;
  $CAN_RadarRR::RRR_Veh_SensorConfig::RRR_Veh_SenConfig_VehicleWidthMax = 2.1;
  $CAN_RadarRR::RRR_Veh_SensorConfig::RRR_Veh_SenConfig_VehicleWidthMin = 2;
  $CAN_RadarRR::RRR_Veh_SensorConfig::RRR_Veh_SenConfig_WheelBase = 3;
  $CAN_RadarRR::RRR_Veh_SensorConfig::RRR_Veh_SenConfig_WheelCircFL = 2.53;
  $CAN_RadarRR::RRR_Veh_SensorConfig::RRR_Veh_SenConfig_WheelCircFR = 2.53;
  $CAN_RadarRR::RRR_Veh_SensorConfig::RRR_Veh_SenConfig_WheelCircRL = 2.53;
  $CAN_RadarRR::RRR_Veh_SensorConfig::RRR_Veh_SenConfig_WheelCircRR = 2.53;
  $CAN_RadarRR::RRR_Veh_SensorConfig::RRR_Veh_SenConfig_WheelTrack = 1.7;
  $CAN_RadarRR::RRR_Veh_SensorConfig::RRR_Veh_SenConfig_dxvFrontBumper = 3.85;
  $CAN_RadarRR::RRR_Veh_SensorConfig::RRR_Veh_SenConfig_dxvRearBumper = -0.95;
  $CAN_RadarRR::RRR_Veh_SensorConfig::RRR_Veh_SenConfig_vCh = 30;
  }
  if(init_count == 6)
  {
  $CAN_RadarFC::Veh_SensorInput::RFC_Veh_SenIn_ABSActive = 0;
  $CAN_RadarFC::Veh_SensorInput::RFC_Veh_SenIn_ASRActive = 0;
  $CAN_RadarFC::Veh_SensorInput::RFC_Veh_SenIn_AirAmb_Temp = -40;
  $CAN_RadarFC::Veh_SensorInput::RFC_Veh_SenIn_AngleStrWhlQf = 3;
  $CAN_RadarFC::Veh_SensorInput::RFC_Veh_SenIn_ECU_Input_Vltg = 12;
  $CAN_RadarFC::Veh_SensorInput::RFC_Veh_SenIn_ESPActive = 0;
  $CAN_RadarFC::Veh_SensorInput::RFC_Veh_SenIn_ESPEnabled = 1;
  $CAN_RadarFC::Veh_SensorInput::RFC_Veh_SenIn_GearLvr_D_ActlDrv = 0;
  $CAN_RadarFC::Veh_SensorInput::RFC_Veh_SenIn_HmiAExRevEgo_Cust = 0;
  $CAN_RadarFC::Veh_SensorInput::RFC_Veh_SenIn_HmiAExRevEgo_Switch = 0;
  $CAN_RadarFC::Veh_SensorInput::RFC_Veh_SenIn_HmiBsdLca_Cust = 0;
  $CAN_RadarFC::Veh_SensorInput::RFC_Veh_SenIn_HmiBsdLca_Switch = 0;
  $CAN_RadarFC::Veh_SensorInput::RFC_Veh_SenIn_HmiDOx_Cust = 3;
  $CAN_RadarFC::Veh_SensorInput::RFC_Veh_SenIn_HmiDOx_Switch = 0;
  $CAN_RadarFC::Veh_SensorInput::RFC_Veh_SenIn_LatAccel = 0.02;
  $CAN_RadarFC::Veh_SensorInput::RFC_Veh_SenIn_LatAccelQf = 3;
  $CAN_RadarFC::Veh_SensorInput::RFC_Veh_SenIn_LeFrntDoorStatus = 0;
  $CAN_RadarFC::Veh_SensorInput::RFC_Veh_SenIn_LeReDoorStatus = 0;
  $CAN_RadarFC::Veh_SensorInput::RFC_Veh_SenIn_LongAccel = 0.02;
  $CAN_RadarFC::Veh_SensorInput::RFC_Veh_SenIn_LongAccelQf = 3;
  $CAN_RadarFC::Veh_SensorInput::RFC_Veh_SenIn_Odometer_ET = 0;
  $CAN_RadarFC::Veh_SensorInput::RFC_Veh_SenIn_RadioAstronomy = 0;
  $CAN_RadarFC::Veh_SensorInput::RFC_Veh_SenIn_RiFrntDoorStatus = 0;
  $CAN_RadarFC::Veh_SensorInput::RFC_Veh_SenIn_RiReDoorStatus = 0;
  $CAN_RadarFC::Veh_SensorInput::RFC_Veh_SenIn_StrWhlAngSpd = 0;
  }
  if(init_count == 7)
  {
  $CAN_RadarFC::Veh_SensorInput::RFC_Veh_SenIn_StrWhlAngle = 0;
  $CAN_RadarFC::Veh_SensorInput::RFC_Veh_SenIn_TrailerConnSt = 0;
  $CAN_RadarFC::Veh_SensorInput::RFC_Veh_SenIn_TurnIndrSt = 0;
  $CAN_RadarFC::Veh_SensorInput::RFC_Veh_SenIn_VSUActvtyStat = 0;
  $CAN_RadarFC::Veh_SensorInput::RFC_Veh_SenIn_VSUInhbtStat = 1;
  $CAN_RadarFC::Veh_SensorInput::RFC_Veh_SenIn_VehCfgParamLearnReq = 0;
  $CAN_RadarFC::Veh_SensorInput::RFC_Veh_SenIn_VehOverGnd_Est = 0;
  $CAN_RadarFC::Veh_SensorInput::RFC_Veh_SenIn_VehOverGnd_EstQf = 3;
  $CAN_RadarFC::Veh_SensorInput::RFC_Veh_SenIn_VehPwrModStat = 32;
  $CAN_RadarFC::Veh_SensorInput::RFC_Veh_SenIn_VehPwrModStatQf = 3;
  $CAN_RadarFC::Veh_SensorInput::RFC_Veh_SenIn_WheelDirFL = 0;
  $CAN_RadarFC::Veh_SensorInput::RFC_Veh_SenIn_WheelDirFR = 0;
  $CAN_RadarFC::Veh_SensorInput::RFC_Veh_SenIn_WheelDirRL = 0;
  $CAN_RadarFC::Veh_SensorInput::RFC_Veh_SenIn_WheelDirRR = 0;
  $CAN_RadarFC::Veh_SensorInput::RFC_Veh_SenIn_WheelSpeedFL = 0;
  $CAN_RadarFC::Veh_SensorInput::RFC_Veh_SenIn_WheelSpeedFLQf = 3;
  $CAN_RadarFC::Veh_SensorInput::RFC_Veh_SenIn_WheelSpeedFR = 0;
  $CAN_RadarFC::Veh_SensorInput::RFC_Veh_SenIn_WheelSpeedFRQf = 3;
  $CAN_RadarFC::Veh_SensorInput::RFC_Veh_SenIn_WheelSpeedRL = 0;
  $CAN_RadarFC::Veh_SensorInput::RFC_Veh_SenIn_WheelSpeedRLQf = 3;
  $CAN_RadarFC::Veh_SensorInput::RFC_Veh_SenIn_WheelSpeedRR = 0;
  $CAN_RadarFC::Veh_SensorInput::RFC_Veh_SenIn_WheelSpeedRRQf = 3;
  $CAN_RadarFC::Veh_SensorInput::RFC_Veh_SenIn_WheelTicksFL = 0;
  $CAN_RadarFC::Veh_SensorInput::RFC_Veh_SenIn_WheelTicksFR = 0;
  $CAN_RadarFC::Veh_SensorInput::RFC_Veh_SenIn_WheelTicksRL = 0;
  }
  if(init_count == 8)
  {
  $CAN_RadarFC::Veh_SensorInput::RFC_Veh_SenIn_WheelTicksRR = 0;
  $CAN_RadarFC::Veh_SensorInput::RFC_Veh_SenIn_WhlSpdTimestmpCmpFL = 0;
  $CAN_RadarFC::Veh_SensorInput::RFC_Veh_SenIn_WhlSpdTimestmpCmpFR = 0;
  $CAN_RadarFC::Veh_SensorInput::RFC_Veh_SenIn_WhlSpdTimestmpCmpRL = 0;
  $CAN_RadarFC::Veh_SensorInput::RFC_Veh_SenIn_WhlSpdTimestmpCmpRR = 0;
  $CAN_RadarFC::Veh_SensorInput::RFC_Veh_SenIn_WiperFrontSt = 0;
  $CAN_RadarFC::Veh_SensorInput::RFC_Veh_SenIn_WiperRearSt = 0;
  $CAN_RadarFC::Veh_SensorInput::RFC_Veh_SenIn_YawRate = -0.1283;
  $CAN_RadarFC::Veh_SensorInput::RFC_Veh_SenIn_YawRateQf = 3;
  $CAN_RadarFC::Veh_SensorInput::RFC_Veh_SenIn_YawRateTimestmpCmp = 0;
  $CAN_RadarFL::Veh_SensorInput::RFL_Veh_SenIn_ABSActive = 0;
  $CAN_RadarFL::Veh_SensorInput::RFL_Veh_SenIn_ASRActive = 0;
  $CAN_RadarFL::Veh_SensorInput::RFL_Veh_SenIn_AirAmb_Temp = -40;
  $CAN_RadarFL::Veh_SensorInput::RFL_Veh_SenIn_AngleStrWhlQf = 3;
  $CAN_RadarFL::Veh_SensorInput::RFL_Veh_SenIn_ECU_Input_Vltg = 12;
  $CAN_RadarFL::Veh_SensorInput::RFL_Veh_SenIn_ESPActive = 0;
  $CAN_RadarFL::Veh_SensorInput::RFL_Veh_SenIn_ESPEnabled = 1;
  $CAN_RadarFL::Veh_SensorInput::RFL_Veh_SenIn_GearLvr_D_ActlDrv = 0;
  $CAN_RadarFL::Veh_SensorInput::RFL_Veh_SenIn_HmiAExRevEgo_Cust = 0;
  $CAN_RadarFL::Veh_SensorInput::RFL_Veh_SenIn_HmiAExRevEgo_Switch = 0;
  $CAN_RadarFL::Veh_SensorInput::RFL_Veh_SenIn_HmiBsdLca_Cust = 0;
  $CAN_RadarFL::Veh_SensorInput::RFL_Veh_SenIn_HmiBsdLca_Switch = 0;
  $CAN_RadarFL::Veh_SensorInput::RFL_Veh_SenIn_HmiDOx_Cust = 3;
  $CAN_RadarFL::Veh_SensorInput::RFL_Veh_SenIn_HmiDOx_Switch = 0;
  $CAN_RadarFL::Veh_SensorInput::RFL_Veh_SenIn_LatAccel = 0.02;
  }
  if(init_count == 9)
  {
  $CAN_RadarFL::Veh_SensorInput::RFL_Veh_SenIn_LatAccelQf = 3;
  $CAN_RadarFL::Veh_SensorInput::RFL_Veh_SenIn_LeFrntDoorStatus = 0;
  $CAN_RadarFL::Veh_SensorInput::RFL_Veh_SenIn_LeReDoorStatus = 0;
  $CAN_RadarFL::Veh_SensorInput::RFL_Veh_SenIn_LongAccel = 0.02;
  $CAN_RadarFL::Veh_SensorInput::RFL_Veh_SenIn_LongAccelQf = 3;
  $CAN_RadarFL::Veh_SensorInput::RFL_Veh_SenIn_Odometer_ET = 0;
  $CAN_RadarFL::Veh_SensorInput::RFL_Veh_SenIn_RadioAstronomy = 0;
  $CAN_RadarFL::Veh_SensorInput::RFL_Veh_SenIn_RiFrntDoorStatus = 0;
  $CAN_RadarFL::Veh_SensorInput::RFL_Veh_SenIn_RiReDoorStatus = 0;
  $CAN_RadarFL::Veh_SensorInput::RFL_Veh_SenIn_StrWhlAngSpd = 0;
  $CAN_RadarFL::Veh_SensorInput::RFL_Veh_SenIn_StrWhlAngle = 0;
  $CAN_RadarFL::Veh_SensorInput::RFL_Veh_SenIn_TrailerConnSt = 0;
  $CAN_RadarFL::Veh_SensorInput::RFL_Veh_SenIn_TurnIndrSt = 0;
  $CAN_RadarFL::Veh_SensorInput::RFL_Veh_SenIn_VSUActvtyStat = 0;
  $CAN_RadarFL::Veh_SensorInput::RFL_Veh_SenIn_VSUInhbtStat = 1;
  $CAN_RadarFL::Veh_SensorInput::RFL_Veh_SenIn_VehCfgParamLearnReq = 0;
  $CAN_RadarFL::Veh_SensorInput::RFL_Veh_SenIn_VehOverGnd_Est = 0;
  $CAN_RadarFL::Veh_SensorInput::RFL_Veh_SenIn_VehOverGnd_EstQf = 3;
  $CAN_RadarFL::Veh_SensorInput::RFL_Veh_SenIn_VehPwrModStat = 32;
  $CAN_RadarFL::Veh_SensorInput::RFL_Veh_SenIn_VehPwrModStatQf = 3;
  $CAN_RadarFL::Veh_SensorInput::RFL_Veh_SenIn_WheelDirFL = 0;
  $CAN_RadarFL::Veh_SensorInput::RFL_Veh_SenIn_WheelDirFR = 0;
  $CAN_RadarFL::Veh_SensorInput::RFL_Veh_SenIn_WheelDirRL = 0;
  $CAN_RadarFL::Veh_SensorInput::RFL_Veh_SenIn_WheelDirRR = 0;
  $CAN_RadarFL::Veh_SensorInput::RFL_Veh_SenIn_WheelSpeedFL = 0;
  }
  if(init_count == 10)
  {
  $CAN_RadarFL::Veh_SensorInput::RFL_Veh_SenIn_WheelSpeedFLQf = 3;
  $CAN_RadarFL::Veh_SensorInput::RFL_Veh_SenIn_WheelSpeedFR = 0;
  $CAN_RadarFL::Veh_SensorInput::RFL_Veh_SenIn_WheelSpeedFRQf = 3;
  $CAN_RadarFL::Veh_SensorInput::RFL_Veh_SenIn_WheelSpeedRL = 0;
  $CAN_RadarFL::Veh_SensorInput::RFL_Veh_SenIn_WheelSpeedRLQf = 3;
  $CAN_RadarFL::Veh_SensorInput::RFL_Veh_SenIn_WheelSpeedRR = 0;
  $CAN_RadarFL::Veh_SensorInput::RFL_Veh_SenIn_WheelSpeedRRQf = 3;
  $CAN_RadarFL::Veh_SensorInput::RFL_Veh_SenIn_WheelTicksFL = 0;
  $CAN_RadarFL::Veh_SensorInput::RFL_Veh_SenIn_WheelTicksFR = 0;
  $CAN_RadarFL::Veh_SensorInput::RFL_Veh_SenIn_WheelTicksRL = 0;
  $CAN_RadarFL::Veh_SensorInput::RFL_Veh_SenIn_WheelTicksRR = 0;
  $CAN_RadarFL::Veh_SensorInput::RFL_Veh_SenIn_WhlSpdTimestmpCmpFL = 0;
  $CAN_RadarFL::Veh_SensorInput::RFL_Veh_SenIn_WhlSpdTimestmpCmpFR = 0;
  $CAN_RadarFL::Veh_SensorInput::RFL_Veh_SenIn_WhlSpdTimestmpCmpRL = 0;
  $CAN_RadarFL::Veh_SensorInput::RFL_Veh_SenIn_WhlSpdTimestmpCmpRR = 0;
  $CAN_RadarFL::Veh_SensorInput::RFL_Veh_SenIn_WiperFrontSt = 0;
  $CAN_RadarFL::Veh_SensorInput::RFL_Veh_SenIn_WiperRearSt = 0;
  $CAN_RadarFL::Veh_SensorInput::RFL_Veh_SenIn_YawRate = -0.1283;
  $CAN_RadarFL::Veh_SensorInput::RFL_Veh_SenIn_YawRateQf = 3;
  $CAN_RadarFL::Veh_SensorInput::RFL_Veh_SenIn_YawRateTimestmpCmp = 0;
  $CAN_RadarFR::Veh_SensorInput::RFR_Veh_SenIn_ABSActive = 0;
  $CAN_RadarFR::Veh_SensorInput::RFR_Veh_SenIn_ASRActive = 0;
  $CAN_RadarFR::Veh_SensorInput::RFR_Veh_SenIn_AirAmb_Temp = -40;
  $CAN_RadarFR::Veh_SensorInput::RFR_Veh_SenIn_AngleStrWhlQf = 3;
  $CAN_RadarFR::Veh_SensorInput::RFR_Veh_SenIn_ECU_Input_Vltg = 12;
  }
  if(init_count == 11)
  {
  $CAN_RadarFR::Veh_SensorInput::RFR_Veh_SenIn_ESPActive = 0;
  $CAN_RadarFR::Veh_SensorInput::RFR_Veh_SenIn_ESPEnabled = 1;
  $CAN_RadarFR::Veh_SensorInput::RFR_Veh_SenIn_GearLvr_D_ActlDrv = 0;
  $CAN_RadarFR::Veh_SensorInput::RFR_Veh_SenIn_HmiAExRevEgo_Cust = 0;
  $CAN_RadarFR::Veh_SensorInput::RFR_Veh_SenIn_HmiAExRevEgo_Switch = 0;
  $CAN_RadarFR::Veh_SensorInput::RFR_Veh_SenIn_HmiBsdLca_Cust = 0;
  $CAN_RadarFR::Veh_SensorInput::RFR_Veh_SenIn_HmiBsdLca_Switch = 0;
  $CAN_RadarFR::Veh_SensorInput::RFR_Veh_SenIn_HmiDOx_Cust = 3;
  $CAN_RadarFR::Veh_SensorInput::RFR_Veh_SenIn_HmiDOx_Switch = 0;
  $CAN_RadarFR::Veh_SensorInput::RFR_Veh_SenIn_LatAccel = 0.02;
  $CAN_RadarFR::Veh_SensorInput::RFR_Veh_SenIn_LatAccelQf = 3;
  $CAN_RadarFR::Veh_SensorInput::RFR_Veh_SenIn_LeFrntDoorStatus = 0;
  $CAN_RadarFR::Veh_SensorInput::RFR_Veh_SenIn_LeReDoorStatus = 0;
  $CAN_RadarFR::Veh_SensorInput::RFR_Veh_SenIn_LongAccel = 0.02;
  $CAN_RadarFR::Veh_SensorInput::RFR_Veh_SenIn_LongAccelQf = 3;
  $CAN_RadarFR::Veh_SensorInput::RFR_Veh_SenIn_Odometer_ET = 0;
  $CAN_RadarFR::Veh_SensorInput::RFR_Veh_SenIn_RadioAstronomy = 0;
  $CAN_RadarFR::Veh_SensorInput::RFR_Veh_SenIn_RiFrntDoorStatus = 0;
  $CAN_RadarFR::Veh_SensorInput::RFR_Veh_SenIn_RiReDoorStatus = 0;
  $CAN_RadarFR::Veh_SensorInput::RFR_Veh_SenIn_StrWhlAngSpd = 0;
  $CAN_RadarFR::Veh_SensorInput::RFR_Veh_SenIn_StrWhlAngle = 0;
  $CAN_RadarFR::Veh_SensorInput::RFR_Veh_SenIn_TrailerConnSt = 0;
  $CAN_RadarFR::Veh_SensorInput::RFR_Veh_SenIn_TurnIndrSt = 0;
  $CAN_RadarFR::Veh_SensorInput::RFR_Veh_SenIn_VSUActvtyStat = 0;
  $CAN_RadarFR::Veh_SensorInput::RFR_Veh_SenIn_VSUInhbtStat = 1;
  }
  if(init_count == 12)
  {
  $CAN_RadarFR::Veh_SensorInput::RFR_Veh_SenIn_VehCfgParamLearnReq = 0;
  $CAN_RadarFR::Veh_SensorInput::RFR_Veh_SenIn_VehOverGnd_Est = 0;
  $CAN_RadarFR::Veh_SensorInput::RFR_Veh_SenIn_VehOverGnd_EstQf = 3;
  $CAN_RadarFR::Veh_SensorInput::RFR_Veh_SenIn_VehPwrModStat = 32;
  $CAN_RadarFR::Veh_SensorInput::RFR_Veh_SenIn_VehPwrModStatQf = 3;
  $CAN_RadarFR::Veh_SensorInput::RFR_Veh_SenIn_WheelDirFL = 0;
  $CAN_RadarFR::Veh_SensorInput::RFR_Veh_SenIn_WheelDirFR = 0;
  $CAN_RadarFR::Veh_SensorInput::RFR_Veh_SenIn_WheelDirRL = 0;
  $CAN_RadarFR::Veh_SensorInput::RFR_Veh_SenIn_WheelDirRR = 0;
  $CAN_RadarFR::Veh_SensorInput::RFR_Veh_SenIn_WheelSpeedFL = 0;
  $CAN_RadarFR::Veh_SensorInput::RFR_Veh_SenIn_WheelSpeedFLQf = 3;
  $CAN_RadarFR::Veh_SensorInput::RFR_Veh_SenIn_WheelSpeedFR = 0;
  $CAN_RadarFR::Veh_SensorInput::RFR_Veh_SenIn_WheelSpeedFRQf = 3;
  $CAN_RadarFR::Veh_SensorInput::RFR_Veh_SenIn_WheelSpeedRL = 0;
  $CAN_RadarFR::Veh_SensorInput::RFR_Veh_SenIn_WheelSpeedRLQf = 3;
  $CAN_RadarFR::Veh_SensorInput::RFR_Veh_SenIn_WheelSpeedRR = 0;
  $CAN_RadarFR::Veh_SensorInput::RFR_Veh_SenIn_WheelSpeedRRQf = 3;
  $CAN_RadarFR::Veh_SensorInput::RFR_Veh_SenIn_WheelTicksFL = 0;
  $CAN_RadarFR::Veh_SensorInput::RFR_Veh_SenIn_WheelTicksFR = 0;
  $CAN_RadarFR::Veh_SensorInput::RFR_Veh_SenIn_WheelTicksRL = 0;
  $CAN_RadarFR::Veh_SensorInput::RFR_Veh_SenIn_WheelTicksRR = 0;
  $CAN_RadarFR::Veh_SensorInput::RFR_Veh_SenIn_WhlSpdTimestmpCmpFL = 0;
  $CAN_RadarFR::Veh_SensorInput::RFR_Veh_SenIn_WhlSpdTimestmpCmpFR = 0;
  $CAN_RadarFR::Veh_SensorInput::RFR_Veh_SenIn_WhlSpdTimestmpCmpRL = 0;
  $CAN_RadarFR::Veh_SensorInput::RFR_Veh_SenIn_WhlSpdTimestmpCmpRR = 0;
  }
  if(init_count == 13)
  {
  $CAN_RadarFR::Veh_SensorInput::RFR_Veh_SenIn_WiperFrontSt = 0;
  $CAN_RadarFR::Veh_SensorInput::RFR_Veh_SenIn_WiperRearSt = 0;
  $CAN_RadarFR::Veh_SensorInput::RFR_Veh_SenIn_YawRate = -0.1283;
  $CAN_RadarFR::Veh_SensorInput::RFR_Veh_SenIn_YawRateQf = 3;
  $CAN_RadarFR::Veh_SensorInput::RFR_Veh_SenIn_YawRateTimestmpCmp = 0;
  $CAN_RadarRL::Veh_SensorInput::RRL_Veh_SenIn_ABSActive = 0;
  $CAN_RadarRL::Veh_SensorInput::RRL_Veh_SenIn_ASRActive = 0;
  $CAN_RadarRL::Veh_SensorInput::RRL_Veh_SenIn_AirAmb_Temp = -40;
  $CAN_RadarRL::Veh_SensorInput::RRL_Veh_SenIn_AngleStrWhlQf = 3;
  $CAN_RadarRL::Veh_SensorInput::RRL_Veh_SenIn_ECU_Input_Vltg = 12;
  $CAN_RadarRL::Veh_SensorInput::RRL_Veh_SenIn_ESPActive = 0;
  $CAN_RadarRL::Veh_SensorInput::RRL_Veh_SenIn_ESPEnabled = 1;
  $CAN_RadarRL::Veh_SensorInput::RRL_Veh_SenIn_GearLvr_D_ActlDrv = 0;
  $CAN_RadarRL::Veh_SensorInput::RRL_Veh_SenIn_HmiAExRevEgo_Cust = 0;
  $CAN_RadarRL::Veh_SensorInput::RRL_Veh_SenIn_HmiAExRevEgo_Switch = 0;
  $CAN_RadarRL::Veh_SensorInput::RRL_Veh_SenIn_HmiBsdLca_Cust = 0;
  $CAN_RadarRL::Veh_SensorInput::RRL_Veh_SenIn_HmiBsdLca_Switch = 0;
  $CAN_RadarRL::Veh_SensorInput::RRL_Veh_SenIn_HmiDOx_Cust = 3;
  $CAN_RadarRL::Veh_SensorInput::RRL_Veh_SenIn_HmiDOx_Switch = 0;
  $CAN_RadarRL::Veh_SensorInput::RRL_Veh_SenIn_LatAccel = 0.02;
  $CAN_RadarRL::Veh_SensorInput::RRL_Veh_SenIn_LatAccelQf = 3;
  $CAN_RadarRL::Veh_SensorInput::RRL_Veh_SenIn_LeFrntDoorStatus = 0;
  $CAN_RadarRL::Veh_SensorInput::RRL_Veh_SenIn_LeReDoorStatus = 0;
  $CAN_RadarRL::Veh_SensorInput::RRL_Veh_SenIn_LongAccel = 0.02;
  $CAN_RadarRL::Veh_SensorInput::RRL_Veh_SenIn_LongAccelQf = 3;
  }
  if(init_count == 14)
  {
  $CAN_RadarRL::Veh_SensorInput::RRL_Veh_SenIn_Odometer_ET = 0;
  $CAN_RadarRL::Veh_SensorInput::RRL_Veh_SenIn_RadioAstronomy = 0;
  $CAN_RadarRL::Veh_SensorInput::RRL_Veh_SenIn_RiFrntDoorStatus = 0;
  $CAN_RadarRL::Veh_SensorInput::RRL_Veh_SenIn_RiReDoorStatus = 0;
  $CAN_RadarRL::Veh_SensorInput::RRL_Veh_SenIn_StrWhlAngSpd = 0;
  $CAN_RadarRL::Veh_SensorInput::RRL_Veh_SenIn_StrWhlAngle = 0;
  $CAN_RadarRL::Veh_SensorInput::RRL_Veh_SenIn_TrailerConnSt = 0;
  $CAN_RadarRL::Veh_SensorInput::RRL_Veh_SenIn_TurnIndrSt = 0;
  $CAN_RadarRL::Veh_SensorInput::RRL_Veh_SenIn_VSUActvtyStat = 0;
  $CAN_RadarRL::Veh_SensorInput::RRL_Veh_SenIn_VSUInhbtStat = 1;
  $CAN_RadarRL::Veh_SensorInput::RRL_Veh_SenIn_VehCfgParamLearnReq = 0;
  $CAN_RadarRL::Veh_SensorInput::RRL_Veh_SenIn_VehOverGnd_Est = 0;
  $CAN_RadarRL::Veh_SensorInput::RRL_Veh_SenIn_VehOverGnd_EstQf = 3;
  $CAN_RadarRL::Veh_SensorInput::RRL_Veh_SenIn_VehPwrModStat = 32;
  $CAN_RadarRL::Veh_SensorInput::RRL_Veh_SenIn_VehPwrModStatQf = 3;
  $CAN_RadarRL::Veh_SensorInput::RRL_Veh_SenIn_WheelDirFL = 0;
  $CAN_RadarRL::Veh_SensorInput::RRL_Veh_SenIn_WheelDirFR = 0;
  $CAN_RadarRL::Veh_SensorInput::RRL_Veh_SenIn_WheelDirRL = 0;
  $CAN_RadarRL::Veh_SensorInput::RRL_Veh_SenIn_WheelDirRR = 0;
  $CAN_RadarRL::Veh_SensorInput::RRL_Veh_SenIn_WheelSpeedFL = 0;
  $CAN_RadarRL::Veh_SensorInput::RRL_Veh_SenIn_WheelSpeedFLQf = 3;
  $CAN_RadarRL::Veh_SensorInput::RRL_Veh_SenIn_WheelSpeedFR = 0;
  $CAN_RadarRL::Veh_SensorInput::RRL_Veh_SenIn_WheelSpeedFRQf = 3;
  $CAN_RadarRL::Veh_SensorInput::RRL_Veh_SenIn_WheelSpeedRL = 0;
  $CAN_RadarRL::Veh_SensorInput::RRL_Veh_SenIn_WheelSpeedRLQf = 3;
  }
  if(init_count == 15)
  {
  $CAN_RadarRL::Veh_SensorInput::RRL_Veh_SenIn_WheelSpeedRR = 0;
  $CAN_RadarRL::Veh_SensorInput::RRL_Veh_SenIn_WheelSpeedRRQf = 3;
  $CAN_RadarRL::Veh_SensorInput::RRL_Veh_SenIn_WheelTicksFL = 0;
  $CAN_RadarRL::Veh_SensorInput::RRL_Veh_SenIn_WheelTicksFR = 0;
  $CAN_RadarRL::Veh_SensorInput::RRL_Veh_SenIn_WheelTicksRL = 0;
  $CAN_RadarRL::Veh_SensorInput::RRL_Veh_SenIn_WheelTicksRR = 0;
  $CAN_RadarRL::Veh_SensorInput::RRL_Veh_SenIn_WhlSpdTimestmpCmpFL = 0;
  $CAN_RadarRL::Veh_SensorInput::RRL_Veh_SenIn_WhlSpdTimestmpCmpFR = 0;
  $CAN_RadarRL::Veh_SensorInput::RRL_Veh_SenIn_WhlSpdTimestmpCmpRL = 0;
  $CAN_RadarRL::Veh_SensorInput::RRL_Veh_SenIn_WhlSpdTimestmpCmpRR = 0;
  $CAN_RadarRL::Veh_SensorInput::RRL_Veh_SenIn_WiperFrontSt = 0;
  $CAN_RadarRL::Veh_SensorInput::RRL_Veh_SenIn_WiperRearSt = 0;
  $CAN_RadarRL::Veh_SensorInput::RRL_Veh_SenIn_YawRate = -0.1283;
  $CAN_RadarRL::Veh_SensorInput::RRL_Veh_SenIn_YawRateQf = 3;
  $CAN_RadarRL::Veh_SensorInput::RRL_Veh_SenIn_YawRateTimestmpCmp = 0;
  $CAN_RadarRR::Veh_SensorInput::RRR_Veh_SenIn_ABSActive = 0;
  $CAN_RadarRR::Veh_SensorInput::RRR_Veh_SenIn_ASRActive = 0;
  $CAN_RadarRR::Veh_SensorInput::RRR_Veh_SenIn_AirAmb_Temp = -40;
  $CAN_RadarRR::Veh_SensorInput::RRR_Veh_SenIn_AngleStrWhlQf = 3;
  $CAN_RadarRR::Veh_SensorInput::RRR_Veh_SenIn_ECU_Input_Vltg = 12;
  $CAN_RadarRR::Veh_SensorInput::RRR_Veh_SenIn_ESPActive = 0;
  $CAN_RadarRR::Veh_SensorInput::RRR_Veh_SenIn_ESPEnabled = 1;
  $CAN_RadarRR::Veh_SensorInput::RRR_Veh_SenIn_GearLvr_D_ActlDrv = 0;
  $CAN_RadarRR::Veh_SensorInput::RRR_Veh_SenIn_HmiAExRevEgo_Cust = 0;
  $CAN_RadarRR::Veh_SensorInput::RRR_Veh_SenIn_HmiAExRevEgo_Switch = 0;
  }
  if(init_count == 16)
  {
  $CAN_RadarRR::Veh_SensorInput::RRR_Veh_SenIn_HmiBsdLca_Cust = 0;
  $CAN_RadarRR::Veh_SensorInput::RRR_Veh_SenIn_HmiBsdLca_Switch = 0;
  $CAN_RadarRR::Veh_SensorInput::RRR_Veh_SenIn_HmiDOx_Cust = 3;
  $CAN_RadarRR::Veh_SensorInput::RRR_Veh_SenIn_HmiDOx_Switch = 0;
  $CAN_RadarRR::Veh_SensorInput::RRR_Veh_SenIn_LatAccel = 0.02;
  $CAN_RadarRR::Veh_SensorInput::RRR_Veh_SenIn_LatAccelQf = 3;
  $CAN_RadarRR::Veh_SensorInput::RRR_Veh_SenIn_LeFrntDoorStatus = 0;
  $CAN_RadarRR::Veh_SensorInput::RRR_Veh_SenIn_LeReDoorStatus = 0;
  $CAN_RadarRR::Veh_SensorInput::RRR_Veh_SenIn_LongAccel = 0.02;
  $CAN_RadarRR::Veh_SensorInput::RRR_Veh_SenIn_LongAccelQf = 3;
  $CAN_RadarRR::Veh_SensorInput::RRR_Veh_SenIn_Odometer_ET = 0;
  $CAN_RadarRR::Veh_SensorInput::RRR_Veh_SenIn_RadioAstronomy = 0;
  $CAN_RadarRR::Veh_SensorInput::RRR_Veh_SenIn_RiFrntDoorStatus = 0;
  $CAN_RadarRR::Veh_SensorInput::RRR_Veh_SenIn_RiReDoorStatus = 0;
  $CAN_RadarRR::Veh_SensorInput::RRR_Veh_SenIn_StrWhlAngSpd = 0;
  $CAN_RadarRR::Veh_SensorInput::RRR_Veh_SenIn_StrWhlAngle = 0;
  $CAN_RadarRR::Veh_SensorInput::RRR_Veh_SenIn_TrailerConnSt = 0;
  $CAN_RadarRR::Veh_SensorInput::RRR_Veh_SenIn_TurnIndrSt = 0;
  $CAN_RadarRR::Veh_SensorInput::RRR_Veh_SenIn_VSUActvtyStat = 0;
  $CAN_RadarRR::Veh_SensorInput::RRR_Veh_SenIn_VSUInhbtStat = 1;
  $CAN_RadarRR::Veh_SensorInput::RRR_Veh_SenIn_VehCfgParamLearnReq = 0;
  $CAN_RadarRR::Veh_SensorInput::RRR_Veh_SenIn_VehOverGnd_Est = 0;
  $CAN_RadarRR::Veh_SensorInput::RRR_Veh_SenIn_VehOverGnd_EstQf = 3;
  $CAN_RadarRR::Veh_SensorInput::RRR_Veh_SenIn_VehPwrModStat = 32;
  $CAN_RadarRR::Veh_SensorInput::RRR_Veh_SenIn_VehPwrModStatQf = 3;
  }
  if(init_count == 17)
  {
  $CAN_RadarRR::Veh_SensorInput::RRR_Veh_SenIn_WheelDirFL = 0;
  $CAN_RadarRR::Veh_SensorInput::RRR_Veh_SenIn_WheelDirFR = 0;
  $CAN_RadarRR::Veh_SensorInput::RRR_Veh_SenIn_WheelDirRL = 0;
  $CAN_RadarRR::Veh_SensorInput::RRR_Veh_SenIn_WheelDirRR = 0;
  $CAN_RadarRR::Veh_SensorInput::RRR_Veh_SenIn_WheelSpeedFL = 0;
  $CAN_RadarRR::Veh_SensorInput::RRR_Veh_SenIn_WheelSpeedFLQf = 3;
  $CAN_RadarRR::Veh_SensorInput::RRR_Veh_SenIn_WheelSpeedFR = 0;
  $CAN_RadarRR::Veh_SensorInput::RRR_Veh_SenIn_WheelSpeedFRQf = 3;
  $CAN_RadarRR::Veh_SensorInput::RRR_Veh_SenIn_WheelSpeedRL = 0;
  $CAN_RadarRR::Veh_SensorInput::RRR_Veh_SenIn_WheelSpeedRLQf = 3;
  $CAN_RadarRR::Veh_SensorInput::RRR_Veh_SenIn_WheelSpeedRR = 0;
  $CAN_RadarRR::Veh_SensorInput::RRR_Veh_SenIn_WheelSpeedRRQf = 3;
  $CAN_RadarRR::Veh_SensorInput::RRR_Veh_SenIn_WheelTicksFL = 0;
  $CAN_RadarRR::Veh_SensorInput::RRR_Veh_SenIn_WheelTicksFR = 0;
  $CAN_RadarRR::Veh_SensorInput::RRR_Veh_SenIn_WheelTicksRL = 0;
  $CAN_RadarRR::Veh_SensorInput::RRR_Veh_SenIn_WheelTicksRR = 0;
  $CAN_RadarRR::Veh_SensorInput::RRR_Veh_SenIn_WhlSpdTimestmpCmpFL = 0;
  $CAN_RadarRR::Veh_SensorInput::RRR_Veh_SenIn_WhlSpdTimestmpCmpFR = 0;
  $CAN_RadarRR::Veh_SensorInput::RRR_Veh_SenIn_WhlSpdTimestmpCmpRL = 0;
  $CAN_RadarRR::Veh_SensorInput::RRR_Veh_SenIn_WhlSpdTimestmpCmpRR = 0;
  $CAN_RadarRR::Veh_SensorInput::RRR_Veh_SenIn_WiperFrontSt = 0;
  $CAN_RadarRR::Veh_SensorInput::RRR_Veh_SenIn_WiperRearSt = 0;
  $CAN_RadarRR::Veh_SensorInput::RRR_Veh_SenIn_YawRate = -0.1283;
  $CAN_RadarRR::Veh_SensorInput::RRR_Veh_SenIn_YawRateQf = 3;
  $CAN_RadarRR::Veh_SensorInput::RRR_Veh_SenIn_YawRateTimestmpCmp = 0;
  if (prestart_mode==0) init_count = 0;
  initFlag = 9;
  }
  init_count++;
}
void init_CRadarFL_F150_OD()
{
  if(init_count == 1)
  {
  $CAN_RadarFL::RFL_CornerFunctions::RFL_CF_AEx_revEgoBrakingStatus = 0;
  $CAN_RadarFL::RFL_CornerFunctions::RFL_CF_AEx_revEgoWarnStatus = 0;
  $CAN_RadarFL::RFL_CornerFunctions::RFL_CF_AEx_revEgo_BrakeRequest = 0;
  $CAN_RadarFL::RFL_CornerFunctions::RFL_CF_AEx_revEgo_TargetDec = 0;
  $CAN_RadarFL::RFL_CornerFunctions::RFL_CF_AEx_revEgo_WarningLevel = 0;
  $CAN_RadarFL::RFL_CornerFunctions::RFL_CF_BsdLca_Status = 0;
  $CAN_RadarFL::RFL_CornerFunctions::RFL_CF_BsdLca_WarningLevel = 0;
  $CAN_RadarFL::RFL_CornerFunctions::RFL_CF_DOx_PrevStatus = 0;
  $CAN_RadarFL::RFL_CornerFunctions::RFL_CF_DOx_WarnStatus = 0;
  $CAN_RadarFL::RFL_CornerFunctions::RFL_CF_DOx_WarningLevel = 0;
  sysSetVariableData(sysvar::CAN_RadarFL::RFL_FieldDataCollection::RFL_FieldDataCollection::SignalValue, RFL_FieldDataCollection_byte_Array, 5000);
  @CAN_RadarFL::RFL_Object::RFL_Object_E2E_p44_dataId = 0;
  @CAN_RadarFL::RFL_Object::RFL_Object_E2E_p44_length = 0;
  @CAN_RadarFL::RFL_Object::RFL_Object_Obj10.Age = 0;
  @CAN_RadarFL::RFL_Object::RFL_Object_Obj10.Ax = 0;
  @CAN_RadarFL::RFL_Object::RFL_Object_Obj10.AxAyCoVnce = 0;
  @CAN_RadarFL::RFL_Object::RFL_Object_Obj10.AxVnce = 0;
  @CAN_RadarFL::RFL_Object::RFL_Object_Obj10.Ay = 0;
  @CAN_RadarFL::RFL_Object::RFL_Object_Obj10.AyVnce = 0;
  @CAN_RadarFL::RFL_Object::RFL_Object_Obj10.ExistProb = 0;
  @CAN_RadarFL::RFL_Object::RFL_Object_Obj10.FilterInformation = 0;
  @CAN_RadarFL::RFL_Object::RFL_Object_Obj10.Length = 0;
  @CAN_RadarFL::RFL_Object::RFL_Object_Obj10.LengthVnce = 0;
  @CAN_RadarFL::RFL_Object::RFL_Object_Obj10.MeasurementStatus = 0;
  @CAN_RadarFL::RFL_Object::RFL_Object_Obj10.MovingStatus = 0;
  }
  if(init_count == 2)
  {
  @CAN_RadarFL::RFL_Object::RFL_Object_Obj10.ObjId = 0;
  @CAN_RadarFL::RFL_Object::RFL_Object_Obj10.OrientationYaw = 0;
  @CAN_RadarFL::RFL_Object::RFL_Object_Obj10.OrientationYawVnce = 0;
  @CAN_RadarFL::RFL_Object::RFL_Object_Obj10.ProbClassConfidence = 0;
  @CAN_RadarFL::RFL_Object::RFL_Object_Obj10.ProbClassType = 0;
  @CAN_RadarFL::RFL_Object::RFL_Object_Obj10.Px = 0;
  @CAN_RadarFL::RFL_Object::RFL_Object_Obj10.PxAxCoVnce = 0;
  @CAN_RadarFL::RFL_Object::RFL_Object_Obj10.PxAyCoVnce = 0;
  @CAN_RadarFL::RFL_Object::RFL_Object_Obj10.PxPyCoVnce = 0;
  @CAN_RadarFL::RFL_Object::RFL_Object_Obj10.PxVnce = 0;
  @CAN_RadarFL::RFL_Object::RFL_Object_Obj10.PxVxCoVnce = 0;
  @CAN_RadarFL::RFL_Object::RFL_Object_Obj10.PxVyCoVnce = 0;
  @CAN_RadarFL::RFL_Object::RFL_Object_Obj10.Py = 0;
  @CAN_RadarFL::RFL_Object::RFL_Object_Obj10.PyAxCoVnce = 0;
  @CAN_RadarFL::RFL_Object::RFL_Object_Obj10.PyAyCoVnce = 0;
  @CAN_RadarFL::RFL_Object::RFL_Object_Obj10.PyVnce = 0;
  @CAN_RadarFL::RFL_Object::RFL_Object_Obj10.PyVxCoVnce = 0;
  @CAN_RadarFL::RFL_Object::RFL_Object_Obj10.PyVyCoVnce = 0;
  @CAN_RadarFL::RFL_Object::RFL_Object_Obj10.ReferencePoint = 0;
  @CAN_RadarFL::RFL_Object::RFL_Object_Obj10.Vx = 0;
  @CAN_RadarFL::RFL_Object::RFL_Object_Obj10.VxAxCoVnce = 0;
  @CAN_RadarFL::RFL_Object::RFL_Object_Obj10.VxAyCoVnce = 0;
  @CAN_RadarFL::RFL_Object::RFL_Object_Obj10.VxVnce = 0;
  @CAN_RadarFL::RFL_Object::RFL_Object_Obj10.VxVyCoVnce = 0;
  @CAN_RadarFL::RFL_Object::RFL_Object_Obj10.Vy = 0;
  }
  if(init_count == 3)
  {
  @CAN_RadarFL::RFL_Object::RFL_Object_Obj10.VyAxCoVnce = 0;
  @CAN_RadarFL::RFL_Object::RFL_Object_Obj10.VyAyCoVnce = 0;
  @CAN_RadarFL::RFL_Object::RFL_Object_Obj10.VyVnce = 0;
  @CAN_RadarFL::RFL_Object::RFL_Object_Obj10.Width = 0;
  @CAN_RadarFL::RFL_Object::RFL_Object_Obj10.WidthVnce = 0;
  @CAN_RadarFL::RFL_Object::RFL_Object_Obj11.Age = 0;
  @CAN_RadarFL::RFL_Object::RFL_Object_Obj11.Ax = 0;
  @CAN_RadarFL::RFL_Object::RFL_Object_Obj11.AxAyCoVnce = 0;
  @CAN_RadarFL::RFL_Object::RFL_Object_Obj11.AxVnce = 0;
  @CAN_RadarFL::RFL_Object::RFL_Object_Obj11.Ay = 0;
  @CAN_RadarFL::RFL_Object::RFL_Object_Obj11.AyVnce = 0;
  @CAN_RadarFL::RFL_Object::RFL_Object_Obj11.ExistProb = 0;
  @CAN_RadarFL::RFL_Object::RFL_Object_Obj11.FilterInformation = 0;
  @CAN_RadarFL::RFL_Object::RFL_Object_Obj11.Length = 0;
  @CAN_RadarFL::RFL_Object::RFL_Object_Obj11.LengthVnce = 0;
  @CAN_RadarFL::RFL_Object::RFL_Object_Obj11.MeasurementStatus = 0;
  @CAN_RadarFL::RFL_Object::RFL_Object_Obj11.MovingStatus = 0;
  @CAN_RadarFL::RFL_Object::RFL_Object_Obj11.ObjId = 0;
  @CAN_RadarFL::RFL_Object::RFL_Object_Obj11.OrientationYaw = 0;
  @CAN_RadarFL::RFL_Object::RFL_Object_Obj11.OrientationYawVnce = 0;
  @CAN_RadarFL::RFL_Object::RFL_Object_Obj11.ProbClassConfidence = 0;
  @CAN_RadarFL::RFL_Object::RFL_Object_Obj11.ProbClassType = 0;
  @CAN_RadarFL::RFL_Object::RFL_Object_Obj11.Px = 0;
  @CAN_RadarFL::RFL_Object::RFL_Object_Obj11.PxAxCoVnce = 0;
  @CAN_RadarFL::RFL_Object::RFL_Object_Obj11.PxAyCoVnce = 0;
  }
  if(init_count == 4)
  {
  @CAN_RadarFL::RFL_Object::RFL_Object_Obj11.PxPyCoVnce = 0;
  @CAN_RadarFL::RFL_Object::RFL_Object_Obj11.PxVnce = 0;
  @CAN_RadarFL::RFL_Object::RFL_Object_Obj11.PxVxCoVnce = 0;
  @CAN_RadarFL::RFL_Object::RFL_Object_Obj11.PxVyCoVnce = 0;
  @CAN_RadarFL::RFL_Object::RFL_Object_Obj11.Py = 0;
  @CAN_RadarFL::RFL_Object::RFL_Object_Obj11.PyAxCoVnce = 0;
  @CAN_RadarFL::RFL_Object::RFL_Object_Obj11.PyAyCoVnce = 0;
  @CAN_RadarFL::RFL_Object::RFL_Object_Obj11.PyVnce = 0;
  @CAN_RadarFL::RFL_Object::RFL_Object_Obj11.PyVxCoVnce = 0;
  @CAN_RadarFL::RFL_Object::RFL_Object_Obj11.PyVyCoVnce = 0;
  @CAN_RadarFL::RFL_Object::RFL_Object_Obj11.ReferencePoint = 0;
  @CAN_RadarFL::RFL_Object::RFL_Object_Obj11.Vx = 0;
  @CAN_RadarFL::RFL_Object::RFL_Object_Obj11.VxAxCoVnce = 0;
  @CAN_RadarFL::RFL_Object::RFL_Object_Obj11.VxAyCoVnce = 0;
  @CAN_RadarFL::RFL_Object::RFL_Object_Obj11.VxVnce = 0;
  @CAN_RadarFL::RFL_Object::RFL_Object_Obj11.VxVyCoVnce = 0;
  @CAN_RadarFL::RFL_Object::RFL_Object_Obj11.Vy = 0;
  @CAN_RadarFL::RFL_Object::RFL_Object_Obj11.VyAxCoVnce = 0;
  @CAN_RadarFL::RFL_Object::RFL_Object_Obj11.VyAyCoVnce = 0;
  @CAN_RadarFL::RFL_Object::RFL_Object_Obj11.VyVnce = 0;
  @CAN_RadarFL::RFL_Object::RFL_Object_Obj11.Width = 0;
  @CAN_RadarFL::RFL_Object::RFL_Object_Obj11.WidthVnce = 0;
  @CAN_RadarFL::RFL_Object::RFL_Object_Obj12.Age = 0;
  @CAN_RadarFL::RFL_Object::RFL_Object_Obj12.Ax = 0;
  @CAN_RadarFL::RFL_Object::RFL_Object_Obj12.AxAyCoVnce = 0;
  }
  if(init_count == 5)
  {
  @CAN_RadarFL::RFL_Object::RFL_Object_Obj12.AxVnce = 0;
  @CAN_RadarFL::RFL_Object::RFL_Object_Obj12.Ay = 0;
  @CAN_RadarFL::RFL_Object::RFL_Object_Obj12.AyVnce = 0;
  @CAN_RadarFL::RFL_Object::RFL_Object_Obj12.ExistProb = 0;
  @CAN_RadarFL::RFL_Object::RFL_Object_Obj12.FilterInformation = 0;
  @CAN_RadarFL::RFL_Object::RFL_Object_Obj12.Length = 0;
  @CAN_RadarFL::RFL_Object::RFL_Object_Obj12.LengthVnce = 0;
  @CAN_RadarFL::RFL_Object::RFL_Object_Obj12.MeasurementStatus = 0;
  @CAN_RadarFL::RFL_Object::RFL_Object_Obj12.MovingStatus = 0;
  @CAN_RadarFL::RFL_Object::RFL_Object_Obj12.ObjId = 0;
  @CAN_RadarFL::RFL_Object::RFL_Object_Obj12.OrientationYaw = 0;
  @CAN_RadarFL::RFL_Object::RFL_Object_Obj12.OrientationYawVnce = 0;
  @CAN_RadarFL::RFL_Object::RFL_Object_Obj12.ProbClassConfidence = 0;
  @CAN_RadarFL::RFL_Object::RFL_Object_Obj12.ProbClassType = 0;
  @CAN_RadarFL::RFL_Object::RFL_Object_Obj12.Px = 0;
  @CAN_RadarFL::RFL_Object::RFL_Object_Obj12.PxAxCoVnce = 0;
  @CAN_RadarFL::RFL_Object::RFL_Object_Obj12.PxAyCoVnce = 0;
  @CAN_RadarFL::RFL_Object::RFL_Object_Obj12.PxPyCoVnce = 0;
  @CAN_RadarFL::RFL_Object::RFL_Object_Obj12.PxVnce = 0;
  @CAN_RadarFL::RFL_Object::RFL_Object_Obj12.PxVxCoVnce = 0;
  @CAN_RadarFL::RFL_Object::RFL_Object_Obj12.PxVyCoVnce = 0;
  @CAN_RadarFL::RFL_Object::RFL_Object_Obj12.Py = 0;
  @CAN_RadarFL::RFL_Object::RFL_Object_Obj12.PyAxCoVnce = 0;
  @CAN_RadarFL::RFL_Object::RFL_Object_Obj12.PyAyCoVnce = 0;
  @CAN_RadarFL::RFL_Object::RFL_Object_Obj12.PyVnce = 0;
  }
  if(init_count == 6)
  {
  @CAN_RadarFL::RFL_Object::RFL_Object_Obj12.PyVxCoVnce = 0;
  @CAN_RadarFL::RFL_Object::RFL_Object_Obj12.PyVyCoVnce = 0;
  @CAN_RadarFL::RFL_Object::RFL_Object_Obj12.ReferencePoint = 0;
  @CAN_RadarFL::RFL_Object::RFL_Object_Obj12.Vx = 0;
  @CAN_RadarFL::RFL_Object::RFL_Object_Obj12.VxAxCoVnce = 0;
  @CAN_RadarFL::RFL_Object::RFL_Object_Obj12.VxAyCoVnce = 0;
  @CAN_RadarFL::RFL_Object::RFL_Object_Obj12.VxVnce = 0;
  @CAN_RadarFL::RFL_Object::RFL_Object_Obj12.VxVyCoVnce = 0;
  @CAN_RadarFL::RFL_Object::RFL_Object_Obj12.Vy = 0;
  @CAN_RadarFL::RFL_Object::RFL_Object_Obj12.VyAxCoVnce = 0;
  @CAN_RadarFL::RFL_Object::RFL_Object_Obj12.VyAyCoVnce = 0;
  @CAN_RadarFL::RFL_Object::RFL_Object_Obj12.VyVnce = 0;
  @CAN_RadarFL::RFL_Object::RFL_Object_Obj12.Width = 0;
  @CAN_RadarFL::RFL_Object::RFL_Object_Obj12.WidthVnce = 0;
  @CAN_RadarFL::RFL_Object::RFL_Object_Obj13.Age = 0;
  @CAN_RadarFL::RFL_Object::RFL_Object_Obj13.Ax = 0;
  @CAN_RadarFL::RFL_Object::RFL_Object_Obj13.AxAyCoVnce = 0;
  @CAN_RadarFL::RFL_Object::RFL_Object_Obj13.AxVnce = 0;
  @CAN_RadarFL::RFL_Object::RFL_Object_Obj13.Ay = 0;
  @CAN_RadarFL::RFL_Object::RFL_Object_Obj13.AyVnce = 0;
  @CAN_RadarFL::RFL_Object::RFL_Object_Obj13.ExistProb = 0;
  @CAN_RadarFL::RFL_Object::RFL_Object_Obj13.FilterInformation = 0;
  @CAN_RadarFL::RFL_Object::RFL_Object_Obj13.Length = 0;
  @CAN_RadarFL::RFL_Object::RFL_Object_Obj13.LengthVnce = 0;
  @CAN_RadarFL::RFL_Object::RFL_Object_Obj13.MeasurementStatus = 0;
  }
  if(init_count == 7)
  {
  @CAN_RadarFL::RFL_Object::RFL_Object_Obj13.MovingStatus = 0;
  @CAN_RadarFL::RFL_Object::RFL_Object_Obj13.ObjId = 0;
  @CAN_RadarFL::RFL_Object::RFL_Object_Obj13.OrientationYaw = 0;
  @CAN_RadarFL::RFL_Object::RFL_Object_Obj13.OrientationYawVnce = 0;
  @CAN_RadarFL::RFL_Object::RFL_Object_Obj13.ProbClassConfidence = 0;
  @CAN_RadarFL::RFL_Object::RFL_Object_Obj13.ProbClassType = 0;
  @CAN_RadarFL::RFL_Object::RFL_Object_Obj13.Px = 0;
  @CAN_RadarFL::RFL_Object::RFL_Object_Obj13.PxAxCoVnce = 0;
  @CAN_RadarFL::RFL_Object::RFL_Object_Obj13.PxAyCoVnce = 0;
  @CAN_RadarFL::RFL_Object::RFL_Object_Obj13.PxPyCoVnce = 0;
  @CAN_RadarFL::RFL_Object::RFL_Object_Obj13.PxVnce = 0;
  @CAN_RadarFL::RFL_Object::RFL_Object_Obj13.PxVxCoVnce = 0;
  @CAN_RadarFL::RFL_Object::RFL_Object_Obj13.PxVyCoVnce = 0;
  @CAN_RadarFL::RFL_Object::RFL_Object_Obj13.Py = 0;
  @CAN_RadarFL::RFL_Object::RFL_Object_Obj13.PyAxCoVnce = 0;
  @CAN_RadarFL::RFL_Object::RFL_Object_Obj13.PyAyCoVnce = 0;
  @CAN_RadarFL::RFL_Object::RFL_Object_Obj13.PyVnce = 0;
  @CAN_RadarFL::RFL_Object::RFL_Object_Obj13.PyVxCoVnce = 0;
  @CAN_RadarFL::RFL_Object::RFL_Object_Obj13.PyVyCoVnce = 0;
  @CAN_RadarFL::RFL_Object::RFL_Object_Obj13.ReferencePoint = 0;
  @CAN_RadarFL::RFL_Object::RFL_Object_Obj13.Vx = 0;
  @CAN_RadarFL::RFL_Object::RFL_Object_Obj13.VxAxCoVnce = 0;
  @CAN_RadarFL::RFL_Object::RFL_Object_Obj13.VxAyCoVnce = 0;
  @CAN_RadarFL::RFL_Object::RFL_Object_Obj13.VxVnce = 0;
  @CAN_RadarFL::RFL_Object::RFL_Object_Obj13.VxVyCoVnce = 0;
  }
  if(init_count == 8)
  {
  @CAN_RadarFL::RFL_Object::RFL_Object_Obj13.Vy = 0;
  @CAN_RadarFL::RFL_Object::RFL_Object_Obj13.VyAxCoVnce = 0;
  @CAN_RadarFL::RFL_Object::RFL_Object_Obj13.VyAyCoVnce = 0;
  @CAN_RadarFL::RFL_Object::RFL_Object_Obj13.VyVnce = 0;
  @CAN_RadarFL::RFL_Object::RFL_Object_Obj13.Width = 0;
  @CAN_RadarFL::RFL_Object::RFL_Object_Obj13.WidthVnce = 0;
  @CAN_RadarFL::RFL_Object::RFL_Object_Obj14.Age = 0;
  @CAN_RadarFL::RFL_Object::RFL_Object_Obj14.Ax = 0;
  @CAN_RadarFL::RFL_Object::RFL_Object_Obj14.AxAyCoVnce = 0;
  @CAN_RadarFL::RFL_Object::RFL_Object_Obj14.AxVnce = 0;
  @CAN_RadarFL::RFL_Object::RFL_Object_Obj14.Ay = 0;
  @CAN_RadarFL::RFL_Object::RFL_Object_Obj14.AyVnce = 0;
  @CAN_RadarFL::RFL_Object::RFL_Object_Obj14.ExistProb = 0;
  @CAN_RadarFL::RFL_Object::RFL_Object_Obj14.FilterInformation = 0;
  @CAN_RadarFL::RFL_Object::RFL_Object_Obj14.Length = 0;
  @CAN_RadarFL::RFL_Object::RFL_Object_Obj14.LengthVnce = 0;
  @CAN_RadarFL::RFL_Object::RFL_Object_Obj14.MeasurementStatus = 0;
  @CAN_RadarFL::RFL_Object::RFL_Object_Obj14.MovingStatus = 0;
  @CAN_RadarFL::RFL_Object::RFL_Object_Obj14.ObjId = 0;
  @CAN_RadarFL::RFL_Object::RFL_Object_Obj14.OrientationYaw = 0;
  @CAN_RadarFL::RFL_Object::RFL_Object_Obj14.OrientationYawVnce = 0;
  @CAN_RadarFL::RFL_Object::RFL_Object_Obj14.ProbClassConfidence = 0;
  @CAN_RadarFL::RFL_Object::RFL_Object_Obj14.ProbClassType = 0;
  @CAN_RadarFL::RFL_Object::RFL_Object_Obj14.Px = 0;
  @CAN_RadarFL::RFL_Object::RFL_Object_Obj14.PxAxCoVnce = 0;
  }
  if(init_count == 9)
  {
  @CAN_RadarFL::RFL_Object::RFL_Object_Obj14.PxAyCoVnce = 0;
  @CAN_RadarFL::RFL_Object::RFL_Object_Obj14.PxPyCoVnce = 0;
  @CAN_RadarFL::RFL_Object::RFL_Object_Obj14.PxVnce = 0;
  @CAN_RadarFL::RFL_Object::RFL_Object_Obj14.PxVxCoVnce = 0;
  @CAN_RadarFL::RFL_Object::RFL_Object_Obj14.PxVyCoVnce = 0;
  @CAN_RadarFL::RFL_Object::RFL_Object_Obj14.Py = 0;
  @CAN_RadarFL::RFL_Object::RFL_Object_Obj14.PyAxCoVnce = 0;
  @CAN_RadarFL::RFL_Object::RFL_Object_Obj14.PyAyCoVnce = 0;
  @CAN_RadarFL::RFL_Object::RFL_Object_Obj14.PyVnce = 0;
  @CAN_RadarFL::RFL_Object::RFL_Object_Obj14.PyVxCoVnce = 0;
  @CAN_RadarFL::RFL_Object::RFL_Object_Obj14.PyVyCoVnce = 0;
  @CAN_RadarFL::RFL_Object::RFL_Object_Obj14.ReferencePoint = 0;
  @CAN_RadarFL::RFL_Object::RFL_Object_Obj14.Vx = 0;
  @CAN_RadarFL::RFL_Object::RFL_Object_Obj14.VxAxCoVnce = 0;
  @CAN_RadarFL::RFL_Object::RFL_Object_Obj14.VxAyCoVnce = 0;
  @CAN_RadarFL::RFL_Object::RFL_Object_Obj14.VxVnce = 0;
  @CAN_RadarFL::RFL_Object::RFL_Object_Obj14.VxVyCoVnce = 0;
  @CAN_RadarFL::RFL_Object::RFL_Object_Obj14.Vy = 0;
  @CAN_RadarFL::RFL_Object::RFL_Object_Obj14.VyAxCoVnce = 0;
  @CAN_RadarFL::RFL_Object::RFL_Object_Obj14.VyAyCoVnce = 0;
  @CAN_RadarFL::RFL_Object::RFL_Object_Obj14.VyVnce = 0;
  @CAN_RadarFL::RFL_Object::RFL_Object_Obj14.Width = 0;
  @CAN_RadarFL::RFL_Object::RFL_Object_Obj14.WidthVnce = 0;
  @CAN_RadarFL::RFL_Object::RFL_Object_Obj15.Age = 0;
  @CAN_RadarFL::RFL_Object::RFL_Object_Obj15.Ax = 0;
  }
  if(init_count == 10)
  {
  @CAN_RadarFL::RFL_Object::RFL_Object_Obj15.AxAyCoVnce = 0;
  @CAN_RadarFL::RFL_Object::RFL_Object_Obj15.AxVnce = 0;
  @CAN_RadarFL::RFL_Object::RFL_Object_Obj15.Ay = 0;
  @CAN_RadarFL::RFL_Object::RFL_Object_Obj15.AyVnce = 0;
  @CAN_RadarFL::RFL_Object::RFL_Object_Obj15.ExistProb = 0;
  @CAN_RadarFL::RFL_Object::RFL_Object_Obj15.FilterInformation = 0;
  @CAN_RadarFL::RFL_Object::RFL_Object_Obj15.Length = 0;
  @CAN_RadarFL::RFL_Object::RFL_Object_Obj15.LengthVnce = 0;
  @CAN_RadarFL::RFL_Object::RFL_Object_Obj15.MeasurementStatus = 0;
  @CAN_RadarFL::RFL_Object::RFL_Object_Obj15.MovingStatus = 0;
  @CAN_RadarFL::RFL_Object::RFL_Object_Obj15.ObjId = 0;
  @CAN_RadarFL::RFL_Object::RFL_Object_Obj15.OrientationYaw = 0;
  @CAN_RadarFL::RFL_Object::RFL_Object_Obj15.OrientationYawVnce = 0;
  @CAN_RadarFL::RFL_Object::RFL_Object_Obj15.ProbClassConfidence = 0;
  @CAN_RadarFL::RFL_Object::RFL_Object_Obj15.ProbClassType = 0;
  @CAN_RadarFL::RFL_Object::RFL_Object_Obj15.Px = 0;
  @CAN_RadarFL::RFL_Object::RFL_Object_Obj15.PxAxCoVnce = 0;
  @CAN_RadarFL::RFL_Object::RFL_Object_Obj15.PxAyCoVnce = 0;
  @CAN_RadarFL::RFL_Object::RFL_Object_Obj15.PxPyCoVnce = 0;
  @CAN_RadarFL::RFL_Object::RFL_Object_Obj15.PxVnce = 0;
  @CAN_RadarFL::RFL_Object::RFL_Object_Obj15.PxVxCoVnce = 0;
  @CAN_RadarFL::RFL_Object::RFL_Object_Obj15.PxVyCoVnce = 0;
  @CAN_RadarFL::RFL_Object::RFL_Object_Obj15.Py = 0;
  @CAN_RadarFL::RFL_Object::RFL_Object_Obj15.PyAxCoVnce = 0;
  @CAN_RadarFL::RFL_Object::RFL_Object_Obj15.PyAyCoVnce = 0;
  }
  if(init_count == 11)
  {
  @CAN_RadarFL::RFL_Object::RFL_Object_Obj15.PyVnce = 0;
  @CAN_RadarFL::RFL_Object::RFL_Object_Obj15.PyVxCoVnce = 0;
  @CAN_RadarFL::RFL_Object::RFL_Object_Obj15.PyVyCoVnce = 0;
  @CAN_RadarFL::RFL_Object::RFL_Object_Obj15.ReferencePoint = 0;
  @CAN_RadarFL::RFL_Object::RFL_Object_Obj15.Vx = 0;
  @CAN_RadarFL::RFL_Object::RFL_Object_Obj15.VxAxCoVnce = 0;
  @CAN_RadarFL::RFL_Object::RFL_Object_Obj15.VxAyCoVnce = 0;
  @CAN_RadarFL::RFL_Object::RFL_Object_Obj15.VxVnce = 0;
  @CAN_RadarFL::RFL_Object::RFL_Object_Obj15.VxVyCoVnce = 0;
  @CAN_RadarFL::RFL_Object::RFL_Object_Obj15.Vy = 0;
  @CAN_RadarFL::RFL_Object::RFL_Object_Obj15.VyAxCoVnce = 0;
  @CAN_RadarFL::RFL_Object::RFL_Object_Obj15.VyAyCoVnce = 0;
  @CAN_RadarFL::RFL_Object::RFL_Object_Obj15.VyVnce = 0;
  @CAN_RadarFL::RFL_Object::RFL_Object_Obj15.Width = 0;
  @CAN_RadarFL::RFL_Object::RFL_Object_Obj15.WidthVnce = 0;
  @CAN_RadarFL::RFL_Object::RFL_Object_Obj16.Age = 0;
  @CAN_RadarFL::RFL_Object::RFL_Object_Obj16.Ax = 0;
  @CAN_RadarFL::RFL_Object::RFL_Object_Obj16.AxAyCoVnce = 0;
  @CAN_RadarFL::RFL_Object::RFL_Object_Obj16.AxVnce = 0;
  @CAN_RadarFL::RFL_Object::RFL_Object_Obj16.Ay = 0;
  @CAN_RadarFL::RFL_Object::RFL_Object_Obj16.AyVnce = 0;
  @CAN_RadarFL::RFL_Object::RFL_Object_Obj16.ExistProb = 0;
  @CAN_RadarFL::RFL_Object::RFL_Object_Obj16.FilterInformation = 0;
  @CAN_RadarFL::RFL_Object::RFL_Object_Obj16.Length = 0;
  @CAN_RadarFL::RFL_Object::RFL_Object_Obj16.LengthVnce = 0;
  }
  if(init_count == 12)
  {
  @CAN_RadarFL::RFL_Object::RFL_Object_Obj16.MeasurementStatus = 0;
  @CAN_RadarFL::RFL_Object::RFL_Object_Obj16.MovingStatus = 0;
  @CAN_RadarFL::RFL_Object::RFL_Object_Obj16.ObjId = 0;
  @CAN_RadarFL::RFL_Object::RFL_Object_Obj16.OrientationYaw = 0;
  @CAN_RadarFL::RFL_Object::RFL_Object_Obj16.OrientationYawVnce = 0;
  @CAN_RadarFL::RFL_Object::RFL_Object_Obj16.ProbClassConfidence = 0;
  @CAN_RadarFL::RFL_Object::RFL_Object_Obj16.ProbClassType = 0;
  @CAN_RadarFL::RFL_Object::RFL_Object_Obj16.Px = 0;
  @CAN_RadarFL::RFL_Object::RFL_Object_Obj16.PxAxCoVnce = 0;
  @CAN_RadarFL::RFL_Object::RFL_Object_Obj16.PxAyCoVnce = 0;
  @CAN_RadarFL::RFL_Object::RFL_Object_Obj16.PxPyCoVnce = 0;
  @CAN_RadarFL::RFL_Object::RFL_Object_Obj16.PxVnce = 0;
  @CAN_RadarFL::RFL_Object::RFL_Object_Obj16.PxVxCoVnce = 0;
  @CAN_RadarFL::RFL_Object::RFL_Object_Obj16.PxVyCoVnce = 0;
  @CAN_RadarFL::RFL_Object::RFL_Object_Obj16.Py = 0;
  @CAN_RadarFL::RFL_Object::RFL_Object_Obj16.PyAxCoVnce = 0;
  @CAN_RadarFL::RFL_Object::RFL_Object_Obj16.PyAyCoVnce = 0;
  @CAN_RadarFL::RFL_Object::RFL_Object_Obj16.PyVnce = 0;
  @CAN_RadarFL::RFL_Object::RFL_Object_Obj16.PyVxCoVnce = 0;
  @CAN_RadarFL::RFL_Object::RFL_Object_Obj16.PyVyCoVnce = 0;
  @CAN_RadarFL::RFL_Object::RFL_Object_Obj16.ReferencePoint = 0;
  @CAN_RadarFL::RFL_Object::RFL_Object_Obj16.Vx = 0;
  @CAN_RadarFL::RFL_Object::RFL_Object_Obj16.VxAxCoVnce = 0;
  @CAN_RadarFL::RFL_Object::RFL_Object_Obj16.VxAyCoVnce = 0;
  @CAN_RadarFL::RFL_Object::RFL_Object_Obj16.VxVnce = 0;
  }
  if(init_count == 13)
  {
  @CAN_RadarFL::RFL_Object::RFL_Object_Obj16.VxVyCoVnce = 0;
  @CAN_RadarFL::RFL_Object::RFL_Object_Obj16.Vy = 0;
  @CAN_RadarFL::RFL_Object::RFL_Object_Obj16.VyAxCoVnce = 0;
  @CAN_RadarFL::RFL_Object::RFL_Object_Obj16.VyAyCoVnce = 0;
  @CAN_RadarFL::RFL_Object::RFL_Object_Obj16.VyVnce = 0;
  @CAN_RadarFL::RFL_Object::RFL_Object_Obj16.Width = 0;
  @CAN_RadarFL::RFL_Object::RFL_Object_Obj16.WidthVnce = 0;
  @CAN_RadarFL::RFL_Object::RFL_Object_Obj17.Age = 0;
  @CAN_RadarFL::RFL_Object::RFL_Object_Obj17.Ax = 0;
  @CAN_RadarFL::RFL_Object::RFL_Object_Obj17.AxAyCoVnce = 0;
  @CAN_RadarFL::RFL_Object::RFL_Object_Obj17.AxVnce = 0;
  @CAN_RadarFL::RFL_Object::RFL_Object_Obj17.Ay = 0;
  @CAN_RadarFL::RFL_Object::RFL_Object_Obj17.AyVnce = 0;
  @CAN_RadarFL::RFL_Object::RFL_Object_Obj17.ExistProb = 0;
  @CAN_RadarFL::RFL_Object::RFL_Object_Obj17.FilterInformation = 0;
  @CAN_RadarFL::RFL_Object::RFL_Object_Obj17.Length = 0;
  @CAN_RadarFL::RFL_Object::RFL_Object_Obj17.LengthVnce = 0;
  @CAN_RadarFL::RFL_Object::RFL_Object_Obj17.MeasurementStatus = 0;
  @CAN_RadarFL::RFL_Object::RFL_Object_Obj17.MovingStatus = 0;
  @CAN_RadarFL::RFL_Object::RFL_Object_Obj17.ObjId = 0;
  @CAN_RadarFL::RFL_Object::RFL_Object_Obj17.OrientationYaw = 0;
  @CAN_RadarFL::RFL_Object::RFL_Object_Obj17.OrientationYawVnce = 0;
  @CAN_RadarFL::RFL_Object::RFL_Object_Obj17.ProbClassConfidence = 0;
  @CAN_RadarFL::RFL_Object::RFL_Object_Obj17.ProbClassType = 0;
  @CAN_RadarFL::RFL_Object::RFL_Object_Obj17.Px = 0;
  }
  if(init_count == 14)
  {
  @CAN_RadarFL::RFL_Object::RFL_Object_Obj17.PxAxCoVnce = 0;
  @CAN_RadarFL::RFL_Object::RFL_Object_Obj17.PxAyCoVnce = 0;
  @CAN_RadarFL::RFL_Object::RFL_Object_Obj17.PxPyCoVnce = 0;
  @CAN_RadarFL::RFL_Object::RFL_Object_Obj17.PxVnce = 0;
  @CAN_RadarFL::RFL_Object::RFL_Object_Obj17.PxVxCoVnce = 0;
  @CAN_RadarFL::RFL_Object::RFL_Object_Obj17.PxVyCoVnce = 0;
  @CAN_RadarFL::RFL_Object::RFL_Object_Obj17.Py = 0;
  @CAN_RadarFL::RFL_Object::RFL_Object_Obj17.PyAxCoVnce = 0;
  @CAN_RadarFL::RFL_Object::RFL_Object_Obj17.PyAyCoVnce = 0;
  @CAN_RadarFL::RFL_Object::RFL_Object_Obj17.PyVnce = 0;
  @CAN_RadarFL::RFL_Object::RFL_Object_Obj17.PyVxCoVnce = 0;
  @CAN_RadarFL::RFL_Object::RFL_Object_Obj17.PyVyCoVnce = 0;
  @CAN_RadarFL::RFL_Object::RFL_Object_Obj17.ReferencePoint = 0;
  @CAN_RadarFL::RFL_Object::RFL_Object_Obj17.Vx = 0;
  @CAN_RadarFL::RFL_Object::RFL_Object_Obj17.VxAxCoVnce = 0;
  @CAN_RadarFL::RFL_Object::RFL_Object_Obj17.VxAyCoVnce = 0;
  @CAN_RadarFL::RFL_Object::RFL_Object_Obj17.VxVnce = 0;
  @CAN_RadarFL::RFL_Object::RFL_Object_Obj17.VxVyCoVnce = 0;
  @CAN_RadarFL::RFL_Object::RFL_Object_Obj17.Vy = 0;
  @CAN_RadarFL::RFL_Object::RFL_Object_Obj17.VyAxCoVnce = 0;
  @CAN_RadarFL::RFL_Object::RFL_Object_Obj17.VyAyCoVnce = 0;
  @CAN_RadarFL::RFL_Object::RFL_Object_Obj17.VyVnce = 0;
  @CAN_RadarFL::RFL_Object::RFL_Object_Obj17.Width = 0;
  @CAN_RadarFL::RFL_Object::RFL_Object_Obj17.WidthVnce = 0;
  @CAN_RadarFL::RFL_Object::RFL_Object_Obj18.Age = 0;
  }
  if(init_count == 15)
  {
  @CAN_RadarFL::RFL_Object::RFL_Object_Obj18.Ax = 0;
  @CAN_RadarFL::RFL_Object::RFL_Object_Obj18.AxAyCoVnce = 0;
  @CAN_RadarFL::RFL_Object::RFL_Object_Obj18.AxVnce = 0;
  @CAN_RadarFL::RFL_Object::RFL_Object_Obj18.Ay = 0;
  @CAN_RadarFL::RFL_Object::RFL_Object_Obj18.AyVnce = 0;
  @CAN_RadarFL::RFL_Object::RFL_Object_Obj18.ExistProb = 0;
  @CAN_RadarFL::RFL_Object::RFL_Object_Obj18.FilterInformation = 0;
  @CAN_RadarFL::RFL_Object::RFL_Object_Obj18.Length = 0;
  @CAN_RadarFL::RFL_Object::RFL_Object_Obj18.LengthVnce = 0;
  @CAN_RadarFL::RFL_Object::RFL_Object_Obj18.MeasurementStatus = 0;
  @CAN_RadarFL::RFL_Object::RFL_Object_Obj18.MovingStatus = 0;
  @CAN_RadarFL::RFL_Object::RFL_Object_Obj18.ObjId = 0;
  @CAN_RadarFL::RFL_Object::RFL_Object_Obj18.OrientationYaw = 0;
  @CAN_RadarFL::RFL_Object::RFL_Object_Obj18.OrientationYawVnce = 0;
  @CAN_RadarFL::RFL_Object::RFL_Object_Obj18.ProbClassConfidence = 0;
  @CAN_RadarFL::RFL_Object::RFL_Object_Obj18.ProbClassType = 0;
  @CAN_RadarFL::RFL_Object::RFL_Object_Obj18.Px = 0;
  @CAN_RadarFL::RFL_Object::RFL_Object_Obj18.PxAxCoVnce = 0;
  @CAN_RadarFL::RFL_Object::RFL_Object_Obj18.PxAyCoVnce = 0;
  @CAN_RadarFL::RFL_Object::RFL_Object_Obj18.PxPyCoVnce = 0;
  @CAN_RadarFL::RFL_Object::RFL_Object_Obj18.PxVnce = 0;
  @CAN_RadarFL::RFL_Object::RFL_Object_Obj18.PxVxCoVnce = 0;
  @CAN_RadarFL::RFL_Object::RFL_Object_Obj18.PxVyCoVnce = 0;
  @CAN_RadarFL::RFL_Object::RFL_Object_Obj18.Py = 0;
  @CAN_RadarFL::RFL_Object::RFL_Object_Obj18.PyAxCoVnce = 0;
  }
  if(init_count == 16)
  {
  @CAN_RadarFL::RFL_Object::RFL_Object_Obj18.PyAyCoVnce = 0;
  @CAN_RadarFL::RFL_Object::RFL_Object_Obj18.PyVnce = 0;
  @CAN_RadarFL::RFL_Object::RFL_Object_Obj18.PyVxCoVnce = 0;
  @CAN_RadarFL::RFL_Object::RFL_Object_Obj18.PyVyCoVnce = 0;
  @CAN_RadarFL::RFL_Object::RFL_Object_Obj18.ReferencePoint = 0;
  @CAN_RadarFL::RFL_Object::RFL_Object_Obj18.Vx = 0;
  @CAN_RadarFL::RFL_Object::RFL_Object_Obj18.VxAxCoVnce = 0;
  @CAN_RadarFL::RFL_Object::RFL_Object_Obj18.VxAyCoVnce = 0;
  @CAN_RadarFL::RFL_Object::RFL_Object_Obj18.VxVnce = 0;
  @CAN_RadarFL::RFL_Object::RFL_Object_Obj18.VxVyCoVnce = 0;
  @CAN_RadarFL::RFL_Object::RFL_Object_Obj18.Vy = 0;
  @CAN_RadarFL::RFL_Object::RFL_Object_Obj18.VyAxCoVnce = 0;
  @CAN_RadarFL::RFL_Object::RFL_Object_Obj18.VyAyCoVnce = 0;
  @CAN_RadarFL::RFL_Object::RFL_Object_Obj18.VyVnce = 0;
  @CAN_RadarFL::RFL_Object::RFL_Object_Obj18.Width = 0;
  @CAN_RadarFL::RFL_Object::RFL_Object_Obj18.WidthVnce = 0;
  @CAN_RadarFL::RFL_Object::RFL_Object_Obj19.Age = 0;
  @CAN_RadarFL::RFL_Object::RFL_Object_Obj19.Ax = 0;
  @CAN_RadarFL::RFL_Object::RFL_Object_Obj19.AxAyCoVnce = 0;
  @CAN_RadarFL::RFL_Object::RFL_Object_Obj19.AxVnce = 0;
  @CAN_RadarFL::RFL_Object::RFL_Object_Obj19.Ay = 0;
  @CAN_RadarFL::RFL_Object::RFL_Object_Obj19.AyVnce = 0;
  @CAN_RadarFL::RFL_Object::RFL_Object_Obj19.ExistProb = 0;
  @CAN_RadarFL::RFL_Object::RFL_Object_Obj19.FilterInformation = 0;
  @CAN_RadarFL::RFL_Object::RFL_Object_Obj19.Length = 0;
  }
  if(init_count == 17)
  {
  @CAN_RadarFL::RFL_Object::RFL_Object_Obj19.LengthVnce = 0;
  @CAN_RadarFL::RFL_Object::RFL_Object_Obj19.MeasurementStatus = 0;
  @CAN_RadarFL::RFL_Object::RFL_Object_Obj19.MovingStatus = 0;
  @CAN_RadarFL::RFL_Object::RFL_Object_Obj19.ObjId = 0;
  @CAN_RadarFL::RFL_Object::RFL_Object_Obj19.OrientationYaw = 0;
  @CAN_RadarFL::RFL_Object::RFL_Object_Obj19.OrientationYawVnce = 0;
  @CAN_RadarFL::RFL_Object::RFL_Object_Obj19.ProbClassConfidence = 0;
  @CAN_RadarFL::RFL_Object::RFL_Object_Obj19.ProbClassType = 0;
  @CAN_RadarFL::RFL_Object::RFL_Object_Obj19.Px = 0;
  @CAN_RadarFL::RFL_Object::RFL_Object_Obj19.PxAxCoVnce = 0;
  @CAN_RadarFL::RFL_Object::RFL_Object_Obj19.PxAyCoVnce = 0;
  @CAN_RadarFL::RFL_Object::RFL_Object_Obj19.PxPyCoVnce = 0;
  @CAN_RadarFL::RFL_Object::RFL_Object_Obj19.PxVnce = 0;
  @CAN_RadarFL::RFL_Object::RFL_Object_Obj19.PxVxCoVnce = 0;
  @CAN_RadarFL::RFL_Object::RFL_Object_Obj19.PxVyCoVnce = 0;
  @CAN_RadarFL::RFL_Object::RFL_Object_Obj19.Py = 0;
  @CAN_RadarFL::RFL_Object::RFL_Object_Obj19.PyAxCoVnce = 0;
  @CAN_RadarFL::RFL_Object::RFL_Object_Obj19.PyAyCoVnce = 0;
  @CAN_RadarFL::RFL_Object::RFL_Object_Obj19.PyVnce = 0;
  @CAN_RadarFL::RFL_Object::RFL_Object_Obj19.PyVxCoVnce = 0;
  @CAN_RadarFL::RFL_Object::RFL_Object_Obj19.PyVyCoVnce = 0;
  @CAN_RadarFL::RFL_Object::RFL_Object_Obj19.ReferencePoint = 0;
  @CAN_RadarFL::RFL_Object::RFL_Object_Obj19.Vx = 0;
  @CAN_RadarFL::RFL_Object::RFL_Object_Obj19.VxAxCoVnce = 0;
  @CAN_RadarFL::RFL_Object::RFL_Object_Obj19.VxAyCoVnce = 0;
  }
  if(init_count == 18)
  {
  @CAN_RadarFL::RFL_Object::RFL_Object_Obj19.VxVnce = 0;
  @CAN_RadarFL::RFL_Object::RFL_Object_Obj19.VxVyCoVnce = 0;
  @CAN_RadarFL::RFL_Object::RFL_Object_Obj19.Vy = 0;
  @CAN_RadarFL::RFL_Object::RFL_Object_Obj19.VyAxCoVnce = 0;
  @CAN_RadarFL::RFL_Object::RFL_Object_Obj19.VyAyCoVnce = 0;
  @CAN_RadarFL::RFL_Object::RFL_Object_Obj19.VyVnce = 0;
  @CAN_RadarFL::RFL_Object::RFL_Object_Obj19.Width = 0;
  @CAN_RadarFL::RFL_Object::RFL_Object_Obj19.WidthVnce = 0;
  @CAN_RadarFL::RFL_Object::RFL_Object_Obj1.Age = 0;
  @CAN_RadarFL::RFL_Object::RFL_Object_Obj1.Ax = 0;
  @CAN_RadarFL::RFL_Object::RFL_Object_Obj1.AxAyCoVnce = 0;
  @CAN_RadarFL::RFL_Object::RFL_Object_Obj1.AxVnce = 0;
  @CAN_RadarFL::RFL_Object::RFL_Object_Obj1.Ay = 0;
  @CAN_RadarFL::RFL_Object::RFL_Object_Obj1.AyVnce = 0;
  @CAN_RadarFL::RFL_Object::RFL_Object_Obj1.ExistProb = 0;
  @CAN_RadarFL::RFL_Object::RFL_Object_Obj1.FilterInformation = 0;
  @CAN_RadarFL::RFL_Object::RFL_Object_Obj1.Length = 0;
  @CAN_RadarFL::RFL_Object::RFL_Object_Obj1.LengthVnce = 0;
  @CAN_RadarFL::RFL_Object::RFL_Object_Obj1.MeasurementStatus = 0;
  @CAN_RadarFL::RFL_Object::RFL_Object_Obj1.MovingStatus = 0;
  @CAN_RadarFL::RFL_Object::RFL_Object_Obj1.ObjId = 0;
  @CAN_RadarFL::RFL_Object::RFL_Object_Obj1.OrientationYaw = 0;
  @CAN_RadarFL::RFL_Object::RFL_Object_Obj1.OrientationYawVnce = 0;
  @CAN_RadarFL::RFL_Object::RFL_Object_Obj1.ProbClassConfidence = 0;
  @CAN_RadarFL::RFL_Object::RFL_Object_Obj1.ProbClassType = 0;
  }
  if(init_count == 19)
  {
  @CAN_RadarFL::RFL_Object::RFL_Object_Obj1.Px = 0;
  @CAN_RadarFL::RFL_Object::RFL_Object_Obj1.PxAxCoVnce = 0;
  @CAN_RadarFL::RFL_Object::RFL_Object_Obj1.PxAyCoVnce = 0;
  @CAN_RadarFL::RFL_Object::RFL_Object_Obj1.PxPyCoVnce = 0;
  @CAN_RadarFL::RFL_Object::RFL_Object_Obj1.PxVnce = 0;
  @CAN_RadarFL::RFL_Object::RFL_Object_Obj1.PxVxCoVnce = 0;
  @CAN_RadarFL::RFL_Object::RFL_Object_Obj1.PxVyCoVnce = 0;
  @CAN_RadarFL::RFL_Object::RFL_Object_Obj1.Py = 0;
  @CAN_RadarFL::RFL_Object::RFL_Object_Obj1.PyAxCoVnce = 0;
  @CAN_RadarFL::RFL_Object::RFL_Object_Obj1.PyAyCoVnce = 0;
  @CAN_RadarFL::RFL_Object::RFL_Object_Obj1.PyVnce = 0;
  @CAN_RadarFL::RFL_Object::RFL_Object_Obj1.PyVxCoVnce = 0;
  @CAN_RadarFL::RFL_Object::RFL_Object_Obj1.PyVyCoVnce = 0;
  @CAN_RadarFL::RFL_Object::RFL_Object_Obj1.ReferencePoint = 0;
  @CAN_RadarFL::RFL_Object::RFL_Object_Obj1.Vx = 0;
  @CAN_RadarFL::RFL_Object::RFL_Object_Obj1.VxAxCoVnce = 0;
  @CAN_RadarFL::RFL_Object::RFL_Object_Obj1.VxAyCoVnce = 0;
  @CAN_RadarFL::RFL_Object::RFL_Object_Obj1.VxVnce = 0;
  @CAN_RadarFL::RFL_Object::RFL_Object_Obj1.VxVyCoVnce = 0;
  @CAN_RadarFL::RFL_Object::RFL_Object_Obj1.Vy = 0;
  @CAN_RadarFL::RFL_Object::RFL_Object_Obj1.VyAxCoVnce = 0;
  @CAN_RadarFL::RFL_Object::RFL_Object_Obj1.VyAyCoVnce = 0;
  @CAN_RadarFL::RFL_Object::RFL_Object_Obj1.VyVnce = 0;
  @CAN_RadarFL::RFL_Object::RFL_Object_Obj1.Width = 0;
  @CAN_RadarFL::RFL_Object::RFL_Object_Obj1.WidthVnce = 0;
  }
  if(init_count == 20)
  {
  @CAN_RadarFL::RFL_Object::RFL_Object_Obj20.Age = 0;
  @CAN_RadarFL::RFL_Object::RFL_Object_Obj20.Ax = 0;
  @CAN_RadarFL::RFL_Object::RFL_Object_Obj20.AxAyCoVnce = 0;
  @CAN_RadarFL::RFL_Object::RFL_Object_Obj20.AxVnce = 0;
  @CAN_RadarFL::RFL_Object::RFL_Object_Obj20.Ay = 0;
  @CAN_RadarFL::RFL_Object::RFL_Object_Obj20.AyVnce = 0;
  @CAN_RadarFL::RFL_Object::RFL_Object_Obj20.ExistProb = 0;
  @CAN_RadarFL::RFL_Object::RFL_Object_Obj20.FilterInformation = 0;
  @CAN_RadarFL::RFL_Object::RFL_Object_Obj20.Length = 0;
  @CAN_RadarFL::RFL_Object::RFL_Object_Obj20.LengthVnce = 0;
  @CAN_RadarFL::RFL_Object::RFL_Object_Obj20.MeasurementStatus = 0;
  @CAN_RadarFL::RFL_Object::RFL_Object_Obj20.MovingStatus = 0;
  @CAN_RadarFL::RFL_Object::RFL_Object_Obj20.ObjId = 0;
  @CAN_RadarFL::RFL_Object::RFL_Object_Obj20.OrientationYaw = 0;
  @CAN_RadarFL::RFL_Object::RFL_Object_Obj20.OrientationYawVnce = 0;
  @CAN_RadarFL::RFL_Object::RFL_Object_Obj20.ProbClassConfidence = 0;
  @CAN_RadarFL::RFL_Object::RFL_Object_Obj20.ProbClassType = 0;
  @CAN_RadarFL::RFL_Object::RFL_Object_Obj20.Px = 0;
  @CAN_RadarFL::RFL_Object::RFL_Object_Obj20.PxAxCoVnce = 0;
  @CAN_RadarFL::RFL_Object::RFL_Object_Obj20.PxAyCoVnce = 0;
  @CAN_RadarFL::RFL_Object::RFL_Object_Obj20.PxPyCoVnce = 0;
  @CAN_RadarFL::RFL_Object::RFL_Object_Obj20.PxVnce = 0;
  @CAN_RadarFL::RFL_Object::RFL_Object_Obj20.PxVxCoVnce = 0;
  @CAN_RadarFL::RFL_Object::RFL_Object_Obj20.PxVyCoVnce = 0;
  @CAN_RadarFL::RFL_Object::RFL_Object_Obj20.Py = 0;
  }
  if(init_count == 21)
  {
  @CAN_RadarFL::RFL_Object::RFL_Object_Obj20.PyAxCoVnce = 0;
  @CAN_RadarFL::RFL_Object::RFL_Object_Obj20.PyAyCoVnce = 0;
  @CAN_RadarFL::RFL_Object::RFL_Object_Obj20.PyVnce = 0;
  @CAN_RadarFL::RFL_Object::RFL_Object_Obj20.PyVxCoVnce = 0;
  @CAN_RadarFL::RFL_Object::RFL_Object_Obj20.PyVyCoVnce = 0;
  @CAN_RadarFL::RFL_Object::RFL_Object_Obj20.ReferencePoint = 0;
  @CAN_RadarFL::RFL_Object::RFL_Object_Obj20.Vx = 0;
  @CAN_RadarFL::RFL_Object::RFL_Object_Obj20.VxAxCoVnce = 0;
  @CAN_RadarFL::RFL_Object::RFL_Object_Obj20.VxAyCoVnce = 0;
  @CAN_RadarFL::RFL_Object::RFL_Object_Obj20.VxVnce = 0;
  @CAN_RadarFL::RFL_Object::RFL_Object_Obj20.VxVyCoVnce = 0;
  @CAN_RadarFL::RFL_Object::RFL_Object_Obj20.Vy = 0;
  @CAN_RadarFL::RFL_Object::RFL_Object_Obj20.VyAxCoVnce = 0;
  @CAN_RadarFL::RFL_Object::RFL_Object_Obj20.VyAyCoVnce = 0;
  @CAN_RadarFL::RFL_Object::RFL_Object_Obj20.VyVnce = 0;
  @CAN_RadarFL::RFL_Object::RFL_Object_Obj20.Width = 0;
  @CAN_RadarFL::RFL_Object::RFL_Object_Obj20.WidthVnce = 0;
  @CAN_RadarFL::RFL_Object::RFL_Object_Obj21.Age = 0;
  @CAN_RadarFL::RFL_Object::RFL_Object_Obj21.Ax = 0;
  @CAN_RadarFL::RFL_Object::RFL_Object_Obj21.AxAyCoVnce = 0;
  @CAN_RadarFL::RFL_Object::RFL_Object_Obj21.AxVnce = 0;
  @CAN_RadarFL::RFL_Object::RFL_Object_Obj21.Ay = 0;
  @CAN_RadarFL::RFL_Object::RFL_Object_Obj21.AyVnce = 0;
  @CAN_RadarFL::RFL_Object::RFL_Object_Obj21.ExistProb = 0;
  @CAN_RadarFL::RFL_Object::RFL_Object_Obj21.FilterInformation = 0;
  }
  if(init_count == 22)
  {
  @CAN_RadarFL::RFL_Object::RFL_Object_Obj21.Length = 0;
  @CAN_RadarFL::RFL_Object::RFL_Object_Obj21.LengthVnce = 0;
  @CAN_RadarFL::RFL_Object::RFL_Object_Obj21.MeasurementStatus = 0;
  @CAN_RadarFL::RFL_Object::RFL_Object_Obj21.MovingStatus = 0;
  @CAN_RadarFL::RFL_Object::RFL_Object_Obj21.ObjId = 0;
  @CAN_RadarFL::RFL_Object::RFL_Object_Obj21.OrientationYaw = 0;
  @CAN_RadarFL::RFL_Object::RFL_Object_Obj21.OrientationYawVnce = 0;
  @CAN_RadarFL::RFL_Object::RFL_Object_Obj21.ProbClassConfidence = 0;
  @CAN_RadarFL::RFL_Object::RFL_Object_Obj21.ProbClassType = 0;
  @CAN_RadarFL::RFL_Object::RFL_Object_Obj21.Px = 0;
  @CAN_RadarFL::RFL_Object::RFL_Object_Obj21.PxAxCoVnce = 0;
  @CAN_RadarFL::RFL_Object::RFL_Object_Obj21.PxAyCoVnce = 0;
  @CAN_RadarFL::RFL_Object::RFL_Object_Obj21.PxPyCoVnce = 0;
  @CAN_RadarFL::RFL_Object::RFL_Object_Obj21.PxVnce = 0;
  @CAN_RadarFL::RFL_Object::RFL_Object_Obj21.PxVxCoVnce = 0;
  @CAN_RadarFL::RFL_Object::RFL_Object_Obj21.PxVyCoVnce = 0;
  @CAN_RadarFL::RFL_Object::RFL_Object_Obj21.Py = 0;
  @CAN_RadarFL::RFL_Object::RFL_Object_Obj21.PyAxCoVnce = 0;
  @CAN_RadarFL::RFL_Object::RFL_Object_Obj21.PyAyCoVnce = 0;
  @CAN_RadarFL::RFL_Object::RFL_Object_Obj21.PyVnce = 0;
  @CAN_RadarFL::RFL_Object::RFL_Object_Obj21.PyVxCoVnce = 0;
  @CAN_RadarFL::RFL_Object::RFL_Object_Obj21.PyVyCoVnce = 0;
  @CAN_RadarFL::RFL_Object::RFL_Object_Obj21.ReferencePoint = 0;
  @CAN_RadarFL::RFL_Object::RFL_Object_Obj21.Vx = 0;
  @CAN_RadarFL::RFL_Object::RFL_Object_Obj21.VxAxCoVnce = 0;
  }
  if(init_count == 23)
  {
  @CAN_RadarFL::RFL_Object::RFL_Object_Obj21.VxAyCoVnce = 0;
  @CAN_RadarFL::RFL_Object::RFL_Object_Obj21.VxVnce = 0;
  @CAN_RadarFL::RFL_Object::RFL_Object_Obj21.VxVyCoVnce = 0;
  @CAN_RadarFL::RFL_Object::RFL_Object_Obj21.Vy = 0;
  @CAN_RadarFL::RFL_Object::RFL_Object_Obj21.VyAxCoVnce = 0;
  @CAN_RadarFL::RFL_Object::RFL_Object_Obj21.VyAyCoVnce = 0;
  @CAN_RadarFL::RFL_Object::RFL_Object_Obj21.VyVnce = 0;
  @CAN_RadarFL::RFL_Object::RFL_Object_Obj21.Width = 0;
  @CAN_RadarFL::RFL_Object::RFL_Object_Obj21.WidthVnce = 0;
  @CAN_RadarFL::RFL_Object::RFL_Object_Obj22.Age = 0;
  @CAN_RadarFL::RFL_Object::RFL_Object_Obj22.Ax = 0;
  @CAN_RadarFL::RFL_Object::RFL_Object_Obj22.AxAyCoVnce = 0;
  @CAN_RadarFL::RFL_Object::RFL_Object_Obj22.AxVnce = 0;
  @CAN_RadarFL::RFL_Object::RFL_Object_Obj22.Ay = 0;
  @CAN_RadarFL::RFL_Object::RFL_Object_Obj22.AyVnce = 0;
  @CAN_RadarFL::RFL_Object::RFL_Object_Obj22.ExistProb = 0;
  @CAN_RadarFL::RFL_Object::RFL_Object_Obj22.FilterInformation = 0;
  @CAN_RadarFL::RFL_Object::RFL_Object_Obj22.Length = 0;
  @CAN_RadarFL::RFL_Object::RFL_Object_Obj22.LengthVnce = 0;
  @CAN_RadarFL::RFL_Object::RFL_Object_Obj22.MeasurementStatus = 0;
  @CAN_RadarFL::RFL_Object::RFL_Object_Obj22.MovingStatus = 0;
  @CAN_RadarFL::RFL_Object::RFL_Object_Obj22.ObjId = 0;
  @CAN_RadarFL::RFL_Object::RFL_Object_Obj22.OrientationYaw = 0;
  @CAN_RadarFL::RFL_Object::RFL_Object_Obj22.OrientationYawVnce = 0;
  @CAN_RadarFL::RFL_Object::RFL_Object_Obj22.ProbClassConfidence = 0;
  }
  if(init_count == 24)
  {
  @CAN_RadarFL::RFL_Object::RFL_Object_Obj22.ProbClassType = 0;
  @CAN_RadarFL::RFL_Object::RFL_Object_Obj22.Px = 0;
  @CAN_RadarFL::RFL_Object::RFL_Object_Obj22.PxAxCoVnce = 0;
  @CAN_RadarFL::RFL_Object::RFL_Object_Obj22.PxAyCoVnce = 0;
  @CAN_RadarFL::RFL_Object::RFL_Object_Obj22.PxPyCoVnce = 0;
  @CAN_RadarFL::RFL_Object::RFL_Object_Obj22.PxVnce = 0;
  @CAN_RadarFL::RFL_Object::RFL_Object_Obj22.PxVxCoVnce = 0;
  @CAN_RadarFL::RFL_Object::RFL_Object_Obj22.PxVyCoVnce = 0;
  @CAN_RadarFL::RFL_Object::RFL_Object_Obj22.Py = 0;
  @CAN_RadarFL::RFL_Object::RFL_Object_Obj22.PyAxCoVnce = 0;
  @CAN_RadarFL::RFL_Object::RFL_Object_Obj22.PyAyCoVnce = 0;
  @CAN_RadarFL::RFL_Object::RFL_Object_Obj22.PyVnce = 0;
  @CAN_RadarFL::RFL_Object::RFL_Object_Obj22.PyVxCoVnce = 0;
  @CAN_RadarFL::RFL_Object::RFL_Object_Obj22.PyVyCoVnce = 0;
  @CAN_RadarFL::RFL_Object::RFL_Object_Obj22.ReferencePoint = 0;
  @CAN_RadarFL::RFL_Object::RFL_Object_Obj22.Vx = 0;
  @CAN_RadarFL::RFL_Object::RFL_Object_Obj22.VxAxCoVnce = 0;
  @CAN_RadarFL::RFL_Object::RFL_Object_Obj22.VxAyCoVnce = 0;
  @CAN_RadarFL::RFL_Object::RFL_Object_Obj22.VxVnce = 0;
  @CAN_RadarFL::RFL_Object::RFL_Object_Obj22.VxVyCoVnce = 0;
  @CAN_RadarFL::RFL_Object::RFL_Object_Obj22.Vy = 0;
  @CAN_RadarFL::RFL_Object::RFL_Object_Obj22.VyAxCoVnce = 0;
  @CAN_RadarFL::RFL_Object::RFL_Object_Obj22.VyAyCoVnce = 0;
  @CAN_RadarFL::RFL_Object::RFL_Object_Obj22.VyVnce = 0;
  @CAN_RadarFL::RFL_Object::RFL_Object_Obj22.Width = 0;
  }
  if(init_count == 25)
  {
  @CAN_RadarFL::RFL_Object::RFL_Object_Obj22.WidthVnce = 0;
  @CAN_RadarFL::RFL_Object::RFL_Object_Obj23.Age = 0;
  @CAN_RadarFL::RFL_Object::RFL_Object_Obj23.Ax = 0;
  @CAN_RadarFL::RFL_Object::RFL_Object_Obj23.AxAyCoVnce = 0;
  @CAN_RadarFL::RFL_Object::RFL_Object_Obj23.AxVnce = 0;
  @CAN_RadarFL::RFL_Object::RFL_Object_Obj23.Ay = 0;
  @CAN_RadarFL::RFL_Object::RFL_Object_Obj23.AyVnce = 0;
  @CAN_RadarFL::RFL_Object::RFL_Object_Obj23.ExistProb = 0;
  @CAN_RadarFL::RFL_Object::RFL_Object_Obj23.FilterInformation = 0;
  @CAN_RadarFL::RFL_Object::RFL_Object_Obj23.Length = 0;
  @CAN_RadarFL::RFL_Object::RFL_Object_Obj23.LengthVnce = 0;
  @CAN_RadarFL::RFL_Object::RFL_Object_Obj23.MeasurementStatus = 0;
  @CAN_RadarFL::RFL_Object::RFL_Object_Obj23.MovingStatus = 0;
  @CAN_RadarFL::RFL_Object::RFL_Object_Obj23.ObjId = 0;
  @CAN_RadarFL::RFL_Object::RFL_Object_Obj23.OrientationYaw = 0;
  @CAN_RadarFL::RFL_Object::RFL_Object_Obj23.OrientationYawVnce = 0;
  @CAN_RadarFL::RFL_Object::RFL_Object_Obj23.ProbClassConfidence = 0;
  @CAN_RadarFL::RFL_Object::RFL_Object_Obj23.ProbClassType = 0;
  @CAN_RadarFL::RFL_Object::RFL_Object_Obj23.Px = 0;
  @CAN_RadarFL::RFL_Object::RFL_Object_Obj23.PxAxCoVnce = 0;
  @CAN_RadarFL::RFL_Object::RFL_Object_Obj23.PxAyCoVnce = 0;
  @CAN_RadarFL::RFL_Object::RFL_Object_Obj23.PxPyCoVnce = 0;
  @CAN_RadarFL::RFL_Object::RFL_Object_Obj23.PxVnce = 0;
  @CAN_RadarFL::RFL_Object::RFL_Object_Obj23.PxVxCoVnce = 0;
  @CAN_RadarFL::RFL_Object::RFL_Object_Obj23.PxVyCoVnce = 0;
  }
  if(init_count == 26)
  {
  @CAN_RadarFL::RFL_Object::RFL_Object_Obj23.Py = 0;
  @CAN_RadarFL::RFL_Object::RFL_Object_Obj23.PyAxCoVnce = 0;
  @CAN_RadarFL::RFL_Object::RFL_Object_Obj23.PyAyCoVnce = 0;
  @CAN_RadarFL::RFL_Object::RFL_Object_Obj23.PyVnce = 0;
  @CAN_RadarFL::RFL_Object::RFL_Object_Obj23.PyVxCoVnce = 0;
  @CAN_RadarFL::RFL_Object::RFL_Object_Obj23.PyVyCoVnce = 0;
  @CAN_RadarFL::RFL_Object::RFL_Object_Obj23.ReferencePoint = 0;
  @CAN_RadarFL::RFL_Object::RFL_Object_Obj23.Vx = 0;
  @CAN_RadarFL::RFL_Object::RFL_Object_Obj23.VxAxCoVnce = 0;
  @CAN_RadarFL::RFL_Object::RFL_Object_Obj23.VxAyCoVnce = 0;
  @CAN_RadarFL::RFL_Object::RFL_Object_Obj23.VxVnce = 0;
  @CAN_RadarFL::RFL_Object::RFL_Object_Obj23.VxVyCoVnce = 0;
  @CAN_RadarFL::RFL_Object::RFL_Object_Obj23.Vy = 0;
  @CAN_RadarFL::RFL_Object::RFL_Object_Obj23.VyAxCoVnce = 0;
  @CAN_RadarFL::RFL_Object::RFL_Object_Obj23.VyAyCoVnce = 0;
  @CAN_RadarFL::RFL_Object::RFL_Object_Obj23.VyVnce = 0;
  @CAN_RadarFL::RFL_Object::RFL_Object_Obj23.Width = 0;
  @CAN_RadarFL::RFL_Object::RFL_Object_Obj23.WidthVnce = 0;
  @CAN_RadarFL::RFL_Object::RFL_Object_Obj24.Age = 0;
  @CAN_RadarFL::RFL_Object::RFL_Object_Obj24.Ax = 0;
  @CAN_RadarFL::RFL_Object::RFL_Object_Obj24.AxAyCoVnce = 0;
  @CAN_RadarFL::RFL_Object::RFL_Object_Obj24.AxVnce = 0;
  @CAN_RadarFL::RFL_Object::RFL_Object_Obj24.Ay = 0;
  @CAN_RadarFL::RFL_Object::RFL_Object_Obj24.AyVnce = 0;
  @CAN_RadarFL::RFL_Object::RFL_Object_Obj24.ExistProb = 0;
  }
  if(init_count == 27)
  {
  @CAN_RadarFL::RFL_Object::RFL_Object_Obj24.FilterInformation = 0;
  @CAN_RadarFL::RFL_Object::RFL_Object_Obj24.Length = 0;
  @CAN_RadarFL::RFL_Object::RFL_Object_Obj24.LengthVnce = 0;
  @CAN_RadarFL::RFL_Object::RFL_Object_Obj24.MeasurementStatus = 0;
  @CAN_RadarFL::RFL_Object::RFL_Object_Obj24.MovingStatus = 0;
  @CAN_RadarFL::RFL_Object::RFL_Object_Obj24.ObjId = 0;
  @CAN_RadarFL::RFL_Object::RFL_Object_Obj24.OrientationYaw = 0;
  @CAN_RadarFL::RFL_Object::RFL_Object_Obj24.OrientationYawVnce = 0;
  @CAN_RadarFL::RFL_Object::RFL_Object_Obj24.ProbClassConfidence = 0;
  @CAN_RadarFL::RFL_Object::RFL_Object_Obj24.ProbClassType = 0;
  @CAN_RadarFL::RFL_Object::RFL_Object_Obj24.Px = 0;
  @CAN_RadarFL::RFL_Object::RFL_Object_Obj24.PxAxCoVnce = 0;
  @CAN_RadarFL::RFL_Object::RFL_Object_Obj24.PxAyCoVnce = 0;
  @CAN_RadarFL::RFL_Object::RFL_Object_Obj24.PxPyCoVnce = 0;
  @CAN_RadarFL::RFL_Object::RFL_Object_Obj24.PxVnce = 0;
  @CAN_RadarFL::RFL_Object::RFL_Object_Obj24.PxVxCoVnce = 0;
  @CAN_RadarFL::RFL_Object::RFL_Object_Obj24.PxVyCoVnce = 0;
  @CAN_RadarFL::RFL_Object::RFL_Object_Obj24.Py = 0;
  @CAN_RadarFL::RFL_Object::RFL_Object_Obj24.PyAxCoVnce = 0;
  @CAN_RadarFL::RFL_Object::RFL_Object_Obj24.PyAyCoVnce = 0;
  @CAN_RadarFL::RFL_Object::RFL_Object_Obj24.PyVnce = 0;
  @CAN_RadarFL::RFL_Object::RFL_Object_Obj24.PyVxCoVnce = 0;
  @CAN_RadarFL::RFL_Object::RFL_Object_Obj24.PyVyCoVnce = 0;
  @CAN_RadarFL::RFL_Object::RFL_Object_Obj24.ReferencePoint = 0;
  @CAN_RadarFL::RFL_Object::RFL_Object_Obj24.Vx = 0;
  }
  if(init_count == 28)
  {
  @CAN_RadarFL::RFL_Object::RFL_Object_Obj24.VxAxCoVnce = 0;
  @CAN_RadarFL::RFL_Object::RFL_Object_Obj24.VxAyCoVnce = 0;
  @CAN_RadarFL::RFL_Object::RFL_Object_Obj24.VxVnce = 0;
  @CAN_RadarFL::RFL_Object::RFL_Object_Obj24.VxVyCoVnce = 0;
  @CAN_RadarFL::RFL_Object::RFL_Object_Obj24.Vy = 0;
  @CAN_RadarFL::RFL_Object::RFL_Object_Obj24.VyAxCoVnce = 0;
  @CAN_RadarFL::RFL_Object::RFL_Object_Obj24.VyAyCoVnce = 0;
  @CAN_RadarFL::RFL_Object::RFL_Object_Obj24.VyVnce = 0;
  @CAN_RadarFL::RFL_Object::RFL_Object_Obj24.Width = 0;
  @CAN_RadarFL::RFL_Object::RFL_Object_Obj24.WidthVnce = 0;
  @CAN_RadarFL::RFL_Object::RFL_Object_Obj25.Age = 0;
  @CAN_RadarFL::RFL_Object::RFL_Object_Obj25.Ax = 0;
  @CAN_RadarFL::RFL_Object::RFL_Object_Obj25.AxAyCoVnce = 0;
  @CAN_RadarFL::RFL_Object::RFL_Object_Obj25.AxVnce = 0;
  @CAN_RadarFL::RFL_Object::RFL_Object_Obj25.Ay = 0;
  @CAN_RadarFL::RFL_Object::RFL_Object_Obj25.AyVnce = 0;
  @CAN_RadarFL::RFL_Object::RFL_Object_Obj25.ExistProb = 0;
  @CAN_RadarFL::RFL_Object::RFL_Object_Obj25.FilterInformation = 0;
  @CAN_RadarFL::RFL_Object::RFL_Object_Obj25.Length = 0;
  @CAN_RadarFL::RFL_Object::RFL_Object_Obj25.LengthVnce = 0;
  @CAN_RadarFL::RFL_Object::RFL_Object_Obj25.MeasurementStatus = 0;
  @CAN_RadarFL::RFL_Object::RFL_Object_Obj25.MovingStatus = 0;
  @CAN_RadarFL::RFL_Object::RFL_Object_Obj25.ObjId = 0;
  @CAN_RadarFL::RFL_Object::RFL_Object_Obj25.OrientationYaw = 0;
  @CAN_RadarFL::RFL_Object::RFL_Object_Obj25.OrientationYawVnce = 0;
  }
  if(init_count == 29)
  {
  @CAN_RadarFL::RFL_Object::RFL_Object_Obj25.ProbClassConfidence = 0;
  @CAN_RadarFL::RFL_Object::RFL_Object_Obj25.ProbClassType = 0;
  @CAN_RadarFL::RFL_Object::RFL_Object_Obj25.Px = 0;
  @CAN_RadarFL::RFL_Object::RFL_Object_Obj25.PxAxCoVnce = 0;
  @CAN_RadarFL::RFL_Object::RFL_Object_Obj25.PxAyCoVnce = 0;
  @CAN_RadarFL::RFL_Object::RFL_Object_Obj25.PxPyCoVnce = 0;
  @CAN_RadarFL::RFL_Object::RFL_Object_Obj25.PxVnce = 0;
  @CAN_RadarFL::RFL_Object::RFL_Object_Obj25.PxVxCoVnce = 0;
  @CAN_RadarFL::RFL_Object::RFL_Object_Obj25.PxVyCoVnce = 0;
  @CAN_RadarFL::RFL_Object::RFL_Object_Obj25.Py = 0;
  @CAN_RadarFL::RFL_Object::RFL_Object_Obj25.PyAxCoVnce = 0;
  @CAN_RadarFL::RFL_Object::RFL_Object_Obj25.PyAyCoVnce = 0;
  @CAN_RadarFL::RFL_Object::RFL_Object_Obj25.PyVnce = 0;
  @CAN_RadarFL::RFL_Object::RFL_Object_Obj25.PyVxCoVnce = 0;
  @CAN_RadarFL::RFL_Object::RFL_Object_Obj25.PyVyCoVnce = 0;
  @CAN_RadarFL::RFL_Object::RFL_Object_Obj25.ReferencePoint = 0;
  @CAN_RadarFL::RFL_Object::RFL_Object_Obj25.Vx = 0;
  @CAN_RadarFL::RFL_Object::RFL_Object_Obj25.VxAxCoVnce = 0;
  @CAN_RadarFL::RFL_Object::RFL_Object_Obj25.VxAyCoVnce = 0;
  @CAN_RadarFL::RFL_Object::RFL_Object_Obj25.VxVnce = 0;
  @CAN_RadarFL::RFL_Object::RFL_Object_Obj25.VxVyCoVnce = 0;
  @CAN_RadarFL::RFL_Object::RFL_Object_Obj25.Vy = 0;
  @CAN_RadarFL::RFL_Object::RFL_Object_Obj25.VyAxCoVnce = 0;
  @CAN_RadarFL::RFL_Object::RFL_Object_Obj25.VyAyCoVnce = 0;
  @CAN_RadarFL::RFL_Object::RFL_Object_Obj25.VyVnce = 0;
  }
  if(init_count == 30)
  {
  @CAN_RadarFL::RFL_Object::RFL_Object_Obj25.Width = 0;
  @CAN_RadarFL::RFL_Object::RFL_Object_Obj25.WidthVnce = 0;
  @CAN_RadarFL::RFL_Object::RFL_Object_Obj26.Age = 0;
  @CAN_RadarFL::RFL_Object::RFL_Object_Obj26.Ax = 0;
  @CAN_RadarFL::RFL_Object::RFL_Object_Obj26.AxAyCoVnce = 0;
  @CAN_RadarFL::RFL_Object::RFL_Object_Obj26.AxVnce = 0;
  @CAN_RadarFL::RFL_Object::RFL_Object_Obj26.Ay = 0;
  @CAN_RadarFL::RFL_Object::RFL_Object_Obj26.AyVnce = 0;
  @CAN_RadarFL::RFL_Object::RFL_Object_Obj26.ExistProb = 0;
  @CAN_RadarFL::RFL_Object::RFL_Object_Obj26.FilterInformation = 0;
  @CAN_RadarFL::RFL_Object::RFL_Object_Obj26.Length = 0;
  @CAN_RadarFL::RFL_Object::RFL_Object_Obj26.LengthVnce = 0;
  @CAN_RadarFL::RFL_Object::RFL_Object_Obj26.MeasurementStatus = 0;
  @CAN_RadarFL::RFL_Object::RFL_Object_Obj26.MovingStatus = 0;
  @CAN_RadarFL::RFL_Object::RFL_Object_Obj26.ObjId = 0;
  @CAN_RadarFL::RFL_Object::RFL_Object_Obj26.OrientationYaw = 0;
  @CAN_RadarFL::RFL_Object::RFL_Object_Obj26.OrientationYawVnce = 0;
  @CAN_RadarFL::RFL_Object::RFL_Object_Obj26.ProbClassConfidence = 0;
  @CAN_RadarFL::RFL_Object::RFL_Object_Obj26.ProbClassType = 0;
  @CAN_RadarFL::RFL_Object::RFL_Object_Obj26.Px = 0;
  @CAN_RadarFL::RFL_Object::RFL_Object_Obj26.PxAxCoVnce = 0;
  @CAN_RadarFL::RFL_Object::RFL_Object_Obj26.PxAyCoVnce = 0;
  @CAN_RadarFL::RFL_Object::RFL_Object_Obj26.PxPyCoVnce = 0;
  @CAN_RadarFL::RFL_Object::RFL_Object_Obj26.PxVnce = 0;
  @CAN_RadarFL::RFL_Object::RFL_Object_Obj26.PxVxCoVnce = 0;
  }
  if(init_count == 31)
  {
  @CAN_RadarFL::RFL_Object::RFL_Object_Obj26.PxVyCoVnce = 0;
  @CAN_RadarFL::RFL_Object::RFL_Object_Obj26.Py = 0;
  @CAN_RadarFL::RFL_Object::RFL_Object_Obj26.PyAxCoVnce = 0;
  @CAN_RadarFL::RFL_Object::RFL_Object_Obj26.PyAyCoVnce = 0;
  @CAN_RadarFL::RFL_Object::RFL_Object_Obj26.PyVnce = 0;
  @CAN_RadarFL::RFL_Object::RFL_Object_Obj26.PyVxCoVnce = 0;
  @CAN_RadarFL::RFL_Object::RFL_Object_Obj26.PyVyCoVnce = 0;
  @CAN_RadarFL::RFL_Object::RFL_Object_Obj26.ReferencePoint = 0;
  @CAN_RadarFL::RFL_Object::RFL_Object_Obj26.Vx = 0;
  @CAN_RadarFL::RFL_Object::RFL_Object_Obj26.VxAxCoVnce = 0;
  @CAN_RadarFL::RFL_Object::RFL_Object_Obj26.VxAyCoVnce = 0;
  @CAN_RadarFL::RFL_Object::RFL_Object_Obj26.VxVnce = 0;
  @CAN_RadarFL::RFL_Object::RFL_Object_Obj26.VxVyCoVnce = 0;
  @CAN_RadarFL::RFL_Object::RFL_Object_Obj26.Vy = 0;
  @CAN_RadarFL::RFL_Object::RFL_Object_Obj26.VyAxCoVnce = 0;
  @CAN_RadarFL::RFL_Object::RFL_Object_Obj26.VyAyCoVnce = 0;
  @CAN_RadarFL::RFL_Object::RFL_Object_Obj26.VyVnce = 0;
  @CAN_RadarFL::RFL_Object::RFL_Object_Obj26.Width = 0;
  @CAN_RadarFL::RFL_Object::RFL_Object_Obj26.WidthVnce = 0;
  @CAN_RadarFL::RFL_Object::RFL_Object_Obj27.Age = 0;
  @CAN_RadarFL::RFL_Object::RFL_Object_Obj27.Ax = 0;
  @CAN_RadarFL::RFL_Object::RFL_Object_Obj27.AxAyCoVnce = 0;
  @CAN_RadarFL::RFL_Object::RFL_Object_Obj27.AxVnce = 0;
  @CAN_RadarFL::RFL_Object::RFL_Object_Obj27.Ay = 0;
  @CAN_RadarFL::RFL_Object::RFL_Object_Obj27.AyVnce = 0;
  }
  if(init_count == 32)
  {
  @CAN_RadarFL::RFL_Object::RFL_Object_Obj27.ExistProb = 0;
  @CAN_RadarFL::RFL_Object::RFL_Object_Obj27.FilterInformation = 0;
  @CAN_RadarFL::RFL_Object::RFL_Object_Obj27.Length = 0;
  @CAN_RadarFL::RFL_Object::RFL_Object_Obj27.LengthVnce = 0;
  @CAN_RadarFL::RFL_Object::RFL_Object_Obj27.MeasurementStatus = 0;
  @CAN_RadarFL::RFL_Object::RFL_Object_Obj27.MovingStatus = 0;
  @CAN_RadarFL::RFL_Object::RFL_Object_Obj27.ObjId = 0;
  @CAN_RadarFL::RFL_Object::RFL_Object_Obj27.OrientationYaw = 0;
  @CAN_RadarFL::RFL_Object::RFL_Object_Obj27.OrientationYawVnce = 0;
  @CAN_RadarFL::RFL_Object::RFL_Object_Obj27.ProbClassConfidence = 0;
  @CAN_RadarFL::RFL_Object::RFL_Object_Obj27.ProbClassType = 0;
  @CAN_RadarFL::RFL_Object::RFL_Object_Obj27.Px = 0;
  @CAN_RadarFL::RFL_Object::RFL_Object_Obj27.PxAxCoVnce = 0;
  @CAN_RadarFL::RFL_Object::RFL_Object_Obj27.PxAyCoVnce = 0;
  @CAN_RadarFL::RFL_Object::RFL_Object_Obj27.PxPyCoVnce = 0;
  @CAN_RadarFL::RFL_Object::RFL_Object_Obj27.PxVnce = 0;
  @CAN_RadarFL::RFL_Object::RFL_Object_Obj27.PxVxCoVnce = 0;
  @CAN_RadarFL::RFL_Object::RFL_Object_Obj27.PxVyCoVnce = 0;
  @CAN_RadarFL::RFL_Object::RFL_Object_Obj27.Py = 0;
  @CAN_RadarFL::RFL_Object::RFL_Object_Obj27.PyAxCoVnce = 0;
  @CAN_RadarFL::RFL_Object::RFL_Object_Obj27.PyAyCoVnce = 0;
  @CAN_RadarFL::RFL_Object::RFL_Object_Obj27.PyVnce = 0;
  @CAN_RadarFL::RFL_Object::RFL_Object_Obj27.PyVxCoVnce = 0;
  @CAN_RadarFL::RFL_Object::RFL_Object_Obj27.PyVyCoVnce = 0;
  @CAN_RadarFL::RFL_Object::RFL_Object_Obj27.ReferencePoint = 0;
  }
  if(init_count == 33)
  {
  @CAN_RadarFL::RFL_Object::RFL_Object_Obj27.Vx = 0;
  @CAN_RadarFL::RFL_Object::RFL_Object_Obj27.VxAxCoVnce = 0;
  @CAN_RadarFL::RFL_Object::RFL_Object_Obj27.VxAyCoVnce = 0;
  @CAN_RadarFL::RFL_Object::RFL_Object_Obj27.VxVnce = 0;
  @CAN_RadarFL::RFL_Object::RFL_Object_Obj27.VxVyCoVnce = 0;
  @CAN_RadarFL::RFL_Object::RFL_Object_Obj27.Vy = 0;
  @CAN_RadarFL::RFL_Object::RFL_Object_Obj27.VyAxCoVnce = 0;
  @CAN_RadarFL::RFL_Object::RFL_Object_Obj27.VyAyCoVnce = 0;
  @CAN_RadarFL::RFL_Object::RFL_Object_Obj27.VyVnce = 0;
  @CAN_RadarFL::RFL_Object::RFL_Object_Obj27.Width = 0;
  @CAN_RadarFL::RFL_Object::RFL_Object_Obj27.WidthVnce = 0;
  @CAN_RadarFL::RFL_Object::RFL_Object_Obj28.Age = 0;
  @CAN_RadarFL::RFL_Object::RFL_Object_Obj28.Ax = 0;
  @CAN_RadarFL::RFL_Object::RFL_Object_Obj28.AxAyCoVnce = 0;
  @CAN_RadarFL::RFL_Object::RFL_Object_Obj28.AxVnce = 0;
  @CAN_RadarFL::RFL_Object::RFL_Object_Obj28.Ay = 0;
  @CAN_RadarFL::RFL_Object::RFL_Object_Obj28.AyVnce = 0;
  @CAN_RadarFL::RFL_Object::RFL_Object_Obj28.ExistProb = 0;
  @CAN_RadarFL::RFL_Object::RFL_Object_Obj28.FilterInformation = 0;
  @CAN_RadarFL::RFL_Object::RFL_Object_Obj28.Length = 0;
  @CAN_RadarFL::RFL_Object::RFL_Object_Obj28.LengthVnce = 0;
  @CAN_RadarFL::RFL_Object::RFL_Object_Obj28.MeasurementStatus = 0;
  @CAN_RadarFL::RFL_Object::RFL_Object_Obj28.MovingStatus = 0;
  @CAN_RadarFL::RFL_Object::RFL_Object_Obj28.ObjId = 0;
  @CAN_RadarFL::RFL_Object::RFL_Object_Obj28.OrientationYaw = 0;
  }
  if(init_count == 34)
  {
  @CAN_RadarFL::RFL_Object::RFL_Object_Obj28.OrientationYawVnce = 0;
  @CAN_RadarFL::RFL_Object::RFL_Object_Obj28.ProbClassConfidence = 0;
  @CAN_RadarFL::RFL_Object::RFL_Object_Obj28.ProbClassType = 0;
  @CAN_RadarFL::RFL_Object::RFL_Object_Obj28.Px = 0;
  @CAN_RadarFL::RFL_Object::RFL_Object_Obj28.PxAxCoVnce = 0;
  @CAN_RadarFL::RFL_Object::RFL_Object_Obj28.PxAyCoVnce = 0;
  @CAN_RadarFL::RFL_Object::RFL_Object_Obj28.PxPyCoVnce = 0;
  @CAN_RadarFL::RFL_Object::RFL_Object_Obj28.PxVnce = 0;
  @CAN_RadarFL::RFL_Object::RFL_Object_Obj28.PxVxCoVnce = 0;
  @CAN_RadarFL::RFL_Object::RFL_Object_Obj28.PxVyCoVnce = 0;
  @CAN_RadarFL::RFL_Object::RFL_Object_Obj28.Py = 0;
  @CAN_RadarFL::RFL_Object::RFL_Object_Obj28.PyAxCoVnce = 0;
  @CAN_RadarFL::RFL_Object::RFL_Object_Obj28.PyAyCoVnce = 0;
  @CAN_RadarFL::RFL_Object::RFL_Object_Obj28.PyVnce = 0;
  @CAN_RadarFL::RFL_Object::RFL_Object_Obj28.PyVxCoVnce = 0;
  @CAN_RadarFL::RFL_Object::RFL_Object_Obj28.PyVyCoVnce = 0;
  @CAN_RadarFL::RFL_Object::RFL_Object_Obj28.ReferencePoint = 0;
  @CAN_RadarFL::RFL_Object::RFL_Object_Obj28.Vx = 0;
  @CAN_RadarFL::RFL_Object::RFL_Object_Obj28.VxAxCoVnce = 0;
  @CAN_RadarFL::RFL_Object::RFL_Object_Obj28.VxAyCoVnce = 0;
  @CAN_RadarFL::RFL_Object::RFL_Object_Obj28.VxVnce = 0;
  @CAN_RadarFL::RFL_Object::RFL_Object_Obj28.VxVyCoVnce = 0;
  @CAN_RadarFL::RFL_Object::RFL_Object_Obj28.Vy = 0;
  @CAN_RadarFL::RFL_Object::RFL_Object_Obj28.VyAxCoVnce = 0;
  @CAN_RadarFL::RFL_Object::RFL_Object_Obj28.VyAyCoVnce = 0;
  }
  if(init_count == 35)
  {
  @CAN_RadarFL::RFL_Object::RFL_Object_Obj28.VyVnce = 0;
  @CAN_RadarFL::RFL_Object::RFL_Object_Obj28.Width = 0;
  @CAN_RadarFL::RFL_Object::RFL_Object_Obj28.WidthVnce = 0;
  @CAN_RadarFL::RFL_Object::RFL_Object_Obj29.Age = 0;
  @CAN_RadarFL::RFL_Object::RFL_Object_Obj29.Ax = 0;
  @CAN_RadarFL::RFL_Object::RFL_Object_Obj29.AxAyCoVnce = 0;
  @CAN_RadarFL::RFL_Object::RFL_Object_Obj29.AxVnce = 0;
  @CAN_RadarFL::RFL_Object::RFL_Object_Obj29.Ay = 0;
  @CAN_RadarFL::RFL_Object::RFL_Object_Obj29.AyVnce = 0;
  @CAN_RadarFL::RFL_Object::RFL_Object_Obj29.ExistProb = 0;
  @CAN_RadarFL::RFL_Object::RFL_Object_Obj29.FilterInformation = 0;
  @CAN_RadarFL::RFL_Object::RFL_Object_Obj29.Length = 0;
  @CAN_RadarFL::RFL_Object::RFL_Object_Obj29.LengthVnce = 0;
  @CAN_RadarFL::RFL_Object::RFL_Object_Obj29.MeasurementStatus = 0;
  @CAN_RadarFL::RFL_Object::RFL_Object_Obj29.MovingStatus = 0;
  @CAN_RadarFL::RFL_Object::RFL_Object_Obj29.ObjId = 0;
  @CAN_RadarFL::RFL_Object::RFL_Object_Obj29.OrientationYaw = 0;
  @CAN_RadarFL::RFL_Object::RFL_Object_Obj29.OrientationYawVnce = 0;
  @CAN_RadarFL::RFL_Object::RFL_Object_Obj29.ProbClassConfidence = 0;
  @CAN_RadarFL::RFL_Object::RFL_Object_Obj29.ProbClassType = 0;
  @CAN_RadarFL::RFL_Object::RFL_Object_Obj29.Px = 0;
  @CAN_RadarFL::RFL_Object::RFL_Object_Obj29.PxAxCoVnce = 0;
  @CAN_RadarFL::RFL_Object::RFL_Object_Obj29.PxAyCoVnce = 0;
  @CAN_RadarFL::RFL_Object::RFL_Object_Obj29.PxPyCoVnce = 0;
  @CAN_RadarFL::RFL_Object::RFL_Object_Obj29.PxVnce = 0;
  }
  if(init_count == 36)
  {
  @CAN_RadarFL::RFL_Object::RFL_Object_Obj29.PxVxCoVnce = 0;
  @CAN_RadarFL::RFL_Object::RFL_Object_Obj29.PxVyCoVnce = 0;
  @CAN_RadarFL::RFL_Object::RFL_Object_Obj29.Py = 0;
  @CAN_RadarFL::RFL_Object::RFL_Object_Obj29.PyAxCoVnce = 0;
  @CAN_RadarFL::RFL_Object::RFL_Object_Obj29.PyAyCoVnce = 0;
  @CAN_RadarFL::RFL_Object::RFL_Object_Obj29.PyVnce = 0;
  @CAN_RadarFL::RFL_Object::RFL_Object_Obj29.PyVxCoVnce = 0;
  @CAN_RadarFL::RFL_Object::RFL_Object_Obj29.PyVyCoVnce = 0;
  @CAN_RadarFL::RFL_Object::RFL_Object_Obj29.ReferencePoint = 0;
  @CAN_RadarFL::RFL_Object::RFL_Object_Obj29.Vx = 0;
  @CAN_RadarFL::RFL_Object::RFL_Object_Obj29.VxAxCoVnce = 0;
  @CAN_RadarFL::RFL_Object::RFL_Object_Obj29.VxAyCoVnce = 0;
  @CAN_RadarFL::RFL_Object::RFL_Object_Obj29.VxVnce = 0;
  @CAN_RadarFL::RFL_Object::RFL_Object_Obj29.VxVyCoVnce = 0;
  @CAN_RadarFL::RFL_Object::RFL_Object_Obj29.Vy = 0;
  @CAN_RadarFL::RFL_Object::RFL_Object_Obj29.VyAxCoVnce = 0;
  @CAN_RadarFL::RFL_Object::RFL_Object_Obj29.VyAyCoVnce = 0;
  @CAN_RadarFL::RFL_Object::RFL_Object_Obj29.VyVnce = 0;
  @CAN_RadarFL::RFL_Object::RFL_Object_Obj29.Width = 0;
  @CAN_RadarFL::RFL_Object::RFL_Object_Obj29.WidthVnce = 0;
  @CAN_RadarFL::RFL_Object::RFL_Object_Obj2.Age = 0;
  @CAN_RadarFL::RFL_Object::RFL_Object_Obj2.Ax = 0;
  @CAN_RadarFL::RFL_Object::RFL_Object_Obj2.AxAyCoVnce = 0;
  @CAN_RadarFL::RFL_Object::RFL_Object_Obj2.AxVnce = 0;
  @CAN_RadarFL::RFL_Object::RFL_Object_Obj2.Ay = 0;
  }
  if(init_count == 37)
  {
  @CAN_RadarFL::RFL_Object::RFL_Object_Obj2.AyVnce = 0;
  @CAN_RadarFL::RFL_Object::RFL_Object_Obj2.ExistProb = 0;
  @CAN_RadarFL::RFL_Object::RFL_Object_Obj2.FilterInformation = 0;
  @CAN_RadarFL::RFL_Object::RFL_Object_Obj2.Length = 0;
  @CAN_RadarFL::RFL_Object::RFL_Object_Obj2.LengthVnce = 0;
  @CAN_RadarFL::RFL_Object::RFL_Object_Obj2.MeasurementStatus = 0;
  @CAN_RadarFL::RFL_Object::RFL_Object_Obj2.MovingStatus = 0;
  @CAN_RadarFL::RFL_Object::RFL_Object_Obj2.ObjId = 0;
  @CAN_RadarFL::RFL_Object::RFL_Object_Obj2.OrientationYaw = 0;
  @CAN_RadarFL::RFL_Object::RFL_Object_Obj2.OrientationYawVnce = 0;
  @CAN_RadarFL::RFL_Object::RFL_Object_Obj2.ProbClassConfidence = 0;
  @CAN_RadarFL::RFL_Object::RFL_Object_Obj2.ProbClassType = 0;
  @CAN_RadarFL::RFL_Object::RFL_Object_Obj2.Px = 0;
  @CAN_RadarFL::RFL_Object::RFL_Object_Obj2.PxAxCoVnce = 0;
  @CAN_RadarFL::RFL_Object::RFL_Object_Obj2.PxAyCoVnce = 0;
  @CAN_RadarFL::RFL_Object::RFL_Object_Obj2.PxPyCoVnce = 0;
  @CAN_RadarFL::RFL_Object::RFL_Object_Obj2.PxVnce = 0;
  @CAN_RadarFL::RFL_Object::RFL_Object_Obj2.PxVxCoVnce = 0;
  @CAN_RadarFL::RFL_Object::RFL_Object_Obj2.PxVyCoVnce = 0;
  @CAN_RadarFL::RFL_Object::RFL_Object_Obj2.Py = 0;
  @CAN_RadarFL::RFL_Object::RFL_Object_Obj2.PyAxCoVnce = 0;
  @CAN_RadarFL::RFL_Object::RFL_Object_Obj2.PyAyCoVnce = 0;
  @CAN_RadarFL::RFL_Object::RFL_Object_Obj2.PyVnce = 0;
  @CAN_RadarFL::RFL_Object::RFL_Object_Obj2.PyVxCoVnce = 0;
  @CAN_RadarFL::RFL_Object::RFL_Object_Obj2.PyVyCoVnce = 0;
  }
  if(init_count == 38)
  {
  @CAN_RadarFL::RFL_Object::RFL_Object_Obj2.ReferencePoint = 0;
  @CAN_RadarFL::RFL_Object::RFL_Object_Obj2.Vx = 0;
  @CAN_RadarFL::RFL_Object::RFL_Object_Obj2.VxAxCoVnce = 0;
  @CAN_RadarFL::RFL_Object::RFL_Object_Obj2.VxAyCoVnce = 0;
  @CAN_RadarFL::RFL_Object::RFL_Object_Obj2.VxVnce = 0;
  @CAN_RadarFL::RFL_Object::RFL_Object_Obj2.VxVyCoVnce = 0;
  @CAN_RadarFL::RFL_Object::RFL_Object_Obj2.Vy = 0;
  @CAN_RadarFL::RFL_Object::RFL_Object_Obj2.VyAxCoVnce = 0;
  @CAN_RadarFL::RFL_Object::RFL_Object_Obj2.VyAyCoVnce = 0;
  @CAN_RadarFL::RFL_Object::RFL_Object_Obj2.VyVnce = 0;
  @CAN_RadarFL::RFL_Object::RFL_Object_Obj2.Width = 0;
  @CAN_RadarFL::RFL_Object::RFL_Object_Obj2.WidthVnce = 0;
  @CAN_RadarFL::RFL_Object::RFL_Object_Obj30.Age = 0;
  @CAN_RadarFL::RFL_Object::RFL_Object_Obj30.Ax = 0;
  @CAN_RadarFL::RFL_Object::RFL_Object_Obj30.AxAyCoVnce = 0;
  @CAN_RadarFL::RFL_Object::RFL_Object_Obj30.AxVnce = 0;
  @CAN_RadarFL::RFL_Object::RFL_Object_Obj30.Ay = 0;
  @CAN_RadarFL::RFL_Object::RFL_Object_Obj30.AyVnce = 0;
  @CAN_RadarFL::RFL_Object::RFL_Object_Obj30.ExistProb = 0;
  @CAN_RadarFL::RFL_Object::RFL_Object_Obj30.FilterInformation = 0;
  @CAN_RadarFL::RFL_Object::RFL_Object_Obj30.Length = 0;
  @CAN_RadarFL::RFL_Object::RFL_Object_Obj30.LengthVnce = 0;
  @CAN_RadarFL::RFL_Object::RFL_Object_Obj30.MeasurementStatus = 0;
  @CAN_RadarFL::RFL_Object::RFL_Object_Obj30.MovingStatus = 0;
  @CAN_RadarFL::RFL_Object::RFL_Object_Obj30.ObjId = 0;
  }
  if(init_count == 39)
  {
  @CAN_RadarFL::RFL_Object::RFL_Object_Obj30.OrientationYaw = 0;
  @CAN_RadarFL::RFL_Object::RFL_Object_Obj30.OrientationYawVnce = 0;
  @CAN_RadarFL::RFL_Object::RFL_Object_Obj30.ProbClassConfidence = 0;
  @CAN_RadarFL::RFL_Object::RFL_Object_Obj30.ProbClassType = 0;
  @CAN_RadarFL::RFL_Object::RFL_Object_Obj30.Px = 0;
  @CAN_RadarFL::RFL_Object::RFL_Object_Obj30.PxAxCoVnce = 0;
  @CAN_RadarFL::RFL_Object::RFL_Object_Obj30.PxAyCoVnce = 0;
  @CAN_RadarFL::RFL_Object::RFL_Object_Obj30.PxPyCoVnce = 0;
  @CAN_RadarFL::RFL_Object::RFL_Object_Obj30.PxVnce = 0;
  @CAN_RadarFL::RFL_Object::RFL_Object_Obj30.PxVxCoVnce = 0;
  @CAN_RadarFL::RFL_Object::RFL_Object_Obj30.PxVyCoVnce = 0;
  @CAN_RadarFL::RFL_Object::RFL_Object_Obj30.Py = 0;
  @CAN_RadarFL::RFL_Object::RFL_Object_Obj30.PyAxCoVnce = 0;
  @CAN_RadarFL::RFL_Object::RFL_Object_Obj30.PyAyCoVnce = 0;
  @CAN_RadarFL::RFL_Object::RFL_Object_Obj30.PyVnce = 0;
  @CAN_RadarFL::RFL_Object::RFL_Object_Obj30.PyVxCoVnce = 0;
  @CAN_RadarFL::RFL_Object::RFL_Object_Obj30.PyVyCoVnce = 0;
  @CAN_RadarFL::RFL_Object::RFL_Object_Obj30.ReferencePoint = 0;
  @CAN_RadarFL::RFL_Object::RFL_Object_Obj30.Vx = 0;
  @CAN_RadarFL::RFL_Object::RFL_Object_Obj30.VxAxCoVnce = 0;
  @CAN_RadarFL::RFL_Object::RFL_Object_Obj30.VxAyCoVnce = 0;
  @CAN_RadarFL::RFL_Object::RFL_Object_Obj30.VxVnce = 0;
  @CAN_RadarFL::RFL_Object::RFL_Object_Obj30.VxVyCoVnce = 0;
  @CAN_RadarFL::RFL_Object::RFL_Object_Obj30.Vy = 0;
  @CAN_RadarFL::RFL_Object::RFL_Object_Obj30.VyAxCoVnce = 0;
  }
  if(init_count == 40)
  {
  @CAN_RadarFL::RFL_Object::RFL_Object_Obj30.VyAyCoVnce = 0;
  @CAN_RadarFL::RFL_Object::RFL_Object_Obj30.VyVnce = 0;
  @CAN_RadarFL::RFL_Object::RFL_Object_Obj30.Width = 0;
  @CAN_RadarFL::RFL_Object::RFL_Object_Obj30.WidthVnce = 0;
  @CAN_RadarFL::RFL_Object::RFL_Object_Obj31.Age = 0;
  @CAN_RadarFL::RFL_Object::RFL_Object_Obj31.Ax = 0;
  @CAN_RadarFL::RFL_Object::RFL_Object_Obj31.AxAyCoVnce = 0;
  @CAN_RadarFL::RFL_Object::RFL_Object_Obj31.AxVnce = 0;
  @CAN_RadarFL::RFL_Object::RFL_Object_Obj31.Ay = 0;
  @CAN_RadarFL::RFL_Object::RFL_Object_Obj31.AyVnce = 0;
  @CAN_RadarFL::RFL_Object::RFL_Object_Obj31.ExistProb = 0;
  @CAN_RadarFL::RFL_Object::RFL_Object_Obj31.FilterInformation = 0;
  @CAN_RadarFL::RFL_Object::RFL_Object_Obj31.Length = 0;
  @CAN_RadarFL::RFL_Object::RFL_Object_Obj31.LengthVnce = 0;
  @CAN_RadarFL::RFL_Object::RFL_Object_Obj31.MeasurementStatus = 0;
  @CAN_RadarFL::RFL_Object::RFL_Object_Obj31.MovingStatus = 0;
  @CAN_RadarFL::RFL_Object::RFL_Object_Obj31.ObjId = 0;
  @CAN_RadarFL::RFL_Object::RFL_Object_Obj31.OrientationYaw = 0;
  @CAN_RadarFL::RFL_Object::RFL_Object_Obj31.OrientationYawVnce = 0;
  @CAN_RadarFL::RFL_Object::RFL_Object_Obj31.ProbClassConfidence = 0;
  @CAN_RadarFL::RFL_Object::RFL_Object_Obj31.ProbClassType = 0;
  @CAN_RadarFL::RFL_Object::RFL_Object_Obj31.Px = 0;
  @CAN_RadarFL::RFL_Object::RFL_Object_Obj31.PxAxCoVnce = 0;
  @CAN_RadarFL::RFL_Object::RFL_Object_Obj31.PxAyCoVnce = 0;
  @CAN_RadarFL::RFL_Object::RFL_Object_Obj31.PxPyCoVnce = 0;
  }
  if(init_count == 41)
  {
  @CAN_RadarFL::RFL_Object::RFL_Object_Obj31.PxVnce = 0;
  @CAN_RadarFL::RFL_Object::RFL_Object_Obj31.PxVxCoVnce = 0;
  @CAN_RadarFL::RFL_Object::RFL_Object_Obj31.PxVyCoVnce = 0;
  @CAN_RadarFL::RFL_Object::RFL_Object_Obj31.Py = 0;
  @CAN_RadarFL::RFL_Object::RFL_Object_Obj31.PyAxCoVnce = 0;
  @CAN_RadarFL::RFL_Object::RFL_Object_Obj31.PyAyCoVnce = 0;
  @CAN_RadarFL::RFL_Object::RFL_Object_Obj31.PyVnce = 0;
  @CAN_RadarFL::RFL_Object::RFL_Object_Obj31.PyVxCoVnce = 0;
  @CAN_RadarFL::RFL_Object::RFL_Object_Obj31.PyVyCoVnce = 0;
  @CAN_RadarFL::RFL_Object::RFL_Object_Obj31.ReferencePoint = 0;
  @CAN_RadarFL::RFL_Object::RFL_Object_Obj31.Vx = 0;
  @CAN_RadarFL::RFL_Object::RFL_Object_Obj31.VxAxCoVnce = 0;
  @CAN_RadarFL::RFL_Object::RFL_Object_Obj31.VxAyCoVnce = 0;
  @CAN_RadarFL::RFL_Object::RFL_Object_Obj31.VxVnce = 0;
  @CAN_RadarFL::RFL_Object::RFL_Object_Obj31.VxVyCoVnce = 0;
  @CAN_RadarFL::RFL_Object::RFL_Object_Obj31.Vy = 0;
  @CAN_RadarFL::RFL_Object::RFL_Object_Obj31.VyAxCoVnce = 0;
  @CAN_RadarFL::RFL_Object::RFL_Object_Obj31.VyAyCoVnce = 0;
  @CAN_RadarFL::RFL_Object::RFL_Object_Obj31.VyVnce = 0;
  @CAN_RadarFL::RFL_Object::RFL_Object_Obj31.Width = 0;
  @CAN_RadarFL::RFL_Object::RFL_Object_Obj31.WidthVnce = 0;
  @CAN_RadarFL::RFL_Object::RFL_Object_Obj32.Age = 0;
  @CAN_RadarFL::RFL_Object::RFL_Object_Obj32.Ax = 0;
  @CAN_RadarFL::RFL_Object::RFL_Object_Obj32.AxAyCoVnce = 0;
  @CAN_RadarFL::RFL_Object::RFL_Object_Obj32.AxVnce = 0;
  }
  if(init_count == 42)
  {
  @CAN_RadarFL::RFL_Object::RFL_Object_Obj32.Ay = 0;
  @CAN_RadarFL::RFL_Object::RFL_Object_Obj32.AyVnce = 0;
  @CAN_RadarFL::RFL_Object::RFL_Object_Obj32.ExistProb = 0;
  @CAN_RadarFL::RFL_Object::RFL_Object_Obj32.FilterInformation = 0;
  @CAN_RadarFL::RFL_Object::RFL_Object_Obj32.Length = 0;
  @CAN_RadarFL::RFL_Object::RFL_Object_Obj32.LengthVnce = 0;
  @CAN_RadarFL::RFL_Object::RFL_Object_Obj32.MeasurementStatus = 0;
  @CAN_RadarFL::RFL_Object::RFL_Object_Obj32.MovingStatus = 0;
  @CAN_RadarFL::RFL_Object::RFL_Object_Obj32.ObjId = 0;
  @CAN_RadarFL::RFL_Object::RFL_Object_Obj32.OrientationYaw = 0;
  @CAN_RadarFL::RFL_Object::RFL_Object_Obj32.OrientationYawVnce = 0;
  @CAN_RadarFL::RFL_Object::RFL_Object_Obj32.ProbClassConfidence = 0;
  @CAN_RadarFL::RFL_Object::RFL_Object_Obj32.ProbClassType = 0;
  @CAN_RadarFL::RFL_Object::RFL_Object_Obj32.Px = 0;
  @CAN_RadarFL::RFL_Object::RFL_Object_Obj32.PxAxCoVnce = 0;
  @CAN_RadarFL::RFL_Object::RFL_Object_Obj32.PxAyCoVnce = 0;
  @CAN_RadarFL::RFL_Object::RFL_Object_Obj32.PxPyCoVnce = 0;
  @CAN_RadarFL::RFL_Object::RFL_Object_Obj32.PxVnce = 0;
  @CAN_RadarFL::RFL_Object::RFL_Object_Obj32.PxVxCoVnce = 0;
  @CAN_RadarFL::RFL_Object::RFL_Object_Obj32.PxVyCoVnce = 0;
  @CAN_RadarFL::RFL_Object::RFL_Object_Obj32.Py = 0;
  @CAN_RadarFL::RFL_Object::RFL_Object_Obj32.PyAxCoVnce = 0;
  @CAN_RadarFL::RFL_Object::RFL_Object_Obj32.PyAyCoVnce = 0;
  @CAN_RadarFL::RFL_Object::RFL_Object_Obj32.PyVnce = 0;
  @CAN_RadarFL::RFL_Object::RFL_Object_Obj32.PyVxCoVnce = 0;
  }
  if(init_count == 43)
  {
  @CAN_RadarFL::RFL_Object::RFL_Object_Obj32.PyVyCoVnce = 0;
  @CAN_RadarFL::RFL_Object::RFL_Object_Obj32.ReferencePoint = 0;
  @CAN_RadarFL::RFL_Object::RFL_Object_Obj32.Vx = 0;
  @CAN_RadarFL::RFL_Object::RFL_Object_Obj32.VxAxCoVnce = 0;
  @CAN_RadarFL::RFL_Object::RFL_Object_Obj32.VxAyCoVnce = 0;
  @CAN_RadarFL::RFL_Object::RFL_Object_Obj32.VxVnce = 0;
  @CAN_RadarFL::RFL_Object::RFL_Object_Obj32.VxVyCoVnce = 0;
  @CAN_RadarFL::RFL_Object::RFL_Object_Obj32.Vy = 0;
  @CAN_RadarFL::RFL_Object::RFL_Object_Obj32.VyAxCoVnce = 0;
  @CAN_RadarFL::RFL_Object::RFL_Object_Obj32.VyAyCoVnce = 0;
  @CAN_RadarFL::RFL_Object::RFL_Object_Obj32.VyVnce = 0;
  @CAN_RadarFL::RFL_Object::RFL_Object_Obj32.Width = 0;
  @CAN_RadarFL::RFL_Object::RFL_Object_Obj32.WidthVnce = 0;
  @CAN_RadarFL::RFL_Object::RFL_Object_Obj33.Age = 0;
  @CAN_RadarFL::RFL_Object::RFL_Object_Obj33.Ax = 0;
  @CAN_RadarFL::RFL_Object::RFL_Object_Obj33.AxAyCoVnce = 0;
  @CAN_RadarFL::RFL_Object::RFL_Object_Obj33.AxVnce = 0;
  @CAN_RadarFL::RFL_Object::RFL_Object_Obj33.Ay = 0;
  @CAN_RadarFL::RFL_Object::RFL_Object_Obj33.AyVnce = 0;
  @CAN_RadarFL::RFL_Object::RFL_Object_Obj33.ExistProb = 0;
  @CAN_RadarFL::RFL_Object::RFL_Object_Obj33.FilterInformation = 0;
  @CAN_RadarFL::RFL_Object::RFL_Object_Obj33.Length = 0;
  @CAN_RadarFL::RFL_Object::RFL_Object_Obj33.LengthVnce = 0;
  @CAN_RadarFL::RFL_Object::RFL_Object_Obj33.MeasurementStatus = 0;
  @CAN_RadarFL::RFL_Object::RFL_Object_Obj33.MovingStatus = 0;
  }
  if(init_count == 44)
  {
  @CAN_RadarFL::RFL_Object::RFL_Object_Obj33.ObjId = 0;
  @CAN_RadarFL::RFL_Object::RFL_Object_Obj33.OrientationYaw = 0;
  @CAN_RadarFL::RFL_Object::RFL_Object_Obj33.OrientationYawVnce = 0;
  @CAN_RadarFL::RFL_Object::RFL_Object_Obj33.ProbClassConfidence = 0;
  @CAN_RadarFL::RFL_Object::RFL_Object_Obj33.ProbClassType = 0;
  @CAN_RadarFL::RFL_Object::RFL_Object_Obj33.Px = 0;
  @CAN_RadarFL::RFL_Object::RFL_Object_Obj33.PxAxCoVnce = 0;
  @CAN_RadarFL::RFL_Object::RFL_Object_Obj33.PxAyCoVnce = 0;
  @CAN_RadarFL::RFL_Object::RFL_Object_Obj33.PxPyCoVnce = 0;
  @CAN_RadarFL::RFL_Object::RFL_Object_Obj33.PxVnce = 0;
  @CAN_RadarFL::RFL_Object::RFL_Object_Obj33.PxVxCoVnce = 0;
  @CAN_RadarFL::RFL_Object::RFL_Object_Obj33.PxVyCoVnce = 0;
  @CAN_RadarFL::RFL_Object::RFL_Object_Obj33.Py = 0;
  @CAN_RadarFL::RFL_Object::RFL_Object_Obj33.PyAxCoVnce = 0;
  @CAN_RadarFL::RFL_Object::RFL_Object_Obj33.PyAyCoVnce = 0;
  @CAN_RadarFL::RFL_Object::RFL_Object_Obj33.PyVnce = 0;
  @CAN_RadarFL::RFL_Object::RFL_Object_Obj33.PyVxCoVnce = 0;
  @CAN_RadarFL::RFL_Object::RFL_Object_Obj33.PyVyCoVnce = 0;
  @CAN_RadarFL::RFL_Object::RFL_Object_Obj33.ReferencePoint = 0;
  @CAN_RadarFL::RFL_Object::RFL_Object_Obj33.Vx = 0;
  @CAN_RadarFL::RFL_Object::RFL_Object_Obj33.VxAxCoVnce = 0;
  @CAN_RadarFL::RFL_Object::RFL_Object_Obj33.VxAyCoVnce = 0;
  @CAN_RadarFL::RFL_Object::RFL_Object_Obj33.VxVnce = 0;
  @CAN_RadarFL::RFL_Object::RFL_Object_Obj33.VxVyCoVnce = 0;
  @CAN_RadarFL::RFL_Object::RFL_Object_Obj33.Vy = 0;
  }
  if(init_count == 45)
  {
  @CAN_RadarFL::RFL_Object::RFL_Object_Obj33.VyAxCoVnce = 0;
  @CAN_RadarFL::RFL_Object::RFL_Object_Obj33.VyAyCoVnce = 0;
  @CAN_RadarFL::RFL_Object::RFL_Object_Obj33.VyVnce = 0;
  @CAN_RadarFL::RFL_Object::RFL_Object_Obj33.Width = 0;
  @CAN_RadarFL::RFL_Object::RFL_Object_Obj33.WidthVnce = 0;
  @CAN_RadarFL::RFL_Object::RFL_Object_Obj34.Age = 0;
  @CAN_RadarFL::RFL_Object::RFL_Object_Obj34.Ax = 0;
  @CAN_RadarFL::RFL_Object::RFL_Object_Obj34.AxAyCoVnce = 0;
  @CAN_RadarFL::RFL_Object::RFL_Object_Obj34.AxVnce = 0;
  @CAN_RadarFL::RFL_Object::RFL_Object_Obj34.Ay = 0;
  @CAN_RadarFL::RFL_Object::RFL_Object_Obj34.AyVnce = 0;
  @CAN_RadarFL::RFL_Object::RFL_Object_Obj34.ExistProb = 0;
  @CAN_RadarFL::RFL_Object::RFL_Object_Obj34.FilterInformation = 0;
  @CAN_RadarFL::RFL_Object::RFL_Object_Obj34.Length = 0;
  @CAN_RadarFL::RFL_Object::RFL_Object_Obj34.LengthVnce = 0;
  @CAN_RadarFL::RFL_Object::RFL_Object_Obj34.MeasurementStatus = 0;
  @CAN_RadarFL::RFL_Object::RFL_Object_Obj34.MovingStatus = 0;
  @CAN_RadarFL::RFL_Object::RFL_Object_Obj34.ObjId = 0;
  @CAN_RadarFL::RFL_Object::RFL_Object_Obj34.OrientationYaw = 0;
  @CAN_RadarFL::RFL_Object::RFL_Object_Obj34.OrientationYawVnce = 0;
  @CAN_RadarFL::RFL_Object::RFL_Object_Obj34.ProbClassConfidence = 0;
  @CAN_RadarFL::RFL_Object::RFL_Object_Obj34.ProbClassType = 0;
  @CAN_RadarFL::RFL_Object::RFL_Object_Obj34.Px = 0;
  @CAN_RadarFL::RFL_Object::RFL_Object_Obj34.PxAxCoVnce = 0;
  @CAN_RadarFL::RFL_Object::RFL_Object_Obj34.PxAyCoVnce = 0;
  }
  if(init_count == 46)
  {
  @CAN_RadarFL::RFL_Object::RFL_Object_Obj34.PxPyCoVnce = 0;
  @CAN_RadarFL::RFL_Object::RFL_Object_Obj34.PxVnce = 0;
  @CAN_RadarFL::RFL_Object::RFL_Object_Obj34.PxVxCoVnce = 0;
  @CAN_RadarFL::RFL_Object::RFL_Object_Obj34.PxVyCoVnce = 0;
  @CAN_RadarFL::RFL_Object::RFL_Object_Obj34.Py = 0;
  @CAN_RadarFL::RFL_Object::RFL_Object_Obj34.PyAxCoVnce = 0;
  @CAN_RadarFL::RFL_Object::RFL_Object_Obj34.PyAyCoVnce = 0;
  @CAN_RadarFL::RFL_Object::RFL_Object_Obj34.PyVnce = 0;
  @CAN_RadarFL::RFL_Object::RFL_Object_Obj34.PyVxCoVnce = 0;
  @CAN_RadarFL::RFL_Object::RFL_Object_Obj34.PyVyCoVnce = 0;
  @CAN_RadarFL::RFL_Object::RFL_Object_Obj34.ReferencePoint = 0;
  @CAN_RadarFL::RFL_Object::RFL_Object_Obj34.Vx = 0;
  @CAN_RadarFL::RFL_Object::RFL_Object_Obj34.VxAxCoVnce = 0;
  @CAN_RadarFL::RFL_Object::RFL_Object_Obj34.VxAyCoVnce = 0;
  @CAN_RadarFL::RFL_Object::RFL_Object_Obj34.VxVnce = 0;
  @CAN_RadarFL::RFL_Object::RFL_Object_Obj34.VxVyCoVnce = 0;
  @CAN_RadarFL::RFL_Object::RFL_Object_Obj34.Vy = 0;
  @CAN_RadarFL::RFL_Object::RFL_Object_Obj34.VyAxCoVnce = 0;
  @CAN_RadarFL::RFL_Object::RFL_Object_Obj34.VyAyCoVnce = 0;
  @CAN_RadarFL::RFL_Object::RFL_Object_Obj34.VyVnce = 0;
  @CAN_RadarFL::RFL_Object::RFL_Object_Obj34.Width = 0;
  @CAN_RadarFL::RFL_Object::RFL_Object_Obj34.WidthVnce = 0;
  @CAN_RadarFL::RFL_Object::RFL_Object_Obj35.Age = 0;
  @CAN_RadarFL::RFL_Object::RFL_Object_Obj35.Ax = 0;
  @CAN_RadarFL::RFL_Object::RFL_Object_Obj35.AxAyCoVnce = 0;
  }
  if(init_count == 47)
  {
  @CAN_RadarFL::RFL_Object::RFL_Object_Obj35.AxVnce = 0;
  @CAN_RadarFL::RFL_Object::RFL_Object_Obj35.Ay = 0;
  @CAN_RadarFL::RFL_Object::RFL_Object_Obj35.AyVnce = 0;
  @CAN_RadarFL::RFL_Object::RFL_Object_Obj35.ExistProb = 0;
  @CAN_RadarFL::RFL_Object::RFL_Object_Obj35.FilterInformation = 0;
  @CAN_RadarFL::RFL_Object::RFL_Object_Obj35.Length = 0;
  @CAN_RadarFL::RFL_Object::RFL_Object_Obj35.LengthVnce = 0;
  @CAN_RadarFL::RFL_Object::RFL_Object_Obj35.MeasurementStatus = 0;
  @CAN_RadarFL::RFL_Object::RFL_Object_Obj35.MovingStatus = 0;
  @CAN_RadarFL::RFL_Object::RFL_Object_Obj35.ObjId = 0;
  @CAN_RadarFL::RFL_Object::RFL_Object_Obj35.OrientationYaw = 0;
  @CAN_RadarFL::RFL_Object::RFL_Object_Obj35.OrientationYawVnce = 0;
  @CAN_RadarFL::RFL_Object::RFL_Object_Obj35.ProbClassConfidence = 0;
  @CAN_RadarFL::RFL_Object::RFL_Object_Obj35.ProbClassType = 0;
  @CAN_RadarFL::RFL_Object::RFL_Object_Obj35.Px = 0;
  @CAN_RadarFL::RFL_Object::RFL_Object_Obj35.PxAxCoVnce = 0;
  @CAN_RadarFL::RFL_Object::RFL_Object_Obj35.PxAyCoVnce = 0;
  @CAN_RadarFL::RFL_Object::RFL_Object_Obj35.PxPyCoVnce = 0;
  @CAN_RadarFL::RFL_Object::RFL_Object_Obj35.PxVnce = 0;
  @CAN_RadarFL::RFL_Object::RFL_Object_Obj35.PxVxCoVnce = 0;
  @CAN_RadarFL::RFL_Object::RFL_Object_Obj35.PxVyCoVnce = 0;
  @CAN_RadarFL::RFL_Object::RFL_Object_Obj35.Py = 0;
  @CAN_RadarFL::RFL_Object::RFL_Object_Obj35.PyAxCoVnce = 0;
  @CAN_RadarFL::RFL_Object::RFL_Object_Obj35.PyAyCoVnce = 0;
  @CAN_RadarFL::RFL_Object::RFL_Object_Obj35.PyVnce = 0;
  }
  if(init_count == 48)
  {
  @CAN_RadarFL::RFL_Object::RFL_Object_Obj35.PyVxCoVnce = 0;
  @CAN_RadarFL::RFL_Object::RFL_Object_Obj35.PyVyCoVnce = 0;
  @CAN_RadarFL::RFL_Object::RFL_Object_Obj35.ReferencePoint = 0;
  @CAN_RadarFL::RFL_Object::RFL_Object_Obj35.Vx = 0;
  @CAN_RadarFL::RFL_Object::RFL_Object_Obj35.VxAxCoVnce = 0;
  @CAN_RadarFL::RFL_Object::RFL_Object_Obj35.VxAyCoVnce = 0;
  @CAN_RadarFL::RFL_Object::RFL_Object_Obj35.VxVnce = 0;
  @CAN_RadarFL::RFL_Object::RFL_Object_Obj35.VxVyCoVnce = 0;
  @CAN_RadarFL::RFL_Object::RFL_Object_Obj35.Vy = 0;
  @CAN_RadarFL::RFL_Object::RFL_Object_Obj35.VyAxCoVnce = 0;
  @CAN_RadarFL::RFL_Object::RFL_Object_Obj35.VyAyCoVnce = 0;
  @CAN_RadarFL::RFL_Object::RFL_Object_Obj35.VyVnce = 0;
  @CAN_RadarFL::RFL_Object::RFL_Object_Obj35.Width = 0;
  @CAN_RadarFL::RFL_Object::RFL_Object_Obj35.WidthVnce = 0;
  @CAN_RadarFL::RFL_Object::RFL_Object_Obj36.Age = 0;
  @CAN_RadarFL::RFL_Object::RFL_Object_Obj36.Ax = 0;
  @CAN_RadarFL::RFL_Object::RFL_Object_Obj36.AxAyCoVnce = 0;
  @CAN_RadarFL::RFL_Object::RFL_Object_Obj36.AxVnce = 0;
  @CAN_RadarFL::RFL_Object::RFL_Object_Obj36.Ay = 0;
  @CAN_RadarFL::RFL_Object::RFL_Object_Obj36.AyVnce = 0;
  @CAN_RadarFL::RFL_Object::RFL_Object_Obj36.ExistProb = 0;
  @CAN_RadarFL::RFL_Object::RFL_Object_Obj36.FilterInformation = 0;
  @CAN_RadarFL::RFL_Object::RFL_Object_Obj36.Length = 0;
  @CAN_RadarFL::RFL_Object::RFL_Object_Obj36.LengthVnce = 0;
  @CAN_RadarFL::RFL_Object::RFL_Object_Obj36.MeasurementStatus = 0;
  }
  if(init_count == 49)
  {
  @CAN_RadarFL::RFL_Object::RFL_Object_Obj36.MovingStatus = 0;
  @CAN_RadarFL::RFL_Object::RFL_Object_Obj36.ObjId = 0;
  @CAN_RadarFL::RFL_Object::RFL_Object_Obj36.OrientationYaw = 0;
  @CAN_RadarFL::RFL_Object::RFL_Object_Obj36.OrientationYawVnce = 0;
  @CAN_RadarFL::RFL_Object::RFL_Object_Obj36.ProbClassConfidence = 0;
  @CAN_RadarFL::RFL_Object::RFL_Object_Obj36.ProbClassType = 0;
  @CAN_RadarFL::RFL_Object::RFL_Object_Obj36.Px = 0;
  @CAN_RadarFL::RFL_Object::RFL_Object_Obj36.PxAxCoVnce = 0;
  @CAN_RadarFL::RFL_Object::RFL_Object_Obj36.PxAyCoVnce = 0;
  @CAN_RadarFL::RFL_Object::RFL_Object_Obj36.PxPyCoVnce = 0;
  @CAN_RadarFL::RFL_Object::RFL_Object_Obj36.PxVnce = 0;
  @CAN_RadarFL::RFL_Object::RFL_Object_Obj36.PxVxCoVnce = 0;
  @CAN_RadarFL::RFL_Object::RFL_Object_Obj36.PxVyCoVnce = 0;
  @CAN_RadarFL::RFL_Object::RFL_Object_Obj36.Py = 0;
  @CAN_RadarFL::RFL_Object::RFL_Object_Obj36.PyAxCoVnce = 0;
  @CAN_RadarFL::RFL_Object::RFL_Object_Obj36.PyAyCoVnce = 0;
  @CAN_RadarFL::RFL_Object::RFL_Object_Obj36.PyVnce = 0;
  @CAN_RadarFL::RFL_Object::RFL_Object_Obj36.PyVxCoVnce = 0;
  @CAN_RadarFL::RFL_Object::RFL_Object_Obj36.PyVyCoVnce = 0;
  @CAN_RadarFL::RFL_Object::RFL_Object_Obj36.ReferencePoint = 0;
  @CAN_RadarFL::RFL_Object::RFL_Object_Obj36.Vx = 0;
  @CAN_RadarFL::RFL_Object::RFL_Object_Obj36.VxAxCoVnce = 0;
  @CAN_RadarFL::RFL_Object::RFL_Object_Obj36.VxAyCoVnce = 0;
  @CAN_RadarFL::RFL_Object::RFL_Object_Obj36.VxVnce = 0;
  @CAN_RadarFL::RFL_Object::RFL_Object_Obj36.VxVyCoVnce = 0;
  }
  if(init_count == 50)
  {
  @CAN_RadarFL::RFL_Object::RFL_Object_Obj36.Vy = 0;
  @CAN_RadarFL::RFL_Object::RFL_Object_Obj36.VyAxCoVnce = 0;
  @CAN_RadarFL::RFL_Object::RFL_Object_Obj36.VyAyCoVnce = 0;
  @CAN_RadarFL::RFL_Object::RFL_Object_Obj36.VyVnce = 0;
  @CAN_RadarFL::RFL_Object::RFL_Object_Obj36.Width = 0;
  @CAN_RadarFL::RFL_Object::RFL_Object_Obj36.WidthVnce = 0;
  @CAN_RadarFL::RFL_Object::RFL_Object_Obj37.Age = 0;
  @CAN_RadarFL::RFL_Object::RFL_Object_Obj37.Ax = 0;
  @CAN_RadarFL::RFL_Object::RFL_Object_Obj37.AxAyCoVnce = 0;
  @CAN_RadarFL::RFL_Object::RFL_Object_Obj37.AxVnce = 0;
  @CAN_RadarFL::RFL_Object::RFL_Object_Obj37.Ay = 0;
  @CAN_RadarFL::RFL_Object::RFL_Object_Obj37.AyVnce = 0;
  @CAN_RadarFL::RFL_Object::RFL_Object_Obj37.ExistProb = 0;
  @CAN_RadarFL::RFL_Object::RFL_Object_Obj37.FilterInformation = 0;
  @CAN_RadarFL::RFL_Object::RFL_Object_Obj37.Length = 0;
  @CAN_RadarFL::RFL_Object::RFL_Object_Obj37.LengthVnce = 0;
  @CAN_RadarFL::RFL_Object::RFL_Object_Obj37.MeasurementStatus = 0;
  @CAN_RadarFL::RFL_Object::RFL_Object_Obj37.MovingStatus = 0;
  @CAN_RadarFL::RFL_Object::RFL_Object_Obj37.ObjId = 0;
  @CAN_RadarFL::RFL_Object::RFL_Object_Obj37.OrientationYaw = 0;
  @CAN_RadarFL::RFL_Object::RFL_Object_Obj37.OrientationYawVnce = 0;
  @CAN_RadarFL::RFL_Object::RFL_Object_Obj37.ProbClassConfidence = 0;
  @CAN_RadarFL::RFL_Object::RFL_Object_Obj37.ProbClassType = 0;
  @CAN_RadarFL::RFL_Object::RFL_Object_Obj37.Px = 0;
  @CAN_RadarFL::RFL_Object::RFL_Object_Obj37.PxAxCoVnce = 0;
  }
  if(init_count == 51)
  {
  @CAN_RadarFL::RFL_Object::RFL_Object_Obj37.PxAyCoVnce = 0;
  @CAN_RadarFL::RFL_Object::RFL_Object_Obj37.PxPyCoVnce = 0;
  @CAN_RadarFL::RFL_Object::RFL_Object_Obj37.PxVnce = 0;
  @CAN_RadarFL::RFL_Object::RFL_Object_Obj37.PxVxCoVnce = 0;
  @CAN_RadarFL::RFL_Object::RFL_Object_Obj37.PxVyCoVnce = 0;
  @CAN_RadarFL::RFL_Object::RFL_Object_Obj37.Py = 0;
  @CAN_RadarFL::RFL_Object::RFL_Object_Obj37.PyAxCoVnce = 0;
  @CAN_RadarFL::RFL_Object::RFL_Object_Obj37.PyAyCoVnce = 0;
  @CAN_RadarFL::RFL_Object::RFL_Object_Obj37.PyVnce = 0;
  @CAN_RadarFL::RFL_Object::RFL_Object_Obj37.PyVxCoVnce = 0;
  @CAN_RadarFL::RFL_Object::RFL_Object_Obj37.PyVyCoVnce = 0;
  @CAN_RadarFL::RFL_Object::RFL_Object_Obj37.ReferencePoint = 0;
  @CAN_RadarFL::RFL_Object::RFL_Object_Obj37.Vx = 0;
  @CAN_RadarFL::RFL_Object::RFL_Object_Obj37.VxAxCoVnce = 0;
  @CAN_RadarFL::RFL_Object::RFL_Object_Obj37.VxAyCoVnce = 0;
  @CAN_RadarFL::RFL_Object::RFL_Object_Obj37.VxVnce = 0;
  @CAN_RadarFL::RFL_Object::RFL_Object_Obj37.VxVyCoVnce = 0;
  @CAN_RadarFL::RFL_Object::RFL_Object_Obj37.Vy = 0;
  @CAN_RadarFL::RFL_Object::RFL_Object_Obj37.VyAxCoVnce = 0;
  @CAN_RadarFL::RFL_Object::RFL_Object_Obj37.VyAyCoVnce = 0;
  @CAN_RadarFL::RFL_Object::RFL_Object_Obj37.VyVnce = 0;
  @CAN_RadarFL::RFL_Object::RFL_Object_Obj37.Width = 0;
  @CAN_RadarFL::RFL_Object::RFL_Object_Obj37.WidthVnce = 0;
  @CAN_RadarFL::RFL_Object::RFL_Object_Obj38.Age = 0;
  @CAN_RadarFL::RFL_Object::RFL_Object_Obj38.Ax = 0;
  }
  if(init_count == 52)
  {
  @CAN_RadarFL::RFL_Object::RFL_Object_Obj38.AxAyCoVnce = 0;
  @CAN_RadarFL::RFL_Object::RFL_Object_Obj38.AxVnce = 0;
  @CAN_RadarFL::RFL_Object::RFL_Object_Obj38.Ay = 0;
  @CAN_RadarFL::RFL_Object::RFL_Object_Obj38.AyVnce = 0;
  @CAN_RadarFL::RFL_Object::RFL_Object_Obj38.ExistProb = 0;
  @CAN_RadarFL::RFL_Object::RFL_Object_Obj38.FilterInformation = 0;
  @CAN_RadarFL::RFL_Object::RFL_Object_Obj38.Length = 0;
  @CAN_RadarFL::RFL_Object::RFL_Object_Obj38.LengthVnce = 0;
  @CAN_RadarFL::RFL_Object::RFL_Object_Obj38.MeasurementStatus = 0;
  @CAN_RadarFL::RFL_Object::RFL_Object_Obj38.MovingStatus = 0;
  @CAN_RadarFL::RFL_Object::RFL_Object_Obj38.ObjId = 0;
  @CAN_RadarFL::RFL_Object::RFL_Object_Obj38.OrientationYaw = 0;
  @CAN_RadarFL::RFL_Object::RFL_Object_Obj38.OrientationYawVnce = 0;
  @CAN_RadarFL::RFL_Object::RFL_Object_Obj38.ProbClassConfidence = 0;
  @CAN_RadarFL::RFL_Object::RFL_Object_Obj38.ProbClassType = 0;
  @CAN_RadarFL::RFL_Object::RFL_Object_Obj38.Px = 0;
  @CAN_RadarFL::RFL_Object::RFL_Object_Obj38.PxAxCoVnce = 0;
  @CAN_RadarFL::RFL_Object::RFL_Object_Obj38.PxAyCoVnce = 0;
  @CAN_RadarFL::RFL_Object::RFL_Object_Obj38.PxPyCoVnce = 0;
  @CAN_RadarFL::RFL_Object::RFL_Object_Obj38.PxVnce = 0;
  @CAN_RadarFL::RFL_Object::RFL_Object_Obj38.PxVxCoVnce = 0;
  @CAN_RadarFL::RFL_Object::RFL_Object_Obj38.PxVyCoVnce = 0;
  @CAN_RadarFL::RFL_Object::RFL_Object_Obj38.Py = 0;
  @CAN_RadarFL::RFL_Object::RFL_Object_Obj38.PyAxCoVnce = 0;
  @CAN_RadarFL::RFL_Object::RFL_Object_Obj38.PyAyCoVnce = 0;
  }
  if(init_count == 53)
  {
  @CAN_RadarFL::RFL_Object::RFL_Object_Obj38.PyVnce = 0;
  @CAN_RadarFL::RFL_Object::RFL_Object_Obj38.PyVxCoVnce = 0;
  @CAN_RadarFL::RFL_Object::RFL_Object_Obj38.PyVyCoVnce = 0;
  @CAN_RadarFL::RFL_Object::RFL_Object_Obj38.ReferencePoint = 0;
  @CAN_RadarFL::RFL_Object::RFL_Object_Obj38.Vx = 0;
  @CAN_RadarFL::RFL_Object::RFL_Object_Obj38.VxAxCoVnce = 0;
  @CAN_RadarFL::RFL_Object::RFL_Object_Obj38.VxAyCoVnce = 0;
  @CAN_RadarFL::RFL_Object::RFL_Object_Obj38.VxVnce = 0;
  @CAN_RadarFL::RFL_Object::RFL_Object_Obj38.VxVyCoVnce = 0;
  @CAN_RadarFL::RFL_Object::RFL_Object_Obj38.Vy = 0;
  @CAN_RadarFL::RFL_Object::RFL_Object_Obj38.VyAxCoVnce = 0;
  @CAN_RadarFL::RFL_Object::RFL_Object_Obj38.VyAyCoVnce = 0;
  @CAN_RadarFL::RFL_Object::RFL_Object_Obj38.VyVnce = 0;
  @CAN_RadarFL::RFL_Object::RFL_Object_Obj38.Width = 0;
  @CAN_RadarFL::RFL_Object::RFL_Object_Obj38.WidthVnce = 0;
  @CAN_RadarFL::RFL_Object::RFL_Object_Obj39.Age = 0;
  @CAN_RadarFL::RFL_Object::RFL_Object_Obj39.Ax = 0;
  @CAN_RadarFL::RFL_Object::RFL_Object_Obj39.AxAyCoVnce = 0;
  @CAN_RadarFL::RFL_Object::RFL_Object_Obj39.AxVnce = 0;
  @CAN_RadarFL::RFL_Object::RFL_Object_Obj39.Ay = 0;
  @CAN_RadarFL::RFL_Object::RFL_Object_Obj39.AyVnce = 0;
  @CAN_RadarFL::RFL_Object::RFL_Object_Obj39.ExistProb = 0;
  @CAN_RadarFL::RFL_Object::RFL_Object_Obj39.FilterInformation = 0;
  @CAN_RadarFL::RFL_Object::RFL_Object_Obj39.Length = 0;
  @CAN_RadarFL::RFL_Object::RFL_Object_Obj39.LengthVnce = 0;
  }
  if(init_count == 54)
  {
  @CAN_RadarFL::RFL_Object::RFL_Object_Obj39.MeasurementStatus = 0;
  @CAN_RadarFL::RFL_Object::RFL_Object_Obj39.MovingStatus = 0;
  @CAN_RadarFL::RFL_Object::RFL_Object_Obj39.ObjId = 0;
  @CAN_RadarFL::RFL_Object::RFL_Object_Obj39.OrientationYaw = 0;
  @CAN_RadarFL::RFL_Object::RFL_Object_Obj39.OrientationYawVnce = 0;
  @CAN_RadarFL::RFL_Object::RFL_Object_Obj39.ProbClassConfidence = 0;
  @CAN_RadarFL::RFL_Object::RFL_Object_Obj39.ProbClassType = 0;
  @CAN_RadarFL::RFL_Object::RFL_Object_Obj39.Px = 0;
  @CAN_RadarFL::RFL_Object::RFL_Object_Obj39.PxAxCoVnce = 0;
  @CAN_RadarFL::RFL_Object::RFL_Object_Obj39.PxAyCoVnce = 0;
  @CAN_RadarFL::RFL_Object::RFL_Object_Obj39.PxPyCoVnce = 0;
  @CAN_RadarFL::RFL_Object::RFL_Object_Obj39.PxVnce = 0;
  @CAN_RadarFL::RFL_Object::RFL_Object_Obj39.PxVxCoVnce = 0;
  @CAN_RadarFL::RFL_Object::RFL_Object_Obj39.PxVyCoVnce = 0;
  @CAN_RadarFL::RFL_Object::RFL_Object_Obj39.Py = 0;
  @CAN_RadarFL::RFL_Object::RFL_Object_Obj39.PyAxCoVnce = 0;
  @CAN_RadarFL::RFL_Object::RFL_Object_Obj39.PyAyCoVnce = 0;
  @CAN_RadarFL::RFL_Object::RFL_Object_Obj39.PyVnce = 0;
  @CAN_RadarFL::RFL_Object::RFL_Object_Obj39.PyVxCoVnce = 0;
  @CAN_RadarFL::RFL_Object::RFL_Object_Obj39.PyVyCoVnce = 0;
  @CAN_RadarFL::RFL_Object::RFL_Object_Obj39.ReferencePoint = 0;
  @CAN_RadarFL::RFL_Object::RFL_Object_Obj39.Vx = 0;
  @CAN_RadarFL::RFL_Object::RFL_Object_Obj39.VxAxCoVnce = 0;
  @CAN_RadarFL::RFL_Object::RFL_Object_Obj39.VxAyCoVnce = 0;
  @CAN_RadarFL::RFL_Object::RFL_Object_Obj39.VxVnce = 0;
  }
  if(init_count == 55)
  {
  @CAN_RadarFL::RFL_Object::RFL_Object_Obj39.VxVyCoVnce = 0;
  @CAN_RadarFL::RFL_Object::RFL_Object_Obj39.Vy = 0;
  @CAN_RadarFL::RFL_Object::RFL_Object_Obj39.VyAxCoVnce = 0;
  @CAN_RadarFL::RFL_Object::RFL_Object_Obj39.VyAyCoVnce = 0;
  @CAN_RadarFL::RFL_Object::RFL_Object_Obj39.VyVnce = 0;
  @CAN_RadarFL::RFL_Object::RFL_Object_Obj39.Width = 0;
  @CAN_RadarFL::RFL_Object::RFL_Object_Obj39.WidthVnce = 0;
  @CAN_RadarFL::RFL_Object::RFL_Object_Obj3.Age = 0;
  @CAN_RadarFL::RFL_Object::RFL_Object_Obj3.Ax = 0;
  @CAN_RadarFL::RFL_Object::RFL_Object_Obj3.AxAyCoVnce = 0;
  @CAN_RadarFL::RFL_Object::RFL_Object_Obj3.AxVnce = 0;
  @CAN_RadarFL::RFL_Object::RFL_Object_Obj3.Ay = 0;
  @CAN_RadarFL::RFL_Object::RFL_Object_Obj3.AyVnce = 0;
  @CAN_RadarFL::RFL_Object::RFL_Object_Obj3.ExistProb = 0;
  @CAN_RadarFL::RFL_Object::RFL_Object_Obj3.FilterInformation = 0;
  @CAN_RadarFL::RFL_Object::RFL_Object_Obj3.Length = 0;
  @CAN_RadarFL::RFL_Object::RFL_Object_Obj3.LengthVnce = 0;
  @CAN_RadarFL::RFL_Object::RFL_Object_Obj3.MeasurementStatus = 0;
  @CAN_RadarFL::RFL_Object::RFL_Object_Obj3.MovingStatus = 0;
  @CAN_RadarFL::RFL_Object::RFL_Object_Obj3.ObjId = 0;
  @CAN_RadarFL::RFL_Object::RFL_Object_Obj3.OrientationYaw = 0;
  @CAN_RadarFL::RFL_Object::RFL_Object_Obj3.OrientationYawVnce = 0;
  @CAN_RadarFL::RFL_Object::RFL_Object_Obj3.ProbClassConfidence = 0;
  @CAN_RadarFL::RFL_Object::RFL_Object_Obj3.ProbClassType = 0;
  @CAN_RadarFL::RFL_Object::RFL_Object_Obj3.Px = 0;
  }
  if(init_count == 56)
  {
  @CAN_RadarFL::RFL_Object::RFL_Object_Obj3.PxAxCoVnce = 0;
  @CAN_RadarFL::RFL_Object::RFL_Object_Obj3.PxAyCoVnce = 0;
  @CAN_RadarFL::RFL_Object::RFL_Object_Obj3.PxPyCoVnce = 0;
  @CAN_RadarFL::RFL_Object::RFL_Object_Obj3.PxVnce = 0;
  @CAN_RadarFL::RFL_Object::RFL_Object_Obj3.PxVxCoVnce = 0;
  @CAN_RadarFL::RFL_Object::RFL_Object_Obj3.PxVyCoVnce = 0;
  @CAN_RadarFL::RFL_Object::RFL_Object_Obj3.Py = 0;
  @CAN_RadarFL::RFL_Object::RFL_Object_Obj3.PyAxCoVnce = 0;
  @CAN_RadarFL::RFL_Object::RFL_Object_Obj3.PyAyCoVnce = 0;
  @CAN_RadarFL::RFL_Object::RFL_Object_Obj3.PyVnce = 0;
  @CAN_RadarFL::RFL_Object::RFL_Object_Obj3.PyVxCoVnce = 0;
  @CAN_RadarFL::RFL_Object::RFL_Object_Obj3.PyVyCoVnce = 0;
  @CAN_RadarFL::RFL_Object::RFL_Object_Obj3.ReferencePoint = 0;
  @CAN_RadarFL::RFL_Object::RFL_Object_Obj3.Vx = 0;
  @CAN_RadarFL::RFL_Object::RFL_Object_Obj3.VxAxCoVnce = 0;
  @CAN_RadarFL::RFL_Object::RFL_Object_Obj3.VxAyCoVnce = 0;
  @CAN_RadarFL::RFL_Object::RFL_Object_Obj3.VxVnce = 0;
  @CAN_RadarFL::RFL_Object::RFL_Object_Obj3.VxVyCoVnce = 0;
  @CAN_RadarFL::RFL_Object::RFL_Object_Obj3.Vy = 0;
  @CAN_RadarFL::RFL_Object::RFL_Object_Obj3.VyAxCoVnce = 0;
  @CAN_RadarFL::RFL_Object::RFL_Object_Obj3.VyAyCoVnce = 0;
  @CAN_RadarFL::RFL_Object::RFL_Object_Obj3.VyVnce = 0;
  @CAN_RadarFL::RFL_Object::RFL_Object_Obj3.Width = 0;
  @CAN_RadarFL::RFL_Object::RFL_Object_Obj3.WidthVnce = 0;
  @CAN_RadarFL::RFL_Object::RFL_Object_Obj40.Age = 0;
  }
  if(init_count == 57)
  {
  @CAN_RadarFL::RFL_Object::RFL_Object_Obj40.Ax = 0;
  @CAN_RadarFL::RFL_Object::RFL_Object_Obj40.AxAyCoVnce = 0;
  @CAN_RadarFL::RFL_Object::RFL_Object_Obj40.AxVnce = 0;
  @CAN_RadarFL::RFL_Object::RFL_Object_Obj40.Ay = 0;
  @CAN_RadarFL::RFL_Object::RFL_Object_Obj40.AyVnce = 0;
  @CAN_RadarFL::RFL_Object::RFL_Object_Obj40.ExistProb = 0;
  @CAN_RadarFL::RFL_Object::RFL_Object_Obj40.FilterInformation = 0;
  @CAN_RadarFL::RFL_Object::RFL_Object_Obj40.Length = 0;
  @CAN_RadarFL::RFL_Object::RFL_Object_Obj40.LengthVnce = 0;
  @CAN_RadarFL::RFL_Object::RFL_Object_Obj40.MeasurementStatus = 0;
  @CAN_RadarFL::RFL_Object::RFL_Object_Obj40.MovingStatus = 0;
  @CAN_RadarFL::RFL_Object::RFL_Object_Obj40.ObjId = 0;
  @CAN_RadarFL::RFL_Object::RFL_Object_Obj40.OrientationYaw = 0;
  @CAN_RadarFL::RFL_Object::RFL_Object_Obj40.OrientationYawVnce = 0;
  @CAN_RadarFL::RFL_Object::RFL_Object_Obj40.ProbClassConfidence = 0;
  @CAN_RadarFL::RFL_Object::RFL_Object_Obj40.ProbClassType = 0;
  @CAN_RadarFL::RFL_Object::RFL_Object_Obj40.Px = 0;
  @CAN_RadarFL::RFL_Object::RFL_Object_Obj40.PxAxCoVnce = 0;
  @CAN_RadarFL::RFL_Object::RFL_Object_Obj40.PxAyCoVnce = 0;
  @CAN_RadarFL::RFL_Object::RFL_Object_Obj40.PxPyCoVnce = 0;
  @CAN_RadarFL::RFL_Object::RFL_Object_Obj40.PxVnce = 0;
  @CAN_RadarFL::RFL_Object::RFL_Object_Obj40.PxVxCoVnce = 0;
  @CAN_RadarFL::RFL_Object::RFL_Object_Obj40.PxVyCoVnce = 0;
  @CAN_RadarFL::RFL_Object::RFL_Object_Obj40.Py = 0;
  @CAN_RadarFL::RFL_Object::RFL_Object_Obj40.PyAxCoVnce = 0;
  }
  if(init_count == 58)
  {
  @CAN_RadarFL::RFL_Object::RFL_Object_Obj40.PyAyCoVnce = 0;
  @CAN_RadarFL::RFL_Object::RFL_Object_Obj40.PyVnce = 0;
  @CAN_RadarFL::RFL_Object::RFL_Object_Obj40.PyVxCoVnce = 0;
  @CAN_RadarFL::RFL_Object::RFL_Object_Obj40.PyVyCoVnce = 0;
  @CAN_RadarFL::RFL_Object::RFL_Object_Obj40.ReferencePoint = 0;
  @CAN_RadarFL::RFL_Object::RFL_Object_Obj40.Vx = 0;
  @CAN_RadarFL::RFL_Object::RFL_Object_Obj40.VxAxCoVnce = 0;
  @CAN_RadarFL::RFL_Object::RFL_Object_Obj40.VxAyCoVnce = 0;
  @CAN_RadarFL::RFL_Object::RFL_Object_Obj40.VxVnce = 0;
  @CAN_RadarFL::RFL_Object::RFL_Object_Obj40.VxVyCoVnce = 0;
  @CAN_RadarFL::RFL_Object::RFL_Object_Obj40.Vy = 0;
  @CAN_RadarFL::RFL_Object::RFL_Object_Obj40.VyAxCoVnce = 0;
  @CAN_RadarFL::RFL_Object::RFL_Object_Obj40.VyAyCoVnce = 0;
  @CAN_RadarFL::RFL_Object::RFL_Object_Obj40.VyVnce = 0;
  @CAN_RadarFL::RFL_Object::RFL_Object_Obj40.Width = 0;
  @CAN_RadarFL::RFL_Object::RFL_Object_Obj40.WidthVnce = 0;
  @CAN_RadarFL::RFL_Object::RFL_Object_Obj41.Age = 0;
  @CAN_RadarFL::RFL_Object::RFL_Object_Obj41.Ax = 0;
  @CAN_RadarFL::RFL_Object::RFL_Object_Obj41.AxAyCoVnce = 0;
  @CAN_RadarFL::RFL_Object::RFL_Object_Obj41.AxVnce = 0;
  @CAN_RadarFL::RFL_Object::RFL_Object_Obj41.Ay = 0;
  @CAN_RadarFL::RFL_Object::RFL_Object_Obj41.AyVnce = 0;
  @CAN_RadarFL::RFL_Object::RFL_Object_Obj41.ExistProb = 0;
  @CAN_RadarFL::RFL_Object::RFL_Object_Obj41.FilterInformation = 0;
  @CAN_RadarFL::RFL_Object::RFL_Object_Obj41.Length = 0;
  }
  if(init_count == 59)
  {
  @CAN_RadarFL::RFL_Object::RFL_Object_Obj41.LengthVnce = 0;
  @CAN_RadarFL::RFL_Object::RFL_Object_Obj41.MeasurementStatus = 0;
  @CAN_RadarFL::RFL_Object::RFL_Object_Obj41.MovingStatus = 0;
  @CAN_RadarFL::RFL_Object::RFL_Object_Obj41.ObjId = 0;
  @CAN_RadarFL::RFL_Object::RFL_Object_Obj41.OrientationYaw = 0;
  @CAN_RadarFL::RFL_Object::RFL_Object_Obj41.OrientationYawVnce = 0;
  @CAN_RadarFL::RFL_Object::RFL_Object_Obj41.ProbClassConfidence = 0;
  @CAN_RadarFL::RFL_Object::RFL_Object_Obj41.ProbClassType = 0;
  @CAN_RadarFL::RFL_Object::RFL_Object_Obj41.Px = 0;
  @CAN_RadarFL::RFL_Object::RFL_Object_Obj41.PxAxCoVnce = 0;
  @CAN_RadarFL::RFL_Object::RFL_Object_Obj41.PxAyCoVnce = 0;
  @CAN_RadarFL::RFL_Object::RFL_Object_Obj41.PxPyCoVnce = 0;
  @CAN_RadarFL::RFL_Object::RFL_Object_Obj41.PxVnce = 0;
  @CAN_RadarFL::RFL_Object::RFL_Object_Obj41.PxVxCoVnce = 0;
  @CAN_RadarFL::RFL_Object::RFL_Object_Obj41.PxVyCoVnce = 0;
  @CAN_RadarFL::RFL_Object::RFL_Object_Obj41.Py = 0;
  @CAN_RadarFL::RFL_Object::RFL_Object_Obj41.PyAxCoVnce = 0;
  @CAN_RadarFL::RFL_Object::RFL_Object_Obj41.PyAyCoVnce = 0;
  @CAN_RadarFL::RFL_Object::RFL_Object_Obj41.PyVnce = 0;
  @CAN_RadarFL::RFL_Object::RFL_Object_Obj41.PyVxCoVnce = 0;
  @CAN_RadarFL::RFL_Object::RFL_Object_Obj41.PyVyCoVnce = 0;
  @CAN_RadarFL::RFL_Object::RFL_Object_Obj41.ReferencePoint = 0;
  @CAN_RadarFL::RFL_Object::RFL_Object_Obj41.Vx = 0;
  @CAN_RadarFL::RFL_Object::RFL_Object_Obj41.VxAxCoVnce = 0;
  @CAN_RadarFL::RFL_Object::RFL_Object_Obj41.VxAyCoVnce = 0;
  }
  if(init_count == 60)
  {
  @CAN_RadarFL::RFL_Object::RFL_Object_Obj41.VxVnce = 0;
  @CAN_RadarFL::RFL_Object::RFL_Object_Obj41.VxVyCoVnce = 0;
  @CAN_RadarFL::RFL_Object::RFL_Object_Obj41.Vy = 0;
  @CAN_RadarFL::RFL_Object::RFL_Object_Obj41.VyAxCoVnce = 0;
  @CAN_RadarFL::RFL_Object::RFL_Object_Obj41.VyAyCoVnce = 0;
  @CAN_RadarFL::RFL_Object::RFL_Object_Obj41.VyVnce = 0;
  @CAN_RadarFL::RFL_Object::RFL_Object_Obj41.Width = 0;
  @CAN_RadarFL::RFL_Object::RFL_Object_Obj41.WidthVnce = 0;
  @CAN_RadarFL::RFL_Object::RFL_Object_Obj42.Age = 0;
  @CAN_RadarFL::RFL_Object::RFL_Object_Obj42.Ax = 0;
  @CAN_RadarFL::RFL_Object::RFL_Object_Obj42.AxAyCoVnce = 0;
  @CAN_RadarFL::RFL_Object::RFL_Object_Obj42.AxVnce = 0;
  @CAN_RadarFL::RFL_Object::RFL_Object_Obj42.Ay = 0;
  @CAN_RadarFL::RFL_Object::RFL_Object_Obj42.AyVnce = 0;
  @CAN_RadarFL::RFL_Object::RFL_Object_Obj42.ExistProb = 0;
  @CAN_RadarFL::RFL_Object::RFL_Object_Obj42.FilterInformation = 0;
  @CAN_RadarFL::RFL_Object::RFL_Object_Obj42.Length = 0;
  @CAN_RadarFL::RFL_Object::RFL_Object_Obj42.LengthVnce = 0;
  @CAN_RadarFL::RFL_Object::RFL_Object_Obj42.MeasurementStatus = 0;
  @CAN_RadarFL::RFL_Object::RFL_Object_Obj42.MovingStatus = 0;
  @CAN_RadarFL::RFL_Object::RFL_Object_Obj42.ObjId = 0;
  @CAN_RadarFL::RFL_Object::RFL_Object_Obj42.OrientationYaw = 0;
  @CAN_RadarFL::RFL_Object::RFL_Object_Obj42.OrientationYawVnce = 0;
  @CAN_RadarFL::RFL_Object::RFL_Object_Obj42.ProbClassConfidence = 0;
  @CAN_RadarFL::RFL_Object::RFL_Object_Obj42.ProbClassType = 0;
  }
  if(init_count == 61)
  {
  @CAN_RadarFL::RFL_Object::RFL_Object_Obj42.Px = 0;
  @CAN_RadarFL::RFL_Object::RFL_Object_Obj42.PxAxCoVnce = 0;
  @CAN_RadarFL::RFL_Object::RFL_Object_Obj42.PxAyCoVnce = 0;
  @CAN_RadarFL::RFL_Object::RFL_Object_Obj42.PxPyCoVnce = 0;
  @CAN_RadarFL::RFL_Object::RFL_Object_Obj42.PxVnce = 0;
  @CAN_RadarFL::RFL_Object::RFL_Object_Obj42.PxVxCoVnce = 0;
  @CAN_RadarFL::RFL_Object::RFL_Object_Obj42.PxVyCoVnce = 0;
  @CAN_RadarFL::RFL_Object::RFL_Object_Obj42.Py = 0;
  @CAN_RadarFL::RFL_Object::RFL_Object_Obj42.PyAxCoVnce = 0;
  @CAN_RadarFL::RFL_Object::RFL_Object_Obj42.PyAyCoVnce = 0;
  @CAN_RadarFL::RFL_Object::RFL_Object_Obj42.PyVnce = 0;
  @CAN_RadarFL::RFL_Object::RFL_Object_Obj42.PyVxCoVnce = 0;
  @CAN_RadarFL::RFL_Object::RFL_Object_Obj42.PyVyCoVnce = 0;
  @CAN_RadarFL::RFL_Object::RFL_Object_Obj42.ReferencePoint = 0;
  @CAN_RadarFL::RFL_Object::RFL_Object_Obj42.Vx = 0;
  @CAN_RadarFL::RFL_Object::RFL_Object_Obj42.VxAxCoVnce = 0;
  @CAN_RadarFL::RFL_Object::RFL_Object_Obj42.VxAyCoVnce = 0;
  @CAN_RadarFL::RFL_Object::RFL_Object_Obj42.VxVnce = 0;
  @CAN_RadarFL::RFL_Object::RFL_Object_Obj42.VxVyCoVnce = 0;
  @CAN_RadarFL::RFL_Object::RFL_Object_Obj42.Vy = 0;
  @CAN_RadarFL::RFL_Object::RFL_Object_Obj42.VyAxCoVnce = 0;
  @CAN_RadarFL::RFL_Object::RFL_Object_Obj42.VyAyCoVnce = 0;
  @CAN_RadarFL::RFL_Object::RFL_Object_Obj42.VyVnce = 0;
  @CAN_RadarFL::RFL_Object::RFL_Object_Obj42.Width = 0;
  @CAN_RadarFL::RFL_Object::RFL_Object_Obj42.WidthVnce = 0;
  }
  if(init_count == 62)
  {
  @CAN_RadarFL::RFL_Object::RFL_Object_Obj43.Age = 0;
  @CAN_RadarFL::RFL_Object::RFL_Object_Obj43.Ax = 0;
  @CAN_RadarFL::RFL_Object::RFL_Object_Obj43.AxAyCoVnce = 0;
  @CAN_RadarFL::RFL_Object::RFL_Object_Obj43.AxVnce = 0;
  @CAN_RadarFL::RFL_Object::RFL_Object_Obj43.Ay = 0;
  @CAN_RadarFL::RFL_Object::RFL_Object_Obj43.AyVnce = 0;
  @CAN_RadarFL::RFL_Object::RFL_Object_Obj43.ExistProb = 0;
  @CAN_RadarFL::RFL_Object::RFL_Object_Obj43.FilterInformation = 0;
  @CAN_RadarFL::RFL_Object::RFL_Object_Obj43.Length = 0;
  @CAN_RadarFL::RFL_Object::RFL_Object_Obj43.LengthVnce = 0;
  @CAN_RadarFL::RFL_Object::RFL_Object_Obj43.MeasurementStatus = 0;
  @CAN_RadarFL::RFL_Object::RFL_Object_Obj43.MovingStatus = 0;
  @CAN_RadarFL::RFL_Object::RFL_Object_Obj43.ObjId = 0;
  @CAN_RadarFL::RFL_Object::RFL_Object_Obj43.OrientationYaw = 0;
  @CAN_RadarFL::RFL_Object::RFL_Object_Obj43.OrientationYawVnce = 0;
  @CAN_RadarFL::RFL_Object::RFL_Object_Obj43.ProbClassConfidence = 0;
  @CAN_RadarFL::RFL_Object::RFL_Object_Obj43.ProbClassType = 0;
  @CAN_RadarFL::RFL_Object::RFL_Object_Obj43.Px = 0;
  @CAN_RadarFL::RFL_Object::RFL_Object_Obj43.PxAxCoVnce = 0;
  @CAN_RadarFL::RFL_Object::RFL_Object_Obj43.PxAyCoVnce = 0;
  @CAN_RadarFL::RFL_Object::RFL_Object_Obj43.PxPyCoVnce = 0;
  @CAN_RadarFL::RFL_Object::RFL_Object_Obj43.PxVnce = 0;
  @CAN_RadarFL::RFL_Object::RFL_Object_Obj43.PxVxCoVnce = 0;
  @CAN_RadarFL::RFL_Object::RFL_Object_Obj43.PxVyCoVnce = 0;
  @CAN_RadarFL::RFL_Object::RFL_Object_Obj43.Py = 0;
  }
  if(init_count == 63)
  {
  @CAN_RadarFL::RFL_Object::RFL_Object_Obj43.PyAxCoVnce = 0;
  @CAN_RadarFL::RFL_Object::RFL_Object_Obj43.PyAyCoVnce = 0;
  @CAN_RadarFL::RFL_Object::RFL_Object_Obj43.PyVnce = 0;
  @CAN_RadarFL::RFL_Object::RFL_Object_Obj43.PyVxCoVnce = 0;
  @CAN_RadarFL::RFL_Object::RFL_Object_Obj43.PyVyCoVnce = 0;
  @CAN_RadarFL::RFL_Object::RFL_Object_Obj43.ReferencePoint = 0;
  @CAN_RadarFL::RFL_Object::RFL_Object_Obj43.Vx = 0;
  @CAN_RadarFL::RFL_Object::RFL_Object_Obj43.VxAxCoVnce = 0;
  @CAN_RadarFL::RFL_Object::RFL_Object_Obj43.VxAyCoVnce = 0;
  @CAN_RadarFL::RFL_Object::RFL_Object_Obj43.VxVnce = 0;
  @CAN_RadarFL::RFL_Object::RFL_Object_Obj43.VxVyCoVnce = 0;
  @CAN_RadarFL::RFL_Object::RFL_Object_Obj43.Vy = 0;
  @CAN_RadarFL::RFL_Object::RFL_Object_Obj43.VyAxCoVnce = 0;
  @CAN_RadarFL::RFL_Object::RFL_Object_Obj43.VyAyCoVnce = 0;
  @CAN_RadarFL::RFL_Object::RFL_Object_Obj43.VyVnce = 0;
  @CAN_RadarFL::RFL_Object::RFL_Object_Obj43.Width = 0;
  @CAN_RadarFL::RFL_Object::RFL_Object_Obj43.WidthVnce = 0;
  @CAN_RadarFL::RFL_Object::RFL_Object_Obj44.Age = 0;
  @CAN_RadarFL::RFL_Object::RFL_Object_Obj44.Ax = 0;
  @CAN_RadarFL::RFL_Object::RFL_Object_Obj44.AxAyCoVnce = 0;
  @CAN_RadarFL::RFL_Object::RFL_Object_Obj44.AxVnce = 0;
  @CAN_RadarFL::RFL_Object::RFL_Object_Obj44.Ay = 0;
  @CAN_RadarFL::RFL_Object::RFL_Object_Obj44.AyVnce = 0;
  @CAN_RadarFL::RFL_Object::RFL_Object_Obj44.ExistProb = 0;
  @CAN_RadarFL::RFL_Object::RFL_Object_Obj44.FilterInformation = 0;
  }
  if(init_count == 64)
  {
  @CAN_RadarFL::RFL_Object::RFL_Object_Obj44.Length = 0;
  @CAN_RadarFL::RFL_Object::RFL_Object_Obj44.LengthVnce = 0;
  @CAN_RadarFL::RFL_Object::RFL_Object_Obj44.MeasurementStatus = 0;
  @CAN_RadarFL::RFL_Object::RFL_Object_Obj44.MovingStatus = 0;
  @CAN_RadarFL::RFL_Object::RFL_Object_Obj44.ObjId = 0;
  @CAN_RadarFL::RFL_Object::RFL_Object_Obj44.OrientationYaw = 0;
  @CAN_RadarFL::RFL_Object::RFL_Object_Obj44.OrientationYawVnce = 0;
  @CAN_RadarFL::RFL_Object::RFL_Object_Obj44.ProbClassConfidence = 0;
  @CAN_RadarFL::RFL_Object::RFL_Object_Obj44.ProbClassType = 0;
  @CAN_RadarFL::RFL_Object::RFL_Object_Obj44.Px = 0;
  @CAN_RadarFL::RFL_Object::RFL_Object_Obj44.PxAxCoVnce = 0;
  @CAN_RadarFL::RFL_Object::RFL_Object_Obj44.PxAyCoVnce = 0;
  @CAN_RadarFL::RFL_Object::RFL_Object_Obj44.PxPyCoVnce = 0;
  @CAN_RadarFL::RFL_Object::RFL_Object_Obj44.PxVnce = 0;
  @CAN_RadarFL::RFL_Object::RFL_Object_Obj44.PxVxCoVnce = 0;
  @CAN_RadarFL::RFL_Object::RFL_Object_Obj44.PxVyCoVnce = 0;
  @CAN_RadarFL::RFL_Object::RFL_Object_Obj44.Py = 0;
  @CAN_RadarFL::RFL_Object::RFL_Object_Obj44.PyAxCoVnce = 0;
  @CAN_RadarFL::RFL_Object::RFL_Object_Obj44.PyAyCoVnce = 0;
  @CAN_RadarFL::RFL_Object::RFL_Object_Obj44.PyVnce = 0;
  @CAN_RadarFL::RFL_Object::RFL_Object_Obj44.PyVxCoVnce = 0;
  @CAN_RadarFL::RFL_Object::RFL_Object_Obj44.PyVyCoVnce = 0;
  @CAN_RadarFL::RFL_Object::RFL_Object_Obj44.ReferencePoint = 0;
  @CAN_RadarFL::RFL_Object::RFL_Object_Obj44.Vx = 0;
  @CAN_RadarFL::RFL_Object::RFL_Object_Obj44.VxAxCoVnce = 0;
  }
  if(init_count == 65)
  {
  @CAN_RadarFL::RFL_Object::RFL_Object_Obj44.VxAyCoVnce = 0;
  @CAN_RadarFL::RFL_Object::RFL_Object_Obj44.VxVnce = 0;
  @CAN_RadarFL::RFL_Object::RFL_Object_Obj44.VxVyCoVnce = 0;
  @CAN_RadarFL::RFL_Object::RFL_Object_Obj44.Vy = 0;
  @CAN_RadarFL::RFL_Object::RFL_Object_Obj44.VyAxCoVnce = 0;
  @CAN_RadarFL::RFL_Object::RFL_Object_Obj44.VyAyCoVnce = 0;
  @CAN_RadarFL::RFL_Object::RFL_Object_Obj44.VyVnce = 0;
  @CAN_RadarFL::RFL_Object::RFL_Object_Obj44.Width = 0;
  @CAN_RadarFL::RFL_Object::RFL_Object_Obj44.WidthVnce = 0;
  @CAN_RadarFL::RFL_Object::RFL_Object_Obj45.Age = 0;
  @CAN_RadarFL::RFL_Object::RFL_Object_Obj45.Ax = 0;
  @CAN_RadarFL::RFL_Object::RFL_Object_Obj45.AxAyCoVnce = 0;
  @CAN_RadarFL::RFL_Object::RFL_Object_Obj45.AxVnce = 0;
  @CAN_RadarFL::RFL_Object::RFL_Object_Obj45.Ay = 0;
  @CAN_RadarFL::RFL_Object::RFL_Object_Obj45.AyVnce = 0;
  @CAN_RadarFL::RFL_Object::RFL_Object_Obj45.ExistProb = 0;
  @CAN_RadarFL::RFL_Object::RFL_Object_Obj45.FilterInformation = 0;
  @CAN_RadarFL::RFL_Object::RFL_Object_Obj45.Length = 0;
  @CAN_RadarFL::RFL_Object::RFL_Object_Obj45.LengthVnce = 0;
  @CAN_RadarFL::RFL_Object::RFL_Object_Obj45.MeasurementStatus = 0;
  @CAN_RadarFL::RFL_Object::RFL_Object_Obj45.MovingStatus = 0;
  @CAN_RadarFL::RFL_Object::RFL_Object_Obj45.ObjId = 0;
  @CAN_RadarFL::RFL_Object::RFL_Object_Obj45.OrientationYaw = 0;
  @CAN_RadarFL::RFL_Object::RFL_Object_Obj45.OrientationYawVnce = 0;
  @CAN_RadarFL::RFL_Object::RFL_Object_Obj45.ProbClassConfidence = 0;
  }
  if(init_count == 66)
  {
  @CAN_RadarFL::RFL_Object::RFL_Object_Obj45.ProbClassType = 0;
  @CAN_RadarFL::RFL_Object::RFL_Object_Obj45.Px = 0;
  @CAN_RadarFL::RFL_Object::RFL_Object_Obj45.PxAxCoVnce = 0;
  @CAN_RadarFL::RFL_Object::RFL_Object_Obj45.PxAyCoVnce = 0;
  @CAN_RadarFL::RFL_Object::RFL_Object_Obj45.PxPyCoVnce = 0;
  @CAN_RadarFL::RFL_Object::RFL_Object_Obj45.PxVnce = 0;
  @CAN_RadarFL::RFL_Object::RFL_Object_Obj45.PxVxCoVnce = 0;
  @CAN_RadarFL::RFL_Object::RFL_Object_Obj45.PxVyCoVnce = 0;
  @CAN_RadarFL::RFL_Object::RFL_Object_Obj45.Py = 0;
  @CAN_RadarFL::RFL_Object::RFL_Object_Obj45.PyAxCoVnce = 0;
  @CAN_RadarFL::RFL_Object::RFL_Object_Obj45.PyAyCoVnce = 0;
  @CAN_RadarFL::RFL_Object::RFL_Object_Obj45.PyVnce = 0;
  @CAN_RadarFL::RFL_Object::RFL_Object_Obj45.PyVxCoVnce = 0;
  @CAN_RadarFL::RFL_Object::RFL_Object_Obj45.PyVyCoVnce = 0;
  @CAN_RadarFL::RFL_Object::RFL_Object_Obj45.ReferencePoint = 0;
  @CAN_RadarFL::RFL_Object::RFL_Object_Obj45.Vx = 0;
  @CAN_RadarFL::RFL_Object::RFL_Object_Obj45.VxAxCoVnce = 0;
  @CAN_RadarFL::RFL_Object::RFL_Object_Obj45.VxAyCoVnce = 0;
  @CAN_RadarFL::RFL_Object::RFL_Object_Obj45.VxVnce = 0;
  @CAN_RadarFL::RFL_Object::RFL_Object_Obj45.VxVyCoVnce = 0;
  @CAN_RadarFL::RFL_Object::RFL_Object_Obj45.Vy = 0;
  @CAN_RadarFL::RFL_Object::RFL_Object_Obj45.VyAxCoVnce = 0;
  @CAN_RadarFL::RFL_Object::RFL_Object_Obj45.VyAyCoVnce = 0;
  @CAN_RadarFL::RFL_Object::RFL_Object_Obj45.VyVnce = 0;
  @CAN_RadarFL::RFL_Object::RFL_Object_Obj45.Width = 0;
  }
  if(init_count == 67)
  {
  @CAN_RadarFL::RFL_Object::RFL_Object_Obj45.WidthVnce = 0;
  @CAN_RadarFL::RFL_Object::RFL_Object_Obj46.Age = 0;
  @CAN_RadarFL::RFL_Object::RFL_Object_Obj46.Ax = 0;
  @CAN_RadarFL::RFL_Object::RFL_Object_Obj46.AxAyCoVnce = 0;
  @CAN_RadarFL::RFL_Object::RFL_Object_Obj46.AxVnce = 0;
  @CAN_RadarFL::RFL_Object::RFL_Object_Obj46.Ay = 0;
  @CAN_RadarFL::RFL_Object::RFL_Object_Obj46.AyVnce = 0;
  @CAN_RadarFL::RFL_Object::RFL_Object_Obj46.ExistProb = 0;
  @CAN_RadarFL::RFL_Object::RFL_Object_Obj46.FilterInformation = 0;
  @CAN_RadarFL::RFL_Object::RFL_Object_Obj46.Length = 0;
  @CAN_RadarFL::RFL_Object::RFL_Object_Obj46.LengthVnce = 0;
  @CAN_RadarFL::RFL_Object::RFL_Object_Obj46.MeasurementStatus = 0;
  @CAN_RadarFL::RFL_Object::RFL_Object_Obj46.MovingStatus = 0;
  @CAN_RadarFL::RFL_Object::RFL_Object_Obj46.ObjId = 0;
  @CAN_RadarFL::RFL_Object::RFL_Object_Obj46.OrientationYaw = 0;
  @CAN_RadarFL::RFL_Object::RFL_Object_Obj46.OrientationYawVnce = 0;
  @CAN_RadarFL::RFL_Object::RFL_Object_Obj46.ProbClassConfidence = 0;
  @CAN_RadarFL::RFL_Object::RFL_Object_Obj46.ProbClassType = 0;
  @CAN_RadarFL::RFL_Object::RFL_Object_Obj46.Px = 0;
  @CAN_RadarFL::RFL_Object::RFL_Object_Obj46.PxAxCoVnce = 0;
  @CAN_RadarFL::RFL_Object::RFL_Object_Obj46.PxAyCoVnce = 0;
  @CAN_RadarFL::RFL_Object::RFL_Object_Obj46.PxPyCoVnce = 0;
  @CAN_RadarFL::RFL_Object::RFL_Object_Obj46.PxVnce = 0;
  @CAN_RadarFL::RFL_Object::RFL_Object_Obj46.PxVxCoVnce = 0;
  @CAN_RadarFL::RFL_Object::RFL_Object_Obj46.PxVyCoVnce = 0;
  }
  if(init_count == 68)
  {
  @CAN_RadarFL::RFL_Object::RFL_Object_Obj46.Py = 0;
  @CAN_RadarFL::RFL_Object::RFL_Object_Obj46.PyAxCoVnce = 0;
  @CAN_RadarFL::RFL_Object::RFL_Object_Obj46.PyAyCoVnce = 0;
  @CAN_RadarFL::RFL_Object::RFL_Object_Obj46.PyVnce = 0;
  @CAN_RadarFL::RFL_Object::RFL_Object_Obj46.PyVxCoVnce = 0;
  @CAN_RadarFL::RFL_Object::RFL_Object_Obj46.PyVyCoVnce = 0;
  @CAN_RadarFL::RFL_Object::RFL_Object_Obj46.ReferencePoint = 0;
  @CAN_RadarFL::RFL_Object::RFL_Object_Obj46.Vx = 0;
  @CAN_RadarFL::RFL_Object::RFL_Object_Obj46.VxAxCoVnce = 0;
  @CAN_RadarFL::RFL_Object::RFL_Object_Obj46.VxAyCoVnce = 0;
  @CAN_RadarFL::RFL_Object::RFL_Object_Obj46.VxVnce = 0;
  @CAN_RadarFL::RFL_Object::RFL_Object_Obj46.VxVyCoVnce = 0;
  @CAN_RadarFL::RFL_Object::RFL_Object_Obj46.Vy = 0;
  @CAN_RadarFL::RFL_Object::RFL_Object_Obj46.VyAxCoVnce = 0;
  @CAN_RadarFL::RFL_Object::RFL_Object_Obj46.VyAyCoVnce = 0;
  @CAN_RadarFL::RFL_Object::RFL_Object_Obj46.VyVnce = 0;
  @CAN_RadarFL::RFL_Object::RFL_Object_Obj46.Width = 0;
  @CAN_RadarFL::RFL_Object::RFL_Object_Obj46.WidthVnce = 0;
  @CAN_RadarFL::RFL_Object::RFL_Object_Obj47.Age = 0;
  @CAN_RadarFL::RFL_Object::RFL_Object_Obj47.Ax = 0;
  @CAN_RadarFL::RFL_Object::RFL_Object_Obj47.AxAyCoVnce = 0;
  @CAN_RadarFL::RFL_Object::RFL_Object_Obj47.AxVnce = 0;
  @CAN_RadarFL::RFL_Object::RFL_Object_Obj47.Ay = 0;
  @CAN_RadarFL::RFL_Object::RFL_Object_Obj47.AyVnce = 0;
  @CAN_RadarFL::RFL_Object::RFL_Object_Obj47.ExistProb = 0;
  }
  if(init_count == 69)
  {
  @CAN_RadarFL::RFL_Object::RFL_Object_Obj47.FilterInformation = 0;
  @CAN_RadarFL::RFL_Object::RFL_Object_Obj47.Length = 0;
  @CAN_RadarFL::RFL_Object::RFL_Object_Obj47.LengthVnce = 0;
  @CAN_RadarFL::RFL_Object::RFL_Object_Obj47.MeasurementStatus = 0;
  @CAN_RadarFL::RFL_Object::RFL_Object_Obj47.MovingStatus = 0;
  @CAN_RadarFL::RFL_Object::RFL_Object_Obj47.ObjId = 0;
  @CAN_RadarFL::RFL_Object::RFL_Object_Obj47.OrientationYaw = 0;
  @CAN_RadarFL::RFL_Object::RFL_Object_Obj47.OrientationYawVnce = 0;
  @CAN_RadarFL::RFL_Object::RFL_Object_Obj47.ProbClassConfidence = 0;
  @CAN_RadarFL::RFL_Object::RFL_Object_Obj47.ProbClassType = 0;
  @CAN_RadarFL::RFL_Object::RFL_Object_Obj47.Px = 0;
  @CAN_RadarFL::RFL_Object::RFL_Object_Obj47.PxAxCoVnce = 0;
  @CAN_RadarFL::RFL_Object::RFL_Object_Obj47.PxAyCoVnce = 0;
  @CAN_RadarFL::RFL_Object::RFL_Object_Obj47.PxPyCoVnce = 0;
  @CAN_RadarFL::RFL_Object::RFL_Object_Obj47.PxVnce = 0;
  @CAN_RadarFL::RFL_Object::RFL_Object_Obj47.PxVxCoVnce = 0;
  @CAN_RadarFL::RFL_Object::RFL_Object_Obj47.PxVyCoVnce = 0;
  @CAN_RadarFL::RFL_Object::RFL_Object_Obj47.Py = 0;
  @CAN_RadarFL::RFL_Object::RFL_Object_Obj47.PyAxCoVnce = 0;
  @CAN_RadarFL::RFL_Object::RFL_Object_Obj47.PyAyCoVnce = 0;
  @CAN_RadarFL::RFL_Object::RFL_Object_Obj47.PyVnce = 0;
  @CAN_RadarFL::RFL_Object::RFL_Object_Obj47.PyVxCoVnce = 0;
  @CAN_RadarFL::RFL_Object::RFL_Object_Obj47.PyVyCoVnce = 0;
  @CAN_RadarFL::RFL_Object::RFL_Object_Obj47.ReferencePoint = 0;
  @CAN_RadarFL::RFL_Object::RFL_Object_Obj47.Vx = 0;
  }
  if(init_count == 70)
  {
  @CAN_RadarFL::RFL_Object::RFL_Object_Obj47.VxAxCoVnce = 0;
  @CAN_RadarFL::RFL_Object::RFL_Object_Obj47.VxAyCoVnce = 0;
  @CAN_RadarFL::RFL_Object::RFL_Object_Obj47.VxVnce = 0;
  @CAN_RadarFL::RFL_Object::RFL_Object_Obj47.VxVyCoVnce = 0;
  @CAN_RadarFL::RFL_Object::RFL_Object_Obj47.Vy = 0;
  @CAN_RadarFL::RFL_Object::RFL_Object_Obj47.VyAxCoVnce = 0;
  @CAN_RadarFL::RFL_Object::RFL_Object_Obj47.VyAyCoVnce = 0;
  @CAN_RadarFL::RFL_Object::RFL_Object_Obj47.VyVnce = 0;
  @CAN_RadarFL::RFL_Object::RFL_Object_Obj47.Width = 0;
  @CAN_RadarFL::RFL_Object::RFL_Object_Obj47.WidthVnce = 0;
  @CAN_RadarFL::RFL_Object::RFL_Object_Obj48.Age = 0;
  @CAN_RadarFL::RFL_Object::RFL_Object_Obj48.Ax = 0;
  @CAN_RadarFL::RFL_Object::RFL_Object_Obj48.AxAyCoVnce = 0;
  @CAN_RadarFL::RFL_Object::RFL_Object_Obj48.AxVnce = 0;
  @CAN_RadarFL::RFL_Object::RFL_Object_Obj48.Ay = 0;
  @CAN_RadarFL::RFL_Object::RFL_Object_Obj48.AyVnce = 0;
  @CAN_RadarFL::RFL_Object::RFL_Object_Obj48.ExistProb = 0;
  @CAN_RadarFL::RFL_Object::RFL_Object_Obj48.FilterInformation = 0;
  @CAN_RadarFL::RFL_Object::RFL_Object_Obj48.Length = 0;
  @CAN_RadarFL::RFL_Object::RFL_Object_Obj48.LengthVnce = 0;
  @CAN_RadarFL::RFL_Object::RFL_Object_Obj48.MeasurementStatus = 0;
  @CAN_RadarFL::RFL_Object::RFL_Object_Obj48.MovingStatus = 0;
  @CAN_RadarFL::RFL_Object::RFL_Object_Obj48.ObjId = 0;
  @CAN_RadarFL::RFL_Object::RFL_Object_Obj48.OrientationYaw = 0;
  @CAN_RadarFL::RFL_Object::RFL_Object_Obj48.OrientationYawVnce = 0;
  }
  if(init_count == 71)
  {
  @CAN_RadarFL::RFL_Object::RFL_Object_Obj48.ProbClassConfidence = 0;
  @CAN_RadarFL::RFL_Object::RFL_Object_Obj48.ProbClassType = 0;
  @CAN_RadarFL::RFL_Object::RFL_Object_Obj48.Px = 0;
  @CAN_RadarFL::RFL_Object::RFL_Object_Obj48.PxAxCoVnce = 0;
  @CAN_RadarFL::RFL_Object::RFL_Object_Obj48.PxAyCoVnce = 0;
  @CAN_RadarFL::RFL_Object::RFL_Object_Obj48.PxPyCoVnce = 0;
  @CAN_RadarFL::RFL_Object::RFL_Object_Obj48.PxVnce = 0;
  @CAN_RadarFL::RFL_Object::RFL_Object_Obj48.PxVxCoVnce = 0;
  @CAN_RadarFL::RFL_Object::RFL_Object_Obj48.PxVyCoVnce = 0;
  @CAN_RadarFL::RFL_Object::RFL_Object_Obj48.Py = 0;
  @CAN_RadarFL::RFL_Object::RFL_Object_Obj48.PyAxCoVnce = 0;
  @CAN_RadarFL::RFL_Object::RFL_Object_Obj48.PyAyCoVnce = 0;
  @CAN_RadarFL::RFL_Object::RFL_Object_Obj48.PyVnce = 0;
  @CAN_RadarFL::RFL_Object::RFL_Object_Obj48.PyVxCoVnce = 0;
  @CAN_RadarFL::RFL_Object::RFL_Object_Obj48.PyVyCoVnce = 0;
  @CAN_RadarFL::RFL_Object::RFL_Object_Obj48.ReferencePoint = 0;
  @CAN_RadarFL::RFL_Object::RFL_Object_Obj48.Vx = 0;
  @CAN_RadarFL::RFL_Object::RFL_Object_Obj48.VxAxCoVnce = 0;
  @CAN_RadarFL::RFL_Object::RFL_Object_Obj48.VxAyCoVnce = 0;
  @CAN_RadarFL::RFL_Object::RFL_Object_Obj48.VxVnce = 0;
  @CAN_RadarFL::RFL_Object::RFL_Object_Obj48.VxVyCoVnce = 0;
  @CAN_RadarFL::RFL_Object::RFL_Object_Obj48.Vy = 0;
  @CAN_RadarFL::RFL_Object::RFL_Object_Obj48.VyAxCoVnce = 0;
  @CAN_RadarFL::RFL_Object::RFL_Object_Obj48.VyAyCoVnce = 0;
  @CAN_RadarFL::RFL_Object::RFL_Object_Obj48.VyVnce = 0;
  }
  if(init_count == 72)
  {
  @CAN_RadarFL::RFL_Object::RFL_Object_Obj48.Width = 0;
  @CAN_RadarFL::RFL_Object::RFL_Object_Obj48.WidthVnce = 0;
  @CAN_RadarFL::RFL_Object::RFL_Object_Obj4.Age = 0;
  @CAN_RadarFL::RFL_Object::RFL_Object_Obj4.Ax = 0;
  @CAN_RadarFL::RFL_Object::RFL_Object_Obj4.AxAyCoVnce = 0;
  @CAN_RadarFL::RFL_Object::RFL_Object_Obj4.AxVnce = 0;
  @CAN_RadarFL::RFL_Object::RFL_Object_Obj4.Ay = 0;
  @CAN_RadarFL::RFL_Object::RFL_Object_Obj4.AyVnce = 0;
  @CAN_RadarFL::RFL_Object::RFL_Object_Obj4.ExistProb = 0;
  @CAN_RadarFL::RFL_Object::RFL_Object_Obj4.FilterInformation = 0;
  @CAN_RadarFL::RFL_Object::RFL_Object_Obj4.Length = 0;
  @CAN_RadarFL::RFL_Object::RFL_Object_Obj4.LengthVnce = 0;
  @CAN_RadarFL::RFL_Object::RFL_Object_Obj4.MeasurementStatus = 0;
  @CAN_RadarFL::RFL_Object::RFL_Object_Obj4.MovingStatus = 0;
  @CAN_RadarFL::RFL_Object::RFL_Object_Obj4.ObjId = 0;
  @CAN_RadarFL::RFL_Object::RFL_Object_Obj4.OrientationYaw = 0;
  @CAN_RadarFL::RFL_Object::RFL_Object_Obj4.OrientationYawVnce = 0;
  @CAN_RadarFL::RFL_Object::RFL_Object_Obj4.ProbClassConfidence = 0;
  @CAN_RadarFL::RFL_Object::RFL_Object_Obj4.ProbClassType = 0;
  @CAN_RadarFL::RFL_Object::RFL_Object_Obj4.Px = 0;
  @CAN_RadarFL::RFL_Object::RFL_Object_Obj4.PxAxCoVnce = 0;
  @CAN_RadarFL::RFL_Object::RFL_Object_Obj4.PxAyCoVnce = 0;
  @CAN_RadarFL::RFL_Object::RFL_Object_Obj4.PxPyCoVnce = 0;
  @CAN_RadarFL::RFL_Object::RFL_Object_Obj4.PxVnce = 0;
  @CAN_RadarFL::RFL_Object::RFL_Object_Obj4.PxVxCoVnce = 0;
  }
  if(init_count == 73)
  {
  @CAN_RadarFL::RFL_Object::RFL_Object_Obj4.PxVyCoVnce = 0;
  @CAN_RadarFL::RFL_Object::RFL_Object_Obj4.Py = 0;
  @CAN_RadarFL::RFL_Object::RFL_Object_Obj4.PyAxCoVnce = 0;
  @CAN_RadarFL::RFL_Object::RFL_Object_Obj4.PyAyCoVnce = 0;
  @CAN_RadarFL::RFL_Object::RFL_Object_Obj4.PyVnce = 0;
  @CAN_RadarFL::RFL_Object::RFL_Object_Obj4.PyVxCoVnce = 0;
  @CAN_RadarFL::RFL_Object::RFL_Object_Obj4.PyVyCoVnce = 0;
  @CAN_RadarFL::RFL_Object::RFL_Object_Obj4.ReferencePoint = 0;
  @CAN_RadarFL::RFL_Object::RFL_Object_Obj4.Vx = 0;
  @CAN_RadarFL::RFL_Object::RFL_Object_Obj4.VxAxCoVnce = 0;
  @CAN_RadarFL::RFL_Object::RFL_Object_Obj4.VxAyCoVnce = 0;
  @CAN_RadarFL::RFL_Object::RFL_Object_Obj4.VxVnce = 0;
  @CAN_RadarFL::RFL_Object::RFL_Object_Obj4.VxVyCoVnce = 0;
  @CAN_RadarFL::RFL_Object::RFL_Object_Obj4.Vy = 0;
  @CAN_RadarFL::RFL_Object::RFL_Object_Obj4.VyAxCoVnce = 0;
  @CAN_RadarFL::RFL_Object::RFL_Object_Obj4.VyAyCoVnce = 0;
  @CAN_RadarFL::RFL_Object::RFL_Object_Obj4.VyVnce = 0;
  @CAN_RadarFL::RFL_Object::RFL_Object_Obj4.Width = 0;
  @CAN_RadarFL::RFL_Object::RFL_Object_Obj4.WidthVnce = 0;
  @CAN_RadarFL::RFL_Object::RFL_Object_Obj5.Age = 0;
  @CAN_RadarFL::RFL_Object::RFL_Object_Obj5.Ax = 0;
  @CAN_RadarFL::RFL_Object::RFL_Object_Obj5.AxAyCoVnce = 0;
  @CAN_RadarFL::RFL_Object::RFL_Object_Obj5.AxVnce = 0;
  @CAN_RadarFL::RFL_Object::RFL_Object_Obj5.Ay = 0;
  @CAN_RadarFL::RFL_Object::RFL_Object_Obj5.AyVnce = 0;
  }
  if(init_count == 74)
  {
  @CAN_RadarFL::RFL_Object::RFL_Object_Obj5.ExistProb = 0;
  @CAN_RadarFL::RFL_Object::RFL_Object_Obj5.FilterInformation = 0;
  @CAN_RadarFL::RFL_Object::RFL_Object_Obj5.Length = 0;
  @CAN_RadarFL::RFL_Object::RFL_Object_Obj5.LengthVnce = 0;
  @CAN_RadarFL::RFL_Object::RFL_Object_Obj5.MeasurementStatus = 0;
  @CAN_RadarFL::RFL_Object::RFL_Object_Obj5.MovingStatus = 0;
  @CAN_RadarFL::RFL_Object::RFL_Object_Obj5.ObjId = 0;
  @CAN_RadarFL::RFL_Object::RFL_Object_Obj5.OrientationYaw = 0;
  @CAN_RadarFL::RFL_Object::RFL_Object_Obj5.OrientationYawVnce = 0;
  @CAN_RadarFL::RFL_Object::RFL_Object_Obj5.ProbClassConfidence = 0;
  @CAN_RadarFL::RFL_Object::RFL_Object_Obj5.ProbClassType = 0;
  @CAN_RadarFL::RFL_Object::RFL_Object_Obj5.Px = 0;
  @CAN_RadarFL::RFL_Object::RFL_Object_Obj5.PxAxCoVnce = 0;
  @CAN_RadarFL::RFL_Object::RFL_Object_Obj5.PxAyCoVnce = 0;
  @CAN_RadarFL::RFL_Object::RFL_Object_Obj5.PxPyCoVnce = 0;
  @CAN_RadarFL::RFL_Object::RFL_Object_Obj5.PxVnce = 0;
  @CAN_RadarFL::RFL_Object::RFL_Object_Obj5.PxVxCoVnce = 0;
  @CAN_RadarFL::RFL_Object::RFL_Object_Obj5.PxVyCoVnce = 0;
  @CAN_RadarFL::RFL_Object::RFL_Object_Obj5.Py = 0;
  @CAN_RadarFL::RFL_Object::RFL_Object_Obj5.PyAxCoVnce = 0;
  @CAN_RadarFL::RFL_Object::RFL_Object_Obj5.PyAyCoVnce = 0;
  @CAN_RadarFL::RFL_Object::RFL_Object_Obj5.PyVnce = 0;
  @CAN_RadarFL::RFL_Object::RFL_Object_Obj5.PyVxCoVnce = 0;
  @CAN_RadarFL::RFL_Object::RFL_Object_Obj5.PyVyCoVnce = 0;
  @CAN_RadarFL::RFL_Object::RFL_Object_Obj5.ReferencePoint = 0;
  }
  if(init_count == 75)
  {
  @CAN_RadarFL::RFL_Object::RFL_Object_Obj5.Vx = 0;
  @CAN_RadarFL::RFL_Object::RFL_Object_Obj5.VxAxCoVnce = 0;
  @CAN_RadarFL::RFL_Object::RFL_Object_Obj5.VxAyCoVnce = 0;
  @CAN_RadarFL::RFL_Object::RFL_Object_Obj5.VxVnce = 0;
  @CAN_RadarFL::RFL_Object::RFL_Object_Obj5.VxVyCoVnce = 0;
  @CAN_RadarFL::RFL_Object::RFL_Object_Obj5.Vy = 0;
  @CAN_RadarFL::RFL_Object::RFL_Object_Obj5.VyAxCoVnce = 0;
  @CAN_RadarFL::RFL_Object::RFL_Object_Obj5.VyAyCoVnce = 0;
  @CAN_RadarFL::RFL_Object::RFL_Object_Obj5.VyVnce = 0;
  @CAN_RadarFL::RFL_Object::RFL_Object_Obj5.Width = 0;
  @CAN_RadarFL::RFL_Object::RFL_Object_Obj5.WidthVnce = 0;
  @CAN_RadarFL::RFL_Object::RFL_Object_Obj6.Age = 0;
  @CAN_RadarFL::RFL_Object::RFL_Object_Obj6.Ax = 0;
  @CAN_RadarFL::RFL_Object::RFL_Object_Obj6.AxAyCoVnce = 0;
  @CAN_RadarFL::RFL_Object::RFL_Object_Obj6.AxVnce = 0;
  @CAN_RadarFL::RFL_Object::RFL_Object_Obj6.Ay = 0;
  @CAN_RadarFL::RFL_Object::RFL_Object_Obj6.AyVnce = 0;
  @CAN_RadarFL::RFL_Object::RFL_Object_Obj6.ExistProb = 0;
  @CAN_RadarFL::RFL_Object::RFL_Object_Obj6.FilterInformation = 0;
  @CAN_RadarFL::RFL_Object::RFL_Object_Obj6.Length = 0;
  @CAN_RadarFL::RFL_Object::RFL_Object_Obj6.LengthVnce = 0;
  @CAN_RadarFL::RFL_Object::RFL_Object_Obj6.MeasurementStatus = 0;
  @CAN_RadarFL::RFL_Object::RFL_Object_Obj6.MovingStatus = 0;
  @CAN_RadarFL::RFL_Object::RFL_Object_Obj6.ObjId = 0;
  @CAN_RadarFL::RFL_Object::RFL_Object_Obj6.OrientationYaw = 0;
  }
  if(init_count == 76)
  {
  @CAN_RadarFL::RFL_Object::RFL_Object_Obj6.OrientationYawVnce = 0;
  @CAN_RadarFL::RFL_Object::RFL_Object_Obj6.ProbClassConfidence = 0;
  @CAN_RadarFL::RFL_Object::RFL_Object_Obj6.ProbClassType = 0;
  @CAN_RadarFL::RFL_Object::RFL_Object_Obj6.Px = 0;
  @CAN_RadarFL::RFL_Object::RFL_Object_Obj6.PxAxCoVnce = 0;
  @CAN_RadarFL::RFL_Object::RFL_Object_Obj6.PxAyCoVnce = 0;
  @CAN_RadarFL::RFL_Object::RFL_Object_Obj6.PxPyCoVnce = 0;
  @CAN_RadarFL::RFL_Object::RFL_Object_Obj6.PxVnce = 0;
  @CAN_RadarFL::RFL_Object::RFL_Object_Obj6.PxVxCoVnce = 0;
  @CAN_RadarFL::RFL_Object::RFL_Object_Obj6.PxVyCoVnce = 0;
  @CAN_RadarFL::RFL_Object::RFL_Object_Obj6.Py = 0;
  @CAN_RadarFL::RFL_Object::RFL_Object_Obj6.PyAxCoVnce = 0;
  @CAN_RadarFL::RFL_Object::RFL_Object_Obj6.PyAyCoVnce = 0;
  @CAN_RadarFL::RFL_Object::RFL_Object_Obj6.PyVnce = 0;
  @CAN_RadarFL::RFL_Object::RFL_Object_Obj6.PyVxCoVnce = 0;
  @CAN_RadarFL::RFL_Object::RFL_Object_Obj6.PyVyCoVnce = 0;
  @CAN_RadarFL::RFL_Object::RFL_Object_Obj6.ReferencePoint = 0;
  @CAN_RadarFL::RFL_Object::RFL_Object_Obj6.Vx = 0;
  @CAN_RadarFL::RFL_Object::RFL_Object_Obj6.VxAxCoVnce = 0;
  @CAN_RadarFL::RFL_Object::RFL_Object_Obj6.VxAyCoVnce = 0;
  @CAN_RadarFL::RFL_Object::RFL_Object_Obj6.VxVnce = 0;
  @CAN_RadarFL::RFL_Object::RFL_Object_Obj6.VxVyCoVnce = 0;
  @CAN_RadarFL::RFL_Object::RFL_Object_Obj6.Vy = 0;
  @CAN_RadarFL::RFL_Object::RFL_Object_Obj6.VyAxCoVnce = 0;
  @CAN_RadarFL::RFL_Object::RFL_Object_Obj6.VyAyCoVnce = 0;
  }
  if(init_count == 77)
  {
  @CAN_RadarFL::RFL_Object::RFL_Object_Obj6.VyVnce = 0;
  @CAN_RadarFL::RFL_Object::RFL_Object_Obj6.Width = 0;
  @CAN_RadarFL::RFL_Object::RFL_Object_Obj6.WidthVnce = 0;
  @CAN_RadarFL::RFL_Object::RFL_Object_Obj7.Age = 0;
  @CAN_RadarFL::RFL_Object::RFL_Object_Obj7.Ax = 0;
  @CAN_RadarFL::RFL_Object::RFL_Object_Obj7.AxAyCoVnce = 0;
  @CAN_RadarFL::RFL_Object::RFL_Object_Obj7.AxVnce = 0;
  @CAN_RadarFL::RFL_Object::RFL_Object_Obj7.Ay = 0;
  @CAN_RadarFL::RFL_Object::RFL_Object_Obj7.AyVnce = 0;
  @CAN_RadarFL::RFL_Object::RFL_Object_Obj7.ExistProb = 0;
  @CAN_RadarFL::RFL_Object::RFL_Object_Obj7.FilterInformation = 0;
  @CAN_RadarFL::RFL_Object::RFL_Object_Obj7.Length = 0;
  @CAN_RadarFL::RFL_Object::RFL_Object_Obj7.LengthVnce = 0;
  @CAN_RadarFL::RFL_Object::RFL_Object_Obj7.MeasurementStatus = 0;
  @CAN_RadarFL::RFL_Object::RFL_Object_Obj7.MovingStatus = 0;
  @CAN_RadarFL::RFL_Object::RFL_Object_Obj7.ObjId = 0;
  @CAN_RadarFL::RFL_Object::RFL_Object_Obj7.OrientationYaw = 0;
  @CAN_RadarFL::RFL_Object::RFL_Object_Obj7.OrientationYawVnce = 0;
  @CAN_RadarFL::RFL_Object::RFL_Object_Obj7.ProbClassConfidence = 0;
  @CAN_RadarFL::RFL_Object::RFL_Object_Obj7.ProbClassType = 0;
  @CAN_RadarFL::RFL_Object::RFL_Object_Obj7.Px = 0;
  @CAN_RadarFL::RFL_Object::RFL_Object_Obj7.PxAxCoVnce = 0;
  @CAN_RadarFL::RFL_Object::RFL_Object_Obj7.PxAyCoVnce = 0;
  @CAN_RadarFL::RFL_Object::RFL_Object_Obj7.PxPyCoVnce = 0;
  @CAN_RadarFL::RFL_Object::RFL_Object_Obj7.PxVnce = 0;
  }
  if(init_count == 78)
  {
  @CAN_RadarFL::RFL_Object::RFL_Object_Obj7.PxVxCoVnce = 0;
  @CAN_RadarFL::RFL_Object::RFL_Object_Obj7.PxVyCoVnce = 0;
  @CAN_RadarFL::RFL_Object::RFL_Object_Obj7.Py = 0;
  @CAN_RadarFL::RFL_Object::RFL_Object_Obj7.PyAxCoVnce = 0;
  @CAN_RadarFL::RFL_Object::RFL_Object_Obj7.PyAyCoVnce = 0;
  @CAN_RadarFL::RFL_Object::RFL_Object_Obj7.PyVnce = 0;
  @CAN_RadarFL::RFL_Object::RFL_Object_Obj7.PyVxCoVnce = 0;
  @CAN_RadarFL::RFL_Object::RFL_Object_Obj7.PyVyCoVnce = 0;
  @CAN_RadarFL::RFL_Object::RFL_Object_Obj7.ReferencePoint = 0;
  @CAN_RadarFL::RFL_Object::RFL_Object_Obj7.Vx = 0;
  @CAN_RadarFL::RFL_Object::RFL_Object_Obj7.VxAxCoVnce = 0;
  @CAN_RadarFL::RFL_Object::RFL_Object_Obj7.VxAyCoVnce = 0;
  @CAN_RadarFL::RFL_Object::RFL_Object_Obj7.VxVnce = 0;
  @CAN_RadarFL::RFL_Object::RFL_Object_Obj7.VxVyCoVnce = 0;
  @CAN_RadarFL::RFL_Object::RFL_Object_Obj7.Vy = 0;
  @CAN_RadarFL::RFL_Object::RFL_Object_Obj7.VyAxCoVnce = 0;
  @CAN_RadarFL::RFL_Object::RFL_Object_Obj7.VyAyCoVnce = 0;
  @CAN_RadarFL::RFL_Object::RFL_Object_Obj7.VyVnce = 0;
  @CAN_RadarFL::RFL_Object::RFL_Object_Obj7.Width = 0;
  @CAN_RadarFL::RFL_Object::RFL_Object_Obj7.WidthVnce = 0;
  @CAN_RadarFL::RFL_Object::RFL_Object_Obj8.Age = 0;
  @CAN_RadarFL::RFL_Object::RFL_Object_Obj8.Ax = 0;
  @CAN_RadarFL::RFL_Object::RFL_Object_Obj8.AxAyCoVnce = 0;
  @CAN_RadarFL::RFL_Object::RFL_Object_Obj8.AxVnce = 0;
  @CAN_RadarFL::RFL_Object::RFL_Object_Obj8.Ay = 0;
  }
  if(init_count == 79)
  {
  @CAN_RadarFL::RFL_Object::RFL_Object_Obj8.AyVnce = 0;
  @CAN_RadarFL::RFL_Object::RFL_Object_Obj8.ExistProb = 0;
  @CAN_RadarFL::RFL_Object::RFL_Object_Obj8.FilterInformation = 0;
  @CAN_RadarFL::RFL_Object::RFL_Object_Obj8.Length = 0;
  @CAN_RadarFL::RFL_Object::RFL_Object_Obj8.LengthVnce = 0;
  @CAN_RadarFL::RFL_Object::RFL_Object_Obj8.MeasurementStatus = 0;
  @CAN_RadarFL::RFL_Object::RFL_Object_Obj8.MovingStatus = 0;
  @CAN_RadarFL::RFL_Object::RFL_Object_Obj8.ObjId = 0;
  @CAN_RadarFL::RFL_Object::RFL_Object_Obj8.OrientationYaw = 0;
  @CAN_RadarFL::RFL_Object::RFL_Object_Obj8.OrientationYawVnce = 0;
  @CAN_RadarFL::RFL_Object::RFL_Object_Obj8.ProbClassConfidence = 0;
  @CAN_RadarFL::RFL_Object::RFL_Object_Obj8.ProbClassType = 0;
  @CAN_RadarFL::RFL_Object::RFL_Object_Obj8.Px = 0;
  @CAN_RadarFL::RFL_Object::RFL_Object_Obj8.PxAxCoVnce = 0;
  @CAN_RadarFL::RFL_Object::RFL_Object_Obj8.PxAyCoVnce = 0;
  @CAN_RadarFL::RFL_Object::RFL_Object_Obj8.PxPyCoVnce = 0;
  @CAN_RadarFL::RFL_Object::RFL_Object_Obj8.PxVnce = 0;
  @CAN_RadarFL::RFL_Object::RFL_Object_Obj8.PxVxCoVnce = 0;
  @CAN_RadarFL::RFL_Object::RFL_Object_Obj8.PxVyCoVnce = 0;
  @CAN_RadarFL::RFL_Object::RFL_Object_Obj8.Py = 0;
  @CAN_RadarFL::RFL_Object::RFL_Object_Obj8.PyAxCoVnce = 0;
  @CAN_RadarFL::RFL_Object::RFL_Object_Obj8.PyAyCoVnce = 0;
  @CAN_RadarFL::RFL_Object::RFL_Object_Obj8.PyVnce = 0;
  @CAN_RadarFL::RFL_Object::RFL_Object_Obj8.PyVxCoVnce = 0;
  @CAN_RadarFL::RFL_Object::RFL_Object_Obj8.PyVyCoVnce = 0;
  }
  if(init_count == 80)
  {
  @CAN_RadarFL::RFL_Object::RFL_Object_Obj8.ReferencePoint = 0;
  @CAN_RadarFL::RFL_Object::RFL_Object_Obj8.Vx = 0;
  @CAN_RadarFL::RFL_Object::RFL_Object_Obj8.VxAxCoVnce = 0;
  @CAN_RadarFL::RFL_Object::RFL_Object_Obj8.VxAyCoVnce = 0;
  @CAN_RadarFL::RFL_Object::RFL_Object_Obj8.VxVnce = 0;
  @CAN_RadarFL::RFL_Object::RFL_Object_Obj8.VxVyCoVnce = 0;
  @CAN_RadarFL::RFL_Object::RFL_Object_Obj8.Vy = 0;
  @CAN_RadarFL::RFL_Object::RFL_Object_Obj8.VyAxCoVnce = 0;
  @CAN_RadarFL::RFL_Object::RFL_Object_Obj8.VyAyCoVnce = 0;
  @CAN_RadarFL::RFL_Object::RFL_Object_Obj8.VyVnce = 0;
  @CAN_RadarFL::RFL_Object::RFL_Object_Obj8.Width = 0;
  @CAN_RadarFL::RFL_Object::RFL_Object_Obj8.WidthVnce = 0;
  @CAN_RadarFL::RFL_Object::RFL_Object_Obj9.Age = 0;
  @CAN_RadarFL::RFL_Object::RFL_Object_Obj9.Ax = 0;
  @CAN_RadarFL::RFL_Object::RFL_Object_Obj9.AxAyCoVnce = 0;
  @CAN_RadarFL::RFL_Object::RFL_Object_Obj9.AxVnce = 0;
  @CAN_RadarFL::RFL_Object::RFL_Object_Obj9.Ay = 0;
  @CAN_RadarFL::RFL_Object::RFL_Object_Obj9.AyVnce = 0;
  @CAN_RadarFL::RFL_Object::RFL_Object_Obj9.ExistProb = 0;
  @CAN_RadarFL::RFL_Object::RFL_Object_Obj9.FilterInformation = 0;
  @CAN_RadarFL::RFL_Object::RFL_Object_Obj9.Length = 0;
  @CAN_RadarFL::RFL_Object::RFL_Object_Obj9.LengthVnce = 0;
  @CAN_RadarFL::RFL_Object::RFL_Object_Obj9.MeasurementStatus = 0;
  @CAN_RadarFL::RFL_Object::RFL_Object_Obj9.MovingStatus = 0;
  @CAN_RadarFL::RFL_Object::RFL_Object_Obj9.ObjId = 0;
  }
  if(init_count == 81)
  {
  @CAN_RadarFL::RFL_Object::RFL_Object_Obj9.OrientationYaw = 0;
  @CAN_RadarFL::RFL_Object::RFL_Object_Obj9.OrientationYawVnce = 0;
  @CAN_RadarFL::RFL_Object::RFL_Object_Obj9.ProbClassConfidence = 0;
  @CAN_RadarFL::RFL_Object::RFL_Object_Obj9.ProbClassType = 0;
  @CAN_RadarFL::RFL_Object::RFL_Object_Obj9.Px = 0;
  @CAN_RadarFL::RFL_Object::RFL_Object_Obj9.PxAxCoVnce = 0;
  @CAN_RadarFL::RFL_Object::RFL_Object_Obj9.PxAyCoVnce = 0;
  @CAN_RadarFL::RFL_Object::RFL_Object_Obj9.PxPyCoVnce = 0;
  @CAN_RadarFL::RFL_Object::RFL_Object_Obj9.PxVnce = 0;
  @CAN_RadarFL::RFL_Object::RFL_Object_Obj9.PxVxCoVnce = 0;
  @CAN_RadarFL::RFL_Object::RFL_Object_Obj9.PxVyCoVnce = 0;
  @CAN_RadarFL::RFL_Object::RFL_Object_Obj9.Py = 0;
  @CAN_RadarFL::RFL_Object::RFL_Object_Obj9.PyAxCoVnce = 0;
  @CAN_RadarFL::RFL_Object::RFL_Object_Obj9.PyAyCoVnce = 0;
  @CAN_RadarFL::RFL_Object::RFL_Object_Obj9.PyVnce = 0;
  @CAN_RadarFL::RFL_Object::RFL_Object_Obj9.PyVxCoVnce = 0;
  @CAN_RadarFL::RFL_Object::RFL_Object_Obj9.PyVyCoVnce = 0;
  @CAN_RadarFL::RFL_Object::RFL_Object_Obj9.ReferencePoint = 0;
  @CAN_RadarFL::RFL_Object::RFL_Object_Obj9.Vx = 0;
  @CAN_RadarFL::RFL_Object::RFL_Object_Obj9.VxAxCoVnce = 0;
  @CAN_RadarFL::RFL_Object::RFL_Object_Obj9.VxAyCoVnce = 0;
  @CAN_RadarFL::RFL_Object::RFL_Object_Obj9.VxVnce = 0;
  @CAN_RadarFL::RFL_Object::RFL_Object_Obj9.VxVyCoVnce = 0;
  @CAN_RadarFL::RFL_Object::RFL_Object_Obj9.Vy = 0;
  @CAN_RadarFL::RFL_Object::RFL_Object_Obj9.VyAxCoVnce = 0;
  }
  if(init_count == 82)
  {
  @CAN_RadarFL::RFL_Object::RFL_Object_Obj9.VyAyCoVnce = 0;
  @CAN_RadarFL::RFL_Object::RFL_Object_Obj9.VyVnce = 0;
  @CAN_RadarFL::RFL_Object::RFL_Object_Obj9.Width = 0;
  @CAN_RadarFL::RFL_Object::RFL_Object_Obj9.WidthVnce = 0;
  @CAN_RadarFL::RFL_Object::RFL_Object_ObjHdr_NumValidObjects = 0;
  @CAN_RadarFL::RFL_Object::RFL_Object_ObjHdr_TimeStamp = 0;
  @CAN_RadarFL::RFL_Object::RFL_Object_ObjHdr_TimeStampStatus = 0;
  @CAN_RadarFL::RFL_Object::RFL_Object_ObjHdr_VersionIdMajor = 0;
  @CAN_RadarFL::RFL_Object::RFL_Object_ObjHdr_VersionIdMinor = 0;
  @CAN_RadarFL::RFL_Object::RFL_Object_ObjHdr_VersionPatch = 0;
  @CAN_RadarFL::RFL_Object::RFL_Object_ObjHdr_content_type = 0;
  @CAN_RadarFL::RFL_Object::RFL_Object_ShiiHdr_DataMeasured = 0;
  @CAN_RadarFL::RFL_Object::RFL_Object_ShiiHdr_MisAzOOPCause = 0;
  @CAN_RadarFL::RFL_Object::RFL_Object_ShiiHdr_MisElOOPCause = 0;
  @CAN_RadarFL::RFL_Object::RFL_Object_ShiiHdr_RatioAdvProcListProc = 0;
  @CAN_RadarFL::RFL_Object::RFL_Object_ShiiHdr_SensorCalExtStat = 0;
  @CAN_RadarFL::RFL_Object::RFL_Object_ShiiHdr_SensorCalIntStat = 0;
  @CAN_RadarFL::RFL_Object::RFL_Object_ShiiHdr_SensorCalOnlStat = 0;
  @CAN_RadarFL::RFL_Object::RFL_Object_ShiiHdr_SensorFailureReas = 0;
  @CAN_RadarFL::RFL_Object::RFL_Object_ShiiHdr_SensorHeatingStatus = 0;
  @CAN_RadarFL::RFL_Object::RFL_Object_ShiiHdr_SensorOmmOpMode = 0;
  @CAN_RadarFL::RFL_Object::RFL_Object_ShiiHdr_ThermalDegr = 0;
  @CAN_RadarFL::RFL_Object::RFL_Object_SpiHdr_BldFov_Confidence = 0;
  @CAN_RadarFL::RFL_Object::RFL_Object_SpiHdr_BldFov_Status = 0;
  @CAN_RadarFL::RFL_Object::RFL_Object_SpiHdr_BldOperationMode = 0;
  }
  if(init_count == 83)
  {
  @CAN_RadarFL::RFL_Object::RFL_Object_SpiHdr_DistMaxProc = 0;
  @CAN_RadarFL::RFL_Object::RFL_Object_SpiHdr_DistMeasMaxMod = 0;
  @CAN_RadarFL::RFL_Object::RFL_Object_SpiHdr_DistMeasMinMod = 0;
  @CAN_RadarFL::RFL_Object::RFL_Object_SpiHdr_DistPrec = 0;
  @CAN_RadarFL::RFL_Object::RFL_Object_SpiHdr_DistSep = 0;
  @CAN_RadarFL::RFL_Object::RFL_Object_SpiHdr_DistStartProcDegraded = 0;
  @CAN_RadarFL::RFL_Object::RFL_Object_SpiHdr_DmpId = 0;
  @CAN_RadarFL::RFL_Object::RFL_Object_SpiHdr_FovRtrAzDetRng00 = 0;
  @CAN_RadarFL::RFL_Object::RFL_Object_SpiHdr_FovRtrAzDetRng01 = 0;
  @CAN_RadarFL::RFL_Object::RFL_Object_SpiHdr_FovRtrAzDetRng02 = 0;
  @CAN_RadarFL::RFL_Object::RFL_Object_SpiHdr_FovRtrAzDetRng03 = 0;
  @CAN_RadarFL::RFL_Object::RFL_Object_SpiHdr_FovRtrAzDetRng04 = 0;
  @CAN_RadarFL::RFL_Object::RFL_Object_SpiHdr_FovRtrAzDetRng05 = 0;
  @CAN_RadarFL::RFL_Object::RFL_Object_SpiHdr_FovRtrAzDetRng06 = 0;
  @CAN_RadarFL::RFL_Object::RFL_Object_SpiHdr_FovRtrAzDetRng07 = 0;
  @CAN_RadarFL::RFL_Object::RFL_Object_SpiHdr_FovRtrAzDetRng08 = 0;
  @CAN_RadarFL::RFL_Object::RFL_Object_SpiHdr_FovRtrAzDetRng09 = 0;
  @CAN_RadarFL::RFL_Object::RFL_Object_SpiHdr_FovRtrAzDetRng10 = 0;
  @CAN_RadarFL::RFL_Object::RFL_Object_SpiHdr_FovRtrAzDetRng11 = 0;
  @CAN_RadarFL::RFL_Object::RFL_Object_SpiHdr_FovRtrAzDetRng12 = 0;
  @CAN_RadarFL::RFL_Object::RFL_Object_SpiHdr_FovRtrAzDetRng13 = 0;
  @CAN_RadarFL::RFL_Object::RFL_Object_SpiHdr_FovRtrAzDetRng14 = 0;
  @CAN_RadarFL::RFL_Object::RFL_Object_SpiHdr_FovRtrAzDetRng15 = 0;
  @CAN_RadarFL::RFL_Object::RFL_Object_SpiHdr_FovRtrAzDetRng16 = 0;
  @CAN_RadarFL::RFL_Object::RFL_Object_SpiHdr_FovRtrAzDetRng17 = 0;
  }
  if(init_count == 84)
  {
  @CAN_RadarFL::RFL_Object::RFL_Object_SpiHdr_FovRtrAzDetRng18 = 0;
  @CAN_RadarFL::RFL_Object::RFL_Object_SpiHdr_FovRtrAzDetRng19 = 0;
  @CAN_RadarFL::RFL_Object::RFL_Object_SpiHdr_FovRtrAzDetRng20 = 0;
  @CAN_RadarFL::RFL_Object::RFL_Object_SpiHdr_FovRtrAzDetRng21 = 0;
  @CAN_RadarFL::RFL_Object::RFL_Object_SpiHdr_FovRtrAzDetRng22 = 0;
  @CAN_RadarFL::RFL_Object::RFL_Object_SpiHdr_FovRtrAzDetRng23 = 0;
  @CAN_RadarFL::RFL_Object::RFL_Object_SpiHdr_FovRtrAzDetRng24 = 0;
  @CAN_RadarFL::RFL_Object::RFL_Object_SpiHdr_FovRtrAzSegBrdr00 = 0;
  @CAN_RadarFL::RFL_Object::RFL_Object_SpiHdr_FovRtrAzSegBrdr01 = 0;
  @CAN_RadarFL::RFL_Object::RFL_Object_SpiHdr_FovRtrAzSegBrdr02 = 0;
  @CAN_RadarFL::RFL_Object::RFL_Object_SpiHdr_FovRtrAzSegBrdr03 = 0;
  @CAN_RadarFL::RFL_Object::RFL_Object_SpiHdr_FovRtrAzSegBrdr04 = 0;
  @CAN_RadarFL::RFL_Object::RFL_Object_SpiHdr_FovRtrAzSegBrdr05 = 0;
  @CAN_RadarFL::RFL_Object::RFL_Object_SpiHdr_FovRtrAzSegBrdr06 = 0;
  @CAN_RadarFL::RFL_Object::RFL_Object_SpiHdr_FovRtrAzSegBrdr07 = 0;
  @CAN_RadarFL::RFL_Object::RFL_Object_SpiHdr_FovRtrAzSegBrdr08 = 0;
  @CAN_RadarFL::RFL_Object::RFL_Object_SpiHdr_FovRtrAzSegBrdr09 = 0;
  @CAN_RadarFL::RFL_Object::RFL_Object_SpiHdr_FovRtrAzSegBrdr10 = 0;
  @CAN_RadarFL::RFL_Object::RFL_Object_SpiHdr_FovRtrAzSegBrdr11 = 0;
  @CAN_RadarFL::RFL_Object::RFL_Object_SpiHdr_FovRtrAzSegBrdr12 = 0;
  @CAN_RadarFL::RFL_Object::RFL_Object_SpiHdr_FovRtrAzSegBrdr13 = 0;
  @CAN_RadarFL::RFL_Object::RFL_Object_SpiHdr_FovRtrAzSegBrdr14 = 0;
  @CAN_RadarFL::RFL_Object::RFL_Object_SpiHdr_FovRtrAzSegBrdr15 = 0;
  @CAN_RadarFL::RFL_Object::RFL_Object_SpiHdr_FovRtrAzSegBrdr16 = 0;
  @CAN_RadarFL::RFL_Object::RFL_Object_SpiHdr_FovRtrAzSegBrdr17 = 0;
  }
  if(init_count == 85)
  {
  @CAN_RadarFL::RFL_Object::RFL_Object_SpiHdr_FovRtrAzSegBrdr18 = 0;
  @CAN_RadarFL::RFL_Object::RFL_Object_SpiHdr_FovRtrAzSegBrdr19 = 0;
  @CAN_RadarFL::RFL_Object::RFL_Object_SpiHdr_FovRtrAzSegBrdr20 = 0;
  @CAN_RadarFL::RFL_Object::RFL_Object_SpiHdr_FovRtrAzSegBrdr21 = 0;
  @CAN_RadarFL::RFL_Object::RFL_Object_SpiHdr_FovRtrAzSegBrdr22 = 0;
  @CAN_RadarFL::RFL_Object::RFL_Object_SpiHdr_FovRtrAzSegBrdr23 = 0;
  @CAN_RadarFL::RFL_Object::RFL_Object_SpiHdr_FovRtrAzSegBrdr24 = 0;
  @CAN_RadarFL::RFL_Object::RFL_Object_SpiHdr_FovRtrElRngGEnd00 = 0;
  @CAN_RadarFL::RFL_Object::RFL_Object_SpiHdr_FovRtrElRngGEnd01 = 0;
  @CAN_RadarFL::RFL_Object::RFL_Object_SpiHdr_FovRtrElRngGEnd02 = 0;
  @CAN_RadarFL::RFL_Object::RFL_Object_SpiHdr_FovRtrElRngGEnd03 = 0;
  @CAN_RadarFL::RFL_Object::RFL_Object_SpiHdr_FovRtrElRngGEnd04 = 0;
  @CAN_RadarFL::RFL_Object::RFL_Object_SpiHdr_FovRtrElRngGEnd05 = 0;
  @CAN_RadarFL::RFL_Object::RFL_Object_SpiHdr_FovRtrElRngGEnd06 = 0;
  @CAN_RadarFL::RFL_Object::RFL_Object_SpiHdr_FovRtrElRngGEnd07 = 0;
  @CAN_RadarFL::RFL_Object::RFL_Object_SpiHdr_FovRtrElRngGEnd08 = 0;
  @CAN_RadarFL::RFL_Object::RFL_Object_SpiHdr_FovRtrElRngGEnd09 = 0;
  @CAN_RadarFL::RFL_Object::RFL_Object_SpiHdr_FovRtrElRngGEnd10 = 0;
  @CAN_RadarFL::RFL_Object::RFL_Object_SpiHdr_FovRtrElSegBrdr00 = 0;
  @CAN_RadarFL::RFL_Object::RFL_Object_SpiHdr_FovRtrElSegBrdr01 = 0;
  @CAN_RadarFL::RFL_Object::RFL_Object_SpiHdr_FovRtrElSegBrdr02 = 0;
  @CAN_RadarFL::RFL_Object::RFL_Object_SpiHdr_FovRtrElSegBrdr03 = 0;
  @CAN_RadarFL::RFL_Object::RFL_Object_SpiHdr_FovRtrElSegBrdr04 = 0;
  @CAN_RadarFL::RFL_Object::RFL_Object_SpiHdr_FovRtrElSegBrdr05 = 0;
  @CAN_RadarFL::RFL_Object::RFL_Object_SpiHdr_FovRtrElSegBrdr06 = 0;
  }
  if(init_count == 86)
  {
  @CAN_RadarFL::RFL_Object::RFL_Object_SpiHdr_FovRtrElSegBrdr07 = 0;
  @CAN_RadarFL::RFL_Object::RFL_Object_SpiHdr_FovRtrElSegBrdr08 = 0;
  @CAN_RadarFL::RFL_Object::RFL_Object_SpiHdr_FovRtrElSegBrdr09 = 0;
  @CAN_RadarFL::RFL_Object::RFL_Object_SpiHdr_FovRtrElSegBrdr10 = 0;
  @CAN_RadarFL::RFL_Object::RFL_Object_SpiHdr_ModId = 0;
  @CAN_RadarFL::RFL_Object::RFL_Object_SpiHdr_RngGainRfInterfere = 0;
  @CAN_RadarFL::RFL_Object::RFL_Object_SpiHdr_SensorExtDisturbed = 0;
  @CAN_RadarFL::RFL_Object::RFL_Object_SpiHdr_SensorOrientPitch = 0;
  @CAN_RadarFL::RFL_Object::RFL_Object_SpiHdr_SensorOrientYaw = 0;
  @CAN_RadarFL::RFL_Object::RFL_Object_SpiHdr_SensorOrientation = 0;
  @CAN_RadarFL::RFL_Object::RFL_Object_SpiHdr_SensorOriginPointX = 0;
  @CAN_RadarFL::RFL_Object::RFL_Object_SpiHdr_SensorOriginPointY = 0;
  @CAN_RadarFL::RFL_Object::RFL_Object_SpiHdr_SensorOriginPointZ = 0;
  @CAN_RadarFL::RFL_Object::RFL_Object_SpiHdr_VelMeasMax = 0;
  @CAN_RadarFL::RFL_Object::RFL_Object_SpiHdr_VelMeasMin = 0;
  @CAN_RadarFL::RFL_Object::RFL_Object_SpiHdr_VelPrec = 0;
  @CAN_RadarFL::RFL_Object::RFL_Object_SpiHdr_VelSep = 0;
  sysSetVariableData(sysvar::CAN_RadarFL::RFL_RoadSideBoundaries::RFL_RoadSideBoundaries::SignalValue, RFL_RoadSideBoundaries_byte_Array, 1000);
  $CAN_RadarFL::RFL_SensorOutput::RFL_Veh_SenOut_VehConfParamStatus = 0;
  if (prestart_mode==0) init_count = 0;
  initFlag = 10;
  }
  init_count++;
}
void init_CRadarFR_F150_OD()
{
  if(init_count == 1)
  {
  $CAN_RadarFR::RFR_CornerFunctions::RFR_CF_AEx_revEgoBrakingStatus = 0;
  $CAN_RadarFR::RFR_CornerFunctions::RFR_CF_AEx_revEgoWarnStatus = 0;
  $CAN_RadarFR::RFR_CornerFunctions::RFR_CF_AEx_revEgo_BrakeRequest = 0;
  $CAN_RadarFR::RFR_CornerFunctions::RFR_CF_AEx_revEgo_TargetDec = 0;
  $CAN_RadarFR::RFR_CornerFunctions::RFR_CF_AEx_revEgo_WarningLevel = 0;
  $CAN_RadarFR::RFR_CornerFunctions::RFR_CF_BsdLca_Status = 0;
  $CAN_RadarFR::RFR_CornerFunctions::RFR_CF_BsdLca_WarningLevel = 0;
  $CAN_RadarFR::RFR_CornerFunctions::RFR_CF_DOx_PrevStatus = 0;
  $CAN_RadarFR::RFR_CornerFunctions::RFR_CF_DOx_WarnStatus = 0;
  $CAN_RadarFR::RFR_CornerFunctions::RFR_CF_DOx_WarningLevel = 0;
  sysSetVariableData(sysvar::CAN_RadarFR::RFR_FieldDataCollection::RFR_FieldDataCollection::SignalValue, RFR_FieldDataCollection_byte_Array, 5000);
  @CAN_RadarFR::RFR_Object::RFR_Object_E2E_p44_dataId = 0;
  @CAN_RadarFR::RFR_Object::RFR_Object_E2E_p44_length = 0;
  @CAN_RadarFR::RFR_Object::RFR_Object_Obj10.Age = 0;
  @CAN_RadarFR::RFR_Object::RFR_Object_Obj10.Ax = 0;
  @CAN_RadarFR::RFR_Object::RFR_Object_Obj10.AxAyCoVnce = 0;
  @CAN_RadarFR::RFR_Object::RFR_Object_Obj10.AxVnce = 0;
  @CAN_RadarFR::RFR_Object::RFR_Object_Obj10.Ay = 0;
  @CAN_RadarFR::RFR_Object::RFR_Object_Obj10.AyVnce = 0;
  @CAN_RadarFR::RFR_Object::RFR_Object_Obj10.ExistProb = 0;
  @CAN_RadarFR::RFR_Object::RFR_Object_Obj10.FilterInformation = 0;
  @CAN_RadarFR::RFR_Object::RFR_Object_Obj10.Length = 0;
  @CAN_RadarFR::RFR_Object::RFR_Object_Obj10.LengthVnce = 0;
  @CAN_RadarFR::RFR_Object::RFR_Object_Obj10.MeasurementStatus = 0;
  @CAN_RadarFR::RFR_Object::RFR_Object_Obj10.MovingStatus = 0;
  }
  if(init_count == 2)
  {
  @CAN_RadarFR::RFR_Object::RFR_Object_Obj10.ObjId = 0;
  @CAN_RadarFR::RFR_Object::RFR_Object_Obj10.OrientationYaw = 0;
  @CAN_RadarFR::RFR_Object::RFR_Object_Obj10.OrientationYawVnce = 0;
  @CAN_RadarFR::RFR_Object::RFR_Object_Obj10.ProbClassConfidence = 0;
  @CAN_RadarFR::RFR_Object::RFR_Object_Obj10.ProbClassType = 0;
  @CAN_RadarFR::RFR_Object::RFR_Object_Obj10.Px = 0;
  @CAN_RadarFR::RFR_Object::RFR_Object_Obj10.PxAxCoVnce = 0;
  @CAN_RadarFR::RFR_Object::RFR_Object_Obj10.PxAyCoVnce = 0;
  @CAN_RadarFR::RFR_Object::RFR_Object_Obj10.PxPyCoVnce = 0;
  @CAN_RadarFR::RFR_Object::RFR_Object_Obj10.PxVnce = 0;
  @CAN_RadarFR::RFR_Object::RFR_Object_Obj10.PxVxCoVnce = 0;
  @CAN_RadarFR::RFR_Object::RFR_Object_Obj10.PxVyCoVnce = 0;
  @CAN_RadarFR::RFR_Object::RFR_Object_Obj10.Py = 0;
  @CAN_RadarFR::RFR_Object::RFR_Object_Obj10.PyAxCoVnce = 0;
  @CAN_RadarFR::RFR_Object::RFR_Object_Obj10.PyAyCoVnce = 0;
  @CAN_RadarFR::RFR_Object::RFR_Object_Obj10.PyVnce = 0;
  @CAN_RadarFR::RFR_Object::RFR_Object_Obj10.PyVxCoVnce = 0;
  @CAN_RadarFR::RFR_Object::RFR_Object_Obj10.PyVyCoVnce = 0;
  @CAN_RadarFR::RFR_Object::RFR_Object_Obj10.ReferencePoint = 0;
  @CAN_RadarFR::RFR_Object::RFR_Object_Obj10.Vx = 0;
  @CAN_RadarFR::RFR_Object::RFR_Object_Obj10.VxAxCoVnce = 0;
  @CAN_RadarFR::RFR_Object::RFR_Object_Obj10.VxAyCoVnce = 0;
  @CAN_RadarFR::RFR_Object::RFR_Object_Obj10.VxVnce = 0;
  @CAN_RadarFR::RFR_Object::RFR_Object_Obj10.VxVyCoVnce = 0;
  @CAN_RadarFR::RFR_Object::RFR_Object_Obj10.Vy = 0;
  }
  if(init_count == 3)
  {
  @CAN_RadarFR::RFR_Object::RFR_Object_Obj10.VyAxCoVnce = 0;
  @CAN_RadarFR::RFR_Object::RFR_Object_Obj10.VyAyCoVnce = 0;
  @CAN_RadarFR::RFR_Object::RFR_Object_Obj10.VyVnce = 0;
  @CAN_RadarFR::RFR_Object::RFR_Object_Obj10.Width = 0;
  @CAN_RadarFR::RFR_Object::RFR_Object_Obj10.WidthVnce = 0;
  @CAN_RadarFR::RFR_Object::RFR_Object_Obj11.Age = 0;
  @CAN_RadarFR::RFR_Object::RFR_Object_Obj11.Ax = 0;
  @CAN_RadarFR::RFR_Object::RFR_Object_Obj11.AxAyCoVnce = 0;
  @CAN_RadarFR::RFR_Object::RFR_Object_Obj11.AxVnce = 0;
  @CAN_RadarFR::RFR_Object::RFR_Object_Obj11.Ay = 0;
  @CAN_RadarFR::RFR_Object::RFR_Object_Obj11.AyVnce = 0;
  @CAN_RadarFR::RFR_Object::RFR_Object_Obj11.ExistProb = 0;
  @CAN_RadarFR::RFR_Object::RFR_Object_Obj11.FilterInformation = 0;
  @CAN_RadarFR::RFR_Object::RFR_Object_Obj11.Length = 0;
  @CAN_RadarFR::RFR_Object::RFR_Object_Obj11.LengthVnce = 0;
  @CAN_RadarFR::RFR_Object::RFR_Object_Obj11.MeasurementStatus = 0;
  @CAN_RadarFR::RFR_Object::RFR_Object_Obj11.MovingStatus = 0;
  @CAN_RadarFR::RFR_Object::RFR_Object_Obj11.ObjId = 0;
  @CAN_RadarFR::RFR_Object::RFR_Object_Obj11.OrientationYaw = 0;
  @CAN_RadarFR::RFR_Object::RFR_Object_Obj11.OrientationYawVnce = 0;
  @CAN_RadarFR::RFR_Object::RFR_Object_Obj11.ProbClassConfidence = 0;
  @CAN_RadarFR::RFR_Object::RFR_Object_Obj11.ProbClassType = 0;
  @CAN_RadarFR::RFR_Object::RFR_Object_Obj11.Px = 0;
  @CAN_RadarFR::RFR_Object::RFR_Object_Obj11.PxAxCoVnce = 0;
  @CAN_RadarFR::RFR_Object::RFR_Object_Obj11.PxAyCoVnce = 0;
  }
  if(init_count == 4)
  {
  @CAN_RadarFR::RFR_Object::RFR_Object_Obj11.PxPyCoVnce = 0;
  @CAN_RadarFR::RFR_Object::RFR_Object_Obj11.PxVnce = 0;
  @CAN_RadarFR::RFR_Object::RFR_Object_Obj11.PxVxCoVnce = 0;
  @CAN_RadarFR::RFR_Object::RFR_Object_Obj11.PxVyCoVnce = 0;
  @CAN_RadarFR::RFR_Object::RFR_Object_Obj11.Py = 0;
  @CAN_RadarFR::RFR_Object::RFR_Object_Obj11.PyAxCoVnce = 0;
  @CAN_RadarFR::RFR_Object::RFR_Object_Obj11.PyAyCoVnce = 0;
  @CAN_RadarFR::RFR_Object::RFR_Object_Obj11.PyVnce = 0;
  @CAN_RadarFR::RFR_Object::RFR_Object_Obj11.PyVxCoVnce = 0;
  @CAN_RadarFR::RFR_Object::RFR_Object_Obj11.PyVyCoVnce = 0;
  @CAN_RadarFR::RFR_Object::RFR_Object_Obj11.ReferencePoint = 0;
  @CAN_RadarFR::RFR_Object::RFR_Object_Obj11.Vx = 0;
  @CAN_RadarFR::RFR_Object::RFR_Object_Obj11.VxAxCoVnce = 0;
  @CAN_RadarFR::RFR_Object::RFR_Object_Obj11.VxAyCoVnce = 0;
  @CAN_RadarFR::RFR_Object::RFR_Object_Obj11.VxVnce = 0;
  @CAN_RadarFR::RFR_Object::RFR_Object_Obj11.VxVyCoVnce = 0;
  @CAN_RadarFR::RFR_Object::RFR_Object_Obj11.Vy = 0;
  @CAN_RadarFR::RFR_Object::RFR_Object_Obj11.VyAxCoVnce = 0;
  @CAN_RadarFR::RFR_Object::RFR_Object_Obj11.VyAyCoVnce = 0;
  @CAN_RadarFR::RFR_Object::RFR_Object_Obj11.VyVnce = 0;
  @CAN_RadarFR::RFR_Object::RFR_Object_Obj11.Width = 0;
  @CAN_RadarFR::RFR_Object::RFR_Object_Obj11.WidthVnce = 0;
  @CAN_RadarFR::RFR_Object::RFR_Object_Obj12.Age = 0;
  @CAN_RadarFR::RFR_Object::RFR_Object_Obj12.Ax = 0;
  @CAN_RadarFR::RFR_Object::RFR_Object_Obj12.AxAyCoVnce = 0;
  }
  if(init_count == 5)
  {
  @CAN_RadarFR::RFR_Object::RFR_Object_Obj12.AxVnce = 0;
  @CAN_RadarFR::RFR_Object::RFR_Object_Obj12.Ay = 0;
  @CAN_RadarFR::RFR_Object::RFR_Object_Obj12.AyVnce = 0;
  @CAN_RadarFR::RFR_Object::RFR_Object_Obj12.ExistProb = 0;
  @CAN_RadarFR::RFR_Object::RFR_Object_Obj12.FilterInformation = 0;
  @CAN_RadarFR::RFR_Object::RFR_Object_Obj12.Length = 0;
  @CAN_RadarFR::RFR_Object::RFR_Object_Obj12.LengthVnce = 0;
  @CAN_RadarFR::RFR_Object::RFR_Object_Obj12.MeasurementStatus = 0;
  @CAN_RadarFR::RFR_Object::RFR_Object_Obj12.MovingStatus = 0;
  @CAN_RadarFR::RFR_Object::RFR_Object_Obj12.ObjId = 0;
  @CAN_RadarFR::RFR_Object::RFR_Object_Obj12.OrientationYaw = 0;
  @CAN_RadarFR::RFR_Object::RFR_Object_Obj12.OrientationYawVnce = 0;
  @CAN_RadarFR::RFR_Object::RFR_Object_Obj12.ProbClassConfidence = 0;
  @CAN_RadarFR::RFR_Object::RFR_Object_Obj12.ProbClassType = 0;
  @CAN_RadarFR::RFR_Object::RFR_Object_Obj12.Px = 0;
  @CAN_RadarFR::RFR_Object::RFR_Object_Obj12.PxAxCoVnce = 0;
  @CAN_RadarFR::RFR_Object::RFR_Object_Obj12.PxAyCoVnce = 0;
  @CAN_RadarFR::RFR_Object::RFR_Object_Obj12.PxPyCoVnce = 0;
  @CAN_RadarFR::RFR_Object::RFR_Object_Obj12.PxVnce = 0;
  @CAN_RadarFR::RFR_Object::RFR_Object_Obj12.PxVxCoVnce = 0;
  @CAN_RadarFR::RFR_Object::RFR_Object_Obj12.PxVyCoVnce = 0;
  @CAN_RadarFR::RFR_Object::RFR_Object_Obj12.Py = 0;
  @CAN_RadarFR::RFR_Object::RFR_Object_Obj12.PyAxCoVnce = 0;
  @CAN_RadarFR::RFR_Object::RFR_Object_Obj12.PyAyCoVnce = 0;
  @CAN_RadarFR::RFR_Object::RFR_Object_Obj12.PyVnce = 0;
  }
  if(init_count == 6)
  {
  @CAN_RadarFR::RFR_Object::RFR_Object_Obj12.PyVxCoVnce = 0;
  @CAN_RadarFR::RFR_Object::RFR_Object_Obj12.PyVyCoVnce = 0;
  @CAN_RadarFR::RFR_Object::RFR_Object_Obj12.ReferencePoint = 0;
  @CAN_RadarFR::RFR_Object::RFR_Object_Obj12.Vx = 0;
  @CAN_RadarFR::RFR_Object::RFR_Object_Obj12.VxAxCoVnce = 0;
  @CAN_RadarFR::RFR_Object::RFR_Object_Obj12.VxAyCoVnce = 0;
  @CAN_RadarFR::RFR_Object::RFR_Object_Obj12.VxVnce = 0;
  @CAN_RadarFR::RFR_Object::RFR_Object_Obj12.VxVyCoVnce = 0;
  @CAN_RadarFR::RFR_Object::RFR_Object_Obj12.Vy = 0;
  @CAN_RadarFR::RFR_Object::RFR_Object_Obj12.VyAxCoVnce = 0;
  @CAN_RadarFR::RFR_Object::RFR_Object_Obj12.VyAyCoVnce = 0;
  @CAN_RadarFR::RFR_Object::RFR_Object_Obj12.VyVnce = 0;
  @CAN_RadarFR::RFR_Object::RFR_Object_Obj12.Width = 0;
  @CAN_RadarFR::RFR_Object::RFR_Object_Obj12.WidthVnce = 0;
  @CAN_RadarFR::RFR_Object::RFR_Object_Obj13.Age = 0;
  @CAN_RadarFR::RFR_Object::RFR_Object_Obj13.Ax = 0;
  @CAN_RadarFR::RFR_Object::RFR_Object_Obj13.AxAyCoVnce = 0;
  @CAN_RadarFR::RFR_Object::RFR_Object_Obj13.AxVnce = 0;
  @CAN_RadarFR::RFR_Object::RFR_Object_Obj13.Ay = 0;
  @CAN_RadarFR::RFR_Object::RFR_Object_Obj13.AyVnce = 0;
  @CAN_RadarFR::RFR_Object::RFR_Object_Obj13.ExistProb = 0;
  @CAN_RadarFR::RFR_Object::RFR_Object_Obj13.FilterInformation = 0;
  @CAN_RadarFR::RFR_Object::RFR_Object_Obj13.Length = 0;
  @CAN_RadarFR::RFR_Object::RFR_Object_Obj13.LengthVnce = 0;
  @CAN_RadarFR::RFR_Object::RFR_Object_Obj13.MeasurementStatus = 0;
  }
  if(init_count == 7)
  {
  @CAN_RadarFR::RFR_Object::RFR_Object_Obj13.MovingStatus = 0;
  @CAN_RadarFR::RFR_Object::RFR_Object_Obj13.ObjId = 0;
  @CAN_RadarFR::RFR_Object::RFR_Object_Obj13.OrientationYaw = 0;
  @CAN_RadarFR::RFR_Object::RFR_Object_Obj13.OrientationYawVnce = 0;
  @CAN_RadarFR::RFR_Object::RFR_Object_Obj13.ProbClassConfidence = 0;
  @CAN_RadarFR::RFR_Object::RFR_Object_Obj13.ProbClassType = 0;
  @CAN_RadarFR::RFR_Object::RFR_Object_Obj13.Px = 0;
  @CAN_RadarFR::RFR_Object::RFR_Object_Obj13.PxAxCoVnce = 0;
  @CAN_RadarFR::RFR_Object::RFR_Object_Obj13.PxAyCoVnce = 0;
  @CAN_RadarFR::RFR_Object::RFR_Object_Obj13.PxPyCoVnce = 0;
  @CAN_RadarFR::RFR_Object::RFR_Object_Obj13.PxVnce = 0;
  @CAN_RadarFR::RFR_Object::RFR_Object_Obj13.PxVxCoVnce = 0;
  @CAN_RadarFR::RFR_Object::RFR_Object_Obj13.PxVyCoVnce = 0;
  @CAN_RadarFR::RFR_Object::RFR_Object_Obj13.Py = 0;
  @CAN_RadarFR::RFR_Object::RFR_Object_Obj13.PyAxCoVnce = 0;
  @CAN_RadarFR::RFR_Object::RFR_Object_Obj13.PyAyCoVnce = 0;
  @CAN_RadarFR::RFR_Object::RFR_Object_Obj13.PyVnce = 0;
  @CAN_RadarFR::RFR_Object::RFR_Object_Obj13.PyVxCoVnce = 0;
  @CAN_RadarFR::RFR_Object::RFR_Object_Obj13.PyVyCoVnce = 0;
  @CAN_RadarFR::RFR_Object::RFR_Object_Obj13.ReferencePoint = 0;
  @CAN_RadarFR::RFR_Object::RFR_Object_Obj13.Vx = 0;
  @CAN_RadarFR::RFR_Object::RFR_Object_Obj13.VxAxCoVnce = 0;
  @CAN_RadarFR::RFR_Object::RFR_Object_Obj13.VxAyCoVnce = 0;
  @CAN_RadarFR::RFR_Object::RFR_Object_Obj13.VxVnce = 0;
  @CAN_RadarFR::RFR_Object::RFR_Object_Obj13.VxVyCoVnce = 0;
  }
  if(init_count == 8)
  {
  @CAN_RadarFR::RFR_Object::RFR_Object_Obj13.Vy = 0;
  @CAN_RadarFR::RFR_Object::RFR_Object_Obj13.VyAxCoVnce = 0;
  @CAN_RadarFR::RFR_Object::RFR_Object_Obj13.VyAyCoVnce = 0;
  @CAN_RadarFR::RFR_Object::RFR_Object_Obj13.VyVnce = 0;
  @CAN_RadarFR::RFR_Object::RFR_Object_Obj13.Width = 0;
  @CAN_RadarFR::RFR_Object::RFR_Object_Obj13.WidthVnce = 0;
  @CAN_RadarFR::RFR_Object::RFR_Object_Obj14.Age = 0;
  @CAN_RadarFR::RFR_Object::RFR_Object_Obj14.Ax = 0;
  @CAN_RadarFR::RFR_Object::RFR_Object_Obj14.AxAyCoVnce = 0;
  @CAN_RadarFR::RFR_Object::RFR_Object_Obj14.AxVnce = 0;
  @CAN_RadarFR::RFR_Object::RFR_Object_Obj14.Ay = 0;
  @CAN_RadarFR::RFR_Object::RFR_Object_Obj14.AyVnce = 0;
  @CAN_RadarFR::RFR_Object::RFR_Object_Obj14.ExistProb = 0;
  @CAN_RadarFR::RFR_Object::RFR_Object_Obj14.FilterInformation = 0;
  @CAN_RadarFR::RFR_Object::RFR_Object_Obj14.Length = 0;
  @CAN_RadarFR::RFR_Object::RFR_Object_Obj14.LengthVnce = 0;
  @CAN_RadarFR::RFR_Object::RFR_Object_Obj14.MeasurementStatus = 0;
  @CAN_RadarFR::RFR_Object::RFR_Object_Obj14.MovingStatus = 0;
  @CAN_RadarFR::RFR_Object::RFR_Object_Obj14.ObjId = 0;
  @CAN_RadarFR::RFR_Object::RFR_Object_Obj14.OrientationYaw = 0;
  @CAN_RadarFR::RFR_Object::RFR_Object_Obj14.OrientationYawVnce = 0;
  @CAN_RadarFR::RFR_Object::RFR_Object_Obj14.ProbClassConfidence = 0;
  @CAN_RadarFR::RFR_Object::RFR_Object_Obj14.ProbClassType = 0;
  @CAN_RadarFR::RFR_Object::RFR_Object_Obj14.Px = 0;
  @CAN_RadarFR::RFR_Object::RFR_Object_Obj14.PxAxCoVnce = 0;
  }
  if(init_count == 9)
  {
  @CAN_RadarFR::RFR_Object::RFR_Object_Obj14.PxAyCoVnce = 0;
  @CAN_RadarFR::RFR_Object::RFR_Object_Obj14.PxPyCoVnce = 0;
  @CAN_RadarFR::RFR_Object::RFR_Object_Obj14.PxVnce = 0;
  @CAN_RadarFR::RFR_Object::RFR_Object_Obj14.PxVxCoVnce = 0;
  @CAN_RadarFR::RFR_Object::RFR_Object_Obj14.PxVyCoVnce = 0;
  @CAN_RadarFR::RFR_Object::RFR_Object_Obj14.Py = 0;
  @CAN_RadarFR::RFR_Object::RFR_Object_Obj14.PyAxCoVnce = 0;
  @CAN_RadarFR::RFR_Object::RFR_Object_Obj14.PyAyCoVnce = 0;
  @CAN_RadarFR::RFR_Object::RFR_Object_Obj14.PyVnce = 0;
  @CAN_RadarFR::RFR_Object::RFR_Object_Obj14.PyVxCoVnce = 0;
  @CAN_RadarFR::RFR_Object::RFR_Object_Obj14.PyVyCoVnce = 0;
  @CAN_RadarFR::RFR_Object::RFR_Object_Obj14.ReferencePoint = 0;
  @CAN_RadarFR::RFR_Object::RFR_Object_Obj14.Vx = 0;
  @CAN_RadarFR::RFR_Object::RFR_Object_Obj14.VxAxCoVnce = 0;
  @CAN_RadarFR::RFR_Object::RFR_Object_Obj14.VxAyCoVnce = 0;
  @CAN_RadarFR::RFR_Object::RFR_Object_Obj14.VxVnce = 0;
  @CAN_RadarFR::RFR_Object::RFR_Object_Obj14.VxVyCoVnce = 0;
  @CAN_RadarFR::RFR_Object::RFR_Object_Obj14.Vy = 0;
  @CAN_RadarFR::RFR_Object::RFR_Object_Obj14.VyAxCoVnce = 0;
  @CAN_RadarFR::RFR_Object::RFR_Object_Obj14.VyAyCoVnce = 0;
  @CAN_RadarFR::RFR_Object::RFR_Object_Obj14.VyVnce = 0;
  @CAN_RadarFR::RFR_Object::RFR_Object_Obj14.Width = 0;
  @CAN_RadarFR::RFR_Object::RFR_Object_Obj14.WidthVnce = 0;
  @CAN_RadarFR::RFR_Object::RFR_Object_Obj15.Age = 0;
  @CAN_RadarFR::RFR_Object::RFR_Object_Obj15.Ax = 0;
  }
  if(init_count == 10)
  {
  @CAN_RadarFR::RFR_Object::RFR_Object_Obj15.AxAyCoVnce = 0;
  @CAN_RadarFR::RFR_Object::RFR_Object_Obj15.AxVnce = 0;
  @CAN_RadarFR::RFR_Object::RFR_Object_Obj15.Ay = 0;
  @CAN_RadarFR::RFR_Object::RFR_Object_Obj15.AyVnce = 0;
  @CAN_RadarFR::RFR_Object::RFR_Object_Obj15.ExistProb = 0;
  @CAN_RadarFR::RFR_Object::RFR_Object_Obj15.FilterInformation = 0;
  @CAN_RadarFR::RFR_Object::RFR_Object_Obj15.Length = 0;
  @CAN_RadarFR::RFR_Object::RFR_Object_Obj15.LengthVnce = 0;
  @CAN_RadarFR::RFR_Object::RFR_Object_Obj15.MeasurementStatus = 0;
  @CAN_RadarFR::RFR_Object::RFR_Object_Obj15.MovingStatus = 0;
  @CAN_RadarFR::RFR_Object::RFR_Object_Obj15.ObjId = 0;
  @CAN_RadarFR::RFR_Object::RFR_Object_Obj15.OrientationYaw = 0;
  @CAN_RadarFR::RFR_Object::RFR_Object_Obj15.OrientationYawVnce = 0;
  @CAN_RadarFR::RFR_Object::RFR_Object_Obj15.ProbClassConfidence = 0;
  @CAN_RadarFR::RFR_Object::RFR_Object_Obj15.ProbClassType = 0;
  @CAN_RadarFR::RFR_Object::RFR_Object_Obj15.Px = 0;
  @CAN_RadarFR::RFR_Object::RFR_Object_Obj15.PxAxCoVnce = 0;
  @CAN_RadarFR::RFR_Object::RFR_Object_Obj15.PxAyCoVnce = 0;
  @CAN_RadarFR::RFR_Object::RFR_Object_Obj15.PxPyCoVnce = 0;
  @CAN_RadarFR::RFR_Object::RFR_Object_Obj15.PxVnce = 0;
  @CAN_RadarFR::RFR_Object::RFR_Object_Obj15.PxVxCoVnce = 0;
  @CAN_RadarFR::RFR_Object::RFR_Object_Obj15.PxVyCoVnce = 0;
  @CAN_RadarFR::RFR_Object::RFR_Object_Obj15.Py = 0;
  @CAN_RadarFR::RFR_Object::RFR_Object_Obj15.PyAxCoVnce = 0;
  @CAN_RadarFR::RFR_Object::RFR_Object_Obj15.PyAyCoVnce = 0;
  }
  if(init_count == 11)
  {
  @CAN_RadarFR::RFR_Object::RFR_Object_Obj15.PyVnce = 0;
  @CAN_RadarFR::RFR_Object::RFR_Object_Obj15.PyVxCoVnce = 0;
  @CAN_RadarFR::RFR_Object::RFR_Object_Obj15.PyVyCoVnce = 0;
  @CAN_RadarFR::RFR_Object::RFR_Object_Obj15.ReferencePoint = 0;
  @CAN_RadarFR::RFR_Object::RFR_Object_Obj15.Vx = 0;
  @CAN_RadarFR::RFR_Object::RFR_Object_Obj15.VxAxCoVnce = 0;
  @CAN_RadarFR::RFR_Object::RFR_Object_Obj15.VxAyCoVnce = 0;
  @CAN_RadarFR::RFR_Object::RFR_Object_Obj15.VxVnce = 0;
  @CAN_RadarFR::RFR_Object::RFR_Object_Obj15.VxVyCoVnce = 0;
  @CAN_RadarFR::RFR_Object::RFR_Object_Obj15.Vy = 0;
  @CAN_RadarFR::RFR_Object::RFR_Object_Obj15.VyAxCoVnce = 0;
  @CAN_RadarFR::RFR_Object::RFR_Object_Obj15.VyAyCoVnce = 0;
  @CAN_RadarFR::RFR_Object::RFR_Object_Obj15.VyVnce = 0;
  @CAN_RadarFR::RFR_Object::RFR_Object_Obj15.Width = 0;
  @CAN_RadarFR::RFR_Object::RFR_Object_Obj15.WidthVnce = 0;
  @CAN_RadarFR::RFR_Object::RFR_Object_Obj16.Age = 0;
  @CAN_RadarFR::RFR_Object::RFR_Object_Obj16.Ax = 0;
  @CAN_RadarFR::RFR_Object::RFR_Object_Obj16.AxAyCoVnce = 0;
  @CAN_RadarFR::RFR_Object::RFR_Object_Obj16.AxVnce = 0;
  @CAN_RadarFR::RFR_Object::RFR_Object_Obj16.Ay = 0;
  @CAN_RadarFR::RFR_Object::RFR_Object_Obj16.AyVnce = 0;
  @CAN_RadarFR::RFR_Object::RFR_Object_Obj16.ExistProb = 0;
  @CAN_RadarFR::RFR_Object::RFR_Object_Obj16.FilterInformation = 0;
  @CAN_RadarFR::RFR_Object::RFR_Object_Obj16.Length = 0;
  @CAN_RadarFR::RFR_Object::RFR_Object_Obj16.LengthVnce = 0;
  }
  if(init_count == 12)
  {
  @CAN_RadarFR::RFR_Object::RFR_Object_Obj16.MeasurementStatus = 0;
  @CAN_RadarFR::RFR_Object::RFR_Object_Obj16.MovingStatus = 0;
  @CAN_RadarFR::RFR_Object::RFR_Object_Obj16.ObjId = 0;
  @CAN_RadarFR::RFR_Object::RFR_Object_Obj16.OrientationYaw = 0;
  @CAN_RadarFR::RFR_Object::RFR_Object_Obj16.OrientationYawVnce = 0;
  @CAN_RadarFR::RFR_Object::RFR_Object_Obj16.ProbClassConfidence = 0;
  @CAN_RadarFR::RFR_Object::RFR_Object_Obj16.ProbClassType = 0;
  @CAN_RadarFR::RFR_Object::RFR_Object_Obj16.Px = 0;
  @CAN_RadarFR::RFR_Object::RFR_Object_Obj16.PxAxCoVnce = 0;
  @CAN_RadarFR::RFR_Object::RFR_Object_Obj16.PxAyCoVnce = 0;
  @CAN_RadarFR::RFR_Object::RFR_Object_Obj16.PxPyCoVnce = 0;
  @CAN_RadarFR::RFR_Object::RFR_Object_Obj16.PxVnce = 0;
  @CAN_RadarFR::RFR_Object::RFR_Object_Obj16.PxVxCoVnce = 0;
  @CAN_RadarFR::RFR_Object::RFR_Object_Obj16.PxVyCoVnce = 0;
  @CAN_RadarFR::RFR_Object::RFR_Object_Obj16.Py = 0;
  @CAN_RadarFR::RFR_Object::RFR_Object_Obj16.PyAxCoVnce = 0;
  @CAN_RadarFR::RFR_Object::RFR_Object_Obj16.PyAyCoVnce = 0;
  @CAN_RadarFR::RFR_Object::RFR_Object_Obj16.PyVnce = 0;
  @CAN_RadarFR::RFR_Object::RFR_Object_Obj16.PyVxCoVnce = 0;
  @CAN_RadarFR::RFR_Object::RFR_Object_Obj16.PyVyCoVnce = 0;
  @CAN_RadarFR::RFR_Object::RFR_Object_Obj16.ReferencePoint = 0;
  @CAN_RadarFR::RFR_Object::RFR_Object_Obj16.Vx = 0;
  @CAN_RadarFR::RFR_Object::RFR_Object_Obj16.VxAxCoVnce = 0;
  @CAN_RadarFR::RFR_Object::RFR_Object_Obj16.VxAyCoVnce = 0;
  @CAN_RadarFR::RFR_Object::RFR_Object_Obj16.VxVnce = 0;
  }
  if(init_count == 13)
  {
  @CAN_RadarFR::RFR_Object::RFR_Object_Obj16.VxVyCoVnce = 0;
  @CAN_RadarFR::RFR_Object::RFR_Object_Obj16.Vy = 0;
  @CAN_RadarFR::RFR_Object::RFR_Object_Obj16.VyAxCoVnce = 0;
  @CAN_RadarFR::RFR_Object::RFR_Object_Obj16.VyAyCoVnce = 0;
  @CAN_RadarFR::RFR_Object::RFR_Object_Obj16.VyVnce = 0;
  @CAN_RadarFR::RFR_Object::RFR_Object_Obj16.Width = 0;
  @CAN_RadarFR::RFR_Object::RFR_Object_Obj16.WidthVnce = 0;
  @CAN_RadarFR::RFR_Object::RFR_Object_Obj17.Age = 0;
  @CAN_RadarFR::RFR_Object::RFR_Object_Obj17.Ax = 0;
  @CAN_RadarFR::RFR_Object::RFR_Object_Obj17.AxAyCoVnce = 0;
  @CAN_RadarFR::RFR_Object::RFR_Object_Obj17.AxVnce = 0;
  @CAN_RadarFR::RFR_Object::RFR_Object_Obj17.Ay = 0;
  @CAN_RadarFR::RFR_Object::RFR_Object_Obj17.AyVnce = 0;
  @CAN_RadarFR::RFR_Object::RFR_Object_Obj17.ExistProb = 0;
  @CAN_RadarFR::RFR_Object::RFR_Object_Obj17.FilterInformation = 0;
  @CAN_RadarFR::RFR_Object::RFR_Object_Obj17.Length = 0;
  @CAN_RadarFR::RFR_Object::RFR_Object_Obj17.LengthVnce = 0;
  @CAN_RadarFR::RFR_Object::RFR_Object_Obj17.MeasurementStatus = 0;
  @CAN_RadarFR::RFR_Object::RFR_Object_Obj17.MovingStatus = 0;
  @CAN_RadarFR::RFR_Object::RFR_Object_Obj17.ObjId = 0;
  @CAN_RadarFR::RFR_Object::RFR_Object_Obj17.OrientationYaw = 0;
  @CAN_RadarFR::RFR_Object::RFR_Object_Obj17.OrientationYawVnce = 0;
  @CAN_RadarFR::RFR_Object::RFR_Object_Obj17.ProbClassConfidence = 0;
  @CAN_RadarFR::RFR_Object::RFR_Object_Obj17.ProbClassType = 0;
  @CAN_RadarFR::RFR_Object::RFR_Object_Obj17.Px = 0;
  }
  if(init_count == 14)
  {
  @CAN_RadarFR::RFR_Object::RFR_Object_Obj17.PxAxCoVnce = 0;
  @CAN_RadarFR::RFR_Object::RFR_Object_Obj17.PxAyCoVnce = 0;
  @CAN_RadarFR::RFR_Object::RFR_Object_Obj17.PxPyCoVnce = 0;
  @CAN_RadarFR::RFR_Object::RFR_Object_Obj17.PxVnce = 0;
  @CAN_RadarFR::RFR_Object::RFR_Object_Obj17.PxVxCoVnce = 0;
  @CAN_RadarFR::RFR_Object::RFR_Object_Obj17.PxVyCoVnce = 0;
  @CAN_RadarFR::RFR_Object::RFR_Object_Obj17.Py = 0;
  @CAN_RadarFR::RFR_Object::RFR_Object_Obj17.PyAxCoVnce = 0;
  @CAN_RadarFR::RFR_Object::RFR_Object_Obj17.PyAyCoVnce = 0;
  @CAN_RadarFR::RFR_Object::RFR_Object_Obj17.PyVnce = 0;
  @CAN_RadarFR::RFR_Object::RFR_Object_Obj17.PyVxCoVnce = 0;
  @CAN_RadarFR::RFR_Object::RFR_Object_Obj17.PyVyCoVnce = 0;
  @CAN_RadarFR::RFR_Object::RFR_Object_Obj17.ReferencePoint = 0;
  @CAN_RadarFR::RFR_Object::RFR_Object_Obj17.Vx = 0;
  @CAN_RadarFR::RFR_Object::RFR_Object_Obj17.VxAxCoVnce = 0;
  @CAN_RadarFR::RFR_Object::RFR_Object_Obj17.VxAyCoVnce = 0;
  @CAN_RadarFR::RFR_Object::RFR_Object_Obj17.VxVnce = 0;
  @CAN_RadarFR::RFR_Object::RFR_Object_Obj17.VxVyCoVnce = 0;
  @CAN_RadarFR::RFR_Object::RFR_Object_Obj17.Vy = 0;
  @CAN_RadarFR::RFR_Object::RFR_Object_Obj17.VyAxCoVnce = 0;
  @CAN_RadarFR::RFR_Object::RFR_Object_Obj17.VyAyCoVnce = 0;
  @CAN_RadarFR::RFR_Object::RFR_Object_Obj17.VyVnce = 0;
  @CAN_RadarFR::RFR_Object::RFR_Object_Obj17.Width = 0;
  @CAN_RadarFR::RFR_Object::RFR_Object_Obj17.WidthVnce = 0;
  @CAN_RadarFR::RFR_Object::RFR_Object_Obj18.Age = 0;
  }
  if(init_count == 15)
  {
  @CAN_RadarFR::RFR_Object::RFR_Object_Obj18.Ax = 0;
  @CAN_RadarFR::RFR_Object::RFR_Object_Obj18.AxAyCoVnce = 0;
  @CAN_RadarFR::RFR_Object::RFR_Object_Obj18.AxVnce = 0;
  @CAN_RadarFR::RFR_Object::RFR_Object_Obj18.Ay = 0;
  @CAN_RadarFR::RFR_Object::RFR_Object_Obj18.AyVnce = 0;
  @CAN_RadarFR::RFR_Object::RFR_Object_Obj18.ExistProb = 0;
  @CAN_RadarFR::RFR_Object::RFR_Object_Obj18.FilterInformation = 0;
  @CAN_RadarFR::RFR_Object::RFR_Object_Obj18.Length = 0;
  @CAN_RadarFR::RFR_Object::RFR_Object_Obj18.LengthVnce = 0;
  @CAN_RadarFR::RFR_Object::RFR_Object_Obj18.MeasurementStatus = 0;
  @CAN_RadarFR::RFR_Object::RFR_Object_Obj18.MovingStatus = 0;
  @CAN_RadarFR::RFR_Object::RFR_Object_Obj18.ObjId = 0;
  @CAN_RadarFR::RFR_Object::RFR_Object_Obj18.OrientationYaw = 0;
  @CAN_RadarFR::RFR_Object::RFR_Object_Obj18.OrientationYawVnce = 0;
  @CAN_RadarFR::RFR_Object::RFR_Object_Obj18.ProbClassConfidence = 0;
  @CAN_RadarFR::RFR_Object::RFR_Object_Obj18.ProbClassType = 0;
  @CAN_RadarFR::RFR_Object::RFR_Object_Obj18.Px = 0;
  @CAN_RadarFR::RFR_Object::RFR_Object_Obj18.PxAxCoVnce = 0;
  @CAN_RadarFR::RFR_Object::RFR_Object_Obj18.PxAyCoVnce = 0;
  @CAN_RadarFR::RFR_Object::RFR_Object_Obj18.PxPyCoVnce = 0;
  @CAN_RadarFR::RFR_Object::RFR_Object_Obj18.PxVnce = 0;
  @CAN_RadarFR::RFR_Object::RFR_Object_Obj18.PxVxCoVnce = 0;
  @CAN_RadarFR::RFR_Object::RFR_Object_Obj18.PxVyCoVnce = 0;
  @CAN_RadarFR::RFR_Object::RFR_Object_Obj18.Py = 0;
  @CAN_RadarFR::RFR_Object::RFR_Object_Obj18.PyAxCoVnce = 0;
  }
  if(init_count == 16)
  {
  @CAN_RadarFR::RFR_Object::RFR_Object_Obj18.PyAyCoVnce = 0;
  @CAN_RadarFR::RFR_Object::RFR_Object_Obj18.PyVnce = 0;
  @CAN_RadarFR::RFR_Object::RFR_Object_Obj18.PyVxCoVnce = 0;
  @CAN_RadarFR::RFR_Object::RFR_Object_Obj18.PyVyCoVnce = 0;
  @CAN_RadarFR::RFR_Object::RFR_Object_Obj18.ReferencePoint = 0;
  @CAN_RadarFR::RFR_Object::RFR_Object_Obj18.Vx = 0;
  @CAN_RadarFR::RFR_Object::RFR_Object_Obj18.VxAxCoVnce = 0;
  @CAN_RadarFR::RFR_Object::RFR_Object_Obj18.VxAyCoVnce = 0;
  @CAN_RadarFR::RFR_Object::RFR_Object_Obj18.VxVnce = 0;
  @CAN_RadarFR::RFR_Object::RFR_Object_Obj18.VxVyCoVnce = 0;
  @CAN_RadarFR::RFR_Object::RFR_Object_Obj18.Vy = 0;
  @CAN_RadarFR::RFR_Object::RFR_Object_Obj18.VyAxCoVnce = 0;
  @CAN_RadarFR::RFR_Object::RFR_Object_Obj18.VyAyCoVnce = 0;
  @CAN_RadarFR::RFR_Object::RFR_Object_Obj18.VyVnce = 0;
  @CAN_RadarFR::RFR_Object::RFR_Object_Obj18.Width = 0;
  @CAN_RadarFR::RFR_Object::RFR_Object_Obj18.WidthVnce = 0;
  @CAN_RadarFR::RFR_Object::RFR_Object_Obj19.Age = 0;
  @CAN_RadarFR::RFR_Object::RFR_Object_Obj19.Ax = 0;
  @CAN_RadarFR::RFR_Object::RFR_Object_Obj19.AxAyCoVnce = 0;
  @CAN_RadarFR::RFR_Object::RFR_Object_Obj19.AxVnce = 0;
  @CAN_RadarFR::RFR_Object::RFR_Object_Obj19.Ay = 0;
  @CAN_RadarFR::RFR_Object::RFR_Object_Obj19.AyVnce = 0;
  @CAN_RadarFR::RFR_Object::RFR_Object_Obj19.ExistProb = 0;
  @CAN_RadarFR::RFR_Object::RFR_Object_Obj19.FilterInformation = 0;
  @CAN_RadarFR::RFR_Object::RFR_Object_Obj19.Length = 0;
  }
  if(init_count == 17)
  {
  @CAN_RadarFR::RFR_Object::RFR_Object_Obj19.LengthVnce = 0;
  @CAN_RadarFR::RFR_Object::RFR_Object_Obj19.MeasurementStatus = 0;
  @CAN_RadarFR::RFR_Object::RFR_Object_Obj19.MovingStatus = 0;
  @CAN_RadarFR::RFR_Object::RFR_Object_Obj19.ObjId = 0;
  @CAN_RadarFR::RFR_Object::RFR_Object_Obj19.OrientationYaw = 0;
  @CAN_RadarFR::RFR_Object::RFR_Object_Obj19.OrientationYawVnce = 0;
  @CAN_RadarFR::RFR_Object::RFR_Object_Obj19.ProbClassConfidence = 0;
  @CAN_RadarFR::RFR_Object::RFR_Object_Obj19.ProbClassType = 0;
  @CAN_RadarFR::RFR_Object::RFR_Object_Obj19.Px = 0;
  @CAN_RadarFR::RFR_Object::RFR_Object_Obj19.PxAxCoVnce = 0;
  @CAN_RadarFR::RFR_Object::RFR_Object_Obj19.PxAyCoVnce = 0;
  @CAN_RadarFR::RFR_Object::RFR_Object_Obj19.PxPyCoVnce = 0;
  @CAN_RadarFR::RFR_Object::RFR_Object_Obj19.PxVnce = 0;
  @CAN_RadarFR::RFR_Object::RFR_Object_Obj19.PxVxCoVnce = 0;
  @CAN_RadarFR::RFR_Object::RFR_Object_Obj19.PxVyCoVnce = 0;
  @CAN_RadarFR::RFR_Object::RFR_Object_Obj19.Py = 0;
  @CAN_RadarFR::RFR_Object::RFR_Object_Obj19.PyAxCoVnce = 0;
  @CAN_RadarFR::RFR_Object::RFR_Object_Obj19.PyAyCoVnce = 0;
  @CAN_RadarFR::RFR_Object::RFR_Object_Obj19.PyVnce = 0;
  @CAN_RadarFR::RFR_Object::RFR_Object_Obj19.PyVxCoVnce = 0;
  @CAN_RadarFR::RFR_Object::RFR_Object_Obj19.PyVyCoVnce = 0;
  @CAN_RadarFR::RFR_Object::RFR_Object_Obj19.ReferencePoint = 0;
  @CAN_RadarFR::RFR_Object::RFR_Object_Obj19.Vx = 0;
  @CAN_RadarFR::RFR_Object::RFR_Object_Obj19.VxAxCoVnce = 0;
  @CAN_RadarFR::RFR_Object::RFR_Object_Obj19.VxAyCoVnce = 0;
  }
  if(init_count == 18)
  {
  @CAN_RadarFR::RFR_Object::RFR_Object_Obj19.VxVnce = 0;
  @CAN_RadarFR::RFR_Object::RFR_Object_Obj19.VxVyCoVnce = 0;
  @CAN_RadarFR::RFR_Object::RFR_Object_Obj19.Vy = 0;
  @CAN_RadarFR::RFR_Object::RFR_Object_Obj19.VyAxCoVnce = 0;
  @CAN_RadarFR::RFR_Object::RFR_Object_Obj19.VyAyCoVnce = 0;
  @CAN_RadarFR::RFR_Object::RFR_Object_Obj19.VyVnce = 0;
  @CAN_RadarFR::RFR_Object::RFR_Object_Obj19.Width = 0;
  @CAN_RadarFR::RFR_Object::RFR_Object_Obj19.WidthVnce = 0;
  @CAN_RadarFR::RFR_Object::RFR_Object_Obj1.Age = 0;
  @CAN_RadarFR::RFR_Object::RFR_Object_Obj1.Ax = 0;
  @CAN_RadarFR::RFR_Object::RFR_Object_Obj1.AxAyCoVnce = 0;
  @CAN_RadarFR::RFR_Object::RFR_Object_Obj1.AxVnce = 0;
  @CAN_RadarFR::RFR_Object::RFR_Object_Obj1.Ay = 0;
  @CAN_RadarFR::RFR_Object::RFR_Object_Obj1.AyVnce = 0;
  @CAN_RadarFR::RFR_Object::RFR_Object_Obj1.ExistProb = 0;
  @CAN_RadarFR::RFR_Object::RFR_Object_Obj1.FilterInformation = 0;
  @CAN_RadarFR::RFR_Object::RFR_Object_Obj1.Length = 0;
  @CAN_RadarFR::RFR_Object::RFR_Object_Obj1.LengthVnce = 0;
  @CAN_RadarFR::RFR_Object::RFR_Object_Obj1.MeasurementStatus = 0;
  @CAN_RadarFR::RFR_Object::RFR_Object_Obj1.MovingStatus = 0;
  @CAN_RadarFR::RFR_Object::RFR_Object_Obj1.ObjId = 0;
  @CAN_RadarFR::RFR_Object::RFR_Object_Obj1.OrientationYaw = 0;
  @CAN_RadarFR::RFR_Object::RFR_Object_Obj1.OrientationYawVnce = 0;
  @CAN_RadarFR::RFR_Object::RFR_Object_Obj1.ProbClassConfidence = 0;
  @CAN_RadarFR::RFR_Object::RFR_Object_Obj1.ProbClassType = 0;
  }
  if(init_count == 19)
  {
  @CAN_RadarFR::RFR_Object::RFR_Object_Obj1.Px = 0;
  @CAN_RadarFR::RFR_Object::RFR_Object_Obj1.PxAxCoVnce = 0;
  @CAN_RadarFR::RFR_Object::RFR_Object_Obj1.PxAyCoVnce = 0;
  @CAN_RadarFR::RFR_Object::RFR_Object_Obj1.PxPyCoVnce = 0;
  @CAN_RadarFR::RFR_Object::RFR_Object_Obj1.PxVnce = 0;
  @CAN_RadarFR::RFR_Object::RFR_Object_Obj1.PxVxCoVnce = 0;
  @CAN_RadarFR::RFR_Object::RFR_Object_Obj1.PxVyCoVnce = 0;
  @CAN_RadarFR::RFR_Object::RFR_Object_Obj1.Py = 0;
  @CAN_RadarFR::RFR_Object::RFR_Object_Obj1.PyAxCoVnce = 0;
  @CAN_RadarFR::RFR_Object::RFR_Object_Obj1.PyAyCoVnce = 0;
  @CAN_RadarFR::RFR_Object::RFR_Object_Obj1.PyVnce = 0;
  @CAN_RadarFR::RFR_Object::RFR_Object_Obj1.PyVxCoVnce = 0;
  @CAN_RadarFR::RFR_Object::RFR_Object_Obj1.PyVyCoVnce = 0;
  @CAN_RadarFR::RFR_Object::RFR_Object_Obj1.ReferencePoint = 0;
  @CAN_RadarFR::RFR_Object::RFR_Object_Obj1.Vx = 0;
  @CAN_RadarFR::RFR_Object::RFR_Object_Obj1.VxAxCoVnce = 0;
  @CAN_RadarFR::RFR_Object::RFR_Object_Obj1.VxAyCoVnce = 0;
  @CAN_RadarFR::RFR_Object::RFR_Object_Obj1.VxVnce = 0;
  @CAN_RadarFR::RFR_Object::RFR_Object_Obj1.VxVyCoVnce = 0;
  @CAN_RadarFR::RFR_Object::RFR_Object_Obj1.Vy = 0;
  @CAN_RadarFR::RFR_Object::RFR_Object_Obj1.VyAxCoVnce = 0;
  @CAN_RadarFR::RFR_Object::RFR_Object_Obj1.VyAyCoVnce = 0;
  @CAN_RadarFR::RFR_Object::RFR_Object_Obj1.VyVnce = 0;
  @CAN_RadarFR::RFR_Object::RFR_Object_Obj1.Width = 0;
  @CAN_RadarFR::RFR_Object::RFR_Object_Obj1.WidthVnce = 0;
  }
  if(init_count == 20)
  {
  @CAN_RadarFR::RFR_Object::RFR_Object_Obj20.Age = 0;
  @CAN_RadarFR::RFR_Object::RFR_Object_Obj20.Ax = 0;
  @CAN_RadarFR::RFR_Object::RFR_Object_Obj20.AxAyCoVnce = 0;
  @CAN_RadarFR::RFR_Object::RFR_Object_Obj20.AxVnce = 0;
  @CAN_RadarFR::RFR_Object::RFR_Object_Obj20.Ay = 0;
  @CAN_RadarFR::RFR_Object::RFR_Object_Obj20.AyVnce = 0;
  @CAN_RadarFR::RFR_Object::RFR_Object_Obj20.ExistProb = 0;
  @CAN_RadarFR::RFR_Object::RFR_Object_Obj20.FilterInformation = 0;
  @CAN_RadarFR::RFR_Object::RFR_Object_Obj20.Length = 0;
  @CAN_RadarFR::RFR_Object::RFR_Object_Obj20.LengthVnce = 0;
  @CAN_RadarFR::RFR_Object::RFR_Object_Obj20.MeasurementStatus = 0;
  @CAN_RadarFR::RFR_Object::RFR_Object_Obj20.MovingStatus = 0;
  @CAN_RadarFR::RFR_Object::RFR_Object_Obj20.ObjId = 0;
  @CAN_RadarFR::RFR_Object::RFR_Object_Obj20.OrientationYaw = 0;
  @CAN_RadarFR::RFR_Object::RFR_Object_Obj20.OrientationYawVnce = 0;
  @CAN_RadarFR::RFR_Object::RFR_Object_Obj20.ProbClassConfidence = 0;
  @CAN_RadarFR::RFR_Object::RFR_Object_Obj20.ProbClassType = 0;
  @CAN_RadarFR::RFR_Object::RFR_Object_Obj20.Px = 0;
  @CAN_RadarFR::RFR_Object::RFR_Object_Obj20.PxAxCoVnce = 0;
  @CAN_RadarFR::RFR_Object::RFR_Object_Obj20.PxAyCoVnce = 0;
  @CAN_RadarFR::RFR_Object::RFR_Object_Obj20.PxPyCoVnce = 0;
  @CAN_RadarFR::RFR_Object::RFR_Object_Obj20.PxVnce = 0;
  @CAN_RadarFR::RFR_Object::RFR_Object_Obj20.PxVxCoVnce = 0;
  @CAN_RadarFR::RFR_Object::RFR_Object_Obj20.PxVyCoVnce = 0;
  @CAN_RadarFR::RFR_Object::RFR_Object_Obj20.Py = 0;
  }
  if(init_count == 21)
  {
  @CAN_RadarFR::RFR_Object::RFR_Object_Obj20.PyAxCoVnce = 0;
  @CAN_RadarFR::RFR_Object::RFR_Object_Obj20.PyAyCoVnce = 0;
  @CAN_RadarFR::RFR_Object::RFR_Object_Obj20.PyVnce = 0;
  @CAN_RadarFR::RFR_Object::RFR_Object_Obj20.PyVxCoVnce = 0;
  @CAN_RadarFR::RFR_Object::RFR_Object_Obj20.PyVyCoVnce = 0;
  @CAN_RadarFR::RFR_Object::RFR_Object_Obj20.ReferencePoint = 0;
  @CAN_RadarFR::RFR_Object::RFR_Object_Obj20.Vx = 0;
  @CAN_RadarFR::RFR_Object::RFR_Object_Obj20.VxAxCoVnce = 0;
  @CAN_RadarFR::RFR_Object::RFR_Object_Obj20.VxAyCoVnce = 0;
  @CAN_RadarFR::RFR_Object::RFR_Object_Obj20.VxVnce = 0;
  @CAN_RadarFR::RFR_Object::RFR_Object_Obj20.VxVyCoVnce = 0;
  @CAN_RadarFR::RFR_Object::RFR_Object_Obj20.Vy = 0;
  @CAN_RadarFR::RFR_Object::RFR_Object_Obj20.VyAxCoVnce = 0;
  @CAN_RadarFR::RFR_Object::RFR_Object_Obj20.VyAyCoVnce = 0;
  @CAN_RadarFR::RFR_Object::RFR_Object_Obj20.VyVnce = 0;
  @CAN_RadarFR::RFR_Object::RFR_Object_Obj20.Width = 0;
  @CAN_RadarFR::RFR_Object::RFR_Object_Obj20.WidthVnce = 0;
  @CAN_RadarFR::RFR_Object::RFR_Object_Obj21.Age = 0;
  @CAN_RadarFR::RFR_Object::RFR_Object_Obj21.Ax = 0;
  @CAN_RadarFR::RFR_Object::RFR_Object_Obj21.AxAyCoVnce = 0;
  @CAN_RadarFR::RFR_Object::RFR_Object_Obj21.AxVnce = 0;
  @CAN_RadarFR::RFR_Object::RFR_Object_Obj21.Ay = 0;
  @CAN_RadarFR::RFR_Object::RFR_Object_Obj21.AyVnce = 0;
  @CAN_RadarFR::RFR_Object::RFR_Object_Obj21.ExistProb = 0;
  @CAN_RadarFR::RFR_Object::RFR_Object_Obj21.FilterInformation = 0;
  }
  if(init_count == 22)
  {
  @CAN_RadarFR::RFR_Object::RFR_Object_Obj21.Length = 0;
  @CAN_RadarFR::RFR_Object::RFR_Object_Obj21.LengthVnce = 0;
  @CAN_RadarFR::RFR_Object::RFR_Object_Obj21.MeasurementStatus = 0;
  @CAN_RadarFR::RFR_Object::RFR_Object_Obj21.MovingStatus = 0;
  @CAN_RadarFR::RFR_Object::RFR_Object_Obj21.ObjId = 0;
  @CAN_RadarFR::RFR_Object::RFR_Object_Obj21.OrientationYaw = 0;
  @CAN_RadarFR::RFR_Object::RFR_Object_Obj21.OrientationYawVnce = 0;
  @CAN_RadarFR::RFR_Object::RFR_Object_Obj21.ProbClassConfidence = 0;
  @CAN_RadarFR::RFR_Object::RFR_Object_Obj21.ProbClassType = 0;
  @CAN_RadarFR::RFR_Object::RFR_Object_Obj21.Px = 0;
  @CAN_RadarFR::RFR_Object::RFR_Object_Obj21.PxAxCoVnce = 0;
  @CAN_RadarFR::RFR_Object::RFR_Object_Obj21.PxAyCoVnce = 0;
  @CAN_RadarFR::RFR_Object::RFR_Object_Obj21.PxPyCoVnce = 0;
  @CAN_RadarFR::RFR_Object::RFR_Object_Obj21.PxVnce = 0;
  @CAN_RadarFR::RFR_Object::RFR_Object_Obj21.PxVxCoVnce = 0;
  @CAN_RadarFR::RFR_Object::RFR_Object_Obj21.PxVyCoVnce = 0;
  @CAN_RadarFR::RFR_Object::RFR_Object_Obj21.Py = 0;
  @CAN_RadarFR::RFR_Object::RFR_Object_Obj21.PyAxCoVnce = 0;
  @CAN_RadarFR::RFR_Object::RFR_Object_Obj21.PyAyCoVnce = 0;
  @CAN_RadarFR::RFR_Object::RFR_Object_Obj21.PyVnce = 0;
  @CAN_RadarFR::RFR_Object::RFR_Object_Obj21.PyVxCoVnce = 0;
  @CAN_RadarFR::RFR_Object::RFR_Object_Obj21.PyVyCoVnce = 0;
  @CAN_RadarFR::RFR_Object::RFR_Object_Obj21.ReferencePoint = 0;
  @CAN_RadarFR::RFR_Object::RFR_Object_Obj21.Vx = 0;
  @CAN_RadarFR::RFR_Object::RFR_Object_Obj21.VxAxCoVnce = 0;
  }
  if(init_count == 23)
  {
  @CAN_RadarFR::RFR_Object::RFR_Object_Obj21.VxAyCoVnce = 0;
  @CAN_RadarFR::RFR_Object::RFR_Object_Obj21.VxVnce = 0;
  @CAN_RadarFR::RFR_Object::RFR_Object_Obj21.VxVyCoVnce = 0;
  @CAN_RadarFR::RFR_Object::RFR_Object_Obj21.Vy = 0;
  @CAN_RadarFR::RFR_Object::RFR_Object_Obj21.VyAxCoVnce = 0;
  @CAN_RadarFR::RFR_Object::RFR_Object_Obj21.VyAyCoVnce = 0;
  @CAN_RadarFR::RFR_Object::RFR_Object_Obj21.VyVnce = 0;
  @CAN_RadarFR::RFR_Object::RFR_Object_Obj21.Width = 0;
  @CAN_RadarFR::RFR_Object::RFR_Object_Obj21.WidthVnce = 0;
  @CAN_RadarFR::RFR_Object::RFR_Object_Obj22.Age = 0;
  @CAN_RadarFR::RFR_Object::RFR_Object_Obj22.Ax = 0;
  @CAN_RadarFR::RFR_Object::RFR_Object_Obj22.AxAyCoVnce = 0;
  @CAN_RadarFR::RFR_Object::RFR_Object_Obj22.AxVnce = 0;
  @CAN_RadarFR::RFR_Object::RFR_Object_Obj22.Ay = 0;
  @CAN_RadarFR::RFR_Object::RFR_Object_Obj22.AyVnce = 0;
  @CAN_RadarFR::RFR_Object::RFR_Object_Obj22.ExistProb = 0;
  @CAN_RadarFR::RFR_Object::RFR_Object_Obj22.FilterInformation = 0;
  @CAN_RadarFR::RFR_Object::RFR_Object_Obj22.Length = 0;
  @CAN_RadarFR::RFR_Object::RFR_Object_Obj22.LengthVnce = 0;
  @CAN_RadarFR::RFR_Object::RFR_Object_Obj22.MeasurementStatus = 0;
  @CAN_RadarFR::RFR_Object::RFR_Object_Obj22.MovingStatus = 0;
  @CAN_RadarFR::RFR_Object::RFR_Object_Obj22.ObjId = 0;
  @CAN_RadarFR::RFR_Object::RFR_Object_Obj22.OrientationYaw = 0;
  @CAN_RadarFR::RFR_Object::RFR_Object_Obj22.OrientationYawVnce = 0;
  @CAN_RadarFR::RFR_Object::RFR_Object_Obj22.ProbClassConfidence = 0;
  }
  if(init_count == 24)
  {
  @CAN_RadarFR::RFR_Object::RFR_Object_Obj22.ProbClassType = 0;
  @CAN_RadarFR::RFR_Object::RFR_Object_Obj22.Px = 0;
  @CAN_RadarFR::RFR_Object::RFR_Object_Obj22.PxAxCoVnce = 0;
  @CAN_RadarFR::RFR_Object::RFR_Object_Obj22.PxAyCoVnce = 0;
  @CAN_RadarFR::RFR_Object::RFR_Object_Obj22.PxPyCoVnce = 0;
  @CAN_RadarFR::RFR_Object::RFR_Object_Obj22.PxVnce = 0;
  @CAN_RadarFR::RFR_Object::RFR_Object_Obj22.PxVxCoVnce = 0;
  @CAN_RadarFR::RFR_Object::RFR_Object_Obj22.PxVyCoVnce = 0;
  @CAN_RadarFR::RFR_Object::RFR_Object_Obj22.Py = 0;
  @CAN_RadarFR::RFR_Object::RFR_Object_Obj22.PyAxCoVnce = 0;
  @CAN_RadarFR::RFR_Object::RFR_Object_Obj22.PyAyCoVnce = 0;
  @CAN_RadarFR::RFR_Object::RFR_Object_Obj22.PyVnce = 0;
  @CAN_RadarFR::RFR_Object::RFR_Object_Obj22.PyVxCoVnce = 0;
  @CAN_RadarFR::RFR_Object::RFR_Object_Obj22.PyVyCoVnce = 0;
  @CAN_RadarFR::RFR_Object::RFR_Object_Obj22.ReferencePoint = 0;
  @CAN_RadarFR::RFR_Object::RFR_Object_Obj22.Vx = 0;
  @CAN_RadarFR::RFR_Object::RFR_Object_Obj22.VxAxCoVnce = 0;
  @CAN_RadarFR::RFR_Object::RFR_Object_Obj22.VxAyCoVnce = 0;
  @CAN_RadarFR::RFR_Object::RFR_Object_Obj22.VxVnce = 0;
  @CAN_RadarFR::RFR_Object::RFR_Object_Obj22.VxVyCoVnce = 0;
  @CAN_RadarFR::RFR_Object::RFR_Object_Obj22.Vy = 0;
  @CAN_RadarFR::RFR_Object::RFR_Object_Obj22.VyAxCoVnce = 0;
  @CAN_RadarFR::RFR_Object::RFR_Object_Obj22.VyAyCoVnce = 0;
  @CAN_RadarFR::RFR_Object::RFR_Object_Obj22.VyVnce = 0;
  @CAN_RadarFR::RFR_Object::RFR_Object_Obj22.Width = 0;
  }
  if(init_count == 25)
  {
  @CAN_RadarFR::RFR_Object::RFR_Object_Obj22.WidthVnce = 0;
  @CAN_RadarFR::RFR_Object::RFR_Object_Obj23.Age = 0;
  @CAN_RadarFR::RFR_Object::RFR_Object_Obj23.Ax = 0;
  @CAN_RadarFR::RFR_Object::RFR_Object_Obj23.AxAyCoVnce = 0;
  @CAN_RadarFR::RFR_Object::RFR_Object_Obj23.AxVnce = 0;
  @CAN_RadarFR::RFR_Object::RFR_Object_Obj23.Ay = 0;
  @CAN_RadarFR::RFR_Object::RFR_Object_Obj23.AyVnce = 0;
  @CAN_RadarFR::RFR_Object::RFR_Object_Obj23.ExistProb = 0;
  @CAN_RadarFR::RFR_Object::RFR_Object_Obj23.FilterInformation = 0;
  @CAN_RadarFR::RFR_Object::RFR_Object_Obj23.Length = 0;
  @CAN_RadarFR::RFR_Object::RFR_Object_Obj23.LengthVnce = 0;
  @CAN_RadarFR::RFR_Object::RFR_Object_Obj23.MeasurementStatus = 0;
  @CAN_RadarFR::RFR_Object::RFR_Object_Obj23.MovingStatus = 0;
  @CAN_RadarFR::RFR_Object::RFR_Object_Obj23.ObjId = 0;
  @CAN_RadarFR::RFR_Object::RFR_Object_Obj23.OrientationYaw = 0;
  @CAN_RadarFR::RFR_Object::RFR_Object_Obj23.OrientationYawVnce = 0;
  @CAN_RadarFR::RFR_Object::RFR_Object_Obj23.ProbClassConfidence = 0;
  @CAN_RadarFR::RFR_Object::RFR_Object_Obj23.ProbClassType = 0;
  @CAN_RadarFR::RFR_Object::RFR_Object_Obj23.Px = 0;
  @CAN_RadarFR::RFR_Object::RFR_Object_Obj23.PxAxCoVnce = 0;
  @CAN_RadarFR::RFR_Object::RFR_Object_Obj23.PxAyCoVnce = 0;
  @CAN_RadarFR::RFR_Object::RFR_Object_Obj23.PxPyCoVnce = 0;
  @CAN_RadarFR::RFR_Object::RFR_Object_Obj23.PxVnce = 0;
  @CAN_RadarFR::RFR_Object::RFR_Object_Obj23.PxVxCoVnce = 0;
  @CAN_RadarFR::RFR_Object::RFR_Object_Obj23.PxVyCoVnce = 0;
  }
  if(init_count == 26)
  {
  @CAN_RadarFR::RFR_Object::RFR_Object_Obj23.Py = 0;
  @CAN_RadarFR::RFR_Object::RFR_Object_Obj23.PyAxCoVnce = 0;
  @CAN_RadarFR::RFR_Object::RFR_Object_Obj23.PyAyCoVnce = 0;
  @CAN_RadarFR::RFR_Object::RFR_Object_Obj23.PyVnce = 0;
  @CAN_RadarFR::RFR_Object::RFR_Object_Obj23.PyVxCoVnce = 0;
  @CAN_RadarFR::RFR_Object::RFR_Object_Obj23.PyVyCoVnce = 0;
  @CAN_RadarFR::RFR_Object::RFR_Object_Obj23.ReferencePoint = 0;
  @CAN_RadarFR::RFR_Object::RFR_Object_Obj23.Vx = 0;
  @CAN_RadarFR::RFR_Object::RFR_Object_Obj23.VxAxCoVnce = 0;
  @CAN_RadarFR::RFR_Object::RFR_Object_Obj23.VxAyCoVnce = 0;
  @CAN_RadarFR::RFR_Object::RFR_Object_Obj23.VxVnce = 0;
  @CAN_RadarFR::RFR_Object::RFR_Object_Obj23.VxVyCoVnce = 0;
  @CAN_RadarFR::RFR_Object::RFR_Object_Obj23.Vy = 0;
  @CAN_RadarFR::RFR_Object::RFR_Object_Obj23.VyAxCoVnce = 0;
  @CAN_RadarFR::RFR_Object::RFR_Object_Obj23.VyAyCoVnce = 0;
  @CAN_RadarFR::RFR_Object::RFR_Object_Obj23.VyVnce = 0;
  @CAN_RadarFR::RFR_Object::RFR_Object_Obj23.Width = 0;
  @CAN_RadarFR::RFR_Object::RFR_Object_Obj23.WidthVnce = 0;
  @CAN_RadarFR::RFR_Object::RFR_Object_Obj24.Age = 0;
  @CAN_RadarFR::RFR_Object::RFR_Object_Obj24.Ax = 0;
  @CAN_RadarFR::RFR_Object::RFR_Object_Obj24.AxAyCoVnce = 0;
  @CAN_RadarFR::RFR_Object::RFR_Object_Obj24.AxVnce = 0;
  @CAN_RadarFR::RFR_Object::RFR_Object_Obj24.Ay = 0;
  @CAN_RadarFR::RFR_Object::RFR_Object_Obj24.AyVnce = 0;
  @CAN_RadarFR::RFR_Object::RFR_Object_Obj24.ExistProb = 0;
  }
  if(init_count == 27)
  {
  @CAN_RadarFR::RFR_Object::RFR_Object_Obj24.FilterInformation = 0;
  @CAN_RadarFR::RFR_Object::RFR_Object_Obj24.Length = 0;
  @CAN_RadarFR::RFR_Object::RFR_Object_Obj24.LengthVnce = 0;
  @CAN_RadarFR::RFR_Object::RFR_Object_Obj24.MeasurementStatus = 0;
  @CAN_RadarFR::RFR_Object::RFR_Object_Obj24.MovingStatus = 0;
  @CAN_RadarFR::RFR_Object::RFR_Object_Obj24.ObjId = 0;
  @CAN_RadarFR::RFR_Object::RFR_Object_Obj24.OrientationYaw = 0;
  @CAN_RadarFR::RFR_Object::RFR_Object_Obj24.OrientationYawVnce = 0;
  @CAN_RadarFR::RFR_Object::RFR_Object_Obj24.ProbClassConfidence = 0;
  @CAN_RadarFR::RFR_Object::RFR_Object_Obj24.ProbClassType = 0;
  @CAN_RadarFR::RFR_Object::RFR_Object_Obj24.Px = 0;
  @CAN_RadarFR::RFR_Object::RFR_Object_Obj24.PxAxCoVnce = 0;
  @CAN_RadarFR::RFR_Object::RFR_Object_Obj24.PxAyCoVnce = 0;
  @CAN_RadarFR::RFR_Object::RFR_Object_Obj24.PxPyCoVnce = 0;
  @CAN_RadarFR::RFR_Object::RFR_Object_Obj24.PxVnce = 0;
  @CAN_RadarFR::RFR_Object::RFR_Object_Obj24.PxVxCoVnce = 0;
  @CAN_RadarFR::RFR_Object::RFR_Object_Obj24.PxVyCoVnce = 0;
  @CAN_RadarFR::RFR_Object::RFR_Object_Obj24.Py = 0;
  @CAN_RadarFR::RFR_Object::RFR_Object_Obj24.PyAxCoVnce = 0;
  @CAN_RadarFR::RFR_Object::RFR_Object_Obj24.PyAyCoVnce = 0;
  @CAN_RadarFR::RFR_Object::RFR_Object_Obj24.PyVnce = 0;
  @CAN_RadarFR::RFR_Object::RFR_Object_Obj24.PyVxCoVnce = 0;
  @CAN_RadarFR::RFR_Object::RFR_Object_Obj24.PyVyCoVnce = 0;
  @CAN_RadarFR::RFR_Object::RFR_Object_Obj24.ReferencePoint = 0;
  @CAN_RadarFR::RFR_Object::RFR_Object_Obj24.Vx = 0;
  }
  if(init_count == 28)
  {
  @CAN_RadarFR::RFR_Object::RFR_Object_Obj24.VxAxCoVnce = 0;
  @CAN_RadarFR::RFR_Object::RFR_Object_Obj24.VxAyCoVnce = 0;
  @CAN_RadarFR::RFR_Object::RFR_Object_Obj24.VxVnce = 0;
  @CAN_RadarFR::RFR_Object::RFR_Object_Obj24.VxVyCoVnce = 0;
  @CAN_RadarFR::RFR_Object::RFR_Object_Obj24.Vy = 0;
  @CAN_RadarFR::RFR_Object::RFR_Object_Obj24.VyAxCoVnce = 0;
  @CAN_RadarFR::RFR_Object::RFR_Object_Obj24.VyAyCoVnce = 0;
  @CAN_RadarFR::RFR_Object::RFR_Object_Obj24.VyVnce = 0;
  @CAN_RadarFR::RFR_Object::RFR_Object_Obj24.Width = 0;
  @CAN_RadarFR::RFR_Object::RFR_Object_Obj24.WidthVnce = 0;
  @CAN_RadarFR::RFR_Object::RFR_Object_Obj25.Age = 0;
  @CAN_RadarFR::RFR_Object::RFR_Object_Obj25.Ax = 0;
  @CAN_RadarFR::RFR_Object::RFR_Object_Obj25.AxAyCoVnce = 0;
  @CAN_RadarFR::RFR_Object::RFR_Object_Obj25.AxVnce = 0;
  @CAN_RadarFR::RFR_Object::RFR_Object_Obj25.Ay = 0;
  @CAN_RadarFR::RFR_Object::RFR_Object_Obj25.AyVnce = 0;
  @CAN_RadarFR::RFR_Object::RFR_Object_Obj25.ExistProb = 0;
  @CAN_RadarFR::RFR_Object::RFR_Object_Obj25.FilterInformation = 0;
  @CAN_RadarFR::RFR_Object::RFR_Object_Obj25.Length = 0;
  @CAN_RadarFR::RFR_Object::RFR_Object_Obj25.LengthVnce = 0;
  @CAN_RadarFR::RFR_Object::RFR_Object_Obj25.MeasurementStatus = 0;
  @CAN_RadarFR::RFR_Object::RFR_Object_Obj25.MovingStatus = 0;
  @CAN_RadarFR::RFR_Object::RFR_Object_Obj25.ObjId = 0;
  @CAN_RadarFR::RFR_Object::RFR_Object_Obj25.OrientationYaw = 0;
  @CAN_RadarFR::RFR_Object::RFR_Object_Obj25.OrientationYawVnce = 0;
  }
  if(init_count == 29)
  {
  @CAN_RadarFR::RFR_Object::RFR_Object_Obj25.ProbClassConfidence = 0;
  @CAN_RadarFR::RFR_Object::RFR_Object_Obj25.ProbClassType = 0;
  @CAN_RadarFR::RFR_Object::RFR_Object_Obj25.Px = 0;
  @CAN_RadarFR::RFR_Object::RFR_Object_Obj25.PxAxCoVnce = 0;
  @CAN_RadarFR::RFR_Object::RFR_Object_Obj25.PxAyCoVnce = 0;
  @CAN_RadarFR::RFR_Object::RFR_Object_Obj25.PxPyCoVnce = 0;
  @CAN_RadarFR::RFR_Object::RFR_Object_Obj25.PxVnce = 0;
  @CAN_RadarFR::RFR_Object::RFR_Object_Obj25.PxVxCoVnce = 0;
  @CAN_RadarFR::RFR_Object::RFR_Object_Obj25.PxVyCoVnce = 0;
  @CAN_RadarFR::RFR_Object::RFR_Object_Obj25.Py = 0;
  @CAN_RadarFR::RFR_Object::RFR_Object_Obj25.PyAxCoVnce = 0;
  @CAN_RadarFR::RFR_Object::RFR_Object_Obj25.PyAyCoVnce = 0;
  @CAN_RadarFR::RFR_Object::RFR_Object_Obj25.PyVnce = 0;
  @CAN_RadarFR::RFR_Object::RFR_Object_Obj25.PyVxCoVnce = 0;
  @CAN_RadarFR::RFR_Object::RFR_Object_Obj25.PyVyCoVnce = 0;
  @CAN_RadarFR::RFR_Object::RFR_Object_Obj25.ReferencePoint = 0;
  @CAN_RadarFR::RFR_Object::RFR_Object_Obj25.Vx = 0;
  @CAN_RadarFR::RFR_Object::RFR_Object_Obj25.VxAxCoVnce = 0;
  @CAN_RadarFR::RFR_Object::RFR_Object_Obj25.VxAyCoVnce = 0;
  @CAN_RadarFR::RFR_Object::RFR_Object_Obj25.VxVnce = 0;
  @CAN_RadarFR::RFR_Object::RFR_Object_Obj25.VxVyCoVnce = 0;
  @CAN_RadarFR::RFR_Object::RFR_Object_Obj25.Vy = 0;
  @CAN_RadarFR::RFR_Object::RFR_Object_Obj25.VyAxCoVnce = 0;
  @CAN_RadarFR::RFR_Object::RFR_Object_Obj25.VyAyCoVnce = 0;
  @CAN_RadarFR::RFR_Object::RFR_Object_Obj25.VyVnce = 0;
  }
  if(init_count == 30)
  {
  @CAN_RadarFR::RFR_Object::RFR_Object_Obj25.Width = 0;
  @CAN_RadarFR::RFR_Object::RFR_Object_Obj25.WidthVnce = 0;
  @CAN_RadarFR::RFR_Object::RFR_Object_Obj26.Age = 0;
  @CAN_RadarFR::RFR_Object::RFR_Object_Obj26.Ax = 0;
  @CAN_RadarFR::RFR_Object::RFR_Object_Obj26.AxAyCoVnce = 0;
  @CAN_RadarFR::RFR_Object::RFR_Object_Obj26.AxVnce = 0;
  @CAN_RadarFR::RFR_Object::RFR_Object_Obj26.Ay = 0;
  @CAN_RadarFR::RFR_Object::RFR_Object_Obj26.AyVnce = 0;
  @CAN_RadarFR::RFR_Object::RFR_Object_Obj26.ExistProb = 0;
  @CAN_RadarFR::RFR_Object::RFR_Object_Obj26.FilterInformation = 0;
  @CAN_RadarFR::RFR_Object::RFR_Object_Obj26.Length = 0;
  @CAN_RadarFR::RFR_Object::RFR_Object_Obj26.LengthVnce = 0;
  @CAN_RadarFR::RFR_Object::RFR_Object_Obj26.MeasurementStatus = 0;
  @CAN_RadarFR::RFR_Object::RFR_Object_Obj26.MovingStatus = 0;
  @CAN_RadarFR::RFR_Object::RFR_Object_Obj26.ObjId = 0;
  @CAN_RadarFR::RFR_Object::RFR_Object_Obj26.OrientationYaw = 0;
  @CAN_RadarFR::RFR_Object::RFR_Object_Obj26.OrientationYawVnce = 0;
  @CAN_RadarFR::RFR_Object::RFR_Object_Obj26.ProbClassConfidence = 0;
  @CAN_RadarFR::RFR_Object::RFR_Object_Obj26.ProbClassType = 0;
  @CAN_RadarFR::RFR_Object::RFR_Object_Obj26.Px = 0;
  @CAN_RadarFR::RFR_Object::RFR_Object_Obj26.PxAxCoVnce = 0;
  @CAN_RadarFR::RFR_Object::RFR_Object_Obj26.PxAyCoVnce = 0;
  @CAN_RadarFR::RFR_Object::RFR_Object_Obj26.PxPyCoVnce = 0;
  @CAN_RadarFR::RFR_Object::RFR_Object_Obj26.PxVnce = 0;
  @CAN_RadarFR::RFR_Object::RFR_Object_Obj26.PxVxCoVnce = 0;
  }
  if(init_count == 31)
  {
  @CAN_RadarFR::RFR_Object::RFR_Object_Obj26.PxVyCoVnce = 0;
  @CAN_RadarFR::RFR_Object::RFR_Object_Obj26.Py = 0;
  @CAN_RadarFR::RFR_Object::RFR_Object_Obj26.PyAxCoVnce = 0;
  @CAN_RadarFR::RFR_Object::RFR_Object_Obj26.PyAyCoVnce = 0;
  @CAN_RadarFR::RFR_Object::RFR_Object_Obj26.PyVnce = 0;
  @CAN_RadarFR::RFR_Object::RFR_Object_Obj26.PyVxCoVnce = 0;
  @CAN_RadarFR::RFR_Object::RFR_Object_Obj26.PyVyCoVnce = 0;
  @CAN_RadarFR::RFR_Object::RFR_Object_Obj26.ReferencePoint = 0;
  @CAN_RadarFR::RFR_Object::RFR_Object_Obj26.Vx = 0;
  @CAN_RadarFR::RFR_Object::RFR_Object_Obj26.VxAxCoVnce = 0;
  @CAN_RadarFR::RFR_Object::RFR_Object_Obj26.VxAyCoVnce = 0;
  @CAN_RadarFR::RFR_Object::RFR_Object_Obj26.VxVnce = 0;
  @CAN_RadarFR::RFR_Object::RFR_Object_Obj26.VxVyCoVnce = 0;
  @CAN_RadarFR::RFR_Object::RFR_Object_Obj26.Vy = 0;
  @CAN_RadarFR::RFR_Object::RFR_Object_Obj26.VyAxCoVnce = 0;
  @CAN_RadarFR::RFR_Object::RFR_Object_Obj26.VyAyCoVnce = 0;
  @CAN_RadarFR::RFR_Object::RFR_Object_Obj26.VyVnce = 0;
  @CAN_RadarFR::RFR_Object::RFR_Object_Obj26.Width = 0;
  @CAN_RadarFR::RFR_Object::RFR_Object_Obj26.WidthVnce = 0;
  @CAN_RadarFR::RFR_Object::RFR_Object_Obj27.Age = 0;
  @CAN_RadarFR::RFR_Object::RFR_Object_Obj27.Ax = 0;
  @CAN_RadarFR::RFR_Object::RFR_Object_Obj27.AxAyCoVnce = 0;
  @CAN_RadarFR::RFR_Object::RFR_Object_Obj27.AxVnce = 0;
  @CAN_RadarFR::RFR_Object::RFR_Object_Obj27.Ay = 0;
  @CAN_RadarFR::RFR_Object::RFR_Object_Obj27.AyVnce = 0;
  }
  if(init_count == 32)
  {
  @CAN_RadarFR::RFR_Object::RFR_Object_Obj27.ExistProb = 0;
  @CAN_RadarFR::RFR_Object::RFR_Object_Obj27.FilterInformation = 0;
  @CAN_RadarFR::RFR_Object::RFR_Object_Obj27.Length = 0;
  @CAN_RadarFR::RFR_Object::RFR_Object_Obj27.LengthVnce = 0;
  @CAN_RadarFR::RFR_Object::RFR_Object_Obj27.MeasurementStatus = 0;
  @CAN_RadarFR::RFR_Object::RFR_Object_Obj27.MovingStatus = 0;
  @CAN_RadarFR::RFR_Object::RFR_Object_Obj27.ObjId = 0;
  @CAN_RadarFR::RFR_Object::RFR_Object_Obj27.OrientationYaw = 0;
  @CAN_RadarFR::RFR_Object::RFR_Object_Obj27.OrientationYawVnce = 0;
  @CAN_RadarFR::RFR_Object::RFR_Object_Obj27.ProbClassConfidence = 0;
  @CAN_RadarFR::RFR_Object::RFR_Object_Obj27.ProbClassType = 0;
  @CAN_RadarFR::RFR_Object::RFR_Object_Obj27.Px = 0;
  @CAN_RadarFR::RFR_Object::RFR_Object_Obj27.PxAxCoVnce = 0;
  @CAN_RadarFR::RFR_Object::RFR_Object_Obj27.PxAyCoVnce = 0;
  @CAN_RadarFR::RFR_Object::RFR_Object_Obj27.PxPyCoVnce = 0;
  @CAN_RadarFR::RFR_Object::RFR_Object_Obj27.PxVnce = 0;
  @CAN_RadarFR::RFR_Object::RFR_Object_Obj27.PxVxCoVnce = 0;
  @CAN_RadarFR::RFR_Object::RFR_Object_Obj27.PxVyCoVnce = 0;
  @CAN_RadarFR::RFR_Object::RFR_Object_Obj27.Py = 0;
  @CAN_RadarFR::RFR_Object::RFR_Object_Obj27.PyAxCoVnce = 0;
  @CAN_RadarFR::RFR_Object::RFR_Object_Obj27.PyAyCoVnce = 0;
  @CAN_RadarFR::RFR_Object::RFR_Object_Obj27.PyVnce = 0;
  @CAN_RadarFR::RFR_Object::RFR_Object_Obj27.PyVxCoVnce = 0;
  @CAN_RadarFR::RFR_Object::RFR_Object_Obj27.PyVyCoVnce = 0;
  @CAN_RadarFR::RFR_Object::RFR_Object_Obj27.ReferencePoint = 0;
  }
  if(init_count == 33)
  {
  @CAN_RadarFR::RFR_Object::RFR_Object_Obj27.Vx = 0;
  @CAN_RadarFR::RFR_Object::RFR_Object_Obj27.VxAxCoVnce = 0;
  @CAN_RadarFR::RFR_Object::RFR_Object_Obj27.VxAyCoVnce = 0;
  @CAN_RadarFR::RFR_Object::RFR_Object_Obj27.VxVnce = 0;
  @CAN_RadarFR::RFR_Object::RFR_Object_Obj27.VxVyCoVnce = 0;
  @CAN_RadarFR::RFR_Object::RFR_Object_Obj27.Vy = 0;
  @CAN_RadarFR::RFR_Object::RFR_Object_Obj27.VyAxCoVnce = 0;
  @CAN_RadarFR::RFR_Object::RFR_Object_Obj27.VyAyCoVnce = 0;
  @CAN_RadarFR::RFR_Object::RFR_Object_Obj27.VyVnce = 0;
  @CAN_RadarFR::RFR_Object::RFR_Object_Obj27.Width = 0;
  @CAN_RadarFR::RFR_Object::RFR_Object_Obj27.WidthVnce = 0;
  @CAN_RadarFR::RFR_Object::RFR_Object_Obj28.Age = 0;
  @CAN_RadarFR::RFR_Object::RFR_Object_Obj28.Ax = 0;
  @CAN_RadarFR::RFR_Object::RFR_Object_Obj28.AxAyCoVnce = 0;
  @CAN_RadarFR::RFR_Object::RFR_Object_Obj28.AxVnce = 0;
  @CAN_RadarFR::RFR_Object::RFR_Object_Obj28.Ay = 0;
  @CAN_RadarFR::RFR_Object::RFR_Object_Obj28.AyVnce = 0;
  @CAN_RadarFR::RFR_Object::RFR_Object_Obj28.ExistProb = 0;
  @CAN_RadarFR::RFR_Object::RFR_Object_Obj28.FilterInformation = 0;
  @CAN_RadarFR::RFR_Object::RFR_Object_Obj28.Length = 0;
  @CAN_RadarFR::RFR_Object::RFR_Object_Obj28.LengthVnce = 0;
  @CAN_RadarFR::RFR_Object::RFR_Object_Obj28.MeasurementStatus = 0;
  @CAN_RadarFR::RFR_Object::RFR_Object_Obj28.MovingStatus = 0;
  @CAN_RadarFR::RFR_Object::RFR_Object_Obj28.ObjId = 0;
  @CAN_RadarFR::RFR_Object::RFR_Object_Obj28.OrientationYaw = 0;
  }
  if(init_count == 34)
  {
  @CAN_RadarFR::RFR_Object::RFR_Object_Obj28.OrientationYawVnce = 0;
  @CAN_RadarFR::RFR_Object::RFR_Object_Obj28.ProbClassConfidence = 0;
  @CAN_RadarFR::RFR_Object::RFR_Object_Obj28.ProbClassType = 0;
  @CAN_RadarFR::RFR_Object::RFR_Object_Obj28.Px = 0;
  @CAN_RadarFR::RFR_Object::RFR_Object_Obj28.PxAxCoVnce = 0;
  @CAN_RadarFR::RFR_Object::RFR_Object_Obj28.PxAyCoVnce = 0;
  @CAN_RadarFR::RFR_Object::RFR_Object_Obj28.PxPyCoVnce = 0;
  @CAN_RadarFR::RFR_Object::RFR_Object_Obj28.PxVnce = 0;
  @CAN_RadarFR::RFR_Object::RFR_Object_Obj28.PxVxCoVnce = 0;
  @CAN_RadarFR::RFR_Object::RFR_Object_Obj28.PxVyCoVnce = 0;
  @CAN_RadarFR::RFR_Object::RFR_Object_Obj28.Py = 0;
  @CAN_RadarFR::RFR_Object::RFR_Object_Obj28.PyAxCoVnce = 0;
  @CAN_RadarFR::RFR_Object::RFR_Object_Obj28.PyAyCoVnce = 0;
  @CAN_RadarFR::RFR_Object::RFR_Object_Obj28.PyVnce = 0;
  @CAN_RadarFR::RFR_Object::RFR_Object_Obj28.PyVxCoVnce = 0;
  @CAN_RadarFR::RFR_Object::RFR_Object_Obj28.PyVyCoVnce = 0;
  @CAN_RadarFR::RFR_Object::RFR_Object_Obj28.ReferencePoint = 0;
  @CAN_RadarFR::RFR_Object::RFR_Object_Obj28.Vx = 0;
  @CAN_RadarFR::RFR_Object::RFR_Object_Obj28.VxAxCoVnce = 0;
  @CAN_RadarFR::RFR_Object::RFR_Object_Obj28.VxAyCoVnce = 0;
  @CAN_RadarFR::RFR_Object::RFR_Object_Obj28.VxVnce = 0;
  @CAN_RadarFR::RFR_Object::RFR_Object_Obj28.VxVyCoVnce = 0;
  @CAN_RadarFR::RFR_Object::RFR_Object_Obj28.Vy = 0;
  @CAN_RadarFR::RFR_Object::RFR_Object_Obj28.VyAxCoVnce = 0;
  @CAN_RadarFR::RFR_Object::RFR_Object_Obj28.VyAyCoVnce = 0;
  }
  if(init_count == 35)
  {
  @CAN_RadarFR::RFR_Object::RFR_Object_Obj28.VyVnce = 0;
  @CAN_RadarFR::RFR_Object::RFR_Object_Obj28.Width = 0;
  @CAN_RadarFR::RFR_Object::RFR_Object_Obj28.WidthVnce = 0;
  @CAN_RadarFR::RFR_Object::RFR_Object_Obj29.Age = 0;
  @CAN_RadarFR::RFR_Object::RFR_Object_Obj29.Ax = 0;
  @CAN_RadarFR::RFR_Object::RFR_Object_Obj29.AxAyCoVnce = 0;
  @CAN_RadarFR::RFR_Object::RFR_Object_Obj29.AxVnce = 0;
  @CAN_RadarFR::RFR_Object::RFR_Object_Obj29.Ay = 0;
  @CAN_RadarFR::RFR_Object::RFR_Object_Obj29.AyVnce = 0;
  @CAN_RadarFR::RFR_Object::RFR_Object_Obj29.ExistProb = 0;
  @CAN_RadarFR::RFR_Object::RFR_Object_Obj29.FilterInformation = 0;
  @CAN_RadarFR::RFR_Object::RFR_Object_Obj29.Length = 0;
  @CAN_RadarFR::RFR_Object::RFR_Object_Obj29.LengthVnce = 0;
  @CAN_RadarFR::RFR_Object::RFR_Object_Obj29.MeasurementStatus = 0;
  @CAN_RadarFR::RFR_Object::RFR_Object_Obj29.MovingStatus = 0;
  @CAN_RadarFR::RFR_Object::RFR_Object_Obj29.ObjId = 0;
  @CAN_RadarFR::RFR_Object::RFR_Object_Obj29.OrientationYaw = 0;
  @CAN_RadarFR::RFR_Object::RFR_Object_Obj29.OrientationYawVnce = 0;
  @CAN_RadarFR::RFR_Object::RFR_Object_Obj29.ProbClassConfidence = 0;
  @CAN_RadarFR::RFR_Object::RFR_Object_Obj29.ProbClassType = 0;
  @CAN_RadarFR::RFR_Object::RFR_Object_Obj29.Px = 0;
  @CAN_RadarFR::RFR_Object::RFR_Object_Obj29.PxAxCoVnce = 0;
  @CAN_RadarFR::RFR_Object::RFR_Object_Obj29.PxAyCoVnce = 0;
  @CAN_RadarFR::RFR_Object::RFR_Object_Obj29.PxPyCoVnce = 0;
  @CAN_RadarFR::RFR_Object::RFR_Object_Obj29.PxVnce = 0;
  }
  if(init_count == 36)
  {
  @CAN_RadarFR::RFR_Object::RFR_Object_Obj29.PxVxCoVnce = 0;
  @CAN_RadarFR::RFR_Object::RFR_Object_Obj29.PxVyCoVnce = 0;
  @CAN_RadarFR::RFR_Object::RFR_Object_Obj29.Py = 0;
  @CAN_RadarFR::RFR_Object::RFR_Object_Obj29.PyAxCoVnce = 0;
  @CAN_RadarFR::RFR_Object::RFR_Object_Obj29.PyAyCoVnce = 0;
  @CAN_RadarFR::RFR_Object::RFR_Object_Obj29.PyVnce = 0;
  @CAN_RadarFR::RFR_Object::RFR_Object_Obj29.PyVxCoVnce = 0;
  @CAN_RadarFR::RFR_Object::RFR_Object_Obj29.PyVyCoVnce = 0;
  @CAN_RadarFR::RFR_Object::RFR_Object_Obj29.ReferencePoint = 0;
  @CAN_RadarFR::RFR_Object::RFR_Object_Obj29.Vx = 0;
  @CAN_RadarFR::RFR_Object::RFR_Object_Obj29.VxAxCoVnce = 0;
  @CAN_RadarFR::RFR_Object::RFR_Object_Obj29.VxAyCoVnce = 0;
  @CAN_RadarFR::RFR_Object::RFR_Object_Obj29.VxVnce = 0;
  @CAN_RadarFR::RFR_Object::RFR_Object_Obj29.VxVyCoVnce = 0;
  @CAN_RadarFR::RFR_Object::RFR_Object_Obj29.Vy = 0;
  @CAN_RadarFR::RFR_Object::RFR_Object_Obj29.VyAxCoVnce = 0;
  @CAN_RadarFR::RFR_Object::RFR_Object_Obj29.VyAyCoVnce = 0;
  @CAN_RadarFR::RFR_Object::RFR_Object_Obj29.VyVnce = 0;
  @CAN_RadarFR::RFR_Object::RFR_Object_Obj29.Width = 0;
  @CAN_RadarFR::RFR_Object::RFR_Object_Obj29.WidthVnce = 0;
  @CAN_RadarFR::RFR_Object::RFR_Object_Obj2.Age = 0;
  @CAN_RadarFR::RFR_Object::RFR_Object_Obj2.Ax = 0;
  @CAN_RadarFR::RFR_Object::RFR_Object_Obj2.AxAyCoVnce = 0;
  @CAN_RadarFR::RFR_Object::RFR_Object_Obj2.AxVnce = 0;
  @CAN_RadarFR::RFR_Object::RFR_Object_Obj2.Ay = 0;
  }
  if(init_count == 37)
  {
  @CAN_RadarFR::RFR_Object::RFR_Object_Obj2.AyVnce = 0;
  @CAN_RadarFR::RFR_Object::RFR_Object_Obj2.ExistProb = 0;
  @CAN_RadarFR::RFR_Object::RFR_Object_Obj2.FilterInformation = 0;
  @CAN_RadarFR::RFR_Object::RFR_Object_Obj2.Length = 0;
  @CAN_RadarFR::RFR_Object::RFR_Object_Obj2.LengthVnce = 0;
  @CAN_RadarFR::RFR_Object::RFR_Object_Obj2.MeasurementStatus = 0;
  @CAN_RadarFR::RFR_Object::RFR_Object_Obj2.MovingStatus = 0;
  @CAN_RadarFR::RFR_Object::RFR_Object_Obj2.ObjId = 0;
  @CAN_RadarFR::RFR_Object::RFR_Object_Obj2.OrientationYaw = 0;
  @CAN_RadarFR::RFR_Object::RFR_Object_Obj2.OrientationYawVnce = 0;
  @CAN_RadarFR::RFR_Object::RFR_Object_Obj2.ProbClassConfidence = 0;
  @CAN_RadarFR::RFR_Object::RFR_Object_Obj2.ProbClassType = 0;
  @CAN_RadarFR::RFR_Object::RFR_Object_Obj2.Px = 0;
  @CAN_RadarFR::RFR_Object::RFR_Object_Obj2.PxAxCoVnce = 0;
  @CAN_RadarFR::RFR_Object::RFR_Object_Obj2.PxAyCoVnce = 0;
  @CAN_RadarFR::RFR_Object::RFR_Object_Obj2.PxPyCoVnce = 0;
  @CAN_RadarFR::RFR_Object::RFR_Object_Obj2.PxVnce = 0;
  @CAN_RadarFR::RFR_Object::RFR_Object_Obj2.PxVxCoVnce = 0;
  @CAN_RadarFR::RFR_Object::RFR_Object_Obj2.PxVyCoVnce = 0;
  @CAN_RadarFR::RFR_Object::RFR_Object_Obj2.Py = 0;
  @CAN_RadarFR::RFR_Object::RFR_Object_Obj2.PyAxCoVnce = 0;
  @CAN_RadarFR::RFR_Object::RFR_Object_Obj2.PyAyCoVnce = 0;
  @CAN_RadarFR::RFR_Object::RFR_Object_Obj2.PyVnce = 0;
  @CAN_RadarFR::RFR_Object::RFR_Object_Obj2.PyVxCoVnce = 0;
  @CAN_RadarFR::RFR_Object::RFR_Object_Obj2.PyVyCoVnce = 0;
  }
  if(init_count == 38)
  {
  @CAN_RadarFR::RFR_Object::RFR_Object_Obj2.ReferencePoint = 0;
  @CAN_RadarFR::RFR_Object::RFR_Object_Obj2.Vx = 0;
  @CAN_RadarFR::RFR_Object::RFR_Object_Obj2.VxAxCoVnce = 0;
  @CAN_RadarFR::RFR_Object::RFR_Object_Obj2.VxAyCoVnce = 0;
  @CAN_RadarFR::RFR_Object::RFR_Object_Obj2.VxVnce = 0;
  @CAN_RadarFR::RFR_Object::RFR_Object_Obj2.VxVyCoVnce = 0;
  @CAN_RadarFR::RFR_Object::RFR_Object_Obj2.Vy = 0;
  @CAN_RadarFR::RFR_Object::RFR_Object_Obj2.VyAxCoVnce = 0;
  @CAN_RadarFR::RFR_Object::RFR_Object_Obj2.VyAyCoVnce = 0;
  @CAN_RadarFR::RFR_Object::RFR_Object_Obj2.VyVnce = 0;
  @CAN_RadarFR::RFR_Object::RFR_Object_Obj2.Width = 0;
  @CAN_RadarFR::RFR_Object::RFR_Object_Obj2.WidthVnce = 0;
  @CAN_RadarFR::RFR_Object::RFR_Object_Obj30.Age = 0;
  @CAN_RadarFR::RFR_Object::RFR_Object_Obj30.Ax = 0;
  @CAN_RadarFR::RFR_Object::RFR_Object_Obj30.AxAyCoVnce = 0;
  @CAN_RadarFR::RFR_Object::RFR_Object_Obj30.AxVnce = 0;
  @CAN_RadarFR::RFR_Object::RFR_Object_Obj30.Ay = 0;
  @CAN_RadarFR::RFR_Object::RFR_Object_Obj30.AyVnce = 0;
  @CAN_RadarFR::RFR_Object::RFR_Object_Obj30.ExistProb = 0;
  @CAN_RadarFR::RFR_Object::RFR_Object_Obj30.FilterInformation = 0;
  @CAN_RadarFR::RFR_Object::RFR_Object_Obj30.Length = 0;
  @CAN_RadarFR::RFR_Object::RFR_Object_Obj30.LengthVnce = 0;
  @CAN_RadarFR::RFR_Object::RFR_Object_Obj30.MeasurementStatus = 0;
  @CAN_RadarFR::RFR_Object::RFR_Object_Obj30.MovingStatus = 0;
  @CAN_RadarFR::RFR_Object::RFR_Object_Obj30.ObjId = 0;
  }
  if(init_count == 39)
  {
  @CAN_RadarFR::RFR_Object::RFR_Object_Obj30.OrientationYaw = 0;
  @CAN_RadarFR::RFR_Object::RFR_Object_Obj30.OrientationYawVnce = 0;
  @CAN_RadarFR::RFR_Object::RFR_Object_Obj30.ProbClassConfidence = 0;
  @CAN_RadarFR::RFR_Object::RFR_Object_Obj30.ProbClassType = 0;
  @CAN_RadarFR::RFR_Object::RFR_Object_Obj30.Px = 0;
  @CAN_RadarFR::RFR_Object::RFR_Object_Obj30.PxAxCoVnce = 0;
  @CAN_RadarFR::RFR_Object::RFR_Object_Obj30.PxAyCoVnce = 0;
  @CAN_RadarFR::RFR_Object::RFR_Object_Obj30.PxPyCoVnce = 0;
  @CAN_RadarFR::RFR_Object::RFR_Object_Obj30.PxVnce = 0;
  @CAN_RadarFR::RFR_Object::RFR_Object_Obj30.PxVxCoVnce = 0;
  @CAN_RadarFR::RFR_Object::RFR_Object_Obj30.PxVyCoVnce = 0;
  @CAN_RadarFR::RFR_Object::RFR_Object_Obj30.Py = 0;
  @CAN_RadarFR::RFR_Object::RFR_Object_Obj30.PyAxCoVnce = 0;
  @CAN_RadarFR::RFR_Object::RFR_Object_Obj30.PyAyCoVnce = 0;
  @CAN_RadarFR::RFR_Object::RFR_Object_Obj30.PyVnce = 0;
  @CAN_RadarFR::RFR_Object::RFR_Object_Obj30.PyVxCoVnce = 0;
  @CAN_RadarFR::RFR_Object::RFR_Object_Obj30.PyVyCoVnce = 0;
  @CAN_RadarFR::RFR_Object::RFR_Object_Obj30.ReferencePoint = 0;
  @CAN_RadarFR::RFR_Object::RFR_Object_Obj30.Vx = 0;
  @CAN_RadarFR::RFR_Object::RFR_Object_Obj30.VxAxCoVnce = 0;
  @CAN_RadarFR::RFR_Object::RFR_Object_Obj30.VxAyCoVnce = 0;
  @CAN_RadarFR::RFR_Object::RFR_Object_Obj30.VxVnce = 0;
  @CAN_RadarFR::RFR_Object::RFR_Object_Obj30.VxVyCoVnce = 0;
  @CAN_RadarFR::RFR_Object::RFR_Object_Obj30.Vy = 0;
  @CAN_RadarFR::RFR_Object::RFR_Object_Obj30.VyAxCoVnce = 0;
  }
  if(init_count == 40)
  {
  @CAN_RadarFR::RFR_Object::RFR_Object_Obj30.VyAyCoVnce = 0;
  @CAN_RadarFR::RFR_Object::RFR_Object_Obj30.VyVnce = 0;
  @CAN_RadarFR::RFR_Object::RFR_Object_Obj30.Width = 0;
  @CAN_RadarFR::RFR_Object::RFR_Object_Obj30.WidthVnce = 0;
  @CAN_RadarFR::RFR_Object::RFR_Object_Obj31.Age = 0;
  @CAN_RadarFR::RFR_Object::RFR_Object_Obj31.Ax = 0;
  @CAN_RadarFR::RFR_Object::RFR_Object_Obj31.AxAyCoVnce = 0;
  @CAN_RadarFR::RFR_Object::RFR_Object_Obj31.AxVnce = 0;
  @CAN_RadarFR::RFR_Object::RFR_Object_Obj31.Ay = 0;
  @CAN_RadarFR::RFR_Object::RFR_Object_Obj31.AyVnce = 0;
  @CAN_RadarFR::RFR_Object::RFR_Object_Obj31.ExistProb = 0;
  @CAN_RadarFR::RFR_Object::RFR_Object_Obj31.FilterInformation = 0;
  @CAN_RadarFR::RFR_Object::RFR_Object_Obj31.Length = 0;
  @CAN_RadarFR::RFR_Object::RFR_Object_Obj31.LengthVnce = 0;
  @CAN_RadarFR::RFR_Object::RFR_Object_Obj31.MeasurementStatus = 0;
  @CAN_RadarFR::RFR_Object::RFR_Object_Obj31.MovingStatus = 0;
  @CAN_RadarFR::RFR_Object::RFR_Object_Obj31.ObjId = 0;
  @CAN_RadarFR::RFR_Object::RFR_Object_Obj31.OrientationYaw = 0;
  @CAN_RadarFR::RFR_Object::RFR_Object_Obj31.OrientationYawVnce = 0;
  @CAN_RadarFR::RFR_Object::RFR_Object_Obj31.ProbClassConfidence = 0;
  @CAN_RadarFR::RFR_Object::RFR_Object_Obj31.ProbClassType = 0;
  @CAN_RadarFR::RFR_Object::RFR_Object_Obj31.Px = 0;
  @CAN_RadarFR::RFR_Object::RFR_Object_Obj31.PxAxCoVnce = 0;
  @CAN_RadarFR::RFR_Object::RFR_Object_Obj31.PxAyCoVnce = 0;
  @CAN_RadarFR::RFR_Object::RFR_Object_Obj31.PxPyCoVnce = 0;
  }
  if(init_count == 41)
  {
  @CAN_RadarFR::RFR_Object::RFR_Object_Obj31.PxVnce = 0;
  @CAN_RadarFR::RFR_Object::RFR_Object_Obj31.PxVxCoVnce = 0;
  @CAN_RadarFR::RFR_Object::RFR_Object_Obj31.PxVyCoVnce = 0;
  @CAN_RadarFR::RFR_Object::RFR_Object_Obj31.Py = 0;
  @CAN_RadarFR::RFR_Object::RFR_Object_Obj31.PyAxCoVnce = 0;
  @CAN_RadarFR::RFR_Object::RFR_Object_Obj31.PyAyCoVnce = 0;
  @CAN_RadarFR::RFR_Object::RFR_Object_Obj31.PyVnce = 0;
  @CAN_RadarFR::RFR_Object::RFR_Object_Obj31.PyVxCoVnce = 0;
  @CAN_RadarFR::RFR_Object::RFR_Object_Obj31.PyVyCoVnce = 0;
  @CAN_RadarFR::RFR_Object::RFR_Object_Obj31.ReferencePoint = 0;
  @CAN_RadarFR::RFR_Object::RFR_Object_Obj31.Vx = 0;
  @CAN_RadarFR::RFR_Object::RFR_Object_Obj31.VxAxCoVnce = 0;
  @CAN_RadarFR::RFR_Object::RFR_Object_Obj31.VxAyCoVnce = 0;
  @CAN_RadarFR::RFR_Object::RFR_Object_Obj31.VxVnce = 0;
  @CAN_RadarFR::RFR_Object::RFR_Object_Obj31.VxVyCoVnce = 0;
  @CAN_RadarFR::RFR_Object::RFR_Object_Obj31.Vy = 0;
  @CAN_RadarFR::RFR_Object::RFR_Object_Obj31.VyAxCoVnce = 0;
  @CAN_RadarFR::RFR_Object::RFR_Object_Obj31.VyAyCoVnce = 0;
  @CAN_RadarFR::RFR_Object::RFR_Object_Obj31.VyVnce = 0;
  @CAN_RadarFR::RFR_Object::RFR_Object_Obj31.Width = 0;
  @CAN_RadarFR::RFR_Object::RFR_Object_Obj31.WidthVnce = 0;
  @CAN_RadarFR::RFR_Object::RFR_Object_Obj32.Age = 0;
  @CAN_RadarFR::RFR_Object::RFR_Object_Obj32.Ax = 0;
  @CAN_RadarFR::RFR_Object::RFR_Object_Obj32.AxAyCoVnce = 0;
  @CAN_RadarFR::RFR_Object::RFR_Object_Obj32.AxVnce = 0;
  }
  if(init_count == 42)
  {
  @CAN_RadarFR::RFR_Object::RFR_Object_Obj32.Ay = 0;
  @CAN_RadarFR::RFR_Object::RFR_Object_Obj32.AyVnce = 0;
  @CAN_RadarFR::RFR_Object::RFR_Object_Obj32.ExistProb = 0;
  @CAN_RadarFR::RFR_Object::RFR_Object_Obj32.FilterInformation = 0;
  @CAN_RadarFR::RFR_Object::RFR_Object_Obj32.Length = 0;
  @CAN_RadarFR::RFR_Object::RFR_Object_Obj32.LengthVnce = 0;
  @CAN_RadarFR::RFR_Object::RFR_Object_Obj32.MeasurementStatus = 0;
  @CAN_RadarFR::RFR_Object::RFR_Object_Obj32.MovingStatus = 0;
  @CAN_RadarFR::RFR_Object::RFR_Object_Obj32.ObjId = 0;
  @CAN_RadarFR::RFR_Object::RFR_Object_Obj32.OrientationYaw = 0;
  @CAN_RadarFR::RFR_Object::RFR_Object_Obj32.OrientationYawVnce = 0;
  @CAN_RadarFR::RFR_Object::RFR_Object_Obj32.ProbClassConfidence = 0;
  @CAN_RadarFR::RFR_Object::RFR_Object_Obj32.ProbClassType = 0;
  @CAN_RadarFR::RFR_Object::RFR_Object_Obj32.Px = 0;
  @CAN_RadarFR::RFR_Object::RFR_Object_Obj32.PxAxCoVnce = 0;
  @CAN_RadarFR::RFR_Object::RFR_Object_Obj32.PxAyCoVnce = 0;
  @CAN_RadarFR::RFR_Object::RFR_Object_Obj32.PxPyCoVnce = 0;
  @CAN_RadarFR::RFR_Object::RFR_Object_Obj32.PxVnce = 0;
  @CAN_RadarFR::RFR_Object::RFR_Object_Obj32.PxVxCoVnce = 0;
  @CAN_RadarFR::RFR_Object::RFR_Object_Obj32.PxVyCoVnce = 0;
  @CAN_RadarFR::RFR_Object::RFR_Object_Obj32.Py = 0;
  @CAN_RadarFR::RFR_Object::RFR_Object_Obj32.PyAxCoVnce = 0;
  @CAN_RadarFR::RFR_Object::RFR_Object_Obj32.PyAyCoVnce = 0;
  @CAN_RadarFR::RFR_Object::RFR_Object_Obj32.PyVnce = 0;
  @CAN_RadarFR::RFR_Object::RFR_Object_Obj32.PyVxCoVnce = 0;
  }
  if(init_count == 43)
  {
  @CAN_RadarFR::RFR_Object::RFR_Object_Obj32.PyVyCoVnce = 0;
  @CAN_RadarFR::RFR_Object::RFR_Object_Obj32.ReferencePoint = 0;
  @CAN_RadarFR::RFR_Object::RFR_Object_Obj32.Vx = 0;
  @CAN_RadarFR::RFR_Object::RFR_Object_Obj32.VxAxCoVnce = 0;
  @CAN_RadarFR::RFR_Object::RFR_Object_Obj32.VxAyCoVnce = 0;
  @CAN_RadarFR::RFR_Object::RFR_Object_Obj32.VxVnce = 0;
  @CAN_RadarFR::RFR_Object::RFR_Object_Obj32.VxVyCoVnce = 0;
  @CAN_RadarFR::RFR_Object::RFR_Object_Obj32.Vy = 0;
  @CAN_RadarFR::RFR_Object::RFR_Object_Obj32.VyAxCoVnce = 0;
  @CAN_RadarFR::RFR_Object::RFR_Object_Obj32.VyAyCoVnce = 0;
  @CAN_RadarFR::RFR_Object::RFR_Object_Obj32.VyVnce = 0;
  @CAN_RadarFR::RFR_Object::RFR_Object_Obj32.Width = 0;
  @CAN_RadarFR::RFR_Object::RFR_Object_Obj32.WidthVnce = 0;
  @CAN_RadarFR::RFR_Object::RFR_Object_Obj33.Age = 0;
  @CAN_RadarFR::RFR_Object::RFR_Object_Obj33.Ax = 0;
  @CAN_RadarFR::RFR_Object::RFR_Object_Obj33.AxAyCoVnce = 0;
  @CAN_RadarFR::RFR_Object::RFR_Object_Obj33.AxVnce = 0;
  @CAN_RadarFR::RFR_Object::RFR_Object_Obj33.Ay = 0;
  @CAN_RadarFR::RFR_Object::RFR_Object_Obj33.AyVnce = 0;
  @CAN_RadarFR::RFR_Object::RFR_Object_Obj33.ExistProb = 0;
  @CAN_RadarFR::RFR_Object::RFR_Object_Obj33.FilterInformation = 0;
  @CAN_RadarFR::RFR_Object::RFR_Object_Obj33.Length = 0;
  @CAN_RadarFR::RFR_Object::RFR_Object_Obj33.LengthVnce = 0;
  @CAN_RadarFR::RFR_Object::RFR_Object_Obj33.MeasurementStatus = 0;
  @CAN_RadarFR::RFR_Object::RFR_Object_Obj33.MovingStatus = 0;
  }
  if(init_count == 44)
  {
  @CAN_RadarFR::RFR_Object::RFR_Object_Obj33.ObjId = 0;
  @CAN_RadarFR::RFR_Object::RFR_Object_Obj33.OrientationYaw = 0;
  @CAN_RadarFR::RFR_Object::RFR_Object_Obj33.OrientationYawVnce = 0;
  @CAN_RadarFR::RFR_Object::RFR_Object_Obj33.ProbClassConfidence = 0;
  @CAN_RadarFR::RFR_Object::RFR_Object_Obj33.ProbClassType = 0;
  @CAN_RadarFR::RFR_Object::RFR_Object_Obj33.Px = 0;
  @CAN_RadarFR::RFR_Object::RFR_Object_Obj33.PxAxCoVnce = 0;
  @CAN_RadarFR::RFR_Object::RFR_Object_Obj33.PxAyCoVnce = 0;
  @CAN_RadarFR::RFR_Object::RFR_Object_Obj33.PxPyCoVnce = 0;
  @CAN_RadarFR::RFR_Object::RFR_Object_Obj33.PxVnce = 0;
  @CAN_RadarFR::RFR_Object::RFR_Object_Obj33.PxVxCoVnce = 0;
  @CAN_RadarFR::RFR_Object::RFR_Object_Obj33.PxVyCoVnce = 0;
  @CAN_RadarFR::RFR_Object::RFR_Object_Obj33.Py = 0;
  @CAN_RadarFR::RFR_Object::RFR_Object_Obj33.PyAxCoVnce = 0;
  @CAN_RadarFR::RFR_Object::RFR_Object_Obj33.PyAyCoVnce = 0;
  @CAN_RadarFR::RFR_Object::RFR_Object_Obj33.PyVnce = 0;
  @CAN_RadarFR::RFR_Object::RFR_Object_Obj33.PyVxCoVnce = 0;
  @CAN_RadarFR::RFR_Object::RFR_Object_Obj33.PyVyCoVnce = 0;
  @CAN_RadarFR::RFR_Object::RFR_Object_Obj33.ReferencePoint = 0;
  @CAN_RadarFR::RFR_Object::RFR_Object_Obj33.Vx = 0;
  @CAN_RadarFR::RFR_Object::RFR_Object_Obj33.VxAxCoVnce = 0;
  @CAN_RadarFR::RFR_Object::RFR_Object_Obj33.VxAyCoVnce = 0;
  @CAN_RadarFR::RFR_Object::RFR_Object_Obj33.VxVnce = 0;
  @CAN_RadarFR::RFR_Object::RFR_Object_Obj33.VxVyCoVnce = 0;
  @CAN_RadarFR::RFR_Object::RFR_Object_Obj33.Vy = 0;
  }
  if(init_count == 45)
  {
  @CAN_RadarFR::RFR_Object::RFR_Object_Obj33.VyAxCoVnce = 0;
  @CAN_RadarFR::RFR_Object::RFR_Object_Obj33.VyAyCoVnce = 0;
  @CAN_RadarFR::RFR_Object::RFR_Object_Obj33.VyVnce = 0;
  @CAN_RadarFR::RFR_Object::RFR_Object_Obj33.Width = 0;
  @CAN_RadarFR::RFR_Object::RFR_Object_Obj33.WidthVnce = 0;
  @CAN_RadarFR::RFR_Object::RFR_Object_Obj34.Age = 0;
  @CAN_RadarFR::RFR_Object::RFR_Object_Obj34.Ax = 0;
  @CAN_RadarFR::RFR_Object::RFR_Object_Obj34.AxAyCoVnce = 0;
  @CAN_RadarFR::RFR_Object::RFR_Object_Obj34.AxVnce = 0;
  @CAN_RadarFR::RFR_Object::RFR_Object_Obj34.Ay = 0;
  @CAN_RadarFR::RFR_Object::RFR_Object_Obj34.AyVnce = 0;
  @CAN_RadarFR::RFR_Object::RFR_Object_Obj34.ExistProb = 0;
  @CAN_RadarFR::RFR_Object::RFR_Object_Obj34.FilterInformation = 0;
  @CAN_RadarFR::RFR_Object::RFR_Object_Obj34.Length = 0;
  @CAN_RadarFR::RFR_Object::RFR_Object_Obj34.LengthVnce = 0;
  @CAN_RadarFR::RFR_Object::RFR_Object_Obj34.MeasurementStatus = 0;
  @CAN_RadarFR::RFR_Object::RFR_Object_Obj34.MovingStatus = 0;
  @CAN_RadarFR::RFR_Object::RFR_Object_Obj34.ObjId = 0;
  @CAN_RadarFR::RFR_Object::RFR_Object_Obj34.OrientationYaw = 0;
  @CAN_RadarFR::RFR_Object::RFR_Object_Obj34.OrientationYawVnce = 0;
  @CAN_RadarFR::RFR_Object::RFR_Object_Obj34.ProbClassConfidence = 0;
  @CAN_RadarFR::RFR_Object::RFR_Object_Obj34.ProbClassType = 0;
  @CAN_RadarFR::RFR_Object::RFR_Object_Obj34.Px = 0;
  @CAN_RadarFR::RFR_Object::RFR_Object_Obj34.PxAxCoVnce = 0;
  @CAN_RadarFR::RFR_Object::RFR_Object_Obj34.PxAyCoVnce = 0;
  }
  if(init_count == 46)
  {
  @CAN_RadarFR::RFR_Object::RFR_Object_Obj34.PxPyCoVnce = 0;
  @CAN_RadarFR::RFR_Object::RFR_Object_Obj34.PxVnce = 0;
  @CAN_RadarFR::RFR_Object::RFR_Object_Obj34.PxVxCoVnce = 0;
  @CAN_RadarFR::RFR_Object::RFR_Object_Obj34.PxVyCoVnce = 0;
  @CAN_RadarFR::RFR_Object::RFR_Object_Obj34.Py = 0;
  @CAN_RadarFR::RFR_Object::RFR_Object_Obj34.PyAxCoVnce = 0;
  @CAN_RadarFR::RFR_Object::RFR_Object_Obj34.PyAyCoVnce = 0;
  @CAN_RadarFR::RFR_Object::RFR_Object_Obj34.PyVnce = 0;
  @CAN_RadarFR::RFR_Object::RFR_Object_Obj34.PyVxCoVnce = 0;
  @CAN_RadarFR::RFR_Object::RFR_Object_Obj34.PyVyCoVnce = 0;
  @CAN_RadarFR::RFR_Object::RFR_Object_Obj34.ReferencePoint = 0;
  @CAN_RadarFR::RFR_Object::RFR_Object_Obj34.Vx = 0;
  @CAN_RadarFR::RFR_Object::RFR_Object_Obj34.VxAxCoVnce = 0;
  @CAN_RadarFR::RFR_Object::RFR_Object_Obj34.VxAyCoVnce = 0;
  @CAN_RadarFR::RFR_Object::RFR_Object_Obj34.VxVnce = 0;
  @CAN_RadarFR::RFR_Object::RFR_Object_Obj34.VxVyCoVnce = 0;
  @CAN_RadarFR::RFR_Object::RFR_Object_Obj34.Vy = 0;
  @CAN_RadarFR::RFR_Object::RFR_Object_Obj34.VyAxCoVnce = 0;
  @CAN_RadarFR::RFR_Object::RFR_Object_Obj34.VyAyCoVnce = 0;
  @CAN_RadarFR::RFR_Object::RFR_Object_Obj34.VyVnce = 0;
  @CAN_RadarFR::RFR_Object::RFR_Object_Obj34.Width = 0;
  @CAN_RadarFR::RFR_Object::RFR_Object_Obj34.WidthVnce = 0;
  @CAN_RadarFR::RFR_Object::RFR_Object_Obj35.Age = 0;
  @CAN_RadarFR::RFR_Object::RFR_Object_Obj35.Ax = 0;
  @CAN_RadarFR::RFR_Object::RFR_Object_Obj35.AxAyCoVnce = 0;
  }
  if(init_count == 47)
  {
  @CAN_RadarFR::RFR_Object::RFR_Object_Obj35.AxVnce = 0;
  @CAN_RadarFR::RFR_Object::RFR_Object_Obj35.Ay = 0;
  @CAN_RadarFR::RFR_Object::RFR_Object_Obj35.AyVnce = 0;
  @CAN_RadarFR::RFR_Object::RFR_Object_Obj35.ExistProb = 0;
  @CAN_RadarFR::RFR_Object::RFR_Object_Obj35.FilterInformation = 0;
  @CAN_RadarFR::RFR_Object::RFR_Object_Obj35.Length = 0;
  @CAN_RadarFR::RFR_Object::RFR_Object_Obj35.LengthVnce = 0;
  @CAN_RadarFR::RFR_Object::RFR_Object_Obj35.MeasurementStatus = 0;
  @CAN_RadarFR::RFR_Object::RFR_Object_Obj35.MovingStatus = 0;
  @CAN_RadarFR::RFR_Object::RFR_Object_Obj35.ObjId = 0;
  @CAN_RadarFR::RFR_Object::RFR_Object_Obj35.OrientationYaw = 0;
  @CAN_RadarFR::RFR_Object::RFR_Object_Obj35.OrientationYawVnce = 0;
  @CAN_RadarFR::RFR_Object::RFR_Object_Obj35.ProbClassConfidence = 0;
  @CAN_RadarFR::RFR_Object::RFR_Object_Obj35.ProbClassType = 0;
  @CAN_RadarFR::RFR_Object::RFR_Object_Obj35.Px = 0;
  @CAN_RadarFR::RFR_Object::RFR_Object_Obj35.PxAxCoVnce = 0;
  @CAN_RadarFR::RFR_Object::RFR_Object_Obj35.PxAyCoVnce = 0;
  @CAN_RadarFR::RFR_Object::RFR_Object_Obj35.PxPyCoVnce = 0;
  @CAN_RadarFR::RFR_Object::RFR_Object_Obj35.PxVnce = 0;
  @CAN_RadarFR::RFR_Object::RFR_Object_Obj35.PxVxCoVnce = 0;
  @CAN_RadarFR::RFR_Object::RFR_Object_Obj35.PxVyCoVnce = 0;
  @CAN_RadarFR::RFR_Object::RFR_Object_Obj35.Py = 0;
  @CAN_RadarFR::RFR_Object::RFR_Object_Obj35.PyAxCoVnce = 0;
  @CAN_RadarFR::RFR_Object::RFR_Object_Obj35.PyAyCoVnce = 0;
  @CAN_RadarFR::RFR_Object::RFR_Object_Obj35.PyVnce = 0;
  }
  if(init_count == 48)
  {
  @CAN_RadarFR::RFR_Object::RFR_Object_Obj35.PyVxCoVnce = 0;
  @CAN_RadarFR::RFR_Object::RFR_Object_Obj35.PyVyCoVnce = 0;
  @CAN_RadarFR::RFR_Object::RFR_Object_Obj35.ReferencePoint = 0;
  @CAN_RadarFR::RFR_Object::RFR_Object_Obj35.Vx = 0;
  @CAN_RadarFR::RFR_Object::RFR_Object_Obj35.VxAxCoVnce = 0;
  @CAN_RadarFR::RFR_Object::RFR_Object_Obj35.VxAyCoVnce = 0;
  @CAN_RadarFR::RFR_Object::RFR_Object_Obj35.VxVnce = 0;
  @CAN_RadarFR::RFR_Object::RFR_Object_Obj35.VxVyCoVnce = 0;
  @CAN_RadarFR::RFR_Object::RFR_Object_Obj35.Vy = 0;
  @CAN_RadarFR::RFR_Object::RFR_Object_Obj35.VyAxCoVnce = 0;
  @CAN_RadarFR::RFR_Object::RFR_Object_Obj35.VyAyCoVnce = 0;
  @CAN_RadarFR::RFR_Object::RFR_Object_Obj35.VyVnce = 0;
  @CAN_RadarFR::RFR_Object::RFR_Object_Obj35.Width = 0;
  @CAN_RadarFR::RFR_Object::RFR_Object_Obj35.WidthVnce = 0;
  @CAN_RadarFR::RFR_Object::RFR_Object_Obj36.Age = 0;
  @CAN_RadarFR::RFR_Object::RFR_Object_Obj36.Ax = 0;
  @CAN_RadarFR::RFR_Object::RFR_Object_Obj36.AxAyCoVnce = 0;
  @CAN_RadarFR::RFR_Object::RFR_Object_Obj36.AxVnce = 0;
  @CAN_RadarFR::RFR_Object::RFR_Object_Obj36.Ay = 0;
  @CAN_RadarFR::RFR_Object::RFR_Object_Obj36.AyVnce = 0;
  @CAN_RadarFR::RFR_Object::RFR_Object_Obj36.ExistProb = 0;
  @CAN_RadarFR::RFR_Object::RFR_Object_Obj36.FilterInformation = 0;
  @CAN_RadarFR::RFR_Object::RFR_Object_Obj36.Length = 0;
  @CAN_RadarFR::RFR_Object::RFR_Object_Obj36.LengthVnce = 0;
  @CAN_RadarFR::RFR_Object::RFR_Object_Obj36.MeasurementStatus = 0;
  }
  if(init_count == 49)
  {
  @CAN_RadarFR::RFR_Object::RFR_Object_Obj36.MovingStatus = 0;
  @CAN_RadarFR::RFR_Object::RFR_Object_Obj36.ObjId = 0;
  @CAN_RadarFR::RFR_Object::RFR_Object_Obj36.OrientationYaw = 0;
  @CAN_RadarFR::RFR_Object::RFR_Object_Obj36.OrientationYawVnce = 0;
  @CAN_RadarFR::RFR_Object::RFR_Object_Obj36.ProbClassConfidence = 0;
  @CAN_RadarFR::RFR_Object::RFR_Object_Obj36.ProbClassType = 0;
  @CAN_RadarFR::RFR_Object::RFR_Object_Obj36.Px = 0;
  @CAN_RadarFR::RFR_Object::RFR_Object_Obj36.PxAxCoVnce = 0;
  @CAN_RadarFR::RFR_Object::RFR_Object_Obj36.PxAyCoVnce = 0;
  @CAN_RadarFR::RFR_Object::RFR_Object_Obj36.PxPyCoVnce = 0;
  @CAN_RadarFR::RFR_Object::RFR_Object_Obj36.PxVnce = 0;
  @CAN_RadarFR::RFR_Object::RFR_Object_Obj36.PxVxCoVnce = 0;
  @CAN_RadarFR::RFR_Object::RFR_Object_Obj36.PxVyCoVnce = 0;
  @CAN_RadarFR::RFR_Object::RFR_Object_Obj36.Py = 0;
  @CAN_RadarFR::RFR_Object::RFR_Object_Obj36.PyAxCoVnce = 0;
  @CAN_RadarFR::RFR_Object::RFR_Object_Obj36.PyAyCoVnce = 0;
  @CAN_RadarFR::RFR_Object::RFR_Object_Obj36.PyVnce = 0;
  @CAN_RadarFR::RFR_Object::RFR_Object_Obj36.PyVxCoVnce = 0;
  @CAN_RadarFR::RFR_Object::RFR_Object_Obj36.PyVyCoVnce = 0;
  @CAN_RadarFR::RFR_Object::RFR_Object_Obj36.ReferencePoint = 0;
  @CAN_RadarFR::RFR_Object::RFR_Object_Obj36.Vx = 0;
  @CAN_RadarFR::RFR_Object::RFR_Object_Obj36.VxAxCoVnce = 0;
  @CAN_RadarFR::RFR_Object::RFR_Object_Obj36.VxAyCoVnce = 0;
  @CAN_RadarFR::RFR_Object::RFR_Object_Obj36.VxVnce = 0;
  @CAN_RadarFR::RFR_Object::RFR_Object_Obj36.VxVyCoVnce = 0;
  }
  if(init_count == 50)
  {
  @CAN_RadarFR::RFR_Object::RFR_Object_Obj36.Vy = 0;
  @CAN_RadarFR::RFR_Object::RFR_Object_Obj36.VyAxCoVnce = 0;
  @CAN_RadarFR::RFR_Object::RFR_Object_Obj36.VyAyCoVnce = 0;
  @CAN_RadarFR::RFR_Object::RFR_Object_Obj36.VyVnce = 0;
  @CAN_RadarFR::RFR_Object::RFR_Object_Obj36.Width = 0;
  @CAN_RadarFR::RFR_Object::RFR_Object_Obj36.WidthVnce = 0;
  @CAN_RadarFR::RFR_Object::RFR_Object_Obj37.Age = 0;
  @CAN_RadarFR::RFR_Object::RFR_Object_Obj37.Ax = 0;
  @CAN_RadarFR::RFR_Object::RFR_Object_Obj37.AxAyCoVnce = 0;
  @CAN_RadarFR::RFR_Object::RFR_Object_Obj37.AxVnce = 0;
  @CAN_RadarFR::RFR_Object::RFR_Object_Obj37.Ay = 0;
  @CAN_RadarFR::RFR_Object::RFR_Object_Obj37.AyVnce = 0;
  @CAN_RadarFR::RFR_Object::RFR_Object_Obj37.ExistProb = 0;
  @CAN_RadarFR::RFR_Object::RFR_Object_Obj37.FilterInformation = 0;
  @CAN_RadarFR::RFR_Object::RFR_Object_Obj37.Length = 0;
  @CAN_RadarFR::RFR_Object::RFR_Object_Obj37.LengthVnce = 0;
  @CAN_RadarFR::RFR_Object::RFR_Object_Obj37.MeasurementStatus = 0;
  @CAN_RadarFR::RFR_Object::RFR_Object_Obj37.MovingStatus = 0;
  @CAN_RadarFR::RFR_Object::RFR_Object_Obj37.ObjId = 0;
  @CAN_RadarFR::RFR_Object::RFR_Object_Obj37.OrientationYaw = 0;
  @CAN_RadarFR::RFR_Object::RFR_Object_Obj37.OrientationYawVnce = 0;
  @CAN_RadarFR::RFR_Object::RFR_Object_Obj37.ProbClassConfidence = 0;
  @CAN_RadarFR::RFR_Object::RFR_Object_Obj37.ProbClassType = 0;
  @CAN_RadarFR::RFR_Object::RFR_Object_Obj37.Px = 0;
  @CAN_RadarFR::RFR_Object::RFR_Object_Obj37.PxAxCoVnce = 0;
  }
  if(init_count == 51)
  {
  @CAN_RadarFR::RFR_Object::RFR_Object_Obj37.PxAyCoVnce = 0;
  @CAN_RadarFR::RFR_Object::RFR_Object_Obj37.PxPyCoVnce = 0;
  @CAN_RadarFR::RFR_Object::RFR_Object_Obj37.PxVnce = 0;
  @CAN_RadarFR::RFR_Object::RFR_Object_Obj37.PxVxCoVnce = 0;
  @CAN_RadarFR::RFR_Object::RFR_Object_Obj37.PxVyCoVnce = 0;
  @CAN_RadarFR::RFR_Object::RFR_Object_Obj37.Py = 0;
  @CAN_RadarFR::RFR_Object::RFR_Object_Obj37.PyAxCoVnce = 0;
  @CAN_RadarFR::RFR_Object::RFR_Object_Obj37.PyAyCoVnce = 0;
  @CAN_RadarFR::RFR_Object::RFR_Object_Obj37.PyVnce = 0;
  @CAN_RadarFR::RFR_Object::RFR_Object_Obj37.PyVxCoVnce = 0;
  @CAN_RadarFR::RFR_Object::RFR_Object_Obj37.PyVyCoVnce = 0;
  @CAN_RadarFR::RFR_Object::RFR_Object_Obj37.ReferencePoint = 0;
  @CAN_RadarFR::RFR_Object::RFR_Object_Obj37.Vx = 0;
  @CAN_RadarFR::RFR_Object::RFR_Object_Obj37.VxAxCoVnce = 0;
  @CAN_RadarFR::RFR_Object::RFR_Object_Obj37.VxAyCoVnce = 0;
  @CAN_RadarFR::RFR_Object::RFR_Object_Obj37.VxVnce = 0;
  @CAN_RadarFR::RFR_Object::RFR_Object_Obj37.VxVyCoVnce = 0;
  @CAN_RadarFR::RFR_Object::RFR_Object_Obj37.Vy = 0;
  @CAN_RadarFR::RFR_Object::RFR_Object_Obj37.VyAxCoVnce = 0;
  @CAN_RadarFR::RFR_Object::RFR_Object_Obj37.VyAyCoVnce = 0;
  @CAN_RadarFR::RFR_Object::RFR_Object_Obj37.VyVnce = 0;
  @CAN_RadarFR::RFR_Object::RFR_Object_Obj37.Width = 0;
  @CAN_RadarFR::RFR_Object::RFR_Object_Obj37.WidthVnce = 0;
  @CAN_RadarFR::RFR_Object::RFR_Object_Obj38.Age = 0;
  @CAN_RadarFR::RFR_Object::RFR_Object_Obj38.Ax = 0;
  }
  if(init_count == 52)
  {
  @CAN_RadarFR::RFR_Object::RFR_Object_Obj38.AxAyCoVnce = 0;
  @CAN_RadarFR::RFR_Object::RFR_Object_Obj38.AxVnce = 0;
  @CAN_RadarFR::RFR_Object::RFR_Object_Obj38.Ay = 0;
  @CAN_RadarFR::RFR_Object::RFR_Object_Obj38.AyVnce = 0;
  @CAN_RadarFR::RFR_Object::RFR_Object_Obj38.ExistProb = 0;
  @CAN_RadarFR::RFR_Object::RFR_Object_Obj38.FilterInformation = 0;
  @CAN_RadarFR::RFR_Object::RFR_Object_Obj38.Length = 0;
  @CAN_RadarFR::RFR_Object::RFR_Object_Obj38.LengthVnce = 0;
  @CAN_RadarFR::RFR_Object::RFR_Object_Obj38.MeasurementStatus = 0;
  @CAN_RadarFR::RFR_Object::RFR_Object_Obj38.MovingStatus = 0;
  @CAN_RadarFR::RFR_Object::RFR_Object_Obj38.ObjId = 0;
  @CAN_RadarFR::RFR_Object::RFR_Object_Obj38.OrientationYaw = 0;
  @CAN_RadarFR::RFR_Object::RFR_Object_Obj38.OrientationYawVnce = 0;
  @CAN_RadarFR::RFR_Object::RFR_Object_Obj38.ProbClassConfidence = 0;
  @CAN_RadarFR::RFR_Object::RFR_Object_Obj38.ProbClassType = 0;
  @CAN_RadarFR::RFR_Object::RFR_Object_Obj38.Px = 0;
  @CAN_RadarFR::RFR_Object::RFR_Object_Obj38.PxAxCoVnce = 0;
  @CAN_RadarFR::RFR_Object::RFR_Object_Obj38.PxAyCoVnce = 0;
  @CAN_RadarFR::RFR_Object::RFR_Object_Obj38.PxPyCoVnce = 0;
  @CAN_RadarFR::RFR_Object::RFR_Object_Obj38.PxVnce = 0;
  @CAN_RadarFR::RFR_Object::RFR_Object_Obj38.PxVxCoVnce = 0;
  @CAN_RadarFR::RFR_Object::RFR_Object_Obj38.PxVyCoVnce = 0;
  @CAN_RadarFR::RFR_Object::RFR_Object_Obj38.Py = 0;
  @CAN_RadarFR::RFR_Object::RFR_Object_Obj38.PyAxCoVnce = 0;
  @CAN_RadarFR::RFR_Object::RFR_Object_Obj38.PyAyCoVnce = 0;
  }
  if(init_count == 53)
  {
  @CAN_RadarFR::RFR_Object::RFR_Object_Obj38.PyVnce = 0;
  @CAN_RadarFR::RFR_Object::RFR_Object_Obj38.PyVxCoVnce = 0;
  @CAN_RadarFR::RFR_Object::RFR_Object_Obj38.PyVyCoVnce = 0;
  @CAN_RadarFR::RFR_Object::RFR_Object_Obj38.ReferencePoint = 0;
  @CAN_RadarFR::RFR_Object::RFR_Object_Obj38.Vx = 0;
  @CAN_RadarFR::RFR_Object::RFR_Object_Obj38.VxAxCoVnce = 0;
  @CAN_RadarFR::RFR_Object::RFR_Object_Obj38.VxAyCoVnce = 0;
  @CAN_RadarFR::RFR_Object::RFR_Object_Obj38.VxVnce = 0;
  @CAN_RadarFR::RFR_Object::RFR_Object_Obj38.VxVyCoVnce = 0;
  @CAN_RadarFR::RFR_Object::RFR_Object_Obj38.Vy = 0;
  @CAN_RadarFR::RFR_Object::RFR_Object_Obj38.VyAxCoVnce = 0;
  @CAN_RadarFR::RFR_Object::RFR_Object_Obj38.VyAyCoVnce = 0;
  @CAN_RadarFR::RFR_Object::RFR_Object_Obj38.VyVnce = 0;
  @CAN_RadarFR::RFR_Object::RFR_Object_Obj38.Width = 0;
  @CAN_RadarFR::RFR_Object::RFR_Object_Obj38.WidthVnce = 0;
  @CAN_RadarFR::RFR_Object::RFR_Object_Obj39.Age = 0;
  @CAN_RadarFR::RFR_Object::RFR_Object_Obj39.Ax = 0;
  @CAN_RadarFR::RFR_Object::RFR_Object_Obj39.AxAyCoVnce = 0;
  @CAN_RadarFR::RFR_Object::RFR_Object_Obj39.AxVnce = 0;
  @CAN_RadarFR::RFR_Object::RFR_Object_Obj39.Ay = 0;
  @CAN_RadarFR::RFR_Object::RFR_Object_Obj39.AyVnce = 0;
  @CAN_RadarFR::RFR_Object::RFR_Object_Obj39.ExistProb = 0;
  @CAN_RadarFR::RFR_Object::RFR_Object_Obj39.FilterInformation = 0;
  @CAN_RadarFR::RFR_Object::RFR_Object_Obj39.Length = 0;
  @CAN_RadarFR::RFR_Object::RFR_Object_Obj39.LengthVnce = 0;
  }
  if(init_count == 54)
  {
  @CAN_RadarFR::RFR_Object::RFR_Object_Obj39.MeasurementStatus = 0;
  @CAN_RadarFR::RFR_Object::RFR_Object_Obj39.MovingStatus = 0;
  @CAN_RadarFR::RFR_Object::RFR_Object_Obj39.ObjId = 0;
  @CAN_RadarFR::RFR_Object::RFR_Object_Obj39.OrientationYaw = 0;
  @CAN_RadarFR::RFR_Object::RFR_Object_Obj39.OrientationYawVnce = 0;
  @CAN_RadarFR::RFR_Object::RFR_Object_Obj39.ProbClassConfidence = 0;
  @CAN_RadarFR::RFR_Object::RFR_Object_Obj39.ProbClassType = 0;
  @CAN_RadarFR::RFR_Object::RFR_Object_Obj39.Px = 0;
  @CAN_RadarFR::RFR_Object::RFR_Object_Obj39.PxAxCoVnce = 0;
  @CAN_RadarFR::RFR_Object::RFR_Object_Obj39.PxAyCoVnce = 0;
  @CAN_RadarFR::RFR_Object::RFR_Object_Obj39.PxPyCoVnce = 0;
  @CAN_RadarFR::RFR_Object::RFR_Object_Obj39.PxVnce = 0;
  @CAN_RadarFR::RFR_Object::RFR_Object_Obj39.PxVxCoVnce = 0;
  @CAN_RadarFR::RFR_Object::RFR_Object_Obj39.PxVyCoVnce = 0;
  @CAN_RadarFR::RFR_Object::RFR_Object_Obj39.Py = 0;
  @CAN_RadarFR::RFR_Object::RFR_Object_Obj39.PyAxCoVnce = 0;
  @CAN_RadarFR::RFR_Object::RFR_Object_Obj39.PyAyCoVnce = 0;
  @CAN_RadarFR::RFR_Object::RFR_Object_Obj39.PyVnce = 0;
  @CAN_RadarFR::RFR_Object::RFR_Object_Obj39.PyVxCoVnce = 0;
  @CAN_RadarFR::RFR_Object::RFR_Object_Obj39.PyVyCoVnce = 0;
  @CAN_RadarFR::RFR_Object::RFR_Object_Obj39.ReferencePoint = 0;
  @CAN_RadarFR::RFR_Object::RFR_Object_Obj39.Vx = 0;
  @CAN_RadarFR::RFR_Object::RFR_Object_Obj39.VxAxCoVnce = 0;
  @CAN_RadarFR::RFR_Object::RFR_Object_Obj39.VxAyCoVnce = 0;
  @CAN_RadarFR::RFR_Object::RFR_Object_Obj39.VxVnce = 0;
  }
  if(init_count == 55)
  {
  @CAN_RadarFR::RFR_Object::RFR_Object_Obj39.VxVyCoVnce = 0;
  @CAN_RadarFR::RFR_Object::RFR_Object_Obj39.Vy = 0;
  @CAN_RadarFR::RFR_Object::RFR_Object_Obj39.VyAxCoVnce = 0;
  @CAN_RadarFR::RFR_Object::RFR_Object_Obj39.VyAyCoVnce = 0;
  @CAN_RadarFR::RFR_Object::RFR_Object_Obj39.VyVnce = 0;
  @CAN_RadarFR::RFR_Object::RFR_Object_Obj39.Width = 0;
  @CAN_RadarFR::RFR_Object::RFR_Object_Obj39.WidthVnce = 0;
  @CAN_RadarFR::RFR_Object::RFR_Object_Obj3.Age = 0;
  @CAN_RadarFR::RFR_Object::RFR_Object_Obj3.Ax = 0;
  @CAN_RadarFR::RFR_Object::RFR_Object_Obj3.AxAyCoVnce = 0;
  @CAN_RadarFR::RFR_Object::RFR_Object_Obj3.AxVnce = 0;
  @CAN_RadarFR::RFR_Object::RFR_Object_Obj3.Ay = 0;
  @CAN_RadarFR::RFR_Object::RFR_Object_Obj3.AyVnce = 0;
  @CAN_RadarFR::RFR_Object::RFR_Object_Obj3.ExistProb = 0;
  @CAN_RadarFR::RFR_Object::RFR_Object_Obj3.FilterInformation = 0;
  @CAN_RadarFR::RFR_Object::RFR_Object_Obj3.Length = 0;
  @CAN_RadarFR::RFR_Object::RFR_Object_Obj3.LengthVnce = 0;
  @CAN_RadarFR::RFR_Object::RFR_Object_Obj3.MeasurementStatus = 0;
  @CAN_RadarFR::RFR_Object::RFR_Object_Obj3.MovingStatus = 0;
  @CAN_RadarFR::RFR_Object::RFR_Object_Obj3.ObjId = 0;
  @CAN_RadarFR::RFR_Object::RFR_Object_Obj3.OrientationYaw = 0;
  @CAN_RadarFR::RFR_Object::RFR_Object_Obj3.OrientationYawVnce = 0;
  @CAN_RadarFR::RFR_Object::RFR_Object_Obj3.ProbClassConfidence = 0;
  @CAN_RadarFR::RFR_Object::RFR_Object_Obj3.ProbClassType = 0;
  @CAN_RadarFR::RFR_Object::RFR_Object_Obj3.Px = 0;
  }
  if(init_count == 56)
  {
  @CAN_RadarFR::RFR_Object::RFR_Object_Obj3.PxAxCoVnce = 0;
  @CAN_RadarFR::RFR_Object::RFR_Object_Obj3.PxAyCoVnce = 0;
  @CAN_RadarFR::RFR_Object::RFR_Object_Obj3.PxPyCoVnce = 0;
  @CAN_RadarFR::RFR_Object::RFR_Object_Obj3.PxVnce = 0;
  @CAN_RadarFR::RFR_Object::RFR_Object_Obj3.PxVxCoVnce = 0;
  @CAN_RadarFR::RFR_Object::RFR_Object_Obj3.PxVyCoVnce = 0;
  @CAN_RadarFR::RFR_Object::RFR_Object_Obj3.Py = 0;
  @CAN_RadarFR::RFR_Object::RFR_Object_Obj3.PyAxCoVnce = 0;
  @CAN_RadarFR::RFR_Object::RFR_Object_Obj3.PyAyCoVnce = 0;
  @CAN_RadarFR::RFR_Object::RFR_Object_Obj3.PyVnce = 0;
  @CAN_RadarFR::RFR_Object::RFR_Object_Obj3.PyVxCoVnce = 0;
  @CAN_RadarFR::RFR_Object::RFR_Object_Obj3.PyVyCoVnce = 0;
  @CAN_RadarFR::RFR_Object::RFR_Object_Obj3.ReferencePoint = 0;
  @CAN_RadarFR::RFR_Object::RFR_Object_Obj3.Vx = 0;
  @CAN_RadarFR::RFR_Object::RFR_Object_Obj3.VxAxCoVnce = 0;
  @CAN_RadarFR::RFR_Object::RFR_Object_Obj3.VxAyCoVnce = 0;
  @CAN_RadarFR::RFR_Object::RFR_Object_Obj3.VxVnce = 0;
  @CAN_RadarFR::RFR_Object::RFR_Object_Obj3.VxVyCoVnce = 0;
  @CAN_RadarFR::RFR_Object::RFR_Object_Obj3.Vy = 0;
  @CAN_RadarFR::RFR_Object::RFR_Object_Obj3.VyAxCoVnce = 0;
  @CAN_RadarFR::RFR_Object::RFR_Object_Obj3.VyAyCoVnce = 0;
  @CAN_RadarFR::RFR_Object::RFR_Object_Obj3.VyVnce = 0;
  @CAN_RadarFR::RFR_Object::RFR_Object_Obj3.Width = 0;
  @CAN_RadarFR::RFR_Object::RFR_Object_Obj3.WidthVnce = 0;
  @CAN_RadarFR::RFR_Object::RFR_Object_Obj40.Age = 0;
  }
  if(init_count == 57)
  {
  @CAN_RadarFR::RFR_Object::RFR_Object_Obj40.Ax = 0;
  @CAN_RadarFR::RFR_Object::RFR_Object_Obj40.AxAyCoVnce = 0;
  @CAN_RadarFR::RFR_Object::RFR_Object_Obj40.AxVnce = 0;
  @CAN_RadarFR::RFR_Object::RFR_Object_Obj40.Ay = 0;
  @CAN_RadarFR::RFR_Object::RFR_Object_Obj40.AyVnce = 0;
  @CAN_RadarFR::RFR_Object::RFR_Object_Obj40.ExistProb = 0;
  @CAN_RadarFR::RFR_Object::RFR_Object_Obj40.FilterInformation = 0;
  @CAN_RadarFR::RFR_Object::RFR_Object_Obj40.Length = 0;
  @CAN_RadarFR::RFR_Object::RFR_Object_Obj40.LengthVnce = 0;
  @CAN_RadarFR::RFR_Object::RFR_Object_Obj40.MeasurementStatus = 0;
  @CAN_RadarFR::RFR_Object::RFR_Object_Obj40.MovingStatus = 0;
  @CAN_RadarFR::RFR_Object::RFR_Object_Obj40.ObjId = 0;
  @CAN_RadarFR::RFR_Object::RFR_Object_Obj40.OrientationYaw = 0;
  @CAN_RadarFR::RFR_Object::RFR_Object_Obj40.OrientationYawVnce = 0;
  @CAN_RadarFR::RFR_Object::RFR_Object_Obj40.ProbClassConfidence = 0;
  @CAN_RadarFR::RFR_Object::RFR_Object_Obj40.ProbClassType = 0;
  @CAN_RadarFR::RFR_Object::RFR_Object_Obj40.Px = 0;
  @CAN_RadarFR::RFR_Object::RFR_Object_Obj40.PxAxCoVnce = 0;
  @CAN_RadarFR::RFR_Object::RFR_Object_Obj40.PxAyCoVnce = 0;
  @CAN_RadarFR::RFR_Object::RFR_Object_Obj40.PxPyCoVnce = 0;
  @CAN_RadarFR::RFR_Object::RFR_Object_Obj40.PxVnce = 0;
  @CAN_RadarFR::RFR_Object::RFR_Object_Obj40.PxVxCoVnce = 0;
  @CAN_RadarFR::RFR_Object::RFR_Object_Obj40.PxVyCoVnce = 0;
  @CAN_RadarFR::RFR_Object::RFR_Object_Obj40.Py = 0;
  @CAN_RadarFR::RFR_Object::RFR_Object_Obj40.PyAxCoVnce = 0;
  }
  if(init_count == 58)
  {
  @CAN_RadarFR::RFR_Object::RFR_Object_Obj40.PyAyCoVnce = 0;
  @CAN_RadarFR::RFR_Object::RFR_Object_Obj40.PyVnce = 0;
  @CAN_RadarFR::RFR_Object::RFR_Object_Obj40.PyVxCoVnce = 0;
  @CAN_RadarFR::RFR_Object::RFR_Object_Obj40.PyVyCoVnce = 0;
  @CAN_RadarFR::RFR_Object::RFR_Object_Obj40.ReferencePoint = 0;
  @CAN_RadarFR::RFR_Object::RFR_Object_Obj40.Vx = 0;
  @CAN_RadarFR::RFR_Object::RFR_Object_Obj40.VxAxCoVnce = 0;
  @CAN_RadarFR::RFR_Object::RFR_Object_Obj40.VxAyCoVnce = 0;
  @CAN_RadarFR::RFR_Object::RFR_Object_Obj40.VxVnce = 0;
  @CAN_RadarFR::RFR_Object::RFR_Object_Obj40.VxVyCoVnce = 0;
  @CAN_RadarFR::RFR_Object::RFR_Object_Obj40.Vy = 0;
  @CAN_RadarFR::RFR_Object::RFR_Object_Obj40.VyAxCoVnce = 0;
  @CAN_RadarFR::RFR_Object::RFR_Object_Obj40.VyAyCoVnce = 0;
  @CAN_RadarFR::RFR_Object::RFR_Object_Obj40.VyVnce = 0;
  @CAN_RadarFR::RFR_Object::RFR_Object_Obj40.Width = 0;
  @CAN_RadarFR::RFR_Object::RFR_Object_Obj40.WidthVnce = 0;
  @CAN_RadarFR::RFR_Object::RFR_Object_Obj41.Age = 0;
  @CAN_RadarFR::RFR_Object::RFR_Object_Obj41.Ax = 0;
  @CAN_RadarFR::RFR_Object::RFR_Object_Obj41.AxAyCoVnce = 0;
  @CAN_RadarFR::RFR_Object::RFR_Object_Obj41.AxVnce = 0;
  @CAN_RadarFR::RFR_Object::RFR_Object_Obj41.Ay = 0;
  @CAN_RadarFR::RFR_Object::RFR_Object_Obj41.AyVnce = 0;
  @CAN_RadarFR::RFR_Object::RFR_Object_Obj41.ExistProb = 0;
  @CAN_RadarFR::RFR_Object::RFR_Object_Obj41.FilterInformation = 0;
  @CAN_RadarFR::RFR_Object::RFR_Object_Obj41.Length = 0;
  }
  if(init_count == 59)
  {
  @CAN_RadarFR::RFR_Object::RFR_Object_Obj41.LengthVnce = 0;
  @CAN_RadarFR::RFR_Object::RFR_Object_Obj41.MeasurementStatus = 0;
  @CAN_RadarFR::RFR_Object::RFR_Object_Obj41.MovingStatus = 0;
  @CAN_RadarFR::RFR_Object::RFR_Object_Obj41.ObjId = 0;
  @CAN_RadarFR::RFR_Object::RFR_Object_Obj41.OrientationYaw = 0;
  @CAN_RadarFR::RFR_Object::RFR_Object_Obj41.OrientationYawVnce = 0;
  @CAN_RadarFR::RFR_Object::RFR_Object_Obj41.ProbClassConfidence = 0;
  @CAN_RadarFR::RFR_Object::RFR_Object_Obj41.ProbClassType = 0;
  @CAN_RadarFR::RFR_Object::RFR_Object_Obj41.Px = 0;
  @CAN_RadarFR::RFR_Object::RFR_Object_Obj41.PxAxCoVnce = 0;
  @CAN_RadarFR::RFR_Object::RFR_Object_Obj41.PxAyCoVnce = 0;
  @CAN_RadarFR::RFR_Object::RFR_Object_Obj41.PxPyCoVnce = 0;
  @CAN_RadarFR::RFR_Object::RFR_Object_Obj41.PxVnce = 0;
  @CAN_RadarFR::RFR_Object::RFR_Object_Obj41.PxVxCoVnce = 0;
  @CAN_RadarFR::RFR_Object::RFR_Object_Obj41.PxVyCoVnce = 0;
  @CAN_RadarFR::RFR_Object::RFR_Object_Obj41.Py = 0;
  @CAN_RadarFR::RFR_Object::RFR_Object_Obj41.PyAxCoVnce = 0;
  @CAN_RadarFR::RFR_Object::RFR_Object_Obj41.PyAyCoVnce = 0;
  @CAN_RadarFR::RFR_Object::RFR_Object_Obj41.PyVnce = 0;
  @CAN_RadarFR::RFR_Object::RFR_Object_Obj41.PyVxCoVnce = 0;
  @CAN_RadarFR::RFR_Object::RFR_Object_Obj41.PyVyCoVnce = 0;
  @CAN_RadarFR::RFR_Object::RFR_Object_Obj41.ReferencePoint = 0;
  @CAN_RadarFR::RFR_Object::RFR_Object_Obj41.Vx = 0;
  @CAN_RadarFR::RFR_Object::RFR_Object_Obj41.VxAxCoVnce = 0;
  @CAN_RadarFR::RFR_Object::RFR_Object_Obj41.VxAyCoVnce = 0;
  }
  if(init_count == 60)
  {
  @CAN_RadarFR::RFR_Object::RFR_Object_Obj41.VxVnce = 0;
  @CAN_RadarFR::RFR_Object::RFR_Object_Obj41.VxVyCoVnce = 0;
  @CAN_RadarFR::RFR_Object::RFR_Object_Obj41.Vy = 0;
  @CAN_RadarFR::RFR_Object::RFR_Object_Obj41.VyAxCoVnce = 0;
  @CAN_RadarFR::RFR_Object::RFR_Object_Obj41.VyAyCoVnce = 0;
  @CAN_RadarFR::RFR_Object::RFR_Object_Obj41.VyVnce = 0;
  @CAN_RadarFR::RFR_Object::RFR_Object_Obj41.Width = 0;
  @CAN_RadarFR::RFR_Object::RFR_Object_Obj41.WidthVnce = 0;
  @CAN_RadarFR::RFR_Object::RFR_Object_Obj42.Age = 0;
  @CAN_RadarFR::RFR_Object::RFR_Object_Obj42.Ax = 0;
  @CAN_RadarFR::RFR_Object::RFR_Object_Obj42.AxAyCoVnce = 0;
  @CAN_RadarFR::RFR_Object::RFR_Object_Obj42.AxVnce = 0;
  @CAN_RadarFR::RFR_Object::RFR_Object_Obj42.Ay = 0;
  @CAN_RadarFR::RFR_Object::RFR_Object_Obj42.AyVnce = 0;
  @CAN_RadarFR::RFR_Object::RFR_Object_Obj42.ExistProb = 0;
  @CAN_RadarFR::RFR_Object::RFR_Object_Obj42.FilterInformation = 0;
  @CAN_RadarFR::RFR_Object::RFR_Object_Obj42.Length = 0;
  @CAN_RadarFR::RFR_Object::RFR_Object_Obj42.LengthVnce = 0;
  @CAN_RadarFR::RFR_Object::RFR_Object_Obj42.MeasurementStatus = 0;
  @CAN_RadarFR::RFR_Object::RFR_Object_Obj42.MovingStatus = 0;
  @CAN_RadarFR::RFR_Object::RFR_Object_Obj42.ObjId = 0;
  @CAN_RadarFR::RFR_Object::RFR_Object_Obj42.OrientationYaw = 0;
  @CAN_RadarFR::RFR_Object::RFR_Object_Obj42.OrientationYawVnce = 0;
  @CAN_RadarFR::RFR_Object::RFR_Object_Obj42.ProbClassConfidence = 0;
  @CAN_RadarFR::RFR_Object::RFR_Object_Obj42.ProbClassType = 0;
  }
  if(init_count == 61)
  {
  @CAN_RadarFR::RFR_Object::RFR_Object_Obj42.Px = 0;
  @CAN_RadarFR::RFR_Object::RFR_Object_Obj42.PxAxCoVnce = 0;
  @CAN_RadarFR::RFR_Object::RFR_Object_Obj42.PxAyCoVnce = 0;
  @CAN_RadarFR::RFR_Object::RFR_Object_Obj42.PxPyCoVnce = 0;
  @CAN_RadarFR::RFR_Object::RFR_Object_Obj42.PxVnce = 0;
  @CAN_RadarFR::RFR_Object::RFR_Object_Obj42.PxVxCoVnce = 0;
  @CAN_RadarFR::RFR_Object::RFR_Object_Obj42.PxVyCoVnce = 0;
  @CAN_RadarFR::RFR_Object::RFR_Object_Obj42.Py = 0;
  @CAN_RadarFR::RFR_Object::RFR_Object_Obj42.PyAxCoVnce = 0;
  @CAN_RadarFR::RFR_Object::RFR_Object_Obj42.PyAyCoVnce = 0;
  @CAN_RadarFR::RFR_Object::RFR_Object_Obj42.PyVnce = 0;
  @CAN_RadarFR::RFR_Object::RFR_Object_Obj42.PyVxCoVnce = 0;
  @CAN_RadarFR::RFR_Object::RFR_Object_Obj42.PyVyCoVnce = 0;
  @CAN_RadarFR::RFR_Object::RFR_Object_Obj42.ReferencePoint = 0;
  @CAN_RadarFR::RFR_Object::RFR_Object_Obj42.Vx = 0;
  @CAN_RadarFR::RFR_Object::RFR_Object_Obj42.VxAxCoVnce = 0;
  @CAN_RadarFR::RFR_Object::RFR_Object_Obj42.VxAyCoVnce = 0;
  @CAN_RadarFR::RFR_Object::RFR_Object_Obj42.VxVnce = 0;
  @CAN_RadarFR::RFR_Object::RFR_Object_Obj42.VxVyCoVnce = 0;
  @CAN_RadarFR::RFR_Object::RFR_Object_Obj42.Vy = 0;
  @CAN_RadarFR::RFR_Object::RFR_Object_Obj42.VyAxCoVnce = 0;
  @CAN_RadarFR::RFR_Object::RFR_Object_Obj42.VyAyCoVnce = 0;
  @CAN_RadarFR::RFR_Object::RFR_Object_Obj42.VyVnce = 0;
  @CAN_RadarFR::RFR_Object::RFR_Object_Obj42.Width = 0;
  @CAN_RadarFR::RFR_Object::RFR_Object_Obj42.WidthVnce = 0;
  }
  if(init_count == 62)
  {
  @CAN_RadarFR::RFR_Object::RFR_Object_Obj43.Age = 0;
  @CAN_RadarFR::RFR_Object::RFR_Object_Obj43.Ax = 0;
  @CAN_RadarFR::RFR_Object::RFR_Object_Obj43.AxAyCoVnce = 0;
  @CAN_RadarFR::RFR_Object::RFR_Object_Obj43.AxVnce = 0;
  @CAN_RadarFR::RFR_Object::RFR_Object_Obj43.Ay = 0;
  @CAN_RadarFR::RFR_Object::RFR_Object_Obj43.AyVnce = 0;
  @CAN_RadarFR::RFR_Object::RFR_Object_Obj43.ExistProb = 0;
  @CAN_RadarFR::RFR_Object::RFR_Object_Obj43.FilterInformation = 0;
  @CAN_RadarFR::RFR_Object::RFR_Object_Obj43.Length = 0;
  @CAN_RadarFR::RFR_Object::RFR_Object_Obj43.LengthVnce = 0;
  @CAN_RadarFR::RFR_Object::RFR_Object_Obj43.MeasurementStatus = 0;
  @CAN_RadarFR::RFR_Object::RFR_Object_Obj43.MovingStatus = 0;
  @CAN_RadarFR::RFR_Object::RFR_Object_Obj43.ObjId = 0;
  @CAN_RadarFR::RFR_Object::RFR_Object_Obj43.OrientationYaw = 0;
  @CAN_RadarFR::RFR_Object::RFR_Object_Obj43.OrientationYawVnce = 0;
  @CAN_RadarFR::RFR_Object::RFR_Object_Obj43.ProbClassConfidence = 0;
  @CAN_RadarFR::RFR_Object::RFR_Object_Obj43.ProbClassType = 0;
  @CAN_RadarFR::RFR_Object::RFR_Object_Obj43.Px = 0;
  @CAN_RadarFR::RFR_Object::RFR_Object_Obj43.PxAxCoVnce = 0;
  @CAN_RadarFR::RFR_Object::RFR_Object_Obj43.PxAyCoVnce = 0;
  @CAN_RadarFR::RFR_Object::RFR_Object_Obj43.PxPyCoVnce = 0;
  @CAN_RadarFR::RFR_Object::RFR_Object_Obj43.PxVnce = 0;
  @CAN_RadarFR::RFR_Object::RFR_Object_Obj43.PxVxCoVnce = 0;
  @CAN_RadarFR::RFR_Object::RFR_Object_Obj43.PxVyCoVnce = 0;
  @CAN_RadarFR::RFR_Object::RFR_Object_Obj43.Py = 0;
  }
  if(init_count == 63)
  {
  @CAN_RadarFR::RFR_Object::RFR_Object_Obj43.PyAxCoVnce = 0;
  @CAN_RadarFR::RFR_Object::RFR_Object_Obj43.PyAyCoVnce = 0;
  @CAN_RadarFR::RFR_Object::RFR_Object_Obj43.PyVnce = 0;
  @CAN_RadarFR::RFR_Object::RFR_Object_Obj43.PyVxCoVnce = 0;
  @CAN_RadarFR::RFR_Object::RFR_Object_Obj43.PyVyCoVnce = 0;
  @CAN_RadarFR::RFR_Object::RFR_Object_Obj43.ReferencePoint = 0;
  @CAN_RadarFR::RFR_Object::RFR_Object_Obj43.Vx = 0;
  @CAN_RadarFR::RFR_Object::RFR_Object_Obj43.VxAxCoVnce = 0;
  @CAN_RadarFR::RFR_Object::RFR_Object_Obj43.VxAyCoVnce = 0;
  @CAN_RadarFR::RFR_Object::RFR_Object_Obj43.VxVnce = 0;
  @CAN_RadarFR::RFR_Object::RFR_Object_Obj43.VxVyCoVnce = 0;
  @CAN_RadarFR::RFR_Object::RFR_Object_Obj43.Vy = 0;
  @CAN_RadarFR::RFR_Object::RFR_Object_Obj43.VyAxCoVnce = 0;
  @CAN_RadarFR::RFR_Object::RFR_Object_Obj43.VyAyCoVnce = 0;
  @CAN_RadarFR::RFR_Object::RFR_Object_Obj43.VyVnce = 0;
  @CAN_RadarFR::RFR_Object::RFR_Object_Obj43.Width = 0;
  @CAN_RadarFR::RFR_Object::RFR_Object_Obj43.WidthVnce = 0;
  @CAN_RadarFR::RFR_Object::RFR_Object_Obj44.Age = 0;
  @CAN_RadarFR::RFR_Object::RFR_Object_Obj44.Ax = 0;
  @CAN_RadarFR::RFR_Object::RFR_Object_Obj44.AxAyCoVnce = 0;
  @CAN_RadarFR::RFR_Object::RFR_Object_Obj44.AxVnce = 0;
  @CAN_RadarFR::RFR_Object::RFR_Object_Obj44.Ay = 0;
  @CAN_RadarFR::RFR_Object::RFR_Object_Obj44.AyVnce = 0;
  @CAN_RadarFR::RFR_Object::RFR_Object_Obj44.ExistProb = 0;
  @CAN_RadarFR::RFR_Object::RFR_Object_Obj44.FilterInformation = 0;
  }
  if(init_count == 64)
  {
  @CAN_RadarFR::RFR_Object::RFR_Object_Obj44.Length = 0;
  @CAN_RadarFR::RFR_Object::RFR_Object_Obj44.LengthVnce = 0;
  @CAN_RadarFR::RFR_Object::RFR_Object_Obj44.MeasurementStatus = 0;
  @CAN_RadarFR::RFR_Object::RFR_Object_Obj44.MovingStatus = 0;
  @CAN_RadarFR::RFR_Object::RFR_Object_Obj44.ObjId = 0;
  @CAN_RadarFR::RFR_Object::RFR_Object_Obj44.OrientationYaw = 0;
  @CAN_RadarFR::RFR_Object::RFR_Object_Obj44.OrientationYawVnce = 0;
  @CAN_RadarFR::RFR_Object::RFR_Object_Obj44.ProbClassConfidence = 0;
  @CAN_RadarFR::RFR_Object::RFR_Object_Obj44.ProbClassType = 0;
  @CAN_RadarFR::RFR_Object::RFR_Object_Obj44.Px = 0;
  @CAN_RadarFR::RFR_Object::RFR_Object_Obj44.PxAxCoVnce = 0;
  @CAN_RadarFR::RFR_Object::RFR_Object_Obj44.PxAyCoVnce = 0;
  @CAN_RadarFR::RFR_Object::RFR_Object_Obj44.PxPyCoVnce = 0;
  @CAN_RadarFR::RFR_Object::RFR_Object_Obj44.PxVnce = 0;
  @CAN_RadarFR::RFR_Object::RFR_Object_Obj44.PxVxCoVnce = 0;
  @CAN_RadarFR::RFR_Object::RFR_Object_Obj44.PxVyCoVnce = 0;
  @CAN_RadarFR::RFR_Object::RFR_Object_Obj44.Py = 0;
  @CAN_RadarFR::RFR_Object::RFR_Object_Obj44.PyAxCoVnce = 0;
  @CAN_RadarFR::RFR_Object::RFR_Object_Obj44.PyAyCoVnce = 0;
  @CAN_RadarFR::RFR_Object::RFR_Object_Obj44.PyVnce = 0;
  @CAN_RadarFR::RFR_Object::RFR_Object_Obj44.PyVxCoVnce = 0;
  @CAN_RadarFR::RFR_Object::RFR_Object_Obj44.PyVyCoVnce = 0;
  @CAN_RadarFR::RFR_Object::RFR_Object_Obj44.ReferencePoint = 0;
  @CAN_RadarFR::RFR_Object::RFR_Object_Obj44.Vx = 0;
  @CAN_RadarFR::RFR_Object::RFR_Object_Obj44.VxAxCoVnce = 0;
  }
  if(init_count == 65)
  {
  @CAN_RadarFR::RFR_Object::RFR_Object_Obj44.VxAyCoVnce = 0;
  @CAN_RadarFR::RFR_Object::RFR_Object_Obj44.VxVnce = 0;
  @CAN_RadarFR::RFR_Object::RFR_Object_Obj44.VxVyCoVnce = 0;
  @CAN_RadarFR::RFR_Object::RFR_Object_Obj44.Vy = 0;
  @CAN_RadarFR::RFR_Object::RFR_Object_Obj44.VyAxCoVnce = 0;
  @CAN_RadarFR::RFR_Object::RFR_Object_Obj44.VyAyCoVnce = 0;
  @CAN_RadarFR::RFR_Object::RFR_Object_Obj44.VyVnce = 0;
  @CAN_RadarFR::RFR_Object::RFR_Object_Obj44.Width = 0;
  @CAN_RadarFR::RFR_Object::RFR_Object_Obj44.WidthVnce = 0;
  @CAN_RadarFR::RFR_Object::RFR_Object_Obj45.Age = 0;
  @CAN_RadarFR::RFR_Object::RFR_Object_Obj45.Ax = 0;
  @CAN_RadarFR::RFR_Object::RFR_Object_Obj45.AxAyCoVnce = 0;
  @CAN_RadarFR::RFR_Object::RFR_Object_Obj45.AxVnce = 0;
  @CAN_RadarFR::RFR_Object::RFR_Object_Obj45.Ay = 0;
  @CAN_RadarFR::RFR_Object::RFR_Object_Obj45.AyVnce = 0;
  @CAN_RadarFR::RFR_Object::RFR_Object_Obj45.ExistProb = 0;
  @CAN_RadarFR::RFR_Object::RFR_Object_Obj45.FilterInformation = 0;
  @CAN_RadarFR::RFR_Object::RFR_Object_Obj45.Length = 0;
  @CAN_RadarFR::RFR_Object::RFR_Object_Obj45.LengthVnce = 0;
  @CAN_RadarFR::RFR_Object::RFR_Object_Obj45.MeasurementStatus = 0;
  @CAN_RadarFR::RFR_Object::RFR_Object_Obj45.MovingStatus = 0;
  @CAN_RadarFR::RFR_Object::RFR_Object_Obj45.ObjId = 0;
  @CAN_RadarFR::RFR_Object::RFR_Object_Obj45.OrientationYaw = 0;
  @CAN_RadarFR::RFR_Object::RFR_Object_Obj45.OrientationYawVnce = 0;
  @CAN_RadarFR::RFR_Object::RFR_Object_Obj45.ProbClassConfidence = 0;
  }
  if(init_count == 66)
  {
  @CAN_RadarFR::RFR_Object::RFR_Object_Obj45.ProbClassType = 0;
  @CAN_RadarFR::RFR_Object::RFR_Object_Obj45.Px = 0;
  @CAN_RadarFR::RFR_Object::RFR_Object_Obj45.PxAxCoVnce = 0;
  @CAN_RadarFR::RFR_Object::RFR_Object_Obj45.PxAyCoVnce = 0;
  @CAN_RadarFR::RFR_Object::RFR_Object_Obj45.PxPyCoVnce = 0;
  @CAN_RadarFR::RFR_Object::RFR_Object_Obj45.PxVnce = 0;
  @CAN_RadarFR::RFR_Object::RFR_Object_Obj45.PxVxCoVnce = 0;
  @CAN_RadarFR::RFR_Object::RFR_Object_Obj45.PxVyCoVnce = 0;
  @CAN_RadarFR::RFR_Object::RFR_Object_Obj45.Py = 0;
  @CAN_RadarFR::RFR_Object::RFR_Object_Obj45.PyAxCoVnce = 0;
  @CAN_RadarFR::RFR_Object::RFR_Object_Obj45.PyAyCoVnce = 0;
  @CAN_RadarFR::RFR_Object::RFR_Object_Obj45.PyVnce = 0;
  @CAN_RadarFR::RFR_Object::RFR_Object_Obj45.PyVxCoVnce = 0;
  @CAN_RadarFR::RFR_Object::RFR_Object_Obj45.PyVyCoVnce = 0;
  @CAN_RadarFR::RFR_Object::RFR_Object_Obj45.ReferencePoint = 0;
  @CAN_RadarFR::RFR_Object::RFR_Object_Obj45.Vx = 0;
  @CAN_RadarFR::RFR_Object::RFR_Object_Obj45.VxAxCoVnce = 0;
  @CAN_RadarFR::RFR_Object::RFR_Object_Obj45.VxAyCoVnce = 0;
  @CAN_RadarFR::RFR_Object::RFR_Object_Obj45.VxVnce = 0;
  @CAN_RadarFR::RFR_Object::RFR_Object_Obj45.VxVyCoVnce = 0;
  @CAN_RadarFR::RFR_Object::RFR_Object_Obj45.Vy = 0;
  @CAN_RadarFR::RFR_Object::RFR_Object_Obj45.VyAxCoVnce = 0;
  @CAN_RadarFR::RFR_Object::RFR_Object_Obj45.VyAyCoVnce = 0;
  @CAN_RadarFR::RFR_Object::RFR_Object_Obj45.VyVnce = 0;
  @CAN_RadarFR::RFR_Object::RFR_Object_Obj45.Width = 0;
  }
  if(init_count == 67)
  {
  @CAN_RadarFR::RFR_Object::RFR_Object_Obj45.WidthVnce = 0;
  @CAN_RadarFR::RFR_Object::RFR_Object_Obj46.Age = 0;
  @CAN_RadarFR::RFR_Object::RFR_Object_Obj46.Ax = 0;
  @CAN_RadarFR::RFR_Object::RFR_Object_Obj46.AxAyCoVnce = 0;
  @CAN_RadarFR::RFR_Object::RFR_Object_Obj46.AxVnce = 0;
  @CAN_RadarFR::RFR_Object::RFR_Object_Obj46.Ay = 0;
  @CAN_RadarFR::RFR_Object::RFR_Object_Obj46.AyVnce = 0;
  @CAN_RadarFR::RFR_Object::RFR_Object_Obj46.ExistProb = 0;
  @CAN_RadarFR::RFR_Object::RFR_Object_Obj46.FilterInformation = 0;
  @CAN_RadarFR::RFR_Object::RFR_Object_Obj46.Length = 0;
  @CAN_RadarFR::RFR_Object::RFR_Object_Obj46.LengthVnce = 0;
  @CAN_RadarFR::RFR_Object::RFR_Object_Obj46.MeasurementStatus = 0;
  @CAN_RadarFR::RFR_Object::RFR_Object_Obj46.MovingStatus = 0;
  @CAN_RadarFR::RFR_Object::RFR_Object_Obj46.ObjId = 0;
  @CAN_RadarFR::RFR_Object::RFR_Object_Obj46.OrientationYaw = 0;
  @CAN_RadarFR::RFR_Object::RFR_Object_Obj46.OrientationYawVnce = 0;
  @CAN_RadarFR::RFR_Object::RFR_Object_Obj46.ProbClassConfidence = 0;
  @CAN_RadarFR::RFR_Object::RFR_Object_Obj46.ProbClassType = 0;
  @CAN_RadarFR::RFR_Object::RFR_Object_Obj46.Px = 0;
  @CAN_RadarFR::RFR_Object::RFR_Object_Obj46.PxAxCoVnce = 0;
  @CAN_RadarFR::RFR_Object::RFR_Object_Obj46.PxAyCoVnce = 0;
  @CAN_RadarFR::RFR_Object::RFR_Object_Obj46.PxPyCoVnce = 0;
  @CAN_RadarFR::RFR_Object::RFR_Object_Obj46.PxVnce = 0;
  @CAN_RadarFR::RFR_Object::RFR_Object_Obj46.PxVxCoVnce = 0;
  @CAN_RadarFR::RFR_Object::RFR_Object_Obj46.PxVyCoVnce = 0;
  }
  if(init_count == 68)
  {
  @CAN_RadarFR::RFR_Object::RFR_Object_Obj46.Py = 0;
  @CAN_RadarFR::RFR_Object::RFR_Object_Obj46.PyAxCoVnce = 0;
  @CAN_RadarFR::RFR_Object::RFR_Object_Obj46.PyAyCoVnce = 0;
  @CAN_RadarFR::RFR_Object::RFR_Object_Obj46.PyVnce = 0;
  @CAN_RadarFR::RFR_Object::RFR_Object_Obj46.PyVxCoVnce = 0;
  @CAN_RadarFR::RFR_Object::RFR_Object_Obj46.PyVyCoVnce = 0;
  @CAN_RadarFR::RFR_Object::RFR_Object_Obj46.ReferencePoint = 0;
  @CAN_RadarFR::RFR_Object::RFR_Object_Obj46.Vx = 0;
  @CAN_RadarFR::RFR_Object::RFR_Object_Obj46.VxAxCoVnce = 0;
  @CAN_RadarFR::RFR_Object::RFR_Object_Obj46.VxAyCoVnce = 0;
  @CAN_RadarFR::RFR_Object::RFR_Object_Obj46.VxVnce = 0;
  @CAN_RadarFR::RFR_Object::RFR_Object_Obj46.VxVyCoVnce = 0;
  @CAN_RadarFR::RFR_Object::RFR_Object_Obj46.Vy = 0;
  @CAN_RadarFR::RFR_Object::RFR_Object_Obj46.VyAxCoVnce = 0;
  @CAN_RadarFR::RFR_Object::RFR_Object_Obj46.VyAyCoVnce = 0;
  @CAN_RadarFR::RFR_Object::RFR_Object_Obj46.VyVnce = 0;
  @CAN_RadarFR::RFR_Object::RFR_Object_Obj46.Width = 0;
  @CAN_RadarFR::RFR_Object::RFR_Object_Obj46.WidthVnce = 0;
  @CAN_RadarFR::RFR_Object::RFR_Object_Obj47.Age = 0;
  @CAN_RadarFR::RFR_Object::RFR_Object_Obj47.Ax = 0;
  @CAN_RadarFR::RFR_Object::RFR_Object_Obj47.AxAyCoVnce = 0;
  @CAN_RadarFR::RFR_Object::RFR_Object_Obj47.AxVnce = 0;
  @CAN_RadarFR::RFR_Object::RFR_Object_Obj47.Ay = 0;
  @CAN_RadarFR::RFR_Object::RFR_Object_Obj47.AyVnce = 0;
  @CAN_RadarFR::RFR_Object::RFR_Object_Obj47.ExistProb = 0;
  }
  if(init_count == 69)
  {
  @CAN_RadarFR::RFR_Object::RFR_Object_Obj47.FilterInformation = 0;
  @CAN_RadarFR::RFR_Object::RFR_Object_Obj47.Length = 0;
  @CAN_RadarFR::RFR_Object::RFR_Object_Obj47.LengthVnce = 0;
  @CAN_RadarFR::RFR_Object::RFR_Object_Obj47.MeasurementStatus = 0;
  @CAN_RadarFR::RFR_Object::RFR_Object_Obj47.MovingStatus = 0;
  @CAN_RadarFR::RFR_Object::RFR_Object_Obj47.ObjId = 0;
  @CAN_RadarFR::RFR_Object::RFR_Object_Obj47.OrientationYaw = 0;
  @CAN_RadarFR::RFR_Object::RFR_Object_Obj47.OrientationYawVnce = 0;
  @CAN_RadarFR::RFR_Object::RFR_Object_Obj47.ProbClassConfidence = 0;
  @CAN_RadarFR::RFR_Object::RFR_Object_Obj47.ProbClassType = 0;
  @CAN_RadarFR::RFR_Object::RFR_Object_Obj47.Px = 0;
  @CAN_RadarFR::RFR_Object::RFR_Object_Obj47.PxAxCoVnce = 0;
  @CAN_RadarFR::RFR_Object::RFR_Object_Obj47.PxAyCoVnce = 0;
  @CAN_RadarFR::RFR_Object::RFR_Object_Obj47.PxPyCoVnce = 0;
  @CAN_RadarFR::RFR_Object::RFR_Object_Obj47.PxVnce = 0;
  @CAN_RadarFR::RFR_Object::RFR_Object_Obj47.PxVxCoVnce = 0;
  @CAN_RadarFR::RFR_Object::RFR_Object_Obj47.PxVyCoVnce = 0;
  @CAN_RadarFR::RFR_Object::RFR_Object_Obj47.Py = 0;
  @CAN_RadarFR::RFR_Object::RFR_Object_Obj47.PyAxCoVnce = 0;
  @CAN_RadarFR::RFR_Object::RFR_Object_Obj47.PyAyCoVnce = 0;
  @CAN_RadarFR::RFR_Object::RFR_Object_Obj47.PyVnce = 0;
  @CAN_RadarFR::RFR_Object::RFR_Object_Obj47.PyVxCoVnce = 0;
  @CAN_RadarFR::RFR_Object::RFR_Object_Obj47.PyVyCoVnce = 0;
  @CAN_RadarFR::RFR_Object::RFR_Object_Obj47.ReferencePoint = 0;
  @CAN_RadarFR::RFR_Object::RFR_Object_Obj47.Vx = 0;
  }
  if(init_count == 70)
  {
  @CAN_RadarFR::RFR_Object::RFR_Object_Obj47.VxAxCoVnce = 0;
  @CAN_RadarFR::RFR_Object::RFR_Object_Obj47.VxAyCoVnce = 0;
  @CAN_RadarFR::RFR_Object::RFR_Object_Obj47.VxVnce = 0;
  @CAN_RadarFR::RFR_Object::RFR_Object_Obj47.VxVyCoVnce = 0;
  @CAN_RadarFR::RFR_Object::RFR_Object_Obj47.Vy = 0;
  @CAN_RadarFR::RFR_Object::RFR_Object_Obj47.VyAxCoVnce = 0;
  @CAN_RadarFR::RFR_Object::RFR_Object_Obj47.VyAyCoVnce = 0;
  @CAN_RadarFR::RFR_Object::RFR_Object_Obj47.VyVnce = 0;
  @CAN_RadarFR::RFR_Object::RFR_Object_Obj47.Width = 0;
  @CAN_RadarFR::RFR_Object::RFR_Object_Obj47.WidthVnce = 0;
  @CAN_RadarFR::RFR_Object::RFR_Object_Obj48.Age = 0;
  @CAN_RadarFR::RFR_Object::RFR_Object_Obj48.Ax = 0;
  @CAN_RadarFR::RFR_Object::RFR_Object_Obj48.AxAyCoVnce = 0;
  @CAN_RadarFR::RFR_Object::RFR_Object_Obj48.AxVnce = 0;
  @CAN_RadarFR::RFR_Object::RFR_Object_Obj48.Ay = 0;
  @CAN_RadarFR::RFR_Object::RFR_Object_Obj48.AyVnce = 0;
  @CAN_RadarFR::RFR_Object::RFR_Object_Obj48.ExistProb = 0;
  @CAN_RadarFR::RFR_Object::RFR_Object_Obj48.FilterInformation = 0;
  @CAN_RadarFR::RFR_Object::RFR_Object_Obj48.Length = 0;
  @CAN_RadarFR::RFR_Object::RFR_Object_Obj48.LengthVnce = 0;
  @CAN_RadarFR::RFR_Object::RFR_Object_Obj48.MeasurementStatus = 0;
  @CAN_RadarFR::RFR_Object::RFR_Object_Obj48.MovingStatus = 0;
  @CAN_RadarFR::RFR_Object::RFR_Object_Obj48.ObjId = 0;
  @CAN_RadarFR::RFR_Object::RFR_Object_Obj48.OrientationYaw = 0;
  @CAN_RadarFR::RFR_Object::RFR_Object_Obj48.OrientationYawVnce = 0;
  }
  if(init_count == 71)
  {
  @CAN_RadarFR::RFR_Object::RFR_Object_Obj48.ProbClassConfidence = 0;
  @CAN_RadarFR::RFR_Object::RFR_Object_Obj48.ProbClassType = 0;
  @CAN_RadarFR::RFR_Object::RFR_Object_Obj48.Px = 0;
  @CAN_RadarFR::RFR_Object::RFR_Object_Obj48.PxAxCoVnce = 0;
  @CAN_RadarFR::RFR_Object::RFR_Object_Obj48.PxAyCoVnce = 0;
  @CAN_RadarFR::RFR_Object::RFR_Object_Obj48.PxPyCoVnce = 0;
  @CAN_RadarFR::RFR_Object::RFR_Object_Obj48.PxVnce = 0;
  @CAN_RadarFR::RFR_Object::RFR_Object_Obj48.PxVxCoVnce = 0;
  @CAN_RadarFR::RFR_Object::RFR_Object_Obj48.PxVyCoVnce = 0;
  @CAN_RadarFR::RFR_Object::RFR_Object_Obj48.Py = 0;
  @CAN_RadarFR::RFR_Object::RFR_Object_Obj48.PyAxCoVnce = 0;
  @CAN_RadarFR::RFR_Object::RFR_Object_Obj48.PyAyCoVnce = 0;
  @CAN_RadarFR::RFR_Object::RFR_Object_Obj48.PyVnce = 0;
  @CAN_RadarFR::RFR_Object::RFR_Object_Obj48.PyVxCoVnce = 0;
  @CAN_RadarFR::RFR_Object::RFR_Object_Obj48.PyVyCoVnce = 0;
  @CAN_RadarFR::RFR_Object::RFR_Object_Obj48.ReferencePoint = 0;
  @CAN_RadarFR::RFR_Object::RFR_Object_Obj48.Vx = 0;
  @CAN_RadarFR::RFR_Object::RFR_Object_Obj48.VxAxCoVnce = 0;
  @CAN_RadarFR::RFR_Object::RFR_Object_Obj48.VxAyCoVnce = 0;
  @CAN_RadarFR::RFR_Object::RFR_Object_Obj48.VxVnce = 0;
  @CAN_RadarFR::RFR_Object::RFR_Object_Obj48.VxVyCoVnce = 0;
  @CAN_RadarFR::RFR_Object::RFR_Object_Obj48.Vy = 0;
  @CAN_RadarFR::RFR_Object::RFR_Object_Obj48.VyAxCoVnce = 0;
  @CAN_RadarFR::RFR_Object::RFR_Object_Obj48.VyAyCoVnce = 0;
  @CAN_RadarFR::RFR_Object::RFR_Object_Obj48.VyVnce = 0;
  }
  if(init_count == 72)
  {
  @CAN_RadarFR::RFR_Object::RFR_Object_Obj48.Width = 0;
  @CAN_RadarFR::RFR_Object::RFR_Object_Obj48.WidthVnce = 0;
  @CAN_RadarFR::RFR_Object::RFR_Object_Obj4.Age = 0;
  @CAN_RadarFR::RFR_Object::RFR_Object_Obj4.Ax = 0;
  @CAN_RadarFR::RFR_Object::RFR_Object_Obj4.AxAyCoVnce = 0;
  @CAN_RadarFR::RFR_Object::RFR_Object_Obj4.AxVnce = 0;
  @CAN_RadarFR::RFR_Object::RFR_Object_Obj4.Ay = 0;
  @CAN_RadarFR::RFR_Object::RFR_Object_Obj4.AyVnce = 0;
  @CAN_RadarFR::RFR_Object::RFR_Object_Obj4.ExistProb = 0;
  @CAN_RadarFR::RFR_Object::RFR_Object_Obj4.FilterInformation = 0;
  @CAN_RadarFR::RFR_Object::RFR_Object_Obj4.Length = 0;
  @CAN_RadarFR::RFR_Object::RFR_Object_Obj4.LengthVnce = 0;
  @CAN_RadarFR::RFR_Object::RFR_Object_Obj4.MeasurementStatus = 0;
  @CAN_RadarFR::RFR_Object::RFR_Object_Obj4.MovingStatus = 0;
  @CAN_RadarFR::RFR_Object::RFR_Object_Obj4.ObjId = 0;
  @CAN_RadarFR::RFR_Object::RFR_Object_Obj4.OrientationYaw = 0;
  @CAN_RadarFR::RFR_Object::RFR_Object_Obj4.OrientationYawVnce = 0;
  @CAN_RadarFR::RFR_Object::RFR_Object_Obj4.ProbClassConfidence = 0;
  @CAN_RadarFR::RFR_Object::RFR_Object_Obj4.ProbClassType = 0;
  @CAN_RadarFR::RFR_Object::RFR_Object_Obj4.Px = 0;
  @CAN_RadarFR::RFR_Object::RFR_Object_Obj4.PxAxCoVnce = 0;
  @CAN_RadarFR::RFR_Object::RFR_Object_Obj4.PxAyCoVnce = 0;
  @CAN_RadarFR::RFR_Object::RFR_Object_Obj4.PxPyCoVnce = 0;
  @CAN_RadarFR::RFR_Object::RFR_Object_Obj4.PxVnce = 0;
  @CAN_RadarFR::RFR_Object::RFR_Object_Obj4.PxVxCoVnce = 0;
  }
  if(init_count == 73)
  {
  @CAN_RadarFR::RFR_Object::RFR_Object_Obj4.PxVyCoVnce = 0;
  @CAN_RadarFR::RFR_Object::RFR_Object_Obj4.Py = 0;
  @CAN_RadarFR::RFR_Object::RFR_Object_Obj4.PyAxCoVnce = 0;
  @CAN_RadarFR::RFR_Object::RFR_Object_Obj4.PyAyCoVnce = 0;
  @CAN_RadarFR::RFR_Object::RFR_Object_Obj4.PyVnce = 0;
  @CAN_RadarFR::RFR_Object::RFR_Object_Obj4.PyVxCoVnce = 0;
  @CAN_RadarFR::RFR_Object::RFR_Object_Obj4.PyVyCoVnce = 0;
  @CAN_RadarFR::RFR_Object::RFR_Object_Obj4.ReferencePoint = 0;
  @CAN_RadarFR::RFR_Object::RFR_Object_Obj4.Vx = 0;
  @CAN_RadarFR::RFR_Object::RFR_Object_Obj4.VxAxCoVnce = 0;
  @CAN_RadarFR::RFR_Object::RFR_Object_Obj4.VxAyCoVnce = 0;
  @CAN_RadarFR::RFR_Object::RFR_Object_Obj4.VxVnce = 0;
  @CAN_RadarFR::RFR_Object::RFR_Object_Obj4.VxVyCoVnce = 0;
  @CAN_RadarFR::RFR_Object::RFR_Object_Obj4.Vy = 0;
  @CAN_RadarFR::RFR_Object::RFR_Object_Obj4.VyAxCoVnce = 0;
  @CAN_RadarFR::RFR_Object::RFR_Object_Obj4.VyAyCoVnce = 0;
  @CAN_RadarFR::RFR_Object::RFR_Object_Obj4.VyVnce = 0;
  @CAN_RadarFR::RFR_Object::RFR_Object_Obj4.Width = 0;
  @CAN_RadarFR::RFR_Object::RFR_Object_Obj4.WidthVnce = 0;
  @CAN_RadarFR::RFR_Object::RFR_Object_Obj5.Age = 0;
  @CAN_RadarFR::RFR_Object::RFR_Object_Obj5.Ax = 0;
  @CAN_RadarFR::RFR_Object::RFR_Object_Obj5.AxAyCoVnce = 0;
  @CAN_RadarFR::RFR_Object::RFR_Object_Obj5.AxVnce = 0;
  @CAN_RadarFR::RFR_Object::RFR_Object_Obj5.Ay = 0;
  @CAN_RadarFR::RFR_Object::RFR_Object_Obj5.AyVnce = 0;
  }
  if(init_count == 74)
  {
  @CAN_RadarFR::RFR_Object::RFR_Object_Obj5.ExistProb = 0;
  @CAN_RadarFR::RFR_Object::RFR_Object_Obj5.FilterInformation = 0;
  @CAN_RadarFR::RFR_Object::RFR_Object_Obj5.Length = 0;
  @CAN_RadarFR::RFR_Object::RFR_Object_Obj5.LengthVnce = 0;
  @CAN_RadarFR::RFR_Object::RFR_Object_Obj5.MeasurementStatus = 0;
  @CAN_RadarFR::RFR_Object::RFR_Object_Obj5.MovingStatus = 0;
  @CAN_RadarFR::RFR_Object::RFR_Object_Obj5.ObjId = 0;
  @CAN_RadarFR::RFR_Object::RFR_Object_Obj5.OrientationYaw = 0;
  @CAN_RadarFR::RFR_Object::RFR_Object_Obj5.OrientationYawVnce = 0;
  @CAN_RadarFR::RFR_Object::RFR_Object_Obj5.ProbClassConfidence = 0;
  @CAN_RadarFR::RFR_Object::RFR_Object_Obj5.ProbClassType = 0;
  @CAN_RadarFR::RFR_Object::RFR_Object_Obj5.Px = 0;
  @CAN_RadarFR::RFR_Object::RFR_Object_Obj5.PxAxCoVnce = 0;
  @CAN_RadarFR::RFR_Object::RFR_Object_Obj5.PxAyCoVnce = 0;
  @CAN_RadarFR::RFR_Object::RFR_Object_Obj5.PxPyCoVnce = 0;
  @CAN_RadarFR::RFR_Object::RFR_Object_Obj5.PxVnce = 0;
  @CAN_RadarFR::RFR_Object::RFR_Object_Obj5.PxVxCoVnce = 0;
  @CAN_RadarFR::RFR_Object::RFR_Object_Obj5.PxVyCoVnce = 0;
  @CAN_RadarFR::RFR_Object::RFR_Object_Obj5.Py = 0;
  @CAN_RadarFR::RFR_Object::RFR_Object_Obj5.PyAxCoVnce = 0;
  @CAN_RadarFR::RFR_Object::RFR_Object_Obj5.PyAyCoVnce = 0;
  @CAN_RadarFR::RFR_Object::RFR_Object_Obj5.PyVnce = 0;
  @CAN_RadarFR::RFR_Object::RFR_Object_Obj5.PyVxCoVnce = 0;
  @CAN_RadarFR::RFR_Object::RFR_Object_Obj5.PyVyCoVnce = 0;
  @CAN_RadarFR::RFR_Object::RFR_Object_Obj5.ReferencePoint = 0;
  }
  if(init_count == 75)
  {
  @CAN_RadarFR::RFR_Object::RFR_Object_Obj5.Vx = 0;
  @CAN_RadarFR::RFR_Object::RFR_Object_Obj5.VxAxCoVnce = 0;
  @CAN_RadarFR::RFR_Object::RFR_Object_Obj5.VxAyCoVnce = 0;
  @CAN_RadarFR::RFR_Object::RFR_Object_Obj5.VxVnce = 0;
  @CAN_RadarFR::RFR_Object::RFR_Object_Obj5.VxVyCoVnce = 0;
  @CAN_RadarFR::RFR_Object::RFR_Object_Obj5.Vy = 0;
  @CAN_RadarFR::RFR_Object::RFR_Object_Obj5.VyAxCoVnce = 0;
  @CAN_RadarFR::RFR_Object::RFR_Object_Obj5.VyAyCoVnce = 0;
  @CAN_RadarFR::RFR_Object::RFR_Object_Obj5.VyVnce = 0;
  @CAN_RadarFR::RFR_Object::RFR_Object_Obj5.Width = 0;
  @CAN_RadarFR::RFR_Object::RFR_Object_Obj5.WidthVnce = 0;
  @CAN_RadarFR::RFR_Object::RFR_Object_Obj6.Age = 0;
  @CAN_RadarFR::RFR_Object::RFR_Object_Obj6.Ax = 0;
  @CAN_RadarFR::RFR_Object::RFR_Object_Obj6.AxAyCoVnce = 0;
  @CAN_RadarFR::RFR_Object::RFR_Object_Obj6.AxVnce = 0;
  @CAN_RadarFR::RFR_Object::RFR_Object_Obj6.Ay = 0;
  @CAN_RadarFR::RFR_Object::RFR_Object_Obj6.AyVnce = 0;
  @CAN_RadarFR::RFR_Object::RFR_Object_Obj6.ExistProb = 0;
  @CAN_RadarFR::RFR_Object::RFR_Object_Obj6.FilterInformation = 0;
  @CAN_RadarFR::RFR_Object::RFR_Object_Obj6.Length = 0;
  @CAN_RadarFR::RFR_Object::RFR_Object_Obj6.LengthVnce = 0;
  @CAN_RadarFR::RFR_Object::RFR_Object_Obj6.MeasurementStatus = 0;
  @CAN_RadarFR::RFR_Object::RFR_Object_Obj6.MovingStatus = 0;
  @CAN_RadarFR::RFR_Object::RFR_Object_Obj6.ObjId = 0;
  @CAN_RadarFR::RFR_Object::RFR_Object_Obj6.OrientationYaw = 0;
  }
  if(init_count == 76)
  {
  @CAN_RadarFR::RFR_Object::RFR_Object_Obj6.OrientationYawVnce = 0;
  @CAN_RadarFR::RFR_Object::RFR_Object_Obj6.ProbClassConfidence = 0;
  @CAN_RadarFR::RFR_Object::RFR_Object_Obj6.ProbClassType = 0;
  @CAN_RadarFR::RFR_Object::RFR_Object_Obj6.Px = 0;
  @CAN_RadarFR::RFR_Object::RFR_Object_Obj6.PxAxCoVnce = 0;
  @CAN_RadarFR::RFR_Object::RFR_Object_Obj6.PxAyCoVnce = 0;
  @CAN_RadarFR::RFR_Object::RFR_Object_Obj6.PxPyCoVnce = 0;
  @CAN_RadarFR::RFR_Object::RFR_Object_Obj6.PxVnce = 0;
  @CAN_RadarFR::RFR_Object::RFR_Object_Obj6.PxVxCoVnce = 0;
  @CAN_RadarFR::RFR_Object::RFR_Object_Obj6.PxVyCoVnce = 0;
  @CAN_RadarFR::RFR_Object::RFR_Object_Obj6.Py = 0;
  @CAN_RadarFR::RFR_Object::RFR_Object_Obj6.PyAxCoVnce = 0;
  @CAN_RadarFR::RFR_Object::RFR_Object_Obj6.PyAyCoVnce = 0;
  @CAN_RadarFR::RFR_Object::RFR_Object_Obj6.PyVnce = 0;
  @CAN_RadarFR::RFR_Object::RFR_Object_Obj6.PyVxCoVnce = 0;
  @CAN_RadarFR::RFR_Object::RFR_Object_Obj6.PyVyCoVnce = 0;
  @CAN_RadarFR::RFR_Object::RFR_Object_Obj6.ReferencePoint = 0;
  @CAN_RadarFR::RFR_Object::RFR_Object_Obj6.Vx = 0;
  @CAN_RadarFR::RFR_Object::RFR_Object_Obj6.VxAxCoVnce = 0;
  @CAN_RadarFR::RFR_Object::RFR_Object_Obj6.VxAyCoVnce = 0;
  @CAN_RadarFR::RFR_Object::RFR_Object_Obj6.VxVnce = 0;
  @CAN_RadarFR::RFR_Object::RFR_Object_Obj6.VxVyCoVnce = 0;
  @CAN_RadarFR::RFR_Object::RFR_Object_Obj6.Vy = 0;
  @CAN_RadarFR::RFR_Object::RFR_Object_Obj6.VyAxCoVnce = 0;
  @CAN_RadarFR::RFR_Object::RFR_Object_Obj6.VyAyCoVnce = 0;
  }
  if(init_count == 77)
  {
  @CAN_RadarFR::RFR_Object::RFR_Object_Obj6.VyVnce = 0;
  @CAN_RadarFR::RFR_Object::RFR_Object_Obj6.Width = 0;
  @CAN_RadarFR::RFR_Object::RFR_Object_Obj6.WidthVnce = 0;
  @CAN_RadarFR::RFR_Object::RFR_Object_Obj7.Age = 0;
  @CAN_RadarFR::RFR_Object::RFR_Object_Obj7.Ax = 0;
  @CAN_RadarFR::RFR_Object::RFR_Object_Obj7.AxAyCoVnce = 0;
  @CAN_RadarFR::RFR_Object::RFR_Object_Obj7.AxVnce = 0;
  @CAN_RadarFR::RFR_Object::RFR_Object_Obj7.Ay = 0;
  @CAN_RadarFR::RFR_Object::RFR_Object_Obj7.AyVnce = 0;
  @CAN_RadarFR::RFR_Object::RFR_Object_Obj7.ExistProb = 0;
  @CAN_RadarFR::RFR_Object::RFR_Object_Obj7.FilterInformation = 0;
  @CAN_RadarFR::RFR_Object::RFR_Object_Obj7.Length = 0;
  @CAN_RadarFR::RFR_Object::RFR_Object_Obj7.LengthVnce = 0;
  @CAN_RadarFR::RFR_Object::RFR_Object_Obj7.MeasurementStatus = 0;
  @CAN_RadarFR::RFR_Object::RFR_Object_Obj7.MovingStatus = 0;
  @CAN_RadarFR::RFR_Object::RFR_Object_Obj7.ObjId = 0;
  @CAN_RadarFR::RFR_Object::RFR_Object_Obj7.OrientationYaw = 0;
  @CAN_RadarFR::RFR_Object::RFR_Object_Obj7.OrientationYawVnce = 0;
  @CAN_RadarFR::RFR_Object::RFR_Object_Obj7.ProbClassConfidence = 0;
  @CAN_RadarFR::RFR_Object::RFR_Object_Obj7.ProbClassType = 0;
  @CAN_RadarFR::RFR_Object::RFR_Object_Obj7.Px = 0;
  @CAN_RadarFR::RFR_Object::RFR_Object_Obj7.PxAxCoVnce = 0;
  @CAN_RadarFR::RFR_Object::RFR_Object_Obj7.PxAyCoVnce = 0;
  @CAN_RadarFR::RFR_Object::RFR_Object_Obj7.PxPyCoVnce = 0;
  @CAN_RadarFR::RFR_Object::RFR_Object_Obj7.PxVnce = 0;
  }
  if(init_count == 78)
  {
  @CAN_RadarFR::RFR_Object::RFR_Object_Obj7.PxVxCoVnce = 0;
  @CAN_RadarFR::RFR_Object::RFR_Object_Obj7.PxVyCoVnce = 0;
  @CAN_RadarFR::RFR_Object::RFR_Object_Obj7.Py = 0;
  @CAN_RadarFR::RFR_Object::RFR_Object_Obj7.PyAxCoVnce = 0;
  @CAN_RadarFR::RFR_Object::RFR_Object_Obj7.PyAyCoVnce = 0;
  @CAN_RadarFR::RFR_Object::RFR_Object_Obj7.PyVnce = 0;
  @CAN_RadarFR::RFR_Object::RFR_Object_Obj7.PyVxCoVnce = 0;
  @CAN_RadarFR::RFR_Object::RFR_Object_Obj7.PyVyCoVnce = 0;
  @CAN_RadarFR::RFR_Object::RFR_Object_Obj7.ReferencePoint = 0;
  @CAN_RadarFR::RFR_Object::RFR_Object_Obj7.Vx = 0;
  @CAN_RadarFR::RFR_Object::RFR_Object_Obj7.VxAxCoVnce = 0;
  @CAN_RadarFR::RFR_Object::RFR_Object_Obj7.VxAyCoVnce = 0;
  @CAN_RadarFR::RFR_Object::RFR_Object_Obj7.VxVnce = 0;
  @CAN_RadarFR::RFR_Object::RFR_Object_Obj7.VxVyCoVnce = 0;
  @CAN_RadarFR::RFR_Object::RFR_Object_Obj7.Vy = 0;
  @CAN_RadarFR::RFR_Object::RFR_Object_Obj7.VyAxCoVnce = 0;
  @CAN_RadarFR::RFR_Object::RFR_Object_Obj7.VyAyCoVnce = 0;
  @CAN_RadarFR::RFR_Object::RFR_Object_Obj7.VyVnce = 0;
  @CAN_RadarFR::RFR_Object::RFR_Object_Obj7.Width = 0;
  @CAN_RadarFR::RFR_Object::RFR_Object_Obj7.WidthVnce = 0;
  @CAN_RadarFR::RFR_Object::RFR_Object_Obj8.Age = 0;
  @CAN_RadarFR::RFR_Object::RFR_Object_Obj8.Ax = 0;
  @CAN_RadarFR::RFR_Object::RFR_Object_Obj8.AxAyCoVnce = 0;
  @CAN_RadarFR::RFR_Object::RFR_Object_Obj8.AxVnce = 0;
  @CAN_RadarFR::RFR_Object::RFR_Object_Obj8.Ay = 0;
  }
  if(init_count == 79)
  {
  @CAN_RadarFR::RFR_Object::RFR_Object_Obj8.AyVnce = 0;
  @CAN_RadarFR::RFR_Object::RFR_Object_Obj8.ExistProb = 0;
  @CAN_RadarFR::RFR_Object::RFR_Object_Obj8.FilterInformation = 0;
  @CAN_RadarFR::RFR_Object::RFR_Object_Obj8.Length = 0;
  @CAN_RadarFR::RFR_Object::RFR_Object_Obj8.LengthVnce = 0;
  @CAN_RadarFR::RFR_Object::RFR_Object_Obj8.MeasurementStatus = 0;
  @CAN_RadarFR::RFR_Object::RFR_Object_Obj8.MovingStatus = 0;
  @CAN_RadarFR::RFR_Object::RFR_Object_Obj8.ObjId = 0;
  @CAN_RadarFR::RFR_Object::RFR_Object_Obj8.OrientationYaw = 0;
  @CAN_RadarFR::RFR_Object::RFR_Object_Obj8.OrientationYawVnce = 0;
  @CAN_RadarFR::RFR_Object::RFR_Object_Obj8.ProbClassConfidence = 0;
  @CAN_RadarFR::RFR_Object::RFR_Object_Obj8.ProbClassType = 0;
  @CAN_RadarFR::RFR_Object::RFR_Object_Obj8.Px = 0;
  @CAN_RadarFR::RFR_Object::RFR_Object_Obj8.PxAxCoVnce = 0;
  @CAN_RadarFR::RFR_Object::RFR_Object_Obj8.PxAyCoVnce = 0;
  @CAN_RadarFR::RFR_Object::RFR_Object_Obj8.PxPyCoVnce = 0;
  @CAN_RadarFR::RFR_Object::RFR_Object_Obj8.PxVnce = 0;
  @CAN_RadarFR::RFR_Object::RFR_Object_Obj8.PxVxCoVnce = 0;
  @CAN_RadarFR::RFR_Object::RFR_Object_Obj8.PxVyCoVnce = 0;
  @CAN_RadarFR::RFR_Object::RFR_Object_Obj8.Py = 0;
  @CAN_RadarFR::RFR_Object::RFR_Object_Obj8.PyAxCoVnce = 0;
  @CAN_RadarFR::RFR_Object::RFR_Object_Obj8.PyAyCoVnce = 0;
  @CAN_RadarFR::RFR_Object::RFR_Object_Obj8.PyVnce = 0;
  @CAN_RadarFR::RFR_Object::RFR_Object_Obj8.PyVxCoVnce = 0;
  @CAN_RadarFR::RFR_Object::RFR_Object_Obj8.PyVyCoVnce = 0;
  }
  if(init_count == 80)
  {
  @CAN_RadarFR::RFR_Object::RFR_Object_Obj8.ReferencePoint = 0;
  @CAN_RadarFR::RFR_Object::RFR_Object_Obj8.Vx = 0;
  @CAN_RadarFR::RFR_Object::RFR_Object_Obj8.VxAxCoVnce = 0;
  @CAN_RadarFR::RFR_Object::RFR_Object_Obj8.VxAyCoVnce = 0;
  @CAN_RadarFR::RFR_Object::RFR_Object_Obj8.VxVnce = 0;
  @CAN_RadarFR::RFR_Object::RFR_Object_Obj8.VxVyCoVnce = 0;
  @CAN_RadarFR::RFR_Object::RFR_Object_Obj8.Vy = 0;
  @CAN_RadarFR::RFR_Object::RFR_Object_Obj8.VyAxCoVnce = 0;
  @CAN_RadarFR::RFR_Object::RFR_Object_Obj8.VyAyCoVnce = 0;
  @CAN_RadarFR::RFR_Object::RFR_Object_Obj8.VyVnce = 0;
  @CAN_RadarFR::RFR_Object::RFR_Object_Obj8.Width = 0;
  @CAN_RadarFR::RFR_Object::RFR_Object_Obj8.WidthVnce = 0;
  @CAN_RadarFR::RFR_Object::RFR_Object_Obj9.Age = 0;
  @CAN_RadarFR::RFR_Object::RFR_Object_Obj9.Ax = 0;
  @CAN_RadarFR::RFR_Object::RFR_Object_Obj9.AxAyCoVnce = 0;
  @CAN_RadarFR::RFR_Object::RFR_Object_Obj9.AxVnce = 0;
  @CAN_RadarFR::RFR_Object::RFR_Object_Obj9.Ay = 0;
  @CAN_RadarFR::RFR_Object::RFR_Object_Obj9.AyVnce = 0;
  @CAN_RadarFR::RFR_Object::RFR_Object_Obj9.ExistProb = 0;
  @CAN_RadarFR::RFR_Object::RFR_Object_Obj9.FilterInformation = 0;
  @CAN_RadarFR::RFR_Object::RFR_Object_Obj9.Length = 0;
  @CAN_RadarFR::RFR_Object::RFR_Object_Obj9.LengthVnce = 0;
  @CAN_RadarFR::RFR_Object::RFR_Object_Obj9.MeasurementStatus = 0;
  @CAN_RadarFR::RFR_Object::RFR_Object_Obj9.MovingStatus = 0;
  @CAN_RadarFR::RFR_Object::RFR_Object_Obj9.ObjId = 0;
  }
  if(init_count == 81)
  {
  @CAN_RadarFR::RFR_Object::RFR_Object_Obj9.OrientationYaw = 0;
  @CAN_RadarFR::RFR_Object::RFR_Object_Obj9.OrientationYawVnce = 0;
  @CAN_RadarFR::RFR_Object::RFR_Object_Obj9.ProbClassConfidence = 0;
  @CAN_RadarFR::RFR_Object::RFR_Object_Obj9.ProbClassType = 0;
  @CAN_RadarFR::RFR_Object::RFR_Object_Obj9.Px = 0;
  @CAN_RadarFR::RFR_Object::RFR_Object_Obj9.PxAxCoVnce = 0;
  @CAN_RadarFR::RFR_Object::RFR_Object_Obj9.PxAyCoVnce = 0;
  @CAN_RadarFR::RFR_Object::RFR_Object_Obj9.PxPyCoVnce = 0;
  @CAN_RadarFR::RFR_Object::RFR_Object_Obj9.PxVnce = 0;
  @CAN_RadarFR::RFR_Object::RFR_Object_Obj9.PxVxCoVnce = 0;
  @CAN_RadarFR::RFR_Object::RFR_Object_Obj9.PxVyCoVnce = 0;
  @CAN_RadarFR::RFR_Object::RFR_Object_Obj9.Py = 0;
  @CAN_RadarFR::RFR_Object::RFR_Object_Obj9.PyAxCoVnce = 0;
  @CAN_RadarFR::RFR_Object::RFR_Object_Obj9.PyAyCoVnce = 0;
  @CAN_RadarFR::RFR_Object::RFR_Object_Obj9.PyVnce = 0;
  @CAN_RadarFR::RFR_Object::RFR_Object_Obj9.PyVxCoVnce = 0;
  @CAN_RadarFR::RFR_Object::RFR_Object_Obj9.PyVyCoVnce = 0;
  @CAN_RadarFR::RFR_Object::RFR_Object_Obj9.ReferencePoint = 0;
  @CAN_RadarFR::RFR_Object::RFR_Object_Obj9.Vx = 0;
  @CAN_RadarFR::RFR_Object::RFR_Object_Obj9.VxAxCoVnce = 0;
  @CAN_RadarFR::RFR_Object::RFR_Object_Obj9.VxAyCoVnce = 0;
  @CAN_RadarFR::RFR_Object::RFR_Object_Obj9.VxVnce = 0;
  @CAN_RadarFR::RFR_Object::RFR_Object_Obj9.VxVyCoVnce = 0;
  @CAN_RadarFR::RFR_Object::RFR_Object_Obj9.Vy = 0;
  @CAN_RadarFR::RFR_Object::RFR_Object_Obj9.VyAxCoVnce = 0;
  }
  if(init_count == 82)
  {
  @CAN_RadarFR::RFR_Object::RFR_Object_Obj9.VyAyCoVnce = 0;
  @CAN_RadarFR::RFR_Object::RFR_Object_Obj9.VyVnce = 0;
  @CAN_RadarFR::RFR_Object::RFR_Object_Obj9.Width = 0;
  @CAN_RadarFR::RFR_Object::RFR_Object_Obj9.WidthVnce = 0;
  @CAN_RadarFR::RFR_Object::RFR_Object_ObjHdr_NumValidObjects = 0;
  @CAN_RadarFR::RFR_Object::RFR_Object_ObjHdr_TimeStamp = 0;
  @CAN_RadarFR::RFR_Object::RFR_Object_ObjHdr_TimeStampStatus = 0;
  @CAN_RadarFR::RFR_Object::RFR_Object_ObjHdr_VersionIdMajor = 0;
  @CAN_RadarFR::RFR_Object::RFR_Object_ObjHdr_VersionIdMinor = 0;
  @CAN_RadarFR::RFR_Object::RFR_Object_ObjHdr_VersionPatch = 0;
  @CAN_RadarFR::RFR_Object::RFR_Object_ObjHdr_content_type = 0;
  @CAN_RadarFR::RFR_Object::RFR_Object_ShiiHdr_DataMeasured = 0;
  @CAN_RadarFR::RFR_Object::RFR_Object_ShiiHdr_MisAzOOPCause = 0;
  @CAN_RadarFR::RFR_Object::RFR_Object_ShiiHdr_MisElOOPCause = 0;
  @CAN_RadarFR::RFR_Object::RFR_Object_ShiiHdr_RatioAdvProcListProc = 0;
  @CAN_RadarFR::RFR_Object::RFR_Object_ShiiHdr_SensorCalExtStat = 0;
  @CAN_RadarFR::RFR_Object::RFR_Object_ShiiHdr_SensorCalIntStat = 0;
  @CAN_RadarFR::RFR_Object::RFR_Object_ShiiHdr_SensorCalOnlStat = 0;
  @CAN_RadarFR::RFR_Object::RFR_Object_ShiiHdr_SensorFailureReas = 0;
  @CAN_RadarFR::RFR_Object::RFR_Object_ShiiHdr_SensorHeatingStatus = 0;
  @CAN_RadarFR::RFR_Object::RFR_Object_ShiiHdr_SensorOmmOpMode = 0;
  @CAN_RadarFR::RFR_Object::RFR_Object_ShiiHdr_ThermalDegr = 0;
  @CAN_RadarFR::RFR_Object::RFR_Object_SpiHdr_BldFov_Confidence = 0;
  @CAN_RadarFR::RFR_Object::RFR_Object_SpiHdr_BldFov_Status = 0;
  @CAN_RadarFR::RFR_Object::RFR_Object_SpiHdr_BldOperationMode = 0;
  }
  if(init_count == 83)
  {
  @CAN_RadarFR::RFR_Object::RFR_Object_SpiHdr_DistMaxProc = 0;
  @CAN_RadarFR::RFR_Object::RFR_Object_SpiHdr_DistMeasMaxMod = 0;
  @CAN_RadarFR::RFR_Object::RFR_Object_SpiHdr_DistMeasMinMod = 0;
  @CAN_RadarFR::RFR_Object::RFR_Object_SpiHdr_DistPrec = 0;
  @CAN_RadarFR::RFR_Object::RFR_Object_SpiHdr_DistSep = 0;
  @CAN_RadarFR::RFR_Object::RFR_Object_SpiHdr_DistStartProcDegraded = 0;
  @CAN_RadarFR::RFR_Object::RFR_Object_SpiHdr_DmpId = 0;
  @CAN_RadarFR::RFR_Object::RFR_Object_SpiHdr_FovRtrAzDetRng00 = 0;
  @CAN_RadarFR::RFR_Object::RFR_Object_SpiHdr_FovRtrAzDetRng01 = 0;
  @CAN_RadarFR::RFR_Object::RFR_Object_SpiHdr_FovRtrAzDetRng02 = 0;
  @CAN_RadarFR::RFR_Object::RFR_Object_SpiHdr_FovRtrAzDetRng03 = 0;
  @CAN_RadarFR::RFR_Object::RFR_Object_SpiHdr_FovRtrAzDetRng04 = 0;
  @CAN_RadarFR::RFR_Object::RFR_Object_SpiHdr_FovRtrAzDetRng05 = 0;
  @CAN_RadarFR::RFR_Object::RFR_Object_SpiHdr_FovRtrAzDetRng06 = 0;
  @CAN_RadarFR::RFR_Object::RFR_Object_SpiHdr_FovRtrAzDetRng07 = 0;
  @CAN_RadarFR::RFR_Object::RFR_Object_SpiHdr_FovRtrAzDetRng08 = 0;
  @CAN_RadarFR::RFR_Object::RFR_Object_SpiHdr_FovRtrAzDetRng09 = 0;
  @CAN_RadarFR::RFR_Object::RFR_Object_SpiHdr_FovRtrAzDetRng10 = 0;
  @CAN_RadarFR::RFR_Object::RFR_Object_SpiHdr_FovRtrAzDetRng11 = 0;
  @CAN_RadarFR::RFR_Object::RFR_Object_SpiHdr_FovRtrAzDetRng12 = 0;
  @CAN_RadarFR::RFR_Object::RFR_Object_SpiHdr_FovRtrAzDetRng13 = 0;
  @CAN_RadarFR::RFR_Object::RFR_Object_SpiHdr_FovRtrAzDetRng14 = 0;
  @CAN_RadarFR::RFR_Object::RFR_Object_SpiHdr_FovRtrAzDetRng15 = 0;
  @CAN_RadarFR::RFR_Object::RFR_Object_SpiHdr_FovRtrAzDetRng16 = 0;
  @CAN_RadarFR::RFR_Object::RFR_Object_SpiHdr_FovRtrAzDetRng17 = 0;
  }
  if(init_count == 84)
  {
  @CAN_RadarFR::RFR_Object::RFR_Object_SpiHdr_FovRtrAzDetRng18 = 0;
  @CAN_RadarFR::RFR_Object::RFR_Object_SpiHdr_FovRtrAzDetRng19 = 0;
  @CAN_RadarFR::RFR_Object::RFR_Object_SpiHdr_FovRtrAzDetRng20 = 0;
  @CAN_RadarFR::RFR_Object::RFR_Object_SpiHdr_FovRtrAzDetRng21 = 0;
  @CAN_RadarFR::RFR_Object::RFR_Object_SpiHdr_FovRtrAzDetRng22 = 0;
  @CAN_RadarFR::RFR_Object::RFR_Object_SpiHdr_FovRtrAzDetRng23 = 0;
  @CAN_RadarFR::RFR_Object::RFR_Object_SpiHdr_FovRtrAzDetRng24 = 0;
  @CAN_RadarFR::RFR_Object::RFR_Object_SpiHdr_FovRtrAzSegBrdr00 = 0;
  @CAN_RadarFR::RFR_Object::RFR_Object_SpiHdr_FovRtrAzSegBrdr01 = 0;
  @CAN_RadarFR::RFR_Object::RFR_Object_SpiHdr_FovRtrAzSegBrdr02 = 0;
  @CAN_RadarFR::RFR_Object::RFR_Object_SpiHdr_FovRtrAzSegBrdr03 = 0;
  @CAN_RadarFR::RFR_Object::RFR_Object_SpiHdr_FovRtrAzSegBrdr04 = 0;
  @CAN_RadarFR::RFR_Object::RFR_Object_SpiHdr_FovRtrAzSegBrdr05 = 0;
  @CAN_RadarFR::RFR_Object::RFR_Object_SpiHdr_FovRtrAzSegBrdr06 = 0;
  @CAN_RadarFR::RFR_Object::RFR_Object_SpiHdr_FovRtrAzSegBrdr07 = 0;
  @CAN_RadarFR::RFR_Object::RFR_Object_SpiHdr_FovRtrAzSegBrdr08 = 0;
  @CAN_RadarFR::RFR_Object::RFR_Object_SpiHdr_FovRtrAzSegBrdr09 = 0;
  @CAN_RadarFR::RFR_Object::RFR_Object_SpiHdr_FovRtrAzSegBrdr10 = 0;
  @CAN_RadarFR::RFR_Object::RFR_Object_SpiHdr_FovRtrAzSegBrdr11 = 0;
  @CAN_RadarFR::RFR_Object::RFR_Object_SpiHdr_FovRtrAzSegBrdr12 = 0;
  @CAN_RadarFR::RFR_Object::RFR_Object_SpiHdr_FovRtrAzSegBrdr13 = 0;
  @CAN_RadarFR::RFR_Object::RFR_Object_SpiHdr_FovRtrAzSegBrdr14 = 0;
  @CAN_RadarFR::RFR_Object::RFR_Object_SpiHdr_FovRtrAzSegBrdr15 = 0;
  @CAN_RadarFR::RFR_Object::RFR_Object_SpiHdr_FovRtrAzSegBrdr16 = 0;
  @CAN_RadarFR::RFR_Object::RFR_Object_SpiHdr_FovRtrAzSegBrdr17 = 0;
  }
  if(init_count == 85)
  {
  @CAN_RadarFR::RFR_Object::RFR_Object_SpiHdr_FovRtrAzSegBrdr18 = 0;
  @CAN_RadarFR::RFR_Object::RFR_Object_SpiHdr_FovRtrAzSegBrdr19 = 0;
  @CAN_RadarFR::RFR_Object::RFR_Object_SpiHdr_FovRtrAzSegBrdr20 = 0;
  @CAN_RadarFR::RFR_Object::RFR_Object_SpiHdr_FovRtrAzSegBrdr21 = 0;
  @CAN_RadarFR::RFR_Object::RFR_Object_SpiHdr_FovRtrAzSegBrdr22 = 0;
  @CAN_RadarFR::RFR_Object::RFR_Object_SpiHdr_FovRtrAzSegBrdr23 = 0;
  @CAN_RadarFR::RFR_Object::RFR_Object_SpiHdr_FovRtrAzSegBrdr24 = 0;
  @CAN_RadarFR::RFR_Object::RFR_Object_SpiHdr_FovRtrElRngGEnd00 = 0;
  @CAN_RadarFR::RFR_Object::RFR_Object_SpiHdr_FovRtrElRngGEnd01 = 0;
  @CAN_RadarFR::RFR_Object::RFR_Object_SpiHdr_FovRtrElRngGEnd02 = 0;
  @CAN_RadarFR::RFR_Object::RFR_Object_SpiHdr_FovRtrElRngGEnd03 = 0;
  @CAN_RadarFR::RFR_Object::RFR_Object_SpiHdr_FovRtrElRngGEnd04 = 0;
  @CAN_RadarFR::RFR_Object::RFR_Object_SpiHdr_FovRtrElRngGEnd05 = 0;
  @CAN_RadarFR::RFR_Object::RFR_Object_SpiHdr_FovRtrElRngGEnd06 = 0;
  @CAN_RadarFR::RFR_Object::RFR_Object_SpiHdr_FovRtrElRngGEnd07 = 0;
  @CAN_RadarFR::RFR_Object::RFR_Object_SpiHdr_FovRtrElRngGEnd08 = 0;
  @CAN_RadarFR::RFR_Object::RFR_Object_SpiHdr_FovRtrElRngGEnd09 = 0;
  @CAN_RadarFR::RFR_Object::RFR_Object_SpiHdr_FovRtrElRngGEnd10 = 0;
  @CAN_RadarFR::RFR_Object::RFR_Object_SpiHdr_FovRtrElSegBrdr00 = 0;
  @CAN_RadarFR::RFR_Object::RFR_Object_SpiHdr_FovRtrElSegBrdr01 = 0;
  @CAN_RadarFR::RFR_Object::RFR_Object_SpiHdr_FovRtrElSegBrdr02 = 0;
  @CAN_RadarFR::RFR_Object::RFR_Object_SpiHdr_FovRtrElSegBrdr03 = 0;
  @CAN_RadarFR::RFR_Object::RFR_Object_SpiHdr_FovRtrElSegBrdr04 = 0;
  @CAN_RadarFR::RFR_Object::RFR_Object_SpiHdr_FovRtrElSegBrdr05 = 0;
  @CAN_RadarFR::RFR_Object::RFR_Object_SpiHdr_FovRtrElSegBrdr06 = 0;
  }
  if(init_count == 86)
  {
  @CAN_RadarFR::RFR_Object::RFR_Object_SpiHdr_FovRtrElSegBrdr07 = 0;
  @CAN_RadarFR::RFR_Object::RFR_Object_SpiHdr_FovRtrElSegBrdr08 = 0;
  @CAN_RadarFR::RFR_Object::RFR_Object_SpiHdr_FovRtrElSegBrdr09 = 0;
  @CAN_RadarFR::RFR_Object::RFR_Object_SpiHdr_FovRtrElSegBrdr10 = 0;
  @CAN_RadarFR::RFR_Object::RFR_Object_SpiHdr_ModId = 0;
  @CAN_RadarFR::RFR_Object::RFR_Object_SpiHdr_RngGainRfInterfere = 0;
  @CAN_RadarFR::RFR_Object::RFR_Object_SpiHdr_SensorExtDisturbed = 0;
  @CAN_RadarFR::RFR_Object::RFR_Object_SpiHdr_SensorOrientPitch = 0;
  @CAN_RadarFR::RFR_Object::RFR_Object_SpiHdr_SensorOrientYaw = 0;
  @CAN_RadarFR::RFR_Object::RFR_Object_SpiHdr_SensorOrientation = 0;
  @CAN_RadarFR::RFR_Object::RFR_Object_SpiHdr_SensorOriginPointX = 0;
  @CAN_RadarFR::RFR_Object::RFR_Object_SpiHdr_SensorOriginPointY = 0;
  @CAN_RadarFR::RFR_Object::RFR_Object_SpiHdr_SensorOriginPointZ = 0;
  @CAN_RadarFR::RFR_Object::RFR_Object_SpiHdr_VelMeasMax = 0;
  @CAN_RadarFR::RFR_Object::RFR_Object_SpiHdr_VelMeasMin = 0;
  @CAN_RadarFR::RFR_Object::RFR_Object_SpiHdr_VelPrec = 0;
  @CAN_RadarFR::RFR_Object::RFR_Object_SpiHdr_VelSep = 0;
  sysSetVariableData(sysvar::CAN_RadarFR::RFR_RoadSideBoundaries::RFR_RoadSideBoundaries::SignalValue, RFR_RoadSideBoundaries_byte_Array, 1000);
  $CAN_RadarFR::RFR_SensorOutput::RFR_Veh_SenOut_VehConfParamStatus = 0;
  if (prestart_mode==0) init_count = 0;
  initFlag = 11;
  }
  init_count++;
}
void init_CRadarRL_F150_OD()
{
  if(init_count == 1)
  {
  $CAN_RadarRL::RRL_CornerFunctions::RRL_CF_AEx_revEgoBrakingStatus = 0;
  $CAN_RadarRL::RRL_CornerFunctions::RRL_CF_AEx_revEgoWarnStatus = 0;
  $CAN_RadarRL::RRL_CornerFunctions::RRL_CF_AEx_revEgo_BrakeRequest = 0;
  $CAN_RadarRL::RRL_CornerFunctions::RRL_CF_AEx_revEgo_TargetDec = 0;
  $CAN_RadarRL::RRL_CornerFunctions::RRL_CF_AEx_revEgo_WarningLevel = 0;
  $CAN_RadarRL::RRL_CornerFunctions::RRL_CF_BsdLca_Status = 0;
  $CAN_RadarRL::RRL_CornerFunctions::RRL_CF_BsdLca_WarningLevel = 0;
  $CAN_RadarRL::RRL_CornerFunctions::RRL_CF_DOx_PrevStatus = 0;
  $CAN_RadarRL::RRL_CornerFunctions::RRL_CF_DOx_WarnStatus = 0;
  $CAN_RadarRL::RRL_CornerFunctions::RRL_CF_DOx_WarningLevel = 0;
  sysSetVariableData(sysvar::CAN_RadarRL::RRL_FieldDataCollection::RRL_FieldDataCollection::SignalValue, RRL_FieldDataCollection_byte_Array, 5000);
  @CAN_RadarRL::RRL_Object::RRL_Object_E2E_p44_dataId = 0;
  @CAN_RadarRL::RRL_Object::RRL_Object_E2E_p44_length = 0;
  @CAN_RadarRL::RRL_Object::RRL_Object_Obj10.Age = 0;
  @CAN_RadarRL::RRL_Object::RRL_Object_Obj10.Ax = 0;
  @CAN_RadarRL::RRL_Object::RRL_Object_Obj10.AxAyCoVnce = 0;
  @CAN_RadarRL::RRL_Object::RRL_Object_Obj10.AxVnce = 0;
  @CAN_RadarRL::RRL_Object::RRL_Object_Obj10.Ay = 0;
  @CAN_RadarRL::RRL_Object::RRL_Object_Obj10.AyVnce = 0;
  @CAN_RadarRL::RRL_Object::RRL_Object_Obj10.ExistProb = 0;
  @CAN_RadarRL::RRL_Object::RRL_Object_Obj10.FilterInformation = 0;
  @CAN_RadarRL::RRL_Object::RRL_Object_Obj10.Length = 0;
  @CAN_RadarRL::RRL_Object::RRL_Object_Obj10.LengthVnce = 0;
  @CAN_RadarRL::RRL_Object::RRL_Object_Obj10.MeasurementStatus = 0;
  @CAN_RadarRL::RRL_Object::RRL_Object_Obj10.MovingStatus = 0;
  }
  if(init_count == 2)
  {
  @CAN_RadarRL::RRL_Object::RRL_Object_Obj10.ObjId = 0;
  @CAN_RadarRL::RRL_Object::RRL_Object_Obj10.OrientationYaw = 0;
  @CAN_RadarRL::RRL_Object::RRL_Object_Obj10.OrientationYawVnce = 0;
  @CAN_RadarRL::RRL_Object::RRL_Object_Obj10.ProbClassConfidence = 0;
  @CAN_RadarRL::RRL_Object::RRL_Object_Obj10.ProbClassType = 0;
  @CAN_RadarRL::RRL_Object::RRL_Object_Obj10.Px = 0;
  @CAN_RadarRL::RRL_Object::RRL_Object_Obj10.PxAxCoVnce = 0;
  @CAN_RadarRL::RRL_Object::RRL_Object_Obj10.PxAyCoVnce = 0;
  @CAN_RadarRL::RRL_Object::RRL_Object_Obj10.PxPyCoVnce = 0;
  @CAN_RadarRL::RRL_Object::RRL_Object_Obj10.PxVnce = 0;
  @CAN_RadarRL::RRL_Object::RRL_Object_Obj10.PxVxCoVnce = 0;
  @CAN_RadarRL::RRL_Object::RRL_Object_Obj10.PxVyCoVnce = 0;
  @CAN_RadarRL::RRL_Object::RRL_Object_Obj10.Py = 0;
  @CAN_RadarRL::RRL_Object::RRL_Object_Obj10.PyAxCoVnce = 0;
  @CAN_RadarRL::RRL_Object::RRL_Object_Obj10.PyAyCoVnce = 0;
  @CAN_RadarRL::RRL_Object::RRL_Object_Obj10.PyVnce = 0;
  @CAN_RadarRL::RRL_Object::RRL_Object_Obj10.PyVxCoVnce = 0;
  @CAN_RadarRL::RRL_Object::RRL_Object_Obj10.PyVyCoVnce = 0;
  @CAN_RadarRL::RRL_Object::RRL_Object_Obj10.ReferencePoint = 0;
  @CAN_RadarRL::RRL_Object::RRL_Object_Obj10.Vx = 0;
  @CAN_RadarRL::RRL_Object::RRL_Object_Obj10.VxAxCoVnce = 0;
  @CAN_RadarRL::RRL_Object::RRL_Object_Obj10.VxAyCoVnce = 0;
  @CAN_RadarRL::RRL_Object::RRL_Object_Obj10.VxVnce = 0;
  @CAN_RadarRL::RRL_Object::RRL_Object_Obj10.VxVyCoVnce = 0;
  @CAN_RadarRL::RRL_Object::RRL_Object_Obj10.Vy = 0;
  }
  if(init_count == 3)
  {
  @CAN_RadarRL::RRL_Object::RRL_Object_Obj10.VyAxCoVnce = 0;
  @CAN_RadarRL::RRL_Object::RRL_Object_Obj10.VyAyCoVnce = 0;
  @CAN_RadarRL::RRL_Object::RRL_Object_Obj10.VyVnce = 0;
  @CAN_RadarRL::RRL_Object::RRL_Object_Obj10.Width = 0;
  @CAN_RadarRL::RRL_Object::RRL_Object_Obj10.WidthVnce = 0;
  @CAN_RadarRL::RRL_Object::RRL_Object_Obj11.Age = 0;
  @CAN_RadarRL::RRL_Object::RRL_Object_Obj11.Ax = 0;
  @CAN_RadarRL::RRL_Object::RRL_Object_Obj11.AxAyCoVnce = 0;
  @CAN_RadarRL::RRL_Object::RRL_Object_Obj11.AxVnce = 0;
  @CAN_RadarRL::RRL_Object::RRL_Object_Obj11.Ay = 0;
  @CAN_RadarRL::RRL_Object::RRL_Object_Obj11.AyVnce = 0;
  @CAN_RadarRL::RRL_Object::RRL_Object_Obj11.ExistProb = 0;
  @CAN_RadarRL::RRL_Object::RRL_Object_Obj11.FilterInformation = 0;
  @CAN_RadarRL::RRL_Object::RRL_Object_Obj11.Length = 0;
  @CAN_RadarRL::RRL_Object::RRL_Object_Obj11.LengthVnce = 0;
  @CAN_RadarRL::RRL_Object::RRL_Object_Obj11.MeasurementStatus = 0;
  @CAN_RadarRL::RRL_Object::RRL_Object_Obj11.MovingStatus = 0;
  @CAN_RadarRL::RRL_Object::RRL_Object_Obj11.ObjId = 0;
  @CAN_RadarRL::RRL_Object::RRL_Object_Obj11.OrientationYaw = 0;
  @CAN_RadarRL::RRL_Object::RRL_Object_Obj11.OrientationYawVnce = 0;
  @CAN_RadarRL::RRL_Object::RRL_Object_Obj11.ProbClassConfidence = 0;
  @CAN_RadarRL::RRL_Object::RRL_Object_Obj11.ProbClassType = 0;
  @CAN_RadarRL::RRL_Object::RRL_Object_Obj11.Px = 0;
  @CAN_RadarRL::RRL_Object::RRL_Object_Obj11.PxAxCoVnce = 0;
  @CAN_RadarRL::RRL_Object::RRL_Object_Obj11.PxAyCoVnce = 0;
  }
  if(init_count == 4)
  {
  @CAN_RadarRL::RRL_Object::RRL_Object_Obj11.PxPyCoVnce = 0;
  @CAN_RadarRL::RRL_Object::RRL_Object_Obj11.PxVnce = 0;
  @CAN_RadarRL::RRL_Object::RRL_Object_Obj11.PxVxCoVnce = 0;
  @CAN_RadarRL::RRL_Object::RRL_Object_Obj11.PxVyCoVnce = 0;
  @CAN_RadarRL::RRL_Object::RRL_Object_Obj11.Py = 0;
  @CAN_RadarRL::RRL_Object::RRL_Object_Obj11.PyAxCoVnce = 0;
  @CAN_RadarRL::RRL_Object::RRL_Object_Obj11.PyAyCoVnce = 0;
  @CAN_RadarRL::RRL_Object::RRL_Object_Obj11.PyVnce = 0;
  @CAN_RadarRL::RRL_Object::RRL_Object_Obj11.PyVxCoVnce = 0;
  @CAN_RadarRL::RRL_Object::RRL_Object_Obj11.PyVyCoVnce = 0;
  @CAN_RadarRL::RRL_Object::RRL_Object_Obj11.ReferencePoint = 0;
  @CAN_RadarRL::RRL_Object::RRL_Object_Obj11.Vx = 0;
  @CAN_RadarRL::RRL_Object::RRL_Object_Obj11.VxAxCoVnce = 0;
  @CAN_RadarRL::RRL_Object::RRL_Object_Obj11.VxAyCoVnce = 0;
  @CAN_RadarRL::RRL_Object::RRL_Object_Obj11.VxVnce = 0;
  @CAN_RadarRL::RRL_Object::RRL_Object_Obj11.VxVyCoVnce = 0;
  @CAN_RadarRL::RRL_Object::RRL_Object_Obj11.Vy = 0;
  @CAN_RadarRL::RRL_Object::RRL_Object_Obj11.VyAxCoVnce = 0;
  @CAN_RadarRL::RRL_Object::RRL_Object_Obj11.VyAyCoVnce = 0;
  @CAN_RadarRL::RRL_Object::RRL_Object_Obj11.VyVnce = 0;
  @CAN_RadarRL::RRL_Object::RRL_Object_Obj11.Width = 0;
  @CAN_RadarRL::RRL_Object::RRL_Object_Obj11.WidthVnce = 0;
  @CAN_RadarRL::RRL_Object::RRL_Object_Obj12.Age = 0;
  @CAN_RadarRL::RRL_Object::RRL_Object_Obj12.Ax = 0;
  @CAN_RadarRL::RRL_Object::RRL_Object_Obj12.AxAyCoVnce = 0;
  }
  if(init_count == 5)
  {
  @CAN_RadarRL::RRL_Object::RRL_Object_Obj12.AxVnce = 0;
  @CAN_RadarRL::RRL_Object::RRL_Object_Obj12.Ay = 0;
  @CAN_RadarRL::RRL_Object::RRL_Object_Obj12.AyVnce = 0;
  @CAN_RadarRL::RRL_Object::RRL_Object_Obj12.ExistProb = 0;
  @CAN_RadarRL::RRL_Object::RRL_Object_Obj12.FilterInformation = 0;
  @CAN_RadarRL::RRL_Object::RRL_Object_Obj12.Length = 0;
  @CAN_RadarRL::RRL_Object::RRL_Object_Obj12.LengthVnce = 0;
  @CAN_RadarRL::RRL_Object::RRL_Object_Obj12.MeasurementStatus = 0;
  @CAN_RadarRL::RRL_Object::RRL_Object_Obj12.MovingStatus = 0;
  @CAN_RadarRL::RRL_Object::RRL_Object_Obj12.ObjId = 0;
  @CAN_RadarRL::RRL_Object::RRL_Object_Obj12.OrientationYaw = 0;
  @CAN_RadarRL::RRL_Object::RRL_Object_Obj12.OrientationYawVnce = 0;
  @CAN_RadarRL::RRL_Object::RRL_Object_Obj12.ProbClassConfidence = 0;
  @CAN_RadarRL::RRL_Object::RRL_Object_Obj12.ProbClassType = 0;
  @CAN_RadarRL::RRL_Object::RRL_Object_Obj12.Px = 0;
  @CAN_RadarRL::RRL_Object::RRL_Object_Obj12.PxAxCoVnce = 0;
  @CAN_RadarRL::RRL_Object::RRL_Object_Obj12.PxAyCoVnce = 0;
  @CAN_RadarRL::RRL_Object::RRL_Object_Obj12.PxPyCoVnce = 0;
  @CAN_RadarRL::RRL_Object::RRL_Object_Obj12.PxVnce = 0;
  @CAN_RadarRL::RRL_Object::RRL_Object_Obj12.PxVxCoVnce = 0;
  @CAN_RadarRL::RRL_Object::RRL_Object_Obj12.PxVyCoVnce = 0;
  @CAN_RadarRL::RRL_Object::RRL_Object_Obj12.Py = 0;
  @CAN_RadarRL::RRL_Object::RRL_Object_Obj12.PyAxCoVnce = 0;
  @CAN_RadarRL::RRL_Object::RRL_Object_Obj12.PyAyCoVnce = 0;
  @CAN_RadarRL::RRL_Object::RRL_Object_Obj12.PyVnce = 0;
  }
  if(init_count == 6)
  {
  @CAN_RadarRL::RRL_Object::RRL_Object_Obj12.PyVxCoVnce = 0;
  @CAN_RadarRL::RRL_Object::RRL_Object_Obj12.PyVyCoVnce = 0;
  @CAN_RadarRL::RRL_Object::RRL_Object_Obj12.ReferencePoint = 0;
  @CAN_RadarRL::RRL_Object::RRL_Object_Obj12.Vx = 0;
  @CAN_RadarRL::RRL_Object::RRL_Object_Obj12.VxAxCoVnce = 0;
  @CAN_RadarRL::RRL_Object::RRL_Object_Obj12.VxAyCoVnce = 0;
  @CAN_RadarRL::RRL_Object::RRL_Object_Obj12.VxVnce = 0;
  @CAN_RadarRL::RRL_Object::RRL_Object_Obj12.VxVyCoVnce = 0;
  @CAN_RadarRL::RRL_Object::RRL_Object_Obj12.Vy = 0;
  @CAN_RadarRL::RRL_Object::RRL_Object_Obj12.VyAxCoVnce = 0;
  @CAN_RadarRL::RRL_Object::RRL_Object_Obj12.VyAyCoVnce = 0;
  @CAN_RadarRL::RRL_Object::RRL_Object_Obj12.VyVnce = 0;
  @CAN_RadarRL::RRL_Object::RRL_Object_Obj12.Width = 0;
  @CAN_RadarRL::RRL_Object::RRL_Object_Obj12.WidthVnce = 0;
  @CAN_RadarRL::RRL_Object::RRL_Object_Obj13.Age = 0;
  @CAN_RadarRL::RRL_Object::RRL_Object_Obj13.Ax = 0;
  @CAN_RadarRL::RRL_Object::RRL_Object_Obj13.AxAyCoVnce = 0;
  @CAN_RadarRL::RRL_Object::RRL_Object_Obj13.AxVnce = 0;
  @CAN_RadarRL::RRL_Object::RRL_Object_Obj13.Ay = 0;
  @CAN_RadarRL::RRL_Object::RRL_Object_Obj13.AyVnce = 0;
  @CAN_RadarRL::RRL_Object::RRL_Object_Obj13.ExistProb = 0;
  @CAN_RadarRL::RRL_Object::RRL_Object_Obj13.FilterInformation = 0;
  @CAN_RadarRL::RRL_Object::RRL_Object_Obj13.Length = 0;
  @CAN_RadarRL::RRL_Object::RRL_Object_Obj13.LengthVnce = 0;
  @CAN_RadarRL::RRL_Object::RRL_Object_Obj13.MeasurementStatus = 0;
  }
  if(init_count == 7)
  {
  @CAN_RadarRL::RRL_Object::RRL_Object_Obj13.MovingStatus = 0;
  @CAN_RadarRL::RRL_Object::RRL_Object_Obj13.ObjId = 0;
  @CAN_RadarRL::RRL_Object::RRL_Object_Obj13.OrientationYaw = 0;
  @CAN_RadarRL::RRL_Object::RRL_Object_Obj13.OrientationYawVnce = 0;
  @CAN_RadarRL::RRL_Object::RRL_Object_Obj13.ProbClassConfidence = 0;
  @CAN_RadarRL::RRL_Object::RRL_Object_Obj13.ProbClassType = 0;
  @CAN_RadarRL::RRL_Object::RRL_Object_Obj13.Px = 0;
  @CAN_RadarRL::RRL_Object::RRL_Object_Obj13.PxAxCoVnce = 0;
  @CAN_RadarRL::RRL_Object::RRL_Object_Obj13.PxAyCoVnce = 0;
  @CAN_RadarRL::RRL_Object::RRL_Object_Obj13.PxPyCoVnce = 0;
  @CAN_RadarRL::RRL_Object::RRL_Object_Obj13.PxVnce = 0;
  @CAN_RadarRL::RRL_Object::RRL_Object_Obj13.PxVxCoVnce = 0;
  @CAN_RadarRL::RRL_Object::RRL_Object_Obj13.PxVyCoVnce = 0;
  @CAN_RadarRL::RRL_Object::RRL_Object_Obj13.Py = 0;
  @CAN_RadarRL::RRL_Object::RRL_Object_Obj13.PyAxCoVnce = 0;
  @CAN_RadarRL::RRL_Object::RRL_Object_Obj13.PyAyCoVnce = 0;
  @CAN_RadarRL::RRL_Object::RRL_Object_Obj13.PyVnce = 0;
  @CAN_RadarRL::RRL_Object::RRL_Object_Obj13.PyVxCoVnce = 0;
  @CAN_RadarRL::RRL_Object::RRL_Object_Obj13.PyVyCoVnce = 0;
  @CAN_RadarRL::RRL_Object::RRL_Object_Obj13.ReferencePoint = 0;
  @CAN_RadarRL::RRL_Object::RRL_Object_Obj13.Vx = 0;
  @CAN_RadarRL::RRL_Object::RRL_Object_Obj13.VxAxCoVnce = 0;
  @CAN_RadarRL::RRL_Object::RRL_Object_Obj13.VxAyCoVnce = 0;
  @CAN_RadarRL::RRL_Object::RRL_Object_Obj13.VxVnce = 0;
  @CAN_RadarRL::RRL_Object::RRL_Object_Obj13.VxVyCoVnce = 0;
  }
  if(init_count == 8)
  {
  @CAN_RadarRL::RRL_Object::RRL_Object_Obj13.Vy = 0;
  @CAN_RadarRL::RRL_Object::RRL_Object_Obj13.VyAxCoVnce = 0;
  @CAN_RadarRL::RRL_Object::RRL_Object_Obj13.VyAyCoVnce = 0;
  @CAN_RadarRL::RRL_Object::RRL_Object_Obj13.VyVnce = 0;
  @CAN_RadarRL::RRL_Object::RRL_Object_Obj13.Width = 0;
  @CAN_RadarRL::RRL_Object::RRL_Object_Obj13.WidthVnce = 0;
  @CAN_RadarRL::RRL_Object::RRL_Object_Obj14.Age = 0;
  @CAN_RadarRL::RRL_Object::RRL_Object_Obj14.Ax = 0;
  @CAN_RadarRL::RRL_Object::RRL_Object_Obj14.AxAyCoVnce = 0;
  @CAN_RadarRL::RRL_Object::RRL_Object_Obj14.AxVnce = 0;
  @CAN_RadarRL::RRL_Object::RRL_Object_Obj14.Ay = 0;
  @CAN_RadarRL::RRL_Object::RRL_Object_Obj14.AyVnce = 0;
  @CAN_RadarRL::RRL_Object::RRL_Object_Obj14.ExistProb = 0;
  @CAN_RadarRL::RRL_Object::RRL_Object_Obj14.FilterInformation = 0;
  @CAN_RadarRL::RRL_Object::RRL_Object_Obj14.Length = 0;
  @CAN_RadarRL::RRL_Object::RRL_Object_Obj14.LengthVnce = 0;
  @CAN_RadarRL::RRL_Object::RRL_Object_Obj14.MeasurementStatus = 0;
  @CAN_RadarRL::RRL_Object::RRL_Object_Obj14.MovingStatus = 0;
  @CAN_RadarRL::RRL_Object::RRL_Object_Obj14.ObjId = 0;
  @CAN_RadarRL::RRL_Object::RRL_Object_Obj14.OrientationYaw = 0;
  @CAN_RadarRL::RRL_Object::RRL_Object_Obj14.OrientationYawVnce = 0;
  @CAN_RadarRL::RRL_Object::RRL_Object_Obj14.ProbClassConfidence = 0;
  @CAN_RadarRL::RRL_Object::RRL_Object_Obj14.ProbClassType = 0;
  @CAN_RadarRL::RRL_Object::RRL_Object_Obj14.Px = 0;
  @CAN_RadarRL::RRL_Object::RRL_Object_Obj14.PxAxCoVnce = 0;
  }
  if(init_count == 9)
  {
  @CAN_RadarRL::RRL_Object::RRL_Object_Obj14.PxAyCoVnce = 0;
  @CAN_RadarRL::RRL_Object::RRL_Object_Obj14.PxPyCoVnce = 0;
  @CAN_RadarRL::RRL_Object::RRL_Object_Obj14.PxVnce = 0;
  @CAN_RadarRL::RRL_Object::RRL_Object_Obj14.PxVxCoVnce = 0;
  @CAN_RadarRL::RRL_Object::RRL_Object_Obj14.PxVyCoVnce = 0;
  @CAN_RadarRL::RRL_Object::RRL_Object_Obj14.Py = 0;
  @CAN_RadarRL::RRL_Object::RRL_Object_Obj14.PyAxCoVnce = 0;
  @CAN_RadarRL::RRL_Object::RRL_Object_Obj14.PyAyCoVnce = 0;
  @CAN_RadarRL::RRL_Object::RRL_Object_Obj14.PyVnce = 0;
  @CAN_RadarRL::RRL_Object::RRL_Object_Obj14.PyVxCoVnce = 0;
  @CAN_RadarRL::RRL_Object::RRL_Object_Obj14.PyVyCoVnce = 0;
  @CAN_RadarRL::RRL_Object::RRL_Object_Obj14.ReferencePoint = 0;
  @CAN_RadarRL::RRL_Object::RRL_Object_Obj14.Vx = 0;
  @CAN_RadarRL::RRL_Object::RRL_Object_Obj14.VxAxCoVnce = 0;
  @CAN_RadarRL::RRL_Object::RRL_Object_Obj14.VxAyCoVnce = 0;
  @CAN_RadarRL::RRL_Object::RRL_Object_Obj14.VxVnce = 0;
  @CAN_RadarRL::RRL_Object::RRL_Object_Obj14.VxVyCoVnce = 0;
  @CAN_RadarRL::RRL_Object::RRL_Object_Obj14.Vy = 0;
  @CAN_RadarRL::RRL_Object::RRL_Object_Obj14.VyAxCoVnce = 0;
  @CAN_RadarRL::RRL_Object::RRL_Object_Obj14.VyAyCoVnce = 0;
  @CAN_RadarRL::RRL_Object::RRL_Object_Obj14.VyVnce = 0;
  @CAN_RadarRL::RRL_Object::RRL_Object_Obj14.Width = 0;
  @CAN_RadarRL::RRL_Object::RRL_Object_Obj14.WidthVnce = 0;
  @CAN_RadarRL::RRL_Object::RRL_Object_Obj15.Age = 0;
  @CAN_RadarRL::RRL_Object::RRL_Object_Obj15.Ax = 0;
  }
  if(init_count == 10)
  {
  @CAN_RadarRL::RRL_Object::RRL_Object_Obj15.AxAyCoVnce = 0;
  @CAN_RadarRL::RRL_Object::RRL_Object_Obj15.AxVnce = 0;
  @CAN_RadarRL::RRL_Object::RRL_Object_Obj15.Ay = 0;
  @CAN_RadarRL::RRL_Object::RRL_Object_Obj15.AyVnce = 0;
  @CAN_RadarRL::RRL_Object::RRL_Object_Obj15.ExistProb = 0;
  @CAN_RadarRL::RRL_Object::RRL_Object_Obj15.FilterInformation = 0;
  @CAN_RadarRL::RRL_Object::RRL_Object_Obj15.Length = 0;
  @CAN_RadarRL::RRL_Object::RRL_Object_Obj15.LengthVnce = 0;
  @CAN_RadarRL::RRL_Object::RRL_Object_Obj15.MeasurementStatus = 0;
  @CAN_RadarRL::RRL_Object::RRL_Object_Obj15.MovingStatus = 0;
  @CAN_RadarRL::RRL_Object::RRL_Object_Obj15.ObjId = 0;
  @CAN_RadarRL::RRL_Object::RRL_Object_Obj15.OrientationYaw = 0;
  @CAN_RadarRL::RRL_Object::RRL_Object_Obj15.OrientationYawVnce = 0;
  @CAN_RadarRL::RRL_Object::RRL_Object_Obj15.ProbClassConfidence = 0;
  @CAN_RadarRL::RRL_Object::RRL_Object_Obj15.ProbClassType = 0;
  @CAN_RadarRL::RRL_Object::RRL_Object_Obj15.Px = 0;
  @CAN_RadarRL::RRL_Object::RRL_Object_Obj15.PxAxCoVnce = 0;
  @CAN_RadarRL::RRL_Object::RRL_Object_Obj15.PxAyCoVnce = 0;
  @CAN_RadarRL::RRL_Object::RRL_Object_Obj15.PxPyCoVnce = 0;
  @CAN_RadarRL::RRL_Object::RRL_Object_Obj15.PxVnce = 0;
  @CAN_RadarRL::RRL_Object::RRL_Object_Obj15.PxVxCoVnce = 0;
  @CAN_RadarRL::RRL_Object::RRL_Object_Obj15.PxVyCoVnce = 0;
  @CAN_RadarRL::RRL_Object::RRL_Object_Obj15.Py = 0;
  @CAN_RadarRL::RRL_Object::RRL_Object_Obj15.PyAxCoVnce = 0;
  @CAN_RadarRL::RRL_Object::RRL_Object_Obj15.PyAyCoVnce = 0;
  }
  if(init_count == 11)
  {
  @CAN_RadarRL::RRL_Object::RRL_Object_Obj15.PyVnce = 0;
  @CAN_RadarRL::RRL_Object::RRL_Object_Obj15.PyVxCoVnce = 0;
  @CAN_RadarRL::RRL_Object::RRL_Object_Obj15.PyVyCoVnce = 0;
  @CAN_RadarRL::RRL_Object::RRL_Object_Obj15.ReferencePoint = 0;
  @CAN_RadarRL::RRL_Object::RRL_Object_Obj15.Vx = 0;
  @CAN_RadarRL::RRL_Object::RRL_Object_Obj15.VxAxCoVnce = 0;
  @CAN_RadarRL::RRL_Object::RRL_Object_Obj15.VxAyCoVnce = 0;
  @CAN_RadarRL::RRL_Object::RRL_Object_Obj15.VxVnce = 0;
  @CAN_RadarRL::RRL_Object::RRL_Object_Obj15.VxVyCoVnce = 0;
  @CAN_RadarRL::RRL_Object::RRL_Object_Obj15.Vy = 0;
  @CAN_RadarRL::RRL_Object::RRL_Object_Obj15.VyAxCoVnce = 0;
  @CAN_RadarRL::RRL_Object::RRL_Object_Obj15.VyAyCoVnce = 0;
  @CAN_RadarRL::RRL_Object::RRL_Object_Obj15.VyVnce = 0;
  @CAN_RadarRL::RRL_Object::RRL_Object_Obj15.Width = 0;
  @CAN_RadarRL::RRL_Object::RRL_Object_Obj15.WidthVnce = 0;
  @CAN_RadarRL::RRL_Object::RRL_Object_Obj16.Age = 0;
  @CAN_RadarRL::RRL_Object::RRL_Object_Obj16.Ax = 0;
  @CAN_RadarRL::RRL_Object::RRL_Object_Obj16.AxAyCoVnce = 0;
  @CAN_RadarRL::RRL_Object::RRL_Object_Obj16.AxVnce = 0;
  @CAN_RadarRL::RRL_Object::RRL_Object_Obj16.Ay = 0;
  @CAN_RadarRL::RRL_Object::RRL_Object_Obj16.AyVnce = 0;
  @CAN_RadarRL::RRL_Object::RRL_Object_Obj16.ExistProb = 0;
  @CAN_RadarRL::RRL_Object::RRL_Object_Obj16.FilterInformation = 0;
  @CAN_RadarRL::RRL_Object::RRL_Object_Obj16.Length = 0;
  @CAN_RadarRL::RRL_Object::RRL_Object_Obj16.LengthVnce = 0;
  }
  if(init_count == 12)
  {
  @CAN_RadarRL::RRL_Object::RRL_Object_Obj16.MeasurementStatus = 0;
  @CAN_RadarRL::RRL_Object::RRL_Object_Obj16.MovingStatus = 0;
  @CAN_RadarRL::RRL_Object::RRL_Object_Obj16.ObjId = 0;
  @CAN_RadarRL::RRL_Object::RRL_Object_Obj16.OrientationYaw = 0;
  @CAN_RadarRL::RRL_Object::RRL_Object_Obj16.OrientationYawVnce = 0;
  @CAN_RadarRL::RRL_Object::RRL_Object_Obj16.ProbClassConfidence = 0;
  @CAN_RadarRL::RRL_Object::RRL_Object_Obj16.ProbClassType = 0;
  @CAN_RadarRL::RRL_Object::RRL_Object_Obj16.Px = 0;
  @CAN_RadarRL::RRL_Object::RRL_Object_Obj16.PxAxCoVnce = 0;
  @CAN_RadarRL::RRL_Object::RRL_Object_Obj16.PxAyCoVnce = 0;
  @CAN_RadarRL::RRL_Object::RRL_Object_Obj16.PxPyCoVnce = 0;
  @CAN_RadarRL::RRL_Object::RRL_Object_Obj16.PxVnce = 0;
  @CAN_RadarRL::RRL_Object::RRL_Object_Obj16.PxVxCoVnce = 0;
  @CAN_RadarRL::RRL_Object::RRL_Object_Obj16.PxVyCoVnce = 0;
  @CAN_RadarRL::RRL_Object::RRL_Object_Obj16.Py = 0;
  @CAN_RadarRL::RRL_Object::RRL_Object_Obj16.PyAxCoVnce = 0;
  @CAN_RadarRL::RRL_Object::RRL_Object_Obj16.PyAyCoVnce = 0;
  @CAN_RadarRL::RRL_Object::RRL_Object_Obj16.PyVnce = 0;
  @CAN_RadarRL::RRL_Object::RRL_Object_Obj16.PyVxCoVnce = 0;
  @CAN_RadarRL::RRL_Object::RRL_Object_Obj16.PyVyCoVnce = 0;
  @CAN_RadarRL::RRL_Object::RRL_Object_Obj16.ReferencePoint = 0;
  @CAN_RadarRL::RRL_Object::RRL_Object_Obj16.Vx = 0;
  @CAN_RadarRL::RRL_Object::RRL_Object_Obj16.VxAxCoVnce = 0;
  @CAN_RadarRL::RRL_Object::RRL_Object_Obj16.VxAyCoVnce = 0;
  @CAN_RadarRL::RRL_Object::RRL_Object_Obj16.VxVnce = 0;
  }
  if(init_count == 13)
  {
  @CAN_RadarRL::RRL_Object::RRL_Object_Obj16.VxVyCoVnce = 0;
  @CAN_RadarRL::RRL_Object::RRL_Object_Obj16.Vy = 0;
  @CAN_RadarRL::RRL_Object::RRL_Object_Obj16.VyAxCoVnce = 0;
  @CAN_RadarRL::RRL_Object::RRL_Object_Obj16.VyAyCoVnce = 0;
  @CAN_RadarRL::RRL_Object::RRL_Object_Obj16.VyVnce = 0;
  @CAN_RadarRL::RRL_Object::RRL_Object_Obj16.Width = 0;
  @CAN_RadarRL::RRL_Object::RRL_Object_Obj16.WidthVnce = 0;
  @CAN_RadarRL::RRL_Object::RRL_Object_Obj17.Age = 0;
  @CAN_RadarRL::RRL_Object::RRL_Object_Obj17.Ax = 0;
  @CAN_RadarRL::RRL_Object::RRL_Object_Obj17.AxAyCoVnce = 0;
  @CAN_RadarRL::RRL_Object::RRL_Object_Obj17.AxVnce = 0;
  @CAN_RadarRL::RRL_Object::RRL_Object_Obj17.Ay = 0;
  @CAN_RadarRL::RRL_Object::RRL_Object_Obj17.AyVnce = 0;
  @CAN_RadarRL::RRL_Object::RRL_Object_Obj17.ExistProb = 0;
  @CAN_RadarRL::RRL_Object::RRL_Object_Obj17.FilterInformation = 0;
  @CAN_RadarRL::RRL_Object::RRL_Object_Obj17.Length = 0;
  @CAN_RadarRL::RRL_Object::RRL_Object_Obj17.LengthVnce = 0;
  @CAN_RadarRL::RRL_Object::RRL_Object_Obj17.MeasurementStatus = 0;
  @CAN_RadarRL::RRL_Object::RRL_Object_Obj17.MovingStatus = 0;
  @CAN_RadarRL::RRL_Object::RRL_Object_Obj17.ObjId = 0;
  @CAN_RadarRL::RRL_Object::RRL_Object_Obj17.OrientationYaw = 0;
  @CAN_RadarRL::RRL_Object::RRL_Object_Obj17.OrientationYawVnce = 0;
  @CAN_RadarRL::RRL_Object::RRL_Object_Obj17.ProbClassConfidence = 0;
  @CAN_RadarRL::RRL_Object::RRL_Object_Obj17.ProbClassType = 0;
  @CAN_RadarRL::RRL_Object::RRL_Object_Obj17.Px = 0;
  }
  if(init_count == 14)
  {
  @CAN_RadarRL::RRL_Object::RRL_Object_Obj17.PxAxCoVnce = 0;
  @CAN_RadarRL::RRL_Object::RRL_Object_Obj17.PxAyCoVnce = 0;
  @CAN_RadarRL::RRL_Object::RRL_Object_Obj17.PxPyCoVnce = 0;
  @CAN_RadarRL::RRL_Object::RRL_Object_Obj17.PxVnce = 0;
  @CAN_RadarRL::RRL_Object::RRL_Object_Obj17.PxVxCoVnce = 0;
  @CAN_RadarRL::RRL_Object::RRL_Object_Obj17.PxVyCoVnce = 0;
  @CAN_RadarRL::RRL_Object::RRL_Object_Obj17.Py = 0;
  @CAN_RadarRL::RRL_Object::RRL_Object_Obj17.PyAxCoVnce = 0;
  @CAN_RadarRL::RRL_Object::RRL_Object_Obj17.PyAyCoVnce = 0;
  @CAN_RadarRL::RRL_Object::RRL_Object_Obj17.PyVnce = 0;
  @CAN_RadarRL::RRL_Object::RRL_Object_Obj17.PyVxCoVnce = 0;
  @CAN_RadarRL::RRL_Object::RRL_Object_Obj17.PyVyCoVnce = 0;
  @CAN_RadarRL::RRL_Object::RRL_Object_Obj17.ReferencePoint = 0;
  @CAN_RadarRL::RRL_Object::RRL_Object_Obj17.Vx = 0;
  @CAN_RadarRL::RRL_Object::RRL_Object_Obj17.VxAxCoVnce = 0;
  @CAN_RadarRL::RRL_Object::RRL_Object_Obj17.VxAyCoVnce = 0;
  @CAN_RadarRL::RRL_Object::RRL_Object_Obj17.VxVnce = 0;
  @CAN_RadarRL::RRL_Object::RRL_Object_Obj17.VxVyCoVnce = 0;
  @CAN_RadarRL::RRL_Object::RRL_Object_Obj17.Vy = 0;
  @CAN_RadarRL::RRL_Object::RRL_Object_Obj17.VyAxCoVnce = 0;
  @CAN_RadarRL::RRL_Object::RRL_Object_Obj17.VyAyCoVnce = 0;
  @CAN_RadarRL::RRL_Object::RRL_Object_Obj17.VyVnce = 0;
  @CAN_RadarRL::RRL_Object::RRL_Object_Obj17.Width = 0;
  @CAN_RadarRL::RRL_Object::RRL_Object_Obj17.WidthVnce = 0;
  @CAN_RadarRL::RRL_Object::RRL_Object_Obj18.Age = 0;
  }
  if(init_count == 15)
  {
  @CAN_RadarRL::RRL_Object::RRL_Object_Obj18.Ax = 0;
  @CAN_RadarRL::RRL_Object::RRL_Object_Obj18.AxAyCoVnce = 0;
  @CAN_RadarRL::RRL_Object::RRL_Object_Obj18.AxVnce = 0;
  @CAN_RadarRL::RRL_Object::RRL_Object_Obj18.Ay = 0;
  @CAN_RadarRL::RRL_Object::RRL_Object_Obj18.AyVnce = 0;
  @CAN_RadarRL::RRL_Object::RRL_Object_Obj18.ExistProb = 0;
  @CAN_RadarRL::RRL_Object::RRL_Object_Obj18.FilterInformation = 0;
  @CAN_RadarRL::RRL_Object::RRL_Object_Obj18.Length = 0;
  @CAN_RadarRL::RRL_Object::RRL_Object_Obj18.LengthVnce = 0;
  @CAN_RadarRL::RRL_Object::RRL_Object_Obj18.MeasurementStatus = 0;
  @CAN_RadarRL::RRL_Object::RRL_Object_Obj18.MovingStatus = 0;
  @CAN_RadarRL::RRL_Object::RRL_Object_Obj18.ObjId = 0;
  @CAN_RadarRL::RRL_Object::RRL_Object_Obj18.OrientationYaw = 0;
  @CAN_RadarRL::RRL_Object::RRL_Object_Obj18.OrientationYawVnce = 0;
  @CAN_RadarRL::RRL_Object::RRL_Object_Obj18.ProbClassConfidence = 0;
  @CAN_RadarRL::RRL_Object::RRL_Object_Obj18.ProbClassType = 0;
  @CAN_RadarRL::RRL_Object::RRL_Object_Obj18.Px = 0;
  @CAN_RadarRL::RRL_Object::RRL_Object_Obj18.PxAxCoVnce = 0;
  @CAN_RadarRL::RRL_Object::RRL_Object_Obj18.PxAyCoVnce = 0;
  @CAN_RadarRL::RRL_Object::RRL_Object_Obj18.PxPyCoVnce = 0;
  @CAN_RadarRL::RRL_Object::RRL_Object_Obj18.PxVnce = 0;
  @CAN_RadarRL::RRL_Object::RRL_Object_Obj18.PxVxCoVnce = 0;
  @CAN_RadarRL::RRL_Object::RRL_Object_Obj18.PxVyCoVnce = 0;
  @CAN_RadarRL::RRL_Object::RRL_Object_Obj18.Py = 0;
  @CAN_RadarRL::RRL_Object::RRL_Object_Obj18.PyAxCoVnce = 0;
  }
  if(init_count == 16)
  {
  @CAN_RadarRL::RRL_Object::RRL_Object_Obj18.PyAyCoVnce = 0;
  @CAN_RadarRL::RRL_Object::RRL_Object_Obj18.PyVnce = 0;
  @CAN_RadarRL::RRL_Object::RRL_Object_Obj18.PyVxCoVnce = 0;
  @CAN_RadarRL::RRL_Object::RRL_Object_Obj18.PyVyCoVnce = 0;
  @CAN_RadarRL::RRL_Object::RRL_Object_Obj18.ReferencePoint = 0;
  @CAN_RadarRL::RRL_Object::RRL_Object_Obj18.Vx = 0;
  @CAN_RadarRL::RRL_Object::RRL_Object_Obj18.VxAxCoVnce = 0;
  @CAN_RadarRL::RRL_Object::RRL_Object_Obj18.VxAyCoVnce = 0;
  @CAN_RadarRL::RRL_Object::RRL_Object_Obj18.VxVnce = 0;
  @CAN_RadarRL::RRL_Object::RRL_Object_Obj18.VxVyCoVnce = 0;
  @CAN_RadarRL::RRL_Object::RRL_Object_Obj18.Vy = 0;
  @CAN_RadarRL::RRL_Object::RRL_Object_Obj18.VyAxCoVnce = 0;
  @CAN_RadarRL::RRL_Object::RRL_Object_Obj18.VyAyCoVnce = 0;
  @CAN_RadarRL::RRL_Object::RRL_Object_Obj18.VyVnce = 0;
  @CAN_RadarRL::RRL_Object::RRL_Object_Obj18.Width = 0;
  @CAN_RadarRL::RRL_Object::RRL_Object_Obj18.WidthVnce = 0;
  @CAN_RadarRL::RRL_Object::RRL_Object_Obj19.Age = 0;
  @CAN_RadarRL::RRL_Object::RRL_Object_Obj19.Ax = 0;
  @CAN_RadarRL::RRL_Object::RRL_Object_Obj19.AxAyCoVnce = 0;
  @CAN_RadarRL::RRL_Object::RRL_Object_Obj19.AxVnce = 0;
  @CAN_RadarRL::RRL_Object::RRL_Object_Obj19.Ay = 0;
  @CAN_RadarRL::RRL_Object::RRL_Object_Obj19.AyVnce = 0;
  @CAN_RadarRL::RRL_Object::RRL_Object_Obj19.ExistProb = 0;
  @CAN_RadarRL::RRL_Object::RRL_Object_Obj19.FilterInformation = 0;
  @CAN_RadarRL::RRL_Object::RRL_Object_Obj19.Length = 0;
  }
  if(init_count == 17)
  {
  @CAN_RadarRL::RRL_Object::RRL_Object_Obj19.LengthVnce = 0;
  @CAN_RadarRL::RRL_Object::RRL_Object_Obj19.MeasurementStatus = 0;
  @CAN_RadarRL::RRL_Object::RRL_Object_Obj19.MovingStatus = 0;
  @CAN_RadarRL::RRL_Object::RRL_Object_Obj19.ObjId = 0;
  @CAN_RadarRL::RRL_Object::RRL_Object_Obj19.OrientationYaw = 0;
  @CAN_RadarRL::RRL_Object::RRL_Object_Obj19.OrientationYawVnce = 0;
  @CAN_RadarRL::RRL_Object::RRL_Object_Obj19.ProbClassConfidence = 0;
  @CAN_RadarRL::RRL_Object::RRL_Object_Obj19.ProbClassType = 0;
  @CAN_RadarRL::RRL_Object::RRL_Object_Obj19.Px = 0;
  @CAN_RadarRL::RRL_Object::RRL_Object_Obj19.PxAxCoVnce = 0;
  @CAN_RadarRL::RRL_Object::RRL_Object_Obj19.PxAyCoVnce = 0;
  @CAN_RadarRL::RRL_Object::RRL_Object_Obj19.PxPyCoVnce = 0;
  @CAN_RadarRL::RRL_Object::RRL_Object_Obj19.PxVnce = 0;
  @CAN_RadarRL::RRL_Object::RRL_Object_Obj19.PxVxCoVnce = 0;
  @CAN_RadarRL::RRL_Object::RRL_Object_Obj19.PxVyCoVnce = 0;
  @CAN_RadarRL::RRL_Object::RRL_Object_Obj19.Py = 0;
  @CAN_RadarRL::RRL_Object::RRL_Object_Obj19.PyAxCoVnce = 0;
  @CAN_RadarRL::RRL_Object::RRL_Object_Obj19.PyAyCoVnce = 0;
  @CAN_RadarRL::RRL_Object::RRL_Object_Obj19.PyVnce = 0;
  @CAN_RadarRL::RRL_Object::RRL_Object_Obj19.PyVxCoVnce = 0;
  @CAN_RadarRL::RRL_Object::RRL_Object_Obj19.PyVyCoVnce = 0;
  @CAN_RadarRL::RRL_Object::RRL_Object_Obj19.ReferencePoint = 0;
  @CAN_RadarRL::RRL_Object::RRL_Object_Obj19.Vx = 0;
  @CAN_RadarRL::RRL_Object::RRL_Object_Obj19.VxAxCoVnce = 0;
  @CAN_RadarRL::RRL_Object::RRL_Object_Obj19.VxAyCoVnce = 0;
  }
  if(init_count == 18)
  {
  @CAN_RadarRL::RRL_Object::RRL_Object_Obj19.VxVnce = 0;
  @CAN_RadarRL::RRL_Object::RRL_Object_Obj19.VxVyCoVnce = 0;
  @CAN_RadarRL::RRL_Object::RRL_Object_Obj19.Vy = 0;
  @CAN_RadarRL::RRL_Object::RRL_Object_Obj19.VyAxCoVnce = 0;
  @CAN_RadarRL::RRL_Object::RRL_Object_Obj19.VyAyCoVnce = 0;
  @CAN_RadarRL::RRL_Object::RRL_Object_Obj19.VyVnce = 0;
  @CAN_RadarRL::RRL_Object::RRL_Object_Obj19.Width = 0;
  @CAN_RadarRL::RRL_Object::RRL_Object_Obj19.WidthVnce = 0;
  @CAN_RadarRL::RRL_Object::RRL_Object_Obj1.Age = 0;
  @CAN_RadarRL::RRL_Object::RRL_Object_Obj1.Ax = 0;
  @CAN_RadarRL::RRL_Object::RRL_Object_Obj1.AxAyCoVnce = 0;
  @CAN_RadarRL::RRL_Object::RRL_Object_Obj1.AxVnce = 0;
  @CAN_RadarRL::RRL_Object::RRL_Object_Obj1.Ay = 0;
  @CAN_RadarRL::RRL_Object::RRL_Object_Obj1.AyVnce = 0;
  @CAN_RadarRL::RRL_Object::RRL_Object_Obj1.ExistProb = 0;
  @CAN_RadarRL::RRL_Object::RRL_Object_Obj1.FilterInformation = 0;
  @CAN_RadarRL::RRL_Object::RRL_Object_Obj1.Length = 0;
  @CAN_RadarRL::RRL_Object::RRL_Object_Obj1.LengthVnce = 0;
  @CAN_RadarRL::RRL_Object::RRL_Object_Obj1.MeasurementStatus = 0;
  @CAN_RadarRL::RRL_Object::RRL_Object_Obj1.MovingStatus = 0;
  @CAN_RadarRL::RRL_Object::RRL_Object_Obj1.ObjId = 0;
  @CAN_RadarRL::RRL_Object::RRL_Object_Obj1.OrientationYaw = 0;
  @CAN_RadarRL::RRL_Object::RRL_Object_Obj1.OrientationYawVnce = 0;
  @CAN_RadarRL::RRL_Object::RRL_Object_Obj1.ProbClassConfidence = 0;
  @CAN_RadarRL::RRL_Object::RRL_Object_Obj1.ProbClassType = 0;
  }
  if(init_count == 19)
  {
  @CAN_RadarRL::RRL_Object::RRL_Object_Obj1.Px = 0;
  @CAN_RadarRL::RRL_Object::RRL_Object_Obj1.PxAxCoVnce = 0;
  @CAN_RadarRL::RRL_Object::RRL_Object_Obj1.PxAyCoVnce = 0;
  @CAN_RadarRL::RRL_Object::RRL_Object_Obj1.PxPyCoVnce = 0;
  @CAN_RadarRL::RRL_Object::RRL_Object_Obj1.PxVnce = 0;
  @CAN_RadarRL::RRL_Object::RRL_Object_Obj1.PxVxCoVnce = 0;
  @CAN_RadarRL::RRL_Object::RRL_Object_Obj1.PxVyCoVnce = 0;
  @CAN_RadarRL::RRL_Object::RRL_Object_Obj1.Py = 0;
  @CAN_RadarRL::RRL_Object::RRL_Object_Obj1.PyAxCoVnce = 0;
  @CAN_RadarRL::RRL_Object::RRL_Object_Obj1.PyAyCoVnce = 0;
  @CAN_RadarRL::RRL_Object::RRL_Object_Obj1.PyVnce = 0;
  @CAN_RadarRL::RRL_Object::RRL_Object_Obj1.PyVxCoVnce = 0;
  @CAN_RadarRL::RRL_Object::RRL_Object_Obj1.PyVyCoVnce = 0;
  @CAN_RadarRL::RRL_Object::RRL_Object_Obj1.ReferencePoint = 0;
  @CAN_RadarRL::RRL_Object::RRL_Object_Obj1.Vx = 0;
  @CAN_RadarRL::RRL_Object::RRL_Object_Obj1.VxAxCoVnce = 0;
  @CAN_RadarRL::RRL_Object::RRL_Object_Obj1.VxAyCoVnce = 0;
  @CAN_RadarRL::RRL_Object::RRL_Object_Obj1.VxVnce = 0;
  @CAN_RadarRL::RRL_Object::RRL_Object_Obj1.VxVyCoVnce = 0;
  @CAN_RadarRL::RRL_Object::RRL_Object_Obj1.Vy = 0;
  @CAN_RadarRL::RRL_Object::RRL_Object_Obj1.VyAxCoVnce = 0;
  @CAN_RadarRL::RRL_Object::RRL_Object_Obj1.VyAyCoVnce = 0;
  @CAN_RadarRL::RRL_Object::RRL_Object_Obj1.VyVnce = 0;
  @CAN_RadarRL::RRL_Object::RRL_Object_Obj1.Width = 0;
  @CAN_RadarRL::RRL_Object::RRL_Object_Obj1.WidthVnce = 0;
  }
  if(init_count == 20)
  {
  @CAN_RadarRL::RRL_Object::RRL_Object_Obj20.Age = 0;
  @CAN_RadarRL::RRL_Object::RRL_Object_Obj20.Ax = 0;
  @CAN_RadarRL::RRL_Object::RRL_Object_Obj20.AxAyCoVnce = 0;
  @CAN_RadarRL::RRL_Object::RRL_Object_Obj20.AxVnce = 0;
  @CAN_RadarRL::RRL_Object::RRL_Object_Obj20.Ay = 0;
  @CAN_RadarRL::RRL_Object::RRL_Object_Obj20.AyVnce = 0;
  @CAN_RadarRL::RRL_Object::RRL_Object_Obj20.ExistProb = 0;
  @CAN_RadarRL::RRL_Object::RRL_Object_Obj20.FilterInformation = 0;
  @CAN_RadarRL::RRL_Object::RRL_Object_Obj20.Length = 0;
  @CAN_RadarRL::RRL_Object::RRL_Object_Obj20.LengthVnce = 0;
  @CAN_RadarRL::RRL_Object::RRL_Object_Obj20.MeasurementStatus = 0;
  @CAN_RadarRL::RRL_Object::RRL_Object_Obj20.MovingStatus = 0;
  @CAN_RadarRL::RRL_Object::RRL_Object_Obj20.ObjId = 0;
  @CAN_RadarRL::RRL_Object::RRL_Object_Obj20.OrientationYaw = 0;
  @CAN_RadarRL::RRL_Object::RRL_Object_Obj20.OrientationYawVnce = 0;
  @CAN_RadarRL::RRL_Object::RRL_Object_Obj20.ProbClassConfidence = 0;
  @CAN_RadarRL::RRL_Object::RRL_Object_Obj20.ProbClassType = 0;
  @CAN_RadarRL::RRL_Object::RRL_Object_Obj20.Px = 0;
  @CAN_RadarRL::RRL_Object::RRL_Object_Obj20.PxAxCoVnce = 0;
  @CAN_RadarRL::RRL_Object::RRL_Object_Obj20.PxAyCoVnce = 0;
  @CAN_RadarRL::RRL_Object::RRL_Object_Obj20.PxPyCoVnce = 0;
  @CAN_RadarRL::RRL_Object::RRL_Object_Obj20.PxVnce = 0;
  @CAN_RadarRL::RRL_Object::RRL_Object_Obj20.PxVxCoVnce = 0;
  @CAN_RadarRL::RRL_Object::RRL_Object_Obj20.PxVyCoVnce = 0;
  @CAN_RadarRL::RRL_Object::RRL_Object_Obj20.Py = 0;
  }
  if(init_count == 21)
  {
  @CAN_RadarRL::RRL_Object::RRL_Object_Obj20.PyAxCoVnce = 0;
  @CAN_RadarRL::RRL_Object::RRL_Object_Obj20.PyAyCoVnce = 0;
  @CAN_RadarRL::RRL_Object::RRL_Object_Obj20.PyVnce = 0;
  @CAN_RadarRL::RRL_Object::RRL_Object_Obj20.PyVxCoVnce = 0;
  @CAN_RadarRL::RRL_Object::RRL_Object_Obj20.PyVyCoVnce = 0;
  @CAN_RadarRL::RRL_Object::RRL_Object_Obj20.ReferencePoint = 0;
  @CAN_RadarRL::RRL_Object::RRL_Object_Obj20.Vx = 0;
  @CAN_RadarRL::RRL_Object::RRL_Object_Obj20.VxAxCoVnce = 0;
  @CAN_RadarRL::RRL_Object::RRL_Object_Obj20.VxAyCoVnce = 0;
  @CAN_RadarRL::RRL_Object::RRL_Object_Obj20.VxVnce = 0;
  @CAN_RadarRL::RRL_Object::RRL_Object_Obj20.VxVyCoVnce = 0;
  @CAN_RadarRL::RRL_Object::RRL_Object_Obj20.Vy = 0;
  @CAN_RadarRL::RRL_Object::RRL_Object_Obj20.VyAxCoVnce = 0;
  @CAN_RadarRL::RRL_Object::RRL_Object_Obj20.VyAyCoVnce = 0;
  @CAN_RadarRL::RRL_Object::RRL_Object_Obj20.VyVnce = 0;
  @CAN_RadarRL::RRL_Object::RRL_Object_Obj20.Width = 0;
  @CAN_RadarRL::RRL_Object::RRL_Object_Obj20.WidthVnce = 0;
  @CAN_RadarRL::RRL_Object::RRL_Object_Obj21.Age = 0;
  @CAN_RadarRL::RRL_Object::RRL_Object_Obj21.Ax = 0;
  @CAN_RadarRL::RRL_Object::RRL_Object_Obj21.AxAyCoVnce = 0;
  @CAN_RadarRL::RRL_Object::RRL_Object_Obj21.AxVnce = 0;
  @CAN_RadarRL::RRL_Object::RRL_Object_Obj21.Ay = 0;
  @CAN_RadarRL::RRL_Object::RRL_Object_Obj21.AyVnce = 0;
  @CAN_RadarRL::RRL_Object::RRL_Object_Obj21.ExistProb = 0;
  @CAN_RadarRL::RRL_Object::RRL_Object_Obj21.FilterInformation = 0;
  }
  if(init_count == 22)
  {
  @CAN_RadarRL::RRL_Object::RRL_Object_Obj21.Length = 0;
  @CAN_RadarRL::RRL_Object::RRL_Object_Obj21.LengthVnce = 0;
  @CAN_RadarRL::RRL_Object::RRL_Object_Obj21.MeasurementStatus = 0;
  @CAN_RadarRL::RRL_Object::RRL_Object_Obj21.MovingStatus = 0;
  @CAN_RadarRL::RRL_Object::RRL_Object_Obj21.ObjId = 0;
  @CAN_RadarRL::RRL_Object::RRL_Object_Obj21.OrientationYaw = 0;
  @CAN_RadarRL::RRL_Object::RRL_Object_Obj21.OrientationYawVnce = 0;
  @CAN_RadarRL::RRL_Object::RRL_Object_Obj21.ProbClassConfidence = 0;
  @CAN_RadarRL::RRL_Object::RRL_Object_Obj21.ProbClassType = 0;
  @CAN_RadarRL::RRL_Object::RRL_Object_Obj21.Px = 0;
  @CAN_RadarRL::RRL_Object::RRL_Object_Obj21.PxAxCoVnce = 0;
  @CAN_RadarRL::RRL_Object::RRL_Object_Obj21.PxAyCoVnce = 0;
  @CAN_RadarRL::RRL_Object::RRL_Object_Obj21.PxPyCoVnce = 0;
  @CAN_RadarRL::RRL_Object::RRL_Object_Obj21.PxVnce = 0;
  @CAN_RadarRL::RRL_Object::RRL_Object_Obj21.PxVxCoVnce = 0;
  @CAN_RadarRL::RRL_Object::RRL_Object_Obj21.PxVyCoVnce = 0;
  @CAN_RadarRL::RRL_Object::RRL_Object_Obj21.Py = 0;
  @CAN_RadarRL::RRL_Object::RRL_Object_Obj21.PyAxCoVnce = 0;
  @CAN_RadarRL::RRL_Object::RRL_Object_Obj21.PyAyCoVnce = 0;
  @CAN_RadarRL::RRL_Object::RRL_Object_Obj21.PyVnce = 0;
  @CAN_RadarRL::RRL_Object::RRL_Object_Obj21.PyVxCoVnce = 0;
  @CAN_RadarRL::RRL_Object::RRL_Object_Obj21.PyVyCoVnce = 0;
  @CAN_RadarRL::RRL_Object::RRL_Object_Obj21.ReferencePoint = 0;
  @CAN_RadarRL::RRL_Object::RRL_Object_Obj21.Vx = 0;
  @CAN_RadarRL::RRL_Object::RRL_Object_Obj21.VxAxCoVnce = 0;
  }
  if(init_count == 23)
  {
  @CAN_RadarRL::RRL_Object::RRL_Object_Obj21.VxAyCoVnce = 0;
  @CAN_RadarRL::RRL_Object::RRL_Object_Obj21.VxVnce = 0;
  @CAN_RadarRL::RRL_Object::RRL_Object_Obj21.VxVyCoVnce = 0;
  @CAN_RadarRL::RRL_Object::RRL_Object_Obj21.Vy = 0;
  @CAN_RadarRL::RRL_Object::RRL_Object_Obj21.VyAxCoVnce = 0;
  @CAN_RadarRL::RRL_Object::RRL_Object_Obj21.VyAyCoVnce = 0;
  @CAN_RadarRL::RRL_Object::RRL_Object_Obj21.VyVnce = 0;
  @CAN_RadarRL::RRL_Object::RRL_Object_Obj21.Width = 0;
  @CAN_RadarRL::RRL_Object::RRL_Object_Obj21.WidthVnce = 0;
  @CAN_RadarRL::RRL_Object::RRL_Object_Obj22.Age = 0;
  @CAN_RadarRL::RRL_Object::RRL_Object_Obj22.Ax = 0;
  @CAN_RadarRL::RRL_Object::RRL_Object_Obj22.AxAyCoVnce = 0;
  @CAN_RadarRL::RRL_Object::RRL_Object_Obj22.AxVnce = 0;
  @CAN_RadarRL::RRL_Object::RRL_Object_Obj22.Ay = 0;
  @CAN_RadarRL::RRL_Object::RRL_Object_Obj22.AyVnce = 0;
  @CAN_RadarRL::RRL_Object::RRL_Object_Obj22.ExistProb = 0;
  @CAN_RadarRL::RRL_Object::RRL_Object_Obj22.FilterInformation = 0;
  @CAN_RadarRL::RRL_Object::RRL_Object_Obj22.Length = 0;
  @CAN_RadarRL::RRL_Object::RRL_Object_Obj22.LengthVnce = 0;
  @CAN_RadarRL::RRL_Object::RRL_Object_Obj22.MeasurementStatus = 0;
  @CAN_RadarRL::RRL_Object::RRL_Object_Obj22.MovingStatus = 0;
  @CAN_RadarRL::RRL_Object::RRL_Object_Obj22.ObjId = 0;
  @CAN_RadarRL::RRL_Object::RRL_Object_Obj22.OrientationYaw = 0;
  @CAN_RadarRL::RRL_Object::RRL_Object_Obj22.OrientationYawVnce = 0;
  @CAN_RadarRL::RRL_Object::RRL_Object_Obj22.ProbClassConfidence = 0;
  }
  if(init_count == 24)
  {
  @CAN_RadarRL::RRL_Object::RRL_Object_Obj22.ProbClassType = 0;
  @CAN_RadarRL::RRL_Object::RRL_Object_Obj22.Px = 0;
  @CAN_RadarRL::RRL_Object::RRL_Object_Obj22.PxAxCoVnce = 0;
  @CAN_RadarRL::RRL_Object::RRL_Object_Obj22.PxAyCoVnce = 0;
  @CAN_RadarRL::RRL_Object::RRL_Object_Obj22.PxPyCoVnce = 0;
  @CAN_RadarRL::RRL_Object::RRL_Object_Obj22.PxVnce = 0;
  @CAN_RadarRL::RRL_Object::RRL_Object_Obj22.PxVxCoVnce = 0;
  @CAN_RadarRL::RRL_Object::RRL_Object_Obj22.PxVyCoVnce = 0;
  @CAN_RadarRL::RRL_Object::RRL_Object_Obj22.Py = 0;
  @CAN_RadarRL::RRL_Object::RRL_Object_Obj22.PyAxCoVnce = 0;
  @CAN_RadarRL::RRL_Object::RRL_Object_Obj22.PyAyCoVnce = 0;
  @CAN_RadarRL::RRL_Object::RRL_Object_Obj22.PyVnce = 0;
  @CAN_RadarRL::RRL_Object::RRL_Object_Obj22.PyVxCoVnce = 0;
  @CAN_RadarRL::RRL_Object::RRL_Object_Obj22.PyVyCoVnce = 0;
  @CAN_RadarRL::RRL_Object::RRL_Object_Obj22.ReferencePoint = 0;
  @CAN_RadarRL::RRL_Object::RRL_Object_Obj22.Vx = 0;
  @CAN_RadarRL::RRL_Object::RRL_Object_Obj22.VxAxCoVnce = 0;
  @CAN_RadarRL::RRL_Object::RRL_Object_Obj22.VxAyCoVnce = 0;
  @CAN_RadarRL::RRL_Object::RRL_Object_Obj22.VxVnce = 0;
  @CAN_RadarRL::RRL_Object::RRL_Object_Obj22.VxVyCoVnce = 0;
  @CAN_RadarRL::RRL_Object::RRL_Object_Obj22.Vy = 0;
  @CAN_RadarRL::RRL_Object::RRL_Object_Obj22.VyAxCoVnce = 0;
  @CAN_RadarRL::RRL_Object::RRL_Object_Obj22.VyAyCoVnce = 0;
  @CAN_RadarRL::RRL_Object::RRL_Object_Obj22.VyVnce = 0;
  @CAN_RadarRL::RRL_Object::RRL_Object_Obj22.Width = 0;
  }
  if(init_count == 25)
  {
  @CAN_RadarRL::RRL_Object::RRL_Object_Obj22.WidthVnce = 0;
  @CAN_RadarRL::RRL_Object::RRL_Object_Obj23.Age = 0;
  @CAN_RadarRL::RRL_Object::RRL_Object_Obj23.Ax = 0;
  @CAN_RadarRL::RRL_Object::RRL_Object_Obj23.AxAyCoVnce = 0;
  @CAN_RadarRL::RRL_Object::RRL_Object_Obj23.AxVnce = 0;
  @CAN_RadarRL::RRL_Object::RRL_Object_Obj23.Ay = 0;
  @CAN_RadarRL::RRL_Object::RRL_Object_Obj23.AyVnce = 0;
  @CAN_RadarRL::RRL_Object::RRL_Object_Obj23.ExistProb = 0;
  @CAN_RadarRL::RRL_Object::RRL_Object_Obj23.FilterInformation = 0;
  @CAN_RadarRL::RRL_Object::RRL_Object_Obj23.Length = 0;
  @CAN_RadarRL::RRL_Object::RRL_Object_Obj23.LengthVnce = 0;
  @CAN_RadarRL::RRL_Object::RRL_Object_Obj23.MeasurementStatus = 0;
  @CAN_RadarRL::RRL_Object::RRL_Object_Obj23.MovingStatus = 0;
  @CAN_RadarRL::RRL_Object::RRL_Object_Obj23.ObjId = 0;
  @CAN_RadarRL::RRL_Object::RRL_Object_Obj23.OrientationYaw = 0;
  @CAN_RadarRL::RRL_Object::RRL_Object_Obj23.OrientationYawVnce = 0;
  @CAN_RadarRL::RRL_Object::RRL_Object_Obj23.ProbClassConfidence = 0;
  @CAN_RadarRL::RRL_Object::RRL_Object_Obj23.ProbClassType = 0;
  @CAN_RadarRL::RRL_Object::RRL_Object_Obj23.Px = 0;
  @CAN_RadarRL::RRL_Object::RRL_Object_Obj23.PxAxCoVnce = 0;
  @CAN_RadarRL::RRL_Object::RRL_Object_Obj23.PxAyCoVnce = 0;
  @CAN_RadarRL::RRL_Object::RRL_Object_Obj23.PxPyCoVnce = 0;
  @CAN_RadarRL::RRL_Object::RRL_Object_Obj23.PxVnce = 0;
  @CAN_RadarRL::RRL_Object::RRL_Object_Obj23.PxVxCoVnce = 0;
  @CAN_RadarRL::RRL_Object::RRL_Object_Obj23.PxVyCoVnce = 0;
  }
  if(init_count == 26)
  {
  @CAN_RadarRL::RRL_Object::RRL_Object_Obj23.Py = 0;
  @CAN_RadarRL::RRL_Object::RRL_Object_Obj23.PyAxCoVnce = 0;
  @CAN_RadarRL::RRL_Object::RRL_Object_Obj23.PyAyCoVnce = 0;
  @CAN_RadarRL::RRL_Object::RRL_Object_Obj23.PyVnce = 0;
  @CAN_RadarRL::RRL_Object::RRL_Object_Obj23.PyVxCoVnce = 0;
  @CAN_RadarRL::RRL_Object::RRL_Object_Obj23.PyVyCoVnce = 0;
  @CAN_RadarRL::RRL_Object::RRL_Object_Obj23.ReferencePoint = 0;
  @CAN_RadarRL::RRL_Object::RRL_Object_Obj23.Vx = 0;
  @CAN_RadarRL::RRL_Object::RRL_Object_Obj23.VxAxCoVnce = 0;
  @CAN_RadarRL::RRL_Object::RRL_Object_Obj23.VxAyCoVnce = 0;
  @CAN_RadarRL::RRL_Object::RRL_Object_Obj23.VxVnce = 0;
  @CAN_RadarRL::RRL_Object::RRL_Object_Obj23.VxVyCoVnce = 0;
  @CAN_RadarRL::RRL_Object::RRL_Object_Obj23.Vy = 0;
  @CAN_RadarRL::RRL_Object::RRL_Object_Obj23.VyAxCoVnce = 0;
  @CAN_RadarRL::RRL_Object::RRL_Object_Obj23.VyAyCoVnce = 0;
  @CAN_RadarRL::RRL_Object::RRL_Object_Obj23.VyVnce = 0;
  @CAN_RadarRL::RRL_Object::RRL_Object_Obj23.Width = 0;
  @CAN_RadarRL::RRL_Object::RRL_Object_Obj23.WidthVnce = 0;
  @CAN_RadarRL::RRL_Object::RRL_Object_Obj24.Age = 0;
  @CAN_RadarRL::RRL_Object::RRL_Object_Obj24.Ax = 0;
  @CAN_RadarRL::RRL_Object::RRL_Object_Obj24.AxAyCoVnce = 0;
  @CAN_RadarRL::RRL_Object::RRL_Object_Obj24.AxVnce = 0;
  @CAN_RadarRL::RRL_Object::RRL_Object_Obj24.Ay = 0;
  @CAN_RadarRL::RRL_Object::RRL_Object_Obj24.AyVnce = 0;
  @CAN_RadarRL::RRL_Object::RRL_Object_Obj24.ExistProb = 0;
  }
  if(init_count == 27)
  {
  @CAN_RadarRL::RRL_Object::RRL_Object_Obj24.FilterInformation = 0;
  @CAN_RadarRL::RRL_Object::RRL_Object_Obj24.Length = 0;
  @CAN_RadarRL::RRL_Object::RRL_Object_Obj24.LengthVnce = 0;
  @CAN_RadarRL::RRL_Object::RRL_Object_Obj24.MeasurementStatus = 0;
  @CAN_RadarRL::RRL_Object::RRL_Object_Obj24.MovingStatus = 0;
  @CAN_RadarRL::RRL_Object::RRL_Object_Obj24.ObjId = 0;
  @CAN_RadarRL::RRL_Object::RRL_Object_Obj24.OrientationYaw = 0;
  @CAN_RadarRL::RRL_Object::RRL_Object_Obj24.OrientationYawVnce = 0;
  @CAN_RadarRL::RRL_Object::RRL_Object_Obj24.ProbClassConfidence = 0;
  @CAN_RadarRL::RRL_Object::RRL_Object_Obj24.ProbClassType = 0;
  @CAN_RadarRL::RRL_Object::RRL_Object_Obj24.Px = 0;
  @CAN_RadarRL::RRL_Object::RRL_Object_Obj24.PxAxCoVnce = 0;
  @CAN_RadarRL::RRL_Object::RRL_Object_Obj24.PxAyCoVnce = 0;
  @CAN_RadarRL::RRL_Object::RRL_Object_Obj24.PxPyCoVnce = 0;
  @CAN_RadarRL::RRL_Object::RRL_Object_Obj24.PxVnce = 0;
  @CAN_RadarRL::RRL_Object::RRL_Object_Obj24.PxVxCoVnce = 0;
  @CAN_RadarRL::RRL_Object::RRL_Object_Obj24.PxVyCoVnce = 0;
  @CAN_RadarRL::RRL_Object::RRL_Object_Obj24.Py = 0;
  @CAN_RadarRL::RRL_Object::RRL_Object_Obj24.PyAxCoVnce = 0;
  @CAN_RadarRL::RRL_Object::RRL_Object_Obj24.PyAyCoVnce = 0;
  @CAN_RadarRL::RRL_Object::RRL_Object_Obj24.PyVnce = 0;
  @CAN_RadarRL::RRL_Object::RRL_Object_Obj24.PyVxCoVnce = 0;
  @CAN_RadarRL::RRL_Object::RRL_Object_Obj24.PyVyCoVnce = 0;
  @CAN_RadarRL::RRL_Object::RRL_Object_Obj24.ReferencePoint = 0;
  @CAN_RadarRL::RRL_Object::RRL_Object_Obj24.Vx = 0;
  }
  if(init_count == 28)
  {
  @CAN_RadarRL::RRL_Object::RRL_Object_Obj24.VxAxCoVnce = 0;
  @CAN_RadarRL::RRL_Object::RRL_Object_Obj24.VxAyCoVnce = 0;
  @CAN_RadarRL::RRL_Object::RRL_Object_Obj24.VxVnce = 0;
  @CAN_RadarRL::RRL_Object::RRL_Object_Obj24.VxVyCoVnce = 0;
  @CAN_RadarRL::RRL_Object::RRL_Object_Obj24.Vy = 0;
  @CAN_RadarRL::RRL_Object::RRL_Object_Obj24.VyAxCoVnce = 0;
  @CAN_RadarRL::RRL_Object::RRL_Object_Obj24.VyAyCoVnce = 0;
  @CAN_RadarRL::RRL_Object::RRL_Object_Obj24.VyVnce = 0;
  @CAN_RadarRL::RRL_Object::RRL_Object_Obj24.Width = 0;
  @CAN_RadarRL::RRL_Object::RRL_Object_Obj24.WidthVnce = 0;
  @CAN_RadarRL::RRL_Object::RRL_Object_Obj25.Age = 0;
  @CAN_RadarRL::RRL_Object::RRL_Object_Obj25.Ax = 0;
  @CAN_RadarRL::RRL_Object::RRL_Object_Obj25.AxAyCoVnce = 0;
  @CAN_RadarRL::RRL_Object::RRL_Object_Obj25.AxVnce = 0;
  @CAN_RadarRL::RRL_Object::RRL_Object_Obj25.Ay = 0;
  @CAN_RadarRL::RRL_Object::RRL_Object_Obj25.AyVnce = 0;
  @CAN_RadarRL::RRL_Object::RRL_Object_Obj25.ExistProb = 0;
  @CAN_RadarRL::RRL_Object::RRL_Object_Obj25.FilterInformation = 0;
  @CAN_RadarRL::RRL_Object::RRL_Object_Obj25.Length = 0;
  @CAN_RadarRL::RRL_Object::RRL_Object_Obj25.LengthVnce = 0;
  @CAN_RadarRL::RRL_Object::RRL_Object_Obj25.MeasurementStatus = 0;
  @CAN_RadarRL::RRL_Object::RRL_Object_Obj25.MovingStatus = 0;
  @CAN_RadarRL::RRL_Object::RRL_Object_Obj25.ObjId = 0;
  @CAN_RadarRL::RRL_Object::RRL_Object_Obj25.OrientationYaw = 0;
  @CAN_RadarRL::RRL_Object::RRL_Object_Obj25.OrientationYawVnce = 0;
  }
  if(init_count == 29)
  {
  @CAN_RadarRL::RRL_Object::RRL_Object_Obj25.ProbClassConfidence = 0;
  @CAN_RadarRL::RRL_Object::RRL_Object_Obj25.ProbClassType = 0;
  @CAN_RadarRL::RRL_Object::RRL_Object_Obj25.Px = 0;
  @CAN_RadarRL::RRL_Object::RRL_Object_Obj25.PxAxCoVnce = 0;
  @CAN_RadarRL::RRL_Object::RRL_Object_Obj25.PxAyCoVnce = 0;
  @CAN_RadarRL::RRL_Object::RRL_Object_Obj25.PxPyCoVnce = 0;
  @CAN_RadarRL::RRL_Object::RRL_Object_Obj25.PxVnce = 0;
  @CAN_RadarRL::RRL_Object::RRL_Object_Obj25.PxVxCoVnce = 0;
  @CAN_RadarRL::RRL_Object::RRL_Object_Obj25.PxVyCoVnce = 0;
  @CAN_RadarRL::RRL_Object::RRL_Object_Obj25.Py = 0;
  @CAN_RadarRL::RRL_Object::RRL_Object_Obj25.PyAxCoVnce = 0;
  @CAN_RadarRL::RRL_Object::RRL_Object_Obj25.PyAyCoVnce = 0;
  @CAN_RadarRL::RRL_Object::RRL_Object_Obj25.PyVnce = 0;
  @CAN_RadarRL::RRL_Object::RRL_Object_Obj25.PyVxCoVnce = 0;
  @CAN_RadarRL::RRL_Object::RRL_Object_Obj25.PyVyCoVnce = 0;
  @CAN_RadarRL::RRL_Object::RRL_Object_Obj25.ReferencePoint = 0;
  @CAN_RadarRL::RRL_Object::RRL_Object_Obj25.Vx = 0;
  @CAN_RadarRL::RRL_Object::RRL_Object_Obj25.VxAxCoVnce = 0;
  @CAN_RadarRL::RRL_Object::RRL_Object_Obj25.VxAyCoVnce = 0;
  @CAN_RadarRL::RRL_Object::RRL_Object_Obj25.VxVnce = 0;
  @CAN_RadarRL::RRL_Object::RRL_Object_Obj25.VxVyCoVnce = 0;
  @CAN_RadarRL::RRL_Object::RRL_Object_Obj25.Vy = 0;
  @CAN_RadarRL::RRL_Object::RRL_Object_Obj25.VyAxCoVnce = 0;
  @CAN_RadarRL::RRL_Object::RRL_Object_Obj25.VyAyCoVnce = 0;
  @CAN_RadarRL::RRL_Object::RRL_Object_Obj25.VyVnce = 0;
  }
  if(init_count == 30)
  {
  @CAN_RadarRL::RRL_Object::RRL_Object_Obj25.Width = 0;
  @CAN_RadarRL::RRL_Object::RRL_Object_Obj25.WidthVnce = 0;
  @CAN_RadarRL::RRL_Object::RRL_Object_Obj26.Age = 0;
  @CAN_RadarRL::RRL_Object::RRL_Object_Obj26.Ax = 0;
  @CAN_RadarRL::RRL_Object::RRL_Object_Obj26.AxAyCoVnce = 0;
  @CAN_RadarRL::RRL_Object::RRL_Object_Obj26.AxVnce = 0;
  @CAN_RadarRL::RRL_Object::RRL_Object_Obj26.Ay = 0;
  @CAN_RadarRL::RRL_Object::RRL_Object_Obj26.AyVnce = 0;
  @CAN_RadarRL::RRL_Object::RRL_Object_Obj26.ExistProb = 0;
  @CAN_RadarRL::RRL_Object::RRL_Object_Obj26.FilterInformation = 0;
  @CAN_RadarRL::RRL_Object::RRL_Object_Obj26.Length = 0;
  @CAN_RadarRL::RRL_Object::RRL_Object_Obj26.LengthVnce = 0;
  @CAN_RadarRL::RRL_Object::RRL_Object_Obj26.MeasurementStatus = 0;
  @CAN_RadarRL::RRL_Object::RRL_Object_Obj26.MovingStatus = 0;
  @CAN_RadarRL::RRL_Object::RRL_Object_Obj26.ObjId = 0;
  @CAN_RadarRL::RRL_Object::RRL_Object_Obj26.OrientationYaw = 0;
  @CAN_RadarRL::RRL_Object::RRL_Object_Obj26.OrientationYawVnce = 0;
  @CAN_RadarRL::RRL_Object::RRL_Object_Obj26.ProbClassConfidence = 0;
  @CAN_RadarRL::RRL_Object::RRL_Object_Obj26.ProbClassType = 0;
  @CAN_RadarRL::RRL_Object::RRL_Object_Obj26.Px = 0;
  @CAN_RadarRL::RRL_Object::RRL_Object_Obj26.PxAxCoVnce = 0;
  @CAN_RadarRL::RRL_Object::RRL_Object_Obj26.PxAyCoVnce = 0;
  @CAN_RadarRL::RRL_Object::RRL_Object_Obj26.PxPyCoVnce = 0;
  @CAN_RadarRL::RRL_Object::RRL_Object_Obj26.PxVnce = 0;
  @CAN_RadarRL::RRL_Object::RRL_Object_Obj26.PxVxCoVnce = 0;
  }
  if(init_count == 31)
  {
  @CAN_RadarRL::RRL_Object::RRL_Object_Obj26.PxVyCoVnce = 0;
  @CAN_RadarRL::RRL_Object::RRL_Object_Obj26.Py = 0;
  @CAN_RadarRL::RRL_Object::RRL_Object_Obj26.PyAxCoVnce = 0;
  @CAN_RadarRL::RRL_Object::RRL_Object_Obj26.PyAyCoVnce = 0;
  @CAN_RadarRL::RRL_Object::RRL_Object_Obj26.PyVnce = 0;
  @CAN_RadarRL::RRL_Object::RRL_Object_Obj26.PyVxCoVnce = 0;
  @CAN_RadarRL::RRL_Object::RRL_Object_Obj26.PyVyCoVnce = 0;
  @CAN_RadarRL::RRL_Object::RRL_Object_Obj26.ReferencePoint = 0;
  @CAN_RadarRL::RRL_Object::RRL_Object_Obj26.Vx = 0;
  @CAN_RadarRL::RRL_Object::RRL_Object_Obj26.VxAxCoVnce = 0;
  @CAN_RadarRL::RRL_Object::RRL_Object_Obj26.VxAyCoVnce = 0;
  @CAN_RadarRL::RRL_Object::RRL_Object_Obj26.VxVnce = 0;
  @CAN_RadarRL::RRL_Object::RRL_Object_Obj26.VxVyCoVnce = 0;
  @CAN_RadarRL::RRL_Object::RRL_Object_Obj26.Vy = 0;
  @CAN_RadarRL::RRL_Object::RRL_Object_Obj26.VyAxCoVnce = 0;
  @CAN_RadarRL::RRL_Object::RRL_Object_Obj26.VyAyCoVnce = 0;
  @CAN_RadarRL::RRL_Object::RRL_Object_Obj26.VyVnce = 0;
  @CAN_RadarRL::RRL_Object::RRL_Object_Obj26.Width = 0;
  @CAN_RadarRL::RRL_Object::RRL_Object_Obj26.WidthVnce = 0;
  @CAN_RadarRL::RRL_Object::RRL_Object_Obj27.Age = 0;
  @CAN_RadarRL::RRL_Object::RRL_Object_Obj27.Ax = 0;
  @CAN_RadarRL::RRL_Object::RRL_Object_Obj27.AxAyCoVnce = 0;
  @CAN_RadarRL::RRL_Object::RRL_Object_Obj27.AxVnce = 0;
  @CAN_RadarRL::RRL_Object::RRL_Object_Obj27.Ay = 0;
  @CAN_RadarRL::RRL_Object::RRL_Object_Obj27.AyVnce = 0;
  }
  if(init_count == 32)
  {
  @CAN_RadarRL::RRL_Object::RRL_Object_Obj27.ExistProb = 0;
  @CAN_RadarRL::RRL_Object::RRL_Object_Obj27.FilterInformation = 0;
  @CAN_RadarRL::RRL_Object::RRL_Object_Obj27.Length = 0;
  @CAN_RadarRL::RRL_Object::RRL_Object_Obj27.LengthVnce = 0;
  @CAN_RadarRL::RRL_Object::RRL_Object_Obj27.MeasurementStatus = 0;
  @CAN_RadarRL::RRL_Object::RRL_Object_Obj27.MovingStatus = 0;
  @CAN_RadarRL::RRL_Object::RRL_Object_Obj27.ObjId = 0;
  @CAN_RadarRL::RRL_Object::RRL_Object_Obj27.OrientationYaw = 0;
  @CAN_RadarRL::RRL_Object::RRL_Object_Obj27.OrientationYawVnce = 0;
  @CAN_RadarRL::RRL_Object::RRL_Object_Obj27.ProbClassConfidence = 0;
  @CAN_RadarRL::RRL_Object::RRL_Object_Obj27.ProbClassType = 0;
  @CAN_RadarRL::RRL_Object::RRL_Object_Obj27.Px = 0;
  @CAN_RadarRL::RRL_Object::RRL_Object_Obj27.PxAxCoVnce = 0;
  @CAN_RadarRL::RRL_Object::RRL_Object_Obj27.PxAyCoVnce = 0;
  @CAN_RadarRL::RRL_Object::RRL_Object_Obj27.PxPyCoVnce = 0;
  @CAN_RadarRL::RRL_Object::RRL_Object_Obj27.PxVnce = 0;
  @CAN_RadarRL::RRL_Object::RRL_Object_Obj27.PxVxCoVnce = 0;
  @CAN_RadarRL::RRL_Object::RRL_Object_Obj27.PxVyCoVnce = 0;
  @CAN_RadarRL::RRL_Object::RRL_Object_Obj27.Py = 0;
  @CAN_RadarRL::RRL_Object::RRL_Object_Obj27.PyAxCoVnce = 0;
  @CAN_RadarRL::RRL_Object::RRL_Object_Obj27.PyAyCoVnce = 0;
  @CAN_RadarRL::RRL_Object::RRL_Object_Obj27.PyVnce = 0;
  @CAN_RadarRL::RRL_Object::RRL_Object_Obj27.PyVxCoVnce = 0;
  @CAN_RadarRL::RRL_Object::RRL_Object_Obj27.PyVyCoVnce = 0;
  @CAN_RadarRL::RRL_Object::RRL_Object_Obj27.ReferencePoint = 0;
  }
  if(init_count == 33)
  {
  @CAN_RadarRL::RRL_Object::RRL_Object_Obj27.Vx = 0;
  @CAN_RadarRL::RRL_Object::RRL_Object_Obj27.VxAxCoVnce = 0;
  @CAN_RadarRL::RRL_Object::RRL_Object_Obj27.VxAyCoVnce = 0;
  @CAN_RadarRL::RRL_Object::RRL_Object_Obj27.VxVnce = 0;
  @CAN_RadarRL::RRL_Object::RRL_Object_Obj27.VxVyCoVnce = 0;
  @CAN_RadarRL::RRL_Object::RRL_Object_Obj27.Vy = 0;
  @CAN_RadarRL::RRL_Object::RRL_Object_Obj27.VyAxCoVnce = 0;
  @CAN_RadarRL::RRL_Object::RRL_Object_Obj27.VyAyCoVnce = 0;
  @CAN_RadarRL::RRL_Object::RRL_Object_Obj27.VyVnce = 0;
  @CAN_RadarRL::RRL_Object::RRL_Object_Obj27.Width = 0;
  @CAN_RadarRL::RRL_Object::RRL_Object_Obj27.WidthVnce = 0;
  @CAN_RadarRL::RRL_Object::RRL_Object_Obj28.Age = 0;
  @CAN_RadarRL::RRL_Object::RRL_Object_Obj28.Ax = 0;
  @CAN_RadarRL::RRL_Object::RRL_Object_Obj28.AxAyCoVnce = 0;
  @CAN_RadarRL::RRL_Object::RRL_Object_Obj28.AxVnce = 0;
  @CAN_RadarRL::RRL_Object::RRL_Object_Obj28.Ay = 0;
  @CAN_RadarRL::RRL_Object::RRL_Object_Obj28.AyVnce = 0;
  @CAN_RadarRL::RRL_Object::RRL_Object_Obj28.ExistProb = 0;
  @CAN_RadarRL::RRL_Object::RRL_Object_Obj28.FilterInformation = 0;
  @CAN_RadarRL::RRL_Object::RRL_Object_Obj28.Length = 0;
  @CAN_RadarRL::RRL_Object::RRL_Object_Obj28.LengthVnce = 0;
  @CAN_RadarRL::RRL_Object::RRL_Object_Obj28.MeasurementStatus = 0;
  @CAN_RadarRL::RRL_Object::RRL_Object_Obj28.MovingStatus = 0;
  @CAN_RadarRL::RRL_Object::RRL_Object_Obj28.ObjId = 0;
  @CAN_RadarRL::RRL_Object::RRL_Object_Obj28.OrientationYaw = 0;
  }
  if(init_count == 34)
  {
  @CAN_RadarRL::RRL_Object::RRL_Object_Obj28.OrientationYawVnce = 0;
  @CAN_RadarRL::RRL_Object::RRL_Object_Obj28.ProbClassConfidence = 0;
  @CAN_RadarRL::RRL_Object::RRL_Object_Obj28.ProbClassType = 0;
  @CAN_RadarRL::RRL_Object::RRL_Object_Obj28.Px = 0;
  @CAN_RadarRL::RRL_Object::RRL_Object_Obj28.PxAxCoVnce = 0;
  @CAN_RadarRL::RRL_Object::RRL_Object_Obj28.PxAyCoVnce = 0;
  @CAN_RadarRL::RRL_Object::RRL_Object_Obj28.PxPyCoVnce = 0;
  @CAN_RadarRL::RRL_Object::RRL_Object_Obj28.PxVnce = 0;
  @CAN_RadarRL::RRL_Object::RRL_Object_Obj28.PxVxCoVnce = 0;
  @CAN_RadarRL::RRL_Object::RRL_Object_Obj28.PxVyCoVnce = 0;
  @CAN_RadarRL::RRL_Object::RRL_Object_Obj28.Py = 0;
  @CAN_RadarRL::RRL_Object::RRL_Object_Obj28.PyAxCoVnce = 0;
  @CAN_RadarRL::RRL_Object::RRL_Object_Obj28.PyAyCoVnce = 0;
  @CAN_RadarRL::RRL_Object::RRL_Object_Obj28.PyVnce = 0;
  @CAN_RadarRL::RRL_Object::RRL_Object_Obj28.PyVxCoVnce = 0;
  @CAN_RadarRL::RRL_Object::RRL_Object_Obj28.PyVyCoVnce = 0;
  @CAN_RadarRL::RRL_Object::RRL_Object_Obj28.ReferencePoint = 0;
  @CAN_RadarRL::RRL_Object::RRL_Object_Obj28.Vx = 0;
  @CAN_RadarRL::RRL_Object::RRL_Object_Obj28.VxAxCoVnce = 0;
  @CAN_RadarRL::RRL_Object::RRL_Object_Obj28.VxAyCoVnce = 0;
  @CAN_RadarRL::RRL_Object::RRL_Object_Obj28.VxVnce = 0;
  @CAN_RadarRL::RRL_Object::RRL_Object_Obj28.VxVyCoVnce = 0;
  @CAN_RadarRL::RRL_Object::RRL_Object_Obj28.Vy = 0;
  @CAN_RadarRL::RRL_Object::RRL_Object_Obj28.VyAxCoVnce = 0;
  @CAN_RadarRL::RRL_Object::RRL_Object_Obj28.VyAyCoVnce = 0;
  }
  if(init_count == 35)
  {
  @CAN_RadarRL::RRL_Object::RRL_Object_Obj28.VyVnce = 0;
  @CAN_RadarRL::RRL_Object::RRL_Object_Obj28.Width = 0;
  @CAN_RadarRL::RRL_Object::RRL_Object_Obj28.WidthVnce = 0;
  @CAN_RadarRL::RRL_Object::RRL_Object_Obj29.Age = 0;
  @CAN_RadarRL::RRL_Object::RRL_Object_Obj29.Ax = 0;
  @CAN_RadarRL::RRL_Object::RRL_Object_Obj29.AxAyCoVnce = 0;
  @CAN_RadarRL::RRL_Object::RRL_Object_Obj29.AxVnce = 0;
  @CAN_RadarRL::RRL_Object::RRL_Object_Obj29.Ay = 0;
  @CAN_RadarRL::RRL_Object::RRL_Object_Obj29.AyVnce = 0;
  @CAN_RadarRL::RRL_Object::RRL_Object_Obj29.ExistProb = 0;
  @CAN_RadarRL::RRL_Object::RRL_Object_Obj29.FilterInformation = 0;
  @CAN_RadarRL::RRL_Object::RRL_Object_Obj29.Length = 0;
  @CAN_RadarRL::RRL_Object::RRL_Object_Obj29.LengthVnce = 0;
  @CAN_RadarRL::RRL_Object::RRL_Object_Obj29.MeasurementStatus = 0;
  @CAN_RadarRL::RRL_Object::RRL_Object_Obj29.MovingStatus = 0;
  @CAN_RadarRL::RRL_Object::RRL_Object_Obj29.ObjId = 0;
  @CAN_RadarRL::RRL_Object::RRL_Object_Obj29.OrientationYaw = 0;
  @CAN_RadarRL::RRL_Object::RRL_Object_Obj29.OrientationYawVnce = 0;
  @CAN_RadarRL::RRL_Object::RRL_Object_Obj29.ProbClassConfidence = 0;
  @CAN_RadarRL::RRL_Object::RRL_Object_Obj29.ProbClassType = 0;
  @CAN_RadarRL::RRL_Object::RRL_Object_Obj29.Px = 0;
  @CAN_RadarRL::RRL_Object::RRL_Object_Obj29.PxAxCoVnce = 0;
  @CAN_RadarRL::RRL_Object::RRL_Object_Obj29.PxAyCoVnce = 0;
  @CAN_RadarRL::RRL_Object::RRL_Object_Obj29.PxPyCoVnce = 0;
  @CAN_RadarRL::RRL_Object::RRL_Object_Obj29.PxVnce = 0;
  }
  if(init_count == 36)
  {
  @CAN_RadarRL::RRL_Object::RRL_Object_Obj29.PxVxCoVnce = 0;
  @CAN_RadarRL::RRL_Object::RRL_Object_Obj29.PxVyCoVnce = 0;
  @CAN_RadarRL::RRL_Object::RRL_Object_Obj29.Py = 0;
  @CAN_RadarRL::RRL_Object::RRL_Object_Obj29.PyAxCoVnce = 0;
  @CAN_RadarRL::RRL_Object::RRL_Object_Obj29.PyAyCoVnce = 0;
  @CAN_RadarRL::RRL_Object::RRL_Object_Obj29.PyVnce = 0;
  @CAN_RadarRL::RRL_Object::RRL_Object_Obj29.PyVxCoVnce = 0;
  @CAN_RadarRL::RRL_Object::RRL_Object_Obj29.PyVyCoVnce = 0;
  @CAN_RadarRL::RRL_Object::RRL_Object_Obj29.ReferencePoint = 0;
  @CAN_RadarRL::RRL_Object::RRL_Object_Obj29.Vx = 0;
  @CAN_RadarRL::RRL_Object::RRL_Object_Obj29.VxAxCoVnce = 0;
  @CAN_RadarRL::RRL_Object::RRL_Object_Obj29.VxAyCoVnce = 0;
  @CAN_RadarRL::RRL_Object::RRL_Object_Obj29.VxVnce = 0;
  @CAN_RadarRL::RRL_Object::RRL_Object_Obj29.VxVyCoVnce = 0;
  @CAN_RadarRL::RRL_Object::RRL_Object_Obj29.Vy = 0;
  @CAN_RadarRL::RRL_Object::RRL_Object_Obj29.VyAxCoVnce = 0;
  @CAN_RadarRL::RRL_Object::RRL_Object_Obj29.VyAyCoVnce = 0;
  @CAN_RadarRL::RRL_Object::RRL_Object_Obj29.VyVnce = 0;
  @CAN_RadarRL::RRL_Object::RRL_Object_Obj29.Width = 0;
  @CAN_RadarRL::RRL_Object::RRL_Object_Obj29.WidthVnce = 0;
  @CAN_RadarRL::RRL_Object::RRL_Object_Obj2.Age = 0;
  @CAN_RadarRL::RRL_Object::RRL_Object_Obj2.Ax = 0;
  @CAN_RadarRL::RRL_Object::RRL_Object_Obj2.AxAyCoVnce = 0;
  @CAN_RadarRL::RRL_Object::RRL_Object_Obj2.AxVnce = 0;
  @CAN_RadarRL::RRL_Object::RRL_Object_Obj2.Ay = 0;
  }
  if(init_count == 37)
  {
  @CAN_RadarRL::RRL_Object::RRL_Object_Obj2.AyVnce = 0;
  @CAN_RadarRL::RRL_Object::RRL_Object_Obj2.ExistProb = 0;
  @CAN_RadarRL::RRL_Object::RRL_Object_Obj2.FilterInformation = 0;
  @CAN_RadarRL::RRL_Object::RRL_Object_Obj2.Length = 0;
  @CAN_RadarRL::RRL_Object::RRL_Object_Obj2.LengthVnce = 0;
  @CAN_RadarRL::RRL_Object::RRL_Object_Obj2.MeasurementStatus = 0;
  @CAN_RadarRL::RRL_Object::RRL_Object_Obj2.MovingStatus = 0;
  @CAN_RadarRL::RRL_Object::RRL_Object_Obj2.ObjId = 0;
  @CAN_RadarRL::RRL_Object::RRL_Object_Obj2.OrientationYaw = 0;
  @CAN_RadarRL::RRL_Object::RRL_Object_Obj2.OrientationYawVnce = 0;
  @CAN_RadarRL::RRL_Object::RRL_Object_Obj2.ProbClassConfidence = 0;
  @CAN_RadarRL::RRL_Object::RRL_Object_Obj2.ProbClassType = 0;
  @CAN_RadarRL::RRL_Object::RRL_Object_Obj2.Px = 0;
  @CAN_RadarRL::RRL_Object::RRL_Object_Obj2.PxAxCoVnce = 0;
  @CAN_RadarRL::RRL_Object::RRL_Object_Obj2.PxAyCoVnce = 0;
  @CAN_RadarRL::RRL_Object::RRL_Object_Obj2.PxPyCoVnce = 0;
  @CAN_RadarRL::RRL_Object::RRL_Object_Obj2.PxVnce = 0;
  @CAN_RadarRL::RRL_Object::RRL_Object_Obj2.PxVxCoVnce = 0;
  @CAN_RadarRL::RRL_Object::RRL_Object_Obj2.PxVyCoVnce = 0;
  @CAN_RadarRL::RRL_Object::RRL_Object_Obj2.Py = 0;
  @CAN_RadarRL::RRL_Object::RRL_Object_Obj2.PyAxCoVnce = 0;
  @CAN_RadarRL::RRL_Object::RRL_Object_Obj2.PyAyCoVnce = 0;
  @CAN_RadarRL::RRL_Object::RRL_Object_Obj2.PyVnce = 0;
  @CAN_RadarRL::RRL_Object::RRL_Object_Obj2.PyVxCoVnce = 0;
  @CAN_RadarRL::RRL_Object::RRL_Object_Obj2.PyVyCoVnce = 0;
  }
  if(init_count == 38)
  {
  @CAN_RadarRL::RRL_Object::RRL_Object_Obj2.ReferencePoint = 0;
  @CAN_RadarRL::RRL_Object::RRL_Object_Obj2.Vx = 0;
  @CAN_RadarRL::RRL_Object::RRL_Object_Obj2.VxAxCoVnce = 0;
  @CAN_RadarRL::RRL_Object::RRL_Object_Obj2.VxAyCoVnce = 0;
  @CAN_RadarRL::RRL_Object::RRL_Object_Obj2.VxVnce = 0;
  @CAN_RadarRL::RRL_Object::RRL_Object_Obj2.VxVyCoVnce = 0;
  @CAN_RadarRL::RRL_Object::RRL_Object_Obj2.Vy = 0;
  @CAN_RadarRL::RRL_Object::RRL_Object_Obj2.VyAxCoVnce = 0;
  @CAN_RadarRL::RRL_Object::RRL_Object_Obj2.VyAyCoVnce = 0;
  @CAN_RadarRL::RRL_Object::RRL_Object_Obj2.VyVnce = 0;
  @CAN_RadarRL::RRL_Object::RRL_Object_Obj2.Width = 0;
  @CAN_RadarRL::RRL_Object::RRL_Object_Obj2.WidthVnce = 0;
  @CAN_RadarRL::RRL_Object::RRL_Object_Obj30.Age = 0;
  @CAN_RadarRL::RRL_Object::RRL_Object_Obj30.Ax = 0;
  @CAN_RadarRL::RRL_Object::RRL_Object_Obj30.AxAyCoVnce = 0;
  @CAN_RadarRL::RRL_Object::RRL_Object_Obj30.AxVnce = 0;
  @CAN_RadarRL::RRL_Object::RRL_Object_Obj30.Ay = 0;
  @CAN_RadarRL::RRL_Object::RRL_Object_Obj30.AyVnce = 0;
  @CAN_RadarRL::RRL_Object::RRL_Object_Obj30.ExistProb = 0;
  @CAN_RadarRL::RRL_Object::RRL_Object_Obj30.FilterInformation = 0;
  @CAN_RadarRL::RRL_Object::RRL_Object_Obj30.Length = 0;
  @CAN_RadarRL::RRL_Object::RRL_Object_Obj30.LengthVnce = 0;
  @CAN_RadarRL::RRL_Object::RRL_Object_Obj30.MeasurementStatus = 0;
  @CAN_RadarRL::RRL_Object::RRL_Object_Obj30.MovingStatus = 0;
  @CAN_RadarRL::RRL_Object::RRL_Object_Obj30.ObjId = 0;
  }
  if(init_count == 39)
  {
  @CAN_RadarRL::RRL_Object::RRL_Object_Obj30.OrientationYaw = 0;
  @CAN_RadarRL::RRL_Object::RRL_Object_Obj30.OrientationYawVnce = 0;
  @CAN_RadarRL::RRL_Object::RRL_Object_Obj30.ProbClassConfidence = 0;
  @CAN_RadarRL::RRL_Object::RRL_Object_Obj30.ProbClassType = 0;
  @CAN_RadarRL::RRL_Object::RRL_Object_Obj30.Px = 0;
  @CAN_RadarRL::RRL_Object::RRL_Object_Obj30.PxAxCoVnce = 0;
  @CAN_RadarRL::RRL_Object::RRL_Object_Obj30.PxAyCoVnce = 0;
  @CAN_RadarRL::RRL_Object::RRL_Object_Obj30.PxPyCoVnce = 0;
  @CAN_RadarRL::RRL_Object::RRL_Object_Obj30.PxVnce = 0;
  @CAN_RadarRL::RRL_Object::RRL_Object_Obj30.PxVxCoVnce = 0;
  @CAN_RadarRL::RRL_Object::RRL_Object_Obj30.PxVyCoVnce = 0;
  @CAN_RadarRL::RRL_Object::RRL_Object_Obj30.Py = 0;
  @CAN_RadarRL::RRL_Object::RRL_Object_Obj30.PyAxCoVnce = 0;
  @CAN_RadarRL::RRL_Object::RRL_Object_Obj30.PyAyCoVnce = 0;
  @CAN_RadarRL::RRL_Object::RRL_Object_Obj30.PyVnce = 0;
  @CAN_RadarRL::RRL_Object::RRL_Object_Obj30.PyVxCoVnce = 0;
  @CAN_RadarRL::RRL_Object::RRL_Object_Obj30.PyVyCoVnce = 0;
  @CAN_RadarRL::RRL_Object::RRL_Object_Obj30.ReferencePoint = 0;
  @CAN_RadarRL::RRL_Object::RRL_Object_Obj30.Vx = 0;
  @CAN_RadarRL::RRL_Object::RRL_Object_Obj30.VxAxCoVnce = 0;
  @CAN_RadarRL::RRL_Object::RRL_Object_Obj30.VxAyCoVnce = 0;
  @CAN_RadarRL::RRL_Object::RRL_Object_Obj30.VxVnce = 0;
  @CAN_RadarRL::RRL_Object::RRL_Object_Obj30.VxVyCoVnce = 0;
  @CAN_RadarRL::RRL_Object::RRL_Object_Obj30.Vy = 0;
  @CAN_RadarRL::RRL_Object::RRL_Object_Obj30.VyAxCoVnce = 0;
  }
  if(init_count == 40)
  {
  @CAN_RadarRL::RRL_Object::RRL_Object_Obj30.VyAyCoVnce = 0;
  @CAN_RadarRL::RRL_Object::RRL_Object_Obj30.VyVnce = 0;
  @CAN_RadarRL::RRL_Object::RRL_Object_Obj30.Width = 0;
  @CAN_RadarRL::RRL_Object::RRL_Object_Obj30.WidthVnce = 0;
  @CAN_RadarRL::RRL_Object::RRL_Object_Obj31.Age = 0;
  @CAN_RadarRL::RRL_Object::RRL_Object_Obj31.Ax = 0;
  @CAN_RadarRL::RRL_Object::RRL_Object_Obj31.AxAyCoVnce = 0;
  @CAN_RadarRL::RRL_Object::RRL_Object_Obj31.AxVnce = 0;
  @CAN_RadarRL::RRL_Object::RRL_Object_Obj31.Ay = 0;
  @CAN_RadarRL::RRL_Object::RRL_Object_Obj31.AyVnce = 0;
  @CAN_RadarRL::RRL_Object::RRL_Object_Obj31.ExistProb = 0;
  @CAN_RadarRL::RRL_Object::RRL_Object_Obj31.FilterInformation = 0;
  @CAN_RadarRL::RRL_Object::RRL_Object_Obj31.Length = 0;
  @CAN_RadarRL::RRL_Object::RRL_Object_Obj31.LengthVnce = 0;
  @CAN_RadarRL::RRL_Object::RRL_Object_Obj31.MeasurementStatus = 0;
  @CAN_RadarRL::RRL_Object::RRL_Object_Obj31.MovingStatus = 0;
  @CAN_RadarRL::RRL_Object::RRL_Object_Obj31.ObjId = 0;
  @CAN_RadarRL::RRL_Object::RRL_Object_Obj31.OrientationYaw = 0;
  @CAN_RadarRL::RRL_Object::RRL_Object_Obj31.OrientationYawVnce = 0;
  @CAN_RadarRL::RRL_Object::RRL_Object_Obj31.ProbClassConfidence = 0;
  @CAN_RadarRL::RRL_Object::RRL_Object_Obj31.ProbClassType = 0;
  @CAN_RadarRL::RRL_Object::RRL_Object_Obj31.Px = 0;
  @CAN_RadarRL::RRL_Object::RRL_Object_Obj31.PxAxCoVnce = 0;
  @CAN_RadarRL::RRL_Object::RRL_Object_Obj31.PxAyCoVnce = 0;
  @CAN_RadarRL::RRL_Object::RRL_Object_Obj31.PxPyCoVnce = 0;
  }
  if(init_count == 41)
  {
  @CAN_RadarRL::RRL_Object::RRL_Object_Obj31.PxVnce = 0;
  @CAN_RadarRL::RRL_Object::RRL_Object_Obj31.PxVxCoVnce = 0;
  @CAN_RadarRL::RRL_Object::RRL_Object_Obj31.PxVyCoVnce = 0;
  @CAN_RadarRL::RRL_Object::RRL_Object_Obj31.Py = 0;
  @CAN_RadarRL::RRL_Object::RRL_Object_Obj31.PyAxCoVnce = 0;
  @CAN_RadarRL::RRL_Object::RRL_Object_Obj31.PyAyCoVnce = 0;
  @CAN_RadarRL::RRL_Object::RRL_Object_Obj31.PyVnce = 0;
  @CAN_RadarRL::RRL_Object::RRL_Object_Obj31.PyVxCoVnce = 0;
  @CAN_RadarRL::RRL_Object::RRL_Object_Obj31.PyVyCoVnce = 0;
  @CAN_RadarRL::RRL_Object::RRL_Object_Obj31.ReferencePoint = 0;
  @CAN_RadarRL::RRL_Object::RRL_Object_Obj31.Vx = 0;
  @CAN_RadarRL::RRL_Object::RRL_Object_Obj31.VxAxCoVnce = 0;
  @CAN_RadarRL::RRL_Object::RRL_Object_Obj31.VxAyCoVnce = 0;
  @CAN_RadarRL::RRL_Object::RRL_Object_Obj31.VxVnce = 0;
  @CAN_RadarRL::RRL_Object::RRL_Object_Obj31.VxVyCoVnce = 0;
  @CAN_RadarRL::RRL_Object::RRL_Object_Obj31.Vy = 0;
  @CAN_RadarRL::RRL_Object::RRL_Object_Obj31.VyAxCoVnce = 0;
  @CAN_RadarRL::RRL_Object::RRL_Object_Obj31.VyAyCoVnce = 0;
  @CAN_RadarRL::RRL_Object::RRL_Object_Obj31.VyVnce = 0;
  @CAN_RadarRL::RRL_Object::RRL_Object_Obj31.Width = 0;
  @CAN_RadarRL::RRL_Object::RRL_Object_Obj31.WidthVnce = 0;
  @CAN_RadarRL::RRL_Object::RRL_Object_Obj32.Age = 0;
  @CAN_RadarRL::RRL_Object::RRL_Object_Obj32.Ax = 0;
  @CAN_RadarRL::RRL_Object::RRL_Object_Obj32.AxAyCoVnce = 0;
  @CAN_RadarRL::RRL_Object::RRL_Object_Obj32.AxVnce = 0;
  }
  if(init_count == 42)
  {
  @CAN_RadarRL::RRL_Object::RRL_Object_Obj32.Ay = 0;
  @CAN_RadarRL::RRL_Object::RRL_Object_Obj32.AyVnce = 0;
  @CAN_RadarRL::RRL_Object::RRL_Object_Obj32.ExistProb = 0;
  @CAN_RadarRL::RRL_Object::RRL_Object_Obj32.FilterInformation = 0;
  @CAN_RadarRL::RRL_Object::RRL_Object_Obj32.Length = 0;
  @CAN_RadarRL::RRL_Object::RRL_Object_Obj32.LengthVnce = 0;
  @CAN_RadarRL::RRL_Object::RRL_Object_Obj32.MeasurementStatus = 0;
  @CAN_RadarRL::RRL_Object::RRL_Object_Obj32.MovingStatus = 0;
  @CAN_RadarRL::RRL_Object::RRL_Object_Obj32.ObjId = 0;
  @CAN_RadarRL::RRL_Object::RRL_Object_Obj32.OrientationYaw = 0;
  @CAN_RadarRL::RRL_Object::RRL_Object_Obj32.OrientationYawVnce = 0;
  @CAN_RadarRL::RRL_Object::RRL_Object_Obj32.ProbClassConfidence = 0;
  @CAN_RadarRL::RRL_Object::RRL_Object_Obj32.ProbClassType = 0;
  @CAN_RadarRL::RRL_Object::RRL_Object_Obj32.Px = 0;
  @CAN_RadarRL::RRL_Object::RRL_Object_Obj32.PxAxCoVnce = 0;
  @CAN_RadarRL::RRL_Object::RRL_Object_Obj32.PxAyCoVnce = 0;
  @CAN_RadarRL::RRL_Object::RRL_Object_Obj32.PxPyCoVnce = 0;
  @CAN_RadarRL::RRL_Object::RRL_Object_Obj32.PxVnce = 0;
  @CAN_RadarRL::RRL_Object::RRL_Object_Obj32.PxVxCoVnce = 0;
  @CAN_RadarRL::RRL_Object::RRL_Object_Obj32.PxVyCoVnce = 0;
  @CAN_RadarRL::RRL_Object::RRL_Object_Obj32.Py = 0;
  @CAN_RadarRL::RRL_Object::RRL_Object_Obj32.PyAxCoVnce = 0;
  @CAN_RadarRL::RRL_Object::RRL_Object_Obj32.PyAyCoVnce = 0;
  @CAN_RadarRL::RRL_Object::RRL_Object_Obj32.PyVnce = 0;
  @CAN_RadarRL::RRL_Object::RRL_Object_Obj32.PyVxCoVnce = 0;
  }
  if(init_count == 43)
  {
  @CAN_RadarRL::RRL_Object::RRL_Object_Obj32.PyVyCoVnce = 0;
  @CAN_RadarRL::RRL_Object::RRL_Object_Obj32.ReferencePoint = 0;
  @CAN_RadarRL::RRL_Object::RRL_Object_Obj32.Vx = 0;
  @CAN_RadarRL::RRL_Object::RRL_Object_Obj32.VxAxCoVnce = 0;
  @CAN_RadarRL::RRL_Object::RRL_Object_Obj32.VxAyCoVnce = 0;
  @CAN_RadarRL::RRL_Object::RRL_Object_Obj32.VxVnce = 0;
  @CAN_RadarRL::RRL_Object::RRL_Object_Obj32.VxVyCoVnce = 0;
  @CAN_RadarRL::RRL_Object::RRL_Object_Obj32.Vy = 0;
  @CAN_RadarRL::RRL_Object::RRL_Object_Obj32.VyAxCoVnce = 0;
  @CAN_RadarRL::RRL_Object::RRL_Object_Obj32.VyAyCoVnce = 0;
  @CAN_RadarRL::RRL_Object::RRL_Object_Obj32.VyVnce = 0;
  @CAN_RadarRL::RRL_Object::RRL_Object_Obj32.Width = 0;
  @CAN_RadarRL::RRL_Object::RRL_Object_Obj32.WidthVnce = 0;
  @CAN_RadarRL::RRL_Object::RRL_Object_Obj33.Age = 0;
  @CAN_RadarRL::RRL_Object::RRL_Object_Obj33.Ax = 0;
  @CAN_RadarRL::RRL_Object::RRL_Object_Obj33.AxAyCoVnce = 0;
  @CAN_RadarRL::RRL_Object::RRL_Object_Obj33.AxVnce = 0;
  @CAN_RadarRL::RRL_Object::RRL_Object_Obj33.Ay = 0;
  @CAN_RadarRL::RRL_Object::RRL_Object_Obj33.AyVnce = 0;
  @CAN_RadarRL::RRL_Object::RRL_Object_Obj33.ExistProb = 0;
  @CAN_RadarRL::RRL_Object::RRL_Object_Obj33.FilterInformation = 0;
  @CAN_RadarRL::RRL_Object::RRL_Object_Obj33.Length = 0;
  @CAN_RadarRL::RRL_Object::RRL_Object_Obj33.LengthVnce = 0;
  @CAN_RadarRL::RRL_Object::RRL_Object_Obj33.MeasurementStatus = 0;
  @CAN_RadarRL::RRL_Object::RRL_Object_Obj33.MovingStatus = 0;
  }
  if(init_count == 44)
  {
  @CAN_RadarRL::RRL_Object::RRL_Object_Obj33.ObjId = 0;
  @CAN_RadarRL::RRL_Object::RRL_Object_Obj33.OrientationYaw = 0;
  @CAN_RadarRL::RRL_Object::RRL_Object_Obj33.OrientationYawVnce = 0;
  @CAN_RadarRL::RRL_Object::RRL_Object_Obj33.ProbClassConfidence = 0;
  @CAN_RadarRL::RRL_Object::RRL_Object_Obj33.ProbClassType = 0;
  @CAN_RadarRL::RRL_Object::RRL_Object_Obj33.Px = 0;
  @CAN_RadarRL::RRL_Object::RRL_Object_Obj33.PxAxCoVnce = 0;
  @CAN_RadarRL::RRL_Object::RRL_Object_Obj33.PxAyCoVnce = 0;
  @CAN_RadarRL::RRL_Object::RRL_Object_Obj33.PxPyCoVnce = 0;
  @CAN_RadarRL::RRL_Object::RRL_Object_Obj33.PxVnce = 0;
  @CAN_RadarRL::RRL_Object::RRL_Object_Obj33.PxVxCoVnce = 0;
  @CAN_RadarRL::RRL_Object::RRL_Object_Obj33.PxVyCoVnce = 0;
  @CAN_RadarRL::RRL_Object::RRL_Object_Obj33.Py = 0;
  @CAN_RadarRL::RRL_Object::RRL_Object_Obj33.PyAxCoVnce = 0;
  @CAN_RadarRL::RRL_Object::RRL_Object_Obj33.PyAyCoVnce = 0;
  @CAN_RadarRL::RRL_Object::RRL_Object_Obj33.PyVnce = 0;
  @CAN_RadarRL::RRL_Object::RRL_Object_Obj33.PyVxCoVnce = 0;
  @CAN_RadarRL::RRL_Object::RRL_Object_Obj33.PyVyCoVnce = 0;
  @CAN_RadarRL::RRL_Object::RRL_Object_Obj33.ReferencePoint = 0;
  @CAN_RadarRL::RRL_Object::RRL_Object_Obj33.Vx = 0;
  @CAN_RadarRL::RRL_Object::RRL_Object_Obj33.VxAxCoVnce = 0;
  @CAN_RadarRL::RRL_Object::RRL_Object_Obj33.VxAyCoVnce = 0;
  @CAN_RadarRL::RRL_Object::RRL_Object_Obj33.VxVnce = 0;
  @CAN_RadarRL::RRL_Object::RRL_Object_Obj33.VxVyCoVnce = 0;
  @CAN_RadarRL::RRL_Object::RRL_Object_Obj33.Vy = 0;
  }
  if(init_count == 45)
  {
  @CAN_RadarRL::RRL_Object::RRL_Object_Obj33.VyAxCoVnce = 0;
  @CAN_RadarRL::RRL_Object::RRL_Object_Obj33.VyAyCoVnce = 0;
  @CAN_RadarRL::RRL_Object::RRL_Object_Obj33.VyVnce = 0;
  @CAN_RadarRL::RRL_Object::RRL_Object_Obj33.Width = 0;
  @CAN_RadarRL::RRL_Object::RRL_Object_Obj33.WidthVnce = 0;
  @CAN_RadarRL::RRL_Object::RRL_Object_Obj34.Age = 0;
  @CAN_RadarRL::RRL_Object::RRL_Object_Obj34.Ax = 0;
  @CAN_RadarRL::RRL_Object::RRL_Object_Obj34.AxAyCoVnce = 0;
  @CAN_RadarRL::RRL_Object::RRL_Object_Obj34.AxVnce = 0;
  @CAN_RadarRL::RRL_Object::RRL_Object_Obj34.Ay = 0;
  @CAN_RadarRL::RRL_Object::RRL_Object_Obj34.AyVnce = 0;
  @CAN_RadarRL::RRL_Object::RRL_Object_Obj34.ExistProb = 0;
  @CAN_RadarRL::RRL_Object::RRL_Object_Obj34.FilterInformation = 0;
  @CAN_RadarRL::RRL_Object::RRL_Object_Obj34.Length = 0;
  @CAN_RadarRL::RRL_Object::RRL_Object_Obj34.LengthVnce = 0;
  @CAN_RadarRL::RRL_Object::RRL_Object_Obj34.MeasurementStatus = 0;
  @CAN_RadarRL::RRL_Object::RRL_Object_Obj34.MovingStatus = 0;
  @CAN_RadarRL::RRL_Object::RRL_Object_Obj34.ObjId = 0;
  @CAN_RadarRL::RRL_Object::RRL_Object_Obj34.OrientationYaw = 0;
  @CAN_RadarRL::RRL_Object::RRL_Object_Obj34.OrientationYawVnce = 0;
  @CAN_RadarRL::RRL_Object::RRL_Object_Obj34.ProbClassConfidence = 0;
  @CAN_RadarRL::RRL_Object::RRL_Object_Obj34.ProbClassType = 0;
  @CAN_RadarRL::RRL_Object::RRL_Object_Obj34.Px = 0;
  @CAN_RadarRL::RRL_Object::RRL_Object_Obj34.PxAxCoVnce = 0;
  @CAN_RadarRL::RRL_Object::RRL_Object_Obj34.PxAyCoVnce = 0;
  }
  if(init_count == 46)
  {
  @CAN_RadarRL::RRL_Object::RRL_Object_Obj34.PxPyCoVnce = 0;
  @CAN_RadarRL::RRL_Object::RRL_Object_Obj34.PxVnce = 0;
  @CAN_RadarRL::RRL_Object::RRL_Object_Obj34.PxVxCoVnce = 0;
  @CAN_RadarRL::RRL_Object::RRL_Object_Obj34.PxVyCoVnce = 0;
  @CAN_RadarRL::RRL_Object::RRL_Object_Obj34.Py = 0;
  @CAN_RadarRL::RRL_Object::RRL_Object_Obj34.PyAxCoVnce = 0;
  @CAN_RadarRL::RRL_Object::RRL_Object_Obj34.PyAyCoVnce = 0;
  @CAN_RadarRL::RRL_Object::RRL_Object_Obj34.PyVnce = 0;
  @CAN_RadarRL::RRL_Object::RRL_Object_Obj34.PyVxCoVnce = 0;
  @CAN_RadarRL::RRL_Object::RRL_Object_Obj34.PyVyCoVnce = 0;
  @CAN_RadarRL::RRL_Object::RRL_Object_Obj34.ReferencePoint = 0;
  @CAN_RadarRL::RRL_Object::RRL_Object_Obj34.Vx = 0;
  @CAN_RadarRL::RRL_Object::RRL_Object_Obj34.VxAxCoVnce = 0;
  @CAN_RadarRL::RRL_Object::RRL_Object_Obj34.VxAyCoVnce = 0;
  @CAN_RadarRL::RRL_Object::RRL_Object_Obj34.VxVnce = 0;
  @CAN_RadarRL::RRL_Object::RRL_Object_Obj34.VxVyCoVnce = 0;
  @CAN_RadarRL::RRL_Object::RRL_Object_Obj34.Vy = 0;
  @CAN_RadarRL::RRL_Object::RRL_Object_Obj34.VyAxCoVnce = 0;
  @CAN_RadarRL::RRL_Object::RRL_Object_Obj34.VyAyCoVnce = 0;
  @CAN_RadarRL::RRL_Object::RRL_Object_Obj34.VyVnce = 0;
  @CAN_RadarRL::RRL_Object::RRL_Object_Obj34.Width = 0;
  @CAN_RadarRL::RRL_Object::RRL_Object_Obj34.WidthVnce = 0;
  @CAN_RadarRL::RRL_Object::RRL_Object_Obj35.Age = 0;
  @CAN_RadarRL::RRL_Object::RRL_Object_Obj35.Ax = 0;
  @CAN_RadarRL::RRL_Object::RRL_Object_Obj35.AxAyCoVnce = 0;
  }
  if(init_count == 47)
  {
  @CAN_RadarRL::RRL_Object::RRL_Object_Obj35.AxVnce = 0;
  @CAN_RadarRL::RRL_Object::RRL_Object_Obj35.Ay = 0;
  @CAN_RadarRL::RRL_Object::RRL_Object_Obj35.AyVnce = 0;
  @CAN_RadarRL::RRL_Object::RRL_Object_Obj35.ExistProb = 0;
  @CAN_RadarRL::RRL_Object::RRL_Object_Obj35.FilterInformation = 0;
  @CAN_RadarRL::RRL_Object::RRL_Object_Obj35.Length = 0;
  @CAN_RadarRL::RRL_Object::RRL_Object_Obj35.LengthVnce = 0;
  @CAN_RadarRL::RRL_Object::RRL_Object_Obj35.MeasurementStatus = 0;
  @CAN_RadarRL::RRL_Object::RRL_Object_Obj35.MovingStatus = 0;
  @CAN_RadarRL::RRL_Object::RRL_Object_Obj35.ObjId = 0;
  @CAN_RadarRL::RRL_Object::RRL_Object_Obj35.OrientationYaw = 0;
  @CAN_RadarRL::RRL_Object::RRL_Object_Obj35.OrientationYawVnce = 0;
  @CAN_RadarRL::RRL_Object::RRL_Object_Obj35.ProbClassConfidence = 0;
  @CAN_RadarRL::RRL_Object::RRL_Object_Obj35.ProbClassType = 0;
  @CAN_RadarRL::RRL_Object::RRL_Object_Obj35.Px = 0;
  @CAN_RadarRL::RRL_Object::RRL_Object_Obj35.PxAxCoVnce = 0;
  @CAN_RadarRL::RRL_Object::RRL_Object_Obj35.PxAyCoVnce = 0;
  @CAN_RadarRL::RRL_Object::RRL_Object_Obj35.PxPyCoVnce = 0;
  @CAN_RadarRL::RRL_Object::RRL_Object_Obj35.PxVnce = 0;
  @CAN_RadarRL::RRL_Object::RRL_Object_Obj35.PxVxCoVnce = 0;
  @CAN_RadarRL::RRL_Object::RRL_Object_Obj35.PxVyCoVnce = 0;
  @CAN_RadarRL::RRL_Object::RRL_Object_Obj35.Py = 0;
  @CAN_RadarRL::RRL_Object::RRL_Object_Obj35.PyAxCoVnce = 0;
  @CAN_RadarRL::RRL_Object::RRL_Object_Obj35.PyAyCoVnce = 0;
  @CAN_RadarRL::RRL_Object::RRL_Object_Obj35.PyVnce = 0;
  }
  if(init_count == 48)
  {
  @CAN_RadarRL::RRL_Object::RRL_Object_Obj35.PyVxCoVnce = 0;
  @CAN_RadarRL::RRL_Object::RRL_Object_Obj35.PyVyCoVnce = 0;
  @CAN_RadarRL::RRL_Object::RRL_Object_Obj35.ReferencePoint = 0;
  @CAN_RadarRL::RRL_Object::RRL_Object_Obj35.Vx = 0;
  @CAN_RadarRL::RRL_Object::RRL_Object_Obj35.VxAxCoVnce = 0;
  @CAN_RadarRL::RRL_Object::RRL_Object_Obj35.VxAyCoVnce = 0;
  @CAN_RadarRL::RRL_Object::RRL_Object_Obj35.VxVnce = 0;
  @CAN_RadarRL::RRL_Object::RRL_Object_Obj35.VxVyCoVnce = 0;
  @CAN_RadarRL::RRL_Object::RRL_Object_Obj35.Vy = 0;
  @CAN_RadarRL::RRL_Object::RRL_Object_Obj35.VyAxCoVnce = 0;
  @CAN_RadarRL::RRL_Object::RRL_Object_Obj35.VyAyCoVnce = 0;
  @CAN_RadarRL::RRL_Object::RRL_Object_Obj35.VyVnce = 0;
  @CAN_RadarRL::RRL_Object::RRL_Object_Obj35.Width = 0;
  @CAN_RadarRL::RRL_Object::RRL_Object_Obj35.WidthVnce = 0;
  @CAN_RadarRL::RRL_Object::RRL_Object_Obj36.Age = 0;
  @CAN_RadarRL::RRL_Object::RRL_Object_Obj36.Ax = 0;
  @CAN_RadarRL::RRL_Object::RRL_Object_Obj36.AxAyCoVnce = 0;
  @CAN_RadarRL::RRL_Object::RRL_Object_Obj36.AxVnce = 0;
  @CAN_RadarRL::RRL_Object::RRL_Object_Obj36.Ay = 0;
  @CAN_RadarRL::RRL_Object::RRL_Object_Obj36.AyVnce = 0;
  @CAN_RadarRL::RRL_Object::RRL_Object_Obj36.ExistProb = 0;
  @CAN_RadarRL::RRL_Object::RRL_Object_Obj36.FilterInformation = 0;
  @CAN_RadarRL::RRL_Object::RRL_Object_Obj36.Length = 0;
  @CAN_RadarRL::RRL_Object::RRL_Object_Obj36.LengthVnce = 0;
  @CAN_RadarRL::RRL_Object::RRL_Object_Obj36.MeasurementStatus = 0;
  }
  if(init_count == 49)
  {
  @CAN_RadarRL::RRL_Object::RRL_Object_Obj36.MovingStatus = 0;
  @CAN_RadarRL::RRL_Object::RRL_Object_Obj36.ObjId = 0;
  @CAN_RadarRL::RRL_Object::RRL_Object_Obj36.OrientationYaw = 0;
  @CAN_RadarRL::RRL_Object::RRL_Object_Obj36.OrientationYawVnce = 0;
  @CAN_RadarRL::RRL_Object::RRL_Object_Obj36.ProbClassConfidence = 0;
  @CAN_RadarRL::RRL_Object::RRL_Object_Obj36.ProbClassType = 0;
  @CAN_RadarRL::RRL_Object::RRL_Object_Obj36.Px = 0;
  @CAN_RadarRL::RRL_Object::RRL_Object_Obj36.PxAxCoVnce = 0;
  @CAN_RadarRL::RRL_Object::RRL_Object_Obj36.PxAyCoVnce = 0;
  @CAN_RadarRL::RRL_Object::RRL_Object_Obj36.PxPyCoVnce = 0;
  @CAN_RadarRL::RRL_Object::RRL_Object_Obj36.PxVnce = 0;
  @CAN_RadarRL::RRL_Object::RRL_Object_Obj36.PxVxCoVnce = 0;
  @CAN_RadarRL::RRL_Object::RRL_Object_Obj36.PxVyCoVnce = 0;
  @CAN_RadarRL::RRL_Object::RRL_Object_Obj36.Py = 0;
  @CAN_RadarRL::RRL_Object::RRL_Object_Obj36.PyAxCoVnce = 0;
  @CAN_RadarRL::RRL_Object::RRL_Object_Obj36.PyAyCoVnce = 0;
  @CAN_RadarRL::RRL_Object::RRL_Object_Obj36.PyVnce = 0;
  @CAN_RadarRL::RRL_Object::RRL_Object_Obj36.PyVxCoVnce = 0;
  @CAN_RadarRL::RRL_Object::RRL_Object_Obj36.PyVyCoVnce = 0;
  @CAN_RadarRL::RRL_Object::RRL_Object_Obj36.ReferencePoint = 0;
  @CAN_RadarRL::RRL_Object::RRL_Object_Obj36.Vx = 0;
  @CAN_RadarRL::RRL_Object::RRL_Object_Obj36.VxAxCoVnce = 0;
  @CAN_RadarRL::RRL_Object::RRL_Object_Obj36.VxAyCoVnce = 0;
  @CAN_RadarRL::RRL_Object::RRL_Object_Obj36.VxVnce = 0;
  @CAN_RadarRL::RRL_Object::RRL_Object_Obj36.VxVyCoVnce = 0;
  }
  if(init_count == 50)
  {
  @CAN_RadarRL::RRL_Object::RRL_Object_Obj36.Vy = 0;
  @CAN_RadarRL::RRL_Object::RRL_Object_Obj36.VyAxCoVnce = 0;
  @CAN_RadarRL::RRL_Object::RRL_Object_Obj36.VyAyCoVnce = 0;
  @CAN_RadarRL::RRL_Object::RRL_Object_Obj36.VyVnce = 0;
  @CAN_RadarRL::RRL_Object::RRL_Object_Obj36.Width = 0;
  @CAN_RadarRL::RRL_Object::RRL_Object_Obj36.WidthVnce = 0;
  @CAN_RadarRL::RRL_Object::RRL_Object_Obj37.Age = 0;
  @CAN_RadarRL::RRL_Object::RRL_Object_Obj37.Ax = 0;
  @CAN_RadarRL::RRL_Object::RRL_Object_Obj37.AxAyCoVnce = 0;
  @CAN_RadarRL::RRL_Object::RRL_Object_Obj37.AxVnce = 0;
  @CAN_RadarRL::RRL_Object::RRL_Object_Obj37.Ay = 0;
  @CAN_RadarRL::RRL_Object::RRL_Object_Obj37.AyVnce = 0;
  @CAN_RadarRL::RRL_Object::RRL_Object_Obj37.ExistProb = 0;
  @CAN_RadarRL::RRL_Object::RRL_Object_Obj37.FilterInformation = 0;
  @CAN_RadarRL::RRL_Object::RRL_Object_Obj37.Length = 0;
  @CAN_RadarRL::RRL_Object::RRL_Object_Obj37.LengthVnce = 0;
  @CAN_RadarRL::RRL_Object::RRL_Object_Obj37.MeasurementStatus = 0;
  @CAN_RadarRL::RRL_Object::RRL_Object_Obj37.MovingStatus = 0;
  @CAN_RadarRL::RRL_Object::RRL_Object_Obj37.ObjId = 0;
  @CAN_RadarRL::RRL_Object::RRL_Object_Obj37.OrientationYaw = 0;
  @CAN_RadarRL::RRL_Object::RRL_Object_Obj37.OrientationYawVnce = 0;
  @CAN_RadarRL::RRL_Object::RRL_Object_Obj37.ProbClassConfidence = 0;
  @CAN_RadarRL::RRL_Object::RRL_Object_Obj37.ProbClassType = 0;
  @CAN_RadarRL::RRL_Object::RRL_Object_Obj37.Px = 0;
  @CAN_RadarRL::RRL_Object::RRL_Object_Obj37.PxAxCoVnce = 0;
  }
  if(init_count == 51)
  {
  @CAN_RadarRL::RRL_Object::RRL_Object_Obj37.PxAyCoVnce = 0;
  @CAN_RadarRL::RRL_Object::RRL_Object_Obj37.PxPyCoVnce = 0;
  @CAN_RadarRL::RRL_Object::RRL_Object_Obj37.PxVnce = 0;
  @CAN_RadarRL::RRL_Object::RRL_Object_Obj37.PxVxCoVnce = 0;
  @CAN_RadarRL::RRL_Object::RRL_Object_Obj37.PxVyCoVnce = 0;
  @CAN_RadarRL::RRL_Object::RRL_Object_Obj37.Py = 0;
  @CAN_RadarRL::RRL_Object::RRL_Object_Obj37.PyAxCoVnce = 0;
  @CAN_RadarRL::RRL_Object::RRL_Object_Obj37.PyAyCoVnce = 0;
  @CAN_RadarRL::RRL_Object::RRL_Object_Obj37.PyVnce = 0;
  @CAN_RadarRL::RRL_Object::RRL_Object_Obj37.PyVxCoVnce = 0;
  @CAN_RadarRL::RRL_Object::RRL_Object_Obj37.PyVyCoVnce = 0;
  @CAN_RadarRL::RRL_Object::RRL_Object_Obj37.ReferencePoint = 0;
  @CAN_RadarRL::RRL_Object::RRL_Object_Obj37.Vx = 0;
  @CAN_RadarRL::RRL_Object::RRL_Object_Obj37.VxAxCoVnce = 0;
  @CAN_RadarRL::RRL_Object::RRL_Object_Obj37.VxAyCoVnce = 0;
  @CAN_RadarRL::RRL_Object::RRL_Object_Obj37.VxVnce = 0;
  @CAN_RadarRL::RRL_Object::RRL_Object_Obj37.VxVyCoVnce = 0;
  @CAN_RadarRL::RRL_Object::RRL_Object_Obj37.Vy = 0;
  @CAN_RadarRL::RRL_Object::RRL_Object_Obj37.VyAxCoVnce = 0;
  @CAN_RadarRL::RRL_Object::RRL_Object_Obj37.VyAyCoVnce = 0;
  @CAN_RadarRL::RRL_Object::RRL_Object_Obj37.VyVnce = 0;
  @CAN_RadarRL::RRL_Object::RRL_Object_Obj37.Width = 0;
  @CAN_RadarRL::RRL_Object::RRL_Object_Obj37.WidthVnce = 0;
  @CAN_RadarRL::RRL_Object::RRL_Object_Obj38.Age = 0;
  @CAN_RadarRL::RRL_Object::RRL_Object_Obj38.Ax = 0;
  }
  if(init_count == 52)
  {
  @CAN_RadarRL::RRL_Object::RRL_Object_Obj38.AxAyCoVnce = 0;
  @CAN_RadarRL::RRL_Object::RRL_Object_Obj38.AxVnce = 0;
  @CAN_RadarRL::RRL_Object::RRL_Object_Obj38.Ay = 0;
  @CAN_RadarRL::RRL_Object::RRL_Object_Obj38.AyVnce = 0;
  @CAN_RadarRL::RRL_Object::RRL_Object_Obj38.ExistProb = 0;
  @CAN_RadarRL::RRL_Object::RRL_Object_Obj38.FilterInformation = 0;
  @CAN_RadarRL::RRL_Object::RRL_Object_Obj38.Length = 0;
  @CAN_RadarRL::RRL_Object::RRL_Object_Obj38.LengthVnce = 0;
  @CAN_RadarRL::RRL_Object::RRL_Object_Obj38.MeasurementStatus = 0;
  @CAN_RadarRL::RRL_Object::RRL_Object_Obj38.MovingStatus = 0;
  @CAN_RadarRL::RRL_Object::RRL_Object_Obj38.ObjId = 0;
  @CAN_RadarRL::RRL_Object::RRL_Object_Obj38.OrientationYaw = 0;
  @CAN_RadarRL::RRL_Object::RRL_Object_Obj38.OrientationYawVnce = 0;
  @CAN_RadarRL::RRL_Object::RRL_Object_Obj38.ProbClassConfidence = 0;
  @CAN_RadarRL::RRL_Object::RRL_Object_Obj38.ProbClassType = 0;
  @CAN_RadarRL::RRL_Object::RRL_Object_Obj38.Px = 0;
  @CAN_RadarRL::RRL_Object::RRL_Object_Obj38.PxAxCoVnce = 0;
  @CAN_RadarRL::RRL_Object::RRL_Object_Obj38.PxAyCoVnce = 0;
  @CAN_RadarRL::RRL_Object::RRL_Object_Obj38.PxPyCoVnce = 0;
  @CAN_RadarRL::RRL_Object::RRL_Object_Obj38.PxVnce = 0;
  @CAN_RadarRL::RRL_Object::RRL_Object_Obj38.PxVxCoVnce = 0;
  @CAN_RadarRL::RRL_Object::RRL_Object_Obj38.PxVyCoVnce = 0;
  @CAN_RadarRL::RRL_Object::RRL_Object_Obj38.Py = 0;
  @CAN_RadarRL::RRL_Object::RRL_Object_Obj38.PyAxCoVnce = 0;
  @CAN_RadarRL::RRL_Object::RRL_Object_Obj38.PyAyCoVnce = 0;
  }
  if(init_count == 53)
  {
  @CAN_RadarRL::RRL_Object::RRL_Object_Obj38.PyVnce = 0;
  @CAN_RadarRL::RRL_Object::RRL_Object_Obj38.PyVxCoVnce = 0;
  @CAN_RadarRL::RRL_Object::RRL_Object_Obj38.PyVyCoVnce = 0;
  @CAN_RadarRL::RRL_Object::RRL_Object_Obj38.ReferencePoint = 0;
  @CAN_RadarRL::RRL_Object::RRL_Object_Obj38.Vx = 0;
  @CAN_RadarRL::RRL_Object::RRL_Object_Obj38.VxAxCoVnce = 0;
  @CAN_RadarRL::RRL_Object::RRL_Object_Obj38.VxAyCoVnce = 0;
  @CAN_RadarRL::RRL_Object::RRL_Object_Obj38.VxVnce = 0;
  @CAN_RadarRL::RRL_Object::RRL_Object_Obj38.VxVyCoVnce = 0;
  @CAN_RadarRL::RRL_Object::RRL_Object_Obj38.Vy = 0;
  @CAN_RadarRL::RRL_Object::RRL_Object_Obj38.VyAxCoVnce = 0;
  @CAN_RadarRL::RRL_Object::RRL_Object_Obj38.VyAyCoVnce = 0;
  @CAN_RadarRL::RRL_Object::RRL_Object_Obj38.VyVnce = 0;
  @CAN_RadarRL::RRL_Object::RRL_Object_Obj38.Width = 0;
  @CAN_RadarRL::RRL_Object::RRL_Object_Obj38.WidthVnce = 0;
  @CAN_RadarRL::RRL_Object::RRL_Object_Obj39.Age = 0;
  @CAN_RadarRL::RRL_Object::RRL_Object_Obj39.Ax = 0;
  @CAN_RadarRL::RRL_Object::RRL_Object_Obj39.AxAyCoVnce = 0;
  @CAN_RadarRL::RRL_Object::RRL_Object_Obj39.AxVnce = 0;
  @CAN_RadarRL::RRL_Object::RRL_Object_Obj39.Ay = 0;
  @CAN_RadarRL::RRL_Object::RRL_Object_Obj39.AyVnce = 0;
  @CAN_RadarRL::RRL_Object::RRL_Object_Obj39.ExistProb = 0;
  @CAN_RadarRL::RRL_Object::RRL_Object_Obj39.FilterInformation = 0;
  @CAN_RadarRL::RRL_Object::RRL_Object_Obj39.Length = 0;
  @CAN_RadarRL::RRL_Object::RRL_Object_Obj39.LengthVnce = 0;
  }
  if(init_count == 54)
  {
  @CAN_RadarRL::RRL_Object::RRL_Object_Obj39.MeasurementStatus = 0;
  @CAN_RadarRL::RRL_Object::RRL_Object_Obj39.MovingStatus = 0;
  @CAN_RadarRL::RRL_Object::RRL_Object_Obj39.ObjId = 0;
  @CAN_RadarRL::RRL_Object::RRL_Object_Obj39.OrientationYaw = 0;
  @CAN_RadarRL::RRL_Object::RRL_Object_Obj39.OrientationYawVnce = 0;
  @CAN_RadarRL::RRL_Object::RRL_Object_Obj39.ProbClassConfidence = 0;
  @CAN_RadarRL::RRL_Object::RRL_Object_Obj39.ProbClassType = 0;
  @CAN_RadarRL::RRL_Object::RRL_Object_Obj39.Px = 0;
  @CAN_RadarRL::RRL_Object::RRL_Object_Obj39.PxAxCoVnce = 0;
  @CAN_RadarRL::RRL_Object::RRL_Object_Obj39.PxAyCoVnce = 0;
  @CAN_RadarRL::RRL_Object::RRL_Object_Obj39.PxPyCoVnce = 0;
  @CAN_RadarRL::RRL_Object::RRL_Object_Obj39.PxVnce = 0;
  @CAN_RadarRL::RRL_Object::RRL_Object_Obj39.PxVxCoVnce = 0;
  @CAN_RadarRL::RRL_Object::RRL_Object_Obj39.PxVyCoVnce = 0;
  @CAN_RadarRL::RRL_Object::RRL_Object_Obj39.Py = 0;
  @CAN_RadarRL::RRL_Object::RRL_Object_Obj39.PyAxCoVnce = 0;
  @CAN_RadarRL::RRL_Object::RRL_Object_Obj39.PyAyCoVnce = 0;
  @CAN_RadarRL::RRL_Object::RRL_Object_Obj39.PyVnce = 0;
  @CAN_RadarRL::RRL_Object::RRL_Object_Obj39.PyVxCoVnce = 0;
  @CAN_RadarRL::RRL_Object::RRL_Object_Obj39.PyVyCoVnce = 0;
  @CAN_RadarRL::RRL_Object::RRL_Object_Obj39.ReferencePoint = 0;
  @CAN_RadarRL::RRL_Object::RRL_Object_Obj39.Vx = 0;
  @CAN_RadarRL::RRL_Object::RRL_Object_Obj39.VxAxCoVnce = 0;
  @CAN_RadarRL::RRL_Object::RRL_Object_Obj39.VxAyCoVnce = 0;
  @CAN_RadarRL::RRL_Object::RRL_Object_Obj39.VxVnce = 0;
  }
  if(init_count == 55)
  {
  @CAN_RadarRL::RRL_Object::RRL_Object_Obj39.VxVyCoVnce = 0;
  @CAN_RadarRL::RRL_Object::RRL_Object_Obj39.Vy = 0;
  @CAN_RadarRL::RRL_Object::RRL_Object_Obj39.VyAxCoVnce = 0;
  @CAN_RadarRL::RRL_Object::RRL_Object_Obj39.VyAyCoVnce = 0;
  @CAN_RadarRL::RRL_Object::RRL_Object_Obj39.VyVnce = 0;
  @CAN_RadarRL::RRL_Object::RRL_Object_Obj39.Width = 0;
  @CAN_RadarRL::RRL_Object::RRL_Object_Obj39.WidthVnce = 0;
  @CAN_RadarRL::RRL_Object::RRL_Object_Obj3.Age = 0;
  @CAN_RadarRL::RRL_Object::RRL_Object_Obj3.Ax = 0;
  @CAN_RadarRL::RRL_Object::RRL_Object_Obj3.AxAyCoVnce = 0;
  @CAN_RadarRL::RRL_Object::RRL_Object_Obj3.AxVnce = 0;
  @CAN_RadarRL::RRL_Object::RRL_Object_Obj3.Ay = 0;
  @CAN_RadarRL::RRL_Object::RRL_Object_Obj3.AyVnce = 0;
  @CAN_RadarRL::RRL_Object::RRL_Object_Obj3.ExistProb = 0;
  @CAN_RadarRL::RRL_Object::RRL_Object_Obj3.FilterInformation = 0;
  @CAN_RadarRL::RRL_Object::RRL_Object_Obj3.Length = 0;
  @CAN_RadarRL::RRL_Object::RRL_Object_Obj3.LengthVnce = 0;
  @CAN_RadarRL::RRL_Object::RRL_Object_Obj3.MeasurementStatus = 0;
  @CAN_RadarRL::RRL_Object::RRL_Object_Obj3.MovingStatus = 0;
  @CAN_RadarRL::RRL_Object::RRL_Object_Obj3.ObjId = 0;
  @CAN_RadarRL::RRL_Object::RRL_Object_Obj3.OrientationYaw = 0;
  @CAN_RadarRL::RRL_Object::RRL_Object_Obj3.OrientationYawVnce = 0;
  @CAN_RadarRL::RRL_Object::RRL_Object_Obj3.ProbClassConfidence = 0;
  @CAN_RadarRL::RRL_Object::RRL_Object_Obj3.ProbClassType = 0;
  @CAN_RadarRL::RRL_Object::RRL_Object_Obj3.Px = 0;
  }
  if(init_count == 56)
  {
  @CAN_RadarRL::RRL_Object::RRL_Object_Obj3.PxAxCoVnce = 0;
  @CAN_RadarRL::RRL_Object::RRL_Object_Obj3.PxAyCoVnce = 0;
  @CAN_RadarRL::RRL_Object::RRL_Object_Obj3.PxPyCoVnce = 0;
  @CAN_RadarRL::RRL_Object::RRL_Object_Obj3.PxVnce = 0;
  @CAN_RadarRL::RRL_Object::RRL_Object_Obj3.PxVxCoVnce = 0;
  @CAN_RadarRL::RRL_Object::RRL_Object_Obj3.PxVyCoVnce = 0;
  @CAN_RadarRL::RRL_Object::RRL_Object_Obj3.Py = 0;
  @CAN_RadarRL::RRL_Object::RRL_Object_Obj3.PyAxCoVnce = 0;
  @CAN_RadarRL::RRL_Object::RRL_Object_Obj3.PyAyCoVnce = 0;
  @CAN_RadarRL::RRL_Object::RRL_Object_Obj3.PyVnce = 0;
  @CAN_RadarRL::RRL_Object::RRL_Object_Obj3.PyVxCoVnce = 0;
  @CAN_RadarRL::RRL_Object::RRL_Object_Obj3.PyVyCoVnce = 0;
  @CAN_RadarRL::RRL_Object::RRL_Object_Obj3.ReferencePoint = 0;
  @CAN_RadarRL::RRL_Object::RRL_Object_Obj3.Vx = 0;
  @CAN_RadarRL::RRL_Object::RRL_Object_Obj3.VxAxCoVnce = 0;
  @CAN_RadarRL::RRL_Object::RRL_Object_Obj3.VxAyCoVnce = 0;
  @CAN_RadarRL::RRL_Object::RRL_Object_Obj3.VxVnce = 0;
  @CAN_RadarRL::RRL_Object::RRL_Object_Obj3.VxVyCoVnce = 0;
  @CAN_RadarRL::RRL_Object::RRL_Object_Obj3.Vy = 0;
  @CAN_RadarRL::RRL_Object::RRL_Object_Obj3.VyAxCoVnce = 0;
  @CAN_RadarRL::RRL_Object::RRL_Object_Obj3.VyAyCoVnce = 0;
  @CAN_RadarRL::RRL_Object::RRL_Object_Obj3.VyVnce = 0;
  @CAN_RadarRL::RRL_Object::RRL_Object_Obj3.Width = 0;
  @CAN_RadarRL::RRL_Object::RRL_Object_Obj3.WidthVnce = 0;
  @CAN_RadarRL::RRL_Object::RRL_Object_Obj40.Age = 0;
  }
  if(init_count == 57)
  {
  @CAN_RadarRL::RRL_Object::RRL_Object_Obj40.Ax = 0;
  @CAN_RadarRL::RRL_Object::RRL_Object_Obj40.AxAyCoVnce = 0;
  @CAN_RadarRL::RRL_Object::RRL_Object_Obj40.AxVnce = 0;
  @CAN_RadarRL::RRL_Object::RRL_Object_Obj40.Ay = 0;
  @CAN_RadarRL::RRL_Object::RRL_Object_Obj40.AyVnce = 0;
  @CAN_RadarRL::RRL_Object::RRL_Object_Obj40.ExistProb = 0;
  @CAN_RadarRL::RRL_Object::RRL_Object_Obj40.FilterInformation = 0;
  @CAN_RadarRL::RRL_Object::RRL_Object_Obj40.Length = 0;
  @CAN_RadarRL::RRL_Object::RRL_Object_Obj40.LengthVnce = 0;
  @CAN_RadarRL::RRL_Object::RRL_Object_Obj40.MeasurementStatus = 0;
  @CAN_RadarRL::RRL_Object::RRL_Object_Obj40.MovingStatus = 0;
  @CAN_RadarRL::RRL_Object::RRL_Object_Obj40.ObjId = 0;
  @CAN_RadarRL::RRL_Object::RRL_Object_Obj40.OrientationYaw = 0;
  @CAN_RadarRL::RRL_Object::RRL_Object_Obj40.OrientationYawVnce = 0;
  @CAN_RadarRL::RRL_Object::RRL_Object_Obj40.ProbClassConfidence = 0;
  @CAN_RadarRL::RRL_Object::RRL_Object_Obj40.ProbClassType = 0;
  @CAN_RadarRL::RRL_Object::RRL_Object_Obj40.Px = 0;
  @CAN_RadarRL::RRL_Object::RRL_Object_Obj40.PxAxCoVnce = 0;
  @CAN_RadarRL::RRL_Object::RRL_Object_Obj40.PxAyCoVnce = 0;
  @CAN_RadarRL::RRL_Object::RRL_Object_Obj40.PxPyCoVnce = 0;
  @CAN_RadarRL::RRL_Object::RRL_Object_Obj40.PxVnce = 0;
  @CAN_RadarRL::RRL_Object::RRL_Object_Obj40.PxVxCoVnce = 0;
  @CAN_RadarRL::RRL_Object::RRL_Object_Obj40.PxVyCoVnce = 0;
  @CAN_RadarRL::RRL_Object::RRL_Object_Obj40.Py = 0;
  @CAN_RadarRL::RRL_Object::RRL_Object_Obj40.PyAxCoVnce = 0;
  }
  if(init_count == 58)
  {
  @CAN_RadarRL::RRL_Object::RRL_Object_Obj40.PyAyCoVnce = 0;
  @CAN_RadarRL::RRL_Object::RRL_Object_Obj40.PyVnce = 0;
  @CAN_RadarRL::RRL_Object::RRL_Object_Obj40.PyVxCoVnce = 0;
  @CAN_RadarRL::RRL_Object::RRL_Object_Obj40.PyVyCoVnce = 0;
  @CAN_RadarRL::RRL_Object::RRL_Object_Obj40.ReferencePoint = 0;
  @CAN_RadarRL::RRL_Object::RRL_Object_Obj40.Vx = 0;
  @CAN_RadarRL::RRL_Object::RRL_Object_Obj40.VxAxCoVnce = 0;
  @CAN_RadarRL::RRL_Object::RRL_Object_Obj40.VxAyCoVnce = 0;
  @CAN_RadarRL::RRL_Object::RRL_Object_Obj40.VxVnce = 0;
  @CAN_RadarRL::RRL_Object::RRL_Object_Obj40.VxVyCoVnce = 0;
  @CAN_RadarRL::RRL_Object::RRL_Object_Obj40.Vy = 0;
  @CAN_RadarRL::RRL_Object::RRL_Object_Obj40.VyAxCoVnce = 0;
  @CAN_RadarRL::RRL_Object::RRL_Object_Obj40.VyAyCoVnce = 0;
  @CAN_RadarRL::RRL_Object::RRL_Object_Obj40.VyVnce = 0;
  @CAN_RadarRL::RRL_Object::RRL_Object_Obj40.Width = 0;
  @CAN_RadarRL::RRL_Object::RRL_Object_Obj40.WidthVnce = 0;
  @CAN_RadarRL::RRL_Object::RRL_Object_Obj41.Age = 0;
  @CAN_RadarRL::RRL_Object::RRL_Object_Obj41.Ax = 0;
  @CAN_RadarRL::RRL_Object::RRL_Object_Obj41.AxAyCoVnce = 0;
  @CAN_RadarRL::RRL_Object::RRL_Object_Obj41.AxVnce = 0;
  @CAN_RadarRL::RRL_Object::RRL_Object_Obj41.Ay = 0;
  @CAN_RadarRL::RRL_Object::RRL_Object_Obj41.AyVnce = 0;
  @CAN_RadarRL::RRL_Object::RRL_Object_Obj41.ExistProb = 0;
  @CAN_RadarRL::RRL_Object::RRL_Object_Obj41.FilterInformation = 0;
  @CAN_RadarRL::RRL_Object::RRL_Object_Obj41.Length = 0;
  }
  if(init_count == 59)
  {
  @CAN_RadarRL::RRL_Object::RRL_Object_Obj41.LengthVnce = 0;
  @CAN_RadarRL::RRL_Object::RRL_Object_Obj41.MeasurementStatus = 0;
  @CAN_RadarRL::RRL_Object::RRL_Object_Obj41.MovingStatus = 0;
  @CAN_RadarRL::RRL_Object::RRL_Object_Obj41.ObjId = 0;
  @CAN_RadarRL::RRL_Object::RRL_Object_Obj41.OrientationYaw = 0;
  @CAN_RadarRL::RRL_Object::RRL_Object_Obj41.OrientationYawVnce = 0;
  @CAN_RadarRL::RRL_Object::RRL_Object_Obj41.ProbClassConfidence = 0;
  @CAN_RadarRL::RRL_Object::RRL_Object_Obj41.ProbClassType = 0;
  @CAN_RadarRL::RRL_Object::RRL_Object_Obj41.Px = 0;
  @CAN_RadarRL::RRL_Object::RRL_Object_Obj41.PxAxCoVnce = 0;
  @CAN_RadarRL::RRL_Object::RRL_Object_Obj41.PxAyCoVnce = 0;
  @CAN_RadarRL::RRL_Object::RRL_Object_Obj41.PxPyCoVnce = 0;
  @CAN_RadarRL::RRL_Object::RRL_Object_Obj41.PxVnce = 0;
  @CAN_RadarRL::RRL_Object::RRL_Object_Obj41.PxVxCoVnce = 0;
  @CAN_RadarRL::RRL_Object::RRL_Object_Obj41.PxVyCoVnce = 0;
  @CAN_RadarRL::RRL_Object::RRL_Object_Obj41.Py = 0;
  @CAN_RadarRL::RRL_Object::RRL_Object_Obj41.PyAxCoVnce = 0;
  @CAN_RadarRL::RRL_Object::RRL_Object_Obj41.PyAyCoVnce = 0;
  @CAN_RadarRL::RRL_Object::RRL_Object_Obj41.PyVnce = 0;
  @CAN_RadarRL::RRL_Object::RRL_Object_Obj41.PyVxCoVnce = 0;
  @CAN_RadarRL::RRL_Object::RRL_Object_Obj41.PyVyCoVnce = 0;
  @CAN_RadarRL::RRL_Object::RRL_Object_Obj41.ReferencePoint = 0;
  @CAN_RadarRL::RRL_Object::RRL_Object_Obj41.Vx = 0;
  @CAN_RadarRL::RRL_Object::RRL_Object_Obj41.VxAxCoVnce = 0;
  @CAN_RadarRL::RRL_Object::RRL_Object_Obj41.VxAyCoVnce = 0;
  }
  if(init_count == 60)
  {
  @CAN_RadarRL::RRL_Object::RRL_Object_Obj41.VxVnce = 0;
  @CAN_RadarRL::RRL_Object::RRL_Object_Obj41.VxVyCoVnce = 0;
  @CAN_RadarRL::RRL_Object::RRL_Object_Obj41.Vy = 0;
  @CAN_RadarRL::RRL_Object::RRL_Object_Obj41.VyAxCoVnce = 0;
  @CAN_RadarRL::RRL_Object::RRL_Object_Obj41.VyAyCoVnce = 0;
  @CAN_RadarRL::RRL_Object::RRL_Object_Obj41.VyVnce = 0;
  @CAN_RadarRL::RRL_Object::RRL_Object_Obj41.Width = 0;
  @CAN_RadarRL::RRL_Object::RRL_Object_Obj41.WidthVnce = 0;
  @CAN_RadarRL::RRL_Object::RRL_Object_Obj42.Age = 0;
  @CAN_RadarRL::RRL_Object::RRL_Object_Obj42.Ax = 0;
  @CAN_RadarRL::RRL_Object::RRL_Object_Obj42.AxAyCoVnce = 0;
  @CAN_RadarRL::RRL_Object::RRL_Object_Obj42.AxVnce = 0;
  @CAN_RadarRL::RRL_Object::RRL_Object_Obj42.Ay = 0;
  @CAN_RadarRL::RRL_Object::RRL_Object_Obj42.AyVnce = 0;
  @CAN_RadarRL::RRL_Object::RRL_Object_Obj42.ExistProb = 0;
  @CAN_RadarRL::RRL_Object::RRL_Object_Obj42.FilterInformation = 0;
  @CAN_RadarRL::RRL_Object::RRL_Object_Obj42.Length = 0;
  @CAN_RadarRL::RRL_Object::RRL_Object_Obj42.LengthVnce = 0;
  @CAN_RadarRL::RRL_Object::RRL_Object_Obj42.MeasurementStatus = 0;
  @CAN_RadarRL::RRL_Object::RRL_Object_Obj42.MovingStatus = 0;
  @CAN_RadarRL::RRL_Object::RRL_Object_Obj42.ObjId = 0;
  @CAN_RadarRL::RRL_Object::RRL_Object_Obj42.OrientationYaw = 0;
  @CAN_RadarRL::RRL_Object::RRL_Object_Obj42.OrientationYawVnce = 0;
  @CAN_RadarRL::RRL_Object::RRL_Object_Obj42.ProbClassConfidence = 0;
  @CAN_RadarRL::RRL_Object::RRL_Object_Obj42.ProbClassType = 0;
  }
  if(init_count == 61)
  {
  @CAN_RadarRL::RRL_Object::RRL_Object_Obj42.Px = 0;
  @CAN_RadarRL::RRL_Object::RRL_Object_Obj42.PxAxCoVnce = 0;
  @CAN_RadarRL::RRL_Object::RRL_Object_Obj42.PxAyCoVnce = 0;
  @CAN_RadarRL::RRL_Object::RRL_Object_Obj42.PxPyCoVnce = 0;
  @CAN_RadarRL::RRL_Object::RRL_Object_Obj42.PxVnce = 0;
  @CAN_RadarRL::RRL_Object::RRL_Object_Obj42.PxVxCoVnce = 0;
  @CAN_RadarRL::RRL_Object::RRL_Object_Obj42.PxVyCoVnce = 0;
  @CAN_RadarRL::RRL_Object::RRL_Object_Obj42.Py = 0;
  @CAN_RadarRL::RRL_Object::RRL_Object_Obj42.PyAxCoVnce = 0;
  @CAN_RadarRL::RRL_Object::RRL_Object_Obj42.PyAyCoVnce = 0;
  @CAN_RadarRL::RRL_Object::RRL_Object_Obj42.PyVnce = 0;
  @CAN_RadarRL::RRL_Object::RRL_Object_Obj42.PyVxCoVnce = 0;
  @CAN_RadarRL::RRL_Object::RRL_Object_Obj42.PyVyCoVnce = 0;
  @CAN_RadarRL::RRL_Object::RRL_Object_Obj42.ReferencePoint = 0;
  @CAN_RadarRL::RRL_Object::RRL_Object_Obj42.Vx = 0;
  @CAN_RadarRL::RRL_Object::RRL_Object_Obj42.VxAxCoVnce = 0;
  @CAN_RadarRL::RRL_Object::RRL_Object_Obj42.VxAyCoVnce = 0;
  @CAN_RadarRL::RRL_Object::RRL_Object_Obj42.VxVnce = 0;
  @CAN_RadarRL::RRL_Object::RRL_Object_Obj42.VxVyCoVnce = 0;
  @CAN_RadarRL::RRL_Object::RRL_Object_Obj42.Vy = 0;
  @CAN_RadarRL::RRL_Object::RRL_Object_Obj42.VyAxCoVnce = 0;
  @CAN_RadarRL::RRL_Object::RRL_Object_Obj42.VyAyCoVnce = 0;
  @CAN_RadarRL::RRL_Object::RRL_Object_Obj42.VyVnce = 0;
  @CAN_RadarRL::RRL_Object::RRL_Object_Obj42.Width = 0;
  @CAN_RadarRL::RRL_Object::RRL_Object_Obj42.WidthVnce = 0;
  }
  if(init_count == 62)
  {
  @CAN_RadarRL::RRL_Object::RRL_Object_Obj43.Age = 0;
  @CAN_RadarRL::RRL_Object::RRL_Object_Obj43.Ax = 0;
  @CAN_RadarRL::RRL_Object::RRL_Object_Obj43.AxAyCoVnce = 0;
  @CAN_RadarRL::RRL_Object::RRL_Object_Obj43.AxVnce = 0;
  @CAN_RadarRL::RRL_Object::RRL_Object_Obj43.Ay = 0;
  @CAN_RadarRL::RRL_Object::RRL_Object_Obj43.AyVnce = 0;
  @CAN_RadarRL::RRL_Object::RRL_Object_Obj43.ExistProb = 0;
  @CAN_RadarRL::RRL_Object::RRL_Object_Obj43.FilterInformation = 0;
  @CAN_RadarRL::RRL_Object::RRL_Object_Obj43.Length = 0;
  @CAN_RadarRL::RRL_Object::RRL_Object_Obj43.LengthVnce = 0;
  @CAN_RadarRL::RRL_Object::RRL_Object_Obj43.MeasurementStatus = 0;
  @CAN_RadarRL::RRL_Object::RRL_Object_Obj43.MovingStatus = 0;
  @CAN_RadarRL::RRL_Object::RRL_Object_Obj43.ObjId = 0;
  @CAN_RadarRL::RRL_Object::RRL_Object_Obj43.OrientationYaw = 0;
  @CAN_RadarRL::RRL_Object::RRL_Object_Obj43.OrientationYawVnce = 0;
  @CAN_RadarRL::RRL_Object::RRL_Object_Obj43.ProbClassConfidence = 0;
  @CAN_RadarRL::RRL_Object::RRL_Object_Obj43.ProbClassType = 0;
  @CAN_RadarRL::RRL_Object::RRL_Object_Obj43.Px = 0;
  @CAN_RadarRL::RRL_Object::RRL_Object_Obj43.PxAxCoVnce = 0;
  @CAN_RadarRL::RRL_Object::RRL_Object_Obj43.PxAyCoVnce = 0;
  @CAN_RadarRL::RRL_Object::RRL_Object_Obj43.PxPyCoVnce = 0;
  @CAN_RadarRL::RRL_Object::RRL_Object_Obj43.PxVnce = 0;
  @CAN_RadarRL::RRL_Object::RRL_Object_Obj43.PxVxCoVnce = 0;
  @CAN_RadarRL::RRL_Object::RRL_Object_Obj43.PxVyCoVnce = 0;
  @CAN_RadarRL::RRL_Object::RRL_Object_Obj43.Py = 0;
  }
  if(init_count == 63)
  {
  @CAN_RadarRL::RRL_Object::RRL_Object_Obj43.PyAxCoVnce = 0;
  @CAN_RadarRL::RRL_Object::RRL_Object_Obj43.PyAyCoVnce = 0;
  @CAN_RadarRL::RRL_Object::RRL_Object_Obj43.PyVnce = 0;
  @CAN_RadarRL::RRL_Object::RRL_Object_Obj43.PyVxCoVnce = 0;
  @CAN_RadarRL::RRL_Object::RRL_Object_Obj43.PyVyCoVnce = 0;
  @CAN_RadarRL::RRL_Object::RRL_Object_Obj43.ReferencePoint = 0;
  @CAN_RadarRL::RRL_Object::RRL_Object_Obj43.Vx = 0;
  @CAN_RadarRL::RRL_Object::RRL_Object_Obj43.VxAxCoVnce = 0;
  @CAN_RadarRL::RRL_Object::RRL_Object_Obj43.VxAyCoVnce = 0;
  @CAN_RadarRL::RRL_Object::RRL_Object_Obj43.VxVnce = 0;
  @CAN_RadarRL::RRL_Object::RRL_Object_Obj43.VxVyCoVnce = 0;
  @CAN_RadarRL::RRL_Object::RRL_Object_Obj43.Vy = 0;
  @CAN_RadarRL::RRL_Object::RRL_Object_Obj43.VyAxCoVnce = 0;
  @CAN_RadarRL::RRL_Object::RRL_Object_Obj43.VyAyCoVnce = 0;
  @CAN_RadarRL::RRL_Object::RRL_Object_Obj43.VyVnce = 0;
  @CAN_RadarRL::RRL_Object::RRL_Object_Obj43.Width = 0;
  @CAN_RadarRL::RRL_Object::RRL_Object_Obj43.WidthVnce = 0;
  @CAN_RadarRL::RRL_Object::RRL_Object_Obj44.Age = 0;
  @CAN_RadarRL::RRL_Object::RRL_Object_Obj44.Ax = 0;
  @CAN_RadarRL::RRL_Object::RRL_Object_Obj44.AxAyCoVnce = 0;
  @CAN_RadarRL::RRL_Object::RRL_Object_Obj44.AxVnce = 0;
  @CAN_RadarRL::RRL_Object::RRL_Object_Obj44.Ay = 0;
  @CAN_RadarRL::RRL_Object::RRL_Object_Obj44.AyVnce = 0;
  @CAN_RadarRL::RRL_Object::RRL_Object_Obj44.ExistProb = 0;
  @CAN_RadarRL::RRL_Object::RRL_Object_Obj44.FilterInformation = 0;
  }
  if(init_count == 64)
  {
  @CAN_RadarRL::RRL_Object::RRL_Object_Obj44.Length = 0;
  @CAN_RadarRL::RRL_Object::RRL_Object_Obj44.LengthVnce = 0;
  @CAN_RadarRL::RRL_Object::RRL_Object_Obj44.MeasurementStatus = 0;
  @CAN_RadarRL::RRL_Object::RRL_Object_Obj44.MovingStatus = 0;
  @CAN_RadarRL::RRL_Object::RRL_Object_Obj44.ObjId = 0;
  @CAN_RadarRL::RRL_Object::RRL_Object_Obj44.OrientationYaw = 0;
  @CAN_RadarRL::RRL_Object::RRL_Object_Obj44.OrientationYawVnce = 0;
  @CAN_RadarRL::RRL_Object::RRL_Object_Obj44.ProbClassConfidence = 0;
  @CAN_RadarRL::RRL_Object::RRL_Object_Obj44.ProbClassType = 0;
  @CAN_RadarRL::RRL_Object::RRL_Object_Obj44.Px = 0;
  @CAN_RadarRL::RRL_Object::RRL_Object_Obj44.PxAxCoVnce = 0;
  @CAN_RadarRL::RRL_Object::RRL_Object_Obj44.PxAyCoVnce = 0;
  @CAN_RadarRL::RRL_Object::RRL_Object_Obj44.PxPyCoVnce = 0;
  @CAN_RadarRL::RRL_Object::RRL_Object_Obj44.PxVnce = 0;
  @CAN_RadarRL::RRL_Object::RRL_Object_Obj44.PxVxCoVnce = 0;
  @CAN_RadarRL::RRL_Object::RRL_Object_Obj44.PxVyCoVnce = 0;
  @CAN_RadarRL::RRL_Object::RRL_Object_Obj44.Py = 0;
  @CAN_RadarRL::RRL_Object::RRL_Object_Obj44.PyAxCoVnce = 0;
  @CAN_RadarRL::RRL_Object::RRL_Object_Obj44.PyAyCoVnce = 0;
  @CAN_RadarRL::RRL_Object::RRL_Object_Obj44.PyVnce = 0;
  @CAN_RadarRL::RRL_Object::RRL_Object_Obj44.PyVxCoVnce = 0;
  @CAN_RadarRL::RRL_Object::RRL_Object_Obj44.PyVyCoVnce = 0;
  @CAN_RadarRL::RRL_Object::RRL_Object_Obj44.ReferencePoint = 0;
  @CAN_RadarRL::RRL_Object::RRL_Object_Obj44.Vx = 0;
  @CAN_RadarRL::RRL_Object::RRL_Object_Obj44.VxAxCoVnce = 0;
  }
  if(init_count == 65)
  {
  @CAN_RadarRL::RRL_Object::RRL_Object_Obj44.VxAyCoVnce = 0;
  @CAN_RadarRL::RRL_Object::RRL_Object_Obj44.VxVnce = 0;
  @CAN_RadarRL::RRL_Object::RRL_Object_Obj44.VxVyCoVnce = 0;
  @CAN_RadarRL::RRL_Object::RRL_Object_Obj44.Vy = 0;
  @CAN_RadarRL::RRL_Object::RRL_Object_Obj44.VyAxCoVnce = 0;
  @CAN_RadarRL::RRL_Object::RRL_Object_Obj44.VyAyCoVnce = 0;
  @CAN_RadarRL::RRL_Object::RRL_Object_Obj44.VyVnce = 0;
  @CAN_RadarRL::RRL_Object::RRL_Object_Obj44.Width = 0;
  @CAN_RadarRL::RRL_Object::RRL_Object_Obj44.WidthVnce = 0;
  @CAN_RadarRL::RRL_Object::RRL_Object_Obj45.Age = 0;
  @CAN_RadarRL::RRL_Object::RRL_Object_Obj45.Ax = 0;
  @CAN_RadarRL::RRL_Object::RRL_Object_Obj45.AxAyCoVnce = 0;
  @CAN_RadarRL::RRL_Object::RRL_Object_Obj45.AxVnce = 0;
  @CAN_RadarRL::RRL_Object::RRL_Object_Obj45.Ay = 0;
  @CAN_RadarRL::RRL_Object::RRL_Object_Obj45.AyVnce = 0;
  @CAN_RadarRL::RRL_Object::RRL_Object_Obj45.ExistProb = 0;
  @CAN_RadarRL::RRL_Object::RRL_Object_Obj45.FilterInformation = 0;
  @CAN_RadarRL::RRL_Object::RRL_Object_Obj45.Length = 0;
  @CAN_RadarRL::RRL_Object::RRL_Object_Obj45.LengthVnce = 0;
  @CAN_RadarRL::RRL_Object::RRL_Object_Obj45.MeasurementStatus = 0;
  @CAN_RadarRL::RRL_Object::RRL_Object_Obj45.MovingStatus = 0;
  @CAN_RadarRL::RRL_Object::RRL_Object_Obj45.ObjId = 0;
  @CAN_RadarRL::RRL_Object::RRL_Object_Obj45.OrientationYaw = 0;
  @CAN_RadarRL::RRL_Object::RRL_Object_Obj45.OrientationYawVnce = 0;
  @CAN_RadarRL::RRL_Object::RRL_Object_Obj45.ProbClassConfidence = 0;
  }
  if(init_count == 66)
  {
  @CAN_RadarRL::RRL_Object::RRL_Object_Obj45.ProbClassType = 0;
  @CAN_RadarRL::RRL_Object::RRL_Object_Obj45.Px = 0;
  @CAN_RadarRL::RRL_Object::RRL_Object_Obj45.PxAxCoVnce = 0;
  @CAN_RadarRL::RRL_Object::RRL_Object_Obj45.PxAyCoVnce = 0;
  @CAN_RadarRL::RRL_Object::RRL_Object_Obj45.PxPyCoVnce = 0;
  @CAN_RadarRL::RRL_Object::RRL_Object_Obj45.PxVnce = 0;
  @CAN_RadarRL::RRL_Object::RRL_Object_Obj45.PxVxCoVnce = 0;
  @CAN_RadarRL::RRL_Object::RRL_Object_Obj45.PxVyCoVnce = 0;
  @CAN_RadarRL::RRL_Object::RRL_Object_Obj45.Py = 0;
  @CAN_RadarRL::RRL_Object::RRL_Object_Obj45.PyAxCoVnce = 0;
  @CAN_RadarRL::RRL_Object::RRL_Object_Obj45.PyAyCoVnce = 0;
  @CAN_RadarRL::RRL_Object::RRL_Object_Obj45.PyVnce = 0;
  @CAN_RadarRL::RRL_Object::RRL_Object_Obj45.PyVxCoVnce = 0;
  @CAN_RadarRL::RRL_Object::RRL_Object_Obj45.PyVyCoVnce = 0;
  @CAN_RadarRL::RRL_Object::RRL_Object_Obj45.ReferencePoint = 0;
  @CAN_RadarRL::RRL_Object::RRL_Object_Obj45.Vx = 0;
  @CAN_RadarRL::RRL_Object::RRL_Object_Obj45.VxAxCoVnce = 0;
  @CAN_RadarRL::RRL_Object::RRL_Object_Obj45.VxAyCoVnce = 0;
  @CAN_RadarRL::RRL_Object::RRL_Object_Obj45.VxVnce = 0;
  @CAN_RadarRL::RRL_Object::RRL_Object_Obj45.VxVyCoVnce = 0;
  @CAN_RadarRL::RRL_Object::RRL_Object_Obj45.Vy = 0;
  @CAN_RadarRL::RRL_Object::RRL_Object_Obj45.VyAxCoVnce = 0;
  @CAN_RadarRL::RRL_Object::RRL_Object_Obj45.VyAyCoVnce = 0;
  @CAN_RadarRL::RRL_Object::RRL_Object_Obj45.VyVnce = 0;
  @CAN_RadarRL::RRL_Object::RRL_Object_Obj45.Width = 0;
  }
  if(init_count == 67)
  {
  @CAN_RadarRL::RRL_Object::RRL_Object_Obj45.WidthVnce = 0;
  @CAN_RadarRL::RRL_Object::RRL_Object_Obj46.Age = 0;
  @CAN_RadarRL::RRL_Object::RRL_Object_Obj46.Ax = 0;
  @CAN_RadarRL::RRL_Object::RRL_Object_Obj46.AxAyCoVnce = 0;
  @CAN_RadarRL::RRL_Object::RRL_Object_Obj46.AxVnce = 0;
  @CAN_RadarRL::RRL_Object::RRL_Object_Obj46.Ay = 0;
  @CAN_RadarRL::RRL_Object::RRL_Object_Obj46.AyVnce = 0;
  @CAN_RadarRL::RRL_Object::RRL_Object_Obj46.ExistProb = 0;
  @CAN_RadarRL::RRL_Object::RRL_Object_Obj46.FilterInformation = 0;
  @CAN_RadarRL::RRL_Object::RRL_Object_Obj46.Length = 0;
  @CAN_RadarRL::RRL_Object::RRL_Object_Obj46.LengthVnce = 0;
  @CAN_RadarRL::RRL_Object::RRL_Object_Obj46.MeasurementStatus = 0;
  @CAN_RadarRL::RRL_Object::RRL_Object_Obj46.MovingStatus = 0;
  @CAN_RadarRL::RRL_Object::RRL_Object_Obj46.ObjId = 0;
  @CAN_RadarRL::RRL_Object::RRL_Object_Obj46.OrientationYaw = 0;
  @CAN_RadarRL::RRL_Object::RRL_Object_Obj46.OrientationYawVnce = 0;
  @CAN_RadarRL::RRL_Object::RRL_Object_Obj46.ProbClassConfidence = 0;
  @CAN_RadarRL::RRL_Object::RRL_Object_Obj46.ProbClassType = 0;
  @CAN_RadarRL::RRL_Object::RRL_Object_Obj46.Px = 0;
  @CAN_RadarRL::RRL_Object::RRL_Object_Obj46.PxAxCoVnce = 0;
  @CAN_RadarRL::RRL_Object::RRL_Object_Obj46.PxAyCoVnce = 0;
  @CAN_RadarRL::RRL_Object::RRL_Object_Obj46.PxPyCoVnce = 0;
  @CAN_RadarRL::RRL_Object::RRL_Object_Obj46.PxVnce = 0;
  @CAN_RadarRL::RRL_Object::RRL_Object_Obj46.PxVxCoVnce = 0;
  @CAN_RadarRL::RRL_Object::RRL_Object_Obj46.PxVyCoVnce = 0;
  }
  if(init_count == 68)
  {
  @CAN_RadarRL::RRL_Object::RRL_Object_Obj46.Py = 0;
  @CAN_RadarRL::RRL_Object::RRL_Object_Obj46.PyAxCoVnce = 0;
  @CAN_RadarRL::RRL_Object::RRL_Object_Obj46.PyAyCoVnce = 0;
  @CAN_RadarRL::RRL_Object::RRL_Object_Obj46.PyVnce = 0;
  @CAN_RadarRL::RRL_Object::RRL_Object_Obj46.PyVxCoVnce = 0;
  @CAN_RadarRL::RRL_Object::RRL_Object_Obj46.PyVyCoVnce = 0;
  @CAN_RadarRL::RRL_Object::RRL_Object_Obj46.ReferencePoint = 0;
  @CAN_RadarRL::RRL_Object::RRL_Object_Obj46.Vx = 0;
  @CAN_RadarRL::RRL_Object::RRL_Object_Obj46.VxAxCoVnce = 0;
  @CAN_RadarRL::RRL_Object::RRL_Object_Obj46.VxAyCoVnce = 0;
  @CAN_RadarRL::RRL_Object::RRL_Object_Obj46.VxVnce = 0;
  @CAN_RadarRL::RRL_Object::RRL_Object_Obj46.VxVyCoVnce = 0;
  @CAN_RadarRL::RRL_Object::RRL_Object_Obj46.Vy = 0;
  @CAN_RadarRL::RRL_Object::RRL_Object_Obj46.VyAxCoVnce = 0;
  @CAN_RadarRL::RRL_Object::RRL_Object_Obj46.VyAyCoVnce = 0;
  @CAN_RadarRL::RRL_Object::RRL_Object_Obj46.VyVnce = 0;
  @CAN_RadarRL::RRL_Object::RRL_Object_Obj46.Width = 0;
  @CAN_RadarRL::RRL_Object::RRL_Object_Obj46.WidthVnce = 0;
  @CAN_RadarRL::RRL_Object::RRL_Object_Obj47.Age = 0;
  @CAN_RadarRL::RRL_Object::RRL_Object_Obj47.Ax = 0;
  @CAN_RadarRL::RRL_Object::RRL_Object_Obj47.AxAyCoVnce = 0;
  @CAN_RadarRL::RRL_Object::RRL_Object_Obj47.AxVnce = 0;
  @CAN_RadarRL::RRL_Object::RRL_Object_Obj47.Ay = 0;
  @CAN_RadarRL::RRL_Object::RRL_Object_Obj47.AyVnce = 0;
  @CAN_RadarRL::RRL_Object::RRL_Object_Obj47.ExistProb = 0;
  }
  if(init_count == 69)
  {
  @CAN_RadarRL::RRL_Object::RRL_Object_Obj47.FilterInformation = 0;
  @CAN_RadarRL::RRL_Object::RRL_Object_Obj47.Length = 0;
  @CAN_RadarRL::RRL_Object::RRL_Object_Obj47.LengthVnce = 0;
  @CAN_RadarRL::RRL_Object::RRL_Object_Obj47.MeasurementStatus = 0;
  @CAN_RadarRL::RRL_Object::RRL_Object_Obj47.MovingStatus = 0;
  @CAN_RadarRL::RRL_Object::RRL_Object_Obj47.ObjId = 0;
  @CAN_RadarRL::RRL_Object::RRL_Object_Obj47.OrientationYaw = 0;
  @CAN_RadarRL::RRL_Object::RRL_Object_Obj47.OrientationYawVnce = 0;
  @CAN_RadarRL::RRL_Object::RRL_Object_Obj47.ProbClassConfidence = 0;
  @CAN_RadarRL::RRL_Object::RRL_Object_Obj47.ProbClassType = 0;
  @CAN_RadarRL::RRL_Object::RRL_Object_Obj47.Px = 0;
  @CAN_RadarRL::RRL_Object::RRL_Object_Obj47.PxAxCoVnce = 0;
  @CAN_RadarRL::RRL_Object::RRL_Object_Obj47.PxAyCoVnce = 0;
  @CAN_RadarRL::RRL_Object::RRL_Object_Obj47.PxPyCoVnce = 0;
  @CAN_RadarRL::RRL_Object::RRL_Object_Obj47.PxVnce = 0;
  @CAN_RadarRL::RRL_Object::RRL_Object_Obj47.PxVxCoVnce = 0;
  @CAN_RadarRL::RRL_Object::RRL_Object_Obj47.PxVyCoVnce = 0;
  @CAN_RadarRL::RRL_Object::RRL_Object_Obj47.Py = 0;
  @CAN_RadarRL::RRL_Object::RRL_Object_Obj47.PyAxCoVnce = 0;
  @CAN_RadarRL::RRL_Object::RRL_Object_Obj47.PyAyCoVnce = 0;
  @CAN_RadarRL::RRL_Object::RRL_Object_Obj47.PyVnce = 0;
  @CAN_RadarRL::RRL_Object::RRL_Object_Obj47.PyVxCoVnce = 0;
  @CAN_RadarRL::RRL_Object::RRL_Object_Obj47.PyVyCoVnce = 0;
  @CAN_RadarRL::RRL_Object::RRL_Object_Obj47.ReferencePoint = 0;
  @CAN_RadarRL::RRL_Object::RRL_Object_Obj47.Vx = 0;
  }
  if(init_count == 70)
  {
  @CAN_RadarRL::RRL_Object::RRL_Object_Obj47.VxAxCoVnce = 0;
  @CAN_RadarRL::RRL_Object::RRL_Object_Obj47.VxAyCoVnce = 0;
  @CAN_RadarRL::RRL_Object::RRL_Object_Obj47.VxVnce = 0;
  @CAN_RadarRL::RRL_Object::RRL_Object_Obj47.VxVyCoVnce = 0;
  @CAN_RadarRL::RRL_Object::RRL_Object_Obj47.Vy = 0;
  @CAN_RadarRL::RRL_Object::RRL_Object_Obj47.VyAxCoVnce = 0;
  @CAN_RadarRL::RRL_Object::RRL_Object_Obj47.VyAyCoVnce = 0;
  @CAN_RadarRL::RRL_Object::RRL_Object_Obj47.VyVnce = 0;
  @CAN_RadarRL::RRL_Object::RRL_Object_Obj47.Width = 0;
  @CAN_RadarRL::RRL_Object::RRL_Object_Obj47.WidthVnce = 0;
  @CAN_RadarRL::RRL_Object::RRL_Object_Obj48.Age = 0;
  @CAN_RadarRL::RRL_Object::RRL_Object_Obj48.Ax = 0;
  @CAN_RadarRL::RRL_Object::RRL_Object_Obj48.AxAyCoVnce = 0;
  @CAN_RadarRL::RRL_Object::RRL_Object_Obj48.AxVnce = 0;
  @CAN_RadarRL::RRL_Object::RRL_Object_Obj48.Ay = 0;
  @CAN_RadarRL::RRL_Object::RRL_Object_Obj48.AyVnce = 0;
  @CAN_RadarRL::RRL_Object::RRL_Object_Obj48.ExistProb = 0;
  @CAN_RadarRL::RRL_Object::RRL_Object_Obj48.FilterInformation = 0;
  @CAN_RadarRL::RRL_Object::RRL_Object_Obj48.Length = 0;
  @CAN_RadarRL::RRL_Object::RRL_Object_Obj48.LengthVnce = 0;
  @CAN_RadarRL::RRL_Object::RRL_Object_Obj48.MeasurementStatus = 0;
  @CAN_RadarRL::RRL_Object::RRL_Object_Obj48.MovingStatus = 0;
  @CAN_RadarRL::RRL_Object::RRL_Object_Obj48.ObjId = 0;
  @CAN_RadarRL::RRL_Object::RRL_Object_Obj48.OrientationYaw = 0;
  @CAN_RadarRL::RRL_Object::RRL_Object_Obj48.OrientationYawVnce = 0;
  }
  if(init_count == 71)
  {
  @CAN_RadarRL::RRL_Object::RRL_Object_Obj48.ProbClassConfidence = 0;
  @CAN_RadarRL::RRL_Object::RRL_Object_Obj48.ProbClassType = 0;
  @CAN_RadarRL::RRL_Object::RRL_Object_Obj48.Px = 0;
  @CAN_RadarRL::RRL_Object::RRL_Object_Obj48.PxAxCoVnce = 0;
  @CAN_RadarRL::RRL_Object::RRL_Object_Obj48.PxAyCoVnce = 0;
  @CAN_RadarRL::RRL_Object::RRL_Object_Obj48.PxPyCoVnce = 0;
  @CAN_RadarRL::RRL_Object::RRL_Object_Obj48.PxVnce = 0;
  @CAN_RadarRL::RRL_Object::RRL_Object_Obj48.PxVxCoVnce = 0;
  @CAN_RadarRL::RRL_Object::RRL_Object_Obj48.PxVyCoVnce = 0;
  @CAN_RadarRL::RRL_Object::RRL_Object_Obj48.Py = 0;
  @CAN_RadarRL::RRL_Object::RRL_Object_Obj48.PyAxCoVnce = 0;
  @CAN_RadarRL::RRL_Object::RRL_Object_Obj48.PyAyCoVnce = 0;
  @CAN_RadarRL::RRL_Object::RRL_Object_Obj48.PyVnce = 0;
  @CAN_RadarRL::RRL_Object::RRL_Object_Obj48.PyVxCoVnce = 0;
  @CAN_RadarRL::RRL_Object::RRL_Object_Obj48.PyVyCoVnce = 0;
  @CAN_RadarRL::RRL_Object::RRL_Object_Obj48.ReferencePoint = 0;
  @CAN_RadarRL::RRL_Object::RRL_Object_Obj48.Vx = 0;
  @CAN_RadarRL::RRL_Object::RRL_Object_Obj48.VxAxCoVnce = 0;
  @CAN_RadarRL::RRL_Object::RRL_Object_Obj48.VxAyCoVnce = 0;
  @CAN_RadarRL::RRL_Object::RRL_Object_Obj48.VxVnce = 0;
  @CAN_RadarRL::RRL_Object::RRL_Object_Obj48.VxVyCoVnce = 0;
  @CAN_RadarRL::RRL_Object::RRL_Object_Obj48.Vy = 0;
  @CAN_RadarRL::RRL_Object::RRL_Object_Obj48.VyAxCoVnce = 0;
  @CAN_RadarRL::RRL_Object::RRL_Object_Obj48.VyAyCoVnce = 0;
  @CAN_RadarRL::RRL_Object::RRL_Object_Obj48.VyVnce = 0;
  }
  if(init_count == 72)
  {
  @CAN_RadarRL::RRL_Object::RRL_Object_Obj48.Width = 0;
  @CAN_RadarRL::RRL_Object::RRL_Object_Obj48.WidthVnce = 0;
  @CAN_RadarRL::RRL_Object::RRL_Object_Obj4.Age = 0;
  @CAN_RadarRL::RRL_Object::RRL_Object_Obj4.Ax = 0;
  @CAN_RadarRL::RRL_Object::RRL_Object_Obj4.AxAyCoVnce = 0;
  @CAN_RadarRL::RRL_Object::RRL_Object_Obj4.AxVnce = 0;
  @CAN_RadarRL::RRL_Object::RRL_Object_Obj4.Ay = 0;
  @CAN_RadarRL::RRL_Object::RRL_Object_Obj4.AyVnce = 0;
  @CAN_RadarRL::RRL_Object::RRL_Object_Obj4.ExistProb = 0;
  @CAN_RadarRL::RRL_Object::RRL_Object_Obj4.FilterInformation = 0;
  @CAN_RadarRL::RRL_Object::RRL_Object_Obj4.Length = 0;
  @CAN_RadarRL::RRL_Object::RRL_Object_Obj4.LengthVnce = 0;
  @CAN_RadarRL::RRL_Object::RRL_Object_Obj4.MeasurementStatus = 0;
  @CAN_RadarRL::RRL_Object::RRL_Object_Obj4.MovingStatus = 0;
  @CAN_RadarRL::RRL_Object::RRL_Object_Obj4.ObjId = 0;
  @CAN_RadarRL::RRL_Object::RRL_Object_Obj4.OrientationYaw = 0;
  @CAN_RadarRL::RRL_Object::RRL_Object_Obj4.OrientationYawVnce = 0;
  @CAN_RadarRL::RRL_Object::RRL_Object_Obj4.ProbClassConfidence = 0;
  @CAN_RadarRL::RRL_Object::RRL_Object_Obj4.ProbClassType = 0;
  @CAN_RadarRL::RRL_Object::RRL_Object_Obj4.Px = 0;
  @CAN_RadarRL::RRL_Object::RRL_Object_Obj4.PxAxCoVnce = 0;
  @CAN_RadarRL::RRL_Object::RRL_Object_Obj4.PxAyCoVnce = 0;
  @CAN_RadarRL::RRL_Object::RRL_Object_Obj4.PxPyCoVnce = 0;
  @CAN_RadarRL::RRL_Object::RRL_Object_Obj4.PxVnce = 0;
  @CAN_RadarRL::RRL_Object::RRL_Object_Obj4.PxVxCoVnce = 0;
  }
  if(init_count == 73)
  {
  @CAN_RadarRL::RRL_Object::RRL_Object_Obj4.PxVyCoVnce = 0;
  @CAN_RadarRL::RRL_Object::RRL_Object_Obj4.Py = 0;
  @CAN_RadarRL::RRL_Object::RRL_Object_Obj4.PyAxCoVnce = 0;
  @CAN_RadarRL::RRL_Object::RRL_Object_Obj4.PyAyCoVnce = 0;
  @CAN_RadarRL::RRL_Object::RRL_Object_Obj4.PyVnce = 0;
  @CAN_RadarRL::RRL_Object::RRL_Object_Obj4.PyVxCoVnce = 0;
  @CAN_RadarRL::RRL_Object::RRL_Object_Obj4.PyVyCoVnce = 0;
  @CAN_RadarRL::RRL_Object::RRL_Object_Obj4.ReferencePoint = 0;
  @CAN_RadarRL::RRL_Object::RRL_Object_Obj4.Vx = 0;
  @CAN_RadarRL::RRL_Object::RRL_Object_Obj4.VxAxCoVnce = 0;
  @CAN_RadarRL::RRL_Object::RRL_Object_Obj4.VxAyCoVnce = 0;
  @CAN_RadarRL::RRL_Object::RRL_Object_Obj4.VxVnce = 0;
  @CAN_RadarRL::RRL_Object::RRL_Object_Obj4.VxVyCoVnce = 0;
  @CAN_RadarRL::RRL_Object::RRL_Object_Obj4.Vy = 0;
  @CAN_RadarRL::RRL_Object::RRL_Object_Obj4.VyAxCoVnce = 0;
  @CAN_RadarRL::RRL_Object::RRL_Object_Obj4.VyAyCoVnce = 0;
  @CAN_RadarRL::RRL_Object::RRL_Object_Obj4.VyVnce = 0;
  @CAN_RadarRL::RRL_Object::RRL_Object_Obj4.Width = 0;
  @CAN_RadarRL::RRL_Object::RRL_Object_Obj4.WidthVnce = 0;
  @CAN_RadarRL::RRL_Object::RRL_Object_Obj5.Age = 0;
  @CAN_RadarRL::RRL_Object::RRL_Object_Obj5.Ax = 0;
  @CAN_RadarRL::RRL_Object::RRL_Object_Obj5.AxAyCoVnce = 0;
  @CAN_RadarRL::RRL_Object::RRL_Object_Obj5.AxVnce = 0;
  @CAN_RadarRL::RRL_Object::RRL_Object_Obj5.Ay = 0;
  @CAN_RadarRL::RRL_Object::RRL_Object_Obj5.AyVnce = 0;
  }
  if(init_count == 74)
  {
  @CAN_RadarRL::RRL_Object::RRL_Object_Obj5.ExistProb = 0;
  @CAN_RadarRL::RRL_Object::RRL_Object_Obj5.FilterInformation = 0;
  @CAN_RadarRL::RRL_Object::RRL_Object_Obj5.Length = 0;
  @CAN_RadarRL::RRL_Object::RRL_Object_Obj5.LengthVnce = 0;
  @CAN_RadarRL::RRL_Object::RRL_Object_Obj5.MeasurementStatus = 0;
  @CAN_RadarRL::RRL_Object::RRL_Object_Obj5.MovingStatus = 0;
  @CAN_RadarRL::RRL_Object::RRL_Object_Obj5.ObjId = 0;
  @CAN_RadarRL::RRL_Object::RRL_Object_Obj5.OrientationYaw = 0;
  @CAN_RadarRL::RRL_Object::RRL_Object_Obj5.OrientationYawVnce = 0;
  @CAN_RadarRL::RRL_Object::RRL_Object_Obj5.ProbClassConfidence = 0;
  @CAN_RadarRL::RRL_Object::RRL_Object_Obj5.ProbClassType = 0;
  @CAN_RadarRL::RRL_Object::RRL_Object_Obj5.Px = 0;
  @CAN_RadarRL::RRL_Object::RRL_Object_Obj5.PxAxCoVnce = 0;
  @CAN_RadarRL::RRL_Object::RRL_Object_Obj5.PxAyCoVnce = 0;
  @CAN_RadarRL::RRL_Object::RRL_Object_Obj5.PxPyCoVnce = 0;
  @CAN_RadarRL::RRL_Object::RRL_Object_Obj5.PxVnce = 0;
  @CAN_RadarRL::RRL_Object::RRL_Object_Obj5.PxVxCoVnce = 0;
  @CAN_RadarRL::RRL_Object::RRL_Object_Obj5.PxVyCoVnce = 0;
  @CAN_RadarRL::RRL_Object::RRL_Object_Obj5.Py = 0;
  @CAN_RadarRL::RRL_Object::RRL_Object_Obj5.PyAxCoVnce = 0;
  @CAN_RadarRL::RRL_Object::RRL_Object_Obj5.PyAyCoVnce = 0;
  @CAN_RadarRL::RRL_Object::RRL_Object_Obj5.PyVnce = 0;
  @CAN_RadarRL::RRL_Object::RRL_Object_Obj5.PyVxCoVnce = 0;
  @CAN_RadarRL::RRL_Object::RRL_Object_Obj5.PyVyCoVnce = 0;
  @CAN_RadarRL::RRL_Object::RRL_Object_Obj5.ReferencePoint = 0;
  }
  if(init_count == 75)
  {
  @CAN_RadarRL::RRL_Object::RRL_Object_Obj5.Vx = 0;
  @CAN_RadarRL::RRL_Object::RRL_Object_Obj5.VxAxCoVnce = 0;
  @CAN_RadarRL::RRL_Object::RRL_Object_Obj5.VxAyCoVnce = 0;
  @CAN_RadarRL::RRL_Object::RRL_Object_Obj5.VxVnce = 0;
  @CAN_RadarRL::RRL_Object::RRL_Object_Obj5.VxVyCoVnce = 0;
  @CAN_RadarRL::RRL_Object::RRL_Object_Obj5.Vy = 0;
  @CAN_RadarRL::RRL_Object::RRL_Object_Obj5.VyAxCoVnce = 0;
  @CAN_RadarRL::RRL_Object::RRL_Object_Obj5.VyAyCoVnce = 0;
  @CAN_RadarRL::RRL_Object::RRL_Object_Obj5.VyVnce = 0;
  @CAN_RadarRL::RRL_Object::RRL_Object_Obj5.Width = 0;
  @CAN_RadarRL::RRL_Object::RRL_Object_Obj5.WidthVnce = 0;
  @CAN_RadarRL::RRL_Object::RRL_Object_Obj6.Age = 0;
  @CAN_RadarRL::RRL_Object::RRL_Object_Obj6.Ax = 0;
  @CAN_RadarRL::RRL_Object::RRL_Object_Obj6.AxAyCoVnce = 0;
  @CAN_RadarRL::RRL_Object::RRL_Object_Obj6.AxVnce = 0;
  @CAN_RadarRL::RRL_Object::RRL_Object_Obj6.Ay = 0;
  @CAN_RadarRL::RRL_Object::RRL_Object_Obj6.AyVnce = 0;
  @CAN_RadarRL::RRL_Object::RRL_Object_Obj6.ExistProb = 0;
  @CAN_RadarRL::RRL_Object::RRL_Object_Obj6.FilterInformation = 0;
  @CAN_RadarRL::RRL_Object::RRL_Object_Obj6.Length = 0;
  @CAN_RadarRL::RRL_Object::RRL_Object_Obj6.LengthVnce = 0;
  @CAN_RadarRL::RRL_Object::RRL_Object_Obj6.MeasurementStatus = 0;
  @CAN_RadarRL::RRL_Object::RRL_Object_Obj6.MovingStatus = 0;
  @CAN_RadarRL::RRL_Object::RRL_Object_Obj6.ObjId = 0;
  @CAN_RadarRL::RRL_Object::RRL_Object_Obj6.OrientationYaw = 0;
  }
  if(init_count == 76)
  {
  @CAN_RadarRL::RRL_Object::RRL_Object_Obj6.OrientationYawVnce = 0;
  @CAN_RadarRL::RRL_Object::RRL_Object_Obj6.ProbClassConfidence = 0;
  @CAN_RadarRL::RRL_Object::RRL_Object_Obj6.ProbClassType = 0;
  @CAN_RadarRL::RRL_Object::RRL_Object_Obj6.Px = 0;
  @CAN_RadarRL::RRL_Object::RRL_Object_Obj6.PxAxCoVnce = 0;
  @CAN_RadarRL::RRL_Object::RRL_Object_Obj6.PxAyCoVnce = 0;
  @CAN_RadarRL::RRL_Object::RRL_Object_Obj6.PxPyCoVnce = 0;
  @CAN_RadarRL::RRL_Object::RRL_Object_Obj6.PxVnce = 0;
  @CAN_RadarRL::RRL_Object::RRL_Object_Obj6.PxVxCoVnce = 0;
  @CAN_RadarRL::RRL_Object::RRL_Object_Obj6.PxVyCoVnce = 0;
  @CAN_RadarRL::RRL_Object::RRL_Object_Obj6.Py = 0;
  @CAN_RadarRL::RRL_Object::RRL_Object_Obj6.PyAxCoVnce = 0;
  @CAN_RadarRL::RRL_Object::RRL_Object_Obj6.PyAyCoVnce = 0;
  @CAN_RadarRL::RRL_Object::RRL_Object_Obj6.PyVnce = 0;
  @CAN_RadarRL::RRL_Object::RRL_Object_Obj6.PyVxCoVnce = 0;
  @CAN_RadarRL::RRL_Object::RRL_Object_Obj6.PyVyCoVnce = 0;
  @CAN_RadarRL::RRL_Object::RRL_Object_Obj6.ReferencePoint = 0;
  @CAN_RadarRL::RRL_Object::RRL_Object_Obj6.Vx = 0;
  @CAN_RadarRL::RRL_Object::RRL_Object_Obj6.VxAxCoVnce = 0;
  @CAN_RadarRL::RRL_Object::RRL_Object_Obj6.VxAyCoVnce = 0;
  @CAN_RadarRL::RRL_Object::RRL_Object_Obj6.VxVnce = 0;
  @CAN_RadarRL::RRL_Object::RRL_Object_Obj6.VxVyCoVnce = 0;
  @CAN_RadarRL::RRL_Object::RRL_Object_Obj6.Vy = 0;
  @CAN_RadarRL::RRL_Object::RRL_Object_Obj6.VyAxCoVnce = 0;
  @CAN_RadarRL::RRL_Object::RRL_Object_Obj6.VyAyCoVnce = 0;
  }
  if(init_count == 77)
  {
  @CAN_RadarRL::RRL_Object::RRL_Object_Obj6.VyVnce = 0;
  @CAN_RadarRL::RRL_Object::RRL_Object_Obj6.Width = 0;
  @CAN_RadarRL::RRL_Object::RRL_Object_Obj6.WidthVnce = 0;
  @CAN_RadarRL::RRL_Object::RRL_Object_Obj7.Age = 0;
  @CAN_RadarRL::RRL_Object::RRL_Object_Obj7.Ax = 0;
  @CAN_RadarRL::RRL_Object::RRL_Object_Obj7.AxAyCoVnce = 0;
  @CAN_RadarRL::RRL_Object::RRL_Object_Obj7.AxVnce = 0;
  @CAN_RadarRL::RRL_Object::RRL_Object_Obj7.Ay = 0;
  @CAN_RadarRL::RRL_Object::RRL_Object_Obj7.AyVnce = 0;
  @CAN_RadarRL::RRL_Object::RRL_Object_Obj7.ExistProb = 0;
  @CAN_RadarRL::RRL_Object::RRL_Object_Obj7.FilterInformation = 0;
  @CAN_RadarRL::RRL_Object::RRL_Object_Obj7.Length = 0;
  @CAN_RadarRL::RRL_Object::RRL_Object_Obj7.LengthVnce = 0;
  @CAN_RadarRL::RRL_Object::RRL_Object_Obj7.MeasurementStatus = 0;
  @CAN_RadarRL::RRL_Object::RRL_Object_Obj7.MovingStatus = 0;
  @CAN_RadarRL::RRL_Object::RRL_Object_Obj7.ObjId = 0;
  @CAN_RadarRL::RRL_Object::RRL_Object_Obj7.OrientationYaw = 0;
  @CAN_RadarRL::RRL_Object::RRL_Object_Obj7.OrientationYawVnce = 0;
  @CAN_RadarRL::RRL_Object::RRL_Object_Obj7.ProbClassConfidence = 0;
  @CAN_RadarRL::RRL_Object::RRL_Object_Obj7.ProbClassType = 0;
  @CAN_RadarRL::RRL_Object::RRL_Object_Obj7.Px = 0;
  @CAN_RadarRL::RRL_Object::RRL_Object_Obj7.PxAxCoVnce = 0;
  @CAN_RadarRL::RRL_Object::RRL_Object_Obj7.PxAyCoVnce = 0;
  @CAN_RadarRL::RRL_Object::RRL_Object_Obj7.PxPyCoVnce = 0;
  @CAN_RadarRL::RRL_Object::RRL_Object_Obj7.PxVnce = 0;
  }
  if(init_count == 78)
  {
  @CAN_RadarRL::RRL_Object::RRL_Object_Obj7.PxVxCoVnce = 0;
  @CAN_RadarRL::RRL_Object::RRL_Object_Obj7.PxVyCoVnce = 0;
  @CAN_RadarRL::RRL_Object::RRL_Object_Obj7.Py = 0;
  @CAN_RadarRL::RRL_Object::RRL_Object_Obj7.PyAxCoVnce = 0;
  @CAN_RadarRL::RRL_Object::RRL_Object_Obj7.PyAyCoVnce = 0;
  @CAN_RadarRL::RRL_Object::RRL_Object_Obj7.PyVnce = 0;
  @CAN_RadarRL::RRL_Object::RRL_Object_Obj7.PyVxCoVnce = 0;
  @CAN_RadarRL::RRL_Object::RRL_Object_Obj7.PyVyCoVnce = 0;
  @CAN_RadarRL::RRL_Object::RRL_Object_Obj7.ReferencePoint = 0;
  @CAN_RadarRL::RRL_Object::RRL_Object_Obj7.Vx = 0;
  @CAN_RadarRL::RRL_Object::RRL_Object_Obj7.VxAxCoVnce = 0;
  @CAN_RadarRL::RRL_Object::RRL_Object_Obj7.VxAyCoVnce = 0;
  @CAN_RadarRL::RRL_Object::RRL_Object_Obj7.VxVnce = 0;
  @CAN_RadarRL::RRL_Object::RRL_Object_Obj7.VxVyCoVnce = 0;
  @CAN_RadarRL::RRL_Object::RRL_Object_Obj7.Vy = 0;
  @CAN_RadarRL::RRL_Object::RRL_Object_Obj7.VyAxCoVnce = 0;
  @CAN_RadarRL::RRL_Object::RRL_Object_Obj7.VyAyCoVnce = 0;
  @CAN_RadarRL::RRL_Object::RRL_Object_Obj7.VyVnce = 0;
  @CAN_RadarRL::RRL_Object::RRL_Object_Obj7.Width = 0;
  @CAN_RadarRL::RRL_Object::RRL_Object_Obj7.WidthVnce = 0;
  @CAN_RadarRL::RRL_Object::RRL_Object_Obj8.Age = 0;
  @CAN_RadarRL::RRL_Object::RRL_Object_Obj8.Ax = 0;
  @CAN_RadarRL::RRL_Object::RRL_Object_Obj8.AxAyCoVnce = 0;
  @CAN_RadarRL::RRL_Object::RRL_Object_Obj8.AxVnce = 0;
  @CAN_RadarRL::RRL_Object::RRL_Object_Obj8.Ay = 0;
  }
  if(init_count == 79)
  {
  @CAN_RadarRL::RRL_Object::RRL_Object_Obj8.AyVnce = 0;
  @CAN_RadarRL::RRL_Object::RRL_Object_Obj8.ExistProb = 0;
  @CAN_RadarRL::RRL_Object::RRL_Object_Obj8.FilterInformation = 0;
  @CAN_RadarRL::RRL_Object::RRL_Object_Obj8.Length = 0;
  @CAN_RadarRL::RRL_Object::RRL_Object_Obj8.LengthVnce = 0;
  @CAN_RadarRL::RRL_Object::RRL_Object_Obj8.MeasurementStatus = 0;
  @CAN_RadarRL::RRL_Object::RRL_Object_Obj8.MovingStatus = 0;
  @CAN_RadarRL::RRL_Object::RRL_Object_Obj8.ObjId = 0;
  @CAN_RadarRL::RRL_Object::RRL_Object_Obj8.OrientationYaw = 0;
  @CAN_RadarRL::RRL_Object::RRL_Object_Obj8.OrientationYawVnce = 0;
  @CAN_RadarRL::RRL_Object::RRL_Object_Obj8.ProbClassConfidence = 0;
  @CAN_RadarRL::RRL_Object::RRL_Object_Obj8.ProbClassType = 0;
  @CAN_RadarRL::RRL_Object::RRL_Object_Obj8.Px = 0;
  @CAN_RadarRL::RRL_Object::RRL_Object_Obj8.PxAxCoVnce = 0;
  @CAN_RadarRL::RRL_Object::RRL_Object_Obj8.PxAyCoVnce = 0;
  @CAN_RadarRL::RRL_Object::RRL_Object_Obj8.PxPyCoVnce = 0;
  @CAN_RadarRL::RRL_Object::RRL_Object_Obj8.PxVnce = 0;
  @CAN_RadarRL::RRL_Object::RRL_Object_Obj8.PxVxCoVnce = 0;
  @CAN_RadarRL::RRL_Object::RRL_Object_Obj8.PxVyCoVnce = 0;
  @CAN_RadarRL::RRL_Object::RRL_Object_Obj8.Py = 0;
  @CAN_RadarRL::RRL_Object::RRL_Object_Obj8.PyAxCoVnce = 0;
  @CAN_RadarRL::RRL_Object::RRL_Object_Obj8.PyAyCoVnce = 0;
  @CAN_RadarRL::RRL_Object::RRL_Object_Obj8.PyVnce = 0;
  @CAN_RadarRL::RRL_Object::RRL_Object_Obj8.PyVxCoVnce = 0;
  @CAN_RadarRL::RRL_Object::RRL_Object_Obj8.PyVyCoVnce = 0;
  }
  if(init_count == 80)
  {
  @CAN_RadarRL::RRL_Object::RRL_Object_Obj8.ReferencePoint = 0;
  @CAN_RadarRL::RRL_Object::RRL_Object_Obj8.Vx = 0;
  @CAN_RadarRL::RRL_Object::RRL_Object_Obj8.VxAxCoVnce = 0;
  @CAN_RadarRL::RRL_Object::RRL_Object_Obj8.VxAyCoVnce = 0;
  @CAN_RadarRL::RRL_Object::RRL_Object_Obj8.VxVnce = 0;
  @CAN_RadarRL::RRL_Object::RRL_Object_Obj8.VxVyCoVnce = 0;
  @CAN_RadarRL::RRL_Object::RRL_Object_Obj8.Vy = 0;
  @CAN_RadarRL::RRL_Object::RRL_Object_Obj8.VyAxCoVnce = 0;
  @CAN_RadarRL::RRL_Object::RRL_Object_Obj8.VyAyCoVnce = 0;
  @CAN_RadarRL::RRL_Object::RRL_Object_Obj8.VyVnce = 0;
  @CAN_RadarRL::RRL_Object::RRL_Object_Obj8.Width = 0;
  @CAN_RadarRL::RRL_Object::RRL_Object_Obj8.WidthVnce = 0;
  @CAN_RadarRL::RRL_Object::RRL_Object_Obj9.Age = 0;
  @CAN_RadarRL::RRL_Object::RRL_Object_Obj9.Ax = 0;
  @CAN_RadarRL::RRL_Object::RRL_Object_Obj9.AxAyCoVnce = 0;
  @CAN_RadarRL::RRL_Object::RRL_Object_Obj9.AxVnce = 0;
  @CAN_RadarRL::RRL_Object::RRL_Object_Obj9.Ay = 0;
  @CAN_RadarRL::RRL_Object::RRL_Object_Obj9.AyVnce = 0;
  @CAN_RadarRL::RRL_Object::RRL_Object_Obj9.ExistProb = 0;
  @CAN_RadarRL::RRL_Object::RRL_Object_Obj9.FilterInformation = 0;
  @CAN_RadarRL::RRL_Object::RRL_Object_Obj9.Length = 0;
  @CAN_RadarRL::RRL_Object::RRL_Object_Obj9.LengthVnce = 0;
  @CAN_RadarRL::RRL_Object::RRL_Object_Obj9.MeasurementStatus = 0;
  @CAN_RadarRL::RRL_Object::RRL_Object_Obj9.MovingStatus = 0;
  @CAN_RadarRL::RRL_Object::RRL_Object_Obj9.ObjId = 0;
  }
  if(init_count == 81)
  {
  @CAN_RadarRL::RRL_Object::RRL_Object_Obj9.OrientationYaw = 0;
  @CAN_RadarRL::RRL_Object::RRL_Object_Obj9.OrientationYawVnce = 0;
  @CAN_RadarRL::RRL_Object::RRL_Object_Obj9.ProbClassConfidence = 0;
  @CAN_RadarRL::RRL_Object::RRL_Object_Obj9.ProbClassType = 0;
  @CAN_RadarRL::RRL_Object::RRL_Object_Obj9.Px = 0;
  @CAN_RadarRL::RRL_Object::RRL_Object_Obj9.PxAxCoVnce = 0;
  @CAN_RadarRL::RRL_Object::RRL_Object_Obj9.PxAyCoVnce = 0;
  @CAN_RadarRL::RRL_Object::RRL_Object_Obj9.PxPyCoVnce = 0;
  @CAN_RadarRL::RRL_Object::RRL_Object_Obj9.PxVnce = 0;
  @CAN_RadarRL::RRL_Object::RRL_Object_Obj9.PxVxCoVnce = 0;
  @CAN_RadarRL::RRL_Object::RRL_Object_Obj9.PxVyCoVnce = 0;
  @CAN_RadarRL::RRL_Object::RRL_Object_Obj9.Py = 0;
  @CAN_RadarRL::RRL_Object::RRL_Object_Obj9.PyAxCoVnce = 0;
  @CAN_RadarRL::RRL_Object::RRL_Object_Obj9.PyAyCoVnce = 0;
  @CAN_RadarRL::RRL_Object::RRL_Object_Obj9.PyVnce = 0;
  @CAN_RadarRL::RRL_Object::RRL_Object_Obj9.PyVxCoVnce = 0;
  @CAN_RadarRL::RRL_Object::RRL_Object_Obj9.PyVyCoVnce = 0;
  @CAN_RadarRL::RRL_Object::RRL_Object_Obj9.ReferencePoint = 0;
  @CAN_RadarRL::RRL_Object::RRL_Object_Obj9.Vx = 0;
  @CAN_RadarRL::RRL_Object::RRL_Object_Obj9.VxAxCoVnce = 0;
  @CAN_RadarRL::RRL_Object::RRL_Object_Obj9.VxAyCoVnce = 0;
  @CAN_RadarRL::RRL_Object::RRL_Object_Obj9.VxVnce = 0;
  @CAN_RadarRL::RRL_Object::RRL_Object_Obj9.VxVyCoVnce = 0;
  @CAN_RadarRL::RRL_Object::RRL_Object_Obj9.Vy = 0;
  @CAN_RadarRL::RRL_Object::RRL_Object_Obj9.VyAxCoVnce = 0;
  }
  if(init_count == 82)
  {
  @CAN_RadarRL::RRL_Object::RRL_Object_Obj9.VyAyCoVnce = 0;
  @CAN_RadarRL::RRL_Object::RRL_Object_Obj9.VyVnce = 0;
  @CAN_RadarRL::RRL_Object::RRL_Object_Obj9.Width = 0;
  @CAN_RadarRL::RRL_Object::RRL_Object_Obj9.WidthVnce = 0;
  @CAN_RadarRL::RRL_Object::RRL_Object_ObjHdr_NumValidObjects = 0;
  @CAN_RadarRL::RRL_Object::RRL_Object_ObjHdr_TimeStamp = 0;
  @CAN_RadarRL::RRL_Object::RRL_Object_ObjHdr_TimeStampStatus = 0;
  @CAN_RadarRL::RRL_Object::RRL_Object_ObjHdr_VersionIdMajor = 0;
  @CAN_RadarRL::RRL_Object::RRL_Object_ObjHdr_VersionIdMinor = 0;
  @CAN_RadarRL::RRL_Object::RRL_Object_ObjHdr_VersionPatch = 0;
  @CAN_RadarRL::RRL_Object::RRL_Object_ObjHdr_content_type = 0;
  @CAN_RadarRL::RRL_Object::RRL_Object_ShiiHdr_DataMeasured = 0;
  @CAN_RadarRL::RRL_Object::RRL_Object_ShiiHdr_MisAzOOPCause = 0;
  @CAN_RadarRL::RRL_Object::RRL_Object_ShiiHdr_MisElOOPCause = 0;
  @CAN_RadarRL::RRL_Object::RRL_Object_ShiiHdr_RatioAdvProcListProc = 0;
  @CAN_RadarRL::RRL_Object::RRL_Object_ShiiHdr_SensorCalExtStat = 0;
  @CAN_RadarRL::RRL_Object::RRL_Object_ShiiHdr_SensorCalIntStat = 0;
  @CAN_RadarRL::RRL_Object::RRL_Object_ShiiHdr_SensorCalOnlStat = 0;
  @CAN_RadarRL::RRL_Object::RRL_Object_ShiiHdr_SensorFailureReas = 0;
  @CAN_RadarRL::RRL_Object::RRL_Object_ShiiHdr_SensorHeatingStatus = 0;
  @CAN_RadarRL::RRL_Object::RRL_Object_ShiiHdr_SensorOmmOpMode = 0;
  @CAN_RadarRL::RRL_Object::RRL_Object_ShiiHdr_ThermalDegr = 0;
  @CAN_RadarRL::RRL_Object::RRL_Object_SpiHdr_BldFov_Confidence = 0;
  @CAN_RadarRL::RRL_Object::RRL_Object_SpiHdr_BldFov_Status = 0;
  @CAN_RadarRL::RRL_Object::RRL_Object_SpiHdr_BldOperationMode = 0;
  }
  if(init_count == 83)
  {
  @CAN_RadarRL::RRL_Object::RRL_Object_SpiHdr_DistMaxProc = 0;
  @CAN_RadarRL::RRL_Object::RRL_Object_SpiHdr_DistMeasMaxMod = 0;
  @CAN_RadarRL::RRL_Object::RRL_Object_SpiHdr_DistMeasMinMod = 0;
  @CAN_RadarRL::RRL_Object::RRL_Object_SpiHdr_DistPrec = 0;
  @CAN_RadarRL::RRL_Object::RRL_Object_SpiHdr_DistSep = 0;
  @CAN_RadarRL::RRL_Object::RRL_Object_SpiHdr_DistStartProcDegraded = 0;
  @CAN_RadarRL::RRL_Object::RRL_Object_SpiHdr_DmpId = 0;
  @CAN_RadarRL::RRL_Object::RRL_Object_SpiHdr_FovRtrAzDetRng00 = 0;
  @CAN_RadarRL::RRL_Object::RRL_Object_SpiHdr_FovRtrAzDetRng01 = 0;
  @CAN_RadarRL::RRL_Object::RRL_Object_SpiHdr_FovRtrAzDetRng02 = 0;
  @CAN_RadarRL::RRL_Object::RRL_Object_SpiHdr_FovRtrAzDetRng03 = 0;
  @CAN_RadarRL::RRL_Object::RRL_Object_SpiHdr_FovRtrAzDetRng04 = 0;
  @CAN_RadarRL::RRL_Object::RRL_Object_SpiHdr_FovRtrAzDetRng05 = 0;
  @CAN_RadarRL::RRL_Object::RRL_Object_SpiHdr_FovRtrAzDetRng06 = 0;
  @CAN_RadarRL::RRL_Object::RRL_Object_SpiHdr_FovRtrAzDetRng07 = 0;
  @CAN_RadarRL::RRL_Object::RRL_Object_SpiHdr_FovRtrAzDetRng08 = 0;
  @CAN_RadarRL::RRL_Object::RRL_Object_SpiHdr_FovRtrAzDetRng09 = 0;
  @CAN_RadarRL::RRL_Object::RRL_Object_SpiHdr_FovRtrAzDetRng10 = 0;
  @CAN_RadarRL::RRL_Object::RRL_Object_SpiHdr_FovRtrAzDetRng11 = 0;
  @CAN_RadarRL::RRL_Object::RRL_Object_SpiHdr_FovRtrAzDetRng12 = 0;
  @CAN_RadarRL::RRL_Object::RRL_Object_SpiHdr_FovRtrAzDetRng13 = 0;
  @CAN_RadarRL::RRL_Object::RRL_Object_SpiHdr_FovRtrAzDetRng14 = 0;
  @CAN_RadarRL::RRL_Object::RRL_Object_SpiHdr_FovRtrAzDetRng15 = 0;
  @CAN_RadarRL::RRL_Object::RRL_Object_SpiHdr_FovRtrAzDetRng16 = 0;
  @CAN_RadarRL::RRL_Object::RRL_Object_SpiHdr_FovRtrAzDetRng17 = 0;
  }
  if(init_count == 84)
  {
  @CAN_RadarRL::RRL_Object::RRL_Object_SpiHdr_FovRtrAzDetRng18 = 0;
  @CAN_RadarRL::RRL_Object::RRL_Object_SpiHdr_FovRtrAzDetRng19 = 0;
  @CAN_RadarRL::RRL_Object::RRL_Object_SpiHdr_FovRtrAzDetRng20 = 0;
  @CAN_RadarRL::RRL_Object::RRL_Object_SpiHdr_FovRtrAzDetRng21 = 0;
  @CAN_RadarRL::RRL_Object::RRL_Object_SpiHdr_FovRtrAzDetRng22 = 0;
  @CAN_RadarRL::RRL_Object::RRL_Object_SpiHdr_FovRtrAzDetRng23 = 0;
  @CAN_RadarRL::RRL_Object::RRL_Object_SpiHdr_FovRtrAzDetRng24 = 0;
  @CAN_RadarRL::RRL_Object::RRL_Object_SpiHdr_FovRtrAzSegBrdr00 = 0;
  @CAN_RadarRL::RRL_Object::RRL_Object_SpiHdr_FovRtrAzSegBrdr01 = 0;
  @CAN_RadarRL::RRL_Object::RRL_Object_SpiHdr_FovRtrAzSegBrdr02 = 0;
  @CAN_RadarRL::RRL_Object::RRL_Object_SpiHdr_FovRtrAzSegBrdr03 = 0;
  @CAN_RadarRL::RRL_Object::RRL_Object_SpiHdr_FovRtrAzSegBrdr04 = 0;
  @CAN_RadarRL::RRL_Object::RRL_Object_SpiHdr_FovRtrAzSegBrdr05 = 0;
  @CAN_RadarRL::RRL_Object::RRL_Object_SpiHdr_FovRtrAzSegBrdr06 = 0;
  @CAN_RadarRL::RRL_Object::RRL_Object_SpiHdr_FovRtrAzSegBrdr07 = 0;
  @CAN_RadarRL::RRL_Object::RRL_Object_SpiHdr_FovRtrAzSegBrdr08 = 0;
  @CAN_RadarRL::RRL_Object::RRL_Object_SpiHdr_FovRtrAzSegBrdr09 = 0;
  @CAN_RadarRL::RRL_Object::RRL_Object_SpiHdr_FovRtrAzSegBrdr10 = 0;
  @CAN_RadarRL::RRL_Object::RRL_Object_SpiHdr_FovRtrAzSegBrdr11 = 0;
  @CAN_RadarRL::RRL_Object::RRL_Object_SpiHdr_FovRtrAzSegBrdr12 = 0;
  @CAN_RadarRL::RRL_Object::RRL_Object_SpiHdr_FovRtrAzSegBrdr13 = 0;
  @CAN_RadarRL::RRL_Object::RRL_Object_SpiHdr_FovRtrAzSegBrdr14 = 0;
  @CAN_RadarRL::RRL_Object::RRL_Object_SpiHdr_FovRtrAzSegBrdr15 = 0;
  @CAN_RadarRL::RRL_Object::RRL_Object_SpiHdr_FovRtrAzSegBrdr16 = 0;
  @CAN_RadarRL::RRL_Object::RRL_Object_SpiHdr_FovRtrAzSegBrdr17 = 0;
  }
  if(init_count == 85)
  {
  @CAN_RadarRL::RRL_Object::RRL_Object_SpiHdr_FovRtrAzSegBrdr18 = 0;
  @CAN_RadarRL::RRL_Object::RRL_Object_SpiHdr_FovRtrAzSegBrdr19 = 0;
  @CAN_RadarRL::RRL_Object::RRL_Object_SpiHdr_FovRtrAzSegBrdr20 = 0;
  @CAN_RadarRL::RRL_Object::RRL_Object_SpiHdr_FovRtrAzSegBrdr21 = 0;
  @CAN_RadarRL::RRL_Object::RRL_Object_SpiHdr_FovRtrAzSegBrdr22 = 0;
  @CAN_RadarRL::RRL_Object::RRL_Object_SpiHdr_FovRtrAzSegBrdr23 = 0;
  @CAN_RadarRL::RRL_Object::RRL_Object_SpiHdr_FovRtrAzSegBrdr24 = 0;
  @CAN_RadarRL::RRL_Object::RRL_Object_SpiHdr_FovRtrElRngGEnd00 = 0;
  @CAN_RadarRL::RRL_Object::RRL_Object_SpiHdr_FovRtrElRngGEnd01 = 0;
  @CAN_RadarRL::RRL_Object::RRL_Object_SpiHdr_FovRtrElRngGEnd02 = 0;
  @CAN_RadarRL::RRL_Object::RRL_Object_SpiHdr_FovRtrElRngGEnd03 = 0;
  @CAN_RadarRL::RRL_Object::RRL_Object_SpiHdr_FovRtrElRngGEnd04 = 0;
  @CAN_RadarRL::RRL_Object::RRL_Object_SpiHdr_FovRtrElRngGEnd05 = 0;
  @CAN_RadarRL::RRL_Object::RRL_Object_SpiHdr_FovRtrElRngGEnd06 = 0;
  @CAN_RadarRL::RRL_Object::RRL_Object_SpiHdr_FovRtrElRngGEnd07 = 0;
  @CAN_RadarRL::RRL_Object::RRL_Object_SpiHdr_FovRtrElRngGEnd08 = 0;
  @CAN_RadarRL::RRL_Object::RRL_Object_SpiHdr_FovRtrElRngGEnd09 = 0;
  @CAN_RadarRL::RRL_Object::RRL_Object_SpiHdr_FovRtrElRngGEnd10 = 0;
  @CAN_RadarRL::RRL_Object::RRL_Object_SpiHdr_FovRtrElSegBrdr00 = 0;
  @CAN_RadarRL::RRL_Object::RRL_Object_SpiHdr_FovRtrElSegBrdr01 = 0;
  @CAN_RadarRL::RRL_Object::RRL_Object_SpiHdr_FovRtrElSegBrdr02 = 0;
  @CAN_RadarRL::RRL_Object::RRL_Object_SpiHdr_FovRtrElSegBrdr03 = 0;
  @CAN_RadarRL::RRL_Object::RRL_Object_SpiHdr_FovRtrElSegBrdr04 = 0;
  @CAN_RadarRL::RRL_Object::RRL_Object_SpiHdr_FovRtrElSegBrdr05 = 0;
  @CAN_RadarRL::RRL_Object::RRL_Object_SpiHdr_FovRtrElSegBrdr06 = 0;
  }
  if(init_count == 86)
  {
  @CAN_RadarRL::RRL_Object::RRL_Object_SpiHdr_FovRtrElSegBrdr07 = 0;
  @CAN_RadarRL::RRL_Object::RRL_Object_SpiHdr_FovRtrElSegBrdr08 = 0;
  @CAN_RadarRL::RRL_Object::RRL_Object_SpiHdr_FovRtrElSegBrdr09 = 0;
  @CAN_RadarRL::RRL_Object::RRL_Object_SpiHdr_FovRtrElSegBrdr10 = 0;
  @CAN_RadarRL::RRL_Object::RRL_Object_SpiHdr_ModId = 0;
  @CAN_RadarRL::RRL_Object::RRL_Object_SpiHdr_RngGainRfInterfere = 0;
  @CAN_RadarRL::RRL_Object::RRL_Object_SpiHdr_SensorExtDisturbed = 0;
  @CAN_RadarRL::RRL_Object::RRL_Object_SpiHdr_SensorOrientPitch = 0;
  @CAN_RadarRL::RRL_Object::RRL_Object_SpiHdr_SensorOrientYaw = 0;
  @CAN_RadarRL::RRL_Object::RRL_Object_SpiHdr_SensorOrientation = 0;
  @CAN_RadarRL::RRL_Object::RRL_Object_SpiHdr_SensorOriginPointX = 0;
  @CAN_RadarRL::RRL_Object::RRL_Object_SpiHdr_SensorOriginPointY = 0;
  @CAN_RadarRL::RRL_Object::RRL_Object_SpiHdr_SensorOriginPointZ = 0;
  @CAN_RadarRL::RRL_Object::RRL_Object_SpiHdr_VelMeasMax = 0;
  @CAN_RadarRL::RRL_Object::RRL_Object_SpiHdr_VelMeasMin = 0;
  @CAN_RadarRL::RRL_Object::RRL_Object_SpiHdr_VelPrec = 0;
  @CAN_RadarRL::RRL_Object::RRL_Object_SpiHdr_VelSep = 0;
  sysSetVariableData(sysvar::CAN_RadarRL::RRL_RoadSideBoundaries::RRL_RoadSideBoundaries::SignalValue, RRL_RoadSideBoundaries_byte_Array, 1000);
  $CAN_RadarRL::RRL_SensorOutput::RRL_Veh_SenOut_VehConfParamStatus = 0;
  if (prestart_mode==0) init_count = 0;
  initFlag = 12;
  }
  init_count++;
}
void init_CRadarRR_F150_OD()
{
  if(init_count == 1)
  {
  $CAN_RadarRR::RRR_CornerFunctions::RRR_CF_AEx_revEgoBrakingStatus = 0;
  $CAN_RadarRR::RRR_CornerFunctions::RRR_CF_AEx_revEgoWarnStatus = 0;
  $CAN_RadarRR::RRR_CornerFunctions::RRR_CF_AEx_revEgo_BrakeRequest = 0;
  $CAN_RadarRR::RRR_CornerFunctions::RRR_CF_AEx_revEgo_TargetDec = 0;
  $CAN_RadarRR::RRR_CornerFunctions::RRR_CF_AEx_revEgo_WarningLevel = 0;
  $CAN_RadarRR::RRR_CornerFunctions::RRR_CF_BsdLca_Status = 0;
  $CAN_RadarRR::RRR_CornerFunctions::RRR_CF_BsdLca_WarningLevel = 0;
  $CAN_RadarRR::RRR_CornerFunctions::RRR_CF_DOx_PrevStatus = 0;
  $CAN_RadarRR::RRR_CornerFunctions::RRR_CF_DOx_WarnStatus = 0;
  $CAN_RadarRR::RRR_CornerFunctions::RRR_CF_DOx_WarningLevel = 0;
  sysSetVariableData(sysvar::CAN_RadarRR::RRR_FieldDataCollection::RRR_FieldDataCollection::SignalValue, RRR_FieldDataCollection_byte_Array, 5000);
  @CAN_RadarRR::RRR_Object::RRR_Object_E2E_p44_dataId = 0;
  @CAN_RadarRR::RRR_Object::RRR_Object_E2E_p44_length = 0;
  @CAN_RadarRR::RRR_Object::RRR_Object_Obj10.Age = 0;
  @CAN_RadarRR::RRR_Object::RRR_Object_Obj10.Ax = 0;
  @CAN_RadarRR::RRR_Object::RRR_Object_Obj10.AxAyCoVnce = 0;
  @CAN_RadarRR::RRR_Object::RRR_Object_Obj10.AxVnce = 0;
  @CAN_RadarRR::RRR_Object::RRR_Object_Obj10.Ay = 0;
  @CAN_RadarRR::RRR_Object::RRR_Object_Obj10.AyVnce = 0;
  @CAN_RadarRR::RRR_Object::RRR_Object_Obj10.ExistProb = 0;
  @CAN_RadarRR::RRR_Object::RRR_Object_Obj10.FilterInformation = 0;
  @CAN_RadarRR::RRR_Object::RRR_Object_Obj10.Length = 0;
  @CAN_RadarRR::RRR_Object::RRR_Object_Obj10.LengthVnce = 0;
  @CAN_RadarRR::RRR_Object::RRR_Object_Obj10.MeasurementStatus = 0;
  @CAN_RadarRR::RRR_Object::RRR_Object_Obj10.MovingStatus = 0;
  }
  if(init_count == 2)
  {
  @CAN_RadarRR::RRR_Object::RRR_Object_Obj10.ObjId = 0;
  @CAN_RadarRR::RRR_Object::RRR_Object_Obj10.OrientationYaw = 0;
  @CAN_RadarRR::RRR_Object::RRR_Object_Obj10.OrientationYawVnce = 0;
  @CAN_RadarRR::RRR_Object::RRR_Object_Obj10.ProbClassConfidence = 0;
  @CAN_RadarRR::RRR_Object::RRR_Object_Obj10.ProbClassType = 0;
  @CAN_RadarRR::RRR_Object::RRR_Object_Obj10.Px = 0;
  @CAN_RadarRR::RRR_Object::RRR_Object_Obj10.PxAxCoVnce = 0;
  @CAN_RadarRR::RRR_Object::RRR_Object_Obj10.PxAyCoVnce = 0;
  @CAN_RadarRR::RRR_Object::RRR_Object_Obj10.PxPyCoVnce = 0;
  @CAN_RadarRR::RRR_Object::RRR_Object_Obj10.PxVnce = 0;
  @CAN_RadarRR::RRR_Object::RRR_Object_Obj10.PxVxCoVnce = 0;
  @CAN_RadarRR::RRR_Object::RRR_Object_Obj10.PxVyCoVnce = 0;
  @CAN_RadarRR::RRR_Object::RRR_Object_Obj10.Py = 0;
  @CAN_RadarRR::RRR_Object::RRR_Object_Obj10.PyAxCoVnce = 0;
  @CAN_RadarRR::RRR_Object::RRR_Object_Obj10.PyAyCoVnce = 0;
  @CAN_RadarRR::RRR_Object::RRR_Object_Obj10.PyVnce = 0;
  @CAN_RadarRR::RRR_Object::RRR_Object_Obj10.PyVxCoVnce = 0;
  @CAN_RadarRR::RRR_Object::RRR_Object_Obj10.PyVyCoVnce = 0;
  @CAN_RadarRR::RRR_Object::RRR_Object_Obj10.ReferencePoint = 0;
  @CAN_RadarRR::RRR_Object::RRR_Object_Obj10.Vx = 0;
  @CAN_RadarRR::RRR_Object::RRR_Object_Obj10.VxAxCoVnce = 0;
  @CAN_RadarRR::RRR_Object::RRR_Object_Obj10.VxAyCoVnce = 0;
  @CAN_RadarRR::RRR_Object::RRR_Object_Obj10.VxVnce = 0;
  @CAN_RadarRR::RRR_Object::RRR_Object_Obj10.VxVyCoVnce = 0;
  @CAN_RadarRR::RRR_Object::RRR_Object_Obj10.Vy = 0;
  }
  if(init_count == 3)
  {
  @CAN_RadarRR::RRR_Object::RRR_Object_Obj10.VyAxCoVnce = 0;
  @CAN_RadarRR::RRR_Object::RRR_Object_Obj10.VyAyCoVnce = 0;
  @CAN_RadarRR::RRR_Object::RRR_Object_Obj10.VyVnce = 0;
  @CAN_RadarRR::RRR_Object::RRR_Object_Obj10.Width = 0;
  @CAN_RadarRR::RRR_Object::RRR_Object_Obj10.WidthVnce = 0;
  @CAN_RadarRR::RRR_Object::RRR_Object_Obj11.Age = 0;
  @CAN_RadarRR::RRR_Object::RRR_Object_Obj11.Ax = 0;
  @CAN_RadarRR::RRR_Object::RRR_Object_Obj11.AxAyCoVnce = 0;
  @CAN_RadarRR::RRR_Object::RRR_Object_Obj11.AxVnce = 0;
  @CAN_RadarRR::RRR_Object::RRR_Object_Obj11.Ay = 0;
  @CAN_RadarRR::RRR_Object::RRR_Object_Obj11.AyVnce = 0;
  @CAN_RadarRR::RRR_Object::RRR_Object_Obj11.ExistProb = 0;
  @CAN_RadarRR::RRR_Object::RRR_Object_Obj11.FilterInformation = 0;
  @CAN_RadarRR::RRR_Object::RRR_Object_Obj11.Length = 0;
  @CAN_RadarRR::RRR_Object::RRR_Object_Obj11.LengthVnce = 0;
  @CAN_RadarRR::RRR_Object::RRR_Object_Obj11.MeasurementStatus = 0;
  @CAN_RadarRR::RRR_Object::RRR_Object_Obj11.MovingStatus = 0;
  @CAN_RadarRR::RRR_Object::RRR_Object_Obj11.ObjId = 0;
  @CAN_RadarRR::RRR_Object::RRR_Object_Obj11.OrientationYaw = 0;
  @CAN_RadarRR::RRR_Object::RRR_Object_Obj11.OrientationYawVnce = 0;
  @CAN_RadarRR::RRR_Object::RRR_Object_Obj11.ProbClassConfidence = 0;
  @CAN_RadarRR::RRR_Object::RRR_Object_Obj11.ProbClassType = 0;
  @CAN_RadarRR::RRR_Object::RRR_Object_Obj11.Px = 0;
  @CAN_RadarRR::RRR_Object::RRR_Object_Obj11.PxAxCoVnce = 0;
  @CAN_RadarRR::RRR_Object::RRR_Object_Obj11.PxAyCoVnce = 0;
  }
  if(init_count == 4)
  {
  @CAN_RadarRR::RRR_Object::RRR_Object_Obj11.PxPyCoVnce = 0;
  @CAN_RadarRR::RRR_Object::RRR_Object_Obj11.PxVnce = 0;
  @CAN_RadarRR::RRR_Object::RRR_Object_Obj11.PxVxCoVnce = 0;
  @CAN_RadarRR::RRR_Object::RRR_Object_Obj11.PxVyCoVnce = 0;
  @CAN_RadarRR::RRR_Object::RRR_Object_Obj11.Py = 0;
  @CAN_RadarRR::RRR_Object::RRR_Object_Obj11.PyAxCoVnce = 0;
  @CAN_RadarRR::RRR_Object::RRR_Object_Obj11.PyAyCoVnce = 0;
  @CAN_RadarRR::RRR_Object::RRR_Object_Obj11.PyVnce = 0;
  @CAN_RadarRR::RRR_Object::RRR_Object_Obj11.PyVxCoVnce = 0;
  @CAN_RadarRR::RRR_Object::RRR_Object_Obj11.PyVyCoVnce = 0;
  @CAN_RadarRR::RRR_Object::RRR_Object_Obj11.ReferencePoint = 0;
  @CAN_RadarRR::RRR_Object::RRR_Object_Obj11.Vx = 0;
  @CAN_RadarRR::RRR_Object::RRR_Object_Obj11.VxAxCoVnce = 0;
  @CAN_RadarRR::RRR_Object::RRR_Object_Obj11.VxAyCoVnce = 0;
  @CAN_RadarRR::RRR_Object::RRR_Object_Obj11.VxVnce = 0;
  @CAN_RadarRR::RRR_Object::RRR_Object_Obj11.VxVyCoVnce = 0;
  @CAN_RadarRR::RRR_Object::RRR_Object_Obj11.Vy = 0;
  @CAN_RadarRR::RRR_Object::RRR_Object_Obj11.VyAxCoVnce = 0;
  @CAN_RadarRR::RRR_Object::RRR_Object_Obj11.VyAyCoVnce = 0;
  @CAN_RadarRR::RRR_Object::RRR_Object_Obj11.VyVnce = 0;
  @CAN_RadarRR::RRR_Object::RRR_Object_Obj11.Width = 0;
  @CAN_RadarRR::RRR_Object::RRR_Object_Obj11.WidthVnce = 0;
  @CAN_RadarRR::RRR_Object::RRR_Object_Obj12.Age = 0;
  @CAN_RadarRR::RRR_Object::RRR_Object_Obj12.Ax = 0;
  @CAN_RadarRR::RRR_Object::RRR_Object_Obj12.AxAyCoVnce = 0;
  }
  if(init_count == 5)
  {
  @CAN_RadarRR::RRR_Object::RRR_Object_Obj12.AxVnce = 0;
  @CAN_RadarRR::RRR_Object::RRR_Object_Obj12.Ay = 0;
  @CAN_RadarRR::RRR_Object::RRR_Object_Obj12.AyVnce = 0;
  @CAN_RadarRR::RRR_Object::RRR_Object_Obj12.ExistProb = 0;
  @CAN_RadarRR::RRR_Object::RRR_Object_Obj12.FilterInformation = 0;
  @CAN_RadarRR::RRR_Object::RRR_Object_Obj12.Length = 0;
  @CAN_RadarRR::RRR_Object::RRR_Object_Obj12.LengthVnce = 0;
  @CAN_RadarRR::RRR_Object::RRR_Object_Obj12.MeasurementStatus = 0;
  @CAN_RadarRR::RRR_Object::RRR_Object_Obj12.MovingStatus = 0;
  @CAN_RadarRR::RRR_Object::RRR_Object_Obj12.ObjId = 0;
  @CAN_RadarRR::RRR_Object::RRR_Object_Obj12.OrientationYaw = 0;
  @CAN_RadarRR::RRR_Object::RRR_Object_Obj12.OrientationYawVnce = 0;
  @CAN_RadarRR::RRR_Object::RRR_Object_Obj12.ProbClassConfidence = 0;
  @CAN_RadarRR::RRR_Object::RRR_Object_Obj12.ProbClassType = 0;
  @CAN_RadarRR::RRR_Object::RRR_Object_Obj12.Px = 0;
  @CAN_RadarRR::RRR_Object::RRR_Object_Obj12.PxAxCoVnce = 0;
  @CAN_RadarRR::RRR_Object::RRR_Object_Obj12.PxAyCoVnce = 0;
  @CAN_RadarRR::RRR_Object::RRR_Object_Obj12.PxPyCoVnce = 0;
  @CAN_RadarRR::RRR_Object::RRR_Object_Obj12.PxVnce = 0;
  @CAN_RadarRR::RRR_Object::RRR_Object_Obj12.PxVxCoVnce = 0;
  @CAN_RadarRR::RRR_Object::RRR_Object_Obj12.PxVyCoVnce = 0;
  @CAN_RadarRR::RRR_Object::RRR_Object_Obj12.Py = 0;
  @CAN_RadarRR::RRR_Object::RRR_Object_Obj12.PyAxCoVnce = 0;
  @CAN_RadarRR::RRR_Object::RRR_Object_Obj12.PyAyCoVnce = 0;
  @CAN_RadarRR::RRR_Object::RRR_Object_Obj12.PyVnce = 0;
  }
  if(init_count == 6)
  {
  @CAN_RadarRR::RRR_Object::RRR_Object_Obj12.PyVxCoVnce = 0;
  @CAN_RadarRR::RRR_Object::RRR_Object_Obj12.PyVyCoVnce = 0;
  @CAN_RadarRR::RRR_Object::RRR_Object_Obj12.ReferencePoint = 0;
  @CAN_RadarRR::RRR_Object::RRR_Object_Obj12.Vx = 0;
  @CAN_RadarRR::RRR_Object::RRR_Object_Obj12.VxAxCoVnce = 0;
  @CAN_RadarRR::RRR_Object::RRR_Object_Obj12.VxAyCoVnce = 0;
  @CAN_RadarRR::RRR_Object::RRR_Object_Obj12.VxVnce = 0;
  @CAN_RadarRR::RRR_Object::RRR_Object_Obj12.VxVyCoVnce = 0;
  @CAN_RadarRR::RRR_Object::RRR_Object_Obj12.Vy = 0;
  @CAN_RadarRR::RRR_Object::RRR_Object_Obj12.VyAxCoVnce = 0;
  @CAN_RadarRR::RRR_Object::RRR_Object_Obj12.VyAyCoVnce = 0;
  @CAN_RadarRR::RRR_Object::RRR_Object_Obj12.VyVnce = 0;
  @CAN_RadarRR::RRR_Object::RRR_Object_Obj12.Width = 0;
  @CAN_RadarRR::RRR_Object::RRR_Object_Obj12.WidthVnce = 0;
  @CAN_RadarRR::RRR_Object::RRR_Object_Obj13.Age = 0;
  @CAN_RadarRR::RRR_Object::RRR_Object_Obj13.Ax = 0;
  @CAN_RadarRR::RRR_Object::RRR_Object_Obj13.AxAyCoVnce = 0;
  @CAN_RadarRR::RRR_Object::RRR_Object_Obj13.AxVnce = 0;
  @CAN_RadarRR::RRR_Object::RRR_Object_Obj13.Ay = 0;
  @CAN_RadarRR::RRR_Object::RRR_Object_Obj13.AyVnce = 0;
  @CAN_RadarRR::RRR_Object::RRR_Object_Obj13.ExistProb = 0;
  @CAN_RadarRR::RRR_Object::RRR_Object_Obj13.FilterInformation = 0;
  @CAN_RadarRR::RRR_Object::RRR_Object_Obj13.Length = 0;
  @CAN_RadarRR::RRR_Object::RRR_Object_Obj13.LengthVnce = 0;
  @CAN_RadarRR::RRR_Object::RRR_Object_Obj13.MeasurementStatus = 0;
  }
  if(init_count == 7)
  {
  @CAN_RadarRR::RRR_Object::RRR_Object_Obj13.MovingStatus = 0;
  @CAN_RadarRR::RRR_Object::RRR_Object_Obj13.ObjId = 0;
  @CAN_RadarRR::RRR_Object::RRR_Object_Obj13.OrientationYaw = 0;
  @CAN_RadarRR::RRR_Object::RRR_Object_Obj13.OrientationYawVnce = 0;
  @CAN_RadarRR::RRR_Object::RRR_Object_Obj13.ProbClassConfidence = 0;
  @CAN_RadarRR::RRR_Object::RRR_Object_Obj13.ProbClassType = 0;
  @CAN_RadarRR::RRR_Object::RRR_Object_Obj13.Px = 0;
  @CAN_RadarRR::RRR_Object::RRR_Object_Obj13.PxAxCoVnce = 0;
  @CAN_RadarRR::RRR_Object::RRR_Object_Obj13.PxAyCoVnce = 0;
  @CAN_RadarRR::RRR_Object::RRR_Object_Obj13.PxPyCoVnce = 0;
  @CAN_RadarRR::RRR_Object::RRR_Object_Obj13.PxVnce = 0;
  @CAN_RadarRR::RRR_Object::RRR_Object_Obj13.PxVxCoVnce = 0;
  @CAN_RadarRR::RRR_Object::RRR_Object_Obj13.PxVyCoVnce = 0;
  @CAN_RadarRR::RRR_Object::RRR_Object_Obj13.Py = 0;
  @CAN_RadarRR::RRR_Object::RRR_Object_Obj13.PyAxCoVnce = 0;
  @CAN_RadarRR::RRR_Object::RRR_Object_Obj13.PyAyCoVnce = 0;
  @CAN_RadarRR::RRR_Object::RRR_Object_Obj13.PyVnce = 0;
  @CAN_RadarRR::RRR_Object::RRR_Object_Obj13.PyVxCoVnce = 0;
  @CAN_RadarRR::RRR_Object::RRR_Object_Obj13.PyVyCoVnce = 0;
  @CAN_RadarRR::RRR_Object::RRR_Object_Obj13.ReferencePoint = 0;
  @CAN_RadarRR::RRR_Object::RRR_Object_Obj13.Vx = 0;
  @CAN_RadarRR::RRR_Object::RRR_Object_Obj13.VxAxCoVnce = 0;
  @CAN_RadarRR::RRR_Object::RRR_Object_Obj13.VxAyCoVnce = 0;
  @CAN_RadarRR::RRR_Object::RRR_Object_Obj13.VxVnce = 0;
  @CAN_RadarRR::RRR_Object::RRR_Object_Obj13.VxVyCoVnce = 0;
  }
  if(init_count == 8)
  {
  @CAN_RadarRR::RRR_Object::RRR_Object_Obj13.Vy = 0;
  @CAN_RadarRR::RRR_Object::RRR_Object_Obj13.VyAxCoVnce = 0;
  @CAN_RadarRR::RRR_Object::RRR_Object_Obj13.VyAyCoVnce = 0;
  @CAN_RadarRR::RRR_Object::RRR_Object_Obj13.VyVnce = 0;
  @CAN_RadarRR::RRR_Object::RRR_Object_Obj13.Width = 0;
  @CAN_RadarRR::RRR_Object::RRR_Object_Obj13.WidthVnce = 0;
  @CAN_RadarRR::RRR_Object::RRR_Object_Obj14.Age = 0;
  @CAN_RadarRR::RRR_Object::RRR_Object_Obj14.Ax = 0;
  @CAN_RadarRR::RRR_Object::RRR_Object_Obj14.AxAyCoVnce = 0;
  @CAN_RadarRR::RRR_Object::RRR_Object_Obj14.AxVnce = 0;
  @CAN_RadarRR::RRR_Object::RRR_Object_Obj14.Ay = 0;
  @CAN_RadarRR::RRR_Object::RRR_Object_Obj14.AyVnce = 0;
  @CAN_RadarRR::RRR_Object::RRR_Object_Obj14.ExistProb = 0;
  @CAN_RadarRR::RRR_Object::RRR_Object_Obj14.FilterInformation = 0;
  @CAN_RadarRR::RRR_Object::RRR_Object_Obj14.Length = 0;
  @CAN_RadarRR::RRR_Object::RRR_Object_Obj14.LengthVnce = 0;
  @CAN_RadarRR::RRR_Object::RRR_Object_Obj14.MeasurementStatus = 0;
  @CAN_RadarRR::RRR_Object::RRR_Object_Obj14.MovingStatus = 0;
  @CAN_RadarRR::RRR_Object::RRR_Object_Obj14.ObjId = 0;
  @CAN_RadarRR::RRR_Object::RRR_Object_Obj14.OrientationYaw = 0;
  @CAN_RadarRR::RRR_Object::RRR_Object_Obj14.OrientationYawVnce = 0;
  @CAN_RadarRR::RRR_Object::RRR_Object_Obj14.ProbClassConfidence = 0;
  @CAN_RadarRR::RRR_Object::RRR_Object_Obj14.ProbClassType = 0;
  @CAN_RadarRR::RRR_Object::RRR_Object_Obj14.Px = 0;
  @CAN_RadarRR::RRR_Object::RRR_Object_Obj14.PxAxCoVnce = 0;
  }
  if(init_count == 9)
  {
  @CAN_RadarRR::RRR_Object::RRR_Object_Obj14.PxAyCoVnce = 0;
  @CAN_RadarRR::RRR_Object::RRR_Object_Obj14.PxPyCoVnce = 0;
  @CAN_RadarRR::RRR_Object::RRR_Object_Obj14.PxVnce = 0;
  @CAN_RadarRR::RRR_Object::RRR_Object_Obj14.PxVxCoVnce = 0;
  @CAN_RadarRR::RRR_Object::RRR_Object_Obj14.PxVyCoVnce = 0;
  @CAN_RadarRR::RRR_Object::RRR_Object_Obj14.Py = 0;
  @CAN_RadarRR::RRR_Object::RRR_Object_Obj14.PyAxCoVnce = 0;
  @CAN_RadarRR::RRR_Object::RRR_Object_Obj14.PyAyCoVnce = 0;
  @CAN_RadarRR::RRR_Object::RRR_Object_Obj14.PyVnce = 0;
  @CAN_RadarRR::RRR_Object::RRR_Object_Obj14.PyVxCoVnce = 0;
  @CAN_RadarRR::RRR_Object::RRR_Object_Obj14.PyVyCoVnce = 0;
  @CAN_RadarRR::RRR_Object::RRR_Object_Obj14.ReferencePoint = 0;
  @CAN_RadarRR::RRR_Object::RRR_Object_Obj14.Vx = 0;
  @CAN_RadarRR::RRR_Object::RRR_Object_Obj14.VxAxCoVnce = 0;
  @CAN_RadarRR::RRR_Object::RRR_Object_Obj14.VxAyCoVnce = 0;
  @CAN_RadarRR::RRR_Object::RRR_Object_Obj14.VxVnce = 0;
  @CAN_RadarRR::RRR_Object::RRR_Object_Obj14.VxVyCoVnce = 0;
  @CAN_RadarRR::RRR_Object::RRR_Object_Obj14.Vy = 0;
  @CAN_RadarRR::RRR_Object::RRR_Object_Obj14.VyAxCoVnce = 0;
  @CAN_RadarRR::RRR_Object::RRR_Object_Obj14.VyAyCoVnce = 0;
  @CAN_RadarRR::RRR_Object::RRR_Object_Obj14.VyVnce = 0;
  @CAN_RadarRR::RRR_Object::RRR_Object_Obj14.Width = 0;
  @CAN_RadarRR::RRR_Object::RRR_Object_Obj14.WidthVnce = 0;
  @CAN_RadarRR::RRR_Object::RRR_Object_Obj15.Age = 0;
  @CAN_RadarRR::RRR_Object::RRR_Object_Obj15.Ax = 0;
  }
  if(init_count == 10)
  {
  @CAN_RadarRR::RRR_Object::RRR_Object_Obj15.AxAyCoVnce = 0;
  @CAN_RadarRR::RRR_Object::RRR_Object_Obj15.AxVnce = 0;
  @CAN_RadarRR::RRR_Object::RRR_Object_Obj15.Ay = 0;
  @CAN_RadarRR::RRR_Object::RRR_Object_Obj15.AyVnce = 0;
  @CAN_RadarRR::RRR_Object::RRR_Object_Obj15.ExistProb = 0;
  @CAN_RadarRR::RRR_Object::RRR_Object_Obj15.FilterInformation = 0;
  @CAN_RadarRR::RRR_Object::RRR_Object_Obj15.Length = 0;
  @CAN_RadarRR::RRR_Object::RRR_Object_Obj15.LengthVnce = 0;
  @CAN_RadarRR::RRR_Object::RRR_Object_Obj15.MeasurementStatus = 0;
  @CAN_RadarRR::RRR_Object::RRR_Object_Obj15.MovingStatus = 0;
  @CAN_RadarRR::RRR_Object::RRR_Object_Obj15.ObjId = 0;
  @CAN_RadarRR::RRR_Object::RRR_Object_Obj15.OrientationYaw = 0;
  @CAN_RadarRR::RRR_Object::RRR_Object_Obj15.OrientationYawVnce = 0;
  @CAN_RadarRR::RRR_Object::RRR_Object_Obj15.ProbClassConfidence = 0;
  @CAN_RadarRR::RRR_Object::RRR_Object_Obj15.ProbClassType = 0;
  @CAN_RadarRR::RRR_Object::RRR_Object_Obj15.Px = 0;
  @CAN_RadarRR::RRR_Object::RRR_Object_Obj15.PxAxCoVnce = 0;
  @CAN_RadarRR::RRR_Object::RRR_Object_Obj15.PxAyCoVnce = 0;
  @CAN_RadarRR::RRR_Object::RRR_Object_Obj15.PxPyCoVnce = 0;
  @CAN_RadarRR::RRR_Object::RRR_Object_Obj15.PxVnce = 0;
  @CAN_RadarRR::RRR_Object::RRR_Object_Obj15.PxVxCoVnce = 0;
  @CAN_RadarRR::RRR_Object::RRR_Object_Obj15.PxVyCoVnce = 0;
  @CAN_RadarRR::RRR_Object::RRR_Object_Obj15.Py = 0;
  @CAN_RadarRR::RRR_Object::RRR_Object_Obj15.PyAxCoVnce = 0;
  @CAN_RadarRR::RRR_Object::RRR_Object_Obj15.PyAyCoVnce = 0;
  }
  if(init_count == 11)
  {
  @CAN_RadarRR::RRR_Object::RRR_Object_Obj15.PyVnce = 0;
  @CAN_RadarRR::RRR_Object::RRR_Object_Obj15.PyVxCoVnce = 0;
  @CAN_RadarRR::RRR_Object::RRR_Object_Obj15.PyVyCoVnce = 0;
  @CAN_RadarRR::RRR_Object::RRR_Object_Obj15.ReferencePoint = 0;
  @CAN_RadarRR::RRR_Object::RRR_Object_Obj15.Vx = 0;
  @CAN_RadarRR::RRR_Object::RRR_Object_Obj15.VxAxCoVnce = 0;
  @CAN_RadarRR::RRR_Object::RRR_Object_Obj15.VxAyCoVnce = 0;
  @CAN_RadarRR::RRR_Object::RRR_Object_Obj15.VxVnce = 0;
  @CAN_RadarRR::RRR_Object::RRR_Object_Obj15.VxVyCoVnce = 0;
  @CAN_RadarRR::RRR_Object::RRR_Object_Obj15.Vy = 0;
  @CAN_RadarRR::RRR_Object::RRR_Object_Obj15.VyAxCoVnce = 0;
  @CAN_RadarRR::RRR_Object::RRR_Object_Obj15.VyAyCoVnce = 0;
  @CAN_RadarRR::RRR_Object::RRR_Object_Obj15.VyVnce = 0;
  @CAN_RadarRR::RRR_Object::RRR_Object_Obj15.Width = 0;
  @CAN_RadarRR::RRR_Object::RRR_Object_Obj15.WidthVnce = 0;
  @CAN_RadarRR::RRR_Object::RRR_Object_Obj16.Age = 0;
  @CAN_RadarRR::RRR_Object::RRR_Object_Obj16.Ax = 0;
  @CAN_RadarRR::RRR_Object::RRR_Object_Obj16.AxAyCoVnce = 0;
  @CAN_RadarRR::RRR_Object::RRR_Object_Obj16.AxVnce = 0;
  @CAN_RadarRR::RRR_Object::RRR_Object_Obj16.Ay = 0;
  @CAN_RadarRR::RRR_Object::RRR_Object_Obj16.AyVnce = 0;
  @CAN_RadarRR::RRR_Object::RRR_Object_Obj16.ExistProb = 0;
  @CAN_RadarRR::RRR_Object::RRR_Object_Obj16.FilterInformation = 0;
  @CAN_RadarRR::RRR_Object::RRR_Object_Obj16.Length = 0;
  @CAN_RadarRR::RRR_Object::RRR_Object_Obj16.LengthVnce = 0;
  }
  if(init_count == 12)
  {
  @CAN_RadarRR::RRR_Object::RRR_Object_Obj16.MeasurementStatus = 0;
  @CAN_RadarRR::RRR_Object::RRR_Object_Obj16.MovingStatus = 0;
  @CAN_RadarRR::RRR_Object::RRR_Object_Obj16.ObjId = 0;
  @CAN_RadarRR::RRR_Object::RRR_Object_Obj16.OrientationYaw = 0;
  @CAN_RadarRR::RRR_Object::RRR_Object_Obj16.OrientationYawVnce = 0;
  @CAN_RadarRR::RRR_Object::RRR_Object_Obj16.ProbClassConfidence = 0;
  @CAN_RadarRR::RRR_Object::RRR_Object_Obj16.ProbClassType = 0;
  @CAN_RadarRR::RRR_Object::RRR_Object_Obj16.Px = 0;
  @CAN_RadarRR::RRR_Object::RRR_Object_Obj16.PxAxCoVnce = 0;
  @CAN_RadarRR::RRR_Object::RRR_Object_Obj16.PxAyCoVnce = 0;
  @CAN_RadarRR::RRR_Object::RRR_Object_Obj16.PxPyCoVnce = 0;
  @CAN_RadarRR::RRR_Object::RRR_Object_Obj16.PxVnce = 0;
  @CAN_RadarRR::RRR_Object::RRR_Object_Obj16.PxVxCoVnce = 0;
  @CAN_RadarRR::RRR_Object::RRR_Object_Obj16.PxVyCoVnce = 0;
  @CAN_RadarRR::RRR_Object::RRR_Object_Obj16.Py = 0;
  @CAN_RadarRR::RRR_Object::RRR_Object_Obj16.PyAxCoVnce = 0;
  @CAN_RadarRR::RRR_Object::RRR_Object_Obj16.PyAyCoVnce = 0;
  @CAN_RadarRR::RRR_Object::RRR_Object_Obj16.PyVnce = 0;
  @CAN_RadarRR::RRR_Object::RRR_Object_Obj16.PyVxCoVnce = 0;
  @CAN_RadarRR::RRR_Object::RRR_Object_Obj16.PyVyCoVnce = 0;
  @CAN_RadarRR::RRR_Object::RRR_Object_Obj16.ReferencePoint = 0;
  @CAN_RadarRR::RRR_Object::RRR_Object_Obj16.Vx = 0;
  @CAN_RadarRR::RRR_Object::RRR_Object_Obj16.VxAxCoVnce = 0;
  @CAN_RadarRR::RRR_Object::RRR_Object_Obj16.VxAyCoVnce = 0;
  @CAN_RadarRR::RRR_Object::RRR_Object_Obj16.VxVnce = 0;
  }
  if(init_count == 13)
  {
  @CAN_RadarRR::RRR_Object::RRR_Object_Obj16.VxVyCoVnce = 0;
  @CAN_RadarRR::RRR_Object::RRR_Object_Obj16.Vy = 0;
  @CAN_RadarRR::RRR_Object::RRR_Object_Obj16.VyAxCoVnce = 0;
  @CAN_RadarRR::RRR_Object::RRR_Object_Obj16.VyAyCoVnce = 0;
  @CAN_RadarRR::RRR_Object::RRR_Object_Obj16.VyVnce = 0;
  @CAN_RadarRR::RRR_Object::RRR_Object_Obj16.Width = 0;
  @CAN_RadarRR::RRR_Object::RRR_Object_Obj16.WidthVnce = 0;
  @CAN_RadarRR::RRR_Object::RRR_Object_Obj17.Age = 0;
  @CAN_RadarRR::RRR_Object::RRR_Object_Obj17.Ax = 0;
  @CAN_RadarRR::RRR_Object::RRR_Object_Obj17.AxAyCoVnce = 0;
  @CAN_RadarRR::RRR_Object::RRR_Object_Obj17.AxVnce = 0;
  @CAN_RadarRR::RRR_Object::RRR_Object_Obj17.Ay = 0;
  @CAN_RadarRR::RRR_Object::RRR_Object_Obj17.AyVnce = 0;
  @CAN_RadarRR::RRR_Object::RRR_Object_Obj17.ExistProb = 0;
  @CAN_RadarRR::RRR_Object::RRR_Object_Obj17.FilterInformation = 0;
  @CAN_RadarRR::RRR_Object::RRR_Object_Obj17.Length = 0;
  @CAN_RadarRR::RRR_Object::RRR_Object_Obj17.LengthVnce = 0;
  @CAN_RadarRR::RRR_Object::RRR_Object_Obj17.MeasurementStatus = 0;
  @CAN_RadarRR::RRR_Object::RRR_Object_Obj17.MovingStatus = 0;
  @CAN_RadarRR::RRR_Object::RRR_Object_Obj17.ObjId = 0;
  @CAN_RadarRR::RRR_Object::RRR_Object_Obj17.OrientationYaw = 0;
  @CAN_RadarRR::RRR_Object::RRR_Object_Obj17.OrientationYawVnce = 0;
  @CAN_RadarRR::RRR_Object::RRR_Object_Obj17.ProbClassConfidence = 0;
  @CAN_RadarRR::RRR_Object::RRR_Object_Obj17.ProbClassType = 0;
  @CAN_RadarRR::RRR_Object::RRR_Object_Obj17.Px = 0;
  }
  if(init_count == 14)
  {
  @CAN_RadarRR::RRR_Object::RRR_Object_Obj17.PxAxCoVnce = 0;
  @CAN_RadarRR::RRR_Object::RRR_Object_Obj17.PxAyCoVnce = 0;
  @CAN_RadarRR::RRR_Object::RRR_Object_Obj17.PxPyCoVnce = 0;
  @CAN_RadarRR::RRR_Object::RRR_Object_Obj17.PxVnce = 0;
  @CAN_RadarRR::RRR_Object::RRR_Object_Obj17.PxVxCoVnce = 0;
  @CAN_RadarRR::RRR_Object::RRR_Object_Obj17.PxVyCoVnce = 0;
  @CAN_RadarRR::RRR_Object::RRR_Object_Obj17.Py = 0;
  @CAN_RadarRR::RRR_Object::RRR_Object_Obj17.PyAxCoVnce = 0;
  @CAN_RadarRR::RRR_Object::RRR_Object_Obj17.PyAyCoVnce = 0;
  @CAN_RadarRR::RRR_Object::RRR_Object_Obj17.PyVnce = 0;
  @CAN_RadarRR::RRR_Object::RRR_Object_Obj17.PyVxCoVnce = 0;
  @CAN_RadarRR::RRR_Object::RRR_Object_Obj17.PyVyCoVnce = 0;
  @CAN_RadarRR::RRR_Object::RRR_Object_Obj17.ReferencePoint = 0;
  @CAN_RadarRR::RRR_Object::RRR_Object_Obj17.Vx = 0;
  @CAN_RadarRR::RRR_Object::RRR_Object_Obj17.VxAxCoVnce = 0;
  @CAN_RadarRR::RRR_Object::RRR_Object_Obj17.VxAyCoVnce = 0;
  @CAN_RadarRR::RRR_Object::RRR_Object_Obj17.VxVnce = 0;
  @CAN_RadarRR::RRR_Object::RRR_Object_Obj17.VxVyCoVnce = 0;
  @CAN_RadarRR::RRR_Object::RRR_Object_Obj17.Vy = 0;
  @CAN_RadarRR::RRR_Object::RRR_Object_Obj17.VyAxCoVnce = 0;
  @CAN_RadarRR::RRR_Object::RRR_Object_Obj17.VyAyCoVnce = 0;
  @CAN_RadarRR::RRR_Object::RRR_Object_Obj17.VyVnce = 0;
  @CAN_RadarRR::RRR_Object::RRR_Object_Obj17.Width = 0;
  @CAN_RadarRR::RRR_Object::RRR_Object_Obj17.WidthVnce = 0;
  @CAN_RadarRR::RRR_Object::RRR_Object_Obj18.Age = 0;
  }
  if(init_count == 15)
  {
  @CAN_RadarRR::RRR_Object::RRR_Object_Obj18.Ax = 0;
  @CAN_RadarRR::RRR_Object::RRR_Object_Obj18.AxAyCoVnce = 0;
  @CAN_RadarRR::RRR_Object::RRR_Object_Obj18.AxVnce = 0;
  @CAN_RadarRR::RRR_Object::RRR_Object_Obj18.Ay = 0;
  @CAN_RadarRR::RRR_Object::RRR_Object_Obj18.AyVnce = 0;
  @CAN_RadarRR::RRR_Object::RRR_Object_Obj18.ExistProb = 0;
  @CAN_RadarRR::RRR_Object::RRR_Object_Obj18.FilterInformation = 0;
  @CAN_RadarRR::RRR_Object::RRR_Object_Obj18.Length = 0;
  @CAN_RadarRR::RRR_Object::RRR_Object_Obj18.LengthVnce = 0;
  @CAN_RadarRR::RRR_Object::RRR_Object_Obj18.MeasurementStatus = 0;
  @CAN_RadarRR::RRR_Object::RRR_Object_Obj18.MovingStatus = 0;
  @CAN_RadarRR::RRR_Object::RRR_Object_Obj18.ObjId = 0;
  @CAN_RadarRR::RRR_Object::RRR_Object_Obj18.OrientationYaw = 0;
  @CAN_RadarRR::RRR_Object::RRR_Object_Obj18.OrientationYawVnce = 0;
  @CAN_RadarRR::RRR_Object::RRR_Object_Obj18.ProbClassConfidence = 0;
  @CAN_RadarRR::RRR_Object::RRR_Object_Obj18.ProbClassType = 0;
  @CAN_RadarRR::RRR_Object::RRR_Object_Obj18.Px = 0;
  @CAN_RadarRR::RRR_Object::RRR_Object_Obj18.PxAxCoVnce = 0;
  @CAN_RadarRR::RRR_Object::RRR_Object_Obj18.PxAyCoVnce = 0;
  @CAN_RadarRR::RRR_Object::RRR_Object_Obj18.PxPyCoVnce = 0;
  @CAN_RadarRR::RRR_Object::RRR_Object_Obj18.PxVnce = 0;
  @CAN_RadarRR::RRR_Object::RRR_Object_Obj18.PxVxCoVnce = 0;
  @CAN_RadarRR::RRR_Object::RRR_Object_Obj18.PxVyCoVnce = 0;
  @CAN_RadarRR::RRR_Object::RRR_Object_Obj18.Py = 0;
  @CAN_RadarRR::RRR_Object::RRR_Object_Obj18.PyAxCoVnce = 0;
  }
  if(init_count == 16)
  {
  @CAN_RadarRR::RRR_Object::RRR_Object_Obj18.PyAyCoVnce = 0;
  @CAN_RadarRR::RRR_Object::RRR_Object_Obj18.PyVnce = 0;
  @CAN_RadarRR::RRR_Object::RRR_Object_Obj18.PyVxCoVnce = 0;
  @CAN_RadarRR::RRR_Object::RRR_Object_Obj18.PyVyCoVnce = 0;
  @CAN_RadarRR::RRR_Object::RRR_Object_Obj18.ReferencePoint = 0;
  @CAN_RadarRR::RRR_Object::RRR_Object_Obj18.Vx = 0;
  @CAN_RadarRR::RRR_Object::RRR_Object_Obj18.VxAxCoVnce = 0;
  @CAN_RadarRR::RRR_Object::RRR_Object_Obj18.VxAyCoVnce = 0;
  @CAN_RadarRR::RRR_Object::RRR_Object_Obj18.VxVnce = 0;
  @CAN_RadarRR::RRR_Object::RRR_Object_Obj18.VxVyCoVnce = 0;
  @CAN_RadarRR::RRR_Object::RRR_Object_Obj18.Vy = 0;
  @CAN_RadarRR::RRR_Object::RRR_Object_Obj18.VyAxCoVnce = 0;
  @CAN_RadarRR::RRR_Object::RRR_Object_Obj18.VyAyCoVnce = 0;
  @CAN_RadarRR::RRR_Object::RRR_Object_Obj18.VyVnce = 0;
  @CAN_RadarRR::RRR_Object::RRR_Object_Obj18.Width = 0;
  @CAN_RadarRR::RRR_Object::RRR_Object_Obj18.WidthVnce = 0;
  @CAN_RadarRR::RRR_Object::RRR_Object_Obj19.Age = 0;
  @CAN_RadarRR::RRR_Object::RRR_Object_Obj19.Ax = 0;
  @CAN_RadarRR::RRR_Object::RRR_Object_Obj19.AxAyCoVnce = 0;
  @CAN_RadarRR::RRR_Object::RRR_Object_Obj19.AxVnce = 0;
  @CAN_RadarRR::RRR_Object::RRR_Object_Obj19.Ay = 0;
  @CAN_RadarRR::RRR_Object::RRR_Object_Obj19.AyVnce = 0;
  @CAN_RadarRR::RRR_Object::RRR_Object_Obj19.ExistProb = 0;
  @CAN_RadarRR::RRR_Object::RRR_Object_Obj19.FilterInformation = 0;
  @CAN_RadarRR::RRR_Object::RRR_Object_Obj19.Length = 0;
  }
  if(init_count == 17)
  {
  @CAN_RadarRR::RRR_Object::RRR_Object_Obj19.LengthVnce = 0;
  @CAN_RadarRR::RRR_Object::RRR_Object_Obj19.MeasurementStatus = 0;
  @CAN_RadarRR::RRR_Object::RRR_Object_Obj19.MovingStatus = 0;
  @CAN_RadarRR::RRR_Object::RRR_Object_Obj19.ObjId = 0;
  @CAN_RadarRR::RRR_Object::RRR_Object_Obj19.OrientationYaw = 0;
  @CAN_RadarRR::RRR_Object::RRR_Object_Obj19.OrientationYawVnce = 0;
  @CAN_RadarRR::RRR_Object::RRR_Object_Obj19.ProbClassConfidence = 0;
  @CAN_RadarRR::RRR_Object::RRR_Object_Obj19.ProbClassType = 0;
  @CAN_RadarRR::RRR_Object::RRR_Object_Obj19.Px = 0;
  @CAN_RadarRR::RRR_Object::RRR_Object_Obj19.PxAxCoVnce = 0;
  @CAN_RadarRR::RRR_Object::RRR_Object_Obj19.PxAyCoVnce = 0;
  @CAN_RadarRR::RRR_Object::RRR_Object_Obj19.PxPyCoVnce = 0;
  @CAN_RadarRR::RRR_Object::RRR_Object_Obj19.PxVnce = 0;
  @CAN_RadarRR::RRR_Object::RRR_Object_Obj19.PxVxCoVnce = 0;
  @CAN_RadarRR::RRR_Object::RRR_Object_Obj19.PxVyCoVnce = 0;
  @CAN_RadarRR::RRR_Object::RRR_Object_Obj19.Py = 0;
  @CAN_RadarRR::RRR_Object::RRR_Object_Obj19.PyAxCoVnce = 0;
  @CAN_RadarRR::RRR_Object::RRR_Object_Obj19.PyAyCoVnce = 0;
  @CAN_RadarRR::RRR_Object::RRR_Object_Obj19.PyVnce = 0;
  @CAN_RadarRR::RRR_Object::RRR_Object_Obj19.PyVxCoVnce = 0;
  @CAN_RadarRR::RRR_Object::RRR_Object_Obj19.PyVyCoVnce = 0;
  @CAN_RadarRR::RRR_Object::RRR_Object_Obj19.ReferencePoint = 0;
  @CAN_RadarRR::RRR_Object::RRR_Object_Obj19.Vx = 0;
  @CAN_RadarRR::RRR_Object::RRR_Object_Obj19.VxAxCoVnce = 0;
  @CAN_RadarRR::RRR_Object::RRR_Object_Obj19.VxAyCoVnce = 0;
  }
  if(init_count == 18)
  {
  @CAN_RadarRR::RRR_Object::RRR_Object_Obj19.VxVnce = 0;
  @CAN_RadarRR::RRR_Object::RRR_Object_Obj19.VxVyCoVnce = 0;
  @CAN_RadarRR::RRR_Object::RRR_Object_Obj19.Vy = 0;
  @CAN_RadarRR::RRR_Object::RRR_Object_Obj19.VyAxCoVnce = 0;
  @CAN_RadarRR::RRR_Object::RRR_Object_Obj19.VyAyCoVnce = 0;
  @CAN_RadarRR::RRR_Object::RRR_Object_Obj19.VyVnce = 0;
  @CAN_RadarRR::RRR_Object::RRR_Object_Obj19.Width = 0;
  @CAN_RadarRR::RRR_Object::RRR_Object_Obj19.WidthVnce = 0;
  @CAN_RadarRR::RRR_Object::RRR_Object_Obj1.Age = 0;
  @CAN_RadarRR::RRR_Object::RRR_Object_Obj1.Ax = 0;
  @CAN_RadarRR::RRR_Object::RRR_Object_Obj1.AxAyCoVnce = 0;
  @CAN_RadarRR::RRR_Object::RRR_Object_Obj1.AxVnce = 0;
  @CAN_RadarRR::RRR_Object::RRR_Object_Obj1.Ay = 0;
  @CAN_RadarRR::RRR_Object::RRR_Object_Obj1.AyVnce = 0;
  @CAN_RadarRR::RRR_Object::RRR_Object_Obj1.ExistProb = 0;
  @CAN_RadarRR::RRR_Object::RRR_Object_Obj1.FilterInformation = 0;
  @CAN_RadarRR::RRR_Object::RRR_Object_Obj1.Length = 0;
  @CAN_RadarRR::RRR_Object::RRR_Object_Obj1.LengthVnce = 0;
  @CAN_RadarRR::RRR_Object::RRR_Object_Obj1.MeasurementStatus = 0;
  @CAN_RadarRR::RRR_Object::RRR_Object_Obj1.MovingStatus = 0;
  @CAN_RadarRR::RRR_Object::RRR_Object_Obj1.ObjId = 0;
  @CAN_RadarRR::RRR_Object::RRR_Object_Obj1.OrientationYaw = 0;
  @CAN_RadarRR::RRR_Object::RRR_Object_Obj1.OrientationYawVnce = 0;
  @CAN_RadarRR::RRR_Object::RRR_Object_Obj1.ProbClassConfidence = 0;
  @CAN_RadarRR::RRR_Object::RRR_Object_Obj1.ProbClassType = 0;
  }
  if(init_count == 19)
  {
  @CAN_RadarRR::RRR_Object::RRR_Object_Obj1.Px = 0;
  @CAN_RadarRR::RRR_Object::RRR_Object_Obj1.PxAxCoVnce = 0;
  @CAN_RadarRR::RRR_Object::RRR_Object_Obj1.PxAyCoVnce = 0;
  @CAN_RadarRR::RRR_Object::RRR_Object_Obj1.PxPyCoVnce = 0;
  @CAN_RadarRR::RRR_Object::RRR_Object_Obj1.PxVnce = 0;
  @CAN_RadarRR::RRR_Object::RRR_Object_Obj1.PxVxCoVnce = 0;
  @CAN_RadarRR::RRR_Object::RRR_Object_Obj1.PxVyCoVnce = 0;
  @CAN_RadarRR::RRR_Object::RRR_Object_Obj1.Py = 0;
  @CAN_RadarRR::RRR_Object::RRR_Object_Obj1.PyAxCoVnce = 0;
  @CAN_RadarRR::RRR_Object::RRR_Object_Obj1.PyAyCoVnce = 0;
  @CAN_RadarRR::RRR_Object::RRR_Object_Obj1.PyVnce = 0;
  @CAN_RadarRR::RRR_Object::RRR_Object_Obj1.PyVxCoVnce = 0;
  @CAN_RadarRR::RRR_Object::RRR_Object_Obj1.PyVyCoVnce = 0;
  @CAN_RadarRR::RRR_Object::RRR_Object_Obj1.ReferencePoint = 0;
  @CAN_RadarRR::RRR_Object::RRR_Object_Obj1.Vx = 0;
  @CAN_RadarRR::RRR_Object::RRR_Object_Obj1.VxAxCoVnce = 0;
  @CAN_RadarRR::RRR_Object::RRR_Object_Obj1.VxAyCoVnce = 0;
  @CAN_RadarRR::RRR_Object::RRR_Object_Obj1.VxVnce = 0;
  @CAN_RadarRR::RRR_Object::RRR_Object_Obj1.VxVyCoVnce = 0;
  @CAN_RadarRR::RRR_Object::RRR_Object_Obj1.Vy = 0;
  @CAN_RadarRR::RRR_Object::RRR_Object_Obj1.VyAxCoVnce = 0;
  @CAN_RadarRR::RRR_Object::RRR_Object_Obj1.VyAyCoVnce = 0;
  @CAN_RadarRR::RRR_Object::RRR_Object_Obj1.VyVnce = 0;
  @CAN_RadarRR::RRR_Object::RRR_Object_Obj1.Width = 0;
  @CAN_RadarRR::RRR_Object::RRR_Object_Obj1.WidthVnce = 0;
  }
  if(init_count == 20)
  {
  @CAN_RadarRR::RRR_Object::RRR_Object_Obj20.Age = 0;
  @CAN_RadarRR::RRR_Object::RRR_Object_Obj20.Ax = 0;
  @CAN_RadarRR::RRR_Object::RRR_Object_Obj20.AxAyCoVnce = 0;
  @CAN_RadarRR::RRR_Object::RRR_Object_Obj20.AxVnce = 0;
  @CAN_RadarRR::RRR_Object::RRR_Object_Obj20.Ay = 0;
  @CAN_RadarRR::RRR_Object::RRR_Object_Obj20.AyVnce = 0;
  @CAN_RadarRR::RRR_Object::RRR_Object_Obj20.ExistProb = 0;
  @CAN_RadarRR::RRR_Object::RRR_Object_Obj20.FilterInformation = 0;
  @CAN_RadarRR::RRR_Object::RRR_Object_Obj20.Length = 0;
  @CAN_RadarRR::RRR_Object::RRR_Object_Obj20.LengthVnce = 0;
  @CAN_RadarRR::RRR_Object::RRR_Object_Obj20.MeasurementStatus = 0;
  @CAN_RadarRR::RRR_Object::RRR_Object_Obj20.MovingStatus = 0;
  @CAN_RadarRR::RRR_Object::RRR_Object_Obj20.ObjId = 0;
  @CAN_RadarRR::RRR_Object::RRR_Object_Obj20.OrientationYaw = 0;
  @CAN_RadarRR::RRR_Object::RRR_Object_Obj20.OrientationYawVnce = 0;
  @CAN_RadarRR::RRR_Object::RRR_Object_Obj20.ProbClassConfidence = 0;
  @CAN_RadarRR::RRR_Object::RRR_Object_Obj20.ProbClassType = 0;
  @CAN_RadarRR::RRR_Object::RRR_Object_Obj20.Px = 0;
  @CAN_RadarRR::RRR_Object::RRR_Object_Obj20.PxAxCoVnce = 0;
  @CAN_RadarRR::RRR_Object::RRR_Object_Obj20.PxAyCoVnce = 0;
  @CAN_RadarRR::RRR_Object::RRR_Object_Obj20.PxPyCoVnce = 0;
  @CAN_RadarRR::RRR_Object::RRR_Object_Obj20.PxVnce = 0;
  @CAN_RadarRR::RRR_Object::RRR_Object_Obj20.PxVxCoVnce = 0;
  @CAN_RadarRR::RRR_Object::RRR_Object_Obj20.PxVyCoVnce = 0;
  @CAN_RadarRR::RRR_Object::RRR_Object_Obj20.Py = 0;
  }
  if(init_count == 21)
  {
  @CAN_RadarRR::RRR_Object::RRR_Object_Obj20.PyAxCoVnce = 0;
  @CAN_RadarRR::RRR_Object::RRR_Object_Obj20.PyAyCoVnce = 0;
  @CAN_RadarRR::RRR_Object::RRR_Object_Obj20.PyVnce = 0;
  @CAN_RadarRR::RRR_Object::RRR_Object_Obj20.PyVxCoVnce = 0;
  @CAN_RadarRR::RRR_Object::RRR_Object_Obj20.PyVyCoVnce = 0;
  @CAN_RadarRR::RRR_Object::RRR_Object_Obj20.ReferencePoint = 0;
  @CAN_RadarRR::RRR_Object::RRR_Object_Obj20.Vx = 0;
  @CAN_RadarRR::RRR_Object::RRR_Object_Obj20.VxAxCoVnce = 0;
  @CAN_RadarRR::RRR_Object::RRR_Object_Obj20.VxAyCoVnce = 0;
  @CAN_RadarRR::RRR_Object::RRR_Object_Obj20.VxVnce = 0;
  @CAN_RadarRR::RRR_Object::RRR_Object_Obj20.VxVyCoVnce = 0;
  @CAN_RadarRR::RRR_Object::RRR_Object_Obj20.Vy = 0;
  @CAN_RadarRR::RRR_Object::RRR_Object_Obj20.VyAxCoVnce = 0;
  @CAN_RadarRR::RRR_Object::RRR_Object_Obj20.VyAyCoVnce = 0;
  @CAN_RadarRR::RRR_Object::RRR_Object_Obj20.VyVnce = 0;
  @CAN_RadarRR::RRR_Object::RRR_Object_Obj20.Width = 0;
  @CAN_RadarRR::RRR_Object::RRR_Object_Obj20.WidthVnce = 0;
  @CAN_RadarRR::RRR_Object::RRR_Object_Obj21.Age = 0;
  @CAN_RadarRR::RRR_Object::RRR_Object_Obj21.Ax = 0;
  @CAN_RadarRR::RRR_Object::RRR_Object_Obj21.AxAyCoVnce = 0;
  @CAN_RadarRR::RRR_Object::RRR_Object_Obj21.AxVnce = 0;
  @CAN_RadarRR::RRR_Object::RRR_Object_Obj21.Ay = 0;
  @CAN_RadarRR::RRR_Object::RRR_Object_Obj21.AyVnce = 0;
  @CAN_RadarRR::RRR_Object::RRR_Object_Obj21.ExistProb = 0;
  @CAN_RadarRR::RRR_Object::RRR_Object_Obj21.FilterInformation = 0;
  }
  if(init_count == 22)
  {
  @CAN_RadarRR::RRR_Object::RRR_Object_Obj21.Length = 0;
  @CAN_RadarRR::RRR_Object::RRR_Object_Obj21.LengthVnce = 0;
  @CAN_RadarRR::RRR_Object::RRR_Object_Obj21.MeasurementStatus = 0;
  @CAN_RadarRR::RRR_Object::RRR_Object_Obj21.MovingStatus = 0;
  @CAN_RadarRR::RRR_Object::RRR_Object_Obj21.ObjId = 0;
  @CAN_RadarRR::RRR_Object::RRR_Object_Obj21.OrientationYaw = 0;
  @CAN_RadarRR::RRR_Object::RRR_Object_Obj21.OrientationYawVnce = 0;
  @CAN_RadarRR::RRR_Object::RRR_Object_Obj21.ProbClassConfidence = 0;
  @CAN_RadarRR::RRR_Object::RRR_Object_Obj21.ProbClassType = 0;
  @CAN_RadarRR::RRR_Object::RRR_Object_Obj21.Px = 0;
  @CAN_RadarRR::RRR_Object::RRR_Object_Obj21.PxAxCoVnce = 0;
  @CAN_RadarRR::RRR_Object::RRR_Object_Obj21.PxAyCoVnce = 0;
  @CAN_RadarRR::RRR_Object::RRR_Object_Obj21.PxPyCoVnce = 0;
  @CAN_RadarRR::RRR_Object::RRR_Object_Obj21.PxVnce = 0;
  @CAN_RadarRR::RRR_Object::RRR_Object_Obj21.PxVxCoVnce = 0;
  @CAN_RadarRR::RRR_Object::RRR_Object_Obj21.PxVyCoVnce = 0;
  @CAN_RadarRR::RRR_Object::RRR_Object_Obj21.Py = 0;
  @CAN_RadarRR::RRR_Object::RRR_Object_Obj21.PyAxCoVnce = 0;
  @CAN_RadarRR::RRR_Object::RRR_Object_Obj21.PyAyCoVnce = 0;
  @CAN_RadarRR::RRR_Object::RRR_Object_Obj21.PyVnce = 0;
  @CAN_RadarRR::RRR_Object::RRR_Object_Obj21.PyVxCoVnce = 0;
  @CAN_RadarRR::RRR_Object::RRR_Object_Obj21.PyVyCoVnce = 0;
  @CAN_RadarRR::RRR_Object::RRR_Object_Obj21.ReferencePoint = 0;
  @CAN_RadarRR::RRR_Object::RRR_Object_Obj21.Vx = 0;
  @CAN_RadarRR::RRR_Object::RRR_Object_Obj21.VxAxCoVnce = 0;
  }
  if(init_count == 23)
  {
  @CAN_RadarRR::RRR_Object::RRR_Object_Obj21.VxAyCoVnce = 0;
  @CAN_RadarRR::RRR_Object::RRR_Object_Obj21.VxVnce = 0;
  @CAN_RadarRR::RRR_Object::RRR_Object_Obj21.VxVyCoVnce = 0;
  @CAN_RadarRR::RRR_Object::RRR_Object_Obj21.Vy = 0;
  @CAN_RadarRR::RRR_Object::RRR_Object_Obj21.VyAxCoVnce = 0;
  @CAN_RadarRR::RRR_Object::RRR_Object_Obj21.VyAyCoVnce = 0;
  @CAN_RadarRR::RRR_Object::RRR_Object_Obj21.VyVnce = 0;
  @CAN_RadarRR::RRR_Object::RRR_Object_Obj21.Width = 0;
  @CAN_RadarRR::RRR_Object::RRR_Object_Obj21.WidthVnce = 0;
  @CAN_RadarRR::RRR_Object::RRR_Object_Obj22.Age = 0;
  @CAN_RadarRR::RRR_Object::RRR_Object_Obj22.Ax = 0;
  @CAN_RadarRR::RRR_Object::RRR_Object_Obj22.AxAyCoVnce = 0;
  @CAN_RadarRR::RRR_Object::RRR_Object_Obj22.AxVnce = 0;
  @CAN_RadarRR::RRR_Object::RRR_Object_Obj22.Ay = 0;
  @CAN_RadarRR::RRR_Object::RRR_Object_Obj22.AyVnce = 0;
  @CAN_RadarRR::RRR_Object::RRR_Object_Obj22.ExistProb = 0;
  @CAN_RadarRR::RRR_Object::RRR_Object_Obj22.FilterInformation = 0;
  @CAN_RadarRR::RRR_Object::RRR_Object_Obj22.Length = 0;
  @CAN_RadarRR::RRR_Object::RRR_Object_Obj22.LengthVnce = 0;
  @CAN_RadarRR::RRR_Object::RRR_Object_Obj22.MeasurementStatus = 0;
  @CAN_RadarRR::RRR_Object::RRR_Object_Obj22.MovingStatus = 0;
  @CAN_RadarRR::RRR_Object::RRR_Object_Obj22.ObjId = 0;
  @CAN_RadarRR::RRR_Object::RRR_Object_Obj22.OrientationYaw = 0;
  @CAN_RadarRR::RRR_Object::RRR_Object_Obj22.OrientationYawVnce = 0;
  @CAN_RadarRR::RRR_Object::RRR_Object_Obj22.ProbClassConfidence = 0;
  }
  if(init_count == 24)
  {
  @CAN_RadarRR::RRR_Object::RRR_Object_Obj22.ProbClassType = 0;
  @CAN_RadarRR::RRR_Object::RRR_Object_Obj22.Px = 0;
  @CAN_RadarRR::RRR_Object::RRR_Object_Obj22.PxAxCoVnce = 0;
  @CAN_RadarRR::RRR_Object::RRR_Object_Obj22.PxAyCoVnce = 0;
  @CAN_RadarRR::RRR_Object::RRR_Object_Obj22.PxPyCoVnce = 0;
  @CAN_RadarRR::RRR_Object::RRR_Object_Obj22.PxVnce = 0;
  @CAN_RadarRR::RRR_Object::RRR_Object_Obj22.PxVxCoVnce = 0;
  @CAN_RadarRR::RRR_Object::RRR_Object_Obj22.PxVyCoVnce = 0;
  @CAN_RadarRR::RRR_Object::RRR_Object_Obj22.Py = 0;
  @CAN_RadarRR::RRR_Object::RRR_Object_Obj22.PyAxCoVnce = 0;
  @CAN_RadarRR::RRR_Object::RRR_Object_Obj22.PyAyCoVnce = 0;
  @CAN_RadarRR::RRR_Object::RRR_Object_Obj22.PyVnce = 0;
  @CAN_RadarRR::RRR_Object::RRR_Object_Obj22.PyVxCoVnce = 0;
  @CAN_RadarRR::RRR_Object::RRR_Object_Obj22.PyVyCoVnce = 0;
  @CAN_RadarRR::RRR_Object::RRR_Object_Obj22.ReferencePoint = 0;
  @CAN_RadarRR::RRR_Object::RRR_Object_Obj22.Vx = 0;
  @CAN_RadarRR::RRR_Object::RRR_Object_Obj22.VxAxCoVnce = 0;
  @CAN_RadarRR::RRR_Object::RRR_Object_Obj22.VxAyCoVnce = 0;
  @CAN_RadarRR::RRR_Object::RRR_Object_Obj22.VxVnce = 0;
  @CAN_RadarRR::RRR_Object::RRR_Object_Obj22.VxVyCoVnce = 0;
  @CAN_RadarRR::RRR_Object::RRR_Object_Obj22.Vy = 0;
  @CAN_RadarRR::RRR_Object::RRR_Object_Obj22.VyAxCoVnce = 0;
  @CAN_RadarRR::RRR_Object::RRR_Object_Obj22.VyAyCoVnce = 0;
  @CAN_RadarRR::RRR_Object::RRR_Object_Obj22.VyVnce = 0;
  @CAN_RadarRR::RRR_Object::RRR_Object_Obj22.Width = 0;
  }
  if(init_count == 25)
  {
  @CAN_RadarRR::RRR_Object::RRR_Object_Obj22.WidthVnce = 0;
  @CAN_RadarRR::RRR_Object::RRR_Object_Obj23.Age = 0;
  @CAN_RadarRR::RRR_Object::RRR_Object_Obj23.Ax = 0;
  @CAN_RadarRR::RRR_Object::RRR_Object_Obj23.AxAyCoVnce = 0;
  @CAN_RadarRR::RRR_Object::RRR_Object_Obj23.AxVnce = 0;
  @CAN_RadarRR::RRR_Object::RRR_Object_Obj23.Ay = 0;
  @CAN_RadarRR::RRR_Object::RRR_Object_Obj23.AyVnce = 0;
  @CAN_RadarRR::RRR_Object::RRR_Object_Obj23.ExistProb = 0;
  @CAN_RadarRR::RRR_Object::RRR_Object_Obj23.FilterInformation = 0;
  @CAN_RadarRR::RRR_Object::RRR_Object_Obj23.Length = 0;
  @CAN_RadarRR::RRR_Object::RRR_Object_Obj23.LengthVnce = 0;
  @CAN_RadarRR::RRR_Object::RRR_Object_Obj23.MeasurementStatus = 0;
  @CAN_RadarRR::RRR_Object::RRR_Object_Obj23.MovingStatus = 0;
  @CAN_RadarRR::RRR_Object::RRR_Object_Obj23.ObjId = 0;
  @CAN_RadarRR::RRR_Object::RRR_Object_Obj23.OrientationYaw = 0;
  @CAN_RadarRR::RRR_Object::RRR_Object_Obj23.OrientationYawVnce = 0;
  @CAN_RadarRR::RRR_Object::RRR_Object_Obj23.ProbClassConfidence = 0;
  @CAN_RadarRR::RRR_Object::RRR_Object_Obj23.ProbClassType = 0;
  @CAN_RadarRR::RRR_Object::RRR_Object_Obj23.Px = 0;
  @CAN_RadarRR::RRR_Object::RRR_Object_Obj23.PxAxCoVnce = 0;
  @CAN_RadarRR::RRR_Object::RRR_Object_Obj23.PxAyCoVnce = 0;
  @CAN_RadarRR::RRR_Object::RRR_Object_Obj23.PxPyCoVnce = 0;
  @CAN_RadarRR::RRR_Object::RRR_Object_Obj23.PxVnce = 0;
  @CAN_RadarRR::RRR_Object::RRR_Object_Obj23.PxVxCoVnce = 0;
  @CAN_RadarRR::RRR_Object::RRR_Object_Obj23.PxVyCoVnce = 0;
  }
  if(init_count == 26)
  {
  @CAN_RadarRR::RRR_Object::RRR_Object_Obj23.Py = 0;
  @CAN_RadarRR::RRR_Object::RRR_Object_Obj23.PyAxCoVnce = 0;
  @CAN_RadarRR::RRR_Object::RRR_Object_Obj23.PyAyCoVnce = 0;
  @CAN_RadarRR::RRR_Object::RRR_Object_Obj23.PyVnce = 0;
  @CAN_RadarRR::RRR_Object::RRR_Object_Obj23.PyVxCoVnce = 0;
  @CAN_RadarRR::RRR_Object::RRR_Object_Obj23.PyVyCoVnce = 0;
  @CAN_RadarRR::RRR_Object::RRR_Object_Obj23.ReferencePoint = 0;
  @CAN_RadarRR::RRR_Object::RRR_Object_Obj23.Vx = 0;
  @CAN_RadarRR::RRR_Object::RRR_Object_Obj23.VxAxCoVnce = 0;
  @CAN_RadarRR::RRR_Object::RRR_Object_Obj23.VxAyCoVnce = 0;
  @CAN_RadarRR::RRR_Object::RRR_Object_Obj23.VxVnce = 0;
  @CAN_RadarRR::RRR_Object::RRR_Object_Obj23.VxVyCoVnce = 0;
  @CAN_RadarRR::RRR_Object::RRR_Object_Obj23.Vy = 0;
  @CAN_RadarRR::RRR_Object::RRR_Object_Obj23.VyAxCoVnce = 0;
  @CAN_RadarRR::RRR_Object::RRR_Object_Obj23.VyAyCoVnce = 0;
  @CAN_RadarRR::RRR_Object::RRR_Object_Obj23.VyVnce = 0;
  @CAN_RadarRR::RRR_Object::RRR_Object_Obj23.Width = 0;
  @CAN_RadarRR::RRR_Object::RRR_Object_Obj23.WidthVnce = 0;
  @CAN_RadarRR::RRR_Object::RRR_Object_Obj24.Age = 0;
  @CAN_RadarRR::RRR_Object::RRR_Object_Obj24.Ax = 0;
  @CAN_RadarRR::RRR_Object::RRR_Object_Obj24.AxAyCoVnce = 0;
  @CAN_RadarRR::RRR_Object::RRR_Object_Obj24.AxVnce = 0;
  @CAN_RadarRR::RRR_Object::RRR_Object_Obj24.Ay = 0;
  @CAN_RadarRR::RRR_Object::RRR_Object_Obj24.AyVnce = 0;
  @CAN_RadarRR::RRR_Object::RRR_Object_Obj24.ExistProb = 0;
  }
  if(init_count == 27)
  {
  @CAN_RadarRR::RRR_Object::RRR_Object_Obj24.FilterInformation = 0;
  @CAN_RadarRR::RRR_Object::RRR_Object_Obj24.Length = 0;
  @CAN_RadarRR::RRR_Object::RRR_Object_Obj24.LengthVnce = 0;
  @CAN_RadarRR::RRR_Object::RRR_Object_Obj24.MeasurementStatus = 0;
  @CAN_RadarRR::RRR_Object::RRR_Object_Obj24.MovingStatus = 0;
  @CAN_RadarRR::RRR_Object::RRR_Object_Obj24.ObjId = 0;
  @CAN_RadarRR::RRR_Object::RRR_Object_Obj24.OrientationYaw = 0;
  @CAN_RadarRR::RRR_Object::RRR_Object_Obj24.OrientationYawVnce = 0;
  @CAN_RadarRR::RRR_Object::RRR_Object_Obj24.ProbClassConfidence = 0;
  @CAN_RadarRR::RRR_Object::RRR_Object_Obj24.ProbClassType = 0;
  @CAN_RadarRR::RRR_Object::RRR_Object_Obj24.Px = 0;
  @CAN_RadarRR::RRR_Object::RRR_Object_Obj24.PxAxCoVnce = 0;
  @CAN_RadarRR::RRR_Object::RRR_Object_Obj24.PxAyCoVnce = 0;
  @CAN_RadarRR::RRR_Object::RRR_Object_Obj24.PxPyCoVnce = 0;
  @CAN_RadarRR::RRR_Object::RRR_Object_Obj24.PxVnce = 0;
  @CAN_RadarRR::RRR_Object::RRR_Object_Obj24.PxVxCoVnce = 0;
  @CAN_RadarRR::RRR_Object::RRR_Object_Obj24.PxVyCoVnce = 0;
  @CAN_RadarRR::RRR_Object::RRR_Object_Obj24.Py = 0;
  @CAN_RadarRR::RRR_Object::RRR_Object_Obj24.PyAxCoVnce = 0;
  @CAN_RadarRR::RRR_Object::RRR_Object_Obj24.PyAyCoVnce = 0;
  @CAN_RadarRR::RRR_Object::RRR_Object_Obj24.PyVnce = 0;
  @CAN_RadarRR::RRR_Object::RRR_Object_Obj24.PyVxCoVnce = 0;
  @CAN_RadarRR::RRR_Object::RRR_Object_Obj24.PyVyCoVnce = 0;
  @CAN_RadarRR::RRR_Object::RRR_Object_Obj24.ReferencePoint = 0;
  @CAN_RadarRR::RRR_Object::RRR_Object_Obj24.Vx = 0;
  }
  if(init_count == 28)
  {
  @CAN_RadarRR::RRR_Object::RRR_Object_Obj24.VxAxCoVnce = 0;
  @CAN_RadarRR::RRR_Object::RRR_Object_Obj24.VxAyCoVnce = 0;
  @CAN_RadarRR::RRR_Object::RRR_Object_Obj24.VxVnce = 0;
  @CAN_RadarRR::RRR_Object::RRR_Object_Obj24.VxVyCoVnce = 0;
  @CAN_RadarRR::RRR_Object::RRR_Object_Obj24.Vy = 0;
  @CAN_RadarRR::RRR_Object::RRR_Object_Obj24.VyAxCoVnce = 0;
  @CAN_RadarRR::RRR_Object::RRR_Object_Obj24.VyAyCoVnce = 0;
  @CAN_RadarRR::RRR_Object::RRR_Object_Obj24.VyVnce = 0;
  @CAN_RadarRR::RRR_Object::RRR_Object_Obj24.Width = 0;
  @CAN_RadarRR::RRR_Object::RRR_Object_Obj24.WidthVnce = 0;
  @CAN_RadarRR::RRR_Object::RRR_Object_Obj25.Age = 0;
  @CAN_RadarRR::RRR_Object::RRR_Object_Obj25.Ax = 0;
  @CAN_RadarRR::RRR_Object::RRR_Object_Obj25.AxAyCoVnce = 0;
  @CAN_RadarRR::RRR_Object::RRR_Object_Obj25.AxVnce = 0;
  @CAN_RadarRR::RRR_Object::RRR_Object_Obj25.Ay = 0;
  @CAN_RadarRR::RRR_Object::RRR_Object_Obj25.AyVnce = 0;
  @CAN_RadarRR::RRR_Object::RRR_Object_Obj25.ExistProb = 0;
  @CAN_RadarRR::RRR_Object::RRR_Object_Obj25.FilterInformation = 0;
  @CAN_RadarRR::RRR_Object::RRR_Object_Obj25.Length = 0;
  @CAN_RadarRR::RRR_Object::RRR_Object_Obj25.LengthVnce = 0;
  @CAN_RadarRR::RRR_Object::RRR_Object_Obj25.MeasurementStatus = 0;
  @CAN_RadarRR::RRR_Object::RRR_Object_Obj25.MovingStatus = 0;
  @CAN_RadarRR::RRR_Object::RRR_Object_Obj25.ObjId = 0;
  @CAN_RadarRR::RRR_Object::RRR_Object_Obj25.OrientationYaw = 0;
  @CAN_RadarRR::RRR_Object::RRR_Object_Obj25.OrientationYawVnce = 0;
  }
  if(init_count == 29)
  {
  @CAN_RadarRR::RRR_Object::RRR_Object_Obj25.ProbClassConfidence = 0;
  @CAN_RadarRR::RRR_Object::RRR_Object_Obj25.ProbClassType = 0;
  @CAN_RadarRR::RRR_Object::RRR_Object_Obj25.Px = 0;
  @CAN_RadarRR::RRR_Object::RRR_Object_Obj25.PxAxCoVnce = 0;
  @CAN_RadarRR::RRR_Object::RRR_Object_Obj25.PxAyCoVnce = 0;
  @CAN_RadarRR::RRR_Object::RRR_Object_Obj25.PxPyCoVnce = 0;
  @CAN_RadarRR::RRR_Object::RRR_Object_Obj25.PxVnce = 0;
  @CAN_RadarRR::RRR_Object::RRR_Object_Obj25.PxVxCoVnce = 0;
  @CAN_RadarRR::RRR_Object::RRR_Object_Obj25.PxVyCoVnce = 0;
  @CAN_RadarRR::RRR_Object::RRR_Object_Obj25.Py = 0;
  @CAN_RadarRR::RRR_Object::RRR_Object_Obj25.PyAxCoVnce = 0;
  @CAN_RadarRR::RRR_Object::RRR_Object_Obj25.PyAyCoVnce = 0;
  @CAN_RadarRR::RRR_Object::RRR_Object_Obj25.PyVnce = 0;
  @CAN_RadarRR::RRR_Object::RRR_Object_Obj25.PyVxCoVnce = 0;
  @CAN_RadarRR::RRR_Object::RRR_Object_Obj25.PyVyCoVnce = 0;
  @CAN_RadarRR::RRR_Object::RRR_Object_Obj25.ReferencePoint = 0;
  @CAN_RadarRR::RRR_Object::RRR_Object_Obj25.Vx = 0;
  @CAN_RadarRR::RRR_Object::RRR_Object_Obj25.VxAxCoVnce = 0;
  @CAN_RadarRR::RRR_Object::RRR_Object_Obj25.VxAyCoVnce = 0;
  @CAN_RadarRR::RRR_Object::RRR_Object_Obj25.VxVnce = 0;
  @CAN_RadarRR::RRR_Object::RRR_Object_Obj25.VxVyCoVnce = 0;
  @CAN_RadarRR::RRR_Object::RRR_Object_Obj25.Vy = 0;
  @CAN_RadarRR::RRR_Object::RRR_Object_Obj25.VyAxCoVnce = 0;
  @CAN_RadarRR::RRR_Object::RRR_Object_Obj25.VyAyCoVnce = 0;
  @CAN_RadarRR::RRR_Object::RRR_Object_Obj25.VyVnce = 0;
  }
  if(init_count == 30)
  {
  @CAN_RadarRR::RRR_Object::RRR_Object_Obj25.Width = 0;
  @CAN_RadarRR::RRR_Object::RRR_Object_Obj25.WidthVnce = 0;
  @CAN_RadarRR::RRR_Object::RRR_Object_Obj26.Age = 0;
  @CAN_RadarRR::RRR_Object::RRR_Object_Obj26.Ax = 0;
  @CAN_RadarRR::RRR_Object::RRR_Object_Obj26.AxAyCoVnce = 0;
  @CAN_RadarRR::RRR_Object::RRR_Object_Obj26.AxVnce = 0;
  @CAN_RadarRR::RRR_Object::RRR_Object_Obj26.Ay = 0;
  @CAN_RadarRR::RRR_Object::RRR_Object_Obj26.AyVnce = 0;
  @CAN_RadarRR::RRR_Object::RRR_Object_Obj26.ExistProb = 0;
  @CAN_RadarRR::RRR_Object::RRR_Object_Obj26.FilterInformation = 0;
  @CAN_RadarRR::RRR_Object::RRR_Object_Obj26.Length = 0;
  @CAN_RadarRR::RRR_Object::RRR_Object_Obj26.LengthVnce = 0;
  @CAN_RadarRR::RRR_Object::RRR_Object_Obj26.MeasurementStatus = 0;
  @CAN_RadarRR::RRR_Object::RRR_Object_Obj26.MovingStatus = 0;
  @CAN_RadarRR::RRR_Object::RRR_Object_Obj26.ObjId = 0;
  @CAN_RadarRR::RRR_Object::RRR_Object_Obj26.OrientationYaw = 0;
  @CAN_RadarRR::RRR_Object::RRR_Object_Obj26.OrientationYawVnce = 0;
  @CAN_RadarRR::RRR_Object::RRR_Object_Obj26.ProbClassConfidence = 0;
  @CAN_RadarRR::RRR_Object::RRR_Object_Obj26.ProbClassType = 0;
  @CAN_RadarRR::RRR_Object::RRR_Object_Obj26.Px = 0;
  @CAN_RadarRR::RRR_Object::RRR_Object_Obj26.PxAxCoVnce = 0;
  @CAN_RadarRR::RRR_Object::RRR_Object_Obj26.PxAyCoVnce = 0;
  @CAN_RadarRR::RRR_Object::RRR_Object_Obj26.PxPyCoVnce = 0;
  @CAN_RadarRR::RRR_Object::RRR_Object_Obj26.PxVnce = 0;
  @CAN_RadarRR::RRR_Object::RRR_Object_Obj26.PxVxCoVnce = 0;
  }
  if(init_count == 31)
  {
  @CAN_RadarRR::RRR_Object::RRR_Object_Obj26.PxVyCoVnce = 0;
  @CAN_RadarRR::RRR_Object::RRR_Object_Obj26.Py = 0;
  @CAN_RadarRR::RRR_Object::RRR_Object_Obj26.PyAxCoVnce = 0;
  @CAN_RadarRR::RRR_Object::RRR_Object_Obj26.PyAyCoVnce = 0;
  @CAN_RadarRR::RRR_Object::RRR_Object_Obj26.PyVnce = 0;
  @CAN_RadarRR::RRR_Object::RRR_Object_Obj26.PyVxCoVnce = 0;
  @CAN_RadarRR::RRR_Object::RRR_Object_Obj26.PyVyCoVnce = 0;
  @CAN_RadarRR::RRR_Object::RRR_Object_Obj26.ReferencePoint = 0;
  @CAN_RadarRR::RRR_Object::RRR_Object_Obj26.Vx = 0;
  @CAN_RadarRR::RRR_Object::RRR_Object_Obj26.VxAxCoVnce = 0;
  @CAN_RadarRR::RRR_Object::RRR_Object_Obj26.VxAyCoVnce = 0;
  @CAN_RadarRR::RRR_Object::RRR_Object_Obj26.VxVnce = 0;
  @CAN_RadarRR::RRR_Object::RRR_Object_Obj26.VxVyCoVnce = 0;
  @CAN_RadarRR::RRR_Object::RRR_Object_Obj26.Vy = 0;
  @CAN_RadarRR::RRR_Object::RRR_Object_Obj26.VyAxCoVnce = 0;
  @CAN_RadarRR::RRR_Object::RRR_Object_Obj26.VyAyCoVnce = 0;
  @CAN_RadarRR::RRR_Object::RRR_Object_Obj26.VyVnce = 0;
  @CAN_RadarRR::RRR_Object::RRR_Object_Obj26.Width = 0;
  @CAN_RadarRR::RRR_Object::RRR_Object_Obj26.WidthVnce = 0;
  @CAN_RadarRR::RRR_Object::RRR_Object_Obj27.Age = 0;
  @CAN_RadarRR::RRR_Object::RRR_Object_Obj27.Ax = 0;
  @CAN_RadarRR::RRR_Object::RRR_Object_Obj27.AxAyCoVnce = 0;
  @CAN_RadarRR::RRR_Object::RRR_Object_Obj27.AxVnce = 0;
  @CAN_RadarRR::RRR_Object::RRR_Object_Obj27.Ay = 0;
  @CAN_RadarRR::RRR_Object::RRR_Object_Obj27.AyVnce = 0;
  }
  if(init_count == 32)
  {
  @CAN_RadarRR::RRR_Object::RRR_Object_Obj27.ExistProb = 0;
  @CAN_RadarRR::RRR_Object::RRR_Object_Obj27.FilterInformation = 0;
  @CAN_RadarRR::RRR_Object::RRR_Object_Obj27.Length = 0;
  @CAN_RadarRR::RRR_Object::RRR_Object_Obj27.LengthVnce = 0;
  @CAN_RadarRR::RRR_Object::RRR_Object_Obj27.MeasurementStatus = 0;
  @CAN_RadarRR::RRR_Object::RRR_Object_Obj27.MovingStatus = 0;
  @CAN_RadarRR::RRR_Object::RRR_Object_Obj27.ObjId = 0;
  @CAN_RadarRR::RRR_Object::RRR_Object_Obj27.OrientationYaw = 0;
  @CAN_RadarRR::RRR_Object::RRR_Object_Obj27.OrientationYawVnce = 0;
  @CAN_RadarRR::RRR_Object::RRR_Object_Obj27.ProbClassConfidence = 0;
  @CAN_RadarRR::RRR_Object::RRR_Object_Obj27.ProbClassType = 0;
  @CAN_RadarRR::RRR_Object::RRR_Object_Obj27.Px = 0;
  @CAN_RadarRR::RRR_Object::RRR_Object_Obj27.PxAxCoVnce = 0;
  @CAN_RadarRR::RRR_Object::RRR_Object_Obj27.PxAyCoVnce = 0;
  @CAN_RadarRR::RRR_Object::RRR_Object_Obj27.PxPyCoVnce = 0;
  @CAN_RadarRR::RRR_Object::RRR_Object_Obj27.PxVnce = 0;
  @CAN_RadarRR::RRR_Object::RRR_Object_Obj27.PxVxCoVnce = 0;
  @CAN_RadarRR::RRR_Object::RRR_Object_Obj27.PxVyCoVnce = 0;
  @CAN_RadarRR::RRR_Object::RRR_Object_Obj27.Py = 0;
  @CAN_RadarRR::RRR_Object::RRR_Object_Obj27.PyAxCoVnce = 0;
  @CAN_RadarRR::RRR_Object::RRR_Object_Obj27.PyAyCoVnce = 0;
  @CAN_RadarRR::RRR_Object::RRR_Object_Obj27.PyVnce = 0;
  @CAN_RadarRR::RRR_Object::RRR_Object_Obj27.PyVxCoVnce = 0;
  @CAN_RadarRR::RRR_Object::RRR_Object_Obj27.PyVyCoVnce = 0;
  @CAN_RadarRR::RRR_Object::RRR_Object_Obj27.ReferencePoint = 0;
  }
  if(init_count == 33)
  {
  @CAN_RadarRR::RRR_Object::RRR_Object_Obj27.Vx = 0;
  @CAN_RadarRR::RRR_Object::RRR_Object_Obj27.VxAxCoVnce = 0;
  @CAN_RadarRR::RRR_Object::RRR_Object_Obj27.VxAyCoVnce = 0;
  @CAN_RadarRR::RRR_Object::RRR_Object_Obj27.VxVnce = 0;
  @CAN_RadarRR::RRR_Object::RRR_Object_Obj27.VxVyCoVnce = 0;
  @CAN_RadarRR::RRR_Object::RRR_Object_Obj27.Vy = 0;
  @CAN_RadarRR::RRR_Object::RRR_Object_Obj27.VyAxCoVnce = 0;
  @CAN_RadarRR::RRR_Object::RRR_Object_Obj27.VyAyCoVnce = 0;
  @CAN_RadarRR::RRR_Object::RRR_Object_Obj27.VyVnce = 0;
  @CAN_RadarRR::RRR_Object::RRR_Object_Obj27.Width = 0;
  @CAN_RadarRR::RRR_Object::RRR_Object_Obj27.WidthVnce = 0;
  @CAN_RadarRR::RRR_Object::RRR_Object_Obj28.Age = 0;
  @CAN_RadarRR::RRR_Object::RRR_Object_Obj28.Ax = 0;
  @CAN_RadarRR::RRR_Object::RRR_Object_Obj28.AxAyCoVnce = 0;
  @CAN_RadarRR::RRR_Object::RRR_Object_Obj28.AxVnce = 0;
  @CAN_RadarRR::RRR_Object::RRR_Object_Obj28.Ay = 0;
  @CAN_RadarRR::RRR_Object::RRR_Object_Obj28.AyVnce = 0;
  @CAN_RadarRR::RRR_Object::RRR_Object_Obj28.ExistProb = 0;
  @CAN_RadarRR::RRR_Object::RRR_Object_Obj28.FilterInformation = 0;
  @CAN_RadarRR::RRR_Object::RRR_Object_Obj28.Length = 0;
  @CAN_RadarRR::RRR_Object::RRR_Object_Obj28.LengthVnce = 0;
  @CAN_RadarRR::RRR_Object::RRR_Object_Obj28.MeasurementStatus = 0;
  @CAN_RadarRR::RRR_Object::RRR_Object_Obj28.MovingStatus = 0;
  @CAN_RadarRR::RRR_Object::RRR_Object_Obj28.ObjId = 0;
  @CAN_RadarRR::RRR_Object::RRR_Object_Obj28.OrientationYaw = 0;
  }
  if(init_count == 34)
  {
  @CAN_RadarRR::RRR_Object::RRR_Object_Obj28.OrientationYawVnce = 0;
  @CAN_RadarRR::RRR_Object::RRR_Object_Obj28.ProbClassConfidence = 0;
  @CAN_RadarRR::RRR_Object::RRR_Object_Obj28.ProbClassType = 0;
  @CAN_RadarRR::RRR_Object::RRR_Object_Obj28.Px = 0;
  @CAN_RadarRR::RRR_Object::RRR_Object_Obj28.PxAxCoVnce = 0;
  @CAN_RadarRR::RRR_Object::RRR_Object_Obj28.PxAyCoVnce = 0;
  @CAN_RadarRR::RRR_Object::RRR_Object_Obj28.PxPyCoVnce = 0;
  @CAN_RadarRR::RRR_Object::RRR_Object_Obj28.PxVnce = 0;
  @CAN_RadarRR::RRR_Object::RRR_Object_Obj28.PxVxCoVnce = 0;
  @CAN_RadarRR::RRR_Object::RRR_Object_Obj28.PxVyCoVnce = 0;
  @CAN_RadarRR::RRR_Object::RRR_Object_Obj28.Py = 0;
  @CAN_RadarRR::RRR_Object::RRR_Object_Obj28.PyAxCoVnce = 0;
  @CAN_RadarRR::RRR_Object::RRR_Object_Obj28.PyAyCoVnce = 0;
  @CAN_RadarRR::RRR_Object::RRR_Object_Obj28.PyVnce = 0;
  @CAN_RadarRR::RRR_Object::RRR_Object_Obj28.PyVxCoVnce = 0;
  @CAN_RadarRR::RRR_Object::RRR_Object_Obj28.PyVyCoVnce = 0;
  @CAN_RadarRR::RRR_Object::RRR_Object_Obj28.ReferencePoint = 0;
  @CAN_RadarRR::RRR_Object::RRR_Object_Obj28.Vx = 0;
  @CAN_RadarRR::RRR_Object::RRR_Object_Obj28.VxAxCoVnce = 0;
  @CAN_RadarRR::RRR_Object::RRR_Object_Obj28.VxAyCoVnce = 0;
  @CAN_RadarRR::RRR_Object::RRR_Object_Obj28.VxVnce = 0;
  @CAN_RadarRR::RRR_Object::RRR_Object_Obj28.VxVyCoVnce = 0;
  @CAN_RadarRR::RRR_Object::RRR_Object_Obj28.Vy = 0;
  @CAN_RadarRR::RRR_Object::RRR_Object_Obj28.VyAxCoVnce = 0;
  @CAN_RadarRR::RRR_Object::RRR_Object_Obj28.VyAyCoVnce = 0;
  }
  if(init_count == 35)
  {
  @CAN_RadarRR::RRR_Object::RRR_Object_Obj28.VyVnce = 0;
  @CAN_RadarRR::RRR_Object::RRR_Object_Obj28.Width = 0;
  @CAN_RadarRR::RRR_Object::RRR_Object_Obj28.WidthVnce = 0;
  @CAN_RadarRR::RRR_Object::RRR_Object_Obj29.Age = 0;
  @CAN_RadarRR::RRR_Object::RRR_Object_Obj29.Ax = 0;
  @CAN_RadarRR::RRR_Object::RRR_Object_Obj29.AxAyCoVnce = 0;
  @CAN_RadarRR::RRR_Object::RRR_Object_Obj29.AxVnce = 0;
  @CAN_RadarRR::RRR_Object::RRR_Object_Obj29.Ay = 0;
  @CAN_RadarRR::RRR_Object::RRR_Object_Obj29.AyVnce = 0;
  @CAN_RadarRR::RRR_Object::RRR_Object_Obj29.ExistProb = 0;
  @CAN_RadarRR::RRR_Object::RRR_Object_Obj29.FilterInformation = 0;
  @CAN_RadarRR::RRR_Object::RRR_Object_Obj29.Length = 0;
  @CAN_RadarRR::RRR_Object::RRR_Object_Obj29.LengthVnce = 0;
  @CAN_RadarRR::RRR_Object::RRR_Object_Obj29.MeasurementStatus = 0;
  @CAN_RadarRR::RRR_Object::RRR_Object_Obj29.MovingStatus = 0;
  @CAN_RadarRR::RRR_Object::RRR_Object_Obj29.ObjId = 0;
  @CAN_RadarRR::RRR_Object::RRR_Object_Obj29.OrientationYaw = 0;
  @CAN_RadarRR::RRR_Object::RRR_Object_Obj29.OrientationYawVnce = 0;
  @CAN_RadarRR::RRR_Object::RRR_Object_Obj29.ProbClassConfidence = 0;
  @CAN_RadarRR::RRR_Object::RRR_Object_Obj29.ProbClassType = 0;
  @CAN_RadarRR::RRR_Object::RRR_Object_Obj29.Px = 0;
  @CAN_RadarRR::RRR_Object::RRR_Object_Obj29.PxAxCoVnce = 0;
  @CAN_RadarRR::RRR_Object::RRR_Object_Obj29.PxAyCoVnce = 0;
  @CAN_RadarRR::RRR_Object::RRR_Object_Obj29.PxPyCoVnce = 0;
  @CAN_RadarRR::RRR_Object::RRR_Object_Obj29.PxVnce = 0;
  }
  if(init_count == 36)
  {
  @CAN_RadarRR::RRR_Object::RRR_Object_Obj29.PxVxCoVnce = 0;
  @CAN_RadarRR::RRR_Object::RRR_Object_Obj29.PxVyCoVnce = 0;
  @CAN_RadarRR::RRR_Object::RRR_Object_Obj29.Py = 0;
  @CAN_RadarRR::RRR_Object::RRR_Object_Obj29.PyAxCoVnce = 0;
  @CAN_RadarRR::RRR_Object::RRR_Object_Obj29.PyAyCoVnce = 0;
  @CAN_RadarRR::RRR_Object::RRR_Object_Obj29.PyVnce = 0;
  @CAN_RadarRR::RRR_Object::RRR_Object_Obj29.PyVxCoVnce = 0;
  @CAN_RadarRR::RRR_Object::RRR_Object_Obj29.PyVyCoVnce = 0;
  @CAN_RadarRR::RRR_Object::RRR_Object_Obj29.ReferencePoint = 0;
  @CAN_RadarRR::RRR_Object::RRR_Object_Obj29.Vx = 0;
  @CAN_RadarRR::RRR_Object::RRR_Object_Obj29.VxAxCoVnce = 0;
  @CAN_RadarRR::RRR_Object::RRR_Object_Obj29.VxAyCoVnce = 0;
  @CAN_RadarRR::RRR_Object::RRR_Object_Obj29.VxVnce = 0;
  @CAN_RadarRR::RRR_Object::RRR_Object_Obj29.VxVyCoVnce = 0;
  @CAN_RadarRR::RRR_Object::RRR_Object_Obj29.Vy = 0;
  @CAN_RadarRR::RRR_Object::RRR_Object_Obj29.VyAxCoVnce = 0;
  @CAN_RadarRR::RRR_Object::RRR_Object_Obj29.VyAyCoVnce = 0;
  @CAN_RadarRR::RRR_Object::RRR_Object_Obj29.VyVnce = 0;
  @CAN_RadarRR::RRR_Object::RRR_Object_Obj29.Width = 0;
  @CAN_RadarRR::RRR_Object::RRR_Object_Obj29.WidthVnce = 0;
  @CAN_RadarRR::RRR_Object::RRR_Object_Obj2.Age = 0;
  @CAN_RadarRR::RRR_Object::RRR_Object_Obj2.Ax = 0;
  @CAN_RadarRR::RRR_Object::RRR_Object_Obj2.AxAyCoVnce = 0;
  @CAN_RadarRR::RRR_Object::RRR_Object_Obj2.AxVnce = 0;
  @CAN_RadarRR::RRR_Object::RRR_Object_Obj2.Ay = 0;
  }
  if(init_count == 37)
  {
  @CAN_RadarRR::RRR_Object::RRR_Object_Obj2.AyVnce = 0;
  @CAN_RadarRR::RRR_Object::RRR_Object_Obj2.ExistProb = 0;
  @CAN_RadarRR::RRR_Object::RRR_Object_Obj2.FilterInformation = 0;
  @CAN_RadarRR::RRR_Object::RRR_Object_Obj2.Length = 0;
  @CAN_RadarRR::RRR_Object::RRR_Object_Obj2.LengthVnce = 0;
  @CAN_RadarRR::RRR_Object::RRR_Object_Obj2.MeasurementStatus = 0;
  @CAN_RadarRR::RRR_Object::RRR_Object_Obj2.MovingStatus = 0;
  @CAN_RadarRR::RRR_Object::RRR_Object_Obj2.ObjId = 0;
  @CAN_RadarRR::RRR_Object::RRR_Object_Obj2.OrientationYaw = 0;
  @CAN_RadarRR::RRR_Object::RRR_Object_Obj2.OrientationYawVnce = 0;
  @CAN_RadarRR::RRR_Object::RRR_Object_Obj2.ProbClassConfidence = 0;
  @CAN_RadarRR::RRR_Object::RRR_Object_Obj2.ProbClassType = 0;
  @CAN_RadarRR::RRR_Object::RRR_Object_Obj2.Px = 0;
  @CAN_RadarRR::RRR_Object::RRR_Object_Obj2.PxAxCoVnce = 0;
  @CAN_RadarRR::RRR_Object::RRR_Object_Obj2.PxAyCoVnce = 0;
  @CAN_RadarRR::RRR_Object::RRR_Object_Obj2.PxPyCoVnce = 0;
  @CAN_RadarRR::RRR_Object::RRR_Object_Obj2.PxVnce = 0;
  @CAN_RadarRR::RRR_Object::RRR_Object_Obj2.PxVxCoVnce = 0;
  @CAN_RadarRR::RRR_Object::RRR_Object_Obj2.PxVyCoVnce = 0;
  @CAN_RadarRR::RRR_Object::RRR_Object_Obj2.Py = 0;
  @CAN_RadarRR::RRR_Object::RRR_Object_Obj2.PyAxCoVnce = 0;
  @CAN_RadarRR::RRR_Object::RRR_Object_Obj2.PyAyCoVnce = 0;
  @CAN_RadarRR::RRR_Object::RRR_Object_Obj2.PyVnce = 0;
  @CAN_RadarRR::RRR_Object::RRR_Object_Obj2.PyVxCoVnce = 0;
  @CAN_RadarRR::RRR_Object::RRR_Object_Obj2.PyVyCoVnce = 0;
  }
  if(init_count == 38)
  {
  @CAN_RadarRR::RRR_Object::RRR_Object_Obj2.ReferencePoint = 0;
  @CAN_RadarRR::RRR_Object::RRR_Object_Obj2.Vx = 0;
  @CAN_RadarRR::RRR_Object::RRR_Object_Obj2.VxAxCoVnce = 0;
  @CAN_RadarRR::RRR_Object::RRR_Object_Obj2.VxAyCoVnce = 0;
  @CAN_RadarRR::RRR_Object::RRR_Object_Obj2.VxVnce = 0;
  @CAN_RadarRR::RRR_Object::RRR_Object_Obj2.VxVyCoVnce = 0;
  @CAN_RadarRR::RRR_Object::RRR_Object_Obj2.Vy = 0;
  @CAN_RadarRR::RRR_Object::RRR_Object_Obj2.VyAxCoVnce = 0;
  @CAN_RadarRR::RRR_Object::RRR_Object_Obj2.VyAyCoVnce = 0;
  @CAN_RadarRR::RRR_Object::RRR_Object_Obj2.VyVnce = 0;
  @CAN_RadarRR::RRR_Object::RRR_Object_Obj2.Width = 0;
  @CAN_RadarRR::RRR_Object::RRR_Object_Obj2.WidthVnce = 0;
  @CAN_RadarRR::RRR_Object::RRR_Object_Obj30.Age = 0;
  @CAN_RadarRR::RRR_Object::RRR_Object_Obj30.Ax = 0;
  @CAN_RadarRR::RRR_Object::RRR_Object_Obj30.AxAyCoVnce = 0;
  @CAN_RadarRR::RRR_Object::RRR_Object_Obj30.AxVnce = 0;
  @CAN_RadarRR::RRR_Object::RRR_Object_Obj30.Ay = 0;
  @CAN_RadarRR::RRR_Object::RRR_Object_Obj30.AyVnce = 0;
  @CAN_RadarRR::RRR_Object::RRR_Object_Obj30.ExistProb = 0;
  @CAN_RadarRR::RRR_Object::RRR_Object_Obj30.FilterInformation = 0;
  @CAN_RadarRR::RRR_Object::RRR_Object_Obj30.Length = 0;
  @CAN_RadarRR::RRR_Object::RRR_Object_Obj30.LengthVnce = 0;
  @CAN_RadarRR::RRR_Object::RRR_Object_Obj30.MeasurementStatus = 0;
  @CAN_RadarRR::RRR_Object::RRR_Object_Obj30.MovingStatus = 0;
  @CAN_RadarRR::RRR_Object::RRR_Object_Obj30.ObjId = 0;
  }
  if(init_count == 39)
  {
  @CAN_RadarRR::RRR_Object::RRR_Object_Obj30.OrientationYaw = 0;
  @CAN_RadarRR::RRR_Object::RRR_Object_Obj30.OrientationYawVnce = 0;
  @CAN_RadarRR::RRR_Object::RRR_Object_Obj30.ProbClassConfidence = 0;
  @CAN_RadarRR::RRR_Object::RRR_Object_Obj30.ProbClassType = 0;
  @CAN_RadarRR::RRR_Object::RRR_Object_Obj30.Px = 0;
  @CAN_RadarRR::RRR_Object::RRR_Object_Obj30.PxAxCoVnce = 0;
  @CAN_RadarRR::RRR_Object::RRR_Object_Obj30.PxAyCoVnce = 0;
  @CAN_RadarRR::RRR_Object::RRR_Object_Obj30.PxPyCoVnce = 0;
  @CAN_RadarRR::RRR_Object::RRR_Object_Obj30.PxVnce = 0;
  @CAN_RadarRR::RRR_Object::RRR_Object_Obj30.PxVxCoVnce = 0;
  @CAN_RadarRR::RRR_Object::RRR_Object_Obj30.PxVyCoVnce = 0;
  @CAN_RadarRR::RRR_Object::RRR_Object_Obj30.Py = 0;
  @CAN_RadarRR::RRR_Object::RRR_Object_Obj30.PyAxCoVnce = 0;
  @CAN_RadarRR::RRR_Object::RRR_Object_Obj30.PyAyCoVnce = 0;
  @CAN_RadarRR::RRR_Object::RRR_Object_Obj30.PyVnce = 0;
  @CAN_RadarRR::RRR_Object::RRR_Object_Obj30.PyVxCoVnce = 0;
  @CAN_RadarRR::RRR_Object::RRR_Object_Obj30.PyVyCoVnce = 0;
  @CAN_RadarRR::RRR_Object::RRR_Object_Obj30.ReferencePoint = 0;
  @CAN_RadarRR::RRR_Object::RRR_Object_Obj30.Vx = 0;
  @CAN_RadarRR::RRR_Object::RRR_Object_Obj30.VxAxCoVnce = 0;
  @CAN_RadarRR::RRR_Object::RRR_Object_Obj30.VxAyCoVnce = 0;
  @CAN_RadarRR::RRR_Object::RRR_Object_Obj30.VxVnce = 0;
  @CAN_RadarRR::RRR_Object::RRR_Object_Obj30.VxVyCoVnce = 0;
  @CAN_RadarRR::RRR_Object::RRR_Object_Obj30.Vy = 0;
  @CAN_RadarRR::RRR_Object::RRR_Object_Obj30.VyAxCoVnce = 0;
  }
  if(init_count == 40)
  {
  @CAN_RadarRR::RRR_Object::RRR_Object_Obj30.VyAyCoVnce = 0;
  @CAN_RadarRR::RRR_Object::RRR_Object_Obj30.VyVnce = 0;
  @CAN_RadarRR::RRR_Object::RRR_Object_Obj30.Width = 0;
  @CAN_RadarRR::RRR_Object::RRR_Object_Obj30.WidthVnce = 0;
  @CAN_RadarRR::RRR_Object::RRR_Object_Obj31.Age = 0;
  @CAN_RadarRR::RRR_Object::RRR_Object_Obj31.Ax = 0;
  @CAN_RadarRR::RRR_Object::RRR_Object_Obj31.AxAyCoVnce = 0;
  @CAN_RadarRR::RRR_Object::RRR_Object_Obj31.AxVnce = 0;
  @CAN_RadarRR::RRR_Object::RRR_Object_Obj31.Ay = 0;
  @CAN_RadarRR::RRR_Object::RRR_Object_Obj31.AyVnce = 0;
  @CAN_RadarRR::RRR_Object::RRR_Object_Obj31.ExistProb = 0;
  @CAN_RadarRR::RRR_Object::RRR_Object_Obj31.FilterInformation = 0;
  @CAN_RadarRR::RRR_Object::RRR_Object_Obj31.Length = 0;
  @CAN_RadarRR::RRR_Object::RRR_Object_Obj31.LengthVnce = 0;
  @CAN_RadarRR::RRR_Object::RRR_Object_Obj31.MeasurementStatus = 0;
  @CAN_RadarRR::RRR_Object::RRR_Object_Obj31.MovingStatus = 0;
  @CAN_RadarRR::RRR_Object::RRR_Object_Obj31.ObjId = 0;
  @CAN_RadarRR::RRR_Object::RRR_Object_Obj31.OrientationYaw = 0;
  @CAN_RadarRR::RRR_Object::RRR_Object_Obj31.OrientationYawVnce = 0;
  @CAN_RadarRR::RRR_Object::RRR_Object_Obj31.ProbClassConfidence = 0;
  @CAN_RadarRR::RRR_Object::RRR_Object_Obj31.ProbClassType = 0;
  @CAN_RadarRR::RRR_Object::RRR_Object_Obj31.Px = 0;
  @CAN_RadarRR::RRR_Object::RRR_Object_Obj31.PxAxCoVnce = 0;
  @CAN_RadarRR::RRR_Object::RRR_Object_Obj31.PxAyCoVnce = 0;
  @CAN_RadarRR::RRR_Object::RRR_Object_Obj31.PxPyCoVnce = 0;
  }
  if(init_count == 41)
  {
  @CAN_RadarRR::RRR_Object::RRR_Object_Obj31.PxVnce = 0;
  @CAN_RadarRR::RRR_Object::RRR_Object_Obj31.PxVxCoVnce = 0;
  @CAN_RadarRR::RRR_Object::RRR_Object_Obj31.PxVyCoVnce = 0;
  @CAN_RadarRR::RRR_Object::RRR_Object_Obj31.Py = 0;
  @CAN_RadarRR::RRR_Object::RRR_Object_Obj31.PyAxCoVnce = 0;
  @CAN_RadarRR::RRR_Object::RRR_Object_Obj31.PyAyCoVnce = 0;
  @CAN_RadarRR::RRR_Object::RRR_Object_Obj31.PyVnce = 0;
  @CAN_RadarRR::RRR_Object::RRR_Object_Obj31.PyVxCoVnce = 0;
  @CAN_RadarRR::RRR_Object::RRR_Object_Obj31.PyVyCoVnce = 0;
  @CAN_RadarRR::RRR_Object::RRR_Object_Obj31.ReferencePoint = 0;
  @CAN_RadarRR::RRR_Object::RRR_Object_Obj31.Vx = 0;
  @CAN_RadarRR::RRR_Object::RRR_Object_Obj31.VxAxCoVnce = 0;
  @CAN_RadarRR::RRR_Object::RRR_Object_Obj31.VxAyCoVnce = 0;
  @CAN_RadarRR::RRR_Object::RRR_Object_Obj31.VxVnce = 0;
  @CAN_RadarRR::RRR_Object::RRR_Object_Obj31.VxVyCoVnce = 0;
  @CAN_RadarRR::RRR_Object::RRR_Object_Obj31.Vy = 0;
  @CAN_RadarRR::RRR_Object::RRR_Object_Obj31.VyAxCoVnce = 0;
  @CAN_RadarRR::RRR_Object::RRR_Object_Obj31.VyAyCoVnce = 0;
  @CAN_RadarRR::RRR_Object::RRR_Object_Obj31.VyVnce = 0;
  @CAN_RadarRR::RRR_Object::RRR_Object_Obj31.Width = 0;
  @CAN_RadarRR::RRR_Object::RRR_Object_Obj31.WidthVnce = 0;
  @CAN_RadarRR::RRR_Object::RRR_Object_Obj32.Age = 0;
  @CAN_RadarRR::RRR_Object::RRR_Object_Obj32.Ax = 0;
  @CAN_RadarRR::RRR_Object::RRR_Object_Obj32.AxAyCoVnce = 0;
  @CAN_RadarRR::RRR_Object::RRR_Object_Obj32.AxVnce = 0;
  }
  if(init_count == 42)
  {
  @CAN_RadarRR::RRR_Object::RRR_Object_Obj32.Ay = 0;
  @CAN_RadarRR::RRR_Object::RRR_Object_Obj32.AyVnce = 0;
  @CAN_RadarRR::RRR_Object::RRR_Object_Obj32.ExistProb = 0;
  @CAN_RadarRR::RRR_Object::RRR_Object_Obj32.FilterInformation = 0;
  @CAN_RadarRR::RRR_Object::RRR_Object_Obj32.Length = 0;
  @CAN_RadarRR::RRR_Object::RRR_Object_Obj32.LengthVnce = 0;
  @CAN_RadarRR::RRR_Object::RRR_Object_Obj32.MeasurementStatus = 0;
  @CAN_RadarRR::RRR_Object::RRR_Object_Obj32.MovingStatus = 0;
  @CAN_RadarRR::RRR_Object::RRR_Object_Obj32.ObjId = 0;
  @CAN_RadarRR::RRR_Object::RRR_Object_Obj32.OrientationYaw = 0;
  @CAN_RadarRR::RRR_Object::RRR_Object_Obj32.OrientationYawVnce = 0;
  @CAN_RadarRR::RRR_Object::RRR_Object_Obj32.ProbClassConfidence = 0;
  @CAN_RadarRR::RRR_Object::RRR_Object_Obj32.ProbClassType = 0;
  @CAN_RadarRR::RRR_Object::RRR_Object_Obj32.Px = 0;
  @CAN_RadarRR::RRR_Object::RRR_Object_Obj32.PxAxCoVnce = 0;
  @CAN_RadarRR::RRR_Object::RRR_Object_Obj32.PxAyCoVnce = 0;
  @CAN_RadarRR::RRR_Object::RRR_Object_Obj32.PxPyCoVnce = 0;
  @CAN_RadarRR::RRR_Object::RRR_Object_Obj32.PxVnce = 0;
  @CAN_RadarRR::RRR_Object::RRR_Object_Obj32.PxVxCoVnce = 0;
  @CAN_RadarRR::RRR_Object::RRR_Object_Obj32.PxVyCoVnce = 0;
  @CAN_RadarRR::RRR_Object::RRR_Object_Obj32.Py = 0;
  @CAN_RadarRR::RRR_Object::RRR_Object_Obj32.PyAxCoVnce = 0;
  @CAN_RadarRR::RRR_Object::RRR_Object_Obj32.PyAyCoVnce = 0;
  @CAN_RadarRR::RRR_Object::RRR_Object_Obj32.PyVnce = 0;
  @CAN_RadarRR::RRR_Object::RRR_Object_Obj32.PyVxCoVnce = 0;
  }
  if(init_count == 43)
  {
  @CAN_RadarRR::RRR_Object::RRR_Object_Obj32.PyVyCoVnce = 0;
  @CAN_RadarRR::RRR_Object::RRR_Object_Obj32.ReferencePoint = 0;
  @CAN_RadarRR::RRR_Object::RRR_Object_Obj32.Vx = 0;
  @CAN_RadarRR::RRR_Object::RRR_Object_Obj32.VxAxCoVnce = 0;
  @CAN_RadarRR::RRR_Object::RRR_Object_Obj32.VxAyCoVnce = 0;
  @CAN_RadarRR::RRR_Object::RRR_Object_Obj32.VxVnce = 0;
  @CAN_RadarRR::RRR_Object::RRR_Object_Obj32.VxVyCoVnce = 0;
  @CAN_RadarRR::RRR_Object::RRR_Object_Obj32.Vy = 0;
  @CAN_RadarRR::RRR_Object::RRR_Object_Obj32.VyAxCoVnce = 0;
  @CAN_RadarRR::RRR_Object::RRR_Object_Obj32.VyAyCoVnce = 0;
  @CAN_RadarRR::RRR_Object::RRR_Object_Obj32.VyVnce = 0;
  @CAN_RadarRR::RRR_Object::RRR_Object_Obj32.Width = 0;
  @CAN_RadarRR::RRR_Object::RRR_Object_Obj32.WidthVnce = 0;
  @CAN_RadarRR::RRR_Object::RRR_Object_Obj33.Age = 0;
  @CAN_RadarRR::RRR_Object::RRR_Object_Obj33.Ax = 0;
  @CAN_RadarRR::RRR_Object::RRR_Object_Obj33.AxAyCoVnce = 0;
  @CAN_RadarRR::RRR_Object::RRR_Object_Obj33.AxVnce = 0;
  @CAN_RadarRR::RRR_Object::RRR_Object_Obj33.Ay = 0;
  @CAN_RadarRR::RRR_Object::RRR_Object_Obj33.AyVnce = 0;
  @CAN_RadarRR::RRR_Object::RRR_Object_Obj33.ExistProb = 0;
  @CAN_RadarRR::RRR_Object::RRR_Object_Obj33.FilterInformation = 0;
  @CAN_RadarRR::RRR_Object::RRR_Object_Obj33.Length = 0;
  @CAN_RadarRR::RRR_Object::RRR_Object_Obj33.LengthVnce = 0;
  @CAN_RadarRR::RRR_Object::RRR_Object_Obj33.MeasurementStatus = 0;
  @CAN_RadarRR::RRR_Object::RRR_Object_Obj33.MovingStatus = 0;
  }
  if(init_count == 44)
  {
  @CAN_RadarRR::RRR_Object::RRR_Object_Obj33.ObjId = 0;
  @CAN_RadarRR::RRR_Object::RRR_Object_Obj33.OrientationYaw = 0;
  @CAN_RadarRR::RRR_Object::RRR_Object_Obj33.OrientationYawVnce = 0;
  @CAN_RadarRR::RRR_Object::RRR_Object_Obj33.ProbClassConfidence = 0;
  @CAN_RadarRR::RRR_Object::RRR_Object_Obj33.ProbClassType = 0;
  @CAN_RadarRR::RRR_Object::RRR_Object_Obj33.Px = 0;
  @CAN_RadarRR::RRR_Object::RRR_Object_Obj33.PxAxCoVnce = 0;
  @CAN_RadarRR::RRR_Object::RRR_Object_Obj33.PxAyCoVnce = 0;
  @CAN_RadarRR::RRR_Object::RRR_Object_Obj33.PxPyCoVnce = 0;
  @CAN_RadarRR::RRR_Object::RRR_Object_Obj33.PxVnce = 0;
  @CAN_RadarRR::RRR_Object::RRR_Object_Obj33.PxVxCoVnce = 0;
  @CAN_RadarRR::RRR_Object::RRR_Object_Obj33.PxVyCoVnce = 0;
  @CAN_RadarRR::RRR_Object::RRR_Object_Obj33.Py = 0;
  @CAN_RadarRR::RRR_Object::RRR_Object_Obj33.PyAxCoVnce = 0;
  @CAN_RadarRR::RRR_Object::RRR_Object_Obj33.PyAyCoVnce = 0;
  @CAN_RadarRR::RRR_Object::RRR_Object_Obj33.PyVnce = 0;
  @CAN_RadarRR::RRR_Object::RRR_Object_Obj33.PyVxCoVnce = 0;
  @CAN_RadarRR::RRR_Object::RRR_Object_Obj33.PyVyCoVnce = 0;
  @CAN_RadarRR::RRR_Object::RRR_Object_Obj33.ReferencePoint = 0;
  @CAN_RadarRR::RRR_Object::RRR_Object_Obj33.Vx = 0;
  @CAN_RadarRR::RRR_Object::RRR_Object_Obj33.VxAxCoVnce = 0;
  @CAN_RadarRR::RRR_Object::RRR_Object_Obj33.VxAyCoVnce = 0;
  @CAN_RadarRR::RRR_Object::RRR_Object_Obj33.VxVnce = 0;
  @CAN_RadarRR::RRR_Object::RRR_Object_Obj33.VxVyCoVnce = 0;
  @CAN_RadarRR::RRR_Object::RRR_Object_Obj33.Vy = 0;
  }
  if(init_count == 45)
  {
  @CAN_RadarRR::RRR_Object::RRR_Object_Obj33.VyAxCoVnce = 0;
  @CAN_RadarRR::RRR_Object::RRR_Object_Obj33.VyAyCoVnce = 0;
  @CAN_RadarRR::RRR_Object::RRR_Object_Obj33.VyVnce = 0;
  @CAN_RadarRR::RRR_Object::RRR_Object_Obj33.Width = 0;
  @CAN_RadarRR::RRR_Object::RRR_Object_Obj33.WidthVnce = 0;
  @CAN_RadarRR::RRR_Object::RRR_Object_Obj34.Age = 0;
  @CAN_RadarRR::RRR_Object::RRR_Object_Obj34.Ax = 0;
  @CAN_RadarRR::RRR_Object::RRR_Object_Obj34.AxAyCoVnce = 0;
  @CAN_RadarRR::RRR_Object::RRR_Object_Obj34.AxVnce = 0;
  @CAN_RadarRR::RRR_Object::RRR_Object_Obj34.Ay = 0;
  @CAN_RadarRR::RRR_Object::RRR_Object_Obj34.AyVnce = 0;
  @CAN_RadarRR::RRR_Object::RRR_Object_Obj34.ExistProb = 0;
  @CAN_RadarRR::RRR_Object::RRR_Object_Obj34.FilterInformation = 0;
  @CAN_RadarRR::RRR_Object::RRR_Object_Obj34.Length = 0;
  @CAN_RadarRR::RRR_Object::RRR_Object_Obj34.LengthVnce = 0;
  @CAN_RadarRR::RRR_Object::RRR_Object_Obj34.MeasurementStatus = 0;
  @CAN_RadarRR::RRR_Object::RRR_Object_Obj34.MovingStatus = 0;
  @CAN_RadarRR::RRR_Object::RRR_Object_Obj34.ObjId = 0;
  @CAN_RadarRR::RRR_Object::RRR_Object_Obj34.OrientationYaw = 0;
  @CAN_RadarRR::RRR_Object::RRR_Object_Obj34.OrientationYawVnce = 0;
  @CAN_RadarRR::RRR_Object::RRR_Object_Obj34.ProbClassConfidence = 0;
  @CAN_RadarRR::RRR_Object::RRR_Object_Obj34.ProbClassType = 0;
  @CAN_RadarRR::RRR_Object::RRR_Object_Obj34.Px = 0;
  @CAN_RadarRR::RRR_Object::RRR_Object_Obj34.PxAxCoVnce = 0;
  @CAN_RadarRR::RRR_Object::RRR_Object_Obj34.PxAyCoVnce = 0;
  }
  if(init_count == 46)
  {
  @CAN_RadarRR::RRR_Object::RRR_Object_Obj34.PxPyCoVnce = 0;
  @CAN_RadarRR::RRR_Object::RRR_Object_Obj34.PxVnce = 0;
  @CAN_RadarRR::RRR_Object::RRR_Object_Obj34.PxVxCoVnce = 0;
  @CAN_RadarRR::RRR_Object::RRR_Object_Obj34.PxVyCoVnce = 0;
  @CAN_RadarRR::RRR_Object::RRR_Object_Obj34.Py = 0;
  @CAN_RadarRR::RRR_Object::RRR_Object_Obj34.PyAxCoVnce = 0;
  @CAN_RadarRR::RRR_Object::RRR_Object_Obj34.PyAyCoVnce = 0;
  @CAN_RadarRR::RRR_Object::RRR_Object_Obj34.PyVnce = 0;
  @CAN_RadarRR::RRR_Object::RRR_Object_Obj34.PyVxCoVnce = 0;
  @CAN_RadarRR::RRR_Object::RRR_Object_Obj34.PyVyCoVnce = 0;
  @CAN_RadarRR::RRR_Object::RRR_Object_Obj34.ReferencePoint = 0;
  @CAN_RadarRR::RRR_Object::RRR_Object_Obj34.Vx = 0;
  @CAN_RadarRR::RRR_Object::RRR_Object_Obj34.VxAxCoVnce = 0;
  @CAN_RadarRR::RRR_Object::RRR_Object_Obj34.VxAyCoVnce = 0;
  @CAN_RadarRR::RRR_Object::RRR_Object_Obj34.VxVnce = 0;
  @CAN_RadarRR::RRR_Object::RRR_Object_Obj34.VxVyCoVnce = 0;
  @CAN_RadarRR::RRR_Object::RRR_Object_Obj34.Vy = 0;
  @CAN_RadarRR::RRR_Object::RRR_Object_Obj34.VyAxCoVnce = 0;
  @CAN_RadarRR::RRR_Object::RRR_Object_Obj34.VyAyCoVnce = 0;
  @CAN_RadarRR::RRR_Object::RRR_Object_Obj34.VyVnce = 0;
  @CAN_RadarRR::RRR_Object::RRR_Object_Obj34.Width = 0;
  @CAN_RadarRR::RRR_Object::RRR_Object_Obj34.WidthVnce = 0;
  @CAN_RadarRR::RRR_Object::RRR_Object_Obj35.Age = 0;
  @CAN_RadarRR::RRR_Object::RRR_Object_Obj35.Ax = 0;
  @CAN_RadarRR::RRR_Object::RRR_Object_Obj35.AxAyCoVnce = 0;
  }
  if(init_count == 47)
  {
  @CAN_RadarRR::RRR_Object::RRR_Object_Obj35.AxVnce = 0;
  @CAN_RadarRR::RRR_Object::RRR_Object_Obj35.Ay = 0;
  @CAN_RadarRR::RRR_Object::RRR_Object_Obj35.AyVnce = 0;
  @CAN_RadarRR::RRR_Object::RRR_Object_Obj35.ExistProb = 0;
  @CAN_RadarRR::RRR_Object::RRR_Object_Obj35.FilterInformation = 0;
  @CAN_RadarRR::RRR_Object::RRR_Object_Obj35.Length = 0;
  @CAN_RadarRR::RRR_Object::RRR_Object_Obj35.LengthVnce = 0;
  @CAN_RadarRR::RRR_Object::RRR_Object_Obj35.MeasurementStatus = 0;
  @CAN_RadarRR::RRR_Object::RRR_Object_Obj35.MovingStatus = 0;
  @CAN_RadarRR::RRR_Object::RRR_Object_Obj35.ObjId = 0;
  @CAN_RadarRR::RRR_Object::RRR_Object_Obj35.OrientationYaw = 0;
  @CAN_RadarRR::RRR_Object::RRR_Object_Obj35.OrientationYawVnce = 0;
  @CAN_RadarRR::RRR_Object::RRR_Object_Obj35.ProbClassConfidence = 0;
  @CAN_RadarRR::RRR_Object::RRR_Object_Obj35.ProbClassType = 0;
  @CAN_RadarRR::RRR_Object::RRR_Object_Obj35.Px = 0;
  @CAN_RadarRR::RRR_Object::RRR_Object_Obj35.PxAxCoVnce = 0;
  @CAN_RadarRR::RRR_Object::RRR_Object_Obj35.PxAyCoVnce = 0;
  @CAN_RadarRR::RRR_Object::RRR_Object_Obj35.PxPyCoVnce = 0;
  @CAN_RadarRR::RRR_Object::RRR_Object_Obj35.PxVnce = 0;
  @CAN_RadarRR::RRR_Object::RRR_Object_Obj35.PxVxCoVnce = 0;
  @CAN_RadarRR::RRR_Object::RRR_Object_Obj35.PxVyCoVnce = 0;
  @CAN_RadarRR::RRR_Object::RRR_Object_Obj35.Py = 0;
  @CAN_RadarRR::RRR_Object::RRR_Object_Obj35.PyAxCoVnce = 0;
  @CAN_RadarRR::RRR_Object::RRR_Object_Obj35.PyAyCoVnce = 0;
  @CAN_RadarRR::RRR_Object::RRR_Object_Obj35.PyVnce = 0;
  }
  if(init_count == 48)
  {
  @CAN_RadarRR::RRR_Object::RRR_Object_Obj35.PyVxCoVnce = 0;
  @CAN_RadarRR::RRR_Object::RRR_Object_Obj35.PyVyCoVnce = 0;
  @CAN_RadarRR::RRR_Object::RRR_Object_Obj35.ReferencePoint = 0;
  @CAN_RadarRR::RRR_Object::RRR_Object_Obj35.Vx = 0;
  @CAN_RadarRR::RRR_Object::RRR_Object_Obj35.VxAxCoVnce = 0;
  @CAN_RadarRR::RRR_Object::RRR_Object_Obj35.VxAyCoVnce = 0;
  @CAN_RadarRR::RRR_Object::RRR_Object_Obj35.VxVnce = 0;
  @CAN_RadarRR::RRR_Object::RRR_Object_Obj35.VxVyCoVnce = 0;
  @CAN_RadarRR::RRR_Object::RRR_Object_Obj35.Vy = 0;
  @CAN_RadarRR::RRR_Object::RRR_Object_Obj35.VyAxCoVnce = 0;
  @CAN_RadarRR::RRR_Object::RRR_Object_Obj35.VyAyCoVnce = 0;
  @CAN_RadarRR::RRR_Object::RRR_Object_Obj35.VyVnce = 0;
  @CAN_RadarRR::RRR_Object::RRR_Object_Obj35.Width = 0;
  @CAN_RadarRR::RRR_Object::RRR_Object_Obj35.WidthVnce = 0;
  @CAN_RadarRR::RRR_Object::RRR_Object_Obj36.Age = 0;
  @CAN_RadarRR::RRR_Object::RRR_Object_Obj36.Ax = 0;
  @CAN_RadarRR::RRR_Object::RRR_Object_Obj36.AxAyCoVnce = 0;
  @CAN_RadarRR::RRR_Object::RRR_Object_Obj36.AxVnce = 0;
  @CAN_RadarRR::RRR_Object::RRR_Object_Obj36.Ay = 0;
  @CAN_RadarRR::RRR_Object::RRR_Object_Obj36.AyVnce = 0;
  @CAN_RadarRR::RRR_Object::RRR_Object_Obj36.ExistProb = 0;
  @CAN_RadarRR::RRR_Object::RRR_Object_Obj36.FilterInformation = 0;
  @CAN_RadarRR::RRR_Object::RRR_Object_Obj36.Length = 0;
  @CAN_RadarRR::RRR_Object::RRR_Object_Obj36.LengthVnce = 0;
  @CAN_RadarRR::RRR_Object::RRR_Object_Obj36.MeasurementStatus = 0;
  }
  if(init_count == 49)
  {
  @CAN_RadarRR::RRR_Object::RRR_Object_Obj36.MovingStatus = 0;
  @CAN_RadarRR::RRR_Object::RRR_Object_Obj36.ObjId = 0;
  @CAN_RadarRR::RRR_Object::RRR_Object_Obj36.OrientationYaw = 0;
  @CAN_RadarRR::RRR_Object::RRR_Object_Obj36.OrientationYawVnce = 0;
  @CAN_RadarRR::RRR_Object::RRR_Object_Obj36.ProbClassConfidence = 0;
  @CAN_RadarRR::RRR_Object::RRR_Object_Obj36.ProbClassType = 0;
  @CAN_RadarRR::RRR_Object::RRR_Object_Obj36.Px = 0;
  @CAN_RadarRR::RRR_Object::RRR_Object_Obj36.PxAxCoVnce = 0;
  @CAN_RadarRR::RRR_Object::RRR_Object_Obj36.PxAyCoVnce = 0;
  @CAN_RadarRR::RRR_Object::RRR_Object_Obj36.PxPyCoVnce = 0;
  @CAN_RadarRR::RRR_Object::RRR_Object_Obj36.PxVnce = 0;
  @CAN_RadarRR::RRR_Object::RRR_Object_Obj36.PxVxCoVnce = 0;
  @CAN_RadarRR::RRR_Object::RRR_Object_Obj36.PxVyCoVnce = 0;
  @CAN_RadarRR::RRR_Object::RRR_Object_Obj36.Py = 0;
  @CAN_RadarRR::RRR_Object::RRR_Object_Obj36.PyAxCoVnce = 0;
  @CAN_RadarRR::RRR_Object::RRR_Object_Obj36.PyAyCoVnce = 0;
  @CAN_RadarRR::RRR_Object::RRR_Object_Obj36.PyVnce = 0;
  @CAN_RadarRR::RRR_Object::RRR_Object_Obj36.PyVxCoVnce = 0;
  @CAN_RadarRR::RRR_Object::RRR_Object_Obj36.PyVyCoVnce = 0;
  @CAN_RadarRR::RRR_Object::RRR_Object_Obj36.ReferencePoint = 0;
  @CAN_RadarRR::RRR_Object::RRR_Object_Obj36.Vx = 0;
  @CAN_RadarRR::RRR_Object::RRR_Object_Obj36.VxAxCoVnce = 0;
  @CAN_RadarRR::RRR_Object::RRR_Object_Obj36.VxAyCoVnce = 0;
  @CAN_RadarRR::RRR_Object::RRR_Object_Obj36.VxVnce = 0;
  @CAN_RadarRR::RRR_Object::RRR_Object_Obj36.VxVyCoVnce = 0;
  }
  if(init_count == 50)
  {
  @CAN_RadarRR::RRR_Object::RRR_Object_Obj36.Vy = 0;
  @CAN_RadarRR::RRR_Object::RRR_Object_Obj36.VyAxCoVnce = 0;
  @CAN_RadarRR::RRR_Object::RRR_Object_Obj36.VyAyCoVnce = 0;
  @CAN_RadarRR::RRR_Object::RRR_Object_Obj36.VyVnce = 0;
  @CAN_RadarRR::RRR_Object::RRR_Object_Obj36.Width = 0;
  @CAN_RadarRR::RRR_Object::RRR_Object_Obj36.WidthVnce = 0;
  @CAN_RadarRR::RRR_Object::RRR_Object_Obj37.Age = 0;
  @CAN_RadarRR::RRR_Object::RRR_Object_Obj37.Ax = 0;
  @CAN_RadarRR::RRR_Object::RRR_Object_Obj37.AxAyCoVnce = 0;
  @CAN_RadarRR::RRR_Object::RRR_Object_Obj37.AxVnce = 0;
  @CAN_RadarRR::RRR_Object::RRR_Object_Obj37.Ay = 0;
  @CAN_RadarRR::RRR_Object::RRR_Object_Obj37.AyVnce = 0;
  @CAN_RadarRR::RRR_Object::RRR_Object_Obj37.ExistProb = 0;
  @CAN_RadarRR::RRR_Object::RRR_Object_Obj37.FilterInformation = 0;
  @CAN_RadarRR::RRR_Object::RRR_Object_Obj37.Length = 0;
  @CAN_RadarRR::RRR_Object::RRR_Object_Obj37.LengthVnce = 0;
  @CAN_RadarRR::RRR_Object::RRR_Object_Obj37.MeasurementStatus = 0;
  @CAN_RadarRR::RRR_Object::RRR_Object_Obj37.MovingStatus = 0;
  @CAN_RadarRR::RRR_Object::RRR_Object_Obj37.ObjId = 0;
  @CAN_RadarRR::RRR_Object::RRR_Object_Obj37.OrientationYaw = 0;
  @CAN_RadarRR::RRR_Object::RRR_Object_Obj37.OrientationYawVnce = 0;
  @CAN_RadarRR::RRR_Object::RRR_Object_Obj37.ProbClassConfidence = 0;
  @CAN_RadarRR::RRR_Object::RRR_Object_Obj37.ProbClassType = 0;
  @CAN_RadarRR::RRR_Object::RRR_Object_Obj37.Px = 0;
  @CAN_RadarRR::RRR_Object::RRR_Object_Obj37.PxAxCoVnce = 0;
  }
  if(init_count == 51)
  {
  @CAN_RadarRR::RRR_Object::RRR_Object_Obj37.PxAyCoVnce = 0;
  @CAN_RadarRR::RRR_Object::RRR_Object_Obj37.PxPyCoVnce = 0;
  @CAN_RadarRR::RRR_Object::RRR_Object_Obj37.PxVnce = 0;
  @CAN_RadarRR::RRR_Object::RRR_Object_Obj37.PxVxCoVnce = 0;
  @CAN_RadarRR::RRR_Object::RRR_Object_Obj37.PxVyCoVnce = 0;
  @CAN_RadarRR::RRR_Object::RRR_Object_Obj37.Py = 0;
  @CAN_RadarRR::RRR_Object::RRR_Object_Obj37.PyAxCoVnce = 0;
  @CAN_RadarRR::RRR_Object::RRR_Object_Obj37.PyAyCoVnce = 0;
  @CAN_RadarRR::RRR_Object::RRR_Object_Obj37.PyVnce = 0;
  @CAN_RadarRR::RRR_Object::RRR_Object_Obj37.PyVxCoVnce = 0;
  @CAN_RadarRR::RRR_Object::RRR_Object_Obj37.PyVyCoVnce = 0;
  @CAN_RadarRR::RRR_Object::RRR_Object_Obj37.ReferencePoint = 0;
  @CAN_RadarRR::RRR_Object::RRR_Object_Obj37.Vx = 0;
  @CAN_RadarRR::RRR_Object::RRR_Object_Obj37.VxAxCoVnce = 0;
  @CAN_RadarRR::RRR_Object::RRR_Object_Obj37.VxAyCoVnce = 0;
  @CAN_RadarRR::RRR_Object::RRR_Object_Obj37.VxVnce = 0;
  @CAN_RadarRR::RRR_Object::RRR_Object_Obj37.VxVyCoVnce = 0;
  @CAN_RadarRR::RRR_Object::RRR_Object_Obj37.Vy = 0;
  @CAN_RadarRR::RRR_Object::RRR_Object_Obj37.VyAxCoVnce = 0;
  @CAN_RadarRR::RRR_Object::RRR_Object_Obj37.VyAyCoVnce = 0;
  @CAN_RadarRR::RRR_Object::RRR_Object_Obj37.VyVnce = 0;
  @CAN_RadarRR::RRR_Object::RRR_Object_Obj37.Width = 0;
  @CAN_RadarRR::RRR_Object::RRR_Object_Obj37.WidthVnce = 0;
  @CAN_RadarRR::RRR_Object::RRR_Object_Obj38.Age = 0;
  @CAN_RadarRR::RRR_Object::RRR_Object_Obj38.Ax = 0;
  }
  if(init_count == 52)
  {
  @CAN_RadarRR::RRR_Object::RRR_Object_Obj38.AxAyCoVnce = 0;
  @CAN_RadarRR::RRR_Object::RRR_Object_Obj38.AxVnce = 0;
  @CAN_RadarRR::RRR_Object::RRR_Object_Obj38.Ay = 0;
  @CAN_RadarRR::RRR_Object::RRR_Object_Obj38.AyVnce = 0;
  @CAN_RadarRR::RRR_Object::RRR_Object_Obj38.ExistProb = 0;
  @CAN_RadarRR::RRR_Object::RRR_Object_Obj38.FilterInformation = 0;
  @CAN_RadarRR::RRR_Object::RRR_Object_Obj38.Length = 0;
  @CAN_RadarRR::RRR_Object::RRR_Object_Obj38.LengthVnce = 0;
  @CAN_RadarRR::RRR_Object::RRR_Object_Obj38.MeasurementStatus = 0;
  @CAN_RadarRR::RRR_Object::RRR_Object_Obj38.MovingStatus = 0;
  @CAN_RadarRR::RRR_Object::RRR_Object_Obj38.ObjId = 0;
  @CAN_RadarRR::RRR_Object::RRR_Object_Obj38.OrientationYaw = 0;
  @CAN_RadarRR::RRR_Object::RRR_Object_Obj38.OrientationYawVnce = 0;
  @CAN_RadarRR::RRR_Object::RRR_Object_Obj38.ProbClassConfidence = 0;
  @CAN_RadarRR::RRR_Object::RRR_Object_Obj38.ProbClassType = 0;
  @CAN_RadarRR::RRR_Object::RRR_Object_Obj38.Px = 0;
  @CAN_RadarRR::RRR_Object::RRR_Object_Obj38.PxAxCoVnce = 0;
  @CAN_RadarRR::RRR_Object::RRR_Object_Obj38.PxAyCoVnce = 0;
  @CAN_RadarRR::RRR_Object::RRR_Object_Obj38.PxPyCoVnce = 0;
  @CAN_RadarRR::RRR_Object::RRR_Object_Obj38.PxVnce = 0;
  @CAN_RadarRR::RRR_Object::RRR_Object_Obj38.PxVxCoVnce = 0;
  @CAN_RadarRR::RRR_Object::RRR_Object_Obj38.PxVyCoVnce = 0;
  @CAN_RadarRR::RRR_Object::RRR_Object_Obj38.Py = 0;
  @CAN_RadarRR::RRR_Object::RRR_Object_Obj38.PyAxCoVnce = 0;
  @CAN_RadarRR::RRR_Object::RRR_Object_Obj38.PyAyCoVnce = 0;
  }
  if(init_count == 53)
  {
  @CAN_RadarRR::RRR_Object::RRR_Object_Obj38.PyVnce = 0;
  @CAN_RadarRR::RRR_Object::RRR_Object_Obj38.PyVxCoVnce = 0;
  @CAN_RadarRR::RRR_Object::RRR_Object_Obj38.PyVyCoVnce = 0;
  @CAN_RadarRR::RRR_Object::RRR_Object_Obj38.ReferencePoint = 0;
  @CAN_RadarRR::RRR_Object::RRR_Object_Obj38.Vx = 0;
  @CAN_RadarRR::RRR_Object::RRR_Object_Obj38.VxAxCoVnce = 0;
  @CAN_RadarRR::RRR_Object::RRR_Object_Obj38.VxAyCoVnce = 0;
  @CAN_RadarRR::RRR_Object::RRR_Object_Obj38.VxVnce = 0;
  @CAN_RadarRR::RRR_Object::RRR_Object_Obj38.VxVyCoVnce = 0;
  @CAN_RadarRR::RRR_Object::RRR_Object_Obj38.Vy = 0;
  @CAN_RadarRR::RRR_Object::RRR_Object_Obj38.VyAxCoVnce = 0;
  @CAN_RadarRR::RRR_Object::RRR_Object_Obj38.VyAyCoVnce = 0;
  @CAN_RadarRR::RRR_Object::RRR_Object_Obj38.VyVnce = 0;
  @CAN_RadarRR::RRR_Object::RRR_Object_Obj38.Width = 0;
  @CAN_RadarRR::RRR_Object::RRR_Object_Obj38.WidthVnce = 0;
  @CAN_RadarRR::RRR_Object::RRR_Object_Obj39.Age = 0;
  @CAN_RadarRR::RRR_Object::RRR_Object_Obj39.Ax = 0;
  @CAN_RadarRR::RRR_Object::RRR_Object_Obj39.AxAyCoVnce = 0;
  @CAN_RadarRR::RRR_Object::RRR_Object_Obj39.AxVnce = 0;
  @CAN_RadarRR::RRR_Object::RRR_Object_Obj39.Ay = 0;
  @CAN_RadarRR::RRR_Object::RRR_Object_Obj39.AyVnce = 0;
  @CAN_RadarRR::RRR_Object::RRR_Object_Obj39.ExistProb = 0;
  @CAN_RadarRR::RRR_Object::RRR_Object_Obj39.FilterInformation = 0;
  @CAN_RadarRR::RRR_Object::RRR_Object_Obj39.Length = 0;
  @CAN_RadarRR::RRR_Object::RRR_Object_Obj39.LengthVnce = 0;
  }
  if(init_count == 54)
  {
  @CAN_RadarRR::RRR_Object::RRR_Object_Obj39.MeasurementStatus = 0;
  @CAN_RadarRR::RRR_Object::RRR_Object_Obj39.MovingStatus = 0;
  @CAN_RadarRR::RRR_Object::RRR_Object_Obj39.ObjId = 0;
  @CAN_RadarRR::RRR_Object::RRR_Object_Obj39.OrientationYaw = 0;
  @CAN_RadarRR::RRR_Object::RRR_Object_Obj39.OrientationYawVnce = 0;
  @CAN_RadarRR::RRR_Object::RRR_Object_Obj39.ProbClassConfidence = 0;
  @CAN_RadarRR::RRR_Object::RRR_Object_Obj39.ProbClassType = 0;
  @CAN_RadarRR::RRR_Object::RRR_Object_Obj39.Px = 0;
  @CAN_RadarRR::RRR_Object::RRR_Object_Obj39.PxAxCoVnce = 0;
  @CAN_RadarRR::RRR_Object::RRR_Object_Obj39.PxAyCoVnce = 0;
  @CAN_RadarRR::RRR_Object::RRR_Object_Obj39.PxPyCoVnce = 0;
  @CAN_RadarRR::RRR_Object::RRR_Object_Obj39.PxVnce = 0;
  @CAN_RadarRR::RRR_Object::RRR_Object_Obj39.PxVxCoVnce = 0;
  @CAN_RadarRR::RRR_Object::RRR_Object_Obj39.PxVyCoVnce = 0;
  @CAN_RadarRR::RRR_Object::RRR_Object_Obj39.Py = 0;
  @CAN_RadarRR::RRR_Object::RRR_Object_Obj39.PyAxCoVnce = 0;
  @CAN_RadarRR::RRR_Object::RRR_Object_Obj39.PyAyCoVnce = 0;
  @CAN_RadarRR::RRR_Object::RRR_Object_Obj39.PyVnce = 0;
  @CAN_RadarRR::RRR_Object::RRR_Object_Obj39.PyVxCoVnce = 0;
  @CAN_RadarRR::RRR_Object::RRR_Object_Obj39.PyVyCoVnce = 0;
  @CAN_RadarRR::RRR_Object::RRR_Object_Obj39.ReferencePoint = 0;
  @CAN_RadarRR::RRR_Object::RRR_Object_Obj39.Vx = 0;
  @CAN_RadarRR::RRR_Object::RRR_Object_Obj39.VxAxCoVnce = 0;
  @CAN_RadarRR::RRR_Object::RRR_Object_Obj39.VxAyCoVnce = 0;
  @CAN_RadarRR::RRR_Object::RRR_Object_Obj39.VxVnce = 0;
  }
  if(init_count == 55)
  {
  @CAN_RadarRR::RRR_Object::RRR_Object_Obj39.VxVyCoVnce = 0;
  @CAN_RadarRR::RRR_Object::RRR_Object_Obj39.Vy = 0;
  @CAN_RadarRR::RRR_Object::RRR_Object_Obj39.VyAxCoVnce = 0;
  @CAN_RadarRR::RRR_Object::RRR_Object_Obj39.VyAyCoVnce = 0;
  @CAN_RadarRR::RRR_Object::RRR_Object_Obj39.VyVnce = 0;
  @CAN_RadarRR::RRR_Object::RRR_Object_Obj39.Width = 0;
  @CAN_RadarRR::RRR_Object::RRR_Object_Obj39.WidthVnce = 0;
  @CAN_RadarRR::RRR_Object::RRR_Object_Obj3.Age = 0;
  @CAN_RadarRR::RRR_Object::RRR_Object_Obj3.Ax = 0;
  @CAN_RadarRR::RRR_Object::RRR_Object_Obj3.AxAyCoVnce = 0;
  @CAN_RadarRR::RRR_Object::RRR_Object_Obj3.AxVnce = 0;
  @CAN_RadarRR::RRR_Object::RRR_Object_Obj3.Ay = 0;
  @CAN_RadarRR::RRR_Object::RRR_Object_Obj3.AyVnce = 0;
  @CAN_RadarRR::RRR_Object::RRR_Object_Obj3.ExistProb = 0;
  @CAN_RadarRR::RRR_Object::RRR_Object_Obj3.FilterInformation = 0;
  @CAN_RadarRR::RRR_Object::RRR_Object_Obj3.Length = 0;
  @CAN_RadarRR::RRR_Object::RRR_Object_Obj3.LengthVnce = 0;
  @CAN_RadarRR::RRR_Object::RRR_Object_Obj3.MeasurementStatus = 0;
  @CAN_RadarRR::RRR_Object::RRR_Object_Obj3.MovingStatus = 0;
  @CAN_RadarRR::RRR_Object::RRR_Object_Obj3.ObjId = 0;
  @CAN_RadarRR::RRR_Object::RRR_Object_Obj3.OrientationYaw = 0;
  @CAN_RadarRR::RRR_Object::RRR_Object_Obj3.OrientationYawVnce = 0;
  @CAN_RadarRR::RRR_Object::RRR_Object_Obj3.ProbClassConfidence = 0;
  @CAN_RadarRR::RRR_Object::RRR_Object_Obj3.ProbClassType = 0;
  @CAN_RadarRR::RRR_Object::RRR_Object_Obj3.Px = 0;
  }
  if(init_count == 56)
  {
  @CAN_RadarRR::RRR_Object::RRR_Object_Obj3.PxAxCoVnce = 0;
  @CAN_RadarRR::RRR_Object::RRR_Object_Obj3.PxAyCoVnce = 0;
  @CAN_RadarRR::RRR_Object::RRR_Object_Obj3.PxPyCoVnce = 0;
  @CAN_RadarRR::RRR_Object::RRR_Object_Obj3.PxVnce = 0;
  @CAN_RadarRR::RRR_Object::RRR_Object_Obj3.PxVxCoVnce = 0;
  @CAN_RadarRR::RRR_Object::RRR_Object_Obj3.PxVyCoVnce = 0;
  @CAN_RadarRR::RRR_Object::RRR_Object_Obj3.Py = 0;
  @CAN_RadarRR::RRR_Object::RRR_Object_Obj3.PyAxCoVnce = 0;
  @CAN_RadarRR::RRR_Object::RRR_Object_Obj3.PyAyCoVnce = 0;
  @CAN_RadarRR::RRR_Object::RRR_Object_Obj3.PyVnce = 0;
  @CAN_RadarRR::RRR_Object::RRR_Object_Obj3.PyVxCoVnce = 0;
  @CAN_RadarRR::RRR_Object::RRR_Object_Obj3.PyVyCoVnce = 0;
  @CAN_RadarRR::RRR_Object::RRR_Object_Obj3.ReferencePoint = 0;
  @CAN_RadarRR::RRR_Object::RRR_Object_Obj3.Vx = 0;
  @CAN_RadarRR::RRR_Object::RRR_Object_Obj3.VxAxCoVnce = 0;
  @CAN_RadarRR::RRR_Object::RRR_Object_Obj3.VxAyCoVnce = 0;
  @CAN_RadarRR::RRR_Object::RRR_Object_Obj3.VxVnce = 0;
  @CAN_RadarRR::RRR_Object::RRR_Object_Obj3.VxVyCoVnce = 0;
  @CAN_RadarRR::RRR_Object::RRR_Object_Obj3.Vy = 0;
  @CAN_RadarRR::RRR_Object::RRR_Object_Obj3.VyAxCoVnce = 0;
  @CAN_RadarRR::RRR_Object::RRR_Object_Obj3.VyAyCoVnce = 0;
  @CAN_RadarRR::RRR_Object::RRR_Object_Obj3.VyVnce = 0;
  @CAN_RadarRR::RRR_Object::RRR_Object_Obj3.Width = 0;
  @CAN_RadarRR::RRR_Object::RRR_Object_Obj3.WidthVnce = 0;
  @CAN_RadarRR::RRR_Object::RRR_Object_Obj40.Age = 0;
  }
  if(init_count == 57)
  {
  @CAN_RadarRR::RRR_Object::RRR_Object_Obj40.Ax = 0;
  @CAN_RadarRR::RRR_Object::RRR_Object_Obj40.AxAyCoVnce = 0;
  @CAN_RadarRR::RRR_Object::RRR_Object_Obj40.AxVnce = 0;
  @CAN_RadarRR::RRR_Object::RRR_Object_Obj40.Ay = 0;
  @CAN_RadarRR::RRR_Object::RRR_Object_Obj40.AyVnce = 0;
  @CAN_RadarRR::RRR_Object::RRR_Object_Obj40.ExistProb = 0;
  @CAN_RadarRR::RRR_Object::RRR_Object_Obj40.FilterInformation = 0;
  @CAN_RadarRR::RRR_Object::RRR_Object_Obj40.Length = 0;
  @CAN_RadarRR::RRR_Object::RRR_Object_Obj40.LengthVnce = 0;
  @CAN_RadarRR::RRR_Object::RRR_Object_Obj40.MeasurementStatus = 0;
  @CAN_RadarRR::RRR_Object::RRR_Object_Obj40.MovingStatus = 0;
  @CAN_RadarRR::RRR_Object::RRR_Object_Obj40.ObjId = 0;
  @CAN_RadarRR::RRR_Object::RRR_Object_Obj40.OrientationYaw = 0;
  @CAN_RadarRR::RRR_Object::RRR_Object_Obj40.OrientationYawVnce = 0;
  @CAN_RadarRR::RRR_Object::RRR_Object_Obj40.ProbClassConfidence = 0;
  @CAN_RadarRR::RRR_Object::RRR_Object_Obj40.ProbClassType = 0;
  @CAN_RadarRR::RRR_Object::RRR_Object_Obj40.Px = 0;
  @CAN_RadarRR::RRR_Object::RRR_Object_Obj40.PxAxCoVnce = 0;
  @CAN_RadarRR::RRR_Object::RRR_Object_Obj40.PxAyCoVnce = 0;
  @CAN_RadarRR::RRR_Object::RRR_Object_Obj40.PxPyCoVnce = 0;
  @CAN_RadarRR::RRR_Object::RRR_Object_Obj40.PxVnce = 0;
  @CAN_RadarRR::RRR_Object::RRR_Object_Obj40.PxVxCoVnce = 0;
  @CAN_RadarRR::RRR_Object::RRR_Object_Obj40.PxVyCoVnce = 0;
  @CAN_RadarRR::RRR_Object::RRR_Object_Obj40.Py = 0;
  @CAN_RadarRR::RRR_Object::RRR_Object_Obj40.PyAxCoVnce = 0;
  }
  if(init_count == 58)
  {
  @CAN_RadarRR::RRR_Object::RRR_Object_Obj40.PyAyCoVnce = 0;
  @CAN_RadarRR::RRR_Object::RRR_Object_Obj40.PyVnce = 0;
  @CAN_RadarRR::RRR_Object::RRR_Object_Obj40.PyVxCoVnce = 0;
  @CAN_RadarRR::RRR_Object::RRR_Object_Obj40.PyVyCoVnce = 0;
  @CAN_RadarRR::RRR_Object::RRR_Object_Obj40.ReferencePoint = 0;
  @CAN_RadarRR::RRR_Object::RRR_Object_Obj40.Vx = 0;
  @CAN_RadarRR::RRR_Object::RRR_Object_Obj40.VxAxCoVnce = 0;
  @CAN_RadarRR::RRR_Object::RRR_Object_Obj40.VxAyCoVnce = 0;
  @CAN_RadarRR::RRR_Object::RRR_Object_Obj40.VxVnce = 0;
  @CAN_RadarRR::RRR_Object::RRR_Object_Obj40.VxVyCoVnce = 0;
  @CAN_RadarRR::RRR_Object::RRR_Object_Obj40.Vy = 0;
  @CAN_RadarRR::RRR_Object::RRR_Object_Obj40.VyAxCoVnce = 0;
  @CAN_RadarRR::RRR_Object::RRR_Object_Obj40.VyAyCoVnce = 0;
  @CAN_RadarRR::RRR_Object::RRR_Object_Obj40.VyVnce = 0;
  @CAN_RadarRR::RRR_Object::RRR_Object_Obj40.Width = 0;
  @CAN_RadarRR::RRR_Object::RRR_Object_Obj40.WidthVnce = 0;
  @CAN_RadarRR::RRR_Object::RRR_Object_Obj41.Age = 0;
  @CAN_RadarRR::RRR_Object::RRR_Object_Obj41.Ax = 0;
  @CAN_RadarRR::RRR_Object::RRR_Object_Obj41.AxAyCoVnce = 0;
  @CAN_RadarRR::RRR_Object::RRR_Object_Obj41.AxVnce = 0;
  @CAN_RadarRR::RRR_Object::RRR_Object_Obj41.Ay = 0;
  @CAN_RadarRR::RRR_Object::RRR_Object_Obj41.AyVnce = 0;
  @CAN_RadarRR::RRR_Object::RRR_Object_Obj41.ExistProb = 0;
  @CAN_RadarRR::RRR_Object::RRR_Object_Obj41.FilterInformation = 0;
  @CAN_RadarRR::RRR_Object::RRR_Object_Obj41.Length = 0;
  }
  if(init_count == 59)
  {
  @CAN_RadarRR::RRR_Object::RRR_Object_Obj41.LengthVnce = 0;
  @CAN_RadarRR::RRR_Object::RRR_Object_Obj41.MeasurementStatus = 0;
  @CAN_RadarRR::RRR_Object::RRR_Object_Obj41.MovingStatus = 0;
  @CAN_RadarRR::RRR_Object::RRR_Object_Obj41.ObjId = 0;
  @CAN_RadarRR::RRR_Object::RRR_Object_Obj41.OrientationYaw = 0;
  @CAN_RadarRR::RRR_Object::RRR_Object_Obj41.OrientationYawVnce = 0;
  @CAN_RadarRR::RRR_Object::RRR_Object_Obj41.ProbClassConfidence = 0;
  @CAN_RadarRR::RRR_Object::RRR_Object_Obj41.ProbClassType = 0;
  @CAN_RadarRR::RRR_Object::RRR_Object_Obj41.Px = 0;
  @CAN_RadarRR::RRR_Object::RRR_Object_Obj41.PxAxCoVnce = 0;
  @CAN_RadarRR::RRR_Object::RRR_Object_Obj41.PxAyCoVnce = 0;
  @CAN_RadarRR::RRR_Object::RRR_Object_Obj41.PxPyCoVnce = 0;
  @CAN_RadarRR::RRR_Object::RRR_Object_Obj41.PxVnce = 0;
  @CAN_RadarRR::RRR_Object::RRR_Object_Obj41.PxVxCoVnce = 0;
  @CAN_RadarRR::RRR_Object::RRR_Object_Obj41.PxVyCoVnce = 0;
  @CAN_RadarRR::RRR_Object::RRR_Object_Obj41.Py = 0;
  @CAN_RadarRR::RRR_Object::RRR_Object_Obj41.PyAxCoVnce = 0;
  @CAN_RadarRR::RRR_Object::RRR_Object_Obj41.PyAyCoVnce = 0;
  @CAN_RadarRR::RRR_Object::RRR_Object_Obj41.PyVnce = 0;
  @CAN_RadarRR::RRR_Object::RRR_Object_Obj41.PyVxCoVnce = 0;
  @CAN_RadarRR::RRR_Object::RRR_Object_Obj41.PyVyCoVnce = 0;
  @CAN_RadarRR::RRR_Object::RRR_Object_Obj41.ReferencePoint = 0;
  @CAN_RadarRR::RRR_Object::RRR_Object_Obj41.Vx = 0;
  @CAN_RadarRR::RRR_Object::RRR_Object_Obj41.VxAxCoVnce = 0;
  @CAN_RadarRR::RRR_Object::RRR_Object_Obj41.VxAyCoVnce = 0;
  }
  if(init_count == 60)
  {
  @CAN_RadarRR::RRR_Object::RRR_Object_Obj41.VxVnce = 0;
  @CAN_RadarRR::RRR_Object::RRR_Object_Obj41.VxVyCoVnce = 0;
  @CAN_RadarRR::RRR_Object::RRR_Object_Obj41.Vy = 0;
  @CAN_RadarRR::RRR_Object::RRR_Object_Obj41.VyAxCoVnce = 0;
  @CAN_RadarRR::RRR_Object::RRR_Object_Obj41.VyAyCoVnce = 0;
  @CAN_RadarRR::RRR_Object::RRR_Object_Obj41.VyVnce = 0;
  @CAN_RadarRR::RRR_Object::RRR_Object_Obj41.Width = 0;
  @CAN_RadarRR::RRR_Object::RRR_Object_Obj41.WidthVnce = 0;
  @CAN_RadarRR::RRR_Object::RRR_Object_Obj42.Age = 0;
  @CAN_RadarRR::RRR_Object::RRR_Object_Obj42.Ax = 0;
  @CAN_RadarRR::RRR_Object::RRR_Object_Obj42.AxAyCoVnce = 0;
  @CAN_RadarRR::RRR_Object::RRR_Object_Obj42.AxVnce = 0;
  @CAN_RadarRR::RRR_Object::RRR_Object_Obj42.Ay = 0;
  @CAN_RadarRR::RRR_Object::RRR_Object_Obj42.AyVnce = 0;
  @CAN_RadarRR::RRR_Object::RRR_Object_Obj42.ExistProb = 0;
  @CAN_RadarRR::RRR_Object::RRR_Object_Obj42.FilterInformation = 0;
  @CAN_RadarRR::RRR_Object::RRR_Object_Obj42.Length = 0;
  @CAN_RadarRR::RRR_Object::RRR_Object_Obj42.LengthVnce = 0;
  @CAN_RadarRR::RRR_Object::RRR_Object_Obj42.MeasurementStatus = 0;
  @CAN_RadarRR::RRR_Object::RRR_Object_Obj42.MovingStatus = 0;
  @CAN_RadarRR::RRR_Object::RRR_Object_Obj42.ObjId = 0;
  @CAN_RadarRR::RRR_Object::RRR_Object_Obj42.OrientationYaw = 0;
  @CAN_RadarRR::RRR_Object::RRR_Object_Obj42.OrientationYawVnce = 0;
  @CAN_RadarRR::RRR_Object::RRR_Object_Obj42.ProbClassConfidence = 0;
  @CAN_RadarRR::RRR_Object::RRR_Object_Obj42.ProbClassType = 0;
  }
  if(init_count == 61)
  {
  @CAN_RadarRR::RRR_Object::RRR_Object_Obj42.Px = 0;
  @CAN_RadarRR::RRR_Object::RRR_Object_Obj42.PxAxCoVnce = 0;
  @CAN_RadarRR::RRR_Object::RRR_Object_Obj42.PxAyCoVnce = 0;
  @CAN_RadarRR::RRR_Object::RRR_Object_Obj42.PxPyCoVnce = 0;
  @CAN_RadarRR::RRR_Object::RRR_Object_Obj42.PxVnce = 0;
  @CAN_RadarRR::RRR_Object::RRR_Object_Obj42.PxVxCoVnce = 0;
  @CAN_RadarRR::RRR_Object::RRR_Object_Obj42.PxVyCoVnce = 0;
  @CAN_RadarRR::RRR_Object::RRR_Object_Obj42.Py = 0;
  @CAN_RadarRR::RRR_Object::RRR_Object_Obj42.PyAxCoVnce = 0;
  @CAN_RadarRR::RRR_Object::RRR_Object_Obj42.PyAyCoVnce = 0;
  @CAN_RadarRR::RRR_Object::RRR_Object_Obj42.PyVnce = 0;
  @CAN_RadarRR::RRR_Object::RRR_Object_Obj42.PyVxCoVnce = 0;
  @CAN_RadarRR::RRR_Object::RRR_Object_Obj42.PyVyCoVnce = 0;
  @CAN_RadarRR::RRR_Object::RRR_Object_Obj42.ReferencePoint = 0;
  @CAN_RadarRR::RRR_Object::RRR_Object_Obj42.Vx = 0;
  @CAN_RadarRR::RRR_Object::RRR_Object_Obj42.VxAxCoVnce = 0;
  @CAN_RadarRR::RRR_Object::RRR_Object_Obj42.VxAyCoVnce = 0;
  @CAN_RadarRR::RRR_Object::RRR_Object_Obj42.VxVnce = 0;
  @CAN_RadarRR::RRR_Object::RRR_Object_Obj42.VxVyCoVnce = 0;
  @CAN_RadarRR::RRR_Object::RRR_Object_Obj42.Vy = 0;
  @CAN_RadarRR::RRR_Object::RRR_Object_Obj42.VyAxCoVnce = 0;
  @CAN_RadarRR::RRR_Object::RRR_Object_Obj42.VyAyCoVnce = 0;
  @CAN_RadarRR::RRR_Object::RRR_Object_Obj42.VyVnce = 0;
  @CAN_RadarRR::RRR_Object::RRR_Object_Obj42.Width = 0;
  @CAN_RadarRR::RRR_Object::RRR_Object_Obj42.WidthVnce = 0;
  }
  if(init_count == 62)
  {
  @CAN_RadarRR::RRR_Object::RRR_Object_Obj43.Age = 0;
  @CAN_RadarRR::RRR_Object::RRR_Object_Obj43.Ax = 0;
  @CAN_RadarRR::RRR_Object::RRR_Object_Obj43.AxAyCoVnce = 0;
  @CAN_RadarRR::RRR_Object::RRR_Object_Obj43.AxVnce = 0;
  @CAN_RadarRR::RRR_Object::RRR_Object_Obj43.Ay = 0;
  @CAN_RadarRR::RRR_Object::RRR_Object_Obj43.AyVnce = 0;
  @CAN_RadarRR::RRR_Object::RRR_Object_Obj43.ExistProb = 0;
  @CAN_RadarRR::RRR_Object::RRR_Object_Obj43.FilterInformation = 0;
  @CAN_RadarRR::RRR_Object::RRR_Object_Obj43.Length = 0;
  @CAN_RadarRR::RRR_Object::RRR_Object_Obj43.LengthVnce = 0;
  @CAN_RadarRR::RRR_Object::RRR_Object_Obj43.MeasurementStatus = 0;
  @CAN_RadarRR::RRR_Object::RRR_Object_Obj43.MovingStatus = 0;
  @CAN_RadarRR::RRR_Object::RRR_Object_Obj43.ObjId = 0;
  @CAN_RadarRR::RRR_Object::RRR_Object_Obj43.OrientationYaw = 0;
  @CAN_RadarRR::RRR_Object::RRR_Object_Obj43.OrientationYawVnce = 0;
  @CAN_RadarRR::RRR_Object::RRR_Object_Obj43.ProbClassConfidence = 0;
  @CAN_RadarRR::RRR_Object::RRR_Object_Obj43.ProbClassType = 0;
  @CAN_RadarRR::RRR_Object::RRR_Object_Obj43.Px = 0;
  @CAN_RadarRR::RRR_Object::RRR_Object_Obj43.PxAxCoVnce = 0;
  @CAN_RadarRR::RRR_Object::RRR_Object_Obj43.PxAyCoVnce = 0;
  @CAN_RadarRR::RRR_Object::RRR_Object_Obj43.PxPyCoVnce = 0;
  @CAN_RadarRR::RRR_Object::RRR_Object_Obj43.PxVnce = 0;
  @CAN_RadarRR::RRR_Object::RRR_Object_Obj43.PxVxCoVnce = 0;
  @CAN_RadarRR::RRR_Object::RRR_Object_Obj43.PxVyCoVnce = 0;
  @CAN_RadarRR::RRR_Object::RRR_Object_Obj43.Py = 0;
  }
  if(init_count == 63)
  {
  @CAN_RadarRR::RRR_Object::RRR_Object_Obj43.PyAxCoVnce = 0;
  @CAN_RadarRR::RRR_Object::RRR_Object_Obj43.PyAyCoVnce = 0;
  @CAN_RadarRR::RRR_Object::RRR_Object_Obj43.PyVnce = 0;
  @CAN_RadarRR::RRR_Object::RRR_Object_Obj43.PyVxCoVnce = 0;
  @CAN_RadarRR::RRR_Object::RRR_Object_Obj43.PyVyCoVnce = 0;
  @CAN_RadarRR::RRR_Object::RRR_Object_Obj43.ReferencePoint = 0;
  @CAN_RadarRR::RRR_Object::RRR_Object_Obj43.Vx = 0;
  @CAN_RadarRR::RRR_Object::RRR_Object_Obj43.VxAxCoVnce = 0;
  @CAN_RadarRR::RRR_Object::RRR_Object_Obj43.VxAyCoVnce = 0;
  @CAN_RadarRR::RRR_Object::RRR_Object_Obj43.VxVnce = 0;
  @CAN_RadarRR::RRR_Object::RRR_Object_Obj43.VxVyCoVnce = 0;
  @CAN_RadarRR::RRR_Object::RRR_Object_Obj43.Vy = 0;
  @CAN_RadarRR::RRR_Object::RRR_Object_Obj43.VyAxCoVnce = 0;
  @CAN_RadarRR::RRR_Object::RRR_Object_Obj43.VyAyCoVnce = 0;
  @CAN_RadarRR::RRR_Object::RRR_Object_Obj43.VyVnce = 0;
  @CAN_RadarRR::RRR_Object::RRR_Object_Obj43.Width = 0;
  @CAN_RadarRR::RRR_Object::RRR_Object_Obj43.WidthVnce = 0;
  @CAN_RadarRR::RRR_Object::RRR_Object_Obj44.Age = 0;
  @CAN_RadarRR::RRR_Object::RRR_Object_Obj44.Ax = 0;
  @CAN_RadarRR::RRR_Object::RRR_Object_Obj44.AxAyCoVnce = 0;
  @CAN_RadarRR::RRR_Object::RRR_Object_Obj44.AxVnce = 0;
  @CAN_RadarRR::RRR_Object::RRR_Object_Obj44.Ay = 0;
  @CAN_RadarRR::RRR_Object::RRR_Object_Obj44.AyVnce = 0;
  @CAN_RadarRR::RRR_Object::RRR_Object_Obj44.ExistProb = 0;
  @CAN_RadarRR::RRR_Object::RRR_Object_Obj44.FilterInformation = 0;
  }
  if(init_count == 64)
  {
  @CAN_RadarRR::RRR_Object::RRR_Object_Obj44.Length = 0;
  @CAN_RadarRR::RRR_Object::RRR_Object_Obj44.LengthVnce = 0;
  @CAN_RadarRR::RRR_Object::RRR_Object_Obj44.MeasurementStatus = 0;
  @CAN_RadarRR::RRR_Object::RRR_Object_Obj44.MovingStatus = 0;
  @CAN_RadarRR::RRR_Object::RRR_Object_Obj44.ObjId = 0;
  @CAN_RadarRR::RRR_Object::RRR_Object_Obj44.OrientationYaw = 0;
  @CAN_RadarRR::RRR_Object::RRR_Object_Obj44.OrientationYawVnce = 0;
  @CAN_RadarRR::RRR_Object::RRR_Object_Obj44.ProbClassConfidence = 0;
  @CAN_RadarRR::RRR_Object::RRR_Object_Obj44.ProbClassType = 0;
  @CAN_RadarRR::RRR_Object::RRR_Object_Obj44.Px = 0;
  @CAN_RadarRR::RRR_Object::RRR_Object_Obj44.PxAxCoVnce = 0;
  @CAN_RadarRR::RRR_Object::RRR_Object_Obj44.PxAyCoVnce = 0;
  @CAN_RadarRR::RRR_Object::RRR_Object_Obj44.PxPyCoVnce = 0;
  @CAN_RadarRR::RRR_Object::RRR_Object_Obj44.PxVnce = 0;
  @CAN_RadarRR::RRR_Object::RRR_Object_Obj44.PxVxCoVnce = 0;
  @CAN_RadarRR::RRR_Object::RRR_Object_Obj44.PxVyCoVnce = 0;
  @CAN_RadarRR::RRR_Object::RRR_Object_Obj44.Py = 0;
  @CAN_RadarRR::RRR_Object::RRR_Object_Obj44.PyAxCoVnce = 0;
  @CAN_RadarRR::RRR_Object::RRR_Object_Obj44.PyAyCoVnce = 0;
  @CAN_RadarRR::RRR_Object::RRR_Object_Obj44.PyVnce = 0;
  @CAN_RadarRR::RRR_Object::RRR_Object_Obj44.PyVxCoVnce = 0;
  @CAN_RadarRR::RRR_Object::RRR_Object_Obj44.PyVyCoVnce = 0;
  @CAN_RadarRR::RRR_Object::RRR_Object_Obj44.ReferencePoint = 0;
  @CAN_RadarRR::RRR_Object::RRR_Object_Obj44.Vx = 0;
  @CAN_RadarRR::RRR_Object::RRR_Object_Obj44.VxAxCoVnce = 0;
  }
  if(init_count == 65)
  {
  @CAN_RadarRR::RRR_Object::RRR_Object_Obj44.VxAyCoVnce = 0;
  @CAN_RadarRR::RRR_Object::RRR_Object_Obj44.VxVnce = 0;
  @CAN_RadarRR::RRR_Object::RRR_Object_Obj44.VxVyCoVnce = 0;
  @CAN_RadarRR::RRR_Object::RRR_Object_Obj44.Vy = 0;
  @CAN_RadarRR::RRR_Object::RRR_Object_Obj44.VyAxCoVnce = 0;
  @CAN_RadarRR::RRR_Object::RRR_Object_Obj44.VyAyCoVnce = 0;
  @CAN_RadarRR::RRR_Object::RRR_Object_Obj44.VyVnce = 0;
  @CAN_RadarRR::RRR_Object::RRR_Object_Obj44.Width = 0;
  @CAN_RadarRR::RRR_Object::RRR_Object_Obj44.WidthVnce = 0;
  @CAN_RadarRR::RRR_Object::RRR_Object_Obj45.Age = 0;
  @CAN_RadarRR::RRR_Object::RRR_Object_Obj45.Ax = 0;
  @CAN_RadarRR::RRR_Object::RRR_Object_Obj45.AxAyCoVnce = 0;
  @CAN_RadarRR::RRR_Object::RRR_Object_Obj45.AxVnce = 0;
  @CAN_RadarRR::RRR_Object::RRR_Object_Obj45.Ay = 0;
  @CAN_RadarRR::RRR_Object::RRR_Object_Obj45.AyVnce = 0;
  @CAN_RadarRR::RRR_Object::RRR_Object_Obj45.ExistProb = 0;
  @CAN_RadarRR::RRR_Object::RRR_Object_Obj45.FilterInformation = 0;
  @CAN_RadarRR::RRR_Object::RRR_Object_Obj45.Length = 0;
  @CAN_RadarRR::RRR_Object::RRR_Object_Obj45.LengthVnce = 0;
  @CAN_RadarRR::RRR_Object::RRR_Object_Obj45.MeasurementStatus = 0;
  @CAN_RadarRR::RRR_Object::RRR_Object_Obj45.MovingStatus = 0;
  @CAN_RadarRR::RRR_Object::RRR_Object_Obj45.ObjId = 0;
  @CAN_RadarRR::RRR_Object::RRR_Object_Obj45.OrientationYaw = 0;
  @CAN_RadarRR::RRR_Object::RRR_Object_Obj45.OrientationYawVnce = 0;
  @CAN_RadarRR::RRR_Object::RRR_Object_Obj45.ProbClassConfidence = 0;
  }
  if(init_count == 66)
  {
  @CAN_RadarRR::RRR_Object::RRR_Object_Obj45.ProbClassType = 0;
  @CAN_RadarRR::RRR_Object::RRR_Object_Obj45.Px = 0;
  @CAN_RadarRR::RRR_Object::RRR_Object_Obj45.PxAxCoVnce = 0;
  @CAN_RadarRR::RRR_Object::RRR_Object_Obj45.PxAyCoVnce = 0;
  @CAN_RadarRR::RRR_Object::RRR_Object_Obj45.PxPyCoVnce = 0;
  @CAN_RadarRR::RRR_Object::RRR_Object_Obj45.PxVnce = 0;
  @CAN_RadarRR::RRR_Object::RRR_Object_Obj45.PxVxCoVnce = 0;
  @CAN_RadarRR::RRR_Object::RRR_Object_Obj45.PxVyCoVnce = 0;
  @CAN_RadarRR::RRR_Object::RRR_Object_Obj45.Py = 0;
  @CAN_RadarRR::RRR_Object::RRR_Object_Obj45.PyAxCoVnce = 0;
  @CAN_RadarRR::RRR_Object::RRR_Object_Obj45.PyAyCoVnce = 0;
  @CAN_RadarRR::RRR_Object::RRR_Object_Obj45.PyVnce = 0;
  @CAN_RadarRR::RRR_Object::RRR_Object_Obj45.PyVxCoVnce = 0;
  @CAN_RadarRR::RRR_Object::RRR_Object_Obj45.PyVyCoVnce = 0;
  @CAN_RadarRR::RRR_Object::RRR_Object_Obj45.ReferencePoint = 0;
  @CAN_RadarRR::RRR_Object::RRR_Object_Obj45.Vx = 0;
  @CAN_RadarRR::RRR_Object::RRR_Object_Obj45.VxAxCoVnce = 0;
  @CAN_RadarRR::RRR_Object::RRR_Object_Obj45.VxAyCoVnce = 0;
  @CAN_RadarRR::RRR_Object::RRR_Object_Obj45.VxVnce = 0;
  @CAN_RadarRR::RRR_Object::RRR_Object_Obj45.VxVyCoVnce = 0;
  @CAN_RadarRR::RRR_Object::RRR_Object_Obj45.Vy = 0;
  @CAN_RadarRR::RRR_Object::RRR_Object_Obj45.VyAxCoVnce = 0;
  @CAN_RadarRR::RRR_Object::RRR_Object_Obj45.VyAyCoVnce = 0;
  @CAN_RadarRR::RRR_Object::RRR_Object_Obj45.VyVnce = 0;
  @CAN_RadarRR::RRR_Object::RRR_Object_Obj45.Width = 0;
  }
  if(init_count == 67)
  {
  @CAN_RadarRR::RRR_Object::RRR_Object_Obj45.WidthVnce = 0;
  @CAN_RadarRR::RRR_Object::RRR_Object_Obj46.Age = 0;
  @CAN_RadarRR::RRR_Object::RRR_Object_Obj46.Ax = 0;
  @CAN_RadarRR::RRR_Object::RRR_Object_Obj46.AxAyCoVnce = 0;
  @CAN_RadarRR::RRR_Object::RRR_Object_Obj46.AxVnce = 0;
  @CAN_RadarRR::RRR_Object::RRR_Object_Obj46.Ay = 0;
  @CAN_RadarRR::RRR_Object::RRR_Object_Obj46.AyVnce = 0;
  @CAN_RadarRR::RRR_Object::RRR_Object_Obj46.ExistProb = 0;
  @CAN_RadarRR::RRR_Object::RRR_Object_Obj46.FilterInformation = 0;
  @CAN_RadarRR::RRR_Object::RRR_Object_Obj46.Length = 0;
  @CAN_RadarRR::RRR_Object::RRR_Object_Obj46.LengthVnce = 0;
  @CAN_RadarRR::RRR_Object::RRR_Object_Obj46.MeasurementStatus = 0;
  @CAN_RadarRR::RRR_Object::RRR_Object_Obj46.MovingStatus = 0;
  @CAN_RadarRR::RRR_Object::RRR_Object_Obj46.ObjId = 0;
  @CAN_RadarRR::RRR_Object::RRR_Object_Obj46.OrientationYaw = 0;
  @CAN_RadarRR::RRR_Object::RRR_Object_Obj46.OrientationYawVnce = 0;
  @CAN_RadarRR::RRR_Object::RRR_Object_Obj46.ProbClassConfidence = 0;
  @CAN_RadarRR::RRR_Object::RRR_Object_Obj46.ProbClassType = 0;
  @CAN_RadarRR::RRR_Object::RRR_Object_Obj46.Px = 0;
  @CAN_RadarRR::RRR_Object::RRR_Object_Obj46.PxAxCoVnce = 0;
  @CAN_RadarRR::RRR_Object::RRR_Object_Obj46.PxAyCoVnce = 0;
  @CAN_RadarRR::RRR_Object::RRR_Object_Obj46.PxPyCoVnce = 0;
  @CAN_RadarRR::RRR_Object::RRR_Object_Obj46.PxVnce = 0;
  @CAN_RadarRR::RRR_Object::RRR_Object_Obj46.PxVxCoVnce = 0;
  @CAN_RadarRR::RRR_Object::RRR_Object_Obj46.PxVyCoVnce = 0;
  }
  if(init_count == 68)
  {
  @CAN_RadarRR::RRR_Object::RRR_Object_Obj46.Py = 0;
  @CAN_RadarRR::RRR_Object::RRR_Object_Obj46.PyAxCoVnce = 0;
  @CAN_RadarRR::RRR_Object::RRR_Object_Obj46.PyAyCoVnce = 0;
  @CAN_RadarRR::RRR_Object::RRR_Object_Obj46.PyVnce = 0;
  @CAN_RadarRR::RRR_Object::RRR_Object_Obj46.PyVxCoVnce = 0;
  @CAN_RadarRR::RRR_Object::RRR_Object_Obj46.PyVyCoVnce = 0;
  @CAN_RadarRR::RRR_Object::RRR_Object_Obj46.ReferencePoint = 0;
  @CAN_RadarRR::RRR_Object::RRR_Object_Obj46.Vx = 0;
  @CAN_RadarRR::RRR_Object::RRR_Object_Obj46.VxAxCoVnce = 0;
  @CAN_RadarRR::RRR_Object::RRR_Object_Obj46.VxAyCoVnce = 0;
  @CAN_RadarRR::RRR_Object::RRR_Object_Obj46.VxVnce = 0;
  @CAN_RadarRR::RRR_Object::RRR_Object_Obj46.VxVyCoVnce = 0;
  @CAN_RadarRR::RRR_Object::RRR_Object_Obj46.Vy = 0;
  @CAN_RadarRR::RRR_Object::RRR_Object_Obj46.VyAxCoVnce = 0;
  @CAN_RadarRR::RRR_Object::RRR_Object_Obj46.VyAyCoVnce = 0;
  @CAN_RadarRR::RRR_Object::RRR_Object_Obj46.VyVnce = 0;
  @CAN_RadarRR::RRR_Object::RRR_Object_Obj46.Width = 0;
  @CAN_RadarRR::RRR_Object::RRR_Object_Obj46.WidthVnce = 0;
  @CAN_RadarRR::RRR_Object::RRR_Object_Obj47.Age = 0;
  @CAN_RadarRR::RRR_Object::RRR_Object_Obj47.Ax = 0;
  @CAN_RadarRR::RRR_Object::RRR_Object_Obj47.AxAyCoVnce = 0;
  @CAN_RadarRR::RRR_Object::RRR_Object_Obj47.AxVnce = 0;
  @CAN_RadarRR::RRR_Object::RRR_Object_Obj47.Ay = 0;
  @CAN_RadarRR::RRR_Object::RRR_Object_Obj47.AyVnce = 0;
  @CAN_RadarRR::RRR_Object::RRR_Object_Obj47.ExistProb = 0;
  }
  if(init_count == 69)
  {
  @CAN_RadarRR::RRR_Object::RRR_Object_Obj47.FilterInformation = 0;
  @CAN_RadarRR::RRR_Object::RRR_Object_Obj47.Length = 0;
  @CAN_RadarRR::RRR_Object::RRR_Object_Obj47.LengthVnce = 0;
  @CAN_RadarRR::RRR_Object::RRR_Object_Obj47.MeasurementStatus = 0;
  @CAN_RadarRR::RRR_Object::RRR_Object_Obj47.MovingStatus = 0;
  @CAN_RadarRR::RRR_Object::RRR_Object_Obj47.ObjId = 0;
  @CAN_RadarRR::RRR_Object::RRR_Object_Obj47.OrientationYaw = 0;
  @CAN_RadarRR::RRR_Object::RRR_Object_Obj47.OrientationYawVnce = 0;
  @CAN_RadarRR::RRR_Object::RRR_Object_Obj47.ProbClassConfidence = 0;
  @CAN_RadarRR::RRR_Object::RRR_Object_Obj47.ProbClassType = 0;
  @CAN_RadarRR::RRR_Object::RRR_Object_Obj47.Px = 0;
  @CAN_RadarRR::RRR_Object::RRR_Object_Obj47.PxAxCoVnce = 0;
  @CAN_RadarRR::RRR_Object::RRR_Object_Obj47.PxAyCoVnce = 0;
  @CAN_RadarRR::RRR_Object::RRR_Object_Obj47.PxPyCoVnce = 0;
  @CAN_RadarRR::RRR_Object::RRR_Object_Obj47.PxVnce = 0;
  @CAN_RadarRR::RRR_Object::RRR_Object_Obj47.PxVxCoVnce = 0;
  @CAN_RadarRR::RRR_Object::RRR_Object_Obj47.PxVyCoVnce = 0;
  @CAN_RadarRR::RRR_Object::RRR_Object_Obj47.Py = 0;
  @CAN_RadarRR::RRR_Object::RRR_Object_Obj47.PyAxCoVnce = 0;
  @CAN_RadarRR::RRR_Object::RRR_Object_Obj47.PyAyCoVnce = 0;
  @CAN_RadarRR::RRR_Object::RRR_Object_Obj47.PyVnce = 0;
  @CAN_RadarRR::RRR_Object::RRR_Object_Obj47.PyVxCoVnce = 0;
  @CAN_RadarRR::RRR_Object::RRR_Object_Obj47.PyVyCoVnce = 0;
  @CAN_RadarRR::RRR_Object::RRR_Object_Obj47.ReferencePoint = 0;
  @CAN_RadarRR::RRR_Object::RRR_Object_Obj47.Vx = 0;
  }
  if(init_count == 70)
  {
  @CAN_RadarRR::RRR_Object::RRR_Object_Obj47.VxAxCoVnce = 0;
  @CAN_RadarRR::RRR_Object::RRR_Object_Obj47.VxAyCoVnce = 0;
  @CAN_RadarRR::RRR_Object::RRR_Object_Obj47.VxVnce = 0;
  @CAN_RadarRR::RRR_Object::RRR_Object_Obj47.VxVyCoVnce = 0;
  @CAN_RadarRR::RRR_Object::RRR_Object_Obj47.Vy = 0;
  @CAN_RadarRR::RRR_Object::RRR_Object_Obj47.VyAxCoVnce = 0;
  @CAN_RadarRR::RRR_Object::RRR_Object_Obj47.VyAyCoVnce = 0;
  @CAN_RadarRR::RRR_Object::RRR_Object_Obj47.VyVnce = 0;
  @CAN_RadarRR::RRR_Object::RRR_Object_Obj47.Width = 0;
  @CAN_RadarRR::RRR_Object::RRR_Object_Obj47.WidthVnce = 0;
  @CAN_RadarRR::RRR_Object::RRR_Object_Obj48.Age = 0;
  @CAN_RadarRR::RRR_Object::RRR_Object_Obj48.Ax = 0;
  @CAN_RadarRR::RRR_Object::RRR_Object_Obj48.AxAyCoVnce = 0;
  @CAN_RadarRR::RRR_Object::RRR_Object_Obj48.AxVnce = 0;
  @CAN_RadarRR::RRR_Object::RRR_Object_Obj48.Ay = 0;
  @CAN_RadarRR::RRR_Object::RRR_Object_Obj48.AyVnce = 0;
  @CAN_RadarRR::RRR_Object::RRR_Object_Obj48.ExistProb = 0;
  @CAN_RadarRR::RRR_Object::RRR_Object_Obj48.FilterInformation = 0;
  @CAN_RadarRR::RRR_Object::RRR_Object_Obj48.Length = 0;
  @CAN_RadarRR::RRR_Object::RRR_Object_Obj48.LengthVnce = 0;
  @CAN_RadarRR::RRR_Object::RRR_Object_Obj48.MeasurementStatus = 0;
  @CAN_RadarRR::RRR_Object::RRR_Object_Obj48.MovingStatus = 0;
  @CAN_RadarRR::RRR_Object::RRR_Object_Obj48.ObjId = 0;
  @CAN_RadarRR::RRR_Object::RRR_Object_Obj48.OrientationYaw = 0;
  @CAN_RadarRR::RRR_Object::RRR_Object_Obj48.OrientationYawVnce = 0;
  }
  if(init_count == 71)
  {
  @CAN_RadarRR::RRR_Object::RRR_Object_Obj48.ProbClassConfidence = 0;
  @CAN_RadarRR::RRR_Object::RRR_Object_Obj48.ProbClassType = 0;
  @CAN_RadarRR::RRR_Object::RRR_Object_Obj48.Px = 0;
  @CAN_RadarRR::RRR_Object::RRR_Object_Obj48.PxAxCoVnce = 0;
  @CAN_RadarRR::RRR_Object::RRR_Object_Obj48.PxAyCoVnce = 0;
  @CAN_RadarRR::RRR_Object::RRR_Object_Obj48.PxPyCoVnce = 0;
  @CAN_RadarRR::RRR_Object::RRR_Object_Obj48.PxVnce = 0;
  @CAN_RadarRR::RRR_Object::RRR_Object_Obj48.PxVxCoVnce = 0;
  @CAN_RadarRR::RRR_Object::RRR_Object_Obj48.PxVyCoVnce = 0;
  @CAN_RadarRR::RRR_Object::RRR_Object_Obj48.Py = 0;
  @CAN_RadarRR::RRR_Object::RRR_Object_Obj48.PyAxCoVnce = 0;
  @CAN_RadarRR::RRR_Object::RRR_Object_Obj48.PyAyCoVnce = 0;
  @CAN_RadarRR::RRR_Object::RRR_Object_Obj48.PyVnce = 0;
  @CAN_RadarRR::RRR_Object::RRR_Object_Obj48.PyVxCoVnce = 0;
  @CAN_RadarRR::RRR_Object::RRR_Object_Obj48.PyVyCoVnce = 0;
  @CAN_RadarRR::RRR_Object::RRR_Object_Obj48.ReferencePoint = 0;
  @CAN_RadarRR::RRR_Object::RRR_Object_Obj48.Vx = 0;
  @CAN_RadarRR::RRR_Object::RRR_Object_Obj48.VxAxCoVnce = 0;
  @CAN_RadarRR::RRR_Object::RRR_Object_Obj48.VxAyCoVnce = 0;
  @CAN_RadarRR::RRR_Object::RRR_Object_Obj48.VxVnce = 0;
  @CAN_RadarRR::RRR_Object::RRR_Object_Obj48.VxVyCoVnce = 0;
  @CAN_RadarRR::RRR_Object::RRR_Object_Obj48.Vy = 0;
  @CAN_RadarRR::RRR_Object::RRR_Object_Obj48.VyAxCoVnce = 0;
  @CAN_RadarRR::RRR_Object::RRR_Object_Obj48.VyAyCoVnce = 0;
  @CAN_RadarRR::RRR_Object::RRR_Object_Obj48.VyVnce = 0;
  }
  if(init_count == 72)
  {
  @CAN_RadarRR::RRR_Object::RRR_Object_Obj48.Width = 0;
  @CAN_RadarRR::RRR_Object::RRR_Object_Obj48.WidthVnce = 0;
  @CAN_RadarRR::RRR_Object::RRR_Object_Obj4.Age = 0;
  @CAN_RadarRR::RRR_Object::RRR_Object_Obj4.Ax = 0;
  @CAN_RadarRR::RRR_Object::RRR_Object_Obj4.AxAyCoVnce = 0;
  @CAN_RadarRR::RRR_Object::RRR_Object_Obj4.AxVnce = 0;
  @CAN_RadarRR::RRR_Object::RRR_Object_Obj4.Ay = 0;
  @CAN_RadarRR::RRR_Object::RRR_Object_Obj4.AyVnce = 0;
  @CAN_RadarRR::RRR_Object::RRR_Object_Obj4.ExistProb = 0;
  @CAN_RadarRR::RRR_Object::RRR_Object_Obj4.FilterInformation = 0;
  @CAN_RadarRR::RRR_Object::RRR_Object_Obj4.Length = 0;
  @CAN_RadarRR::RRR_Object::RRR_Object_Obj4.LengthVnce = 0;
  @CAN_RadarRR::RRR_Object::RRR_Object_Obj4.MeasurementStatus = 0;
  @CAN_RadarRR::RRR_Object::RRR_Object_Obj4.MovingStatus = 0;
  @CAN_RadarRR::RRR_Object::RRR_Object_Obj4.ObjId = 0;
  @CAN_RadarRR::RRR_Object::RRR_Object_Obj4.OrientationYaw = 0;
  @CAN_RadarRR::RRR_Object::RRR_Object_Obj4.OrientationYawVnce = 0;
  @CAN_RadarRR::RRR_Object::RRR_Object_Obj4.ProbClassConfidence = 0;
  @CAN_RadarRR::RRR_Object::RRR_Object_Obj4.ProbClassType = 0;
  @CAN_RadarRR::RRR_Object::RRR_Object_Obj4.Px = 0;
  @CAN_RadarRR::RRR_Object::RRR_Object_Obj4.PxAxCoVnce = 0;
  @CAN_RadarRR::RRR_Object::RRR_Object_Obj4.PxAyCoVnce = 0;
  @CAN_RadarRR::RRR_Object::RRR_Object_Obj4.PxPyCoVnce = 0;
  @CAN_RadarRR::RRR_Object::RRR_Object_Obj4.PxVnce = 0;
  @CAN_RadarRR::RRR_Object::RRR_Object_Obj4.PxVxCoVnce = 0;
  }
  if(init_count == 73)
  {
  @CAN_RadarRR::RRR_Object::RRR_Object_Obj4.PxVyCoVnce = 0;
  @CAN_RadarRR::RRR_Object::RRR_Object_Obj4.Py = 0;
  @CAN_RadarRR::RRR_Object::RRR_Object_Obj4.PyAxCoVnce = 0;
  @CAN_RadarRR::RRR_Object::RRR_Object_Obj4.PyAyCoVnce = 0;
  @CAN_RadarRR::RRR_Object::RRR_Object_Obj4.PyVnce = 0;
  @CAN_RadarRR::RRR_Object::RRR_Object_Obj4.PyVxCoVnce = 0;
  @CAN_RadarRR::RRR_Object::RRR_Object_Obj4.PyVyCoVnce = 0;
  @CAN_RadarRR::RRR_Object::RRR_Object_Obj4.ReferencePoint = 0;
  @CAN_RadarRR::RRR_Object::RRR_Object_Obj4.Vx = 0;
  @CAN_RadarRR::RRR_Object::RRR_Object_Obj4.VxAxCoVnce = 0;
  @CAN_RadarRR::RRR_Object::RRR_Object_Obj4.VxAyCoVnce = 0;
  @CAN_RadarRR::RRR_Object::RRR_Object_Obj4.VxVnce = 0;
  @CAN_RadarRR::RRR_Object::RRR_Object_Obj4.VxVyCoVnce = 0;
  @CAN_RadarRR::RRR_Object::RRR_Object_Obj4.Vy = 0;
  @CAN_RadarRR::RRR_Object::RRR_Object_Obj4.VyAxCoVnce = 0;
  @CAN_RadarRR::RRR_Object::RRR_Object_Obj4.VyAyCoVnce = 0;
  @CAN_RadarRR::RRR_Object::RRR_Object_Obj4.VyVnce = 0;
  @CAN_RadarRR::RRR_Object::RRR_Object_Obj4.Width = 0;
  @CAN_RadarRR::RRR_Object::RRR_Object_Obj4.WidthVnce = 0;
  @CAN_RadarRR::RRR_Object::RRR_Object_Obj5.Age = 0;
  @CAN_RadarRR::RRR_Object::RRR_Object_Obj5.Ax = 0;
  @CAN_RadarRR::RRR_Object::RRR_Object_Obj5.AxAyCoVnce = 0;
  @CAN_RadarRR::RRR_Object::RRR_Object_Obj5.AxVnce = 0;
  @CAN_RadarRR::RRR_Object::RRR_Object_Obj5.Ay = 0;
  @CAN_RadarRR::RRR_Object::RRR_Object_Obj5.AyVnce = 0;
  }
  if(init_count == 74)
  {
  @CAN_RadarRR::RRR_Object::RRR_Object_Obj5.ExistProb = 0;
  @CAN_RadarRR::RRR_Object::RRR_Object_Obj5.FilterInformation = 0;
  @CAN_RadarRR::RRR_Object::RRR_Object_Obj5.Length = 0;
  @CAN_RadarRR::RRR_Object::RRR_Object_Obj5.LengthVnce = 0;
  @CAN_RadarRR::RRR_Object::RRR_Object_Obj5.MeasurementStatus = 0;
  @CAN_RadarRR::RRR_Object::RRR_Object_Obj5.MovingStatus = 0;
  @CAN_RadarRR::RRR_Object::RRR_Object_Obj5.ObjId = 0;
  @CAN_RadarRR::RRR_Object::RRR_Object_Obj5.OrientationYaw = 0;
  @CAN_RadarRR::RRR_Object::RRR_Object_Obj5.OrientationYawVnce = 0;
  @CAN_RadarRR::RRR_Object::RRR_Object_Obj5.ProbClassConfidence = 0;
  @CAN_RadarRR::RRR_Object::RRR_Object_Obj5.ProbClassType = 0;
  @CAN_RadarRR::RRR_Object::RRR_Object_Obj5.Px = 0;
  @CAN_RadarRR::RRR_Object::RRR_Object_Obj5.PxAxCoVnce = 0;
  @CAN_RadarRR::RRR_Object::RRR_Object_Obj5.PxAyCoVnce = 0;
  @CAN_RadarRR::RRR_Object::RRR_Object_Obj5.PxPyCoVnce = 0;
  @CAN_RadarRR::RRR_Object::RRR_Object_Obj5.PxVnce = 0;
  @CAN_RadarRR::RRR_Object::RRR_Object_Obj5.PxVxCoVnce = 0;
  @CAN_RadarRR::RRR_Object::RRR_Object_Obj5.PxVyCoVnce = 0;
  @CAN_RadarRR::RRR_Object::RRR_Object_Obj5.Py = 0;
  @CAN_RadarRR::RRR_Object::RRR_Object_Obj5.PyAxCoVnce = 0;
  @CAN_RadarRR::RRR_Object::RRR_Object_Obj5.PyAyCoVnce = 0;
  @CAN_RadarRR::RRR_Object::RRR_Object_Obj5.PyVnce = 0;
  @CAN_RadarRR::RRR_Object::RRR_Object_Obj5.PyVxCoVnce = 0;
  @CAN_RadarRR::RRR_Object::RRR_Object_Obj5.PyVyCoVnce = 0;
  @CAN_RadarRR::RRR_Object::RRR_Object_Obj5.ReferencePoint = 0;
  }
  if(init_count == 75)
  {
  @CAN_RadarRR::RRR_Object::RRR_Object_Obj5.Vx = 0;
  @CAN_RadarRR::RRR_Object::RRR_Object_Obj5.VxAxCoVnce = 0;
  @CAN_RadarRR::RRR_Object::RRR_Object_Obj5.VxAyCoVnce = 0;
  @CAN_RadarRR::RRR_Object::RRR_Object_Obj5.VxVnce = 0;
  @CAN_RadarRR::RRR_Object::RRR_Object_Obj5.VxVyCoVnce = 0;
  @CAN_RadarRR::RRR_Object::RRR_Object_Obj5.Vy = 0;
  @CAN_RadarRR::RRR_Object::RRR_Object_Obj5.VyAxCoVnce = 0;
  @CAN_RadarRR::RRR_Object::RRR_Object_Obj5.VyAyCoVnce = 0;
  @CAN_RadarRR::RRR_Object::RRR_Object_Obj5.VyVnce = 0;
  @CAN_RadarRR::RRR_Object::RRR_Object_Obj5.Width = 0;
  @CAN_RadarRR::RRR_Object::RRR_Object_Obj5.WidthVnce = 0;
  @CAN_RadarRR::RRR_Object::RRR_Object_Obj6.Age = 0;
  @CAN_RadarRR::RRR_Object::RRR_Object_Obj6.Ax = 0;
  @CAN_RadarRR::RRR_Object::RRR_Object_Obj6.AxAyCoVnce = 0;
  @CAN_RadarRR::RRR_Object::RRR_Object_Obj6.AxVnce = 0;
  @CAN_RadarRR::RRR_Object::RRR_Object_Obj6.Ay = 0;
  @CAN_RadarRR::RRR_Object::RRR_Object_Obj6.AyVnce = 0;
  @CAN_RadarRR::RRR_Object::RRR_Object_Obj6.ExistProb = 0;
  @CAN_RadarRR::RRR_Object::RRR_Object_Obj6.FilterInformation = 0;
  @CAN_RadarRR::RRR_Object::RRR_Object_Obj6.Length = 0;
  @CAN_RadarRR::RRR_Object::RRR_Object_Obj6.LengthVnce = 0;
  @CAN_RadarRR::RRR_Object::RRR_Object_Obj6.MeasurementStatus = 0;
  @CAN_RadarRR::RRR_Object::RRR_Object_Obj6.MovingStatus = 0;
  @CAN_RadarRR::RRR_Object::RRR_Object_Obj6.ObjId = 0;
  @CAN_RadarRR::RRR_Object::RRR_Object_Obj6.OrientationYaw = 0;
  }
  if(init_count == 76)
  {
  @CAN_RadarRR::RRR_Object::RRR_Object_Obj6.OrientationYawVnce = 0;
  @CAN_RadarRR::RRR_Object::RRR_Object_Obj6.ProbClassConfidence = 0;
  @CAN_RadarRR::RRR_Object::RRR_Object_Obj6.ProbClassType = 0;
  @CAN_RadarRR::RRR_Object::RRR_Object_Obj6.Px = 0;
  @CAN_RadarRR::RRR_Object::RRR_Object_Obj6.PxAxCoVnce = 0;
  @CAN_RadarRR::RRR_Object::RRR_Object_Obj6.PxAyCoVnce = 0;
  @CAN_RadarRR::RRR_Object::RRR_Object_Obj6.PxPyCoVnce = 0;
  @CAN_RadarRR::RRR_Object::RRR_Object_Obj6.PxVnce = 0;
  @CAN_RadarRR::RRR_Object::RRR_Object_Obj6.PxVxCoVnce = 0;
  @CAN_RadarRR::RRR_Object::RRR_Object_Obj6.PxVyCoVnce = 0;
  @CAN_RadarRR::RRR_Object::RRR_Object_Obj6.Py = 0;
  @CAN_RadarRR::RRR_Object::RRR_Object_Obj6.PyAxCoVnce = 0;
  @CAN_RadarRR::RRR_Object::RRR_Object_Obj6.PyAyCoVnce = 0;
  @CAN_RadarRR::RRR_Object::RRR_Object_Obj6.PyVnce = 0;
  @CAN_RadarRR::RRR_Object::RRR_Object_Obj6.PyVxCoVnce = 0;
  @CAN_RadarRR::RRR_Object::RRR_Object_Obj6.PyVyCoVnce = 0;
  @CAN_RadarRR::RRR_Object::RRR_Object_Obj6.ReferencePoint = 0;
  @CAN_RadarRR::RRR_Object::RRR_Object_Obj6.Vx = 0;
  @CAN_RadarRR::RRR_Object::RRR_Object_Obj6.VxAxCoVnce = 0;
  @CAN_RadarRR::RRR_Object::RRR_Object_Obj6.VxAyCoVnce = 0;
  @CAN_RadarRR::RRR_Object::RRR_Object_Obj6.VxVnce = 0;
  @CAN_RadarRR::RRR_Object::RRR_Object_Obj6.VxVyCoVnce = 0;
  @CAN_RadarRR::RRR_Object::RRR_Object_Obj6.Vy = 0;
  @CAN_RadarRR::RRR_Object::RRR_Object_Obj6.VyAxCoVnce = 0;
  @CAN_RadarRR::RRR_Object::RRR_Object_Obj6.VyAyCoVnce = 0;
  }
  if(init_count == 77)
  {
  @CAN_RadarRR::RRR_Object::RRR_Object_Obj6.VyVnce = 0;
  @CAN_RadarRR::RRR_Object::RRR_Object_Obj6.Width = 0;
  @CAN_RadarRR::RRR_Object::RRR_Object_Obj6.WidthVnce = 0;
  @CAN_RadarRR::RRR_Object::RRR_Object_Obj7.Age = 0;
  @CAN_RadarRR::RRR_Object::RRR_Object_Obj7.Ax = 0;
  @CAN_RadarRR::RRR_Object::RRR_Object_Obj7.AxAyCoVnce = 0;
  @CAN_RadarRR::RRR_Object::RRR_Object_Obj7.AxVnce = 0;
  @CAN_RadarRR::RRR_Object::RRR_Object_Obj7.Ay = 0;
  @CAN_RadarRR::RRR_Object::RRR_Object_Obj7.AyVnce = 0;
  @CAN_RadarRR::RRR_Object::RRR_Object_Obj7.ExistProb = 0;
  @CAN_RadarRR::RRR_Object::RRR_Object_Obj7.FilterInformation = 0;
  @CAN_RadarRR::RRR_Object::RRR_Object_Obj7.Length = 0;
  @CAN_RadarRR::RRR_Object::RRR_Object_Obj7.LengthVnce = 0;
  @CAN_RadarRR::RRR_Object::RRR_Object_Obj7.MeasurementStatus = 0;
  @CAN_RadarRR::RRR_Object::RRR_Object_Obj7.MovingStatus = 0;
  @CAN_RadarRR::RRR_Object::RRR_Object_Obj7.ObjId = 0;
  @CAN_RadarRR::RRR_Object::RRR_Object_Obj7.OrientationYaw = 0;
  @CAN_RadarRR::RRR_Object::RRR_Object_Obj7.OrientationYawVnce = 0;
  @CAN_RadarRR::RRR_Object::RRR_Object_Obj7.ProbClassConfidence = 0;
  @CAN_RadarRR::RRR_Object::RRR_Object_Obj7.ProbClassType = 0;
  @CAN_RadarRR::RRR_Object::RRR_Object_Obj7.Px = 0;
  @CAN_RadarRR::RRR_Object::RRR_Object_Obj7.PxAxCoVnce = 0;
  @CAN_RadarRR::RRR_Object::RRR_Object_Obj7.PxAyCoVnce = 0;
  @CAN_RadarRR::RRR_Object::RRR_Object_Obj7.PxPyCoVnce = 0;
  @CAN_RadarRR::RRR_Object::RRR_Object_Obj7.PxVnce = 0;
  }
  if(init_count == 78)
  {
  @CAN_RadarRR::RRR_Object::RRR_Object_Obj7.PxVxCoVnce = 0;
  @CAN_RadarRR::RRR_Object::RRR_Object_Obj7.PxVyCoVnce = 0;
  @CAN_RadarRR::RRR_Object::RRR_Object_Obj7.Py = 0;
  @CAN_RadarRR::RRR_Object::RRR_Object_Obj7.PyAxCoVnce = 0;
  @CAN_RadarRR::RRR_Object::RRR_Object_Obj7.PyAyCoVnce = 0;
  @CAN_RadarRR::RRR_Object::RRR_Object_Obj7.PyVnce = 0;
  @CAN_RadarRR::RRR_Object::RRR_Object_Obj7.PyVxCoVnce = 0;
  @CAN_RadarRR::RRR_Object::RRR_Object_Obj7.PyVyCoVnce = 0;
  @CAN_RadarRR::RRR_Object::RRR_Object_Obj7.ReferencePoint = 0;
  @CAN_RadarRR::RRR_Object::RRR_Object_Obj7.Vx = 0;
  @CAN_RadarRR::RRR_Object::RRR_Object_Obj7.VxAxCoVnce = 0;
  @CAN_RadarRR::RRR_Object::RRR_Object_Obj7.VxAyCoVnce = 0;
  @CAN_RadarRR::RRR_Object::RRR_Object_Obj7.VxVnce = 0;
  @CAN_RadarRR::RRR_Object::RRR_Object_Obj7.VxVyCoVnce = 0;
  @CAN_RadarRR::RRR_Object::RRR_Object_Obj7.Vy = 0;
  @CAN_RadarRR::RRR_Object::RRR_Object_Obj7.VyAxCoVnce = 0;
  @CAN_RadarRR::RRR_Object::RRR_Object_Obj7.VyAyCoVnce = 0;
  @CAN_RadarRR::RRR_Object::RRR_Object_Obj7.VyVnce = 0;
  @CAN_RadarRR::RRR_Object::RRR_Object_Obj7.Width = 0;
  @CAN_RadarRR::RRR_Object::RRR_Object_Obj7.WidthVnce = 0;
  @CAN_RadarRR::RRR_Object::RRR_Object_Obj8.Age = 0;
  @CAN_RadarRR::RRR_Object::RRR_Object_Obj8.Ax = 0;
  @CAN_RadarRR::RRR_Object::RRR_Object_Obj8.AxAyCoVnce = 0;
  @CAN_RadarRR::RRR_Object::RRR_Object_Obj8.AxVnce = 0;
  @CAN_RadarRR::RRR_Object::RRR_Object_Obj8.Ay = 0;
  }
  if(init_count == 79)
  {
  @CAN_RadarRR::RRR_Object::RRR_Object_Obj8.AyVnce = 0;
  @CAN_RadarRR::RRR_Object::RRR_Object_Obj8.ExistProb = 0;
  @CAN_RadarRR::RRR_Object::RRR_Object_Obj8.FilterInformation = 0;
  @CAN_RadarRR::RRR_Object::RRR_Object_Obj8.Length = 0;
  @CAN_RadarRR::RRR_Object::RRR_Object_Obj8.LengthVnce = 0;
  @CAN_RadarRR::RRR_Object::RRR_Object_Obj8.MeasurementStatus = 0;
  @CAN_RadarRR::RRR_Object::RRR_Object_Obj8.MovingStatus = 0;
  @CAN_RadarRR::RRR_Object::RRR_Object_Obj8.ObjId = 0;
  @CAN_RadarRR::RRR_Object::RRR_Object_Obj8.OrientationYaw = 0;
  @CAN_RadarRR::RRR_Object::RRR_Object_Obj8.OrientationYawVnce = 0;
  @CAN_RadarRR::RRR_Object::RRR_Object_Obj8.ProbClassConfidence = 0;
  @CAN_RadarRR::RRR_Object::RRR_Object_Obj8.ProbClassType = 0;
  @CAN_RadarRR::RRR_Object::RRR_Object_Obj8.Px = 0;
  @CAN_RadarRR::RRR_Object::RRR_Object_Obj8.PxAxCoVnce = 0;
  @CAN_RadarRR::RRR_Object::RRR_Object_Obj8.PxAyCoVnce = 0;
  @CAN_RadarRR::RRR_Object::RRR_Object_Obj8.PxPyCoVnce = 0;
  @CAN_RadarRR::RRR_Object::RRR_Object_Obj8.PxVnce = 0;
  @CAN_RadarRR::RRR_Object::RRR_Object_Obj8.PxVxCoVnce = 0;
  @CAN_RadarRR::RRR_Object::RRR_Object_Obj8.PxVyCoVnce = 0;
  @CAN_RadarRR::RRR_Object::RRR_Object_Obj8.Py = 0;
  @CAN_RadarRR::RRR_Object::RRR_Object_Obj8.PyAxCoVnce = 0;
  @CAN_RadarRR::RRR_Object::RRR_Object_Obj8.PyAyCoVnce = 0;
  @CAN_RadarRR::RRR_Object::RRR_Object_Obj8.PyVnce = 0;
  @CAN_RadarRR::RRR_Object::RRR_Object_Obj8.PyVxCoVnce = 0;
  @CAN_RadarRR::RRR_Object::RRR_Object_Obj8.PyVyCoVnce = 0;
  }
  if(init_count == 80)
  {
  @CAN_RadarRR::RRR_Object::RRR_Object_Obj8.ReferencePoint = 0;
  @CAN_RadarRR::RRR_Object::RRR_Object_Obj8.Vx = 0;
  @CAN_RadarRR::RRR_Object::RRR_Object_Obj8.VxAxCoVnce = 0;
  @CAN_RadarRR::RRR_Object::RRR_Object_Obj8.VxAyCoVnce = 0;
  @CAN_RadarRR::RRR_Object::RRR_Object_Obj8.VxVnce = 0;
  @CAN_RadarRR::RRR_Object::RRR_Object_Obj8.VxVyCoVnce = 0;
  @CAN_RadarRR::RRR_Object::RRR_Object_Obj8.Vy = 0;
  @CAN_RadarRR::RRR_Object::RRR_Object_Obj8.VyAxCoVnce = 0;
  @CAN_RadarRR::RRR_Object::RRR_Object_Obj8.VyAyCoVnce = 0;
  @CAN_RadarRR::RRR_Object::RRR_Object_Obj8.VyVnce = 0;
  @CAN_RadarRR::RRR_Object::RRR_Object_Obj8.Width = 0;
  @CAN_RadarRR::RRR_Object::RRR_Object_Obj8.WidthVnce = 0;
  @CAN_RadarRR::RRR_Object::RRR_Object_Obj9.Age = 0;
  @CAN_RadarRR::RRR_Object::RRR_Object_Obj9.Ax = 0;
  @CAN_RadarRR::RRR_Object::RRR_Object_Obj9.AxAyCoVnce = 0;
  @CAN_RadarRR::RRR_Object::RRR_Object_Obj9.AxVnce = 0;
  @CAN_RadarRR::RRR_Object::RRR_Object_Obj9.Ay = 0;
  @CAN_RadarRR::RRR_Object::RRR_Object_Obj9.AyVnce = 0;
  @CAN_RadarRR::RRR_Object::RRR_Object_Obj9.ExistProb = 0;
  @CAN_RadarRR::RRR_Object::RRR_Object_Obj9.FilterInformation = 0;
  @CAN_RadarRR::RRR_Object::RRR_Object_Obj9.Length = 0;
  @CAN_RadarRR::RRR_Object::RRR_Object_Obj9.LengthVnce = 0;
  @CAN_RadarRR::RRR_Object::RRR_Object_Obj9.MeasurementStatus = 0;
  @CAN_RadarRR::RRR_Object::RRR_Object_Obj9.MovingStatus = 0;
  @CAN_RadarRR::RRR_Object::RRR_Object_Obj9.ObjId = 0;
  }
  if(init_count == 81)
  {
  @CAN_RadarRR::RRR_Object::RRR_Object_Obj9.OrientationYaw = 0;
  @CAN_RadarRR::RRR_Object::RRR_Object_Obj9.OrientationYawVnce = 0;
  @CAN_RadarRR::RRR_Object::RRR_Object_Obj9.ProbClassConfidence = 0;
  @CAN_RadarRR::RRR_Object::RRR_Object_Obj9.ProbClassType = 0;
  @CAN_RadarRR::RRR_Object::RRR_Object_Obj9.Px = 0;
  @CAN_RadarRR::RRR_Object::RRR_Object_Obj9.PxAxCoVnce = 0;
  @CAN_RadarRR::RRR_Object::RRR_Object_Obj9.PxAyCoVnce = 0;
  @CAN_RadarRR::RRR_Object::RRR_Object_Obj9.PxPyCoVnce = 0;
  @CAN_RadarRR::RRR_Object::RRR_Object_Obj9.PxVnce = 0;
  @CAN_RadarRR::RRR_Object::RRR_Object_Obj9.PxVxCoVnce = 0;
  @CAN_RadarRR::RRR_Object::RRR_Object_Obj9.PxVyCoVnce = 0;
  @CAN_RadarRR::RRR_Object::RRR_Object_Obj9.Py = 0;
  @CAN_RadarRR::RRR_Object::RRR_Object_Obj9.PyAxCoVnce = 0;
  @CAN_RadarRR::RRR_Object::RRR_Object_Obj9.PyAyCoVnce = 0;
  @CAN_RadarRR::RRR_Object::RRR_Object_Obj9.PyVnce = 0;
  @CAN_RadarRR::RRR_Object::RRR_Object_Obj9.PyVxCoVnce = 0;
  @CAN_RadarRR::RRR_Object::RRR_Object_Obj9.PyVyCoVnce = 0;
  @CAN_RadarRR::RRR_Object::RRR_Object_Obj9.ReferencePoint = 0;
  @CAN_RadarRR::RRR_Object::RRR_Object_Obj9.Vx = 0;
  @CAN_RadarRR::RRR_Object::RRR_Object_Obj9.VxAxCoVnce = 0;
  @CAN_RadarRR::RRR_Object::RRR_Object_Obj9.VxAyCoVnce = 0;
  @CAN_RadarRR::RRR_Object::RRR_Object_Obj9.VxVnce = 0;
  @CAN_RadarRR::RRR_Object::RRR_Object_Obj9.VxVyCoVnce = 0;
  @CAN_RadarRR::RRR_Object::RRR_Object_Obj9.Vy = 0;
  @CAN_RadarRR::RRR_Object::RRR_Object_Obj9.VyAxCoVnce = 0;
  }
  if(init_count == 82)
  {
  @CAN_RadarRR::RRR_Object::RRR_Object_Obj9.VyAyCoVnce = 0;
  @CAN_RadarRR::RRR_Object::RRR_Object_Obj9.VyVnce = 0;
  @CAN_RadarRR::RRR_Object::RRR_Object_Obj9.Width = 0;
  @CAN_RadarRR::RRR_Object::RRR_Object_Obj9.WidthVnce = 0;
  @CAN_RadarRR::RRR_Object::RRR_Object_ObjHdr_NumValidObjects = 0;
  @CAN_RadarRR::RRR_Object::RRR_Object_ObjHdr_TimeStamp = 0;
  @CAN_RadarRR::RRR_Object::RRR_Object_ObjHdr_TimeStampStatus = 0;
  @CAN_RadarRR::RRR_Object::RRR_Object_ObjHdr_VersionIdMajor = 0;
  @CAN_RadarRR::RRR_Object::RRR_Object_ObjHdr_VersionIdMinor = 0;
  @CAN_RadarRR::RRR_Object::RRR_Object_ObjHdr_VersionPatch = 0;
  @CAN_RadarRR::RRR_Object::RRR_Object_ObjHdr_content_type = 0;
  @CAN_RadarRR::RRR_Object::RRR_Object_ShiiHdr_DataMeasured = 0;
  @CAN_RadarRR::RRR_Object::RRR_Object_ShiiHdr_MisAzOOPCause = 0;
  @CAN_RadarRR::RRR_Object::RRR_Object_ShiiHdr_MisElOOPCause = 0;
  @CAN_RadarRR::RRR_Object::RRR_Object_ShiiHdr_RatioAdvProcListProc = 0;
  @CAN_RadarRR::RRR_Object::RRR_Object_ShiiHdr_SensorCalExtStat = 0;
  @CAN_RadarRR::RRR_Object::RRR_Object_ShiiHdr_SensorCalIntStat = 0;
  @CAN_RadarRR::RRR_Object::RRR_Object_ShiiHdr_SensorCalOnlStat = 0;
  @CAN_RadarRR::RRR_Object::RRR_Object_ShiiHdr_SensorFailureReas = 0;
  @CAN_RadarRR::RRR_Object::RRR_Object_ShiiHdr_SensorHeatingStatus = 0;
  @CAN_RadarRR::RRR_Object::RRR_Object_ShiiHdr_SensorOmmOpMode = 0;
  @CAN_RadarRR::RRR_Object::RRR_Object_ShiiHdr_ThermalDegr = 0;
  @CAN_RadarRR::RRR_Object::RRR_Object_SpiHdr_BldFov_Confidence = 0;
  @CAN_RadarRR::RRR_Object::RRR_Object_SpiHdr_BldFov_Status = 0;
  @CAN_RadarRR::RRR_Object::RRR_Object_SpiHdr_BldOperationMode = 0;
  }
  if(init_count == 83)
  {
  @CAN_RadarRR::RRR_Object::RRR_Object_SpiHdr_DistMaxProc = 0;
  @CAN_RadarRR::RRR_Object::RRR_Object_SpiHdr_DistMeasMaxMod = 0;
  @CAN_RadarRR::RRR_Object::RRR_Object_SpiHdr_DistMeasMinMod = 0;
  @CAN_RadarRR::RRR_Object::RRR_Object_SpiHdr_DistPrec = 0;
  @CAN_RadarRR::RRR_Object::RRR_Object_SpiHdr_DistSep = 0;
  @CAN_RadarRR::RRR_Object::RRR_Object_SpiHdr_DistStartProcDegraded = 0;
  @CAN_RadarRR::RRR_Object::RRR_Object_SpiHdr_DmpId = 0;
  @CAN_RadarRR::RRR_Object::RRR_Object_SpiHdr_FovRtrAzDetRng00 = 0;
  @CAN_RadarRR::RRR_Object::RRR_Object_SpiHdr_FovRtrAzDetRng01 = 0;
  @CAN_RadarRR::RRR_Object::RRR_Object_SpiHdr_FovRtrAzDetRng02 = 0;
  @CAN_RadarRR::RRR_Object::RRR_Object_SpiHdr_FovRtrAzDetRng03 = 0;
  @CAN_RadarRR::RRR_Object::RRR_Object_SpiHdr_FovRtrAzDetRng04 = 0;
  @CAN_RadarRR::RRR_Object::RRR_Object_SpiHdr_FovRtrAzDetRng05 = 0;
  @CAN_RadarRR::RRR_Object::RRR_Object_SpiHdr_FovRtrAzDetRng06 = 0;
  @CAN_RadarRR::RRR_Object::RRR_Object_SpiHdr_FovRtrAzDetRng07 = 0;
  @CAN_RadarRR::RRR_Object::RRR_Object_SpiHdr_FovRtrAzDetRng08 = 0;
  @CAN_RadarRR::RRR_Object::RRR_Object_SpiHdr_FovRtrAzDetRng09 = 0;
  @CAN_RadarRR::RRR_Object::RRR_Object_SpiHdr_FovRtrAzDetRng10 = 0;
  @CAN_RadarRR::RRR_Object::RRR_Object_SpiHdr_FovRtrAzDetRng11 = 0;
  @CAN_RadarRR::RRR_Object::RRR_Object_SpiHdr_FovRtrAzDetRng12 = 0;
  @CAN_RadarRR::RRR_Object::RRR_Object_SpiHdr_FovRtrAzDetRng13 = 0;
  @CAN_RadarRR::RRR_Object::RRR_Object_SpiHdr_FovRtrAzDetRng14 = 0;
  @CAN_RadarRR::RRR_Object::RRR_Object_SpiHdr_FovRtrAzDetRng15 = 0;
  @CAN_RadarRR::RRR_Object::RRR_Object_SpiHdr_FovRtrAzDetRng16 = 0;
  @CAN_RadarRR::RRR_Object::RRR_Object_SpiHdr_FovRtrAzDetRng17 = 0;
  }
  if(init_count == 84)
  {
  @CAN_RadarRR::RRR_Object::RRR_Object_SpiHdr_FovRtrAzDetRng18 = 0;
  @CAN_RadarRR::RRR_Object::RRR_Object_SpiHdr_FovRtrAzDetRng19 = 0;
  @CAN_RadarRR::RRR_Object::RRR_Object_SpiHdr_FovRtrAzDetRng20 = 0;
  @CAN_RadarRR::RRR_Object::RRR_Object_SpiHdr_FovRtrAzDetRng21 = 0;
  @CAN_RadarRR::RRR_Object::RRR_Object_SpiHdr_FovRtrAzDetRng22 = 0;
  @CAN_RadarRR::RRR_Object::RRR_Object_SpiHdr_FovRtrAzDetRng23 = 0;
  @CAN_RadarRR::RRR_Object::RRR_Object_SpiHdr_FovRtrAzDetRng24 = 0;
  @CAN_RadarRR::RRR_Object::RRR_Object_SpiHdr_FovRtrAzSegBrdr00 = 0;
  @CAN_RadarRR::RRR_Object::RRR_Object_SpiHdr_FovRtrAzSegBrdr01 = 0;
  @CAN_RadarRR::RRR_Object::RRR_Object_SpiHdr_FovRtrAzSegBrdr02 = 0;
  @CAN_RadarRR::RRR_Object::RRR_Object_SpiHdr_FovRtrAzSegBrdr03 = 0;
  @CAN_RadarRR::RRR_Object::RRR_Object_SpiHdr_FovRtrAzSegBrdr04 = 0;
  @CAN_RadarRR::RRR_Object::RRR_Object_SpiHdr_FovRtrAzSegBrdr05 = 0;
  @CAN_RadarRR::RRR_Object::RRR_Object_SpiHdr_FovRtrAzSegBrdr06 = 0;
  @CAN_RadarRR::RRR_Object::RRR_Object_SpiHdr_FovRtrAzSegBrdr07 = 0;
  @CAN_RadarRR::RRR_Object::RRR_Object_SpiHdr_FovRtrAzSegBrdr08 = 0;
  @CAN_RadarRR::RRR_Object::RRR_Object_SpiHdr_FovRtrAzSegBrdr09 = 0;
  @CAN_RadarRR::RRR_Object::RRR_Object_SpiHdr_FovRtrAzSegBrdr10 = 0;
  @CAN_RadarRR::RRR_Object::RRR_Object_SpiHdr_FovRtrAzSegBrdr11 = 0;
  @CAN_RadarRR::RRR_Object::RRR_Object_SpiHdr_FovRtrAzSegBrdr12 = 0;
  @CAN_RadarRR::RRR_Object::RRR_Object_SpiHdr_FovRtrAzSegBrdr13 = 0;
  @CAN_RadarRR::RRR_Object::RRR_Object_SpiHdr_FovRtrAzSegBrdr14 = 0;
  @CAN_RadarRR::RRR_Object::RRR_Object_SpiHdr_FovRtrAzSegBrdr15 = 0;
  @CAN_RadarRR::RRR_Object::RRR_Object_SpiHdr_FovRtrAzSegBrdr16 = 0;
  @CAN_RadarRR::RRR_Object::RRR_Object_SpiHdr_FovRtrAzSegBrdr17 = 0;
  }
  if(init_count == 85)
  {
  @CAN_RadarRR::RRR_Object::RRR_Object_SpiHdr_FovRtrAzSegBrdr18 = 0;
  @CAN_RadarRR::RRR_Object::RRR_Object_SpiHdr_FovRtrAzSegBrdr19 = 0;
  @CAN_RadarRR::RRR_Object::RRR_Object_SpiHdr_FovRtrAzSegBrdr20 = 0;
  @CAN_RadarRR::RRR_Object::RRR_Object_SpiHdr_FovRtrAzSegBrdr21 = 0;
  @CAN_RadarRR::RRR_Object::RRR_Object_SpiHdr_FovRtrAzSegBrdr22 = 0;
  @CAN_RadarRR::RRR_Object::RRR_Object_SpiHdr_FovRtrAzSegBrdr23 = 0;
  @CAN_RadarRR::RRR_Object::RRR_Object_SpiHdr_FovRtrAzSegBrdr24 = 0;
  @CAN_RadarRR::RRR_Object::RRR_Object_SpiHdr_FovRtrElRngGEnd00 = 0;
  @CAN_RadarRR::RRR_Object::RRR_Object_SpiHdr_FovRtrElRngGEnd01 = 0;
  @CAN_RadarRR::RRR_Object::RRR_Object_SpiHdr_FovRtrElRngGEnd02 = 0;
  @CAN_RadarRR::RRR_Object::RRR_Object_SpiHdr_FovRtrElRngGEnd03 = 0;
  @CAN_RadarRR::RRR_Object::RRR_Object_SpiHdr_FovRtrElRngGEnd04 = 0;
  @CAN_RadarRR::RRR_Object::RRR_Object_SpiHdr_FovRtrElRngGEnd05 = 0;
  @CAN_RadarRR::RRR_Object::RRR_Object_SpiHdr_FovRtrElRngGEnd06 = 0;
  @CAN_RadarRR::RRR_Object::RRR_Object_SpiHdr_FovRtrElRngGEnd07 = 0;
  @CAN_RadarRR::RRR_Object::RRR_Object_SpiHdr_FovRtrElRngGEnd08 = 0;
  @CAN_RadarRR::RRR_Object::RRR_Object_SpiHdr_FovRtrElRngGEnd09 = 0;
  @CAN_RadarRR::RRR_Object::RRR_Object_SpiHdr_FovRtrElRngGEnd10 = 0;
  @CAN_RadarRR::RRR_Object::RRR_Object_SpiHdr_FovRtrElSegBrdr00 = 0;
  @CAN_RadarRR::RRR_Object::RRR_Object_SpiHdr_FovRtrElSegBrdr01 = 0;
  @CAN_RadarRR::RRR_Object::RRR_Object_SpiHdr_FovRtrElSegBrdr02 = 0;
  @CAN_RadarRR::RRR_Object::RRR_Object_SpiHdr_FovRtrElSegBrdr03 = 0;
  @CAN_RadarRR::RRR_Object::RRR_Object_SpiHdr_FovRtrElSegBrdr04 = 0;
  @CAN_RadarRR::RRR_Object::RRR_Object_SpiHdr_FovRtrElSegBrdr05 = 0;
  @CAN_RadarRR::RRR_Object::RRR_Object_SpiHdr_FovRtrElSegBrdr06 = 0;
  }
  if(init_count == 86)
  {
  @CAN_RadarRR::RRR_Object::RRR_Object_SpiHdr_FovRtrElSegBrdr07 = 0;
  @CAN_RadarRR::RRR_Object::RRR_Object_SpiHdr_FovRtrElSegBrdr08 = 0;
  @CAN_RadarRR::RRR_Object::RRR_Object_SpiHdr_FovRtrElSegBrdr09 = 0;
  @CAN_RadarRR::RRR_Object::RRR_Object_SpiHdr_FovRtrElSegBrdr10 = 0;
  @CAN_RadarRR::RRR_Object::RRR_Object_SpiHdr_ModId = 0;
  @CAN_RadarRR::RRR_Object::RRR_Object_SpiHdr_RngGainRfInterfere = 0;
  @CAN_RadarRR::RRR_Object::RRR_Object_SpiHdr_SensorExtDisturbed = 0;
  @CAN_RadarRR::RRR_Object::RRR_Object_SpiHdr_SensorOrientPitch = 0;
  @CAN_RadarRR::RRR_Object::RRR_Object_SpiHdr_SensorOrientYaw = 0;
  @CAN_RadarRR::RRR_Object::RRR_Object_SpiHdr_SensorOrientation = 0;
  @CAN_RadarRR::RRR_Object::RRR_Object_SpiHdr_SensorOriginPointX = 0;
  @CAN_RadarRR::RRR_Object::RRR_Object_SpiHdr_SensorOriginPointY = 0;
  @CAN_RadarRR::RRR_Object::RRR_Object_SpiHdr_SensorOriginPointZ = 0;
  @CAN_RadarRR::RRR_Object::RRR_Object_SpiHdr_VelMeasMax = 0;
  @CAN_RadarRR::RRR_Object::RRR_Object_SpiHdr_VelMeasMin = 0;
  @CAN_RadarRR::RRR_Object::RRR_Object_SpiHdr_VelPrec = 0;
  @CAN_RadarRR::RRR_Object::RRR_Object_SpiHdr_VelSep = 0;
  sysSetVariableData(sysvar::CAN_RadarRR::RRR_RoadSideBoundaries::RRR_RoadSideBoundaries::SignalValue, RRR_RoadSideBoundaries_byte_Array, 1000);
  $CAN_RadarRR::RRR_SensorOutput::RRR_Veh_SenOut_VehConfParamStatus = 0;
  if (prestart_mode==0) init_count = 0;
  initFlag = 13;
  }
  init_count++;
}