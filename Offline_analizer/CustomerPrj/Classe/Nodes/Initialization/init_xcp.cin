/*@!Encoding:1252*/
/**
 * @file init_xcp.cin
 * @author ADAS_HIL_TEAM
 * @date 10-04-2022
 * @brief  contains code that initilizes the XCP variables
 *
 * ################################################################
 * C O P Y R I G H T S
 * ----------------------------------------------------------------
 * Copyright (c) 2022-2023 by Robert Bosch GmbH. All rights reserved.
 
 * The reproduction, distribution and utilization of this file as
 * well as the communication of its contents to others without express
 * authorization is prohibited. Offenders will be held liable for the
 * payment of damages. All rights reserved in the event of the grant
 * of a patent, utility model or design.
 *
 * ################################################################
*/

includes
{
}

variables
{
}

/***** Automated code generation starts here *****/

void init_xcp()
{
  if(init_count == 1)
  {
//  @sysvar::XCP::RadarFC::_g_ods_OneDrivingSW_fct_fct_mainproc_ods_fct_fct_mainproc_RunnableMainProc::_m_portFunctionStates::_m_states::_m_aebCfmFullBrakeState = 0;
//  @sysvar::XCP::RadarFC::_g_ods_OneDrivingSW_fct_fct_mainproc_ods_fct_fct_mainproc_RunnableMainProc::_m_portFunctionStates::_m_states::_m_aebCfmPrefillState = 0;
//  @sysvar::XCP::RadarFC::_g_ods_OneDrivingSW_fct_fct_mainproc_ods_fct_fct_mainproc_RunnableMainProc::_m_portFunctionStates::_m_states::_m_aebCfmWarningAcousticState = 0;
//  @sysvar::XCP::RadarFC::_g_ods_OneDrivingSW_fct_fct_mainproc_ods_fct_fct_mainproc_RunnableMainProc::_m_portFunctionStates::_m_states::_m_aebTiplLongFullBrakeState = 0;
//  @sysvar::XCP::RadarFC::_g_ods_OneDrivingSW_fct_fct_mainproc_ods_fct_fct_mainproc_RunnableMainProc::_m_portFunctionStates::_m_states::_m_aebTiplLongWarningAcousticState = 0;
//  @sysvar::XCP::RadarFC::_g_ods_OneDrivingSW_fct_fct_mainproc_ods_fct_fct_mainproc_RunnableMainProc::_m_portFunctionStates::_m_states::_m_aebTiplTurnFullBrakeState = 0;
//  @sysvar::XCP::RadarFC::_g_ods_OneDrivingSW_fct_fct_mainproc_ods_fct_fct_mainproc_RunnableMainProc_m_portMainProc_out_local::TChangeableMemPool::_::_::_m_arrayPool::_1_::_elem::_m_functionStatesHmi::_m_states::_m_aebTiplLongLatentInformationState = 0;
//  @sysvar::XCP::RadarFC::_g_ods_OneDrivingSW_fct_fct_mainproc_ods_fct_fct_mainproc_RunnableMainProc_m_portMainProc_out_local::TChangeableMemPool::_::_::_m_arrayPool::_1_::_elem::_m_functionStatesHmi::_m_states::_m_aebTiplLongWarningHapticState = 0;
//  @sysvar::XCP::RadarFC::_g_ods_OneDrivingSW_motion_PJ_VMC_BehaviorStateControlLogic_BehaviorStateControlLogicRunnable_m_portLongitudinalActivationRequest_local::TChangeableMemPool::_::_::_m_arrayPool::_1_::_elem::_m_longitudinal_L12_Emergency_ActivationRequest = 0;
//  @sysvar::XCP::RadarFC::_g_ods_OneDrivingSW_perEnv_EnvModel_PerEimTprRunnable_PerEimTprRunnable_m_fusObjPort_out_local::TChangeableMemPool::_::_::_m_arrayPool::_0_::_elem::_FusObj_st::_m_value::_0_::_b_un::_b_st::_AdditionalSensorAssociated_b = 0;
//  @sysvar::XCP::RadarFC::_g_ods_OneDrivingSW_perEnv_EnvModel_PerEimTprRunnable_PerEimTprRunnable_m_fusObjPort_out_local::TChangeableMemPool::_::_::_m_arrayPool::_0_::_elem::_FusObj_st::_m_value::_0_::_dxv_sw = 0;
//  @sysvar::XCP::RadarFC::_g_ods_OneDrivingSW_perEnv_EnvModel_PerEimTprRunnable_PerEimTprRunnable_m_fusObjPort_out_local::TChangeableMemPool::_::_::_m_arrayPool::_0_::_elem::_FusObj_st::_m_value::_0_::_vxv_sw = 0;
//  @sysvar::XCP::RadarFC::_g_ods_OneDrivingSW_perHv_HV_PerPmeRunnable_PerPmeRunnable::PerRunnable::_::_m_controller::_m_HistBuffer::_m_hostVehHist::_tAbsTimeStamp_ul = 0;
//  @sysvar::XCP::RadarFC::_g_ods_OneDrivingSW_perHv_HV_PerPmeRunnable_PerPmeRunnable_m_pmePort_out_local::TChangeableMemPool::_::_::_m_arrayPool::_1_::_elem::_ayvRef_sw = 0;
//  @sysvar::XCP::RadarFC::_g_ods_OneDrivingSW_perHv_HV_PerPmeRunnable_PerPmeRunnable_m_pmePort_out_local::TChangeableMemPool::_::_::_m_arrayPool::_1_::_elem::_kapCurvTraj_sw = 0;
//  @sysvar::XCP::RadarFC::_g_ods_OneDrivingSW_perHv_HV_PerPmeRunnable_PerPmeRunnable_m_pmePort_out_local::TChangeableMemPool::_::_::_m_arrayPool::_1_::_elem::_psiDtOpt_sw = 0;
//  @sysvar::XCP::RadarFC::_g_ods_OneDrivingSW_perHv_HV_PerPmeRunnable_PerPmeRunnable_m_pmePort_out_local::TChangeableMemPool::_::_::_m_arrayPool::_1_::_elem::_vxvRef_sw = 0;
//  @sysvar::XCP::RadarFC::_g_ods_OneDrivingSW_sitBc_Bc_RunnableTrafficContext_RunnableTrafficContext_m_trafficContext_out_local::TChangeableMemPool::_::_::_m_arrayPool::_1_::_elem::_m_probDrivingSense = 0;
//  @sysvar::XCP::RadarFC::_padval_x_par_a_st::_VdiDisableAebOutput_B = 0;
  initFlag = 2;
  }
  init_count++;
}