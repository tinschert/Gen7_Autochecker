
// Autogenerated by -> Platform\Classe\Scripts\Rbs_Scripts\create_ininode.py 
includes
{
}

variables
{
}
/***** Automated code generation starts here *****/

void init_customer_VW_GOLF_VII_W3()
{
  int object_id;
  int array_len;
  if(init_count == 1)
  {
  @hil_ctrl::frame_grabber_btn = 0;
  @hil_ctrl::frame_grabber_result = 0;
  @hil_ctrl::frame_grabber_mode = 0;
  @hil_ctrl::frame_grabber_timeout = 10;
  @hil_ctrl::ralo_version = 3;
  @hil_ctrl::reset_vx = 0;
  @hil_ctrl::pmb_variant = 0;
  @hil_ctrl::camera_view = 0;
  @hil_ctrl::front_rwa_ctrl = 1;
  @hil_ctrl::rear_rwa_ctrl = 1;
  @hil_ctrl::cm_version = 0;
  @hil_ctrl::cm_modify_test_run = 1;
  @CAN_RadarFL_RXX_Location::Read_No_signals = 55;
  @CAN_RadarFL_RXX_Location::Write_No_signals = 55;
  @CAN_RadarFL_RXX_Location::TP_enable_loopback_reading = 0;
  @CAN_RadarFC_RXX_Location::Read_No_signals = 55;
  @CAN_RadarFC_RXX_Location::Write_No_signals = 55;
  @CAN_RadarFC_RXX_Location::TP_enable_loopback_reading = 0;
  @CAN_RadarFR_RXX_Location::Read_No_signals = 55;
  @CAN_RadarFR_RXX_Location::Write_No_signals = 55;
  @CAN_RadarFR_RXX_Location::TP_enable_loopback_reading = 0;
  @CAN_RadarRR_RXX_Location::Read_No_signals = 55;
  @CAN_RadarRR_RXX_Location::Write_No_signals = 55;
  @CAN_RadarRR_RXX_Location::TP_enable_loopback_reading = 0;
  @CAN_RadarRL_RXX_Location::Read_No_signals = 55;
  }
  if(init_count == 2)
  {
  @CAN_RadarRL_RXX_Location::Write_No_signals = 55;
  @CAN_RadarRL_RXX_Location::TP_enable_loopback_reading = 0;
  @CAN_RadarFL_RFL_Object::Read_No_signals = 10;
  @CAN_RadarFL_RFL_Object::Write_No_signals = 10;
  @CAN_RadarFC_RFC_Object::Read_No_signals = 10;
  @CAN_RadarFC_RFC_Object::Write_No_signals = 10;
  @CAN_RadarFR_RFR_Object::Read_No_signals = 10;
  @CAN_RadarFR_RFR_Object::Write_No_signals = 10;
  @CAN_RadarRR_RRR_Object::Read_No_signals = 10;
  @CAN_RadarRR_RRR_Object::Write_No_signals = 10;
  @CAN_RadarRL_RRL_Object::Read_No_signals = 10;
  @CAN_RadarRL_RRL_Object::Write_No_signals = 10;
  @CAN_RadarFL_RFL_RoadSideBoundaries::Read_No_signals = 10;
  @CAN_RadarFL_RFL_RoadSideBoundaries::Write_No_signals = 10;
  @CAN_RadarFC_RFC_RoadSideBoundaries::Read_No_signals = 10;
  @CAN_RadarFC_RFC_RoadSideBoundaries::Write_No_signals = 10;
  @CAN_RadarFR_RFR_RoadSideBoundaries::Read_No_signals = 10;
  @CAN_RadarFR_RFR_RoadSideBoundaries::Write_No_signals = 10;
  @CAN_RadarRR_RRR_RoadSideBoundaries::Read_No_signals = 10;
  @CAN_RadarRR_RRR_RoadSideBoundaries::Write_No_signals = 10;
  @CAN_RadarRL_RRL_RoadSideBoundaries::Read_No_signals = 10;
  @CAN_RadarRL_RRL_RoadSideBoundaries::Write_No_signals = 10;
  @CAN_RadarFL_RFL_Object::TP_enable_loopback_reading = 0;
  @CAN_RadarFC_RFC_Object::TP_enable_loopback_reading = 0;
  @CAN_RadarFR_RFR_Object::TP_enable_loopback_reading = 0;
  }
  if(init_count == 3)
  {
  @CAN_RadarRL_RRL_Object::TP_enable_loopback_reading = 0;
  @CAN_RadarRR_RRR_Object::TP_enable_loopback_reading = 0;
  @CAN_RadarFL_RFL_RoadSideBoundaries::TP_enable_loopback_reading = 0;
  @CAN_RadarFC_RFC_RoadSideBoundaries::TP_enable_loopback_reading = 0;
  @CAN_RadarFR_RFR_RoadSideBoundaries::TP_enable_loopback_reading = 0;
  @CAN_RadarRL_RRL_RoadSideBoundaries::TP_enable_loopback_reading = 0;
  @CAN_RadarRR_RRR_RoadSideBoundaries::TP_enable_loopback_reading = 0;
  @hil_vehicle::wic_half_axis_length = 0.0;
  @hil_vehicle::wic_impulse_length = 19.93;
  @hil_vehicle::wic_impulses_per_rotation = 96.0;
  @hil_vehicle::wic_max_impulses = 255.0;
  @hil_vehicle::vehicle_mass = 1279.0;
  @hil_vehicle::vehicle_length = 4562.0;
  @hil_vehicle::vehicle_width = 1799.0;
  @hil_vehicle::wheelbase = 2631.0;
  @hil_vehicle::front_axis_length = 1354.0;
  @hil_vehicle::rear_axis_length = 1325.0;
  @hil_vehicle::stub_axle_length = 98.0;
  @hil_vehicle::front_overhang_length = 798.0;
  @hil_vehicle::rear_overhang_length = 770.0;
  @hil_vehicle::turning_radius_min = 11000.0;
  @hil_vehicle::swa_to_rwa_ratio = 1.0;
  @hil_vehicle::wheel_radius = 316.0;
  @hil_vehicle::driven_wheel = 2.0;
  @hil_vehicle::steering_characteristic_type = 0.0;
  }
  if(init_count == 4)
  {
  @hil_vehicle::steering_characteristic_rack_travel = 100.0;
  @hil_vehicle::steering_characteristic_swa_rwa_ratio = 0.047;
  @hil_vehicle::steering_arm_length = 0.1;
  @hil_vehicle::abs_wic_counter_cfg = 0.0;
  @hil_vehicle::max_vehicle_speed = 300.0;
  @hil_vehicle::brake_pedal_override_limit = 15.0;
  @hil_vehicle::adas_reaction_delay = 0.2;
  @hil_vehicle::brake_jerk_decel_req = -15.0;
  @hil_vehicle::brake_jerk_duration = 0.38;
  @hil_drv::driver_torque_is_auto_calculated = 0.0;
  @hil_drv::driver_override_torque_limit = 6.0;
  @hil_drv::driver_torque_min = 0.5;
  @hil_adas::long_ctrl_is_enabled = 1;
  @hil_adas::lat_ctrl_is_enabled = 1;
  @radarfc_par::sensor_model = 1.0;
  @fvideo_par::mounting_pos_x = 2.03;
  @fvideo_par::mounting_pos_y = 0.0;
  @fvideo_par::mounting_pos_z = 1.35;
  @fvideo_par::mounting_ori_yaw = 0.0;
  @radarfc_par::mounting_pos_x = 3.4719;
  @radarfc_par::mounting_pos_y = 0.0;
  @radarfc_par::mounting_pos_z = 0.4;
  @radarfc_par::mounting_ori_yaw = 0.0;
  @radarfr_par::mounting_pos_x = 3.33;
  @radarfr_par::mounting_pos_y = -0.774;
  }
  if(init_count == 5)
  {
  @radarfr_par::mounting_pos_z = 0.4;
  @radarfr_par::mounting_ori_yaw = -0.7853981633974483;
  @radarfl_par::mounting_pos_x = 3.33;
  @radarfl_par::mounting_pos_y = 0.774;
  @radarfl_par::mounting_pos_z = 0.4;
  @radarfl_par::mounting_ori_yaw = 0.7853981633974483;
  @radarrr_par::mounting_pos_x = -0.7591;
  @radarrr_par::mounting_pos_y = -0.774;
  @radarrr_par::mounting_pos_z = 0.4;
  @radarrr_par::mounting_ori_yaw = -2.356194490192345;
  @radarrl_par::mounting_pos_x = -0.7591;
  @radarrl_par::mounting_pos_y = 0.774;
  @radarrl_par::mounting_pos_z = 0.4;
  @radarrl_par::mounting_ori_yaw = 2.356194490192345;
  if (prestart_mode==0) init_count = 0;
  initFlag = 3;
  }
  init_count++;
}