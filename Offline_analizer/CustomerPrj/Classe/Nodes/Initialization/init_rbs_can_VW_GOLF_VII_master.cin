/*@!Encoding:1252*/
// Autogenerated by -> Platform\Classe\Scripts\Rbs_Scripts\create_ininode.py 

includes
{
}

variables 
{
  int i;
  byte RFC_FieldDataCollection_byte_Array[5000];
  byte RFC_RoadSideBoundaries_byte_Array[1000];
  byte RFC_Veh_ConfigMgmt_byte_Array[20];
  byte RFL_Veh_ConfigMgmt_byte_Array[20];
  byte RFR_Veh_ConfigMgmt_byte_Array[20];
  byte RRL_Veh_ConfigMgmt_byte_Array[20];
  byte RRR_Veh_ConfigMgmt_byte_Array[20];
  byte RFL_FieldDataCollection_byte_Array[5000];
  byte RFL_RoadSideBoundaries_byte_Array[1000];
  byte RFR_FieldDataCollection_byte_Array[5000];
  byte RFR_RoadSideBoundaries_byte_Array[1000];
  byte RRL_FieldDataCollection_byte_Array[5000];
  byte RRL_RoadSideBoundaries_byte_Array[1000];
  byte RRR_FieldDataCollection_byte_Array[5000];
  byte RRR_RoadSideBoundaries_byte_Array[1000];
} 

void init_DASy_VW_GOLF_VII()
{
  if(init_count == 1)
  {
  $CAN_ADAS::ACC_06_DASy::ACC_Minimale_Bremsung_D = 0;
  $CAN_ADAS::ACC_06_DASy::ACC_neg_Sollbeschl_Grad_02_D = 0;
  $CAN_ADAS::ACC_06_DASy::ACC_pos_Sollbeschl_Grad_02_D = 0;
  $CAN_ADAS::ACC_06_DASy::ACC_zul_Regelabw_oben_D = 0;
  $CAN_ADAS::ACC_06_DASy::ACC_zul_Regelabw_unten_D = 0;
  $CAN_ADAS::ACC_06_DASy::ADAS_CoastReq_ACC = 0;
  $CAN_ADAS::ACC_06_DASy::ADAS_EngStartRun_Req = 0;
  $CAN_ADAS::ACC_06_DASy::ADAS_LimActReq = 0;
  $CAN_ADAS::ACC_06_DASy::ADAS_LimAx_LIM = 0;
  $CAN_ADAS::ACC_06_DASy::ADAS_ShtDwnStrat_ACC = 0;
  $CAN_ADAS::ACC_06_DASy::ADAS_ShtDwnStrat_Lim = 0;
  $CAN_ADAS::ACC_06_DASy::ADAS_Sts_LIM = 0;
  $CAN_ADAS::ACC_06_DASy::ADAS_VehSecureReq = 0;
  $CAN_ADAS::ACC_06_DASy::LIM_neg_Sollbeschl_Grad_02_D = 0;
  $CAN_ADAS::ACC_06_DASy::LIM_pos_Sollbeschl_Grad_02_D = 0;
  $CAN_ADAS::ACC_06_DASy::LIM_zul_Regelabw_oben_D = 0;
  $CAN_ADAS::ACC_06_DASy::LIM_zul_Regelabw_unten_D = 0;
  $CAN_ADAS::ACC_06_DASy::YawTorqueRequest = 0;
  $CAN_ADAS::ACC_06_DASy::YawTorqueTarget = 0;
  $CAN_ADAS::ADAS2EPS_0x1C1::ADAS_ExtMaxRPCTrq = 0;
  $CAN_ADAS::ADAS2EPS_0x1C1::ADAS_ExtMinRPCTrq = 0;
  $CAN_ADAS::ADAS2EPS_0x1C1::ADAS_RdWhlAgReq = 0;
  $CAN_ADAS::ADAS2EPS_0x1C1::ADAS_RdWhlAgReqActive = 0;
  $CAN_ADAS::ADAS2EPS_0x1C1::DADCSteerTqReqActive = 0;
  $CAN_ADAS::ADAS_0x4BA_HMI::ACCTrafficLightReaction = 0;
  }
  if(init_count == 2)
  {
  $CAN_ADAS::ADAS_0x4BA_HMI::ACC_ICON_LADI = 0;
  $CAN_ADAS::ADAS_0x4BA_HMI::ALCFeatureStatus = 0;
  $CAN_ADAS::ADAS_0x4BA_HMI::AdcStateInformation = 0;
  $CAN_ADAS::ADAS_0x4BA_HMI::AlcEnhancedStatus = 0;
  $CAN_ADAS::ADAS_0x4BA_HMI::AlcPlusState = 0;
  $CAN_ADAS::ADAS_0x4BA_HMI::AlcPremiumState = 0;
  $CAN_ADAS::ADAS_0x4BA_HMI::AudioNotificationId = 0;
  $CAN_ADAS::ADAS_0x4BA_HMI::AuxiliarySymbol = 0;
  $CAN_ADAS::ADAS_0x4BA_HMI::CurvatureInformation = 0;
  $CAN_ADAS::ADAS_0x4BA_HMI::DisplayedEgoSpeed = 0;
  $CAN_ADAS::ADAS_0x4BA_HMI::DisplayedEgoSpeedColor = 0;
  $CAN_ADAS::ADAS_0x4BA_HMI::DisplayedLaneMarking1Color = 0;
  $CAN_ADAS::ADAS_0x4BA_HMI::DisplayedLaneMarking1Type = 0;
  $CAN_ADAS::ADAS_0x4BA_HMI::DisplayedLaneMarking1Y = 0;
  $CAN_ADAS::ADAS_0x4BA_HMI::DisplayedLaneMarking2Color = 0;
  $CAN_ADAS::ADAS_0x4BA_HMI::DisplayedLaneMarking2Type = 0;
  $CAN_ADAS::ADAS_0x4BA_HMI::DisplayedLaneMarking2Y = 0;
  $CAN_ADAS::ADAS_0x4BA_HMI::DisplayedLaneMarking3Color = 0;
  $CAN_ADAS::ADAS_0x4BA_HMI::DisplayedLaneMarking3Type = 0;
  $CAN_ADAS::ADAS_0x4BA_HMI::DisplayedLaneMarking3Y = 0;
  $CAN_ADAS::ADAS_0x4BA_HMI::DisplayedLaneMarking4Color = 0;
  $CAN_ADAS::ADAS_0x4BA_HMI::DisplayedLaneMarking4Type = 0;
  $CAN_ADAS::ADAS_0x4BA_HMI::DisplayedLaneMarking4Y = 0;
  $CAN_ADAS::ADAS_0x4BA_HMI::DisplayedLaneMarkingLeftColor = 0;
  $CAN_ADAS::ADAS_0x4BA_HMI::DisplayedLaneMarkingLeftType = 0;
  }
  if(init_count == 3)
  {
  $CAN_ADAS::ADAS_0x4BA_HMI::DisplayedLaneMarkingRightColor = 0;
  $CAN_ADAS::ADAS_0x4BA_HMI::DisplayedLaneMarkingRightType = 0;
  $CAN_ADAS::ADAS_0x4BA_HMI::DisplayedTextMessageId = 0;
  $CAN_ADAS::ADAS_0x4BA_HMI::ELKHREStatus = 0;
  $CAN_ADAS::ADAS_0x4BA_HMI::ELKOCVStatus = 0;
  $CAN_ADAS::ADAS_0x4BA_HMI::ELKOTStatus = 0;
  $CAN_ADAS::ADAS_0x4BA_HMI::ELKSLStatus = 0;
  $CAN_ADAS::ADAS_0x4BA_HMI::ELKVREStatus = 0;
  $CAN_ADAS::ADAS_0x4BA_HMI::EgoLaneAssignment = 0;
  $CAN_ADAS::ADAS_0x4BA_HMI::EgoLaneChange = 0;
  $CAN_ADAS::ADAS_0x4BA_HMI::HwaAccStatus = 0;
  $CAN_ADAS::ADAS_0x4BA_HMI::HwaHfStatus = 0;
  $CAN_ADAS::ADAS_0x4BA_HMI::HwaHonStatus = 0;
  $CAN_ADAS::ADAS_0x4BA_HMI::Indicator01 = 0;
  $CAN_ADAS::ADAS_0x4BA_HMI::Indicator02 = 0;
  $CAN_ADAS::ADAS_0x4BA_HMI::Indicator03 = 0;
  $CAN_ADAS::ADAS_0x4BA_HMI::Indicator04 = 0;
  $CAN_ADAS::ADAS_0x4BA_HMI::Indicator05 = 0;
  $CAN_ADAS::ADAS_0x4BA_HMI::Indicator06 = 0;
  $CAN_ADAS::ADAS_0x4BA_HMI::Indicator07 = 0;
  $CAN_ADAS::ADAS_0x4BA_HMI::Indicator08 = 0;
  $CAN_ADAS::ADAS_0x4BA_HMI::Indicator09 = 0;
  $CAN_ADAS::ADAS_0x4BA_HMI::Indicator10 = 0;
  $CAN_ADAS::ADAS_0x4BA_HMI::Indicator11 = 0;
  $CAN_ADAS::ADAS_0x4BA_HMI::Indicator12 = 0;
  }
  if(init_count == 4)
  {
  $CAN_ADAS::ADAS_0x4BA_HMI::Indicator13 = 0;
  $CAN_ADAS::ADAS_0x4BA_HMI::Indicator14 = 0;
  $CAN_ADAS::ADAS_0x4BA_HMI::Indicator15 = 0;
  $CAN_ADAS::ADAS_0x4BA_HMI::Indicator16 = 0;
  $CAN_ADAS::ADAS_0x4BA_HMI::LDWStatus = 0;
  $CAN_ADAS::ADAS_0x4BA_HMI::LKAStatus = 0;
  $CAN_ADAS::ADAS_0x4BA_HMI::LedHadState = 0;
  $CAN_ADAS::ADAS_0x4BA_HMI::NeighboringVehicle1AugmentedData = 0;
  $CAN_ADAS::ADAS_0x4BA_HMI::NeighboringVehicle1VehicleType = 0;
  $CAN_ADAS::ADAS_0x4BA_HMI::NeighboringVehicle1X = 0;
  $CAN_ADAS::ADAS_0x4BA_HMI::NeighboringVehicle1Y = 0;
  $CAN_ADAS::ADAS_0x4BA_HMI::NeighboringVehicle2AugmentedData = 0;
  $CAN_ADAS::ADAS_0x4BA_HMI::NeighboringVehicle2VehicleType = 0;
  $CAN_ADAS::ADAS_0x4BA_HMI::NeighboringVehicle2X = 0;
  $CAN_ADAS::ADAS_0x4BA_HMI::NeighboringVehicle2Y = 0;
  $CAN_ADAS::ADAS_0x4BA_HMI::NeighboringVehicle3AugmentedData = 0;
  $CAN_ADAS::ADAS_0x4BA_HMI::NeighboringVehicle3VehicleType = 0;
  $CAN_ADAS::ADAS_0x4BA_HMI::NeighboringVehicle3X = 0;
  $CAN_ADAS::ADAS_0x4BA_HMI::NeighboringVehicle3Y = 0;
  $CAN_ADAS::ADAS_0x4BA_HMI::NeighboringVehicle4AugmentedData = 0;
  $CAN_ADAS::ADAS_0x4BA_HMI::NeighboringVehicle4VehicleType = 0;
  $CAN_ADAS::ADAS_0x4BA_HMI::NeighboringVehicle4X = 0;
  $CAN_ADAS::ADAS_0x4BA_HMI::NeighboringVehicle4Y = 0;
  $CAN_ADAS::ADAS_0x4BA_HMI::NeighboringVehicle5AugmentedData = 0;
  $CAN_ADAS::ADAS_0x4BA_HMI::NeighboringVehicle5VehicleType = 0;
  }
  if(init_count == 5)
  {
  $CAN_ADAS::ADAS_0x4BA_HMI::NeighboringVehicle5X = 0;
  $CAN_ADAS::ADAS_0x4BA_HMI::NeighboringVehicle5Y = 0;
  $CAN_ADAS::ADAS_0x4BA_HMI::NeighboringVehicle6AugmentedData = 0;
  $CAN_ADAS::ADAS_0x4BA_HMI::NeighboringVehicle6VehicleType = 0;
  $CAN_ADAS::ADAS_0x4BA_HMI::NeighboringVehicle6X = 0;
  $CAN_ADAS::ADAS_0x4BA_HMI::NeighboringVehicle6Y = 0;
  $CAN_ADAS::ADAS_0x4BA_HMI::NeighboringVehicle7AugmentedData = 0;
  $CAN_ADAS::ADAS_0x4BA_HMI::NeighboringVehicle7VehicleType = 0;
  $CAN_ADAS::ADAS_0x4BA_HMI::NeighboringVehicle7X = 0;
  $CAN_ADAS::ADAS_0x4BA_HMI::NeighboringVehicle7Y = 0;
  $CAN_ADAS::ADAS_0x4BA_HMI::NeighboringVehicle8AugmentedData = 0;
  $CAN_ADAS::ADAS_0x4BA_HMI::NeighboringVehicle8VehicleType = 0;
  $CAN_ADAS::ADAS_0x4BA_HMI::NeighboringVehicle8X = 0;
  $CAN_ADAS::ADAS_0x4BA_HMI::NeighboringVehicle8Y = 0;
  $CAN_ADAS::ADAS_0x4BA_HMI::Number01 = 0;
  $CAN_ADAS::ADAS_0x4BA_HMI::Number02 = 0;
  $CAN_ADAS::ADAS_0x4BA_HMI::OffsetDirection = 0;
  $CAN_ADAS::ADAS_0x4BA_HMI::OffsetReason = 0;
  $CAN_ADAS::ADAS_0x4BA_HMI::PopupTextMessage = 0;
  $CAN_ADAS::ADAS_0x4BA_HMI::ReducedTimeGap = 0;
  $CAN_ADAS::ADAS_0x4BA_HMI::SensorConeFrontCenter = 0;
  $CAN_ADAS::ADAS_0x4BA_HMI::SetSpeed = 0;
  $CAN_ADAS::ADAS_0x4BA_HMI::SetSpeedColor = 0;
  $CAN_ADAS::ADAS_0x4BA_HMI::TimeGapColor = 0;
  $CAN_ADAS::ADAS_0x4BA_HMI::TimeGapSetValue = 0;
  }
  if(init_count == 6)
  {
  $CAN_ADAS::ADAS_0x4BA_HMI::TrafficLightDisplayRequest = 0;
  $CAN_ADAS::ADAS_0x4BA_HMI::TrafficLightDistance = 0;
  $CAN_ADAS::ADAS_0x4BA_HMI::TrafficLightStatus = 0;
  $CAN_ADAS::ADAS_0x4BA_HMI::TrafficSignSpeedLimit = 0;
  $CAN_ADAS::ADAS_0x4BA_HMI::TurnIndicatorSignal = 0;
  $CAN_ADAS::ADAS_0x4BC_HMI::ADAS_Curv_1_NumValidPoints = 0;
  $CAN_ADAS::ADAS_0x4BC_HMI::ADAS_Curv_1_dy_00 = 0;
  $CAN_ADAS::ADAS_0x4BC_HMI::ADAS_Curv_1_dy_01 = 0;
  $CAN_ADAS::ADAS_0x4BC_HMI::ADAS_Curv_1_dy_02 = 0;
  $CAN_ADAS::ADAS_0x4BC_HMI::ADAS_Curv_1_dy_03 = 0;
  $CAN_ADAS::ADAS_0x4BC_HMI::ADAS_Curv_1_dy_04 = 0;
  $CAN_ADAS::ADAS_0x4BC_HMI::ADAS_Curv_1_dy_05 = 0;
  $CAN_ADAS::ADAS_0x4BC_HMI::ADAS_Curv_1_dy_06 = 0;
  $CAN_ADAS::ADAS_0x4BC_HMI::ADAS_Curv_1_dy_07 = 0;
  $CAN_ADAS::ADAS_0x4BC_HMI::ADAS_Curv_1_dy_08 = 0;
  $CAN_ADAS::ADAS_0x4BC_HMI::ADAS_Curv_1_dy_09 = 0;
  $CAN_ADAS::ADAS_0x4BC_HMI::ADAS_Curv_1_dy_10 = 0;
  $CAN_ADAS::ADAS_0x4BC_HMI::ADAS_Curv_1_dy_11 = 0;
  $CAN_ADAS::ADAS_0x4BC_HMI::ADAS_Curv_1_dy_12 = 0;
  $CAN_ADAS::ADAS_0x4BC_HMI::ADAS_Curv_1_dy_13 = 0;
  $CAN_ADAS::ADAS_0x4BC_HMI::ADAS_Curv_1_dy_14 = 0;
  $CAN_ADAS::ADAS_0x4BC_HMI::ADAS_Curv_1_dy_15 = 0;
  $CAN_ADAS::ADAS_0x4BC_HMI::ADAS_Curv_2_NumValidPoints = 0;
  $CAN_ADAS::ADAS_0x4BC_HMI::ADAS_Curv_2_dy_00 = 0;
  $CAN_ADAS::ADAS_0x4BC_HMI::ADAS_Curv_2_dy_01 = 0;
  }
  if(init_count == 7)
  {
  $CAN_ADAS::ADAS_0x4BC_HMI::ADAS_Curv_2_dy_02 = 0;
  $CAN_ADAS::ADAS_0x4BC_HMI::ADAS_Curv_2_dy_03 = 0;
  $CAN_ADAS::ADAS_0x4BC_HMI::ADAS_Curv_2_dy_04 = 0;
  $CAN_ADAS::ADAS_0x4BC_HMI::ADAS_Curv_2_dy_05 = 0;
  $CAN_ADAS::ADAS_0x4BC_HMI::ADAS_Curv_2_dy_06 = 0;
  $CAN_ADAS::ADAS_0x4BC_HMI::ADAS_Curv_2_dy_07 = 0;
  $CAN_ADAS::ADAS_0x4BC_HMI::ADAS_Curv_2_dy_08 = 0;
  $CAN_ADAS::ADAS_0x4BC_HMI::ADAS_Curv_2_dy_09 = 0;
  $CAN_ADAS::ADAS_0x4BC_HMI::ADAS_Curv_2_dy_10 = 0;
  $CAN_ADAS::ADAS_0x4BC_HMI::ADAS_Curv_2_dy_11 = 0;
  $CAN_ADAS::ADAS_0x4BC_HMI::ADAS_Curv_2_dy_12 = 0;
  $CAN_ADAS::ADAS_0x4BC_HMI::ADAS_Curv_2_dy_13 = 0;
  $CAN_ADAS::ADAS_0x4BC_HMI::ADAS_Curv_2_dy_14 = 0;
  $CAN_ADAS::ADAS_0x4BC_HMI::ADAS_Curv_2_dy_15 = 0;
  $CAN_ADAS::ADAS_0x4BC_HMI::ADAS_Curv_3_NumValidPoints = 0;
  $CAN_ADAS::ADAS_0x4BC_HMI::ADAS_Curv_3_dy_00 = 0;
  $CAN_ADAS::ADAS_0x4BC_HMI::ADAS_Curv_3_dy_01 = 0;
  $CAN_ADAS::ADAS_0x4BC_HMI::ADAS_Curv_3_dy_02 = 0;
  $CAN_ADAS::ADAS_0x4BC_HMI::ADAS_Curv_3_dy_03 = 0;
  $CAN_ADAS::ADAS_0x4BC_HMI::ADAS_Curv_3_dy_04 = 0;
  $CAN_ADAS::ADAS_0x4BC_HMI::ADAS_Curv_3_dy_05 = 0;
  $CAN_ADAS::ADAS_0x4BC_HMI::ADAS_Curv_3_dy_06 = 0;
  $CAN_ADAS::ADAS_0x4BC_HMI::ADAS_Curv_3_dy_07 = 0;
  $CAN_ADAS::ADAS_0x4BC_HMI::ADAS_Curv_3_dy_08 = 0;
  $CAN_ADAS::ADAS_0x4BC_HMI::ADAS_Curv_3_dy_09 = 0;
  }
  if(init_count == 8)
  {
  $CAN_ADAS::ADAS_0x4BC_HMI::ADAS_Curv_3_dy_10 = 0;
  $CAN_ADAS::ADAS_0x4BC_HMI::ADAS_Curv_3_dy_11 = 0;
  $CAN_ADAS::ADAS_0x4BC_HMI::ADAS_Curv_3_dy_12 = 0;
  $CAN_ADAS::ADAS_0x4BC_HMI::ADAS_Curv_3_dy_13 = 0;
  $CAN_ADAS::ADAS_0x4BC_HMI::ADAS_Curv_3_dy_14 = 0;
  $CAN_ADAS::ADAS_0x4BC_HMI::ADAS_Curv_3_dy_15 = 0;
  $CAN_ADAS::ADAS_0x4BC_HMI::ADAS_RSF_Status = 0;
  $CAN_ADAS::ADAS_0x4BC_HMI::ADAS_TrafficSign1_AdditionalSign = 0;
  $CAN_ADAS::ADAS_0x4BC_HMI::ADAS_TrafficSign1_Distance = 0;
  $CAN_ADAS::ADAS_0x4BC_HMI::ADAS_TrafficSign1_Main = 0;
  $CAN_ADAS::ADAS_0x4BC_HMI::ADAS_TrafficSign1_Status = 0;
  $CAN_ADAS::ADAS_0x4BC_HMI::ADAS_TrafficSign2_AdditionalSign = 0;
  $CAN_ADAS::ADAS_0x4BC_HMI::ADAS_TrafficSign2_Distance = 0;
  $CAN_ADAS::ADAS_0x4BC_HMI::ADAS_TrafficSign2_Main = 0;
  $CAN_ADAS::ADAS_0x4BC_HMI::ADAS_TrafficSign2_Status = 0;
  $CAN_ADAS::ADAS_0x4BC_HMI::ADAS_TrafficSign3_AdditionalSign = 0;
  $CAN_ADAS::ADAS_0x4BC_HMI::ADAS_TrafficSign3_Distance = 0;
  $CAN_ADAS::ADAS_0x4BC_HMI::ADAS_TrafficSign3_Main = 0;
  $CAN_ADAS::ADAS_0x4BC_HMI::ADAS_TrafficSign3_Status = 0;
  $CAN_ADAS::ADAS_0x4BD_HMI::ADAS_Curv_4_NumValidPoints = 0;
  $CAN_ADAS::ADAS_0x4BD_HMI::ADAS_Curv_4_dy_00 = 0;
  $CAN_ADAS::ADAS_0x4BD_HMI::ADAS_Curv_4_dy_01 = 0;
  $CAN_ADAS::ADAS_0x4BD_HMI::ADAS_Curv_4_dy_02 = 0;
  $CAN_ADAS::ADAS_0x4BD_HMI::ADAS_Curv_4_dy_03 = 0;
  $CAN_ADAS::ADAS_0x4BD_HMI::ADAS_Curv_4_dy_04 = 0;
  }
  if(init_count == 9)
  {
  $CAN_ADAS::ADAS_0x4BD_HMI::ADAS_Curv_4_dy_05 = 0;
  $CAN_ADAS::ADAS_0x4BD_HMI::ADAS_Curv_4_dy_06 = 0;
  $CAN_ADAS::ADAS_0x4BD_HMI::ADAS_Curv_4_dy_07 = 0;
  $CAN_ADAS::ADAS_0x4BD_HMI::ADAS_Curv_4_dy_08 = 0;
  $CAN_ADAS::ADAS_0x4BD_HMI::ADAS_Curv_4_dy_09 = 0;
  $CAN_ADAS::ADAS_0x4BD_HMI::ADAS_Curv_4_dy_10 = 0;
  $CAN_ADAS::ADAS_0x4BD_HMI::ADAS_Curv_4_dy_11 = 0;
  $CAN_ADAS::ADAS_0x4BD_HMI::ADAS_Curv_4_dy_12 = 0;
  $CAN_ADAS::ADAS_0x4BD_HMI::ADAS_Curv_4_dy_13 = 0;
  $CAN_ADAS::ADAS_0x4BD_HMI::ADAS_Curv_4_dy_14 = 0;
  $CAN_ADAS::ADAS_0x4BD_HMI::ADAS_Curv_4_dy_15 = 0;
  $CAN_ADAS::ADAS_0x4BD_HMI::ADAS_Curv_RefLine_NumValidPoints = 0;
  $CAN_ADAS::ADAS_0x4BD_HMI::ADAS_Curv_RefLine_dy_00 = 0;
  $CAN_ADAS::ADAS_0x4BD_HMI::ADAS_Curv_RefLine_dy_01 = 0;
  $CAN_ADAS::ADAS_0x4BD_HMI::ADAS_Curv_RefLine_dy_02 = 0;
  $CAN_ADAS::ADAS_0x4BD_HMI::ADAS_Curv_RefLine_dy_03 = 0;
  $CAN_ADAS::ADAS_0x4BD_HMI::ADAS_Curv_RefLine_dy_04 = 0;
  $CAN_ADAS::ADAS_0x4BD_HMI::ADAS_Curv_RefLine_dy_05 = 0;
  $CAN_ADAS::ADAS_0x4BD_HMI::ADAS_Curv_RefLine_dy_06 = 0;
  $CAN_ADAS::ADAS_0x4BD_HMI::ADAS_Curv_RefLine_dy_07 = 0;
  $CAN_ADAS::ADAS_0x4BD_HMI::ADAS_Curv_RefLine_dy_08 = 0;
  $CAN_ADAS::ADAS_0x4BD_HMI::ADAS_Curv_RefLine_dy_09 = 0;
  $CAN_ADAS::ADAS_0x4BD_HMI::ADAS_Curv_RefLine_dy_10 = 0;
  $CAN_ADAS::ADAS_0x4BD_HMI::ADAS_Curv_RefLine_dy_11 = 0;
  $CAN_ADAS::ADAS_0x4BD_HMI::ADAS_Curv_RefLine_dy_12 = 0;
  }
  if(init_count == 10)
  {
  $CAN_ADAS::ADAS_0x4BD_HMI::ADAS_Curv_RefLine_dy_13 = 0;
  $CAN_ADAS::ADAS_0x4BD_HMI::ADAS_Curv_RefLine_dy_14 = 0;
  $CAN_ADAS::ADAS_0x4BD_HMI::ADAS_Curv_RefLine_dy_15 = 0;
  $CAN_ADAS::ADAS_0x4BE_HMI::ACCplusIsActiveSubfeatureFriction = 0;
  $CAN_ADAS::ADAS_0x4BE_HMI::ACCplusIsActiveSubfeatureSLA = 0;
  $CAN_ADAS::ADAS_0x4BE_HMI::ACCplusIsActiveSubfeatureSPA = 0;
  $CAN_ADAS::ADAS_0x4BE_HMI::ActiveADCParameterSet = 0;
  $CAN_ADAS::ADAS_0x4BE_HMI::FrontCollisionWarningSensitivitySelection = 0;
  $CAN_ADAS::ADAS_0x4BE_HMI::IsActiveACC = 0;
  $CAN_ADAS::ADAS_0x4BE_HMI::IsActiveACCplus = 0;
  $CAN_ADAS::ADAS_0x4BE_HMI::IsActiveADC = 0;
  $CAN_ADAS::ADAS_0x4BE_HMI::IsActiveTLR = 0;
  $CAN_ADAS::ADAS_0x4BE_HMI::IsAvailableACCplus0 = 0;
  $CAN_ADAS::ADAS_0x4BE_HMI::IsAvailableACCplus1 = 0;
  $CAN_ADAS::ADAS_0x4BE_HMI::IsAvailableADC = 0;
  $CAN_ADAS::ADAS_0x4BE_HMI::IsAvailableTLR = 0;
  $CAN_ADAS::ADAS_0x4BE_HMI::SelectedACFDrivingMode = 0;
  $CAN_ADAS::ADAS_0x4BE_HMI::SelectedADCVariant = 0;
  $CAN_ADAS::MCAM_VMI_01::McamLongState = 0;
  $CAN_ADAS::MCAM_VMI_01::PtFxLimActuationReq = 0;
  $CAN_ADAS::MCAM_VMI_01::PtFxLimit = 0;
  $CAN_ADAS::MCAM_VMI_01::PtFxTarActuationReq = 0;
  $CAN_ADAS::MCAM_VMI_01::PtFxTarget = 0;
  $CAN_ADAS::MRR_0x1C0::ADAS_LatMtnCtrlSts = 0;
  $CAN_ADAS::MRR_0x1C0::ADAS_LatMtnTypExed = 0;
  }
  if(init_count == 11)
  {
  $CAN_ADAS::MRR_0x1C0::ADAS_SteerTqReq = 0;
  $CAN_ADAS::MRR_0x1C0::ADAS_SteerWhlVibrAmp = 0;
  $CAN_ADAS::MRR_0x1C0::ADAS_SteerWhlVibrFrq = 0;
  $CAN_ADAS::MRR_0x1C0::ADAS_WarnVbrnReq = 0;
  $CAN_ADAS::MRR_0x254::ADAS_DecelToStopReq_ACC = 0;
  $CAN_ADAS::MRR_0x254::ADAS_DrvOffReq_ACC = 0;
  $CAN_ADAS::MRR_0x254::ADAS_Sts_ACC = 0;
  $CAN_ADAS::MRR_0x254::ADAS_TarAReq_ACC = 0;
  $CAN_ADAS::MRR_0x254::ADAS_TarA_ACC = 0;
  $CAN_ADAS::MRR_0x254::ADAS_TqReq_ACC = 0;
  $CAN_ADAS::MRR_0x254::ADAS_WhlTq_ACC = 0;
  $CAN_ADAS::MRR_0x25A::ADAS_DecelTyp_AEB = 0;
  $CAN_ADAS::MRR_0x25A::ADAS_Decel_AEB = 0;
  $CAN_ADAS::MRR_0x25A::ADAS_Lvl_AWB = 0;
  $CAN_ADAS::MRR_0x25A::ADAS_Lvl_HBA = 0;
  $CAN_ADAS::MRR_0x25A::ADAS_Req_AWB = 0;
  $CAN_ADAS::MRR_0x25A::ADAS_Req_HBA = 0;
  $CAN_ADAS::MRR_0x25A::ADAS_Req_Prefill = 0;
  $CAN_ADAS::MRR_0x25B::ADAS_Fwd_Safety_Func = 0;
  $CAN_ADAS::MRR_0x32C::ADAS_ADASSnvtySetFb = 0;
  $CAN_ADAS::MRR_0x32C::ADAS_AudioWarn = 0;
  $CAN_ADAS::MRR_0x32C::ADAS_DispReq = 0;
  $CAN_ADAS::MRR_0x32C::ADAS_EmergencyCallReq = 0;
  $CAN_ADAS::MRR_0x32C::ADAS_FCWSnvty = 0;
  $CAN_ADAS::MRR_0x32C::ADAS_HVACAutoMode = 0;
  }
  if(init_count == 12)
  {
  $CAN_ADAS::MRR_0x32C::ADAS_HandsOffTakeOverReq = 0;
  $CAN_ADAS::MRR_0x32C::ADAS_HazzardLightReq = 0;
  $CAN_ADAS::MRR_0x32C::ADAS_HeadLightReq = 0;
  $CAN_ADAS::MRR_0x32C::ADAS_HornReq = 0;
  $CAN_ADAS::MRR_0x32C::ADAS_InteriorLightReq = 0;
  $CAN_ADAS::MRR_0x32C::ADAS_IntvDir_ELK = 0;
  $CAN_ADAS::MRR_0x32C::ADAS_IntvMod_ELK = 0;
  $CAN_ADAS::MRR_0x32C::ADAS_LatMtnColor = 0;
  $CAN_ADAS::MRR_0x32C::ADAS_LeTrunLampReq = 0;
  $CAN_ADAS::MRR_0x32C::ADAS_RiTrunLampReq = 0;
  $CAN_ADAS::MRR_0x32C::ADAS_SeatBeltWindingReq = 0;
  $CAN_ADAS::MRR_0x32C::ADAS_Sts_ELK_oc = 0;
  $CAN_ADAS::MRR_0x32C::ADAS_Sts_ELK_ot = 0;
  $CAN_ADAS::MRR_0x32C::ADAS_Sts_ELK_re = 0;
  $CAN_ADAS::MRR_0x32C::ADAS_Sts_LDW = 0;
  $CAN_ADAS::MRR_0x32C::ADAS_Sts_LKA = 0;
  $CAN_ADAS::MRR_0x32C::ADAS_Sts_RDP = 0;
  $CAN_ADAS::MRR_0x32C::ADAS_Sts_TJAICA = 0;
  $CAN_ADAS::MRR_0x32C::ADAS_SysWarnTyp = 0;
  $CAN_ADAS::MRR_0x32C::ADAS_TailLightReq = 0;
  $CAN_ADAS::MRR_0x32C::ADAS_UnlockDoorReq = 0;
  $CAN_ADAS::MRR_0x33C::ADAS_Sts_AEB = 0;
  $CAN_ADAS::MRR_0x33C::ADAS_Sts_FCW = 0;
  $CAN_ADAS::MRR_0x33C::ADAS_WarnTyp_FCWAEB = 0;
  $CAN_ADAS::MRR_0x33C::ADAS_Warn_FCW = 0;
  }
  if(init_count == 13)
  {
  $CAN_ADAS::MRR_0x340::ADAS_ACCIconDisp = 0;
  $CAN_ADAS::MRR_0x340::ADAS_AEBFCTBSwtFb = 0;
  $CAN_ADAS::MRR_0x340::ADAS_ESSSwtFb = 0;
  $CAN_ADAS::MRR_0x340::ADAS_FCWFCTASwtFb = 0;
  $CAN_ADAS::MRR_0x340::ADAS_FltIndcr = 0;
  $CAN_ADAS::MRR_0x340::ADAS_FwdWarnFltTxt = 0;
  $CAN_ADAS::MRR_0x340::ADAS_IntecnFltTxt = 0;
  $CAN_ADAS::MRR_0x340::ADAS_IntegtCrsFltTxt = 0;
  $CAN_ADAS::MRR_0x340::ADAS_IntegtCrsModSetFb = 0;
  $CAN_ADAS::MRR_0x340::ADAS_IntegtCrsSwtFb = 0;
  $CAN_ADAS::MRR_0x340::ADAS_LaneCrvt = 0;
  $CAN_ADAS::MRR_0x340::ADAS_LaneSprtFltTxt = 0;
  $CAN_ADAS::MRR_0x340::ADAS_LaneSprtSwtFb = 0;
  $CAN_ADAS::MRR_0x340::ADAS_LaneSprtTypSetFb = 0;
  $CAN_ADAS::MRR_0x340::ADAS_LeLineColor = 0;
  $CAN_ADAS::MRR_0x340::ADAS_LeLineDst = 0;
  $CAN_ADAS::MRR_0x340::ADAS_LeLineFlash = 0;
  $CAN_ADAS::MRR_0x340::ADAS_LeLineTyp = 0;
  $CAN_ADAS::MRR_0x340::ADAS_RiLineColor = 0;
  $CAN_ADAS::MRR_0x340::ADAS_RiLineDst = 0;
  $CAN_ADAS::MRR_0x340::ADAS_RiLineFlash = 0;
  $CAN_ADAS::MRR_0x340::ADAS_RiLineTyp = 0;
  $CAN_ADAS::MRR_0x340::ADAS_VoiceSpdRglnFb = 0;
  $CAN_ADAS::MRR_0x347::ADAS_DispSpdUnit_ACC = 0;
  $CAN_ADAS::MRR_0x347::ADAS_DispSpd_ACC = 0;
  }
  if(init_count == 14)
  {
  $CAN_ADAS::MRR_0x347::ADAS_FrntTar1Typ_ACC = 0;
  $CAN_ADAS::MRR_0x347::ADAS_FrntTar2Typ_ACC = 0;
  $CAN_ADAS::MRR_0x347::ADAS_LeFrntTarTyp_ACC = 0;
  $CAN_ADAS::MRR_0x347::ADAS_OperTxt = 0;
  $CAN_ADAS::MRR_0x347::ADAS_RiFrntTarTyp_ACC = 0;
  $CAN_ADAS::MRR_0x347::ADAS_SpdLimSts_ASL = 0;
  $CAN_ADAS::MRR_0x347::ADAS_SpdLimUnit_ASL = 0;
  $CAN_ADAS::MRR_0x347::ADAS_SpdLim_ASL = 0;
  $CAN_ADAS::MRR_0x347::ADAS_Sts_ACC_ICC = 0;
  $CAN_ADAS::MRR_0x347::ADAS_TakeOverReq_ACC = 0;
  $CAN_ADAS::MRR_0x347::ADAS_TiGapSet_ACC = 0;
  $CAN_ADAS::VMCMain11::VMCMain11_BrakeBackupStgyReq = 0;
  $CAN_ADAS::VMCMain11::VMCMain11_BrakeFxActuationType = 0;
  $CAN_ADAS::VMCMain11::VMCMain11_BrakeFxTarget = 0;
  $CAN_ADAS::VMCMain11::VMCMain11_BrakeFxTargetGrad = 0;
  $CAN_ADAS::VMCMain11::VMCMain11_BrakePrepReq = 0;
  $CAN_ADAS::VMCMain11::VMCMain11_BrkCmptibiltyIndex = 0;
  $CAN_ADAS::VMCMain11::VMCMain11_EnableBrkFxTarGrad = 0;
  $CAN_ADAS::VMCMain11::VMCMain11_ParkBrakeRequest = 0;
  $CAN_ADAS::VMCMain11::VMCMain11_VehMotionCtrlAvl = 0;
  $CAN_ADAS::VMCMain11::VMCMain11_WarningJerkRequest = 0;
  $CAN_ADAS::VMCMain11::VMCMain11_isBrkReqProspective = 0;
  $CAN_ADAS::VMCMain12::VMCMain12_BrkSensDrvDtctnReq = 0;
  $CAN_ADAS::VMCMain12::VMCMain12_BrkSrvReqStandstill = 0;
  $CAN_ADAS::VMCMain12::VMCMain12_MinPumpRevolutionReq = 0;
  if (prestart_mode==0) init_count = 0;
  initFlag = 2;
  }
  init_count++;
}
void init_DMS_VW_GOLF_VII()
{
  if(init_count == 1)
  {
  $CAN_ADAS::DMS_HSC4_FrP01::DMSAdoWrnngDspCmdHSC4 = 0;
  $CAN_ADAS::DMS_HSC4_FrP01::DMSAudReqHSC4 = 0;
  $CAN_ADAS::DMS_HSC4_FrP01::DMSDspCmdHSC4 = 0;
  $CAN_ADAS::DMS_HSC4_FrP01::DMSHapticWrnngDspCmdHSC4 = 0;
  $CAN_ADAS::DMS_HSC4_FrP01::DMSStsHSC4 = 0;
  $CAN_ADAS::DMS_HSC4_FrP01::DMSVbnLvlReqHSC4 = 0;
  $CAN_ADAS::DMS_HSC4_FrP01::DMSWrnngReqHSC4 = 0;
  $CAN_ADAS::DMS_HSC4_FrP01::DrvrAbnormBehvorHSC4 = 0;
  $CAN_ADAS::DMS_HSC4_FrP01::DrvrDstcnStsHSC4 = 0;
  $CAN_ADAS::DMS_HSC4_FrP01::DrvrFtgLvlHSC4 = 0;
  $CAN_ADAS::DMS_HSC4_FrP01::DrvrGazeRgnHSC4 = 0;
  $CAN_ADAS::DMS_HSC4_FrP01::DrvrPrstHSC4 = 0;
  $CAN_ADAS::DMS_HSC4_FrP01::EyeOnRoadHSC4 = 0;
  $CAN_ADAS::DMS_HSC4_FrP01::SpfngDetHSC4 = 0;
  if (prestart_mode==0) init_count = 0;
  initFlag = 3;
  }
  init_count++;
}
void init_Map_VW_GOLF_VII()
{
  if(init_count == 1)
  {
  $CAN_ADAS::EHR_Ego_Lane_Info1_0x4CC::Ego_Lane_CurrBoundary_Type_L = 0;
  $CAN_ADAS::EHR_Ego_Lane_Info1_0x4CC::Ego_Lane_CurrBoundary_Type_R = 0;
  $CAN_ADAS::EHR_Ego_Lane_Info1_0x4CC::Ego_Lane_CurrentSpeedLimit = 0;
  $CAN_ADAS::EHR_Ego_Lane_Info1_0x4CC::Ego_Lane_CurrentSpeedLimit_Type = 0;
  $CAN_ADAS::EHR_Ego_Lane_Info1_0x4CC::Ego_Lane_Info1_TimeStamp = 0;
  $CAN_ADAS::EHR_Ego_Lane_Info1_0x4CC::Ego_Lane_Map_Status = 0;
  $CAN_ADAS::EHR_Ego_Lane_Info1_0x4CC::Ego_Lane_NextBoundary_Loc_L_1 = 0;
  $CAN_ADAS::EHR_Ego_Lane_Info1_0x4CC::Ego_Lane_NextBoundary_Loc_L_2 = 0;
  $CAN_ADAS::EHR_Ego_Lane_Info1_0x4CC::Ego_Lane_NextBoundary_Loc_L_3 = 0;
  $CAN_ADAS::EHR_Ego_Lane_Info1_0x4CC::Ego_Lane_NextBoundary_Loc_L_4 = 0;
  $CAN_ADAS::EHR_Ego_Lane_Info1_0x4CC::Ego_Lane_NextBoundary_Loc_R_1 = 0;
  $CAN_ADAS::EHR_Ego_Lane_Info1_0x4CC::Ego_Lane_NextBoundary_Loc_R_2 = 0;
  $CAN_ADAS::EHR_Ego_Lane_Info1_0x4CC::Ego_Lane_NextBoundary_Loc_R_3 = 0;
  $CAN_ADAS::EHR_Ego_Lane_Info1_0x4CC::Ego_Lane_NextBoundary_Loc_R_4 = 0;
  $CAN_ADAS::EHR_Ego_Lane_Info1_0x4CC::Ego_Lane_NextBoundary_Type_L_1 = 0;
  $CAN_ADAS::EHR_Ego_Lane_Info1_0x4CC::Ego_Lane_NextBoundary_Type_L_2 = 0;
  $CAN_ADAS::EHR_Ego_Lane_Info1_0x4CC::Ego_Lane_NextBoundary_Type_L_3 = 0;
  $CAN_ADAS::EHR_Ego_Lane_Info1_0x4CC::Ego_Lane_NextBoundary_Type_L_4 = 0;
  $CAN_ADAS::EHR_Ego_Lane_Info1_0x4CC::Ego_Lane_NextBoundary_Type_R_1 = 0;
  $CAN_ADAS::EHR_Ego_Lane_Info1_0x4CC::Ego_Lane_NextBoundary_Type_R_2 = 0;
  $CAN_ADAS::EHR_Ego_Lane_Info1_0x4CC::Ego_Lane_NextBoundary_Type_R_3 = 0;
  $CAN_ADAS::EHR_Ego_Lane_Info1_0x4CC::Ego_Lane_NextBoundary_Type_R_4 = 0;
  $CAN_ADAS::EHR_Ego_Lane_Info1_0x4CC::Ego_Lane_NextSpeedLimit_Loc_1 = 0;
  $CAN_ADAS::EHR_Ego_Lane_Info1_0x4CC::Ego_Lane_NextSpeedLimit_Loc_2 = 0;
  $CAN_ADAS::EHR_Ego_Lane_Info1_0x4CC::Ego_Lane_NextSpeedLimit_Loc_3 = 0;
  }
  if(init_count == 2)
  {
  $CAN_ADAS::EHR_Ego_Lane_Info1_0x4CC::Ego_Lane_NextSpeedLimit_Loc_4 = 0;
  $CAN_ADAS::EHR_Ego_Lane_Info1_0x4CC::Ego_Lane_NextSpeedLimit_Type_1 = 0;
  $CAN_ADAS::EHR_Ego_Lane_Info1_0x4CC::Ego_Lane_NextSpeedLimit_Type_2 = 0;
  $CAN_ADAS::EHR_Ego_Lane_Info1_0x4CC::Ego_Lane_NextSpeedLimit_Type_3 = 0;
  $CAN_ADAS::EHR_Ego_Lane_Info1_0x4CC::Ego_Lane_NextSpeedLimit_Type_4 = 0;
  $CAN_ADAS::EHR_Ego_Lane_Info1_0x4CC::Ego_Lane_NextSpeedLimit_Value_1 = 0;
  $CAN_ADAS::EHR_Ego_Lane_Info1_0x4CC::Ego_Lane_NextSpeedLimit_Value_2 = 0;
  $CAN_ADAS::EHR_Ego_Lane_Info1_0x4CC::Ego_Lane_NextSpeedLimit_Value_3 = 0;
  $CAN_ADAS::EHR_Ego_Lane_Info1_0x4CC::Ego_Lane_NextSpeedLimit_Value_4 = 0;
  $CAN_ADAS::EHR_Ego_Lane_Info1_0x4CC::Ego_Lane_NextTopoLocation_1 = 0;
  $CAN_ADAS::EHR_Ego_Lane_Info1_0x4CC::Ego_Lane_NextTopoLocation_2 = 0;
  $CAN_ADAS::EHR_Ego_Lane_Info1_0x4CC::Ego_Lane_NextTopoLocation_3 = 0;
  $CAN_ADAS::EHR_Ego_Lane_Info1_0x4CC::Ego_Lane_NextTopoLocation_4 = 0;
  $CAN_ADAS::EHR_Ego_Lane_Info1_0x4CC::Ego_Lane_NextTopoSide_1 = 0;
  $CAN_ADAS::EHR_Ego_Lane_Info1_0x4CC::Ego_Lane_NextTopoSide_2 = 0;
  $CAN_ADAS::EHR_Ego_Lane_Info1_0x4CC::Ego_Lane_NextTopoSide_3 = 0;
  $CAN_ADAS::EHR_Ego_Lane_Info1_0x4CC::Ego_Lane_NextTopoSide_4 = 0;
  $CAN_ADAS::EHR_Ego_Lane_Info1_0x4CC::Ego_Lane_NextTopoType_1 = 0;
  $CAN_ADAS::EHR_Ego_Lane_Info1_0x4CC::Ego_Lane_NextTopoType_2 = 0;
  $CAN_ADAS::EHR_Ego_Lane_Info1_0x4CC::Ego_Lane_NextTopoType_3 = 0;
  $CAN_ADAS::EHR_Ego_Lane_Info1_0x4CC::Ego_Lane_NextTopoType_4 = 0;
  $CAN_ADAS::EHR_Ego_Lane_Info2_0x4CD::Ego_Lane_Info2_TimeStamp = 0;
  $CAN_ADAS::EHR_Ego_Lane_Info2_0x4CD::Ego_Lane_NextHotspot_Int_1 = 0;
  $CAN_ADAS::EHR_Ego_Lane_Info2_0x4CD::Ego_Lane_NextHotspot_Int_2 = 0;
  $CAN_ADAS::EHR_Ego_Lane_Info2_0x4CD::Ego_Lane_NextHotspot_Int_3 = 0;
  }
  if(init_count == 3)
  {
  $CAN_ADAS::EHR_Ego_Lane_Info2_0x4CD::Ego_Lane_NextHotspot_Int_4 = 0;
  $CAN_ADAS::EHR_Ego_Lane_Info2_0x4CD::Ego_Lane_NextHotspot_Length_1 = 0;
  $CAN_ADAS::EHR_Ego_Lane_Info2_0x4CD::Ego_Lane_NextHotspot_Length_2 = 0;
  $CAN_ADAS::EHR_Ego_Lane_Info2_0x4CD::Ego_Lane_NextHotspot_Length_3 = 0;
  $CAN_ADAS::EHR_Ego_Lane_Info2_0x4CD::Ego_Lane_NextHotspot_Length_4 = 0;
  $CAN_ADAS::EHR_Ego_Lane_Info2_0x4CD::Ego_Lane_NextHotspot_Loc_1 = 0;
  $CAN_ADAS::EHR_Ego_Lane_Info2_0x4CD::Ego_Lane_NextHotspot_Loc_2 = 0;
  $CAN_ADAS::EHR_Ego_Lane_Info2_0x4CD::Ego_Lane_NextHotspot_Loc_3 = 0;
  $CAN_ADAS::EHR_Ego_Lane_Info2_0x4CD::Ego_Lane_NextHotspot_Loc_4 = 0;
  $CAN_ADAS::EHR_Ego_Lane_Info2_0x4CD::Ego_Lane_NextHotspot_Prob_1 = 0;
  $CAN_ADAS::EHR_Ego_Lane_Info2_0x4CD::Ego_Lane_NextHotspot_Prob_2 = 0;
  $CAN_ADAS::EHR_Ego_Lane_Info2_0x4CD::Ego_Lane_NextHotspot_Prob_3 = 0;
  $CAN_ADAS::EHR_Ego_Lane_Info2_0x4CD::Ego_Lane_NextHotspot_Prob_4 = 0;
  $CAN_ADAS::EHR_Ego_Lane_Info2_0x4CD::Ego_Lane_NextHotspot_Side_1 = 0;
  $CAN_ADAS::EHR_Ego_Lane_Info2_0x4CD::Ego_Lane_NextHotspot_Side_2 = 0;
  $CAN_ADAS::EHR_Ego_Lane_Info2_0x4CD::Ego_Lane_NextHotspot_Side_3 = 0;
  $CAN_ADAS::EHR_Ego_Lane_Info2_0x4CD::Ego_Lane_NextHotspot_Side_4 = 0;
  $CAN_ADAS::EHR_Ego_Lane_Info2_0x4CD::Ego_Lane_NextHotspot_Type_1 = 0;
  $CAN_ADAS::EHR_Ego_Lane_Info2_0x4CD::Ego_Lane_NextHotspot_Type_2 = 0;
  $CAN_ADAS::EHR_Ego_Lane_Info2_0x4CD::Ego_Lane_NextHotspot_Type_3 = 0;
  $CAN_ADAS::EHR_Ego_Lane_Info2_0x4CD::Ego_Lane_NextHotspot_Type_4 = 0;
  $CAN_ADAS::EHR_Ego_Lane_Info2_0x4CD::Ego_Lane_SpeedProfile_Far_00 = 0;
  $CAN_ADAS::EHR_Ego_Lane_Info2_0x4CD::Ego_Lane_SpeedProfile_Far_01 = 0;
  $CAN_ADAS::EHR_Ego_Lane_Info2_0x4CD::Ego_Lane_SpeedProfile_Far_02 = 0;
  $CAN_ADAS::EHR_Ego_Lane_Info2_0x4CD::Ego_Lane_SpeedProfile_Far_03 = 0;
  }
  if(init_count == 4)
  {
  $CAN_ADAS::EHR_Ego_Lane_Info2_0x4CD::Ego_Lane_SpeedProfile_Far_04 = 0;
  $CAN_ADAS::EHR_Ego_Lane_Info2_0x4CD::Ego_Lane_SpeedProfile_Far_05 = 0;
  $CAN_ADAS::EHR_Ego_Lane_Info2_0x4CD::Ego_Lane_SpeedProfile_Far_06 = 0;
  $CAN_ADAS::EHR_Ego_Lane_Info2_0x4CD::Ego_Lane_SpeedProfile_Far_07 = 0;
  $CAN_ADAS::EHR_Ego_Lane_Info2_0x4CD::Ego_Lane_SpeedProfile_Far_08 = 0;
  $CAN_ADAS::EHR_Ego_Lane_Info2_0x4CD::Ego_Lane_SpeedProfile_Far_09 = 0;
  $CAN_ADAS::EHR_Ego_Lane_Info2_0x4CD::Ego_Lane_SpeedProfile_Far_10 = 0;
  $CAN_ADAS::EHR_Ego_Lane_Info2_0x4CD::Ego_Lane_SpeedProfile_Far_11 = 0;
  $CAN_ADAS::EHR_Ego_Lane_Info2_0x4CD::Ego_Lane_SpeedProfile_Far_12 = 0;
  $CAN_ADAS::EHR_Ego_Lane_Info2_0x4CD::Ego_Lane_SpeedProfile_Far_13 = 0;
  $CAN_ADAS::EHR_Ego_Lane_Info2_0x4CD::Ego_Lane_SpeedProfile_Far_14 = 0;
  $CAN_ADAS::EHR_Ego_Lane_Info2_0x4CD::Ego_Lane_SpeedProfile_Far_15 = 0;
  $CAN_ADAS::EHR_Ego_Lane_Info2_0x4CD::Ego_Lane_SpeedProfile_Far_16 = 0;
  $CAN_ADAS::EHR_Ego_Lane_Info2_0x4CD::Ego_Lane_SpeedProfile_Far_N = 0;
  $CAN_ADAS::EHR_Ego_Lane_Info2_0x4CD::Ego_Lane_SpeedProfile_Near_00 = 0;
  $CAN_ADAS::EHR_Ego_Lane_Info2_0x4CD::Ego_Lane_SpeedProfile_Near_01 = 0;
  $CAN_ADAS::EHR_Ego_Lane_Info2_0x4CD::Ego_Lane_SpeedProfile_Near_02 = 0;
  $CAN_ADAS::EHR_Ego_Lane_Info2_0x4CD::Ego_Lane_SpeedProfile_Near_03 = 0;
  $CAN_ADAS::EHR_Ego_Lane_Info2_0x4CD::Ego_Lane_SpeedProfile_Near_04 = 0;
  $CAN_ADAS::EHR_Ego_Lane_Info2_0x4CD::Ego_Lane_SpeedProfile_Near_05 = 0;
  $CAN_ADAS::EHR_Ego_Lane_Info2_0x4CD::Ego_Lane_SpeedProfile_Near_06 = 0;
  $CAN_ADAS::EHR_Ego_Lane_Info2_0x4CD::Ego_Lane_SpeedProfile_Near_07 = 0;
  $CAN_ADAS::EHR_Ego_Lane_Info2_0x4CD::Ego_Lane_SpeedProfile_Near_08 = 0;
  $CAN_ADAS::EHR_Ego_Lane_Info2_0x4CD::Ego_Lane_SpeedProfile_Near_09 = 0;
  $CAN_ADAS::EHR_Ego_Lane_Info2_0x4CD::Ego_Lane_SpeedProfile_Near_10 = 0;
  }
  if(init_count == 5)
  {
  $CAN_ADAS::EHR_Ego_Lane_Info2_0x4CD::Ego_Lane_SpeedProfile_Near_11 = 0;
  $CAN_ADAS::EHR_Ego_Lane_Info2_0x4CD::Ego_Lane_SpeedProfile_Near_12 = 0;
  $CAN_ADAS::EHR_Ego_Lane_Info2_0x4CD::Ego_Lane_SpeedProfile_Near_13 = 0;
  $CAN_ADAS::EHR_Ego_Lane_Info2_0x4CD::Ego_Lane_SpeedProfile_Near_14 = 0;
  $CAN_ADAS::EHR_Ego_Lane_Info2_0x4CD::Ego_Lane_SpeedProfile_Near_15 = 0;
  $CAN_ADAS::EHR_Ego_Lane_Info2_0x4CD::Ego_Lane_SpeedProfile_Near_16 = 0;
  $CAN_ADAS::EHR_Ego_Lane_Info2_0x4CD::Ego_Lane_SpeedProfile_Near_17 = 0;
  $CAN_ADAS::EHR_Ego_Lane_Info2_0x4CD::Ego_Lane_SpeedProfile_Near_18 = 0;
  $CAN_ADAS::EHR_Ego_Lane_Info2_0x4CD::Ego_Lane_SpeedProfile_Near_19 = 0;
  $CAN_ADAS::EHR_Ego_Lane_Info2_0x4CD::Ego_Lane_SpeedProfile_Near_20 = 0;
  $CAN_ADAS::EHR_Ego_Lane_Info2_0x4CD::Ego_Lane_SpeedProfile_Near_21 = 0;
  $CAN_ADAS::EHR_Ego_Lane_Info2_0x4CD::Ego_Lane_SpeedProfile_Near_22 = 0;
  $CAN_ADAS::EHR_Ego_Lane_Info2_0x4CD::Ego_Lane_SpeedProfile_Near_N = 0;
  $CAN_ADAS::EHR_GNSS_POS::EHR_GNSS_POS_LAT = 0;
  $CAN_ADAS::EHR_GNSS_POS::EHR_GNSS_POS_LONG = 0;
  $CAN_ADAS::EHR_GNSS_POS::EHR_GNSS_Stddev_lat = 0;
  $CAN_ADAS::EHR_GNSS_POS::EHR_GNSS_Stddev_long = 0;
  $CAN_ADAS::EHR_LOC_POSE::EHR_LOC_POSE_LAT = 0;
  $CAN_ADAS::EHR_LOC_POSE::EHR_LOC_POSE_LONG = 0;
  $CAN_ADAS::EHR_LOC_POSE::EHR_LOC_POSE_YAW = 0;
  $CAN_ADAS::EHR_LOC_POSE::EHR_LOC_Status = 0;
  $CAN_ADAS::EHR_Left_Lane_info_0x4CE::Left_CurrentSpeedLimit = 0;
  $CAN_ADAS::EHR_Left_Lane_info_0x4CE::Left_CurrentSpeedLimit_Type = 0;
  $CAN_ADAS::EHR_Left_Lane_info_0x4CE::Left_Lane_Exists = 0;
  $CAN_ADAS::EHR_Left_Lane_info_0x4CE::Left_Lane_Info_TimeStamp = 0;
  }
  if(init_count == 6)
  {
  $CAN_ADAS::EHR_Left_Lane_info_0x4CE::Left_Lane_Start_dx = 0;
  $CAN_ADAS::EHR_Left_Lane_info_0x4CE::Left_Lane_isOvertakeLane = 0;
  $CAN_ADAS::EHR_Left_Lane_info_0x4CE::Left_NextSpeedLimit_Location_1 = 0;
  $CAN_ADAS::EHR_Left_Lane_info_0x4CE::Left_NextSpeedLimit_Location_2 = 0;
  $CAN_ADAS::EHR_Left_Lane_info_0x4CE::Left_NextSpeedLimit_Location_3 = 0;
  $CAN_ADAS::EHR_Left_Lane_info_0x4CE::Left_NextSpeedLimit_Location_4 = 0;
  $CAN_ADAS::EHR_Left_Lane_info_0x4CE::Left_NextSpeedLimit_Type_1 = 0;
  $CAN_ADAS::EHR_Left_Lane_info_0x4CE::Left_NextSpeedLimit_Type_2 = 0;
  $CAN_ADAS::EHR_Left_Lane_info_0x4CE::Left_NextSpeedLimit_Type_3 = 0;
  $CAN_ADAS::EHR_Left_Lane_info_0x4CE::Left_NextSpeedLimit_Type_4 = 0;
  $CAN_ADAS::EHR_Left_Lane_info_0x4CE::Left_NextSpeedLimit_Value_1 = 0;
  $CAN_ADAS::EHR_Left_Lane_info_0x4CE::Left_NextSpeedLimit_Value_2 = 0;
  $CAN_ADAS::EHR_Left_Lane_info_0x4CE::Left_NextSpeedLimit_Value_3 = 0;
  $CAN_ADAS::EHR_Left_Lane_info_0x4CE::Left_NextSpeedLimit_Value_4 = 0;
  $CAN_ADAS::EHR_Left_Lane_info_0x4CE::Left_NextTopo_Loc_1 = 0;
  $CAN_ADAS::EHR_Left_Lane_info_0x4CE::Left_NextTopo_Loc_2 = 0;
  $CAN_ADAS::EHR_Left_Lane_info_0x4CE::Left_NextTopo_Loc_3 = 0;
  $CAN_ADAS::EHR_Left_Lane_info_0x4CE::Left_NextTopo_Loc_4 = 0;
  $CAN_ADAS::EHR_Left_Lane_info_0x4CE::Left_NextTopo_Side_1 = 0;
  $CAN_ADAS::EHR_Left_Lane_info_0x4CE::Left_NextTopo_Side_2 = 0;
  $CAN_ADAS::EHR_Left_Lane_info_0x4CE::Left_NextTopo_Side_3 = 0;
  $CAN_ADAS::EHR_Left_Lane_info_0x4CE::Left_NextTopo_Side_4 = 0;
  $CAN_ADAS::EHR_Left_Lane_info_0x4CE::Left_NextTopo_Type_1 = 0;
  $CAN_ADAS::EHR_Left_Lane_info_0x4CE::Left_NextTopo_Type_2 = 0;
  $CAN_ADAS::EHR_Left_Lane_info_0x4CE::Left_NextTopo_Type_3 = 0;
  }
  if(init_count == 7)
  {
  $CAN_ADAS::EHR_Left_Lane_info_0x4CE::Left_NextTopo_Type_4 = 0;
  $CAN_ADAS::EHR_Left_Lane_info_0x4CE::Left_SpeedProfile_Far_00 = 0;
  $CAN_ADAS::EHR_Left_Lane_info_0x4CE::Left_SpeedProfile_Far_01 = 0;
  $CAN_ADAS::EHR_Left_Lane_info_0x4CE::Left_SpeedProfile_Far_02 = 0;
  $CAN_ADAS::EHR_Left_Lane_info_0x4CE::Left_SpeedProfile_Far_03 = 0;
  $CAN_ADAS::EHR_Left_Lane_info_0x4CE::Left_SpeedProfile_Far_04 = 0;
  $CAN_ADAS::EHR_Left_Lane_info_0x4CE::Left_SpeedProfile_Far_05 = 0;
  $CAN_ADAS::EHR_Left_Lane_info_0x4CE::Left_SpeedProfile_Far_06 = 0;
  $CAN_ADAS::EHR_Left_Lane_info_0x4CE::Left_SpeedProfile_Far_07 = 0;
  $CAN_ADAS::EHR_Left_Lane_info_0x4CE::Left_SpeedProfile_Far_08 = 0;
  $CAN_ADAS::EHR_Left_Lane_info_0x4CE::Left_SpeedProfile_Far_09 = 0;
  $CAN_ADAS::EHR_Left_Lane_info_0x4CE::Left_SpeedProfile_Far_10 = 0;
  $CAN_ADAS::EHR_Left_Lane_info_0x4CE::Left_SpeedProfile_Far_11 = 0;
  $CAN_ADAS::EHR_Left_Lane_info_0x4CE::Left_SpeedProfile_Far_12 = 0;
  $CAN_ADAS::EHR_Left_Lane_info_0x4CE::Left_SpeedProfile_Far_13 = 0;
  $CAN_ADAS::EHR_Left_Lane_info_0x4CE::Left_SpeedProfile_Far_14 = 0;
  $CAN_ADAS::EHR_Left_Lane_info_0x4CE::Left_SpeedProfile_Far_15 = 0;
  $CAN_ADAS::EHR_Left_Lane_info_0x4CE::Left_SpeedProfile_Far_16 = 0;
  $CAN_ADAS::EHR_Left_Lane_info_0x4CE::Left_SpeedProfile_Far_N = 0;
  $CAN_ADAS::EHR_ReferenceLine1_0x4CA::ReferenceLine1_TimeStamp = 0;
  $CAN_ADAS::EHR_ReferenceLine1_0x4CA::ReferenceLine_dx_00 = 0;
  $CAN_ADAS::EHR_ReferenceLine1_0x4CA::ReferenceLine_dx_01 = 0;
  $CAN_ADAS::EHR_ReferenceLine1_0x4CA::ReferenceLine_dx_02 = 0;
  $CAN_ADAS::EHR_ReferenceLine1_0x4CA::ReferenceLine_dx_03 = 0;
  $CAN_ADAS::EHR_ReferenceLine1_0x4CA::ReferenceLine_dx_04 = 0;
  }
  if(init_count == 8)
  {
  $CAN_ADAS::EHR_ReferenceLine1_0x4CA::ReferenceLine_dx_05 = 0;
  $CAN_ADAS::EHR_ReferenceLine1_0x4CA::ReferenceLine_dx_06 = 0;
  $CAN_ADAS::EHR_ReferenceLine1_0x4CA::ReferenceLine_dx_07 = 0;
  $CAN_ADAS::EHR_ReferenceLine1_0x4CA::ReferenceLine_dx_08 = 0;
  $CAN_ADAS::EHR_ReferenceLine1_0x4CA::ReferenceLine_dx_09 = 0;
  $CAN_ADAS::EHR_ReferenceLine1_0x4CA::ReferenceLine_dx_10 = 0;
  $CAN_ADAS::EHR_ReferenceLine1_0x4CA::ReferenceLine_dx_11 = 0;
  $CAN_ADAS::EHR_ReferenceLine1_0x4CA::ReferenceLine_dx_12 = 0;
  $CAN_ADAS::EHR_ReferenceLine1_0x4CA::ReferenceLine_dx_13 = 0;
  $CAN_ADAS::EHR_ReferenceLine1_0x4CA::ReferenceLine_dx_14 = 0;
  $CAN_ADAS::EHR_ReferenceLine1_0x4CA::ReferenceLine_dx_15 = 0;
  $CAN_ADAS::EHR_ReferenceLine1_0x4CA::ReferenceLine_dx_16 = 0;
  $CAN_ADAS::EHR_ReferenceLine1_0x4CA::ReferenceLine_dx_17 = 0;
  $CAN_ADAS::EHR_ReferenceLine1_0x4CA::ReferenceLine_dx_18 = 0;
  $CAN_ADAS::EHR_ReferenceLine1_0x4CA::ReferenceLine_dy_00 = 0;
  $CAN_ADAS::EHR_ReferenceLine1_0x4CA::ReferenceLine_dy_01 = 0;
  $CAN_ADAS::EHR_ReferenceLine1_0x4CA::ReferenceLine_dy_02 = 0;
  $CAN_ADAS::EHR_ReferenceLine1_0x4CA::ReferenceLine_dy_03 = 0;
  $CAN_ADAS::EHR_ReferenceLine1_0x4CA::ReferenceLine_dy_04 = 0;
  $CAN_ADAS::EHR_ReferenceLine1_0x4CA::ReferenceLine_dy_05 = 0;
  $CAN_ADAS::EHR_ReferenceLine1_0x4CA::ReferenceLine_dy_06 = 0;
  $CAN_ADAS::EHR_ReferenceLine1_0x4CA::ReferenceLine_dy_07 = 0;
  $CAN_ADAS::EHR_ReferenceLine1_0x4CA::ReferenceLine_dy_08 = 0;
  $CAN_ADAS::EHR_ReferenceLine1_0x4CA::ReferenceLine_dy_09 = 0;
  $CAN_ADAS::EHR_ReferenceLine1_0x4CA::ReferenceLine_dy_10 = 0;
  }
  if(init_count == 9)
  {
  $CAN_ADAS::EHR_ReferenceLine1_0x4CA::ReferenceLine_dy_11 = 0;
  $CAN_ADAS::EHR_ReferenceLine1_0x4CA::ReferenceLine_dy_12 = 0;
  $CAN_ADAS::EHR_ReferenceLine1_0x4CA::ReferenceLine_dy_13 = 0;
  $CAN_ADAS::EHR_ReferenceLine1_0x4CA::ReferenceLine_dy_14 = 0;
  $CAN_ADAS::EHR_ReferenceLine1_0x4CA::ReferenceLine_dy_15 = 0;
  $CAN_ADAS::EHR_ReferenceLine1_0x4CA::ReferenceLine_dy_16 = 0;
  $CAN_ADAS::EHR_ReferenceLine1_0x4CA::ReferenceLine_dy_17 = 0;
  $CAN_ADAS::EHR_ReferenceLine1_0x4CA::ReferenceLine_dy_18 = 0;
  $CAN_ADAS::EHR_ReferenceLine1_0x4CA::ReferenceLine_point_N = 0;
  $CAN_ADAS::EHR_ReferenceLine2_0x4CB::ReferenceLine2_TimeStamp = 0;
  $CAN_ADAS::EHR_ReferenceLine2_0x4CB::ReferenceLine_dx_19 = 0;
  $CAN_ADAS::EHR_ReferenceLine2_0x4CB::ReferenceLine_dx_20 = 0;
  $CAN_ADAS::EHR_ReferenceLine2_0x4CB::ReferenceLine_dx_21 = 0;
  $CAN_ADAS::EHR_ReferenceLine2_0x4CB::ReferenceLine_dx_22 = 0;
  $CAN_ADAS::EHR_ReferenceLine2_0x4CB::ReferenceLine_dx_23 = 0;
  $CAN_ADAS::EHR_ReferenceLine2_0x4CB::ReferenceLine_dx_24 = 0;
  $CAN_ADAS::EHR_ReferenceLine2_0x4CB::ReferenceLine_dx_25 = 0;
  $CAN_ADAS::EHR_ReferenceLine2_0x4CB::ReferenceLine_dx_26 = 0;
  $CAN_ADAS::EHR_ReferenceLine2_0x4CB::ReferenceLine_dx_27 = 0;
  $CAN_ADAS::EHR_ReferenceLine2_0x4CB::ReferenceLine_dx_28 = 0;
  $CAN_ADAS::EHR_ReferenceLine2_0x4CB::ReferenceLine_dx_29 = 0;
  $CAN_ADAS::EHR_ReferenceLine2_0x4CB::ReferenceLine_dx_30 = 0;
  $CAN_ADAS::EHR_ReferenceLine2_0x4CB::ReferenceLine_dx_31 = 0;
  $CAN_ADAS::EHR_ReferenceLine2_0x4CB::ReferenceLine_dx_32 = 0;
  $CAN_ADAS::EHR_ReferenceLine2_0x4CB::ReferenceLine_dx_33 = 0;
  }
  if(init_count == 10)
  {
  $CAN_ADAS::EHR_ReferenceLine2_0x4CB::ReferenceLine_dx_34 = 0;
  $CAN_ADAS::EHR_ReferenceLine2_0x4CB::ReferenceLine_dy_19 = 0;
  $CAN_ADAS::EHR_ReferenceLine2_0x4CB::ReferenceLine_dy_20 = 0;
  $CAN_ADAS::EHR_ReferenceLine2_0x4CB::ReferenceLine_dy_21 = 0;
  $CAN_ADAS::EHR_ReferenceLine2_0x4CB::ReferenceLine_dy_22 = 0;
  $CAN_ADAS::EHR_ReferenceLine2_0x4CB::ReferenceLine_dy_23 = 0;
  $CAN_ADAS::EHR_ReferenceLine2_0x4CB::ReferenceLine_dy_24 = 0;
  $CAN_ADAS::EHR_ReferenceLine2_0x4CB::ReferenceLine_dy_25 = 0;
  $CAN_ADAS::EHR_ReferenceLine2_0x4CB::ReferenceLine_dy_26 = 0;
  $CAN_ADAS::EHR_ReferenceLine2_0x4CB::ReferenceLine_dy_27 = 0;
  $CAN_ADAS::EHR_ReferenceLine2_0x4CB::ReferenceLine_dy_28 = 0;
  $CAN_ADAS::EHR_ReferenceLine2_0x4CB::ReferenceLine_dy_29 = 0;
  $CAN_ADAS::EHR_ReferenceLine2_0x4CB::ReferenceLine_dy_30 = 0;
  $CAN_ADAS::EHR_ReferenceLine2_0x4CB::ReferenceLine_dy_31 = 0;
  $CAN_ADAS::EHR_ReferenceLine2_0x4CB::ReferenceLine_dy_32 = 0;
  $CAN_ADAS::EHR_ReferenceLine2_0x4CB::ReferenceLine_dy_33 = 0;
  $CAN_ADAS::EHR_ReferenceLine2_0x4CB::ReferenceLine_dy_34 = 0;
  $CAN_ADAS::EHR_Right_Lane_info_0x4CF::Right_CurrentSpeedLimit = 0;
  $CAN_ADAS::EHR_Right_Lane_info_0x4CF::Right_CurrentSpeedLimit_Type = 0;
  $CAN_ADAS::EHR_Right_Lane_info_0x4CF::Right_Lane_Exists = 0;
  $CAN_ADAS::EHR_Right_Lane_info_0x4CF::Right_Lane_Info_TimeStamp = 0;
  $CAN_ADAS::EHR_Right_Lane_info_0x4CF::Right_Lane_Start_dx = 0;
  $CAN_ADAS::EHR_Right_Lane_info_0x4CF::Right_Lane_isOvertakeLane = 0;
  $CAN_ADAS::EHR_Right_Lane_info_0x4CF::Right_NextSpeedLimit_Location_1 = 0;
  $CAN_ADAS::EHR_Right_Lane_info_0x4CF::Right_NextSpeedLimit_Location_2 = 0;
  }
  if(init_count == 11)
  {
  $CAN_ADAS::EHR_Right_Lane_info_0x4CF::Right_NextSpeedLimit_Location_3 = 0;
  $CAN_ADAS::EHR_Right_Lane_info_0x4CF::Right_NextSpeedLimit_Location_4 = 0;
  $CAN_ADAS::EHR_Right_Lane_info_0x4CF::Right_NextSpeedLimit_Type_1 = 0;
  $CAN_ADAS::EHR_Right_Lane_info_0x4CF::Right_NextSpeedLimit_Type_2 = 0;
  $CAN_ADAS::EHR_Right_Lane_info_0x4CF::Right_NextSpeedLimit_Type_3 = 0;
  $CAN_ADAS::EHR_Right_Lane_info_0x4CF::Right_NextSpeedLimit_Type_4 = 0;
  $CAN_ADAS::EHR_Right_Lane_info_0x4CF::Right_NextSpeedLimit_Value_1 = 0;
  $CAN_ADAS::EHR_Right_Lane_info_0x4CF::Right_NextSpeedLimit_Value_2 = 0;
  $CAN_ADAS::EHR_Right_Lane_info_0x4CF::Right_NextSpeedLimit_Value_3 = 0;
  $CAN_ADAS::EHR_Right_Lane_info_0x4CF::Right_NextSpeedLimit_Value_4 = 0;
  $CAN_ADAS::EHR_Right_Lane_info_0x4CF::Right_NextTopo_Loc_1 = 0;
  $CAN_ADAS::EHR_Right_Lane_info_0x4CF::Right_NextTopo_Loc_2 = 0;
  $CAN_ADAS::EHR_Right_Lane_info_0x4CF::Right_NextTopo_Loc_3 = 0;
  $CAN_ADAS::EHR_Right_Lane_info_0x4CF::Right_NextTopo_Loc_4 = 0;
  $CAN_ADAS::EHR_Right_Lane_info_0x4CF::Right_NextTopo_Side_1 = 0;
  $CAN_ADAS::EHR_Right_Lane_info_0x4CF::Right_NextTopo_Side_2 = 0;
  $CAN_ADAS::EHR_Right_Lane_info_0x4CF::Right_NextTopo_Side_3 = 0;
  $CAN_ADAS::EHR_Right_Lane_info_0x4CF::Right_NextTopo_Side_4 = 0;
  $CAN_ADAS::EHR_Right_Lane_info_0x4CF::Right_NextTopo_Type_1 = 0;
  $CAN_ADAS::EHR_Right_Lane_info_0x4CF::Right_NextTopo_Type_2 = 0;
  $CAN_ADAS::EHR_Right_Lane_info_0x4CF::Right_NextTopo_Type_3 = 0;
  $CAN_ADAS::EHR_Right_Lane_info_0x4CF::Right_NextTopo_Type_4 = 0;
  $CAN_ADAS::EHR_Right_Lane_info_0x4CF::Right_SpeedProfile_Far_00 = 0;
  $CAN_ADAS::EHR_Right_Lane_info_0x4CF::Right_SpeedProfile_Far_01 = 0;
  $CAN_ADAS::EHR_Right_Lane_info_0x4CF::Right_SpeedProfile_Far_02 = 0;
  }
  if(init_count == 12)
  {
  $CAN_ADAS::EHR_Right_Lane_info_0x4CF::Right_SpeedProfile_Far_03 = 0;
  $CAN_ADAS::EHR_Right_Lane_info_0x4CF::Right_SpeedProfile_Far_04 = 0;
  $CAN_ADAS::EHR_Right_Lane_info_0x4CF::Right_SpeedProfile_Far_05 = 0;
  $CAN_ADAS::EHR_Right_Lane_info_0x4CF::Right_SpeedProfile_Far_06 = 0;
  $CAN_ADAS::EHR_Right_Lane_info_0x4CF::Right_SpeedProfile_Far_07 = 0;
  $CAN_ADAS::EHR_Right_Lane_info_0x4CF::Right_SpeedProfile_Far_08 = 0;
  $CAN_ADAS::EHR_Right_Lane_info_0x4CF::Right_SpeedProfile_Far_09 = 0;
  $CAN_ADAS::EHR_Right_Lane_info_0x4CF::Right_SpeedProfile_Far_10 = 0;
  $CAN_ADAS::EHR_Right_Lane_info_0x4CF::Right_SpeedProfile_Far_11 = 0;
  $CAN_ADAS::EHR_Right_Lane_info_0x4CF::Right_SpeedProfile_Far_12 = 0;
  $CAN_ADAS::EHR_Right_Lane_info_0x4CF::Right_SpeedProfile_Far_13 = 0;
  $CAN_ADAS::EHR_Right_Lane_info_0x4CF::Right_SpeedProfile_Far_14 = 0;
  $CAN_ADAS::EHR_Right_Lane_info_0x4CF::Right_SpeedProfile_Far_15 = 0;
  $CAN_ADAS::EHR_Right_Lane_info_0x4CF::Right_SpeedProfile_Far_16 = 0;
  $CAN_ADAS::EHR_Right_Lane_info_0x4CF::Right_SpeedProfile_Far_N = 0;
  $CAN_ADAS::HDM_Centerline_1::CenterPoint_dx_00 = 0;
  $CAN_ADAS::HDM_Centerline_1::CenterPoint_dx_01 = 0;
  $CAN_ADAS::HDM_Centerline_1::CenterPoint_dx_02 = 0;
  $CAN_ADAS::HDM_Centerline_1::CenterPoint_dx_03 = 0;
  $CAN_ADAS::HDM_Centerline_1::CenterPoint_dx_04 = 0;
  $CAN_ADAS::HDM_Centerline_1::CenterPoint_dx_05 = 0;
  $CAN_ADAS::HDM_Centerline_1::CenterPoint_dx_06 = 0;
  $CAN_ADAS::HDM_Centerline_1::CenterPoint_dx_07 = 0;
  $CAN_ADAS::HDM_Centerline_1::CenterPoint_dx_08 = 0;
  $CAN_ADAS::HDM_Centerline_1::CenterPoint_dx_09 = 0;
  }
  if(init_count == 13)
  {
  $CAN_ADAS::HDM_Centerline_1::CenterPoint_dx_10 = 0;
  $CAN_ADAS::HDM_Centerline_1::CenterPoint_dx_11 = 0;
  $CAN_ADAS::HDM_Centerline_1::CenterPoint_dx_12 = 0;
  $CAN_ADAS::HDM_Centerline_1::CenterPoint_dx_13 = 0;
  $CAN_ADAS::HDM_Centerline_1::CenterPoint_dx_14 = 0;
  $CAN_ADAS::HDM_Centerline_1::CenterPoint_dx_15 = 0;
  $CAN_ADAS::HDM_Centerline_1::CenterPoint_dx_16 = 0;
  $CAN_ADAS::HDM_Centerline_1::CenterPoint_dx_17 = 0;
  $CAN_ADAS::HDM_Centerline_1::CenterPoint_dx_18 = 0;
  $CAN_ADAS::HDM_Centerline_1::CenterPoint_dx_19 = 0;
  $CAN_ADAS::HDM_Centerline_1::CenterPoint_dy_00 = 0;
  $CAN_ADAS::HDM_Centerline_1::CenterPoint_dy_01 = 0;
  $CAN_ADAS::HDM_Centerline_1::CenterPoint_dy_02 = 0;
  $CAN_ADAS::HDM_Centerline_1::CenterPoint_dy_03 = 0;
  $CAN_ADAS::HDM_Centerline_1::CenterPoint_dy_04 = 0;
  $CAN_ADAS::HDM_Centerline_1::CenterPoint_dy_05 = 0;
  $CAN_ADAS::HDM_Centerline_1::CenterPoint_dy_06 = 0;
  $CAN_ADAS::HDM_Centerline_1::CenterPoint_dy_07 = 0;
  $CAN_ADAS::HDM_Centerline_1::CenterPoint_dy_08 = 0;
  $CAN_ADAS::HDM_Centerline_1::CenterPoint_dy_09 = 0;
  $CAN_ADAS::HDM_Centerline_1::CenterPoint_dy_10 = 0;
  $CAN_ADAS::HDM_Centerline_1::CenterPoint_dy_11 = 0;
  $CAN_ADAS::HDM_Centerline_1::CenterPoint_dy_12 = 0;
  $CAN_ADAS::HDM_Centerline_1::CenterPoint_dy_13 = 0;
  $CAN_ADAS::HDM_Centerline_1::CenterPoint_dy_14 = 0;
  }
  if(init_count == 14)
  {
  $CAN_ADAS::HDM_Centerline_1::CenterPoint_dy_15 = 0;
  $CAN_ADAS::HDM_Centerline_1::CenterPoint_dy_16 = 0;
  $CAN_ADAS::HDM_Centerline_1::CenterPoint_dy_17 = 0;
  $CAN_ADAS::HDM_Centerline_1::CenterPoint_dy_18 = 0;
  $CAN_ADAS::HDM_Centerline_1::CenterPoint_dy_19 = 0;
  $CAN_ADAS::HDM_Centerline_2::CenterPoint_dx_20 = 0;
  $CAN_ADAS::HDM_Centerline_2::CenterPoint_dx_21 = 0;
  $CAN_ADAS::HDM_Centerline_2::CenterPoint_dx_22 = 0;
  $CAN_ADAS::HDM_Centerline_2::CenterPoint_dx_23 = 0;
  $CAN_ADAS::HDM_Centerline_2::CenterPoint_dx_24 = 0;
  $CAN_ADAS::HDM_Centerline_2::CenterPoint_dx_25 = 0;
  $CAN_ADAS::HDM_Centerline_2::CenterPoint_dx_26 = 0;
  $CAN_ADAS::HDM_Centerline_2::CenterPoint_dx_27 = 0;
  $CAN_ADAS::HDM_Centerline_2::CenterPoint_dx_28 = 0;
  $CAN_ADAS::HDM_Centerline_2::CenterPoint_dx_29 = 0;
  $CAN_ADAS::HDM_Centerline_2::CenterPoint_dx_30 = 0;
  $CAN_ADAS::HDM_Centerline_2::CenterPoint_dx_31 = 0;
  $CAN_ADAS::HDM_Centerline_2::CenterPoint_dx_32 = 0;
  $CAN_ADAS::HDM_Centerline_2::CenterPoint_dx_33 = 0;
  $CAN_ADAS::HDM_Centerline_2::CenterPoint_dx_34 = 0;
  $CAN_ADAS::HDM_Centerline_2::CenterPoint_dy_20 = 0;
  $CAN_ADAS::HDM_Centerline_2::CenterPoint_dy_21 = 0;
  $CAN_ADAS::HDM_Centerline_2::CenterPoint_dy_22 = 0;
  $CAN_ADAS::HDM_Centerline_2::CenterPoint_dy_23 = 0;
  $CAN_ADAS::HDM_Centerline_2::CenterPoint_dy_24 = 0;
  }
  if(init_count == 15)
  {
  $CAN_ADAS::HDM_Centerline_2::CenterPoint_dy_25 = 0;
  $CAN_ADAS::HDM_Centerline_2::CenterPoint_dy_26 = 0;
  $CAN_ADAS::HDM_Centerline_2::CenterPoint_dy_27 = 0;
  $CAN_ADAS::HDM_Centerline_2::CenterPoint_dy_28 = 0;
  $CAN_ADAS::HDM_Centerline_2::CenterPoint_dy_29 = 0;
  $CAN_ADAS::HDM_Centerline_2::CenterPoint_dy_30 = 0;
  $CAN_ADAS::HDM_Centerline_2::CenterPoint_dy_31 = 0;
  $CAN_ADAS::HDM_Centerline_2::CenterPoint_dy_32 = 0;
  $CAN_ADAS::HDM_Centerline_2::CenterPoint_dy_33 = 0;
  $CAN_ADAS::HDM_Centerline_2::CenterPoint_dy_34 = 0;
  $CAN_ADAS::HDM_Centerline_2::Timestamp = 0;
  $CAN_ADAS::HDM_Centerline_2::centerline_LaneWidth = 0;
  $CAN_ADAS::HDM_Centerline_2::localization_heading_StdDev = 0;
  $CAN_ADAS::HDM_Centerline_2::localization_lat_StdDev = 0;
  $CAN_ADAS::HDM_Centerline_2::localization_long_StdDev = 0;
  $CAN_ADAS::HDM_Centerline_2::map_position_accuracy = 0;
  $CAN_ADAS::HDM_Centerline_2::map_position_deviation = 0;
  $CAN_ADAS::HDM_Central_Line_HighR::CenterPoint_dx_00_HighR = 0;
  $CAN_ADAS::HDM_Central_Line_HighR::CenterPoint_dx_01_HighR = 0;
  $CAN_ADAS::HDM_Central_Line_HighR::CenterPoint_dx_02_HighR = 0;
  $CAN_ADAS::HDM_Central_Line_HighR::CenterPoint_dx_03_HighR = 0;
  $CAN_ADAS::HDM_Central_Line_HighR::CenterPoint_dx_04_HighR = 0;
  $CAN_ADAS::HDM_Central_Line_HighR::CenterPoint_dx_05_HighR = 0;
  $CAN_ADAS::HDM_Central_Line_HighR::CenterPoint_dx_06_HighR = 0;
  $CAN_ADAS::HDM_Central_Line_HighR::CenterPoint_dx_07_HighR = 0;
  }
  if(init_count == 16)
  {
  $CAN_ADAS::HDM_Central_Line_HighR::CenterPoint_dx_08_HighR = 0;
  $CAN_ADAS::HDM_Central_Line_HighR::CenterPoint_dx_09_HighR = 0;
  $CAN_ADAS::HDM_Central_Line_HighR::CenterPoint_dx_10_HighR = 0;
  $CAN_ADAS::HDM_Central_Line_HighR::CenterPoint_dx_11_HighR = 0;
  $CAN_ADAS::HDM_Central_Line_HighR::CenterPoint_dx_12_HighR = 0;
  $CAN_ADAS::HDM_Central_Line_HighR::CenterPoint_dx_13_HighR = 0;
  $CAN_ADAS::HDM_Central_Line_HighR::CenterPoint_dx_14_HighR = 0;
  $CAN_ADAS::HDM_Central_Line_HighR::CenterPoint_dx_15_HighR = 0;
  $CAN_ADAS::HDM_Central_Line_HighR::CenterPoint_dx_16_HighR = 0;
  $CAN_ADAS::HDM_Central_Line_HighR::CenterPoint_dx_17_HighR = 0;
  $CAN_ADAS::HDM_Central_Line_HighR::CenterPoint_dx_18_HighR = 0;
  $CAN_ADAS::HDM_Central_Line_HighR::CenterPoint_dx_19_HighR = 0;
  $CAN_ADAS::HDM_Central_Line_HighR::CenterPoint_dx_20_HighR = 0;
  $CAN_ADAS::HDM_Central_Line_HighR::CenterPoint_dx_21_HighR = 0;
  $CAN_ADAS::HDM_Central_Line_HighR::CenterPoint_dx_22_HighR = 0;
  $CAN_ADAS::HDM_Central_Line_HighR::CenterPoint_dx_23_HighR = 0;
  $CAN_ADAS::HDM_Central_Line_HighR::CenterPoint_dx_24_HighR = 0;
  $CAN_ADAS::HDM_Central_Line_HighR::CenterPoint_dx_25_HighR = 0;
  $CAN_ADAS::HDM_Central_Line_HighR::CenterPoint_dx_26_HighR = 0;
  $CAN_ADAS::HDM_Central_Line_HighR::CenterPoint_dx_27_HighR = 0;
  $CAN_ADAS::HDM_Central_Line_HighR::CenterPoint_dx_28_HighR = 0;
  $CAN_ADAS::HDM_Central_Line_HighR::CenterPoint_dx_29_HighR = 0;
  $CAN_ADAS::HDM_Central_Line_HighR::CenterPoint_dx_30_HighR = 0;
  $CAN_ADAS::HDM_Central_Line_HighR::CenterPoint_dx_31_HighR = 0;
  $CAN_ADAS::HDM_Central_Line_HighR::CenterPoint_dx_32_HighR = 0;
  }
  if(init_count == 17)
  {
  $CAN_ADAS::HDM_Central_Line_HighR::CenterPoint_dx_33_HighR = 0;
  $CAN_ADAS::HDM_Central_Line_HighR::CenterPoint_dx_34_HighR = 0;
  $CAN_ADAS::HDM_Central_Line_HighR::CenterPoint_dx_m01_HighR = 0;
  $CAN_ADAS::HDM_Central_Line_HighR::CenterPoint_dx_m02_HighR = 0;
  $CAN_ADAS::HDM_Central_Line_HighR::CenterPoint_dx_m03_HighR = 0;
  $CAN_ADAS::HDM_Central_Line_HighR::CenterPoint_dx_m04_HighR = 0;
  $CAN_ADAS::HDM_Central_Line_HighR::CenterPoint_dy_00_HighR = 0;
  $CAN_ADAS::HDM_Central_Line_HighR::CenterPoint_dy_01_HighR = 0;
  $CAN_ADAS::HDM_Central_Line_HighR::CenterPoint_dy_02_HighR = 0;
  $CAN_ADAS::HDM_Central_Line_HighR::CenterPoint_dy_03_HighR = 0;
  $CAN_ADAS::HDM_Central_Line_HighR::CenterPoint_dy_04_HighR = 0;
  $CAN_ADAS::HDM_Central_Line_HighR::CenterPoint_dy_05_HighR = 0;
  $CAN_ADAS::HDM_Central_Line_HighR::CenterPoint_dy_06_HighR = 0;
  $CAN_ADAS::HDM_Central_Line_HighR::CenterPoint_dy_07_HighR = 0;
  $CAN_ADAS::HDM_Central_Line_HighR::CenterPoint_dy_08_HighR = 0;
  $CAN_ADAS::HDM_Central_Line_HighR::CenterPoint_dy_09_HighR = 0;
  $CAN_ADAS::HDM_Central_Line_HighR::CenterPoint_dy_10_HighR = 0;
  $CAN_ADAS::HDM_Central_Line_HighR::CenterPoint_dy_11_HighR = 0;
  $CAN_ADAS::HDM_Central_Line_HighR::CenterPoint_dy_12_HighR = 0;
  $CAN_ADAS::HDM_Central_Line_HighR::CenterPoint_dy_13_HighR = 0;
  $CAN_ADAS::HDM_Central_Line_HighR::CenterPoint_dy_14_HighR = 0;
  $CAN_ADAS::HDM_Central_Line_HighR::CenterPoint_dy_15_HighR = 0;
  $CAN_ADAS::HDM_Central_Line_HighR::CenterPoint_dy_16_HighR = 0;
  $CAN_ADAS::HDM_Central_Line_HighR::CenterPoint_dy_17_HighR = 0;
  $CAN_ADAS::HDM_Central_Line_HighR::CenterPoint_dy_18_HighR = 0;
  }
  if(init_count == 18)
  {
  $CAN_ADAS::HDM_Central_Line_HighR::CenterPoint_dy_19_HighR = 0;
  $CAN_ADAS::HDM_Central_Line_HighR::CenterPoint_dy_20_HighR = 0;
  $CAN_ADAS::HDM_Central_Line_HighR::CenterPoint_dy_21_HighR = 0;
  $CAN_ADAS::HDM_Central_Line_HighR::CenterPoint_dy_22_HighR = 0;
  $CAN_ADAS::HDM_Central_Line_HighR::CenterPoint_dy_23_HighR = 0;
  $CAN_ADAS::HDM_Central_Line_HighR::CenterPoint_dy_24_HighR = 0;
  $CAN_ADAS::HDM_Central_Line_HighR::CenterPoint_dy_25_HighR = 0;
  $CAN_ADAS::HDM_Central_Line_HighR::CenterPoint_dy_26_HighR = 0;
  $CAN_ADAS::HDM_Central_Line_HighR::CenterPoint_dy_27_HighR = 0;
  $CAN_ADAS::HDM_Central_Line_HighR::CenterPoint_dy_28_HighR = 0;
  $CAN_ADAS::HDM_Central_Line_HighR::CenterPoint_dy_29_HighR = 0;
  $CAN_ADAS::HDM_Central_Line_HighR::CenterPoint_dy_30_HighR = 0;
  $CAN_ADAS::HDM_Central_Line_HighR::CenterPoint_dy_31_HighR = 0;
  $CAN_ADAS::HDM_Central_Line_HighR::CenterPoint_dy_32_HighR = 0;
  $CAN_ADAS::HDM_Central_Line_HighR::CenterPoint_dy_33_HighR = 0;
  $CAN_ADAS::HDM_Central_Line_HighR::CenterPoint_dy_34_HighR = 0;
  $CAN_ADAS::HDM_Central_Line_HighR::CenterPoint_dy_m01_HighR = 0;
  $CAN_ADAS::HDM_Central_Line_HighR::CenterPoint_dy_m02_HighR = 0;
  $CAN_ADAS::HDM_Central_Line_HighR::CenterPoint_dy_m03_HighR = 0;
  $CAN_ADAS::HDM_Central_Line_HighR::CenterPoint_dy_m04_HighR = 0;
  $CAN_ADAS::HDM_Central_Line_M::CenterPoint_dx_m01 = 0;
  $CAN_ADAS::HDM_Central_Line_M::CenterPoint_dx_m02 = 0;
  $CAN_ADAS::HDM_Central_Line_M::CenterPoint_dx_m03 = 0;
  $CAN_ADAS::HDM_Central_Line_M::CenterPoint_dx_m04 = 0;
  $CAN_ADAS::HDM_Central_Line_M::CenterPoint_dy_m01 = 0;
  }
  if(init_count == 19)
  {
  $CAN_ADAS::HDM_Central_Line_M::CenterPoint_dy_m02 = 0;
  $CAN_ADAS::HDM_Central_Line_M::CenterPoint_dy_m03 = 0;
  $CAN_ADAS::HDM_Central_Line_M::CenterPoint_dy_m04 = 0;
  $CAN_ADAS::HDM_Central_Line_M::MAP_TimeSync = 0;
  $CAN_ADAS::HDM_Curv::Cv_Offset_Seg00 = 0;
  $CAN_ADAS::HDM_Curv::Cv_Offset_Seg01 = 0;
  $CAN_ADAS::HDM_Curv::Cv_Offset_Seg02 = 0;
  $CAN_ADAS::HDM_Curv::Cv_Offset_Seg03 = 0;
  $CAN_ADAS::HDM_Curv::Cv_Offset_Seg04 = 0;
  $CAN_ADAS::HDM_Curv::Cv_Offset_Seg05 = 0;
  $CAN_ADAS::HDM_Curv::Cv_Offset_Seg06 = 0;
  $CAN_ADAS::HDM_Curv::Cv_Offset_Seg07 = 0;
  $CAN_ADAS::HDM_Curv::Cv_Offset_Seg08 = 0;
  $CAN_ADAS::HDM_Curv::Cv_Offset_Seg09 = 0;
  $CAN_ADAS::HDM_Curv::Cv_Offset_Seg10 = 0;
  $CAN_ADAS::HDM_Curv::Cv_Offset_Seg11 = 0;
  $CAN_ADAS::HDM_Curv::Cv_Offset_Seg12 = 0;
  $CAN_ADAS::HDM_Curv::Cv_Offset_Seg13 = 0;
  $CAN_ADAS::HDM_Curv::Cv_Offset_Seg14 = 0;
  $CAN_ADAS::HDM_Curv::Cv_Offset_Seg15 = 0;
  $CAN_ADAS::HDM_Curv::Cv_Offset_Seg16 = 0;
  $CAN_ADAS::HDM_Curv::Cv_Offset_Seg17 = 0;
  $CAN_ADAS::HDM_Curv::Cv_Offset_Seg18 = 0;
  $CAN_ADAS::HDM_Curv::Cv_Offset_Seg19 = 0;
  $CAN_ADAS::HDM_Curv::Cv_Value_Seg00 = 0;
  }
  if(init_count == 20)
  {
  $CAN_ADAS::HDM_Curv::Cv_Value_Seg01 = 0;
  $CAN_ADAS::HDM_Curv::Cv_Value_Seg02 = 0;
  $CAN_ADAS::HDM_Curv::Cv_Value_Seg03 = 0;
  $CAN_ADAS::HDM_Curv::Cv_Value_Seg04 = 0;
  $CAN_ADAS::HDM_Curv::Cv_Value_Seg05 = 0;
  $CAN_ADAS::HDM_Curv::Cv_Value_Seg06 = 0;
  $CAN_ADAS::HDM_Curv::Cv_Value_Seg07 = 0;
  $CAN_ADAS::HDM_Curv::Cv_Value_Seg08 = 0;
  $CAN_ADAS::HDM_Curv::Cv_Value_Seg09 = 0;
  $CAN_ADAS::HDM_Curv::Cv_Value_Seg10 = 0;
  $CAN_ADAS::HDM_Curv::Cv_Value_Seg11 = 0;
  $CAN_ADAS::HDM_Curv::Cv_Value_Seg12 = 0;
  $CAN_ADAS::HDM_Curv::Cv_Value_Seg13 = 0;
  $CAN_ADAS::HDM_Curv::Cv_Value_Seg14 = 0;
  $CAN_ADAS::HDM_Curv::Cv_Value_Seg15 = 0;
  $CAN_ADAS::HDM_Curv::Cv_Value_Seg16 = 0;
  $CAN_ADAS::HDM_Curv::Cv_Value_Seg17 = 0;
  $CAN_ADAS::HDM_Curv::Cv_Value_Seg18 = 0;
  $CAN_ADAS::HDM_Curv::Cv_Value_Seg19 = 0;
  $CAN_ADAS::HDM_GF::GF_ActiveSpeedLimit = 0;
  $CAN_ADAS::HDM_GF::GF_BlackListedSegment_offset = 0;
  $CAN_ADAS::HDM_GF::GF_Country_outOfODD_offset = 0;
  $CAN_ADAS::HDM_GF::GF_Currentlane_Index = 0;
  $CAN_ADAS::HDM_GF::GF_Curvature_outOfODD_offset = 0;
  $CAN_ADAS::HDM_GF::GF_FormOfWay_outOfODD_offset = 0;
  }
  if(init_count == 21)
  {
  $CAN_ADAS::HDM_GF::GF_Intersection_offset = 0;
  $CAN_ADAS::HDM_GF::GF_LaneTrans_outOfODD_offset = 0;
  $CAN_ADAS::HDM_GF::GF_LaneType_outOfODD_offset = 0;
  $CAN_ADAS::HDM_GF::GF_LaneWidth_outOfODD_offset = 0;
  $CAN_ADAS::HDM_GF::GF_MapExpired = 0;
  $CAN_ADAS::HDM_GF::GF_MapStatus = 0;
  $CAN_ADAS::HDM_GF::GF_NumberOfLanes = 0;
  $CAN_ADAS::HDM_GF::GF_Region_outOfODD_offset = 0;
  $CAN_ADAS::HDM_GF::GF_RoadSlope_outOfODD_offset = 0;
  $CAN_ADAS::HDM_GF::GF_SideWind_offset = 0;
  $CAN_ADAS::HDM_GF::GF_TollGate_offset = 0;
  $CAN_ADAS::HDM_GF::GF_TrafficLight_offset = 0;
  $CAN_ADAS::HDM_GF::GF_Tunnel_Offset = 0;
  $CAN_ADAS::HDM_GF::GF_map_position_accuracy = 0;
  $CAN_ADAS::HDM_GF::GF_map_position_deviation = 0;
  if (prestart_mode==0) init_count = 0;
  initFlag = 4;
  }
  init_count++;
}
void init_IMU_VW_GOLF_VII()
{
  if(init_count == 1)
  {
  $CAN_ADAS::IMU_TX1::acc_x = 0;
  $CAN_ADAS::IMU_TX1::acc_y = 0;
  $CAN_ADAS::IMU_TX1::acc_z = 0;
  $CAN_ADAS::IMU_TX1::crc_tx1 = 0;
  $CAN_ADAS::IMU_TX1::msg_cnt_tx1 = 0;
  $CAN_ADAS::IMU_TX1::status_acc_x = 0;
  $CAN_ADAS::IMU_TX1::status_acc_y = 0;
  $CAN_ADAS::IMU_TX1::status_acc_z = 0;
  $CAN_ADAS::IMU_TX2::crc_tx2 = 0;
  $CAN_ADAS::IMU_TX2::msg_cnt_tx2 = 0;
  $CAN_ADAS::IMU_TX2::rate_x = 0;
  $CAN_ADAS::IMU_TX2::rate_y = 0;
  $CAN_ADAS::IMU_TX2::rate_z = 0;
  $CAN_ADAS::IMU_TX2::status_rate_x = 0;
  $CAN_ADAS::IMU_TX2::status_rate_y = 0;
  $CAN_ADAS::IMU_TX2::status_rate_z = 0;
  if (prestart_mode==0) init_count = 0;
  initFlag = 5;
  }
  init_count++;
}
void init_Rbs_VW_GOLF_VII()
{
  if(init_count == 1)
  {
  $CAN_ADAS::ADASLong_Mux::ADASLONG_Mux_MsgTyp = 0;
  $CAN_ADAS::ADAS_0x4BB_HMI::TLF_Mode = 0;
  $CAN_ADAS::ADAS_0x4BB_HMI::TLF_functionState = 0;
  $CAN_ADAS::ADAS_0x4BB_HMI::TL_suggestedDriveAction = 0;
  $CAN_ADAS::ADAS_0x4BB_HMI::TL_warning = 0;
  $CAN_ADAS::ADAS_Metadata::ADAS_Meta_CountryCode = 0;
  $CAN_ADAS::ADAS_Metadata::ADAS_Meta_CycCnt = 0;
  $CAN_ADAS::ADAS_Metadata::ADAS_Meta_DrvSide = 0;
  $CAN_ADAS::ADAS_Metadata::ADAS_Meta_HwVer = 0;
  $CAN_ADAS::ADAS_Metadata::ADAS_Meta_MapProvider = 0;
  $CAN_ADAS::ADAS_Metadata::ADAS_Meta_MapVerQtr = 0;
  $CAN_ADAS::ADAS_Metadata::ADAS_Meta_MapVerYear = 0;
  $CAN_ADAS::ADAS_Metadata::ADAS_Meta_MsgType = 0;
  $CAN_ADAS::ADAS_Metadata::ADAS_Meta_ProtVer_Major = 0;
  $CAN_ADAS::ADAS_Metadata::ADAS_Meta_ProtVer_Minor = 0;
  $CAN_ADAS::ADAS_Metadata::ADAS_Meta_ProtVer_MinorSub = 0;
  $CAN_ADAS::ADAS_Metadata::ADAS_Meta_RegionCode = 0;
  $CAN_ADAS::ADAS_Metadata::ADAS_Meta_SpdUnits = 0;
  $CAN_ADAS::ADAS_Position::ADAS_Posn_Age = 0;
  $CAN_ADAS::ADAS_Position::ADAS_Posn_CurLane = 0;
  $CAN_ADAS::ADAS_Position::ADAS_Posn_CycCnt = 0;
  $CAN_ADAS::ADAS_Position::ADAS_Posn_Idx = 0;
  $CAN_ADAS::ADAS_Position::ADAS_Posn_MsgTyp = 0;
  $CAN_ADAS::ADAS_Position::ADAS_Posn_Offset = 0;
  $CAN_ADAS::ADAS_Position::ADAS_Posn_PathIdx = 0;
  }
  if(init_count == 2)
  {
  $CAN_ADAS::ADAS_Position::ADAS_Posn_PosConfdc = 0;
  $CAN_ADAS::ADAS_Position::ADAS_Posn_PosProbb = 0;
  $CAN_ADAS::ADAS_Position::ADAS_Posn_RelHead = 0;
  $CAN_ADAS::ADAS_Position::ADAS_Posn_Spd = 0;
  $CAN_ADAS::ADAS_Profile_Long::ADAS_ProfLong_CtrlPoint = 0;
  $CAN_ADAS::ADAS_Profile_Long::ADAS_ProfLong_CycCnt = 0;
  $CAN_ADAS::ADAS_Profile_Long::ADAS_ProfLong_MsgType = 0;
  $CAN_ADAS::ADAS_Profile_Long::ADAS_ProfLong_Offset = 0;
  $CAN_ADAS::ADAS_Profile_Long::ADAS_ProfLong_PathIdx = 0;
  $CAN_ADAS::ADAS_Profile_Long::ADAS_ProfLong_ProfType = 0;
  $CAN_ADAS::ADAS_Profile_Long::ADAS_ProfLong_Retr = 0;
  $CAN_ADAS::ADAS_Profile_Long::ADAS_ProfLong_Update = 0;
  $CAN_ADAS::ADAS_Profile_Long::ProfileLong_Value = 0;
  $CAN_ADAS::ADAS_Profile_Short::ADAS_ProfShort_AccurClass = 0;
  $CAN_ADAS::ADAS_Profile_Short::ADAS_ProfShort_CtrlPoint = 0;
  $CAN_ADAS::ADAS_Profile_Short::ADAS_ProfShort_CycCnt = 0;
  $CAN_ADAS::ADAS_Profile_Short::ADAS_ProfShort_Dist1 = 0;
  $CAN_ADAS::ADAS_Profile_Short::ADAS_ProfShort_MsgType = 0;
  $CAN_ADAS::ADAS_Profile_Short::ADAS_ProfShort_Offset = 0;
  $CAN_ADAS::ADAS_Profile_Short::ADAS_ProfShort_PathIdx = 0;
  $CAN_ADAS::ADAS_Profile_Short::ADAS_ProfShort_ProfType = 0;
  $CAN_ADAS::ADAS_Profile_Short::ADAS_ProfShort_Retr = 0;
  $CAN_ADAS::ADAS_Profile_Short::ADAS_ProfShort_Update = 0;
  $CAN_ADAS::ADAS_Profile_Short::ADAS_ProfShort_Value0 = 0;
  $CAN_ADAS::ADAS_Profile_Short::ADAS_ProfShort_Value1 = 0;
  }
  if(init_count == 3)
  {
  $CAN_ADAS::ADAS_Segment::ADAS_Seg_Bridge = 0;
  $CAN_ADAS::ADAS_Segment::ADAS_Seg_BuildUpArea = 0;
  $CAN_ADAS::ADAS_Segment::ADAS_Seg_CmplxInsct = 0;
  $CAN_ADAS::ADAS_Segment::ADAS_Seg_CycCnt = 0;
  $CAN_ADAS::ADAS_Segment::ADAS_Seg_DividedRoad = 0;
  $CAN_ADAS::ADAS_Segment::ADAS_Seg_EffSpdLmt = 0;
  $CAN_ADAS::ADAS_Segment::ADAS_Seg_EffSpdLmtType = 0;
  $CAN_ADAS::ADAS_Segment::ADAS_Seg_FormOfWay = 0;
  $CAN_ADAS::ADAS_Segment::ADAS_Seg_FuncRoadClass = 0;
  $CAN_ADAS::ADAS_Segment::ADAS_Seg_MsgType = 0;
  $CAN_ADAS::ADAS_Segment::ADAS_Seg_NumOfLaneDrvDir = 0;
  $CAN_ADAS::ADAS_Segment::ADAS_Seg_NumOfLaneOppDir = 0;
  $CAN_ADAS::ADAS_Segment::ADAS_Seg_Offset = 0;
  $CAN_ADAS::ADAS_Segment::ADAS_Seg_PartOfCalcRoute = 0;
  $CAN_ADAS::ADAS_Segment::ADAS_Seg_PathIdx = 0;
  $CAN_ADAS::ADAS_Segment::ADAS_Seg_RelProbb = 0;
  $CAN_ADAS::ADAS_Segment::ADAS_Seg_Retr = 0;
  $CAN_ADAS::ADAS_Segment::ADAS_Seg_Tunnel = 0;
  $CAN_ADAS::ADAS_Segment::ADAS_Seg_Update = 0;
  $CAN_ADAS::ADAS_Stub::ADAS_Stub_CmplxInsct = 0;
  $CAN_ADAS::ADAS_Stub::ADAS_Stub_CycCnt = 0;
  $CAN_ADAS::ADAS_Stub::ADAS_Stub_FormOfWay = 0;
  $CAN_ADAS::ADAS_Stub::ADAS_Stub_FuncRoadClass = 0;
  $CAN_ADAS::ADAS_Stub::ADAS_Stub_LastStub = 0;
  $CAN_ADAS::ADAS_Stub::ADAS_Stub_MsgType = 0;
  }
  if(init_count == 4)
  {
  $CAN_ADAS::ADAS_Stub::ADAS_Stub_NumOfLaneDrvDir = 0;
  $CAN_ADAS::ADAS_Stub::ADAS_Stub_NumOfLaneOppDir = 0;
  $CAN_ADAS::ADAS_Stub::ADAS_Stub_Offset = 0;
  $CAN_ADAS::ADAS_Stub::ADAS_Stub_PartOfCalcRoute = 0;
  $CAN_ADAS::ADAS_Stub::ADAS_Stub_PathIdx = 0;
  $CAN_ADAS::ADAS_Stub::ADAS_Stub_RelProbb = 0;
  $CAN_ADAS::ADAS_Stub::ADAS_Stub_Retr = 0;
  $CAN_ADAS::ADAS_Stub::ADAS_Stub_RtOfWay = 0;
  $CAN_ADAS::ADAS_Stub::ADAS_Stub_SubPathIdx = 0;
  $CAN_ADAS::ADAS_Stub::ADAS_Stub_TurnAngl = 0;
  $CAN_ADAS::ADAS_Stub::ADAS_Stub_Update = 0;
  $CAN_ADAS::AEB_Status_0x5A0::AEB_Status = 0;
  $CAN_ADAS::AFB_0x1BB::ShiftInProgress = 0;
  $CAN_ADAS::AFB_0x1BB::WhlTqMin = 0;
  $CAN_ADAS::APA_0x1B0::APA_Sts = 0;
  $CAN_ADAS::BCM_0x335::BCM_DangerAlrmLampSwtSts = 0;
  $CAN_ADAS::BCM_0x335::BCM_HiBeamOutpCmd = 0;
  $CAN_ADAS::BCM_0x335::BCM_LeTrunLampOutpCmd = 0;
  $CAN_ADAS::BCM_0x335::BCM_LoBeamOutpCmd = 1;
  $CAN_ADAS::BCM_0x335::BCM_ReFogLampSwtSts = 0;
  $CAN_ADAS::BCM_0x335::BCM_ReWiprOutpCmd = 0;
  $CAN_ADAS::BCM_0x335::BCM_RiTrunLampOutpCmd = 0;
  $CAN_ADAS::BCM_0x343::BCM_FrntHoodLidSts = 0;
  $CAN_ADAS::BCM_0x343::BCM_LeFrntDoorSts = 0;
  $CAN_ADAS::BCM_0x343::BCM_LeReDoorSts = 0;
  }
  if(init_count == 5)
  {
  $CAN_ADAS::BCM_0x343::BCM_RiFrntDoorSts = 0;
  $CAN_ADAS::BCM_0x343::BCM_RiReDoorSts = 0;
  $CAN_ADAS::BCM_0x343::BCM_TrailerConnection = 0;
  $CAN_ADAS::CIM_0x310::CIM_Cncl_ADAS = 0;
  $CAN_ADAS::CIM_0x310::CIM_DstWithCarFrntAdj = 3;
  $CAN_ADAS::CIM_0x310::CIM_FrntWiprSwtSts = 0;
  $CAN_ADAS::CIM_0x310::CIM_FrntWshrSwtSts = 0;
  $CAN_ADAS::CIM_0x310::CIM_HiBeamSwtSts = 0;
  $CAN_ADAS::CIM_0x310::CIM_MainSwitchCC = 0;
  $CAN_ADAS::CIM_0x310::CIM_MainSwitchLimiter = 0;
  $CAN_ADAS::CIM_0x310::CIM_ReWshrSwtSts = 0;
  $CAN_ADAS::CIM_0x310::CIM_SpdLim_ADAS = 0;
  $CAN_ADAS::CIM_0x310::CIM_SpdRglnVld_ADAS = 1;
  $CAN_ADAS::CIM_0x310::CIM_SpdRgln_ADAS = 0;
  $CAN_ADAS::CIM_0x310::CIM_SwtVld_ADAS = 1;
  $CAN_ADAS::CIM_0x310::CIM_Swt_ADAS = 0;
  $CAN_ADAS::CIM_0x310::CIM_TurnLampSwtSts = 0;
  $CAN_ADAS::DBC_Version::DBC_VersionIdMajor = 0;
  $CAN_ADAS::DBC_Version::DBC_VersionIdMinor = 0;
  $CAN_ADAS::ECC_0x373::ECC_OutdT = 0;
  $CAN_ADAS::ECC_0x373::ECC_OutdTVld = 1;
  $CAN_ADAS::EPS2ADAS_0x1C5::EPS_ActRPCTrq = 0;
  $CAN_ADAS::EPS2ADAS_0x1C5::EPS_ActRoadWheelAngState = 2;
  $CAN_ADAS::EPS2ADAS_0x1C5::EPS_ActRoadWheelAngValue = 0;
  $CAN_ADAS::EPS2ADAS_0x1C5::EPS_IntRPCMaxTrq = 0;
  }
  if(init_count == 6)
  {
  $CAN_ADAS::EPS2ADAS_0x1C5::EPS_IntRPCMinTrq = 0;
  $CAN_ADAS::EPS2ADAS_0x1C5::EPS_LatDrvLvl12SrvAvl = 0;
  $CAN_ADAS::EPS2ADAS_0x1C5::EPS_LatMCHptcWrnSrvAvl = 0;
  $CAN_ADAS::EPS2ADAS_0x1C5::EPS_LatMCRoadWheelAngActive = 0;
  $CAN_ADAS::EPS_0x1C2::EPS_MaxSftyTq = 0;
  $CAN_ADAS::EPS_0x1C2::EPS_SteerAgSnsrCalSts = 1;
  $CAN_ADAS::EPS_0x1C2::EPS_SteerWhlAgSig = 0;
  $CAN_ADAS::EPS_0x1C2::EPS_SteerWhlAgSigVld = 1;
  $CAN_ADAS::EPS_0x1C2::EPS_SteerWhlRotSpd = 0;
  $CAN_ADAS::EPS_0x1C2::EPS_SteerWhlRotSpdVld = 1;
  $CAN_ADAS::EPS_0x1C2::EPS_SteerWhlVbrnAlrmAvl = 0;
  $CAN_ADAS::EPS_0x1C2::EPS_WarnVbrnSts = 0;
  $CAN_ADAS::EPS_0x1C4::EPS_DrvrSteerTq = 0;
  $CAN_ADAS::EPS_0x1C4::EPS_DrvrSteerTqDir = 0;
  $CAN_ADAS::EPS_0x1C4::EPS_DrvrSteerTqVld = 1;
  $CAN_ADAS::EPS_0x1C4::EPS_EPSAvl = 1;
  $CAN_ADAS::EPS_0x1C4::EPS_EmgyCtrlSts = 0;
  $CAN_ADAS::EPS_0x1C4::EPS_LatMtnCtrlSts = 0;
  $CAN_ADAS::EPS_0x1C4::EPS_MinSftyTq = 0;
  $CAN_ADAS::EPS_0x1C4::EPS_PinionAg = 0;
  $CAN_ADAS::EPS_0x1C4::EPS_SteerSnsrSts = 0;
  $CAN_ADAS::EPS_0x475::EPS_ModSts = 2;
  $CAN_ADAS::ESP_0x116::ESP_QBit_Wegimpuls_HL = 0;
  $CAN_ADAS::ESP_0x116::ESP_QBit_Wegimpuls_HR = 0;
  $CAN_ADAS::ESP_0x116::ESP_QBit_Wegimpuls_VL = 0;
  }
  if(init_count == 7)
  {
  $CAN_ADAS::ESP_0x116::ESP_QBit_Wegimpuls_VR = 0;
  $CAN_ADAS::ESP_0x116::ESP_Wegimpuls_HL = 0;
  $CAN_ADAS::ESP_0x116::ESP_Wegimpuls_HR = 0;
  $CAN_ADAS::ESP_0x116::ESP_Wegimpuls_VL = 0;
  $CAN_ADAS::ESP_0x116::ESP_Wegimpuls_VR = 0;
  $CAN_ADAS::ESP_0x120::ESP_ActvSig_ABS = 0;
  $CAN_ADAS::ESP_0x120::ESP_MstCylP = 0;
  $CAN_ADAS::ESP_0x120::ESP_MstCylPOffs = 0;
  $CAN_ADAS::ESP_0x120::ESP_MstCylPOffsVld = 1;
  $CAN_ADAS::ESP_0x120::ESP_MstCylPVld = 1;
  $CAN_ADAS::ESP_0x120::ESP_RoadSlope = 0;
  $CAN_ADAS::ESP_0x120::ESP_VmcVseSasAvlCpby = 4;
  $CAN_ADAS::ESP_0x120::ESP_VmcVseYawRateAvlCpby = 4;
  $CAN_ADAS::ESP_0x261::ESP_ActvIndcn_ABA = 0;
  $CAN_ADAS::ESP_0x261::ESP_ActvIndcn_ABP = 0;
  $CAN_ADAS::ESP_0x261::ESP_ActvIndcn_AEB = 0;
  $CAN_ADAS::ESP_0x261::ESP_ActvIndcn_AWB = 0;
  $CAN_ADAS::ESP_0x261::ESP_ActvSig = 0;
  $CAN_ADAS::ESP_0x261::ESP_ActvSig_DTC = 0;
  $CAN_ADAS::ESP_0x261::ESP_ActvSig_EBD = 0;
  $CAN_ADAS::ESP_0x261::ESP_ActvSig_TCS = 0;
  $CAN_ADAS::ESP_0x261::ESP_Actvndcn_CDD = 0;
  $CAN_ADAS::ESP_0x261::ESP_BrkOverTIndcn = 0;
  $CAN_ADAS::ESP_0x261::ESP_FadeoutFinished = 0;
  $CAN_ADAS::ESP_0x261::ESP_FltIndcn_ABA = 0;
  }
  if(init_count == 8)
  {
  $CAN_ADAS::ESP_0x261::ESP_FltIndcn_ABP = 0;
  $CAN_ADAS::ESP_0x261::ESP_FltIndcn_AEB = 0;
  $CAN_ADAS::ESP_0x261::ESP_FltIndcn_AWB = 0;
  $CAN_ADAS::ESP_0x261::ESP_FltIndcn_CDD = 0;
  $CAN_ADAS::ESP_0x261::ESP_VehStandstillIndcn = 1;
  $CAN_ADAS::ESP_0x268::ESP_EPBSwtichPosition = 0;
  $CAN_ADAS::ESP_0x268::ESP_FltIndcn_EPB = 0;
  $CAN_ADAS::ESP_0x268::ESP_SysSts_EPB = 1;
  $CAN_ADAS::ESP_0x268::ESP_YawRateStabnAvl = 1;
  $CAN_ADAS::ESP_0x268::YawTorque = 0;
  $CAN_ADAS::ESP_0x305::ESP_WhlMovgDir_LF = 3;
  $CAN_ADAS::ESP_0x305::ESP_WhlMovgDir_RF = 3;
  $CAN_ADAS::ESP_0x305::ESP_WhlSpdVld_LF = 1;
  $CAN_ADAS::ESP_0x305::ESP_WhlSpdVld_RF = 1;
  $CAN_ADAS::ESP_0x305::ESP_WhlSpd_LF = 0;
  $CAN_ADAS::ESP_0x305::ESP_WhlSpd_RF = 0;
  $CAN_ADAS::ESP_0x306::ESP_WhlMovgDir_RL = 3;
  $CAN_ADAS::ESP_0x306::ESP_WhlMovgDir_RR = 3;
  $CAN_ADAS::ESP_0x306::ESP_WhlSpdVld_RL = 1;
  $CAN_ADAS::ESP_0x306::ESP_WhlSpdVld_RR = 1;
  $CAN_ADAS::ESP_0x306::ESP_WhlSpd_RL = 0;
  $CAN_ADAS::ESP_0x306::ESP_WhlSpd_RR = 0;
  $CAN_ADAS::ESP_0x318::ESP_CtrlSts_HDC = 0;
  $CAN_ADAS::ESP_0x318::ESP_FltIndcn_ABS = 0;
  $CAN_ADAS::ESP_0x318::ESP_FltIndcn_TCS = 0;
  }
  if(init_count == 9)
  {
  $CAN_ADAS::ESP_0x318::ESP_LampSwtOffIndcn = 0;
  $CAN_ADAS::ESP_0x318::ESP_NoBrkP = 1;
  $CAN_ADAS::ESP_0x318::ESP_SwtOff_TCS = 0;
  $CAN_ADAS::ESP_0x318::ESP_VehSpd = 0;
  $CAN_ADAS::ESP_0x318::ESP_VehSpdVld = 1;
  $CAN_ADAS::GW_HSC8_FrP16::HODDetnSts_h8HSC8 = 0;
  $CAN_ADAS::GW_HSC8_FrP16::HODSysSts_h8HSC8 = 0;
  $CAN_ADAS::GW_HSC8_FrP16::HODTchZone1Sts_h8HSC8 = 0;
  $CAN_ADAS::GW_HSC8_FrP16::HODTchZone1Val_h8HSC8 = 0;
  $CAN_ADAS::GW_HSC8_FrP16::HODTchZone2Sts_h8HSC8 = 0;
  $CAN_ADAS::GW_HSC8_FrP16::HODTchZone2Val_h8HSC8 = 0;
  $CAN_ADAS::GW_HSC8_FrP16::HODTchZone3Sts_h8HSC8 = 0;
  $CAN_ADAS::GW_HSC8_FrP16::HODTchZone3Val_h8HSC8 = 0;
  $CAN_ADAS::GW_HSC8_FrP16::HODdiagSts_h8HSC8 = 0;
  $CAN_ADAS::HMI_0x4BF_ADAS::ACCDriverInputConfirmation = 0;
  $CAN_ADAS::HMI_0x4BF_ADAS::ACCDriverInputResume = 0;
  $CAN_ADAS::HMI_0x4BF_ADAS::ACCDriverInputSet = 0;
  $CAN_ADAS::HMI_0x4BF_ADAS::ACCDriverInputSetSpeedDecrease = 0;
  $CAN_ADAS::HMI_0x4BF_ADAS::ACCDriverInputSetSpeedIncrease = 0;
  $CAN_ADAS::HMI_0x4BF_ADAS::ACCDriverInputTimeGapChange = 0;
  $CAN_ADAS::HMI_0x4BF_ADAS::ACCplusActivationSubfeatureFriction = 0;
  $CAN_ADAS::HMI_0x4BF_ADAS::ACCplusActivationSubfeatureSPA = 0;
  $CAN_ADAS::HMI_0x4BF_ADAS::ACCplusActivationSubfeature_SLA = 0;
  $CAN_ADAS::HMI_0x4BF_ADAS::ACFDrivingMode = 0;
  $CAN_ADAS::HMI_0x4BF_ADAS::ADCDriverInputActivationDeactivation = 0;
  }
  if(init_count == 10)
  {
  $CAN_ADAS::HMI_0x4BF_ADAS::ADCParameterSelection = 0;
  $CAN_ADAS::HMI_0x4BF_ADAS::ADCVariantSelection = 0;
  $CAN_ADAS::HMI_0x4BF_ADAS::FrontCollisionWarningSensitivity = 0;
  $CAN_ADAS::HMI_0x4BF_ADAS::MainSwitchACC = 0;
  $CAN_ADAS::HMI_0x4BF_ADAS::MainSwitchACCplus = 0;
  $CAN_ADAS::HMI_0x4BF_ADAS::MainSwitchADC = 0;
  $CAN_ADAS::HMI_0x4BF_ADAS::MainSwitchTLR = 0;
  $CAN_ADAS::HMI_0x4BF_ADAS::Measurement_label = 0;
  $CAN_ADAS::ICC_0x526::EHU_ADASSnvtySet = 2;
  $CAN_ADAS::ICC_0x526::EHU_AEBFCTBSwt = 0;
  $CAN_ADAS::ICC_0x526::EHU_ESSSwt = 0;
  $CAN_ADAS::ICC_0x526::EHU_FCWFCTASwt = 0;
  $CAN_ADAS::ICC_0x526::EHU_HiwayExitAuxReq = 0;
  $CAN_ADAS::ICC_0x526::EHU_HiwayExitAuxSwt = 0;
  $CAN_ADAS::ICC_0x526::EHU_IntegtCrsModSet = 0;
  $CAN_ADAS::ICC_0x526::EHU_IntegtCrsSwt = 2;
  $CAN_ADAS::ICC_0x526::EHU_LDWAlrmTypReq = 1;
  $CAN_ADAS::ICC_0x526::EHU_LaneSprtSwt = 1;
  $CAN_ADAS::ICC_0x526::EHU_LaneSprtTypSet = 0;
  $CAN_ADAS::ICC_0x526::EHU_VoiceSpdRgln_ADAS = 40;
  $CAN_ADAS::ICC_0x531::ICM_ADASSigFlt = 0;
  $CAN_ADAS::ICC_0x531::ICM_DispFlt = 0;
  $CAN_ADAS::ICC_0x531::ICM_DispVehSpd = 0;
  $CAN_ADAS::ICC_0x531::ICM_DispVehSpdUnit = 0;
  $CAN_ADAS::ICC_0x531::ICM_TotMilgVld_ODO = 0;
  }
  if(init_count == 11)
  {
  $CAN_ADAS::ICC_0x531::ICM_TotMilg_ODO = 122692;
  $CAN_ADAS::MCU_F_0x150::MCU_F_CrtSpd = 740;
  $CAN_ADAS::MCU_F_0x150::MCU_F_CrtSpdSigVld = 1;
  $CAN_ADAS::MCU_R_0x151::MCU_R_CrtSpd = 740;
  $CAN_ADAS::MCU_R_0x151::MCU_R_CrtSpdSigVld = 1;
  $CAN_ADAS::PEPS_0x333::PEPS_PwrMod = 2;
  $CAN_ADAS::PEPS_0x333::PEPS_PwrModVld = 1;
  $CAN_ADAS::PT_VMI_01::DriverRqPtFxDominant = 0;
  $CAN_ADAS::PT_VMI_01::PtFxActual = 0;
  $CAN_ADAS::PT_VMI_01::PtFxMax = 0;
  $CAN_ADAS::PT_VMI_01::PtFxMin = 0;
  $CAN_ADAS::PT_VMI_01::PtFxRequested = 0;
  $CAN_ADAS::RBFMain11::RBFMain11_AccStabActivity = 0;
  $CAN_ADAS::RBFMain11::RBFMain11_AccStabAvail = 0;
  $CAN_ADAS::RBFMain11::RBFMain11_BrakeFxActual = 0;
  $CAN_ADAS::RBFMain11::RBFMain11_BrakeFxAvailability = 0;
  $CAN_ADAS::RBFMain11::RBFMain11_BrakeFxCapability = 0;
  $CAN_ADAS::RBFMain11::RBFMain11_DecStabActivity = 0;
  $CAN_ADAS::RBFMain11::RBFMain11_DecStabAvail = 0;
  $CAN_ADAS::RBFMain11::RBFMain11_DecStabAvlForDriver = 0;
  $CAN_ADAS::RBFMain11::RBFMain11_DecStabCpblty = 0;
  $CAN_ADAS::RBFMain11::RBFMain11_DecStabCpbltyForDrvr = 0;
  $CAN_ADAS::RBFMain11::RBFMain11_ParkBrakeAvl = 0;
  $CAN_ADAS::RBFMain11::RBFMain11_ParkBrakeCapability = 0;
  $CAN_ADAS::RBFMain11::RBFMain11_ParkBrakeState = 0;
  }
  if(init_count == 12)
  {
  $CAN_ADAS::RBFMain11::RBFMain11_ParkBrakeSupportReq = 0;
  $CAN_ADAS::RBFMain11::RBFMain11_YawRateStabActivity = 0;
  $CAN_ADAS::RBFMain11::RBFMain11_YawRateStabAvl = 2;
  $CAN_ADAS::RBFMain11::RBFMain11_isBrkFctReqFxBrkDom = 0;
  $CAN_ADAS::RBFMain11::RBFMain11_isBrkFctReqPrkBrkDom = 0;
  $CAN_ADAS::RBFMain11::RBFMain11_usedChannel = 0;
  $CAN_ADAS::RBFMain12::RBFMain12_BrakeBckpStratState = 0;
  $CAN_ADAS::RBFMain12::RBFMain12_BrkBckStgyVehStopAvl = 0;
  $CAN_ADAS::RBFMain12::RBFMain12_BrkBckStratFxCtrlAvl = 0;
  $CAN_ADAS::RBFMain12::RBFMain12_BrkDiscTempStatus = 0;
  $CAN_ADAS::RBFMain12::RBFMain12_BrkDiscTempStatusAvl = 0;
  $CAN_ADAS::RBFMain12::RBFMain12_CurrentPumpRev = 0;
  $CAN_ADAS::RBFMain12::RBFMain12_DriverReqParkBrake = 0;
  $CAN_ADAS::RBFMain12::RBFMain12_DrvPressBrkPedalAvl = 0;
  $CAN_ADAS::RBFMain12::RBFMain12_DrvReqFxBrkDomAvail = 0;
  $CAN_ADAS::RBFMain12::RBFMain12_DrvReqParkBrakeAvail = 0;
  $CAN_ADAS::RBFMain12::RBFMain12_DrvReqTarFxBrake = 0;
  $CAN_ADAS::RBFMain12::RBFMain12_DrvReqTarFxBrakeAvl = 0;
  $CAN_ADAS::RBFMain12::RBFMain12_isDrvPressBrkPedal = 0;
  $CAN_ADAS::RBFMain12::RBFMain12_isDrvReqFxBrakeDom = 0;
  $CAN_ADAS::RBFMain12::RBFMain12_isDrvReqParkBrkDom = 0;
  $CAN_ADAS::SDM_0x319::SDM_AirBagSysAlrmLampSts = 0;
  $CAN_ADAS::SDM_0x319::SDM_CllsnSig = 0;
  $CAN_ADAS::SDM_0x319::SDM_DrverSecuBltAlrmSts = 0;
  $CAN_ADAS::SDM_0x319::SDM_FrntCllsn = 0;
  }
  if(init_count == 13)
  {
  $CAN_ADAS::SDM_0x319::SDM_LeSideCllsn = 0;
  $CAN_ADAS::SDM_0x319::SDM_PassSecuBltAlrmSts = 0;
  $CAN_ADAS::SDM_0x319::SDM_ReCllsn = 0;
  $CAN_ADAS::SDM_0x319::SDM_RiSideCllsn = 0;
  $CAN_ADAS::VCU_0x1BA::ESP_LmcAxTrgt = 0;
  $CAN_ADAS::VCU_0x1BA::PwrTrnDrvDmdSts = 0;
  $CAN_ADAS::VCU_0x1BA::VCU_DrvrAPSPerc = 0;
  $CAN_ADAS::VCU_0x1BA::VCU_DrvrAPSPercVld = 1;
  $CAN_ADAS::VCU_0x1BA::VCU_WhlTqAct = 180;
  $CAN_ADAS::VCU_0x1BA::VCU_WhlTqActVld = 1;
  $CAN_ADAS::VCU_0x214::VCU_DrvModSig = 0;
  $CAN_ADAS::VCU_0x214::VCU_GearSig = 1;
  $CAN_ADAS::VCU_0x214::VCU_GearSigVld = 1;
  $CAN_ADAS::VCU_0x214::VCU_RdyLamp = 1;
  $CAN_ADAS::VCU_0x225::VCU_MotChkACCFltFbFlg = 0;
  $CAN_ADAS::VCU_0x225::VCU_OverMod = 0;
  $CAN_ADAS::VCU_0x225::VCU_VehMaxWhlTq = 32767;
  $CAN_ADAS::VCU_0x225::VCU_VehTqFltSts = 0;
  $CAN_ADAS::VariantCoding::Vehicle_Variant = 0;
  $CAN_ADAS::YRS_0x242::YRS_LatAcce = 0.01900000000000013;
  $CAN_ADAS::YRS_0x242::YRS_LatSnsrSts = 1;
  $CAN_ADAS::YRS_0x242::YRS_YawRate = 0.009999999999990905;
  $CAN_ADAS::YRS_0x242::YRS_YawRateCalSts = 1;
  $CAN_ADAS::YRS_0x242::YRS_YawRateSnsrSts = 1;
  $CAN_ADAS::YRS_0x246::YRS_LgtAcce = 0.008999999999999897;
  }
  if(init_count == 14)
  {
  $CAN_ADAS::YRS_0x246::YRS_LgtSnsrSts = 1;
  $CAN_ADAS::iBooster_0x271::iBooster_BrkPedlAppldFlg = 0;
  $CAN_ADAS::iBooster_0x271::iBooster_BrkPedlAppldVld = 1;
  if (prestart_mode==0) init_count = 0;
  initFlag = 6;
  }
  init_count++;
}
void init_MPC3_VW_GOLF_VII()
{
  if(init_count == 1)
  {
  $CAN_MPC3::ABS_UN_PR_11::ABSMode = 0;
  $CAN_MPC3::ABS_UN_PR_11::DSCActivityStatus = 0;
  $CAN_MPC3::ABS_UN_PR_11::TCSSwitchSports = 2;
  $CAN_MPC3::ABS_UN_PR_11::TractionControlActive = 0;
  $CAN_MPC3::ABS_UN_PR_11::TractionControlFault = 0;
  $CAN_MPC3::ABS_UN_PR_11::YawControlFault = 0;
  $CAN_MPC3::ABS_UN_PR_4::ABSFault = 0;
  $CAN_MPC3::ABS_UN_PR_4::YawRate = 0;
  $CAN_MPC3::ABS_UN_PR_6::GSAPosStatus = 0;
  $CAN_MPC3::ABS_UN_PR_GW_2::ABSEngVacReq = 0;
  $CAN_MPC3::ABS_UN_PR_GW_2::ABSPwrTrnTorqReq = 0;
  $CAN_MPC3::ABS_UN_PR_GW_2::BrakePressure = 39.8;
  $CAN_MPC3::ABS_UN_PR_GW_2::BrakePressureQF = 3;
  $CAN_MPC3::ABS_UN_PR_GW_2::VehicleSpeed = 0;
  $CAN_MPC3::ABS_UN_PR_GW_2::VehicleSpeedQF = 3;
  $CAN_MPC3::ABS_UN_PR_GW_3::HillDescentMode = 1;
  $CAN_MPC3::ABS_UN_PR_GW_3::VehMovementDirection = 2;
  $CAN_MPC3::ABS_UN_PR_GW_3::VehMovementStatus = 0;
  $CAN_MPC3::ABS_UN_PR_GW_3::WheelDirectionFL = 3;
  $CAN_MPC3::ABS_UN_PR_GW_3::WheelDirectionFR = 3;
  $CAN_MPC3::ABS_UN_PR_GW_3::WheelDirectionRL = 3;
  $CAN_MPC3::ABS_UN_PR_GW_3::WheelDirectionRR = 3;
  $CAN_MPC3::ABS_UN_PR_GW_5_1::WheelSpeedFrL = 0;
  $CAN_MPC3::ABS_UN_PR_GW_5_1::WheelSpeedFrLQF = 3;
  $CAN_MPC3::ABS_UN_PR_GW_5_1::WheelSpeedFrR = 0;
  }
  if(init_count == 2)
  {
  $CAN_MPC3::ABS_UN_PR_GW_5_1::WheelSpeedFrRQF = 3;
  $CAN_MPC3::ABS_UN_PR_GW_5_2::WheelSpeedReL = 0;
  $CAN_MPC3::ABS_UN_PR_GW_5_2::WheelSpeedReLQF = 3;
  $CAN_MPC3::ABS_UN_PR_GW_5_2::WheelSpeedReR = 0;
  $CAN_MPC3::ABS_UN_PR_GW_5_2::WheelSpeedReRQF = 3;
  $CAN_MPC3::ACC_01::AxrArbitrated = 0;
  $CAN_MPC3::ACC_01::ESP_NotAvailable = 0;
  $CAN_MPC3::AEB_01::ADAS_FwdWarnFltTxt = 0;
  $CAN_MPC3::AEB_01::ADAS_Sts_AEB = 0;
  $CAN_MPC3::AEB_01::ADAS_Sts_FCW = 0;
  $CAN_MPC3::AEB_01::ADAS_WarnTyp_FCWAEB = 0;
  $CAN_MPC3::AEB_01::ADAS_WarnType_FCW = 0;
  $CAN_MPC3::AEB_01::AEBFActive = 0;
  $CAN_MPC3::AEB_01::AEBOncomingFeatureStatus = 0;
  $CAN_MPC3::AEB_01::AEBPActive = 0;
  $CAN_MPC3::AEB_01::AebFunctionStatus = 0;
  $CAN_MPC3::BCM_PR_GW_16_UN::UserSetTimeDate = 2641467294753;
  $CAN_MPC3::BCM_PR_GW_1_UN::CarMode = 0;
  $CAN_MPC3::BCM_PR_GW_1_UN::DirectionIndicationSwitch = 0;
  $CAN_MPC3::BCM_PR_GW_1_UN::MainBeamIndication = 0;
  $CAN_MPC3::BCM_PR_GW_1_UN::PowerMode = 0;
  $CAN_MPC3::BCM_PR_GW_1_UN::PowerMode_UB = 1;
  $CAN_MPC3::BCM_PR_GW_1_UN::RunningStandby = 0;
  $CAN_MPC3::BCM_SP_GW_2_UN::DirectionIndication = 0;
  $CAN_MPC3::BCM_SP_GW_2_UN::DirectionIndication_UB = 1;
  }
  if(init_count == 3)
  {
  $CAN_MPC3::BCM_SP_GW_2_UN::LDWSwitchReq = 0;
  $CAN_MPC3::BCM_SP_GW_2_UN::LDWSwitchReq_UB = 1;
  $CAN_MPC3::BCM_SP_GW_2_UN::LowBeamIndication = 0;
  $CAN_MPC3::BCM_SP_GW_2_UN::LowBeamIndication_UB = 1;
  $CAN_MPC3::CHCM_FR_PR_GW_2_UN::SuspensionHeightFL = 4;
  $CAN_MPC3::CHCM_FR_PR_GW_2_UN::SuspensionHeightFR = 1;
  $CAN_MPC3::CHCM_FR_PR_GW_2_UN::SuspensionHeightRL = 2;
  $CAN_MPC3::CHCM_FR_PR_GW_2_UN::SuspensionHeightRR = 4;
  $CAN_MPC3::CHCM_FR_PR_GW_3_UN::AIR_ControlStatus = 0;
  $CAN_MPC3::CHCM_FR_PR_GW_3_UN::AIR_SuspensionMode = 3;
  $CAN_MPC3::DADCA_FR_PR_GW_4_UN::TSRCountry = 13;
  $CAN_MPC3::DADCA_FR_PR_GW_4_UN::TSRHandOfTraffic = 1;
  $CAN_MPC3::DADCA_UN_PR_3::DADCFuncStatus = 0;
  $CAN_MPC3::DADCA_UN_PR_GW_2::RWSAngleDmd = -15;
  $CAN_MPC3::DADCA_UN_PR_GW_2::RWSAngleDmdPDC = -15;
  $CAN_MPC3::DADCA_UN_PR_GW_2::RWSFaultAngle = 0;
  $CAN_MPC3::DADCA_UN_PR_GW_2::RWSFaultStraight = 0;
  $CAN_MPC3::DADCA_UN_PR_GW_2::RWSLinRngeAngleDmd = -15;
  $CAN_MPC3::DADCA_UN_PR_GW_2::RWSMotTypeServeLat = 0;
  $CAN_MPC3::DADCA_UN_PR_GW_2::RWSMotTypeServeLong = 0;
  $CAN_MPC3::DADCA_UN_PR_GW_2::RWSMotTypeServeLvl = 0;
  $CAN_MPC3::DADCA_UN_PR_GW_2::RWSMotTypeServeMode = 0;
  $CAN_MPC3::DADCA_UN_PR_GW_3::DADCRWSAngleReq = -15;
  $CAN_MPC3::DADCA_UN_PR_GW_3::DrvLimRWSAct = 0;
  $CAN_MPC3::DADCA_UN_PR_GW_3::RWSAngleAct = -15;
  }
  if(init_count == 4)
  {
  $CAN_MPC3::DADCA_UN_PR_GW_3::RWSStrkeDmd = -40;
  $CAN_MPC3::DADCA_UN_PR_GW_3::RWSSysStats = 0;
  $CAN_MPC3::DADCA_UN_PR_GW_3::RWSTRConfig = 0;
  $CAN_MPC3::DADCA_UN_PR_GW_3::RWSTerrChngModeStatus = 0;
  $CAN_MPC3::DADCA_UN_PR_GW_3::RWSTerrainModeExt = 0;
  $CAN_MPC3::DADCA_UN_SP_5::CustomerSymptomIPMA = 0;
  $CAN_MPC3::DADCA_UN_SP_5::CustomerSymptomIPMA_UB = 0;
  $CAN_MPC3::DBC_Version::DBC_VersionIdMajor = 3;
  $CAN_MPC3::DBC_Version::DBC_VersionIdMinor = 3;
  $CAN_MPC3::GSR_ISA_CAN_RX_01::ISA_OUTPUT_ENABLED = 0;
  $CAN_MPC3::GSR_ISA_CAN_RX_01::ISA_SLWF_OUTPUT_ENABLED = 0;
  $CAN_MPC3::GSR_ISA_CAN_RX_01::ISA_SLWF_TYPE = 0;
  $CAN_MPC3::GSR_ISA_CAN_RX_01::ISA_SL_CHNG_AUDIO_FEEDBACK = 0;
  $CAN_MPC3::GSR_ISA_CAN_RX_01::ISA_USER_TERMINATION = 0;
  $CAN_MPC3::GWM_UN_PR_1::TerrainModeReqExt = 0;
  $CAN_MPC3::HCMA_PR_1::HBSeg0LT = 0;
  $CAN_MPC3::HCMA_PR_1::HBSeg0RT = 0;
  $CAN_MPC3::HCMA_PR_1::HBSeg1LT = 0;
  $CAN_MPC3::HCMA_PR_1::HBSeg1RT = 0;
  $CAN_MPC3::HCMA_PR_1::HBSeg2LT = 0;
  $CAN_MPC3::HCMA_PR_1::HBSeg2RT = 0;
  $CAN_MPC3::HCMA_PR_1::HBSeg3LT = 0;
  $CAN_MPC3::HCMA_PR_1::HBSeg3RT = 0;
  $CAN_MPC3::HCMA_PR_1::HBSeg4LT = 0;
  $CAN_MPC3::HCMA_PR_1::HBSeg4RT = 0;
  }
  if(init_count == 5)
  {
  $CAN_MPC3::HCMA_PR_1::HBSeg5LT = 0;
  $CAN_MPC3::HCMA_PR_1::HBSeg5RT = 0;
  $CAN_MPC3::HCMA_PR_1::HBSeg6LT = 0;
  $CAN_MPC3::HCMA_PR_1::HBSeg6RT = 0;
  $CAN_MPC3::HCMA_PR_1::HBSeg7LT = 0;
  $CAN_MPC3::HCMA_PR_1::HBSeg7RT = 0;
  $CAN_MPC3::HCMA_PR_1::HBSeg8LT = 0;
  $CAN_MPC3::HCMA_PR_1::HBSeg8RT = 0;
  $CAN_MPC3::HCMA_PR_1::HBSeg9LT = 0;
  $CAN_MPC3::HCMA_PR_1::HBSeg9RT = 0;
  $CAN_MPC3::HCMA_PR_1::HighBeamStatus = 0;
  $CAN_MPC3::HCMA_PR_1::LowBeamStatus = 0;
  $CAN_MPC3::HCMA_PR_2::ADBHorEdgeLT = -30;
  $CAN_MPC3::HCMA_PR_2::ADBHorEdgeRT = -30;
  $CAN_MPC3::HCMA_PR_2::LBStatus = 0;
  $CAN_MPC3::HCMA_PR_2::LaserStatus = 1;
  $CAN_MPC3::HCMA_PR_2::LightDist = 5;
  $CAN_MPC3::HCMB_PR_1::AFSLightDist_b = 15;
  $CAN_MPC3::HCMB_PR_1::AFSPHBAngleLT_b = 0;
  $CAN_MPC3::HCMB_PR_1::AFSPHBAngleRT_b = 0;
  $CAN_MPC3::HCMB_PR_1::AFSStatus_b = 15;
  $CAN_MPC3::HCMB_PR_1::LaserStatus_b = 0;
  $CAN_MPC3::IGM_PR_GW_7_UN::DisttoNextJunct = 0;
  $CAN_MPC3::IGM_PR_GW_7_UN::HandOfTrafficReq = 0;
  $CAN_MPC3::IGM_PR_GW_7_UN::InBuiltArea = 0;
  }
  if(init_count == 6)
  {
  $CAN_MPC3::IGM_PR_GW_7_UN::NavCountryCode = 0;
  $CAN_MPC3::IGM_PR_GW_7_UN::NavCurrRoadType = 0;
  $CAN_MPC3::IGM_PR_GW_7_UN::NavCurrState = 0;
  $CAN_MPC3::IGM_PR_GW_7_UN::NavSpdLimit = 0;
  $CAN_MPC3::IGM_PR_GW_7_UN::NavSpdLimitStatus = 0;
  $CAN_MPC3::IGM_PR_GW_7_UN::NavSpdLimitUnits = 0;
  $CAN_MPC3::IGM_PR_GW_7_UN::NumberofExitLanes = 0;
  $CAN_MPC3::IGM_PR_GW_7_UN::NumberofLanes = 0;
  $CAN_MPC3::IGM_PR_GW_7_UN::RightOfWay = 0;
  $CAN_MPC3::IGM_SP_GW_10_UN::AutoHighBeamSAEModeReq = 0;
  $CAN_MPC3::IGM_SP_GW_10_UN::AutoHighBeamSAEModeReq_UB = 0;
  $CAN_MPC3::IMU_TX1::acc_x = 0;
  $CAN_MPC3::IMU_TX1::acc_y = 0;
  $CAN_MPC3::IMU_TX1::acc_z = 0;
  $CAN_MPC3::IMU_TX1::crc_tx1 = 0;
  $CAN_MPC3::IMU_TX1::msg_cnt_tx1 = 0;
  $CAN_MPC3::IMU_TX1::status_acc_x = 0;
  $CAN_MPC3::IMU_TX1::status_acc_y = 0;
  $CAN_MPC3::IMU_TX1::status_acc_z = 0;
  $CAN_MPC3::IMU_TX2::crc_tx2 = 0;
  $CAN_MPC3::IMU_TX2::msg_cnt_tx2 = 0;
  $CAN_MPC3::IMU_TX2::rate_x = 0;
  $CAN_MPC3::IMU_TX2::rate_y = 0;
  $CAN_MPC3::IMU_TX2::rate_z = 0;
  $CAN_MPC3::IMU_TX2::status_rate_x = 0;
  }
  if(init_count == 7)
  {
  $CAN_MPC3::IMU_TX2::status_rate_y = 0;
  $CAN_MPC3::IMU_TX2::status_rate_z = 0;
  $CAN_MPC3::LANE_02::ElkeStatus = 0;
  $CAN_MPC3::LANE_02::ElkoAdjustInterventionTime = 0;
  $CAN_MPC3::LANE_02::ElkoAdjustWarningType = 0;
  $CAN_MPC3::LANE_02::ElkoStatus = 0;
  $CAN_MPC3::LANE_02::ElkreAdjustInterventionTime = 0;
  $CAN_MPC3::LANE_02::ElkreAdjustWarningType = 0;
  $CAN_MPC3::LANE_02::FeatureInteraction = 0;
  $CAN_MPC3::LANE_02::LdwAdjustSensitivity = 0;
  $CAN_MPC3::LANE_02::LdwAdjustWarningTime = 0;
  $CAN_MPC3::LANE_02::LdwAdjustWarningType = 0;
  $CAN_MPC3::LANE_02::LdwStatus = 0;
  $CAN_MPC3::LANE_02::LksStatus = 0;
  $CAN_MPC3::LANE_02::RdpAdjustSensitivity = 0;
  $CAN_MPC3::LANE_02::RdpAdjustWarningTime = 0;
  $CAN_MPC3::LANE_02::RdpAdjustWarningType = 0;
  $CAN_MPC3::LANE_02::RdpStatus = 0;
  $CAN_MPC3::LANE_02::SteeringSystemState = 0;
  $CAN_MPC3::LANE_05::EPSSensorAvailable = 1;
  $CAN_MPC3::LANE_05::EPS_IntRPCMaxTrq = -20.48;
  $CAN_MPC3::LANE_05::EPS_IntRPCMinTrq = -20.48;
  $CAN_MPC3::LANE_05::EPS_LatDrvLvl12SrvAvl = 0;
  $CAN_MPC3::LANE_05::RoadWheelAngle = 0;
  $CAN_MPC3::LANE_05::RoadWheelAngleSensorAvailable = 1;
  }
  if(init_count == 8)
  {
  $CAN_MPC3::LANE_05::SteeringSystemTorqueUsed = 0;
  $CAN_MPC3::LANE_05::SteeringWheelCapacitive = 2;
  $CAN_MPC3::LANE_05::TorsionBarSensorAvailable = 1;
  $CAN_MPC3::LHSWS_PR_GW_1_UN::JoypadDownBtnStatus = 0;
  $CAN_MPC3::LHSWS_PR_GW_1_UN::JoypadLeftBtnStatus = 0;
  $CAN_MPC3::LHSWS_PR_GW_1_UN::JoypadOKBtnStatus = 0;
  $CAN_MPC3::LHSWS_PR_GW_1_UN::JoypadRightBtnStatus = 0;
  $CAN_MPC3::LHSWS_PR_GW_1_UN::JoypadUpBtnStatus = 0;
  $CAN_MPC3::LIGHT_01::ClfFeatureCoded = 1;
  $CAN_MPC3::LIGHT_01::ClfFeatureStatus = 1;
  $CAN_MPC3::PCM_FR_PR_Core_B_UN::BrakeSwitchStatus = 1;
  $CAN_MPC3::PCM_FR_PR_Core_B_UN::EngineSpeed = 0;
  $CAN_MPC3::PCM_FR_PR_Core_B_UN::EngineSpeedQF = 3;
  $CAN_MPC3::PCM_FR_PR_Core_B_UN::MHStopStartStatus = 4;
  $CAN_MPC3::PCM_FR_PR_Core_B_UN::PowerPackStatus = 5;
  $CAN_MPC3::PCM_FR_PR_PedalPos_UN::PedalPosPro = 0;
  $CAN_MPC3::PCM_FR_PR_PedalPos_UN::PedalPosProQF = 3;
  $CAN_MPC3::PCM_FR_PR_WhlTorqTgt_UN::VSCHoldRequest = 0;
  $CAN_MPC3::PCM_FR_PR_WhlTorqTgt_UN::WheelTorqTgtWoIntF = 0;
  $CAN_MPC3::PCM_FR_PR_WhlTorqTgt_UN::WheelTorqTgtWoIntR = 0;
  $CAN_MPC3::PSCM_FR_PR_GW_1_UN::EPASDrvDmdExcess_dup = 0;
  $CAN_MPC3::PSCM_FR_PR_GW_1_UN::TorsionBarTorque = 0.04;
  $CAN_MPC3::PSCM_FR_PR_GW_1_UN::TorsionBarTorqueQF = 3;
  $CAN_MPC3::PSCM_FR_PR_GW_1_UN::TorsionBarTorqueSign = 1;
  $CAN_MPC3::PSCM_FR_PR_GW_2_UN::ActRoadWheelAngState = 2;
  }
  if(init_count == 9)
  {
  $CAN_MPC3::PSCM_FR_PR_GW_2_UN::ActRoadWheelAngValue = 0;
  $CAN_MPC3::RCM_FR_PR_GW_1_UN::DrivSeatBeltBcklError = 0;
  $CAN_MPC3::RCM_FR_PR_GW_1_UN::DrivSeatBeltBcklState = 1;
  $CAN_MPC3::RCM_FR_PR_TXID1_UN::A1 = 0;
  $CAN_MPC3::RCM_FR_PR_TXID1_UN::A1_STAT = 0;
  $CAN_MPC3::RCM_FR_PR_TXID1_UN::CLU_STAT = 0;
  $CAN_MPC3::RCM_FR_PR_TXID1_UN::PSIP1 = 0;
  $CAN_MPC3::RCM_FR_PR_TXID1_UN::PSIP1_STAT = 0;
  $CAN_MPC3::RCM_FR_PR_TXID2_UN::A2 = 0;
  $CAN_MPC3::RCM_FR_PR_TXID2_UN::A2_STAT = 0;
  $CAN_MPC3::RCM_FR_PR_TXID2_UN::PSIPP1 = 0;
  $CAN_MPC3::RCM_FR_PR_TXID2_UN::PSIPP1_STAT = 1;
  $CAN_MPC3::SASM_FR_GW_1_UN::SteeringWheelAngle = 0;
  $CAN_MPC3::SASM_FR_GW_1_UN::SteeringWheelAngleSpeed = 0;
  $CAN_MPC3::SASM_FR_GW_1_UN::SteeringWheelAngleStatus = 3;
  $CAN_MPC3::SASM_FR_GW_1_UN::SteeringWheelRotDir = 0;
  $CAN_MPC3::SignalGW_PR_1_UN::DemandHeight = 0;
  $CAN_MPC3::SignalGW_PR_1_UN::EstimatedHeight = 0;
  $CAN_MPC3::SignalGW_PR_1_UN::THETAP = 0;
  $CAN_MPC3::SignalGW_PR_3_UN::CountryCode = 0;
  $CAN_MPC3::SignalGW_PR_3_UN::VCGStatus = 0;
  $CAN_MPC3::SignalGW_PR_4_UN::AmbTempImpr = 25;
  $CAN_MPC3::SignalGW_PR_4_UN::DoorStatus = 0;
  $CAN_MPC3::SignalGW_PR_4_UN::ExteriorLightSwitchPos2 = 0;
  $CAN_MPC3::SignalGW_PR_4_UN::FrontFogLightIndication = 0;
  }
  if(init_count == 10)
  {
  $CAN_MPC3::SignalGW_PR_4_UN::MainBeamSwitch = 0;
  $CAN_MPC3::SignalGW_PR_4_UN::WasherFrontCmd_EUCD = 0;
  $CAN_MPC3::SignalGW_PR_4_UN::WasherRearCmd = 0;
  $CAN_MPC3::SignalGW_PR_4_UN::WiperFrontCmd_EuCD = 1;
  $CAN_MPC3::SignalGW_PR_4_UN::WiperRearCmd = 0;
  $CAN_MPC3::SignalGW_PR_4_UN::WiperStatus = 0;
  $CAN_MPC3::SignalGW_PR_6_UN::ATPCProStatus = 0;
  $CAN_MPC3::Snapshot_Data::GlobalRealTime = 0;
  $CAN_MPC3::Snapshot_Data::InCarTemp = 0;
  $CAN_MPC3::Snapshot_Data::MainECUSuppVolt = 0;
  $CAN_MPC3::Snapshot_Data::OutdoorTemp = 0;
  $CAN_MPC3::Snapshot_Data::PowrModePKT = 0;
  $CAN_MPC3::Snapshot_Data::Snapshot_Data_PDU_0 = 0;
  $CAN_MPC3::Snapshot_Data::TotalDistance = 0;
  $CAN_MPC3::TPM_PR_GW_4::ActualTyrePressureFL = 266;
  $CAN_MPC3::TPM_PR_GW_4::ActualTyrePressureFR = 266;
  $CAN_MPC3::TPM_PR_GW_4::ActualTyrePressureRL = 266;
  $CAN_MPC3::TPM_PR_GW_4::ActualTyrePressureRR = 266;
  $CAN_MPC3::TransmissionControl_A_GW_UN::KeepNetInAfterRunTCM = 1;
  $CAN_MPC3::TransmissionControl_A_GW_UN::TCMLockETSReq = 3;
  $CAN_MPC3::TransmissionControl_A_GW_UN::TCMParkReqAck = 0;
  $CAN_MPC3::TransmissionControl_A_GW_UN::TCMPositionDisplay = 1024;
  $CAN_MPC3::TransmissionControl_A_GW_UN::TCMStartEnable = 0;
  $CAN_MPC3::TransmissionControl_A_GW_UN::TCMText = 0;
  $CAN_MPC3::TransmissionControl_A_GW_UN::TransTICStatus = 1;
  }
  if(init_count == 11)
  {
  $CAN_MPC3::VEHCONFIG_400UN_AS::CcfAHBCalibration = 0;
  $CAN_MPC3::VEHCONFIG_400UN_AS::CcfAHBSensitivtyMenu = 0;
  $CAN_MPC3::VEHCONFIG_400UN_AS::CcfAHBSystemStatus = 0;
  $CAN_MPC3::VEHCONFIG_400UN_AS::CcfAdapDrvBeamSeg = 0;
  $CAN_MPC3::VEHCONFIG_400UN_AS::CcfAdaptDrvBeam = 0;
  $CAN_MPC3::VEHCONFIG_400UN_AS::CcfAdasNCapESS = 0;
  $CAN_MPC3::VEHCONFIG_400UN_AS::CcfAllWheelSteer = 0;
  $CAN_MPC3::VEHCONFIG_400UN_AS::CcfDD00GlobalRealTime = 0;
  $CAN_MPC3::VEHCONFIG_400UN_AS::CcfDD01TotalDistance = 0;
  $CAN_MPC3::VEHCONFIG_400UN_AS::CcfDD02MainECUSupVolts = 0;
  $CAN_MPC3::VEHCONFIG_400UN_AS::CcfDD04InCarTemp = 0;
  $CAN_MPC3::VEHCONFIG_400UN_AS::CcfDD05OutdoorTemp = 0;
  $CAN_MPC3::VEHCONFIG_400UN_AS::CcfDD06PowerModePKT = 0;
  $CAN_MPC3::VEHCONFIG_400UN_AS::CcfGlassType = 0;
  $CAN_MPC3::VEHCONFIG_400UN_AS::CcfHUDSubType = 0;
  $CAN_MPC3::VEHCONFIG_400UN_AS::CcfHeatedWindscreen = 0;
  $CAN_MPC3::VEHCONFIG_400UN_AS::CcfParkAssistHMI = 0;
  $CAN_MPC3::VEHCONFIG_400UN_AS::CcfSportbrake = 0;
  $CAN_MPC3::VEHCONFIG_400UN_AS::CcfSteeringWheelPosn = 0;
  $CAN_MPC3::VEHCONFIG_400UN_AS::CcfSuspensionType = 0;
  $CAN_MPC3::VEHCONFIG_400UN_AS::CcfVINPart1 = 0;
  $CAN_MPC3::VEHCONFIG_400UN_AS::CcfVINPart2 = 0;
  $CAN_MPC3::VEHCONFIG_400UN_AS::CcfVINPart3 = 0;
  $CAN_MPC3::VEHCONFIG_400UN_AS::CcfVehClearGuidance = 0;
  $CAN_MPC3::VEHCONFIG_400UN_AS::CcfVehicleType = 0;
  }
  if(init_count == 12)
  {
  $CAN_MPC3::VEHCONFIG_400UN_AS::SF_VEHCONFIG_400UN_AUTOSAR_PDU = 0;
  $CAN_MPC3::VEHCONFIG_400UN_AS::ccfGenericWheelBase = 0;
  $CAN_MPC3::VLC_01::ENG_DRIVER_REQ_TRQ_130 = 0;
  $CAN_MPC3::VLC_01::ENG_ENG_TRQ_130 = 0;
  $CAN_MPC3::VLC_01::ENG_IDAS_MAXMUM_TORQUE = 0;
  $CAN_MPC3::VLC_01::ENG_IDAS_MINMUM_TORQUE = 0;
  $CAN_MPC3::VLC_02::CVT_RATIO_INFO_191 = 0;
  $CAN_MPC3::Vehicle_CAN_01::ADS_Intervention = 0;
  $CAN_MPC3::Vehicle_CAN_01::AcceleratorPedalGradient = 0;
  $CAN_MPC3::Vehicle_CAN_01::AebBrakeFeatureStatus = 1;
  $CAN_MPC3::Vehicle_CAN_01::AebWarnFeatureStatus = 1;
  $CAN_MPC3::Vehicle_CAN_01::BrakeLampOnStatus = 0;
  $CAN_MPC3::Vehicle_CAN_01::DriverSeatBeltPosition = 3;
  $CAN_MPC3::Vehicle_CAN_01::EngineRunningStatus = 0;
  $CAN_MPC3::Vehicle_CAN_01::GasPedalPressedInKickDownMode = 0;
  $CAN_MPC3::Vehicle_CAN_01::Mileage = 0;
  $CAN_MPC3::Vehicle_CAN_01::RequestedDeceleration = 0;
  $CAN_MPC3::Vehicle_CAN_01::SelectedDrivingGear = 0;
  $CAN_MPC3::Vehicle_CAN_01::TSRDisplayEnableSwitch = 0;
  $CAN_MPC3::Vehicle_CAN_01::TrailerConnection = 0;
  $CAN_MPC3::Vehicle_CAN_09::ENG_EM_TEST_MODE_ENABLE = 0;
  $CAN_MPC3::Vehicle_CAN_09::EngineControllerStatus = 3;
  $CAN_MPC3::Vehicle_CAN_09::EngineRPM = 0;
  $CAN_MPC3::Vehicle_CAN_09::EngineRPM_Qbit = 0;
  $CAN_MPC3::Vehicle_CAN_09::Gateway1Timeout = 0;
  }
  if(init_count == 13)
  {
  $CAN_MPC3::Vehicle_CAN_09::Gateway2Timeout = 0;
  $CAN_MPC3::Vehicle_CAN_09::Gateway3Timeout = 0;
  $CAN_MPC3::Vehicle_CAN_09::Gateway4Timeout = 0;
  $CAN_MPC3::Vehicle_CAN_09::Gateway5Timeout = 0;
  $CAN_MPC3::Vehicle_CAN_09::LimiterActive = 0;
  $CAN_MPC3::Vehicle_CAN_09::RoadSlope = 0;
  $CAN_MPC3::Vehicle_CAN_09::RoadSlope_Qbit = 0;
  $CAN_MPC3::Vehicle_CAN_09::StartStop_DriverRequest = 0;
  $CAN_MPC3::Vehicle_CAN_09::StartStop_EngineStarting = 0;
  $CAN_MPC3::Vehicle_CAN_09::StartStop_EngineStopping = 0;
  $CAN_MPC3::Vehicle_CAN_09::StartStop_Status = 0;
  $CAN_MPC3::Vehicle_CAN_09::ThrottleRaw_Qbit = 0;
  $CAN_MPC3::Vehicle_CAN_09::VehicleMass = 0;
  $CAN_MPC3::Vehicle_CAN_09::VehicleMass_Qbit = 0;
  $CAN_MPC3::Vehicle_CAN_15::ACC_CancelSwitch = 0;
  $CAN_MPC3::Vehicle_CAN_15::ACC_LimiterSwitch = 0;
  $CAN_MPC3::Vehicle_CAN_15::ACC_MainSwitch = 0;
  $CAN_MPC3::Vehicle_CAN_15::ACC_ResumeSwitch = 0;
  $CAN_MPC3::Vehicle_CAN_15::ACC_SetSwitch = 0;
  $CAN_MPC3::Vehicle_CAN_15::ACC_SwitchFailure = 0;
  $CAN_MPC3::Vehicle_CAN_15::ACC_TimegapSwitches = 0;
  $CAN_MPC3::Vehicle_CAN_15::ACC_VSetMinusSwitch = 0;
  $CAN_MPC3::Vehicle_CAN_15::ACC_VSetPlusSwitch = 0;
  $CAN_MPC3::Vehicle_CAN_15::DisplayACCScreenActive = 0;
  $CAN_MPC3::Vehicle_CAN_15::DisplayConsistentWithACC = 0;
  }
  if(init_count == 14)
  {
  $CAN_MPC3::Vehicle_CAN_15::DisplayFailure = 0;
  $CAN_MPC3::Vehicle_CAN_15::DisplayedSpeed = 0;
  $CAN_MPC3::Vehicle_CAN_15::DisplayedSpeedUnitType = 0;
  $CAN_MPC3::Vehicle_CAN_15::DriverSeatBeltStatus = 3;
  $CAN_MPC3::Vehicle_CAN_15::DriverSeatPositionSensor = 0;
  $CAN_MPC3::Vehicle_CAN_15::EPB_BrakeForce = 0;
  $CAN_MPC3::Vehicle_CAN_15::EPB_ErrorStatus = 0;
  $CAN_MPC3::Vehicle_CAN_15::EPB_Status = 0;
  $CAN_MPC3::Vehicle_CAN_15::EPB_SwitchPosition = 0;
  $CAN_MPC3::Vehicle_CAN_15::EPB_SwitchPosition_Qbit = 0;
  $CAN_MPC3::Vehicle_CAN_15::NoForwardGear = 0;
  $CAN_MPC3::Vehicle_CAN_15::ParkingBrakeActive = 0;
  $CAN_MPC3::Vehicle_CAN_15::RequestedDrivingProgram = 0;
  $CAN_MPC3::Vehicle_CAN_15::TrailerBrakeLampDefect = 0;
  $CAN_MPC3::Vehicle_CAN_15::VehicleBrakeLampsDefect = 0;
  $CAN_MPC3::Vehicle_CAN_15::VehicleDoorOpen = 0;
  $CAN_MPC3::Vehicle_CAN_17::Day = 0;
  $CAN_MPC3::Vehicle_CAN_17::Hour = 0;
  $CAN_MPC3::Vehicle_CAN_17::KeyNumber = 0;
  $CAN_MPC3::Vehicle_CAN_17::Minute = 0;
  $CAN_MPC3::Vehicle_CAN_17::Month = 0;
  $CAN_MPC3::Vehicle_CAN_17::OverSpdWarningOffset = 128;
  $CAN_MPC3::Vehicle_CAN_17::Second = 0;
  $CAN_MPC3::Vehicle_CAN_17::WheelRotationDirFrontLeft = 0;
  $CAN_MPC3::Vehicle_CAN_17::WheelRotationDirFrontRight = 0;
  }
  if(init_count == 15)
  {
  $CAN_MPC3::Vehicle_CAN_17::WheelRotationDirRearLeft = 0;
  $CAN_MPC3::Vehicle_CAN_17::WheelRotationDirRearRight = 0;
  $CAN_MPC3::Vehicle_CAN_17::Year = 0;
  $CAN_MPC3::Vehicle_CAN_21::ASR_Intervention = 0;
  $CAN_MPC3::Vehicle_CAN_21::AirbagCrashIntensity = 0;
  $CAN_MPC3::Vehicle_CAN_21::BrakePressure_Qbit = 0;
  $CAN_MPC3::Vehicle_CAN_21::BrakeTemperatureStatus = 0;
  $CAN_MPC3::Vehicle_CAN_21::ClutchPedal = 0;
  $CAN_MPC3::Vehicle_CAN_21::ClutchTemperatureStatus = 0;
  $CAN_MPC3::Vehicle_CAN_21::DecelerationEnable = 0;
  $CAN_MPC3::Vehicle_CAN_21::DriverBraked_Qbit = 0;
  $CAN_MPC3::Vehicle_CAN_21::EBV_Intervention = 0;
  $CAN_MPC3::Vehicle_CAN_21::ECD_Failure = 0;
  $CAN_MPC3::Vehicle_CAN_21::ECD_NotAvailable = 0;
  $CAN_MPC3::Vehicle_CAN_21::EDS_Intervention = 0;
  $CAN_MPC3::Vehicle_CAN_21::ESP_AutoholdActive = 0;
  $CAN_MPC3::Vehicle_CAN_21::ESP_ConsistentWithACC = 0;
  $CAN_MPC3::Vehicle_CAN_21::ESP_StandstillConfirmed = 0;
  $CAN_MPC3::Vehicle_CAN_21::ESP_StoppingProcessActive = 0;
  $CAN_MPC3::Vehicle_CAN_21::EmergencyBrakeActive = 0;
  $CAN_MPC3::Vehicle_CAN_21::MSR_Intervention = 0;
  $CAN_MPC3::Vehicle_CAN_21::NumberOfCogs = 0;
  $CAN_MPC3::Vehicle_CAN_21::SteeringAngularSpeed_Qbit = 0;
  $CAN_MPC3::Vehicle_CAN_21::SteeringWheelAngle_Qbit = 0;
  $CAN_MPC3::Vehicle_CAN_21::TSRFeatureEnableSwitch = 255;
  }
  if(init_count == 16)
  {
  $CAN_MPC3::Vehicle_CAN_21::Velocity_Qbit = 0;
  $CAN_MPC3::Vehicle_CAN_21::WheelCircumference = 0;
  $CAN_MPC3::Vehicle_CAN_21::WheelCircumference_QBit = 0;
  $CAN_MPC3::Vehicle_CAN_25::FoggingRiskWindscreen = 0;
  $CAN_MPC3::Vehicle_CAN_25::FrontCrash = 0;
  $CAN_MPC3::Vehicle_CAN_25::RearCrash = 0;
  $CAN_MPC3::Vehicle_CAN_25::RolloverCrash = 0;
  $CAN_MPC3::Vehicle_CAN_25::SideCrashCodriver = 0;
  $CAN_MPC3::Vehicle_CAN_25::SideCrashDriver = 0;
  $CAN_MPC3::Vehicle_CAN_25::WheelPulseIndicatorFL = 0;
  $CAN_MPC3::Vehicle_CAN_25::WheelPulseIndicatorFR = 0;
  $CAN_MPC3::Vehicle_CAN_25::WheelPulseIndicatorRL = 0;
  $CAN_MPC3::Vehicle_CAN_25::WheelPulseIndicatorRR = 0;
  $CAN_MPC3::Vehicle_CAN_25::WheelPulseSensorFL_Qbit = 0;
  $CAN_MPC3::Vehicle_CAN_25::WheelPulseSensorFR_Qbit = 0;
  $CAN_MPC3::Vehicle_CAN_25::WheelPulseSensorRL_Qbit = 0;
  $CAN_MPC3::Vehicle_CAN_25::WheelPulseSensorRR_Qbit = 0;
  $CAN_MPC3::Vehicle_CAN_29::ADAS_ProfLong_CtrlPoint = 0;
  $CAN_MPC3::Vehicle_CAN_29::ADAS_ProfLong_CycCnt = 0;
  $CAN_MPC3::Vehicle_CAN_29::ADAS_ProfLong_MsgType = 0;
  $CAN_MPC3::Vehicle_CAN_29::ADAS_ProfLong_Offset = 0;
  $CAN_MPC3::Vehicle_CAN_29::ADAS_ProfLong_PathIdx = 0;
  $CAN_MPC3::Vehicle_CAN_29::ADAS_ProfLong_ProfType = 0;
  $CAN_MPC3::Vehicle_CAN_29::ADAS_ProfLong_Retr = 0;
  $CAN_MPC3::Vehicle_CAN_29::ADAS_ProfLong_Update = 0;
  }
  if(init_count == 17)
  {
  $CAN_MPC3::Vehicle_CAN_29::ProfileLong_Value = 0;
  $CAN_MPC3::Vehicle_CAN_31::ADAS_Meta_CountryCode = 0;
  $CAN_MPC3::Vehicle_CAN_31::ADAS_Meta_CycCnt = 0;
  $CAN_MPC3::Vehicle_CAN_31::ADAS_Meta_DrvSide = 0;
  $CAN_MPC3::Vehicle_CAN_31::ADAS_Meta_HwVer = 0;
  $CAN_MPC3::Vehicle_CAN_31::ADAS_Meta_MapProvider = 0;
  $CAN_MPC3::Vehicle_CAN_31::ADAS_Meta_MapVerQtr = 0;
  $CAN_MPC3::Vehicle_CAN_31::ADAS_Meta_MapVerYear = 0;
  $CAN_MPC3::Vehicle_CAN_31::ADAS_Meta_MsgType = 0;
  $CAN_MPC3::Vehicle_CAN_31::ADAS_Meta_ProtVer_Major = 0;
  $CAN_MPC3::Vehicle_CAN_31::ADAS_Meta_ProtVer_Minor = 0;
  $CAN_MPC3::Vehicle_CAN_31::ADAS_Meta_ProtVer_MinorSub = 0;
  $CAN_MPC3::Vehicle_CAN_31::ADAS_Meta_RegionCode = 0;
  $CAN_MPC3::Vehicle_CAN_31::ADAS_Meta_SpdUnits = 0;
  $CAN_MPC3::Vehicle_CAN_37::ADAS_ProfShort_AccurClass = 0;
  $CAN_MPC3::Vehicle_CAN_37::ADAS_ProfShort_CtrlPoint = 0;
  $CAN_MPC3::Vehicle_CAN_37::ADAS_ProfShort_CycCnt = 0;
  $CAN_MPC3::Vehicle_CAN_37::ADAS_ProfShort_Dist1 = 0;
  $CAN_MPC3::Vehicle_CAN_37::ADAS_ProfShort_MsgType = 0;
  $CAN_MPC3::Vehicle_CAN_37::ADAS_ProfShort_Offset = 0;
  $CAN_MPC3::Vehicle_CAN_37::ADAS_ProfShort_PathIdx = 0;
  $CAN_MPC3::Vehicle_CAN_37::ADAS_ProfShort_ProfType = 0;
  $CAN_MPC3::Vehicle_CAN_37::ADAS_ProfShort_Retr = 0;
  $CAN_MPC3::Vehicle_CAN_37::ADAS_ProfShort_Update = 0;
  $CAN_MPC3::Vehicle_CAN_37::ADAS_ProfShort_Value0 = 0;
  }
  if(init_count == 18)
  {
  $CAN_MPC3::Vehicle_CAN_37::ADAS_ProfShort_Value1 = 0;
  $CAN_MPC3::Vehicle_CAN_41::ADAS_Stub_CmplxInsct = 0;
  $CAN_MPC3::Vehicle_CAN_41::ADAS_Stub_CycCnt = 0;
  $CAN_MPC3::Vehicle_CAN_41::ADAS_Stub_FormOfWay = 0;
  $CAN_MPC3::Vehicle_CAN_41::ADAS_Stub_FuncRoadClass = 0;
  $CAN_MPC3::Vehicle_CAN_41::ADAS_Stub_LastStub = 0;
  $CAN_MPC3::Vehicle_CAN_41::ADAS_Stub_MsgType = 0;
  $CAN_MPC3::Vehicle_CAN_41::ADAS_Stub_NumOfLaneDrvDir = 0;
  $CAN_MPC3::Vehicle_CAN_41::ADAS_Stub_NumOfLaneOppDir = 0;
  $CAN_MPC3::Vehicle_CAN_41::ADAS_Stub_Offset = 0;
  $CAN_MPC3::Vehicle_CAN_41::ADAS_Stub_PartOfCalcRoute = 0;
  $CAN_MPC3::Vehicle_CAN_41::ADAS_Stub_PathIdx = 0;
  $CAN_MPC3::Vehicle_CAN_41::ADAS_Stub_RelProbb = 0;
  $CAN_MPC3::Vehicle_CAN_41::ADAS_Stub_Retr = 0;
  $CAN_MPC3::Vehicle_CAN_41::ADAS_Stub_RtOfWay = 0;
  $CAN_MPC3::Vehicle_CAN_41::ADAS_Stub_SubPathIdx = 0;
  $CAN_MPC3::Vehicle_CAN_41::ADAS_Stub_TurnAngl = 0;
  $CAN_MPC3::Vehicle_CAN_41::ADAS_Stub_Update = 0;
  $CAN_MPC3::Vehicle_CAN_43::ADAS_Seg_Bridge = 0;
  $CAN_MPC3::Vehicle_CAN_43::ADAS_Seg_BuildUpArea = 0;
  $CAN_MPC3::Vehicle_CAN_43::ADAS_Seg_CmplxInsct = 0;
  $CAN_MPC3::Vehicle_CAN_43::ADAS_Seg_CycCnt = 0;
  $CAN_MPC3::Vehicle_CAN_43::ADAS_Seg_DividedRoad = 0;
  $CAN_MPC3::Vehicle_CAN_43::ADAS_Seg_EffSpdLmt = 0;
  $CAN_MPC3::Vehicle_CAN_43::ADAS_Seg_EffSpdLmtType = 0;
  }
  if(init_count == 19)
  {
  $CAN_MPC3::Vehicle_CAN_43::ADAS_Seg_FormOfWay = 0;
  $CAN_MPC3::Vehicle_CAN_43::ADAS_Seg_FuncRoadClass = 0;
  $CAN_MPC3::Vehicle_CAN_43::ADAS_Seg_MsgType = 0;
  $CAN_MPC3::Vehicle_CAN_43::ADAS_Seg_NumOfLaneDrvDir = 0;
  $CAN_MPC3::Vehicle_CAN_43::ADAS_Seg_NumOfLaneOppDir = 0;
  $CAN_MPC3::Vehicle_CAN_43::ADAS_Seg_Offset = 0;
  $CAN_MPC3::Vehicle_CAN_43::ADAS_Seg_PartOfCalcRoute = 0;
  $CAN_MPC3::Vehicle_CAN_43::ADAS_Seg_PathIdx = 0;
  $CAN_MPC3::Vehicle_CAN_43::ADAS_Seg_RelProbb = 0;
  $CAN_MPC3::Vehicle_CAN_43::ADAS_Seg_Retr = 0;
  $CAN_MPC3::Vehicle_CAN_43::ADAS_Seg_Tunnel = 0;
  $CAN_MPC3::Vehicle_CAN_43::ADAS_Seg_Update = 0;
  $CAN_MPC3::Vehicle_CAN_47::ADAS_Posn_Age = 0;
  $CAN_MPC3::Vehicle_CAN_47::ADAS_Posn_CurLane = 0;
  $CAN_MPC3::Vehicle_CAN_47::ADAS_Posn_CycCnt = 0;
  $CAN_MPC3::Vehicle_CAN_47::ADAS_Posn_Idx = 0;
  $CAN_MPC3::Vehicle_CAN_47::ADAS_Posn_MsgTyp = 0;
  $CAN_MPC3::Vehicle_CAN_47::ADAS_Posn_Offset = 0;
  $CAN_MPC3::Vehicle_CAN_47::ADAS_Posn_PathIdx = 0;
  $CAN_MPC3::Vehicle_CAN_47::ADAS_Posn_PosConfdc = 0;
  $CAN_MPC3::Vehicle_CAN_47::ADAS_Posn_PosProbb = 0;
  $CAN_MPC3::Vehicle_CAN_47::ADAS_Posn_RelHead = 0;
  $CAN_MPC3::Vehicle_CAN_47::ADAS_Posn_Spd = 0;
  $CAN_MPC3::Vehicle_CAN_48::RoadWheelAngleGradients = 0;
  $CAN_MPC3::Vehicle_CAN_48::YawRate_Qbit = 0;
  }
  if(init_count == 20)
  {
  $CAN_MPC3::Vehicle_CAN_48::isPitchRate = 0;
  $CAN_MPC3::Vehicle_CAN_48::isYawRate_Pf = 0;
  if (prestart_mode==0) init_count = 0;
  initFlag = 7;
  }
  init_count++;
}

void Initialize_opaque_byte_order_signal_array()
{
  for(i = 0; i < 5000; i++)
  {
    RFC_FieldDataCollection_byte_Array[i] = 0;
  }
  for(i = 0; i < 1000; i++)
  {
    RFC_RoadSideBoundaries_byte_Array[i] = 0;
  }
  for(i = 0; i < 20; i++)
  {
    RFC_Veh_ConfigMgmt_byte_Array[i] = 0;
  }
  for(i = 0; i < 20; i++)
  {
    RFL_Veh_ConfigMgmt_byte_Array[i] = 0;
  }
  for(i = 0; i < 20; i++)
  {
    RFR_Veh_ConfigMgmt_byte_Array[i] = 0;
  }
  for(i = 0; i < 20; i++)
  {
    RRL_Veh_ConfigMgmt_byte_Array[i] = 0;
  }
  for(i = 0; i < 20; i++)
  {
    RRR_Veh_ConfigMgmt_byte_Array[i] = 0;
  }
  for(i = 0; i < 5000; i++)
  {
    RFL_FieldDataCollection_byte_Array[i] = 0;
  }
  for(i = 0; i < 1000; i++)
  {
    RFL_RoadSideBoundaries_byte_Array[i] = 0;
  }
  for(i = 0; i < 5000; i++)
  {
    RFR_FieldDataCollection_byte_Array[i] = 0;
  }
  for(i = 0; i < 1000; i++)
  {
    RFR_RoadSideBoundaries_byte_Array[i] = 0;
  }
  for(i = 0; i < 5000; i++)
  {
    RRL_FieldDataCollection_byte_Array[i] = 0;
  }
  for(i = 0; i < 1000; i++)
  {
    RRL_RoadSideBoundaries_byte_Array[i] = 0;
  }
  for(i = 0; i < 5000; i++)
  {
    RRR_FieldDataCollection_byte_Array[i] = 0;
  }
  for(i = 0; i < 1000; i++)
  {
    RRR_RoadSideBoundaries_byte_Array[i] = 0;
  }
}