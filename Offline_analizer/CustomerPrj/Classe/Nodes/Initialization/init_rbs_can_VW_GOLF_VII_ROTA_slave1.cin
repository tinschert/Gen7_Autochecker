/*@!Encoding:1252*/
// Autogenerated by -> Platform\Classe\Scripts\Rbs_Scripts\create_ininode.py 

includes
{
}

variables 
{
} 

void init_CRadarFL_VW_GOLF_VII_ROTA()
{
  if(init_count == 1)
  {
  $CAN_PrivFront::RFL_AEB_Request::RFL_AEB_CU = 0;
  $CAN_PrivFront::RFL_AEB_Request::RFL_AEB_DummyForFuture = 0;
  $CAN_PrivFront::RFL_AEB_Request::RFL_AEB_FPC = 0;
  $CAN_PrivFront::RFL_AEB_Request::RFL_AEB_LTA = 0;
  $CAN_PrivFront::RFL_AEB_Request::RFL_AEB_ObjID = 0;
  $CAN_PrivFront::RFL_AEB_Request::RFL_AEB_VRU = 0;
  $CAN_PrivFront::RFL_AEB_Request::RFL_AEB_VRUTA = 0;
  $CAN_PrivFront::RFL_AEB_Request::RFL_Ax_CommandValue = 0;
  $CAN_PrivFront::RFL_Obj00A::RFL_Obj00A_Ax = -16;
  $CAN_PrivFront::RFL_Obj00A::RFL_Obj00A_AxAyCoVnce = 0;
  $CAN_PrivFront::RFL_Obj00A::RFL_Obj00A_AxVnce = 0;
  $CAN_PrivFront::RFL_Obj00A::RFL_Obj00A_Ay = -16;
  $CAN_PrivFront::RFL_Obj00A::RFL_Obj00A_AyVnce = 0;
  $CAN_PrivFront::RFL_Obj00A::RFL_Obj00A_Dx = -256;
  $CAN_PrivFront::RFL_Obj00A::RFL_Obj00A_DxAxCoVnce = 0;
  $CAN_PrivFront::RFL_Obj00A::RFL_Obj00A_DxAyCoVnce = 0;
  $CAN_PrivFront::RFL_Obj00A::RFL_Obj00A_DxDyCoVnce = 0;
  $CAN_PrivFront::RFL_Obj00A::RFL_Obj00A_DxVnce = 0;
  $CAN_PrivFront::RFL_Obj00A::RFL_Obj00A_DxVxCoVnce = 0;
  $CAN_PrivFront::RFL_Obj00A::RFL_Obj00A_DxVyCoVnce = 0;
  $CAN_PrivFront::RFL_Obj00A::RFL_Obj00A_Dy = -128;
  $CAN_PrivFront::RFL_Obj00A::RFL_Obj00A_DyAxCoVnce = 0;
  $CAN_PrivFront::RFL_Obj00A::RFL_Obj00A_DyAyCoVnce = 0;
  $CAN_PrivFront::RFL_Obj00A::RFL_Obj00A_DyVnce = 0;
  $CAN_PrivFront::RFL_Obj00A::RFL_Obj00A_DyVxCoVnce = 0;
  }
  if(init_count == 2)
  {
  $CAN_PrivFront::RFL_Obj00A::RFL_Obj00A_DyVyCoVnce = 0;
  $CAN_PrivFront::RFL_Obj00A::RFL_Obj00A_Dz = -5;
  $CAN_PrivFront::RFL_Obj00A::RFL_Obj00A_DzVnce = 0;
  $CAN_PrivFront::RFL_Obj00A::RFL_Obj00A_HeadingYawAngle = -4.48;
  $CAN_PrivFront::RFL_Obj00A::RFL_Obj00A_HeadingYawAngleVnce = 0;
  $CAN_PrivFront::RFL_Obj00A::RFL_Obj00A_Height = 0;
  $CAN_PrivFront::RFL_Obj00A::RFL_Obj00A_HeightVnce = 0;
  $CAN_PrivFront::RFL_Obj00A::RFL_Obj00A_ID = 0;
  $CAN_PrivFront::RFL_Obj00A::RFL_Obj00A_Length = 0;
  $CAN_PrivFront::RFL_Obj00A::RFL_Obj00A_LengthVnce = 0;
  $CAN_PrivFront::RFL_Obj00A::RFL_Obj00A_Measured = 0;
  $CAN_PrivFront::RFL_Obj00A::RFL_Obj00A_ProbExist = 0;
  $CAN_PrivFront::RFL_Obj00A::RFL_Obj00A_ProbMobileObst = 0;
  $CAN_PrivFront::RFL_Obj00A::RFL_Obj00A_ProbNonObstacle = 0;
  $CAN_PrivFront::RFL_Obj00A::RFL_Obj00A_ProbObstacle = 0;
  $CAN_PrivFront::RFL_Obj00A::RFL_Obj00A_RefPosIndex = 0;
  $CAN_PrivFront::RFL_Obj00A::RFL_Obj00A_Valid = 0;
  $CAN_PrivFront::RFL_Obj00A::RFL_Obj00A_Vx = -128;
  $CAN_PrivFront::RFL_Obj00A::RFL_Obj00A_VxAxCoVnce = 0;
  $CAN_PrivFront::RFL_Obj00A::RFL_Obj00A_VxAyCoVnce = 0;
  $CAN_PrivFront::RFL_Obj00A::RFL_Obj00A_VxVnce = 0;
  $CAN_PrivFront::RFL_Obj00A::RFL_Obj00A_VxVyCoVnce = 0;
  $CAN_PrivFront::RFL_Obj00A::RFL_Obj00A_Vy = -64;
  $CAN_PrivFront::RFL_Obj00A::RFL_Obj00A_VyAxCoVnce = 0;
  $CAN_PrivFront::RFL_Obj00A::RFL_Obj00A_VyAyCoVnce = 0;
  }
  if(init_count == 3)
  {
  $CAN_PrivFront::RFL_Obj00A::RFL_Obj00A_VyVnce = 0;
  $CAN_PrivFront::RFL_Obj00A::RFL_Obj00A_Width = 0;
  $CAN_PrivFront::RFL_Obj00A::RFL_Obj00A_WidthVnce = 0;
  $CAN_PrivFront::RFL_Obj00B::RFL_Obj00B_BehaviorType = 0;
  $CAN_PrivFront::RFL_Obj00B::RFL_Obj00B_MovingObserved = 0;
  $CAN_PrivFront::RFL_Obj00B::RFL_Obj00B_MovingProbability = 0;
  $CAN_PrivFront::RFL_Obj00B::RFL_Obj00B_Prob4PlusWhlCAR = 0;
  $CAN_PrivFront::RFL_Obj00B::RFL_Obj00B_Prob4PlusWhlbHGV = 0;
  $CAN_PrivFront::RFL_Obj00B::RFL_Obj00B_ProbGNDReflex = 0;
  $CAN_PrivFront::RFL_Obj00B::RFL_Obj00B_ProbMob2Whl = 0;
  $CAN_PrivFront::RFL_Obj00B::RFL_Obj00B_ProbMob4PlusWhl = 0;
  $CAN_PrivFront::RFL_Obj00B::RFL_Obj00B_ProbMobPed = 0;
  $CAN_PrivFront::RFL_Obj00B::RFL_Obj00B_ProbStatBarrier = 0;
  $CAN_PrivFront::RFL_Obj00B::RFL_Obj00B_ProbStatObst = 0;
  $CAN_PrivFront::RFL_Obj01A::RFL_Obj01A_Ax = -16;
  $CAN_PrivFront::RFL_Obj01A::RFL_Obj01A_AxAyCoVnce = 0;
  $CAN_PrivFront::RFL_Obj01A::RFL_Obj01A_AxVnce = 0;
  $CAN_PrivFront::RFL_Obj01A::RFL_Obj01A_Ay = -16;
  $CAN_PrivFront::RFL_Obj01A::RFL_Obj01A_AyVnce = 0;
  $CAN_PrivFront::RFL_Obj01A::RFL_Obj01A_Dx = -256;
  $CAN_PrivFront::RFL_Obj01A::RFL_Obj01A_DxAxCoVnce = 0;
  $CAN_PrivFront::RFL_Obj01A::RFL_Obj01A_DxAyCoVnce = 0;
  $CAN_PrivFront::RFL_Obj01A::RFL_Obj01A_DxDyCoVnce = 0;
  $CAN_PrivFront::RFL_Obj01A::RFL_Obj01A_DxVnce = 0;
  $CAN_PrivFront::RFL_Obj01A::RFL_Obj01A_DxVxCoVnce = 0;
  }
  if(init_count == 4)
  {
  $CAN_PrivFront::RFL_Obj01A::RFL_Obj01A_DxVyCoVnce = 0;
  $CAN_PrivFront::RFL_Obj01A::RFL_Obj01A_Dy = -128;
  $CAN_PrivFront::RFL_Obj01A::RFL_Obj01A_DyAxCoVnce = 0;
  $CAN_PrivFront::RFL_Obj01A::RFL_Obj01A_DyAyCoVnce = 0;
  $CAN_PrivFront::RFL_Obj01A::RFL_Obj01A_DyVnce = 0;
  $CAN_PrivFront::RFL_Obj01A::RFL_Obj01A_DyVxCoVnce = 0;
  $CAN_PrivFront::RFL_Obj01A::RFL_Obj01A_DyVyCoVnce = 0;
  $CAN_PrivFront::RFL_Obj01A::RFL_Obj01A_Dz = -5;
  $CAN_PrivFront::RFL_Obj01A::RFL_Obj01A_DzVnce = 0;
  $CAN_PrivFront::RFL_Obj01A::RFL_Obj01A_HeadingYawAngle = -4.48;
  $CAN_PrivFront::RFL_Obj01A::RFL_Obj01A_HeadingYawAngleVnce = 0;
  $CAN_PrivFront::RFL_Obj01A::RFL_Obj01A_Height = 0;
  $CAN_PrivFront::RFL_Obj01A::RFL_Obj01A_HeightVnce = 0;
  $CAN_PrivFront::RFL_Obj01A::RFL_Obj01A_ID = 0;
  $CAN_PrivFront::RFL_Obj01A::RFL_Obj01A_Length = 0;
  $CAN_PrivFront::RFL_Obj01A::RFL_Obj01A_LengthVnce = 0;
  $CAN_PrivFront::RFL_Obj01A::RFL_Obj01A_Measured = 0;
  $CAN_PrivFront::RFL_Obj01A::RFL_Obj01A_ProbExist = 0;
  $CAN_PrivFront::RFL_Obj01A::RFL_Obj01A_ProbMobileObst = 0;
  $CAN_PrivFront::RFL_Obj01A::RFL_Obj01A_ProbNonObstacle = 0;
  $CAN_PrivFront::RFL_Obj01A::RFL_Obj01A_ProbObstacle = 0;
  $CAN_PrivFront::RFL_Obj01A::RFL_Obj01A_RefPosIndex = 0;
  $CAN_PrivFront::RFL_Obj01A::RFL_Obj01A_Valid = 0;
  $CAN_PrivFront::RFL_Obj01A::RFL_Obj01A_Vx = -128;
  $CAN_PrivFront::RFL_Obj01A::RFL_Obj01A_VxAxCoVnce = 0;
  }
  if(init_count == 5)
  {
  $CAN_PrivFront::RFL_Obj01A::RFL_Obj01A_VxAyCoVnce = 0;
  $CAN_PrivFront::RFL_Obj01A::RFL_Obj01A_VxVnce = 0;
  $CAN_PrivFront::RFL_Obj01A::RFL_Obj01A_VxVyCoVnce = 0;
  $CAN_PrivFront::RFL_Obj01A::RFL_Obj01A_Vy = -64;
  $CAN_PrivFront::RFL_Obj01A::RFL_Obj01A_VyAxCoVnce = 0;
  $CAN_PrivFront::RFL_Obj01A::RFL_Obj01A_VyAyCoVnce = 0;
  $CAN_PrivFront::RFL_Obj01A::RFL_Obj01A_VyVnce = 0;
  $CAN_PrivFront::RFL_Obj01A::RFL_Obj01A_Width = 0;
  $CAN_PrivFront::RFL_Obj01A::RFL_Obj01A_WidthVnce = 0;
  $CAN_PrivFront::RFL_Obj01B::RFL_Obj01B_BehaviorType = 0;
  $CAN_PrivFront::RFL_Obj01B::RFL_Obj01B_MovingObserved = 0;
  $CAN_PrivFront::RFL_Obj01B::RFL_Obj01B_MovingProbability = 0;
  $CAN_PrivFront::RFL_Obj01B::RFL_Obj01B_Prob4PlusWhlCAR = 0;
  $CAN_PrivFront::RFL_Obj01B::RFL_Obj01B_Prob4PlusWhlbHGV = 0;
  $CAN_PrivFront::RFL_Obj01B::RFL_Obj01B_ProbGNDReflex = 0;
  $CAN_PrivFront::RFL_Obj01B::RFL_Obj01B_ProbMob2Whl = 0;
  $CAN_PrivFront::RFL_Obj01B::RFL_Obj01B_ProbMob4PlusWhl = 0;
  $CAN_PrivFront::RFL_Obj01B::RFL_Obj01B_ProbMobPed = 0;
  $CAN_PrivFront::RFL_Obj01B::RFL_Obj01B_ProbStatBarrier = 0;
  $CAN_PrivFront::RFL_Obj01B::RFL_Obj01B_ProbStatObst = 0;
  $CAN_PrivFront::RFL_Obj02A::RFL_Obj02A_Ax = -16;
  $CAN_PrivFront::RFL_Obj02A::RFL_Obj02A_AxAyCoVnce = 0;
  $CAN_PrivFront::RFL_Obj02A::RFL_Obj02A_AxVnce = 0;
  $CAN_PrivFront::RFL_Obj02A::RFL_Obj02A_Ay = -16;
  $CAN_PrivFront::RFL_Obj02A::RFL_Obj02A_AyVnce = 0;
  }
  if(init_count == 6)
  {
  $CAN_PrivFront::RFL_Obj02A::RFL_Obj02A_Dx = -256;
  $CAN_PrivFront::RFL_Obj02A::RFL_Obj02A_DxAxCoVnce = 0;
  $CAN_PrivFront::RFL_Obj02A::RFL_Obj02A_DxAyCoVnce = 0;
  $CAN_PrivFront::RFL_Obj02A::RFL_Obj02A_DxDyCoVnce = 0;
  $CAN_PrivFront::RFL_Obj02A::RFL_Obj02A_DxVnce = 0;
  $CAN_PrivFront::RFL_Obj02A::RFL_Obj02A_DxVxCoVnce = 0;
  $CAN_PrivFront::RFL_Obj02A::RFL_Obj02A_DxVyCoVnce = 0;
  $CAN_PrivFront::RFL_Obj02A::RFL_Obj02A_Dy = -128;
  $CAN_PrivFront::RFL_Obj02A::RFL_Obj02A_DyAxCoVnce = 0;
  $CAN_PrivFront::RFL_Obj02A::RFL_Obj02A_DyAyCoVnce = 0;
  $CAN_PrivFront::RFL_Obj02A::RFL_Obj02A_DyVnce = 0;
  $CAN_PrivFront::RFL_Obj02A::RFL_Obj02A_DyVxCoVnce = 0;
  $CAN_PrivFront::RFL_Obj02A::RFL_Obj02A_DyVyCoVnce = 0;
  $CAN_PrivFront::RFL_Obj02A::RFL_Obj02A_Dz = -5;
  $CAN_PrivFront::RFL_Obj02A::RFL_Obj02A_DzVnce = 0;
  $CAN_PrivFront::RFL_Obj02A::RFL_Obj02A_HeadingYawAngle = -4.48;
  $CAN_PrivFront::RFL_Obj02A::RFL_Obj02A_HeadingYawAngleVnce = 0;
  $CAN_PrivFront::RFL_Obj02A::RFL_Obj02A_Height = 0;
  $CAN_PrivFront::RFL_Obj02A::RFL_Obj02A_HeightVnce = 0;
  $CAN_PrivFront::RFL_Obj02A::RFL_Obj02A_ID = 0;
  $CAN_PrivFront::RFL_Obj02A::RFL_Obj02A_Length = 0;
  $CAN_PrivFront::RFL_Obj02A::RFL_Obj02A_LengthVnce = 0;
  $CAN_PrivFront::RFL_Obj02A::RFL_Obj02A_Measured = 0;
  $CAN_PrivFront::RFL_Obj02A::RFL_Obj02A_ProbExist = 0;
  $CAN_PrivFront::RFL_Obj02A::RFL_Obj02A_ProbMobileObst = 0;
  }
  if(init_count == 7)
  {
  $CAN_PrivFront::RFL_Obj02A::RFL_Obj02A_ProbNonObstacle = 0;
  $CAN_PrivFront::RFL_Obj02A::RFL_Obj02A_ProbObstacle = 0;
  $CAN_PrivFront::RFL_Obj02A::RFL_Obj02A_RefPosIndex = 0;
  $CAN_PrivFront::RFL_Obj02A::RFL_Obj02A_Valid = 0;
  $CAN_PrivFront::RFL_Obj02A::RFL_Obj02A_Vx = -128;
  $CAN_PrivFront::RFL_Obj02A::RFL_Obj02A_VxAxCoVnce = 0;
  $CAN_PrivFront::RFL_Obj02A::RFL_Obj02A_VxAyCoVnce = 0;
  $CAN_PrivFront::RFL_Obj02A::RFL_Obj02A_VxVnce = 0;
  $CAN_PrivFront::RFL_Obj02A::RFL_Obj02A_VxVyCoVnce = 0;
  $CAN_PrivFront::RFL_Obj02A::RFL_Obj02A_Vy = -64;
  $CAN_PrivFront::RFL_Obj02A::RFL_Obj02A_VyAxCoVnce = 0;
  $CAN_PrivFront::RFL_Obj02A::RFL_Obj02A_VyAyCoVnce = 0;
  $CAN_PrivFront::RFL_Obj02A::RFL_Obj02A_VyVnce = 0;
  $CAN_PrivFront::RFL_Obj02A::RFL_Obj02A_Width = 0;
  $CAN_PrivFront::RFL_Obj02A::RFL_Obj02A_WidthVnce = 0;
  $CAN_PrivFront::RFL_Obj02B::RFL_Obj02B_BehaviorType = 0;
  $CAN_PrivFront::RFL_Obj02B::RFL_Obj02B_MovingObserved = 0;
  $CAN_PrivFront::RFL_Obj02B::RFL_Obj02B_MovingProbability = 0;
  $CAN_PrivFront::RFL_Obj02B::RFL_Obj02B_Prob4PlusWhlCAR = 0;
  $CAN_PrivFront::RFL_Obj02B::RFL_Obj02B_Prob4PlusWhlbHGV = 0;
  $CAN_PrivFront::RFL_Obj02B::RFL_Obj02B_ProbGNDReflex = 0;
  $CAN_PrivFront::RFL_Obj02B::RFL_Obj02B_ProbMob2Whl = 0;
  $CAN_PrivFront::RFL_Obj02B::RFL_Obj02B_ProbMob4PlusWhl = 0;
  $CAN_PrivFront::RFL_Obj02B::RFL_Obj02B_ProbMobPed = 0;
  $CAN_PrivFront::RFL_Obj02B::RFL_Obj02B_ProbStatBarrier = 0;
  }
  if(init_count == 8)
  {
  $CAN_PrivFront::RFL_Obj02B::RFL_Obj02B_ProbStatObst = 0;
  $CAN_PrivFront::RFL_Obj03A::RFL_Obj03A_Ax = -16;
  $CAN_PrivFront::RFL_Obj03A::RFL_Obj03A_AxAyCoVnce = 0;
  $CAN_PrivFront::RFL_Obj03A::RFL_Obj03A_AxVnce = 0;
  $CAN_PrivFront::RFL_Obj03A::RFL_Obj03A_Ay = -16;
  $CAN_PrivFront::RFL_Obj03A::RFL_Obj03A_AyVnce = 0;
  $CAN_PrivFront::RFL_Obj03A::RFL_Obj03A_Dx = -256;
  $CAN_PrivFront::RFL_Obj03A::RFL_Obj03A_DxAxCoVnce = 0;
  $CAN_PrivFront::RFL_Obj03A::RFL_Obj03A_DxAyCoVnce = 0;
  $CAN_PrivFront::RFL_Obj03A::RFL_Obj03A_DxDyCoVnce = 0;
  $CAN_PrivFront::RFL_Obj03A::RFL_Obj03A_DxVnce = 0;
  $CAN_PrivFront::RFL_Obj03A::RFL_Obj03A_DxVxCoVnce = 0;
  $CAN_PrivFront::RFL_Obj03A::RFL_Obj03A_DxVyCoVnce = 0;
  $CAN_PrivFront::RFL_Obj03A::RFL_Obj03A_Dy = -128;
  $CAN_PrivFront::RFL_Obj03A::RFL_Obj03A_DyAxCoVnce = 0;
  $CAN_PrivFront::RFL_Obj03A::RFL_Obj03A_DyAyCoVnce = 0;
  $CAN_PrivFront::RFL_Obj03A::RFL_Obj03A_DyVnce = 0;
  $CAN_PrivFront::RFL_Obj03A::RFL_Obj03A_DyVxCoVnce = 0;
  $CAN_PrivFront::RFL_Obj03A::RFL_Obj03A_DyVyCoVnce = 0;
  $CAN_PrivFront::RFL_Obj03A::RFL_Obj03A_Dz = -5;
  $CAN_PrivFront::RFL_Obj03A::RFL_Obj03A_DzVnce = 0;
  $CAN_PrivFront::RFL_Obj03A::RFL_Obj03A_HeadingYawAngle = -4.48;
  $CAN_PrivFront::RFL_Obj03A::RFL_Obj03A_HeadingYawAngleVnce = 0;
  $CAN_PrivFront::RFL_Obj03A::RFL_Obj03A_Height = 0;
  $CAN_PrivFront::RFL_Obj03A::RFL_Obj03A_HeightVnce = 0;
  }
  if(init_count == 9)
  {
  $CAN_PrivFront::RFL_Obj03A::RFL_Obj03A_ID = 0;
  $CAN_PrivFront::RFL_Obj03A::RFL_Obj03A_Length = 0;
  $CAN_PrivFront::RFL_Obj03A::RFL_Obj03A_LengthVnce = 0;
  $CAN_PrivFront::RFL_Obj03A::RFL_Obj03A_Measured = 0;
  $CAN_PrivFront::RFL_Obj03A::RFL_Obj03A_ProbExist = 0;
  $CAN_PrivFront::RFL_Obj03A::RFL_Obj03A_ProbMobileObst = 0;
  $CAN_PrivFront::RFL_Obj03A::RFL_Obj03A_ProbNonObstacle = 0;
  $CAN_PrivFront::RFL_Obj03A::RFL_Obj03A_ProbObstacle = 0;
  $CAN_PrivFront::RFL_Obj03A::RFL_Obj03A_RefPosIndex = 0;
  $CAN_PrivFront::RFL_Obj03A::RFL_Obj03A_Valid = 0;
  $CAN_PrivFront::RFL_Obj03A::RFL_Obj03A_Vx = -128;
  $CAN_PrivFront::RFL_Obj03A::RFL_Obj03A_VxAxCoVnce = 0;
  $CAN_PrivFront::RFL_Obj03A::RFL_Obj03A_VxAyCoVnce = 0;
  $CAN_PrivFront::RFL_Obj03A::RFL_Obj03A_VxVnce = 0;
  $CAN_PrivFront::RFL_Obj03A::RFL_Obj03A_VxVyCoVnce = 0;
  $CAN_PrivFront::RFL_Obj03A::RFL_Obj03A_Vy = -64;
  $CAN_PrivFront::RFL_Obj03A::RFL_Obj03A_VyAxCoVnce = 0;
  $CAN_PrivFront::RFL_Obj03A::RFL_Obj03A_VyAyCoVnce = 0;
  $CAN_PrivFront::RFL_Obj03A::RFL_Obj03A_VyVnce = 0;
  $CAN_PrivFront::RFL_Obj03A::RFL_Obj03A_Width = 0;
  $CAN_PrivFront::RFL_Obj03A::RFL_Obj03A_WidthVnce = 0;
  $CAN_PrivFront::RFL_Obj03B::RFL_Obj03B_BehaviorType = 0;
  $CAN_PrivFront::RFL_Obj03B::RFL_Obj03B_MovingObserved = 0;
  $CAN_PrivFront::RFL_Obj03B::RFL_Obj03B_MovingProbability = 0;
  $CAN_PrivFront::RFL_Obj03B::RFL_Obj03B_Prob4PlusWhlCAR = 0;
  }
  if(init_count == 10)
  {
  $CAN_PrivFront::RFL_Obj03B::RFL_Obj03B_Prob4PlusWhlbHGV = 0;
  $CAN_PrivFront::RFL_Obj03B::RFL_Obj03B_ProbGNDReflex = 0;
  $CAN_PrivFront::RFL_Obj03B::RFL_Obj03B_ProbMob2Whl = 0;
  $CAN_PrivFront::RFL_Obj03B::RFL_Obj03B_ProbMob4PlusWhl = 0;
  $CAN_PrivFront::RFL_Obj03B::RFL_Obj03B_ProbMobPed = 0;
  $CAN_PrivFront::RFL_Obj03B::RFL_Obj03B_ProbStatBarrier = 0;
  $CAN_PrivFront::RFL_Obj03B::RFL_Obj03B_ProbStatObst = 0;
  $CAN_PrivFront::RFL_Obj04A::RFL_Obj04A_Ax = -16;
  $CAN_PrivFront::RFL_Obj04A::RFL_Obj04A_AxAyCoVnce = 0;
  $CAN_PrivFront::RFL_Obj04A::RFL_Obj04A_AxVnce = 0;
  $CAN_PrivFront::RFL_Obj04A::RFL_Obj04A_Ay = -16;
  $CAN_PrivFront::RFL_Obj04A::RFL_Obj04A_AyVnce = 0;
  $CAN_PrivFront::RFL_Obj04A::RFL_Obj04A_Dx = -256;
  $CAN_PrivFront::RFL_Obj04A::RFL_Obj04A_DxAxCoVnce = 0;
  $CAN_PrivFront::RFL_Obj04A::RFL_Obj04A_DxAyCoVnce = 0;
  $CAN_PrivFront::RFL_Obj04A::RFL_Obj04A_DxDyCoVnce = 0;
  $CAN_PrivFront::RFL_Obj04A::RFL_Obj04A_DxVnce = 0;
  $CAN_PrivFront::RFL_Obj04A::RFL_Obj04A_DxVxCoVnce = 0;
  $CAN_PrivFront::RFL_Obj04A::RFL_Obj04A_DxVyCoVnce = 0;
  $CAN_PrivFront::RFL_Obj04A::RFL_Obj04A_Dy = -128;
  $CAN_PrivFront::RFL_Obj04A::RFL_Obj04A_DyAxCoVnce = 0;
  $CAN_PrivFront::RFL_Obj04A::RFL_Obj04A_DyAyCoVnce = 0;
  $CAN_PrivFront::RFL_Obj04A::RFL_Obj04A_DyVnce = 0;
  $CAN_PrivFront::RFL_Obj04A::RFL_Obj04A_DyVxCoVnce = 0;
  $CAN_PrivFront::RFL_Obj04A::RFL_Obj04A_DyVyCoVnce = 0;
  }
  if(init_count == 11)
  {
  $CAN_PrivFront::RFL_Obj04A::RFL_Obj04A_Dz = -5;
  $CAN_PrivFront::RFL_Obj04A::RFL_Obj04A_DzVnce = 0;
  $CAN_PrivFront::RFL_Obj04A::RFL_Obj04A_HeadingYawAngle = -4.48;
  $CAN_PrivFront::RFL_Obj04A::RFL_Obj04A_HeadingYawAngleVnce = 0;
  $CAN_PrivFront::RFL_Obj04A::RFL_Obj04A_Height = 0;
  $CAN_PrivFront::RFL_Obj04A::RFL_Obj04A_HeightVnce = 0;
  $CAN_PrivFront::RFL_Obj04A::RFL_Obj04A_ID = 0;
  $CAN_PrivFront::RFL_Obj04A::RFL_Obj04A_Length = 0;
  $CAN_PrivFront::RFL_Obj04A::RFL_Obj04A_LengthVnce = 0;
  $CAN_PrivFront::RFL_Obj04A::RFL_Obj04A_Measured = 0;
  $CAN_PrivFront::RFL_Obj04A::RFL_Obj04A_ProbExist = 0;
  $CAN_PrivFront::RFL_Obj04A::RFL_Obj04A_ProbMobileObst = 0;
  $CAN_PrivFront::RFL_Obj04A::RFL_Obj04A_ProbNonObstacle = 0;
  $CAN_PrivFront::RFL_Obj04A::RFL_Obj04A_ProbObstacle = 0;
  $CAN_PrivFront::RFL_Obj04A::RFL_Obj04A_RefPosIndex = 0;
  $CAN_PrivFront::RFL_Obj04A::RFL_Obj04A_Valid = 0;
  $CAN_PrivFront::RFL_Obj04A::RFL_Obj04A_Vx = -128;
  $CAN_PrivFront::RFL_Obj04A::RFL_Obj04A_VxAxCoVnce = 0;
  $CAN_PrivFront::RFL_Obj04A::RFL_Obj04A_VxAyCoVnce = 0;
  $CAN_PrivFront::RFL_Obj04A::RFL_Obj04A_VxVnce = 0;
  $CAN_PrivFront::RFL_Obj04A::RFL_Obj04A_VxVyCoVnce = 0;
  $CAN_PrivFront::RFL_Obj04A::RFL_Obj04A_Vy = -64;
  $CAN_PrivFront::RFL_Obj04A::RFL_Obj04A_VyAxCoVnce = 0;
  $CAN_PrivFront::RFL_Obj04A::RFL_Obj04A_VyAyCoVnce = 0;
  $CAN_PrivFront::RFL_Obj04A::RFL_Obj04A_VyVnce = 0;
  }
  if(init_count == 12)
  {
  $CAN_PrivFront::RFL_Obj04A::RFL_Obj04A_Width = 0;
  $CAN_PrivFront::RFL_Obj04A::RFL_Obj04A_WidthVnce = 0;
  $CAN_PrivFront::RFL_Obj04B::RFL_Obj04B_BehaviorType = 0;
  $CAN_PrivFront::RFL_Obj04B::RFL_Obj04B_MovingObserved = 0;
  $CAN_PrivFront::RFL_Obj04B::RFL_Obj04B_MovingProbability = 0;
  $CAN_PrivFront::RFL_Obj04B::RFL_Obj04B_Prob4PlusWhlCAR = 0;
  $CAN_PrivFront::RFL_Obj04B::RFL_Obj04B_Prob4PlusWhlbHGV = 0;
  $CAN_PrivFront::RFL_Obj04B::RFL_Obj04B_ProbGNDReflex = 0;
  $CAN_PrivFront::RFL_Obj04B::RFL_Obj04B_ProbMob2Whl = 0;
  $CAN_PrivFront::RFL_Obj04B::RFL_Obj04B_ProbMob4PlusWhl = 0;
  $CAN_PrivFront::RFL_Obj04B::RFL_Obj04B_ProbMobPed = 0;
  $CAN_PrivFront::RFL_Obj04B::RFL_Obj04B_ProbStatBarrier = 0;
  $CAN_PrivFront::RFL_Obj04B::RFL_Obj04B_ProbStatObst = 0;
  $CAN_PrivFront::RFL_Obj05A::RFL_Obj05A_Ax = -16;
  $CAN_PrivFront::RFL_Obj05A::RFL_Obj05A_AxAyCoVnce = 0;
  $CAN_PrivFront::RFL_Obj05A::RFL_Obj05A_AxVnce = 0;
  $CAN_PrivFront::RFL_Obj05A::RFL_Obj05A_Ay = -16;
  $CAN_PrivFront::RFL_Obj05A::RFL_Obj05A_AyVnce = 0;
  $CAN_PrivFront::RFL_Obj05A::RFL_Obj05A_Dx = -256;
  $CAN_PrivFront::RFL_Obj05A::RFL_Obj05A_DxAxCoVnce = 0;
  $CAN_PrivFront::RFL_Obj05A::RFL_Obj05A_DxAyCoVnce = 0;
  $CAN_PrivFront::RFL_Obj05A::RFL_Obj05A_DxDyCoVnce = 0;
  $CAN_PrivFront::RFL_Obj05A::RFL_Obj05A_DxVnce = 0;
  $CAN_PrivFront::RFL_Obj05A::RFL_Obj05A_DxVxCoVnce = 0;
  $CAN_PrivFront::RFL_Obj05A::RFL_Obj05A_DxVyCoVnce = 0;
  }
  if(init_count == 13)
  {
  $CAN_PrivFront::RFL_Obj05A::RFL_Obj05A_Dy = -128;
  $CAN_PrivFront::RFL_Obj05A::RFL_Obj05A_DyAxCoVnce = 0;
  $CAN_PrivFront::RFL_Obj05A::RFL_Obj05A_DyAyCoVnce = 0;
  $CAN_PrivFront::RFL_Obj05A::RFL_Obj05A_DyVnce = 0;
  $CAN_PrivFront::RFL_Obj05A::RFL_Obj05A_DyVxCoVnce = 0;
  $CAN_PrivFront::RFL_Obj05A::RFL_Obj05A_DyVyCoVnce = 0;
  $CAN_PrivFront::RFL_Obj05A::RFL_Obj05A_Dz = -5;
  $CAN_PrivFront::RFL_Obj05A::RFL_Obj05A_DzVnce = 0;
  $CAN_PrivFront::RFL_Obj05A::RFL_Obj05A_HeadingYawAngle = -4.48;
  $CAN_PrivFront::RFL_Obj05A::RFL_Obj05A_HeadingYawAngleVnce = 0;
  $CAN_PrivFront::RFL_Obj05A::RFL_Obj05A_Height = 0;
  $CAN_PrivFront::RFL_Obj05A::RFL_Obj05A_HeightVnce = 0;
  $CAN_PrivFront::RFL_Obj05A::RFL_Obj05A_ID = 0;
  $CAN_PrivFront::RFL_Obj05A::RFL_Obj05A_Length = 0;
  $CAN_PrivFront::RFL_Obj05A::RFL_Obj05A_LengthVnce = 0;
  $CAN_PrivFront::RFL_Obj05A::RFL_Obj05A_Measured = 0;
  $CAN_PrivFront::RFL_Obj05A::RFL_Obj05A_ProbExist = 0;
  $CAN_PrivFront::RFL_Obj05A::RFL_Obj05A_ProbMobileObst = 0;
  $CAN_PrivFront::RFL_Obj05A::RFL_Obj05A_ProbNonObstacle = 0;
  $CAN_PrivFront::RFL_Obj05A::RFL_Obj05A_ProbObstacle = 0;
  $CAN_PrivFront::RFL_Obj05A::RFL_Obj05A_RefPosIndex = 0;
  $CAN_PrivFront::RFL_Obj05A::RFL_Obj05A_Valid = 0;
  $CAN_PrivFront::RFL_Obj05A::RFL_Obj05A_Vx = -128;
  $CAN_PrivFront::RFL_Obj05A::RFL_Obj05A_VxAxCoVnce = 0;
  $CAN_PrivFront::RFL_Obj05A::RFL_Obj05A_VxAyCoVnce = 0;
  }
  if(init_count == 14)
  {
  $CAN_PrivFront::RFL_Obj05A::RFL_Obj05A_VxVnce = 0;
  $CAN_PrivFront::RFL_Obj05A::RFL_Obj05A_VxVyCoVnce = 0;
  $CAN_PrivFront::RFL_Obj05A::RFL_Obj05A_Vy = -64;
  $CAN_PrivFront::RFL_Obj05A::RFL_Obj05A_VyAxCoVnce = 0;
  $CAN_PrivFront::RFL_Obj05A::RFL_Obj05A_VyAyCoVnce = 0;
  $CAN_PrivFront::RFL_Obj05A::RFL_Obj05A_VyVnce = 0;
  $CAN_PrivFront::RFL_Obj05A::RFL_Obj05A_Width = 0;
  $CAN_PrivFront::RFL_Obj05A::RFL_Obj05A_WidthVnce = 0;
  $CAN_PrivFront::RFL_Obj05B::RFL_Obj05B_BehaviorType = 0;
  $CAN_PrivFront::RFL_Obj05B::RFL_Obj05B_MovingObserved = 0;
  $CAN_PrivFront::RFL_Obj05B::RFL_Obj05B_MovingProbability = 0;
  $CAN_PrivFront::RFL_Obj05B::RFL_Obj05B_Prob4PlusWhlCAR = 0;
  $CAN_PrivFront::RFL_Obj05B::RFL_Obj05B_Prob4PlusWhlbHGV = 0;
  $CAN_PrivFront::RFL_Obj05B::RFL_Obj05B_ProbGNDReflex = 0;
  $CAN_PrivFront::RFL_Obj05B::RFL_Obj05B_ProbMob2Whl = 0;
  $CAN_PrivFront::RFL_Obj05B::RFL_Obj05B_ProbMob4PlusWhl = 0;
  $CAN_PrivFront::RFL_Obj05B::RFL_Obj05B_ProbMobPed = 0;
  $CAN_PrivFront::RFL_Obj05B::RFL_Obj05B_ProbStatBarrier = 0;
  $CAN_PrivFront::RFL_Obj05B::RFL_Obj05B_ProbStatObst = 0;
  $CAN_PrivFront::RFL_Obj06A::RFL_Obj06A_Ax = -16;
  $CAN_PrivFront::RFL_Obj06A::RFL_Obj06A_AxAyCoVnce = 0;
  $CAN_PrivFront::RFL_Obj06A::RFL_Obj06A_AxVnce = 0;
  $CAN_PrivFront::RFL_Obj06A::RFL_Obj06A_Ay = -16;
  $CAN_PrivFront::RFL_Obj06A::RFL_Obj06A_AyVnce = 0;
  $CAN_PrivFront::RFL_Obj06A::RFL_Obj06A_Dx = -256;
  }
  if(init_count == 15)
  {
  $CAN_PrivFront::RFL_Obj06A::RFL_Obj06A_DxAxCoVnce = 0;
  $CAN_PrivFront::RFL_Obj06A::RFL_Obj06A_DxAyCoVnce = 0;
  $CAN_PrivFront::RFL_Obj06A::RFL_Obj06A_DxDyCoVnce = 0;
  $CAN_PrivFront::RFL_Obj06A::RFL_Obj06A_DxVnce = 0;
  $CAN_PrivFront::RFL_Obj06A::RFL_Obj06A_DxVxCoVnce = 0;
  $CAN_PrivFront::RFL_Obj06A::RFL_Obj06A_DxVyCoVnce = 0;
  $CAN_PrivFront::RFL_Obj06A::RFL_Obj06A_Dy = -128;
  $CAN_PrivFront::RFL_Obj06A::RFL_Obj06A_DyAxCoVnce = 0;
  $CAN_PrivFront::RFL_Obj06A::RFL_Obj06A_DyAyCoVnce = 0;
  $CAN_PrivFront::RFL_Obj06A::RFL_Obj06A_DyVnce = 0;
  $CAN_PrivFront::RFL_Obj06A::RFL_Obj06A_DyVxCoVnce = 0;
  $CAN_PrivFront::RFL_Obj06A::RFL_Obj06A_DyVyCoVnce = 0;
  $CAN_PrivFront::RFL_Obj06A::RFL_Obj06A_Dz = -5;
  $CAN_PrivFront::RFL_Obj06A::RFL_Obj06A_DzVnce = 0;
  $CAN_PrivFront::RFL_Obj06A::RFL_Obj06A_HeadingYawAngle = -4.48;
  $CAN_PrivFront::RFL_Obj06A::RFL_Obj06A_HeadingYawAngleVnce = 0;
  $CAN_PrivFront::RFL_Obj06A::RFL_Obj06A_Height = 0;
  $CAN_PrivFront::RFL_Obj06A::RFL_Obj06A_HeightVnce = 0;
  $CAN_PrivFront::RFL_Obj06A::RFL_Obj06A_ID = 0;
  $CAN_PrivFront::RFL_Obj06A::RFL_Obj06A_Length = 0;
  $CAN_PrivFront::RFL_Obj06A::RFL_Obj06A_LengthVnce = 0;
  $CAN_PrivFront::RFL_Obj06A::RFL_Obj06A_Measured = 0;
  $CAN_PrivFront::RFL_Obj06A::RFL_Obj06A_ProbExist = 0;
  $CAN_PrivFront::RFL_Obj06A::RFL_Obj06A_ProbMobileObst = 0;
  $CAN_PrivFront::RFL_Obj06A::RFL_Obj06A_ProbNonObstacle = 0;
  }
  if(init_count == 16)
  {
  $CAN_PrivFront::RFL_Obj06A::RFL_Obj06A_ProbObstacle = 0;
  $CAN_PrivFront::RFL_Obj06A::RFL_Obj06A_RefPosIndex = 0;
  $CAN_PrivFront::RFL_Obj06A::RFL_Obj06A_Valid = 0;
  $CAN_PrivFront::RFL_Obj06A::RFL_Obj06A_Vx = -128;
  $CAN_PrivFront::RFL_Obj06A::RFL_Obj06A_VxAxCoVnce = 0;
  $CAN_PrivFront::RFL_Obj06A::RFL_Obj06A_VxAyCoVnce = 0;
  $CAN_PrivFront::RFL_Obj06A::RFL_Obj06A_VxVnce = 0;
  $CAN_PrivFront::RFL_Obj06A::RFL_Obj06A_VxVyCoVnce = 0;
  $CAN_PrivFront::RFL_Obj06A::RFL_Obj06A_Vy = -64;
  $CAN_PrivFront::RFL_Obj06A::RFL_Obj06A_VyAxCoVnce = 0;
  $CAN_PrivFront::RFL_Obj06A::RFL_Obj06A_VyAyCoVnce = 0;
  $CAN_PrivFront::RFL_Obj06A::RFL_Obj06A_VyVnce = 0;
  $CAN_PrivFront::RFL_Obj06A::RFL_Obj06A_Width = 0;
  $CAN_PrivFront::RFL_Obj06A::RFL_Obj06A_WidthVnce = 0;
  $CAN_PrivFront::RFL_Obj06B::RFL_Obj06B_BehaviorType = 0;
  $CAN_PrivFront::RFL_Obj06B::RFL_Obj06B_MovingObserved = 0;
  $CAN_PrivFront::RFL_Obj06B::RFL_Obj06B_MovingProbability = 0;
  $CAN_PrivFront::RFL_Obj06B::RFL_Obj06B_Prob4PlusWhlCAR = 0;
  $CAN_PrivFront::RFL_Obj06B::RFL_Obj06B_Prob4PlusWhlbHGV = 0;
  $CAN_PrivFront::RFL_Obj06B::RFL_Obj06B_ProbGNDReflex = 0;
  $CAN_PrivFront::RFL_Obj06B::RFL_Obj06B_ProbMob2Whl = 0;
  $CAN_PrivFront::RFL_Obj06B::RFL_Obj06B_ProbMob4PlusWhl = 0;
  $CAN_PrivFront::RFL_Obj06B::RFL_Obj06B_ProbMobPed = 0;
  $CAN_PrivFront::RFL_Obj06B::RFL_Obj06B_ProbStatBarrier = 0;
  $CAN_PrivFront::RFL_Obj06B::RFL_Obj06B_ProbStatObst = 0;
  }
  if(init_count == 17)
  {
  $CAN_PrivFront::RFL_Obj07A::RFL_Obj07A_Ax = -16;
  $CAN_PrivFront::RFL_Obj07A::RFL_Obj07A_AxAyCoVnce = 0;
  $CAN_PrivFront::RFL_Obj07A::RFL_Obj07A_AxVnce = 0;
  $CAN_PrivFront::RFL_Obj07A::RFL_Obj07A_Ay = -16;
  $CAN_PrivFront::RFL_Obj07A::RFL_Obj07A_AyVnce = 0;
  $CAN_PrivFront::RFL_Obj07A::RFL_Obj07A_Dx = -256;
  $CAN_PrivFront::RFL_Obj07A::RFL_Obj07A_DxAxCoVnce = 0;
  $CAN_PrivFront::RFL_Obj07A::RFL_Obj07A_DxAyCoVnce = 0;
  $CAN_PrivFront::RFL_Obj07A::RFL_Obj07A_DxDyCoVnce = 0;
  $CAN_PrivFront::RFL_Obj07A::RFL_Obj07A_DxVnce = 0;
  $CAN_PrivFront::RFL_Obj07A::RFL_Obj07A_DxVxCoVnce = 0;
  $CAN_PrivFront::RFL_Obj07A::RFL_Obj07A_DxVyCoVnce = 0;
  $CAN_PrivFront::RFL_Obj07A::RFL_Obj07A_Dy = -128;
  $CAN_PrivFront::RFL_Obj07A::RFL_Obj07A_DyAxCoVnce = 0;
  $CAN_PrivFront::RFL_Obj07A::RFL_Obj07A_DyAyCoVnce = 0;
  $CAN_PrivFront::RFL_Obj07A::RFL_Obj07A_DyVnce = 0;
  $CAN_PrivFront::RFL_Obj07A::RFL_Obj07A_DyVxCoVnce = 0;
  $CAN_PrivFront::RFL_Obj07A::RFL_Obj07A_DyVyCoVnce = 0;
  $CAN_PrivFront::RFL_Obj07A::RFL_Obj07A_Dz = -5;
  $CAN_PrivFront::RFL_Obj07A::RFL_Obj07A_DzVnce = 0;
  $CAN_PrivFront::RFL_Obj07A::RFL_Obj07A_HeadingYawAngle = -4.48;
  $CAN_PrivFront::RFL_Obj07A::RFL_Obj07A_HeadingYawAngleVnce = 0;
  $CAN_PrivFront::RFL_Obj07A::RFL_Obj07A_Height = 0;
  $CAN_PrivFront::RFL_Obj07A::RFL_Obj07A_HeightVnce = 0;
  $CAN_PrivFront::RFL_Obj07A::RFL_Obj07A_ID = 0;
  }
  if(init_count == 18)
  {
  $CAN_PrivFront::RFL_Obj07A::RFL_Obj07A_Length = 0;
  $CAN_PrivFront::RFL_Obj07A::RFL_Obj07A_LengthVnce = 0;
  $CAN_PrivFront::RFL_Obj07A::RFL_Obj07A_Measured = 0;
  $CAN_PrivFront::RFL_Obj07A::RFL_Obj07A_ProbExist = 0;
  $CAN_PrivFront::RFL_Obj07A::RFL_Obj07A_ProbMobileObst = 0;
  $CAN_PrivFront::RFL_Obj07A::RFL_Obj07A_ProbNonObstacle = 0;
  $CAN_PrivFront::RFL_Obj07A::RFL_Obj07A_ProbObstacle = 0;
  $CAN_PrivFront::RFL_Obj07A::RFL_Obj07A_RefPosIndex = 0;
  $CAN_PrivFront::RFL_Obj07A::RFL_Obj07A_Valid = 0;
  $CAN_PrivFront::RFL_Obj07A::RFL_Obj07A_Vx = -128;
  $CAN_PrivFront::RFL_Obj07A::RFL_Obj07A_VxAxCoVnce = 0;
  $CAN_PrivFront::RFL_Obj07A::RFL_Obj07A_VxAyCoVnce = 0;
  $CAN_PrivFront::RFL_Obj07A::RFL_Obj07A_VxVnce = 0;
  $CAN_PrivFront::RFL_Obj07A::RFL_Obj07A_VxVyCoVnce = 0;
  $CAN_PrivFront::RFL_Obj07A::RFL_Obj07A_Vy = -64;
  $CAN_PrivFront::RFL_Obj07A::RFL_Obj07A_VyAxCoVnce = 0;
  $CAN_PrivFront::RFL_Obj07A::RFL_Obj07A_VyAyCoVnce = 0;
  $CAN_PrivFront::RFL_Obj07A::RFL_Obj07A_VyVnce = 0;
  $CAN_PrivFront::RFL_Obj07A::RFL_Obj07A_Width = 0;
  $CAN_PrivFront::RFL_Obj07A::RFL_Obj07A_WidthVnce = 0;
  $CAN_PrivFront::RFL_Obj07B::RFL_Obj07B_BehaviorType = 0;
  $CAN_PrivFront::RFL_Obj07B::RFL_Obj07B_MovingObserved = 0;
  $CAN_PrivFront::RFL_Obj07B::RFL_Obj07B_MovingProbability = 0;
  $CAN_PrivFront::RFL_Obj07B::RFL_Obj07B_Prob4PlusWhlCAR = 0;
  $CAN_PrivFront::RFL_Obj07B::RFL_Obj07B_Prob4PlusWhlbHGV = 0;
  }
  if(init_count == 19)
  {
  $CAN_PrivFront::RFL_Obj07B::RFL_Obj07B_ProbGNDReflex = 0;
  $CAN_PrivFront::RFL_Obj07B::RFL_Obj07B_ProbMob2Whl = 0;
  $CAN_PrivFront::RFL_Obj07B::RFL_Obj07B_ProbMob4PlusWhl = 0;
  $CAN_PrivFront::RFL_Obj07B::RFL_Obj07B_ProbMobPed = 0;
  $CAN_PrivFront::RFL_Obj07B::RFL_Obj07B_ProbStatBarrier = 0;
  $CAN_PrivFront::RFL_Obj07B::RFL_Obj07B_ProbStatObst = 0;
  $CAN_PrivFront::RFL_Obj08A::RFL_Obj08A_Ax = -16;
  $CAN_PrivFront::RFL_Obj08A::RFL_Obj08A_AxAyCoVnce = 0;
  $CAN_PrivFront::RFL_Obj08A::RFL_Obj08A_AxVnce = 0;
  $CAN_PrivFront::RFL_Obj08A::RFL_Obj08A_Ay = -16;
  $CAN_PrivFront::RFL_Obj08A::RFL_Obj08A_AyVnce = 0;
  $CAN_PrivFront::RFL_Obj08A::RFL_Obj08A_Dx = -256;
  $CAN_PrivFront::RFL_Obj08A::RFL_Obj08A_DxAxCoVnce = 0;
  $CAN_PrivFront::RFL_Obj08A::RFL_Obj08A_DxAyCoVnce = 0;
  $CAN_PrivFront::RFL_Obj08A::RFL_Obj08A_DxDyCoVnce = 0;
  $CAN_PrivFront::RFL_Obj08A::RFL_Obj08A_DxVnce = 0;
  $CAN_PrivFront::RFL_Obj08A::RFL_Obj08A_DxVxCoVnce = 0;
  $CAN_PrivFront::RFL_Obj08A::RFL_Obj08A_DxVyCoVnce = 0;
  $CAN_PrivFront::RFL_Obj08A::RFL_Obj08A_Dy = -128;
  $CAN_PrivFront::RFL_Obj08A::RFL_Obj08A_DyAxCoVnce = 0;
  $CAN_PrivFront::RFL_Obj08A::RFL_Obj08A_DyAyCoVnce = 0;
  $CAN_PrivFront::RFL_Obj08A::RFL_Obj08A_DyVnce = 0;
  $CAN_PrivFront::RFL_Obj08A::RFL_Obj08A_DyVxCoVnce = 0;
  $CAN_PrivFront::RFL_Obj08A::RFL_Obj08A_DyVyCoVnce = 0;
  $CAN_PrivFront::RFL_Obj08A::RFL_Obj08A_Dz = -5;
  }
  if(init_count == 20)
  {
  $CAN_PrivFront::RFL_Obj08A::RFL_Obj08A_DzVnce = 0;
  $CAN_PrivFront::RFL_Obj08A::RFL_Obj08A_HeadingYawAngle = -4.48;
  $CAN_PrivFront::RFL_Obj08A::RFL_Obj08A_HeadingYawAngleVnce = 0;
  $CAN_PrivFront::RFL_Obj08A::RFL_Obj08A_Height = 0;
  $CAN_PrivFront::RFL_Obj08A::RFL_Obj08A_HeightVnce = 0;
  $CAN_PrivFront::RFL_Obj08A::RFL_Obj08A_ID = 0;
  $CAN_PrivFront::RFL_Obj08A::RFL_Obj08A_Length = 0;
  $CAN_PrivFront::RFL_Obj08A::RFL_Obj08A_LengthVnce = 0;
  $CAN_PrivFront::RFL_Obj08A::RFL_Obj08A_Measured = 0;
  $CAN_PrivFront::RFL_Obj08A::RFL_Obj08A_ProbExist = 0;
  $CAN_PrivFront::RFL_Obj08A::RFL_Obj08A_ProbMobileObst = 0;
  $CAN_PrivFront::RFL_Obj08A::RFL_Obj08A_ProbNonObstacle = 0;
  $CAN_PrivFront::RFL_Obj08A::RFL_Obj08A_ProbObstacle = 0;
  $CAN_PrivFront::RFL_Obj08A::RFL_Obj08A_RefPosIndex = 0;
  $CAN_PrivFront::RFL_Obj08A::RFL_Obj08A_Valid = 0;
  $CAN_PrivFront::RFL_Obj08A::RFL_Obj08A_Vx = -128;
  $CAN_PrivFront::RFL_Obj08A::RFL_Obj08A_VxAxCoVnce = 0;
  $CAN_PrivFront::RFL_Obj08A::RFL_Obj08A_VxAyCoVnce = 0;
  $CAN_PrivFront::RFL_Obj08A::RFL_Obj08A_VxVnce = 0;
  $CAN_PrivFront::RFL_Obj08A::RFL_Obj08A_VxVyCoVnce = 0;
  $CAN_PrivFront::RFL_Obj08A::RFL_Obj08A_Vy = -64;
  $CAN_PrivFront::RFL_Obj08A::RFL_Obj08A_VyAxCoVnce = 0;
  $CAN_PrivFront::RFL_Obj08A::RFL_Obj08A_VyAyCoVnce = 0;
  $CAN_PrivFront::RFL_Obj08A::RFL_Obj08A_VyVnce = 0;
  $CAN_PrivFront::RFL_Obj08A::RFL_Obj08A_Width = 0;
  }
  if(init_count == 21)
  {
  $CAN_PrivFront::RFL_Obj08A::RFL_Obj08A_WidthVnce = 0;
  $CAN_PrivFront::RFL_Obj08B::RFL_Obj08B_BehaviorType = 0;
  $CAN_PrivFront::RFL_Obj08B::RFL_Obj08B_MovingObserved = 0;
  $CAN_PrivFront::RFL_Obj08B::RFL_Obj08B_MovingProbability = 0;
  $CAN_PrivFront::RFL_Obj08B::RFL_Obj08B_Prob4PlusWhlCAR = 0;
  $CAN_PrivFront::RFL_Obj08B::RFL_Obj08B_Prob4PlusWhlbHGV = 0;
  $CAN_PrivFront::RFL_Obj08B::RFL_Obj08B_ProbGNDReflex = 0;
  $CAN_PrivFront::RFL_Obj08B::RFL_Obj08B_ProbMob2Whl = 0;
  $CAN_PrivFront::RFL_Obj08B::RFL_Obj08B_ProbMob4PlusWhl = 0;
  $CAN_PrivFront::RFL_Obj08B::RFL_Obj08B_ProbMobPed = 0;
  $CAN_PrivFront::RFL_Obj08B::RFL_Obj08B_ProbStatBarrier = 0;
  $CAN_PrivFront::RFL_Obj08B::RFL_Obj08B_ProbStatObst = 0;
  $CAN_PrivFront::RFL_Obj09A::RFL_Obj09A_Ax = -16;
  $CAN_PrivFront::RFL_Obj09A::RFL_Obj09A_AxAyCoVnce = 0;
  $CAN_PrivFront::RFL_Obj09A::RFL_Obj09A_AxVnce = 0;
  $CAN_PrivFront::RFL_Obj09A::RFL_Obj09A_Ay = -16;
  $CAN_PrivFront::RFL_Obj09A::RFL_Obj09A_AyVnce = 0;
  $CAN_PrivFront::RFL_Obj09A::RFL_Obj09A_Dx = -256;
  $CAN_PrivFront::RFL_Obj09A::RFL_Obj09A_DxAxCoVnce = 0;
  $CAN_PrivFront::RFL_Obj09A::RFL_Obj09A_DxAyCoVnce = 0;
  $CAN_PrivFront::RFL_Obj09A::RFL_Obj09A_DxDyCoVnce = 0;
  $CAN_PrivFront::RFL_Obj09A::RFL_Obj09A_DxVnce = 0;
  $CAN_PrivFront::RFL_Obj09A::RFL_Obj09A_DxVxCoVnce = 0;
  $CAN_PrivFront::RFL_Obj09A::RFL_Obj09A_DxVyCoVnce = 0;
  $CAN_PrivFront::RFL_Obj09A::RFL_Obj09A_Dy = -128;
  }
  if(init_count == 22)
  {
  $CAN_PrivFront::RFL_Obj09A::RFL_Obj09A_DyAxCoVnce = 0;
  $CAN_PrivFront::RFL_Obj09A::RFL_Obj09A_DyAyCoVnce = 0;
  $CAN_PrivFront::RFL_Obj09A::RFL_Obj09A_DyVnce = 0;
  $CAN_PrivFront::RFL_Obj09A::RFL_Obj09A_DyVxCoVnce = 0;
  $CAN_PrivFront::RFL_Obj09A::RFL_Obj09A_DyVyCoVnce = 0;
  $CAN_PrivFront::RFL_Obj09A::RFL_Obj09A_Dz = -5;
  $CAN_PrivFront::RFL_Obj09A::RFL_Obj09A_DzVnce = 0;
  $CAN_PrivFront::RFL_Obj09A::RFL_Obj09A_HeadingYawAngle = -4.48;
  $CAN_PrivFront::RFL_Obj09A::RFL_Obj09A_HeadingYawAngleVnce = 0;
  $CAN_PrivFront::RFL_Obj09A::RFL_Obj09A_Height = 0;
  $CAN_PrivFront::RFL_Obj09A::RFL_Obj09A_HeightVnce = 0;
  $CAN_PrivFront::RFL_Obj09A::RFL_Obj09A_ID = 0;
  $CAN_PrivFront::RFL_Obj09A::RFL_Obj09A_Length = 0;
  $CAN_PrivFront::RFL_Obj09A::RFL_Obj09A_LengthVnce = 0;
  $CAN_PrivFront::RFL_Obj09A::RFL_Obj09A_Measured = 0;
  $CAN_PrivFront::RFL_Obj09A::RFL_Obj09A_ProbExist = 0;
  $CAN_PrivFront::RFL_Obj09A::RFL_Obj09A_ProbMobileObst = 0;
  $CAN_PrivFront::RFL_Obj09A::RFL_Obj09A_ProbNonObstacle = 0;
  $CAN_PrivFront::RFL_Obj09A::RFL_Obj09A_ProbObstacle = 0;
  $CAN_PrivFront::RFL_Obj09A::RFL_Obj09A_RefPosIndex = 0;
  $CAN_PrivFront::RFL_Obj09A::RFL_Obj09A_Valid = 0;
  $CAN_PrivFront::RFL_Obj09A::RFL_Obj09A_Vx = -128;
  $CAN_PrivFront::RFL_Obj09A::RFL_Obj09A_VxAxCoVnce = 0;
  $CAN_PrivFront::RFL_Obj09A::RFL_Obj09A_VxAyCoVnce = 0;
  $CAN_PrivFront::RFL_Obj09A::RFL_Obj09A_VxVnce = 0;
  }
  if(init_count == 23)
  {
  $CAN_PrivFront::RFL_Obj09A::RFL_Obj09A_VxVyCoVnce = 0;
  $CAN_PrivFront::RFL_Obj09A::RFL_Obj09A_Vy = -64;
  $CAN_PrivFront::RFL_Obj09A::RFL_Obj09A_VyAxCoVnce = 0;
  $CAN_PrivFront::RFL_Obj09A::RFL_Obj09A_VyAyCoVnce = 0;
  $CAN_PrivFront::RFL_Obj09A::RFL_Obj09A_VyVnce = 0;
  $CAN_PrivFront::RFL_Obj09A::RFL_Obj09A_Width = 0;
  $CAN_PrivFront::RFL_Obj09A::RFL_Obj09A_WidthVnce = 0;
  $CAN_PrivFront::RFL_Obj09B::RFL_Obj09B_BehaviorType = 0;
  $CAN_PrivFront::RFL_Obj09B::RFL_Obj09B_MovingObserved = 0;
  $CAN_PrivFront::RFL_Obj09B::RFL_Obj09B_MovingProbability = 0;
  $CAN_PrivFront::RFL_Obj09B::RFL_Obj09B_Prob4PlusWhlCAR = 0;
  $CAN_PrivFront::RFL_Obj09B::RFL_Obj09B_Prob4PlusWhlbHGV = 0;
  $CAN_PrivFront::RFL_Obj09B::RFL_Obj09B_ProbGNDReflex = 0;
  $CAN_PrivFront::RFL_Obj09B::RFL_Obj09B_ProbMob2Whl = 0;
  $CAN_PrivFront::RFL_Obj09B::RFL_Obj09B_ProbMob4PlusWhl = 0;
  $CAN_PrivFront::RFL_Obj09B::RFL_Obj09B_ProbMobPed = 0;
  $CAN_PrivFront::RFL_Obj09B::RFL_Obj09B_ProbStatBarrier = 0;
  $CAN_PrivFront::RFL_Obj09B::RFL_Obj09B_ProbStatObst = 0;
  $CAN_PrivFront::RFL_ObjHdr::RFL_ObjHdr_AziOutOfSpec = 0;
  $CAN_PrivFront::RFL_ObjHdr::RFL_ObjHdr_DetectionRange = 300;
  $CAN_PrivFront::RFL_ObjHdr::RFL_ObjHdr_ElevOutOfSpec = 0;
  $CAN_PrivFront::RFL_ObjHdr::RFL_ObjHdr_MountPosX = 3.298;
  $CAN_PrivFront::RFL_ObjHdr::RFL_ObjHdr_MountPosY = 0.774;
  $CAN_PrivFront::RFL_ObjHdr::RFL_ObjHdr_MountPosZ = 0.5;
  $CAN_PrivFront::RFL_ObjHdr::RFL_ObjHdr_ObjectDownSel = 0;
  }
  if(init_count == 24)
  {
  $CAN_PrivFront::RFL_ObjHdr::RFL_ObjHdr_PitchAngleLower = -0.2618;
  $CAN_PrivFront::RFL_ObjHdr::RFL_ObjHdr_PitchAngleUpper = 0.26163;
  $CAN_PrivFront::RFL_ObjHdr::RFL_ObjHdr_PitchMountAngle = 0.01326;
  $CAN_PrivFront::RFL_ObjHdr::RFL_ObjHdr_ProtObjectCount = 0;
  $CAN_PrivFront::RFL_ObjHdr::RFL_ObjHdr_ProtRSBPointCount = 0;
  $CAN_PrivFront::RFL_ObjHdr::RFL_ObjHdr_ProtRSBSegmentCount = 0;
  $CAN_PrivFront::RFL_ObjHdr::RFL_ObjHdr_ProtocolVersion = 263;
  $CAN_PrivFront::RFL_ObjHdr::RFL_ObjHdr_RollMountAngle = 0;
  $CAN_PrivFront::RFL_ObjHdr::RFL_ObjHdr_SensorState = 0;
  $CAN_PrivFront::RFL_ObjHdr::RFL_ObjHdr_TimeStamp = 0;
  $CAN_PrivFront::RFL_ObjHdr::RFL_ObjHdr_TimeStampLocal = 0;
  $CAN_PrivFront::RFL_ObjHdr::RFL_ObjHdr_TimeStampStatus = 0;
  $CAN_PrivFront::RFL_ObjHdr::RFL_ObjHdr_YawAngleLower = -1.30883;
  $CAN_PrivFront::RFL_ObjHdr::RFL_ObjHdr_YawAngleUpper = 1.30883;
  $CAN_PrivFront::RFL_ObjHdr::RFL_ObjHdr_YawMountAngle = 0.78539816;
  $CAN_PrivFront::RFL_Status::RFL_Status_ModulationStatus = 0;
  $CAN_PrivFront::RFL_Status::RFL_Status_SensorState = 0;
  if (prestart_mode==0) init_count = 0;
  initFlag = 2;
  }
  init_count++;
}
void init_CRadarFR_VW_GOLF_VII_ROTA()
{
  if(init_count == 1)
  {
  $CAN_PrivFront::RFR_AEB_Request::RFR_AEB_CU = 0;
  $CAN_PrivFront::RFR_AEB_Request::RFR_AEB_DummyForFuture = 0;
  $CAN_PrivFront::RFR_AEB_Request::RFR_AEB_FPC = 0;
  $CAN_PrivFront::RFR_AEB_Request::RFR_AEB_LTA = 0;
  $CAN_PrivFront::RFR_AEB_Request::RFR_AEB_ObjID = 0;
  $CAN_PrivFront::RFR_AEB_Request::RFR_AEB_VRU = 0;
  $CAN_PrivFront::RFR_AEB_Request::RFR_AEB_VRUTA = 0;
  $CAN_PrivFront::RFR_AEB_Request::RFR_Ax_CommandValue = -20.016;
  $CAN_PrivFront::RFR_Obj00A::RFR_Obj00A_Ax = -16;
  $CAN_PrivFront::RFR_Obj00A::RFR_Obj00A_AxAyCoVnce = 0;
  $CAN_PrivFront::RFR_Obj00A::RFR_Obj00A_AxVnce = 0;
  $CAN_PrivFront::RFR_Obj00A::RFR_Obj00A_Ay = -16;
  $CAN_PrivFront::RFR_Obj00A::RFR_Obj00A_AyVnce = 0;
  $CAN_PrivFront::RFR_Obj00A::RFR_Obj00A_Dx = -256;
  $CAN_PrivFront::RFR_Obj00A::RFR_Obj00A_DxAxCoVnce = 0;
  $CAN_PrivFront::RFR_Obj00A::RFR_Obj00A_DxAyCoVnce = 0;
  $CAN_PrivFront::RFR_Obj00A::RFR_Obj00A_DxDyCoVnce = 0;
  $CAN_PrivFront::RFR_Obj00A::RFR_Obj00A_DxVnce = 0;
  $CAN_PrivFront::RFR_Obj00A::RFR_Obj00A_DxVxCoVnce = 0;
  $CAN_PrivFront::RFR_Obj00A::RFR_Obj00A_DxVyCoVnce = 0;
  $CAN_PrivFront::RFR_Obj00A::RFR_Obj00A_Dy = -128;
  $CAN_PrivFront::RFR_Obj00A::RFR_Obj00A_DyAxCoVnce = 0;
  $CAN_PrivFront::RFR_Obj00A::RFR_Obj00A_DyAyCoVnce = 0;
  $CAN_PrivFront::RFR_Obj00A::RFR_Obj00A_DyVnce = 0;
  $CAN_PrivFront::RFR_Obj00A::RFR_Obj00A_DyVxCoVnce = 0;
  }
  if(init_count == 2)
  {
  $CAN_PrivFront::RFR_Obj00A::RFR_Obj00A_DyVyCoVnce = 0;
  $CAN_PrivFront::RFR_Obj00A::RFR_Obj00A_Dz = -5;
  $CAN_PrivFront::RFR_Obj00A::RFR_Obj00A_DzVnce = 0;
  $CAN_PrivFront::RFR_Obj00A::RFR_Obj00A_HeadingYawAngle = -4.48;
  $CAN_PrivFront::RFR_Obj00A::RFR_Obj00A_HeadingYawAngleVnce = 0;
  $CAN_PrivFront::RFR_Obj00A::RFR_Obj00A_Height = 0;
  $CAN_PrivFront::RFR_Obj00A::RFR_Obj00A_HeightVnce = 0;
  $CAN_PrivFront::RFR_Obj00A::RFR_Obj00A_ID = 0;
  $CAN_PrivFront::RFR_Obj00A::RFR_Obj00A_Length = 0;
  $CAN_PrivFront::RFR_Obj00A::RFR_Obj00A_LengthVnce = 0;
  $CAN_PrivFront::RFR_Obj00A::RFR_Obj00A_Measured = 0;
  $CAN_PrivFront::RFR_Obj00A::RFR_Obj00A_ProbExist = 0;
  $CAN_PrivFront::RFR_Obj00A::RFR_Obj00A_ProbMobileObst = 0;
  $CAN_PrivFront::RFR_Obj00A::RFR_Obj00A_ProbNonObstacle = 0;
  $CAN_PrivFront::RFR_Obj00A::RFR_Obj00A_ProbObstacle = 0;
  $CAN_PrivFront::RFR_Obj00A::RFR_Obj00A_RefPosIndex = 0;
  $CAN_PrivFront::RFR_Obj00A::RFR_Obj00A_Valid = 0;
  $CAN_PrivFront::RFR_Obj00A::RFR_Obj00A_Vx = -128;
  $CAN_PrivFront::RFR_Obj00A::RFR_Obj00A_VxAxCoVnce = 0;
  $CAN_PrivFront::RFR_Obj00A::RFR_Obj00A_VxAyCoVnce = 0;
  $CAN_PrivFront::RFR_Obj00A::RFR_Obj00A_VxVnce = 0;
  $CAN_PrivFront::RFR_Obj00A::RFR_Obj00A_VxVyCoVnce = 0;
  $CAN_PrivFront::RFR_Obj00A::RFR_Obj00A_Vy = -64;
  $CAN_PrivFront::RFR_Obj00A::RFR_Obj00A_VyAxCoVnce = 0;
  $CAN_PrivFront::RFR_Obj00A::RFR_Obj00A_VyAyCoVnce = 0;
  }
  if(init_count == 3)
  {
  $CAN_PrivFront::RFR_Obj00A::RFR_Obj00A_VyVnce = 0;
  $CAN_PrivFront::RFR_Obj00A::RFR_Obj00A_Width = 0;
  $CAN_PrivFront::RFR_Obj00A::RFR_Obj00A_WidthVnce = 0;
  $CAN_PrivFront::RFR_Obj00B::RFR_Obj00B_BehaviorType = 0;
  $CAN_PrivFront::RFR_Obj00B::RFR_Obj00B_MovingObserved = 0;
  $CAN_PrivFront::RFR_Obj00B::RFR_Obj00B_MovingProbability = 0;
  $CAN_PrivFront::RFR_Obj00B::RFR_Obj00B_Prob4PlusWhlCAR = 0;
  $CAN_PrivFront::RFR_Obj00B::RFR_Obj00B_Prob4PlusWhlbHGV = 0;
  $CAN_PrivFront::RFR_Obj00B::RFR_Obj00B_ProbGNDReflex = 0;
  $CAN_PrivFront::RFR_Obj00B::RFR_Obj00B_ProbMob2Whl = 0;
  $CAN_PrivFront::RFR_Obj00B::RFR_Obj00B_ProbMob4PlusWhl = 0;
  $CAN_PrivFront::RFR_Obj00B::RFR_Obj00B_ProbMobPed = 0;
  $CAN_PrivFront::RFR_Obj00B::RFR_Obj00B_ProbStatBarrier = 0;
  $CAN_PrivFront::RFR_Obj00B::RFR_Obj00B_ProbStatObst = 0;
  $CAN_PrivFront::RFR_Obj01A::RFR_Obj01A_Ax = -16;
  $CAN_PrivFront::RFR_Obj01A::RFR_Obj01A_AxAyCoVnce = 0;
  $CAN_PrivFront::RFR_Obj01A::RFR_Obj01A_AxVnce = 0;
  $CAN_PrivFront::RFR_Obj01A::RFR_Obj01A_Ay = -16;
  $CAN_PrivFront::RFR_Obj01A::RFR_Obj01A_AyVnce = 0;
  $CAN_PrivFront::RFR_Obj01A::RFR_Obj01A_Dx = -256;
  $CAN_PrivFront::RFR_Obj01A::RFR_Obj01A_DxAxCoVnce = 0;
  $CAN_PrivFront::RFR_Obj01A::RFR_Obj01A_DxAyCoVnce = 0;
  $CAN_PrivFront::RFR_Obj01A::RFR_Obj01A_DxDyCoVnce = 0;
  $CAN_PrivFront::RFR_Obj01A::RFR_Obj01A_DxVnce = 0;
  $CAN_PrivFront::RFR_Obj01A::RFR_Obj01A_DxVxCoVnce = 0;
  }
  if(init_count == 4)
  {
  $CAN_PrivFront::RFR_Obj01A::RFR_Obj01A_DxVyCoVnce = 0;
  $CAN_PrivFront::RFR_Obj01A::RFR_Obj01A_Dy = -128;
  $CAN_PrivFront::RFR_Obj01A::RFR_Obj01A_DyAxCoVnce = 0;
  $CAN_PrivFront::RFR_Obj01A::RFR_Obj01A_DyAyCoVnce = 0;
  $CAN_PrivFront::RFR_Obj01A::RFR_Obj01A_DyVnce = 0;
  $CAN_PrivFront::RFR_Obj01A::RFR_Obj01A_DyVxCoVnce = 0;
  $CAN_PrivFront::RFR_Obj01A::RFR_Obj01A_DyVyCoVnce = 0;
  $CAN_PrivFront::RFR_Obj01A::RFR_Obj01A_Dz = -5;
  $CAN_PrivFront::RFR_Obj01A::RFR_Obj01A_DzVnce = 0;
  $CAN_PrivFront::RFR_Obj01A::RFR_Obj01A_HeadingYawAngle = -4.48;
  $CAN_PrivFront::RFR_Obj01A::RFR_Obj01A_HeadingYawAngleVnce = 0;
  $CAN_PrivFront::RFR_Obj01A::RFR_Obj01A_Height = 0;
  $CAN_PrivFront::RFR_Obj01A::RFR_Obj01A_HeightVnce = 0;
  $CAN_PrivFront::RFR_Obj01A::RFR_Obj01A_ID = 0;
  $CAN_PrivFront::RFR_Obj01A::RFR_Obj01A_Length = 0;
  $CAN_PrivFront::RFR_Obj01A::RFR_Obj01A_LengthVnce = 0;
  $CAN_PrivFront::RFR_Obj01A::RFR_Obj01A_Measured = 0;
  $CAN_PrivFront::RFR_Obj01A::RFR_Obj01A_ProbExist = 0;
  $CAN_PrivFront::RFR_Obj01A::RFR_Obj01A_ProbMobileObst = 0;
  $CAN_PrivFront::RFR_Obj01A::RFR_Obj01A_ProbNonObstacle = 0;
  $CAN_PrivFront::RFR_Obj01A::RFR_Obj01A_ProbObstacle = 0;
  $CAN_PrivFront::RFR_Obj01A::RFR_Obj01A_RefPosIndex = 0;
  $CAN_PrivFront::RFR_Obj01A::RFR_Obj01A_Valid = 0;
  $CAN_PrivFront::RFR_Obj01A::RFR_Obj01A_Vx = -128;
  $CAN_PrivFront::RFR_Obj01A::RFR_Obj01A_VxAxCoVnce = 0;
  }
  if(init_count == 5)
  {
  $CAN_PrivFront::RFR_Obj01A::RFR_Obj01A_VxAyCoVnce = 0;
  $CAN_PrivFront::RFR_Obj01A::RFR_Obj01A_VxVnce = 0;
  $CAN_PrivFront::RFR_Obj01A::RFR_Obj01A_VxVyCoVnce = 0;
  $CAN_PrivFront::RFR_Obj01A::RFR_Obj01A_Vy = -64;
  $CAN_PrivFront::RFR_Obj01A::RFR_Obj01A_VyAxCoVnce = 0;
  $CAN_PrivFront::RFR_Obj01A::RFR_Obj01A_VyAyCoVnce = 0;
  $CAN_PrivFront::RFR_Obj01A::RFR_Obj01A_VyVnce = 0;
  $CAN_PrivFront::RFR_Obj01A::RFR_Obj01A_Width = 0;
  $CAN_PrivFront::RFR_Obj01A::RFR_Obj01A_WidthVnce = 0;
  $CAN_PrivFront::RFR_Obj01B::RFR_Obj01B_BehaviorType = 0;
  $CAN_PrivFront::RFR_Obj01B::RFR_Obj01B_MovingObserved = 0;
  $CAN_PrivFront::RFR_Obj01B::RFR_Obj01B_MovingProbability = 0;
  $CAN_PrivFront::RFR_Obj01B::RFR_Obj01B_Prob4PlusWhlCAR = 0;
  $CAN_PrivFront::RFR_Obj01B::RFR_Obj01B_Prob4PlusWhlbHGV = 0;
  $CAN_PrivFront::RFR_Obj01B::RFR_Obj01B_ProbGNDReflex = 0;
  $CAN_PrivFront::RFR_Obj01B::RFR_Obj01B_ProbMob2Whl = 0;
  $CAN_PrivFront::RFR_Obj01B::RFR_Obj01B_ProbMob4PlusWhl = 0;
  $CAN_PrivFront::RFR_Obj01B::RFR_Obj01B_ProbMobPed = 0;
  $CAN_PrivFront::RFR_Obj01B::RFR_Obj01B_ProbStatBarrier = 0;
  $CAN_PrivFront::RFR_Obj01B::RFR_Obj01B_ProbStatObst = 0;
  $CAN_PrivFront::RFR_Obj02A::RFR_Obj02A_Ax = -16;
  $CAN_PrivFront::RFR_Obj02A::RFR_Obj02A_AxAyCoVnce = 0;
  $CAN_PrivFront::RFR_Obj02A::RFR_Obj02A_AxVnce = 0;
  $CAN_PrivFront::RFR_Obj02A::RFR_Obj02A_Ay = -16;
  $CAN_PrivFront::RFR_Obj02A::RFR_Obj02A_AyVnce = 0;
  }
  if(init_count == 6)
  {
  $CAN_PrivFront::RFR_Obj02A::RFR_Obj02A_Dx = -256;
  $CAN_PrivFront::RFR_Obj02A::RFR_Obj02A_DxAxCoVnce = 0;
  $CAN_PrivFront::RFR_Obj02A::RFR_Obj02A_DxAyCoVnce = 0;
  $CAN_PrivFront::RFR_Obj02A::RFR_Obj02A_DxDyCoVnce = 0;
  $CAN_PrivFront::RFR_Obj02A::RFR_Obj02A_DxVnce = 0;
  $CAN_PrivFront::RFR_Obj02A::RFR_Obj02A_DxVxCoVnce = 0;
  $CAN_PrivFront::RFR_Obj02A::RFR_Obj02A_DxVyCoVnce = 0;
  $CAN_PrivFront::RFR_Obj02A::RFR_Obj02A_Dy = -128;
  $CAN_PrivFront::RFR_Obj02A::RFR_Obj02A_DyAxCoVnce = 0;
  $CAN_PrivFront::RFR_Obj02A::RFR_Obj02A_DyAyCoVnce = 0;
  $CAN_PrivFront::RFR_Obj02A::RFR_Obj02A_DyVnce = 0;
  $CAN_PrivFront::RFR_Obj02A::RFR_Obj02A_DyVxCoVnce = 0;
  $CAN_PrivFront::RFR_Obj02A::RFR_Obj02A_DyVyCoVnce = 0;
  $CAN_PrivFront::RFR_Obj02A::RFR_Obj02A_Dz = -5;
  $CAN_PrivFront::RFR_Obj02A::RFR_Obj02A_DzVnce = 0;
  $CAN_PrivFront::RFR_Obj02A::RFR_Obj02A_HeadingYawAngle = -4.48;
  $CAN_PrivFront::RFR_Obj02A::RFR_Obj02A_HeadingYawAngleVnce = 0;
  $CAN_PrivFront::RFR_Obj02A::RFR_Obj02A_Height = 0;
  $CAN_PrivFront::RFR_Obj02A::RFR_Obj02A_HeightVnce = 0;
  $CAN_PrivFront::RFR_Obj02A::RFR_Obj02A_ID = 0;
  $CAN_PrivFront::RFR_Obj02A::RFR_Obj02A_Length = 0;
  $CAN_PrivFront::RFR_Obj02A::RFR_Obj02A_LengthVnce = 0;
  $CAN_PrivFront::RFR_Obj02A::RFR_Obj02A_Measured = 0;
  $CAN_PrivFront::RFR_Obj02A::RFR_Obj02A_ProbExist = 0;
  $CAN_PrivFront::RFR_Obj02A::RFR_Obj02A_ProbMobileObst = 0;
  }
  if(init_count == 7)
  {
  $CAN_PrivFront::RFR_Obj02A::RFR_Obj02A_ProbNonObstacle = 0;
  $CAN_PrivFront::RFR_Obj02A::RFR_Obj02A_ProbObstacle = 0;
  $CAN_PrivFront::RFR_Obj02A::RFR_Obj02A_RefPosIndex = 0;
  $CAN_PrivFront::RFR_Obj02A::RFR_Obj02A_Valid = 0;
  $CAN_PrivFront::RFR_Obj02A::RFR_Obj02A_Vx = -128;
  $CAN_PrivFront::RFR_Obj02A::RFR_Obj02A_VxAxCoVnce = 0;
  $CAN_PrivFront::RFR_Obj02A::RFR_Obj02A_VxAyCoVnce = 0;
  $CAN_PrivFront::RFR_Obj02A::RFR_Obj02A_VxVnce = 0;
  $CAN_PrivFront::RFR_Obj02A::RFR_Obj02A_VxVyCoVnce = 0;
  $CAN_PrivFront::RFR_Obj02A::RFR_Obj02A_Vy = -64;
  $CAN_PrivFront::RFR_Obj02A::RFR_Obj02A_VyAxCoVnce = 0;
  $CAN_PrivFront::RFR_Obj02A::RFR_Obj02A_VyAyCoVnce = 0;
  $CAN_PrivFront::RFR_Obj02A::RFR_Obj02A_VyVnce = 0;
  $CAN_PrivFront::RFR_Obj02A::RFR_Obj02A_Width = 0;
  $CAN_PrivFront::RFR_Obj02A::RFR_Obj02A_WidthVnce = 0;
  $CAN_PrivFront::RFR_Obj02B::RFR_Obj02B_BehaviorType = 0;
  $CAN_PrivFront::RFR_Obj02B::RFR_Obj02B_MovingObserved = 0;
  $CAN_PrivFront::RFR_Obj02B::RFR_Obj02B_MovingProbability = 0;
  $CAN_PrivFront::RFR_Obj02B::RFR_Obj02B_Prob4PlusWhlCAR = 0;
  $CAN_PrivFront::RFR_Obj02B::RFR_Obj02B_Prob4PlusWhlbHGV = 0;
  $CAN_PrivFront::RFR_Obj02B::RFR_Obj02B_ProbGNDReflex = 0;
  $CAN_PrivFront::RFR_Obj02B::RFR_Obj02B_ProbMob2Whl = 0;
  $CAN_PrivFront::RFR_Obj02B::RFR_Obj02B_ProbMob4PlusWhl = 0;
  $CAN_PrivFront::RFR_Obj02B::RFR_Obj02B_ProbMobPed = 0;
  $CAN_PrivFront::RFR_Obj02B::RFR_Obj02B_ProbStatBarrier = 0;
  }
  if(init_count == 8)
  {
  $CAN_PrivFront::RFR_Obj02B::RFR_Obj02B_ProbStatObst = 0;
  $CAN_PrivFront::RFR_Obj03A::RFR_Obj03A_Ax = -16;
  $CAN_PrivFront::RFR_Obj03A::RFR_Obj03A_AxAyCoVnce = 0;
  $CAN_PrivFront::RFR_Obj03A::RFR_Obj03A_AxVnce = 0;
  $CAN_PrivFront::RFR_Obj03A::RFR_Obj03A_Ay = -16;
  $CAN_PrivFront::RFR_Obj03A::RFR_Obj03A_AyVnce = 0;
  $CAN_PrivFront::RFR_Obj03A::RFR_Obj03A_Dx = -256;
  $CAN_PrivFront::RFR_Obj03A::RFR_Obj03A_DxAxCoVnce = 0;
  $CAN_PrivFront::RFR_Obj03A::RFR_Obj03A_DxAyCoVnce = 0;
  $CAN_PrivFront::RFR_Obj03A::RFR_Obj03A_DxDyCoVnce = 0;
  $CAN_PrivFront::RFR_Obj03A::RFR_Obj03A_DxVnce = 0;
  $CAN_PrivFront::RFR_Obj03A::RFR_Obj03A_DxVxCoVnce = 0;
  $CAN_PrivFront::RFR_Obj03A::RFR_Obj03A_DxVyCoVnce = 0;
  $CAN_PrivFront::RFR_Obj03A::RFR_Obj03A_Dy = -128;
  $CAN_PrivFront::RFR_Obj03A::RFR_Obj03A_DyAxCoVnce = 0;
  $CAN_PrivFront::RFR_Obj03A::RFR_Obj03A_DyAyCoVnce = 0;
  $CAN_PrivFront::RFR_Obj03A::RFR_Obj03A_DyVnce = 0;
  $CAN_PrivFront::RFR_Obj03A::RFR_Obj03A_DyVxCoVnce = 0;
  $CAN_PrivFront::RFR_Obj03A::RFR_Obj03A_DyVyCoVnce = 0;
  $CAN_PrivFront::RFR_Obj03A::RFR_Obj03A_Dz = -5;
  $CAN_PrivFront::RFR_Obj03A::RFR_Obj03A_DzVnce = 0;
  $CAN_PrivFront::RFR_Obj03A::RFR_Obj03A_HeadingYawAngle = -4.48;
  $CAN_PrivFront::RFR_Obj03A::RFR_Obj03A_HeadingYawAngleVnce = 0;
  $CAN_PrivFront::RFR_Obj03A::RFR_Obj03A_Height = 0;
  $CAN_PrivFront::RFR_Obj03A::RFR_Obj03A_HeightVnce = 0;
  }
  if(init_count == 9)
  {
  $CAN_PrivFront::RFR_Obj03A::RFR_Obj03A_ID = 0;
  $CAN_PrivFront::RFR_Obj03A::RFR_Obj03A_Length = 0;
  $CAN_PrivFront::RFR_Obj03A::RFR_Obj03A_LengthVnce = 0;
  $CAN_PrivFront::RFR_Obj03A::RFR_Obj03A_Measured = 0;
  $CAN_PrivFront::RFR_Obj03A::RFR_Obj03A_ProbExist = 0;
  $CAN_PrivFront::RFR_Obj03A::RFR_Obj03A_ProbMobileObst = 0;
  $CAN_PrivFront::RFR_Obj03A::RFR_Obj03A_ProbNonObstacle = 0;
  $CAN_PrivFront::RFR_Obj03A::RFR_Obj03A_ProbObstacle = 0;
  $CAN_PrivFront::RFR_Obj03A::RFR_Obj03A_RefPosIndex = 0;
  $CAN_PrivFront::RFR_Obj03A::RFR_Obj03A_Valid = 0;
  $CAN_PrivFront::RFR_Obj03A::RFR_Obj03A_Vx = -128;
  $CAN_PrivFront::RFR_Obj03A::RFR_Obj03A_VxAxCoVnce = 0;
  $CAN_PrivFront::RFR_Obj03A::RFR_Obj03A_VxAyCoVnce = 0;
  $CAN_PrivFront::RFR_Obj03A::RFR_Obj03A_VxVnce = 0;
  $CAN_PrivFront::RFR_Obj03A::RFR_Obj03A_VxVyCoVnce = 0;
  $CAN_PrivFront::RFR_Obj03A::RFR_Obj03A_Vy = -64;
  $CAN_PrivFront::RFR_Obj03A::RFR_Obj03A_VyAxCoVnce = 0;
  $CAN_PrivFront::RFR_Obj03A::RFR_Obj03A_VyAyCoVnce = 0;
  $CAN_PrivFront::RFR_Obj03A::RFR_Obj03A_VyVnce = 0;
  $CAN_PrivFront::RFR_Obj03A::RFR_Obj03A_Width = 0;
  $CAN_PrivFront::RFR_Obj03A::RFR_Obj03A_WidthVnce = 0;
  $CAN_PrivFront::RFR_Obj03B::RFR_Obj03B_BehaviorType = 0;
  $CAN_PrivFront::RFR_Obj03B::RFR_Obj03B_MovingObserved = 0;
  $CAN_PrivFront::RFR_Obj03B::RFR_Obj03B_MovingProbability = 0;
  $CAN_PrivFront::RFR_Obj03B::RFR_Obj03B_Prob4PlusWhlCAR = 0;
  }
  if(init_count == 10)
  {
  $CAN_PrivFront::RFR_Obj03B::RFR_Obj03B_Prob4PlusWhlbHGV = 0;
  $CAN_PrivFront::RFR_Obj03B::RFR_Obj03B_ProbGNDReflex = 0;
  $CAN_PrivFront::RFR_Obj03B::RFR_Obj03B_ProbMob2Whl = 0;
  $CAN_PrivFront::RFR_Obj03B::RFR_Obj03B_ProbMob4PlusWhl = 0;
  $CAN_PrivFront::RFR_Obj03B::RFR_Obj03B_ProbMobPed = 0;
  $CAN_PrivFront::RFR_Obj03B::RFR_Obj03B_ProbStatBarrier = 0;
  $CAN_PrivFront::RFR_Obj03B::RFR_Obj03B_ProbStatObst = 0;
  $CAN_PrivFront::RFR_Obj04A::RFR_Obj04A_Ax = -16;
  $CAN_PrivFront::RFR_Obj04A::RFR_Obj04A_AxAyCoVnce = 0;
  $CAN_PrivFront::RFR_Obj04A::RFR_Obj04A_AxVnce = 0;
  $CAN_PrivFront::RFR_Obj04A::RFR_Obj04A_Ay = -16;
  $CAN_PrivFront::RFR_Obj04A::RFR_Obj04A_AyVnce = 0;
  $CAN_PrivFront::RFR_Obj04A::RFR_Obj04A_Dx = -256;
  $CAN_PrivFront::RFR_Obj04A::RFR_Obj04A_DxAxCoVnce = 0;
  $CAN_PrivFront::RFR_Obj04A::RFR_Obj04A_DxAyCoVnce = 0;
  $CAN_PrivFront::RFR_Obj04A::RFR_Obj04A_DxDyCoVnce = 0;
  $CAN_PrivFront::RFR_Obj04A::RFR_Obj04A_DxVnce = 0;
  $CAN_PrivFront::RFR_Obj04A::RFR_Obj04A_DxVxCoVnce = 0;
  $CAN_PrivFront::RFR_Obj04A::RFR_Obj04A_DxVyCoVnce = 0;
  $CAN_PrivFront::RFR_Obj04A::RFR_Obj04A_Dy = -128;
  $CAN_PrivFront::RFR_Obj04A::RFR_Obj04A_DyAxCoVnce = 0;
  $CAN_PrivFront::RFR_Obj04A::RFR_Obj04A_DyAyCoVnce = 0;
  $CAN_PrivFront::RFR_Obj04A::RFR_Obj04A_DyVnce = 0;
  $CAN_PrivFront::RFR_Obj04A::RFR_Obj04A_DyVxCoVnce = 0;
  $CAN_PrivFront::RFR_Obj04A::RFR_Obj04A_DyVyCoVnce = 0;
  }
  if(init_count == 11)
  {
  $CAN_PrivFront::RFR_Obj04A::RFR_Obj04A_Dz = -5;
  $CAN_PrivFront::RFR_Obj04A::RFR_Obj04A_DzVnce = 0;
  $CAN_PrivFront::RFR_Obj04A::RFR_Obj04A_HeadingYawAngle = -4.48;
  $CAN_PrivFront::RFR_Obj04A::RFR_Obj04A_HeadingYawAngleVnce = 0;
  $CAN_PrivFront::RFR_Obj04A::RFR_Obj04A_Height = 0;
  $CAN_PrivFront::RFR_Obj04A::RFR_Obj04A_HeightVnce = 0;
  $CAN_PrivFront::RFR_Obj04A::RFR_Obj04A_ID = 0;
  $CAN_PrivFront::RFR_Obj04A::RFR_Obj04A_Length = 0;
  $CAN_PrivFront::RFR_Obj04A::RFR_Obj04A_LengthVnce = 0;
  $CAN_PrivFront::RFR_Obj04A::RFR_Obj04A_Measured = 0;
  $CAN_PrivFront::RFR_Obj04A::RFR_Obj04A_ProbExist = 0;
  $CAN_PrivFront::RFR_Obj04A::RFR_Obj04A_ProbMobileObst = 0;
  $CAN_PrivFront::RFR_Obj04A::RFR_Obj04A_ProbNonObstacle = 0;
  $CAN_PrivFront::RFR_Obj04A::RFR_Obj04A_ProbObstacle = 0;
  $CAN_PrivFront::RFR_Obj04A::RFR_Obj04A_RefPosIndex = 0;
  $CAN_PrivFront::RFR_Obj04A::RFR_Obj04A_Valid = 0;
  $CAN_PrivFront::RFR_Obj04A::RFR_Obj04A_Vx = -128;
  $CAN_PrivFront::RFR_Obj04A::RFR_Obj04A_VxAxCoVnce = 0;
  $CAN_PrivFront::RFR_Obj04A::RFR_Obj04A_VxAyCoVnce = 0;
  $CAN_PrivFront::RFR_Obj04A::RFR_Obj04A_VxVnce = 0;
  $CAN_PrivFront::RFR_Obj04A::RFR_Obj04A_VxVyCoVnce = 0;
  $CAN_PrivFront::RFR_Obj04A::RFR_Obj04A_Vy = -64;
  $CAN_PrivFront::RFR_Obj04A::RFR_Obj04A_VyAxCoVnce = 0;
  $CAN_PrivFront::RFR_Obj04A::RFR_Obj04A_VyAyCoVnce = 0;
  $CAN_PrivFront::RFR_Obj04A::RFR_Obj04A_VyVnce = 0;
  }
  if(init_count == 12)
  {
  $CAN_PrivFront::RFR_Obj04A::RFR_Obj04A_Width = 0;
  $CAN_PrivFront::RFR_Obj04A::RFR_Obj04A_WidthVnce = 0;
  $CAN_PrivFront::RFR_Obj04B::RFR_Obj04B_BehaviorType = 0;
  $CAN_PrivFront::RFR_Obj04B::RFR_Obj04B_MovingObserved = 0;
  $CAN_PrivFront::RFR_Obj04B::RFR_Obj04B_MovingProbability = 0;
  $CAN_PrivFront::RFR_Obj04B::RFR_Obj04B_Prob4PlusWhlCAR = 0;
  $CAN_PrivFront::RFR_Obj04B::RFR_Obj04B_Prob4PlusWhlbHGV = 0;
  $CAN_PrivFront::RFR_Obj04B::RFR_Obj04B_ProbGNDReflex = 0;
  $CAN_PrivFront::RFR_Obj04B::RFR_Obj04B_ProbMob2Whl = 0;
  $CAN_PrivFront::RFR_Obj04B::RFR_Obj04B_ProbMob4PlusWhl = 0;
  $CAN_PrivFront::RFR_Obj04B::RFR_Obj04B_ProbMobPed = 0;
  $CAN_PrivFront::RFR_Obj04B::RFR_Obj04B_ProbStatBarrier = 0;
  $CAN_PrivFront::RFR_Obj04B::RFR_Obj04B_ProbStatObst = 0;
  $CAN_PrivFront::RFR_Obj05A::RFR_Obj05A_Ax = -16;
  $CAN_PrivFront::RFR_Obj05A::RFR_Obj05A_AxAyCoVnce = 0;
  $CAN_PrivFront::RFR_Obj05A::RFR_Obj05A_AxVnce = 0;
  $CAN_PrivFront::RFR_Obj05A::RFR_Obj05A_Ay = -16;
  $CAN_PrivFront::RFR_Obj05A::RFR_Obj05A_AyVnce = 0;
  $CAN_PrivFront::RFR_Obj05A::RFR_Obj05A_Dx = -256;
  $CAN_PrivFront::RFR_Obj05A::RFR_Obj05A_DxAxCoVnce = 0;
  $CAN_PrivFront::RFR_Obj05A::RFR_Obj05A_DxAyCoVnce = 0;
  $CAN_PrivFront::RFR_Obj05A::RFR_Obj05A_DxDyCoVnce = 0;
  $CAN_PrivFront::RFR_Obj05A::RFR_Obj05A_DxVnce = 0;
  $CAN_PrivFront::RFR_Obj05A::RFR_Obj05A_DxVxCoVnce = 0;
  $CAN_PrivFront::RFR_Obj05A::RFR_Obj05A_DxVyCoVnce = 0;
  }
  if(init_count == 13)
  {
  $CAN_PrivFront::RFR_Obj05A::RFR_Obj05A_Dy = -128;
  $CAN_PrivFront::RFR_Obj05A::RFR_Obj05A_DyAxCoVnce = 0;
  $CAN_PrivFront::RFR_Obj05A::RFR_Obj05A_DyAyCoVnce = 0;
  $CAN_PrivFront::RFR_Obj05A::RFR_Obj05A_DyVnce = 0;
  $CAN_PrivFront::RFR_Obj05A::RFR_Obj05A_DyVxCoVnce = 0;
  $CAN_PrivFront::RFR_Obj05A::RFR_Obj05A_DyVyCoVnce = 0;
  $CAN_PrivFront::RFR_Obj05A::RFR_Obj05A_Dz = -5;
  $CAN_PrivFront::RFR_Obj05A::RFR_Obj05A_DzVnce = 0;
  $CAN_PrivFront::RFR_Obj05A::RFR_Obj05A_HeadingYawAngle = -4.48;
  $CAN_PrivFront::RFR_Obj05A::RFR_Obj05A_HeadingYawAngleVnce = 0;
  $CAN_PrivFront::RFR_Obj05A::RFR_Obj05A_Height = 0;
  $CAN_PrivFront::RFR_Obj05A::RFR_Obj05A_HeightVnce = 0;
  $CAN_PrivFront::RFR_Obj05A::RFR_Obj05A_ID = 0;
  $CAN_PrivFront::RFR_Obj05A::RFR_Obj05A_Length = 0;
  $CAN_PrivFront::RFR_Obj05A::RFR_Obj05A_LengthVnce = 0;
  $CAN_PrivFront::RFR_Obj05A::RFR_Obj05A_Measured = 0;
  $CAN_PrivFront::RFR_Obj05A::RFR_Obj05A_ProbExist = 0;
  $CAN_PrivFront::RFR_Obj05A::RFR_Obj05A_ProbMobileObst = 0;
  $CAN_PrivFront::RFR_Obj05A::RFR_Obj05A_ProbNonObstacle = 0;
  $CAN_PrivFront::RFR_Obj05A::RFR_Obj05A_ProbObstacle = 0;
  $CAN_PrivFront::RFR_Obj05A::RFR_Obj05A_RefPosIndex = 0;
  $CAN_PrivFront::RFR_Obj05A::RFR_Obj05A_Valid = 0;
  $CAN_PrivFront::RFR_Obj05A::RFR_Obj05A_Vx = -128;
  $CAN_PrivFront::RFR_Obj05A::RFR_Obj05A_VxAxCoVnce = 0;
  $CAN_PrivFront::RFR_Obj05A::RFR_Obj05A_VxAyCoVnce = 0;
  }
  if(init_count == 14)
  {
  $CAN_PrivFront::RFR_Obj05A::RFR_Obj05A_VxVnce = 0;
  $CAN_PrivFront::RFR_Obj05A::RFR_Obj05A_VxVyCoVnce = 0;
  $CAN_PrivFront::RFR_Obj05A::RFR_Obj05A_Vy = -64;
  $CAN_PrivFront::RFR_Obj05A::RFR_Obj05A_VyAxCoVnce = 0;
  $CAN_PrivFront::RFR_Obj05A::RFR_Obj05A_VyAyCoVnce = 0;
  $CAN_PrivFront::RFR_Obj05A::RFR_Obj05A_VyVnce = 0;
  $CAN_PrivFront::RFR_Obj05A::RFR_Obj05A_Width = 0;
  $CAN_PrivFront::RFR_Obj05A::RFR_Obj05A_WidthVnce = 0;
  $CAN_PrivFront::RFR_Obj05B::RFR_Obj05B_BehaviorType = 0;
  $CAN_PrivFront::RFR_Obj05B::RFR_Obj05B_MovingObserved = 0;
  $CAN_PrivFront::RFR_Obj05B::RFR_Obj05B_MovingProbability = 0;
  $CAN_PrivFront::RFR_Obj05B::RFR_Obj05B_Prob4PlusWhlCAR = 0;
  $CAN_PrivFront::RFR_Obj05B::RFR_Obj05B_Prob4PlusWhlbHGV = 0;
  $CAN_PrivFront::RFR_Obj05B::RFR_Obj05B_ProbGNDReflex = 0;
  $CAN_PrivFront::RFR_Obj05B::RFR_Obj05B_ProbMob2Whl = 0;
  $CAN_PrivFront::RFR_Obj05B::RFR_Obj05B_ProbMob4PlusWhl = 0;
  $CAN_PrivFront::RFR_Obj05B::RFR_Obj05B_ProbMobPed = 0;
  $CAN_PrivFront::RFR_Obj05B::RFR_Obj05B_ProbStatBarrier = 0;
  $CAN_PrivFront::RFR_Obj05B::RFR_Obj05B_ProbStatObst = 0;
  $CAN_PrivFront::RFR_Obj06A::RFR_Obj06A_Ax = -16;
  $CAN_PrivFront::RFR_Obj06A::RFR_Obj06A_AxAyCoVnce = 0;
  $CAN_PrivFront::RFR_Obj06A::RFR_Obj06A_AxVnce = 0;
  $CAN_PrivFront::RFR_Obj06A::RFR_Obj06A_Ay = -16;
  $CAN_PrivFront::RFR_Obj06A::RFR_Obj06A_AyVnce = 0;
  $CAN_PrivFront::RFR_Obj06A::RFR_Obj06A_Dx = -256;
  }
  if(init_count == 15)
  {
  $CAN_PrivFront::RFR_Obj06A::RFR_Obj06A_DxAxCoVnce = 0;
  $CAN_PrivFront::RFR_Obj06A::RFR_Obj06A_DxAyCoVnce = 0;
  $CAN_PrivFront::RFR_Obj06A::RFR_Obj06A_DxDyCoVnce = 0;
  $CAN_PrivFront::RFR_Obj06A::RFR_Obj06A_DxVnce = 0;
  $CAN_PrivFront::RFR_Obj06A::RFR_Obj06A_DxVxCoVnce = 0;
  $CAN_PrivFront::RFR_Obj06A::RFR_Obj06A_DxVyCoVnce = 0;
  $CAN_PrivFront::RFR_Obj06A::RFR_Obj06A_Dy = -128;
  $CAN_PrivFront::RFR_Obj06A::RFR_Obj06A_DyAxCoVnce = 0;
  $CAN_PrivFront::RFR_Obj06A::RFR_Obj06A_DyAyCoVnce = 0;
  $CAN_PrivFront::RFR_Obj06A::RFR_Obj06A_DyVnce = 0;
  $CAN_PrivFront::RFR_Obj06A::RFR_Obj06A_DyVxCoVnce = 0;
  $CAN_PrivFront::RFR_Obj06A::RFR_Obj06A_DyVyCoVnce = 0;
  $CAN_PrivFront::RFR_Obj06A::RFR_Obj06A_Dz = -5;
  $CAN_PrivFront::RFR_Obj06A::RFR_Obj06A_DzVnce = 0;
  $CAN_PrivFront::RFR_Obj06A::RFR_Obj06A_HeadingYawAngle = -4.48;
  $CAN_PrivFront::RFR_Obj06A::RFR_Obj06A_HeadingYawAngleVnce = 0;
  $CAN_PrivFront::RFR_Obj06A::RFR_Obj06A_Height = 0;
  $CAN_PrivFront::RFR_Obj06A::RFR_Obj06A_HeightVnce = 0;
  $CAN_PrivFront::RFR_Obj06A::RFR_Obj06A_ID = 0;
  $CAN_PrivFront::RFR_Obj06A::RFR_Obj06A_Length = 0;
  $CAN_PrivFront::RFR_Obj06A::RFR_Obj06A_LengthVnce = 0;
  $CAN_PrivFront::RFR_Obj06A::RFR_Obj06A_Measured = 0;
  $CAN_PrivFront::RFR_Obj06A::RFR_Obj06A_ProbExist = 0;
  $CAN_PrivFront::RFR_Obj06A::RFR_Obj06A_ProbMobileObst = 0;
  $CAN_PrivFront::RFR_Obj06A::RFR_Obj06A_ProbNonObstacle = 0;
  }
  if(init_count == 16)
  {
  $CAN_PrivFront::RFR_Obj06A::RFR_Obj06A_ProbObstacle = 0;
  $CAN_PrivFront::RFR_Obj06A::RFR_Obj06A_RefPosIndex = 0;
  $CAN_PrivFront::RFR_Obj06A::RFR_Obj06A_Valid = 0;
  $CAN_PrivFront::RFR_Obj06A::RFR_Obj06A_Vx = -128;
  $CAN_PrivFront::RFR_Obj06A::RFR_Obj06A_VxAxCoVnce = 0;
  $CAN_PrivFront::RFR_Obj06A::RFR_Obj06A_VxAyCoVnce = 0;
  $CAN_PrivFront::RFR_Obj06A::RFR_Obj06A_VxVnce = 0;
  $CAN_PrivFront::RFR_Obj06A::RFR_Obj06A_VxVyCoVnce = 0;
  $CAN_PrivFront::RFR_Obj06A::RFR_Obj06A_Vy = -64;
  $CAN_PrivFront::RFR_Obj06A::RFR_Obj06A_VyAxCoVnce = 0;
  $CAN_PrivFront::RFR_Obj06A::RFR_Obj06A_VyAyCoVnce = 0;
  $CAN_PrivFront::RFR_Obj06A::RFR_Obj06A_VyVnce = 0;
  $CAN_PrivFront::RFR_Obj06A::RFR_Obj06A_Width = 0;
  $CAN_PrivFront::RFR_Obj06A::RFR_Obj06A_WidthVnce = 0;
  $CAN_PrivFront::RFR_Obj06B::RFR_Obj06B_BehaviorType = 0;
  $CAN_PrivFront::RFR_Obj06B::RFR_Obj06B_MovingObserved = 0;
  $CAN_PrivFront::RFR_Obj06B::RFR_Obj06B_MovingProbability = 0;
  $CAN_PrivFront::RFR_Obj06B::RFR_Obj06B_Prob4PlusWhlCAR = 0;
  $CAN_PrivFront::RFR_Obj06B::RFR_Obj06B_Prob4PlusWhlbHGV = 0;
  $CAN_PrivFront::RFR_Obj06B::RFR_Obj06B_ProbGNDReflex = 0;
  $CAN_PrivFront::RFR_Obj06B::RFR_Obj06B_ProbMob2Whl = 0;
  $CAN_PrivFront::RFR_Obj06B::RFR_Obj06B_ProbMob4PlusWhl = 0;
  $CAN_PrivFront::RFR_Obj06B::RFR_Obj06B_ProbMobPed = 0;
  $CAN_PrivFront::RFR_Obj06B::RFR_Obj06B_ProbStatBarrier = 0;
  $CAN_PrivFront::RFR_Obj06B::RFR_Obj06B_ProbStatObst = 0;
  }
  if(init_count == 17)
  {
  $CAN_PrivFront::RFR_Obj07A::RFR_Obj07A_Ax = -16;
  $CAN_PrivFront::RFR_Obj07A::RFR_Obj07A_AxAyCoVnce = 0;
  $CAN_PrivFront::RFR_Obj07A::RFR_Obj07A_AxVnce = 0;
  $CAN_PrivFront::RFR_Obj07A::RFR_Obj07A_Ay = -16;
  $CAN_PrivFront::RFR_Obj07A::RFR_Obj07A_AyVnce = 0;
  $CAN_PrivFront::RFR_Obj07A::RFR_Obj07A_Dx = -256;
  $CAN_PrivFront::RFR_Obj07A::RFR_Obj07A_DxAxCoVnce = 0;
  $CAN_PrivFront::RFR_Obj07A::RFR_Obj07A_DxAyCoVnce = 0;
  $CAN_PrivFront::RFR_Obj07A::RFR_Obj07A_DxDyCoVnce = 0;
  $CAN_PrivFront::RFR_Obj07A::RFR_Obj07A_DxVnce = 0;
  $CAN_PrivFront::RFR_Obj07A::RFR_Obj07A_DxVxCoVnce = 0;
  $CAN_PrivFront::RFR_Obj07A::RFR_Obj07A_DxVyCoVnce = 0;
  $CAN_PrivFront::RFR_Obj07A::RFR_Obj07A_Dy = -128;
  $CAN_PrivFront::RFR_Obj07A::RFR_Obj07A_DyAxCoVnce = 0;
  $CAN_PrivFront::RFR_Obj07A::RFR_Obj07A_DyAyCoVnce = 0;
  $CAN_PrivFront::RFR_Obj07A::RFR_Obj07A_DyVnce = 0;
  $CAN_PrivFront::RFR_Obj07A::RFR_Obj07A_DyVxCoVnce = 0;
  $CAN_PrivFront::RFR_Obj07A::RFR_Obj07A_DyVyCoVnce = 0;
  $CAN_PrivFront::RFR_Obj07A::RFR_Obj07A_Dz = -5;
  $CAN_PrivFront::RFR_Obj07A::RFR_Obj07A_DzVnce = 0;
  $CAN_PrivFront::RFR_Obj07A::RFR_Obj07A_HeadingYawAngle = -4.48;
  $CAN_PrivFront::RFR_Obj07A::RFR_Obj07A_HeadingYawAngleVnce = 0;
  $CAN_PrivFront::RFR_Obj07A::RFR_Obj07A_Height = 0;
  $CAN_PrivFront::RFR_Obj07A::RFR_Obj07A_HeightVnce = 0;
  $CAN_PrivFront::RFR_Obj07A::RFR_Obj07A_ID = 0;
  }
  if(init_count == 18)
  {
  $CAN_PrivFront::RFR_Obj07A::RFR_Obj07A_Length = 0;
  $CAN_PrivFront::RFR_Obj07A::RFR_Obj07A_LengthVnce = 0;
  $CAN_PrivFront::RFR_Obj07A::RFR_Obj07A_Measured = 0;
  $CAN_PrivFront::RFR_Obj07A::RFR_Obj07A_ProbExist = 0;
  $CAN_PrivFront::RFR_Obj07A::RFR_Obj07A_ProbMobileObst = 0;
  $CAN_PrivFront::RFR_Obj07A::RFR_Obj07A_ProbNonObstacle = 0;
  $CAN_PrivFront::RFR_Obj07A::RFR_Obj07A_ProbObstacle = 0;
  $CAN_PrivFront::RFR_Obj07A::RFR_Obj07A_RefPosIndex = 0;
  $CAN_PrivFront::RFR_Obj07A::RFR_Obj07A_Valid = 0;
  $CAN_PrivFront::RFR_Obj07A::RFR_Obj07A_Vx = -128;
  $CAN_PrivFront::RFR_Obj07A::RFR_Obj07A_VxAxCoVnce = 0;
  $CAN_PrivFront::RFR_Obj07A::RFR_Obj07A_VxAyCoVnce = 0;
  $CAN_PrivFront::RFR_Obj07A::RFR_Obj07A_VxVnce = 0;
  $CAN_PrivFront::RFR_Obj07A::RFR_Obj07A_VxVyCoVnce = 0;
  $CAN_PrivFront::RFR_Obj07A::RFR_Obj07A_Vy = -64;
  $CAN_PrivFront::RFR_Obj07A::RFR_Obj07A_VyAxCoVnce = 0;
  $CAN_PrivFront::RFR_Obj07A::RFR_Obj07A_VyAyCoVnce = 0;
  $CAN_PrivFront::RFR_Obj07A::RFR_Obj07A_VyVnce = 0;
  $CAN_PrivFront::RFR_Obj07A::RFR_Obj07A_Width = 0;
  $CAN_PrivFront::RFR_Obj07A::RFR_Obj07A_WidthVnce = 0;
  $CAN_PrivFront::RFR_Obj07B::RFR_Obj07B_BehaviorType = 0;
  $CAN_PrivFront::RFR_Obj07B::RFR_Obj07B_MovingObserved = 0;
  $CAN_PrivFront::RFR_Obj07B::RFR_Obj07B_MovingProbability = 0;
  $CAN_PrivFront::RFR_Obj07B::RFR_Obj07B_Prob4PlusWhlCAR = 0;
  $CAN_PrivFront::RFR_Obj07B::RFR_Obj07B_Prob4PlusWhlbHGV = 0;
  }
  if(init_count == 19)
  {
  $CAN_PrivFront::RFR_Obj07B::RFR_Obj07B_ProbGNDReflex = 0;
  $CAN_PrivFront::RFR_Obj07B::RFR_Obj07B_ProbMob2Whl = 0;
  $CAN_PrivFront::RFR_Obj07B::RFR_Obj07B_ProbMob4PlusWhl = 0;
  $CAN_PrivFront::RFR_Obj07B::RFR_Obj07B_ProbMobPed = 0;
  $CAN_PrivFront::RFR_Obj07B::RFR_Obj07B_ProbStatBarrier = 0;
  $CAN_PrivFront::RFR_Obj07B::RFR_Obj07B_ProbStatObst = 0;
  $CAN_PrivFront::RFR_Obj08A::RFR_Obj08A_Ax = -16;
  $CAN_PrivFront::RFR_Obj08A::RFR_Obj08A_AxAyCoVnce = 0;
  $CAN_PrivFront::RFR_Obj08A::RFR_Obj08A_AxVnce = 0;
  $CAN_PrivFront::RFR_Obj08A::RFR_Obj08A_Ay = -16;
  $CAN_PrivFront::RFR_Obj08A::RFR_Obj08A_AyVnce = 0;
  $CAN_PrivFront::RFR_Obj08A::RFR_Obj08A_Dx = -256;
  $CAN_PrivFront::RFR_Obj08A::RFR_Obj08A_DxAxCoVnce = 0;
  $CAN_PrivFront::RFR_Obj08A::RFR_Obj08A_DxAyCoVnce = 0;
  $CAN_PrivFront::RFR_Obj08A::RFR_Obj08A_DxDyCoVnce = 0;
  $CAN_PrivFront::RFR_Obj08A::RFR_Obj08A_DxVnce = 0;
  $CAN_PrivFront::RFR_Obj08A::RFR_Obj08A_DxVxCoVnce = 0;
  $CAN_PrivFront::RFR_Obj08A::RFR_Obj08A_DxVyCoVnce = 0;
  $CAN_PrivFront::RFR_Obj08A::RFR_Obj08A_Dy = -128;
  $CAN_PrivFront::RFR_Obj08A::RFR_Obj08A_DyAxCoVnce = 0;
  $CAN_PrivFront::RFR_Obj08A::RFR_Obj08A_DyAyCoVnce = 0;
  $CAN_PrivFront::RFR_Obj08A::RFR_Obj08A_DyVnce = 0;
  $CAN_PrivFront::RFR_Obj08A::RFR_Obj08A_DyVxCoVnce = 0;
  $CAN_PrivFront::RFR_Obj08A::RFR_Obj08A_DyVyCoVnce = 0;
  $CAN_PrivFront::RFR_Obj08A::RFR_Obj08A_Dz = -5;
  }
  if(init_count == 20)
  {
  $CAN_PrivFront::RFR_Obj08A::RFR_Obj08A_DzVnce = 0;
  $CAN_PrivFront::RFR_Obj08A::RFR_Obj08A_HeadingYawAngle = -4.48;
  $CAN_PrivFront::RFR_Obj08A::RFR_Obj08A_HeadingYawAngleVnce = 0;
  $CAN_PrivFront::RFR_Obj08A::RFR_Obj08A_Height = 0;
  $CAN_PrivFront::RFR_Obj08A::RFR_Obj08A_HeightVnce = 0;
  $CAN_PrivFront::RFR_Obj08A::RFR_Obj08A_ID = 0;
  $CAN_PrivFront::RFR_Obj08A::RFR_Obj08A_Length = 0;
  $CAN_PrivFront::RFR_Obj08A::RFR_Obj08A_LengthVnce = 0;
  $CAN_PrivFront::RFR_Obj08A::RFR_Obj08A_Measured = 0;
  $CAN_PrivFront::RFR_Obj08A::RFR_Obj08A_ProbExist = 0;
  $CAN_PrivFront::RFR_Obj08A::RFR_Obj08A_ProbMobileObst = 0;
  $CAN_PrivFront::RFR_Obj08A::RFR_Obj08A_ProbNonObstacle = 0;
  $CAN_PrivFront::RFR_Obj08A::RFR_Obj08A_ProbObstacle = 0;
  $CAN_PrivFront::RFR_Obj08A::RFR_Obj08A_RefPosIndex = 0;
  $CAN_PrivFront::RFR_Obj08A::RFR_Obj08A_Valid = 0;
  $CAN_PrivFront::RFR_Obj08A::RFR_Obj08A_Vx = -128;
  $CAN_PrivFront::RFR_Obj08A::RFR_Obj08A_VxAxCoVnce = 0;
  $CAN_PrivFront::RFR_Obj08A::RFR_Obj08A_VxAyCoVnce = 0;
  $CAN_PrivFront::RFR_Obj08A::RFR_Obj08A_VxVnce = 0;
  $CAN_PrivFront::RFR_Obj08A::RFR_Obj08A_VxVyCoVnce = 0;
  $CAN_PrivFront::RFR_Obj08A::RFR_Obj08A_Vy = -64;
  $CAN_PrivFront::RFR_Obj08A::RFR_Obj08A_VyAxCoVnce = 0;
  $CAN_PrivFront::RFR_Obj08A::RFR_Obj08A_VyAyCoVnce = 0;
  $CAN_PrivFront::RFR_Obj08A::RFR_Obj08A_VyVnce = 0;
  $CAN_PrivFront::RFR_Obj08A::RFR_Obj08A_Width = 0;
  }
  if(init_count == 21)
  {
  $CAN_PrivFront::RFR_Obj08A::RFR_Obj08A_WidthVnce = 0;
  $CAN_PrivFront::RFR_Obj08B::RFR_Obj08B_BehaviorType = 0;
  $CAN_PrivFront::RFR_Obj08B::RFR_Obj08B_MovingObserved = 0;
  $CAN_PrivFront::RFR_Obj08B::RFR_Obj08B_MovingProbability = 0;
  $CAN_PrivFront::RFR_Obj08B::RFR_Obj08B_Prob4PlusWhlCAR = 0;
  $CAN_PrivFront::RFR_Obj08B::RFR_Obj08B_Prob4PlusWhlbHGV = 0;
  $CAN_PrivFront::RFR_Obj08B::RFR_Obj08B_ProbGNDReflex = 0;
  $CAN_PrivFront::RFR_Obj08B::RFR_Obj08B_ProbMob2Whl = 0;
  $CAN_PrivFront::RFR_Obj08B::RFR_Obj08B_ProbMob4PlusWhl = 0;
  $CAN_PrivFront::RFR_Obj08B::RFR_Obj08B_ProbMobPed = 0;
  $CAN_PrivFront::RFR_Obj08B::RFR_Obj08B_ProbStatBarrier = 0;
  $CAN_PrivFront::RFR_Obj08B::RFR_Obj08B_ProbStatObst = 0;
  $CAN_PrivFront::RFR_Obj09A::RFR_Obj09A_Ax = -16;
  $CAN_PrivFront::RFR_Obj09A::RFR_Obj09A_AxAyCoVnce = 0;
  $CAN_PrivFront::RFR_Obj09A::RFR_Obj09A_AxVnce = 0;
  $CAN_PrivFront::RFR_Obj09A::RFR_Obj09A_Ay = -16;
  $CAN_PrivFront::RFR_Obj09A::RFR_Obj09A_AyVnce = 0;
  $CAN_PrivFront::RFR_Obj09A::RFR_Obj09A_Dx = -256;
  $CAN_PrivFront::RFR_Obj09A::RFR_Obj09A_DxAxCoVnce = 0;
  $CAN_PrivFront::RFR_Obj09A::RFR_Obj09A_DxAyCoVnce = 0;
  $CAN_PrivFront::RFR_Obj09A::RFR_Obj09A_DxDyCoVnce = 0;
  $CAN_PrivFront::RFR_Obj09A::RFR_Obj09A_DxVnce = 0;
  $CAN_PrivFront::RFR_Obj09A::RFR_Obj09A_DxVxCoVnce = 0;
  $CAN_PrivFront::RFR_Obj09A::RFR_Obj09A_DxVyCoVnce = 0;
  $CAN_PrivFront::RFR_Obj09A::RFR_Obj09A_Dy = -128;
  }
  if(init_count == 22)
  {
  $CAN_PrivFront::RFR_Obj09A::RFR_Obj09A_DyAxCoVnce = 0;
  $CAN_PrivFront::RFR_Obj09A::RFR_Obj09A_DyAyCoVnce = 0;
  $CAN_PrivFront::RFR_Obj09A::RFR_Obj09A_DyVnce = 0;
  $CAN_PrivFront::RFR_Obj09A::RFR_Obj09A_DyVxCoVnce = 0;
  $CAN_PrivFront::RFR_Obj09A::RFR_Obj09A_DyVyCoVnce = 0;
  $CAN_PrivFront::RFR_Obj09A::RFR_Obj09A_Dz = -5;
  $CAN_PrivFront::RFR_Obj09A::RFR_Obj09A_DzVnce = 0;
  $CAN_PrivFront::RFR_Obj09A::RFR_Obj09A_HeadingYawAngle = -4.48;
  $CAN_PrivFront::RFR_Obj09A::RFR_Obj09A_HeadingYawAngleVnce = 0;
  $CAN_PrivFront::RFR_Obj09A::RFR_Obj09A_Height = 0;
  $CAN_PrivFront::RFR_Obj09A::RFR_Obj09A_HeightVnce = 0;
  $CAN_PrivFront::RFR_Obj09A::RFR_Obj09A_ID = 0;
  $CAN_PrivFront::RFR_Obj09A::RFR_Obj09A_Length = 0;
  $CAN_PrivFront::RFR_Obj09A::RFR_Obj09A_LengthVnce = 0;
  $CAN_PrivFront::RFR_Obj09A::RFR_Obj09A_Measured = 0;
  $CAN_PrivFront::RFR_Obj09A::RFR_Obj09A_ProbExist = 0;
  $CAN_PrivFront::RFR_Obj09A::RFR_Obj09A_ProbMobileObst = 0;
  $CAN_PrivFront::RFR_Obj09A::RFR_Obj09A_ProbNonObstacle = 0;
  $CAN_PrivFront::RFR_Obj09A::RFR_Obj09A_ProbObstacle = 0;
  $CAN_PrivFront::RFR_Obj09A::RFR_Obj09A_RefPosIndex = 0;
  $CAN_PrivFront::RFR_Obj09A::RFR_Obj09A_Valid = 0;
  $CAN_PrivFront::RFR_Obj09A::RFR_Obj09A_Vx = -128;
  $CAN_PrivFront::RFR_Obj09A::RFR_Obj09A_VxAxCoVnce = 0;
  $CAN_PrivFront::RFR_Obj09A::RFR_Obj09A_VxAyCoVnce = 0;
  $CAN_PrivFront::RFR_Obj09A::RFR_Obj09A_VxVnce = 0;
  }
  if(init_count == 23)
  {
  $CAN_PrivFront::RFR_Obj09A::RFR_Obj09A_VxVyCoVnce = 0;
  $CAN_PrivFront::RFR_Obj09A::RFR_Obj09A_Vy = -64;
  $CAN_PrivFront::RFR_Obj09A::RFR_Obj09A_VyAxCoVnce = 0;
  $CAN_PrivFront::RFR_Obj09A::RFR_Obj09A_VyAyCoVnce = 0;
  $CAN_PrivFront::RFR_Obj09A::RFR_Obj09A_VyVnce = 0;
  $CAN_PrivFront::RFR_Obj09A::RFR_Obj09A_Width = 0;
  $CAN_PrivFront::RFR_Obj09A::RFR_Obj09A_WidthVnce = 0;
  $CAN_PrivFront::RFR_Obj09B::RFR_Obj09B_BehaviorType = 0;
  $CAN_PrivFront::RFR_Obj09B::RFR_Obj09B_MovingObserved = 0;
  $CAN_PrivFront::RFR_Obj09B::RFR_Obj09B_MovingProbability = 0;
  $CAN_PrivFront::RFR_Obj09B::RFR_Obj09B_Prob4PlusWhlCAR = 0;
  $CAN_PrivFront::RFR_Obj09B::RFR_Obj09B_Prob4PlusWhlbHGV = 0;
  $CAN_PrivFront::RFR_Obj09B::RFR_Obj09B_ProbGNDReflex = 0;
  $CAN_PrivFront::RFR_Obj09B::RFR_Obj09B_ProbMob2Whl = 0;
  $CAN_PrivFront::RFR_Obj09B::RFR_Obj09B_ProbMob4PlusWhl = 0;
  $CAN_PrivFront::RFR_Obj09B::RFR_Obj09B_ProbMobPed = 0;
  $CAN_PrivFront::RFR_Obj09B::RFR_Obj09B_ProbStatBarrier = 0;
  $CAN_PrivFront::RFR_Obj09B::RFR_Obj09B_ProbStatObst = 0;
  $CAN_PrivFront::RFR_ObjHdr::RFR_ObjHdr_AziOutOfSpec = 0;
  $CAN_PrivFront::RFR_ObjHdr::RFR_ObjHdr_DetectionRange = 300;
  $CAN_PrivFront::RFR_ObjHdr::RFR_ObjHdr_ElevOutOfSpec = 0;
  $CAN_PrivFront::RFR_ObjHdr::RFR_ObjHdr_MountPosX = 3.298;
  $CAN_PrivFront::RFR_ObjHdr::RFR_ObjHdr_MountPosY = -0.774;
  $CAN_PrivFront::RFR_ObjHdr::RFR_ObjHdr_MountPosZ = 0.4;
  $CAN_PrivFront::RFR_ObjHdr::RFR_ObjHdr_ObjectDownSel = 0;
  }
  if(init_count == 24)
  {
  $CAN_PrivFront::RFR_ObjHdr::RFR_ObjHdr_PitchAngleLower = -0.2618;
  $CAN_PrivFront::RFR_ObjHdr::RFR_ObjHdr_PitchAngleUpper = 0.26163;
  $CAN_PrivFront::RFR_ObjHdr::RFR_ObjHdr_PitchMountAngle = 0.01326;
  $CAN_PrivFront::RFR_ObjHdr::RFR_ObjHdr_ProtObjectCount = 0;
  $CAN_PrivFront::RFR_ObjHdr::RFR_ObjHdr_ProtRSBPointCount = 0;
  $CAN_PrivFront::RFR_ObjHdr::RFR_ObjHdr_ProtRSBSegmentCount = 0;
  $CAN_PrivFront::RFR_ObjHdr::RFR_ObjHdr_ProtocolVersion = 263;
  $CAN_PrivFront::RFR_ObjHdr::RFR_ObjHdr_RollMountAngle = 0;
  $CAN_PrivFront::RFR_ObjHdr::RFR_ObjHdr_SensorState = 0;
  $CAN_PrivFront::RFR_ObjHdr::RFR_ObjHdr_TimeStamp = 0;
  $CAN_PrivFront::RFR_ObjHdr::RFR_ObjHdr_TimeStampLocal = 0;
  $CAN_PrivFront::RFR_ObjHdr::RFR_ObjHdr_TimeStampStatus = 0;
  $CAN_PrivFront::RFR_ObjHdr::RFR_ObjHdr_YawAngleLower = -1.30883;
  $CAN_PrivFront::RFR_ObjHdr::RFR_ObjHdr_YawAngleUpper = 1.30883;
  $CAN_PrivFront::RFR_ObjHdr::RFR_ObjHdr_YawMountAngle = -0.78539816;
  $CAN_PrivFront::RFR_Status::RFR_Status_ModulationStatus = 0;
  $CAN_PrivFront::RFR_Status::RFR_Status_SensorState = 0;
  if (prestart_mode==0) init_count = 0;
  initFlag = 3;
  }
  init_count++;
}
void init_CRadarRL_VW_GOLF_VII_ROTA()
{
  if(init_count == 1)
  {
  $CAN_PrivRear::RRL_AEB_Request::RRL_AEB_CU = 0;
  $CAN_PrivRear::RRL_AEB_Request::RRL_AEB_DummyForFuture = 0;
  $CAN_PrivRear::RRL_AEB_Request::RRL_AEB_FPC = 0;
  $CAN_PrivRear::RRL_AEB_Request::RRL_AEB_LTA = 0;
  $CAN_PrivRear::RRL_AEB_Request::RRL_AEB_ObjID = 0;
  $CAN_PrivRear::RRL_AEB_Request::RRL_AEB_VRU = 0;
  $CAN_PrivRear::RRL_AEB_Request::RRL_AEB_VRUTA = 0;
  $CAN_PrivRear::RRL_AEB_Request::RRL_Ax_CommandValue = 0;
  $CAN_PrivRear::RRL_Obj00A::RRL_Obj00A_Ax = -16;
  $CAN_PrivRear::RRL_Obj00A::RRL_Obj00A_AxAyCoVnce = 0;
  $CAN_PrivRear::RRL_Obj00A::RRL_Obj00A_AxVnce = 0;
  $CAN_PrivRear::RRL_Obj00A::RRL_Obj00A_Ay = -16;
  $CAN_PrivRear::RRL_Obj00A::RRL_Obj00A_AyVnce = 0;
  $CAN_PrivRear::RRL_Obj00A::RRL_Obj00A_Dx = -256;
  $CAN_PrivRear::RRL_Obj00A::RRL_Obj00A_DxAxCoVnce = 0;
  $CAN_PrivRear::RRL_Obj00A::RRL_Obj00A_DxAyCoVnce = 0;
  $CAN_PrivRear::RRL_Obj00A::RRL_Obj00A_DxDyCoVnce = 0;
  $CAN_PrivRear::RRL_Obj00A::RRL_Obj00A_DxVnce = 0;
  $CAN_PrivRear::RRL_Obj00A::RRL_Obj00A_DxVxCoVnce = 0;
  $CAN_PrivRear::RRL_Obj00A::RRL_Obj00A_DxVyCoVnce = 0;
  $CAN_PrivRear::RRL_Obj00A::RRL_Obj00A_Dy = -128;
  $CAN_PrivRear::RRL_Obj00A::RRL_Obj00A_DyAxCoVnce = 0;
  $CAN_PrivRear::RRL_Obj00A::RRL_Obj00A_DyAyCoVnce = 0;
  $CAN_PrivRear::RRL_Obj00A::RRL_Obj00A_DyVnce = 0;
  $CAN_PrivRear::RRL_Obj00A::RRL_Obj00A_DyVxCoVnce = 0;
  }
  if(init_count == 2)
  {
  $CAN_PrivRear::RRL_Obj00A::RRL_Obj00A_DyVyCoVnce = 0;
  $CAN_PrivRear::RRL_Obj00A::RRL_Obj00A_Dz = -5;
  $CAN_PrivRear::RRL_Obj00A::RRL_Obj00A_DzVnce = 0;
  $CAN_PrivRear::RRL_Obj00A::RRL_Obj00A_HeadingYawAngle = -4.48;
  $CAN_PrivRear::RRL_Obj00A::RRL_Obj00A_HeadingYawAngleVnce = 0;
  $CAN_PrivRear::RRL_Obj00A::RRL_Obj00A_Height = 0;
  $CAN_PrivRear::RRL_Obj00A::RRL_Obj00A_HeightVnce = 0;
  $CAN_PrivRear::RRL_Obj00A::RRL_Obj00A_ID = 0;
  $CAN_PrivRear::RRL_Obj00A::RRL_Obj00A_Length = 0;
  $CAN_PrivRear::RRL_Obj00A::RRL_Obj00A_LengthVnce = 0;
  $CAN_PrivRear::RRL_Obj00A::RRL_Obj00A_Measured = 0;
  $CAN_PrivRear::RRL_Obj00A::RRL_Obj00A_ProbExist = 0;
  $CAN_PrivRear::RRL_Obj00A::RRL_Obj00A_ProbMobileObst = 0;
  $CAN_PrivRear::RRL_Obj00A::RRL_Obj00A_ProbNonObstacle = 0;
  $CAN_PrivRear::RRL_Obj00A::RRL_Obj00A_ProbObstacle = 0;
  $CAN_PrivRear::RRL_Obj00A::RRL_Obj00A_RefPosIndex = 0;
  $CAN_PrivRear::RRL_Obj00A::RRL_Obj00A_Valid = 0;
  $CAN_PrivRear::RRL_Obj00A::RRL_Obj00A_Vx = -128;
  $CAN_PrivRear::RRL_Obj00A::RRL_Obj00A_VxAxCoVnce = 0;
  $CAN_PrivRear::RRL_Obj00A::RRL_Obj00A_VxAyCoVnce = 0;
  $CAN_PrivRear::RRL_Obj00A::RRL_Obj00A_VxVnce = 0;
  $CAN_PrivRear::RRL_Obj00A::RRL_Obj00A_VxVyCoVnce = 0;
  $CAN_PrivRear::RRL_Obj00A::RRL_Obj00A_Vy = -64;
  $CAN_PrivRear::RRL_Obj00A::RRL_Obj00A_VyAxCoVnce = 0;
  $CAN_PrivRear::RRL_Obj00A::RRL_Obj00A_VyAyCoVnce = 0;
  }
  if(init_count == 3)
  {
  $CAN_PrivRear::RRL_Obj00A::RRL_Obj00A_VyVnce = 0;
  $CAN_PrivRear::RRL_Obj00A::RRL_Obj00A_Width = 0;
  $CAN_PrivRear::RRL_Obj00A::RRL_Obj00A_WidthVnce = 0;
  $CAN_PrivRear::RRL_Obj00B::RRL_Obj00B_BehaviorType = 0;
  $CAN_PrivRear::RRL_Obj00B::RRL_Obj00B_MovingObserved = 0;
  $CAN_PrivRear::RRL_Obj00B::RRL_Obj00B_MovingProbability = 0;
  $CAN_PrivRear::RRL_Obj00B::RRL_Obj00B_Prob4PlusWhlCAR = 0;
  $CAN_PrivRear::RRL_Obj00B::RRL_Obj00B_Prob4PlusWhlbHGV = 0;
  $CAN_PrivRear::RRL_Obj00B::RRL_Obj00B_ProbGNDReflex = 0;
  $CAN_PrivRear::RRL_Obj00B::RRL_Obj00B_ProbMob2Whl = 0;
  $CAN_PrivRear::RRL_Obj00B::RRL_Obj00B_ProbMob4PlusWhl = 0;
  $CAN_PrivRear::RRL_Obj00B::RRL_Obj00B_ProbMobPed = 0;
  $CAN_PrivRear::RRL_Obj00B::RRL_Obj00B_ProbStatBarrier = 0;
  $CAN_PrivRear::RRL_Obj00B::RRL_Obj00B_ProbStatObst = 0;
  $CAN_PrivRear::RRL_Obj01A::RRL_Obj01A_Ax = -16;
  $CAN_PrivRear::RRL_Obj01A::RRL_Obj01A_AxAyCoVnce = 0;
  $CAN_PrivRear::RRL_Obj01A::RRL_Obj01A_AxVnce = 0;
  $CAN_PrivRear::RRL_Obj01A::RRL_Obj01A_Ay = -16;
  $CAN_PrivRear::RRL_Obj01A::RRL_Obj01A_AyVnce = 0;
  $CAN_PrivRear::RRL_Obj01A::RRL_Obj01A_Dx = -256;
  $CAN_PrivRear::RRL_Obj01A::RRL_Obj01A_DxAxCoVnce = 0;
  $CAN_PrivRear::RRL_Obj01A::RRL_Obj01A_DxAyCoVnce = 0;
  $CAN_PrivRear::RRL_Obj01A::RRL_Obj01A_DxDyCoVnce = 0;
  $CAN_PrivRear::RRL_Obj01A::RRL_Obj01A_DxVnce = 0;
  $CAN_PrivRear::RRL_Obj01A::RRL_Obj01A_DxVxCoVnce = 0;
  }
  if(init_count == 4)
  {
  $CAN_PrivRear::RRL_Obj01A::RRL_Obj01A_DxVyCoVnce = 0;
  $CAN_PrivRear::RRL_Obj01A::RRL_Obj01A_Dy = -128;
  $CAN_PrivRear::RRL_Obj01A::RRL_Obj01A_DyAxCoVnce = 0;
  $CAN_PrivRear::RRL_Obj01A::RRL_Obj01A_DyAyCoVnce = 0;
  $CAN_PrivRear::RRL_Obj01A::RRL_Obj01A_DyVnce = 0;
  $CAN_PrivRear::RRL_Obj01A::RRL_Obj01A_DyVxCoVnce = 0;
  $CAN_PrivRear::RRL_Obj01A::RRL_Obj01A_DyVyCoVnce = 0;
  $CAN_PrivRear::RRL_Obj01A::RRL_Obj01A_Dz = -5;
  $CAN_PrivRear::RRL_Obj01A::RRL_Obj01A_DzVnce = 0;
  $CAN_PrivRear::RRL_Obj01A::RRL_Obj01A_HeadingYawAngle = -4.48;
  $CAN_PrivRear::RRL_Obj01A::RRL_Obj01A_HeadingYawAngleVnce = 0;
  $CAN_PrivRear::RRL_Obj01A::RRL_Obj01A_Height = 0;
  $CAN_PrivRear::RRL_Obj01A::RRL_Obj01A_HeightVnce = 0;
  $CAN_PrivRear::RRL_Obj01A::RRL_Obj01A_ID = 0;
  $CAN_PrivRear::RRL_Obj01A::RRL_Obj01A_Length = 0;
  $CAN_PrivRear::RRL_Obj01A::RRL_Obj01A_LengthVnce = 0;
  $CAN_PrivRear::RRL_Obj01A::RRL_Obj01A_Measured = 0;
  $CAN_PrivRear::RRL_Obj01A::RRL_Obj01A_ProbExist = 0;
  $CAN_PrivRear::RRL_Obj01A::RRL_Obj01A_ProbMobileObst = 0;
  $CAN_PrivRear::RRL_Obj01A::RRL_Obj01A_ProbNonObstacle = 0;
  $CAN_PrivRear::RRL_Obj01A::RRL_Obj01A_ProbObstacle = 0;
  $CAN_PrivRear::RRL_Obj01A::RRL_Obj01A_RefPosIndex = 0;
  $CAN_PrivRear::RRL_Obj01A::RRL_Obj01A_Valid = 0;
  $CAN_PrivRear::RRL_Obj01A::RRL_Obj01A_Vx = -128;
  $CAN_PrivRear::RRL_Obj01A::RRL_Obj01A_VxAxCoVnce = 0;
  }
  if(init_count == 5)
  {
  $CAN_PrivRear::RRL_Obj01A::RRL_Obj01A_VxAyCoVnce = 0;
  $CAN_PrivRear::RRL_Obj01A::RRL_Obj01A_VxVnce = 0;
  $CAN_PrivRear::RRL_Obj01A::RRL_Obj01A_VxVyCoVnce = 0;
  $CAN_PrivRear::RRL_Obj01A::RRL_Obj01A_Vy = -64;
  $CAN_PrivRear::RRL_Obj01A::RRL_Obj01A_VyAxCoVnce = 0;
  $CAN_PrivRear::RRL_Obj01A::RRL_Obj01A_VyAyCoVnce = 0;
  $CAN_PrivRear::RRL_Obj01A::RRL_Obj01A_VyVnce = 0;
  $CAN_PrivRear::RRL_Obj01A::RRL_Obj01A_Width = 0;
  $CAN_PrivRear::RRL_Obj01A::RRL_Obj01A_WidthVnce = 0;
  $CAN_PrivRear::RRL_Obj01B::RRL_Obj01B_BehaviorType = 0;
  $CAN_PrivRear::RRL_Obj01B::RRL_Obj01B_MovingObserved = 0;
  $CAN_PrivRear::RRL_Obj01B::RRL_Obj01B_MovingProbability = 0;
  $CAN_PrivRear::RRL_Obj01B::RRL_Obj01B_Prob4PlusWhlCAR = 0;
  $CAN_PrivRear::RRL_Obj01B::RRL_Obj01B_Prob4PlusWhlbHGV = 0;
  $CAN_PrivRear::RRL_Obj01B::RRL_Obj01B_ProbGNDReflex = 0;
  $CAN_PrivRear::RRL_Obj01B::RRL_Obj01B_ProbMob2Whl = 0;
  $CAN_PrivRear::RRL_Obj01B::RRL_Obj01B_ProbMob4PlusWhl = 0;
  $CAN_PrivRear::RRL_Obj01B::RRL_Obj01B_ProbMobPed = 0;
  $CAN_PrivRear::RRL_Obj01B::RRL_Obj01B_ProbStatBarrier = 0;
  $CAN_PrivRear::RRL_Obj01B::RRL_Obj01B_ProbStatObst = 0;
  $CAN_PrivRear::RRL_Obj02A::RRL_Obj02A_Ax = -16;
  $CAN_PrivRear::RRL_Obj02A::RRL_Obj02A_AxAyCoVnce = 0;
  $CAN_PrivRear::RRL_Obj02A::RRL_Obj02A_AxVnce = 0;
  $CAN_PrivRear::RRL_Obj02A::RRL_Obj02A_Ay = -16;
  $CAN_PrivRear::RRL_Obj02A::RRL_Obj02A_AyVnce = 0;
  }
  if(init_count == 6)
  {
  $CAN_PrivRear::RRL_Obj02A::RRL_Obj02A_Dx = -256;
  $CAN_PrivRear::RRL_Obj02A::RRL_Obj02A_DxAxCoVnce = 0;
  $CAN_PrivRear::RRL_Obj02A::RRL_Obj02A_DxAyCoVnce = 0;
  $CAN_PrivRear::RRL_Obj02A::RRL_Obj02A_DxDyCoVnce = 0;
  $CAN_PrivRear::RRL_Obj02A::RRL_Obj02A_DxVnce = 0;
  $CAN_PrivRear::RRL_Obj02A::RRL_Obj02A_DxVxCoVnce = 0;
  $CAN_PrivRear::RRL_Obj02A::RRL_Obj02A_DxVyCoVnce = 0;
  $CAN_PrivRear::RRL_Obj02A::RRL_Obj02A_Dy = -128;
  $CAN_PrivRear::RRL_Obj02A::RRL_Obj02A_DyAxCoVnce = 0;
  $CAN_PrivRear::RRL_Obj02A::RRL_Obj02A_DyAyCoVnce = 0;
  $CAN_PrivRear::RRL_Obj02A::RRL_Obj02A_DyVnce = 0;
  $CAN_PrivRear::RRL_Obj02A::RRL_Obj02A_DyVxCoVnce = 0;
  $CAN_PrivRear::RRL_Obj02A::RRL_Obj02A_DyVyCoVnce = 0;
  $CAN_PrivRear::RRL_Obj02A::RRL_Obj02A_Dz = -5;
  $CAN_PrivRear::RRL_Obj02A::RRL_Obj02A_DzVnce = 0;
  $CAN_PrivRear::RRL_Obj02A::RRL_Obj02A_HeadingYawAngle = -4.48;
  $CAN_PrivRear::RRL_Obj02A::RRL_Obj02A_HeadingYawAngleVnce = 0;
  $CAN_PrivRear::RRL_Obj02A::RRL_Obj02A_Height = 0;
  $CAN_PrivRear::RRL_Obj02A::RRL_Obj02A_HeightVnce = 0;
  $CAN_PrivRear::RRL_Obj02A::RRL_Obj02A_ID = 0;
  $CAN_PrivRear::RRL_Obj02A::RRL_Obj02A_Length = 0;
  $CAN_PrivRear::RRL_Obj02A::RRL_Obj02A_LengthVnce = 0;
  $CAN_PrivRear::RRL_Obj02A::RRL_Obj02A_Measured = 0;
  $CAN_PrivRear::RRL_Obj02A::RRL_Obj02A_ProbExist = 0;
  $CAN_PrivRear::RRL_Obj02A::RRL_Obj02A_ProbMobileObst = 0;
  }
  if(init_count == 7)
  {
  $CAN_PrivRear::RRL_Obj02A::RRL_Obj02A_ProbNonObstacle = 0;
  $CAN_PrivRear::RRL_Obj02A::RRL_Obj02A_ProbObstacle = 0;
  $CAN_PrivRear::RRL_Obj02A::RRL_Obj02A_RefPosIndex = 0;
  $CAN_PrivRear::RRL_Obj02A::RRL_Obj02A_Valid = 0;
  $CAN_PrivRear::RRL_Obj02A::RRL_Obj02A_Vx = -128;
  $CAN_PrivRear::RRL_Obj02A::RRL_Obj02A_VxAxCoVnce = 0;
  $CAN_PrivRear::RRL_Obj02A::RRL_Obj02A_VxAyCoVnce = 0;
  $CAN_PrivRear::RRL_Obj02A::RRL_Obj02A_VxVnce = 0;
  $CAN_PrivRear::RRL_Obj02A::RRL_Obj02A_VxVyCoVnce = 0;
  $CAN_PrivRear::RRL_Obj02A::RRL_Obj02A_Vy = -64;
  $CAN_PrivRear::RRL_Obj02A::RRL_Obj02A_VyAxCoVnce = 0;
  $CAN_PrivRear::RRL_Obj02A::RRL_Obj02A_VyAyCoVnce = 0;
  $CAN_PrivRear::RRL_Obj02A::RRL_Obj02A_VyVnce = 0;
  $CAN_PrivRear::RRL_Obj02A::RRL_Obj02A_Width = 0;
  $CAN_PrivRear::RRL_Obj02A::RRL_Obj02A_WidthVnce = 0;
  $CAN_PrivRear::RRL_Obj02B::RRL_Obj02B_BehaviorType = 0;
  $CAN_PrivRear::RRL_Obj02B::RRL_Obj02B_MovingObserved = 0;
  $CAN_PrivRear::RRL_Obj02B::RRL_Obj02B_MovingProbability = 0;
  $CAN_PrivRear::RRL_Obj02B::RRL_Obj02B_Prob4PlusWhlCAR = 0;
  $CAN_PrivRear::RRL_Obj02B::RRL_Obj02B_Prob4PlusWhlbHGV = 0;
  $CAN_PrivRear::RRL_Obj02B::RRL_Obj02B_ProbGNDReflex = 0;
  $CAN_PrivRear::RRL_Obj02B::RRL_Obj02B_ProbMob2Whl = 0;
  $CAN_PrivRear::RRL_Obj02B::RRL_Obj02B_ProbMob4PlusWhl = 0;
  $CAN_PrivRear::RRL_Obj02B::RRL_Obj02B_ProbMobPed = 0;
  $CAN_PrivRear::RRL_Obj02B::RRL_Obj02B_ProbStatBarrier = 0;
  }
  if(init_count == 8)
  {
  $CAN_PrivRear::RRL_Obj02B::RRL_Obj02B_ProbStatObst = 0;
  $CAN_PrivRear::RRL_Obj03A::RRL_Obj03A_Ax = -16;
  $CAN_PrivRear::RRL_Obj03A::RRL_Obj03A_AxAyCoVnce = 0;
  $CAN_PrivRear::RRL_Obj03A::RRL_Obj03A_AxVnce = 0;
  $CAN_PrivRear::RRL_Obj03A::RRL_Obj03A_Ay = -16;
  $CAN_PrivRear::RRL_Obj03A::RRL_Obj03A_AyVnce = 0;
  $CAN_PrivRear::RRL_Obj03A::RRL_Obj03A_Dx = -256;
  $CAN_PrivRear::RRL_Obj03A::RRL_Obj03A_DxAxCoVnce = 0;
  $CAN_PrivRear::RRL_Obj03A::RRL_Obj03A_DxAyCoVnce = 0;
  $CAN_PrivRear::RRL_Obj03A::RRL_Obj03A_DxDyCoVnce = 0;
  $CAN_PrivRear::RRL_Obj03A::RRL_Obj03A_DxVnce = 0;
  $CAN_PrivRear::RRL_Obj03A::RRL_Obj03A_DxVxCoVnce = 0;
  $CAN_PrivRear::RRL_Obj03A::RRL_Obj03A_DxVyCoVnce = 0;
  $CAN_PrivRear::RRL_Obj03A::RRL_Obj03A_Dy = -128;
  $CAN_PrivRear::RRL_Obj03A::RRL_Obj03A_DyAxCoVnce = 0;
  $CAN_PrivRear::RRL_Obj03A::RRL_Obj03A_DyAyCoVnce = 0;
  $CAN_PrivRear::RRL_Obj03A::RRL_Obj03A_DyVnce = 0;
  $CAN_PrivRear::RRL_Obj03A::RRL_Obj03A_DyVxCoVnce = 0;
  $CAN_PrivRear::RRL_Obj03A::RRL_Obj03A_DyVyCoVnce = 0;
  $CAN_PrivRear::RRL_Obj03A::RRL_Obj03A_Dz = -5;
  $CAN_PrivRear::RRL_Obj03A::RRL_Obj03A_DzVnce = 0;
  $CAN_PrivRear::RRL_Obj03A::RRL_Obj03A_HeadingYawAngle = -4.48;
  $CAN_PrivRear::RRL_Obj03A::RRL_Obj03A_HeadingYawAngleVnce = 0;
  $CAN_PrivRear::RRL_Obj03A::RRL_Obj03A_Height = 0;
  $CAN_PrivRear::RRL_Obj03A::RRL_Obj03A_HeightVnce = 0;
  }
  if(init_count == 9)
  {
  $CAN_PrivRear::RRL_Obj03A::RRL_Obj03A_ID = 0;
  $CAN_PrivRear::RRL_Obj03A::RRL_Obj03A_Length = 0;
  $CAN_PrivRear::RRL_Obj03A::RRL_Obj03A_LengthVnce = 0;
  $CAN_PrivRear::RRL_Obj03A::RRL_Obj03A_Measured = 0;
  $CAN_PrivRear::RRL_Obj03A::RRL_Obj03A_ProbExist = 0;
  $CAN_PrivRear::RRL_Obj03A::RRL_Obj03A_ProbMobileObst = 0;
  $CAN_PrivRear::RRL_Obj03A::RRL_Obj03A_ProbNonObstacle = 0;
  $CAN_PrivRear::RRL_Obj03A::RRL_Obj03A_ProbObstacle = 0;
  $CAN_PrivRear::RRL_Obj03A::RRL_Obj03A_RefPosIndex = 0;
  $CAN_PrivRear::RRL_Obj03A::RRL_Obj03A_Valid = 0;
  $CAN_PrivRear::RRL_Obj03A::RRL_Obj03A_Vx = -128;
  $CAN_PrivRear::RRL_Obj03A::RRL_Obj03A_VxAxCoVnce = 0;
  $CAN_PrivRear::RRL_Obj03A::RRL_Obj03A_VxAyCoVnce = 0;
  $CAN_PrivRear::RRL_Obj03A::RRL_Obj03A_VxVnce = 0;
  $CAN_PrivRear::RRL_Obj03A::RRL_Obj03A_VxVyCoVnce = 0;
  $CAN_PrivRear::RRL_Obj03A::RRL_Obj03A_Vy = -64;
  $CAN_PrivRear::RRL_Obj03A::RRL_Obj03A_VyAxCoVnce = 0;
  $CAN_PrivRear::RRL_Obj03A::RRL_Obj03A_VyAyCoVnce = 0;
  $CAN_PrivRear::RRL_Obj03A::RRL_Obj03A_VyVnce = 0;
  $CAN_PrivRear::RRL_Obj03A::RRL_Obj03A_Width = 0;
  $CAN_PrivRear::RRL_Obj03A::RRL_Obj03A_WidthVnce = 0;
  $CAN_PrivRear::RRL_Obj03B::RRL_Obj03B_BehaviorType = 0;
  $CAN_PrivRear::RRL_Obj03B::RRL_Obj03B_MovingObserved = 0;
  $CAN_PrivRear::RRL_Obj03B::RRL_Obj03B_MovingProbability = 0;
  $CAN_PrivRear::RRL_Obj03B::RRL_Obj03B_Prob4PlusWhlCAR = 0;
  }
  if(init_count == 10)
  {
  $CAN_PrivRear::RRL_Obj03B::RRL_Obj03B_Prob4PlusWhlbHGV = 0;
  $CAN_PrivRear::RRL_Obj03B::RRL_Obj03B_ProbGNDReflex = 0;
  $CAN_PrivRear::RRL_Obj03B::RRL_Obj03B_ProbMob2Whl = 0;
  $CAN_PrivRear::RRL_Obj03B::RRL_Obj03B_ProbMob4PlusWhl = 0;
  $CAN_PrivRear::RRL_Obj03B::RRL_Obj03B_ProbMobPed = 0;
  $CAN_PrivRear::RRL_Obj03B::RRL_Obj03B_ProbStatBarrier = 0;
  $CAN_PrivRear::RRL_Obj03B::RRL_Obj03B_ProbStatObst = 0;
  $CAN_PrivRear::RRL_Obj04A::RRL_Obj04A_Ax = -16;
  $CAN_PrivRear::RRL_Obj04A::RRL_Obj04A_AxAyCoVnce = 0;
  $CAN_PrivRear::RRL_Obj04A::RRL_Obj04A_AxVnce = 0;
  $CAN_PrivRear::RRL_Obj04A::RRL_Obj04A_Ay = -16;
  $CAN_PrivRear::RRL_Obj04A::RRL_Obj04A_AyVnce = 0;
  $CAN_PrivRear::RRL_Obj04A::RRL_Obj04A_Dx = -256;
  $CAN_PrivRear::RRL_Obj04A::RRL_Obj04A_DxAxCoVnce = 0;
  $CAN_PrivRear::RRL_Obj04A::RRL_Obj04A_DxAyCoVnce = 0;
  $CAN_PrivRear::RRL_Obj04A::RRL_Obj04A_DxDyCoVnce = 0;
  $CAN_PrivRear::RRL_Obj04A::RRL_Obj04A_DxVnce = 0;
  $CAN_PrivRear::RRL_Obj04A::RRL_Obj04A_DxVxCoVnce = 0;
  $CAN_PrivRear::RRL_Obj04A::RRL_Obj04A_DxVyCoVnce = 0;
  $CAN_PrivRear::RRL_Obj04A::RRL_Obj04A_Dy = -128;
  $CAN_PrivRear::RRL_Obj04A::RRL_Obj04A_DyAxCoVnce = 0;
  $CAN_PrivRear::RRL_Obj04A::RRL_Obj04A_DyAyCoVnce = 0;
  $CAN_PrivRear::RRL_Obj04A::RRL_Obj04A_DyVnce = 0;
  $CAN_PrivRear::RRL_Obj04A::RRL_Obj04A_DyVxCoVnce = 0;
  $CAN_PrivRear::RRL_Obj04A::RRL_Obj04A_DyVyCoVnce = 0;
  }
  if(init_count == 11)
  {
  $CAN_PrivRear::RRL_Obj04A::RRL_Obj04A_Dz = -5;
  $CAN_PrivRear::RRL_Obj04A::RRL_Obj04A_DzVnce = 0;
  $CAN_PrivRear::RRL_Obj04A::RRL_Obj04A_HeadingYawAngle = -4.48;
  $CAN_PrivRear::RRL_Obj04A::RRL_Obj04A_HeadingYawAngleVnce = 0;
  $CAN_PrivRear::RRL_Obj04A::RRL_Obj04A_Height = 0;
  $CAN_PrivRear::RRL_Obj04A::RRL_Obj04A_HeightVnce = 0;
  $CAN_PrivRear::RRL_Obj04A::RRL_Obj04A_ID = 0;
  $CAN_PrivRear::RRL_Obj04A::RRL_Obj04A_Length = 0;
  $CAN_PrivRear::RRL_Obj04A::RRL_Obj04A_LengthVnce = 0;
  $CAN_PrivRear::RRL_Obj04A::RRL_Obj04A_Measured = 0;
  $CAN_PrivRear::RRL_Obj04A::RRL_Obj04A_ProbExist = 0;
  $CAN_PrivRear::RRL_Obj04A::RRL_Obj04A_ProbMobileObst = 0;
  $CAN_PrivRear::RRL_Obj04A::RRL_Obj04A_ProbNonObstacle = 0;
  $CAN_PrivRear::RRL_Obj04A::RRL_Obj04A_ProbObstacle = 0;
  $CAN_PrivRear::RRL_Obj04A::RRL_Obj04A_RefPosIndex = 0;
  $CAN_PrivRear::RRL_Obj04A::RRL_Obj04A_Valid = 0;
  $CAN_PrivRear::RRL_Obj04A::RRL_Obj04A_Vx = -128;
  $CAN_PrivRear::RRL_Obj04A::RRL_Obj04A_VxAxCoVnce = 0;
  $CAN_PrivRear::RRL_Obj04A::RRL_Obj04A_VxAyCoVnce = 0;
  $CAN_PrivRear::RRL_Obj04A::RRL_Obj04A_VxVnce = 0;
  $CAN_PrivRear::RRL_Obj04A::RRL_Obj04A_VxVyCoVnce = 0;
  $CAN_PrivRear::RRL_Obj04A::RRL_Obj04A_Vy = -64;
  $CAN_PrivRear::RRL_Obj04A::RRL_Obj04A_VyAxCoVnce = 0;
  $CAN_PrivRear::RRL_Obj04A::RRL_Obj04A_VyAyCoVnce = 0;
  $CAN_PrivRear::RRL_Obj04A::RRL_Obj04A_VyVnce = 0;
  }
  if(init_count == 12)
  {
  $CAN_PrivRear::RRL_Obj04A::RRL_Obj04A_Width = 0;
  $CAN_PrivRear::RRL_Obj04A::RRL_Obj04A_WidthVnce = 0;
  $CAN_PrivRear::RRL_Obj04B::RRL_Obj04B_BehaviorType = 0;
  $CAN_PrivRear::RRL_Obj04B::RRL_Obj04B_MovingObserved = 0;
  $CAN_PrivRear::RRL_Obj04B::RRL_Obj04B_MovingProbability = 0;
  $CAN_PrivRear::RRL_Obj04B::RRL_Obj04B_Prob4PlusWhlCAR = 0;
  $CAN_PrivRear::RRL_Obj04B::RRL_Obj04B_Prob4PlusWhlbHGV = 0;
  $CAN_PrivRear::RRL_Obj04B::RRL_Obj04B_ProbGNDReflex = 0;
  $CAN_PrivRear::RRL_Obj04B::RRL_Obj04B_ProbMob2Whl = 0;
  $CAN_PrivRear::RRL_Obj04B::RRL_Obj04B_ProbMob4PlusWhl = 0;
  $CAN_PrivRear::RRL_Obj04B::RRL_Obj04B_ProbMobPed = 0;
  $CAN_PrivRear::RRL_Obj04B::RRL_Obj04B_ProbStatBarrier = 0;
  $CAN_PrivRear::RRL_Obj04B::RRL_Obj04B_ProbStatObst = 0;
  $CAN_PrivRear::RRL_Obj05A::RRL_Obj05A_Ax = -16;
  $CAN_PrivRear::RRL_Obj05A::RRL_Obj05A_AxAyCoVnce = 0;
  $CAN_PrivRear::RRL_Obj05A::RRL_Obj05A_AxVnce = 0;
  $CAN_PrivRear::RRL_Obj05A::RRL_Obj05A_Ay = -16;
  $CAN_PrivRear::RRL_Obj05A::RRL_Obj05A_AyVnce = 0;
  $CAN_PrivRear::RRL_Obj05A::RRL_Obj05A_Dx = -256;
  $CAN_PrivRear::RRL_Obj05A::RRL_Obj05A_DxAxCoVnce = 0;
  $CAN_PrivRear::RRL_Obj05A::RRL_Obj05A_DxAyCoVnce = 0;
  $CAN_PrivRear::RRL_Obj05A::RRL_Obj05A_DxDyCoVnce = 0;
  $CAN_PrivRear::RRL_Obj05A::RRL_Obj05A_DxVnce = 0;
  $CAN_PrivRear::RRL_Obj05A::RRL_Obj05A_DxVxCoVnce = 0;
  $CAN_PrivRear::RRL_Obj05A::RRL_Obj05A_DxVyCoVnce = 0;
  }
  if(init_count == 13)
  {
  $CAN_PrivRear::RRL_Obj05A::RRL_Obj05A_Dy = -128;
  $CAN_PrivRear::RRL_Obj05A::RRL_Obj05A_DyAxCoVnce = 0;
  $CAN_PrivRear::RRL_Obj05A::RRL_Obj05A_DyAyCoVnce = 0;
  $CAN_PrivRear::RRL_Obj05A::RRL_Obj05A_DyVnce = 0;
  $CAN_PrivRear::RRL_Obj05A::RRL_Obj05A_DyVxCoVnce = 0;
  $CAN_PrivRear::RRL_Obj05A::RRL_Obj05A_DyVyCoVnce = 0;
  $CAN_PrivRear::RRL_Obj05A::RRL_Obj05A_Dz = -5;
  $CAN_PrivRear::RRL_Obj05A::RRL_Obj05A_DzVnce = 0;
  $CAN_PrivRear::RRL_Obj05A::RRL_Obj05A_HeadingYawAngle = -4.48;
  $CAN_PrivRear::RRL_Obj05A::RRL_Obj05A_HeadingYawAngleVnce = 0;
  $CAN_PrivRear::RRL_Obj05A::RRL_Obj05A_Height = 0;
  $CAN_PrivRear::RRL_Obj05A::RRL_Obj05A_HeightVnce = 0;
  $CAN_PrivRear::RRL_Obj05A::RRL_Obj05A_ID = 0;
  $CAN_PrivRear::RRL_Obj05A::RRL_Obj05A_Length = 0;
  $CAN_PrivRear::RRL_Obj05A::RRL_Obj05A_LengthVnce = 0;
  $CAN_PrivRear::RRL_Obj05A::RRL_Obj05A_Measured = 0;
  $CAN_PrivRear::RRL_Obj05A::RRL_Obj05A_ProbExist = 0;
  $CAN_PrivRear::RRL_Obj05A::RRL_Obj05A_ProbMobileObst = 0;
  $CAN_PrivRear::RRL_Obj05A::RRL_Obj05A_ProbNonObstacle = 0;
  $CAN_PrivRear::RRL_Obj05A::RRL_Obj05A_ProbObstacle = 0;
  $CAN_PrivRear::RRL_Obj05A::RRL_Obj05A_RefPosIndex = 0;
  $CAN_PrivRear::RRL_Obj05A::RRL_Obj05A_Valid = 0;
  $CAN_PrivRear::RRL_Obj05A::RRL_Obj05A_Vx = -128;
  $CAN_PrivRear::RRL_Obj05A::RRL_Obj05A_VxAxCoVnce = 0;
  $CAN_PrivRear::RRL_Obj05A::RRL_Obj05A_VxAyCoVnce = 0;
  }
  if(init_count == 14)
  {
  $CAN_PrivRear::RRL_Obj05A::RRL_Obj05A_VxVnce = 0;
  $CAN_PrivRear::RRL_Obj05A::RRL_Obj05A_VxVyCoVnce = 0;
  $CAN_PrivRear::RRL_Obj05A::RRL_Obj05A_Vy = -64;
  $CAN_PrivRear::RRL_Obj05A::RRL_Obj05A_VyAxCoVnce = 0;
  $CAN_PrivRear::RRL_Obj05A::RRL_Obj05A_VyAyCoVnce = 0;
  $CAN_PrivRear::RRL_Obj05A::RRL_Obj05A_VyVnce = 0;
  $CAN_PrivRear::RRL_Obj05A::RRL_Obj05A_Width = 0;
  $CAN_PrivRear::RRL_Obj05A::RRL_Obj05A_WidthVnce = 0;
  $CAN_PrivRear::RRL_Obj05B::RRL_Obj05B_BehaviorType = 0;
  $CAN_PrivRear::RRL_Obj05B::RRL_Obj05B_MovingObserved = 0;
  $CAN_PrivRear::RRL_Obj05B::RRL_Obj05B_MovingProbability = 0;
  $CAN_PrivRear::RRL_Obj05B::RRL_Obj05B_Prob4PlusWhlCAR = 0;
  $CAN_PrivRear::RRL_Obj05B::RRL_Obj05B_Prob4PlusWhlbHGV = 0;
  $CAN_PrivRear::RRL_Obj05B::RRL_Obj05B_ProbGNDReflex = 0;
  $CAN_PrivRear::RRL_Obj05B::RRL_Obj05B_ProbMob2Whl = 0;
  $CAN_PrivRear::RRL_Obj05B::RRL_Obj05B_ProbMob4PlusWhl = 0;
  $CAN_PrivRear::RRL_Obj05B::RRL_Obj05B_ProbMobPed = 0;
  $CAN_PrivRear::RRL_Obj05B::RRL_Obj05B_ProbStatBarrier = 0;
  $CAN_PrivRear::RRL_Obj05B::RRL_Obj05B_ProbStatObst = 0;
  $CAN_PrivRear::RRL_Obj06A::RRL_Obj06A_Ax = -16;
  $CAN_PrivRear::RRL_Obj06A::RRL_Obj06A_AxAyCoVnce = 0;
  $CAN_PrivRear::RRL_Obj06A::RRL_Obj06A_AxVnce = 0;
  $CAN_PrivRear::RRL_Obj06A::RRL_Obj06A_Ay = -16;
  $CAN_PrivRear::RRL_Obj06A::RRL_Obj06A_AyVnce = 0;
  $CAN_PrivRear::RRL_Obj06A::RRL_Obj06A_Dx = -256;
  }
  if(init_count == 15)
  {
  $CAN_PrivRear::RRL_Obj06A::RRL_Obj06A_DxAxCoVnce = 0;
  $CAN_PrivRear::RRL_Obj06A::RRL_Obj06A_DxAyCoVnce = 0;
  $CAN_PrivRear::RRL_Obj06A::RRL_Obj06A_DxDyCoVnce = 0;
  $CAN_PrivRear::RRL_Obj06A::RRL_Obj06A_DxVnce = 0;
  $CAN_PrivRear::RRL_Obj06A::RRL_Obj06A_DxVxCoVnce = 0;
  $CAN_PrivRear::RRL_Obj06A::RRL_Obj06A_DxVyCoVnce = 0;
  $CAN_PrivRear::RRL_Obj06A::RRL_Obj06A_Dy = -128;
  $CAN_PrivRear::RRL_Obj06A::RRL_Obj06A_DyAxCoVnce = 0;
  $CAN_PrivRear::RRL_Obj06A::RRL_Obj06A_DyAyCoVnce = 0;
  $CAN_PrivRear::RRL_Obj06A::RRL_Obj06A_DyVnce = 0;
  $CAN_PrivRear::RRL_Obj06A::RRL_Obj06A_DyVxCoVnce = 0;
  $CAN_PrivRear::RRL_Obj06A::RRL_Obj06A_DyVyCoVnce = 0;
  $CAN_PrivRear::RRL_Obj06A::RRL_Obj06A_Dz = -5;
  $CAN_PrivRear::RRL_Obj06A::RRL_Obj06A_DzVnce = 0;
  $CAN_PrivRear::RRL_Obj06A::RRL_Obj06A_HeadingYawAngle = -4.48;
  $CAN_PrivRear::RRL_Obj06A::RRL_Obj06A_HeadingYawAngleVnce = 0;
  $CAN_PrivRear::RRL_Obj06A::RRL_Obj06A_Height = 0;
  $CAN_PrivRear::RRL_Obj06A::RRL_Obj06A_HeightVnce = 0;
  $CAN_PrivRear::RRL_Obj06A::RRL_Obj06A_ID = 0;
  $CAN_PrivRear::RRL_Obj06A::RRL_Obj06A_Length = 0;
  $CAN_PrivRear::RRL_Obj06A::RRL_Obj06A_LengthVnce = 0;
  $CAN_PrivRear::RRL_Obj06A::RRL_Obj06A_Measured = 0;
  $CAN_PrivRear::RRL_Obj06A::RRL_Obj06A_ProbExist = 0;
  $CAN_PrivRear::RRL_Obj06A::RRL_Obj06A_ProbMobileObst = 0;
  $CAN_PrivRear::RRL_Obj06A::RRL_Obj06A_ProbNonObstacle = 0;
  }
  if(init_count == 16)
  {
  $CAN_PrivRear::RRL_Obj06A::RRL_Obj06A_ProbObstacle = 0;
  $CAN_PrivRear::RRL_Obj06A::RRL_Obj06A_RefPosIndex = 0;
  $CAN_PrivRear::RRL_Obj06A::RRL_Obj06A_Valid = 0;
  $CAN_PrivRear::RRL_Obj06A::RRL_Obj06A_Vx = -128;
  $CAN_PrivRear::RRL_Obj06A::RRL_Obj06A_VxAxCoVnce = 0;
  $CAN_PrivRear::RRL_Obj06A::RRL_Obj06A_VxAyCoVnce = 0;
  $CAN_PrivRear::RRL_Obj06A::RRL_Obj06A_VxVnce = 0;
  $CAN_PrivRear::RRL_Obj06A::RRL_Obj06A_VxVyCoVnce = 0;
  $CAN_PrivRear::RRL_Obj06A::RRL_Obj06A_Vy = -64;
  $CAN_PrivRear::RRL_Obj06A::RRL_Obj06A_VyAxCoVnce = 0;
  $CAN_PrivRear::RRL_Obj06A::RRL_Obj06A_VyAyCoVnce = 0;
  $CAN_PrivRear::RRL_Obj06A::RRL_Obj06A_VyVnce = 0;
  $CAN_PrivRear::RRL_Obj06A::RRL_Obj06A_Width = 0;
  $CAN_PrivRear::RRL_Obj06A::RRL_Obj06A_WidthVnce = 0;
  $CAN_PrivRear::RRL_Obj06B::RRL_Obj06B_BehaviorType = 0;
  $CAN_PrivRear::RRL_Obj06B::RRL_Obj06B_MovingObserved = 0;
  $CAN_PrivRear::RRL_Obj06B::RRL_Obj06B_MovingProbability = 0;
  $CAN_PrivRear::RRL_Obj06B::RRL_Obj06B_Prob4PlusWhlCAR = 0;
  $CAN_PrivRear::RRL_Obj06B::RRL_Obj06B_Prob4PlusWhlbHGV = 0;
  $CAN_PrivRear::RRL_Obj06B::RRL_Obj06B_ProbGNDReflex = 0;
  $CAN_PrivRear::RRL_Obj06B::RRL_Obj06B_ProbMob2Whl = 0;
  $CAN_PrivRear::RRL_Obj06B::RRL_Obj06B_ProbMob4PlusWhl = 0;
  $CAN_PrivRear::RRL_Obj06B::RRL_Obj06B_ProbMobPed = 0;
  $CAN_PrivRear::RRL_Obj06B::RRL_Obj06B_ProbStatBarrier = 0;
  $CAN_PrivRear::RRL_Obj06B::RRL_Obj06B_ProbStatObst = 0;
  }
  if(init_count == 17)
  {
  $CAN_PrivRear::RRL_Obj07A::RRL_Obj07A_Ax = -16;
  $CAN_PrivRear::RRL_Obj07A::RRL_Obj07A_AxAyCoVnce = 0;
  $CAN_PrivRear::RRL_Obj07A::RRL_Obj07A_AxVnce = 0;
  $CAN_PrivRear::RRL_Obj07A::RRL_Obj07A_Ay = -16;
  $CAN_PrivRear::RRL_Obj07A::RRL_Obj07A_AyVnce = 0;
  $CAN_PrivRear::RRL_Obj07A::RRL_Obj07A_Dx = -256;
  $CAN_PrivRear::RRL_Obj07A::RRL_Obj07A_DxAxCoVnce = 0;
  $CAN_PrivRear::RRL_Obj07A::RRL_Obj07A_DxAyCoVnce = 0;
  $CAN_PrivRear::RRL_Obj07A::RRL_Obj07A_DxDyCoVnce = 0;
  $CAN_PrivRear::RRL_Obj07A::RRL_Obj07A_DxVnce = 0;
  $CAN_PrivRear::RRL_Obj07A::RRL_Obj07A_DxVxCoVnce = 0;
  $CAN_PrivRear::RRL_Obj07A::RRL_Obj07A_DxVyCoVnce = 0;
  $CAN_PrivRear::RRL_Obj07A::RRL_Obj07A_Dy = -128;
  $CAN_PrivRear::RRL_Obj07A::RRL_Obj07A_DyAxCoVnce = 0;
  $CAN_PrivRear::RRL_Obj07A::RRL_Obj07A_DyAyCoVnce = 0;
  $CAN_PrivRear::RRL_Obj07A::RRL_Obj07A_DyVnce = 0;
  $CAN_PrivRear::RRL_Obj07A::RRL_Obj07A_DyVxCoVnce = 0;
  $CAN_PrivRear::RRL_Obj07A::RRL_Obj07A_DyVyCoVnce = 0;
  $CAN_PrivRear::RRL_Obj07A::RRL_Obj07A_Dz = -5;
  $CAN_PrivRear::RRL_Obj07A::RRL_Obj07A_DzVnce = 0;
  $CAN_PrivRear::RRL_Obj07A::RRL_Obj07A_HeadingYawAngle = -4.48;
  $CAN_PrivRear::RRL_Obj07A::RRL_Obj07A_HeadingYawAngleVnce = 0;
  $CAN_PrivRear::RRL_Obj07A::RRL_Obj07A_Height = 0;
  $CAN_PrivRear::RRL_Obj07A::RRL_Obj07A_HeightVnce = 0;
  $CAN_PrivRear::RRL_Obj07A::RRL_Obj07A_ID = 0;
  }
  if(init_count == 18)
  {
  $CAN_PrivRear::RRL_Obj07A::RRL_Obj07A_Length = 0;
  $CAN_PrivRear::RRL_Obj07A::RRL_Obj07A_LengthVnce = 0;
  $CAN_PrivRear::RRL_Obj07A::RRL_Obj07A_Measured = 0;
  $CAN_PrivRear::RRL_Obj07A::RRL_Obj07A_ProbExist = 0;
  $CAN_PrivRear::RRL_Obj07A::RRL_Obj07A_ProbMobileObst = 0;
  $CAN_PrivRear::RRL_Obj07A::RRL_Obj07A_ProbNonObstacle = 0;
  $CAN_PrivRear::RRL_Obj07A::RRL_Obj07A_ProbObstacle = 0;
  $CAN_PrivRear::RRL_Obj07A::RRL_Obj07A_RefPosIndex = 0;
  $CAN_PrivRear::RRL_Obj07A::RRL_Obj07A_Valid = 0;
  $CAN_PrivRear::RRL_Obj07A::RRL_Obj07A_Vx = -128;
  $CAN_PrivRear::RRL_Obj07A::RRL_Obj07A_VxAxCoVnce = 0;
  $CAN_PrivRear::RRL_Obj07A::RRL_Obj07A_VxAyCoVnce = 0;
  $CAN_PrivRear::RRL_Obj07A::RRL_Obj07A_VxVnce = 0;
  $CAN_PrivRear::RRL_Obj07A::RRL_Obj07A_VxVyCoVnce = 0;
  $CAN_PrivRear::RRL_Obj07A::RRL_Obj07A_Vy = -64;
  $CAN_PrivRear::RRL_Obj07A::RRL_Obj07A_VyAxCoVnce = 0;
  $CAN_PrivRear::RRL_Obj07A::RRL_Obj07A_VyAyCoVnce = 0;
  $CAN_PrivRear::RRL_Obj07A::RRL_Obj07A_VyVnce = 0;
  $CAN_PrivRear::RRL_Obj07A::RRL_Obj07A_Width = 0;
  $CAN_PrivRear::RRL_Obj07A::RRL_Obj07A_WidthVnce = 0;
  $CAN_PrivRear::RRL_Obj07B::RRL_Obj07B_BehaviorType = 0;
  $CAN_PrivRear::RRL_Obj07B::RRL_Obj07B_MovingObserved = 0;
  $CAN_PrivRear::RRL_Obj07B::RRL_Obj07B_MovingProbability = 0;
  $CAN_PrivRear::RRL_Obj07B::RRL_Obj07B_Prob4PlusWhlCAR = 0;
  $CAN_PrivRear::RRL_Obj07B::RRL_Obj07B_Prob4PlusWhlbHGV = 0;
  }
  if(init_count == 19)
  {
  $CAN_PrivRear::RRL_Obj07B::RRL_Obj07B_ProbGNDReflex = 0;
  $CAN_PrivRear::RRL_Obj07B::RRL_Obj07B_ProbMob2Whl = 0;
  $CAN_PrivRear::RRL_Obj07B::RRL_Obj07B_ProbMob4PlusWhl = 0;
  $CAN_PrivRear::RRL_Obj07B::RRL_Obj07B_ProbMobPed = 0;
  $CAN_PrivRear::RRL_Obj07B::RRL_Obj07B_ProbStatBarrier = 0;
  $CAN_PrivRear::RRL_Obj07B::RRL_Obj07B_ProbStatObst = 0;
  $CAN_PrivRear::RRL_Obj08A::RRL_Obj08A_Ax = -16;
  $CAN_PrivRear::RRL_Obj08A::RRL_Obj08A_AxAyCoVnce = 0;
  $CAN_PrivRear::RRL_Obj08A::RRL_Obj08A_AxVnce = 0;
  $CAN_PrivRear::RRL_Obj08A::RRL_Obj08A_Ay = -16;
  $CAN_PrivRear::RRL_Obj08A::RRL_Obj08A_AyVnce = 0;
  $CAN_PrivRear::RRL_Obj08A::RRL_Obj08A_Dx = -256;
  $CAN_PrivRear::RRL_Obj08A::RRL_Obj08A_DxAxCoVnce = 0;
  $CAN_PrivRear::RRL_Obj08A::RRL_Obj08A_DxAyCoVnce = 0;
  $CAN_PrivRear::RRL_Obj08A::RRL_Obj08A_DxDyCoVnce = 0;
  $CAN_PrivRear::RRL_Obj08A::RRL_Obj08A_DxVnce = 0;
  $CAN_PrivRear::RRL_Obj08A::RRL_Obj08A_DxVxCoVnce = 0;
  $CAN_PrivRear::RRL_Obj08A::RRL_Obj08A_DxVyCoVnce = 0;
  $CAN_PrivRear::RRL_Obj08A::RRL_Obj08A_Dy = -128;
  $CAN_PrivRear::RRL_Obj08A::RRL_Obj08A_DyAxCoVnce = 0;
  $CAN_PrivRear::RRL_Obj08A::RRL_Obj08A_DyAyCoVnce = 0;
  $CAN_PrivRear::RRL_Obj08A::RRL_Obj08A_DyVnce = 0;
  $CAN_PrivRear::RRL_Obj08A::RRL_Obj08A_DyVxCoVnce = 0;
  $CAN_PrivRear::RRL_Obj08A::RRL_Obj08A_DyVyCoVnce = 0;
  $CAN_PrivRear::RRL_Obj08A::RRL_Obj08A_Dz = -5;
  }
  if(init_count == 20)
  {
  $CAN_PrivRear::RRL_Obj08A::RRL_Obj08A_DzVnce = 0;
  $CAN_PrivRear::RRL_Obj08A::RRL_Obj08A_HeadingYawAngle = -4.48;
  $CAN_PrivRear::RRL_Obj08A::RRL_Obj08A_HeadingYawAngleVnce = 0;
  $CAN_PrivRear::RRL_Obj08A::RRL_Obj08A_Height = 0;
  $CAN_PrivRear::RRL_Obj08A::RRL_Obj08A_HeightVnce = 0;
  $CAN_PrivRear::RRL_Obj08A::RRL_Obj08A_ID = 0;
  $CAN_PrivRear::RRL_Obj08A::RRL_Obj08A_Length = 0;
  $CAN_PrivRear::RRL_Obj08A::RRL_Obj08A_LengthVnce = 0;
  $CAN_PrivRear::RRL_Obj08A::RRL_Obj08A_Measured = 0;
  $CAN_PrivRear::RRL_Obj08A::RRL_Obj08A_ProbExist = 0;
  $CAN_PrivRear::RRL_Obj08A::RRL_Obj08A_ProbMobileObst = 0;
  $CAN_PrivRear::RRL_Obj08A::RRL_Obj08A_ProbNonObstacle = 0;
  $CAN_PrivRear::RRL_Obj08A::RRL_Obj08A_ProbObstacle = 0;
  $CAN_PrivRear::RRL_Obj08A::RRL_Obj08A_RefPosIndex = 0;
  $CAN_PrivRear::RRL_Obj08A::RRL_Obj08A_Valid = 0;
  $CAN_PrivRear::RRL_Obj08A::RRL_Obj08A_Vx = -128;
  $CAN_PrivRear::RRL_Obj08A::RRL_Obj08A_VxAxCoVnce = 0;
  $CAN_PrivRear::RRL_Obj08A::RRL_Obj08A_VxAyCoVnce = 0;
  $CAN_PrivRear::RRL_Obj08A::RRL_Obj08A_VxVnce = 0;
  $CAN_PrivRear::RRL_Obj08A::RRL_Obj08A_VxVyCoVnce = 0;
  $CAN_PrivRear::RRL_Obj08A::RRL_Obj08A_Vy = -64;
  $CAN_PrivRear::RRL_Obj08A::RRL_Obj08A_VyAxCoVnce = 0;
  $CAN_PrivRear::RRL_Obj08A::RRL_Obj08A_VyAyCoVnce = 0;
  $CAN_PrivRear::RRL_Obj08A::RRL_Obj08A_VyVnce = 0;
  $CAN_PrivRear::RRL_Obj08A::RRL_Obj08A_Width = 0;
  }
  if(init_count == 21)
  {
  $CAN_PrivRear::RRL_Obj08A::RRL_Obj08A_WidthVnce = 0;
  $CAN_PrivRear::RRL_Obj08B::RRL_Obj08B_BehaviorType = 0;
  $CAN_PrivRear::RRL_Obj08B::RRL_Obj08B_MovingObserved = 0;
  $CAN_PrivRear::RRL_Obj08B::RRL_Obj08B_MovingProbability = 0;
  $CAN_PrivRear::RRL_Obj08B::RRL_Obj08B_Prob4PlusWhlCAR = 0;
  $CAN_PrivRear::RRL_Obj08B::RRL_Obj08B_Prob4PlusWhlbHGV = 0;
  $CAN_PrivRear::RRL_Obj08B::RRL_Obj08B_ProbGNDReflex = 0;
  $CAN_PrivRear::RRL_Obj08B::RRL_Obj08B_ProbMob2Whl = 0;
  $CAN_PrivRear::RRL_Obj08B::RRL_Obj08B_ProbMob4PlusWhl = 0;
  $CAN_PrivRear::RRL_Obj08B::RRL_Obj08B_ProbMobPed = 0;
  $CAN_PrivRear::RRL_Obj08B::RRL_Obj08B_ProbStatBarrier = 0;
  $CAN_PrivRear::RRL_Obj08B::RRL_Obj08B_ProbStatObst = 0;
  $CAN_PrivRear::RRL_Obj09A::RRL_Obj09A_Ax = -16;
  $CAN_PrivRear::RRL_Obj09A::RRL_Obj09A_AxAyCoVnce = 0;
  $CAN_PrivRear::RRL_Obj09A::RRL_Obj09A_AxVnce = 0;
  $CAN_PrivRear::RRL_Obj09A::RRL_Obj09A_Ay = -16;
  $CAN_PrivRear::RRL_Obj09A::RRL_Obj09A_AyVnce = 0;
  $CAN_PrivRear::RRL_Obj09A::RRL_Obj09A_Dx = -256;
  $CAN_PrivRear::RRL_Obj09A::RRL_Obj09A_DxAxCoVnce = 0;
  $CAN_PrivRear::RRL_Obj09A::RRL_Obj09A_DxAyCoVnce = 0;
  $CAN_PrivRear::RRL_Obj09A::RRL_Obj09A_DxDyCoVnce = 0;
  $CAN_PrivRear::RRL_Obj09A::RRL_Obj09A_DxVnce = 0;
  $CAN_PrivRear::RRL_Obj09A::RRL_Obj09A_DxVxCoVnce = 0;
  $CAN_PrivRear::RRL_Obj09A::RRL_Obj09A_DxVyCoVnce = 0;
  $CAN_PrivRear::RRL_Obj09A::RRL_Obj09A_Dy = -128;
  }
  if(init_count == 22)
  {
  $CAN_PrivRear::RRL_Obj09A::RRL_Obj09A_DyAxCoVnce = 0;
  $CAN_PrivRear::RRL_Obj09A::RRL_Obj09A_DyAyCoVnce = 0;
  $CAN_PrivRear::RRL_Obj09A::RRL_Obj09A_DyVnce = 0;
  $CAN_PrivRear::RRL_Obj09A::RRL_Obj09A_DyVxCoVnce = 0;
  $CAN_PrivRear::RRL_Obj09A::RRL_Obj09A_DyVyCoVnce = 0;
  $CAN_PrivRear::RRL_Obj09A::RRL_Obj09A_Dz = -5;
  $CAN_PrivRear::RRL_Obj09A::RRL_Obj09A_DzVnce = 0;
  $CAN_PrivRear::RRL_Obj09A::RRL_Obj09A_HeadingYawAngle = -4.48;
  $CAN_PrivRear::RRL_Obj09A::RRL_Obj09A_HeadingYawAngleVnce = 0;
  $CAN_PrivRear::RRL_Obj09A::RRL_Obj09A_Height = 0;
  $CAN_PrivRear::RRL_Obj09A::RRL_Obj09A_HeightVnce = 0;
  $CAN_PrivRear::RRL_Obj09A::RRL_Obj09A_ID = 0;
  $CAN_PrivRear::RRL_Obj09A::RRL_Obj09A_Length = 0;
  $CAN_PrivRear::RRL_Obj09A::RRL_Obj09A_LengthVnce = 0;
  $CAN_PrivRear::RRL_Obj09A::RRL_Obj09A_Measured = 0;
  $CAN_PrivRear::RRL_Obj09A::RRL_Obj09A_ProbExist = 0;
  $CAN_PrivRear::RRL_Obj09A::RRL_Obj09A_ProbMobileObst = 0;
  $CAN_PrivRear::RRL_Obj09A::RRL_Obj09A_ProbNonObstacle = 0;
  $CAN_PrivRear::RRL_Obj09A::RRL_Obj09A_ProbObstacle = 0;
  $CAN_PrivRear::RRL_Obj09A::RRL_Obj09A_RefPosIndex = 0;
  $CAN_PrivRear::RRL_Obj09A::RRL_Obj09A_Valid = 0;
  $CAN_PrivRear::RRL_Obj09A::RRL_Obj09A_Vx = -128;
  $CAN_PrivRear::RRL_Obj09A::RRL_Obj09A_VxAxCoVnce = 0;
  $CAN_PrivRear::RRL_Obj09A::RRL_Obj09A_VxAyCoVnce = 0;
  $CAN_PrivRear::RRL_Obj09A::RRL_Obj09A_VxVnce = 0;
  }
  if(init_count == 23)
  {
  $CAN_PrivRear::RRL_Obj09A::RRL_Obj09A_VxVyCoVnce = 0;
  $CAN_PrivRear::RRL_Obj09A::RRL_Obj09A_Vy = -64;
  $CAN_PrivRear::RRL_Obj09A::RRL_Obj09A_VyAxCoVnce = 0;
  $CAN_PrivRear::RRL_Obj09A::RRL_Obj09A_VyAyCoVnce = 0;
  $CAN_PrivRear::RRL_Obj09A::RRL_Obj09A_VyVnce = 0;
  $CAN_PrivRear::RRL_Obj09A::RRL_Obj09A_Width = 0;
  $CAN_PrivRear::RRL_Obj09A::RRL_Obj09A_WidthVnce = 0;
  $CAN_PrivRear::RRL_Obj09B::RRL_Obj09B_BehaviorType = 0;
  $CAN_PrivRear::RRL_Obj09B::RRL_Obj09B_MovingObserved = 0;
  $CAN_PrivRear::RRL_Obj09B::RRL_Obj09B_MovingProbability = 0;
  $CAN_PrivRear::RRL_Obj09B::RRL_Obj09B_Prob4PlusWhlCAR = 0;
  $CAN_PrivRear::RRL_Obj09B::RRL_Obj09B_Prob4PlusWhlbHGV = 0;
  $CAN_PrivRear::RRL_Obj09B::RRL_Obj09B_ProbGNDReflex = 0;
  $CAN_PrivRear::RRL_Obj09B::RRL_Obj09B_ProbMob2Whl = 0;
  $CAN_PrivRear::RRL_Obj09B::RRL_Obj09B_ProbMob4PlusWhl = 0;
  $CAN_PrivRear::RRL_Obj09B::RRL_Obj09B_ProbMobPed = 0;
  $CAN_PrivRear::RRL_Obj09B::RRL_Obj09B_ProbStatBarrier = 0;
  $CAN_PrivRear::RRL_Obj09B::RRL_Obj09B_ProbStatObst = 0;
  $CAN_PrivRear::RRL_ObjHdr::RRL_ObjHdr_AziOutOfSpec = 0;
  $CAN_PrivRear::RRL_ObjHdr::RRL_ObjHdr_DetectionRange = 300;
  $CAN_PrivRear::RRL_ObjHdr::RRL_ObjHdr_ElevOutOfSpec = 0;
  $CAN_PrivRear::RRL_ObjHdr::RRL_ObjHdr_MountPosX = -0.8;
  $CAN_PrivRear::RRL_ObjHdr::RRL_ObjHdr_MountPosY = 0.774;
  $CAN_PrivRear::RRL_ObjHdr::RRL_ObjHdr_MountPosZ = 0.4;
  $CAN_PrivRear::RRL_ObjHdr::RRL_ObjHdr_ObjectDownSel = 0;
  }
  if(init_count == 24)
  {
  $CAN_PrivRear::RRL_ObjHdr::RRL_ObjHdr_PitchAngleLower = -0.2618;
  $CAN_PrivRear::RRL_ObjHdr::RRL_ObjHdr_PitchAngleUpper = 0.26163;
  $CAN_PrivRear::RRL_ObjHdr::RRL_ObjHdr_PitchMountAngle = 0.01326;
  $CAN_PrivRear::RRL_ObjHdr::RRL_ObjHdr_ProtObjectCount = 0;
  $CAN_PrivRear::RRL_ObjHdr::RRL_ObjHdr_ProtRSBPointCount = 0;
  $CAN_PrivRear::RRL_ObjHdr::RRL_ObjHdr_ProtRSBSegmentCount = 0;
  $CAN_PrivRear::RRL_ObjHdr::RRL_ObjHdr_ProtocolVersion = 263;
  $CAN_PrivRear::RRL_ObjHdr::RRL_ObjHdr_RollMountAngle = 0;
  $CAN_PrivRear::RRL_ObjHdr::RRL_ObjHdr_SensorState = 0;
  $CAN_PrivRear::RRL_ObjHdr::RRL_ObjHdr_TimeStamp = 0;
  $CAN_PrivRear::RRL_ObjHdr::RRL_ObjHdr_TimeStampLocal = 0;
  $CAN_PrivRear::RRL_ObjHdr::RRL_ObjHdr_TimeStampStatus = 0;
  $CAN_PrivRear::RRL_ObjHdr::RRL_ObjHdr_YawAngleLower = -1.30883;
  $CAN_PrivRear::RRL_ObjHdr::RRL_ObjHdr_YawAngleUpper = 1.30883;
  $CAN_PrivRear::RRL_ObjHdr::RRL_ObjHdr_YawMountAngle = 2.356194490192;
  $CAN_PrivRear::RRL_Status::RRL_Status_ModulationStatus = 0;
  $CAN_PrivRear::RRL_Status::RRL_Status_SensorState = 0;
  if (prestart_mode==0) init_count = 0;
  initFlag = 4;
  }
  init_count++;
}
void init_CRadarRR_VW_GOLF_VII_ROTA()
{
  if(init_count == 1)
  {
  $CAN_PrivRear::RRR_AEB_Request::RRR_AEB_CU = 0;
  $CAN_PrivRear::RRR_AEB_Request::RRR_AEB_DummyForFuture = 0;
  $CAN_PrivRear::RRR_AEB_Request::RRR_AEB_FPC = 0;
  $CAN_PrivRear::RRR_AEB_Request::RRR_AEB_LTA = 0;
  $CAN_PrivRear::RRR_AEB_Request::RRR_AEB_ObjID = 0;
  $CAN_PrivRear::RRR_AEB_Request::RRR_AEB_VRU = 0;
  $CAN_PrivRear::RRR_AEB_Request::RRR_AEB_VRUTA = 0;
  $CAN_PrivRear::RRR_AEB_Request::RRR_Ax_CommandValue = 0;
  $CAN_PrivRear::RRR_Obj00A::RRR_Obj00A_Ax = -16;
  $CAN_PrivRear::RRR_Obj00A::RRR_Obj00A_AxAyCoVnce = 0;
  $CAN_PrivRear::RRR_Obj00A::RRR_Obj00A_AxVnce = 0;
  $CAN_PrivRear::RRR_Obj00A::RRR_Obj00A_Ay = -16;
  $CAN_PrivRear::RRR_Obj00A::RRR_Obj00A_AyVnce = 0;
  $CAN_PrivRear::RRR_Obj00A::RRR_Obj00A_Dx = -256;
  $CAN_PrivRear::RRR_Obj00A::RRR_Obj00A_DxAxCoVnce = 0;
  $CAN_PrivRear::RRR_Obj00A::RRR_Obj00A_DxAyCoVnce = 0;
  $CAN_PrivRear::RRR_Obj00A::RRR_Obj00A_DxDyCoVnce = 0;
  $CAN_PrivRear::RRR_Obj00A::RRR_Obj00A_DxVnce = 0;
  $CAN_PrivRear::RRR_Obj00A::RRR_Obj00A_DxVxCoVnce = 0;
  $CAN_PrivRear::RRR_Obj00A::RRR_Obj00A_DxVyCoVnce = 0;
  $CAN_PrivRear::RRR_Obj00A::RRR_Obj00A_Dy = -128;
  $CAN_PrivRear::RRR_Obj00A::RRR_Obj00A_DyAxCoVnce = 0;
  $CAN_PrivRear::RRR_Obj00A::RRR_Obj00A_DyAyCoVnce = 0;
  $CAN_PrivRear::RRR_Obj00A::RRR_Obj00A_DyVnce = 0;
  $CAN_PrivRear::RRR_Obj00A::RRR_Obj00A_DyVxCoVnce = 0;
  }
  if(init_count == 2)
  {
  $CAN_PrivRear::RRR_Obj00A::RRR_Obj00A_DyVyCoVnce = 0;
  $CAN_PrivRear::RRR_Obj00A::RRR_Obj00A_Dz = -5;
  $CAN_PrivRear::RRR_Obj00A::RRR_Obj00A_DzVnce = 0;
  $CAN_PrivRear::RRR_Obj00A::RRR_Obj00A_HeadingYawAngle = -4.48;
  $CAN_PrivRear::RRR_Obj00A::RRR_Obj00A_HeadingYawAngleVnce = 0;
  $CAN_PrivRear::RRR_Obj00A::RRR_Obj00A_Height = 0;
  $CAN_PrivRear::RRR_Obj00A::RRR_Obj00A_HeightVnce = 0;
  $CAN_PrivRear::RRR_Obj00A::RRR_Obj00A_ID = 0;
  $CAN_PrivRear::RRR_Obj00A::RRR_Obj00A_Length = 0;
  $CAN_PrivRear::RRR_Obj00A::RRR_Obj00A_LengthVnce = 0;
  $CAN_PrivRear::RRR_Obj00A::RRR_Obj00A_Measured = 0;
  $CAN_PrivRear::RRR_Obj00A::RRR_Obj00A_ProbExist = 0;
  $CAN_PrivRear::RRR_Obj00A::RRR_Obj00A_ProbMobileObst = 0;
  $CAN_PrivRear::RRR_Obj00A::RRR_Obj00A_ProbNonObstacle = 0;
  $CAN_PrivRear::RRR_Obj00A::RRR_Obj00A_ProbObstacle = 0;
  $CAN_PrivRear::RRR_Obj00A::RRR_Obj00A_RefPosIndex = 0;
  $CAN_PrivRear::RRR_Obj00A::RRR_Obj00A_Valid = 0;
  $CAN_PrivRear::RRR_Obj00A::RRR_Obj00A_Vx = -128;
  $CAN_PrivRear::RRR_Obj00A::RRR_Obj00A_VxAxCoVnce = 0;
  $CAN_PrivRear::RRR_Obj00A::RRR_Obj00A_VxAyCoVnce = 0;
  $CAN_PrivRear::RRR_Obj00A::RRR_Obj00A_VxVnce = 0;
  $CAN_PrivRear::RRR_Obj00A::RRR_Obj00A_VxVyCoVnce = 0;
  $CAN_PrivRear::RRR_Obj00A::RRR_Obj00A_Vy = -64;
  $CAN_PrivRear::RRR_Obj00A::RRR_Obj00A_VyAxCoVnce = 0;
  $CAN_PrivRear::RRR_Obj00A::RRR_Obj00A_VyAyCoVnce = 0;
  }
  if(init_count == 3)
  {
  $CAN_PrivRear::RRR_Obj00A::RRR_Obj00A_VyVnce = 0;
  $CAN_PrivRear::RRR_Obj00A::RRR_Obj00A_Width = 0;
  $CAN_PrivRear::RRR_Obj00A::RRR_Obj00A_WidthVnce = 0;
  $CAN_PrivRear::RRR_Obj00B::RRR_Obj00B_BehaviorType = 0;
  $CAN_PrivRear::RRR_Obj00B::RRR_Obj00B_MovingObserved = 0;
  $CAN_PrivRear::RRR_Obj00B::RRR_Obj00B_MovingProbability = 0;
  $CAN_PrivRear::RRR_Obj00B::RRR_Obj00B_Prob4PlusWhlCAR = 0;
  $CAN_PrivRear::RRR_Obj00B::RRR_Obj00B_Prob4PlusWhlbHGV = 0;
  $CAN_PrivRear::RRR_Obj00B::RRR_Obj00B_ProbGNDReflex = 0;
  $CAN_PrivRear::RRR_Obj00B::RRR_Obj00B_ProbMob2Whl = 0;
  $CAN_PrivRear::RRR_Obj00B::RRR_Obj00B_ProbMob4PlusWhl = 0;
  $CAN_PrivRear::RRR_Obj00B::RRR_Obj00B_ProbMobPed = 0;
  $CAN_PrivRear::RRR_Obj00B::RRR_Obj00B_ProbStatBarrier = 0;
  $CAN_PrivRear::RRR_Obj00B::RRR_Obj00B_ProbStatObst = 0;
  $CAN_PrivRear::RRR_Obj01A::RRR_Obj01A_Ax = -16;
  $CAN_PrivRear::RRR_Obj01A::RRR_Obj01A_AxAyCoVnce = 0;
  $CAN_PrivRear::RRR_Obj01A::RRR_Obj01A_AxVnce = 0;
  $CAN_PrivRear::RRR_Obj01A::RRR_Obj01A_Ay = -16;
  $CAN_PrivRear::RRR_Obj01A::RRR_Obj01A_AyVnce = 0;
  $CAN_PrivRear::RRR_Obj01A::RRR_Obj01A_Dx = -256;
  $CAN_PrivRear::RRR_Obj01A::RRR_Obj01A_DxAxCoVnce = 0;
  $CAN_PrivRear::RRR_Obj01A::RRR_Obj01A_DxAyCoVnce = 0;
  $CAN_PrivRear::RRR_Obj01A::RRR_Obj01A_DxDyCoVnce = 0;
  $CAN_PrivRear::RRR_Obj01A::RRR_Obj01A_DxVnce = 0;
  $CAN_PrivRear::RRR_Obj01A::RRR_Obj01A_DxVxCoVnce = 0;
  }
  if(init_count == 4)
  {
  $CAN_PrivRear::RRR_Obj01A::RRR_Obj01A_DxVyCoVnce = 0;
  $CAN_PrivRear::RRR_Obj01A::RRR_Obj01A_Dy = -128;
  $CAN_PrivRear::RRR_Obj01A::RRR_Obj01A_DyAxCoVnce = 0;
  $CAN_PrivRear::RRR_Obj01A::RRR_Obj01A_DyAyCoVnce = 0;
  $CAN_PrivRear::RRR_Obj01A::RRR_Obj01A_DyVnce = 0;
  $CAN_PrivRear::RRR_Obj01A::RRR_Obj01A_DyVxCoVnce = 0;
  $CAN_PrivRear::RRR_Obj01A::RRR_Obj01A_DyVyCoVnce = 0;
  $CAN_PrivRear::RRR_Obj01A::RRR_Obj01A_Dz = -5;
  $CAN_PrivRear::RRR_Obj01A::RRR_Obj01A_DzVnce = 0;
  $CAN_PrivRear::RRR_Obj01A::RRR_Obj01A_HeadingYawAngle = -4.48;
  $CAN_PrivRear::RRR_Obj01A::RRR_Obj01A_HeadingYawAngleVnce = 0;
  $CAN_PrivRear::RRR_Obj01A::RRR_Obj01A_Height = 0;
  $CAN_PrivRear::RRR_Obj01A::RRR_Obj01A_HeightVnce = 0;
  $CAN_PrivRear::RRR_Obj01A::RRR_Obj01A_ID = 0;
  $CAN_PrivRear::RRR_Obj01A::RRR_Obj01A_Length = 0;
  $CAN_PrivRear::RRR_Obj01A::RRR_Obj01A_LengthVnce = 0;
  $CAN_PrivRear::RRR_Obj01A::RRR_Obj01A_Measured = 0;
  $CAN_PrivRear::RRR_Obj01A::RRR_Obj01A_ProbExist = 0;
  $CAN_PrivRear::RRR_Obj01A::RRR_Obj01A_ProbMobileObst = 0;
  $CAN_PrivRear::RRR_Obj01A::RRR_Obj01A_ProbNonObstacle = 0;
  $CAN_PrivRear::RRR_Obj01A::RRR_Obj01A_ProbObstacle = 0;
  $CAN_PrivRear::RRR_Obj01A::RRR_Obj01A_RefPosIndex = 0;
  $CAN_PrivRear::RRR_Obj01A::RRR_Obj01A_Valid = 0;
  $CAN_PrivRear::RRR_Obj01A::RRR_Obj01A_Vx = -128;
  $CAN_PrivRear::RRR_Obj01A::RRR_Obj01A_VxAxCoVnce = 0;
  }
  if(init_count == 5)
  {
  $CAN_PrivRear::RRR_Obj01A::RRR_Obj01A_VxAyCoVnce = 0;
  $CAN_PrivRear::RRR_Obj01A::RRR_Obj01A_VxVnce = 0;
  $CAN_PrivRear::RRR_Obj01A::RRR_Obj01A_VxVyCoVnce = 0;
  $CAN_PrivRear::RRR_Obj01A::RRR_Obj01A_Vy = -64;
  $CAN_PrivRear::RRR_Obj01A::RRR_Obj01A_VyAxCoVnce = 0;
  $CAN_PrivRear::RRR_Obj01A::RRR_Obj01A_VyAyCoVnce = 0;
  $CAN_PrivRear::RRR_Obj01A::RRR_Obj01A_VyVnce = 0;
  $CAN_PrivRear::RRR_Obj01A::RRR_Obj01A_Width = 0;
  $CAN_PrivRear::RRR_Obj01A::RRR_Obj01A_WidthVnce = 0;
  $CAN_PrivRear::RRR_Obj01B::RRR_Obj01B_BehaviorType = 0;
  $CAN_PrivRear::RRR_Obj01B::RRR_Obj01B_MovingObserved = 0;
  $CAN_PrivRear::RRR_Obj01B::RRR_Obj01B_MovingProbability = 0;
  $CAN_PrivRear::RRR_Obj01B::RRR_Obj01B_Prob4PlusWhlCAR = 0;
  $CAN_PrivRear::RRR_Obj01B::RRR_Obj01B_Prob4PlusWhlbHGV = 0;
  $CAN_PrivRear::RRR_Obj01B::RRR_Obj01B_ProbGNDReflex = 0;
  $CAN_PrivRear::RRR_Obj01B::RRR_Obj01B_ProbMob2Whl = 0;
  $CAN_PrivRear::RRR_Obj01B::RRR_Obj01B_ProbMob4PlusWhl = 0;
  $CAN_PrivRear::RRR_Obj01B::RRR_Obj01B_ProbMobPed = 0;
  $CAN_PrivRear::RRR_Obj01B::RRR_Obj01B_ProbStatBarrier = 0;
  $CAN_PrivRear::RRR_Obj01B::RRR_Obj01B_ProbStatObst = 0;
  $CAN_PrivRear::RRR_Obj02A::RRR_Obj02A_Ax = -16;
  $CAN_PrivRear::RRR_Obj02A::RRR_Obj02A_AxAyCoVnce = 0;
  $CAN_PrivRear::RRR_Obj02A::RRR_Obj02A_AxVnce = 0;
  $CAN_PrivRear::RRR_Obj02A::RRR_Obj02A_Ay = -16;
  $CAN_PrivRear::RRR_Obj02A::RRR_Obj02A_AyVnce = 0;
  }
  if(init_count == 6)
  {
  $CAN_PrivRear::RRR_Obj02A::RRR_Obj02A_Dx = -256;
  $CAN_PrivRear::RRR_Obj02A::RRR_Obj02A_DxAxCoVnce = 0;
  $CAN_PrivRear::RRR_Obj02A::RRR_Obj02A_DxAyCoVnce = 0;
  $CAN_PrivRear::RRR_Obj02A::RRR_Obj02A_DxDyCoVnce = 0;
  $CAN_PrivRear::RRR_Obj02A::RRR_Obj02A_DxVnce = 0;
  $CAN_PrivRear::RRR_Obj02A::RRR_Obj02A_DxVxCoVnce = 0;
  $CAN_PrivRear::RRR_Obj02A::RRR_Obj02A_DxVyCoVnce = 0;
  $CAN_PrivRear::RRR_Obj02A::RRR_Obj02A_Dy = -128;
  $CAN_PrivRear::RRR_Obj02A::RRR_Obj02A_DyAxCoVnce = 0;
  $CAN_PrivRear::RRR_Obj02A::RRR_Obj02A_DyAyCoVnce = 0;
  $CAN_PrivRear::RRR_Obj02A::RRR_Obj02A_DyVnce = 0;
  $CAN_PrivRear::RRR_Obj02A::RRR_Obj02A_DyVxCoVnce = 0;
  $CAN_PrivRear::RRR_Obj02A::RRR_Obj02A_DyVyCoVnce = 0;
  $CAN_PrivRear::RRR_Obj02A::RRR_Obj02A_Dz = -5;
  $CAN_PrivRear::RRR_Obj02A::RRR_Obj02A_DzVnce = 0;
  $CAN_PrivRear::RRR_Obj02A::RRR_Obj02A_HeadingYawAngle = -4.48;
  $CAN_PrivRear::RRR_Obj02A::RRR_Obj02A_HeadingYawAngleVnce = 0;
  $CAN_PrivRear::RRR_Obj02A::RRR_Obj02A_Height = 0;
  $CAN_PrivRear::RRR_Obj02A::RRR_Obj02A_HeightVnce = 0;
  $CAN_PrivRear::RRR_Obj02A::RRR_Obj02A_ID = 0;
  $CAN_PrivRear::RRR_Obj02A::RRR_Obj02A_Length = 0;
  $CAN_PrivRear::RRR_Obj02A::RRR_Obj02A_LengthVnce = 0;
  $CAN_PrivRear::RRR_Obj02A::RRR_Obj02A_Measured = 0;
  $CAN_PrivRear::RRR_Obj02A::RRR_Obj02A_ProbExist = 0;
  $CAN_PrivRear::RRR_Obj02A::RRR_Obj02A_ProbMobileObst = 0;
  }
  if(init_count == 7)
  {
  $CAN_PrivRear::RRR_Obj02A::RRR_Obj02A_ProbNonObstacle = 0;
  $CAN_PrivRear::RRR_Obj02A::RRR_Obj02A_ProbObstacle = 0;
  $CAN_PrivRear::RRR_Obj02A::RRR_Obj02A_RefPosIndex = 0;
  $CAN_PrivRear::RRR_Obj02A::RRR_Obj02A_Valid = 0;
  $CAN_PrivRear::RRR_Obj02A::RRR_Obj02A_Vx = -128;
  $CAN_PrivRear::RRR_Obj02A::RRR_Obj02A_VxAxCoVnce = 0;
  $CAN_PrivRear::RRR_Obj02A::RRR_Obj02A_VxAyCoVnce = 0;
  $CAN_PrivRear::RRR_Obj02A::RRR_Obj02A_VxVnce = 0;
  $CAN_PrivRear::RRR_Obj02A::RRR_Obj02A_VxVyCoVnce = 0;
  $CAN_PrivRear::RRR_Obj02A::RRR_Obj02A_Vy = -64;
  $CAN_PrivRear::RRR_Obj02A::RRR_Obj02A_VyAxCoVnce = 0;
  $CAN_PrivRear::RRR_Obj02A::RRR_Obj02A_VyAyCoVnce = 0;
  $CAN_PrivRear::RRR_Obj02A::RRR_Obj02A_VyVnce = 0;
  $CAN_PrivRear::RRR_Obj02A::RRR_Obj02A_Width = 0;
  $CAN_PrivRear::RRR_Obj02A::RRR_Obj02A_WidthVnce = 0;
  $CAN_PrivRear::RRR_Obj02B::RRR_Obj02B_BehaviorType = 0;
  $CAN_PrivRear::RRR_Obj02B::RRR_Obj02B_MovingObserved = 0;
  $CAN_PrivRear::RRR_Obj02B::RRR_Obj02B_MovingProbability = 0;
  $CAN_PrivRear::RRR_Obj02B::RRR_Obj02B_Prob4PlusWhlCAR = 0;
  $CAN_PrivRear::RRR_Obj02B::RRR_Obj02B_Prob4PlusWhlbHGV = 0;
  $CAN_PrivRear::RRR_Obj02B::RRR_Obj02B_ProbGNDReflex = 0;
  $CAN_PrivRear::RRR_Obj02B::RRR_Obj02B_ProbMob2Whl = 0;
  $CAN_PrivRear::RRR_Obj02B::RRR_Obj02B_ProbMob4PlusWhl = 0;
  $CAN_PrivRear::RRR_Obj02B::RRR_Obj02B_ProbMobPed = 0;
  $CAN_PrivRear::RRR_Obj02B::RRR_Obj02B_ProbStatBarrier = 0;
  }
  if(init_count == 8)
  {
  $CAN_PrivRear::RRR_Obj02B::RRR_Obj02B_ProbStatObst = 0;
  $CAN_PrivRear::RRR_Obj03A::RRR_Obj03A_Ax = -16;
  $CAN_PrivRear::RRR_Obj03A::RRR_Obj03A_AxAyCoVnce = 0;
  $CAN_PrivRear::RRR_Obj03A::RRR_Obj03A_AxVnce = 0;
  $CAN_PrivRear::RRR_Obj03A::RRR_Obj03A_Ay = -16;
  $CAN_PrivRear::RRR_Obj03A::RRR_Obj03A_AyVnce = 0;
  $CAN_PrivRear::RRR_Obj03A::RRR_Obj03A_Dx = -256;
  $CAN_PrivRear::RRR_Obj03A::RRR_Obj03A_DxAxCoVnce = 0;
  $CAN_PrivRear::RRR_Obj03A::RRR_Obj03A_DxAyCoVnce = 0;
  $CAN_PrivRear::RRR_Obj03A::RRR_Obj03A_DxDyCoVnce = 0;
  $CAN_PrivRear::RRR_Obj03A::RRR_Obj03A_DxVnce = 0;
  $CAN_PrivRear::RRR_Obj03A::RRR_Obj03A_DxVxCoVnce = 0;
  $CAN_PrivRear::RRR_Obj03A::RRR_Obj03A_DxVyCoVnce = 0;
  $CAN_PrivRear::RRR_Obj03A::RRR_Obj03A_Dy = -128;
  $CAN_PrivRear::RRR_Obj03A::RRR_Obj03A_DyAxCoVnce = 0;
  $CAN_PrivRear::RRR_Obj03A::RRR_Obj03A_DyAyCoVnce = 0;
  $CAN_PrivRear::RRR_Obj03A::RRR_Obj03A_DyVnce = 0;
  $CAN_PrivRear::RRR_Obj03A::RRR_Obj03A_DyVxCoVnce = 0;
  $CAN_PrivRear::RRR_Obj03A::RRR_Obj03A_DyVyCoVnce = 0;
  $CAN_PrivRear::RRR_Obj03A::RRR_Obj03A_Dz = -5;
  $CAN_PrivRear::RRR_Obj03A::RRR_Obj03A_DzVnce = 0;
  $CAN_PrivRear::RRR_Obj03A::RRR_Obj03A_HeadingYawAngle = -4.48;
  $CAN_PrivRear::RRR_Obj03A::RRR_Obj03A_HeadingYawAngleVnce = 0;
  $CAN_PrivRear::RRR_Obj03A::RRR_Obj03A_Height = 0;
  $CAN_PrivRear::RRR_Obj03A::RRR_Obj03A_HeightVnce = 0;
  }
  if(init_count == 9)
  {
  $CAN_PrivRear::RRR_Obj03A::RRR_Obj03A_ID = 0;
  $CAN_PrivRear::RRR_Obj03A::RRR_Obj03A_Length = 0;
  $CAN_PrivRear::RRR_Obj03A::RRR_Obj03A_LengthVnce = 0;
  $CAN_PrivRear::RRR_Obj03A::RRR_Obj03A_Measured = 0;
  $CAN_PrivRear::RRR_Obj03A::RRR_Obj03A_ProbExist = 0;
  $CAN_PrivRear::RRR_Obj03A::RRR_Obj03A_ProbMobileObst = 0;
  $CAN_PrivRear::RRR_Obj03A::RRR_Obj03A_ProbNonObstacle = 0;
  $CAN_PrivRear::RRR_Obj03A::RRR_Obj03A_ProbObstacle = 0;
  $CAN_PrivRear::RRR_Obj03A::RRR_Obj03A_RefPosIndex = 0;
  $CAN_PrivRear::RRR_Obj03A::RRR_Obj03A_Valid = 0;
  $CAN_PrivRear::RRR_Obj03A::RRR_Obj03A_Vx = -128;
  $CAN_PrivRear::RRR_Obj03A::RRR_Obj03A_VxAxCoVnce = 0;
  $CAN_PrivRear::RRR_Obj03A::RRR_Obj03A_VxAyCoVnce = 0;
  $CAN_PrivRear::RRR_Obj03A::RRR_Obj03A_VxVnce = 0;
  $CAN_PrivRear::RRR_Obj03A::RRR_Obj03A_VxVyCoVnce = 0;
  $CAN_PrivRear::RRR_Obj03A::RRR_Obj03A_Vy = -64;
  $CAN_PrivRear::RRR_Obj03A::RRR_Obj03A_VyAxCoVnce = 0;
  $CAN_PrivRear::RRR_Obj03A::RRR_Obj03A_VyAyCoVnce = 0;
  $CAN_PrivRear::RRR_Obj03A::RRR_Obj03A_VyVnce = 0;
  $CAN_PrivRear::RRR_Obj03A::RRR_Obj03A_Width = 0;
  $CAN_PrivRear::RRR_Obj03A::RRR_Obj03A_WidthVnce = 0;
  $CAN_PrivRear::RRR_Obj03B::RRR_Obj03B_BehaviorType = 0;
  $CAN_PrivRear::RRR_Obj03B::RRR_Obj03B_MovingObserved = 0;
  $CAN_PrivRear::RRR_Obj03B::RRR_Obj03B_MovingProbability = 0;
  $CAN_PrivRear::RRR_Obj03B::RRR_Obj03B_Prob4PlusWhlCAR = 0;
  }
  if(init_count == 10)
  {
  $CAN_PrivRear::RRR_Obj03B::RRR_Obj03B_Prob4PlusWhlbHGV = 0;
  $CAN_PrivRear::RRR_Obj03B::RRR_Obj03B_ProbGNDReflex = 0;
  $CAN_PrivRear::RRR_Obj03B::RRR_Obj03B_ProbMob2Whl = 0;
  $CAN_PrivRear::RRR_Obj03B::RRR_Obj03B_ProbMob4PlusWhl = 0;
  $CAN_PrivRear::RRR_Obj03B::RRR_Obj03B_ProbMobPed = 0;
  $CAN_PrivRear::RRR_Obj03B::RRR_Obj03B_ProbStatBarrier = 0;
  $CAN_PrivRear::RRR_Obj03B::RRR_Obj03B_ProbStatObst = 0;
  $CAN_PrivRear::RRR_Obj04A::RRR_Obj04A_Ax = -16;
  $CAN_PrivRear::RRR_Obj04A::RRR_Obj04A_AxAyCoVnce = 0;
  $CAN_PrivRear::RRR_Obj04A::RRR_Obj04A_AxVnce = 0;
  $CAN_PrivRear::RRR_Obj04A::RRR_Obj04A_Ay = -16;
  $CAN_PrivRear::RRR_Obj04A::RRR_Obj04A_AyVnce = 0;
  $CAN_PrivRear::RRR_Obj04A::RRR_Obj04A_Dx = -256;
  $CAN_PrivRear::RRR_Obj04A::RRR_Obj04A_DxAxCoVnce = 0;
  $CAN_PrivRear::RRR_Obj04A::RRR_Obj04A_DxAyCoVnce = 0;
  $CAN_PrivRear::RRR_Obj04A::RRR_Obj04A_DxDyCoVnce = 0;
  $CAN_PrivRear::RRR_Obj04A::RRR_Obj04A_DxVnce = 0;
  $CAN_PrivRear::RRR_Obj04A::RRR_Obj04A_DxVxCoVnce = 0;
  $CAN_PrivRear::RRR_Obj04A::RRR_Obj04A_DxVyCoVnce = 0;
  $CAN_PrivRear::RRR_Obj04A::RRR_Obj04A_Dy = -128;
  $CAN_PrivRear::RRR_Obj04A::RRR_Obj04A_DyAxCoVnce = 0;
  $CAN_PrivRear::RRR_Obj04A::RRR_Obj04A_DyAyCoVnce = 0;
  $CAN_PrivRear::RRR_Obj04A::RRR_Obj04A_DyVnce = 0;
  $CAN_PrivRear::RRR_Obj04A::RRR_Obj04A_DyVxCoVnce = 0;
  $CAN_PrivRear::RRR_Obj04A::RRR_Obj04A_DyVyCoVnce = 0;
  }
  if(init_count == 11)
  {
  $CAN_PrivRear::RRR_Obj04A::RRR_Obj04A_Dz = -5;
  $CAN_PrivRear::RRR_Obj04A::RRR_Obj04A_DzVnce = 0;
  $CAN_PrivRear::RRR_Obj04A::RRR_Obj04A_HeadingYawAngle = -4.48;
  $CAN_PrivRear::RRR_Obj04A::RRR_Obj04A_HeadingYawAngleVnce = 0;
  $CAN_PrivRear::RRR_Obj04A::RRR_Obj04A_Height = 0;
  $CAN_PrivRear::RRR_Obj04A::RRR_Obj04A_HeightVnce = 0;
  $CAN_PrivRear::RRR_Obj04A::RRR_Obj04A_ID = 0;
  $CAN_PrivRear::RRR_Obj04A::RRR_Obj04A_Length = 0;
  $CAN_PrivRear::RRR_Obj04A::RRR_Obj04A_LengthVnce = 0;
  $CAN_PrivRear::RRR_Obj04A::RRR_Obj04A_Measured = 0;
  $CAN_PrivRear::RRR_Obj04A::RRR_Obj04A_ProbExist = 0;
  $CAN_PrivRear::RRR_Obj04A::RRR_Obj04A_ProbMobileObst = 0;
  $CAN_PrivRear::RRR_Obj04A::RRR_Obj04A_ProbNonObstacle = 0;
  $CAN_PrivRear::RRR_Obj04A::RRR_Obj04A_ProbObstacle = 0;
  $CAN_PrivRear::RRR_Obj04A::RRR_Obj04A_RefPosIndex = 0;
  $CAN_PrivRear::RRR_Obj04A::RRR_Obj04A_Valid = 0;
  $CAN_PrivRear::RRR_Obj04A::RRR_Obj04A_Vx = -128;
  $CAN_PrivRear::RRR_Obj04A::RRR_Obj04A_VxAxCoVnce = 0;
  $CAN_PrivRear::RRR_Obj04A::RRR_Obj04A_VxAyCoVnce = 0;
  $CAN_PrivRear::RRR_Obj04A::RRR_Obj04A_VxVnce = 0;
  $CAN_PrivRear::RRR_Obj04A::RRR_Obj04A_VxVyCoVnce = 0;
  $CAN_PrivRear::RRR_Obj04A::RRR_Obj04A_Vy = -64;
  $CAN_PrivRear::RRR_Obj04A::RRR_Obj04A_VyAxCoVnce = 0;
  $CAN_PrivRear::RRR_Obj04A::RRR_Obj04A_VyAyCoVnce = 0;
  $CAN_PrivRear::RRR_Obj04A::RRR_Obj04A_VyVnce = 0;
  }
  if(init_count == 12)
  {
  $CAN_PrivRear::RRR_Obj04A::RRR_Obj04A_Width = 0;
  $CAN_PrivRear::RRR_Obj04A::RRR_Obj04A_WidthVnce = 0;
  $CAN_PrivRear::RRR_Obj04B::RRR_Obj04B_BehaviorType = 0;
  $CAN_PrivRear::RRR_Obj04B::RRR_Obj04B_MovingObserved = 0;
  $CAN_PrivRear::RRR_Obj04B::RRR_Obj04B_MovingProbability = 0;
  $CAN_PrivRear::RRR_Obj04B::RRR_Obj04B_Prob4PlusWhlCAR = 0;
  $CAN_PrivRear::RRR_Obj04B::RRR_Obj04B_Prob4PlusWhlbHGV = 0;
  $CAN_PrivRear::RRR_Obj04B::RRR_Obj04B_ProbGNDReflex = 0;
  $CAN_PrivRear::RRR_Obj04B::RRR_Obj04B_ProbMob2Whl = 0;
  $CAN_PrivRear::RRR_Obj04B::RRR_Obj04B_ProbMob4PlusWhl = 0;
  $CAN_PrivRear::RRR_Obj04B::RRR_Obj04B_ProbMobPed = 0;
  $CAN_PrivRear::RRR_Obj04B::RRR_Obj04B_ProbStatBarrier = 0;
  $CAN_PrivRear::RRR_Obj04B::RRR_Obj04B_ProbStatObst = 0;
  $CAN_PrivRear::RRR_Obj05A::RRR_Obj05A_Ax = -16;
  $CAN_PrivRear::RRR_Obj05A::RRR_Obj05A_AxAyCoVnce = 0;
  $CAN_PrivRear::RRR_Obj05A::RRR_Obj05A_AxVnce = 0;
  $CAN_PrivRear::RRR_Obj05A::RRR_Obj05A_Ay = -16;
  $CAN_PrivRear::RRR_Obj05A::RRR_Obj05A_AyVnce = 0;
  $CAN_PrivRear::RRR_Obj05A::RRR_Obj05A_Dx = -256;
  $CAN_PrivRear::RRR_Obj05A::RRR_Obj05A_DxAxCoVnce = 0;
  $CAN_PrivRear::RRR_Obj05A::RRR_Obj05A_DxAyCoVnce = 0;
  $CAN_PrivRear::RRR_Obj05A::RRR_Obj05A_DxDyCoVnce = 0;
  $CAN_PrivRear::RRR_Obj05A::RRR_Obj05A_DxVnce = 0;
  $CAN_PrivRear::RRR_Obj05A::RRR_Obj05A_DxVxCoVnce = 0;
  $CAN_PrivRear::RRR_Obj05A::RRR_Obj05A_DxVyCoVnce = 0;
  }
  if(init_count == 13)
  {
  $CAN_PrivRear::RRR_Obj05A::RRR_Obj05A_Dy = -128;
  $CAN_PrivRear::RRR_Obj05A::RRR_Obj05A_DyAxCoVnce = 0;
  $CAN_PrivRear::RRR_Obj05A::RRR_Obj05A_DyAyCoVnce = 0;
  $CAN_PrivRear::RRR_Obj05A::RRR_Obj05A_DyVnce = 0;
  $CAN_PrivRear::RRR_Obj05A::RRR_Obj05A_DyVxCoVnce = 0;
  $CAN_PrivRear::RRR_Obj05A::RRR_Obj05A_DyVyCoVnce = 0;
  $CAN_PrivRear::RRR_Obj05A::RRR_Obj05A_Dz = -5;
  $CAN_PrivRear::RRR_Obj05A::RRR_Obj05A_DzVnce = 0;
  $CAN_PrivRear::RRR_Obj05A::RRR_Obj05A_HeadingYawAngle = -4.48;
  $CAN_PrivRear::RRR_Obj05A::RRR_Obj05A_HeadingYawAngleVnce = 0;
  $CAN_PrivRear::RRR_Obj05A::RRR_Obj05A_Height = 0;
  $CAN_PrivRear::RRR_Obj05A::RRR_Obj05A_HeightVnce = 0;
  $CAN_PrivRear::RRR_Obj05A::RRR_Obj05A_ID = 0;
  $CAN_PrivRear::RRR_Obj05A::RRR_Obj05A_Length = 0;
  $CAN_PrivRear::RRR_Obj05A::RRR_Obj05A_LengthVnce = 0;
  $CAN_PrivRear::RRR_Obj05A::RRR_Obj05A_Measured = 0;
  $CAN_PrivRear::RRR_Obj05A::RRR_Obj05A_ProbExist = 0;
  $CAN_PrivRear::RRR_Obj05A::RRR_Obj05A_ProbMobileObst = 0;
  $CAN_PrivRear::RRR_Obj05A::RRR_Obj05A_ProbNonObstacle = 0;
  $CAN_PrivRear::RRR_Obj05A::RRR_Obj05A_ProbObstacle = 0;
  $CAN_PrivRear::RRR_Obj05A::RRR_Obj05A_RefPosIndex = 0;
  $CAN_PrivRear::RRR_Obj05A::RRR_Obj05A_Valid = 0;
  $CAN_PrivRear::RRR_Obj05A::RRR_Obj05A_Vx = -128;
  $CAN_PrivRear::RRR_Obj05A::RRR_Obj05A_VxAxCoVnce = 0;
  $CAN_PrivRear::RRR_Obj05A::RRR_Obj05A_VxAyCoVnce = 0;
  }
  if(init_count == 14)
  {
  $CAN_PrivRear::RRR_Obj05A::RRR_Obj05A_VxVnce = 0;
  $CAN_PrivRear::RRR_Obj05A::RRR_Obj05A_VxVyCoVnce = 0;
  $CAN_PrivRear::RRR_Obj05A::RRR_Obj05A_Vy = -64;
  $CAN_PrivRear::RRR_Obj05A::RRR_Obj05A_VyAxCoVnce = 0;
  $CAN_PrivRear::RRR_Obj05A::RRR_Obj05A_VyAyCoVnce = 0;
  $CAN_PrivRear::RRR_Obj05A::RRR_Obj05A_VyVnce = 0;
  $CAN_PrivRear::RRR_Obj05A::RRR_Obj05A_Width = 0;
  $CAN_PrivRear::RRR_Obj05A::RRR_Obj05A_WidthVnce = 0;
  $CAN_PrivRear::RRR_Obj05B::RRR_Obj05B_BehaviorType = 0;
  $CAN_PrivRear::RRR_Obj05B::RRR_Obj05B_MovingObserved = 0;
  $CAN_PrivRear::RRR_Obj05B::RRR_Obj05B_MovingProbability = 0;
  $CAN_PrivRear::RRR_Obj05B::RRR_Obj05B_Prob4PlusWhlCAR = 0;
  $CAN_PrivRear::RRR_Obj05B::RRR_Obj05B_Prob4PlusWhlbHGV = 0;
  $CAN_PrivRear::RRR_Obj05B::RRR_Obj05B_ProbGNDReflex = 0;
  $CAN_PrivRear::RRR_Obj05B::RRR_Obj05B_ProbMob2Whl = 0;
  $CAN_PrivRear::RRR_Obj05B::RRR_Obj05B_ProbMob4PlusWhl = 0;
  $CAN_PrivRear::RRR_Obj05B::RRR_Obj05B_ProbMobPed = 0;
  $CAN_PrivRear::RRR_Obj05B::RRR_Obj05B_ProbStatBarrier = 0;
  $CAN_PrivRear::RRR_Obj05B::RRR_Obj05B_ProbStatObst = 0;
  $CAN_PrivRear::RRR_Obj06A::RRR_Obj06A_Ax = -16;
  $CAN_PrivRear::RRR_Obj06A::RRR_Obj06A_AxAyCoVnce = 0;
  $CAN_PrivRear::RRR_Obj06A::RRR_Obj06A_AxVnce = 0;
  $CAN_PrivRear::RRR_Obj06A::RRR_Obj06A_Ay = -16;
  $CAN_PrivRear::RRR_Obj06A::RRR_Obj06A_AyVnce = 0;
  $CAN_PrivRear::RRR_Obj06A::RRR_Obj06A_Dx = -256;
  }
  if(init_count == 15)
  {
  $CAN_PrivRear::RRR_Obj06A::RRR_Obj06A_DxAxCoVnce = 0;
  $CAN_PrivRear::RRR_Obj06A::RRR_Obj06A_DxAyCoVnce = 0;
  $CAN_PrivRear::RRR_Obj06A::RRR_Obj06A_DxDyCoVnce = 0;
  $CAN_PrivRear::RRR_Obj06A::RRR_Obj06A_DxVnce = 0;
  $CAN_PrivRear::RRR_Obj06A::RRR_Obj06A_DxVxCoVnce = 0;
  $CAN_PrivRear::RRR_Obj06A::RRR_Obj06A_DxVyCoVnce = 0;
  $CAN_PrivRear::RRR_Obj06A::RRR_Obj06A_Dy = -128;
  $CAN_PrivRear::RRR_Obj06A::RRR_Obj06A_DyAxCoVnce = 0;
  $CAN_PrivRear::RRR_Obj06A::RRR_Obj06A_DyAyCoVnce = 0;
  $CAN_PrivRear::RRR_Obj06A::RRR_Obj06A_DyVnce = 0;
  $CAN_PrivRear::RRR_Obj06A::RRR_Obj06A_DyVxCoVnce = 0;
  $CAN_PrivRear::RRR_Obj06A::RRR_Obj06A_DyVyCoVnce = 0;
  $CAN_PrivRear::RRR_Obj06A::RRR_Obj06A_Dz = -5;
  $CAN_PrivRear::RRR_Obj06A::RRR_Obj06A_DzVnce = 0;
  $CAN_PrivRear::RRR_Obj06A::RRR_Obj06A_HeadingYawAngle = -4.48;
  $CAN_PrivRear::RRR_Obj06A::RRR_Obj06A_HeadingYawAngleVnce = 0;
  $CAN_PrivRear::RRR_Obj06A::RRR_Obj06A_Height = 0;
  $CAN_PrivRear::RRR_Obj06A::RRR_Obj06A_HeightVnce = 0;
  $CAN_PrivRear::RRR_Obj06A::RRR_Obj06A_ID = 0;
  $CAN_PrivRear::RRR_Obj06A::RRR_Obj06A_Length = 0;
  $CAN_PrivRear::RRR_Obj06A::RRR_Obj06A_LengthVnce = 0;
  $CAN_PrivRear::RRR_Obj06A::RRR_Obj06A_Measured = 0;
  $CAN_PrivRear::RRR_Obj06A::RRR_Obj06A_ProbExist = 0;
  $CAN_PrivRear::RRR_Obj06A::RRR_Obj06A_ProbMobileObst = 0;
  $CAN_PrivRear::RRR_Obj06A::RRR_Obj06A_ProbNonObstacle = 0;
  }
  if(init_count == 16)
  {
  $CAN_PrivRear::RRR_Obj06A::RRR_Obj06A_ProbObstacle = 0;
  $CAN_PrivRear::RRR_Obj06A::RRR_Obj06A_RefPosIndex = 0;
  $CAN_PrivRear::RRR_Obj06A::RRR_Obj06A_Valid = 0;
  $CAN_PrivRear::RRR_Obj06A::RRR_Obj06A_Vx = -128;
  $CAN_PrivRear::RRR_Obj06A::RRR_Obj06A_VxAxCoVnce = 0;
  $CAN_PrivRear::RRR_Obj06A::RRR_Obj06A_VxAyCoVnce = 0;
  $CAN_PrivRear::RRR_Obj06A::RRR_Obj06A_VxVnce = 0;
  $CAN_PrivRear::RRR_Obj06A::RRR_Obj06A_VxVyCoVnce = 0;
  $CAN_PrivRear::RRR_Obj06A::RRR_Obj06A_Vy = -64;
  $CAN_PrivRear::RRR_Obj06A::RRR_Obj06A_VyAxCoVnce = 0;
  $CAN_PrivRear::RRR_Obj06A::RRR_Obj06A_VyAyCoVnce = 0;
  $CAN_PrivRear::RRR_Obj06A::RRR_Obj06A_VyVnce = 0;
  $CAN_PrivRear::RRR_Obj06A::RRR_Obj06A_Width = 0;
  $CAN_PrivRear::RRR_Obj06A::RRR_Obj06A_WidthVnce = 0;
  $CAN_PrivRear::RRR_Obj06B::RRR_Obj06B_BehaviorType = 0;
  $CAN_PrivRear::RRR_Obj06B::RRR_Obj06B_MovingObserved = 0;
  $CAN_PrivRear::RRR_Obj06B::RRR_Obj06B_MovingProbability = 0;
  $CAN_PrivRear::RRR_Obj06B::RRR_Obj06B_Prob4PlusWhlCAR = 0;
  $CAN_PrivRear::RRR_Obj06B::RRR_Obj06B_Prob4PlusWhlbHGV = 0;
  $CAN_PrivRear::RRR_Obj06B::RRR_Obj06B_ProbGNDReflex = 0;
  $CAN_PrivRear::RRR_Obj06B::RRR_Obj06B_ProbMob2Whl = 0;
  $CAN_PrivRear::RRR_Obj06B::RRR_Obj06B_ProbMob4PlusWhl = 0;
  $CAN_PrivRear::RRR_Obj06B::RRR_Obj06B_ProbMobPed = 0;
  $CAN_PrivRear::RRR_Obj06B::RRR_Obj06B_ProbStatBarrier = 0;
  $CAN_PrivRear::RRR_Obj06B::RRR_Obj06B_ProbStatObst = 0;
  }
  if(init_count == 17)
  {
  $CAN_PrivRear::RRR_Obj07A::RRR_Obj07A_Ax = -16;
  $CAN_PrivRear::RRR_Obj07A::RRR_Obj07A_AxAyCoVnce = 0;
  $CAN_PrivRear::RRR_Obj07A::RRR_Obj07A_AxVnce = 0;
  $CAN_PrivRear::RRR_Obj07A::RRR_Obj07A_Ay = -16;
  $CAN_PrivRear::RRR_Obj07A::RRR_Obj07A_AyVnce = 0;
  $CAN_PrivRear::RRR_Obj07A::RRR_Obj07A_Dx = -256;
  $CAN_PrivRear::RRR_Obj07A::RRR_Obj07A_DxAxCoVnce = 0;
  $CAN_PrivRear::RRR_Obj07A::RRR_Obj07A_DxAyCoVnce = 0;
  $CAN_PrivRear::RRR_Obj07A::RRR_Obj07A_DxDyCoVnce = 0;
  $CAN_PrivRear::RRR_Obj07A::RRR_Obj07A_DxVnce = 0;
  $CAN_PrivRear::RRR_Obj07A::RRR_Obj07A_DxVxCoVnce = 0;
  $CAN_PrivRear::RRR_Obj07A::RRR_Obj07A_DxVyCoVnce = 0;
  $CAN_PrivRear::RRR_Obj07A::RRR_Obj07A_Dy = -128;
  $CAN_PrivRear::RRR_Obj07A::RRR_Obj07A_DyAxCoVnce = 0;
  $CAN_PrivRear::RRR_Obj07A::RRR_Obj07A_DyAyCoVnce = 0;
  $CAN_PrivRear::RRR_Obj07A::RRR_Obj07A_DyVnce = 0;
  $CAN_PrivRear::RRR_Obj07A::RRR_Obj07A_DyVxCoVnce = 0;
  $CAN_PrivRear::RRR_Obj07A::RRR_Obj07A_DyVyCoVnce = 0;
  $CAN_PrivRear::RRR_Obj07A::RRR_Obj07A_Dz = -5;
  $CAN_PrivRear::RRR_Obj07A::RRR_Obj07A_DzVnce = 0;
  $CAN_PrivRear::RRR_Obj07A::RRR_Obj07A_HeadingYawAngle = -4.48;
  $CAN_PrivRear::RRR_Obj07A::RRR_Obj07A_HeadingYawAngleVnce = 0;
  $CAN_PrivRear::RRR_Obj07A::RRR_Obj07A_Height = 0;
  $CAN_PrivRear::RRR_Obj07A::RRR_Obj07A_HeightVnce = 0;
  $CAN_PrivRear::RRR_Obj07A::RRR_Obj07A_ID = 0;
  }
  if(init_count == 18)
  {
  $CAN_PrivRear::RRR_Obj07A::RRR_Obj07A_Length = 0;
  $CAN_PrivRear::RRR_Obj07A::RRR_Obj07A_LengthVnce = 0;
  $CAN_PrivRear::RRR_Obj07A::RRR_Obj07A_Measured = 0;
  $CAN_PrivRear::RRR_Obj07A::RRR_Obj07A_ProbExist = 0;
  $CAN_PrivRear::RRR_Obj07A::RRR_Obj07A_ProbMobileObst = 0;
  $CAN_PrivRear::RRR_Obj07A::RRR_Obj07A_ProbNonObstacle = 0;
  $CAN_PrivRear::RRR_Obj07A::RRR_Obj07A_ProbObstacle = 0;
  $CAN_PrivRear::RRR_Obj07A::RRR_Obj07A_RefPosIndex = 0;
  $CAN_PrivRear::RRR_Obj07A::RRR_Obj07A_Valid = 0;
  $CAN_PrivRear::RRR_Obj07A::RRR_Obj07A_Vx = -128;
  $CAN_PrivRear::RRR_Obj07A::RRR_Obj07A_VxAxCoVnce = 0;
  $CAN_PrivRear::RRR_Obj07A::RRR_Obj07A_VxAyCoVnce = 0;
  $CAN_PrivRear::RRR_Obj07A::RRR_Obj07A_VxVnce = 0;
  $CAN_PrivRear::RRR_Obj07A::RRR_Obj07A_VxVyCoVnce = 0;
  $CAN_PrivRear::RRR_Obj07A::RRR_Obj07A_Vy = -64;
  $CAN_PrivRear::RRR_Obj07A::RRR_Obj07A_VyAxCoVnce = 0;
  $CAN_PrivRear::RRR_Obj07A::RRR_Obj07A_VyAyCoVnce = 0;
  $CAN_PrivRear::RRR_Obj07A::RRR_Obj07A_VyVnce = 0;
  $CAN_PrivRear::RRR_Obj07A::RRR_Obj07A_Width = 0;
  $CAN_PrivRear::RRR_Obj07A::RRR_Obj07A_WidthVnce = 0;
  $CAN_PrivRear::RRR_Obj07B::RRR_Obj07B_BehaviorType = 0;
  $CAN_PrivRear::RRR_Obj07B::RRR_Obj07B_MovingObserved = 0;
  $CAN_PrivRear::RRR_Obj07B::RRR_Obj07B_MovingProbability = 0;
  $CAN_PrivRear::RRR_Obj07B::RRR_Obj07B_Prob4PlusWhlCAR = 0;
  $CAN_PrivRear::RRR_Obj07B::RRR_Obj07B_Prob4PlusWhlbHGV = 0;
  }
  if(init_count == 19)
  {
  $CAN_PrivRear::RRR_Obj07B::RRR_Obj07B_ProbGNDReflex = 0;
  $CAN_PrivRear::RRR_Obj07B::RRR_Obj07B_ProbMob2Whl = 0;
  $CAN_PrivRear::RRR_Obj07B::RRR_Obj07B_ProbMob4PlusWhl = 0;
  $CAN_PrivRear::RRR_Obj07B::RRR_Obj07B_ProbMobPed = 0;
  $CAN_PrivRear::RRR_Obj07B::RRR_Obj07B_ProbStatBarrier = 0;
  $CAN_PrivRear::RRR_Obj07B::RRR_Obj07B_ProbStatObst = 0;
  $CAN_PrivRear::RRR_Obj08A::RRR_Obj08A_Ax = -16;
  $CAN_PrivRear::RRR_Obj08A::RRR_Obj08A_AxAyCoVnce = 0;
  $CAN_PrivRear::RRR_Obj08A::RRR_Obj08A_AxVnce = 0;
  $CAN_PrivRear::RRR_Obj08A::RRR_Obj08A_Ay = -16;
  $CAN_PrivRear::RRR_Obj08A::RRR_Obj08A_AyVnce = 0;
  $CAN_PrivRear::RRR_Obj08A::RRR_Obj08A_Dx = -256;
  $CAN_PrivRear::RRR_Obj08A::RRR_Obj08A_DxAxCoVnce = 0;
  $CAN_PrivRear::RRR_Obj08A::RRR_Obj08A_DxAyCoVnce = 0;
  $CAN_PrivRear::RRR_Obj08A::RRR_Obj08A_DxDyCoVnce = 0;
  $CAN_PrivRear::RRR_Obj08A::RRR_Obj08A_DxVnce = 0;
  $CAN_PrivRear::RRR_Obj08A::RRR_Obj08A_DxVxCoVnce = 0;
  $CAN_PrivRear::RRR_Obj08A::RRR_Obj08A_DxVyCoVnce = 0;
  $CAN_PrivRear::RRR_Obj08A::RRR_Obj08A_Dy = -128;
  $CAN_PrivRear::RRR_Obj08A::RRR_Obj08A_DyAxCoVnce = 0;
  $CAN_PrivRear::RRR_Obj08A::RRR_Obj08A_DyAyCoVnce = 0;
  $CAN_PrivRear::RRR_Obj08A::RRR_Obj08A_DyVnce = 0;
  $CAN_PrivRear::RRR_Obj08A::RRR_Obj08A_DyVxCoVnce = 0;
  $CAN_PrivRear::RRR_Obj08A::RRR_Obj08A_DyVyCoVnce = 0;
  $CAN_PrivRear::RRR_Obj08A::RRR_Obj08A_Dz = -5;
  }
  if(init_count == 20)
  {
  $CAN_PrivRear::RRR_Obj08A::RRR_Obj08A_DzVnce = 0;
  $CAN_PrivRear::RRR_Obj08A::RRR_Obj08A_HeadingYawAngle = -4.48;
  $CAN_PrivRear::RRR_Obj08A::RRR_Obj08A_HeadingYawAngleVnce = 0;
  $CAN_PrivRear::RRR_Obj08A::RRR_Obj08A_Height = 0;
  $CAN_PrivRear::RRR_Obj08A::RRR_Obj08A_HeightVnce = 0;
  $CAN_PrivRear::RRR_Obj08A::RRR_Obj08A_ID = 0;
  $CAN_PrivRear::RRR_Obj08A::RRR_Obj08A_Length = 0;
  $CAN_PrivRear::RRR_Obj08A::RRR_Obj08A_LengthVnce = 0;
  $CAN_PrivRear::RRR_Obj08A::RRR_Obj08A_Measured = 0;
  $CAN_PrivRear::RRR_Obj08A::RRR_Obj08A_ProbExist = 0;
  $CAN_PrivRear::RRR_Obj08A::RRR_Obj08A_ProbMobileObst = 0;
  $CAN_PrivRear::RRR_Obj08A::RRR_Obj08A_ProbNonObstacle = 0;
  $CAN_PrivRear::RRR_Obj08A::RRR_Obj08A_ProbObstacle = 0;
  $CAN_PrivRear::RRR_Obj08A::RRR_Obj08A_RefPosIndex = 0;
  $CAN_PrivRear::RRR_Obj08A::RRR_Obj08A_Valid = 0;
  $CAN_PrivRear::RRR_Obj08A::RRR_Obj08A_Vx = -128;
  $CAN_PrivRear::RRR_Obj08A::RRR_Obj08A_VxAxCoVnce = 0;
  $CAN_PrivRear::RRR_Obj08A::RRR_Obj08A_VxAyCoVnce = 0;
  $CAN_PrivRear::RRR_Obj08A::RRR_Obj08A_VxVnce = 0;
  $CAN_PrivRear::RRR_Obj08A::RRR_Obj08A_VxVyCoVnce = 0;
  $CAN_PrivRear::RRR_Obj08A::RRR_Obj08A_Vy = -64;
  $CAN_PrivRear::RRR_Obj08A::RRR_Obj08A_VyAxCoVnce = 0;
  $CAN_PrivRear::RRR_Obj08A::RRR_Obj08A_VyAyCoVnce = 0;
  $CAN_PrivRear::RRR_Obj08A::RRR_Obj08A_VyVnce = 0;
  $CAN_PrivRear::RRR_Obj08A::RRR_Obj08A_Width = 0;
  }
  if(init_count == 21)
  {
  $CAN_PrivRear::RRR_Obj08A::RRR_Obj08A_WidthVnce = 0;
  $CAN_PrivRear::RRR_Obj08B::RRR_Obj08B_BehaviorType = 0;
  $CAN_PrivRear::RRR_Obj08B::RRR_Obj08B_MovingObserved = 0;
  $CAN_PrivRear::RRR_Obj08B::RRR_Obj08B_MovingProbability = 0;
  $CAN_PrivRear::RRR_Obj08B::RRR_Obj08B_Prob4PlusWhlCAR = 0;
  $CAN_PrivRear::RRR_Obj08B::RRR_Obj08B_Prob4PlusWhlbHGV = 0;
  $CAN_PrivRear::RRR_Obj08B::RRR_Obj08B_ProbGNDReflex = 0;
  $CAN_PrivRear::RRR_Obj08B::RRR_Obj08B_ProbMob2Whl = 0;
  $CAN_PrivRear::RRR_Obj08B::RRR_Obj08B_ProbMob4PlusWhl = 0;
  $CAN_PrivRear::RRR_Obj08B::RRR_Obj08B_ProbMobPed = 0;
  $CAN_PrivRear::RRR_Obj08B::RRR_Obj08B_ProbStatBarrier = 0;
  $CAN_PrivRear::RRR_Obj08B::RRR_Obj08B_ProbStatObst = 0;
  $CAN_PrivRear::RRR_Obj09A::RRR_Obj09A_Ax = -16;
  $CAN_PrivRear::RRR_Obj09A::RRR_Obj09A_AxAyCoVnce = 0;
  $CAN_PrivRear::RRR_Obj09A::RRR_Obj09A_AxVnce = 0;
  $CAN_PrivRear::RRR_Obj09A::RRR_Obj09A_Ay = -16;
  $CAN_PrivRear::RRR_Obj09A::RRR_Obj09A_AyVnce = 0;
  $CAN_PrivRear::RRR_Obj09A::RRR_Obj09A_Dx = -256;
  $CAN_PrivRear::RRR_Obj09A::RRR_Obj09A_DxAxCoVnce = 0;
  $CAN_PrivRear::RRR_Obj09A::RRR_Obj09A_DxAyCoVnce = 0;
  $CAN_PrivRear::RRR_Obj09A::RRR_Obj09A_DxDyCoVnce = 0;
  $CAN_PrivRear::RRR_Obj09A::RRR_Obj09A_DxVnce = 0;
  $CAN_PrivRear::RRR_Obj09A::RRR_Obj09A_DxVxCoVnce = 0;
  $CAN_PrivRear::RRR_Obj09A::RRR_Obj09A_DxVyCoVnce = 0;
  $CAN_PrivRear::RRR_Obj09A::RRR_Obj09A_Dy = -128;
  }
  if(init_count == 22)
  {
  $CAN_PrivRear::RRR_Obj09A::RRR_Obj09A_DyAxCoVnce = 0;
  $CAN_PrivRear::RRR_Obj09A::RRR_Obj09A_DyAyCoVnce = 0;
  $CAN_PrivRear::RRR_Obj09A::RRR_Obj09A_DyVnce = 0;
  $CAN_PrivRear::RRR_Obj09A::RRR_Obj09A_DyVxCoVnce = 0;
  $CAN_PrivRear::RRR_Obj09A::RRR_Obj09A_DyVyCoVnce = 0;
  $CAN_PrivRear::RRR_Obj09A::RRR_Obj09A_Dz = -5;
  $CAN_PrivRear::RRR_Obj09A::RRR_Obj09A_DzVnce = 0;
  $CAN_PrivRear::RRR_Obj09A::RRR_Obj09A_HeadingYawAngle = -4.48;
  $CAN_PrivRear::RRR_Obj09A::RRR_Obj09A_HeadingYawAngleVnce = 0;
  $CAN_PrivRear::RRR_Obj09A::RRR_Obj09A_Height = 0;
  $CAN_PrivRear::RRR_Obj09A::RRR_Obj09A_HeightVnce = 0;
  $CAN_PrivRear::RRR_Obj09A::RRR_Obj09A_ID = 0;
  $CAN_PrivRear::RRR_Obj09A::RRR_Obj09A_Length = 0;
  $CAN_PrivRear::RRR_Obj09A::RRR_Obj09A_LengthVnce = 0;
  $CAN_PrivRear::RRR_Obj09A::RRR_Obj09A_Measured = 0;
  $CAN_PrivRear::RRR_Obj09A::RRR_Obj09A_ProbExist = 0;
  $CAN_PrivRear::RRR_Obj09A::RRR_Obj09A_ProbMobileObst = 0;
  $CAN_PrivRear::RRR_Obj09A::RRR_Obj09A_ProbNonObstacle = 0;
  $CAN_PrivRear::RRR_Obj09A::RRR_Obj09A_ProbObstacle = 0;
  $CAN_PrivRear::RRR_Obj09A::RRR_Obj09A_RefPosIndex = 0;
  $CAN_PrivRear::RRR_Obj09A::RRR_Obj09A_Valid = 0;
  $CAN_PrivRear::RRR_Obj09A::RRR_Obj09A_Vx = -128;
  $CAN_PrivRear::RRR_Obj09A::RRR_Obj09A_VxAxCoVnce = 0;
  $CAN_PrivRear::RRR_Obj09A::RRR_Obj09A_VxAyCoVnce = 0;
  $CAN_PrivRear::RRR_Obj09A::RRR_Obj09A_VxVnce = 0;
  }
  if(init_count == 23)
  {
  $CAN_PrivRear::RRR_Obj09A::RRR_Obj09A_VxVyCoVnce = 0;
  $CAN_PrivRear::RRR_Obj09A::RRR_Obj09A_Vy = -64;
  $CAN_PrivRear::RRR_Obj09A::RRR_Obj09A_VyAxCoVnce = 0;
  $CAN_PrivRear::RRR_Obj09A::RRR_Obj09A_VyAyCoVnce = 0;
  $CAN_PrivRear::RRR_Obj09A::RRR_Obj09A_VyVnce = 0;
  $CAN_PrivRear::RRR_Obj09A::RRR_Obj09A_Width = 0;
  $CAN_PrivRear::RRR_Obj09A::RRR_Obj09A_WidthVnce = 0;
  $CAN_PrivRear::RRR_Obj09B::RRR_Obj09B_BehaviorType = 0;
  $CAN_PrivRear::RRR_Obj09B::RRR_Obj09B_MovingObserved = 0;
  $CAN_PrivRear::RRR_Obj09B::RRR_Obj09B_MovingProbability = 0;
  $CAN_PrivRear::RRR_Obj09B::RRR_Obj09B_Prob4PlusWhlCAR = 0;
  $CAN_PrivRear::RRR_Obj09B::RRR_Obj09B_Prob4PlusWhlbHGV = 0;
  $CAN_PrivRear::RRR_Obj09B::RRR_Obj09B_ProbGNDReflex = 0;
  $CAN_PrivRear::RRR_Obj09B::RRR_Obj09B_ProbMob2Whl = 0;
  $CAN_PrivRear::RRR_Obj09B::RRR_Obj09B_ProbMob4PlusWhl = 0;
  $CAN_PrivRear::RRR_Obj09B::RRR_Obj09B_ProbMobPed = 0;
  $CAN_PrivRear::RRR_Obj09B::RRR_Obj09B_ProbStatBarrier = 0;
  $CAN_PrivRear::RRR_Obj09B::RRR_Obj09B_ProbStatObst = 0;
  $CAN_PrivRear::RRR_ObjHdr::RRR_ObjHdr_AziOutOfSpec = 0;
  $CAN_PrivRear::RRR_ObjHdr::RRR_ObjHdr_DetectionRange = 300;
  $CAN_PrivRear::RRR_ObjHdr::RRR_ObjHdr_ElevOutOfSpec = 0;
  $CAN_PrivRear::RRR_ObjHdr::RRR_ObjHdr_MountPosX = -0.8;
  $CAN_PrivRear::RRR_ObjHdr::RRR_ObjHdr_MountPosY = -0.774;
  $CAN_PrivRear::RRR_ObjHdr::RRR_ObjHdr_MountPosZ = 0.4;
  $CAN_PrivRear::RRR_ObjHdr::RRR_ObjHdr_ObjectDownSel = 0;
  }
  if(init_count == 24)
  {
  $CAN_PrivRear::RRR_ObjHdr::RRR_ObjHdr_PitchAngleLower = -0.2618;
  $CAN_PrivRear::RRR_ObjHdr::RRR_ObjHdr_PitchAngleUpper = 0.26163;
  $CAN_PrivRear::RRR_ObjHdr::RRR_ObjHdr_PitchMountAngle = 0.01326;
  $CAN_PrivRear::RRR_ObjHdr::RRR_ObjHdr_ProtObjectCount = 0;
  $CAN_PrivRear::RRR_ObjHdr::RRR_ObjHdr_ProtRSBPointCount = 0;
  $CAN_PrivRear::RRR_ObjHdr::RRR_ObjHdr_ProtRSBSegmentCount = 0;
  $CAN_PrivRear::RRR_ObjHdr::RRR_ObjHdr_ProtocolVersion = 263;
  $CAN_PrivRear::RRR_ObjHdr::RRR_ObjHdr_RollMountAngle = 0;
  $CAN_PrivRear::RRR_ObjHdr::RRR_ObjHdr_SensorState = 0;
  $CAN_PrivRear::RRR_ObjHdr::RRR_ObjHdr_TimeStamp = 0;
  $CAN_PrivRear::RRR_ObjHdr::RRR_ObjHdr_TimeStampLocal = 0;
  $CAN_PrivRear::RRR_ObjHdr::RRR_ObjHdr_TimeStampStatus = 0;
  $CAN_PrivRear::RRR_ObjHdr::RRR_ObjHdr_YawAngleLower = -1.30883;
  $CAN_PrivRear::RRR_ObjHdr::RRR_ObjHdr_YawAngleUpper = 1.30883;
  $CAN_PrivRear::RRR_ObjHdr::RRR_ObjHdr_YawMountAngle = -2.356194490192;
  $CAN_PrivRear::RRR_Status::RRR_Status_ModulationStatus = 0;
  $CAN_PrivRear::RRR_Status::RRR_Status_SensorState = 0;
  if (prestart_mode==0) init_count = 0;
  initFlag = 5;
  }
  init_count++;
}