/*@!Encoding:1252*/
/**
 * @file Cus_onXcp_init.cin
 * @author ADAS_HIL_TEAM
 * @date 10-04-2022
 * @brief  Handles Customer specific onXCP events
 *
 * ################################################################
 * C O P Y R I G H T S
 * ----------------------------------------------------------------
 * Copyright (c) 2022-2023 by Robert Bosch GmbH. All rights reserved.
 
 * The reproduction, distribution and utilization of this file as
 * well as the communication of its contents to others without express
 * authorization is prohibited. Offenders will be held liable for the
 * payment of damages. All rights reserved in the event of the grant
 * of a patent, utility model or design.
 *
 * ################################################################
*/

includes
{
}

variables
{
}

void Cus_onXcp_init()
{
//  @sysvar::XCP::RadarFC::_padval_x_par_a_st::_VdiDisableAebOutput_B = 0; 
}