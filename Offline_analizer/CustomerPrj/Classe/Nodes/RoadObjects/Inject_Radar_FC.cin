/*@!Encoding:1252*/
/**
 * @file Inject_Radar_FC.cin
 * @author ADAS_HIL_TEAM
 * @date 03-21-2023
 * @brief Handles injection of front center radar
 * 
 * ##################################################################
 * C O P Y R I G H T S
 * ----------------------------------------------------------------
 * Copyright (c) 2023 by Robert Bosch GmbH. All rights reserved.
 * 
 * The reproduction, distribution and utilization of this file as
 * well as the communication of its contents to others without express
 * authorization is prohibited. Offenders will be held liable for the
 * payment of damages. All rights reserved in the event of the grant
 * of a patent, utility model or design.
 * 
 * ##################################################################
 */

includes
{
  #pragma library("..\..\..\..\Platform\Classe\DLL\Release64\RoadObj.dll")
}

variables
{
  int target_counter_radar_fc = 0;
  int injection_counter_radar_fc = -1;
}

/** @brief Setting of variable header values
  * @return void
  */
void inject_radar_fc_hdr(){
  if(@hil_ctrl::ra6_fc_lgu_loc_sim > 0){
//    $RFC_LocationHdrA::RFC_LocHdr_NumValidDetections = @target_radar_fc_sim::locdata.number_of_loc;
//    $RFC_LocationHdrA::RFC_LocHdr_SensorOriginPointX = @radarfc_par::mounting_pos_x;
//    $RFC_LocationHdrA::RFC_LocHdr_SensorOriginPointY = @radarfc_par::mounting_pos_y;
//    $RFC_LocationHdrA::RFC_LocHdr_SensorOriginPointZ = @radarfc_par::mounting_pos_z;
//    $RFC_LocationHdrA::RFC_LocHdr_SensorOrientYaw = @radarfc_par::mounting_ori_yaw;
    
  }else if(@hil_ctrl::ra6_fc_sgu_obj_sim > 0){
    @CAN_RadarFC::RFC_Object::RFC_Object_ObjHdr_NumValidObjects = @target_radar_fc_sim::objdata.number_of_obj;
    @CAN_RadarFC::RFC_Object::RFC_Object_SpiHdr_SensorOriginPointX = @radarfc_par::mounting_pos_x;
    @CAN_RadarFC::RFC_Object::RFC_Object_SpiHdr_SensorOriginPointY = @radarfc_par::mounting_pos_y;
    @CAN_RadarFC::RFC_Object::RFC_Object_SpiHdr_SensorOriginPointZ = @radarfc_par::mounting_pos_z;
    @CAN_RadarFC::RFC_Object::RFC_Object_SpiHdr_SensorOrientYaw = @radarfc_par::mounting_ori_yaw;
    
    // Set the number of objects to be put into the CAN TP ByteArray to be the object count, but atleast 1
    if (@target_radar_fc_sim::objdata.number_of_obj >= 1) @CAN_RadarFC_RFC_Object::Write_No_signals = @target_radar_fc_sim::objdata.number_of_obj; else @CAN_RadarFC_RFC_Object::Write_No_signals = 1;
  }
  
}

/** @brief Injects calculated location data stored in the target_radar_fc_sim arrays.
  *        This is done the way so that all valid objects are being injected in a chain (no "holes" in between).
  * @param object_id ID of the location that shall be injected.
  * @param injection_method Flag to decide if data shall be injected onto the BUS (=1) or via XCP (=2).
  * @return void
  */
//void inject_radar_fc_loc(byte object_id, int injection_method)
//{
//  target_counter_radar_fc = 0;
//  injection_counter_radar_fc = -1;
  
//  //all locations are filled into the array without holes and so being injected in this order
//  injection_counter_radar_fc = object_id;
  
//  if (injection_method == 1)
//  { //Simulated sensor -> BUS
//    switch (injection_counter_radar_fc)
//    {
//      case 0: //"Object-0"
//        /**
//          * Constant values
//          */
//        $RFC_Location_000_002::RFC_Loc000_RadialDistanceVnce = 0.017;
//        $RFC_Location_000_002::RFC_Loc000_DistVelocityCoVnce = 0.0076;
//        $RFC_Location_000_002::RFC_Loc000_DistVelocityQuality = 255;
//        $RFC_Location_000_002::RFC_Loc000_ElevationQuality = 255;
//        $RFC_Location_000_002::RFC_Loc000_ElevationVnce = 0.092;
//        $RFC_Location_000_002::RFC_Loc000_AzimuthQuality = 255;
//        $RFC_Location_000_002::RFC_Loc000_AzimuthVnce = 0.092;
//        $RFC_Location_000_002::RFC_Loc000_RadialVelocityVnce = 0.0032;
//        $RFC_Location_000_002::RFC_Loc000_AzimuthalPartnerId = 1023;
        
//        /**
//          * Variable values
//          */
//        $RFC_Location_000_002::RFC_Loc000_RadialDistance = dllGetRadarFCLocRadialDistance(@hil_ctrl::Handle_RoadObj, object_id);
//        $RFC_Location_000_002::RFC_Loc000_RadialVelocity = dllGetRadarFCLocRadialVelocity(@hil_ctrl::Handle_RoadObj, object_id);
//        $RFC_Location_000_002::RFC_Loc000_Elevation = dllGetRadarFCLocElevationAngle(@hil_ctrl::Handle_RoadObj, object_id);
//        $RFC_Location_000_002::RFC_Loc000_Azimuth = dllGetRadarFCLocAzimuthAngle(@hil_ctrl::Handle_RoadObj, object_id) * 180 / PI;
//        $RFC_Location_000_002::RFC_Loc000_RadarCrossSection = dllGetRadarFCLocRCS(@hil_ctrl::Handle_RoadObj, object_id);
//        $RFC_Location_000_002::RFC_Loc000_RSSI = dllGetRadarFCLocRSSI(@hil_ctrl::Handle_RoadObj, object_id);
//        break;
        
//      case 1: //"Object-1"
//        /**
//          * Constant values
//          */
//        $RFC_Location_000_002::RFC_Loc001_RadialDistanceVnce = 0.017;
//        $RFC_Location_000_002::RFC_Loc001_DistVelocityCoVnce = 0.0076;
//        $RFC_Location_000_002::RFC_Loc001_DistVelocityQuality = 255;
//        $RFC_Location_000_002::RFC_Loc001_ElevationQuality = 255;
//        $RFC_Location_000_002::RFC_Loc001_ElevationVnce = 0.092;
//        $RFC_Location_000_002::RFC_Loc001_AzimuthQuality = 255;
//        $RFC_Location_000_002::RFC_Loc001_AzimuthVnce = 0.092;
//        $RFC_Location_000_002::RFC_Loc001_RadialVelocityVnce = 0.0032;
//        $RFC_Location_000_002::RFC_Loc001_AzimuthalPartnerId = 1023;
        
//        /**
//          * Variable values
//          */
//        $RFC_Location_000_002::RFC_Loc001_RadialDistance = dllGetRadarFCLocRadialDistance(@hil_ctrl::Handle_RoadObj, object_id);
//        $RFC_Location_000_002::RFC_Loc001_RadialVelocity = dllGetRadarFCLocRadialVelocity(@hil_ctrl::Handle_RoadObj, object_id);
//        $RFC_Location_000_002::RFC_Loc001_Elevation = dllGetRadarFCLocElevationAngle(@hil_ctrl::Handle_RoadObj, object_id);
//        $RFC_Location_000_002::RFC_Loc001_Azimuth = dllGetRadarFCLocAzimuthAngle(@hil_ctrl::Handle_RoadObj, object_id) * 180 / PI;
//        $RFC_Location_000_002::RFC_Loc001_RadarCrossSection = dllGetRadarFCLocRCS(@hil_ctrl::Handle_RoadObj, object_id);
//        $RFC_Location_000_002::RFC_Loc001_RSSI = dllGetRadarFCLocRSSI(@hil_ctrl::Handle_RoadObj, object_id);
//        break;
        
//      case 2: //"Object-2"
//        /**
//          * Constant values
//          */
//        $RFC_Location_000_002::RFC_Loc002_RadialDistanceVnce = 0.017;
//        $RFC_Location_000_002::RFC_Loc002_DistVelocityCoVnce = 0.0076;
//        $RFC_Location_000_002::RFC_Loc002_DistVelocityQuality = 255;
//        $RFC_Location_000_002::RFC_Loc002_ElevationQuality = 255;
//        $RFC_Location_000_002::RFC_Loc002_ElevationVnce = 0.092;
//        $RFC_Location_000_002::RFC_Loc002_AzimuthQuality = 255;
//        $RFC_Location_000_002::RFC_Loc002_AzimuthVnce = 0.092;
//        $RFC_Location_000_002::RFC_Loc002_RadialVelocityVnce = 0.0032;
//        $RFC_Location_000_002::RFC_Loc002_AzimuthalPartnerId = 1023;
        
//        /**
//          * Variable values
//          */
//        $RFC_Location_000_002::RFC_Loc002_RadialDistance = dllGetRadarFCLocRadialDistance(@hil_ctrl::Handle_RoadObj, object_id);
//        $RFC_Location_000_002::RFC_Loc002_RadialVelocity = dllGetRadarFCLocRadialVelocity(@hil_ctrl::Handle_RoadObj, object_id);
//        $RFC_Location_000_002::RFC_Loc002_Elevation = dllGetRadarFCLocElevationAngle(@hil_ctrl::Handle_RoadObj, object_id);
//        $RFC_Location_000_002::RFC_Loc002_Azimuth = dllGetRadarFCLocAzimuthAngle(@hil_ctrl::Handle_RoadObj, object_id) * 180 / PI;
//        $RFC_Location_000_002::RFC_Loc002_RadarCrossSection = dllGetRadarFCLocRCS(@hil_ctrl::Handle_RoadObj, object_id);
//        $RFC_Location_000_002::RFC_Loc002_RSSI = dllGetRadarFCLocRSSI(@hil_ctrl::Handle_RoadObj, object_id);
//        break;
        
//      case 3: //"Object-3"
//        /**
//          * Constant values
//          */
//        $RFC_Location_003_005::RFC_Loc003_RadialDistanceVnce = 0.017;
//        $RFC_Location_003_005::RFC_Loc003_DistVelocityCoVnce = 0.0076;
//        $RFC_Location_003_005::RFC_Loc003_DistVelocityQuality = 255;
//        $RFC_Location_003_005::RFC_Loc003_ElevationQuality = 255;
//        $RFC_Location_003_005::RFC_Loc003_ElevationVnce = 0.092;
//        $RFC_Location_003_005::RFC_Loc003_AzimuthQuality = 255;
//        $RFC_Location_003_005::RFC_Loc003_AzimuthVnce = 0.092;
//        $RFC_Location_003_005::RFC_Loc003_RadialVelocityVnce = 0.0032;
//        $RFC_Location_003_005::RFC_Loc003_AzimuthalPartnerId = 1023;
        
//        /**
//          * Variable values
//          */
//        $RFC_Location_003_005::RFC_Loc003_RadialDistance = dllGetRadarFCLocRadialDistance(@hil_ctrl::Handle_RoadObj, object_id);
//        $RFC_Location_003_005::RFC_Loc003_RadialVelocity = dllGetRadarFCLocRadialVelocity(@hil_ctrl::Handle_RoadObj, object_id);
//        $RFC_Location_003_005::RFC_Loc003_Elevation = dllGetRadarFCLocElevationAngle(@hil_ctrl::Handle_RoadObj, object_id);
//        $RFC_Location_003_005::RFC_Loc003_Azimuth = dllGetRadarFCLocAzimuthAngle(@hil_ctrl::Handle_RoadObj, object_id) * 180 / PI;
//        $RFC_Location_003_005::RFC_Loc003_RadarCrossSection = dllGetRadarFCLocRCS(@hil_ctrl::Handle_RoadObj, object_id);
//        $RFC_Location_003_005::RFC_Loc003_RSSI = dllGetRadarFCLocRSSI(@hil_ctrl::Handle_RoadObj, object_id);
//        break;
        
//      case 4: //"Object-4"
//        /**
//          * Constant values
//          */
//        $RFC_Location_003_005::RFC_Loc004_RadialDistanceVnce = 0.017;
//        $RFC_Location_003_005::RFC_Loc004_DistVelocityCoVnce = 0.0076;
//        $RFC_Location_003_005::RFC_Loc004_DistVelocityQuality = 255;
//        $RFC_Location_003_005::RFC_Loc004_ElevationQuality = 255;
//        $RFC_Location_003_005::RFC_Loc004_ElevationVnce = 0.092;
//        $RFC_Location_003_005::RFC_Loc004_AzimuthQuality = 255;
//        $RFC_Location_003_005::RFC_Loc004_AzimuthVnce = 0.092;
//        $RFC_Location_003_005::RFC_Loc004_RadialVelocityVnce = 0.0032;
//        $RFC_Location_003_005::RFC_Loc004_AzimuthalPartnerId = 1023;
        
//        /**
//          * Variable values
//          */
//        $RFC_Location_003_005::RFC_Loc004_RadialDistance = dllGetRadarFCLocRadialDistance(@hil_ctrl::Handle_RoadObj, object_id);
//        $RFC_Location_003_005::RFC_Loc004_RadialVelocity = dllGetRadarFCLocRadialVelocity(@hil_ctrl::Handle_RoadObj, object_id);
//        $RFC_Location_003_005::RFC_Loc004_Elevation = dllGetRadarFCLocElevationAngle(@hil_ctrl::Handle_RoadObj, object_id);
//        $RFC_Location_003_005::RFC_Loc004_Azimuth = dllGetRadarFCLocAzimuthAngle(@hil_ctrl::Handle_RoadObj, object_id) * 180 / PI;
//        $RFC_Location_003_005::RFC_Loc004_RadarCrossSection = dllGetRadarFCLocRCS(@hil_ctrl::Handle_RoadObj, object_id);
//        $RFC_Location_003_005::RFC_Loc004_RSSI = dllGetRadarFCLocRSSI(@hil_ctrl::Handle_RoadObj, object_id);
//        break;
        
//      case 5: //"Object-5"
//        /**
//          * Constant values
//          */
//        $RFC_Location_003_005::RFC_Loc005_RadialDistanceVnce = 0.017;
//        $RFC_Location_003_005::RFC_Loc005_DistVelocityCoVnce = 0.0076;
//        $RFC_Location_003_005::RFC_Loc005_DistVelocityQuality = 255;
//        $RFC_Location_003_005::RFC_Loc005_ElevationQuality = 255;
//        $RFC_Location_003_005::RFC_Loc005_ElevationVnce = 0.092;
//        $RFC_Location_003_005::RFC_Loc005_AzimuthQuality = 255;
//        $RFC_Location_003_005::RFC_Loc005_AzimuthVnce = 0.092;
//        $RFC_Location_003_005::RFC_Loc005_RadialVelocityVnce = 0.0032;
//        $RFC_Location_003_005::RFC_Loc005_AzimuthalPartnerId = 1023;
        
//        /**
//          * Variable values
//          */
//        $RFC_Location_003_005::RFC_Loc005_RadialDistance = dllGetRadarFCLocRadialDistance(@hil_ctrl::Handle_RoadObj, object_id);
//        $RFC_Location_003_005::RFC_Loc005_RadialVelocity = dllGetRadarFCLocRadialVelocity(@hil_ctrl::Handle_RoadObj, object_id);
//        $RFC_Location_003_005::RFC_Loc005_Elevation = dllGetRadarFCLocElevationAngle(@hil_ctrl::Handle_RoadObj, object_id);
//        $RFC_Location_003_005::RFC_Loc005_Azimuth = dllGetRadarFCLocAzimuthAngle(@hil_ctrl::Handle_RoadObj, object_id) * 180 / PI;
//        $RFC_Location_003_005::RFC_Loc005_RadarCrossSection = dllGetRadarFCLocRCS(@hil_ctrl::Handle_RoadObj, object_id);
//        $RFC_Location_003_005::RFC_Loc005_RSSI = dllGetRadarFCLocRSSI(@hil_ctrl::Handle_RoadObj, object_id);
//        break;
        
//      case 6: //"Object-6"
//        /**
//          * Constant values
//          */
//        $RFC_Location_006_008::RFC_Loc006_RadialDistanceVnce = 0.017;
//        $RFC_Location_006_008::RFC_Loc006_DistVelocityCoVnce = 0.0076;
//        $RFC_Location_006_008::RFC_Loc006_DistVelocityQuality = 255;
//        $RFC_Location_006_008::RFC_Loc006_ElevationQuality = 255;
//        $RFC_Location_006_008::RFC_Loc006_ElevationVnce = 0.092;
//        $RFC_Location_006_008::RFC_Loc006_AzimuthQuality = 255;
//        $RFC_Location_006_008::RFC_Loc006_AzimuthVnce = 0.092;
//        $RFC_Location_006_008::RFC_Loc006_RadialVelocityVnce = 0.0032;
//        $RFC_Location_006_008::RFC_Loc006_AzimuthalPartnerId = 1023;
        
//        /**
//          * Variable values
//          */
//        $RFC_Location_006_008::RFC_Loc006_RadialDistance = dllGetRadarFCLocRadialDistance(@hil_ctrl::Handle_RoadObj, object_id);
//        $RFC_Location_006_008::RFC_Loc006_RadialVelocity = dllGetRadarFCLocRadialVelocity(@hil_ctrl::Handle_RoadObj, object_id);
//        $RFC_Location_006_008::RFC_Loc006_Elevation = dllGetRadarFCLocElevationAngle(@hil_ctrl::Handle_RoadObj, object_id);
//        $RFC_Location_006_008::RFC_Loc006_Azimuth = dllGetRadarFCLocAzimuthAngle(@hil_ctrl::Handle_RoadObj, object_id) * 180 / PI;
//        $RFC_Location_006_008::RFC_Loc006_RadarCrossSection = dllGetRadarFCLocRCS(@hil_ctrl::Handle_RoadObj, object_id);
//        $RFC_Location_006_008::RFC_Loc006_RSSI = dllGetRadarFCLocRSSI(@hil_ctrl::Handle_RoadObj, object_id);
//        break;
        
//      case 7: //"Object-7"
//        /**
//          * Constant values
//          */
//        $RFC_Location_006_008::RFC_Loc007_RadialDistanceVnce = 0.017;
//        $RFC_Location_006_008::RFC_Loc007_DistVelocityCoVnce = 0.0076;
//        $RFC_Location_006_008::RFC_Loc007_DistVelocityQuality = 255;
//        $RFC_Location_006_008::RFC_Loc007_ElevationQuality = 255;
//        $RFC_Location_006_008::RFC_Loc007_ElevationVnce = 0.092;
//        $RFC_Location_006_008::RFC_Loc007_AzimuthQuality = 255;
//        $RFC_Location_006_008::RFC_Loc007_AzimuthVnce = 0.092;
//        $RFC_Location_006_008::RFC_Loc007_RadialVelocityVnce = 0.0032;
//        $RFC_Location_006_008::RFC_Loc007_AzimuthalPartnerId = 1023;
        
//        /**
//          * Variable values
//          */
//        $RFC_Location_006_008::RFC_Loc007_RadialDistance = dllGetRadarFCLocRadialDistance(@hil_ctrl::Handle_RoadObj, object_id);
//        $RFC_Location_006_008::RFC_Loc007_RadialVelocity = dllGetRadarFCLocRadialVelocity(@hil_ctrl::Handle_RoadObj, object_id);
//        $RFC_Location_006_008::RFC_Loc007_Elevation = dllGetRadarFCLocElevationAngle(@hil_ctrl::Handle_RoadObj, object_id);
//        $RFC_Location_006_008::RFC_Loc007_Azimuth = dllGetRadarFCLocAzimuthAngle(@hil_ctrl::Handle_RoadObj, object_id) * 180 / PI;
//        $RFC_Location_006_008::RFC_Loc007_RadarCrossSection = dllGetRadarFCLocRCS(@hil_ctrl::Handle_RoadObj, object_id);
//        $RFC_Location_006_008::RFC_Loc007_RSSI = dllGetRadarFCLocRSSI(@hil_ctrl::Handle_RoadObj, object_id);
//        break;
        
//      case 8: //"Object-8"
//        /**
//          * Constant values
//          */
//        $RFC_Location_006_008::RFC_Loc008_RadialDistanceVnce = 0.017;
//        $RFC_Location_006_008::RFC_Loc008_DistVelocityCoVnce = 0.0076;
//        $RFC_Location_006_008::RFC_Loc008_DistVelocityQuality = 255;
//        $RFC_Location_006_008::RFC_Loc008_ElevationQuality = 255;
//        $RFC_Location_006_008::RFC_Loc008_ElevationVnce = 0.092;
//        $RFC_Location_006_008::RFC_Loc008_AzimuthQuality = 255;
//        $RFC_Location_006_008::RFC_Loc008_AzimuthVnce = 0.092;
//        $RFC_Location_006_008::RFC_Loc008_RadialVelocityVnce = 0.0032;
//        $RFC_Location_006_008::RFC_Loc008_AzimuthalPartnerId = 1023;
        
//        /**
//          * Variable values
//          */
//        $RFC_Location_006_008::RFC_Loc008_RadialDistance = dllGetRadarFCLocRadialDistance(@hil_ctrl::Handle_RoadObj, object_id);
//        $RFC_Location_006_008::RFC_Loc008_RadialVelocity = dllGetRadarFCLocRadialVelocity(@hil_ctrl::Handle_RoadObj, object_id);
//        $RFC_Location_006_008::RFC_Loc008_Elevation = dllGetRadarFCLocElevationAngle(@hil_ctrl::Handle_RoadObj, object_id);
//        $RFC_Location_006_008::RFC_Loc008_Azimuth = dllGetRadarFCLocAzimuthAngle(@hil_ctrl::Handle_RoadObj, object_id) * 180 / PI;
//        $RFC_Location_006_008::RFC_Loc008_RadarCrossSection = dllGetRadarFCLocRCS(@hil_ctrl::Handle_RoadObj, object_id);
//        $RFC_Location_006_008::RFC_Loc008_RSSI = dllGetRadarFCLocRSSI(@hil_ctrl::Handle_RoadObj, object_id);
//        break;
        
//      case 9: //"Object-9"
//        /**
//          * Constant values
//          */
//        $RFC_Location_009_011::RFC_Loc009_RadialDistanceVnce = 0.017;
//        $RFC_Location_009_011::RFC_Loc009_DistVelocityCoVnce = 0.0076;
//        $RFC_Location_009_011::RFC_Loc009_DistVelocityQuality = 255;
//        $RFC_Location_009_011::RFC_Loc009_ElevationQuality = 255;
//        $RFC_Location_009_011::RFC_Loc009_ElevationVnce = 0.092;
//        $RFC_Location_009_011::RFC_Loc009_AzimuthQuality = 255;
//        $RFC_Location_009_011::RFC_Loc009_AzimuthVnce = 0.092;
//        $RFC_Location_009_011::RFC_Loc009_RadialVelocityVnce = 0.0032;
//        $RFC_Location_009_011::RFC_Loc009_AzimuthalPartnerId = 1023;
        
//        /**
//          * Variable values
//          */
//        $RFC_Location_009_011::RFC_Loc009_RadialDistance = dllGetRadarFCLocRadialDistance(@hil_ctrl::Handle_RoadObj, object_id);
//        $RFC_Location_009_011::RFC_Loc009_RadialVelocity = dllGetRadarFCLocRadialVelocity(@hil_ctrl::Handle_RoadObj, object_id);
//        $RFC_Location_009_011::RFC_Loc009_Elevation = dllGetRadarFCLocElevationAngle(@hil_ctrl::Handle_RoadObj, object_id);
//        $RFC_Location_009_011::RFC_Loc009_Azimuth = dllGetRadarFCLocAzimuthAngle(@hil_ctrl::Handle_RoadObj, object_id) * 180 / PI;
//        $RFC_Location_009_011::RFC_Loc009_RadarCrossSection = dllGetRadarFCLocRCS(@hil_ctrl::Handle_RoadObj, object_id);
//        $RFC_Location_009_011::RFC_Loc009_RSSI = dllGetRadarFCLocRSSI(@hil_ctrl::Handle_RoadObj, object_id);
//        break;
        
//      case 10: //"Object-10"
//        /**
//          * Constant values
//          */
//        $RFC_Location_009_011::RFC_Loc010_RadialDistanceVnce = 0.017;
//        $RFC_Location_009_011::RFC_Loc010_DistVelocityCoVnce = 0.0076;
//        $RFC_Location_009_011::RFC_Loc010_DistVelocityQuality = 255;
//        $RFC_Location_009_011::RFC_Loc010_ElevationQuality = 255;
//        $RFC_Location_009_011::RFC_Loc010_ElevationVnce = 0.092;
//        $RFC_Location_009_011::RFC_Loc010_AzimuthQuality = 255;
//        $RFC_Location_009_011::RFC_Loc010_AzimuthVnce = 0.092;
//        $RFC_Location_009_011::RFC_Loc010_RadialVelocityVnce = 0.0032;
//        $RFC_Location_009_011::RFC_Loc010_AzimuthalPartnerId = 1023;
        
//        /**
//          * Variable values
//          */
//        $RFC_Location_009_011::RFC_Loc010_RadialDistance = dllGetRadarFCLocRadialDistance(@hil_ctrl::Handle_RoadObj, object_id);
//        $RFC_Location_009_011::RFC_Loc010_RadialVelocity = dllGetRadarFCLocRadialVelocity(@hil_ctrl::Handle_RoadObj, object_id);
//        $RFC_Location_009_011::RFC_Loc010_Elevation = dllGetRadarFCLocElevationAngle(@hil_ctrl::Handle_RoadObj, object_id);
//        $RFC_Location_009_011::RFC_Loc010_Azimuth = dllGetRadarFCLocAzimuthAngle(@hil_ctrl::Handle_RoadObj, object_id) * 180 / PI;
//        $RFC_Location_009_011::RFC_Loc010_RadarCrossSection = dllGetRadarFCLocRCS(@hil_ctrl::Handle_RoadObj, object_id);
//        $RFC_Location_009_011::RFC_Loc010_RSSI = dllGetRadarFCLocRSSI(@hil_ctrl::Handle_RoadObj, object_id);
//        break;
        
//      case 11: //"Object-11"
//        /**
//          * Constant values
//          */
//        $RFC_Location_009_011::RFC_Loc011_RadialDistanceVnce = 0.017;
//        $RFC_Location_009_011::RFC_Loc011_DistVelocityCoVnce = 0.0076;
//        $RFC_Location_009_011::RFC_Loc011_DistVelocityQuality = 255;
//        $RFC_Location_009_011::RFC_Loc011_ElevationQuality = 255;
//        $RFC_Location_009_011::RFC_Loc011_ElevationVnce = 0.092;
//        $RFC_Location_009_011::RFC_Loc011_AzimuthQuality = 255;
//        $RFC_Location_009_011::RFC_Loc011_AzimuthVnce = 0.092;
//        $RFC_Location_009_011::RFC_Loc011_RadialVelocityVnce = 0.0032;
//        $RFC_Location_009_011::RFC_Loc011_AzimuthalPartnerId = 1023;
        
//        /**
//          * Variable values
//          */
//        $RFC_Location_009_011::RFC_Loc011_RadialDistance = dllGetRadarFCLocRadialDistance(@hil_ctrl::Handle_RoadObj, object_id);
//        $RFC_Location_009_011::RFC_Loc011_RadialVelocity = dllGetRadarFCLocRadialVelocity(@hil_ctrl::Handle_RoadObj, object_id);
//        $RFC_Location_009_011::RFC_Loc011_Elevation = dllGetRadarFCLocElevationAngle(@hil_ctrl::Handle_RoadObj, object_id);
//        $RFC_Location_009_011::RFC_Loc011_Azimuth = dllGetRadarFCLocAzimuthAngle(@hil_ctrl::Handle_RoadObj, object_id) * 180 / PI;
//        $RFC_Location_009_011::RFC_Loc011_RadarCrossSection = dllGetRadarFCLocRCS(@hil_ctrl::Handle_RoadObj, object_id);
//        $RFC_Location_009_011::RFC_Loc011_RSSI = dllGetRadarFCLocRSSI(@hil_ctrl::Handle_RoadObj, object_id);
//        break;
        
//      case 12: //"Object-12"
//        /**
//          * Constant values
//          */
//        $RFC_Location_012_014::RFC_Loc012_RadialDistanceVnce = 0.017;
//        $RFC_Location_012_014::RFC_Loc012_DistVelocityCoVnce = 0.0076;
//        $RFC_Location_012_014::RFC_Loc012_DistVelocityQuality = 255;
//        $RFC_Location_012_014::RFC_Loc012_ElevationQuality = 255;
//        $RFC_Location_012_014::RFC_Loc012_ElevationVnce = 0.092;
//        $RFC_Location_012_014::RFC_Loc012_AzimuthQuality = 255;
//        $RFC_Location_012_014::RFC_Loc012_AzimuthVnce = 0.092;
//        $RFC_Location_012_014::RFC_Loc012_RadialVelocityVnce = 0.0032;
//        $RFC_Location_012_014::RFC_Loc012_AzimuthalPartnerId = 1023;
        
//        /**
//          * Variable values
//          */
//        $RFC_Location_012_014::RFC_Loc012_RadialDistance = dllGetRadarFCLocRadialDistance(@hil_ctrl::Handle_RoadObj, object_id);
//        $RFC_Location_012_014::RFC_Loc012_RadialVelocity = dllGetRadarFCLocRadialVelocity(@hil_ctrl::Handle_RoadObj, object_id);
//        $RFC_Location_012_014::RFC_Loc012_Elevation = dllGetRadarFCLocElevationAngle(@hil_ctrl::Handle_RoadObj, object_id);
//        $RFC_Location_012_014::RFC_Loc012_Azimuth = dllGetRadarFCLocAzimuthAngle(@hil_ctrl::Handle_RoadObj, object_id) * 180 / PI;
//        $RFC_Location_012_014::RFC_Loc012_RadarCrossSection = dllGetRadarFCLocRCS(@hil_ctrl::Handle_RoadObj, object_id);
//        $RFC_Location_012_014::RFC_Loc012_RSSI = dllGetRadarFCLocRSSI(@hil_ctrl::Handle_RoadObj, object_id);
//        break;
        
//      case 13: //"Object-13"
//        /**
//          * Constant values
//          */
//        $RFC_Location_012_014::RFC_Loc013_RadialDistanceVnce = 0.017;
//        $RFC_Location_012_014::RFC_Loc013_DistVelocityCoVnce = 0.0076;
//        $RFC_Location_012_014::RFC_Loc013_DistVelocityQuality = 255;
//        $RFC_Location_012_014::RFC_Loc013_ElevationQuality = 255;
//        $RFC_Location_012_014::RFC_Loc013_ElevationVnce = 0.092;
//        $RFC_Location_012_014::RFC_Loc013_AzimuthQuality = 255;
//        $RFC_Location_012_014::RFC_Loc013_AzimuthVnce = 0.092;
//        $RFC_Location_012_014::RFC_Loc013_RadialVelocityVnce = 0.0032;
//        $RFC_Location_012_014::RFC_Loc013_AzimuthalPartnerId = 1023;
        
//        /**
//          * Variable values
//          */
//        $RFC_Location_012_014::RFC_Loc013_RadialDistance = dllGetRadarFCLocRadialDistance(@hil_ctrl::Handle_RoadObj, object_id);
//        $RFC_Location_012_014::RFC_Loc013_RadialVelocity = dllGetRadarFCLocRadialVelocity(@hil_ctrl::Handle_RoadObj, object_id);
//        $RFC_Location_012_014::RFC_Loc013_Elevation = dllGetRadarFCLocElevationAngle(@hil_ctrl::Handle_RoadObj, object_id);
//        $RFC_Location_012_014::RFC_Loc013_Azimuth = dllGetRadarFCLocAzimuthAngle(@hil_ctrl::Handle_RoadObj, object_id) * 180 / PI;
//        $RFC_Location_012_014::RFC_Loc013_RadarCrossSection = dllGetRadarFCLocRCS(@hil_ctrl::Handle_RoadObj, object_id);
//        $RFC_Location_012_014::RFC_Loc013_RSSI = dllGetRadarFCLocRSSI(@hil_ctrl::Handle_RoadObj, object_id);
//        break;
        
//      case 14: //"Object-14"
//        /**
//          * Constant values
//          */
//        $RFC_Location_012_014::RFC_Loc014_RadialDistanceVnce = 0.017;
//        $RFC_Location_012_014::RFC_Loc014_DistVelocityCoVnce = 0.0076;
//        $RFC_Location_012_014::RFC_Loc014_DistVelocityQuality = 255;
//        $RFC_Location_012_014::RFC_Loc014_ElevationQuality = 255;
//        $RFC_Location_012_014::RFC_Loc014_ElevationVnce = 0.092;
//        $RFC_Location_012_014::RFC_Loc014_AzimuthQuality = 255;
//        $RFC_Location_012_014::RFC_Loc014_AzimuthVnce = 0.092;
//        $RFC_Location_012_014::RFC_Loc014_RadialVelocityVnce = 0.0032;
//        $RFC_Location_012_014::RFC_Loc014_AzimuthalPartnerId = 1023;
        
//        /**
//          * Variable values
//          */
//        $RFC_Location_012_014::RFC_Loc014_RadialDistance = dllGetRadarFCLocRadialDistance(@hil_ctrl::Handle_RoadObj, object_id);
//        $RFC_Location_012_014::RFC_Loc014_RadialVelocity = dllGetRadarFCLocRadialVelocity(@hil_ctrl::Handle_RoadObj, object_id);
//        $RFC_Location_012_014::RFC_Loc014_Elevation = dllGetRadarFCLocElevationAngle(@hil_ctrl::Handle_RoadObj, object_id);
//        $RFC_Location_012_014::RFC_Loc014_Azimuth = dllGetRadarFCLocAzimuthAngle(@hil_ctrl::Handle_RoadObj, object_id) * 180 / PI;
//        $RFC_Location_012_014::RFC_Loc014_RadarCrossSection = dllGetRadarFCLocRCS(@hil_ctrl::Handle_RoadObj, object_id);
//        $RFC_Location_012_014::RFC_Loc014_RSSI = dllGetRadarFCLocRSSI(@hil_ctrl::Handle_RoadObj, object_id);
//        break;
        
//      case 15: //"Object-15"
//        /**
//          * Constant values
//          */
//        $RFC_Location_015_017::RFC_Loc015_RadialDistanceVnce = 0.017;
//        $RFC_Location_015_017::RFC_Loc015_DistVelocityCoVnce = 0.0076;
//        $RFC_Location_015_017::RFC_Loc015_DistVelocityQuality = 255;
//        $RFC_Location_015_017::RFC_Loc015_ElevationQuality = 255;
//        $RFC_Location_015_017::RFC_Loc015_ElevationVnce = 0.092;
//        $RFC_Location_015_017::RFC_Loc015_AzimuthQuality = 255;
//        $RFC_Location_015_017::RFC_Loc015_AzimuthVnce = 0.092;
//        $RFC_Location_015_017::RFC_Loc015_RadialVelocityVnce = 0.0032;
//        $RFC_Location_015_017::RFC_Loc015_AzimuthalPartnerId = 1023;
        
//        /**
//          * Variable values
//          */
//        $RFC_Location_015_017::RFC_Loc015_RadialDistance = dllGetRadarFCLocRadialDistance(@hil_ctrl::Handle_RoadObj, object_id);
//        $RFC_Location_015_017::RFC_Loc015_RadialVelocity = dllGetRadarFCLocRadialVelocity(@hil_ctrl::Handle_RoadObj, object_id);
//        $RFC_Location_015_017::RFC_Loc015_Elevation = dllGetRadarFCLocElevationAngle(@hil_ctrl::Handle_RoadObj, object_id);
//        $RFC_Location_015_017::RFC_Loc015_Azimuth = dllGetRadarFCLocAzimuthAngle(@hil_ctrl::Handle_RoadObj, object_id) * 180 / PI;
//        $RFC_Location_015_017::RFC_Loc015_RadarCrossSection = dllGetRadarFCLocRCS(@hil_ctrl::Handle_RoadObj, object_id);
//        $RFC_Location_015_017::RFC_Loc015_RSSI = dllGetRadarFCLocRSSI(@hil_ctrl::Handle_RoadObj, object_id);
//        break;
        
//      case 16: //"Object-16"
//        /**
//          * Constant values
//          */
//        $RFC_Location_015_017::RFC_Loc016_RadialDistanceVnce = 0.017;
//        $RFC_Location_015_017::RFC_Loc016_DistVelocityCoVnce = 0.0076;
//        $RFC_Location_015_017::RFC_Loc016_DistVelocityQuality = 255;
//        $RFC_Location_015_017::RFC_Loc016_ElevationQuality = 255;
//        $RFC_Location_015_017::RFC_Loc016_ElevationVnce = 0.092;
//        $RFC_Location_015_017::RFC_Loc016_AzimuthQuality = 255;
//        $RFC_Location_015_017::RFC_Loc016_AzimuthVnce = 0.092;
//        $RFC_Location_015_017::RFC_Loc016_RadialVelocityVnce = 0.0032;
//        $RFC_Location_015_017::RFC_Loc016_AzimuthalPartnerId = 1023;
        
//        /**
//          * Variable values
//          */
//        $RFC_Location_015_017::RFC_Loc016_RadialDistance = dllGetRadarFCLocRadialDistance(@hil_ctrl::Handle_RoadObj, object_id);
//        $RFC_Location_015_017::RFC_Loc016_RadialVelocity = dllGetRadarFCLocRadialVelocity(@hil_ctrl::Handle_RoadObj, object_id);
//        $RFC_Location_015_017::RFC_Loc016_Elevation = dllGetRadarFCLocElevationAngle(@hil_ctrl::Handle_RoadObj, object_id);
//        $RFC_Location_015_017::RFC_Loc016_Azimuth = dllGetRadarFCLocAzimuthAngle(@hil_ctrl::Handle_RoadObj, object_id) * 180 / PI;
//        $RFC_Location_015_017::RFC_Loc016_RadarCrossSection = dllGetRadarFCLocRCS(@hil_ctrl::Handle_RoadObj, object_id);
//        $RFC_Location_015_017::RFC_Loc016_RSSI = dllGetRadarFCLocRSSI(@hil_ctrl::Handle_RoadObj, object_id);
//        break;
        
//      case 17: //"Object-17"
//        /**
//          * Constant values
//          */
//        $RFC_Location_015_017::RFC_Loc017_RadialDistanceVnce = 0.017;
//        $RFC_Location_015_017::RFC_Loc017_DistVelocityCoVnce = 0.0076;
//        $RFC_Location_015_017::RFC_Loc017_DistVelocityQuality = 255;
//        $RFC_Location_015_017::RFC_Loc017_ElevationQuality = 255;
//        $RFC_Location_015_017::RFC_Loc017_ElevationVnce = 0.092;
//        $RFC_Location_015_017::RFC_Loc017_AzimuthQuality = 255;
//        $RFC_Location_015_017::RFC_Loc017_AzimuthVnce = 0.092;
//        $RFC_Location_015_017::RFC_Loc017_RadialVelocityVnce = 0.0032;
//        $RFC_Location_015_017::RFC_Loc017_AzimuthalPartnerId = 1023;
        
//        /**
//          * Variable values
//          */
//        $RFC_Location_015_017::RFC_Loc017_RadialDistance = dllGetRadarFCLocRadialDistance(@hil_ctrl::Handle_RoadObj, object_id);
//        $RFC_Location_015_017::RFC_Loc017_RadialVelocity = dllGetRadarFCLocRadialVelocity(@hil_ctrl::Handle_RoadObj, object_id);
//        $RFC_Location_015_017::RFC_Loc017_Elevation = dllGetRadarFCLocElevationAngle(@hil_ctrl::Handle_RoadObj, object_id);
//        $RFC_Location_015_017::RFC_Loc017_Azimuth = dllGetRadarFCLocAzimuthAngle(@hil_ctrl::Handle_RoadObj, object_id) * 180 / PI;
//        $RFC_Location_015_017::RFC_Loc017_RadarCrossSection = dllGetRadarFCLocRCS(@hil_ctrl::Handle_RoadObj, object_id);
//        $RFC_Location_015_017::RFC_Loc017_RSSI = dllGetRadarFCLocRSSI(@hil_ctrl::Handle_RoadObj, object_id);
//        break;
        
//      case 18: //"Object-18"
//        /**
//          * Constant values
//          */
//        $RFC_Location_018_020::RFC_Loc018_RadialDistanceVnce = 0.017;
//        $RFC_Location_018_020::RFC_Loc018_DistVelocityCoVnce = 0.0076;
//        $RFC_Location_018_020::RFC_Loc018_DistVelocityQuality = 255;
//        $RFC_Location_018_020::RFC_Loc018_ElevationQuality = 255;
//        $RFC_Location_018_020::RFC_Loc018_ElevationVnce = 0.092;
//        $RFC_Location_018_020::RFC_Loc018_AzimuthQuality = 255;
//        $RFC_Location_018_020::RFC_Loc018_AzimuthVnce = 0.092;
//        $RFC_Location_018_020::RFC_Loc018_RadialVelocityVnce = 0.0032;
//        $RFC_Location_018_020::RFC_Loc018_AzimuthalPartnerId = 1023;
        
//        /**
//          * Variable values
//          */
//        $RFC_Location_018_020::RFC_Loc018_RadialDistance = dllGetRadarFCLocRadialDistance(@hil_ctrl::Handle_RoadObj, object_id);
//        $RFC_Location_018_020::RFC_Loc018_RadialVelocity = dllGetRadarFCLocRadialVelocity(@hil_ctrl::Handle_RoadObj, object_id);
//        $RFC_Location_018_020::RFC_Loc018_Elevation = dllGetRadarFCLocElevationAngle(@hil_ctrl::Handle_RoadObj, object_id);
//        $RFC_Location_018_020::RFC_Loc018_Azimuth = dllGetRadarFCLocAzimuthAngle(@hil_ctrl::Handle_RoadObj, object_id) * 180 / PI;
//        $RFC_Location_018_020::RFC_Loc018_RadarCrossSection = dllGetRadarFCLocRCS(@hil_ctrl::Handle_RoadObj, object_id);
//        $RFC_Location_018_020::RFC_Loc018_RSSI = dllGetRadarFCLocRSSI(@hil_ctrl::Handle_RoadObj, object_id);
//        break;
        
//      case 19: //"Object-19"
//        /**
//          * Constant values
//          */
//        $RFC_Location_018_020::RFC_Loc019_RadialDistanceVnce = 0.017;
//        $RFC_Location_018_020::RFC_Loc019_DistVelocityCoVnce = 0.0076;
//        $RFC_Location_018_020::RFC_Loc019_DistVelocityQuality = 255;
//        $RFC_Location_018_020::RFC_Loc019_ElevationQuality = 255;
//        $RFC_Location_018_020::RFC_Loc019_ElevationVnce = 0.092;
//        $RFC_Location_018_020::RFC_Loc019_AzimuthQuality = 255;
//        $RFC_Location_018_020::RFC_Loc019_AzimuthVnce = 0.092;
//        $RFC_Location_018_020::RFC_Loc019_RadialVelocityVnce = 0.0032;
//        $RFC_Location_018_020::RFC_Loc019_AzimuthalPartnerId = 1023;
        
//        /**
//          * Variable values
//          */
//        $RFC_Location_018_020::RFC_Loc019_RadialDistance = dllGetRadarFCLocRadialDistance(@hil_ctrl::Handle_RoadObj, object_id);
//        $RFC_Location_018_020::RFC_Loc019_RadialVelocity = dllGetRadarFCLocRadialVelocity(@hil_ctrl::Handle_RoadObj, object_id);
//        $RFC_Location_018_020::RFC_Loc019_Elevation = dllGetRadarFCLocElevationAngle(@hil_ctrl::Handle_RoadObj, object_id);
//        $RFC_Location_018_020::RFC_Loc019_Azimuth = dllGetRadarFCLocAzimuthAngle(@hil_ctrl::Handle_RoadObj, object_id) * 180 / PI;
//        $RFC_Location_018_020::RFC_Loc019_RadarCrossSection = dllGetRadarFCLocRCS(@hil_ctrl::Handle_RoadObj, object_id);
//        $RFC_Location_018_020::RFC_Loc019_RSSI = dllGetRadarFCLocRSSI(@hil_ctrl::Handle_RoadObj, object_id);
//        break;
        
//      case 20: //"Object-20"
//        /**
//          * Constant values
//          */
//        $RFC_Location_018_020::RFC_Loc020_RadialDistanceVnce = 0.017;
//        $RFC_Location_018_020::RFC_Loc020_DistVelocityCoVnce = 0.0076;
//        $RFC_Location_018_020::RFC_Loc020_DistVelocityQuality = 255;
//        $RFC_Location_018_020::RFC_Loc020_ElevationQuality = 255;
//        $RFC_Location_018_020::RFC_Loc020_ElevationVnce = 0.092;
//        $RFC_Location_018_020::RFC_Loc020_AzimuthQuality = 255;
//        $RFC_Location_018_020::RFC_Loc020_AzimuthVnce = 0.092;
//        $RFC_Location_018_020::RFC_Loc020_RadialVelocityVnce = 0.0032;
//        $RFC_Location_018_020::RFC_Loc020_AzimuthalPartnerId = 1023;
        
//        /**
//          * Variable values
//          */
//        $RFC_Location_018_020::RFC_Loc020_RadialDistance = dllGetRadarFCLocRadialDistance(@hil_ctrl::Handle_RoadObj, object_id);
//        $RFC_Location_018_020::RFC_Loc020_RadialVelocity = dllGetRadarFCLocRadialVelocity(@hil_ctrl::Handle_RoadObj, object_id);
//        $RFC_Location_018_020::RFC_Loc020_Elevation = dllGetRadarFCLocElevationAngle(@hil_ctrl::Handle_RoadObj, object_id);
//        $RFC_Location_018_020::RFC_Loc020_Azimuth = dllGetRadarFCLocAzimuthAngle(@hil_ctrl::Handle_RoadObj, object_id) * 180 / PI;
//        $RFC_Location_018_020::RFC_Loc020_RadarCrossSection = dllGetRadarFCLocRCS(@hil_ctrl::Handle_RoadObj, object_id);
//        $RFC_Location_018_020::RFC_Loc020_RSSI = dllGetRadarFCLocRSSI(@hil_ctrl::Handle_RoadObj, object_id);
//        break;
        
//      case 21: //"Object-21"
//        /**
//          * Constant values
//          */
//        $RFC_Location_021_023::RFC_Loc021_RadialDistanceVnce = 0.017;
//        $RFC_Location_021_023::RFC_Loc021_DistVelocityCoVnce = 0.0076;
//        $RFC_Location_021_023::RFC_Loc021_DistVelocityQuality = 255;
//        $RFC_Location_021_023::RFC_Loc021_ElevationQuality = 255;
//        $RFC_Location_021_023::RFC_Loc021_ElevationVnce = 0.092;
//        $RFC_Location_021_023::RFC_Loc021_AzimuthQuality = 255;
//        $RFC_Location_021_023::RFC_Loc021_AzimuthVnce = 0.092;
//        $RFC_Location_021_023::RFC_Loc021_RadialVelocityVnce = 0.0032;
//        $RFC_Location_021_023::RFC_Loc021_AzimuthalPartnerId = 1023;
        
//        /**
//          * Variable values
//          */
//        $RFC_Location_021_023::RFC_Loc021_RadialDistance = dllGetRadarFCLocRadialDistance(@hil_ctrl::Handle_RoadObj, object_id);
//        $RFC_Location_021_023::RFC_Loc021_RadialVelocity = dllGetRadarFCLocRadialVelocity(@hil_ctrl::Handle_RoadObj, object_id);
//        $RFC_Location_021_023::RFC_Loc021_Elevation = dllGetRadarFCLocElevationAngle(@hil_ctrl::Handle_RoadObj, object_id);
//        $RFC_Location_021_023::RFC_Loc021_Azimuth = dllGetRadarFCLocAzimuthAngle(@hil_ctrl::Handle_RoadObj, object_id) * 180 / PI;
//        $RFC_Location_021_023::RFC_Loc021_RadarCrossSection = dllGetRadarFCLocRCS(@hil_ctrl::Handle_RoadObj, object_id);
//        $RFC_Location_021_023::RFC_Loc021_RSSI = dllGetRadarFCLocRSSI(@hil_ctrl::Handle_RoadObj, object_id);
//        break;
        
//      case 22: //"Object-22"
//        /**
//          * Constant values
//          */
//        $RFC_Location_021_023::RFC_Loc022_RadialDistanceVnce = 0.017;
//        $RFC_Location_021_023::RFC_Loc022_DistVelocityCoVnce = 0.0076;
//        $RFC_Location_021_023::RFC_Loc022_DistVelocityQuality = 255;
//        $RFC_Location_021_023::RFC_Loc022_ElevationQuality = 255;
//        $RFC_Location_021_023::RFC_Loc022_ElevationVnce = 0.092;
//        $RFC_Location_021_023::RFC_Loc022_AzimuthQuality = 255;
//        $RFC_Location_021_023::RFC_Loc022_AzimuthVnce = 0.092;
//        $RFC_Location_021_023::RFC_Loc022_RadialVelocityVnce = 0.0032;
//        $RFC_Location_021_023::RFC_Loc022_AzimuthalPartnerId = 1023;
        
//        /**
//          * Variable values
//          */
//        $RFC_Location_021_023::RFC_Loc022_RadialDistance = dllGetRadarFCLocRadialDistance(@hil_ctrl::Handle_RoadObj, object_id);
//        $RFC_Location_021_023::RFC_Loc022_RadialVelocity = dllGetRadarFCLocRadialVelocity(@hil_ctrl::Handle_RoadObj, object_id);
//        $RFC_Location_021_023::RFC_Loc022_Elevation = dllGetRadarFCLocElevationAngle(@hil_ctrl::Handle_RoadObj, object_id);
//        $RFC_Location_021_023::RFC_Loc022_Azimuth = dllGetRadarFCLocAzimuthAngle(@hil_ctrl::Handle_RoadObj, object_id) * 180 / PI;
//        $RFC_Location_021_023::RFC_Loc022_RadarCrossSection = dllGetRadarFCLocRCS(@hil_ctrl::Handle_RoadObj, object_id);
//        $RFC_Location_021_023::RFC_Loc022_RSSI = dllGetRadarFCLocRSSI(@hil_ctrl::Handle_RoadObj, object_id);
//        break;
        
//      case 23: //"Object-23"
//        /**
//          * Constant values
//          */
//        $RFC_Location_021_023::RFC_Loc023_RadialDistanceVnce = 0.017;
//        $RFC_Location_021_023::RFC_Loc023_DistVelocityCoVnce = 0.0076;
//        $RFC_Location_021_023::RFC_Loc023_DistVelocityQuality = 255;
//        $RFC_Location_021_023::RFC_Loc023_ElevationQuality = 255;
//        $RFC_Location_021_023::RFC_Loc023_ElevationVnce = 0.092;
//        $RFC_Location_021_023::RFC_Loc023_AzimuthQuality = 255;
//        $RFC_Location_021_023::RFC_Loc023_AzimuthVnce = 0.092;
//        $RFC_Location_021_023::RFC_Loc023_RadialVelocityVnce = 0.0032;
//        $RFC_Location_021_023::RFC_Loc023_AzimuthalPartnerId = 1023;
        
//        /**
//          * Variable values
//          */
//        $RFC_Location_021_023::RFC_Loc023_RadialDistance = dllGetRadarFCLocRadialDistance(@hil_ctrl::Handle_RoadObj, object_id);
//        $RFC_Location_021_023::RFC_Loc023_RadialVelocity = dllGetRadarFCLocRadialVelocity(@hil_ctrl::Handle_RoadObj, object_id);
//        $RFC_Location_021_023::RFC_Loc023_Elevation = dllGetRadarFCLocElevationAngle(@hil_ctrl::Handle_RoadObj, object_id);
//        $RFC_Location_021_023::RFC_Loc023_Azimuth = dllGetRadarFCLocAzimuthAngle(@hil_ctrl::Handle_RoadObj, object_id) * 180 / PI;
//        $RFC_Location_021_023::RFC_Loc023_RadarCrossSection = dllGetRadarFCLocRCS(@hil_ctrl::Handle_RoadObj, object_id);
//        $RFC_Location_021_023::RFC_Loc023_RSSI = dllGetRadarFCLocRSSI(@hil_ctrl::Handle_RoadObj, object_id);
//        break;
        
//      case 24: //"Object-24"
//        /**
//          * Constant values
//          */
//        $RFC_Location_024_026::RFC_Loc024_RadialDistanceVnce = 0.017;
//        $RFC_Location_024_026::RFC_Loc024_DistVelocityCoVnce = 0.0076;
//        $RFC_Location_024_026::RFC_Loc024_DistVelocityQuality = 255;
//        $RFC_Location_024_026::RFC_Loc024_ElevationQuality = 255;
//        $RFC_Location_024_026::RFC_Loc024_ElevationVnce = 0.092;
//        $RFC_Location_024_026::RFC_Loc024_AzimuthQuality = 255;
//        $RFC_Location_024_026::RFC_Loc024_AzimuthVnce = 0.092;
//        $RFC_Location_024_026::RFC_Loc024_RadialVelocityVnce = 0.0032;
//        $RFC_Location_024_026::RFC_Loc024_AzimuthalPartnerId = 1023;
        
//        /**
//          * Variable values
//          */
//        $RFC_Location_024_026::RFC_Loc024_RadialDistance = dllGetRadarFCLocRadialDistance(@hil_ctrl::Handle_RoadObj, object_id);
//        $RFC_Location_024_026::RFC_Loc024_RadialVelocity = dllGetRadarFCLocRadialVelocity(@hil_ctrl::Handle_RoadObj, object_id);
//        $RFC_Location_024_026::RFC_Loc024_Elevation = dllGetRadarFCLocElevationAngle(@hil_ctrl::Handle_RoadObj, object_id);
//        $RFC_Location_024_026::RFC_Loc024_Azimuth = dllGetRadarFCLocAzimuthAngle(@hil_ctrl::Handle_RoadObj, object_id) * 180 / PI;
//        $RFC_Location_024_026::RFC_Loc024_RadarCrossSection = dllGetRadarFCLocRCS(@hil_ctrl::Handle_RoadObj, object_id);
//        $RFC_Location_024_026::RFC_Loc024_RSSI = dllGetRadarFCLocRSSI(@hil_ctrl::Handle_RoadObj, object_id);
//        break;
        
//      case 25: //"Object-25"
//        /**
//          * Constant values
//          */
//        $RFC_Location_024_026::RFC_Loc025_RadialDistanceVnce = 0.017;
//        $RFC_Location_024_026::RFC_Loc025_DistVelocityCoVnce = 0.0076;
//        $RFC_Location_024_026::RFC_Loc025_DistVelocityQuality = 255;
//        $RFC_Location_024_026::RFC_Loc025_ElevationQuality = 255;
//        $RFC_Location_024_026::RFC_Loc025_ElevationVnce = 0.092;
//        $RFC_Location_024_026::RFC_Loc025_AzimuthQuality = 255;
//        $RFC_Location_024_026::RFC_Loc025_AzimuthVnce = 0.092;
//        $RFC_Location_024_026::RFC_Loc025_RadialVelocityVnce = 0.0032;
//        $RFC_Location_024_026::RFC_Loc025_AzimuthalPartnerId = 1023;
        
//        /**
//          * Variable values
//          */
//        $RFC_Location_024_026::RFC_Loc025_RadialDistance = dllGetRadarFCLocRadialDistance(@hil_ctrl::Handle_RoadObj, object_id);
//        $RFC_Location_024_026::RFC_Loc025_RadialVelocity = dllGetRadarFCLocRadialVelocity(@hil_ctrl::Handle_RoadObj, object_id);
//        $RFC_Location_024_026::RFC_Loc025_Elevation = dllGetRadarFCLocElevationAngle(@hil_ctrl::Handle_RoadObj, object_id);
//        $RFC_Location_024_026::RFC_Loc025_Azimuth = dllGetRadarFCLocAzimuthAngle(@hil_ctrl::Handle_RoadObj, object_id) * 180 / PI;
//        $RFC_Location_024_026::RFC_Loc025_RadarCrossSection = dllGetRadarFCLocRCS(@hil_ctrl::Handle_RoadObj, object_id);
//        $RFC_Location_024_026::RFC_Loc025_RSSI = dllGetRadarFCLocRSSI(@hil_ctrl::Handle_RoadObj, object_id);
//        break;
        
//      case 26: //"Object-26"
//        /**
//          * Constant values
//          */
//        $RFC_Location_024_026::RFC_Loc026_RadialDistanceVnce = 0.017;
//        $RFC_Location_024_026::RFC_Loc026_DistVelocityCoVnce = 0.0076;
//        $RFC_Location_024_026::RFC_Loc026_DistVelocityQuality = 255;
//        $RFC_Location_024_026::RFC_Loc026_ElevationQuality = 255;
//        $RFC_Location_024_026::RFC_Loc026_ElevationVnce = 0.092;
//        $RFC_Location_024_026::RFC_Loc026_AzimuthQuality = 255;
//        $RFC_Location_024_026::RFC_Loc026_AzimuthVnce = 0.092;
//        $RFC_Location_024_026::RFC_Loc026_RadialVelocityVnce = 0.0032;
//        $RFC_Location_024_026::RFC_Loc026_AzimuthalPartnerId = 1023;
        
//        /**
//          * Variable values
//          */
//        $RFC_Location_024_026::RFC_Loc026_RadialDistance = dllGetRadarFCLocRadialDistance(@hil_ctrl::Handle_RoadObj, object_id);
//        $RFC_Location_024_026::RFC_Loc026_RadialVelocity = dllGetRadarFCLocRadialVelocity(@hil_ctrl::Handle_RoadObj, object_id);
//        $RFC_Location_024_026::RFC_Loc026_Elevation = dllGetRadarFCLocElevationAngle(@hil_ctrl::Handle_RoadObj, object_id);
//        $RFC_Location_024_026::RFC_Loc026_Azimuth = dllGetRadarFCLocAzimuthAngle(@hil_ctrl::Handle_RoadObj, object_id) * 180 / PI;
//        $RFC_Location_024_026::RFC_Loc026_RadarCrossSection = dllGetRadarFCLocRCS(@hil_ctrl::Handle_RoadObj, object_id);
//        $RFC_Location_024_026::RFC_Loc026_RSSI = dllGetRadarFCLocRSSI(@hil_ctrl::Handle_RoadObj, object_id);
//        break;
        
//      case 27: //"Object-27"
//        /**
//          * Constant values
//          */
//        $RFC_Location_027_029::RFC_Loc027_RadialDistanceVnce = 0.017;
//        $RFC_Location_027_029::RFC_Loc027_DistVelocityCoVnce = 0.0076;
//        $RFC_Location_027_029::RFC_Loc027_DistVelocityQuality = 255;
//        $RFC_Location_027_029::RFC_Loc027_ElevationQuality = 255;
//        $RFC_Location_027_029::RFC_Loc027_ElevationVnce = 0.092;
//        $RFC_Location_027_029::RFC_Loc027_AzimuthQuality = 255;
//        $RFC_Location_027_029::RFC_Loc027_AzimuthVnce = 0.092;
//        $RFC_Location_027_029::RFC_Loc027_RadialVelocityVnce = 0.0032;
//        $RFC_Location_027_029::RFC_Loc027_AzimuthalPartnerId = 1023;
        
//        /**
//          * Variable values
//          */
//        $RFC_Location_027_029::RFC_Loc027_RadialDistance = dllGetRadarFCLocRadialDistance(@hil_ctrl::Handle_RoadObj, object_id);
//        $RFC_Location_027_029::RFC_Loc027_RadialVelocity = dllGetRadarFCLocRadialVelocity(@hil_ctrl::Handle_RoadObj, object_id);
//        $RFC_Location_027_029::RFC_Loc027_Elevation = dllGetRadarFCLocElevationAngle(@hil_ctrl::Handle_RoadObj, object_id);
//        $RFC_Location_027_029::RFC_Loc027_Azimuth = dllGetRadarFCLocAzimuthAngle(@hil_ctrl::Handle_RoadObj, object_id) * 180 / PI;
//        $RFC_Location_027_029::RFC_Loc027_RadarCrossSection = dllGetRadarFCLocRCS(@hil_ctrl::Handle_RoadObj, object_id);
//        $RFC_Location_027_029::RFC_Loc027_RSSI = dllGetRadarFCLocRSSI(@hil_ctrl::Handle_RoadObj, object_id);
//        break;
        
//      case 28: //"Object-28"
//        /**
//          * Constant values
//          */
//        $RFC_Location_027_029::RFC_Loc028_RadialDistanceVnce = 0.017;
//        $RFC_Location_027_029::RFC_Loc028_DistVelocityCoVnce = 0.0076;
//        $RFC_Location_027_029::RFC_Loc028_DistVelocityQuality = 255;
//        $RFC_Location_027_029::RFC_Loc028_ElevationQuality = 255;
//        $RFC_Location_027_029::RFC_Loc028_ElevationVnce = 0.092;
//        $RFC_Location_027_029::RFC_Loc028_AzimuthQuality = 255;
//        $RFC_Location_027_029::RFC_Loc028_AzimuthVnce = 0.092;
//        $RFC_Location_027_029::RFC_Loc028_RadialVelocityVnce = 0.0032;
//        $RFC_Location_027_029::RFC_Loc028_AzimuthalPartnerId = 1023;
        
//        /**
//          * Variable values
//          */
//        $RFC_Location_027_029::RFC_Loc028_RadialDistance = dllGetRadarFCLocRadialDistance(@hil_ctrl::Handle_RoadObj, object_id);
//        $RFC_Location_027_029::RFC_Loc028_RadialVelocity = dllGetRadarFCLocRadialVelocity(@hil_ctrl::Handle_RoadObj, object_id);
//        $RFC_Location_027_029::RFC_Loc028_Elevation = dllGetRadarFCLocElevationAngle(@hil_ctrl::Handle_RoadObj, object_id);
//        $RFC_Location_027_029::RFC_Loc028_Azimuth = dllGetRadarFCLocAzimuthAngle(@hil_ctrl::Handle_RoadObj, object_id) * 180 / PI;
//        $RFC_Location_027_029::RFC_Loc028_RadarCrossSection = dllGetRadarFCLocRCS(@hil_ctrl::Handle_RoadObj, object_id);
//        $RFC_Location_027_029::RFC_Loc028_RSSI = dllGetRadarFCLocRSSI(@hil_ctrl::Handle_RoadObj, object_id);
//        break;
        
//      case 29: //"Object-29"
//        /**
//          * Constant values
//          */
//        $RFC_Location_027_029::RFC_Loc029_RadialDistanceVnce = 0.017;
//        $RFC_Location_027_029::RFC_Loc029_DistVelocityCoVnce = 0.0076;
//        $RFC_Location_027_029::RFC_Loc029_DistVelocityQuality = 255;
//        $RFC_Location_027_029::RFC_Loc029_ElevationQuality = 255;
//        $RFC_Location_027_029::RFC_Loc029_ElevationVnce = 0.092;
//        $RFC_Location_027_029::RFC_Loc029_AzimuthQuality = 255;
//        $RFC_Location_027_029::RFC_Loc029_AzimuthVnce = 0.092;
//        $RFC_Location_027_029::RFC_Loc029_RadialVelocityVnce = 0.0032;
//        $RFC_Location_027_029::RFC_Loc029_AzimuthalPartnerId = 1023;
        
//        /**
//          * Variable values
//          */
//        $RFC_Location_027_029::RFC_Loc029_RadialDistance = dllGetRadarFCLocRadialDistance(@hil_ctrl::Handle_RoadObj, object_id);
//        $RFC_Location_027_029::RFC_Loc029_RadialVelocity = dllGetRadarFCLocRadialVelocity(@hil_ctrl::Handle_RoadObj, object_id);
//        $RFC_Location_027_029::RFC_Loc029_Elevation = dllGetRadarFCLocElevationAngle(@hil_ctrl::Handle_RoadObj, object_id);
//        $RFC_Location_027_029::RFC_Loc029_Azimuth = dllGetRadarFCLocAzimuthAngle(@hil_ctrl::Handle_RoadObj, object_id) * 180 / PI;
//        $RFC_Location_027_029::RFC_Loc029_RadarCrossSection = dllGetRadarFCLocRCS(@hil_ctrl::Handle_RoadObj, object_id);
//        $RFC_Location_027_029::RFC_Loc029_RSSI = dllGetRadarFCLocRSSI(@hil_ctrl::Handle_RoadObj, object_id);
//        break;
        
//      case 30: //"Object-30"
//        /**
//          * Constant values
//          */
//        $RFC_Location_030_032::RFC_Loc030_RadialDistanceVnce = 0.017;
//        $RFC_Location_030_032::RFC_Loc030_DistVelocityCoVnce = 0.0076;
//        $RFC_Location_030_032::RFC_Loc030_DistVelocityQuality = 255;
//        $RFC_Location_030_032::RFC_Loc030_ElevationQuality = 255;
//        $RFC_Location_030_032::RFC_Loc030_ElevationVnce = 0.092;
//        $RFC_Location_030_032::RFC_Loc030_AzimuthQuality = 255;
//        $RFC_Location_030_032::RFC_Loc030_AzimuthVnce = 0.092;
//        $RFC_Location_030_032::RFC_Loc030_RadialVelocityVnce = 0.0032;
//        $RFC_Location_030_032::RFC_Loc030_AzimuthalPartnerId = 1023;
        
//        /**
//          * Variable values
//          */
//        $RFC_Location_030_032::RFC_Loc030_RadialDistance = dllGetRadarFCLocRadialDistance(@hil_ctrl::Handle_RoadObj, object_id);
//        $RFC_Location_030_032::RFC_Loc030_RadialVelocity = dllGetRadarFCLocRadialVelocity(@hil_ctrl::Handle_RoadObj, object_id);
//        $RFC_Location_030_032::RFC_Loc030_Elevation = dllGetRadarFCLocElevationAngle(@hil_ctrl::Handle_RoadObj, object_id);
//        $RFC_Location_030_032::RFC_Loc030_Azimuth = dllGetRadarFCLocAzimuthAngle(@hil_ctrl::Handle_RoadObj, object_id) * 180 / PI;
//        $RFC_Location_030_032::RFC_Loc030_RadarCrossSection = dllGetRadarFCLocRCS(@hil_ctrl::Handle_RoadObj, object_id);
//        $RFC_Location_030_032::RFC_Loc030_RSSI = dllGetRadarFCLocRSSI(@hil_ctrl::Handle_RoadObj, object_id);
//        break;
        
//      case 31: //"Object-31"
//        /**
//          * Constant values
//          */
//        $RFC_Location_030_032::RFC_Loc031_RadialDistanceVnce = 0.017;
//        $RFC_Location_030_032::RFC_Loc031_DistVelocityCoVnce = 0.0076;
//        $RFC_Location_030_032::RFC_Loc031_DistVelocityQuality = 255;
//        $RFC_Location_030_032::RFC_Loc031_ElevationQuality = 255;
//        $RFC_Location_030_032::RFC_Loc031_ElevationVnce = 0.092;
//        $RFC_Location_030_032::RFC_Loc031_AzimuthQuality = 255;
//        $RFC_Location_030_032::RFC_Loc031_AzimuthVnce = 0.092;
//        $RFC_Location_030_032::RFC_Loc031_RadialVelocityVnce = 0.0032;
//        $RFC_Location_030_032::RFC_Loc031_AzimuthalPartnerId = 1023;
        
//        /**
//          * Variable values
//          */
//        $RFC_Location_030_032::RFC_Loc031_RadialDistance = dllGetRadarFCLocRadialDistance(@hil_ctrl::Handle_RoadObj, object_id);
//        $RFC_Location_030_032::RFC_Loc031_RadialVelocity = dllGetRadarFCLocRadialVelocity(@hil_ctrl::Handle_RoadObj, object_id);
//        $RFC_Location_030_032::RFC_Loc031_Elevation = dllGetRadarFCLocElevationAngle(@hil_ctrl::Handle_RoadObj, object_id);
//        $RFC_Location_030_032::RFC_Loc031_Azimuth = dllGetRadarFCLocAzimuthAngle(@hil_ctrl::Handle_RoadObj, object_id) * 180 / PI;
//        $RFC_Location_030_032::RFC_Loc031_RadarCrossSection = dllGetRadarFCLocRCS(@hil_ctrl::Handle_RoadObj, object_id);
//        $RFC_Location_030_032::RFC_Loc031_RSSI = dllGetRadarFCLocRSSI(@hil_ctrl::Handle_RoadObj, object_id);
//        break;
        
//      case 32: //"Object-32"
//        /**
//          * Constant values
//          */
//        $RFC_Location_030_032::RFC_Loc032_RadialDistanceVnce = 0.017;
//        $RFC_Location_030_032::RFC_Loc032_DistVelocityCoVnce = 0.0076;
//        $RFC_Location_030_032::RFC_Loc032_DistVelocityQuality = 255;
//        $RFC_Location_030_032::RFC_Loc032_ElevationQuality = 255;
//        $RFC_Location_030_032::RFC_Loc032_ElevationVnce = 0.092;
//        $RFC_Location_030_032::RFC_Loc032_AzimuthQuality = 255;
//        $RFC_Location_030_032::RFC_Loc032_AzimuthVnce = 0.092;
//        $RFC_Location_030_032::RFC_Loc032_RadialVelocityVnce = 0.0032;
//        $RFC_Location_030_032::RFC_Loc032_AzimuthalPartnerId = 1023;
        
//        /**
//          * Variable values
//          */
//        $RFC_Location_030_032::RFC_Loc032_RadialDistance = dllGetRadarFCLocRadialDistance(@hil_ctrl::Handle_RoadObj, object_id);
//        $RFC_Location_030_032::RFC_Loc032_RadialVelocity = dllGetRadarFCLocRadialVelocity(@hil_ctrl::Handle_RoadObj, object_id);
//        $RFC_Location_030_032::RFC_Loc032_Elevation = dllGetRadarFCLocElevationAngle(@hil_ctrl::Handle_RoadObj, object_id);
//        $RFC_Location_030_032::RFC_Loc032_Azimuth = dllGetRadarFCLocAzimuthAngle(@hil_ctrl::Handle_RoadObj, object_id) * 180 / PI;
//        $RFC_Location_030_032::RFC_Loc032_RadarCrossSection = dllGetRadarFCLocRCS(@hil_ctrl::Handle_RoadObj, object_id);
//        $RFC_Location_030_032::RFC_Loc032_RSSI = dllGetRadarFCLocRSSI(@hil_ctrl::Handle_RoadObj, object_id);
//        break;
        
//      case 33: //"Object-33"
//        /**
//          * Constant values
//          */
//        $RFC_Location_033_035::RFC_Loc033_RadialDistanceVnce = 0.017;
//        $RFC_Location_033_035::RFC_Loc033_DistVelocityCoVnce = 0.0076;
//        $RFC_Location_033_035::RFC_Loc033_DistVelocityQuality = 255;
//        $RFC_Location_033_035::RFC_Loc033_ElevationQuality = 255;
//        $RFC_Location_033_035::RFC_Loc033_ElevationVnce = 0.092;
//        $RFC_Location_033_035::RFC_Loc033_AzimuthQuality = 255;
//        $RFC_Location_033_035::RFC_Loc033_AzimuthVnce = 0.092;
//        $RFC_Location_033_035::RFC_Loc033_RadialVelocityVnce = 0.0032;
//        $RFC_Location_033_035::RFC_Loc033_AzimuthalPartnerId = 1023;
        
//        /**
//          * Variable values
//          */
//        $RFC_Location_033_035::RFC_Loc033_RadialDistance = dllGetRadarFCLocRadialDistance(@hil_ctrl::Handle_RoadObj, object_id);
//        $RFC_Location_033_035::RFC_Loc033_RadialVelocity = dllGetRadarFCLocRadialVelocity(@hil_ctrl::Handle_RoadObj, object_id);
//        $RFC_Location_033_035::RFC_Loc033_Elevation = dllGetRadarFCLocElevationAngle(@hil_ctrl::Handle_RoadObj, object_id);
//        $RFC_Location_033_035::RFC_Loc033_Azimuth = dllGetRadarFCLocAzimuthAngle(@hil_ctrl::Handle_RoadObj, object_id) * 180 / PI;
//        $RFC_Location_033_035::RFC_Loc033_RadarCrossSection = dllGetRadarFCLocRCS(@hil_ctrl::Handle_RoadObj, object_id);
//        $RFC_Location_033_035::RFC_Loc033_RSSI = dllGetRadarFCLocRSSI(@hil_ctrl::Handle_RoadObj, object_id);
//        break;
        
//      case 34: //"Object-34"
//        /**
//          * Constant values
//          */
//        $RFC_Location_033_035::RFC_Loc034_RadialDistanceVnce = 0.017;
//        $RFC_Location_033_035::RFC_Loc034_DistVelocityCoVnce = 0.0076;
//        $RFC_Location_033_035::RFC_Loc034_DistVelocityQuality = 255;
//        $RFC_Location_033_035::RFC_Loc034_ElevationQuality = 255;
//        $RFC_Location_033_035::RFC_Loc034_ElevationVnce = 0.092;
//        $RFC_Location_033_035::RFC_Loc034_AzimuthQuality = 255;
//        $RFC_Location_033_035::RFC_Loc034_AzimuthVnce = 0.092;
//        $RFC_Location_033_035::RFC_Loc034_RadialVelocityVnce = 0.0032;
//        $RFC_Location_033_035::RFC_Loc034_AzimuthalPartnerId = 1023;
        
//        /**
//          * Variable values
//          */
//        $RFC_Location_033_035::RFC_Loc034_RadialDistance = dllGetRadarFCLocRadialDistance(@hil_ctrl::Handle_RoadObj, object_id);
//        $RFC_Location_033_035::RFC_Loc034_RadialVelocity = dllGetRadarFCLocRadialVelocity(@hil_ctrl::Handle_RoadObj, object_id);
//        $RFC_Location_033_035::RFC_Loc034_Elevation = dllGetRadarFCLocElevationAngle(@hil_ctrl::Handle_RoadObj, object_id);
//        $RFC_Location_033_035::RFC_Loc034_Azimuth = dllGetRadarFCLocAzimuthAngle(@hil_ctrl::Handle_RoadObj, object_id) * 180 / PI;
//        $RFC_Location_033_035::RFC_Loc034_RadarCrossSection = dllGetRadarFCLocRCS(@hil_ctrl::Handle_RoadObj, object_id);
//        $RFC_Location_033_035::RFC_Loc034_RSSI = dllGetRadarFCLocRSSI(@hil_ctrl::Handle_RoadObj, object_id);
//        break;
        
//      case 35: //"Object-35"
//        /**
//          * Constant values
//          */
//        $RFC_Location_033_035::RFC_Loc035_RadialDistanceVnce = 0.017;
//        $RFC_Location_033_035::RFC_Loc035_DistVelocityCoVnce = 0.0076;
//        $RFC_Location_033_035::RFC_Loc035_DistVelocityQuality = 255;
//        $RFC_Location_033_035::RFC_Loc035_ElevationQuality = 255;
//        $RFC_Location_033_035::RFC_Loc035_ElevationVnce = 0.092;
//        $RFC_Location_033_035::RFC_Loc035_AzimuthQuality = 255;
//        $RFC_Location_033_035::RFC_Loc035_AzimuthVnce = 0.092;
//        $RFC_Location_033_035::RFC_Loc035_RadialVelocityVnce = 0.0032;
//        $RFC_Location_033_035::RFC_Loc035_AzimuthalPartnerId = 1023;
        
//        /**
//          * Variable values
//          */
//        $RFC_Location_033_035::RFC_Loc035_RadialDistance = dllGetRadarFCLocRadialDistance(@hil_ctrl::Handle_RoadObj, object_id);
//        $RFC_Location_033_035::RFC_Loc035_RadialVelocity = dllGetRadarFCLocRadialVelocity(@hil_ctrl::Handle_RoadObj, object_id);
//        $RFC_Location_033_035::RFC_Loc035_Elevation = dllGetRadarFCLocElevationAngle(@hil_ctrl::Handle_RoadObj, object_id);
//        $RFC_Location_033_035::RFC_Loc035_Azimuth = dllGetRadarFCLocAzimuthAngle(@hil_ctrl::Handle_RoadObj, object_id) * 180 / PI;
//        $RFC_Location_033_035::RFC_Loc035_RadarCrossSection = dllGetRadarFCLocRCS(@hil_ctrl::Handle_RoadObj, object_id);
//        $RFC_Location_033_035::RFC_Loc035_RSSI = dllGetRadarFCLocRSSI(@hil_ctrl::Handle_RoadObj, object_id);
//        break;
        
//      case 36: //"Object-36"
//        /**
//          * Constant values
//          */
//        $RFC_Location_036_038::RFC_Loc036_RadialDistanceVnce = 0.017;
//        $RFC_Location_036_038::RFC_Loc036_DistVelocityCoVnce = 0.0076;
//        $RFC_Location_036_038::RFC_Loc036_DistVelocityQuality = 255;
//        $RFC_Location_036_038::RFC_Loc036_ElevationQuality = 255;
//        $RFC_Location_036_038::RFC_Loc036_ElevationVnce = 0.092;
//        $RFC_Location_036_038::RFC_Loc036_AzimuthQuality = 255;
//        $RFC_Location_036_038::RFC_Loc036_AzimuthVnce = 0.092;
//        $RFC_Location_036_038::RFC_Loc036_RadialVelocityVnce = 0.0032;
//        $RFC_Location_036_038::RFC_Loc036_AzimuthalPartnerId = 1023;
        
//        /**
//          * Variable values
//          */
//        $RFC_Location_036_038::RFC_Loc036_RadialDistance = dllGetRadarFCLocRadialDistance(@hil_ctrl::Handle_RoadObj, object_id);
//        $RFC_Location_036_038::RFC_Loc036_RadialVelocity = dllGetRadarFCLocRadialVelocity(@hil_ctrl::Handle_RoadObj, object_id);
//        $RFC_Location_036_038::RFC_Loc036_Elevation = dllGetRadarFCLocElevationAngle(@hil_ctrl::Handle_RoadObj, object_id);
//        $RFC_Location_036_038::RFC_Loc036_Azimuth = dllGetRadarFCLocAzimuthAngle(@hil_ctrl::Handle_RoadObj, object_id) * 180 / PI;
//        $RFC_Location_036_038::RFC_Loc036_RadarCrossSection = dllGetRadarFCLocRCS(@hil_ctrl::Handle_RoadObj, object_id);
//        $RFC_Location_036_038::RFC_Loc036_RSSI = dllGetRadarFCLocRSSI(@hil_ctrl::Handle_RoadObj, object_id);
//        break;
        
//      case 37: //"Object-37"
//        /**
//          * Constant values
//          */
//        $RFC_Location_036_038::RFC_Loc037_RadialDistanceVnce = 0.017;
//        $RFC_Location_036_038::RFC_Loc037_DistVelocityCoVnce = 0.0076;
//        $RFC_Location_036_038::RFC_Loc037_DistVelocityQuality = 255;
//        $RFC_Location_036_038::RFC_Loc037_ElevationQuality = 255;
//        $RFC_Location_036_038::RFC_Loc037_ElevationVnce = 0.092;
//        $RFC_Location_036_038::RFC_Loc037_AzimuthQuality = 255;
//        $RFC_Location_036_038::RFC_Loc037_AzimuthVnce = 0.092;
//        $RFC_Location_036_038::RFC_Loc037_RadialVelocityVnce = 0.0032;
//        $RFC_Location_036_038::RFC_Loc037_AzimuthalPartnerId = 1023;
        
//        /**
//          * Variable values
//          */
//        $RFC_Location_036_038::RFC_Loc037_RadialDistance = dllGetRadarFCLocRadialDistance(@hil_ctrl::Handle_RoadObj, object_id);
//        $RFC_Location_036_038::RFC_Loc037_RadialVelocity = dllGetRadarFCLocRadialVelocity(@hil_ctrl::Handle_RoadObj, object_id);
//        $RFC_Location_036_038::RFC_Loc037_Elevation = dllGetRadarFCLocElevationAngle(@hil_ctrl::Handle_RoadObj, object_id);
//        $RFC_Location_036_038::RFC_Loc037_Azimuth = dllGetRadarFCLocAzimuthAngle(@hil_ctrl::Handle_RoadObj, object_id) * 180 / PI;
//        $RFC_Location_036_038::RFC_Loc037_RadarCrossSection = dllGetRadarFCLocRCS(@hil_ctrl::Handle_RoadObj, object_id);
//        $RFC_Location_036_038::RFC_Loc037_RSSI = dllGetRadarFCLocRSSI(@hil_ctrl::Handle_RoadObj, object_id);
//        break;
        
//      case 38: //"Object-38"
//        /**
//          * Constant values
//          */
//        $RFC_Location_036_038::RFC_Loc038_RadialDistanceVnce = 0.017;
//        $RFC_Location_036_038::RFC_Loc038_DistVelocityCoVnce = 0.0076;
//        $RFC_Location_036_038::RFC_Loc038_DistVelocityQuality = 255;
//        $RFC_Location_036_038::RFC_Loc038_ElevationQuality = 255;
//        $RFC_Location_036_038::RFC_Loc038_ElevationVnce = 0.092;
//        $RFC_Location_036_038::RFC_Loc038_AzimuthQuality = 255;
//        $RFC_Location_036_038::RFC_Loc038_AzimuthVnce = 0.092;
//        $RFC_Location_036_038::RFC_Loc038_RadialVelocityVnce = 0.0032;
//        $RFC_Location_036_038::RFC_Loc038_AzimuthalPartnerId = 1023;
        
//        /**
//          * Variable values
//          */
//        $RFC_Location_036_038::RFC_Loc038_RadialDistance = dllGetRadarFCLocRadialDistance(@hil_ctrl::Handle_RoadObj, object_id);
//        $RFC_Location_036_038::RFC_Loc038_RadialVelocity = dllGetRadarFCLocRadialVelocity(@hil_ctrl::Handle_RoadObj, object_id);
//        $RFC_Location_036_038::RFC_Loc038_Elevation = dllGetRadarFCLocElevationAngle(@hil_ctrl::Handle_RoadObj, object_id);
//        $RFC_Location_036_038::RFC_Loc038_Azimuth = dllGetRadarFCLocAzimuthAngle(@hil_ctrl::Handle_RoadObj, object_id) * 180 / PI;
//        $RFC_Location_036_038::RFC_Loc038_RadarCrossSection = dllGetRadarFCLocRCS(@hil_ctrl::Handle_RoadObj, object_id);
//        $RFC_Location_036_038::RFC_Loc038_RSSI = dllGetRadarFCLocRSSI(@hil_ctrl::Handle_RoadObj, object_id);
//        break;
        
//      case 39: //"Object-39"
//        /**
//          * Constant values
//          */
//        $RFC_Location_039_041::RFC_Loc039_RadialDistanceVnce = 0.017;
//        $RFC_Location_039_041::RFC_Loc039_DistVelocityCoVnce = 0.0076;
//        $RFC_Location_039_041::RFC_Loc039_DistVelocityQuality = 255;
//        $RFC_Location_039_041::RFC_Loc039_ElevationQuality = 255;
//        $RFC_Location_039_041::RFC_Loc039_ElevationVnce = 0.092;
//        $RFC_Location_039_041::RFC_Loc039_AzimuthQuality = 255;
//        $RFC_Location_039_041::RFC_Loc039_AzimuthVnce = 0.092;
//        $RFC_Location_039_041::RFC_Loc039_RadialVelocityVnce = 0.0032;
//        $RFC_Location_039_041::RFC_Loc039_AzimuthalPartnerId = 1023;
        
//        /**
//          * Variable values
//          */
//        $RFC_Location_039_041::RFC_Loc039_RadialDistance = dllGetRadarFCLocRadialDistance(@hil_ctrl::Handle_RoadObj, object_id);
//        $RFC_Location_039_041::RFC_Loc039_RadialVelocity = dllGetRadarFCLocRadialVelocity(@hil_ctrl::Handle_RoadObj, object_id);
//        $RFC_Location_039_041::RFC_Loc039_Elevation = dllGetRadarFCLocElevationAngle(@hil_ctrl::Handle_RoadObj, object_id);
//        $RFC_Location_039_041::RFC_Loc039_Azimuth = dllGetRadarFCLocAzimuthAngle(@hil_ctrl::Handle_RoadObj, object_id) * 180 / PI;
//        $RFC_Location_039_041::RFC_Loc039_RadarCrossSection = dllGetRadarFCLocRCS(@hil_ctrl::Handle_RoadObj, object_id);
//        $RFC_Location_039_041::RFC_Loc039_RSSI = dllGetRadarFCLocRSSI(@hil_ctrl::Handle_RoadObj, object_id);
//        break;
        
//      case 40: //"Object-40"
//        /**
//          * Constant values
//          */
//        $RFC_Location_039_041::RFC_Loc040_RadialDistanceVnce = 0.017;
//        $RFC_Location_039_041::RFC_Loc040_DistVelocityCoVnce = 0.0076;
//        $RFC_Location_039_041::RFC_Loc040_DistVelocityQuality = 255;
//        $RFC_Location_039_041::RFC_Loc040_ElevationQuality = 255;
//        $RFC_Location_039_041::RFC_Loc040_ElevationVnce = 0.092;
//        $RFC_Location_039_041::RFC_Loc040_AzimuthQuality = 255;
//        $RFC_Location_039_041::RFC_Loc040_AzimuthVnce = 0.092;
//        $RFC_Location_039_041::RFC_Loc040_RadialVelocityVnce = 0.0032;
//        $RFC_Location_039_041::RFC_Loc040_AzimuthalPartnerId = 1023;
        
//        /**
//          * Variable values
//          */
//        $RFC_Location_039_041::RFC_Loc040_RadialDistance = dllGetRadarFCLocRadialDistance(@hil_ctrl::Handle_RoadObj, object_id);
//        $RFC_Location_039_041::RFC_Loc040_RadialVelocity = dllGetRadarFCLocRadialVelocity(@hil_ctrl::Handle_RoadObj, object_id);
//        $RFC_Location_039_041::RFC_Loc040_Elevation = dllGetRadarFCLocElevationAngle(@hil_ctrl::Handle_RoadObj, object_id);
//        $RFC_Location_039_041::RFC_Loc040_Azimuth = dllGetRadarFCLocAzimuthAngle(@hil_ctrl::Handle_RoadObj, object_id) * 180 / PI;
//        $RFC_Location_039_041::RFC_Loc040_RadarCrossSection = dllGetRadarFCLocRCS(@hil_ctrl::Handle_RoadObj, object_id);
//        $RFC_Location_039_041::RFC_Loc040_RSSI = dllGetRadarFCLocRSSI(@hil_ctrl::Handle_RoadObj, object_id);
//        break;
        
//      case 41: //"Object-41"
//        /**
//          * Constant values
//          */
//        $RFC_Location_039_041::RFC_Loc041_RadialDistanceVnce = 0.017;
//        $RFC_Location_039_041::RFC_Loc041_DistVelocityCoVnce = 0.0076;
//        $RFC_Location_039_041::RFC_Loc041_DistVelocityQuality = 255;
//        $RFC_Location_039_041::RFC_Loc041_ElevationQuality = 255;
//        $RFC_Location_039_041::RFC_Loc041_ElevationVnce = 0.092;
//        $RFC_Location_039_041::RFC_Loc041_AzimuthQuality = 255;
//        $RFC_Location_039_041::RFC_Loc041_AzimuthVnce = 0.092;
//        $RFC_Location_039_041::RFC_Loc041_RadialVelocityVnce = 0.0032;
//        $RFC_Location_039_041::RFC_Loc041_AzimuthalPartnerId = 1023;
        
//        /**
//          * Variable values
//          */
//        $RFC_Location_039_041::RFC_Loc041_RadialDistance = dllGetRadarFCLocRadialDistance(@hil_ctrl::Handle_RoadObj, object_id);
//        $RFC_Location_039_041::RFC_Loc041_RadialVelocity = dllGetRadarFCLocRadialVelocity(@hil_ctrl::Handle_RoadObj, object_id);
//        $RFC_Location_039_041::RFC_Loc041_Elevation = dllGetRadarFCLocElevationAngle(@hil_ctrl::Handle_RoadObj, object_id);
//        $RFC_Location_039_041::RFC_Loc041_Azimuth = dllGetRadarFCLocAzimuthAngle(@hil_ctrl::Handle_RoadObj, object_id) * 180 / PI;
//        $RFC_Location_039_041::RFC_Loc041_RadarCrossSection = dllGetRadarFCLocRCS(@hil_ctrl::Handle_RoadObj, object_id);
//        $RFC_Location_039_041::RFC_Loc041_RSSI = dllGetRadarFCLocRSSI(@hil_ctrl::Handle_RoadObj, object_id);
//        break;
        
//      case 42: //"Object-42"
//        /**
//          * Constant values
//          */
//        $RFC_Location_042_044::RFC_Loc042_RadialDistanceVnce = 0.017;
//        $RFC_Location_042_044::RFC_Loc042_DistVelocityCoVnce = 0.0076;
//        $RFC_Location_042_044::RFC_Loc042_DistVelocityQuality = 255;
//        $RFC_Location_042_044::RFC_Loc042_ElevationQuality = 255;
//        $RFC_Location_042_044::RFC_Loc042_ElevationVnce = 0.092;
//        $RFC_Location_042_044::RFC_Loc042_AzimuthQuality = 255;
//        $RFC_Location_042_044::RFC_Loc042_AzimuthVnce = 0.092;
//        $RFC_Location_042_044::RFC_Loc042_RadialVelocityVnce = 0.0032;
//        $RFC_Location_042_044::RFC_Loc042_AzimuthalPartnerId = 1023;
        
//        /**
//          * Variable values
//          */
//        $RFC_Location_042_044::RFC_Loc042_RadialDistance = dllGetRadarFCLocRadialDistance(@hil_ctrl::Handle_RoadObj, object_id);
//        $RFC_Location_042_044::RFC_Loc042_RadialVelocity = dllGetRadarFCLocRadialVelocity(@hil_ctrl::Handle_RoadObj, object_id);
//        $RFC_Location_042_044::RFC_Loc042_Elevation = dllGetRadarFCLocElevationAngle(@hil_ctrl::Handle_RoadObj, object_id);
//        $RFC_Location_042_044::RFC_Loc042_Azimuth = dllGetRadarFCLocAzimuthAngle(@hil_ctrl::Handle_RoadObj, object_id) * 180 / PI;
//        $RFC_Location_042_044::RFC_Loc042_RadarCrossSection = dllGetRadarFCLocRCS(@hil_ctrl::Handle_RoadObj, object_id);
//        $RFC_Location_042_044::RFC_Loc042_RSSI = dllGetRadarFCLocRSSI(@hil_ctrl::Handle_RoadObj, object_id);
//        break;
        
//      case 43: //"Object-43"
//        /**
//          * Constant values
//          */
//        $RFC_Location_042_044::RFC_Loc043_RadialDistanceVnce = 0.017;
//        $RFC_Location_042_044::RFC_Loc043_DistVelocityCoVnce = 0.0076;
//        $RFC_Location_042_044::RFC_Loc043_DistVelocityQuality = 255;
//        $RFC_Location_042_044::RFC_Loc043_ElevationQuality = 255;
//        $RFC_Location_042_044::RFC_Loc043_ElevationVnce = 0.092;
//        $RFC_Location_042_044::RFC_Loc043_AzimuthQuality = 255;
//        $RFC_Location_042_044::RFC_Loc043_AzimuthVnce = 0.092;
//        $RFC_Location_042_044::RFC_Loc043_RadialVelocityVnce = 0.0032;
//        $RFC_Location_042_044::RFC_Loc043_AzimuthalPartnerId = 1023;
        
//        /**
//          * Variable values
//          */
//        $RFC_Location_042_044::RFC_Loc043_RadialDistance = dllGetRadarFCLocRadialDistance(@hil_ctrl::Handle_RoadObj, object_id);
//        $RFC_Location_042_044::RFC_Loc043_RadialVelocity = dllGetRadarFCLocRadialVelocity(@hil_ctrl::Handle_RoadObj, object_id);
//        $RFC_Location_042_044::RFC_Loc043_Elevation = dllGetRadarFCLocElevationAngle(@hil_ctrl::Handle_RoadObj, object_id);
//        $RFC_Location_042_044::RFC_Loc043_Azimuth = dllGetRadarFCLocAzimuthAngle(@hil_ctrl::Handle_RoadObj, object_id) * 180 / PI;
//        $RFC_Location_042_044::RFC_Loc043_RadarCrossSection = dllGetRadarFCLocRCS(@hil_ctrl::Handle_RoadObj, object_id);
//        $RFC_Location_042_044::RFC_Loc043_RSSI = dllGetRadarFCLocRSSI(@hil_ctrl::Handle_RoadObj, object_id);
//        break;
        
//      case 44: //"Object-44"
//        /**
//          * Constant values
//          */
//        $RFC_Location_042_044::RFC_Loc044_RadialDistanceVnce = 0.017;
//        $RFC_Location_042_044::RFC_Loc044_DistVelocityCoVnce = 0.0076;
//        $RFC_Location_042_044::RFC_Loc044_DistVelocityQuality = 255;
//        $RFC_Location_042_044::RFC_Loc044_ElevationQuality = 255;
//        $RFC_Location_042_044::RFC_Loc044_ElevationVnce = 0.092;
//        $RFC_Location_042_044::RFC_Loc044_AzimuthQuality = 255;
//        $RFC_Location_042_044::RFC_Loc044_AzimuthVnce = 0.092;
//        $RFC_Location_042_044::RFC_Loc044_RadialVelocityVnce = 0.0032;
//        $RFC_Location_042_044::RFC_Loc044_AzimuthalPartnerId = 1023;
        
//        /**
//          * Variable values
//          */
//        $RFC_Location_042_044::RFC_Loc044_RadialDistance = dllGetRadarFCLocRadialDistance(@hil_ctrl::Handle_RoadObj, object_id);
//        $RFC_Location_042_044::RFC_Loc044_RadialVelocity = dllGetRadarFCLocRadialVelocity(@hil_ctrl::Handle_RoadObj, object_id);
//        $RFC_Location_042_044::RFC_Loc044_Elevation = dllGetRadarFCLocElevationAngle(@hil_ctrl::Handle_RoadObj, object_id);
//        $RFC_Location_042_044::RFC_Loc044_Azimuth = dllGetRadarFCLocAzimuthAngle(@hil_ctrl::Handle_RoadObj, object_id) * 180 / PI;
//        $RFC_Location_042_044::RFC_Loc044_RadarCrossSection = dllGetRadarFCLocRCS(@hil_ctrl::Handle_RoadObj, object_id);
//        $RFC_Location_042_044::RFC_Loc044_RSSI = dllGetRadarFCLocRSSI(@hil_ctrl::Handle_RoadObj, object_id);
//        break;
        
//      case 45: //"Object-45"
//        /**
//          * Constant values
//          */
//        $RFC_Location_045_047::RFC_Loc045_RadialDistanceVnce = 0.017;
//        $RFC_Location_045_047::RFC_Loc045_DistVelocityCoVnce = 0.0076;
//        $RFC_Location_045_047::RFC_Loc045_DistVelocityQuality = 255;
//        $RFC_Location_045_047::RFC_Loc045_ElevationQuality = 255;
//        $RFC_Location_045_047::RFC_Loc045_ElevationVnce = 0.092;
//        $RFC_Location_045_047::RFC_Loc045_AzimuthQuality = 255;
//        $RFC_Location_045_047::RFC_Loc045_AzimuthVnce = 0.092;
//        $RFC_Location_045_047::RFC_Loc045_RadialVelocityVnce = 0.0032;
//        $RFC_Location_045_047::RFC_Loc045_AzimuthalPartnerId = 1023;
        
//        /**
//          * Variable values
//          */
//        $RFC_Location_045_047::RFC_Loc045_RadialDistance = dllGetRadarFCLocRadialDistance(@hil_ctrl::Handle_RoadObj, object_id);
//        $RFC_Location_045_047::RFC_Loc045_RadialVelocity = dllGetRadarFCLocRadialVelocity(@hil_ctrl::Handle_RoadObj, object_id);
//        $RFC_Location_045_047::RFC_Loc045_Elevation = dllGetRadarFCLocElevationAngle(@hil_ctrl::Handle_RoadObj, object_id);
//        $RFC_Location_045_047::RFC_Loc045_Azimuth = dllGetRadarFCLocAzimuthAngle(@hil_ctrl::Handle_RoadObj, object_id) * 180 / PI;
//        $RFC_Location_045_047::RFC_Loc045_RadarCrossSection = dllGetRadarFCLocRCS(@hil_ctrl::Handle_RoadObj, object_id);
//        $RFC_Location_045_047::RFC_Loc045_RSSI = dllGetRadarFCLocRSSI(@hil_ctrl::Handle_RoadObj, object_id);
//        break;
        
//      case 46: //"Object-46"
//        /**
//          * Constant values
//          */
//        $RFC_Location_045_047::RFC_Loc046_RadialDistanceVnce = 0.017;
//        $RFC_Location_045_047::RFC_Loc046_DistVelocityCoVnce = 0.0076;
//        $RFC_Location_045_047::RFC_Loc046_DistVelocityQuality = 255;
//        $RFC_Location_045_047::RFC_Loc046_ElevationQuality = 255;
//        $RFC_Location_045_047::RFC_Loc046_ElevationVnce = 0.092;
//        $RFC_Location_045_047::RFC_Loc046_AzimuthQuality = 255;
//        $RFC_Location_045_047::RFC_Loc046_AzimuthVnce = 0.092;
//        $RFC_Location_045_047::RFC_Loc046_RadialVelocityVnce = 0.0032;
//        $RFC_Location_045_047::RFC_Loc046_AzimuthalPartnerId = 1023;
        
//        /**
//          * Variable values
//          */
//        $RFC_Location_045_047::RFC_Loc046_RadialDistance = dllGetRadarFCLocRadialDistance(@hil_ctrl::Handle_RoadObj, object_id);
//        $RFC_Location_045_047::RFC_Loc046_RadialVelocity = dllGetRadarFCLocRadialVelocity(@hil_ctrl::Handle_RoadObj, object_id);
//        $RFC_Location_045_047::RFC_Loc046_Elevation = dllGetRadarFCLocElevationAngle(@hil_ctrl::Handle_RoadObj, object_id);
//        $RFC_Location_045_047::RFC_Loc046_Azimuth = dllGetRadarFCLocAzimuthAngle(@hil_ctrl::Handle_RoadObj, object_id) * 180 / PI;
//        $RFC_Location_045_047::RFC_Loc046_RadarCrossSection = dllGetRadarFCLocRCS(@hil_ctrl::Handle_RoadObj, object_id);
//        $RFC_Location_045_047::RFC_Loc046_RSSI = dllGetRadarFCLocRSSI(@hil_ctrl::Handle_RoadObj, object_id);
//        break;
        
//      case 47: //"Object-47"
//        /**
//          * Constant values
//          */
//        $RFC_Location_045_047::RFC_Loc047_RadialDistanceVnce = 0.017;
//        $RFC_Location_045_047::RFC_Loc047_DistVelocityCoVnce = 0.0076;
//        $RFC_Location_045_047::RFC_Loc047_DistVelocityQuality = 255;
//        $RFC_Location_045_047::RFC_Loc047_ElevationQuality = 255;
//        $RFC_Location_045_047::RFC_Loc047_ElevationVnce = 0.092;
//        $RFC_Location_045_047::RFC_Loc047_AzimuthQuality = 255;
//        $RFC_Location_045_047::RFC_Loc047_AzimuthVnce = 0.092;
//        $RFC_Location_045_047::RFC_Loc047_RadialVelocityVnce = 0.0032;
//        $RFC_Location_045_047::RFC_Loc047_AzimuthalPartnerId = 1023;
        
//        /**
//          * Variable values
//          */
//        $RFC_Location_045_047::RFC_Loc047_RadialDistance = dllGetRadarFCLocRadialDistance(@hil_ctrl::Handle_RoadObj, object_id);
//        $RFC_Location_045_047::RFC_Loc047_RadialVelocity = dllGetRadarFCLocRadialVelocity(@hil_ctrl::Handle_RoadObj, object_id);
//        $RFC_Location_045_047::RFC_Loc047_Elevation = dllGetRadarFCLocElevationAngle(@hil_ctrl::Handle_RoadObj, object_id);
//        $RFC_Location_045_047::RFC_Loc047_Azimuth = dllGetRadarFCLocAzimuthAngle(@hil_ctrl::Handle_RoadObj, object_id) * 180 / PI;
//        $RFC_Location_045_047::RFC_Loc047_RadarCrossSection = dllGetRadarFCLocRCS(@hil_ctrl::Handle_RoadObj, object_id);
//        $RFC_Location_045_047::RFC_Loc047_RSSI = dllGetRadarFCLocRSSI(@hil_ctrl::Handle_RoadObj, object_id);
//        break;
        
//      case 48: //"Object-48"
//        /**
//          * Constant values
//          */
//        $RFC_Location_048_050::RFC_Loc048_RadialDistanceVnce = 0.017;
//        $RFC_Location_048_050::RFC_Loc048_DistVelocityCoVnce = 0.0076;
//        $RFC_Location_048_050::RFC_Loc048_DistVelocityQuality = 255;
//        $RFC_Location_048_050::RFC_Loc048_ElevationQuality = 255;
//        $RFC_Location_048_050::RFC_Loc048_ElevationVnce = 0.092;
//        $RFC_Location_048_050::RFC_Loc048_AzimuthQuality = 255;
//        $RFC_Location_048_050::RFC_Loc048_AzimuthVnce = 0.092;
//        $RFC_Location_048_050::RFC_Loc048_RadialVelocityVnce = 0.0032;
//        $RFC_Location_048_050::RFC_Loc048_AzimuthalPartnerId = 1023;
        
//        /**
//          * Variable values
//          */
//        $RFC_Location_048_050::RFC_Loc048_RadialDistance = dllGetRadarFCLocRadialDistance(@hil_ctrl::Handle_RoadObj, object_id);
//        $RFC_Location_048_050::RFC_Loc048_RadialVelocity = dllGetRadarFCLocRadialVelocity(@hil_ctrl::Handle_RoadObj, object_id);
//        $RFC_Location_048_050::RFC_Loc048_Elevation = dllGetRadarFCLocElevationAngle(@hil_ctrl::Handle_RoadObj, object_id);
//        $RFC_Location_048_050::RFC_Loc048_Azimuth = dllGetRadarFCLocAzimuthAngle(@hil_ctrl::Handle_RoadObj, object_id) * 180 / PI;
//        $RFC_Location_048_050::RFC_Loc048_RadarCrossSection = dllGetRadarFCLocRCS(@hil_ctrl::Handle_RoadObj, object_id);
//        $RFC_Location_048_050::RFC_Loc048_RSSI = dllGetRadarFCLocRSSI(@hil_ctrl::Handle_RoadObj, object_id);
//        break;
        
//      case 49: //"Object-49"
//        /**
//          * Constant values
//          */
//        $RFC_Location_048_050::RFC_Loc049_RadialDistanceVnce = 0.017;
//        $RFC_Location_048_050::RFC_Loc049_DistVelocityCoVnce = 0.0076;
//        $RFC_Location_048_050::RFC_Loc049_DistVelocityQuality = 255;
//        $RFC_Location_048_050::RFC_Loc049_ElevationQuality = 255;
//        $RFC_Location_048_050::RFC_Loc049_ElevationVnce = 0.092;
//        $RFC_Location_048_050::RFC_Loc049_AzimuthQuality = 255;
//        $RFC_Location_048_050::RFC_Loc049_AzimuthVnce = 0.092;
//        $RFC_Location_048_050::RFC_Loc049_RadialVelocityVnce = 0.0032;
//        $RFC_Location_048_050::RFC_Loc049_AzimuthalPartnerId = 1023;
        
//        /**
//          * Variable values
//          */
//        $RFC_Location_048_050::RFC_Loc049_RadialDistance = dllGetRadarFCLocRadialDistance(@hil_ctrl::Handle_RoadObj, object_id);
//        $RFC_Location_048_050::RFC_Loc049_RadialVelocity = dllGetRadarFCLocRadialVelocity(@hil_ctrl::Handle_RoadObj, object_id);
//        $RFC_Location_048_050::RFC_Loc049_Elevation = dllGetRadarFCLocElevationAngle(@hil_ctrl::Handle_RoadObj, object_id);
//        $RFC_Location_048_050::RFC_Loc049_Azimuth = dllGetRadarFCLocAzimuthAngle(@hil_ctrl::Handle_RoadObj, object_id) * 180 / PI;
//        $RFC_Location_048_050::RFC_Loc049_RadarCrossSection = dllGetRadarFCLocRCS(@hil_ctrl::Handle_RoadObj, object_id);
//        $RFC_Location_048_050::RFC_Loc049_RSSI = dllGetRadarFCLocRSSI(@hil_ctrl::Handle_RoadObj, object_id);
//        break;
        
//      case 50: //"Object-50"
//        /**
//          * Constant values
//          */
//        $RFC_Location_048_050::RFC_Loc050_RadialDistanceVnce = 0.017;
//        $RFC_Location_048_050::RFC_Loc050_DistVelocityCoVnce = 0.0076;
//        $RFC_Location_048_050::RFC_Loc050_DistVelocityQuality = 255;
//        $RFC_Location_048_050::RFC_Loc050_ElevationQuality = 255;
//        $RFC_Location_048_050::RFC_Loc050_ElevationVnce = 0.092;
//        $RFC_Location_048_050::RFC_Loc050_AzimuthQuality = 255;
//        $RFC_Location_048_050::RFC_Loc050_AzimuthVnce = 0.092;
//        $RFC_Location_048_050::RFC_Loc050_RadialVelocityVnce = 0.0032;
//        $RFC_Location_048_050::RFC_Loc050_AzimuthalPartnerId = 1023;
        
//        /**
//          * Variable values
//          */
//        $RFC_Location_048_050::RFC_Loc050_RadialDistance = dllGetRadarFCLocRadialDistance(@hil_ctrl::Handle_RoadObj, object_id);
//        $RFC_Location_048_050::RFC_Loc050_RadialVelocity = dllGetRadarFCLocRadialVelocity(@hil_ctrl::Handle_RoadObj, object_id);
//        $RFC_Location_048_050::RFC_Loc050_Elevation = dllGetRadarFCLocElevationAngle(@hil_ctrl::Handle_RoadObj, object_id);
//        $RFC_Location_048_050::RFC_Loc050_Azimuth = dllGetRadarFCLocAzimuthAngle(@hil_ctrl::Handle_RoadObj, object_id) * 180 / PI;
//        $RFC_Location_048_050::RFC_Loc050_RadarCrossSection = dllGetRadarFCLocRCS(@hil_ctrl::Handle_RoadObj, object_id);
//        $RFC_Location_048_050::RFC_Loc050_RSSI = dllGetRadarFCLocRSSI(@hil_ctrl::Handle_RoadObj, object_id);
//        break;
        
//      case 51: //"Object-51"
//        /**
//          * Constant values
//          */
//        $RFC_Location_051_053::RFC_Loc051_RadialDistanceVnce = 0.017;
//        $RFC_Location_051_053::RFC_Loc051_DistVelocityCoVnce = 0.0076;
//        $RFC_Location_051_053::RFC_Loc051_DistVelocityQuality = 255;
//        $RFC_Location_051_053::RFC_Loc051_ElevationQuality = 255;
//        $RFC_Location_051_053::RFC_Loc051_ElevationVnce = 0.092;
//        $RFC_Location_051_053::RFC_Loc051_AzimuthQuality = 255;
//        $RFC_Location_051_053::RFC_Loc051_AzimuthVnce = 0.092;
//        $RFC_Location_051_053::RFC_Loc051_RadialVelocityVnce = 0.0032;
//        $RFC_Location_051_053::RFC_Loc051_AzimuthalPartnerId = 1023;
        
//        /**
//          * Variable values
//          */
//        $RFC_Location_051_053::RFC_Loc051_RadialDistance = dllGetRadarFCLocRadialDistance(@hil_ctrl::Handle_RoadObj, object_id);
//        $RFC_Location_051_053::RFC_Loc051_RadialVelocity = dllGetRadarFCLocRadialVelocity(@hil_ctrl::Handle_RoadObj, object_id);
//        $RFC_Location_051_053::RFC_Loc051_Elevation = dllGetRadarFCLocElevationAngle(@hil_ctrl::Handle_RoadObj, object_id);
//        $RFC_Location_051_053::RFC_Loc051_Azimuth = dllGetRadarFCLocAzimuthAngle(@hil_ctrl::Handle_RoadObj, object_id) * 180 / PI;
//        $RFC_Location_051_053::RFC_Loc051_RadarCrossSection = dllGetRadarFCLocRCS(@hil_ctrl::Handle_RoadObj, object_id);
//        $RFC_Location_051_053::RFC_Loc051_RSSI = dllGetRadarFCLocRSSI(@hil_ctrl::Handle_RoadObj, object_id);
//        break;
        
//      case 52: //"Object-52"
//        /**
//          * Constant values
//          */
//        $RFC_Location_051_053::RFC_Loc052_RadialDistanceVnce = 0.017;
//        $RFC_Location_051_053::RFC_Loc052_DistVelocityCoVnce = 0.0076;
//        $RFC_Location_051_053::RFC_Loc052_DistVelocityQuality = 255;
//        $RFC_Location_051_053::RFC_Loc052_ElevationQuality = 255;
//        $RFC_Location_051_053::RFC_Loc052_ElevationVnce = 0.092;
//        $RFC_Location_051_053::RFC_Loc052_AzimuthQuality = 255;
//        $RFC_Location_051_053::RFC_Loc052_AzimuthVnce = 0.092;
//        $RFC_Location_051_053::RFC_Loc052_RadialVelocityVnce = 0.0032;
//        $RFC_Location_051_053::RFC_Loc052_AzimuthalPartnerId = 1023;
        
//        /**
//          * Variable values
//          */
//        $RFC_Location_051_053::RFC_Loc052_RadialDistance = dllGetRadarFCLocRadialDistance(@hil_ctrl::Handle_RoadObj, object_id);
//        $RFC_Location_051_053::RFC_Loc052_RadialVelocity = dllGetRadarFCLocRadialVelocity(@hil_ctrl::Handle_RoadObj, object_id);
//        $RFC_Location_051_053::RFC_Loc052_Elevation = dllGetRadarFCLocElevationAngle(@hil_ctrl::Handle_RoadObj, object_id);
//        $RFC_Location_051_053::RFC_Loc052_Azimuth = dllGetRadarFCLocAzimuthAngle(@hil_ctrl::Handle_RoadObj, object_id) * 180 / PI;
//        $RFC_Location_051_053::RFC_Loc052_RadarCrossSection = dllGetRadarFCLocRCS(@hil_ctrl::Handle_RoadObj, object_id);
//        $RFC_Location_051_053::RFC_Loc052_RSSI = dllGetRadarFCLocRSSI(@hil_ctrl::Handle_RoadObj, object_id);
//        break;
        
//      case 53: //"Object-53"
//        /**
//          * Constant values
//          */
//        $RFC_Location_051_053::RFC_Loc053_RadialDistanceVnce = 0.017;
//        $RFC_Location_051_053::RFC_Loc053_DistVelocityCoVnce = 0.0076;
//        $RFC_Location_051_053::RFC_Loc053_DistVelocityQuality = 255;
//        $RFC_Location_051_053::RFC_Loc053_ElevationQuality = 255;
//        $RFC_Location_051_053::RFC_Loc053_ElevationVnce = 0.092;
//        $RFC_Location_051_053::RFC_Loc053_AzimuthQuality = 255;
//        $RFC_Location_051_053::RFC_Loc053_AzimuthVnce = 0.092;
//        $RFC_Location_051_053::RFC_Loc053_RadialVelocityVnce = 0.0032;
//        $RFC_Location_051_053::RFC_Loc053_AzimuthalPartnerId = 1023;
        
//        /**
//          * Variable values
//          */
//        $RFC_Location_051_053::RFC_Loc053_RadialDistance = dllGetRadarFCLocRadialDistance(@hil_ctrl::Handle_RoadObj, object_id);
//        $RFC_Location_051_053::RFC_Loc053_RadialVelocity = dllGetRadarFCLocRadialVelocity(@hil_ctrl::Handle_RoadObj, object_id);
//        $RFC_Location_051_053::RFC_Loc053_Elevation = dllGetRadarFCLocElevationAngle(@hil_ctrl::Handle_RoadObj, object_id);
//        $RFC_Location_051_053::RFC_Loc053_Azimuth = dllGetRadarFCLocAzimuthAngle(@hil_ctrl::Handle_RoadObj, object_id) * 180 / PI;
//        $RFC_Location_051_053::RFC_Loc053_RadarCrossSection = dllGetRadarFCLocRCS(@hil_ctrl::Handle_RoadObj, object_id);
//        $RFC_Location_051_053::RFC_Loc053_RSSI = dllGetRadarFCLocRSSI(@hil_ctrl::Handle_RoadObj, object_id);
//        break;
        
//      case 54: //"Object-54"
//        /**
//          * Constant values
//          */
//        $RFC_Location_054_056::RFC_Loc054_RadialDistanceVnce = 0.017;
//        $RFC_Location_054_056::RFC_Loc054_DistVelocityCoVnce = 0.0076;
//        $RFC_Location_054_056::RFC_Loc054_DistVelocityQuality = 255;
//        $RFC_Location_054_056::RFC_Loc054_ElevationQuality = 255;
//        $RFC_Location_054_056::RFC_Loc054_ElevationVnce = 0.092;
//        $RFC_Location_054_056::RFC_Loc054_AzimuthQuality = 255;
//        $RFC_Location_054_056::RFC_Loc054_AzimuthVnce = 0.092;
//        $RFC_Location_054_056::RFC_Loc054_RadialVelocityVnce = 0.0032;
//        $RFC_Location_054_056::RFC_Loc054_AzimuthalPartnerId = 1023;
        
//        /**
//          * Variable values
//          */
//        $RFC_Location_054_056::RFC_Loc054_RadialDistance = dllGetRadarFCLocRadialDistance(@hil_ctrl::Handle_RoadObj, object_id);
//        $RFC_Location_054_056::RFC_Loc054_RadialVelocity = dllGetRadarFCLocRadialVelocity(@hil_ctrl::Handle_RoadObj, object_id);
//        $RFC_Location_054_056::RFC_Loc054_Elevation = dllGetRadarFCLocElevationAngle(@hil_ctrl::Handle_RoadObj, object_id);
//        $RFC_Location_054_056::RFC_Loc054_Azimuth = dllGetRadarFCLocAzimuthAngle(@hil_ctrl::Handle_RoadObj, object_id) * 180 / PI;
//        $RFC_Location_054_056::RFC_Loc054_RadarCrossSection = dllGetRadarFCLocRCS(@hil_ctrl::Handle_RoadObj, object_id);
//        $RFC_Location_054_056::RFC_Loc054_RSSI = dllGetRadarFCLocRSSI(@hil_ctrl::Handle_RoadObj, object_id);
//        break;
        
//      case 55: //"Object-55"
//        /**
//          * Constant values
//          */
//        $RFC_Location_054_056::RFC_Loc055_RadialDistanceVnce = 0.017;
//        $RFC_Location_054_056::RFC_Loc055_DistVelocityCoVnce = 0.0076;
//        $RFC_Location_054_056::RFC_Loc055_DistVelocityQuality = 255;
//        $RFC_Location_054_056::RFC_Loc055_ElevationQuality = 255;
//        $RFC_Location_054_056::RFC_Loc055_ElevationVnce = 0.092;
//        $RFC_Location_054_056::RFC_Loc055_AzimuthQuality = 255;
//        $RFC_Location_054_056::RFC_Loc055_AzimuthVnce = 0.092;
//        $RFC_Location_054_056::RFC_Loc055_RadialVelocityVnce = 0.0032;
//        $RFC_Location_054_056::RFC_Loc055_AzimuthalPartnerId = 1023;
        
//        /**
//          * Variable values
//          */
//        $RFC_Location_054_056::RFC_Loc055_RadialDistance = dllGetRadarFCLocRadialDistance(@hil_ctrl::Handle_RoadObj, object_id);
//        $RFC_Location_054_056::RFC_Loc055_RadialVelocity = dllGetRadarFCLocRadialVelocity(@hil_ctrl::Handle_RoadObj, object_id);
//        $RFC_Location_054_056::RFC_Loc055_Elevation = dllGetRadarFCLocElevationAngle(@hil_ctrl::Handle_RoadObj, object_id);
//        $RFC_Location_054_056::RFC_Loc055_Azimuth = dllGetRadarFCLocAzimuthAngle(@hil_ctrl::Handle_RoadObj, object_id) * 180 / PI;
//        $RFC_Location_054_056::RFC_Loc055_RadarCrossSection = dllGetRadarFCLocRCS(@hil_ctrl::Handle_RoadObj, object_id);
//        $RFC_Location_054_056::RFC_Loc055_RSSI = dllGetRadarFCLocRSSI(@hil_ctrl::Handle_RoadObj, object_id);
//        break;
        
//      case 56: //"Object-56"
//        /**
//          * Constant values
//          */
//        $RFC_Location_054_056::RFC_Loc056_RadialDistanceVnce = 0.017;
//        $RFC_Location_054_056::RFC_Loc056_DistVelocityCoVnce = 0.0076;
//        $RFC_Location_054_056::RFC_Loc056_DistVelocityQuality = 255;
//        $RFC_Location_054_056::RFC_Loc056_ElevationQuality = 255;
//        $RFC_Location_054_056::RFC_Loc056_ElevationVnce = 0.092;
//        $RFC_Location_054_056::RFC_Loc056_AzimuthQuality = 255;
//        $RFC_Location_054_056::RFC_Loc056_AzimuthVnce = 0.092;
//        $RFC_Location_054_056::RFC_Loc056_RadialVelocityVnce = 0.0032;
//        $RFC_Location_054_056::RFC_Loc056_AzimuthalPartnerId = 1023;
        
//        /**
//          * Variable values
//          */
//        $RFC_Location_054_056::RFC_Loc056_RadialDistance = dllGetRadarFCLocRadialDistance(@hil_ctrl::Handle_RoadObj, object_id);
//        $RFC_Location_054_056::RFC_Loc056_RadialVelocity = dllGetRadarFCLocRadialVelocity(@hil_ctrl::Handle_RoadObj, object_id);
//        $RFC_Location_054_056::RFC_Loc056_Elevation = dllGetRadarFCLocElevationAngle(@hil_ctrl::Handle_RoadObj, object_id);
//        $RFC_Location_054_056::RFC_Loc056_Azimuth = dllGetRadarFCLocAzimuthAngle(@hil_ctrl::Handle_RoadObj, object_id) * 180 / PI;
//        $RFC_Location_054_056::RFC_Loc056_RadarCrossSection = dllGetRadarFCLocRCS(@hil_ctrl::Handle_RoadObj, object_id);
//        $RFC_Location_054_056::RFC_Loc056_RSSI = dllGetRadarFCLocRSSI(@hil_ctrl::Handle_RoadObj, object_id);
//        break;
        
//      case 57: //"Object-57"
//        /**
//          * Constant values
//          */
//        $RFC_Location_057_059::RFC_Loc057_RadialDistanceVnce = 0.017;
//        $RFC_Location_057_059::RFC_Loc057_DistVelocityCoVnce = 0.0076;
//        $RFC_Location_057_059::RFC_Loc057_DistVelocityQuality = 255;
//        $RFC_Location_057_059::RFC_Loc057_ElevationQuality = 255;
//        $RFC_Location_057_059::RFC_Loc057_ElevationVnce = 0.092;
//        $RFC_Location_057_059::RFC_Loc057_AzimuthQuality = 255;
//        $RFC_Location_057_059::RFC_Loc057_AzimuthVnce = 0.092;
//        $RFC_Location_057_059::RFC_Loc057_RadialVelocityVnce = 0.0032;
//        $RFC_Location_057_059::RFC_Loc057_AzimuthalPartnerId = 1023;
        
//        /**
//          * Variable values
//          */
//        $RFC_Location_057_059::RFC_Loc057_RadialDistance = dllGetRadarFCLocRadialDistance(@hil_ctrl::Handle_RoadObj, object_id);
//        $RFC_Location_057_059::RFC_Loc057_RadialVelocity = dllGetRadarFCLocRadialVelocity(@hil_ctrl::Handle_RoadObj, object_id);
//        $RFC_Location_057_059::RFC_Loc057_Elevation = dllGetRadarFCLocElevationAngle(@hil_ctrl::Handle_RoadObj, object_id);
//        $RFC_Location_057_059::RFC_Loc057_Azimuth = dllGetRadarFCLocAzimuthAngle(@hil_ctrl::Handle_RoadObj, object_id) * 180 / PI;
//        $RFC_Location_057_059::RFC_Loc057_RadarCrossSection = dllGetRadarFCLocRCS(@hil_ctrl::Handle_RoadObj, object_id);
//        $RFC_Location_057_059::RFC_Loc057_RSSI = dllGetRadarFCLocRSSI(@hil_ctrl::Handle_RoadObj, object_id);
//        break;
        
//      case 58: //"Object-58"
//        /**
//          * Constant values
//          */
//        $RFC_Location_057_059::RFC_Loc058_RadialDistanceVnce = 0.017;
//        $RFC_Location_057_059::RFC_Loc058_DistVelocityCoVnce = 0.0076;
//        $RFC_Location_057_059::RFC_Loc058_DistVelocityQuality = 255;
//        $RFC_Location_057_059::RFC_Loc058_ElevationQuality = 255;
//        $RFC_Location_057_059::RFC_Loc058_ElevationVnce = 0.092;
//        $RFC_Location_057_059::RFC_Loc058_AzimuthQuality = 255;
//        $RFC_Location_057_059::RFC_Loc058_AzimuthVnce = 0.092;
//        $RFC_Location_057_059::RFC_Loc058_RadialVelocityVnce = 0.0032;
//        $RFC_Location_057_059::RFC_Loc058_AzimuthalPartnerId = 1023;
        
//        /**
//          * Variable values
//          */
//        $RFC_Location_057_059::RFC_Loc058_RadialDistance = dllGetRadarFCLocRadialDistance(@hil_ctrl::Handle_RoadObj, object_id);
//        $RFC_Location_057_059::RFC_Loc058_RadialVelocity = dllGetRadarFCLocRadialVelocity(@hil_ctrl::Handle_RoadObj, object_id);
//        $RFC_Location_057_059::RFC_Loc058_Elevation = dllGetRadarFCLocElevationAngle(@hil_ctrl::Handle_RoadObj, object_id);
//        $RFC_Location_057_059::RFC_Loc058_Azimuth = dllGetRadarFCLocAzimuthAngle(@hil_ctrl::Handle_RoadObj, object_id) * 180 / PI;
//        $RFC_Location_057_059::RFC_Loc058_RadarCrossSection = dllGetRadarFCLocRCS(@hil_ctrl::Handle_RoadObj, object_id);
//        $RFC_Location_057_059::RFC_Loc058_RSSI = dllGetRadarFCLocRSSI(@hil_ctrl::Handle_RoadObj, object_id);
//        break;
        
//      case 59: //"Object-59"
//        /**
//          * Constant values
//          */
//        $RFC_Location_057_059::RFC_Loc059_RadialDistanceVnce = 0.017;
//        $RFC_Location_057_059::RFC_Loc059_DistVelocityCoVnce = 0.0076;
//        $RFC_Location_057_059::RFC_Loc059_DistVelocityQuality = 255;
//        $RFC_Location_057_059::RFC_Loc059_ElevationQuality = 255;
//        $RFC_Location_057_059::RFC_Loc059_ElevationVnce = 0.092;
//        $RFC_Location_057_059::RFC_Loc059_AzimuthQuality = 255;
//        $RFC_Location_057_059::RFC_Loc059_AzimuthVnce = 0.092;
//        $RFC_Location_057_059::RFC_Loc059_RadialVelocityVnce = 0.0032;
//        $RFC_Location_057_059::RFC_Loc059_AzimuthalPartnerId = 1023;
        
//        /**
//          * Variable values
//          */
//        $RFC_Location_057_059::RFC_Loc059_RadialDistance = dllGetRadarFCLocRadialDistance(@hil_ctrl::Handle_RoadObj, object_id);
//        $RFC_Location_057_059::RFC_Loc059_RadialVelocity = dllGetRadarFCLocRadialVelocity(@hil_ctrl::Handle_RoadObj, object_id);
//        $RFC_Location_057_059::RFC_Loc059_Elevation = dllGetRadarFCLocElevationAngle(@hil_ctrl::Handle_RoadObj, object_id);
//        $RFC_Location_057_059::RFC_Loc059_Azimuth = dllGetRadarFCLocAzimuthAngle(@hil_ctrl::Handle_RoadObj, object_id) * 180 / PI;
//        $RFC_Location_057_059::RFC_Loc059_RadarCrossSection = dllGetRadarFCLocRCS(@hil_ctrl::Handle_RoadObj, object_id);
//        $RFC_Location_057_059::RFC_Loc059_RSSI = dllGetRadarFCLocRSSI(@hil_ctrl::Handle_RoadObj, object_id);
//        break;
        
//      case 60: //"Object-60"
//        /**
//          * Constant values
//          */
//        $RFC_Location_060_062::RFC_Loc060_RadialDistanceVnce = 0.017;
//        $RFC_Location_060_062::RFC_Loc060_DistVelocityCoVnce = 0.0076;
//        $RFC_Location_060_062::RFC_Loc060_DistVelocityQuality = 255;
//        $RFC_Location_060_062::RFC_Loc060_ElevationQuality = 255;
//        $RFC_Location_060_062::RFC_Loc060_ElevationVnce = 0.092;
//        $RFC_Location_060_062::RFC_Loc060_AzimuthQuality = 255;
//        $RFC_Location_060_062::RFC_Loc060_AzimuthVnce = 0.092;
//        $RFC_Location_060_062::RFC_Loc060_RadialVelocityVnce = 0.0032;
//        $RFC_Location_060_062::RFC_Loc060_AzimuthalPartnerId = 1023;
        
//        /**
//          * Variable values
//          */
//        $RFC_Location_060_062::RFC_Loc060_RadialDistance = dllGetRadarFCLocRadialDistance(@hil_ctrl::Handle_RoadObj, object_id);
//        $RFC_Location_060_062::RFC_Loc060_RadialVelocity = dllGetRadarFCLocRadialVelocity(@hil_ctrl::Handle_RoadObj, object_id);
//        $RFC_Location_060_062::RFC_Loc060_Elevation = dllGetRadarFCLocElevationAngle(@hil_ctrl::Handle_RoadObj, object_id);
//        $RFC_Location_060_062::RFC_Loc060_Azimuth = dllGetRadarFCLocAzimuthAngle(@hil_ctrl::Handle_RoadObj, object_id) * 180 / PI;
//        $RFC_Location_060_062::RFC_Loc060_RadarCrossSection = dllGetRadarFCLocRCS(@hil_ctrl::Handle_RoadObj, object_id);
//        $RFC_Location_060_062::RFC_Loc060_RSSI = dllGetRadarFCLocRSSI(@hil_ctrl::Handle_RoadObj, object_id);
//        break;
        
//      case 61: //"Object-61"
//        /**
//          * Constant values
//          */
//        $RFC_Location_060_062::RFC_Loc061_RadialDistanceVnce = 0.017;
//        $RFC_Location_060_062::RFC_Loc061_DistVelocityCoVnce = 0.0076;
//        $RFC_Location_060_062::RFC_Loc061_DistVelocityQuality = 255;
//        $RFC_Location_060_062::RFC_Loc061_ElevationQuality = 255;
//        $RFC_Location_060_062::RFC_Loc061_ElevationVnce = 0.092;
//        $RFC_Location_060_062::RFC_Loc061_AzimuthQuality = 255;
//        $RFC_Location_060_062::RFC_Loc061_AzimuthVnce = 0.092;
//        $RFC_Location_060_062::RFC_Loc061_RadialVelocityVnce = 0.0032;
//        $RFC_Location_060_062::RFC_Loc061_AzimuthalPartnerId = 1023;
        
//        /**
//          * Variable values
//          */
//        $RFC_Location_060_062::RFC_Loc061_RadialDistance = dllGetRadarFCLocRadialDistance(@hil_ctrl::Handle_RoadObj, object_id);
//        $RFC_Location_060_062::RFC_Loc061_RadialVelocity = dllGetRadarFCLocRadialVelocity(@hil_ctrl::Handle_RoadObj, object_id);
//        $RFC_Location_060_062::RFC_Loc061_Elevation = dllGetRadarFCLocElevationAngle(@hil_ctrl::Handle_RoadObj, object_id);
//        $RFC_Location_060_062::RFC_Loc061_Azimuth = dllGetRadarFCLocAzimuthAngle(@hil_ctrl::Handle_RoadObj, object_id) * 180 / PI;
//        $RFC_Location_060_062::RFC_Loc061_RadarCrossSection = dllGetRadarFCLocRCS(@hil_ctrl::Handle_RoadObj, object_id);
//        $RFC_Location_060_062::RFC_Loc061_RSSI = dllGetRadarFCLocRSSI(@hil_ctrl::Handle_RoadObj, object_id);
//        break;
        
//      case 62: //"Object-62"
//        /**
//          * Constant values
//          */
//        $RFC_Location_060_062::RFC_Loc062_RadialDistanceVnce = 0.017;
//        $RFC_Location_060_062::RFC_Loc062_DistVelocityCoVnce = 0.0076;
//        $RFC_Location_060_062::RFC_Loc062_DistVelocityQuality = 255;
//        $RFC_Location_060_062::RFC_Loc062_ElevationQuality = 255;
//        $RFC_Location_060_062::RFC_Loc062_ElevationVnce = 0.092;
//        $RFC_Location_060_062::RFC_Loc062_AzimuthQuality = 255;
//        $RFC_Location_060_062::RFC_Loc062_AzimuthVnce = 0.092;
//        $RFC_Location_060_062::RFC_Loc062_RadialVelocityVnce = 0.0032;
//        $RFC_Location_060_062::RFC_Loc062_AzimuthalPartnerId = 1023;
        
//        /**
//          * Variable values
//          */
//        $RFC_Location_060_062::RFC_Loc062_RadialDistance = dllGetRadarFCLocRadialDistance(@hil_ctrl::Handle_RoadObj, object_id);
//        $RFC_Location_060_062::RFC_Loc062_RadialVelocity = dllGetRadarFCLocRadialVelocity(@hil_ctrl::Handle_RoadObj, object_id);
//        $RFC_Location_060_062::RFC_Loc062_Elevation = dllGetRadarFCLocElevationAngle(@hil_ctrl::Handle_RoadObj, object_id);
//        $RFC_Location_060_062::RFC_Loc062_Azimuth = dllGetRadarFCLocAzimuthAngle(@hil_ctrl::Handle_RoadObj, object_id) * 180 / PI;
//        $RFC_Location_060_062::RFC_Loc062_RadarCrossSection = dllGetRadarFCLocRCS(@hil_ctrl::Handle_RoadObj, object_id);
//        $RFC_Location_060_062::RFC_Loc062_RSSI = dllGetRadarFCLocRSSI(@hil_ctrl::Handle_RoadObj, object_id);
//        break;
        
//      case 63: //"Object-63"
//        /**
//          * Constant values
//          */
//        $RFC_Location_063_065::RFC_Loc063_RadialDistanceVnce = 0.017;
//        $RFC_Location_063_065::RFC_Loc063_DistVelocityCoVnce = 0.0076;
//        $RFC_Location_063_065::RFC_Loc063_DistVelocityQuality = 255;
//        $RFC_Location_063_065::RFC_Loc063_ElevationQuality = 255;
//        $RFC_Location_063_065::RFC_Loc063_ElevationVnce = 0.092;
//        $RFC_Location_063_065::RFC_Loc063_AzimuthQuality = 255;
//        $RFC_Location_063_065::RFC_Loc063_AzimuthVnce = 0.092;
//        $RFC_Location_063_065::RFC_Loc063_RadialVelocityVnce = 0.0032;
//        $RFC_Location_063_065::RFC_Loc063_AzimuthalPartnerId = 1023;
        
//        /**
//          * Variable values
//          */
//        $RFC_Location_063_065::RFC_Loc063_RadialDistance = dllGetRadarFCLocRadialDistance(@hil_ctrl::Handle_RoadObj, object_id);
//        $RFC_Location_063_065::RFC_Loc063_RadialVelocity = dllGetRadarFCLocRadialVelocity(@hil_ctrl::Handle_RoadObj, object_id);
//        $RFC_Location_063_065::RFC_Loc063_Elevation = dllGetRadarFCLocElevationAngle(@hil_ctrl::Handle_RoadObj, object_id);
//        $RFC_Location_063_065::RFC_Loc063_Azimuth = dllGetRadarFCLocAzimuthAngle(@hil_ctrl::Handle_RoadObj, object_id) * 180 / PI;
//        $RFC_Location_063_065::RFC_Loc063_RadarCrossSection = dllGetRadarFCLocRCS(@hil_ctrl::Handle_RoadObj, object_id);
//        $RFC_Location_063_065::RFC_Loc063_RSSI = dllGetRadarFCLocRSSI(@hil_ctrl::Handle_RoadObj, object_id);
//        break;
        
//      case 64: //"Object-64"
//        /**
//          * Constant values
//          */
//        $RFC_Location_063_065::RFC_Loc064_RadialDistanceVnce = 0.017;
//        $RFC_Location_063_065::RFC_Loc064_DistVelocityCoVnce = 0.0076;
//        $RFC_Location_063_065::RFC_Loc064_DistVelocityQuality = 255;
//        $RFC_Location_063_065::RFC_Loc064_ElevationQuality = 255;
//        $RFC_Location_063_065::RFC_Loc064_ElevationVnce = 0.092;
//        $RFC_Location_063_065::RFC_Loc064_AzimuthQuality = 255;
//        $RFC_Location_063_065::RFC_Loc064_AzimuthVnce = 0.092;
//        $RFC_Location_063_065::RFC_Loc064_RadialVelocityVnce = 0.0032;
//        $RFC_Location_063_065::RFC_Loc064_AzimuthalPartnerId = 1023;
        
//        /**
//          * Variable values
//          */
//        $RFC_Location_063_065::RFC_Loc064_RadialDistance = dllGetRadarFCLocRadialDistance(@hil_ctrl::Handle_RoadObj, object_id);
//        $RFC_Location_063_065::RFC_Loc064_RadialVelocity = dllGetRadarFCLocRadialVelocity(@hil_ctrl::Handle_RoadObj, object_id);
//        $RFC_Location_063_065::RFC_Loc064_Elevation = dllGetRadarFCLocElevationAngle(@hil_ctrl::Handle_RoadObj, object_id);
//        $RFC_Location_063_065::RFC_Loc064_Azimuth = dllGetRadarFCLocAzimuthAngle(@hil_ctrl::Handle_RoadObj, object_id) * 180 / PI;
//        $RFC_Location_063_065::RFC_Loc064_RadarCrossSection = dllGetRadarFCLocRCS(@hil_ctrl::Handle_RoadObj, object_id);
//        $RFC_Location_063_065::RFC_Loc064_RSSI = dllGetRadarFCLocRSSI(@hil_ctrl::Handle_RoadObj, object_id);
//        break;
        
//      case 65: //"Object-65"
//        /**
//          * Constant values
//          */
//        $RFC_Location_063_065::RFC_Loc065_RadialDistanceVnce = 0.017;
//        $RFC_Location_063_065::RFC_Loc065_DistVelocityCoVnce = 0.0076;
//        $RFC_Location_063_065::RFC_Loc065_DistVelocityQuality = 255;
//        $RFC_Location_063_065::RFC_Loc065_ElevationQuality = 255;
//        $RFC_Location_063_065::RFC_Loc065_ElevationVnce = 0.092;
//        $RFC_Location_063_065::RFC_Loc065_AzimuthQuality = 255;
//        $RFC_Location_063_065::RFC_Loc065_AzimuthVnce = 0.092;
//        $RFC_Location_063_065::RFC_Loc065_RadialVelocityVnce = 0.0032;
//        $RFC_Location_063_065::RFC_Loc065_AzimuthalPartnerId = 1023;
        
//        /**
//          * Variable values
//          */
//        $RFC_Location_063_065::RFC_Loc065_RadialDistance = dllGetRadarFCLocRadialDistance(@hil_ctrl::Handle_RoadObj, object_id);
//        $RFC_Location_063_065::RFC_Loc065_RadialVelocity = dllGetRadarFCLocRadialVelocity(@hil_ctrl::Handle_RoadObj, object_id);
//        $RFC_Location_063_065::RFC_Loc065_Elevation = dllGetRadarFCLocElevationAngle(@hil_ctrl::Handle_RoadObj, object_id);
//        $RFC_Location_063_065::RFC_Loc065_Azimuth = dllGetRadarFCLocAzimuthAngle(@hil_ctrl::Handle_RoadObj, object_id) * 180 / PI;
//        $RFC_Location_063_065::RFC_Loc065_RadarCrossSection = dllGetRadarFCLocRCS(@hil_ctrl::Handle_RoadObj, object_id);
//        $RFC_Location_063_065::RFC_Loc065_RSSI = dllGetRadarFCLocRSSI(@hil_ctrl::Handle_RoadObj, object_id);
//        break;
        
//      case 66: //"Object-66"
//        /**
//          * Constant values
//          */
//        $RFC_Location_066_068::RFC_Loc066_RadialDistanceVnce = 0.017;
//        $RFC_Location_066_068::RFC_Loc066_DistVelocityCoVnce = 0.0076;
//        $RFC_Location_066_068::RFC_Loc066_DistVelocityQuality = 255;
//        $RFC_Location_066_068::RFC_Loc066_ElevationQuality = 255;
//        $RFC_Location_066_068::RFC_Loc066_ElevationVnce = 0.092;
//        $RFC_Location_066_068::RFC_Loc066_AzimuthQuality = 255;
//        $RFC_Location_066_068::RFC_Loc066_AzimuthVnce = 0.092;
//        $RFC_Location_066_068::RFC_Loc066_RadialVelocityVnce = 0.0032;
//        $RFC_Location_066_068::RFC_Loc066_AzimuthalPartnerId = 1023;
        
//        /**
//          * Variable values
//          */
//        $RFC_Location_066_068::RFC_Loc066_RadialDistance = dllGetRadarFCLocRadialDistance(@hil_ctrl::Handle_RoadObj, object_id);
//        $RFC_Location_066_068::RFC_Loc066_RadialVelocity = dllGetRadarFCLocRadialVelocity(@hil_ctrl::Handle_RoadObj, object_id);
//        $RFC_Location_066_068::RFC_Loc066_Elevation = dllGetRadarFCLocElevationAngle(@hil_ctrl::Handle_RoadObj, object_id);
//        $RFC_Location_066_068::RFC_Loc066_Azimuth = dllGetRadarFCLocAzimuthAngle(@hil_ctrl::Handle_RoadObj, object_id) * 180 / PI;
//        $RFC_Location_066_068::RFC_Loc066_RadarCrossSection = dllGetRadarFCLocRCS(@hil_ctrl::Handle_RoadObj, object_id);
//        $RFC_Location_066_068::RFC_Loc066_RSSI = dllGetRadarFCLocRSSI(@hil_ctrl::Handle_RoadObj, object_id);
//        break;
        
//      case 67: //"Object-67"
//        /**
//          * Constant values
//          */
//        $RFC_Location_066_068::RFC_Loc067_RadialDistanceVnce = 0.017;
//        $RFC_Location_066_068::RFC_Loc067_DistVelocityCoVnce = 0.0076;
//        $RFC_Location_066_068::RFC_Loc067_DistVelocityQuality = 255;
//        $RFC_Location_066_068::RFC_Loc067_ElevationQuality = 255;
//        $RFC_Location_066_068::RFC_Loc067_ElevationVnce = 0.092;
//        $RFC_Location_066_068::RFC_Loc067_AzimuthQuality = 255;
//        $RFC_Location_066_068::RFC_Loc067_AzimuthVnce = 0.092;
//        $RFC_Location_066_068::RFC_Loc067_RadialVelocityVnce = 0.0032;
//        $RFC_Location_066_068::RFC_Loc067_AzimuthalPartnerId = 1023;
        
//        /**
//          * Variable values
//          */
//        $RFC_Location_066_068::RFC_Loc067_RadialDistance = dllGetRadarFCLocRadialDistance(@hil_ctrl::Handle_RoadObj, object_id);
//        $RFC_Location_066_068::RFC_Loc067_RadialVelocity = dllGetRadarFCLocRadialVelocity(@hil_ctrl::Handle_RoadObj, object_id);
//        $RFC_Location_066_068::RFC_Loc067_Elevation = dllGetRadarFCLocElevationAngle(@hil_ctrl::Handle_RoadObj, object_id);
//        $RFC_Location_066_068::RFC_Loc067_Azimuth = dllGetRadarFCLocAzimuthAngle(@hil_ctrl::Handle_RoadObj, object_id) * 180 / PI;
//        $RFC_Location_066_068::RFC_Loc067_RadarCrossSection = dllGetRadarFCLocRCS(@hil_ctrl::Handle_RoadObj, object_id);
//        $RFC_Location_066_068::RFC_Loc067_RSSI = dllGetRadarFCLocRSSI(@hil_ctrl::Handle_RoadObj, object_id);
//        break;
        
//      case 68: //"Object-68"
//        /**
//          * Constant values
//          */
//        $RFC_Location_066_068::RFC_Loc068_RadialDistanceVnce = 0.017;
//        $RFC_Location_066_068::RFC_Loc068_DistVelocityCoVnce = 0.0076;
//        $RFC_Location_066_068::RFC_Loc068_DistVelocityQuality = 255;
//        $RFC_Location_066_068::RFC_Loc068_ElevationQuality = 255;
//        $RFC_Location_066_068::RFC_Loc068_ElevationVnce = 0.092;
//        $RFC_Location_066_068::RFC_Loc068_AzimuthQuality = 255;
//        $RFC_Location_066_068::RFC_Loc068_AzimuthVnce = 0.092;
//        $RFC_Location_066_068::RFC_Loc068_RadialVelocityVnce = 0.0032;
//        $RFC_Location_066_068::RFC_Loc068_AzimuthalPartnerId = 1023;
        
//        /**
//          * Variable values
//          */
//        $RFC_Location_066_068::RFC_Loc068_RadialDistance = dllGetRadarFCLocRadialDistance(@hil_ctrl::Handle_RoadObj, object_id);
//        $RFC_Location_066_068::RFC_Loc068_RadialVelocity = dllGetRadarFCLocRadialVelocity(@hil_ctrl::Handle_RoadObj, object_id);
//        $RFC_Location_066_068::RFC_Loc068_Elevation = dllGetRadarFCLocElevationAngle(@hil_ctrl::Handle_RoadObj, object_id);
//        $RFC_Location_066_068::RFC_Loc068_Azimuth = dllGetRadarFCLocAzimuthAngle(@hil_ctrl::Handle_RoadObj, object_id) * 180 / PI;
//        $RFC_Location_066_068::RFC_Loc068_RadarCrossSection = dllGetRadarFCLocRCS(@hil_ctrl::Handle_RoadObj, object_id);
//        $RFC_Location_066_068::RFC_Loc068_RSSI = dllGetRadarFCLocRSSI(@hil_ctrl::Handle_RoadObj, object_id);
//        break;
        
//      case 69: //"Object-69"
//        /**
//          * Constant values
//          */
//        $RFC_Location_069_071::RFC_Loc069_RadialDistanceVnce = 0.017;
//        $RFC_Location_069_071::RFC_Loc069_DistVelocityCoVnce = 0.0076;
//        $RFC_Location_069_071::RFC_Loc069_DistVelocityQuality = 255;
//        $RFC_Location_069_071::RFC_Loc069_ElevationQuality = 255;
//        $RFC_Location_069_071::RFC_Loc069_ElevationVnce = 0.092;
//        $RFC_Location_069_071::RFC_Loc069_AzimuthQuality = 255;
//        $RFC_Location_069_071::RFC_Loc069_AzimuthVnce = 0.092;
//        $RFC_Location_069_071::RFC_Loc069_RadialVelocityVnce = 0.0032;
//        $RFC_Location_069_071::RFC_Loc069_AzimuthalPartnerId = 1023;
        
//        /**
//          * Variable values
//          */
//        $RFC_Location_069_071::RFC_Loc069_RadialDistance = dllGetRadarFCLocRadialDistance(@hil_ctrl::Handle_RoadObj, object_id);
//        $RFC_Location_069_071::RFC_Loc069_RadialVelocity = dllGetRadarFCLocRadialVelocity(@hil_ctrl::Handle_RoadObj, object_id);
//        $RFC_Location_069_071::RFC_Loc069_Elevation = dllGetRadarFCLocElevationAngle(@hil_ctrl::Handle_RoadObj, object_id);
//        $RFC_Location_069_071::RFC_Loc069_Azimuth = dllGetRadarFCLocAzimuthAngle(@hil_ctrl::Handle_RoadObj, object_id) * 180 / PI;
//        $RFC_Location_069_071::RFC_Loc069_RadarCrossSection = dllGetRadarFCLocRCS(@hil_ctrl::Handle_RoadObj, object_id);
//        $RFC_Location_069_071::RFC_Loc069_RSSI = dllGetRadarFCLocRSSI(@hil_ctrl::Handle_RoadObj, object_id);
//        break;
        
//      case 70: //"Object-70"
//        /**
//          * Constant values
//          */
//        $RFC_Location_069_071::RFC_Loc070_RadialDistanceVnce = 0.017;
//        $RFC_Location_069_071::RFC_Loc070_DistVelocityCoVnce = 0.0076;
//        $RFC_Location_069_071::RFC_Loc070_DistVelocityQuality = 255;
//        $RFC_Location_069_071::RFC_Loc070_ElevationQuality = 255;
//        $RFC_Location_069_071::RFC_Loc070_ElevationVnce = 0.092;
//        $RFC_Location_069_071::RFC_Loc070_AzimuthQuality = 255;
//        $RFC_Location_069_071::RFC_Loc070_AzimuthVnce = 0.092;
//        $RFC_Location_069_071::RFC_Loc070_RadialVelocityVnce = 0.0032;
//        $RFC_Location_069_071::RFC_Loc070_AzimuthalPartnerId = 1023;
        
//        /**
//          * Variable values
//          */
//        $RFC_Location_069_071::RFC_Loc070_RadialDistance = dllGetRadarFCLocRadialDistance(@hil_ctrl::Handle_RoadObj, object_id);
//        $RFC_Location_069_071::RFC_Loc070_RadialVelocity = dllGetRadarFCLocRadialVelocity(@hil_ctrl::Handle_RoadObj, object_id);
//        $RFC_Location_069_071::RFC_Loc070_Elevation = dllGetRadarFCLocElevationAngle(@hil_ctrl::Handle_RoadObj, object_id);
//        $RFC_Location_069_071::RFC_Loc070_Azimuth = dllGetRadarFCLocAzimuthAngle(@hil_ctrl::Handle_RoadObj, object_id) * 180 / PI;
//        $RFC_Location_069_071::RFC_Loc070_RadarCrossSection = dllGetRadarFCLocRCS(@hil_ctrl::Handle_RoadObj, object_id);
//        $RFC_Location_069_071::RFC_Loc070_RSSI = dllGetRadarFCLocRSSI(@hil_ctrl::Handle_RoadObj, object_id);
//        break;
        
//      case 71: //"Object-71"
//        /**
//          * Constant values
//          */
//        $RFC_Location_069_071::RFC_Loc071_RadialDistanceVnce = 0.017;
//        $RFC_Location_069_071::RFC_Loc071_DistVelocityCoVnce = 0.0076;
//        $RFC_Location_069_071::RFC_Loc071_DistVelocityQuality = 255;
//        $RFC_Location_069_071::RFC_Loc071_ElevationQuality = 255;
//        $RFC_Location_069_071::RFC_Loc071_ElevationVnce = 0.092;
//        $RFC_Location_069_071::RFC_Loc071_AzimuthQuality = 255;
//        $RFC_Location_069_071::RFC_Loc071_AzimuthVnce = 0.092;
//        $RFC_Location_069_071::RFC_Loc071_RadialVelocityVnce = 0.0032;
//        $RFC_Location_069_071::RFC_Loc071_AzimuthalPartnerId = 1023;
        
//        /**
//          * Variable values
//          */
//        $RFC_Location_069_071::RFC_Loc071_RadialDistance = dllGetRadarFCLocRadialDistance(@hil_ctrl::Handle_RoadObj, object_id);
//        $RFC_Location_069_071::RFC_Loc071_RadialVelocity = dllGetRadarFCLocRadialVelocity(@hil_ctrl::Handle_RoadObj, object_id);
//        $RFC_Location_069_071::RFC_Loc071_Elevation = dllGetRadarFCLocElevationAngle(@hil_ctrl::Handle_RoadObj, object_id);
//        $RFC_Location_069_071::RFC_Loc071_Azimuth = dllGetRadarFCLocAzimuthAngle(@hil_ctrl::Handle_RoadObj, object_id) * 180 / PI;
//        $RFC_Location_069_071::RFC_Loc071_RadarCrossSection = dllGetRadarFCLocRCS(@hil_ctrl::Handle_RoadObj, object_id);
//        $RFC_Location_069_071::RFC_Loc071_RSSI = dllGetRadarFCLocRSSI(@hil_ctrl::Handle_RoadObj, object_id);
//        break;
        
//      case 72: //"Object-72"
//        /**
//          * Constant values
//          */
//        $RFC_Location_072_074::RFC_Loc072_RadialDistanceVnce = 0.017;
//        $RFC_Location_072_074::RFC_Loc072_DistVelocityCoVnce = 0.0076;
//        $RFC_Location_072_074::RFC_Loc072_DistVelocityQuality = 255;
//        $RFC_Location_072_074::RFC_Loc072_ElevationQuality = 255;
//        $RFC_Location_072_074::RFC_Loc072_ElevationVnce = 0.092;
//        $RFC_Location_072_074::RFC_Loc072_AzimuthQuality = 255;
//        $RFC_Location_072_074::RFC_Loc072_AzimuthVnce = 0.092;
//        $RFC_Location_072_074::RFC_Loc072_RadialVelocityVnce = 0.0032;
//        $RFC_Location_072_074::RFC_Loc072_AzimuthalPartnerId = 1023;
        
//        /**
//          * Variable values
//          */
//        $RFC_Location_072_074::RFC_Loc072_RadialDistance = dllGetRadarFCLocRadialDistance(@hil_ctrl::Handle_RoadObj, object_id);
//        $RFC_Location_072_074::RFC_Loc072_RadialVelocity = dllGetRadarFCLocRadialVelocity(@hil_ctrl::Handle_RoadObj, object_id);
//        $RFC_Location_072_074::RFC_Loc072_Elevation = dllGetRadarFCLocElevationAngle(@hil_ctrl::Handle_RoadObj, object_id);
//        $RFC_Location_072_074::RFC_Loc072_Azimuth = dllGetRadarFCLocAzimuthAngle(@hil_ctrl::Handle_RoadObj, object_id) * 180 / PI;
//        $RFC_Location_072_074::RFC_Loc072_RadarCrossSection = dllGetRadarFCLocRCS(@hil_ctrl::Handle_RoadObj, object_id);
//        $RFC_Location_072_074::RFC_Loc072_RSSI = dllGetRadarFCLocRSSI(@hil_ctrl::Handle_RoadObj, object_id);
//        break;
        
//      case 73: //"Object-73"
//        /**
//          * Constant values
//          */
//        $RFC_Location_072_074::RFC_Loc073_RadialDistanceVnce = 0.017;
//        $RFC_Location_072_074::RFC_Loc073_DistVelocityCoVnce = 0.0076;
//        $RFC_Location_072_074::RFC_Loc073_DistVelocityQuality = 255;
//        $RFC_Location_072_074::RFC_Loc073_ElevationQuality = 255;
//        $RFC_Location_072_074::RFC_Loc073_ElevationVnce = 0.092;
//        $RFC_Location_072_074::RFC_Loc073_AzimuthQuality = 255;
//        $RFC_Location_072_074::RFC_Loc073_AzimuthVnce = 0.092;
//        $RFC_Location_072_074::RFC_Loc073_RadialVelocityVnce = 0.0032;
//        $RFC_Location_072_074::RFC_Loc073_AzimuthalPartnerId = 1023;
        
//        /**
//          * Variable values
//          */
//        $RFC_Location_072_074::RFC_Loc073_RadialDistance = dllGetRadarFCLocRadialDistance(@hil_ctrl::Handle_RoadObj, object_id);
//        $RFC_Location_072_074::RFC_Loc073_RadialVelocity = dllGetRadarFCLocRadialVelocity(@hil_ctrl::Handle_RoadObj, object_id);
//        $RFC_Location_072_074::RFC_Loc073_Elevation = dllGetRadarFCLocElevationAngle(@hil_ctrl::Handle_RoadObj, object_id);
//        $RFC_Location_072_074::RFC_Loc073_Azimuth = dllGetRadarFCLocAzimuthAngle(@hil_ctrl::Handle_RoadObj, object_id) * 180 / PI;
//        $RFC_Location_072_074::RFC_Loc073_RadarCrossSection = dllGetRadarFCLocRCS(@hil_ctrl::Handle_RoadObj, object_id);
//        $RFC_Location_072_074::RFC_Loc073_RSSI = dllGetRadarFCLocRSSI(@hil_ctrl::Handle_RoadObj, object_id);
//        break;
        
//      case 74: //"Object-74"
//        /**
//          * Constant values
//          */
//        $RFC_Location_072_074::RFC_Loc074_RadialDistanceVnce = 0.017;
//        $RFC_Location_072_074::RFC_Loc074_DistVelocityCoVnce = 0.0076;
//        $RFC_Location_072_074::RFC_Loc074_DistVelocityQuality = 255;
//        $RFC_Location_072_074::RFC_Loc074_ElevationQuality = 255;
//        $RFC_Location_072_074::RFC_Loc074_ElevationVnce = 0.092;
//        $RFC_Location_072_074::RFC_Loc074_AzimuthQuality = 255;
//        $RFC_Location_072_074::RFC_Loc074_AzimuthVnce = 0.092;
//        $RFC_Location_072_074::RFC_Loc074_RadialVelocityVnce = 0.0032;
//        $RFC_Location_072_074::RFC_Loc074_AzimuthalPartnerId = 1023;
        
//        /**
//          * Variable values
//          */
//        $RFC_Location_072_074::RFC_Loc074_RadialDistance = dllGetRadarFCLocRadialDistance(@hil_ctrl::Handle_RoadObj, object_id);
//        $RFC_Location_072_074::RFC_Loc074_RadialVelocity = dllGetRadarFCLocRadialVelocity(@hil_ctrl::Handle_RoadObj, object_id);
//        $RFC_Location_072_074::RFC_Loc074_Elevation = dllGetRadarFCLocElevationAngle(@hil_ctrl::Handle_RoadObj, object_id);
//        $RFC_Location_072_074::RFC_Loc074_Azimuth = dllGetRadarFCLocAzimuthAngle(@hil_ctrl::Handle_RoadObj, object_id) * 180 / PI;
//        $RFC_Location_072_074::RFC_Loc074_RadarCrossSection = dllGetRadarFCLocRCS(@hil_ctrl::Handle_RoadObj, object_id);
//        $RFC_Location_072_074::RFC_Loc074_RSSI = dllGetRadarFCLocRSSI(@hil_ctrl::Handle_RoadObj, object_id);
//        break;
        
//      case 75: //"Object-75"
//        /**
//          * Constant values
//          */
//        $RFC_Location_075_077::RFC_Loc075_RadialDistanceVnce = 0.017;
//        $RFC_Location_075_077::RFC_Loc075_DistVelocityCoVnce = 0.0076;
//        $RFC_Location_075_077::RFC_Loc075_DistVelocityQuality = 255;
//        $RFC_Location_075_077::RFC_Loc075_ElevationQuality = 255;
//        $RFC_Location_075_077::RFC_Loc075_ElevationVnce = 0.092;
//        $RFC_Location_075_077::RFC_Loc075_AzimuthQuality = 255;
//        $RFC_Location_075_077::RFC_Loc075_AzimuthVnce = 0.092;
//        $RFC_Location_075_077::RFC_Loc075_RadialVelocityVnce = 0.0032;
//        $RFC_Location_075_077::RFC_Loc075_AzimuthalPartnerId = 1023;
        
//        /**
//          * Variable values
//          */
//        $RFC_Location_075_077::RFC_Loc075_RadialDistance = dllGetRadarFCLocRadialDistance(@hil_ctrl::Handle_RoadObj, object_id);
//        $RFC_Location_075_077::RFC_Loc075_RadialVelocity = dllGetRadarFCLocRadialVelocity(@hil_ctrl::Handle_RoadObj, object_id);
//        $RFC_Location_075_077::RFC_Loc075_Elevation = dllGetRadarFCLocElevationAngle(@hil_ctrl::Handle_RoadObj, object_id);
//        $RFC_Location_075_077::RFC_Loc075_Azimuth = dllGetRadarFCLocAzimuthAngle(@hil_ctrl::Handle_RoadObj, object_id) * 180 / PI;
//        $RFC_Location_075_077::RFC_Loc075_RadarCrossSection = dllGetRadarFCLocRCS(@hil_ctrl::Handle_RoadObj, object_id);
//        $RFC_Location_075_077::RFC_Loc075_RSSI = dllGetRadarFCLocRSSI(@hil_ctrl::Handle_RoadObj, object_id);
//        break;
        
//      case 76: //"Object-76"
//        /**
//          * Constant values
//          */
//        $RFC_Location_075_077::RFC_Loc076_RadialDistanceVnce = 0.017;
//        $RFC_Location_075_077::RFC_Loc076_DistVelocityCoVnce = 0.0076;
//        $RFC_Location_075_077::RFC_Loc076_DistVelocityQuality = 255;
//        $RFC_Location_075_077::RFC_Loc076_ElevationQuality = 255;
//        $RFC_Location_075_077::RFC_Loc076_ElevationVnce = 0.092;
//        $RFC_Location_075_077::RFC_Loc076_AzimuthQuality = 255;
//        $RFC_Location_075_077::RFC_Loc076_AzimuthVnce = 0.092;
//        $RFC_Location_075_077::RFC_Loc076_RadialVelocityVnce = 0.0032;
//        $RFC_Location_075_077::RFC_Loc076_AzimuthalPartnerId = 1023;
        
//        /**
//          * Variable values
//          */
//        $RFC_Location_075_077::RFC_Loc076_RadialDistance = dllGetRadarFCLocRadialDistance(@hil_ctrl::Handle_RoadObj, object_id);
//        $RFC_Location_075_077::RFC_Loc076_RadialVelocity = dllGetRadarFCLocRadialVelocity(@hil_ctrl::Handle_RoadObj, object_id);
//        $RFC_Location_075_077::RFC_Loc076_Elevation = dllGetRadarFCLocElevationAngle(@hil_ctrl::Handle_RoadObj, object_id);
//        $RFC_Location_075_077::RFC_Loc076_Azimuth = dllGetRadarFCLocAzimuthAngle(@hil_ctrl::Handle_RoadObj, object_id) * 180 / PI;
//        $RFC_Location_075_077::RFC_Loc076_RadarCrossSection = dllGetRadarFCLocRCS(@hil_ctrl::Handle_RoadObj, object_id);
//        $RFC_Location_075_077::RFC_Loc076_RSSI = dllGetRadarFCLocRSSI(@hil_ctrl::Handle_RoadObj, object_id);
//        break;
        
//      case 77: //"Object-77"
//        /**
//          * Constant values
//          */
//        $RFC_Location_075_077::RFC_Loc077_RadialDistanceVnce = 0.017;
//        $RFC_Location_075_077::RFC_Loc077_DistVelocityCoVnce = 0.0076;
//        $RFC_Location_075_077::RFC_Loc077_DistVelocityQuality = 255;
//        $RFC_Location_075_077::RFC_Loc077_ElevationQuality = 255;
//        $RFC_Location_075_077::RFC_Loc077_ElevationVnce = 0.092;
//        $RFC_Location_075_077::RFC_Loc077_AzimuthQuality = 255;
//        $RFC_Location_075_077::RFC_Loc077_AzimuthVnce = 0.092;
//        $RFC_Location_075_077::RFC_Loc077_RadialVelocityVnce = 0.0032;
//        $RFC_Location_075_077::RFC_Loc077_AzimuthalPartnerId = 1023;
        
//        /**
//          * Variable values
//          */
//        $RFC_Location_075_077::RFC_Loc077_RadialDistance = dllGetRadarFCLocRadialDistance(@hil_ctrl::Handle_RoadObj, object_id);
//        $RFC_Location_075_077::RFC_Loc077_RadialVelocity = dllGetRadarFCLocRadialVelocity(@hil_ctrl::Handle_RoadObj, object_id);
//        $RFC_Location_075_077::RFC_Loc077_Elevation = dllGetRadarFCLocElevationAngle(@hil_ctrl::Handle_RoadObj, object_id);
//        $RFC_Location_075_077::RFC_Loc077_Azimuth = dllGetRadarFCLocAzimuthAngle(@hil_ctrl::Handle_RoadObj, object_id) * 180 / PI;
//        $RFC_Location_075_077::RFC_Loc077_RadarCrossSection = dllGetRadarFCLocRCS(@hil_ctrl::Handle_RoadObj, object_id);
//        $RFC_Location_075_077::RFC_Loc077_RSSI = dllGetRadarFCLocRSSI(@hil_ctrl::Handle_RoadObj, object_id);
//        break;
        
//      case 78: //"Object-78"
//        /**
//          * Constant values
//          */
//        $RFC_Location_078_080::RFC_Loc078_RadialDistanceVnce = 0.017;
//        $RFC_Location_078_080::RFC_Loc078_DistVelocityCoVnce = 0.0076;
//        $RFC_Location_078_080::RFC_Loc078_DistVelocityQuality = 255;
//        $RFC_Location_078_080::RFC_Loc078_ElevationQuality = 255;
//        $RFC_Location_078_080::RFC_Loc078_ElevationVnce = 0.092;
//        $RFC_Location_078_080::RFC_Loc078_AzimuthQuality = 255;
//        $RFC_Location_078_080::RFC_Loc078_AzimuthVnce = 0.092;
//        $RFC_Location_078_080::RFC_Loc078_RadialVelocityVnce = 0.0032;
//        $RFC_Location_078_080::RFC_Loc078_AzimuthalPartnerId = 1023;
        
//        /**
//          * Variable values
//          */
//        $RFC_Location_078_080::RFC_Loc078_RadialDistance = dllGetRadarFCLocRadialDistance(@hil_ctrl::Handle_RoadObj, object_id);
//        $RFC_Location_078_080::RFC_Loc078_RadialVelocity = dllGetRadarFCLocRadialVelocity(@hil_ctrl::Handle_RoadObj, object_id);
//        $RFC_Location_078_080::RFC_Loc078_Elevation = dllGetRadarFCLocElevationAngle(@hil_ctrl::Handle_RoadObj, object_id);
//        $RFC_Location_078_080::RFC_Loc078_Azimuth = dllGetRadarFCLocAzimuthAngle(@hil_ctrl::Handle_RoadObj, object_id) * 180 / PI;
//        $RFC_Location_078_080::RFC_Loc078_RadarCrossSection = dllGetRadarFCLocRCS(@hil_ctrl::Handle_RoadObj, object_id);
//        $RFC_Location_078_080::RFC_Loc078_RSSI = dllGetRadarFCLocRSSI(@hil_ctrl::Handle_RoadObj, object_id);
//        break;
        
//      case 79: //"Object-79"
//        /**
//          * Constant values
//          */
//        $RFC_Location_078_080::RFC_Loc079_RadialDistanceVnce = 0.017;
//        $RFC_Location_078_080::RFC_Loc079_DistVelocityCoVnce = 0.0076;
//        $RFC_Location_078_080::RFC_Loc079_DistVelocityQuality = 255;
//        $RFC_Location_078_080::RFC_Loc079_ElevationQuality = 255;
//        $RFC_Location_078_080::RFC_Loc079_ElevationVnce = 0.092;
//        $RFC_Location_078_080::RFC_Loc079_AzimuthQuality = 255;
//        $RFC_Location_078_080::RFC_Loc079_AzimuthVnce = 0.092;
//        $RFC_Location_078_080::RFC_Loc079_RadialVelocityVnce = 0.0032;
//        $RFC_Location_078_080::RFC_Loc079_AzimuthalPartnerId = 1023;
        
//        /**
//          * Variable values
//          */
//        $RFC_Location_078_080::RFC_Loc079_RadialDistance = dllGetRadarFCLocRadialDistance(@hil_ctrl::Handle_RoadObj, object_id);
//        $RFC_Location_078_080::RFC_Loc079_RadialVelocity = dllGetRadarFCLocRadialVelocity(@hil_ctrl::Handle_RoadObj, object_id);
//        $RFC_Location_078_080::RFC_Loc079_Elevation = dllGetRadarFCLocElevationAngle(@hil_ctrl::Handle_RoadObj, object_id);
//        $RFC_Location_078_080::RFC_Loc079_Azimuth = dllGetRadarFCLocAzimuthAngle(@hil_ctrl::Handle_RoadObj, object_id) * 180 / PI;
//        $RFC_Location_078_080::RFC_Loc079_RadarCrossSection = dllGetRadarFCLocRCS(@hil_ctrl::Handle_RoadObj, object_id);
//        $RFC_Location_078_080::RFC_Loc079_RSSI = dllGetRadarFCLocRSSI(@hil_ctrl::Handle_RoadObj, object_id);
//        break;
        
//      case 80: //"Object-80"
//        /**
//          * Constant values
//          */
//        $RFC_Location_078_080::RFC_Loc080_RadialDistanceVnce = 0.017;
//        $RFC_Location_078_080::RFC_Loc080_DistVelocityCoVnce = 0.0076;
//        $RFC_Location_078_080::RFC_Loc080_DistVelocityQuality = 255;
//        $RFC_Location_078_080::RFC_Loc080_ElevationQuality = 255;
//        $RFC_Location_078_080::RFC_Loc080_ElevationVnce = 0.092;
//        $RFC_Location_078_080::RFC_Loc080_AzimuthQuality = 255;
//        $RFC_Location_078_080::RFC_Loc080_AzimuthVnce = 0.092;
//        $RFC_Location_078_080::RFC_Loc080_RadialVelocityVnce = 0.0032;
//        $RFC_Location_078_080::RFC_Loc080_AzimuthalPartnerId = 1023;
        
//        /**
//          * Variable values
//          */
//        $RFC_Location_078_080::RFC_Loc080_RadialDistance = dllGetRadarFCLocRadialDistance(@hil_ctrl::Handle_RoadObj, object_id);
//        $RFC_Location_078_080::RFC_Loc080_RadialVelocity = dllGetRadarFCLocRadialVelocity(@hil_ctrl::Handle_RoadObj, object_id);
//        $RFC_Location_078_080::RFC_Loc080_Elevation = dllGetRadarFCLocElevationAngle(@hil_ctrl::Handle_RoadObj, object_id);
//        $RFC_Location_078_080::RFC_Loc080_Azimuth = dllGetRadarFCLocAzimuthAngle(@hil_ctrl::Handle_RoadObj, object_id) * 180 / PI;
//        $RFC_Location_078_080::RFC_Loc080_RadarCrossSection = dllGetRadarFCLocRCS(@hil_ctrl::Handle_RoadObj, object_id);
//        $RFC_Location_078_080::RFC_Loc080_RSSI = dllGetRadarFCLocRSSI(@hil_ctrl::Handle_RoadObj, object_id);
//        break;
        
//      case 81: //"Object-81"
//        /**
//          * Constant values
//          */
//        $RFC_Location_081_083::RFC_Loc081_RadialDistanceVnce = 0.017;
//        $RFC_Location_081_083::RFC_Loc081_DistVelocityCoVnce = 0.0076;
//        $RFC_Location_081_083::RFC_Loc081_DistVelocityQuality = 255;
//        $RFC_Location_081_083::RFC_Loc081_ElevationQuality = 255;
//        $RFC_Location_081_083::RFC_Loc081_ElevationVnce = 0.092;
//        $RFC_Location_081_083::RFC_Loc081_AzimuthQuality = 255;
//        $RFC_Location_081_083::RFC_Loc081_AzimuthVnce = 0.092;
//        $RFC_Location_081_083::RFC_Loc081_RadialVelocityVnce = 0.0032;
//        $RFC_Location_081_083::RFC_Loc081_AzimuthalPartnerId = 1023;
        
//        /**
//          * Variable values
//          */
//        $RFC_Location_081_083::RFC_Loc081_RadialDistance = dllGetRadarFCLocRadialDistance(@hil_ctrl::Handle_RoadObj, object_id);
//        $RFC_Location_081_083::RFC_Loc081_RadialVelocity = dllGetRadarFCLocRadialVelocity(@hil_ctrl::Handle_RoadObj, object_id);
//        $RFC_Location_081_083::RFC_Loc081_Elevation = dllGetRadarFCLocElevationAngle(@hil_ctrl::Handle_RoadObj, object_id);
//        $RFC_Location_081_083::RFC_Loc081_Azimuth = dllGetRadarFCLocAzimuthAngle(@hil_ctrl::Handle_RoadObj, object_id) * 180 / PI;
//        $RFC_Location_081_083::RFC_Loc081_RadarCrossSection = dllGetRadarFCLocRCS(@hil_ctrl::Handle_RoadObj, object_id);
//        $RFC_Location_081_083::RFC_Loc081_RSSI = dllGetRadarFCLocRSSI(@hil_ctrl::Handle_RoadObj, object_id);
//        break;
        
//      case 82: //"Object-82"
//        /**
//          * Constant values
//          */
//        $RFC_Location_081_083::RFC_Loc082_RadialDistanceVnce = 0.017;
//        $RFC_Location_081_083::RFC_Loc082_DistVelocityCoVnce = 0.0076;
//        $RFC_Location_081_083::RFC_Loc082_DistVelocityQuality = 255;
//        $RFC_Location_081_083::RFC_Loc082_ElevationQuality = 255;
//        $RFC_Location_081_083::RFC_Loc082_ElevationVnce = 0.092;
//        $RFC_Location_081_083::RFC_Loc082_AzimuthQuality = 255;
//        $RFC_Location_081_083::RFC_Loc082_AzimuthVnce = 0.092;
//        $RFC_Location_081_083::RFC_Loc082_RadialVelocityVnce = 0.0032;
//        $RFC_Location_081_083::RFC_Loc082_AzimuthalPartnerId = 1023;
        
//        /**
//          * Variable values
//          */
//        $RFC_Location_081_083::RFC_Loc082_RadialDistance = dllGetRadarFCLocRadialDistance(@hil_ctrl::Handle_RoadObj, object_id);
//        $RFC_Location_081_083::RFC_Loc082_RadialVelocity = dllGetRadarFCLocRadialVelocity(@hil_ctrl::Handle_RoadObj, object_id);
//        $RFC_Location_081_083::RFC_Loc082_Elevation = dllGetRadarFCLocElevationAngle(@hil_ctrl::Handle_RoadObj, object_id);
//        $RFC_Location_081_083::RFC_Loc082_Azimuth = dllGetRadarFCLocAzimuthAngle(@hil_ctrl::Handle_RoadObj, object_id) * 180 / PI;
//        $RFC_Location_081_083::RFC_Loc082_RadarCrossSection = dllGetRadarFCLocRCS(@hil_ctrl::Handle_RoadObj, object_id);
//        $RFC_Location_081_083::RFC_Loc082_RSSI = dllGetRadarFCLocRSSI(@hil_ctrl::Handle_RoadObj, object_id);
//        break;
        
//      case 83: //"Object-83"
//        /**
//          * Constant values
//          */
//        $RFC_Location_081_083::RFC_Loc083_RadialDistanceVnce = 0.017;
//        $RFC_Location_081_083::RFC_Loc083_DistVelocityCoVnce = 0.0076;
//        $RFC_Location_081_083::RFC_Loc083_DistVelocityQuality = 255;
//        $RFC_Location_081_083::RFC_Loc083_ElevationQuality = 255;
//        $RFC_Location_081_083::RFC_Loc083_ElevationVnce = 0.092;
//        $RFC_Location_081_083::RFC_Loc083_AzimuthQuality = 255;
//        $RFC_Location_081_083::RFC_Loc083_AzimuthVnce = 0.092;
//        $RFC_Location_081_083::RFC_Loc083_RadialVelocityVnce = 0.0032;
//        $RFC_Location_081_083::RFC_Loc083_AzimuthalPartnerId = 1023;
        
//        /**
//          * Variable values
//          */
//        $RFC_Location_081_083::RFC_Loc083_RadialDistance = dllGetRadarFCLocRadialDistance(@hil_ctrl::Handle_RoadObj, object_id);
//        $RFC_Location_081_083::RFC_Loc083_RadialVelocity = dllGetRadarFCLocRadialVelocity(@hil_ctrl::Handle_RoadObj, object_id);
//        $RFC_Location_081_083::RFC_Loc083_Elevation = dllGetRadarFCLocElevationAngle(@hil_ctrl::Handle_RoadObj, object_id);
//        $RFC_Location_081_083::RFC_Loc083_Azimuth = dllGetRadarFCLocAzimuthAngle(@hil_ctrl::Handle_RoadObj, object_id) * 180 / PI;
//        $RFC_Location_081_083::RFC_Loc083_RadarCrossSection = dllGetRadarFCLocRCS(@hil_ctrl::Handle_RoadObj, object_id);
//        $RFC_Location_081_083::RFC_Loc083_RSSI = dllGetRadarFCLocRSSI(@hil_ctrl::Handle_RoadObj, object_id);
//        break;
        
//      case 84: //"Object-84"
//        /**
//          * Constant values
//          */
//        $RFC_Location_084_086::RFC_Loc084_RadialDistanceVnce = 0.017;
//        $RFC_Location_084_086::RFC_Loc084_DistVelocityCoVnce = 0.0076;
//        $RFC_Location_084_086::RFC_Loc084_DistVelocityQuality = 255;
//        $RFC_Location_084_086::RFC_Loc084_ElevationQuality = 255;
//        $RFC_Location_084_086::RFC_Loc084_ElevationVnce = 0.092;
//        $RFC_Location_084_086::RFC_Loc084_AzimuthQuality = 255;
//        $RFC_Location_084_086::RFC_Loc084_AzimuthVnce = 0.092;
//        $RFC_Location_084_086::RFC_Loc084_RadialVelocityVnce = 0.0032;
//        $RFC_Location_084_086::RFC_Loc084_AzimuthalPartnerId = 1023;
        
//        /**
//          * Variable values
//          */
//        $RFC_Location_084_086::RFC_Loc084_RadialDistance = dllGetRadarFCLocRadialDistance(@hil_ctrl::Handle_RoadObj, object_id);
//        $RFC_Location_084_086::RFC_Loc084_RadialVelocity = dllGetRadarFCLocRadialVelocity(@hil_ctrl::Handle_RoadObj, object_id);
//        $RFC_Location_084_086::RFC_Loc084_Elevation = dllGetRadarFCLocElevationAngle(@hil_ctrl::Handle_RoadObj, object_id);
//        $RFC_Location_084_086::RFC_Loc084_Azimuth = dllGetRadarFCLocAzimuthAngle(@hil_ctrl::Handle_RoadObj, object_id) * 180 / PI;
//        $RFC_Location_084_086::RFC_Loc084_RadarCrossSection = dllGetRadarFCLocRCS(@hil_ctrl::Handle_RoadObj, object_id);
//        $RFC_Location_084_086::RFC_Loc084_RSSI = dllGetRadarFCLocRSSI(@hil_ctrl::Handle_RoadObj, object_id);
//        break;
        
//      case 85: //"Object-85"
//        /**
//          * Constant values
//          */
//        $RFC_Location_084_086::RFC_Loc085_RadialDistanceVnce = 0.017;
//        $RFC_Location_084_086::RFC_Loc085_DistVelocityCoVnce = 0.0076;
//        $RFC_Location_084_086::RFC_Loc085_DistVelocityQuality = 255;
//        $RFC_Location_084_086::RFC_Loc085_ElevationQuality = 255;
//        $RFC_Location_084_086::RFC_Loc085_ElevationVnce = 0.092;
//        $RFC_Location_084_086::RFC_Loc085_AzimuthQuality = 255;
//        $RFC_Location_084_086::RFC_Loc085_AzimuthVnce = 0.092;
//        $RFC_Location_084_086::RFC_Loc085_RadialVelocityVnce = 0.0032;
//        $RFC_Location_084_086::RFC_Loc085_AzimuthalPartnerId = 1023;
        
//        /**
//          * Variable values
//          */
//        $RFC_Location_084_086::RFC_Loc085_RadialDistance = dllGetRadarFCLocRadialDistance(@hil_ctrl::Handle_RoadObj, object_id);
//        $RFC_Location_084_086::RFC_Loc085_RadialVelocity = dllGetRadarFCLocRadialVelocity(@hil_ctrl::Handle_RoadObj, object_id);
//        $RFC_Location_084_086::RFC_Loc085_Elevation = dllGetRadarFCLocElevationAngle(@hil_ctrl::Handle_RoadObj, object_id);
//        $RFC_Location_084_086::RFC_Loc085_Azimuth = dllGetRadarFCLocAzimuthAngle(@hil_ctrl::Handle_RoadObj, object_id) * 180 / PI;
//        $RFC_Location_084_086::RFC_Loc085_RadarCrossSection = dllGetRadarFCLocRCS(@hil_ctrl::Handle_RoadObj, object_id);
//        $RFC_Location_084_086::RFC_Loc085_RSSI = dllGetRadarFCLocRSSI(@hil_ctrl::Handle_RoadObj, object_id);
//        break;
        
//      case 86: //"Object-86"
//        /**
//          * Constant values
//          */
//        $RFC_Location_084_086::RFC_Loc086_RadialDistanceVnce = 0.017;
//        $RFC_Location_084_086::RFC_Loc086_DistVelocityCoVnce = 0.0076;
//        $RFC_Location_084_086::RFC_Loc086_DistVelocityQuality = 255;
//        $RFC_Location_084_086::RFC_Loc086_ElevationQuality = 255;
//        $RFC_Location_084_086::RFC_Loc086_ElevationVnce = 0.092;
//        $RFC_Location_084_086::RFC_Loc086_AzimuthQuality = 255;
//        $RFC_Location_084_086::RFC_Loc086_AzimuthVnce = 0.092;
//        $RFC_Location_084_086::RFC_Loc086_RadialVelocityVnce = 0.0032;
//        $RFC_Location_084_086::RFC_Loc086_AzimuthalPartnerId = 1023;
        
//        /**
//          * Variable values
//          */
//        $RFC_Location_084_086::RFC_Loc086_RadialDistance = dllGetRadarFCLocRadialDistance(@hil_ctrl::Handle_RoadObj, object_id);
//        $RFC_Location_084_086::RFC_Loc086_RadialVelocity = dllGetRadarFCLocRadialVelocity(@hil_ctrl::Handle_RoadObj, object_id);
//        $RFC_Location_084_086::RFC_Loc086_Elevation = dllGetRadarFCLocElevationAngle(@hil_ctrl::Handle_RoadObj, object_id);
//        $RFC_Location_084_086::RFC_Loc086_Azimuth = dllGetRadarFCLocAzimuthAngle(@hil_ctrl::Handle_RoadObj, object_id) * 180 / PI;
//        $RFC_Location_084_086::RFC_Loc086_RadarCrossSection = dllGetRadarFCLocRCS(@hil_ctrl::Handle_RoadObj, object_id);
//        $RFC_Location_084_086::RFC_Loc086_RSSI = dllGetRadarFCLocRSSI(@hil_ctrl::Handle_RoadObj, object_id);
//        break;
        
//      case 87: //"Object-87"
//        /**
//          * Constant values
//          */
//        $RFC_Location_087_089::RFC_Loc087_RadialDistanceVnce = 0.017;
//        $RFC_Location_087_089::RFC_Loc087_DistVelocityCoVnce = 0.0076;
//        $RFC_Location_087_089::RFC_Loc087_DistVelocityQuality = 255;
//        $RFC_Location_087_089::RFC_Loc087_ElevationQuality = 255;
//        $RFC_Location_087_089::RFC_Loc087_ElevationVnce = 0.092;
//        $RFC_Location_087_089::RFC_Loc087_AzimuthQuality = 255;
//        $RFC_Location_087_089::RFC_Loc087_AzimuthVnce = 0.092;
//        $RFC_Location_087_089::RFC_Loc087_RadialVelocityVnce = 0.0032;
//        $RFC_Location_087_089::RFC_Loc087_AzimuthalPartnerId = 1023;
        
//        /**
//          * Variable values
//          */
//        $RFC_Location_087_089::RFC_Loc087_RadialDistance = dllGetRadarFCLocRadialDistance(@hil_ctrl::Handle_RoadObj, object_id);
//        $RFC_Location_087_089::RFC_Loc087_RadialVelocity = dllGetRadarFCLocRadialVelocity(@hil_ctrl::Handle_RoadObj, object_id);
//        $RFC_Location_087_089::RFC_Loc087_Elevation = dllGetRadarFCLocElevationAngle(@hil_ctrl::Handle_RoadObj, object_id);
//        $RFC_Location_087_089::RFC_Loc087_Azimuth = dllGetRadarFCLocAzimuthAngle(@hil_ctrl::Handle_RoadObj, object_id) * 180 / PI;
//        $RFC_Location_087_089::RFC_Loc087_RadarCrossSection = dllGetRadarFCLocRCS(@hil_ctrl::Handle_RoadObj, object_id);
//        $RFC_Location_087_089::RFC_Loc087_RSSI = dllGetRadarFCLocRSSI(@hil_ctrl::Handle_RoadObj, object_id);
//        break;
        
//      case 88: //"Object-88"
//        /**
//          * Constant values
//          */
//        $RFC_Location_087_089::RFC_Loc088_RadialDistanceVnce = 0.017;
//        $RFC_Location_087_089::RFC_Loc088_DistVelocityCoVnce = 0.0076;
//        $RFC_Location_087_089::RFC_Loc088_DistVelocityQuality = 255;
//        $RFC_Location_087_089::RFC_Loc088_ElevationQuality = 255;
//        $RFC_Location_087_089::RFC_Loc088_ElevationVnce = 0.092;
//        $RFC_Location_087_089::RFC_Loc088_AzimuthQuality = 255;
//        $RFC_Location_087_089::RFC_Loc088_AzimuthVnce = 0.092;
//        $RFC_Location_087_089::RFC_Loc088_RadialVelocityVnce = 0.0032;
//        $RFC_Location_087_089::RFC_Loc088_AzimuthalPartnerId = 1023;
        
//        /**
//          * Variable values
//          */
//        $RFC_Location_087_089::RFC_Loc088_RadialDistance = dllGetRadarFCLocRadialDistance(@hil_ctrl::Handle_RoadObj, object_id);
//        $RFC_Location_087_089::RFC_Loc088_RadialVelocity = dllGetRadarFCLocRadialVelocity(@hil_ctrl::Handle_RoadObj, object_id);
//        $RFC_Location_087_089::RFC_Loc088_Elevation = dllGetRadarFCLocElevationAngle(@hil_ctrl::Handle_RoadObj, object_id);
//        $RFC_Location_087_089::RFC_Loc088_Azimuth = dllGetRadarFCLocAzimuthAngle(@hil_ctrl::Handle_RoadObj, object_id) * 180 / PI;
//        $RFC_Location_087_089::RFC_Loc088_RadarCrossSection = dllGetRadarFCLocRCS(@hil_ctrl::Handle_RoadObj, object_id);
//        $RFC_Location_087_089::RFC_Loc088_RSSI = dllGetRadarFCLocRSSI(@hil_ctrl::Handle_RoadObj, object_id);
//        break;
        
//      case 89: //"Object-89"
//        /**
//          * Constant values
//          */
//        $RFC_Location_087_089::RFC_Loc089_RadialDistanceVnce = 0.017;
//        $RFC_Location_087_089::RFC_Loc089_DistVelocityCoVnce = 0.0076;
//        $RFC_Location_087_089::RFC_Loc089_DistVelocityQuality = 255;
//        $RFC_Location_087_089::RFC_Loc089_ElevationQuality = 255;
//        $RFC_Location_087_089::RFC_Loc089_ElevationVnce = 0.092;
//        $RFC_Location_087_089::RFC_Loc089_AzimuthQuality = 255;
//        $RFC_Location_087_089::RFC_Loc089_AzimuthVnce = 0.092;
//        $RFC_Location_087_089::RFC_Loc089_RadialVelocityVnce = 0.0032;
//        $RFC_Location_087_089::RFC_Loc089_AzimuthalPartnerId = 1023;
        
//        /**
//          * Variable values
//          */
//        $RFC_Location_087_089::RFC_Loc089_RadialDistance = dllGetRadarFCLocRadialDistance(@hil_ctrl::Handle_RoadObj, object_id);
//        $RFC_Location_087_089::RFC_Loc089_RadialVelocity = dllGetRadarFCLocRadialVelocity(@hil_ctrl::Handle_RoadObj, object_id);
//        $RFC_Location_087_089::RFC_Loc089_Elevation = dllGetRadarFCLocElevationAngle(@hil_ctrl::Handle_RoadObj, object_id);
//        $RFC_Location_087_089::RFC_Loc089_Azimuth = dllGetRadarFCLocAzimuthAngle(@hil_ctrl::Handle_RoadObj, object_id) * 180 / PI;
//        $RFC_Location_087_089::RFC_Loc089_RadarCrossSection = dllGetRadarFCLocRCS(@hil_ctrl::Handle_RoadObj, object_id);
//        $RFC_Location_087_089::RFC_Loc089_RSSI = dllGetRadarFCLocRSSI(@hil_ctrl::Handle_RoadObj, object_id);
//        break;
        
//    }
//  }
//  else if(injection_method == 2)
//  { //Real sensor -> XCP
//    @sysvar::XCP::RadarFC_Loc::_g_PL_AD_fw_Radar_1R1V_rpc_LocBypassingRunnable_LocBypassingRunnable_m_pad_ensRLocationsPort_par_out_local::TChangeableMemPool::_::_::_m_arrayPool::_0_::_elem::_m_SensState::_DataMeasured = 1;
//    @sysvar::XCP::RadarFC_Loc::_g_PL_AD_fw_Radar_1R1V_rpc_LocBypassingRunnable_LocBypassingRunnable_m_pad_ensRLocationsPort_par_out_local::TChangeableMemPool::_::_::_m_arrayPool::_0_::_elem::_m_LocationList::_NumLocs = @target_radar_fc_sim::locdata.number_of_loc;
    
//    switch (injection_counter_radar_fc)
//    {
//      case 0: //"Object-0"
//        /**
//          * Constant values
//          */
//        @sysvar::XCP::RadarFC_Loc::_g_PL_AD_fw_Radar_1R1V_rpc_LocBypassingRunnable_LocBypassingRunnable_m_pad_ensRLocationsPort_par_out_local::TChangeableMemPool::_::_::_m_arrayPool::_0_::_elem::_m_LocationList::_Item::_0_::_dVar::_m_value = 0.012;
//        @sysvar::XCP::RadarFC_Loc::_g_PL_AD_fw_Radar_1R1V_rpc_LocBypassingRunnable_LocBypassingRunnable_m_pad_ensRLocationsPort_par_out_local::TChangeableMemPool::_::_::_m_arrayPool::_0_::_elem::_m_LocationList::_Item::_0_::_dvCov::_m_value = -0.005;
//        @sysvar::XCP::RadarFC_Loc::_g_PL_AD_fw_Radar_1R1V_rpc_LocBypassingRunnable_LocBypassingRunnable_m_pad_ensRLocationsPort_par_out_local::TChangeableMemPool::_::_::_m_arrayPool::_0_::_elem::_m_LocationList::_Item::_0_::_dvQly = 255;
//        @sysvar::XCP::RadarFC_Loc::_g_PL_AD_fw_Radar_1R1V_rpc_LocBypassingRunnable_LocBypassingRunnable_m_pad_ensRLocationsPort_par_out_local::TChangeableMemPool::_::_::_m_arrayPool::_0_::_elem::_m_LocationList::_Item::_0_::_phiQly = 0;
//        @sysvar::XCP::RadarFC_Loc::_g_PL_AD_fw_Radar_1R1V_rpc_LocBypassingRunnable_LocBypassingRunnable_m_pad_ensRLocationsPort_par_out_local::TChangeableMemPool::_::_::_m_arrayPool::_0_::_elem::_m_LocationList::_Item::_0_::_phiVar::_m_value = 0.002;
//        @sysvar::XCP::RadarFC_Loc::_g_PL_AD_fw_Radar_1R1V_rpc_LocBypassingRunnable_LocBypassingRunnable_m_pad_ensRLocationsPort_par_out_local::TChangeableMemPool::_::_::_m_arrayPool::_0_::_elem::_m_LocationList::_Item::_0_::_thetaQly = 1;
//        @sysvar::XCP::RadarFC_Loc::_g_PL_AD_fw_Radar_1R1V_rpc_LocBypassingRunnable_LocBypassingRunnable_m_pad_ensRLocationsPort_par_out_local::TChangeableMemPool::_::_::_m_arrayPool::_0_::_elem::_m_LocationList::_Item::_0_::_thetaVar::_m_value = 0.0012;
//        @sysvar::XCP::RadarFC_Loc::_g_PL_AD_fw_Radar_1R1V_rpc_LocBypassingRunnable_LocBypassingRunnable_m_pad_ensRLocationsPort_par_out_local::TChangeableMemPool::_::_::_m_arrayPool::_0_::_elem::_m_LocationList::_Item::_0_::_vVar::_m_value = 0.003;
//        @sysvar::XCP::RadarFC_Loc::_g_PL_AD_fw_Radar_1R1V_rpc_LocBypassingRunnable_LocBypassingRunnable_m_pad_ensRLocationsPort_par_out_local::TChangeableMemPool::_::_::_m_arrayPool::_0_::_elem::_m_LocationList::_Item::_0_::_Rssi::_m_value = 83;
//        @sysvar::XCP::RadarFC_Loc::_g_PL_AD_fw_Radar_1R1V_rpc_LocBypassingRunnable_LocBypassingRunnable_m_pad_ensRLocationsPort_par_out_local::TChangeableMemPool::_::_::_m_arrayPool::_0_::_elem::_m_LocationList::_Item::_0_::_idxAzimuthAmbiguityPeer = 65535;
//        @sysvar::XCP::RadarFC_Loc::_g_PL_AD_fw_Radar_1R1V_rpc_LocBypassingRunnable_LocBypassingRunnable_m_pad_ensRLocationsPort_par_out_local::TChangeableMemPool::_::_::_m_arrayPool::_0_::_elem::_m_LocationList::_Item::_0_::_measStatus = 9;
        
//        /**
//          * Variable values
//          */
//        @sysvar::XCP::RadarFC_Loc::_g_PL_AD_fw_Radar_1R1V_rpc_LocBypassingRunnable_LocBypassingRunnable_m_pad_ensRLocationsPort_par_out_local::TChangeableMemPool::_::_::_m_arrayPool::_0_::_elem::_m_LocationList::_Item::_0_::_d = dllGetRadarFCLocRadialDistance(@hil_ctrl::Handle_RoadObj, object_id);
//        @sysvar::XCP::RadarFC_Loc::_g_PL_AD_fw_Radar_1R1V_rpc_LocBypassingRunnable_LocBypassingRunnable_m_pad_ensRLocationsPort_par_out_local::TChangeableMemPool::_::_::_m_arrayPool::_0_::_elem::_m_LocationList::_Item::_0_::_v = dllGetRadarFCLocRadialVelocity(@hil_ctrl::Handle_RoadObj, object_id);
//        @sysvar::XCP::RadarFC_Loc::_g_PL_AD_fw_Radar_1R1V_rpc_LocBypassingRunnable_LocBypassingRunnable_m_pad_ensRLocationsPort_par_out_local::TChangeableMemPool::_::_::_m_arrayPool::_0_::_elem::_m_LocationList::_Item::_0_::_phi::_m_value = dllGetRadarFCLocElevationAngle(@hil_ctrl::Handle_RoadObj, object_id);
//        @sysvar::XCP::RadarFC_Loc::_g_PL_AD_fw_Radar_1R1V_rpc_LocBypassingRunnable_LocBypassingRunnable_m_pad_ensRLocationsPort_par_out_local::TChangeableMemPool::_::_::_m_arrayPool::_0_::_elem::_m_LocationList::_Item::_0_::_theta::_m_value = dllGetRadarFCLocAzimuthAngle(@hil_ctrl::Handle_RoadObj, object_id) * 180 / PI;
//        @sysvar::XCP::RadarFC_Loc::_g_PL_AD_fw_Radar_1R1V_rpc_LocBypassingRunnable_LocBypassingRunnable_m_pad_ensRLocationsPort_par_out_local::TChangeableMemPool::_::_::_m_arrayPool::_0_::_elem::_m_LocationList::_Item::_0_::_Rcs::_m_value = dllGetRadarFCLocRCS(@hil_ctrl::Handle_RoadObj, object_id);
//        break;
        
//      case 1: //"Object-1"
//        /**
//          * Constant values
//          */
//        @sysvar::XCP::RadarFC_Loc::_g_PL_AD_fw_Radar_1R1V_rpc_LocBypassingRunnable_LocBypassingRunnable_m_pad_ensRLocationsPort_par_out_local::TChangeableMemPool::_::_::_m_arrayPool::_0_::_elem::_m_LocationList::_Item::_1_::_dVar::_m_value = 0.012;
//        @sysvar::XCP::RadarFC_Loc::_g_PL_AD_fw_Radar_1R1V_rpc_LocBypassingRunnable_LocBypassingRunnable_m_pad_ensRLocationsPort_par_out_local::TChangeableMemPool::_::_::_m_arrayPool::_0_::_elem::_m_LocationList::_Item::_1_::_dvCov::_m_value = -0.005;
//        @sysvar::XCP::RadarFC_Loc::_g_PL_AD_fw_Radar_1R1V_rpc_LocBypassingRunnable_LocBypassingRunnable_m_pad_ensRLocationsPort_par_out_local::TChangeableMemPool::_::_::_m_arrayPool::_0_::_elem::_m_LocationList::_Item::_1_::_dvQly = 255;
//        @sysvar::XCP::RadarFC_Loc::_g_PL_AD_fw_Radar_1R1V_rpc_LocBypassingRunnable_LocBypassingRunnable_m_pad_ensRLocationsPort_par_out_local::TChangeableMemPool::_::_::_m_arrayPool::_0_::_elem::_m_LocationList::_Item::_1_::_phiQly = 0;
//        @sysvar::XCP::RadarFC_Loc::_g_PL_AD_fw_Radar_1R1V_rpc_LocBypassingRunnable_LocBypassingRunnable_m_pad_ensRLocationsPort_par_out_local::TChangeableMemPool::_::_::_m_arrayPool::_0_::_elem::_m_LocationList::_Item::_1_::_phiVar::_m_value = 0.002;
//        @sysvar::XCP::RadarFC_Loc::_g_PL_AD_fw_Radar_1R1V_rpc_LocBypassingRunnable_LocBypassingRunnable_m_pad_ensRLocationsPort_par_out_local::TChangeableMemPool::_::_::_m_arrayPool::_0_::_elem::_m_LocationList::_Item::_1_::_thetaQly = 1;
//        @sysvar::XCP::RadarFC_Loc::_g_PL_AD_fw_Radar_1R1V_rpc_LocBypassingRunnable_LocBypassingRunnable_m_pad_ensRLocationsPort_par_out_local::TChangeableMemPool::_::_::_m_arrayPool::_0_::_elem::_m_LocationList::_Item::_1_::_thetaVar::_m_value = 0.0012;
//        @sysvar::XCP::RadarFC_Loc::_g_PL_AD_fw_Radar_1R1V_rpc_LocBypassingRunnable_LocBypassingRunnable_m_pad_ensRLocationsPort_par_out_local::TChangeableMemPool::_::_::_m_arrayPool::_0_::_elem::_m_LocationList::_Item::_1_::_vVar::_m_value = 0.003;
//        @sysvar::XCP::RadarFC_Loc::_g_PL_AD_fw_Radar_1R1V_rpc_LocBypassingRunnable_LocBypassingRunnable_m_pad_ensRLocationsPort_par_out_local::TChangeableMemPool::_::_::_m_arrayPool::_0_::_elem::_m_LocationList::_Item::_1_::_Rssi::_m_value = 83;
//        @sysvar::XCP::RadarFC_Loc::_g_PL_AD_fw_Radar_1R1V_rpc_LocBypassingRunnable_LocBypassingRunnable_m_pad_ensRLocationsPort_par_out_local::TChangeableMemPool::_::_::_m_arrayPool::_0_::_elem::_m_LocationList::_Item::_1_::_idxAzimuthAmbiguityPeer = 65535;
//        @sysvar::XCP::RadarFC_Loc::_g_PL_AD_fw_Radar_1R1V_rpc_LocBypassingRunnable_LocBypassingRunnable_m_pad_ensRLocationsPort_par_out_local::TChangeableMemPool::_::_::_m_arrayPool::_0_::_elem::_m_LocationList::_Item::_1_::_measStatus = 9;
        
//        /**
//          * Variable values
//          */
//        @sysvar::XCP::RadarFC_Loc::_g_PL_AD_fw_Radar_1R1V_rpc_LocBypassingRunnable_LocBypassingRunnable_m_pad_ensRLocationsPort_par_out_local::TChangeableMemPool::_::_::_m_arrayPool::_0_::_elem::_m_LocationList::_Item::_1_::_d = dllGetRadarFCLocRadialDistance(@hil_ctrl::Handle_RoadObj, object_id);
//        @sysvar::XCP::RadarFC_Loc::_g_PL_AD_fw_Radar_1R1V_rpc_LocBypassingRunnable_LocBypassingRunnable_m_pad_ensRLocationsPort_par_out_local::TChangeableMemPool::_::_::_m_arrayPool::_0_::_elem::_m_LocationList::_Item::_1_::_v = dllGetRadarFCLocRadialVelocity(@hil_ctrl::Handle_RoadObj, object_id);
//        @sysvar::XCP::RadarFC_Loc::_g_PL_AD_fw_Radar_1R1V_rpc_LocBypassingRunnable_LocBypassingRunnable_m_pad_ensRLocationsPort_par_out_local::TChangeableMemPool::_::_::_m_arrayPool::_0_::_elem::_m_LocationList::_Item::_1_::_phi::_m_value = dllGetRadarFCLocElevationAngle(@hil_ctrl::Handle_RoadObj, object_id);
//        @sysvar::XCP::RadarFC_Loc::_g_PL_AD_fw_Radar_1R1V_rpc_LocBypassingRunnable_LocBypassingRunnable_m_pad_ensRLocationsPort_par_out_local::TChangeableMemPool::_::_::_m_arrayPool::_0_::_elem::_m_LocationList::_Item::_1_::_theta::_m_value = dllGetRadarFCLocAzimuthAngle(@hil_ctrl::Handle_RoadObj, object_id) * 180 / PI;
//        @sysvar::XCP::RadarFC_Loc::_g_PL_AD_fw_Radar_1R1V_rpc_LocBypassingRunnable_LocBypassingRunnable_m_pad_ensRLocationsPort_par_out_local::TChangeableMemPool::_::_::_m_arrayPool::_0_::_elem::_m_LocationList::_Item::_1_::_Rcs::_m_value = dllGetRadarFCLocRCS(@hil_ctrl::Handle_RoadObj, object_id);
//        break;
        
//      case 2: //"Object-2"
//        /**
//          * Constant values
//          */
//        @sysvar::XCP::RadarFC_Loc::_g_PL_AD_fw_Radar_1R1V_rpc_LocBypassingRunnable_LocBypassingRunnable_m_pad_ensRLocationsPort_par_out_local::TChangeableMemPool::_::_::_m_arrayPool::_0_::_elem::_m_LocationList::_Item::_2_::_dVar::_m_value = 0.012;
//        @sysvar::XCP::RadarFC_Loc::_g_PL_AD_fw_Radar_1R1V_rpc_LocBypassingRunnable_LocBypassingRunnable_m_pad_ensRLocationsPort_par_out_local::TChangeableMemPool::_::_::_m_arrayPool::_0_::_elem::_m_LocationList::_Item::_2_::_dvCov::_m_value = -0.005;
//        @sysvar::XCP::RadarFC_Loc::_g_PL_AD_fw_Radar_1R1V_rpc_LocBypassingRunnable_LocBypassingRunnable_m_pad_ensRLocationsPort_par_out_local::TChangeableMemPool::_::_::_m_arrayPool::_0_::_elem::_m_LocationList::_Item::_2_::_dvQly = 255;
//        @sysvar::XCP::RadarFC_Loc::_g_PL_AD_fw_Radar_1R1V_rpc_LocBypassingRunnable_LocBypassingRunnable_m_pad_ensRLocationsPort_par_out_local::TChangeableMemPool::_::_::_m_arrayPool::_0_::_elem::_m_LocationList::_Item::_2_::_phiQly = 0;
//        @sysvar::XCP::RadarFC_Loc::_g_PL_AD_fw_Radar_1R1V_rpc_LocBypassingRunnable_LocBypassingRunnable_m_pad_ensRLocationsPort_par_out_local::TChangeableMemPool::_::_::_m_arrayPool::_0_::_elem::_m_LocationList::_Item::_2_::_phiVar::_m_value = 0.002;
//        @sysvar::XCP::RadarFC_Loc::_g_PL_AD_fw_Radar_1R1V_rpc_LocBypassingRunnable_LocBypassingRunnable_m_pad_ensRLocationsPort_par_out_local::TChangeableMemPool::_::_::_m_arrayPool::_0_::_elem::_m_LocationList::_Item::_2_::_thetaQly = 1;
//        @sysvar::XCP::RadarFC_Loc::_g_PL_AD_fw_Radar_1R1V_rpc_LocBypassingRunnable_LocBypassingRunnable_m_pad_ensRLocationsPort_par_out_local::TChangeableMemPool::_::_::_m_arrayPool::_0_::_elem::_m_LocationList::_Item::_2_::_thetaVar::_m_value = 0.0012;
//        @sysvar::XCP::RadarFC_Loc::_g_PL_AD_fw_Radar_1R1V_rpc_LocBypassingRunnable_LocBypassingRunnable_m_pad_ensRLocationsPort_par_out_local::TChangeableMemPool::_::_::_m_arrayPool::_0_::_elem::_m_LocationList::_Item::_2_::_vVar::_m_value = 0.003;
//        @sysvar::XCP::RadarFC_Loc::_g_PL_AD_fw_Radar_1R1V_rpc_LocBypassingRunnable_LocBypassingRunnable_m_pad_ensRLocationsPort_par_out_local::TChangeableMemPool::_::_::_m_arrayPool::_0_::_elem::_m_LocationList::_Item::_2_::_Rssi::_m_value = 83;
//        @sysvar::XCP::RadarFC_Loc::_g_PL_AD_fw_Radar_1R1V_rpc_LocBypassingRunnable_LocBypassingRunnable_m_pad_ensRLocationsPort_par_out_local::TChangeableMemPool::_::_::_m_arrayPool::_0_::_elem::_m_LocationList::_Item::_2_::_idxAzimuthAmbiguityPeer = 65535;
//        @sysvar::XCP::RadarFC_Loc::_g_PL_AD_fw_Radar_1R1V_rpc_LocBypassingRunnable_LocBypassingRunnable_m_pad_ensRLocationsPort_par_out_local::TChangeableMemPool::_::_::_m_arrayPool::_0_::_elem::_m_LocationList::_Item::_2_::_measStatus = 9;
        
//        /**
//          * Variable values
//          */
//        @sysvar::XCP::RadarFC_Loc::_g_PL_AD_fw_Radar_1R1V_rpc_LocBypassingRunnable_LocBypassingRunnable_m_pad_ensRLocationsPort_par_out_local::TChangeableMemPool::_::_::_m_arrayPool::_0_::_elem::_m_LocationList::_Item::_2_::_d = dllGetRadarFCLocRadialDistance(@hil_ctrl::Handle_RoadObj, object_id);
//        @sysvar::XCP::RadarFC_Loc::_g_PL_AD_fw_Radar_1R1V_rpc_LocBypassingRunnable_LocBypassingRunnable_m_pad_ensRLocationsPort_par_out_local::TChangeableMemPool::_::_::_m_arrayPool::_0_::_elem::_m_LocationList::_Item::_2_::_v = dllGetRadarFCLocRadialVelocity(@hil_ctrl::Handle_RoadObj, object_id);
//        @sysvar::XCP::RadarFC_Loc::_g_PL_AD_fw_Radar_1R1V_rpc_LocBypassingRunnable_LocBypassingRunnable_m_pad_ensRLocationsPort_par_out_local::TChangeableMemPool::_::_::_m_arrayPool::_0_::_elem::_m_LocationList::_Item::_2_::_phi::_m_value = dllGetRadarFCLocElevationAngle(@hil_ctrl::Handle_RoadObj, object_id);
//        @sysvar::XCP::RadarFC_Loc::_g_PL_AD_fw_Radar_1R1V_rpc_LocBypassingRunnable_LocBypassingRunnable_m_pad_ensRLocationsPort_par_out_local::TChangeableMemPool::_::_::_m_arrayPool::_0_::_elem::_m_LocationList::_Item::_2_::_theta::_m_value = dllGetRadarFCLocAzimuthAngle(@hil_ctrl::Handle_RoadObj, object_id) * 180 / PI;
//        @sysvar::XCP::RadarFC_Loc::_g_PL_AD_fw_Radar_1R1V_rpc_LocBypassingRunnable_LocBypassingRunnable_m_pad_ensRLocationsPort_par_out_local::TChangeableMemPool::_::_::_m_arrayPool::_0_::_elem::_m_LocationList::_Item::_2_::_Rcs::_m_value = dllGetRadarFCLocRCS(@hil_ctrl::Handle_RoadObj, object_id);
//        break;
        
//      case 3: //"Object-3"
//        /**
//          * Constant values
//          */
//        @sysvar::XCP::RadarFC_Loc::_g_PL_AD_fw_Radar_1R1V_rpc_LocBypassingRunnable_LocBypassingRunnable_m_pad_ensRLocationsPort_par_out_local::TChangeableMemPool::_::_::_m_arrayPool::_0_::_elem::_m_LocationList::_Item::_3_::_dVar::_m_value = 0.012;
//        @sysvar::XCP::RadarFC_Loc::_g_PL_AD_fw_Radar_1R1V_rpc_LocBypassingRunnable_LocBypassingRunnable_m_pad_ensRLocationsPort_par_out_local::TChangeableMemPool::_::_::_m_arrayPool::_0_::_elem::_m_LocationList::_Item::_3_::_dvCov::_m_value = -0.005;
//        @sysvar::XCP::RadarFC_Loc::_g_PL_AD_fw_Radar_1R1V_rpc_LocBypassingRunnable_LocBypassingRunnable_m_pad_ensRLocationsPort_par_out_local::TChangeableMemPool::_::_::_m_arrayPool::_0_::_elem::_m_LocationList::_Item::_3_::_dvQly = 255;
//        @sysvar::XCP::RadarFC_Loc::_g_PL_AD_fw_Radar_1R1V_rpc_LocBypassingRunnable_LocBypassingRunnable_m_pad_ensRLocationsPort_par_out_local::TChangeableMemPool::_::_::_m_arrayPool::_0_::_elem::_m_LocationList::_Item::_3_::_phiQly = 0;
//        @sysvar::XCP::RadarFC_Loc::_g_PL_AD_fw_Radar_1R1V_rpc_LocBypassingRunnable_LocBypassingRunnable_m_pad_ensRLocationsPort_par_out_local::TChangeableMemPool::_::_::_m_arrayPool::_0_::_elem::_m_LocationList::_Item::_3_::_phiVar::_m_value = 0.002;
//        @sysvar::XCP::RadarFC_Loc::_g_PL_AD_fw_Radar_1R1V_rpc_LocBypassingRunnable_LocBypassingRunnable_m_pad_ensRLocationsPort_par_out_local::TChangeableMemPool::_::_::_m_arrayPool::_0_::_elem::_m_LocationList::_Item::_3_::_thetaQly = 1;
//        @sysvar::XCP::RadarFC_Loc::_g_PL_AD_fw_Radar_1R1V_rpc_LocBypassingRunnable_LocBypassingRunnable_m_pad_ensRLocationsPort_par_out_local::TChangeableMemPool::_::_::_m_arrayPool::_0_::_elem::_m_LocationList::_Item::_3_::_thetaVar::_m_value = 0.0012;
//        @sysvar::XCP::RadarFC_Loc::_g_PL_AD_fw_Radar_1R1V_rpc_LocBypassingRunnable_LocBypassingRunnable_m_pad_ensRLocationsPort_par_out_local::TChangeableMemPool::_::_::_m_arrayPool::_0_::_elem::_m_LocationList::_Item::_3_::_vVar::_m_value = 0.003;
//        @sysvar::XCP::RadarFC_Loc::_g_PL_AD_fw_Radar_1R1V_rpc_LocBypassingRunnable_LocBypassingRunnable_m_pad_ensRLocationsPort_par_out_local::TChangeableMemPool::_::_::_m_arrayPool::_0_::_elem::_m_LocationList::_Item::_3_::_Rssi::_m_value = 83;
//        @sysvar::XCP::RadarFC_Loc::_g_PL_AD_fw_Radar_1R1V_rpc_LocBypassingRunnable_LocBypassingRunnable_m_pad_ensRLocationsPort_par_out_local::TChangeableMemPool::_::_::_m_arrayPool::_0_::_elem::_m_LocationList::_Item::_3_::_idxAzimuthAmbiguityPeer = 65535;
//        @sysvar::XCP::RadarFC_Loc::_g_PL_AD_fw_Radar_1R1V_rpc_LocBypassingRunnable_LocBypassingRunnable_m_pad_ensRLocationsPort_par_out_local::TChangeableMemPool::_::_::_m_arrayPool::_0_::_elem::_m_LocationList::_Item::_3_::_measStatus = 9;
        
//        /**
//          * Variable values
//          */
//        @sysvar::XCP::RadarFC_Loc::_g_PL_AD_fw_Radar_1R1V_rpc_LocBypassingRunnable_LocBypassingRunnable_m_pad_ensRLocationsPort_par_out_local::TChangeableMemPool::_::_::_m_arrayPool::_0_::_elem::_m_LocationList::_Item::_3_::_d = dllGetRadarFCLocRadialDistance(@hil_ctrl::Handle_RoadObj, object_id);
//        @sysvar::XCP::RadarFC_Loc::_g_PL_AD_fw_Radar_1R1V_rpc_LocBypassingRunnable_LocBypassingRunnable_m_pad_ensRLocationsPort_par_out_local::TChangeableMemPool::_::_::_m_arrayPool::_0_::_elem::_m_LocationList::_Item::_3_::_v = dllGetRadarFCLocRadialVelocity(@hil_ctrl::Handle_RoadObj, object_id);
//        @sysvar::XCP::RadarFC_Loc::_g_PL_AD_fw_Radar_1R1V_rpc_LocBypassingRunnable_LocBypassingRunnable_m_pad_ensRLocationsPort_par_out_local::TChangeableMemPool::_::_::_m_arrayPool::_0_::_elem::_m_LocationList::_Item::_3_::_phi::_m_value = dllGetRadarFCLocElevationAngle(@hil_ctrl::Handle_RoadObj, object_id);
//        @sysvar::XCP::RadarFC_Loc::_g_PL_AD_fw_Radar_1R1V_rpc_LocBypassingRunnable_LocBypassingRunnable_m_pad_ensRLocationsPort_par_out_local::TChangeableMemPool::_::_::_m_arrayPool::_0_::_elem::_m_LocationList::_Item::_3_::_theta::_m_value = dllGetRadarFCLocAzimuthAngle(@hil_ctrl::Handle_RoadObj, object_id) * 180 / PI;
//        @sysvar::XCP::RadarFC_Loc::_g_PL_AD_fw_Radar_1R1V_rpc_LocBypassingRunnable_LocBypassingRunnable_m_pad_ensRLocationsPort_par_out_local::TChangeableMemPool::_::_::_m_arrayPool::_0_::_elem::_m_LocationList::_Item::_3_::_Rcs::_m_value = dllGetRadarFCLocRCS(@hil_ctrl::Handle_RoadObj, object_id);
//        break;
        
//      case 4: //"Object-4"
//        /**
//          * Constant values
//          */
//        @sysvar::XCP::RadarFC_Loc::_g_PL_AD_fw_Radar_1R1V_rpc_LocBypassingRunnable_LocBypassingRunnable_m_pad_ensRLocationsPort_par_out_local::TChangeableMemPool::_::_::_m_arrayPool::_0_::_elem::_m_LocationList::_Item::_4_::_dVar::_m_value = 0.012;
//        @sysvar::XCP::RadarFC_Loc::_g_PL_AD_fw_Radar_1R1V_rpc_LocBypassingRunnable_LocBypassingRunnable_m_pad_ensRLocationsPort_par_out_local::TChangeableMemPool::_::_::_m_arrayPool::_0_::_elem::_m_LocationList::_Item::_4_::_dvCov::_m_value = -0.005;
//        @sysvar::XCP::RadarFC_Loc::_g_PL_AD_fw_Radar_1R1V_rpc_LocBypassingRunnable_LocBypassingRunnable_m_pad_ensRLocationsPort_par_out_local::TChangeableMemPool::_::_::_m_arrayPool::_0_::_elem::_m_LocationList::_Item::_4_::_dvQly = 255;
//        @sysvar::XCP::RadarFC_Loc::_g_PL_AD_fw_Radar_1R1V_rpc_LocBypassingRunnable_LocBypassingRunnable_m_pad_ensRLocationsPort_par_out_local::TChangeableMemPool::_::_::_m_arrayPool::_0_::_elem::_m_LocationList::_Item::_4_::_phiQly = 0;
//        @sysvar::XCP::RadarFC_Loc::_g_PL_AD_fw_Radar_1R1V_rpc_LocBypassingRunnable_LocBypassingRunnable_m_pad_ensRLocationsPort_par_out_local::TChangeableMemPool::_::_::_m_arrayPool::_0_::_elem::_m_LocationList::_Item::_4_::_phiVar::_m_value = 0.002;
//        @sysvar::XCP::RadarFC_Loc::_g_PL_AD_fw_Radar_1R1V_rpc_LocBypassingRunnable_LocBypassingRunnable_m_pad_ensRLocationsPort_par_out_local::TChangeableMemPool::_::_::_m_arrayPool::_0_::_elem::_m_LocationList::_Item::_4_::_thetaQly = 1;
//        @sysvar::XCP::RadarFC_Loc::_g_PL_AD_fw_Radar_1R1V_rpc_LocBypassingRunnable_LocBypassingRunnable_m_pad_ensRLocationsPort_par_out_local::TChangeableMemPool::_::_::_m_arrayPool::_0_::_elem::_m_LocationList::_Item::_4_::_thetaVar::_m_value = 0.0012;
//        @sysvar::XCP::RadarFC_Loc::_g_PL_AD_fw_Radar_1R1V_rpc_LocBypassingRunnable_LocBypassingRunnable_m_pad_ensRLocationsPort_par_out_local::TChangeableMemPool::_::_::_m_arrayPool::_0_::_elem::_m_LocationList::_Item::_4_::_vVar::_m_value = 0.003;
//        @sysvar::XCP::RadarFC_Loc::_g_PL_AD_fw_Radar_1R1V_rpc_LocBypassingRunnable_LocBypassingRunnable_m_pad_ensRLocationsPort_par_out_local::TChangeableMemPool::_::_::_m_arrayPool::_0_::_elem::_m_LocationList::_Item::_4_::_Rssi::_m_value = 83;
//        @sysvar::XCP::RadarFC_Loc::_g_PL_AD_fw_Radar_1R1V_rpc_LocBypassingRunnable_LocBypassingRunnable_m_pad_ensRLocationsPort_par_out_local::TChangeableMemPool::_::_::_m_arrayPool::_0_::_elem::_m_LocationList::_Item::_4_::_idxAzimuthAmbiguityPeer = 65535;
//        @sysvar::XCP::RadarFC_Loc::_g_PL_AD_fw_Radar_1R1V_rpc_LocBypassingRunnable_LocBypassingRunnable_m_pad_ensRLocationsPort_par_out_local::TChangeableMemPool::_::_::_m_arrayPool::_0_::_elem::_m_LocationList::_Item::_4_::_measStatus = 9;
        
//        /**
//          * Variable values
//          */
//        @sysvar::XCP::RadarFC_Loc::_g_PL_AD_fw_Radar_1R1V_rpc_LocBypassingRunnable_LocBypassingRunnable_m_pad_ensRLocationsPort_par_out_local::TChangeableMemPool::_::_::_m_arrayPool::_0_::_elem::_m_LocationList::_Item::_4_::_d = dllGetRadarFCLocRadialDistance(@hil_ctrl::Handle_RoadObj, object_id);
//        @sysvar::XCP::RadarFC_Loc::_g_PL_AD_fw_Radar_1R1V_rpc_LocBypassingRunnable_LocBypassingRunnable_m_pad_ensRLocationsPort_par_out_local::TChangeableMemPool::_::_::_m_arrayPool::_0_::_elem::_m_LocationList::_Item::_4_::_v = dllGetRadarFCLocRadialVelocity(@hil_ctrl::Handle_RoadObj, object_id);
//        @sysvar::XCP::RadarFC_Loc::_g_PL_AD_fw_Radar_1R1V_rpc_LocBypassingRunnable_LocBypassingRunnable_m_pad_ensRLocationsPort_par_out_local::TChangeableMemPool::_::_::_m_arrayPool::_0_::_elem::_m_LocationList::_Item::_4_::_phi::_m_value = dllGetRadarFCLocElevationAngle(@hil_ctrl::Handle_RoadObj, object_id);
//        @sysvar::XCP::RadarFC_Loc::_g_PL_AD_fw_Radar_1R1V_rpc_LocBypassingRunnable_LocBypassingRunnable_m_pad_ensRLocationsPort_par_out_local::TChangeableMemPool::_::_::_m_arrayPool::_0_::_elem::_m_LocationList::_Item::_4_::_theta::_m_value = dllGetRadarFCLocAzimuthAngle(@hil_ctrl::Handle_RoadObj, object_id) * 180 / PI;
//        @sysvar::XCP::RadarFC_Loc::_g_PL_AD_fw_Radar_1R1V_rpc_LocBypassingRunnable_LocBypassingRunnable_m_pad_ensRLocationsPort_par_out_local::TChangeableMemPool::_::_::_m_arrayPool::_0_::_elem::_m_LocationList::_Item::_4_::_Rcs::_m_value = dllGetRadarFCLocRCS(@hil_ctrl::Handle_RoadObj, object_id);
//        break;
        
//      case 5: //"Object-5"
//        /**
//          * Constant values
//          */
//        @sysvar::XCP::RadarFC_Loc::_g_PL_AD_fw_Radar_1R1V_rpc_LocBypassingRunnable_LocBypassingRunnable_m_pad_ensRLocationsPort_par_out_local::TChangeableMemPool::_::_::_m_arrayPool::_0_::_elem::_m_LocationList::_Item::_5_::_dVar::_m_value = 0.012;
//        @sysvar::XCP::RadarFC_Loc::_g_PL_AD_fw_Radar_1R1V_rpc_LocBypassingRunnable_LocBypassingRunnable_m_pad_ensRLocationsPort_par_out_local::TChangeableMemPool::_::_::_m_arrayPool::_0_::_elem::_m_LocationList::_Item::_5_::_dvCov::_m_value = -0.005;
//        @sysvar::XCP::RadarFC_Loc::_g_PL_AD_fw_Radar_1R1V_rpc_LocBypassingRunnable_LocBypassingRunnable_m_pad_ensRLocationsPort_par_out_local::TChangeableMemPool::_::_::_m_arrayPool::_0_::_elem::_m_LocationList::_Item::_5_::_dvQly = 255;
//        @sysvar::XCP::RadarFC_Loc::_g_PL_AD_fw_Radar_1R1V_rpc_LocBypassingRunnable_LocBypassingRunnable_m_pad_ensRLocationsPort_par_out_local::TChangeableMemPool::_::_::_m_arrayPool::_0_::_elem::_m_LocationList::_Item::_5_::_phiQly = 0;
//        @sysvar::XCP::RadarFC_Loc::_g_PL_AD_fw_Radar_1R1V_rpc_LocBypassingRunnable_LocBypassingRunnable_m_pad_ensRLocationsPort_par_out_local::TChangeableMemPool::_::_::_m_arrayPool::_0_::_elem::_m_LocationList::_Item::_5_::_phiVar::_m_value = 0.002;
//        @sysvar::XCP::RadarFC_Loc::_g_PL_AD_fw_Radar_1R1V_rpc_LocBypassingRunnable_LocBypassingRunnable_m_pad_ensRLocationsPort_par_out_local::TChangeableMemPool::_::_::_m_arrayPool::_0_::_elem::_m_LocationList::_Item::_5_::_thetaQly = 1;
//        @sysvar::XCP::RadarFC_Loc::_g_PL_AD_fw_Radar_1R1V_rpc_LocBypassingRunnable_LocBypassingRunnable_m_pad_ensRLocationsPort_par_out_local::TChangeableMemPool::_::_::_m_arrayPool::_0_::_elem::_m_LocationList::_Item::_5_::_thetaVar::_m_value = 0.0012;
//        @sysvar::XCP::RadarFC_Loc::_g_PL_AD_fw_Radar_1R1V_rpc_LocBypassingRunnable_LocBypassingRunnable_m_pad_ensRLocationsPort_par_out_local::TChangeableMemPool::_::_::_m_arrayPool::_0_::_elem::_m_LocationList::_Item::_5_::_vVar::_m_value = 0.003;
//        @sysvar::XCP::RadarFC_Loc::_g_PL_AD_fw_Radar_1R1V_rpc_LocBypassingRunnable_LocBypassingRunnable_m_pad_ensRLocationsPort_par_out_local::TChangeableMemPool::_::_::_m_arrayPool::_0_::_elem::_m_LocationList::_Item::_5_::_Rssi::_m_value = 83;
//        @sysvar::XCP::RadarFC_Loc::_g_PL_AD_fw_Radar_1R1V_rpc_LocBypassingRunnable_LocBypassingRunnable_m_pad_ensRLocationsPort_par_out_local::TChangeableMemPool::_::_::_m_arrayPool::_0_::_elem::_m_LocationList::_Item::_5_::_idxAzimuthAmbiguityPeer = 65535;
//        @sysvar::XCP::RadarFC_Loc::_g_PL_AD_fw_Radar_1R1V_rpc_LocBypassingRunnable_LocBypassingRunnable_m_pad_ensRLocationsPort_par_out_local::TChangeableMemPool::_::_::_m_arrayPool::_0_::_elem::_m_LocationList::_Item::_5_::_measStatus = 9;
        
//        /**
//          * Variable values
//          */
//        @sysvar::XCP::RadarFC_Loc::_g_PL_AD_fw_Radar_1R1V_rpc_LocBypassingRunnable_LocBypassingRunnable_m_pad_ensRLocationsPort_par_out_local::TChangeableMemPool::_::_::_m_arrayPool::_0_::_elem::_m_LocationList::_Item::_5_::_d = dllGetRadarFCLocRadialDistance(@hil_ctrl::Handle_RoadObj, object_id);
//        @sysvar::XCP::RadarFC_Loc::_g_PL_AD_fw_Radar_1R1V_rpc_LocBypassingRunnable_LocBypassingRunnable_m_pad_ensRLocationsPort_par_out_local::TChangeableMemPool::_::_::_m_arrayPool::_0_::_elem::_m_LocationList::_Item::_5_::_v = dllGetRadarFCLocRadialVelocity(@hil_ctrl::Handle_RoadObj, object_id);
//        @sysvar::XCP::RadarFC_Loc::_g_PL_AD_fw_Radar_1R1V_rpc_LocBypassingRunnable_LocBypassingRunnable_m_pad_ensRLocationsPort_par_out_local::TChangeableMemPool::_::_::_m_arrayPool::_0_::_elem::_m_LocationList::_Item::_5_::_phi::_m_value = dllGetRadarFCLocElevationAngle(@hil_ctrl::Handle_RoadObj, object_id);
//        @sysvar::XCP::RadarFC_Loc::_g_PL_AD_fw_Radar_1R1V_rpc_LocBypassingRunnable_LocBypassingRunnable_m_pad_ensRLocationsPort_par_out_local::TChangeableMemPool::_::_::_m_arrayPool::_0_::_elem::_m_LocationList::_Item::_5_::_theta::_m_value = dllGetRadarFCLocAzimuthAngle(@hil_ctrl::Handle_RoadObj, object_id) * 180 / PI;
//        @sysvar::XCP::RadarFC_Loc::_g_PL_AD_fw_Radar_1R1V_rpc_LocBypassingRunnable_LocBypassingRunnable_m_pad_ensRLocationsPort_par_out_local::TChangeableMemPool::_::_::_m_arrayPool::_0_::_elem::_m_LocationList::_Item::_5_::_Rcs::_m_value = dllGetRadarFCLocRCS(@hil_ctrl::Handle_RoadObj, object_id);
//        break;
        
//      case 6: //"Object-6"
//        /**
//          * Constant values
//          */
//        @sysvar::XCP::RadarFC_Loc::_g_PL_AD_fw_Radar_1R1V_rpc_LocBypassingRunnable_LocBypassingRunnable_m_pad_ensRLocationsPort_par_out_local::TChangeableMemPool::_::_::_m_arrayPool::_0_::_elem::_m_LocationList::_Item::_6_::_dVar::_m_value = 0.012;
//        @sysvar::XCP::RadarFC_Loc::_g_PL_AD_fw_Radar_1R1V_rpc_LocBypassingRunnable_LocBypassingRunnable_m_pad_ensRLocationsPort_par_out_local::TChangeableMemPool::_::_::_m_arrayPool::_0_::_elem::_m_LocationList::_Item::_6_::_dvCov::_m_value = -0.005;
//        @sysvar::XCP::RadarFC_Loc::_g_PL_AD_fw_Radar_1R1V_rpc_LocBypassingRunnable_LocBypassingRunnable_m_pad_ensRLocationsPort_par_out_local::TChangeableMemPool::_::_::_m_arrayPool::_0_::_elem::_m_LocationList::_Item::_6_::_dvQly = 255;
//        @sysvar::XCP::RadarFC_Loc::_g_PL_AD_fw_Radar_1R1V_rpc_LocBypassingRunnable_LocBypassingRunnable_m_pad_ensRLocationsPort_par_out_local::TChangeableMemPool::_::_::_m_arrayPool::_0_::_elem::_m_LocationList::_Item::_6_::_phiQly = 0;
//        @sysvar::XCP::RadarFC_Loc::_g_PL_AD_fw_Radar_1R1V_rpc_LocBypassingRunnable_LocBypassingRunnable_m_pad_ensRLocationsPort_par_out_local::TChangeableMemPool::_::_::_m_arrayPool::_0_::_elem::_m_LocationList::_Item::_6_::_phiVar::_m_value = 0.002;
//        @sysvar::XCP::RadarFC_Loc::_g_PL_AD_fw_Radar_1R1V_rpc_LocBypassingRunnable_LocBypassingRunnable_m_pad_ensRLocationsPort_par_out_local::TChangeableMemPool::_::_::_m_arrayPool::_0_::_elem::_m_LocationList::_Item::_6_::_thetaQly = 1;
//        @sysvar::XCP::RadarFC_Loc::_g_PL_AD_fw_Radar_1R1V_rpc_LocBypassingRunnable_LocBypassingRunnable_m_pad_ensRLocationsPort_par_out_local::TChangeableMemPool::_::_::_m_arrayPool::_0_::_elem::_m_LocationList::_Item::_6_::_thetaVar::_m_value = 0.0012;
//        @sysvar::XCP::RadarFC_Loc::_g_PL_AD_fw_Radar_1R1V_rpc_LocBypassingRunnable_LocBypassingRunnable_m_pad_ensRLocationsPort_par_out_local::TChangeableMemPool::_::_::_m_arrayPool::_0_::_elem::_m_LocationList::_Item::_6_::_vVar::_m_value = 0.003;
//        @sysvar::XCP::RadarFC_Loc::_g_PL_AD_fw_Radar_1R1V_rpc_LocBypassingRunnable_LocBypassingRunnable_m_pad_ensRLocationsPort_par_out_local::TChangeableMemPool::_::_::_m_arrayPool::_0_::_elem::_m_LocationList::_Item::_6_::_Rssi::_m_value = 83;
//        @sysvar::XCP::RadarFC_Loc::_g_PL_AD_fw_Radar_1R1V_rpc_LocBypassingRunnable_LocBypassingRunnable_m_pad_ensRLocationsPort_par_out_local::TChangeableMemPool::_::_::_m_arrayPool::_0_::_elem::_m_LocationList::_Item::_6_::_idxAzimuthAmbiguityPeer = 65535;
//        @sysvar::XCP::RadarFC_Loc::_g_PL_AD_fw_Radar_1R1V_rpc_LocBypassingRunnable_LocBypassingRunnable_m_pad_ensRLocationsPort_par_out_local::TChangeableMemPool::_::_::_m_arrayPool::_0_::_elem::_m_LocationList::_Item::_6_::_measStatus = 9;
        
//        /**
//          * Variable values
//          */
//        @sysvar::XCP::RadarFC_Loc::_g_PL_AD_fw_Radar_1R1V_rpc_LocBypassingRunnable_LocBypassingRunnable_m_pad_ensRLocationsPort_par_out_local::TChangeableMemPool::_::_::_m_arrayPool::_0_::_elem::_m_LocationList::_Item::_6_::_d = dllGetRadarFCLocRadialDistance(@hil_ctrl::Handle_RoadObj, object_id);
//        @sysvar::XCP::RadarFC_Loc::_g_PL_AD_fw_Radar_1R1V_rpc_LocBypassingRunnable_LocBypassingRunnable_m_pad_ensRLocationsPort_par_out_local::TChangeableMemPool::_::_::_m_arrayPool::_0_::_elem::_m_LocationList::_Item::_6_::_v = dllGetRadarFCLocRadialVelocity(@hil_ctrl::Handle_RoadObj, object_id);
//        @sysvar::XCP::RadarFC_Loc::_g_PL_AD_fw_Radar_1R1V_rpc_LocBypassingRunnable_LocBypassingRunnable_m_pad_ensRLocationsPort_par_out_local::TChangeableMemPool::_::_::_m_arrayPool::_0_::_elem::_m_LocationList::_Item::_6_::_phi::_m_value = dllGetRadarFCLocElevationAngle(@hil_ctrl::Handle_RoadObj, object_id);
//        @sysvar::XCP::RadarFC_Loc::_g_PL_AD_fw_Radar_1R1V_rpc_LocBypassingRunnable_LocBypassingRunnable_m_pad_ensRLocationsPort_par_out_local::TChangeableMemPool::_::_::_m_arrayPool::_0_::_elem::_m_LocationList::_Item::_6_::_theta::_m_value = dllGetRadarFCLocAzimuthAngle(@hil_ctrl::Handle_RoadObj, object_id) * 180 / PI;
//        @sysvar::XCP::RadarFC_Loc::_g_PL_AD_fw_Radar_1R1V_rpc_LocBypassingRunnable_LocBypassingRunnable_m_pad_ensRLocationsPort_par_out_local::TChangeableMemPool::_::_::_m_arrayPool::_0_::_elem::_m_LocationList::_Item::_6_::_Rcs::_m_value = dllGetRadarFCLocRCS(@hil_ctrl::Handle_RoadObj, object_id);
//        break;
        
//      case 7: //"Object-7"
//        /**
//          * Constant values
//          */
//        @sysvar::XCP::RadarFC_Loc::_g_PL_AD_fw_Radar_1R1V_rpc_LocBypassingRunnable_LocBypassingRunnable_m_pad_ensRLocationsPort_par_out_local::TChangeableMemPool::_::_::_m_arrayPool::_0_::_elem::_m_LocationList::_Item::_7_::_dVar::_m_value = 0.012;
//        @sysvar::XCP::RadarFC_Loc::_g_PL_AD_fw_Radar_1R1V_rpc_LocBypassingRunnable_LocBypassingRunnable_m_pad_ensRLocationsPort_par_out_local::TChangeableMemPool::_::_::_m_arrayPool::_0_::_elem::_m_LocationList::_Item::_7_::_dvCov::_m_value = -0.005;
//        @sysvar::XCP::RadarFC_Loc::_g_PL_AD_fw_Radar_1R1V_rpc_LocBypassingRunnable_LocBypassingRunnable_m_pad_ensRLocationsPort_par_out_local::TChangeableMemPool::_::_::_m_arrayPool::_0_::_elem::_m_LocationList::_Item::_7_::_dvQly = 255;
//        @sysvar::XCP::RadarFC_Loc::_g_PL_AD_fw_Radar_1R1V_rpc_LocBypassingRunnable_LocBypassingRunnable_m_pad_ensRLocationsPort_par_out_local::TChangeableMemPool::_::_::_m_arrayPool::_0_::_elem::_m_LocationList::_Item::_7_::_phiQly = 0;
//        @sysvar::XCP::RadarFC_Loc::_g_PL_AD_fw_Radar_1R1V_rpc_LocBypassingRunnable_LocBypassingRunnable_m_pad_ensRLocationsPort_par_out_local::TChangeableMemPool::_::_::_m_arrayPool::_0_::_elem::_m_LocationList::_Item::_7_::_phiVar::_m_value = 0.002;
//        @sysvar::XCP::RadarFC_Loc::_g_PL_AD_fw_Radar_1R1V_rpc_LocBypassingRunnable_LocBypassingRunnable_m_pad_ensRLocationsPort_par_out_local::TChangeableMemPool::_::_::_m_arrayPool::_0_::_elem::_m_LocationList::_Item::_7_::_thetaQly = 1;
//        @sysvar::XCP::RadarFC_Loc::_g_PL_AD_fw_Radar_1R1V_rpc_LocBypassingRunnable_LocBypassingRunnable_m_pad_ensRLocationsPort_par_out_local::TChangeableMemPool::_::_::_m_arrayPool::_0_::_elem::_m_LocationList::_Item::_7_::_thetaVar::_m_value = 0.0012;
//        @sysvar::XCP::RadarFC_Loc::_g_PL_AD_fw_Radar_1R1V_rpc_LocBypassingRunnable_LocBypassingRunnable_m_pad_ensRLocationsPort_par_out_local::TChangeableMemPool::_::_::_m_arrayPool::_0_::_elem::_m_LocationList::_Item::_7_::_vVar::_m_value = 0.003;
//        @sysvar::XCP::RadarFC_Loc::_g_PL_AD_fw_Radar_1R1V_rpc_LocBypassingRunnable_LocBypassingRunnable_m_pad_ensRLocationsPort_par_out_local::TChangeableMemPool::_::_::_m_arrayPool::_0_::_elem::_m_LocationList::_Item::_7_::_Rssi::_m_value = 83;
//        @sysvar::XCP::RadarFC_Loc::_g_PL_AD_fw_Radar_1R1V_rpc_LocBypassingRunnable_LocBypassingRunnable_m_pad_ensRLocationsPort_par_out_local::TChangeableMemPool::_::_::_m_arrayPool::_0_::_elem::_m_LocationList::_Item::_7_::_idxAzimuthAmbiguityPeer = 65535;
//        @sysvar::XCP::RadarFC_Loc::_g_PL_AD_fw_Radar_1R1V_rpc_LocBypassingRunnable_LocBypassingRunnable_m_pad_ensRLocationsPort_par_out_local::TChangeableMemPool::_::_::_m_arrayPool::_0_::_elem::_m_LocationList::_Item::_7_::_measStatus = 9;
        
//        /**
//          * Variable values
//          */
//        @sysvar::XCP::RadarFC_Loc::_g_PL_AD_fw_Radar_1R1V_rpc_LocBypassingRunnable_LocBypassingRunnable_m_pad_ensRLocationsPort_par_out_local::TChangeableMemPool::_::_::_m_arrayPool::_0_::_elem::_m_LocationList::_Item::_7_::_d = dllGetRadarFCLocRadialDistance(@hil_ctrl::Handle_RoadObj, object_id);
//        @sysvar::XCP::RadarFC_Loc::_g_PL_AD_fw_Radar_1R1V_rpc_LocBypassingRunnable_LocBypassingRunnable_m_pad_ensRLocationsPort_par_out_local::TChangeableMemPool::_::_::_m_arrayPool::_0_::_elem::_m_LocationList::_Item::_7_::_v = dllGetRadarFCLocRadialVelocity(@hil_ctrl::Handle_RoadObj, object_id);
//        @sysvar::XCP::RadarFC_Loc::_g_PL_AD_fw_Radar_1R1V_rpc_LocBypassingRunnable_LocBypassingRunnable_m_pad_ensRLocationsPort_par_out_local::TChangeableMemPool::_::_::_m_arrayPool::_0_::_elem::_m_LocationList::_Item::_7_::_phi::_m_value = dllGetRadarFCLocElevationAngle(@hil_ctrl::Handle_RoadObj, object_id);
//        @sysvar::XCP::RadarFC_Loc::_g_PL_AD_fw_Radar_1R1V_rpc_LocBypassingRunnable_LocBypassingRunnable_m_pad_ensRLocationsPort_par_out_local::TChangeableMemPool::_::_::_m_arrayPool::_0_::_elem::_m_LocationList::_Item::_7_::_theta::_m_value = dllGetRadarFCLocAzimuthAngle(@hil_ctrl::Handle_RoadObj, object_id) * 180 / PI;
//        @sysvar::XCP::RadarFC_Loc::_g_PL_AD_fw_Radar_1R1V_rpc_LocBypassingRunnable_LocBypassingRunnable_m_pad_ensRLocationsPort_par_out_local::TChangeableMemPool::_::_::_m_arrayPool::_0_::_elem::_m_LocationList::_Item::_7_::_Rcs::_m_value = dllGetRadarFCLocRCS(@hil_ctrl::Handle_RoadObj, object_id);
//        break;
        
//      case 8: //"Object-8"
//        /**
//          * Constant values
//          */
//        @sysvar::XCP::RadarFC_Loc::_g_PL_AD_fw_Radar_1R1V_rpc_LocBypassingRunnable_LocBypassingRunnable_m_pad_ensRLocationsPort_par_out_local::TChangeableMemPool::_::_::_m_arrayPool::_0_::_elem::_m_LocationList::_Item::_8_::_dVar::_m_value = 0.012;
//        @sysvar::XCP::RadarFC_Loc::_g_PL_AD_fw_Radar_1R1V_rpc_LocBypassingRunnable_LocBypassingRunnable_m_pad_ensRLocationsPort_par_out_local::TChangeableMemPool::_::_::_m_arrayPool::_0_::_elem::_m_LocationList::_Item::_8_::_dvCov::_m_value = -0.005;
//        @sysvar::XCP::RadarFC_Loc::_g_PL_AD_fw_Radar_1R1V_rpc_LocBypassingRunnable_LocBypassingRunnable_m_pad_ensRLocationsPort_par_out_local::TChangeableMemPool::_::_::_m_arrayPool::_0_::_elem::_m_LocationList::_Item::_8_::_dvQly = 255;
//        @sysvar::XCP::RadarFC_Loc::_g_PL_AD_fw_Radar_1R1V_rpc_LocBypassingRunnable_LocBypassingRunnable_m_pad_ensRLocationsPort_par_out_local::TChangeableMemPool::_::_::_m_arrayPool::_0_::_elem::_m_LocationList::_Item::_8_::_phiQly = 0;
//        @sysvar::XCP::RadarFC_Loc::_g_PL_AD_fw_Radar_1R1V_rpc_LocBypassingRunnable_LocBypassingRunnable_m_pad_ensRLocationsPort_par_out_local::TChangeableMemPool::_::_::_m_arrayPool::_0_::_elem::_m_LocationList::_Item::_8_::_phiVar::_m_value = 0.002;
//        @sysvar::XCP::RadarFC_Loc::_g_PL_AD_fw_Radar_1R1V_rpc_LocBypassingRunnable_LocBypassingRunnable_m_pad_ensRLocationsPort_par_out_local::TChangeableMemPool::_::_::_m_arrayPool::_0_::_elem::_m_LocationList::_Item::_8_::_thetaQly = 1;
//        @sysvar::XCP::RadarFC_Loc::_g_PL_AD_fw_Radar_1R1V_rpc_LocBypassingRunnable_LocBypassingRunnable_m_pad_ensRLocationsPort_par_out_local::TChangeableMemPool::_::_::_m_arrayPool::_0_::_elem::_m_LocationList::_Item::_8_::_thetaVar::_m_value = 0.0012;
//        @sysvar::XCP::RadarFC_Loc::_g_PL_AD_fw_Radar_1R1V_rpc_LocBypassingRunnable_LocBypassingRunnable_m_pad_ensRLocationsPort_par_out_local::TChangeableMemPool::_::_::_m_arrayPool::_0_::_elem::_m_LocationList::_Item::_8_::_vVar::_m_value = 0.003;
//        @sysvar::XCP::RadarFC_Loc::_g_PL_AD_fw_Radar_1R1V_rpc_LocBypassingRunnable_LocBypassingRunnable_m_pad_ensRLocationsPort_par_out_local::TChangeableMemPool::_::_::_m_arrayPool::_0_::_elem::_m_LocationList::_Item::_8_::_Rssi::_m_value = 83;
//        @sysvar::XCP::RadarFC_Loc::_g_PL_AD_fw_Radar_1R1V_rpc_LocBypassingRunnable_LocBypassingRunnable_m_pad_ensRLocationsPort_par_out_local::TChangeableMemPool::_::_::_m_arrayPool::_0_::_elem::_m_LocationList::_Item::_8_::_idxAzimuthAmbiguityPeer = 65535;
//        @sysvar::XCP::RadarFC_Loc::_g_PL_AD_fw_Radar_1R1V_rpc_LocBypassingRunnable_LocBypassingRunnable_m_pad_ensRLocationsPort_par_out_local::TChangeableMemPool::_::_::_m_arrayPool::_0_::_elem::_m_LocationList::_Item::_8_::_measStatus = 9;
        
//        /**
//          * Variable values
//          */
//        @sysvar::XCP::RadarFC_Loc::_g_PL_AD_fw_Radar_1R1V_rpc_LocBypassingRunnable_LocBypassingRunnable_m_pad_ensRLocationsPort_par_out_local::TChangeableMemPool::_::_::_m_arrayPool::_0_::_elem::_m_LocationList::_Item::_8_::_d = dllGetRadarFCLocRadialDistance(@hil_ctrl::Handle_RoadObj, object_id);
//        @sysvar::XCP::RadarFC_Loc::_g_PL_AD_fw_Radar_1R1V_rpc_LocBypassingRunnable_LocBypassingRunnable_m_pad_ensRLocationsPort_par_out_local::TChangeableMemPool::_::_::_m_arrayPool::_0_::_elem::_m_LocationList::_Item::_8_::_v = dllGetRadarFCLocRadialVelocity(@hil_ctrl::Handle_RoadObj, object_id);
//        @sysvar::XCP::RadarFC_Loc::_g_PL_AD_fw_Radar_1R1V_rpc_LocBypassingRunnable_LocBypassingRunnable_m_pad_ensRLocationsPort_par_out_local::TChangeableMemPool::_::_::_m_arrayPool::_0_::_elem::_m_LocationList::_Item::_8_::_phi::_m_value = dllGetRadarFCLocElevationAngle(@hil_ctrl::Handle_RoadObj, object_id);
//        @sysvar::XCP::RadarFC_Loc::_g_PL_AD_fw_Radar_1R1V_rpc_LocBypassingRunnable_LocBypassingRunnable_m_pad_ensRLocationsPort_par_out_local::TChangeableMemPool::_::_::_m_arrayPool::_0_::_elem::_m_LocationList::_Item::_8_::_theta::_m_value = dllGetRadarFCLocAzimuthAngle(@hil_ctrl::Handle_RoadObj, object_id) * 180 / PI;
//        @sysvar::XCP::RadarFC_Loc::_g_PL_AD_fw_Radar_1R1V_rpc_LocBypassingRunnable_LocBypassingRunnable_m_pad_ensRLocationsPort_par_out_local::TChangeableMemPool::_::_::_m_arrayPool::_0_::_elem::_m_LocationList::_Item::_8_::_Rcs::_m_value = dllGetRadarFCLocRCS(@hil_ctrl::Handle_RoadObj, object_id);
//        break;
        
//    }
//  }
//}

/** @brief Injects calculated object data stored in the target_radar_fc_sim arrays.
  *        This is done the way so that all valid objects are being injected in a chain (no "holes" in between).
  * @param object_id ID of the object that shall be injected.
  * @param injection_method Flag to decide if data shall be injected onto the BUS (=1) or via XCP (=2).
  * @return void
  */
void inject_radar_fc_obj(byte object_id, int injection_method)
{
  target_counter_radar_fc = 0;
  injection_counter_radar_fc = -1;
  
  for(target_counter_radar_fc = 0; target_counter_radar_fc <= object_id; target_counter_radar_fc++){
    if(@target_radar_fc_sim::objdata.empty_obj[target_counter_radar_fc] == 0 && @target_radar_fc_sim::objdata.empty_obj[object_id] == 0){
      //increase the counter IF there is a valid object found AND only do so if the object we want to inject is valid
      injection_counter_radar_fc++;
    }
  }
  
  if (injection_method == 1)
  { //Simulated sensor -> BUS
    switch (injection_counter_radar_fc)
    {
      case 0: //"Object-0"
        /**
          * Constant values
          */
        @CAN_RadarFC::RFC_Object::RFC_Object_Obj1.ObjId = injection_counter_radar_fc + 1;
        @CAN_RadarFC::RFC_Object::RFC_Object_Obj1.WidthVnce = 0;
        @CAN_RadarFC::RFC_Object::RFC_Object_Obj1.VxVnce = 0;
        @CAN_RadarFC::RFC_Object::RFC_Object_Obj1.AyVnce = 0;
        @CAN_RadarFC::RFC_Object::RFC_Object_Obj1.OrientationYawVnce = 0;
        @CAN_RadarFC::RFC_Object::RFC_Object_Obj1.LengthVnce = 0;
        @CAN_RadarFC::RFC_Object::RFC_Object_Obj1.AxVnce = 0;
        @CAN_RadarFC::RFC_Object::RFC_Object_Obj1.PyVnce = 0;
        @CAN_RadarFC::RFC_Object::RFC_Object_Obj1.PxVnce = 0;
        @CAN_RadarFC::RFC_Object::RFC_Object_Obj1.PxPyCoVnce = 0;
        @CAN_RadarFC::RFC_Object::RFC_Object_Obj1.PyAxCoVnce = 0;
        @CAN_RadarFC::RFC_Object::RFC_Object_Obj1.AxAyCoVnce = 0;
        @CAN_RadarFC::RFC_Object::RFC_Object_Obj1.VyAyCoVnce = 0;
        @CAN_RadarFC::RFC_Object::RFC_Object_Obj1.VyAxCoVnce = 0;
        @CAN_RadarFC::RFC_Object::RFC_Object_Obj1.VxAyCoVnce = 0;
        @CAN_RadarFC::RFC_Object::RFC_Object_Obj1.VxAxCoVnce = 0;
        @CAN_RadarFC::RFC_Object::RFC_Object_Obj1.VxVyCoVnce = 0;
        @CAN_RadarFC::RFC_Object::RFC_Object_Obj1.VyVnce = 0;
        @CAN_RadarFC::RFC_Object::RFC_Object_Obj1.PyAyCoVnce = 0;
        @CAN_RadarFC::RFC_Object::RFC_Object_Obj1.PxAyCoVnce = 0;
        @CAN_RadarFC::RFC_Object::RFC_Object_Obj1.PxAxCoVnce = 0;
        @CAN_RadarFC::RFC_Object::RFC_Object_Obj1.PyVyCoVnce = 0;
        @CAN_RadarFC::RFC_Object::RFC_Object_Obj1.PxVyCoVnce = 0;
        @CAN_RadarFC::RFC_Object::RFC_Object_Obj1.PxVxCoVnce = 0;
        @CAN_RadarFC::RFC_Object::RFC_Object_Obj1.PyVxCoVnce = 0;
        @CAN_RadarFC::RFC_Object::RFC_Object_Obj1.ExistProb = 100;
        @CAN_RadarFC::RFC_Object::RFC_Object_Obj1.ProbClassConfidence = 100;
        @CAN_RadarFC::RFC_Object::RFC_Object_Obj1.MeasurementStatus = 0; // always measured
        
        /**
          * Variable values
          */
        @CAN_RadarFC::RFC_Object::RFC_Object_Obj1.OrientationYaw = dllGetRadarFCObjYawAngle(@hil_ctrl::Handle_RoadObj, object_id);
        @CAN_RadarFC::RFC_Object::RFC_Object_Obj1.Width = dllGetRadarFCInputObjectWidth(@hil_ctrl::Handle_RoadObj, object_id);
        @CAN_RadarFC::RFC_Object::RFC_Object_Obj1.Length = dllGetRadarFCInputObjectLength(@hil_ctrl::Handle_RoadObj, object_id);
        @CAN_RadarFC::RFC_Object::RFC_Object_Obj1.RCS = dllGetRadarFCObjRa6RCS(@hil_ctrl::Handle_RoadObj, object_id);
        @CAN_RadarFC::RFC_Object::RFC_Object_Obj1.Px = dllGetRadarFCObjDistX(@hil_ctrl::Handle_RoadObj, object_id);
        @CAN_RadarFC::RFC_Object::RFC_Object_Obj1.Py = dllGetRadarFCObjDistY(@hil_ctrl::Handle_RoadObj, object_id);
        @CAN_RadarFC::RFC_Object::RFC_Object_Obj1.Vx = dllGetRadarFCObjVelX(@hil_ctrl::Handle_RoadObj, object_id);
        @CAN_RadarFC::RFC_Object::RFC_Object_Obj1.Vy = dllGetRadarFCObjVelY(@hil_ctrl::Handle_RoadObj, object_id);
        @CAN_RadarFC::RFC_Object::RFC_Object_Obj1.Ax = dllGetRadarFCObjAccelX(@hil_ctrl::Handle_RoadObj, object_id);
        @CAN_RadarFC::RFC_Object::RFC_Object_Obj1.Ay = dllGetRadarFCObjAccelY(@hil_ctrl::Handle_RoadObj, object_id);
        @CAN_RadarFC::RFC_Object::RFC_Object_Obj1.MovingStatus = dllGetRadarFCObjRa6MovingStatus(@hil_ctrl::Handle_RoadObj, object_id);
        @CAN_RadarFC::RFC_Object::RFC_Object_Obj1.Age += front_corner_cycle_time * 10; //50 ms * 10 = unit is 100us
        @CAN_RadarFC::RFC_Object::RFC_Object_Obj1.ProbClassType = dllGetRadarFCObjRa6ObjType(@hil_ctrl::Handle_RoadObj, object_id);
        @CAN_RadarFC::RFC_Object::RFC_Object_Obj1.ReferencePoint = dllGetRadarFCObjRefPnt(@hil_ctrl::Handle_RoadObj, object_id);
        @CAN_RadarFC::RFC_Object::RFC_Object_Obj1.FilterInformation = 0; // PER has not yet defined this signal
        break;
        
      case 1: //"Object-1"
        /**
          * Constant values
          */
        @CAN_RadarFC::RFC_Object::RFC_Object_Obj2.ObjId = injection_counter_radar_fc + 1;
        @CAN_RadarFC::RFC_Object::RFC_Object_Obj2.WidthVnce = 0;
        @CAN_RadarFC::RFC_Object::RFC_Object_Obj2.VxVnce = 0;
        @CAN_RadarFC::RFC_Object::RFC_Object_Obj2.AyVnce = 0;
        @CAN_RadarFC::RFC_Object::RFC_Object_Obj2.OrientationYawVnce = 0;
        @CAN_RadarFC::RFC_Object::RFC_Object_Obj2.LengthVnce = 0;
        @CAN_RadarFC::RFC_Object::RFC_Object_Obj2.AxVnce = 0;
        @CAN_RadarFC::RFC_Object::RFC_Object_Obj2.PyVnce = 0;
        @CAN_RadarFC::RFC_Object::RFC_Object_Obj2.PxVnce = 0;
        @CAN_RadarFC::RFC_Object::RFC_Object_Obj2.PxPyCoVnce = 0;
        @CAN_RadarFC::RFC_Object::RFC_Object_Obj2.PyAxCoVnce = 0;
        @CAN_RadarFC::RFC_Object::RFC_Object_Obj2.AxAyCoVnce = 0;
        @CAN_RadarFC::RFC_Object::RFC_Object_Obj2.VyAyCoVnce = 0;
        @CAN_RadarFC::RFC_Object::RFC_Object_Obj2.VyAxCoVnce = 0;
        @CAN_RadarFC::RFC_Object::RFC_Object_Obj2.VxAyCoVnce = 0;
        @CAN_RadarFC::RFC_Object::RFC_Object_Obj2.VxAxCoVnce = 0;
        @CAN_RadarFC::RFC_Object::RFC_Object_Obj2.VxVyCoVnce = 0;
        @CAN_RadarFC::RFC_Object::RFC_Object_Obj2.VyVnce = 0;
        @CAN_RadarFC::RFC_Object::RFC_Object_Obj2.PyAyCoVnce = 0;
        @CAN_RadarFC::RFC_Object::RFC_Object_Obj2.PxAyCoVnce = 0;
        @CAN_RadarFC::RFC_Object::RFC_Object_Obj2.PxAxCoVnce = 0;
        @CAN_RadarFC::RFC_Object::RFC_Object_Obj2.PyVyCoVnce = 0;
        @CAN_RadarFC::RFC_Object::RFC_Object_Obj2.PxVyCoVnce = 0;
        @CAN_RadarFC::RFC_Object::RFC_Object_Obj2.PxVxCoVnce = 0;
        @CAN_RadarFC::RFC_Object::RFC_Object_Obj2.PyVxCoVnce = 0;
        @CAN_RadarFC::RFC_Object::RFC_Object_Obj2.ExistProb = 100;
        @CAN_RadarFC::RFC_Object::RFC_Object_Obj2.ProbClassConfidence = 100;
        @CAN_RadarFC::RFC_Object::RFC_Object_Obj2.MeasurementStatus = 0; // always measured
        
        /**
          * Variable values
          */
        @CAN_RadarFC::RFC_Object::RFC_Object_Obj2.OrientationYaw = dllGetRadarFCObjYawAngle(@hil_ctrl::Handle_RoadObj, object_id);
        @CAN_RadarFC::RFC_Object::RFC_Object_Obj2.Width = dllGetRadarFCInputObjectWidth(@hil_ctrl::Handle_RoadObj, object_id);
        @CAN_RadarFC::RFC_Object::RFC_Object_Obj2.Length = dllGetRadarFCInputObjectLength(@hil_ctrl::Handle_RoadObj, object_id);
        @CAN_RadarFC::RFC_Object::RFC_Object_Obj2.RCS = dllGetRadarFCObjRa6RCS(@hil_ctrl::Handle_RoadObj, object_id);
        @CAN_RadarFC::RFC_Object::RFC_Object_Obj2.Px = dllGetRadarFCObjDistX(@hil_ctrl::Handle_RoadObj, object_id);
        @CAN_RadarFC::RFC_Object::RFC_Object_Obj2.Py = dllGetRadarFCObjDistY(@hil_ctrl::Handle_RoadObj, object_id);
        @CAN_RadarFC::RFC_Object::RFC_Object_Obj2.Vx = dllGetRadarFCObjVelX(@hil_ctrl::Handle_RoadObj, object_id);
        @CAN_RadarFC::RFC_Object::RFC_Object_Obj2.Vy = dllGetRadarFCObjVelY(@hil_ctrl::Handle_RoadObj, object_id);
        @CAN_RadarFC::RFC_Object::RFC_Object_Obj2.Ax = dllGetRadarFCObjAccelX(@hil_ctrl::Handle_RoadObj, object_id);
        @CAN_RadarFC::RFC_Object::RFC_Object_Obj2.Ay = dllGetRadarFCObjAccelY(@hil_ctrl::Handle_RoadObj, object_id);
        @CAN_RadarFC::RFC_Object::RFC_Object_Obj2.MovingStatus = dllGetRadarFCObjRa6MovingStatus(@hil_ctrl::Handle_RoadObj, object_id);
        @CAN_RadarFC::RFC_Object::RFC_Object_Obj2.Age += front_corner_cycle_time * 10; //50 ms * 10 = unit is 100us
        @CAN_RadarFC::RFC_Object::RFC_Object_Obj2.ProbClassType = dllGetRadarFCObjRa6ObjType(@hil_ctrl::Handle_RoadObj, object_id);
        @CAN_RadarFC::RFC_Object::RFC_Object_Obj2.ReferencePoint = dllGetRadarFCObjRefPnt(@hil_ctrl::Handle_RoadObj, object_id);
        @CAN_RadarFC::RFC_Object::RFC_Object_Obj2.FilterInformation = 0; // PER has not yet defined this signal
        break;
        
      case 2: //"Object-2"
        /**
          * Constant values
          */
        @CAN_RadarFC::RFC_Object::RFC_Object_Obj3.ObjId = injection_counter_radar_fc + 1;
        @CAN_RadarFC::RFC_Object::RFC_Object_Obj3.WidthVnce = 0;
        @CAN_RadarFC::RFC_Object::RFC_Object_Obj3.VxVnce = 0;
        @CAN_RadarFC::RFC_Object::RFC_Object_Obj3.AyVnce = 0;
        @CAN_RadarFC::RFC_Object::RFC_Object_Obj3.OrientationYawVnce = 0;
        @CAN_RadarFC::RFC_Object::RFC_Object_Obj3.LengthVnce = 0;
        @CAN_RadarFC::RFC_Object::RFC_Object_Obj3.AxVnce = 0;
        @CAN_RadarFC::RFC_Object::RFC_Object_Obj3.PyVnce = 0;
        @CAN_RadarFC::RFC_Object::RFC_Object_Obj3.PxVnce = 0;
        @CAN_RadarFC::RFC_Object::RFC_Object_Obj3.PxPyCoVnce = 0;
        @CAN_RadarFC::RFC_Object::RFC_Object_Obj3.PyAxCoVnce = 0;
        @CAN_RadarFC::RFC_Object::RFC_Object_Obj3.AxAyCoVnce = 0;
        @CAN_RadarFC::RFC_Object::RFC_Object_Obj3.VyAyCoVnce = 0;
        @CAN_RadarFC::RFC_Object::RFC_Object_Obj3.VyAxCoVnce = 0;
        @CAN_RadarFC::RFC_Object::RFC_Object_Obj3.VxAyCoVnce = 0;
        @CAN_RadarFC::RFC_Object::RFC_Object_Obj3.VxAxCoVnce = 0;
        @CAN_RadarFC::RFC_Object::RFC_Object_Obj3.VxVyCoVnce = 0;
        @CAN_RadarFC::RFC_Object::RFC_Object_Obj3.VyVnce = 0;
        @CAN_RadarFC::RFC_Object::RFC_Object_Obj3.PyAyCoVnce = 0;
        @CAN_RadarFC::RFC_Object::RFC_Object_Obj3.PxAyCoVnce = 0;
        @CAN_RadarFC::RFC_Object::RFC_Object_Obj3.PxAxCoVnce = 0;
        @CAN_RadarFC::RFC_Object::RFC_Object_Obj3.PyVyCoVnce = 0;
        @CAN_RadarFC::RFC_Object::RFC_Object_Obj3.PxVyCoVnce = 0;
        @CAN_RadarFC::RFC_Object::RFC_Object_Obj3.PxVxCoVnce = 0;
        @CAN_RadarFC::RFC_Object::RFC_Object_Obj3.PyVxCoVnce = 0;
        @CAN_RadarFC::RFC_Object::RFC_Object_Obj3.ExistProb = 100;
        @CAN_RadarFC::RFC_Object::RFC_Object_Obj3.ProbClassConfidence = 100;
        @CAN_RadarFC::RFC_Object::RFC_Object_Obj3.MeasurementStatus = 0; // always measured
        
        /**
          * Variable values
          */
        @CAN_RadarFC::RFC_Object::RFC_Object_Obj3.OrientationYaw = dllGetRadarFCObjYawAngle(@hil_ctrl::Handle_RoadObj, object_id);
        @CAN_RadarFC::RFC_Object::RFC_Object_Obj3.Width = dllGetRadarFCInputObjectWidth(@hil_ctrl::Handle_RoadObj, object_id);
        @CAN_RadarFC::RFC_Object::RFC_Object_Obj3.Length = dllGetRadarFCInputObjectLength(@hil_ctrl::Handle_RoadObj, object_id);
        @CAN_RadarFC::RFC_Object::RFC_Object_Obj3.RCS = dllGetRadarFCObjRa6RCS(@hil_ctrl::Handle_RoadObj, object_id);
        @CAN_RadarFC::RFC_Object::RFC_Object_Obj3.Px = dllGetRadarFCObjDistX(@hil_ctrl::Handle_RoadObj, object_id);
        @CAN_RadarFC::RFC_Object::RFC_Object_Obj3.Py = dllGetRadarFCObjDistY(@hil_ctrl::Handle_RoadObj, object_id);
        @CAN_RadarFC::RFC_Object::RFC_Object_Obj3.Vx = dllGetRadarFCObjVelX(@hil_ctrl::Handle_RoadObj, object_id);
        @CAN_RadarFC::RFC_Object::RFC_Object_Obj3.Vy = dllGetRadarFCObjVelY(@hil_ctrl::Handle_RoadObj, object_id);
        @CAN_RadarFC::RFC_Object::RFC_Object_Obj3.Ax = dllGetRadarFCObjAccelX(@hil_ctrl::Handle_RoadObj, object_id);
        @CAN_RadarFC::RFC_Object::RFC_Object_Obj3.Ay = dllGetRadarFCObjAccelY(@hil_ctrl::Handle_RoadObj, object_id);
        @CAN_RadarFC::RFC_Object::RFC_Object_Obj3.MovingStatus = dllGetRadarFCObjRa6MovingStatus(@hil_ctrl::Handle_RoadObj, object_id);
        @CAN_RadarFC::RFC_Object::RFC_Object_Obj3.Age += front_corner_cycle_time * 10; //50 ms * 10 = unit is 100us
        @CAN_RadarFC::RFC_Object::RFC_Object_Obj3.ProbClassType = dllGetRadarFCObjRa6ObjType(@hil_ctrl::Handle_RoadObj, object_id);
        @CAN_RadarFC::RFC_Object::RFC_Object_Obj3.ReferencePoint = dllGetRadarFCObjRefPnt(@hil_ctrl::Handle_RoadObj, object_id);
        @CAN_RadarFC::RFC_Object::RFC_Object_Obj3.FilterInformation = 0; // PER has not yet defined this signal
        break;
        
      case 3: //"Object-3"
        /**
          * Constant values
          */
        @CAN_RadarFC::RFC_Object::RFC_Object_Obj4.ObjId = injection_counter_radar_fc + 1;
        @CAN_RadarFC::RFC_Object::RFC_Object_Obj4.WidthVnce = 0;
        @CAN_RadarFC::RFC_Object::RFC_Object_Obj4.VxVnce = 0;
        @CAN_RadarFC::RFC_Object::RFC_Object_Obj4.AyVnce = 0;
        @CAN_RadarFC::RFC_Object::RFC_Object_Obj4.OrientationYawVnce = 0;
        @CAN_RadarFC::RFC_Object::RFC_Object_Obj4.LengthVnce = 0;
        @CAN_RadarFC::RFC_Object::RFC_Object_Obj4.AxVnce = 0;
        @CAN_RadarFC::RFC_Object::RFC_Object_Obj4.PyVnce = 0;
        @CAN_RadarFC::RFC_Object::RFC_Object_Obj4.PxVnce = 0;
        @CAN_RadarFC::RFC_Object::RFC_Object_Obj4.PxPyCoVnce = 0;
        @CAN_RadarFC::RFC_Object::RFC_Object_Obj4.PyAxCoVnce = 0;
        @CAN_RadarFC::RFC_Object::RFC_Object_Obj4.AxAyCoVnce = 0;
        @CAN_RadarFC::RFC_Object::RFC_Object_Obj4.VyAyCoVnce = 0;
        @CAN_RadarFC::RFC_Object::RFC_Object_Obj4.VyAxCoVnce = 0;
        @CAN_RadarFC::RFC_Object::RFC_Object_Obj4.VxAyCoVnce = 0;
        @CAN_RadarFC::RFC_Object::RFC_Object_Obj4.VxAxCoVnce = 0;
        @CAN_RadarFC::RFC_Object::RFC_Object_Obj4.VxVyCoVnce = 0;
        @CAN_RadarFC::RFC_Object::RFC_Object_Obj4.VyVnce = 0;
        @CAN_RadarFC::RFC_Object::RFC_Object_Obj4.PyAyCoVnce = 0;
        @CAN_RadarFC::RFC_Object::RFC_Object_Obj4.PxAyCoVnce = 0;
        @CAN_RadarFC::RFC_Object::RFC_Object_Obj4.PxAxCoVnce = 0;
        @CAN_RadarFC::RFC_Object::RFC_Object_Obj4.PyVyCoVnce = 0;
        @CAN_RadarFC::RFC_Object::RFC_Object_Obj4.PxVyCoVnce = 0;
        @CAN_RadarFC::RFC_Object::RFC_Object_Obj4.PxVxCoVnce = 0;
        @CAN_RadarFC::RFC_Object::RFC_Object_Obj4.PyVxCoVnce = 0;
        @CAN_RadarFC::RFC_Object::RFC_Object_Obj4.ExistProb = 100;
        @CAN_RadarFC::RFC_Object::RFC_Object_Obj4.ProbClassConfidence = 100;
        @CAN_RadarFC::RFC_Object::RFC_Object_Obj4.MeasurementStatus = 0; // always measured
        
        /**
          * Variable values
          */
        @CAN_RadarFC::RFC_Object::RFC_Object_Obj4.OrientationYaw = dllGetRadarFCObjYawAngle(@hil_ctrl::Handle_RoadObj, object_id);
        @CAN_RadarFC::RFC_Object::RFC_Object_Obj4.Width = dllGetRadarFCInputObjectWidth(@hil_ctrl::Handle_RoadObj, object_id);
        @CAN_RadarFC::RFC_Object::RFC_Object_Obj4.Length = dllGetRadarFCInputObjectLength(@hil_ctrl::Handle_RoadObj, object_id);
        @CAN_RadarFC::RFC_Object::RFC_Object_Obj4.RCS = dllGetRadarFCObjRa6RCS(@hil_ctrl::Handle_RoadObj, object_id);
        @CAN_RadarFC::RFC_Object::RFC_Object_Obj4.Px = dllGetRadarFCObjDistX(@hil_ctrl::Handle_RoadObj, object_id);
        @CAN_RadarFC::RFC_Object::RFC_Object_Obj4.Py = dllGetRadarFCObjDistY(@hil_ctrl::Handle_RoadObj, object_id);
        @CAN_RadarFC::RFC_Object::RFC_Object_Obj4.Vx = dllGetRadarFCObjVelX(@hil_ctrl::Handle_RoadObj, object_id);
        @CAN_RadarFC::RFC_Object::RFC_Object_Obj4.Vy = dllGetRadarFCObjVelY(@hil_ctrl::Handle_RoadObj, object_id);
        @CAN_RadarFC::RFC_Object::RFC_Object_Obj4.Ax = dllGetRadarFCObjAccelX(@hil_ctrl::Handle_RoadObj, object_id);
        @CAN_RadarFC::RFC_Object::RFC_Object_Obj4.Ay = dllGetRadarFCObjAccelY(@hil_ctrl::Handle_RoadObj, object_id);
        @CAN_RadarFC::RFC_Object::RFC_Object_Obj4.MovingStatus = dllGetRadarFCObjRa6MovingStatus(@hil_ctrl::Handle_RoadObj, object_id);
        @CAN_RadarFC::RFC_Object::RFC_Object_Obj4.Age += front_corner_cycle_time * 10; //50 ms * 10 = unit is 100us
        @CAN_RadarFC::RFC_Object::RFC_Object_Obj4.ProbClassType = dllGetRadarFCObjRa6ObjType(@hil_ctrl::Handle_RoadObj, object_id);
        @CAN_RadarFC::RFC_Object::RFC_Object_Obj4.ReferencePoint = dllGetRadarFCObjRefPnt(@hil_ctrl::Handle_RoadObj, object_id);
        @CAN_RadarFC::RFC_Object::RFC_Object_Obj4.FilterInformation = 0; // PER has not yet defined this signal
        break;
        
      case 4: //"Object-4"
        /**
          * Constant values
          */
        @CAN_RadarFC::RFC_Object::RFC_Object_Obj5.ObjId = injection_counter_radar_fc + 1;
        @CAN_RadarFC::RFC_Object::RFC_Object_Obj5.WidthVnce = 0;
        @CAN_RadarFC::RFC_Object::RFC_Object_Obj5.VxVnce = 0;
        @CAN_RadarFC::RFC_Object::RFC_Object_Obj5.AyVnce = 0;
        @CAN_RadarFC::RFC_Object::RFC_Object_Obj5.OrientationYawVnce = 0;
        @CAN_RadarFC::RFC_Object::RFC_Object_Obj5.LengthVnce = 0;
        @CAN_RadarFC::RFC_Object::RFC_Object_Obj5.AxVnce = 0;
        @CAN_RadarFC::RFC_Object::RFC_Object_Obj5.PyVnce = 0;
        @CAN_RadarFC::RFC_Object::RFC_Object_Obj5.PxVnce = 0;
        @CAN_RadarFC::RFC_Object::RFC_Object_Obj5.PxPyCoVnce = 0;
        @CAN_RadarFC::RFC_Object::RFC_Object_Obj5.PyAxCoVnce = 0;
        @CAN_RadarFC::RFC_Object::RFC_Object_Obj5.AxAyCoVnce = 0;
        @CAN_RadarFC::RFC_Object::RFC_Object_Obj5.VyAyCoVnce = 0;
        @CAN_RadarFC::RFC_Object::RFC_Object_Obj5.VyAxCoVnce = 0;
        @CAN_RadarFC::RFC_Object::RFC_Object_Obj5.VxAyCoVnce = 0;
        @CAN_RadarFC::RFC_Object::RFC_Object_Obj5.VxAxCoVnce = 0;
        @CAN_RadarFC::RFC_Object::RFC_Object_Obj5.VxVyCoVnce = 0;
        @CAN_RadarFC::RFC_Object::RFC_Object_Obj5.VyVnce = 0;
        @CAN_RadarFC::RFC_Object::RFC_Object_Obj5.PyAyCoVnce = 0;
        @CAN_RadarFC::RFC_Object::RFC_Object_Obj5.PxAyCoVnce = 0;
        @CAN_RadarFC::RFC_Object::RFC_Object_Obj5.PxAxCoVnce = 0;
        @CAN_RadarFC::RFC_Object::RFC_Object_Obj5.PyVyCoVnce = 0;
        @CAN_RadarFC::RFC_Object::RFC_Object_Obj5.PxVyCoVnce = 0;
        @CAN_RadarFC::RFC_Object::RFC_Object_Obj5.PxVxCoVnce = 0;
        @CAN_RadarFC::RFC_Object::RFC_Object_Obj5.PyVxCoVnce = 0;
        @CAN_RadarFC::RFC_Object::RFC_Object_Obj5.ExistProb = 100;
        @CAN_RadarFC::RFC_Object::RFC_Object_Obj5.ProbClassConfidence = 100;
        @CAN_RadarFC::RFC_Object::RFC_Object_Obj5.MeasurementStatus = 0; // always measured
        
        /**
          * Variable values
          */
        @CAN_RadarFC::RFC_Object::RFC_Object_Obj5.OrientationYaw = dllGetRadarFCObjYawAngle(@hil_ctrl::Handle_RoadObj, object_id);
        @CAN_RadarFC::RFC_Object::RFC_Object_Obj5.Width = dllGetRadarFCInputObjectWidth(@hil_ctrl::Handle_RoadObj, object_id);
        @CAN_RadarFC::RFC_Object::RFC_Object_Obj5.Length = dllGetRadarFCInputObjectLength(@hil_ctrl::Handle_RoadObj, object_id);
        @CAN_RadarFC::RFC_Object::RFC_Object_Obj5.RCS = dllGetRadarFCObjRa6RCS(@hil_ctrl::Handle_RoadObj, object_id);
        @CAN_RadarFC::RFC_Object::RFC_Object_Obj5.Px = dllGetRadarFCObjDistX(@hil_ctrl::Handle_RoadObj, object_id);
        @CAN_RadarFC::RFC_Object::RFC_Object_Obj5.Py = dllGetRadarFCObjDistY(@hil_ctrl::Handle_RoadObj, object_id);
        @CAN_RadarFC::RFC_Object::RFC_Object_Obj5.Vx = dllGetRadarFCObjVelX(@hil_ctrl::Handle_RoadObj, object_id);
        @CAN_RadarFC::RFC_Object::RFC_Object_Obj5.Vy = dllGetRadarFCObjVelY(@hil_ctrl::Handle_RoadObj, object_id);
        @CAN_RadarFC::RFC_Object::RFC_Object_Obj5.Ax = dllGetRadarFCObjAccelX(@hil_ctrl::Handle_RoadObj, object_id);
        @CAN_RadarFC::RFC_Object::RFC_Object_Obj5.Ay = dllGetRadarFCObjAccelY(@hil_ctrl::Handle_RoadObj, object_id);
        @CAN_RadarFC::RFC_Object::RFC_Object_Obj5.MovingStatus = dllGetRadarFCObjRa6MovingStatus(@hil_ctrl::Handle_RoadObj, object_id);
        @CAN_RadarFC::RFC_Object::RFC_Object_Obj5.Age += front_corner_cycle_time * 10; //50 ms * 10 = unit is 100us
        @CAN_RadarFC::RFC_Object::RFC_Object_Obj5.ProbClassType = dllGetRadarFCObjRa6ObjType(@hil_ctrl::Handle_RoadObj, object_id);
        @CAN_RadarFC::RFC_Object::RFC_Object_Obj5.ReferencePoint = dllGetRadarFCObjRefPnt(@hil_ctrl::Handle_RoadObj, object_id);
        @CAN_RadarFC::RFC_Object::RFC_Object_Obj5.FilterInformation = 0; // PER has not yet defined this signal
        break;
        
      case 5: //"Object-5"
        /**
          * Constant values
          */
        @CAN_RadarFC::RFC_Object::RFC_Object_Obj6.ObjId = injection_counter_radar_fc + 1;
        @CAN_RadarFC::RFC_Object::RFC_Object_Obj6.WidthVnce = 0;
        @CAN_RadarFC::RFC_Object::RFC_Object_Obj6.VxVnce = 0;
        @CAN_RadarFC::RFC_Object::RFC_Object_Obj6.AyVnce = 0;
        @CAN_RadarFC::RFC_Object::RFC_Object_Obj6.OrientationYawVnce = 0;
        @CAN_RadarFC::RFC_Object::RFC_Object_Obj6.LengthVnce = 0;
        @CAN_RadarFC::RFC_Object::RFC_Object_Obj6.AxVnce = 0;
        @CAN_RadarFC::RFC_Object::RFC_Object_Obj6.PyVnce = 0;
        @CAN_RadarFC::RFC_Object::RFC_Object_Obj6.PxVnce = 0;
        @CAN_RadarFC::RFC_Object::RFC_Object_Obj6.PxPyCoVnce = 0;
        @CAN_RadarFC::RFC_Object::RFC_Object_Obj6.PyAxCoVnce = 0;
        @CAN_RadarFC::RFC_Object::RFC_Object_Obj6.AxAyCoVnce = 0;
        @CAN_RadarFC::RFC_Object::RFC_Object_Obj6.VyAyCoVnce = 0;
        @CAN_RadarFC::RFC_Object::RFC_Object_Obj6.VyAxCoVnce = 0;
        @CAN_RadarFC::RFC_Object::RFC_Object_Obj6.VxAyCoVnce = 0;
        @CAN_RadarFC::RFC_Object::RFC_Object_Obj6.VxAxCoVnce = 0;
        @CAN_RadarFC::RFC_Object::RFC_Object_Obj6.VxVyCoVnce = 0;
        @CAN_RadarFC::RFC_Object::RFC_Object_Obj6.VyVnce = 0;
        @CAN_RadarFC::RFC_Object::RFC_Object_Obj6.PyAyCoVnce = 0;
        @CAN_RadarFC::RFC_Object::RFC_Object_Obj6.PxAyCoVnce = 0;
        @CAN_RadarFC::RFC_Object::RFC_Object_Obj6.PxAxCoVnce = 0;
        @CAN_RadarFC::RFC_Object::RFC_Object_Obj6.PyVyCoVnce = 0;
        @CAN_RadarFC::RFC_Object::RFC_Object_Obj6.PxVyCoVnce = 0;
        @CAN_RadarFC::RFC_Object::RFC_Object_Obj6.PxVxCoVnce = 0;
        @CAN_RadarFC::RFC_Object::RFC_Object_Obj6.PyVxCoVnce = 0;
        @CAN_RadarFC::RFC_Object::RFC_Object_Obj6.ExistProb = 100;
        @CAN_RadarFC::RFC_Object::RFC_Object_Obj6.ProbClassConfidence = 100;
        @CAN_RadarFC::RFC_Object::RFC_Object_Obj6.MeasurementStatus = 0; // always measured
        
        /**
          * Variable values
          */
        @CAN_RadarFC::RFC_Object::RFC_Object_Obj6.OrientationYaw = dllGetRadarFCObjYawAngle(@hil_ctrl::Handle_RoadObj, object_id);
        @CAN_RadarFC::RFC_Object::RFC_Object_Obj6.Width = dllGetRadarFCInputObjectWidth(@hil_ctrl::Handle_RoadObj, object_id);
        @CAN_RadarFC::RFC_Object::RFC_Object_Obj6.Length = dllGetRadarFCInputObjectLength(@hil_ctrl::Handle_RoadObj, object_id);
        @CAN_RadarFC::RFC_Object::RFC_Object_Obj6.RCS = dllGetRadarFCObjRa6RCS(@hil_ctrl::Handle_RoadObj, object_id);
        @CAN_RadarFC::RFC_Object::RFC_Object_Obj6.Px = dllGetRadarFCObjDistX(@hil_ctrl::Handle_RoadObj, object_id);
        @CAN_RadarFC::RFC_Object::RFC_Object_Obj6.Py = dllGetRadarFCObjDistY(@hil_ctrl::Handle_RoadObj, object_id);
        @CAN_RadarFC::RFC_Object::RFC_Object_Obj6.Vx = dllGetRadarFCObjVelX(@hil_ctrl::Handle_RoadObj, object_id);
        @CAN_RadarFC::RFC_Object::RFC_Object_Obj6.Vy = dllGetRadarFCObjVelY(@hil_ctrl::Handle_RoadObj, object_id);
        @CAN_RadarFC::RFC_Object::RFC_Object_Obj6.Ax = dllGetRadarFCObjAccelX(@hil_ctrl::Handle_RoadObj, object_id);
        @CAN_RadarFC::RFC_Object::RFC_Object_Obj6.Ay = dllGetRadarFCObjAccelY(@hil_ctrl::Handle_RoadObj, object_id);
        @CAN_RadarFC::RFC_Object::RFC_Object_Obj6.MovingStatus = dllGetRadarFCObjRa6MovingStatus(@hil_ctrl::Handle_RoadObj, object_id);
        @CAN_RadarFC::RFC_Object::RFC_Object_Obj6.Age += front_corner_cycle_time * 10; //50 ms * 10 = unit is 100us
        @CAN_RadarFC::RFC_Object::RFC_Object_Obj6.ProbClassType = dllGetRadarFCObjRa6ObjType(@hil_ctrl::Handle_RoadObj, object_id);
        @CAN_RadarFC::RFC_Object::RFC_Object_Obj6.ReferencePoint = dllGetRadarFCObjRefPnt(@hil_ctrl::Handle_RoadObj, object_id);
        @CAN_RadarFC::RFC_Object::RFC_Object_Obj6.FilterInformation = 0; // PER has not yet defined this signal
        break;
        
      case 6: //"Object-6"
        /**
          * Constant values
          */
        @CAN_RadarFC::RFC_Object::RFC_Object_Obj7.ObjId = injection_counter_radar_fc + 1;
        @CAN_RadarFC::RFC_Object::RFC_Object_Obj7.WidthVnce = 0;
        @CAN_RadarFC::RFC_Object::RFC_Object_Obj7.VxVnce = 0;
        @CAN_RadarFC::RFC_Object::RFC_Object_Obj7.AyVnce = 0;
        @CAN_RadarFC::RFC_Object::RFC_Object_Obj7.OrientationYawVnce = 0;
        @CAN_RadarFC::RFC_Object::RFC_Object_Obj7.LengthVnce = 0;
        @CAN_RadarFC::RFC_Object::RFC_Object_Obj7.AxVnce = 0;
        @CAN_RadarFC::RFC_Object::RFC_Object_Obj7.PyVnce = 0;
        @CAN_RadarFC::RFC_Object::RFC_Object_Obj7.PxVnce = 0;
        @CAN_RadarFC::RFC_Object::RFC_Object_Obj7.PxPyCoVnce = 0;
        @CAN_RadarFC::RFC_Object::RFC_Object_Obj7.PyAxCoVnce = 0;
        @CAN_RadarFC::RFC_Object::RFC_Object_Obj7.AxAyCoVnce = 0;
        @CAN_RadarFC::RFC_Object::RFC_Object_Obj7.VyAyCoVnce = 0;
        @CAN_RadarFC::RFC_Object::RFC_Object_Obj7.VyAxCoVnce = 0;
        @CAN_RadarFC::RFC_Object::RFC_Object_Obj7.VxAyCoVnce = 0;
        @CAN_RadarFC::RFC_Object::RFC_Object_Obj7.VxAxCoVnce = 0;
        @CAN_RadarFC::RFC_Object::RFC_Object_Obj7.VxVyCoVnce = 0;
        @CAN_RadarFC::RFC_Object::RFC_Object_Obj7.VyVnce = 0;
        @CAN_RadarFC::RFC_Object::RFC_Object_Obj7.PyAyCoVnce = 0;
        @CAN_RadarFC::RFC_Object::RFC_Object_Obj7.PxAyCoVnce = 0;
        @CAN_RadarFC::RFC_Object::RFC_Object_Obj7.PxAxCoVnce = 0;
        @CAN_RadarFC::RFC_Object::RFC_Object_Obj7.PyVyCoVnce = 0;
        @CAN_RadarFC::RFC_Object::RFC_Object_Obj7.PxVyCoVnce = 0;
        @CAN_RadarFC::RFC_Object::RFC_Object_Obj7.PxVxCoVnce = 0;
        @CAN_RadarFC::RFC_Object::RFC_Object_Obj7.PyVxCoVnce = 0;
        @CAN_RadarFC::RFC_Object::RFC_Object_Obj7.ExistProb = 100;
        @CAN_RadarFC::RFC_Object::RFC_Object_Obj7.ProbClassConfidence = 100;
        @CAN_RadarFC::RFC_Object::RFC_Object_Obj7.MeasurementStatus = 0; // always measured
        
        /**
          * Variable values
          */
        @CAN_RadarFC::RFC_Object::RFC_Object_Obj7.OrientationYaw = dllGetRadarFCObjYawAngle(@hil_ctrl::Handle_RoadObj, object_id);
        @CAN_RadarFC::RFC_Object::RFC_Object_Obj7.Width = dllGetRadarFCInputObjectWidth(@hil_ctrl::Handle_RoadObj, object_id);
        @CAN_RadarFC::RFC_Object::RFC_Object_Obj7.Length = dllGetRadarFCInputObjectLength(@hil_ctrl::Handle_RoadObj, object_id);
        @CAN_RadarFC::RFC_Object::RFC_Object_Obj7.RCS = dllGetRadarFCObjRa6RCS(@hil_ctrl::Handle_RoadObj, object_id);
        @CAN_RadarFC::RFC_Object::RFC_Object_Obj7.Px = dllGetRadarFCObjDistX(@hil_ctrl::Handle_RoadObj, object_id);
        @CAN_RadarFC::RFC_Object::RFC_Object_Obj7.Py = dllGetRadarFCObjDistY(@hil_ctrl::Handle_RoadObj, object_id);
        @CAN_RadarFC::RFC_Object::RFC_Object_Obj7.Vx = dllGetRadarFCObjVelX(@hil_ctrl::Handle_RoadObj, object_id);
        @CAN_RadarFC::RFC_Object::RFC_Object_Obj7.Vy = dllGetRadarFCObjVelY(@hil_ctrl::Handle_RoadObj, object_id);
        @CAN_RadarFC::RFC_Object::RFC_Object_Obj7.Ax = dllGetRadarFCObjAccelX(@hil_ctrl::Handle_RoadObj, object_id);
        @CAN_RadarFC::RFC_Object::RFC_Object_Obj7.Ay = dllGetRadarFCObjAccelY(@hil_ctrl::Handle_RoadObj, object_id);
        @CAN_RadarFC::RFC_Object::RFC_Object_Obj7.MovingStatus = dllGetRadarFCObjRa6MovingStatus(@hil_ctrl::Handle_RoadObj, object_id);
        @CAN_RadarFC::RFC_Object::RFC_Object_Obj7.Age += front_corner_cycle_time * 10; //50 ms * 10 = unit is 100us
        @CAN_RadarFC::RFC_Object::RFC_Object_Obj7.ProbClassType = dllGetRadarFCObjRa6ObjType(@hil_ctrl::Handle_RoadObj, object_id);
        @CAN_RadarFC::RFC_Object::RFC_Object_Obj7.ReferencePoint = dllGetRadarFCObjRefPnt(@hil_ctrl::Handle_RoadObj, object_id);
        @CAN_RadarFC::RFC_Object::RFC_Object_Obj7.FilterInformation = 0; // PER has not yet defined this signal
        break;
        
      case 7: //"Object-7"
        /**
          * Constant values
          */
        @CAN_RadarFC::RFC_Object::RFC_Object_Obj8.ObjId = injection_counter_radar_fc + 1;
        @CAN_RadarFC::RFC_Object::RFC_Object_Obj8.WidthVnce = 0;
        @CAN_RadarFC::RFC_Object::RFC_Object_Obj8.VxVnce = 0;
        @CAN_RadarFC::RFC_Object::RFC_Object_Obj8.AyVnce = 0;
        @CAN_RadarFC::RFC_Object::RFC_Object_Obj8.OrientationYawVnce = 0;
        @CAN_RadarFC::RFC_Object::RFC_Object_Obj8.LengthVnce = 0;
        @CAN_RadarFC::RFC_Object::RFC_Object_Obj8.AxVnce = 0;
        @CAN_RadarFC::RFC_Object::RFC_Object_Obj8.PyVnce = 0;
        @CAN_RadarFC::RFC_Object::RFC_Object_Obj8.PxVnce = 0;
        @CAN_RadarFC::RFC_Object::RFC_Object_Obj8.PxPyCoVnce = 0;
        @CAN_RadarFC::RFC_Object::RFC_Object_Obj8.PyAxCoVnce = 0;
        @CAN_RadarFC::RFC_Object::RFC_Object_Obj8.AxAyCoVnce = 0;
        @CAN_RadarFC::RFC_Object::RFC_Object_Obj8.VyAyCoVnce = 0;
        @CAN_RadarFC::RFC_Object::RFC_Object_Obj8.VyAxCoVnce = 0;
        @CAN_RadarFC::RFC_Object::RFC_Object_Obj8.VxAyCoVnce = 0;
        @CAN_RadarFC::RFC_Object::RFC_Object_Obj8.VxAxCoVnce = 0;
        @CAN_RadarFC::RFC_Object::RFC_Object_Obj8.VxVyCoVnce = 0;
        @CAN_RadarFC::RFC_Object::RFC_Object_Obj8.VyVnce = 0;
        @CAN_RadarFC::RFC_Object::RFC_Object_Obj8.PyAyCoVnce = 0;
        @CAN_RadarFC::RFC_Object::RFC_Object_Obj8.PxAyCoVnce = 0;
        @CAN_RadarFC::RFC_Object::RFC_Object_Obj8.PxAxCoVnce = 0;
        @CAN_RadarFC::RFC_Object::RFC_Object_Obj8.PyVyCoVnce = 0;
        @CAN_RadarFC::RFC_Object::RFC_Object_Obj8.PxVyCoVnce = 0;
        @CAN_RadarFC::RFC_Object::RFC_Object_Obj8.PxVxCoVnce = 0;
        @CAN_RadarFC::RFC_Object::RFC_Object_Obj8.PyVxCoVnce = 0;
        @CAN_RadarFC::RFC_Object::RFC_Object_Obj8.ExistProb = 100;
        @CAN_RadarFC::RFC_Object::RFC_Object_Obj8.ProbClassConfidence = 100;
        @CAN_RadarFC::RFC_Object::RFC_Object_Obj8.MeasurementStatus = 0; // always measured
        
        /**
          * Variable values
          */
        @CAN_RadarFC::RFC_Object::RFC_Object_Obj8.OrientationYaw = dllGetRadarFCObjYawAngle(@hil_ctrl::Handle_RoadObj, object_id);
        @CAN_RadarFC::RFC_Object::RFC_Object_Obj8.Width = dllGetRadarFCInputObjectWidth(@hil_ctrl::Handle_RoadObj, object_id);
        @CAN_RadarFC::RFC_Object::RFC_Object_Obj8.Length = dllGetRadarFCInputObjectLength(@hil_ctrl::Handle_RoadObj, object_id);
        @CAN_RadarFC::RFC_Object::RFC_Object_Obj8.RCS = dllGetRadarFCObjRa6RCS(@hil_ctrl::Handle_RoadObj, object_id);
        @CAN_RadarFC::RFC_Object::RFC_Object_Obj8.Px = dllGetRadarFCObjDistX(@hil_ctrl::Handle_RoadObj, object_id);
        @CAN_RadarFC::RFC_Object::RFC_Object_Obj8.Py = dllGetRadarFCObjDistY(@hil_ctrl::Handle_RoadObj, object_id);
        @CAN_RadarFC::RFC_Object::RFC_Object_Obj8.Vx = dllGetRadarFCObjVelX(@hil_ctrl::Handle_RoadObj, object_id);
        @CAN_RadarFC::RFC_Object::RFC_Object_Obj8.Vy = dllGetRadarFCObjVelY(@hil_ctrl::Handle_RoadObj, object_id);
        @CAN_RadarFC::RFC_Object::RFC_Object_Obj8.Ax = dllGetRadarFCObjAccelX(@hil_ctrl::Handle_RoadObj, object_id);
        @CAN_RadarFC::RFC_Object::RFC_Object_Obj8.Ay = dllGetRadarFCObjAccelY(@hil_ctrl::Handle_RoadObj, object_id);
        @CAN_RadarFC::RFC_Object::RFC_Object_Obj8.MovingStatus = dllGetRadarFCObjRa6MovingStatus(@hil_ctrl::Handle_RoadObj, object_id);
        @CAN_RadarFC::RFC_Object::RFC_Object_Obj8.Age += front_corner_cycle_time * 10; //50 ms * 10 = unit is 100us
        @CAN_RadarFC::RFC_Object::RFC_Object_Obj8.ProbClassType = dllGetRadarFCObjRa6ObjType(@hil_ctrl::Handle_RoadObj, object_id);
        @CAN_RadarFC::RFC_Object::RFC_Object_Obj8.ReferencePoint = dllGetRadarFCObjRefPnt(@hil_ctrl::Handle_RoadObj, object_id);
        @CAN_RadarFC::RFC_Object::RFC_Object_Obj8.FilterInformation = 0; // PER has not yet defined this signal
        break;
        
      case 8: //"Object-8"
        /**
          * Constant values
          */
        @CAN_RadarFC::RFC_Object::RFC_Object_Obj9.ObjId = injection_counter_radar_fc + 1;
        @CAN_RadarFC::RFC_Object::RFC_Object_Obj9.WidthVnce = 0;
        @CAN_RadarFC::RFC_Object::RFC_Object_Obj9.VxVnce = 0;
        @CAN_RadarFC::RFC_Object::RFC_Object_Obj9.AyVnce = 0;
        @CAN_RadarFC::RFC_Object::RFC_Object_Obj9.OrientationYawVnce = 0;
        @CAN_RadarFC::RFC_Object::RFC_Object_Obj9.LengthVnce = 0;
        @CAN_RadarFC::RFC_Object::RFC_Object_Obj9.AxVnce = 0;
        @CAN_RadarFC::RFC_Object::RFC_Object_Obj9.PyVnce = 0;
        @CAN_RadarFC::RFC_Object::RFC_Object_Obj9.PxVnce = 0;
        @CAN_RadarFC::RFC_Object::RFC_Object_Obj9.PxPyCoVnce = 0;
        @CAN_RadarFC::RFC_Object::RFC_Object_Obj9.PyAxCoVnce = 0;
        @CAN_RadarFC::RFC_Object::RFC_Object_Obj9.AxAyCoVnce = 0;
        @CAN_RadarFC::RFC_Object::RFC_Object_Obj9.VyAyCoVnce = 0;
        @CAN_RadarFC::RFC_Object::RFC_Object_Obj9.VyAxCoVnce = 0;
        @CAN_RadarFC::RFC_Object::RFC_Object_Obj9.VxAyCoVnce = 0;
        @CAN_RadarFC::RFC_Object::RFC_Object_Obj9.VxAxCoVnce = 0;
        @CAN_RadarFC::RFC_Object::RFC_Object_Obj9.VxVyCoVnce = 0;
        @CAN_RadarFC::RFC_Object::RFC_Object_Obj9.VyVnce = 0;
        @CAN_RadarFC::RFC_Object::RFC_Object_Obj9.PyAyCoVnce = 0;
        @CAN_RadarFC::RFC_Object::RFC_Object_Obj9.PxAyCoVnce = 0;
        @CAN_RadarFC::RFC_Object::RFC_Object_Obj9.PxAxCoVnce = 0;
        @CAN_RadarFC::RFC_Object::RFC_Object_Obj9.PyVyCoVnce = 0;
        @CAN_RadarFC::RFC_Object::RFC_Object_Obj9.PxVyCoVnce = 0;
        @CAN_RadarFC::RFC_Object::RFC_Object_Obj9.PxVxCoVnce = 0;
        @CAN_RadarFC::RFC_Object::RFC_Object_Obj9.PyVxCoVnce = 0;
        @CAN_RadarFC::RFC_Object::RFC_Object_Obj9.ExistProb = 100;
        @CAN_RadarFC::RFC_Object::RFC_Object_Obj9.ProbClassConfidence = 100;
        @CAN_RadarFC::RFC_Object::RFC_Object_Obj9.MeasurementStatus = 0; // always measured
        
        /**
          * Variable values
          */
        @CAN_RadarFC::RFC_Object::RFC_Object_Obj9.OrientationYaw = dllGetRadarFCObjYawAngle(@hil_ctrl::Handle_RoadObj, object_id);
        @CAN_RadarFC::RFC_Object::RFC_Object_Obj9.Width = dllGetRadarFCInputObjectWidth(@hil_ctrl::Handle_RoadObj, object_id);
        @CAN_RadarFC::RFC_Object::RFC_Object_Obj9.Length = dllGetRadarFCInputObjectLength(@hil_ctrl::Handle_RoadObj, object_id);
        @CAN_RadarFC::RFC_Object::RFC_Object_Obj9.RCS = dllGetRadarFCObjRa6RCS(@hil_ctrl::Handle_RoadObj, object_id);
        @CAN_RadarFC::RFC_Object::RFC_Object_Obj9.Px = dllGetRadarFCObjDistX(@hil_ctrl::Handle_RoadObj, object_id);
        @CAN_RadarFC::RFC_Object::RFC_Object_Obj9.Py = dllGetRadarFCObjDistY(@hil_ctrl::Handle_RoadObj, object_id);
        @CAN_RadarFC::RFC_Object::RFC_Object_Obj9.Vx = dllGetRadarFCObjVelX(@hil_ctrl::Handle_RoadObj, object_id);
        @CAN_RadarFC::RFC_Object::RFC_Object_Obj9.Vy = dllGetRadarFCObjVelY(@hil_ctrl::Handle_RoadObj, object_id);
        @CAN_RadarFC::RFC_Object::RFC_Object_Obj9.Ax = dllGetRadarFCObjAccelX(@hil_ctrl::Handle_RoadObj, object_id);
        @CAN_RadarFC::RFC_Object::RFC_Object_Obj9.Ay = dllGetRadarFCObjAccelY(@hil_ctrl::Handle_RoadObj, object_id);
        @CAN_RadarFC::RFC_Object::RFC_Object_Obj9.MovingStatus = dllGetRadarFCObjRa6MovingStatus(@hil_ctrl::Handle_RoadObj, object_id);
        @CAN_RadarFC::RFC_Object::RFC_Object_Obj9.Age += front_corner_cycle_time * 10; //50 ms * 10 = unit is 100us
        @CAN_RadarFC::RFC_Object::RFC_Object_Obj9.ProbClassType = dllGetRadarFCObjRa6ObjType(@hil_ctrl::Handle_RoadObj, object_id);
        @CAN_RadarFC::RFC_Object::RFC_Object_Obj9.ReferencePoint = dllGetRadarFCObjRefPnt(@hil_ctrl::Handle_RoadObj, object_id);
        @CAN_RadarFC::RFC_Object::RFC_Object_Obj9.FilterInformation = 0; // PER has not yet defined this signal
        break;
        
    }
  }
  else if(injection_method == 2)
  { //Real sensor -> XCP
    @sysvar::XCP::RadarFC_Obj::_g_PL_AD_fw_Radar_1R1V_rpc_XilObjBypassingRunnable_XilObjBypassingRunnable_m_pad_radarObjPort_par_out_local::TChangeableMemPool::_::_::_m_arrayPool::_0_::_elem::_m_alignment::_m_alpAzimuthAngOffsetN = -1146;
    @sysvar::XCP::RadarFC_Obj::_g_PL_AD_fw_Radar_1R1V_rpc_XilObjBypassingRunnable_XilObjBypassingRunnable_m_pad_radarObjPort_par_out_local::TChangeableMemPool::_::_::_m_arrayPool::_0_::_elem::_m_alignment::_m_alpMountAngleN = 0;
    @sysvar::XCP::RadarFC_Obj::_g_PL_AD_fw_Radar_1R1V_rpc_XilObjBypassingRunnable_XilObjBypassingRunnable_m_pad_radarObjPort_par_out_local::TChangeableMemPool::_::_::_m_arrayPool::_0_::_elem::_m_alignment::_m_dLongitudinalOffsetRearAxisN = @radarfc_par::mounting_pos_x * 128;
    @sysvar::XCP::RadarFC_Obj::_g_PL_AD_fw_Radar_1R1V_rpc_XilObjBypassingRunnable_XilObjBypassingRunnable_m_pad_radarObjPort_par_out_local::TChangeableMemPool::_::_::_m_arrayPool::_0_::_elem::_m_alignment::_m_dMountElevationN = @radarfc_par::mounting_pos_z * 32;
    @sysvar::XCP::RadarFC_Obj::_g_PL_AD_fw_Radar_1R1V_rpc_XilObjBypassingRunnable_XilObjBypassingRunnable_m_pad_radarObjPort_par_out_local::TChangeableMemPool::_::_::_m_arrayPool::_0_::_elem::_m_alignment::_m_dMountOffsetN = 0;
    
    switch (object_id)
    {
      case 0: //"Object-0"
        // constant values
        @sysvar::XCP::RadarFC_Obj::_g_PL_AD_fw_Radar_1R1V_rpc_XilObjBypassingRunnable_XilObjBypassingRunnable_m_pad_radarObjPort_par_out_local::TChangeableMemPool::_::_::_m_arrayPool::_0_::_elem::_m_objectInformation::_0_::_Valid_b = 1;
        @sysvar::XCP::RadarFC_Obj::_g_PL_AD_fw_Radar_1R1V_rpc_XilObjBypassingRunnable_XilObjBypassingRunnable_m_pad_radarObjPort_par_out_local::TChangeableMemPool::_::_::_m_arrayPool::_0_::_elem::_m_objectInformation::_0_::_m_HandleN = 1;
        @sysvar::XCP::RadarFC_Obj::_g_PL_AD_fw_Radar_1R1V_rpc_XilObjBypassingRunnable_XilObjBypassingRunnable_m_pad_radarObjPort_par_out_local::TChangeableMemPool::_::_::_m_arrayPool::_0_::_elem::_m_objectInformation::_0_::_m_alpPiVarYawAngleN = 3;
        @sysvar::XCP::RadarFC_Obj::_g_PL_AD_fw_Radar_1R1V_rpc_XilObjBypassingRunnable_XilObjBypassingRunnable_m_pad_radarObjPort_par_out_local::TChangeableMemPool::_::_::_m_arrayPool::_0_::_elem::_m_objectInformation::_0_::_m_varAxN = 0;
        @sysvar::XCP::RadarFC_Obj::_g_PL_AD_fw_Radar_1R1V_rpc_XilObjBypassingRunnable_XilObjBypassingRunnable_m_pad_radarObjPort_par_out_local::TChangeableMemPool::_::_::_m_arrayPool::_0_::_elem::_m_objectInformation::_0_::_m_varAyN = 0;
        @sysvar::XCP::RadarFC_Obj::_g_PL_AD_fw_Radar_1R1V_rpc_XilObjBypassingRunnable_XilObjBypassingRunnable_m_pad_radarObjPort_par_out_local::TChangeableMemPool::_::_::_m_arrayPool::_0_::_elem::_m_objectInformation::_0_::_m_varVxN = 0;
        @sysvar::XCP::RadarFC_Obj::_g_PL_AD_fw_Radar_1R1V_rpc_XilObjBypassingRunnable_XilObjBypassingRunnable_m_pad_radarObjPort_par_out_local::TChangeableMemPool::_::_::_m_arrayPool::_0_::_elem::_m_objectInformation::_0_::_m_varVyN = 0;
        @sysvar::XCP::RadarFC_Obj::_g_PL_AD_fw_Radar_1R1V_rpc_XilObjBypassingRunnable_XilObjBypassingRunnable_m_pad_radarObjPort_par_out_local::TChangeableMemPool::_::_::_m_arrayPool::_0_::_elem::_m_objectInformation::_0_::_m_varDxN = 0;
        @sysvar::XCP::RadarFC_Obj::_g_PL_AD_fw_Radar_1R1V_rpc_XilObjBypassingRunnable_XilObjBypassingRunnable_m_pad_radarObjPort_par_out_local::TChangeableMemPool::_::_::_m_arrayPool::_0_::_elem::_m_objectInformation::_0_::_m_varDyN = 0;
        @sysvar::XCP::RadarFC_Obj::_g_PL_AD_fw_Radar_1R1V_rpc_XilObjBypassingRunnable_XilObjBypassingRunnable_m_pad_radarObjPort_par_out_local::TChangeableMemPool::_::_::_m_arrayPool::_0_::_elem::_m_objectInformation::_0_::_m_dVarLengthN = 0;
        @sysvar::XCP::RadarFC_Obj::_g_PL_AD_fw_Radar_1R1V_rpc_XilObjBypassingRunnable_XilObjBypassingRunnable_m_pad_radarObjPort_par_out_local::TChangeableMemPool::_::_::_m_arrayPool::_0_::_elem::_m_objectInformation::_0_::_m_dVarWidthN = 0;
        @sysvar::XCP::RadarFC_Obj::_g_PL_AD_fw_Radar_1R1V_rpc_XilObjBypassingRunnable_XilObjBypassingRunnable_m_pad_radarObjPort_par_out_local::TChangeableMemPool::_::_::_m_arrayPool::_0_::_elem::_m_objectInformation::_0_::_m_wExistProbN = 64880;
        @sysvar::XCP::RadarFC_Obj::_g_PL_AD_fw_Radar_1R1V_rpc_XilObjBypassingRunnable_XilObjBypassingRunnable_m_pad_radarObjPort_par_out_local::TChangeableMemPool::_::_::_m_arrayPool::_0_::_elem::_m_objectInformation::_0_::_m_isObjectAsil = 1;
        
        // target dimensions
        @sysvar::XCP::RadarFC_Obj::_g_PL_AD_fw_Radar_1R1V_rpc_XilObjBypassingRunnable_XilObjBypassingRunnable_m_pad_radarObjPort_par_out_local::TChangeableMemPool::_::_::_m_arrayPool::_0_::_elem::_m_objectInformation::_0_::_m_dWidthN = dllGetRadarFCInputObjectWidth(@hil_ctrl::Handle_RoadObj, 0) * 128;
        @sysvar::XCP::RadarFC_Obj::_g_PL_AD_fw_Radar_1R1V_rpc_XilObjBypassingRunnable_XilObjBypassingRunnable_m_pad_radarObjPort_par_out_local::TChangeableMemPool::_::_::_m_arrayPool::_0_::_elem::_m_objectInformation::_0_::_m_dLengthN = dllGetRadarFCInputObjectLength(@hil_ctrl::Handle_RoadObj, 0) * 64;
          
        // target movement
        @sysvar::XCP::RadarFC_Obj::_g_PL_AD_fw_Radar_1R1V_rpc_XilObjBypassingRunnable_XilObjBypassingRunnable_m_pad_radarObjPort_par_out_local::TChangeableMemPool::_::_::_m_arrayPool::_0_::_elem::_m_objectInformation::_0_::_m_dxN = dllGetRadarFCObjDistX(@hil_ctrl::Handle_RoadObj, 0) * 128;
        @sysvar::XCP::RadarFC_Obj::_g_PL_AD_fw_Radar_1R1V_rpc_XilObjBypassingRunnable_XilObjBypassingRunnable_m_pad_radarObjPort_par_out_local::TChangeableMemPool::_::_::_m_arrayPool::_0_::_elem::_m_objectInformation::_0_::_m_dyN = dllGetRadarFCObjDistY(@hil_ctrl::Handle_RoadObj, 0) * 128;
        @sysvar::XCP::RadarFC_Obj::_g_PL_AD_fw_Radar_1R1V_rpc_XilObjBypassingRunnable_XilObjBypassingRunnable_m_pad_radarObjPort_par_out_local::TChangeableMemPool::_::_::_m_arrayPool::_0_::_elem::_m_objectInformation::_0_::_m_dzN = 0;
        @sysvar::XCP::RadarFC_Obj::_g_PL_AD_fw_Radar_1R1V_rpc_XilObjBypassingRunnable_XilObjBypassingRunnable_m_pad_radarObjPort_par_out_local::TChangeableMemPool::_::_::_m_arrayPool::_0_::_elem::_m_objectInformation::_0_::_m_vxN = dllGetRadarFCObjVelX(@hil_ctrl::Handle_RoadObj, 0) * 256;
        @sysvar::XCP::RadarFC_Obj::_g_PL_AD_fw_Radar_1R1V_rpc_XilObjBypassingRunnable_XilObjBypassingRunnable_m_pad_radarObjPort_par_out_local::TChangeableMemPool::_::_::_m_arrayPool::_0_::_elem::_m_objectInformation::_0_::_m_vyN = dllGetRadarFCObjVelY(@hil_ctrl::Handle_RoadObj, 0) * 256;
        @sysvar::XCP::RadarFC_Obj::_g_PL_AD_fw_Radar_1R1V_rpc_XilObjBypassingRunnable_XilObjBypassingRunnable_m_pad_radarObjPort_par_out_local::TChangeableMemPool::_::_::_m_arrayPool::_0_::_elem::_m_objectInformation::_0_::_m_axN = 0;
        @sysvar::XCP::RadarFC_Obj::_g_PL_AD_fw_Radar_1R1V_rpc_XilObjBypassingRunnable_XilObjBypassingRunnable_m_pad_radarObjPort_par_out_local::TChangeableMemPool::_::_::_m_arrayPool::_0_::_elem::_m_objectInformation::_0_::_m_ayN = 0;
        @sysvar::XCP::RadarFC_Obj::_g_PL_AD_fw_Radar_1R1V_rpc_XilObjBypassingRunnable_XilObjBypassingRunnable_m_pad_radarObjPort_par_out_local::TChangeableMemPool::_::_::_m_arrayPool::_0_::_elem::_m_objectInformation::_0_::_m_alpPiYawAngleN = dllGetRadarFCObjYawAngle(@hil_ctrl::Handle_RoadObj, 0) * 128; // 128 correct?
        
        // target probabilities
        @sysvar::XCP::RadarFC_Obj::_g_PL_AD_fw_Radar_1R1V_rpc_XilObjBypassingRunnable_XilObjBypassingRunnable_m_pad_radarObjPort_par_out_local::TChangeableMemPool::_::_::_m_arrayPool::_0_::_elem::_m_objectInformation::_0_::_m_prob1HasBeenObservedMovingN = dllGetRadarFCObjProbMoving(@hil_ctrl::Handle_RoadObj, object_id) * 1.26;
        @sysvar::XCP::RadarFC_Obj::_g_PL_AD_fw_Radar_1R1V_rpc_XilObjBypassingRunnable_XilObjBypassingRunnable_m_pad_radarObjPort_par_out_local::TChangeableMemPool::_::_::_m_arrayPool::_0_::_elem::_m_objectInformation::_0_::_m_prob1MovingN = dllGetRadarFCObjProbMoving(@hil_ctrl::Handle_RoadObj, object_id) * 1.26;
        @sysvar::XCP::RadarFC_Obj::_g_PL_AD_fw_Radar_1R1V_rpc_XilObjBypassingRunnable_XilObjBypassingRunnable_m_pad_radarObjPort_par_out_local::TChangeableMemPool::_::_::_m_arrayPool::_0_::_elem::_m_objectInformation::_0_::_m_perObjectType::_m_prob1ObstacleN = (100 - dllGetRadarFCObjProbNonObst(@hil_ctrl::Handle_RoadObj, object_id)) * 1.28;
        @sysvar::XCP::RadarFC_Obj::_g_PL_AD_fw_Radar_1R1V_rpc_XilObjBypassingRunnable_XilObjBypassingRunnable_m_pad_radarObjPort_par_out_local::TChangeableMemPool::_::_::_m_arrayPool::_0_::_elem::_m_objectInformation::_0_::_m_perObjectType::_m_prob1NonObstacleN = dllGetRadarFCObjProbNonObst(@hil_ctrl::Handle_RoadObj, object_id) * 1.28;
        @sysvar::XCP::RadarFC_Obj::_g_PL_AD_fw_Radar_1R1V_rpc_XilObjBypassingRunnable_XilObjBypassingRunnable_m_pad_radarObjPort_par_out_local::TChangeableMemPool::_::_::_m_arrayPool::_0_::_elem::_m_objectInformation::_0_::_m_perObjectType::_m_prob1MobileN = dllGetRadarFCObjProbMoving(@hil_ctrl::Handle_RoadObj, object_id) * 1.28;
        @sysvar::XCP::RadarFC_Obj::_g_PL_AD_fw_Radar_1R1V_rpc_XilObjBypassingRunnable_XilObjBypassingRunnable_m_pad_radarObjPort_par_out_local::TChangeableMemPool::_::_::_m_arrayPool::_0_::_elem::_m_objectInformation::_0_::_m_perObjectType::_m_prob1StationaryN = (100 - dllGetRadarFCObjProbMoving(@hil_ctrl::Handle_RoadObj, object_id)) * 1.28;
        @sysvar::XCP::RadarFC_Obj::_g_PL_AD_fw_Radar_1R1V_rpc_XilObjBypassingRunnable_XilObjBypassingRunnable_m_pad_radarObjPort_par_out_local::TChangeableMemPool::_::_::_m_arrayPool::_0_::_elem::_m_objectInformation::_0_::_m_perObjectType::_m_prob1FourPlusWheelerN = (dllGetRadarFCObjProbCar(@hil_ctrl::Handle_RoadObj, object_id) + dllGetRadarFCObjProbTruck(@hil_ctrl::Handle_RoadObj, object_id)) * 1.28;
        @sysvar::XCP::RadarFC_Obj::_g_PL_AD_fw_Radar_1R1V_rpc_XilObjBypassingRunnable_XilObjBypassingRunnable_m_pad_radarObjPort_par_out_local::TChangeableMemPool::_::_::_m_arrayPool::_0_::_elem::_m_objectInformation::_0_::_m_perObjectType::_m_prob1TwoWheelerN = dllGetRadarFCObjProb2Wheeler(@hil_ctrl::Handle_RoadObj, object_id) * 1.28;
        @sysvar::XCP::RadarFC_Obj::_g_PL_AD_fw_Radar_1R1V_rpc_XilObjBypassingRunnable_XilObjBypassingRunnable_m_pad_radarObjPort_par_out_local::TChangeableMemPool::_::_::_m_arrayPool::_0_::_elem::_m_objectInformation::_0_::_m_perObjectType::_m_prob1PedestrianN = dllGetRadarFCObjProbPedestrian(@hil_ctrl::Handle_RoadObj, object_id) * 1.28;
        @sysvar::XCP::RadarFC_Obj::_g_PL_AD_fw_Radar_1R1V_rpc_XilObjBypassingRunnable_XilObjBypassingRunnable_m_pad_radarObjPort_par_out_local::TChangeableMemPool::_::_::_m_arrayPool::_0_::_elem::_m_objectInformation::_0_::_m_perObjectType::_m_prob1RoadsideBarrierN = (100 - dllGetRadarFCObjProbMoving(@hil_ctrl::Handle_RoadObj, object_id)) * 1.28;
        @sysvar::XCP::RadarFC_Obj::_g_PL_AD_fw_Radar_1R1V_rpc_XilObjBypassingRunnable_XilObjBypassingRunnable_m_pad_radarObjPort_par_out_local::TChangeableMemPool::_::_::_m_arrayPool::_0_::_elem::_m_objectInformation::_0_::_m_perObjectType::_m_prob1PassengerCarN = dllGetRadarFCObjProbCar(@hil_ctrl::Handle_RoadObj, object_id) * 1.28;
        @sysvar::XCP::RadarFC_Obj::_g_PL_AD_fw_Radar_1R1V_rpc_XilObjBypassingRunnable_XilObjBypassingRunnable_m_pad_radarObjPort_par_out_local::TChangeableMemPool::_::_::_m_arrayPool::_0_::_elem::_m_objectInformation::_0_::_m_perObjectType::_m_prob1TruckN = dllGetRadarFCObjProbTruck(@hil_ctrl::Handle_RoadObj, object_id) * 1.28;
        @sysvar::XCP::RadarFC_Obj::_g_PL_AD_fw_Radar_1R1V_rpc_XilObjBypassingRunnable_XilObjBypassingRunnable_m_pad_radarObjPort_par_out_local::TChangeableMemPool::_::_::_m_arrayPool::_0_::_elem::_m_objectInformation::_0_::_m_perObjectType::_m_prob1UnknownN = 0;
        @sysvar::XCP::RadarFC_Obj::_g_PL_AD_fw_Radar_1R1V_rpc_XilObjBypassingRunnable_XilObjBypassingRunnable_m_pad_radarObjPort_par_out_local::TChangeableMemPool::_::_::_m_arrayPool::_0_::_elem::_m_objectInformation::_0_::_m_perObjectType::_m_prob1MovUnknownN = 0;
        @sysvar::XCP::RadarFC_Obj::_g_PL_AD_fw_Radar_1R1V_rpc_XilObjBypassingRunnable_XilObjBypassingRunnable_m_pad_radarObjPort_par_out_local::TChangeableMemPool::_::_::_m_arrayPool::_0_::_elem::_m_objectInformation::_0_::_m_perObjectType::_m_prob1StatUnknownN = 0; // 128 previously
        @sysvar::XCP::RadarFC_Obj::_g_PL_AD_fw_Radar_1R1V_rpc_XilObjBypassingRunnable_XilObjBypassingRunnable_m_pad_radarObjPort_par_out_local::TChangeableMemPool::_::_::_m_arrayPool::_0_::_elem::_m_objectInformation::_0_::_m_perObjectType::_m_prob1ObstUnknownN = 0;
        @sysvar::XCP::RadarFC_Obj::_g_PL_AD_fw_Radar_1R1V_rpc_XilObjBypassingRunnable_XilObjBypassingRunnable_m_pad_radarObjPort_par_out_local::TChangeableMemPool::_::_::_m_arrayPool::_0_::_elem::_m_objectInformation::_0_::_m_perObjectType::_m_prob1FourWheelUnknownN = 0;
        break;
        
      case 1: //"Object-1"
        // constant values
        @sysvar::XCP::RadarFC_Obj::_g_PL_AD_fw_Radar_1R1V_rpc_XilObjBypassingRunnable_XilObjBypassingRunnable_m_pad_radarObjPort_par_out_local::TChangeableMemPool::_::_::_m_arrayPool::_0_::_elem::_m_objectInformation::_1_::_Valid_b = 1;
        @sysvar::XCP::RadarFC_Obj::_g_PL_AD_fw_Radar_1R1V_rpc_XilObjBypassingRunnable_XilObjBypassingRunnable_m_pad_radarObjPort_par_out_local::TChangeableMemPool::_::_::_m_arrayPool::_0_::_elem::_m_objectInformation::_1_::_m_HandleN = 1;
        @sysvar::XCP::RadarFC_Obj::_g_PL_AD_fw_Radar_1R1V_rpc_XilObjBypassingRunnable_XilObjBypassingRunnable_m_pad_radarObjPort_par_out_local::TChangeableMemPool::_::_::_m_arrayPool::_0_::_elem::_m_objectInformation::_1_::_m_alpPiVarYawAngleN = 3;
        @sysvar::XCP::RadarFC_Obj::_g_PL_AD_fw_Radar_1R1V_rpc_XilObjBypassingRunnable_XilObjBypassingRunnable_m_pad_radarObjPort_par_out_local::TChangeableMemPool::_::_::_m_arrayPool::_0_::_elem::_m_objectInformation::_1_::_m_varAxN = 0;
        @sysvar::XCP::RadarFC_Obj::_g_PL_AD_fw_Radar_1R1V_rpc_XilObjBypassingRunnable_XilObjBypassingRunnable_m_pad_radarObjPort_par_out_local::TChangeableMemPool::_::_::_m_arrayPool::_0_::_elem::_m_objectInformation::_1_::_m_varAyN = 0;
        @sysvar::XCP::RadarFC_Obj::_g_PL_AD_fw_Radar_1R1V_rpc_XilObjBypassingRunnable_XilObjBypassingRunnable_m_pad_radarObjPort_par_out_local::TChangeableMemPool::_::_::_m_arrayPool::_0_::_elem::_m_objectInformation::_1_::_m_varVxN = 0;
        @sysvar::XCP::RadarFC_Obj::_g_PL_AD_fw_Radar_1R1V_rpc_XilObjBypassingRunnable_XilObjBypassingRunnable_m_pad_radarObjPort_par_out_local::TChangeableMemPool::_::_::_m_arrayPool::_0_::_elem::_m_objectInformation::_1_::_m_varVyN = 0;
        @sysvar::XCP::RadarFC_Obj::_g_PL_AD_fw_Radar_1R1V_rpc_XilObjBypassingRunnable_XilObjBypassingRunnable_m_pad_radarObjPort_par_out_local::TChangeableMemPool::_::_::_m_arrayPool::_0_::_elem::_m_objectInformation::_1_::_m_varDxN = 0;
        @sysvar::XCP::RadarFC_Obj::_g_PL_AD_fw_Radar_1R1V_rpc_XilObjBypassingRunnable_XilObjBypassingRunnable_m_pad_radarObjPort_par_out_local::TChangeableMemPool::_::_::_m_arrayPool::_0_::_elem::_m_objectInformation::_1_::_m_varDyN = 0;
        @sysvar::XCP::RadarFC_Obj::_g_PL_AD_fw_Radar_1R1V_rpc_XilObjBypassingRunnable_XilObjBypassingRunnable_m_pad_radarObjPort_par_out_local::TChangeableMemPool::_::_::_m_arrayPool::_0_::_elem::_m_objectInformation::_1_::_m_dVarLengthN = 0;
        @sysvar::XCP::RadarFC_Obj::_g_PL_AD_fw_Radar_1R1V_rpc_XilObjBypassingRunnable_XilObjBypassingRunnable_m_pad_radarObjPort_par_out_local::TChangeableMemPool::_::_::_m_arrayPool::_0_::_elem::_m_objectInformation::_1_::_m_dVarWidthN = 0;
        @sysvar::XCP::RadarFC_Obj::_g_PL_AD_fw_Radar_1R1V_rpc_XilObjBypassingRunnable_XilObjBypassingRunnable_m_pad_radarObjPort_par_out_local::TChangeableMemPool::_::_::_m_arrayPool::_0_::_elem::_m_objectInformation::_1_::_m_wExistProbN = 64880;
        @sysvar::XCP::RadarFC_Obj::_g_PL_AD_fw_Radar_1R1V_rpc_XilObjBypassingRunnable_XilObjBypassingRunnable_m_pad_radarObjPort_par_out_local::TChangeableMemPool::_::_::_m_arrayPool::_0_::_elem::_m_objectInformation::_1_::_m_isObjectAsil = 1;
        
        // target dimensions
        @sysvar::XCP::RadarFC_Obj::_g_PL_AD_fw_Radar_1R1V_rpc_XilObjBypassingRunnable_XilObjBypassingRunnable_m_pad_radarObjPort_par_out_local::TChangeableMemPool::_::_::_m_arrayPool::_0_::_elem::_m_objectInformation::_1_::_m_dWidthN = dllGetRadarFCInputObjectWidth(@hil_ctrl::Handle_RoadObj, 0) * 128;
        @sysvar::XCP::RadarFC_Obj::_g_PL_AD_fw_Radar_1R1V_rpc_XilObjBypassingRunnable_XilObjBypassingRunnable_m_pad_radarObjPort_par_out_local::TChangeableMemPool::_::_::_m_arrayPool::_0_::_elem::_m_objectInformation::_1_::_m_dLengthN = dllGetRadarFCInputObjectLength(@hil_ctrl::Handle_RoadObj, 0) * 64;
          
        // target movement
        @sysvar::XCP::RadarFC_Obj::_g_PL_AD_fw_Radar_1R1V_rpc_XilObjBypassingRunnable_XilObjBypassingRunnable_m_pad_radarObjPort_par_out_local::TChangeableMemPool::_::_::_m_arrayPool::_0_::_elem::_m_objectInformation::_1_::_m_dxN = dllGetRadarFCObjDistX(@hil_ctrl::Handle_RoadObj, 0) * 128;
        @sysvar::XCP::RadarFC_Obj::_g_PL_AD_fw_Radar_1R1V_rpc_XilObjBypassingRunnable_XilObjBypassingRunnable_m_pad_radarObjPort_par_out_local::TChangeableMemPool::_::_::_m_arrayPool::_0_::_elem::_m_objectInformation::_1_::_m_dyN = dllGetRadarFCObjDistY(@hil_ctrl::Handle_RoadObj, 0) * 128;
        @sysvar::XCP::RadarFC_Obj::_g_PL_AD_fw_Radar_1R1V_rpc_XilObjBypassingRunnable_XilObjBypassingRunnable_m_pad_radarObjPort_par_out_local::TChangeableMemPool::_::_::_m_arrayPool::_0_::_elem::_m_objectInformation::_1_::_m_dzN = 0;
        @sysvar::XCP::RadarFC_Obj::_g_PL_AD_fw_Radar_1R1V_rpc_XilObjBypassingRunnable_XilObjBypassingRunnable_m_pad_radarObjPort_par_out_local::TChangeableMemPool::_::_::_m_arrayPool::_0_::_elem::_m_objectInformation::_1_::_m_vxN = dllGetRadarFCObjVelX(@hil_ctrl::Handle_RoadObj, 0) * 256;
        @sysvar::XCP::RadarFC_Obj::_g_PL_AD_fw_Radar_1R1V_rpc_XilObjBypassingRunnable_XilObjBypassingRunnable_m_pad_radarObjPort_par_out_local::TChangeableMemPool::_::_::_m_arrayPool::_0_::_elem::_m_objectInformation::_1_::_m_vyN = dllGetRadarFCObjVelY(@hil_ctrl::Handle_RoadObj, 0) * 256;
        @sysvar::XCP::RadarFC_Obj::_g_PL_AD_fw_Radar_1R1V_rpc_XilObjBypassingRunnable_XilObjBypassingRunnable_m_pad_radarObjPort_par_out_local::TChangeableMemPool::_::_::_m_arrayPool::_0_::_elem::_m_objectInformation::_1_::_m_axN = 0;
        @sysvar::XCP::RadarFC_Obj::_g_PL_AD_fw_Radar_1R1V_rpc_XilObjBypassingRunnable_XilObjBypassingRunnable_m_pad_radarObjPort_par_out_local::TChangeableMemPool::_::_::_m_arrayPool::_0_::_elem::_m_objectInformation::_1_::_m_ayN = 0;
        @sysvar::XCP::RadarFC_Obj::_g_PL_AD_fw_Radar_1R1V_rpc_XilObjBypassingRunnable_XilObjBypassingRunnable_m_pad_radarObjPort_par_out_local::TChangeableMemPool::_::_::_m_arrayPool::_0_::_elem::_m_objectInformation::_1_::_m_alpPiYawAngleN = dllGetRadarFCObjYawAngle(@hil_ctrl::Handle_RoadObj, 0) * 128; // 128 correct?
        
        // target probabilities
        @sysvar::XCP::RadarFC_Obj::_g_PL_AD_fw_Radar_1R1V_rpc_XilObjBypassingRunnable_XilObjBypassingRunnable_m_pad_radarObjPort_par_out_local::TChangeableMemPool::_::_::_m_arrayPool::_0_::_elem::_m_objectInformation::_1_::_m_prob1HasBeenObservedMovingN = dllGetRadarFCObjProbMoving(@hil_ctrl::Handle_RoadObj, object_id) * 1.26;
        @sysvar::XCP::RadarFC_Obj::_g_PL_AD_fw_Radar_1R1V_rpc_XilObjBypassingRunnable_XilObjBypassingRunnable_m_pad_radarObjPort_par_out_local::TChangeableMemPool::_::_::_m_arrayPool::_0_::_elem::_m_objectInformation::_1_::_m_prob1MovingN = dllGetRadarFCObjProbMoving(@hil_ctrl::Handle_RoadObj, object_id) * 1.26;
        @sysvar::XCP::RadarFC_Obj::_g_PL_AD_fw_Radar_1R1V_rpc_XilObjBypassingRunnable_XilObjBypassingRunnable_m_pad_radarObjPort_par_out_local::TChangeableMemPool::_::_::_m_arrayPool::_0_::_elem::_m_objectInformation::_1_::_m_perObjectType::_m_prob1ObstacleN = (100 - dllGetRadarFCObjProbNonObst(@hil_ctrl::Handle_RoadObj, object_id)) * 1.28;
        @sysvar::XCP::RadarFC_Obj::_g_PL_AD_fw_Radar_1R1V_rpc_XilObjBypassingRunnable_XilObjBypassingRunnable_m_pad_radarObjPort_par_out_local::TChangeableMemPool::_::_::_m_arrayPool::_0_::_elem::_m_objectInformation::_1_::_m_perObjectType::_m_prob1NonObstacleN = dllGetRadarFCObjProbNonObst(@hil_ctrl::Handle_RoadObj, object_id) * 1.28;
        @sysvar::XCP::RadarFC_Obj::_g_PL_AD_fw_Radar_1R1V_rpc_XilObjBypassingRunnable_XilObjBypassingRunnable_m_pad_radarObjPort_par_out_local::TChangeableMemPool::_::_::_m_arrayPool::_0_::_elem::_m_objectInformation::_1_::_m_perObjectType::_m_prob1MobileN = dllGetRadarFCObjProbMoving(@hil_ctrl::Handle_RoadObj, object_id) * 1.28;
        @sysvar::XCP::RadarFC_Obj::_g_PL_AD_fw_Radar_1R1V_rpc_XilObjBypassingRunnable_XilObjBypassingRunnable_m_pad_radarObjPort_par_out_local::TChangeableMemPool::_::_::_m_arrayPool::_0_::_elem::_m_objectInformation::_1_::_m_perObjectType::_m_prob1StationaryN = (100 - dllGetRadarFCObjProbMoving(@hil_ctrl::Handle_RoadObj, object_id)) * 1.28;
        @sysvar::XCP::RadarFC_Obj::_g_PL_AD_fw_Radar_1R1V_rpc_XilObjBypassingRunnable_XilObjBypassingRunnable_m_pad_radarObjPort_par_out_local::TChangeableMemPool::_::_::_m_arrayPool::_0_::_elem::_m_objectInformation::_1_::_m_perObjectType::_m_prob1FourPlusWheelerN = (dllGetRadarFCObjProbCar(@hil_ctrl::Handle_RoadObj, object_id) + dllGetRadarFCObjProbTruck(@hil_ctrl::Handle_RoadObj, object_id)) * 1.28;
        @sysvar::XCP::RadarFC_Obj::_g_PL_AD_fw_Radar_1R1V_rpc_XilObjBypassingRunnable_XilObjBypassingRunnable_m_pad_radarObjPort_par_out_local::TChangeableMemPool::_::_::_m_arrayPool::_0_::_elem::_m_objectInformation::_1_::_m_perObjectType::_m_prob1TwoWheelerN = dllGetRadarFCObjProb2Wheeler(@hil_ctrl::Handle_RoadObj, object_id) * 1.28;
        @sysvar::XCP::RadarFC_Obj::_g_PL_AD_fw_Radar_1R1V_rpc_XilObjBypassingRunnable_XilObjBypassingRunnable_m_pad_radarObjPort_par_out_local::TChangeableMemPool::_::_::_m_arrayPool::_0_::_elem::_m_objectInformation::_1_::_m_perObjectType::_m_prob1PedestrianN = dllGetRadarFCObjProbPedestrian(@hil_ctrl::Handle_RoadObj, object_id) * 1.28;
        @sysvar::XCP::RadarFC_Obj::_g_PL_AD_fw_Radar_1R1V_rpc_XilObjBypassingRunnable_XilObjBypassingRunnable_m_pad_radarObjPort_par_out_local::TChangeableMemPool::_::_::_m_arrayPool::_0_::_elem::_m_objectInformation::_1_::_m_perObjectType::_m_prob1RoadsideBarrierN = (100 - dllGetRadarFCObjProbMoving(@hil_ctrl::Handle_RoadObj, object_id)) * 1.28;
        @sysvar::XCP::RadarFC_Obj::_g_PL_AD_fw_Radar_1R1V_rpc_XilObjBypassingRunnable_XilObjBypassingRunnable_m_pad_radarObjPort_par_out_local::TChangeableMemPool::_::_::_m_arrayPool::_0_::_elem::_m_objectInformation::_1_::_m_perObjectType::_m_prob1PassengerCarN = dllGetRadarFCObjProbCar(@hil_ctrl::Handle_RoadObj, object_id) * 1.28;
        @sysvar::XCP::RadarFC_Obj::_g_PL_AD_fw_Radar_1R1V_rpc_XilObjBypassingRunnable_XilObjBypassingRunnable_m_pad_radarObjPort_par_out_local::TChangeableMemPool::_::_::_m_arrayPool::_0_::_elem::_m_objectInformation::_1_::_m_perObjectType::_m_prob1TruckN = dllGetRadarFCObjProbTruck(@hil_ctrl::Handle_RoadObj, object_id) * 1.28;
        @sysvar::XCP::RadarFC_Obj::_g_PL_AD_fw_Radar_1R1V_rpc_XilObjBypassingRunnable_XilObjBypassingRunnable_m_pad_radarObjPort_par_out_local::TChangeableMemPool::_::_::_m_arrayPool::_0_::_elem::_m_objectInformation::_1_::_m_perObjectType::_m_prob1UnknownN = 0;
        @sysvar::XCP::RadarFC_Obj::_g_PL_AD_fw_Radar_1R1V_rpc_XilObjBypassingRunnable_XilObjBypassingRunnable_m_pad_radarObjPort_par_out_local::TChangeableMemPool::_::_::_m_arrayPool::_0_::_elem::_m_objectInformation::_1_::_m_perObjectType::_m_prob1MovUnknownN = 0;
        @sysvar::XCP::RadarFC_Obj::_g_PL_AD_fw_Radar_1R1V_rpc_XilObjBypassingRunnable_XilObjBypassingRunnable_m_pad_radarObjPort_par_out_local::TChangeableMemPool::_::_::_m_arrayPool::_0_::_elem::_m_objectInformation::_1_::_m_perObjectType::_m_prob1StatUnknownN = 0; // 128 previously
        @sysvar::XCP::RadarFC_Obj::_g_PL_AD_fw_Radar_1R1V_rpc_XilObjBypassingRunnable_XilObjBypassingRunnable_m_pad_radarObjPort_par_out_local::TChangeableMemPool::_::_::_m_arrayPool::_0_::_elem::_m_objectInformation::_1_::_m_perObjectType::_m_prob1ObstUnknownN = 0;
        @sysvar::XCP::RadarFC_Obj::_g_PL_AD_fw_Radar_1R1V_rpc_XilObjBypassingRunnable_XilObjBypassingRunnable_m_pad_radarObjPort_par_out_local::TChangeableMemPool::_::_::_m_arrayPool::_0_::_elem::_m_objectInformation::_1_::_m_perObjectType::_m_prob1FourWheelUnknownN = 0;
        break;
        
      case 2: //"Object-2"
        // constant values
        @sysvar::XCP::RadarFC_Obj::_g_PL_AD_fw_Radar_1R1V_rpc_XilObjBypassingRunnable_XilObjBypassingRunnable_m_pad_radarObjPort_par_out_local::TChangeableMemPool::_::_::_m_arrayPool::_0_::_elem::_m_objectInformation::_2_::_Valid_b = 1;
        @sysvar::XCP::RadarFC_Obj::_g_PL_AD_fw_Radar_1R1V_rpc_XilObjBypassingRunnable_XilObjBypassingRunnable_m_pad_radarObjPort_par_out_local::TChangeableMemPool::_::_::_m_arrayPool::_0_::_elem::_m_objectInformation::_2_::_m_HandleN = 1;
        @sysvar::XCP::RadarFC_Obj::_g_PL_AD_fw_Radar_1R1V_rpc_XilObjBypassingRunnable_XilObjBypassingRunnable_m_pad_radarObjPort_par_out_local::TChangeableMemPool::_::_::_m_arrayPool::_0_::_elem::_m_objectInformation::_2_::_m_alpPiVarYawAngleN = 3;
        @sysvar::XCP::RadarFC_Obj::_g_PL_AD_fw_Radar_1R1V_rpc_XilObjBypassingRunnable_XilObjBypassingRunnable_m_pad_radarObjPort_par_out_local::TChangeableMemPool::_::_::_m_arrayPool::_0_::_elem::_m_objectInformation::_2_::_m_varAxN = 0;
        @sysvar::XCP::RadarFC_Obj::_g_PL_AD_fw_Radar_1R1V_rpc_XilObjBypassingRunnable_XilObjBypassingRunnable_m_pad_radarObjPort_par_out_local::TChangeableMemPool::_::_::_m_arrayPool::_0_::_elem::_m_objectInformation::_2_::_m_varAyN = 0;
        @sysvar::XCP::RadarFC_Obj::_g_PL_AD_fw_Radar_1R1V_rpc_XilObjBypassingRunnable_XilObjBypassingRunnable_m_pad_radarObjPort_par_out_local::TChangeableMemPool::_::_::_m_arrayPool::_0_::_elem::_m_objectInformation::_2_::_m_varVxN = 0;
        @sysvar::XCP::RadarFC_Obj::_g_PL_AD_fw_Radar_1R1V_rpc_XilObjBypassingRunnable_XilObjBypassingRunnable_m_pad_radarObjPort_par_out_local::TChangeableMemPool::_::_::_m_arrayPool::_0_::_elem::_m_objectInformation::_2_::_m_varVyN = 0;
        @sysvar::XCP::RadarFC_Obj::_g_PL_AD_fw_Radar_1R1V_rpc_XilObjBypassingRunnable_XilObjBypassingRunnable_m_pad_radarObjPort_par_out_local::TChangeableMemPool::_::_::_m_arrayPool::_0_::_elem::_m_objectInformation::_2_::_m_varDxN = 0;
        @sysvar::XCP::RadarFC_Obj::_g_PL_AD_fw_Radar_1R1V_rpc_XilObjBypassingRunnable_XilObjBypassingRunnable_m_pad_radarObjPort_par_out_local::TChangeableMemPool::_::_::_m_arrayPool::_0_::_elem::_m_objectInformation::_2_::_m_varDyN = 0;
        @sysvar::XCP::RadarFC_Obj::_g_PL_AD_fw_Radar_1R1V_rpc_XilObjBypassingRunnable_XilObjBypassingRunnable_m_pad_radarObjPort_par_out_local::TChangeableMemPool::_::_::_m_arrayPool::_0_::_elem::_m_objectInformation::_2_::_m_dVarLengthN = 0;
        @sysvar::XCP::RadarFC_Obj::_g_PL_AD_fw_Radar_1R1V_rpc_XilObjBypassingRunnable_XilObjBypassingRunnable_m_pad_radarObjPort_par_out_local::TChangeableMemPool::_::_::_m_arrayPool::_0_::_elem::_m_objectInformation::_2_::_m_dVarWidthN = 0;
        @sysvar::XCP::RadarFC_Obj::_g_PL_AD_fw_Radar_1R1V_rpc_XilObjBypassingRunnable_XilObjBypassingRunnable_m_pad_radarObjPort_par_out_local::TChangeableMemPool::_::_::_m_arrayPool::_0_::_elem::_m_objectInformation::_2_::_m_wExistProbN = 64880;
        @sysvar::XCP::RadarFC_Obj::_g_PL_AD_fw_Radar_1R1V_rpc_XilObjBypassingRunnable_XilObjBypassingRunnable_m_pad_radarObjPort_par_out_local::TChangeableMemPool::_::_::_m_arrayPool::_0_::_elem::_m_objectInformation::_2_::_m_isObjectAsil = 1;
        
        // target dimensions
        @sysvar::XCP::RadarFC_Obj::_g_PL_AD_fw_Radar_1R1V_rpc_XilObjBypassingRunnable_XilObjBypassingRunnable_m_pad_radarObjPort_par_out_local::TChangeableMemPool::_::_::_m_arrayPool::_0_::_elem::_m_objectInformation::_2_::_m_dWidthN = dllGetRadarFCInputObjectWidth(@hil_ctrl::Handle_RoadObj, 0) * 128;
        @sysvar::XCP::RadarFC_Obj::_g_PL_AD_fw_Radar_1R1V_rpc_XilObjBypassingRunnable_XilObjBypassingRunnable_m_pad_radarObjPort_par_out_local::TChangeableMemPool::_::_::_m_arrayPool::_0_::_elem::_m_objectInformation::_2_::_m_dLengthN = dllGetRadarFCInputObjectLength(@hil_ctrl::Handle_RoadObj, 0) * 64;
          
        // target movement
        @sysvar::XCP::RadarFC_Obj::_g_PL_AD_fw_Radar_1R1V_rpc_XilObjBypassingRunnable_XilObjBypassingRunnable_m_pad_radarObjPort_par_out_local::TChangeableMemPool::_::_::_m_arrayPool::_0_::_elem::_m_objectInformation::_2_::_m_dxN = dllGetRadarFCObjDistX(@hil_ctrl::Handle_RoadObj, 0) * 128;
        @sysvar::XCP::RadarFC_Obj::_g_PL_AD_fw_Radar_1R1V_rpc_XilObjBypassingRunnable_XilObjBypassingRunnable_m_pad_radarObjPort_par_out_local::TChangeableMemPool::_::_::_m_arrayPool::_0_::_elem::_m_objectInformation::_2_::_m_dyN = dllGetRadarFCObjDistY(@hil_ctrl::Handle_RoadObj, 0) * 128;
        @sysvar::XCP::RadarFC_Obj::_g_PL_AD_fw_Radar_1R1V_rpc_XilObjBypassingRunnable_XilObjBypassingRunnable_m_pad_radarObjPort_par_out_local::TChangeableMemPool::_::_::_m_arrayPool::_0_::_elem::_m_objectInformation::_2_::_m_dzN = 0;
        @sysvar::XCP::RadarFC_Obj::_g_PL_AD_fw_Radar_1R1V_rpc_XilObjBypassingRunnable_XilObjBypassingRunnable_m_pad_radarObjPort_par_out_local::TChangeableMemPool::_::_::_m_arrayPool::_0_::_elem::_m_objectInformation::_2_::_m_vxN = dllGetRadarFCObjVelX(@hil_ctrl::Handle_RoadObj, 0) * 256;
        @sysvar::XCP::RadarFC_Obj::_g_PL_AD_fw_Radar_1R1V_rpc_XilObjBypassingRunnable_XilObjBypassingRunnable_m_pad_radarObjPort_par_out_local::TChangeableMemPool::_::_::_m_arrayPool::_0_::_elem::_m_objectInformation::_2_::_m_vyN = dllGetRadarFCObjVelY(@hil_ctrl::Handle_RoadObj, 0) * 256;
        @sysvar::XCP::RadarFC_Obj::_g_PL_AD_fw_Radar_1R1V_rpc_XilObjBypassingRunnable_XilObjBypassingRunnable_m_pad_radarObjPort_par_out_local::TChangeableMemPool::_::_::_m_arrayPool::_0_::_elem::_m_objectInformation::_2_::_m_axN = 0;
        @sysvar::XCP::RadarFC_Obj::_g_PL_AD_fw_Radar_1R1V_rpc_XilObjBypassingRunnable_XilObjBypassingRunnable_m_pad_radarObjPort_par_out_local::TChangeableMemPool::_::_::_m_arrayPool::_0_::_elem::_m_objectInformation::_2_::_m_ayN = 0;
        @sysvar::XCP::RadarFC_Obj::_g_PL_AD_fw_Radar_1R1V_rpc_XilObjBypassingRunnable_XilObjBypassingRunnable_m_pad_radarObjPort_par_out_local::TChangeableMemPool::_::_::_m_arrayPool::_0_::_elem::_m_objectInformation::_2_::_m_alpPiYawAngleN = dllGetRadarFCObjYawAngle(@hil_ctrl::Handle_RoadObj, 0) * 128; // 128 correct?
        
        // target probabilities
        @sysvar::XCP::RadarFC_Obj::_g_PL_AD_fw_Radar_1R1V_rpc_XilObjBypassingRunnable_XilObjBypassingRunnable_m_pad_radarObjPort_par_out_local::TChangeableMemPool::_::_::_m_arrayPool::_0_::_elem::_m_objectInformation::_2_::_m_prob1HasBeenObservedMovingN = dllGetRadarFCObjProbMoving(@hil_ctrl::Handle_RoadObj, object_id) * 1.26;
        @sysvar::XCP::RadarFC_Obj::_g_PL_AD_fw_Radar_1R1V_rpc_XilObjBypassingRunnable_XilObjBypassingRunnable_m_pad_radarObjPort_par_out_local::TChangeableMemPool::_::_::_m_arrayPool::_0_::_elem::_m_objectInformation::_2_::_m_prob1MovingN = dllGetRadarFCObjProbMoving(@hil_ctrl::Handle_RoadObj, object_id) * 1.26;
        @sysvar::XCP::RadarFC_Obj::_g_PL_AD_fw_Radar_1R1V_rpc_XilObjBypassingRunnable_XilObjBypassingRunnable_m_pad_radarObjPort_par_out_local::TChangeableMemPool::_::_::_m_arrayPool::_0_::_elem::_m_objectInformation::_2_::_m_perObjectType::_m_prob1ObstacleN = (100 - dllGetRadarFCObjProbNonObst(@hil_ctrl::Handle_RoadObj, object_id)) * 1.28;
        @sysvar::XCP::RadarFC_Obj::_g_PL_AD_fw_Radar_1R1V_rpc_XilObjBypassingRunnable_XilObjBypassingRunnable_m_pad_radarObjPort_par_out_local::TChangeableMemPool::_::_::_m_arrayPool::_0_::_elem::_m_objectInformation::_2_::_m_perObjectType::_m_prob1NonObstacleN = dllGetRadarFCObjProbNonObst(@hil_ctrl::Handle_RoadObj, object_id) * 1.28;
        @sysvar::XCP::RadarFC_Obj::_g_PL_AD_fw_Radar_1R1V_rpc_XilObjBypassingRunnable_XilObjBypassingRunnable_m_pad_radarObjPort_par_out_local::TChangeableMemPool::_::_::_m_arrayPool::_0_::_elem::_m_objectInformation::_2_::_m_perObjectType::_m_prob1MobileN = dllGetRadarFCObjProbMoving(@hil_ctrl::Handle_RoadObj, object_id) * 1.28;
        @sysvar::XCP::RadarFC_Obj::_g_PL_AD_fw_Radar_1R1V_rpc_XilObjBypassingRunnable_XilObjBypassingRunnable_m_pad_radarObjPort_par_out_local::TChangeableMemPool::_::_::_m_arrayPool::_0_::_elem::_m_objectInformation::_2_::_m_perObjectType::_m_prob1StationaryN = (100 - dllGetRadarFCObjProbMoving(@hil_ctrl::Handle_RoadObj, object_id)) * 1.28;
        @sysvar::XCP::RadarFC_Obj::_g_PL_AD_fw_Radar_1R1V_rpc_XilObjBypassingRunnable_XilObjBypassingRunnable_m_pad_radarObjPort_par_out_local::TChangeableMemPool::_::_::_m_arrayPool::_0_::_elem::_m_objectInformation::_2_::_m_perObjectType::_m_prob1FourPlusWheelerN = (dllGetRadarFCObjProbCar(@hil_ctrl::Handle_RoadObj, object_id) + dllGetRadarFCObjProbTruck(@hil_ctrl::Handle_RoadObj, object_id)) * 1.28;
        @sysvar::XCP::RadarFC_Obj::_g_PL_AD_fw_Radar_1R1V_rpc_XilObjBypassingRunnable_XilObjBypassingRunnable_m_pad_radarObjPort_par_out_local::TChangeableMemPool::_::_::_m_arrayPool::_0_::_elem::_m_objectInformation::_2_::_m_perObjectType::_m_prob1TwoWheelerN = dllGetRadarFCObjProb2Wheeler(@hil_ctrl::Handle_RoadObj, object_id) * 1.28;
        @sysvar::XCP::RadarFC_Obj::_g_PL_AD_fw_Radar_1R1V_rpc_XilObjBypassingRunnable_XilObjBypassingRunnable_m_pad_radarObjPort_par_out_local::TChangeableMemPool::_::_::_m_arrayPool::_0_::_elem::_m_objectInformation::_2_::_m_perObjectType::_m_prob1PedestrianN = dllGetRadarFCObjProbPedestrian(@hil_ctrl::Handle_RoadObj, object_id) * 1.28;
        @sysvar::XCP::RadarFC_Obj::_g_PL_AD_fw_Radar_1R1V_rpc_XilObjBypassingRunnable_XilObjBypassingRunnable_m_pad_radarObjPort_par_out_local::TChangeableMemPool::_::_::_m_arrayPool::_0_::_elem::_m_objectInformation::_2_::_m_perObjectType::_m_prob1RoadsideBarrierN = (100 - dllGetRadarFCObjProbMoving(@hil_ctrl::Handle_RoadObj, object_id)) * 1.28;
        @sysvar::XCP::RadarFC_Obj::_g_PL_AD_fw_Radar_1R1V_rpc_XilObjBypassingRunnable_XilObjBypassingRunnable_m_pad_radarObjPort_par_out_local::TChangeableMemPool::_::_::_m_arrayPool::_0_::_elem::_m_objectInformation::_2_::_m_perObjectType::_m_prob1PassengerCarN = dllGetRadarFCObjProbCar(@hil_ctrl::Handle_RoadObj, object_id) * 1.28;
        @sysvar::XCP::RadarFC_Obj::_g_PL_AD_fw_Radar_1R1V_rpc_XilObjBypassingRunnable_XilObjBypassingRunnable_m_pad_radarObjPort_par_out_local::TChangeableMemPool::_::_::_m_arrayPool::_0_::_elem::_m_objectInformation::_2_::_m_perObjectType::_m_prob1TruckN = dllGetRadarFCObjProbTruck(@hil_ctrl::Handle_RoadObj, object_id) * 1.28;
        @sysvar::XCP::RadarFC_Obj::_g_PL_AD_fw_Radar_1R1V_rpc_XilObjBypassingRunnable_XilObjBypassingRunnable_m_pad_radarObjPort_par_out_local::TChangeableMemPool::_::_::_m_arrayPool::_0_::_elem::_m_objectInformation::_2_::_m_perObjectType::_m_prob1UnknownN = 0;
        @sysvar::XCP::RadarFC_Obj::_g_PL_AD_fw_Radar_1R1V_rpc_XilObjBypassingRunnable_XilObjBypassingRunnable_m_pad_radarObjPort_par_out_local::TChangeableMemPool::_::_::_m_arrayPool::_0_::_elem::_m_objectInformation::_2_::_m_perObjectType::_m_prob1MovUnknownN = 0;
        @sysvar::XCP::RadarFC_Obj::_g_PL_AD_fw_Radar_1R1V_rpc_XilObjBypassingRunnable_XilObjBypassingRunnable_m_pad_radarObjPort_par_out_local::TChangeableMemPool::_::_::_m_arrayPool::_0_::_elem::_m_objectInformation::_2_::_m_perObjectType::_m_prob1StatUnknownN = 0; // 128 previously
        @sysvar::XCP::RadarFC_Obj::_g_PL_AD_fw_Radar_1R1V_rpc_XilObjBypassingRunnable_XilObjBypassingRunnable_m_pad_radarObjPort_par_out_local::TChangeableMemPool::_::_::_m_arrayPool::_0_::_elem::_m_objectInformation::_2_::_m_perObjectType::_m_prob1ObstUnknownN = 0;
        @sysvar::XCP::RadarFC_Obj::_g_PL_AD_fw_Radar_1R1V_rpc_XilObjBypassingRunnable_XilObjBypassingRunnable_m_pad_radarObjPort_par_out_local::TChangeableMemPool::_::_::_m_arrayPool::_0_::_elem::_m_objectInformation::_2_::_m_perObjectType::_m_prob1FourWheelUnknownN = 0;
        break;
        
      case 3: //"Object-3"
        // constant values
        @sysvar::XCP::RadarFC_Obj::_g_PL_AD_fw_Radar_1R1V_rpc_XilObjBypassingRunnable_XilObjBypassingRunnable_m_pad_radarObjPort_par_out_local::TChangeableMemPool::_::_::_m_arrayPool::_0_::_elem::_m_objectInformation::_3_::_Valid_b = 1;
        @sysvar::XCP::RadarFC_Obj::_g_PL_AD_fw_Radar_1R1V_rpc_XilObjBypassingRunnable_XilObjBypassingRunnable_m_pad_radarObjPort_par_out_local::TChangeableMemPool::_::_::_m_arrayPool::_0_::_elem::_m_objectInformation::_3_::_m_HandleN = 1;
        @sysvar::XCP::RadarFC_Obj::_g_PL_AD_fw_Radar_1R1V_rpc_XilObjBypassingRunnable_XilObjBypassingRunnable_m_pad_radarObjPort_par_out_local::TChangeableMemPool::_::_::_m_arrayPool::_0_::_elem::_m_objectInformation::_3_::_m_alpPiVarYawAngleN = 3;
        @sysvar::XCP::RadarFC_Obj::_g_PL_AD_fw_Radar_1R1V_rpc_XilObjBypassingRunnable_XilObjBypassingRunnable_m_pad_radarObjPort_par_out_local::TChangeableMemPool::_::_::_m_arrayPool::_0_::_elem::_m_objectInformation::_3_::_m_varAxN = 0;
        @sysvar::XCP::RadarFC_Obj::_g_PL_AD_fw_Radar_1R1V_rpc_XilObjBypassingRunnable_XilObjBypassingRunnable_m_pad_radarObjPort_par_out_local::TChangeableMemPool::_::_::_m_arrayPool::_0_::_elem::_m_objectInformation::_3_::_m_varAyN = 0;
        @sysvar::XCP::RadarFC_Obj::_g_PL_AD_fw_Radar_1R1V_rpc_XilObjBypassingRunnable_XilObjBypassingRunnable_m_pad_radarObjPort_par_out_local::TChangeableMemPool::_::_::_m_arrayPool::_0_::_elem::_m_objectInformation::_3_::_m_varVxN = 0;
        @sysvar::XCP::RadarFC_Obj::_g_PL_AD_fw_Radar_1R1V_rpc_XilObjBypassingRunnable_XilObjBypassingRunnable_m_pad_radarObjPort_par_out_local::TChangeableMemPool::_::_::_m_arrayPool::_0_::_elem::_m_objectInformation::_3_::_m_varVyN = 0;
        @sysvar::XCP::RadarFC_Obj::_g_PL_AD_fw_Radar_1R1V_rpc_XilObjBypassingRunnable_XilObjBypassingRunnable_m_pad_radarObjPort_par_out_local::TChangeableMemPool::_::_::_m_arrayPool::_0_::_elem::_m_objectInformation::_3_::_m_varDxN = 0;
        @sysvar::XCP::RadarFC_Obj::_g_PL_AD_fw_Radar_1R1V_rpc_XilObjBypassingRunnable_XilObjBypassingRunnable_m_pad_radarObjPort_par_out_local::TChangeableMemPool::_::_::_m_arrayPool::_0_::_elem::_m_objectInformation::_3_::_m_varDyN = 0;
        @sysvar::XCP::RadarFC_Obj::_g_PL_AD_fw_Radar_1R1V_rpc_XilObjBypassingRunnable_XilObjBypassingRunnable_m_pad_radarObjPort_par_out_local::TChangeableMemPool::_::_::_m_arrayPool::_0_::_elem::_m_objectInformation::_3_::_m_dVarLengthN = 0;
        @sysvar::XCP::RadarFC_Obj::_g_PL_AD_fw_Radar_1R1V_rpc_XilObjBypassingRunnable_XilObjBypassingRunnable_m_pad_radarObjPort_par_out_local::TChangeableMemPool::_::_::_m_arrayPool::_0_::_elem::_m_objectInformation::_3_::_m_dVarWidthN = 0;
        @sysvar::XCP::RadarFC_Obj::_g_PL_AD_fw_Radar_1R1V_rpc_XilObjBypassingRunnable_XilObjBypassingRunnable_m_pad_radarObjPort_par_out_local::TChangeableMemPool::_::_::_m_arrayPool::_0_::_elem::_m_objectInformation::_3_::_m_wExistProbN = 64880;
        @sysvar::XCP::RadarFC_Obj::_g_PL_AD_fw_Radar_1R1V_rpc_XilObjBypassingRunnable_XilObjBypassingRunnable_m_pad_radarObjPort_par_out_local::TChangeableMemPool::_::_::_m_arrayPool::_0_::_elem::_m_objectInformation::_3_::_m_isObjectAsil = 1;
        
        // target dimensions
        @sysvar::XCP::RadarFC_Obj::_g_PL_AD_fw_Radar_1R1V_rpc_XilObjBypassingRunnable_XilObjBypassingRunnable_m_pad_radarObjPort_par_out_local::TChangeableMemPool::_::_::_m_arrayPool::_0_::_elem::_m_objectInformation::_3_::_m_dWidthN = dllGetRadarFCInputObjectWidth(@hil_ctrl::Handle_RoadObj, 0) * 128;
        @sysvar::XCP::RadarFC_Obj::_g_PL_AD_fw_Radar_1R1V_rpc_XilObjBypassingRunnable_XilObjBypassingRunnable_m_pad_radarObjPort_par_out_local::TChangeableMemPool::_::_::_m_arrayPool::_0_::_elem::_m_objectInformation::_3_::_m_dLengthN = dllGetRadarFCInputObjectLength(@hil_ctrl::Handle_RoadObj, 0) * 64;
          
        // target movement
        @sysvar::XCP::RadarFC_Obj::_g_PL_AD_fw_Radar_1R1V_rpc_XilObjBypassingRunnable_XilObjBypassingRunnable_m_pad_radarObjPort_par_out_local::TChangeableMemPool::_::_::_m_arrayPool::_0_::_elem::_m_objectInformation::_3_::_m_dxN = dllGetRadarFCObjDistX(@hil_ctrl::Handle_RoadObj, 0) * 128;
        @sysvar::XCP::RadarFC_Obj::_g_PL_AD_fw_Radar_1R1V_rpc_XilObjBypassingRunnable_XilObjBypassingRunnable_m_pad_radarObjPort_par_out_local::TChangeableMemPool::_::_::_m_arrayPool::_0_::_elem::_m_objectInformation::_3_::_m_dyN = dllGetRadarFCObjDistY(@hil_ctrl::Handle_RoadObj, 0) * 128;
        @sysvar::XCP::RadarFC_Obj::_g_PL_AD_fw_Radar_1R1V_rpc_XilObjBypassingRunnable_XilObjBypassingRunnable_m_pad_radarObjPort_par_out_local::TChangeableMemPool::_::_::_m_arrayPool::_0_::_elem::_m_objectInformation::_3_::_m_dzN = 0;
        @sysvar::XCP::RadarFC_Obj::_g_PL_AD_fw_Radar_1R1V_rpc_XilObjBypassingRunnable_XilObjBypassingRunnable_m_pad_radarObjPort_par_out_local::TChangeableMemPool::_::_::_m_arrayPool::_0_::_elem::_m_objectInformation::_3_::_m_vxN = dllGetRadarFCObjVelX(@hil_ctrl::Handle_RoadObj, 0) * 256;
        @sysvar::XCP::RadarFC_Obj::_g_PL_AD_fw_Radar_1R1V_rpc_XilObjBypassingRunnable_XilObjBypassingRunnable_m_pad_radarObjPort_par_out_local::TChangeableMemPool::_::_::_m_arrayPool::_0_::_elem::_m_objectInformation::_3_::_m_vyN = dllGetRadarFCObjVelY(@hil_ctrl::Handle_RoadObj, 0) * 256;
        @sysvar::XCP::RadarFC_Obj::_g_PL_AD_fw_Radar_1R1V_rpc_XilObjBypassingRunnable_XilObjBypassingRunnable_m_pad_radarObjPort_par_out_local::TChangeableMemPool::_::_::_m_arrayPool::_0_::_elem::_m_objectInformation::_3_::_m_axN = 0;
        @sysvar::XCP::RadarFC_Obj::_g_PL_AD_fw_Radar_1R1V_rpc_XilObjBypassingRunnable_XilObjBypassingRunnable_m_pad_radarObjPort_par_out_local::TChangeableMemPool::_::_::_m_arrayPool::_0_::_elem::_m_objectInformation::_3_::_m_ayN = 0;
        @sysvar::XCP::RadarFC_Obj::_g_PL_AD_fw_Radar_1R1V_rpc_XilObjBypassingRunnable_XilObjBypassingRunnable_m_pad_radarObjPort_par_out_local::TChangeableMemPool::_::_::_m_arrayPool::_0_::_elem::_m_objectInformation::_3_::_m_alpPiYawAngleN = dllGetRadarFCObjYawAngle(@hil_ctrl::Handle_RoadObj, 0) * 128; // 128 correct?
        
        // target probabilities
        @sysvar::XCP::RadarFC_Obj::_g_PL_AD_fw_Radar_1R1V_rpc_XilObjBypassingRunnable_XilObjBypassingRunnable_m_pad_radarObjPort_par_out_local::TChangeableMemPool::_::_::_m_arrayPool::_0_::_elem::_m_objectInformation::_3_::_m_prob1HasBeenObservedMovingN = dllGetRadarFCObjProbMoving(@hil_ctrl::Handle_RoadObj, object_id) * 1.26;
        @sysvar::XCP::RadarFC_Obj::_g_PL_AD_fw_Radar_1R1V_rpc_XilObjBypassingRunnable_XilObjBypassingRunnable_m_pad_radarObjPort_par_out_local::TChangeableMemPool::_::_::_m_arrayPool::_0_::_elem::_m_objectInformation::_3_::_m_prob1MovingN = dllGetRadarFCObjProbMoving(@hil_ctrl::Handle_RoadObj, object_id) * 1.26;
        @sysvar::XCP::RadarFC_Obj::_g_PL_AD_fw_Radar_1R1V_rpc_XilObjBypassingRunnable_XilObjBypassingRunnable_m_pad_radarObjPort_par_out_local::TChangeableMemPool::_::_::_m_arrayPool::_0_::_elem::_m_objectInformation::_3_::_m_perObjectType::_m_prob1ObstacleN = (100 - dllGetRadarFCObjProbNonObst(@hil_ctrl::Handle_RoadObj, object_id)) * 1.28;
        @sysvar::XCP::RadarFC_Obj::_g_PL_AD_fw_Radar_1R1V_rpc_XilObjBypassingRunnable_XilObjBypassingRunnable_m_pad_radarObjPort_par_out_local::TChangeableMemPool::_::_::_m_arrayPool::_0_::_elem::_m_objectInformation::_3_::_m_perObjectType::_m_prob1NonObstacleN = dllGetRadarFCObjProbNonObst(@hil_ctrl::Handle_RoadObj, object_id) * 1.28;
        @sysvar::XCP::RadarFC_Obj::_g_PL_AD_fw_Radar_1R1V_rpc_XilObjBypassingRunnable_XilObjBypassingRunnable_m_pad_radarObjPort_par_out_local::TChangeableMemPool::_::_::_m_arrayPool::_0_::_elem::_m_objectInformation::_3_::_m_perObjectType::_m_prob1MobileN = dllGetRadarFCObjProbMoving(@hil_ctrl::Handle_RoadObj, object_id) * 1.28;
        @sysvar::XCP::RadarFC_Obj::_g_PL_AD_fw_Radar_1R1V_rpc_XilObjBypassingRunnable_XilObjBypassingRunnable_m_pad_radarObjPort_par_out_local::TChangeableMemPool::_::_::_m_arrayPool::_0_::_elem::_m_objectInformation::_3_::_m_perObjectType::_m_prob1StationaryN = (100 - dllGetRadarFCObjProbMoving(@hil_ctrl::Handle_RoadObj, object_id)) * 1.28;
        @sysvar::XCP::RadarFC_Obj::_g_PL_AD_fw_Radar_1R1V_rpc_XilObjBypassingRunnable_XilObjBypassingRunnable_m_pad_radarObjPort_par_out_local::TChangeableMemPool::_::_::_m_arrayPool::_0_::_elem::_m_objectInformation::_3_::_m_perObjectType::_m_prob1FourPlusWheelerN = (dllGetRadarFCObjProbCar(@hil_ctrl::Handle_RoadObj, object_id) + dllGetRadarFCObjProbTruck(@hil_ctrl::Handle_RoadObj, object_id)) * 1.28;
        @sysvar::XCP::RadarFC_Obj::_g_PL_AD_fw_Radar_1R1V_rpc_XilObjBypassingRunnable_XilObjBypassingRunnable_m_pad_radarObjPort_par_out_local::TChangeableMemPool::_::_::_m_arrayPool::_0_::_elem::_m_objectInformation::_3_::_m_perObjectType::_m_prob1TwoWheelerN = dllGetRadarFCObjProb2Wheeler(@hil_ctrl::Handle_RoadObj, object_id) * 1.28;
        @sysvar::XCP::RadarFC_Obj::_g_PL_AD_fw_Radar_1R1V_rpc_XilObjBypassingRunnable_XilObjBypassingRunnable_m_pad_radarObjPort_par_out_local::TChangeableMemPool::_::_::_m_arrayPool::_0_::_elem::_m_objectInformation::_3_::_m_perObjectType::_m_prob1PedestrianN = dllGetRadarFCObjProbPedestrian(@hil_ctrl::Handle_RoadObj, object_id) * 1.28;
        @sysvar::XCP::RadarFC_Obj::_g_PL_AD_fw_Radar_1R1V_rpc_XilObjBypassingRunnable_XilObjBypassingRunnable_m_pad_radarObjPort_par_out_local::TChangeableMemPool::_::_::_m_arrayPool::_0_::_elem::_m_objectInformation::_3_::_m_perObjectType::_m_prob1RoadsideBarrierN = (100 - dllGetRadarFCObjProbMoving(@hil_ctrl::Handle_RoadObj, object_id)) * 1.28;
        @sysvar::XCP::RadarFC_Obj::_g_PL_AD_fw_Radar_1R1V_rpc_XilObjBypassingRunnable_XilObjBypassingRunnable_m_pad_radarObjPort_par_out_local::TChangeableMemPool::_::_::_m_arrayPool::_0_::_elem::_m_objectInformation::_3_::_m_perObjectType::_m_prob1PassengerCarN = dllGetRadarFCObjProbCar(@hil_ctrl::Handle_RoadObj, object_id) * 1.28;
        @sysvar::XCP::RadarFC_Obj::_g_PL_AD_fw_Radar_1R1V_rpc_XilObjBypassingRunnable_XilObjBypassingRunnable_m_pad_radarObjPort_par_out_local::TChangeableMemPool::_::_::_m_arrayPool::_0_::_elem::_m_objectInformation::_3_::_m_perObjectType::_m_prob1TruckN = dllGetRadarFCObjProbTruck(@hil_ctrl::Handle_RoadObj, object_id) * 1.28;
        @sysvar::XCP::RadarFC_Obj::_g_PL_AD_fw_Radar_1R1V_rpc_XilObjBypassingRunnable_XilObjBypassingRunnable_m_pad_radarObjPort_par_out_local::TChangeableMemPool::_::_::_m_arrayPool::_0_::_elem::_m_objectInformation::_3_::_m_perObjectType::_m_prob1UnknownN = 0;
        @sysvar::XCP::RadarFC_Obj::_g_PL_AD_fw_Radar_1R1V_rpc_XilObjBypassingRunnable_XilObjBypassingRunnable_m_pad_radarObjPort_par_out_local::TChangeableMemPool::_::_::_m_arrayPool::_0_::_elem::_m_objectInformation::_3_::_m_perObjectType::_m_prob1MovUnknownN = 0;
        @sysvar::XCP::RadarFC_Obj::_g_PL_AD_fw_Radar_1R1V_rpc_XilObjBypassingRunnable_XilObjBypassingRunnable_m_pad_radarObjPort_par_out_local::TChangeableMemPool::_::_::_m_arrayPool::_0_::_elem::_m_objectInformation::_3_::_m_perObjectType::_m_prob1StatUnknownN = 0; // 128 previously
        @sysvar::XCP::RadarFC_Obj::_g_PL_AD_fw_Radar_1R1V_rpc_XilObjBypassingRunnable_XilObjBypassingRunnable_m_pad_radarObjPort_par_out_local::TChangeableMemPool::_::_::_m_arrayPool::_0_::_elem::_m_objectInformation::_3_::_m_perObjectType::_m_prob1ObstUnknownN = 0;
        @sysvar::XCP::RadarFC_Obj::_g_PL_AD_fw_Radar_1R1V_rpc_XilObjBypassingRunnable_XilObjBypassingRunnable_m_pad_radarObjPort_par_out_local::TChangeableMemPool::_::_::_m_arrayPool::_0_::_elem::_m_objectInformation::_3_::_m_perObjectType::_m_prob1FourWheelUnknownN = 0;
        break;
        
      case 4: //"Object-4"
        // constant values
        @sysvar::XCP::RadarFC_Obj::_g_PL_AD_fw_Radar_1R1V_rpc_XilObjBypassingRunnable_XilObjBypassingRunnable_m_pad_radarObjPort_par_out_local::TChangeableMemPool::_::_::_m_arrayPool::_0_::_elem::_m_objectInformation::_4_::_Valid_b = 1;
        @sysvar::XCP::RadarFC_Obj::_g_PL_AD_fw_Radar_1R1V_rpc_XilObjBypassingRunnable_XilObjBypassingRunnable_m_pad_radarObjPort_par_out_local::TChangeableMemPool::_::_::_m_arrayPool::_0_::_elem::_m_objectInformation::_4_::_m_HandleN = 1;
        @sysvar::XCP::RadarFC_Obj::_g_PL_AD_fw_Radar_1R1V_rpc_XilObjBypassingRunnable_XilObjBypassingRunnable_m_pad_radarObjPort_par_out_local::TChangeableMemPool::_::_::_m_arrayPool::_0_::_elem::_m_objectInformation::_4_::_m_alpPiVarYawAngleN = 3;
        @sysvar::XCP::RadarFC_Obj::_g_PL_AD_fw_Radar_1R1V_rpc_XilObjBypassingRunnable_XilObjBypassingRunnable_m_pad_radarObjPort_par_out_local::TChangeableMemPool::_::_::_m_arrayPool::_0_::_elem::_m_objectInformation::_4_::_m_varAxN = 0;
        @sysvar::XCP::RadarFC_Obj::_g_PL_AD_fw_Radar_1R1V_rpc_XilObjBypassingRunnable_XilObjBypassingRunnable_m_pad_radarObjPort_par_out_local::TChangeableMemPool::_::_::_m_arrayPool::_0_::_elem::_m_objectInformation::_4_::_m_varAyN = 0;
        @sysvar::XCP::RadarFC_Obj::_g_PL_AD_fw_Radar_1R1V_rpc_XilObjBypassingRunnable_XilObjBypassingRunnable_m_pad_radarObjPort_par_out_local::TChangeableMemPool::_::_::_m_arrayPool::_0_::_elem::_m_objectInformation::_4_::_m_varVxN = 0;
        @sysvar::XCP::RadarFC_Obj::_g_PL_AD_fw_Radar_1R1V_rpc_XilObjBypassingRunnable_XilObjBypassingRunnable_m_pad_radarObjPort_par_out_local::TChangeableMemPool::_::_::_m_arrayPool::_0_::_elem::_m_objectInformation::_4_::_m_varVyN = 0;
        @sysvar::XCP::RadarFC_Obj::_g_PL_AD_fw_Radar_1R1V_rpc_XilObjBypassingRunnable_XilObjBypassingRunnable_m_pad_radarObjPort_par_out_local::TChangeableMemPool::_::_::_m_arrayPool::_0_::_elem::_m_objectInformation::_4_::_m_varDxN = 0;
        @sysvar::XCP::RadarFC_Obj::_g_PL_AD_fw_Radar_1R1V_rpc_XilObjBypassingRunnable_XilObjBypassingRunnable_m_pad_radarObjPort_par_out_local::TChangeableMemPool::_::_::_m_arrayPool::_0_::_elem::_m_objectInformation::_4_::_m_varDyN = 0;
        @sysvar::XCP::RadarFC_Obj::_g_PL_AD_fw_Radar_1R1V_rpc_XilObjBypassingRunnable_XilObjBypassingRunnable_m_pad_radarObjPort_par_out_local::TChangeableMemPool::_::_::_m_arrayPool::_0_::_elem::_m_objectInformation::_4_::_m_dVarLengthN = 0;
        @sysvar::XCP::RadarFC_Obj::_g_PL_AD_fw_Radar_1R1V_rpc_XilObjBypassingRunnable_XilObjBypassingRunnable_m_pad_radarObjPort_par_out_local::TChangeableMemPool::_::_::_m_arrayPool::_0_::_elem::_m_objectInformation::_4_::_m_dVarWidthN = 0;
        @sysvar::XCP::RadarFC_Obj::_g_PL_AD_fw_Radar_1R1V_rpc_XilObjBypassingRunnable_XilObjBypassingRunnable_m_pad_radarObjPort_par_out_local::TChangeableMemPool::_::_::_m_arrayPool::_0_::_elem::_m_objectInformation::_4_::_m_wExistProbN = 64880;
        @sysvar::XCP::RadarFC_Obj::_g_PL_AD_fw_Radar_1R1V_rpc_XilObjBypassingRunnable_XilObjBypassingRunnable_m_pad_radarObjPort_par_out_local::TChangeableMemPool::_::_::_m_arrayPool::_0_::_elem::_m_objectInformation::_4_::_m_isObjectAsil = 1;
        
        // target dimensions
        @sysvar::XCP::RadarFC_Obj::_g_PL_AD_fw_Radar_1R1V_rpc_XilObjBypassingRunnable_XilObjBypassingRunnable_m_pad_radarObjPort_par_out_local::TChangeableMemPool::_::_::_m_arrayPool::_0_::_elem::_m_objectInformation::_4_::_m_dWidthN = dllGetRadarFCInputObjectWidth(@hil_ctrl::Handle_RoadObj, 0) * 128;
        @sysvar::XCP::RadarFC_Obj::_g_PL_AD_fw_Radar_1R1V_rpc_XilObjBypassingRunnable_XilObjBypassingRunnable_m_pad_radarObjPort_par_out_local::TChangeableMemPool::_::_::_m_arrayPool::_0_::_elem::_m_objectInformation::_4_::_m_dLengthN = dllGetRadarFCInputObjectLength(@hil_ctrl::Handle_RoadObj, 0) * 64;
          
        // target movement
        @sysvar::XCP::RadarFC_Obj::_g_PL_AD_fw_Radar_1R1V_rpc_XilObjBypassingRunnable_XilObjBypassingRunnable_m_pad_radarObjPort_par_out_local::TChangeableMemPool::_::_::_m_arrayPool::_0_::_elem::_m_objectInformation::_4_::_m_dxN = dllGetRadarFCObjDistX(@hil_ctrl::Handle_RoadObj, 0) * 128;
        @sysvar::XCP::RadarFC_Obj::_g_PL_AD_fw_Radar_1R1V_rpc_XilObjBypassingRunnable_XilObjBypassingRunnable_m_pad_radarObjPort_par_out_local::TChangeableMemPool::_::_::_m_arrayPool::_0_::_elem::_m_objectInformation::_4_::_m_dyN = dllGetRadarFCObjDistY(@hil_ctrl::Handle_RoadObj, 0) * 128;
        @sysvar::XCP::RadarFC_Obj::_g_PL_AD_fw_Radar_1R1V_rpc_XilObjBypassingRunnable_XilObjBypassingRunnable_m_pad_radarObjPort_par_out_local::TChangeableMemPool::_::_::_m_arrayPool::_0_::_elem::_m_objectInformation::_4_::_m_dzN = 0;
        @sysvar::XCP::RadarFC_Obj::_g_PL_AD_fw_Radar_1R1V_rpc_XilObjBypassingRunnable_XilObjBypassingRunnable_m_pad_radarObjPort_par_out_local::TChangeableMemPool::_::_::_m_arrayPool::_0_::_elem::_m_objectInformation::_4_::_m_vxN = dllGetRadarFCObjVelX(@hil_ctrl::Handle_RoadObj, 0) * 256;
        @sysvar::XCP::RadarFC_Obj::_g_PL_AD_fw_Radar_1R1V_rpc_XilObjBypassingRunnable_XilObjBypassingRunnable_m_pad_radarObjPort_par_out_local::TChangeableMemPool::_::_::_m_arrayPool::_0_::_elem::_m_objectInformation::_4_::_m_vyN = dllGetRadarFCObjVelY(@hil_ctrl::Handle_RoadObj, 0) * 256;
        @sysvar::XCP::RadarFC_Obj::_g_PL_AD_fw_Radar_1R1V_rpc_XilObjBypassingRunnable_XilObjBypassingRunnable_m_pad_radarObjPort_par_out_local::TChangeableMemPool::_::_::_m_arrayPool::_0_::_elem::_m_objectInformation::_4_::_m_axN = 0;
        @sysvar::XCP::RadarFC_Obj::_g_PL_AD_fw_Radar_1R1V_rpc_XilObjBypassingRunnable_XilObjBypassingRunnable_m_pad_radarObjPort_par_out_local::TChangeableMemPool::_::_::_m_arrayPool::_0_::_elem::_m_objectInformation::_4_::_m_ayN = 0;
        @sysvar::XCP::RadarFC_Obj::_g_PL_AD_fw_Radar_1R1V_rpc_XilObjBypassingRunnable_XilObjBypassingRunnable_m_pad_radarObjPort_par_out_local::TChangeableMemPool::_::_::_m_arrayPool::_0_::_elem::_m_objectInformation::_4_::_m_alpPiYawAngleN = dllGetRadarFCObjYawAngle(@hil_ctrl::Handle_RoadObj, 0) * 128; // 128 correct?
        
        // target probabilities
        @sysvar::XCP::RadarFC_Obj::_g_PL_AD_fw_Radar_1R1V_rpc_XilObjBypassingRunnable_XilObjBypassingRunnable_m_pad_radarObjPort_par_out_local::TChangeableMemPool::_::_::_m_arrayPool::_0_::_elem::_m_objectInformation::_4_::_m_prob1HasBeenObservedMovingN = dllGetRadarFCObjProbMoving(@hil_ctrl::Handle_RoadObj, object_id) * 1.26;
        @sysvar::XCP::RadarFC_Obj::_g_PL_AD_fw_Radar_1R1V_rpc_XilObjBypassingRunnable_XilObjBypassingRunnable_m_pad_radarObjPort_par_out_local::TChangeableMemPool::_::_::_m_arrayPool::_0_::_elem::_m_objectInformation::_4_::_m_prob1MovingN = dllGetRadarFCObjProbMoving(@hil_ctrl::Handle_RoadObj, object_id) * 1.26;
        @sysvar::XCP::RadarFC_Obj::_g_PL_AD_fw_Radar_1R1V_rpc_XilObjBypassingRunnable_XilObjBypassingRunnable_m_pad_radarObjPort_par_out_local::TChangeableMemPool::_::_::_m_arrayPool::_0_::_elem::_m_objectInformation::_4_::_m_perObjectType::_m_prob1ObstacleN = (100 - dllGetRadarFCObjProbNonObst(@hil_ctrl::Handle_RoadObj, object_id)) * 1.28;
        @sysvar::XCP::RadarFC_Obj::_g_PL_AD_fw_Radar_1R1V_rpc_XilObjBypassingRunnable_XilObjBypassingRunnable_m_pad_radarObjPort_par_out_local::TChangeableMemPool::_::_::_m_arrayPool::_0_::_elem::_m_objectInformation::_4_::_m_perObjectType::_m_prob1NonObstacleN = dllGetRadarFCObjProbNonObst(@hil_ctrl::Handle_RoadObj, object_id) * 1.28;
        @sysvar::XCP::RadarFC_Obj::_g_PL_AD_fw_Radar_1R1V_rpc_XilObjBypassingRunnable_XilObjBypassingRunnable_m_pad_radarObjPort_par_out_local::TChangeableMemPool::_::_::_m_arrayPool::_0_::_elem::_m_objectInformation::_4_::_m_perObjectType::_m_prob1MobileN = dllGetRadarFCObjProbMoving(@hil_ctrl::Handle_RoadObj, object_id) * 1.28;
        @sysvar::XCP::RadarFC_Obj::_g_PL_AD_fw_Radar_1R1V_rpc_XilObjBypassingRunnable_XilObjBypassingRunnable_m_pad_radarObjPort_par_out_local::TChangeableMemPool::_::_::_m_arrayPool::_0_::_elem::_m_objectInformation::_4_::_m_perObjectType::_m_prob1StationaryN = (100 - dllGetRadarFCObjProbMoving(@hil_ctrl::Handle_RoadObj, object_id)) * 1.28;
        @sysvar::XCP::RadarFC_Obj::_g_PL_AD_fw_Radar_1R1V_rpc_XilObjBypassingRunnable_XilObjBypassingRunnable_m_pad_radarObjPort_par_out_local::TChangeableMemPool::_::_::_m_arrayPool::_0_::_elem::_m_objectInformation::_4_::_m_perObjectType::_m_prob1FourPlusWheelerN = (dllGetRadarFCObjProbCar(@hil_ctrl::Handle_RoadObj, object_id) + dllGetRadarFCObjProbTruck(@hil_ctrl::Handle_RoadObj, object_id)) * 1.28;
        @sysvar::XCP::RadarFC_Obj::_g_PL_AD_fw_Radar_1R1V_rpc_XilObjBypassingRunnable_XilObjBypassingRunnable_m_pad_radarObjPort_par_out_local::TChangeableMemPool::_::_::_m_arrayPool::_0_::_elem::_m_objectInformation::_4_::_m_perObjectType::_m_prob1TwoWheelerN = dllGetRadarFCObjProb2Wheeler(@hil_ctrl::Handle_RoadObj, object_id) * 1.28;
        @sysvar::XCP::RadarFC_Obj::_g_PL_AD_fw_Radar_1R1V_rpc_XilObjBypassingRunnable_XilObjBypassingRunnable_m_pad_radarObjPort_par_out_local::TChangeableMemPool::_::_::_m_arrayPool::_0_::_elem::_m_objectInformation::_4_::_m_perObjectType::_m_prob1PedestrianN = dllGetRadarFCObjProbPedestrian(@hil_ctrl::Handle_RoadObj, object_id) * 1.28;
        @sysvar::XCP::RadarFC_Obj::_g_PL_AD_fw_Radar_1R1V_rpc_XilObjBypassingRunnable_XilObjBypassingRunnable_m_pad_radarObjPort_par_out_local::TChangeableMemPool::_::_::_m_arrayPool::_0_::_elem::_m_objectInformation::_4_::_m_perObjectType::_m_prob1RoadsideBarrierN = (100 - dllGetRadarFCObjProbMoving(@hil_ctrl::Handle_RoadObj, object_id)) * 1.28;
        @sysvar::XCP::RadarFC_Obj::_g_PL_AD_fw_Radar_1R1V_rpc_XilObjBypassingRunnable_XilObjBypassingRunnable_m_pad_radarObjPort_par_out_local::TChangeableMemPool::_::_::_m_arrayPool::_0_::_elem::_m_objectInformation::_4_::_m_perObjectType::_m_prob1PassengerCarN = dllGetRadarFCObjProbCar(@hil_ctrl::Handle_RoadObj, object_id) * 1.28;
        @sysvar::XCP::RadarFC_Obj::_g_PL_AD_fw_Radar_1R1V_rpc_XilObjBypassingRunnable_XilObjBypassingRunnable_m_pad_radarObjPort_par_out_local::TChangeableMemPool::_::_::_m_arrayPool::_0_::_elem::_m_objectInformation::_4_::_m_perObjectType::_m_prob1TruckN = dllGetRadarFCObjProbTruck(@hil_ctrl::Handle_RoadObj, object_id) * 1.28;
        @sysvar::XCP::RadarFC_Obj::_g_PL_AD_fw_Radar_1R1V_rpc_XilObjBypassingRunnable_XilObjBypassingRunnable_m_pad_radarObjPort_par_out_local::TChangeableMemPool::_::_::_m_arrayPool::_0_::_elem::_m_objectInformation::_4_::_m_perObjectType::_m_prob1UnknownN = 0;
        @sysvar::XCP::RadarFC_Obj::_g_PL_AD_fw_Radar_1R1V_rpc_XilObjBypassingRunnable_XilObjBypassingRunnable_m_pad_radarObjPort_par_out_local::TChangeableMemPool::_::_::_m_arrayPool::_0_::_elem::_m_objectInformation::_4_::_m_perObjectType::_m_prob1MovUnknownN = 0;
        @sysvar::XCP::RadarFC_Obj::_g_PL_AD_fw_Radar_1R1V_rpc_XilObjBypassingRunnable_XilObjBypassingRunnable_m_pad_radarObjPort_par_out_local::TChangeableMemPool::_::_::_m_arrayPool::_0_::_elem::_m_objectInformation::_4_::_m_perObjectType::_m_prob1StatUnknownN = 0; // 128 previously
        @sysvar::XCP::RadarFC_Obj::_g_PL_AD_fw_Radar_1R1V_rpc_XilObjBypassingRunnable_XilObjBypassingRunnable_m_pad_radarObjPort_par_out_local::TChangeableMemPool::_::_::_m_arrayPool::_0_::_elem::_m_objectInformation::_4_::_m_perObjectType::_m_prob1ObstUnknownN = 0;
        @sysvar::XCP::RadarFC_Obj::_g_PL_AD_fw_Radar_1R1V_rpc_XilObjBypassingRunnable_XilObjBypassingRunnable_m_pad_radarObjPort_par_out_local::TChangeableMemPool::_::_::_m_arrayPool::_0_::_elem::_m_objectInformation::_4_::_m_perObjectType::_m_prob1FourWheelUnknownN = 0;
        break;
        
      case 5: //"Object-5"
        // constant values
        @sysvar::XCP::RadarFC_Obj::_g_PL_AD_fw_Radar_1R1V_rpc_XilObjBypassingRunnable_XilObjBypassingRunnable_m_pad_radarObjPort_par_out_local::TChangeableMemPool::_::_::_m_arrayPool::_0_::_elem::_m_objectInformation::_5_::_Valid_b = 1;
        @sysvar::XCP::RadarFC_Obj::_g_PL_AD_fw_Radar_1R1V_rpc_XilObjBypassingRunnable_XilObjBypassingRunnable_m_pad_radarObjPort_par_out_local::TChangeableMemPool::_::_::_m_arrayPool::_0_::_elem::_m_objectInformation::_5_::_m_HandleN = 1;
        @sysvar::XCP::RadarFC_Obj::_g_PL_AD_fw_Radar_1R1V_rpc_XilObjBypassingRunnable_XilObjBypassingRunnable_m_pad_radarObjPort_par_out_local::TChangeableMemPool::_::_::_m_arrayPool::_0_::_elem::_m_objectInformation::_5_::_m_alpPiVarYawAngleN = 3;
        @sysvar::XCP::RadarFC_Obj::_g_PL_AD_fw_Radar_1R1V_rpc_XilObjBypassingRunnable_XilObjBypassingRunnable_m_pad_radarObjPort_par_out_local::TChangeableMemPool::_::_::_m_arrayPool::_0_::_elem::_m_objectInformation::_5_::_m_varAxN = 0;
        @sysvar::XCP::RadarFC_Obj::_g_PL_AD_fw_Radar_1R1V_rpc_XilObjBypassingRunnable_XilObjBypassingRunnable_m_pad_radarObjPort_par_out_local::TChangeableMemPool::_::_::_m_arrayPool::_0_::_elem::_m_objectInformation::_5_::_m_varAyN = 0;
        @sysvar::XCP::RadarFC_Obj::_g_PL_AD_fw_Radar_1R1V_rpc_XilObjBypassingRunnable_XilObjBypassingRunnable_m_pad_radarObjPort_par_out_local::TChangeableMemPool::_::_::_m_arrayPool::_0_::_elem::_m_objectInformation::_5_::_m_varVxN = 0;
        @sysvar::XCP::RadarFC_Obj::_g_PL_AD_fw_Radar_1R1V_rpc_XilObjBypassingRunnable_XilObjBypassingRunnable_m_pad_radarObjPort_par_out_local::TChangeableMemPool::_::_::_m_arrayPool::_0_::_elem::_m_objectInformation::_5_::_m_varVyN = 0;
        @sysvar::XCP::RadarFC_Obj::_g_PL_AD_fw_Radar_1R1V_rpc_XilObjBypassingRunnable_XilObjBypassingRunnable_m_pad_radarObjPort_par_out_local::TChangeableMemPool::_::_::_m_arrayPool::_0_::_elem::_m_objectInformation::_5_::_m_varDxN = 0;
        @sysvar::XCP::RadarFC_Obj::_g_PL_AD_fw_Radar_1R1V_rpc_XilObjBypassingRunnable_XilObjBypassingRunnable_m_pad_radarObjPort_par_out_local::TChangeableMemPool::_::_::_m_arrayPool::_0_::_elem::_m_objectInformation::_5_::_m_varDyN = 0;
        @sysvar::XCP::RadarFC_Obj::_g_PL_AD_fw_Radar_1R1V_rpc_XilObjBypassingRunnable_XilObjBypassingRunnable_m_pad_radarObjPort_par_out_local::TChangeableMemPool::_::_::_m_arrayPool::_0_::_elem::_m_objectInformation::_5_::_m_dVarLengthN = 0;
        @sysvar::XCP::RadarFC_Obj::_g_PL_AD_fw_Radar_1R1V_rpc_XilObjBypassingRunnable_XilObjBypassingRunnable_m_pad_radarObjPort_par_out_local::TChangeableMemPool::_::_::_m_arrayPool::_0_::_elem::_m_objectInformation::_5_::_m_dVarWidthN = 0;
        @sysvar::XCP::RadarFC_Obj::_g_PL_AD_fw_Radar_1R1V_rpc_XilObjBypassingRunnable_XilObjBypassingRunnable_m_pad_radarObjPort_par_out_local::TChangeableMemPool::_::_::_m_arrayPool::_0_::_elem::_m_objectInformation::_5_::_m_wExistProbN = 64880;
        @sysvar::XCP::RadarFC_Obj::_g_PL_AD_fw_Radar_1R1V_rpc_XilObjBypassingRunnable_XilObjBypassingRunnable_m_pad_radarObjPort_par_out_local::TChangeableMemPool::_::_::_m_arrayPool::_0_::_elem::_m_objectInformation::_5_::_m_isObjectAsil = 1;
        
        // target dimensions
        @sysvar::XCP::RadarFC_Obj::_g_PL_AD_fw_Radar_1R1V_rpc_XilObjBypassingRunnable_XilObjBypassingRunnable_m_pad_radarObjPort_par_out_local::TChangeableMemPool::_::_::_m_arrayPool::_0_::_elem::_m_objectInformation::_5_::_m_dWidthN = dllGetRadarFCInputObjectWidth(@hil_ctrl::Handle_RoadObj, 0) * 128;
        @sysvar::XCP::RadarFC_Obj::_g_PL_AD_fw_Radar_1R1V_rpc_XilObjBypassingRunnable_XilObjBypassingRunnable_m_pad_radarObjPort_par_out_local::TChangeableMemPool::_::_::_m_arrayPool::_0_::_elem::_m_objectInformation::_5_::_m_dLengthN = dllGetRadarFCInputObjectLength(@hil_ctrl::Handle_RoadObj, 0) * 64;
          
        // target movement
        @sysvar::XCP::RadarFC_Obj::_g_PL_AD_fw_Radar_1R1V_rpc_XilObjBypassingRunnable_XilObjBypassingRunnable_m_pad_radarObjPort_par_out_local::TChangeableMemPool::_::_::_m_arrayPool::_0_::_elem::_m_objectInformation::_5_::_m_dxN = dllGetRadarFCObjDistX(@hil_ctrl::Handle_RoadObj, 0) * 128;
        @sysvar::XCP::RadarFC_Obj::_g_PL_AD_fw_Radar_1R1V_rpc_XilObjBypassingRunnable_XilObjBypassingRunnable_m_pad_radarObjPort_par_out_local::TChangeableMemPool::_::_::_m_arrayPool::_0_::_elem::_m_objectInformation::_5_::_m_dyN = dllGetRadarFCObjDistY(@hil_ctrl::Handle_RoadObj, 0) * 128;
        @sysvar::XCP::RadarFC_Obj::_g_PL_AD_fw_Radar_1R1V_rpc_XilObjBypassingRunnable_XilObjBypassingRunnable_m_pad_radarObjPort_par_out_local::TChangeableMemPool::_::_::_m_arrayPool::_0_::_elem::_m_objectInformation::_5_::_m_dzN = 0;
        @sysvar::XCP::RadarFC_Obj::_g_PL_AD_fw_Radar_1R1V_rpc_XilObjBypassingRunnable_XilObjBypassingRunnable_m_pad_radarObjPort_par_out_local::TChangeableMemPool::_::_::_m_arrayPool::_0_::_elem::_m_objectInformation::_5_::_m_vxN = dllGetRadarFCObjVelX(@hil_ctrl::Handle_RoadObj, 0) * 256;
        @sysvar::XCP::RadarFC_Obj::_g_PL_AD_fw_Radar_1R1V_rpc_XilObjBypassingRunnable_XilObjBypassingRunnable_m_pad_radarObjPort_par_out_local::TChangeableMemPool::_::_::_m_arrayPool::_0_::_elem::_m_objectInformation::_5_::_m_vyN = dllGetRadarFCObjVelY(@hil_ctrl::Handle_RoadObj, 0) * 256;
        @sysvar::XCP::RadarFC_Obj::_g_PL_AD_fw_Radar_1R1V_rpc_XilObjBypassingRunnable_XilObjBypassingRunnable_m_pad_radarObjPort_par_out_local::TChangeableMemPool::_::_::_m_arrayPool::_0_::_elem::_m_objectInformation::_5_::_m_axN = 0;
        @sysvar::XCP::RadarFC_Obj::_g_PL_AD_fw_Radar_1R1V_rpc_XilObjBypassingRunnable_XilObjBypassingRunnable_m_pad_radarObjPort_par_out_local::TChangeableMemPool::_::_::_m_arrayPool::_0_::_elem::_m_objectInformation::_5_::_m_ayN = 0;
        @sysvar::XCP::RadarFC_Obj::_g_PL_AD_fw_Radar_1R1V_rpc_XilObjBypassingRunnable_XilObjBypassingRunnable_m_pad_radarObjPort_par_out_local::TChangeableMemPool::_::_::_m_arrayPool::_0_::_elem::_m_objectInformation::_5_::_m_alpPiYawAngleN = dllGetRadarFCObjYawAngle(@hil_ctrl::Handle_RoadObj, 0) * 128; // 128 correct?
        
        // target probabilities
        @sysvar::XCP::RadarFC_Obj::_g_PL_AD_fw_Radar_1R1V_rpc_XilObjBypassingRunnable_XilObjBypassingRunnable_m_pad_radarObjPort_par_out_local::TChangeableMemPool::_::_::_m_arrayPool::_0_::_elem::_m_objectInformation::_5_::_m_prob1HasBeenObservedMovingN = dllGetRadarFCObjProbMoving(@hil_ctrl::Handle_RoadObj, object_id) * 1.26;
        @sysvar::XCP::RadarFC_Obj::_g_PL_AD_fw_Radar_1R1V_rpc_XilObjBypassingRunnable_XilObjBypassingRunnable_m_pad_radarObjPort_par_out_local::TChangeableMemPool::_::_::_m_arrayPool::_0_::_elem::_m_objectInformation::_5_::_m_prob1MovingN = dllGetRadarFCObjProbMoving(@hil_ctrl::Handle_RoadObj, object_id) * 1.26;
        @sysvar::XCP::RadarFC_Obj::_g_PL_AD_fw_Radar_1R1V_rpc_XilObjBypassingRunnable_XilObjBypassingRunnable_m_pad_radarObjPort_par_out_local::TChangeableMemPool::_::_::_m_arrayPool::_0_::_elem::_m_objectInformation::_5_::_m_perObjectType::_m_prob1ObstacleN = (100 - dllGetRadarFCObjProbNonObst(@hil_ctrl::Handle_RoadObj, object_id)) * 1.28;
        @sysvar::XCP::RadarFC_Obj::_g_PL_AD_fw_Radar_1R1V_rpc_XilObjBypassingRunnable_XilObjBypassingRunnable_m_pad_radarObjPort_par_out_local::TChangeableMemPool::_::_::_m_arrayPool::_0_::_elem::_m_objectInformation::_5_::_m_perObjectType::_m_prob1NonObstacleN = dllGetRadarFCObjProbNonObst(@hil_ctrl::Handle_RoadObj, object_id) * 1.28;
        @sysvar::XCP::RadarFC_Obj::_g_PL_AD_fw_Radar_1R1V_rpc_XilObjBypassingRunnable_XilObjBypassingRunnable_m_pad_radarObjPort_par_out_local::TChangeableMemPool::_::_::_m_arrayPool::_0_::_elem::_m_objectInformation::_5_::_m_perObjectType::_m_prob1MobileN = dllGetRadarFCObjProbMoving(@hil_ctrl::Handle_RoadObj, object_id) * 1.28;
        @sysvar::XCP::RadarFC_Obj::_g_PL_AD_fw_Radar_1R1V_rpc_XilObjBypassingRunnable_XilObjBypassingRunnable_m_pad_radarObjPort_par_out_local::TChangeableMemPool::_::_::_m_arrayPool::_0_::_elem::_m_objectInformation::_5_::_m_perObjectType::_m_prob1StationaryN = (100 - dllGetRadarFCObjProbMoving(@hil_ctrl::Handle_RoadObj, object_id)) * 1.28;
        @sysvar::XCP::RadarFC_Obj::_g_PL_AD_fw_Radar_1R1V_rpc_XilObjBypassingRunnable_XilObjBypassingRunnable_m_pad_radarObjPort_par_out_local::TChangeableMemPool::_::_::_m_arrayPool::_0_::_elem::_m_objectInformation::_5_::_m_perObjectType::_m_prob1FourPlusWheelerN = (dllGetRadarFCObjProbCar(@hil_ctrl::Handle_RoadObj, object_id) + dllGetRadarFCObjProbTruck(@hil_ctrl::Handle_RoadObj, object_id)) * 1.28;
        @sysvar::XCP::RadarFC_Obj::_g_PL_AD_fw_Radar_1R1V_rpc_XilObjBypassingRunnable_XilObjBypassingRunnable_m_pad_radarObjPort_par_out_local::TChangeableMemPool::_::_::_m_arrayPool::_0_::_elem::_m_objectInformation::_5_::_m_perObjectType::_m_prob1TwoWheelerN = dllGetRadarFCObjProb2Wheeler(@hil_ctrl::Handle_RoadObj, object_id) * 1.28;
        @sysvar::XCP::RadarFC_Obj::_g_PL_AD_fw_Radar_1R1V_rpc_XilObjBypassingRunnable_XilObjBypassingRunnable_m_pad_radarObjPort_par_out_local::TChangeableMemPool::_::_::_m_arrayPool::_0_::_elem::_m_objectInformation::_5_::_m_perObjectType::_m_prob1PedestrianN = dllGetRadarFCObjProbPedestrian(@hil_ctrl::Handle_RoadObj, object_id) * 1.28;
        @sysvar::XCP::RadarFC_Obj::_g_PL_AD_fw_Radar_1R1V_rpc_XilObjBypassingRunnable_XilObjBypassingRunnable_m_pad_radarObjPort_par_out_local::TChangeableMemPool::_::_::_m_arrayPool::_0_::_elem::_m_objectInformation::_5_::_m_perObjectType::_m_prob1RoadsideBarrierN = (100 - dllGetRadarFCObjProbMoving(@hil_ctrl::Handle_RoadObj, object_id)) * 1.28;
        @sysvar::XCP::RadarFC_Obj::_g_PL_AD_fw_Radar_1R1V_rpc_XilObjBypassingRunnable_XilObjBypassingRunnable_m_pad_radarObjPort_par_out_local::TChangeableMemPool::_::_::_m_arrayPool::_0_::_elem::_m_objectInformation::_5_::_m_perObjectType::_m_prob1PassengerCarN = dllGetRadarFCObjProbCar(@hil_ctrl::Handle_RoadObj, object_id) * 1.28;
        @sysvar::XCP::RadarFC_Obj::_g_PL_AD_fw_Radar_1R1V_rpc_XilObjBypassingRunnable_XilObjBypassingRunnable_m_pad_radarObjPort_par_out_local::TChangeableMemPool::_::_::_m_arrayPool::_0_::_elem::_m_objectInformation::_5_::_m_perObjectType::_m_prob1TruckN = dllGetRadarFCObjProbTruck(@hil_ctrl::Handle_RoadObj, object_id) * 1.28;
        @sysvar::XCP::RadarFC_Obj::_g_PL_AD_fw_Radar_1R1V_rpc_XilObjBypassingRunnable_XilObjBypassingRunnable_m_pad_radarObjPort_par_out_local::TChangeableMemPool::_::_::_m_arrayPool::_0_::_elem::_m_objectInformation::_5_::_m_perObjectType::_m_prob1UnknownN = 0;
        @sysvar::XCP::RadarFC_Obj::_g_PL_AD_fw_Radar_1R1V_rpc_XilObjBypassingRunnable_XilObjBypassingRunnable_m_pad_radarObjPort_par_out_local::TChangeableMemPool::_::_::_m_arrayPool::_0_::_elem::_m_objectInformation::_5_::_m_perObjectType::_m_prob1MovUnknownN = 0;
        @sysvar::XCP::RadarFC_Obj::_g_PL_AD_fw_Radar_1R1V_rpc_XilObjBypassingRunnable_XilObjBypassingRunnable_m_pad_radarObjPort_par_out_local::TChangeableMemPool::_::_::_m_arrayPool::_0_::_elem::_m_objectInformation::_5_::_m_perObjectType::_m_prob1StatUnknownN = 0; // 128 previously
        @sysvar::XCP::RadarFC_Obj::_g_PL_AD_fw_Radar_1R1V_rpc_XilObjBypassingRunnable_XilObjBypassingRunnable_m_pad_radarObjPort_par_out_local::TChangeableMemPool::_::_::_m_arrayPool::_0_::_elem::_m_objectInformation::_5_::_m_perObjectType::_m_prob1ObstUnknownN = 0;
        @sysvar::XCP::RadarFC_Obj::_g_PL_AD_fw_Radar_1R1V_rpc_XilObjBypassingRunnable_XilObjBypassingRunnable_m_pad_radarObjPort_par_out_local::TChangeableMemPool::_::_::_m_arrayPool::_0_::_elem::_m_objectInformation::_5_::_m_perObjectType::_m_prob1FourWheelUnknownN = 0;
        break;
        
      case 6: //"Object-6"
        // constant values
        @sysvar::XCP::RadarFC_Obj::_g_PL_AD_fw_Radar_1R1V_rpc_XilObjBypassingRunnable_XilObjBypassingRunnable_m_pad_radarObjPort_par_out_local::TChangeableMemPool::_::_::_m_arrayPool::_0_::_elem::_m_objectInformation::_6_::_Valid_b = 1;
        @sysvar::XCP::RadarFC_Obj::_g_PL_AD_fw_Radar_1R1V_rpc_XilObjBypassingRunnable_XilObjBypassingRunnable_m_pad_radarObjPort_par_out_local::TChangeableMemPool::_::_::_m_arrayPool::_0_::_elem::_m_objectInformation::_6_::_m_HandleN = 1;
        @sysvar::XCP::RadarFC_Obj::_g_PL_AD_fw_Radar_1R1V_rpc_XilObjBypassingRunnable_XilObjBypassingRunnable_m_pad_radarObjPort_par_out_local::TChangeableMemPool::_::_::_m_arrayPool::_0_::_elem::_m_objectInformation::_6_::_m_alpPiVarYawAngleN = 3;
        @sysvar::XCP::RadarFC_Obj::_g_PL_AD_fw_Radar_1R1V_rpc_XilObjBypassingRunnable_XilObjBypassingRunnable_m_pad_radarObjPort_par_out_local::TChangeableMemPool::_::_::_m_arrayPool::_0_::_elem::_m_objectInformation::_6_::_m_varAxN = 0;
        @sysvar::XCP::RadarFC_Obj::_g_PL_AD_fw_Radar_1R1V_rpc_XilObjBypassingRunnable_XilObjBypassingRunnable_m_pad_radarObjPort_par_out_local::TChangeableMemPool::_::_::_m_arrayPool::_0_::_elem::_m_objectInformation::_6_::_m_varAyN = 0;
        @sysvar::XCP::RadarFC_Obj::_g_PL_AD_fw_Radar_1R1V_rpc_XilObjBypassingRunnable_XilObjBypassingRunnable_m_pad_radarObjPort_par_out_local::TChangeableMemPool::_::_::_m_arrayPool::_0_::_elem::_m_objectInformation::_6_::_m_varVxN = 0;
        @sysvar::XCP::RadarFC_Obj::_g_PL_AD_fw_Radar_1R1V_rpc_XilObjBypassingRunnable_XilObjBypassingRunnable_m_pad_radarObjPort_par_out_local::TChangeableMemPool::_::_::_m_arrayPool::_0_::_elem::_m_objectInformation::_6_::_m_varVyN = 0;
        @sysvar::XCP::RadarFC_Obj::_g_PL_AD_fw_Radar_1R1V_rpc_XilObjBypassingRunnable_XilObjBypassingRunnable_m_pad_radarObjPort_par_out_local::TChangeableMemPool::_::_::_m_arrayPool::_0_::_elem::_m_objectInformation::_6_::_m_varDxN = 0;
        @sysvar::XCP::RadarFC_Obj::_g_PL_AD_fw_Radar_1R1V_rpc_XilObjBypassingRunnable_XilObjBypassingRunnable_m_pad_radarObjPort_par_out_local::TChangeableMemPool::_::_::_m_arrayPool::_0_::_elem::_m_objectInformation::_6_::_m_varDyN = 0;
        @sysvar::XCP::RadarFC_Obj::_g_PL_AD_fw_Radar_1R1V_rpc_XilObjBypassingRunnable_XilObjBypassingRunnable_m_pad_radarObjPort_par_out_local::TChangeableMemPool::_::_::_m_arrayPool::_0_::_elem::_m_objectInformation::_6_::_m_dVarLengthN = 0;
        @sysvar::XCP::RadarFC_Obj::_g_PL_AD_fw_Radar_1R1V_rpc_XilObjBypassingRunnable_XilObjBypassingRunnable_m_pad_radarObjPort_par_out_local::TChangeableMemPool::_::_::_m_arrayPool::_0_::_elem::_m_objectInformation::_6_::_m_dVarWidthN = 0;
        @sysvar::XCP::RadarFC_Obj::_g_PL_AD_fw_Radar_1R1V_rpc_XilObjBypassingRunnable_XilObjBypassingRunnable_m_pad_radarObjPort_par_out_local::TChangeableMemPool::_::_::_m_arrayPool::_0_::_elem::_m_objectInformation::_6_::_m_wExistProbN = 64880;
        @sysvar::XCP::RadarFC_Obj::_g_PL_AD_fw_Radar_1R1V_rpc_XilObjBypassingRunnable_XilObjBypassingRunnable_m_pad_radarObjPort_par_out_local::TChangeableMemPool::_::_::_m_arrayPool::_0_::_elem::_m_objectInformation::_6_::_m_isObjectAsil = 1;
        
        // target dimensions
        @sysvar::XCP::RadarFC_Obj::_g_PL_AD_fw_Radar_1R1V_rpc_XilObjBypassingRunnable_XilObjBypassingRunnable_m_pad_radarObjPort_par_out_local::TChangeableMemPool::_::_::_m_arrayPool::_0_::_elem::_m_objectInformation::_6_::_m_dWidthN = dllGetRadarFCInputObjectWidth(@hil_ctrl::Handle_RoadObj, 0) * 128;
        @sysvar::XCP::RadarFC_Obj::_g_PL_AD_fw_Radar_1R1V_rpc_XilObjBypassingRunnable_XilObjBypassingRunnable_m_pad_radarObjPort_par_out_local::TChangeableMemPool::_::_::_m_arrayPool::_0_::_elem::_m_objectInformation::_6_::_m_dLengthN = dllGetRadarFCInputObjectLength(@hil_ctrl::Handle_RoadObj, 0) * 64;
          
        // target movement
        @sysvar::XCP::RadarFC_Obj::_g_PL_AD_fw_Radar_1R1V_rpc_XilObjBypassingRunnable_XilObjBypassingRunnable_m_pad_radarObjPort_par_out_local::TChangeableMemPool::_::_::_m_arrayPool::_0_::_elem::_m_objectInformation::_6_::_m_dxN = dllGetRadarFCObjDistX(@hil_ctrl::Handle_RoadObj, 0) * 128;
        @sysvar::XCP::RadarFC_Obj::_g_PL_AD_fw_Radar_1R1V_rpc_XilObjBypassingRunnable_XilObjBypassingRunnable_m_pad_radarObjPort_par_out_local::TChangeableMemPool::_::_::_m_arrayPool::_0_::_elem::_m_objectInformation::_6_::_m_dyN = dllGetRadarFCObjDistY(@hil_ctrl::Handle_RoadObj, 0) * 128;
        @sysvar::XCP::RadarFC_Obj::_g_PL_AD_fw_Radar_1R1V_rpc_XilObjBypassingRunnable_XilObjBypassingRunnable_m_pad_radarObjPort_par_out_local::TChangeableMemPool::_::_::_m_arrayPool::_0_::_elem::_m_objectInformation::_6_::_m_dzN = 0;
        @sysvar::XCP::RadarFC_Obj::_g_PL_AD_fw_Radar_1R1V_rpc_XilObjBypassingRunnable_XilObjBypassingRunnable_m_pad_radarObjPort_par_out_local::TChangeableMemPool::_::_::_m_arrayPool::_0_::_elem::_m_objectInformation::_6_::_m_vxN = dllGetRadarFCObjVelX(@hil_ctrl::Handle_RoadObj, 0) * 256;
        @sysvar::XCP::RadarFC_Obj::_g_PL_AD_fw_Radar_1R1V_rpc_XilObjBypassingRunnable_XilObjBypassingRunnable_m_pad_radarObjPort_par_out_local::TChangeableMemPool::_::_::_m_arrayPool::_0_::_elem::_m_objectInformation::_6_::_m_vyN = dllGetRadarFCObjVelY(@hil_ctrl::Handle_RoadObj, 0) * 256;
        @sysvar::XCP::RadarFC_Obj::_g_PL_AD_fw_Radar_1R1V_rpc_XilObjBypassingRunnable_XilObjBypassingRunnable_m_pad_radarObjPort_par_out_local::TChangeableMemPool::_::_::_m_arrayPool::_0_::_elem::_m_objectInformation::_6_::_m_axN = 0;
        @sysvar::XCP::RadarFC_Obj::_g_PL_AD_fw_Radar_1R1V_rpc_XilObjBypassingRunnable_XilObjBypassingRunnable_m_pad_radarObjPort_par_out_local::TChangeableMemPool::_::_::_m_arrayPool::_0_::_elem::_m_objectInformation::_6_::_m_ayN = 0;
        @sysvar::XCP::RadarFC_Obj::_g_PL_AD_fw_Radar_1R1V_rpc_XilObjBypassingRunnable_XilObjBypassingRunnable_m_pad_radarObjPort_par_out_local::TChangeableMemPool::_::_::_m_arrayPool::_0_::_elem::_m_objectInformation::_6_::_m_alpPiYawAngleN = dllGetRadarFCObjYawAngle(@hil_ctrl::Handle_RoadObj, 0) * 128; // 128 correct?
        
        // target probabilities
        @sysvar::XCP::RadarFC_Obj::_g_PL_AD_fw_Radar_1R1V_rpc_XilObjBypassingRunnable_XilObjBypassingRunnable_m_pad_radarObjPort_par_out_local::TChangeableMemPool::_::_::_m_arrayPool::_0_::_elem::_m_objectInformation::_6_::_m_prob1HasBeenObservedMovingN = dllGetRadarFCObjProbMoving(@hil_ctrl::Handle_RoadObj, object_id) * 1.26;
        @sysvar::XCP::RadarFC_Obj::_g_PL_AD_fw_Radar_1R1V_rpc_XilObjBypassingRunnable_XilObjBypassingRunnable_m_pad_radarObjPort_par_out_local::TChangeableMemPool::_::_::_m_arrayPool::_0_::_elem::_m_objectInformation::_6_::_m_prob1MovingN = dllGetRadarFCObjProbMoving(@hil_ctrl::Handle_RoadObj, object_id) * 1.26;
        @sysvar::XCP::RadarFC_Obj::_g_PL_AD_fw_Radar_1R1V_rpc_XilObjBypassingRunnable_XilObjBypassingRunnable_m_pad_radarObjPort_par_out_local::TChangeableMemPool::_::_::_m_arrayPool::_0_::_elem::_m_objectInformation::_6_::_m_perObjectType::_m_prob1ObstacleN = (100 - dllGetRadarFCObjProbNonObst(@hil_ctrl::Handle_RoadObj, object_id)) * 1.28;
        @sysvar::XCP::RadarFC_Obj::_g_PL_AD_fw_Radar_1R1V_rpc_XilObjBypassingRunnable_XilObjBypassingRunnable_m_pad_radarObjPort_par_out_local::TChangeableMemPool::_::_::_m_arrayPool::_0_::_elem::_m_objectInformation::_6_::_m_perObjectType::_m_prob1NonObstacleN = dllGetRadarFCObjProbNonObst(@hil_ctrl::Handle_RoadObj, object_id) * 1.28;
        @sysvar::XCP::RadarFC_Obj::_g_PL_AD_fw_Radar_1R1V_rpc_XilObjBypassingRunnable_XilObjBypassingRunnable_m_pad_radarObjPort_par_out_local::TChangeableMemPool::_::_::_m_arrayPool::_0_::_elem::_m_objectInformation::_6_::_m_perObjectType::_m_prob1MobileN = dllGetRadarFCObjProbMoving(@hil_ctrl::Handle_RoadObj, object_id) * 1.28;
        @sysvar::XCP::RadarFC_Obj::_g_PL_AD_fw_Radar_1R1V_rpc_XilObjBypassingRunnable_XilObjBypassingRunnable_m_pad_radarObjPort_par_out_local::TChangeableMemPool::_::_::_m_arrayPool::_0_::_elem::_m_objectInformation::_6_::_m_perObjectType::_m_prob1StationaryN = (100 - dllGetRadarFCObjProbMoving(@hil_ctrl::Handle_RoadObj, object_id)) * 1.28;
        @sysvar::XCP::RadarFC_Obj::_g_PL_AD_fw_Radar_1R1V_rpc_XilObjBypassingRunnable_XilObjBypassingRunnable_m_pad_radarObjPort_par_out_local::TChangeableMemPool::_::_::_m_arrayPool::_0_::_elem::_m_objectInformation::_6_::_m_perObjectType::_m_prob1FourPlusWheelerN = (dllGetRadarFCObjProbCar(@hil_ctrl::Handle_RoadObj, object_id) + dllGetRadarFCObjProbTruck(@hil_ctrl::Handle_RoadObj, object_id)) * 1.28;
        @sysvar::XCP::RadarFC_Obj::_g_PL_AD_fw_Radar_1R1V_rpc_XilObjBypassingRunnable_XilObjBypassingRunnable_m_pad_radarObjPort_par_out_local::TChangeableMemPool::_::_::_m_arrayPool::_0_::_elem::_m_objectInformation::_6_::_m_perObjectType::_m_prob1TwoWheelerN = dllGetRadarFCObjProb2Wheeler(@hil_ctrl::Handle_RoadObj, object_id) * 1.28;
        @sysvar::XCP::RadarFC_Obj::_g_PL_AD_fw_Radar_1R1V_rpc_XilObjBypassingRunnable_XilObjBypassingRunnable_m_pad_radarObjPort_par_out_local::TChangeableMemPool::_::_::_m_arrayPool::_0_::_elem::_m_objectInformation::_6_::_m_perObjectType::_m_prob1PedestrianN = dllGetRadarFCObjProbPedestrian(@hil_ctrl::Handle_RoadObj, object_id) * 1.28;
        @sysvar::XCP::RadarFC_Obj::_g_PL_AD_fw_Radar_1R1V_rpc_XilObjBypassingRunnable_XilObjBypassingRunnable_m_pad_radarObjPort_par_out_local::TChangeableMemPool::_::_::_m_arrayPool::_0_::_elem::_m_objectInformation::_6_::_m_perObjectType::_m_prob1RoadsideBarrierN = (100 - dllGetRadarFCObjProbMoving(@hil_ctrl::Handle_RoadObj, object_id)) * 1.28;
        @sysvar::XCP::RadarFC_Obj::_g_PL_AD_fw_Radar_1R1V_rpc_XilObjBypassingRunnable_XilObjBypassingRunnable_m_pad_radarObjPort_par_out_local::TChangeableMemPool::_::_::_m_arrayPool::_0_::_elem::_m_objectInformation::_6_::_m_perObjectType::_m_prob1PassengerCarN = dllGetRadarFCObjProbCar(@hil_ctrl::Handle_RoadObj, object_id) * 1.28;
        @sysvar::XCP::RadarFC_Obj::_g_PL_AD_fw_Radar_1R1V_rpc_XilObjBypassingRunnable_XilObjBypassingRunnable_m_pad_radarObjPort_par_out_local::TChangeableMemPool::_::_::_m_arrayPool::_0_::_elem::_m_objectInformation::_6_::_m_perObjectType::_m_prob1TruckN = dllGetRadarFCObjProbTruck(@hil_ctrl::Handle_RoadObj, object_id) * 1.28;
        @sysvar::XCP::RadarFC_Obj::_g_PL_AD_fw_Radar_1R1V_rpc_XilObjBypassingRunnable_XilObjBypassingRunnable_m_pad_radarObjPort_par_out_local::TChangeableMemPool::_::_::_m_arrayPool::_0_::_elem::_m_objectInformation::_6_::_m_perObjectType::_m_prob1UnknownN = 0;
        @sysvar::XCP::RadarFC_Obj::_g_PL_AD_fw_Radar_1R1V_rpc_XilObjBypassingRunnable_XilObjBypassingRunnable_m_pad_radarObjPort_par_out_local::TChangeableMemPool::_::_::_m_arrayPool::_0_::_elem::_m_objectInformation::_6_::_m_perObjectType::_m_prob1MovUnknownN = 0;
        @sysvar::XCP::RadarFC_Obj::_g_PL_AD_fw_Radar_1R1V_rpc_XilObjBypassingRunnable_XilObjBypassingRunnable_m_pad_radarObjPort_par_out_local::TChangeableMemPool::_::_::_m_arrayPool::_0_::_elem::_m_objectInformation::_6_::_m_perObjectType::_m_prob1StatUnknownN = 0; // 128 previously
        @sysvar::XCP::RadarFC_Obj::_g_PL_AD_fw_Radar_1R1V_rpc_XilObjBypassingRunnable_XilObjBypassingRunnable_m_pad_radarObjPort_par_out_local::TChangeableMemPool::_::_::_m_arrayPool::_0_::_elem::_m_objectInformation::_6_::_m_perObjectType::_m_prob1ObstUnknownN = 0;
        @sysvar::XCP::RadarFC_Obj::_g_PL_AD_fw_Radar_1R1V_rpc_XilObjBypassingRunnable_XilObjBypassingRunnable_m_pad_radarObjPort_par_out_local::TChangeableMemPool::_::_::_m_arrayPool::_0_::_elem::_m_objectInformation::_6_::_m_perObjectType::_m_prob1FourWheelUnknownN = 0;
        break;
        
      case 7: //"Object-7"
        // constant values
        @sysvar::XCP::RadarFC_Obj::_g_PL_AD_fw_Radar_1R1V_rpc_XilObjBypassingRunnable_XilObjBypassingRunnable_m_pad_radarObjPort_par_out_local::TChangeableMemPool::_::_::_m_arrayPool::_0_::_elem::_m_objectInformation::_7_::_Valid_b = 1;
        @sysvar::XCP::RadarFC_Obj::_g_PL_AD_fw_Radar_1R1V_rpc_XilObjBypassingRunnable_XilObjBypassingRunnable_m_pad_radarObjPort_par_out_local::TChangeableMemPool::_::_::_m_arrayPool::_0_::_elem::_m_objectInformation::_7_::_m_HandleN = 1;
        @sysvar::XCP::RadarFC_Obj::_g_PL_AD_fw_Radar_1R1V_rpc_XilObjBypassingRunnable_XilObjBypassingRunnable_m_pad_radarObjPort_par_out_local::TChangeableMemPool::_::_::_m_arrayPool::_0_::_elem::_m_objectInformation::_7_::_m_alpPiVarYawAngleN = 3;
        @sysvar::XCP::RadarFC_Obj::_g_PL_AD_fw_Radar_1R1V_rpc_XilObjBypassingRunnable_XilObjBypassingRunnable_m_pad_radarObjPort_par_out_local::TChangeableMemPool::_::_::_m_arrayPool::_0_::_elem::_m_objectInformation::_7_::_m_varAxN = 0;
        @sysvar::XCP::RadarFC_Obj::_g_PL_AD_fw_Radar_1R1V_rpc_XilObjBypassingRunnable_XilObjBypassingRunnable_m_pad_radarObjPort_par_out_local::TChangeableMemPool::_::_::_m_arrayPool::_0_::_elem::_m_objectInformation::_7_::_m_varAyN = 0;
        @sysvar::XCP::RadarFC_Obj::_g_PL_AD_fw_Radar_1R1V_rpc_XilObjBypassingRunnable_XilObjBypassingRunnable_m_pad_radarObjPort_par_out_local::TChangeableMemPool::_::_::_m_arrayPool::_0_::_elem::_m_objectInformation::_7_::_m_varVxN = 0;
        @sysvar::XCP::RadarFC_Obj::_g_PL_AD_fw_Radar_1R1V_rpc_XilObjBypassingRunnable_XilObjBypassingRunnable_m_pad_radarObjPort_par_out_local::TChangeableMemPool::_::_::_m_arrayPool::_0_::_elem::_m_objectInformation::_7_::_m_varVyN = 0;
        @sysvar::XCP::RadarFC_Obj::_g_PL_AD_fw_Radar_1R1V_rpc_XilObjBypassingRunnable_XilObjBypassingRunnable_m_pad_radarObjPort_par_out_local::TChangeableMemPool::_::_::_m_arrayPool::_0_::_elem::_m_objectInformation::_7_::_m_varDxN = 0;
        @sysvar::XCP::RadarFC_Obj::_g_PL_AD_fw_Radar_1R1V_rpc_XilObjBypassingRunnable_XilObjBypassingRunnable_m_pad_radarObjPort_par_out_local::TChangeableMemPool::_::_::_m_arrayPool::_0_::_elem::_m_objectInformation::_7_::_m_varDyN = 0;
        @sysvar::XCP::RadarFC_Obj::_g_PL_AD_fw_Radar_1R1V_rpc_XilObjBypassingRunnable_XilObjBypassingRunnable_m_pad_radarObjPort_par_out_local::TChangeableMemPool::_::_::_m_arrayPool::_0_::_elem::_m_objectInformation::_7_::_m_dVarLengthN = 0;
        @sysvar::XCP::RadarFC_Obj::_g_PL_AD_fw_Radar_1R1V_rpc_XilObjBypassingRunnable_XilObjBypassingRunnable_m_pad_radarObjPort_par_out_local::TChangeableMemPool::_::_::_m_arrayPool::_0_::_elem::_m_objectInformation::_7_::_m_dVarWidthN = 0;
        @sysvar::XCP::RadarFC_Obj::_g_PL_AD_fw_Radar_1R1V_rpc_XilObjBypassingRunnable_XilObjBypassingRunnable_m_pad_radarObjPort_par_out_local::TChangeableMemPool::_::_::_m_arrayPool::_0_::_elem::_m_objectInformation::_7_::_m_wExistProbN = 64880;
        @sysvar::XCP::RadarFC_Obj::_g_PL_AD_fw_Radar_1R1V_rpc_XilObjBypassingRunnable_XilObjBypassingRunnable_m_pad_radarObjPort_par_out_local::TChangeableMemPool::_::_::_m_arrayPool::_0_::_elem::_m_objectInformation::_7_::_m_isObjectAsil = 1;
        
        // target dimensions
        @sysvar::XCP::RadarFC_Obj::_g_PL_AD_fw_Radar_1R1V_rpc_XilObjBypassingRunnable_XilObjBypassingRunnable_m_pad_radarObjPort_par_out_local::TChangeableMemPool::_::_::_m_arrayPool::_0_::_elem::_m_objectInformation::_7_::_m_dWidthN = dllGetRadarFCInputObjectWidth(@hil_ctrl::Handle_RoadObj, 0) * 128;
        @sysvar::XCP::RadarFC_Obj::_g_PL_AD_fw_Radar_1R1V_rpc_XilObjBypassingRunnable_XilObjBypassingRunnable_m_pad_radarObjPort_par_out_local::TChangeableMemPool::_::_::_m_arrayPool::_0_::_elem::_m_objectInformation::_7_::_m_dLengthN = dllGetRadarFCInputObjectLength(@hil_ctrl::Handle_RoadObj, 0) * 64;
          
        // target movement
        @sysvar::XCP::RadarFC_Obj::_g_PL_AD_fw_Radar_1R1V_rpc_XilObjBypassingRunnable_XilObjBypassingRunnable_m_pad_radarObjPort_par_out_local::TChangeableMemPool::_::_::_m_arrayPool::_0_::_elem::_m_objectInformation::_7_::_m_dxN = dllGetRadarFCObjDistX(@hil_ctrl::Handle_RoadObj, 0) * 128;
        @sysvar::XCP::RadarFC_Obj::_g_PL_AD_fw_Radar_1R1V_rpc_XilObjBypassingRunnable_XilObjBypassingRunnable_m_pad_radarObjPort_par_out_local::TChangeableMemPool::_::_::_m_arrayPool::_0_::_elem::_m_objectInformation::_7_::_m_dyN = dllGetRadarFCObjDistY(@hil_ctrl::Handle_RoadObj, 0) * 128;
        @sysvar::XCP::RadarFC_Obj::_g_PL_AD_fw_Radar_1R1V_rpc_XilObjBypassingRunnable_XilObjBypassingRunnable_m_pad_radarObjPort_par_out_local::TChangeableMemPool::_::_::_m_arrayPool::_0_::_elem::_m_objectInformation::_7_::_m_dzN = 0;
        @sysvar::XCP::RadarFC_Obj::_g_PL_AD_fw_Radar_1R1V_rpc_XilObjBypassingRunnable_XilObjBypassingRunnable_m_pad_radarObjPort_par_out_local::TChangeableMemPool::_::_::_m_arrayPool::_0_::_elem::_m_objectInformation::_7_::_m_vxN = dllGetRadarFCObjVelX(@hil_ctrl::Handle_RoadObj, 0) * 256;
        @sysvar::XCP::RadarFC_Obj::_g_PL_AD_fw_Radar_1R1V_rpc_XilObjBypassingRunnable_XilObjBypassingRunnable_m_pad_radarObjPort_par_out_local::TChangeableMemPool::_::_::_m_arrayPool::_0_::_elem::_m_objectInformation::_7_::_m_vyN = dllGetRadarFCObjVelY(@hil_ctrl::Handle_RoadObj, 0) * 256;
        @sysvar::XCP::RadarFC_Obj::_g_PL_AD_fw_Radar_1R1V_rpc_XilObjBypassingRunnable_XilObjBypassingRunnable_m_pad_radarObjPort_par_out_local::TChangeableMemPool::_::_::_m_arrayPool::_0_::_elem::_m_objectInformation::_7_::_m_axN = 0;
        @sysvar::XCP::RadarFC_Obj::_g_PL_AD_fw_Radar_1R1V_rpc_XilObjBypassingRunnable_XilObjBypassingRunnable_m_pad_radarObjPort_par_out_local::TChangeableMemPool::_::_::_m_arrayPool::_0_::_elem::_m_objectInformation::_7_::_m_ayN = 0;
        @sysvar::XCP::RadarFC_Obj::_g_PL_AD_fw_Radar_1R1V_rpc_XilObjBypassingRunnable_XilObjBypassingRunnable_m_pad_radarObjPort_par_out_local::TChangeableMemPool::_::_::_m_arrayPool::_0_::_elem::_m_objectInformation::_7_::_m_alpPiYawAngleN = dllGetRadarFCObjYawAngle(@hil_ctrl::Handle_RoadObj, 0) * 128; // 128 correct?
        
        // target probabilities
        @sysvar::XCP::RadarFC_Obj::_g_PL_AD_fw_Radar_1R1V_rpc_XilObjBypassingRunnable_XilObjBypassingRunnable_m_pad_radarObjPort_par_out_local::TChangeableMemPool::_::_::_m_arrayPool::_0_::_elem::_m_objectInformation::_7_::_m_prob1HasBeenObservedMovingN = dllGetRadarFCObjProbMoving(@hil_ctrl::Handle_RoadObj, object_id) * 1.26;
        @sysvar::XCP::RadarFC_Obj::_g_PL_AD_fw_Radar_1R1V_rpc_XilObjBypassingRunnable_XilObjBypassingRunnable_m_pad_radarObjPort_par_out_local::TChangeableMemPool::_::_::_m_arrayPool::_0_::_elem::_m_objectInformation::_7_::_m_prob1MovingN = dllGetRadarFCObjProbMoving(@hil_ctrl::Handle_RoadObj, object_id) * 1.26;
        @sysvar::XCP::RadarFC_Obj::_g_PL_AD_fw_Radar_1R1V_rpc_XilObjBypassingRunnable_XilObjBypassingRunnable_m_pad_radarObjPort_par_out_local::TChangeableMemPool::_::_::_m_arrayPool::_0_::_elem::_m_objectInformation::_7_::_m_perObjectType::_m_prob1ObstacleN = (100 - dllGetRadarFCObjProbNonObst(@hil_ctrl::Handle_RoadObj, object_id)) * 1.28;
        @sysvar::XCP::RadarFC_Obj::_g_PL_AD_fw_Radar_1R1V_rpc_XilObjBypassingRunnable_XilObjBypassingRunnable_m_pad_radarObjPort_par_out_local::TChangeableMemPool::_::_::_m_arrayPool::_0_::_elem::_m_objectInformation::_7_::_m_perObjectType::_m_prob1NonObstacleN = dllGetRadarFCObjProbNonObst(@hil_ctrl::Handle_RoadObj, object_id) * 1.28;
        @sysvar::XCP::RadarFC_Obj::_g_PL_AD_fw_Radar_1R1V_rpc_XilObjBypassingRunnable_XilObjBypassingRunnable_m_pad_radarObjPort_par_out_local::TChangeableMemPool::_::_::_m_arrayPool::_0_::_elem::_m_objectInformation::_7_::_m_perObjectType::_m_prob1MobileN = dllGetRadarFCObjProbMoving(@hil_ctrl::Handle_RoadObj, object_id) * 1.28;
        @sysvar::XCP::RadarFC_Obj::_g_PL_AD_fw_Radar_1R1V_rpc_XilObjBypassingRunnable_XilObjBypassingRunnable_m_pad_radarObjPort_par_out_local::TChangeableMemPool::_::_::_m_arrayPool::_0_::_elem::_m_objectInformation::_7_::_m_perObjectType::_m_prob1StationaryN = (100 - dllGetRadarFCObjProbMoving(@hil_ctrl::Handle_RoadObj, object_id)) * 1.28;
        @sysvar::XCP::RadarFC_Obj::_g_PL_AD_fw_Radar_1R1V_rpc_XilObjBypassingRunnable_XilObjBypassingRunnable_m_pad_radarObjPort_par_out_local::TChangeableMemPool::_::_::_m_arrayPool::_0_::_elem::_m_objectInformation::_7_::_m_perObjectType::_m_prob1FourPlusWheelerN = (dllGetRadarFCObjProbCar(@hil_ctrl::Handle_RoadObj, object_id) + dllGetRadarFCObjProbTruck(@hil_ctrl::Handle_RoadObj, object_id)) * 1.28;
        @sysvar::XCP::RadarFC_Obj::_g_PL_AD_fw_Radar_1R1V_rpc_XilObjBypassingRunnable_XilObjBypassingRunnable_m_pad_radarObjPort_par_out_local::TChangeableMemPool::_::_::_m_arrayPool::_0_::_elem::_m_objectInformation::_7_::_m_perObjectType::_m_prob1TwoWheelerN = dllGetRadarFCObjProb2Wheeler(@hil_ctrl::Handle_RoadObj, object_id) * 1.28;
        @sysvar::XCP::RadarFC_Obj::_g_PL_AD_fw_Radar_1R1V_rpc_XilObjBypassingRunnable_XilObjBypassingRunnable_m_pad_radarObjPort_par_out_local::TChangeableMemPool::_::_::_m_arrayPool::_0_::_elem::_m_objectInformation::_7_::_m_perObjectType::_m_prob1PedestrianN = dllGetRadarFCObjProbPedestrian(@hil_ctrl::Handle_RoadObj, object_id) * 1.28;
        @sysvar::XCP::RadarFC_Obj::_g_PL_AD_fw_Radar_1R1V_rpc_XilObjBypassingRunnable_XilObjBypassingRunnable_m_pad_radarObjPort_par_out_local::TChangeableMemPool::_::_::_m_arrayPool::_0_::_elem::_m_objectInformation::_7_::_m_perObjectType::_m_prob1RoadsideBarrierN = (100 - dllGetRadarFCObjProbMoving(@hil_ctrl::Handle_RoadObj, object_id)) * 1.28;
        @sysvar::XCP::RadarFC_Obj::_g_PL_AD_fw_Radar_1R1V_rpc_XilObjBypassingRunnable_XilObjBypassingRunnable_m_pad_radarObjPort_par_out_local::TChangeableMemPool::_::_::_m_arrayPool::_0_::_elem::_m_objectInformation::_7_::_m_perObjectType::_m_prob1PassengerCarN = dllGetRadarFCObjProbCar(@hil_ctrl::Handle_RoadObj, object_id) * 1.28;
        @sysvar::XCP::RadarFC_Obj::_g_PL_AD_fw_Radar_1R1V_rpc_XilObjBypassingRunnable_XilObjBypassingRunnable_m_pad_radarObjPort_par_out_local::TChangeableMemPool::_::_::_m_arrayPool::_0_::_elem::_m_objectInformation::_7_::_m_perObjectType::_m_prob1TruckN = dllGetRadarFCObjProbTruck(@hil_ctrl::Handle_RoadObj, object_id) * 1.28;
        @sysvar::XCP::RadarFC_Obj::_g_PL_AD_fw_Radar_1R1V_rpc_XilObjBypassingRunnable_XilObjBypassingRunnable_m_pad_radarObjPort_par_out_local::TChangeableMemPool::_::_::_m_arrayPool::_0_::_elem::_m_objectInformation::_7_::_m_perObjectType::_m_prob1UnknownN = 0;
        @sysvar::XCP::RadarFC_Obj::_g_PL_AD_fw_Radar_1R1V_rpc_XilObjBypassingRunnable_XilObjBypassingRunnable_m_pad_radarObjPort_par_out_local::TChangeableMemPool::_::_::_m_arrayPool::_0_::_elem::_m_objectInformation::_7_::_m_perObjectType::_m_prob1MovUnknownN = 0;
        @sysvar::XCP::RadarFC_Obj::_g_PL_AD_fw_Radar_1R1V_rpc_XilObjBypassingRunnable_XilObjBypassingRunnable_m_pad_radarObjPort_par_out_local::TChangeableMemPool::_::_::_m_arrayPool::_0_::_elem::_m_objectInformation::_7_::_m_perObjectType::_m_prob1StatUnknownN = 0; // 128 previously
        @sysvar::XCP::RadarFC_Obj::_g_PL_AD_fw_Radar_1R1V_rpc_XilObjBypassingRunnable_XilObjBypassingRunnable_m_pad_radarObjPort_par_out_local::TChangeableMemPool::_::_::_m_arrayPool::_0_::_elem::_m_objectInformation::_7_::_m_perObjectType::_m_prob1ObstUnknownN = 0;
        @sysvar::XCP::RadarFC_Obj::_g_PL_AD_fw_Radar_1R1V_rpc_XilObjBypassingRunnable_XilObjBypassingRunnable_m_pad_radarObjPort_par_out_local::TChangeableMemPool::_::_::_m_arrayPool::_0_::_elem::_m_objectInformation::_7_::_m_perObjectType::_m_prob1FourWheelUnknownN = 0;
        break;
        
      case 8: //"Object-8"
        // constant values
        @sysvar::XCP::RadarFC_Obj::_g_PL_AD_fw_Radar_1R1V_rpc_XilObjBypassingRunnable_XilObjBypassingRunnable_m_pad_radarObjPort_par_out_local::TChangeableMemPool::_::_::_m_arrayPool::_0_::_elem::_m_objectInformation::_8_::_Valid_b = 1;
        @sysvar::XCP::RadarFC_Obj::_g_PL_AD_fw_Radar_1R1V_rpc_XilObjBypassingRunnable_XilObjBypassingRunnable_m_pad_radarObjPort_par_out_local::TChangeableMemPool::_::_::_m_arrayPool::_0_::_elem::_m_objectInformation::_8_::_m_HandleN = 1;
        @sysvar::XCP::RadarFC_Obj::_g_PL_AD_fw_Radar_1R1V_rpc_XilObjBypassingRunnable_XilObjBypassingRunnable_m_pad_radarObjPort_par_out_local::TChangeableMemPool::_::_::_m_arrayPool::_0_::_elem::_m_objectInformation::_8_::_m_alpPiVarYawAngleN = 3;
        @sysvar::XCP::RadarFC_Obj::_g_PL_AD_fw_Radar_1R1V_rpc_XilObjBypassingRunnable_XilObjBypassingRunnable_m_pad_radarObjPort_par_out_local::TChangeableMemPool::_::_::_m_arrayPool::_0_::_elem::_m_objectInformation::_8_::_m_varAxN = 0;
        @sysvar::XCP::RadarFC_Obj::_g_PL_AD_fw_Radar_1R1V_rpc_XilObjBypassingRunnable_XilObjBypassingRunnable_m_pad_radarObjPort_par_out_local::TChangeableMemPool::_::_::_m_arrayPool::_0_::_elem::_m_objectInformation::_8_::_m_varAyN = 0;
        @sysvar::XCP::RadarFC_Obj::_g_PL_AD_fw_Radar_1R1V_rpc_XilObjBypassingRunnable_XilObjBypassingRunnable_m_pad_radarObjPort_par_out_local::TChangeableMemPool::_::_::_m_arrayPool::_0_::_elem::_m_objectInformation::_8_::_m_varVxN = 0;
        @sysvar::XCP::RadarFC_Obj::_g_PL_AD_fw_Radar_1R1V_rpc_XilObjBypassingRunnable_XilObjBypassingRunnable_m_pad_radarObjPort_par_out_local::TChangeableMemPool::_::_::_m_arrayPool::_0_::_elem::_m_objectInformation::_8_::_m_varVyN = 0;
        @sysvar::XCP::RadarFC_Obj::_g_PL_AD_fw_Radar_1R1V_rpc_XilObjBypassingRunnable_XilObjBypassingRunnable_m_pad_radarObjPort_par_out_local::TChangeableMemPool::_::_::_m_arrayPool::_0_::_elem::_m_objectInformation::_8_::_m_varDxN = 0;
        @sysvar::XCP::RadarFC_Obj::_g_PL_AD_fw_Radar_1R1V_rpc_XilObjBypassingRunnable_XilObjBypassingRunnable_m_pad_radarObjPort_par_out_local::TChangeableMemPool::_::_::_m_arrayPool::_0_::_elem::_m_objectInformation::_8_::_m_varDyN = 0;
        @sysvar::XCP::RadarFC_Obj::_g_PL_AD_fw_Radar_1R1V_rpc_XilObjBypassingRunnable_XilObjBypassingRunnable_m_pad_radarObjPort_par_out_local::TChangeableMemPool::_::_::_m_arrayPool::_0_::_elem::_m_objectInformation::_8_::_m_dVarLengthN = 0;
        @sysvar::XCP::RadarFC_Obj::_g_PL_AD_fw_Radar_1R1V_rpc_XilObjBypassingRunnable_XilObjBypassingRunnable_m_pad_radarObjPort_par_out_local::TChangeableMemPool::_::_::_m_arrayPool::_0_::_elem::_m_objectInformation::_8_::_m_dVarWidthN = 0;
        @sysvar::XCP::RadarFC_Obj::_g_PL_AD_fw_Radar_1R1V_rpc_XilObjBypassingRunnable_XilObjBypassingRunnable_m_pad_radarObjPort_par_out_local::TChangeableMemPool::_::_::_m_arrayPool::_0_::_elem::_m_objectInformation::_8_::_m_wExistProbN = 64880;
        @sysvar::XCP::RadarFC_Obj::_g_PL_AD_fw_Radar_1R1V_rpc_XilObjBypassingRunnable_XilObjBypassingRunnable_m_pad_radarObjPort_par_out_local::TChangeableMemPool::_::_::_m_arrayPool::_0_::_elem::_m_objectInformation::_8_::_m_isObjectAsil = 1;
        
        // target dimensions
        @sysvar::XCP::RadarFC_Obj::_g_PL_AD_fw_Radar_1R1V_rpc_XilObjBypassingRunnable_XilObjBypassingRunnable_m_pad_radarObjPort_par_out_local::TChangeableMemPool::_::_::_m_arrayPool::_0_::_elem::_m_objectInformation::_8_::_m_dWidthN = dllGetRadarFCInputObjectWidth(@hil_ctrl::Handle_RoadObj, 0) * 128;
        @sysvar::XCP::RadarFC_Obj::_g_PL_AD_fw_Radar_1R1V_rpc_XilObjBypassingRunnable_XilObjBypassingRunnable_m_pad_radarObjPort_par_out_local::TChangeableMemPool::_::_::_m_arrayPool::_0_::_elem::_m_objectInformation::_8_::_m_dLengthN = dllGetRadarFCInputObjectLength(@hil_ctrl::Handle_RoadObj, 0) * 64;
          
        // target movement
        @sysvar::XCP::RadarFC_Obj::_g_PL_AD_fw_Radar_1R1V_rpc_XilObjBypassingRunnable_XilObjBypassingRunnable_m_pad_radarObjPort_par_out_local::TChangeableMemPool::_::_::_m_arrayPool::_0_::_elem::_m_objectInformation::_8_::_m_dxN = dllGetRadarFCObjDistX(@hil_ctrl::Handle_RoadObj, 0) * 128;
        @sysvar::XCP::RadarFC_Obj::_g_PL_AD_fw_Radar_1R1V_rpc_XilObjBypassingRunnable_XilObjBypassingRunnable_m_pad_radarObjPort_par_out_local::TChangeableMemPool::_::_::_m_arrayPool::_0_::_elem::_m_objectInformation::_8_::_m_dyN = dllGetRadarFCObjDistY(@hil_ctrl::Handle_RoadObj, 0) * 128;
        @sysvar::XCP::RadarFC_Obj::_g_PL_AD_fw_Radar_1R1V_rpc_XilObjBypassingRunnable_XilObjBypassingRunnable_m_pad_radarObjPort_par_out_local::TChangeableMemPool::_::_::_m_arrayPool::_0_::_elem::_m_objectInformation::_8_::_m_dzN = 0;
        @sysvar::XCP::RadarFC_Obj::_g_PL_AD_fw_Radar_1R1V_rpc_XilObjBypassingRunnable_XilObjBypassingRunnable_m_pad_radarObjPort_par_out_local::TChangeableMemPool::_::_::_m_arrayPool::_0_::_elem::_m_objectInformation::_8_::_m_vxN = dllGetRadarFCObjVelX(@hil_ctrl::Handle_RoadObj, 0) * 256;
        @sysvar::XCP::RadarFC_Obj::_g_PL_AD_fw_Radar_1R1V_rpc_XilObjBypassingRunnable_XilObjBypassingRunnable_m_pad_radarObjPort_par_out_local::TChangeableMemPool::_::_::_m_arrayPool::_0_::_elem::_m_objectInformation::_8_::_m_vyN = dllGetRadarFCObjVelY(@hil_ctrl::Handle_RoadObj, 0) * 256;
        @sysvar::XCP::RadarFC_Obj::_g_PL_AD_fw_Radar_1R1V_rpc_XilObjBypassingRunnable_XilObjBypassingRunnable_m_pad_radarObjPort_par_out_local::TChangeableMemPool::_::_::_m_arrayPool::_0_::_elem::_m_objectInformation::_8_::_m_axN = 0;
        @sysvar::XCP::RadarFC_Obj::_g_PL_AD_fw_Radar_1R1V_rpc_XilObjBypassingRunnable_XilObjBypassingRunnable_m_pad_radarObjPort_par_out_local::TChangeableMemPool::_::_::_m_arrayPool::_0_::_elem::_m_objectInformation::_8_::_m_ayN = 0;
        @sysvar::XCP::RadarFC_Obj::_g_PL_AD_fw_Radar_1R1V_rpc_XilObjBypassingRunnable_XilObjBypassingRunnable_m_pad_radarObjPort_par_out_local::TChangeableMemPool::_::_::_m_arrayPool::_0_::_elem::_m_objectInformation::_8_::_m_alpPiYawAngleN = dllGetRadarFCObjYawAngle(@hil_ctrl::Handle_RoadObj, 0) * 128; // 128 correct?
        
        // target probabilities
        @sysvar::XCP::RadarFC_Obj::_g_PL_AD_fw_Radar_1R1V_rpc_XilObjBypassingRunnable_XilObjBypassingRunnable_m_pad_radarObjPort_par_out_local::TChangeableMemPool::_::_::_m_arrayPool::_0_::_elem::_m_objectInformation::_8_::_m_prob1HasBeenObservedMovingN = dllGetRadarFCObjProbMoving(@hil_ctrl::Handle_RoadObj, object_id) * 1.26;
        @sysvar::XCP::RadarFC_Obj::_g_PL_AD_fw_Radar_1R1V_rpc_XilObjBypassingRunnable_XilObjBypassingRunnable_m_pad_radarObjPort_par_out_local::TChangeableMemPool::_::_::_m_arrayPool::_0_::_elem::_m_objectInformation::_8_::_m_prob1MovingN = dllGetRadarFCObjProbMoving(@hil_ctrl::Handle_RoadObj, object_id) * 1.26;
        @sysvar::XCP::RadarFC_Obj::_g_PL_AD_fw_Radar_1R1V_rpc_XilObjBypassingRunnable_XilObjBypassingRunnable_m_pad_radarObjPort_par_out_local::TChangeableMemPool::_::_::_m_arrayPool::_0_::_elem::_m_objectInformation::_8_::_m_perObjectType::_m_prob1ObstacleN = (100 - dllGetRadarFCObjProbNonObst(@hil_ctrl::Handle_RoadObj, object_id)) * 1.28;
        @sysvar::XCP::RadarFC_Obj::_g_PL_AD_fw_Radar_1R1V_rpc_XilObjBypassingRunnable_XilObjBypassingRunnable_m_pad_radarObjPort_par_out_local::TChangeableMemPool::_::_::_m_arrayPool::_0_::_elem::_m_objectInformation::_8_::_m_perObjectType::_m_prob1NonObstacleN = dllGetRadarFCObjProbNonObst(@hil_ctrl::Handle_RoadObj, object_id) * 1.28;
        @sysvar::XCP::RadarFC_Obj::_g_PL_AD_fw_Radar_1R1V_rpc_XilObjBypassingRunnable_XilObjBypassingRunnable_m_pad_radarObjPort_par_out_local::TChangeableMemPool::_::_::_m_arrayPool::_0_::_elem::_m_objectInformation::_8_::_m_perObjectType::_m_prob1MobileN = dllGetRadarFCObjProbMoving(@hil_ctrl::Handle_RoadObj, object_id) * 1.28;
        @sysvar::XCP::RadarFC_Obj::_g_PL_AD_fw_Radar_1R1V_rpc_XilObjBypassingRunnable_XilObjBypassingRunnable_m_pad_radarObjPort_par_out_local::TChangeableMemPool::_::_::_m_arrayPool::_0_::_elem::_m_objectInformation::_8_::_m_perObjectType::_m_prob1StationaryN = (100 - dllGetRadarFCObjProbMoving(@hil_ctrl::Handle_RoadObj, object_id)) * 1.28;
        @sysvar::XCP::RadarFC_Obj::_g_PL_AD_fw_Radar_1R1V_rpc_XilObjBypassingRunnable_XilObjBypassingRunnable_m_pad_radarObjPort_par_out_local::TChangeableMemPool::_::_::_m_arrayPool::_0_::_elem::_m_objectInformation::_8_::_m_perObjectType::_m_prob1FourPlusWheelerN = (dllGetRadarFCObjProbCar(@hil_ctrl::Handle_RoadObj, object_id) + dllGetRadarFCObjProbTruck(@hil_ctrl::Handle_RoadObj, object_id)) * 1.28;
        @sysvar::XCP::RadarFC_Obj::_g_PL_AD_fw_Radar_1R1V_rpc_XilObjBypassingRunnable_XilObjBypassingRunnable_m_pad_radarObjPort_par_out_local::TChangeableMemPool::_::_::_m_arrayPool::_0_::_elem::_m_objectInformation::_8_::_m_perObjectType::_m_prob1TwoWheelerN = dllGetRadarFCObjProb2Wheeler(@hil_ctrl::Handle_RoadObj, object_id) * 1.28;
        @sysvar::XCP::RadarFC_Obj::_g_PL_AD_fw_Radar_1R1V_rpc_XilObjBypassingRunnable_XilObjBypassingRunnable_m_pad_radarObjPort_par_out_local::TChangeableMemPool::_::_::_m_arrayPool::_0_::_elem::_m_objectInformation::_8_::_m_perObjectType::_m_prob1PedestrianN = dllGetRadarFCObjProbPedestrian(@hil_ctrl::Handle_RoadObj, object_id) * 1.28;
        @sysvar::XCP::RadarFC_Obj::_g_PL_AD_fw_Radar_1R1V_rpc_XilObjBypassingRunnable_XilObjBypassingRunnable_m_pad_radarObjPort_par_out_local::TChangeableMemPool::_::_::_m_arrayPool::_0_::_elem::_m_objectInformation::_8_::_m_perObjectType::_m_prob1RoadsideBarrierN = (100 - dllGetRadarFCObjProbMoving(@hil_ctrl::Handle_RoadObj, object_id)) * 1.28;
        @sysvar::XCP::RadarFC_Obj::_g_PL_AD_fw_Radar_1R1V_rpc_XilObjBypassingRunnable_XilObjBypassingRunnable_m_pad_radarObjPort_par_out_local::TChangeableMemPool::_::_::_m_arrayPool::_0_::_elem::_m_objectInformation::_8_::_m_perObjectType::_m_prob1PassengerCarN = dllGetRadarFCObjProbCar(@hil_ctrl::Handle_RoadObj, object_id) * 1.28;
        @sysvar::XCP::RadarFC_Obj::_g_PL_AD_fw_Radar_1R1V_rpc_XilObjBypassingRunnable_XilObjBypassingRunnable_m_pad_radarObjPort_par_out_local::TChangeableMemPool::_::_::_m_arrayPool::_0_::_elem::_m_objectInformation::_8_::_m_perObjectType::_m_prob1TruckN = dllGetRadarFCObjProbTruck(@hil_ctrl::Handle_RoadObj, object_id) * 1.28;
        @sysvar::XCP::RadarFC_Obj::_g_PL_AD_fw_Radar_1R1V_rpc_XilObjBypassingRunnable_XilObjBypassingRunnable_m_pad_radarObjPort_par_out_local::TChangeableMemPool::_::_::_m_arrayPool::_0_::_elem::_m_objectInformation::_8_::_m_perObjectType::_m_prob1UnknownN = 0;
        @sysvar::XCP::RadarFC_Obj::_g_PL_AD_fw_Radar_1R1V_rpc_XilObjBypassingRunnable_XilObjBypassingRunnable_m_pad_radarObjPort_par_out_local::TChangeableMemPool::_::_::_m_arrayPool::_0_::_elem::_m_objectInformation::_8_::_m_perObjectType::_m_prob1MovUnknownN = 0;
        @sysvar::XCP::RadarFC_Obj::_g_PL_AD_fw_Radar_1R1V_rpc_XilObjBypassingRunnable_XilObjBypassingRunnable_m_pad_radarObjPort_par_out_local::TChangeableMemPool::_::_::_m_arrayPool::_0_::_elem::_m_objectInformation::_8_::_m_perObjectType::_m_prob1StatUnknownN = 0; // 128 previously
        @sysvar::XCP::RadarFC_Obj::_g_PL_AD_fw_Radar_1R1V_rpc_XilObjBypassingRunnable_XilObjBypassingRunnable_m_pad_radarObjPort_par_out_local::TChangeableMemPool::_::_::_m_arrayPool::_0_::_elem::_m_objectInformation::_8_::_m_perObjectType::_m_prob1ObstUnknownN = 0;
        @sysvar::XCP::RadarFC_Obj::_g_PL_AD_fw_Radar_1R1V_rpc_XilObjBypassingRunnable_XilObjBypassingRunnable_m_pad_radarObjPort_par_out_local::TChangeableMemPool::_::_::_m_arrayPool::_0_::_elem::_m_objectInformation::_8_::_m_perObjectType::_m_prob1FourWheelUnknownN = 0;
        break;
        
    }
  }
}

void delete_radar_fc_bus_obj(byte object_id)
{
  target_counter_radar_fc = 0;
  injection_counter_radar_fc = -1;
  
  //object array can contain holes which is why the following code (injection_counter) closes those holes on the bus
  for(target_counter_radar_fc = 0; target_counter_radar_fc <= object_id; target_counter_radar_fc++){
    if(@target_radar_fc_sim::objdata.empty_obj[target_counter_radar_fc] == 0 || target_counter_radar_fc == object_id){
      injection_counter_radar_fc++;
    }
  }
  
  switch (injection_counter_radar_fc)
  {
    case 0:
        @CAN_RadarFC::RFC_Object::RFC_Object_Obj1.ObjId = 0;
        @CAN_RadarFC::RFC_Object::RFC_Object_Obj1.WidthVnce = 0;
        @CAN_RadarFC::RFC_Object::RFC_Object_Obj1.VxVnce = 0;
        @CAN_RadarFC::RFC_Object::RFC_Object_Obj1.AyVnce = 0;
        @CAN_RadarFC::RFC_Object::RFC_Object_Obj1.OrientationYawVnce = 0;
        @CAN_RadarFC::RFC_Object::RFC_Object_Obj1.LengthVnce = 0;
        @CAN_RadarFC::RFC_Object::RFC_Object_Obj1.AxVnce = 0;
        @CAN_RadarFC::RFC_Object::RFC_Object_Obj1.PyVnce = 0;
        @CAN_RadarFC::RFC_Object::RFC_Object_Obj1.PxVnce = 0;
        @CAN_RadarFC::RFC_Object::RFC_Object_Obj1.PxPyCoVnce = 0;
        @CAN_RadarFC::RFC_Object::RFC_Object_Obj1.PyAxCoVnce = 0;
        @CAN_RadarFC::RFC_Object::RFC_Object_Obj1.AxAyCoVnce = 0;
        @CAN_RadarFC::RFC_Object::RFC_Object_Obj1.VyAyCoVnce = 0;
        @CAN_RadarFC::RFC_Object::RFC_Object_Obj1.VyAxCoVnce = 0;
        @CAN_RadarFC::RFC_Object::RFC_Object_Obj1.VxAyCoVnce = 0;
        @CAN_RadarFC::RFC_Object::RFC_Object_Obj1.VxAxCoVnce = 0;
        @CAN_RadarFC::RFC_Object::RFC_Object_Obj1.VxVyCoVnce = 0;
        @CAN_RadarFC::RFC_Object::RFC_Object_Obj1.VyVnce = 0;
        @CAN_RadarFC::RFC_Object::RFC_Object_Obj1.PyAyCoVnce = 0;
        @CAN_RadarFC::RFC_Object::RFC_Object_Obj1.PxAyCoVnce = 0;
        @CAN_RadarFC::RFC_Object::RFC_Object_Obj1.PxAxCoVnce = 0;
        @CAN_RadarFC::RFC_Object::RFC_Object_Obj1.PyVyCoVnce = 0;
        @CAN_RadarFC::RFC_Object::RFC_Object_Obj1.PxVyCoVnce = 0;
        @CAN_RadarFC::RFC_Object::RFC_Object_Obj1.PxVxCoVnce = 0;
        @CAN_RadarFC::RFC_Object::RFC_Object_Obj1.PyVxCoVnce = 0;
        @CAN_RadarFC::RFC_Object::RFC_Object_Obj1.ExistProb = 0;
        @CAN_RadarFC::RFC_Object::RFC_Object_Obj1.ProbClassConfidence = 0;
        @CAN_RadarFC::RFC_Object::RFC_Object_Obj1.MeasurementStatus = 0;
        @CAN_RadarFC::RFC_Object::RFC_Object_Obj1.OrientationYaw = -4.48;
        @CAN_RadarFC::RFC_Object::RFC_Object_Obj1.Width = 0;
        @CAN_RadarFC::RFC_Object::RFC_Object_Obj1.Length = 0;
        @CAN_RadarFC::RFC_Object::RFC_Object_Obj1.RCS = -102.4;
        @CAN_RadarFC::RFC_Object::RFC_Object_Obj1.Px = -512;
        @CAN_RadarFC::RFC_Object::RFC_Object_Obj1.Py = -128;
        @CAN_RadarFC::RFC_Object::RFC_Object_Obj1.Vx = -128;
        @CAN_RadarFC::RFC_Object::RFC_Object_Obj1.Vy = -64;
        @CAN_RadarFC::RFC_Object::RFC_Object_Obj1.Ax = -16;
        @CAN_RadarFC::RFC_Object::RFC_Object_Obj1.Ay = -16;
        @CAN_RadarFC::RFC_Object::RFC_Object_Obj1.MovingStatus = 0;
        @CAN_RadarFC::RFC_Object::RFC_Object_Obj1.Age = 0;
        @CAN_RadarFC::RFC_Object::RFC_Object_Obj1.ProbClassType = 0;
        @CAN_RadarFC::RFC_Object::RFC_Object_Obj1.ReferencePoint = 0;
        @CAN_RadarFC::RFC_Object::RFC_Object_Obj1.FilterInformation = 0;
      break;
      
    case 1:
        @CAN_RadarFC::RFC_Object::RFC_Object_Obj2.ObjId = 0;
        @CAN_RadarFC::RFC_Object::RFC_Object_Obj2.WidthVnce = 0;
        @CAN_RadarFC::RFC_Object::RFC_Object_Obj2.VxVnce = 0;
        @CAN_RadarFC::RFC_Object::RFC_Object_Obj2.AyVnce = 0;
        @CAN_RadarFC::RFC_Object::RFC_Object_Obj2.OrientationYawVnce = 0;
        @CAN_RadarFC::RFC_Object::RFC_Object_Obj2.LengthVnce = 0;
        @CAN_RadarFC::RFC_Object::RFC_Object_Obj2.AxVnce = 0;
        @CAN_RadarFC::RFC_Object::RFC_Object_Obj2.PyVnce = 0;
        @CAN_RadarFC::RFC_Object::RFC_Object_Obj2.PxVnce = 0;
        @CAN_RadarFC::RFC_Object::RFC_Object_Obj2.PxPyCoVnce = 0;
        @CAN_RadarFC::RFC_Object::RFC_Object_Obj2.PyAxCoVnce = 0;
        @CAN_RadarFC::RFC_Object::RFC_Object_Obj2.AxAyCoVnce = 0;
        @CAN_RadarFC::RFC_Object::RFC_Object_Obj2.VyAyCoVnce = 0;
        @CAN_RadarFC::RFC_Object::RFC_Object_Obj2.VyAxCoVnce = 0;
        @CAN_RadarFC::RFC_Object::RFC_Object_Obj2.VxAyCoVnce = 0;
        @CAN_RadarFC::RFC_Object::RFC_Object_Obj2.VxAxCoVnce = 0;
        @CAN_RadarFC::RFC_Object::RFC_Object_Obj2.VxVyCoVnce = 0;
        @CAN_RadarFC::RFC_Object::RFC_Object_Obj2.VyVnce = 0;
        @CAN_RadarFC::RFC_Object::RFC_Object_Obj2.PyAyCoVnce = 0;
        @CAN_RadarFC::RFC_Object::RFC_Object_Obj2.PxAyCoVnce = 0;
        @CAN_RadarFC::RFC_Object::RFC_Object_Obj2.PxAxCoVnce = 0;
        @CAN_RadarFC::RFC_Object::RFC_Object_Obj2.PyVyCoVnce = 0;
        @CAN_RadarFC::RFC_Object::RFC_Object_Obj2.PxVyCoVnce = 0;
        @CAN_RadarFC::RFC_Object::RFC_Object_Obj2.PxVxCoVnce = 0;
        @CAN_RadarFC::RFC_Object::RFC_Object_Obj2.PyVxCoVnce = 0;
        @CAN_RadarFC::RFC_Object::RFC_Object_Obj2.ExistProb = 0;
        @CAN_RadarFC::RFC_Object::RFC_Object_Obj2.ProbClassConfidence = 0;
        @CAN_RadarFC::RFC_Object::RFC_Object_Obj2.MeasurementStatus = 0;
        @CAN_RadarFC::RFC_Object::RFC_Object_Obj2.OrientationYaw = -4.48;
        @CAN_RadarFC::RFC_Object::RFC_Object_Obj2.Width = 0;
        @CAN_RadarFC::RFC_Object::RFC_Object_Obj2.Length = 0;
        @CAN_RadarFC::RFC_Object::RFC_Object_Obj2.RCS = -102.4;
        @CAN_RadarFC::RFC_Object::RFC_Object_Obj2.Px = -512;
        @CAN_RadarFC::RFC_Object::RFC_Object_Obj2.Py = -128;
        @CAN_RadarFC::RFC_Object::RFC_Object_Obj2.Vx = -128;
        @CAN_RadarFC::RFC_Object::RFC_Object_Obj2.Vy = -64;
        @CAN_RadarFC::RFC_Object::RFC_Object_Obj2.Ax = -16;
        @CAN_RadarFC::RFC_Object::RFC_Object_Obj2.Ay = -16;
        @CAN_RadarFC::RFC_Object::RFC_Object_Obj2.MovingStatus = 0;
        @CAN_RadarFC::RFC_Object::RFC_Object_Obj2.Age = 0;
        @CAN_RadarFC::RFC_Object::RFC_Object_Obj2.ProbClassType = 0;
        @CAN_RadarFC::RFC_Object::RFC_Object_Obj2.ReferencePoint = 0;
        @CAN_RadarFC::RFC_Object::RFC_Object_Obj2.FilterInformation = 0;
      break;
      
    case 2:
        @CAN_RadarFC::RFC_Object::RFC_Object_Obj3.ObjId = 0;
        @CAN_RadarFC::RFC_Object::RFC_Object_Obj3.WidthVnce = 0;
        @CAN_RadarFC::RFC_Object::RFC_Object_Obj3.VxVnce = 0;
        @CAN_RadarFC::RFC_Object::RFC_Object_Obj3.AyVnce = 0;
        @CAN_RadarFC::RFC_Object::RFC_Object_Obj3.OrientationYawVnce = 0;
        @CAN_RadarFC::RFC_Object::RFC_Object_Obj3.LengthVnce = 0;
        @CAN_RadarFC::RFC_Object::RFC_Object_Obj3.AxVnce = 0;
        @CAN_RadarFC::RFC_Object::RFC_Object_Obj3.PyVnce = 0;
        @CAN_RadarFC::RFC_Object::RFC_Object_Obj3.PxVnce = 0;
        @CAN_RadarFC::RFC_Object::RFC_Object_Obj3.PxPyCoVnce = 0;
        @CAN_RadarFC::RFC_Object::RFC_Object_Obj3.PyAxCoVnce = 0;
        @CAN_RadarFC::RFC_Object::RFC_Object_Obj3.AxAyCoVnce = 0;
        @CAN_RadarFC::RFC_Object::RFC_Object_Obj3.VyAyCoVnce = 0;
        @CAN_RadarFC::RFC_Object::RFC_Object_Obj3.VyAxCoVnce = 0;
        @CAN_RadarFC::RFC_Object::RFC_Object_Obj3.VxAyCoVnce = 0;
        @CAN_RadarFC::RFC_Object::RFC_Object_Obj3.VxAxCoVnce = 0;
        @CAN_RadarFC::RFC_Object::RFC_Object_Obj3.VxVyCoVnce = 0;
        @CAN_RadarFC::RFC_Object::RFC_Object_Obj3.VyVnce = 0;
        @CAN_RadarFC::RFC_Object::RFC_Object_Obj3.PyAyCoVnce = 0;
        @CAN_RadarFC::RFC_Object::RFC_Object_Obj3.PxAyCoVnce = 0;
        @CAN_RadarFC::RFC_Object::RFC_Object_Obj3.PxAxCoVnce = 0;
        @CAN_RadarFC::RFC_Object::RFC_Object_Obj3.PyVyCoVnce = 0;
        @CAN_RadarFC::RFC_Object::RFC_Object_Obj3.PxVyCoVnce = 0;
        @CAN_RadarFC::RFC_Object::RFC_Object_Obj3.PxVxCoVnce = 0;
        @CAN_RadarFC::RFC_Object::RFC_Object_Obj3.PyVxCoVnce = 0;
        @CAN_RadarFC::RFC_Object::RFC_Object_Obj3.ExistProb = 0;
        @CAN_RadarFC::RFC_Object::RFC_Object_Obj3.ProbClassConfidence = 0;
        @CAN_RadarFC::RFC_Object::RFC_Object_Obj3.MeasurementStatus = 0;
        @CAN_RadarFC::RFC_Object::RFC_Object_Obj3.OrientationYaw = -4.48;
        @CAN_RadarFC::RFC_Object::RFC_Object_Obj3.Width = 0;
        @CAN_RadarFC::RFC_Object::RFC_Object_Obj3.Length = 0;
        @CAN_RadarFC::RFC_Object::RFC_Object_Obj3.RCS = -102.4;
        @CAN_RadarFC::RFC_Object::RFC_Object_Obj3.Px = -512;
        @CAN_RadarFC::RFC_Object::RFC_Object_Obj3.Py = -128;
        @CAN_RadarFC::RFC_Object::RFC_Object_Obj3.Vx = -128;
        @CAN_RadarFC::RFC_Object::RFC_Object_Obj3.Vy = -64;
        @CAN_RadarFC::RFC_Object::RFC_Object_Obj3.Ax = -16;
        @CAN_RadarFC::RFC_Object::RFC_Object_Obj3.Ay = -16;
        @CAN_RadarFC::RFC_Object::RFC_Object_Obj3.MovingStatus = 0;
        @CAN_RadarFC::RFC_Object::RFC_Object_Obj3.Age = 0;
        @CAN_RadarFC::RFC_Object::RFC_Object_Obj3.ProbClassType = 0;
        @CAN_RadarFC::RFC_Object::RFC_Object_Obj3.ReferencePoint = 0;
        @CAN_RadarFC::RFC_Object::RFC_Object_Obj3.FilterInformation = 0;
      break;
      
    case 3:
        @CAN_RadarFC::RFC_Object::RFC_Object_Obj4.ObjId = 0;
        @CAN_RadarFC::RFC_Object::RFC_Object_Obj4.WidthVnce = 0;
        @CAN_RadarFC::RFC_Object::RFC_Object_Obj4.VxVnce = 0;
        @CAN_RadarFC::RFC_Object::RFC_Object_Obj4.AyVnce = 0;
        @CAN_RadarFC::RFC_Object::RFC_Object_Obj4.OrientationYawVnce = 0;
        @CAN_RadarFC::RFC_Object::RFC_Object_Obj4.LengthVnce = 0;
        @CAN_RadarFC::RFC_Object::RFC_Object_Obj4.AxVnce = 0;
        @CAN_RadarFC::RFC_Object::RFC_Object_Obj4.PyVnce = 0;
        @CAN_RadarFC::RFC_Object::RFC_Object_Obj4.PxVnce = 0;
        @CAN_RadarFC::RFC_Object::RFC_Object_Obj4.PxPyCoVnce = 0;
        @CAN_RadarFC::RFC_Object::RFC_Object_Obj4.PyAxCoVnce = 0;
        @CAN_RadarFC::RFC_Object::RFC_Object_Obj4.AxAyCoVnce = 0;
        @CAN_RadarFC::RFC_Object::RFC_Object_Obj4.VyAyCoVnce = 0;
        @CAN_RadarFC::RFC_Object::RFC_Object_Obj4.VyAxCoVnce = 0;
        @CAN_RadarFC::RFC_Object::RFC_Object_Obj4.VxAyCoVnce = 0;
        @CAN_RadarFC::RFC_Object::RFC_Object_Obj4.VxAxCoVnce = 0;
        @CAN_RadarFC::RFC_Object::RFC_Object_Obj4.VxVyCoVnce = 0;
        @CAN_RadarFC::RFC_Object::RFC_Object_Obj4.VyVnce = 0;
        @CAN_RadarFC::RFC_Object::RFC_Object_Obj4.PyAyCoVnce = 0;
        @CAN_RadarFC::RFC_Object::RFC_Object_Obj4.PxAyCoVnce = 0;
        @CAN_RadarFC::RFC_Object::RFC_Object_Obj4.PxAxCoVnce = 0;
        @CAN_RadarFC::RFC_Object::RFC_Object_Obj4.PyVyCoVnce = 0;
        @CAN_RadarFC::RFC_Object::RFC_Object_Obj4.PxVyCoVnce = 0;
        @CAN_RadarFC::RFC_Object::RFC_Object_Obj4.PxVxCoVnce = 0;
        @CAN_RadarFC::RFC_Object::RFC_Object_Obj4.PyVxCoVnce = 0;
        @CAN_RadarFC::RFC_Object::RFC_Object_Obj4.ExistProb = 0;
        @CAN_RadarFC::RFC_Object::RFC_Object_Obj4.ProbClassConfidence = 0;
        @CAN_RadarFC::RFC_Object::RFC_Object_Obj4.MeasurementStatus = 0;
        @CAN_RadarFC::RFC_Object::RFC_Object_Obj4.OrientationYaw = -4.48;
        @CAN_RadarFC::RFC_Object::RFC_Object_Obj4.Width = 0;
        @CAN_RadarFC::RFC_Object::RFC_Object_Obj4.Length = 0;
        @CAN_RadarFC::RFC_Object::RFC_Object_Obj4.RCS = -102.4;
        @CAN_RadarFC::RFC_Object::RFC_Object_Obj4.Px = -512;
        @CAN_RadarFC::RFC_Object::RFC_Object_Obj4.Py = -128;
        @CAN_RadarFC::RFC_Object::RFC_Object_Obj4.Vx = -128;
        @CAN_RadarFC::RFC_Object::RFC_Object_Obj4.Vy = -64;
        @CAN_RadarFC::RFC_Object::RFC_Object_Obj4.Ax = -16;
        @CAN_RadarFC::RFC_Object::RFC_Object_Obj4.Ay = -16;
        @CAN_RadarFC::RFC_Object::RFC_Object_Obj4.MovingStatus = 0;
        @CAN_RadarFC::RFC_Object::RFC_Object_Obj4.Age = 0;
        @CAN_RadarFC::RFC_Object::RFC_Object_Obj4.ProbClassType = 0;
        @CAN_RadarFC::RFC_Object::RFC_Object_Obj4.ReferencePoint = 0;
        @CAN_RadarFC::RFC_Object::RFC_Object_Obj4.FilterInformation = 0;
      break;
      
    case 4:
        @CAN_RadarFC::RFC_Object::RFC_Object_Obj5.ObjId = 0;
        @CAN_RadarFC::RFC_Object::RFC_Object_Obj5.WidthVnce = 0;
        @CAN_RadarFC::RFC_Object::RFC_Object_Obj5.VxVnce = 0;
        @CAN_RadarFC::RFC_Object::RFC_Object_Obj5.AyVnce = 0;
        @CAN_RadarFC::RFC_Object::RFC_Object_Obj5.OrientationYawVnce = 0;
        @CAN_RadarFC::RFC_Object::RFC_Object_Obj5.LengthVnce = 0;
        @CAN_RadarFC::RFC_Object::RFC_Object_Obj5.AxVnce = 0;
        @CAN_RadarFC::RFC_Object::RFC_Object_Obj5.PyVnce = 0;
        @CAN_RadarFC::RFC_Object::RFC_Object_Obj5.PxVnce = 0;
        @CAN_RadarFC::RFC_Object::RFC_Object_Obj5.PxPyCoVnce = 0;
        @CAN_RadarFC::RFC_Object::RFC_Object_Obj5.PyAxCoVnce = 0;
        @CAN_RadarFC::RFC_Object::RFC_Object_Obj5.AxAyCoVnce = 0;
        @CAN_RadarFC::RFC_Object::RFC_Object_Obj5.VyAyCoVnce = 0;
        @CAN_RadarFC::RFC_Object::RFC_Object_Obj5.VyAxCoVnce = 0;
        @CAN_RadarFC::RFC_Object::RFC_Object_Obj5.VxAyCoVnce = 0;
        @CAN_RadarFC::RFC_Object::RFC_Object_Obj5.VxAxCoVnce = 0;
        @CAN_RadarFC::RFC_Object::RFC_Object_Obj5.VxVyCoVnce = 0;
        @CAN_RadarFC::RFC_Object::RFC_Object_Obj5.VyVnce = 0;
        @CAN_RadarFC::RFC_Object::RFC_Object_Obj5.PyAyCoVnce = 0;
        @CAN_RadarFC::RFC_Object::RFC_Object_Obj5.PxAyCoVnce = 0;
        @CAN_RadarFC::RFC_Object::RFC_Object_Obj5.PxAxCoVnce = 0;
        @CAN_RadarFC::RFC_Object::RFC_Object_Obj5.PyVyCoVnce = 0;
        @CAN_RadarFC::RFC_Object::RFC_Object_Obj5.PxVyCoVnce = 0;
        @CAN_RadarFC::RFC_Object::RFC_Object_Obj5.PxVxCoVnce = 0;
        @CAN_RadarFC::RFC_Object::RFC_Object_Obj5.PyVxCoVnce = 0;
        @CAN_RadarFC::RFC_Object::RFC_Object_Obj5.ExistProb = 0;
        @CAN_RadarFC::RFC_Object::RFC_Object_Obj5.ProbClassConfidence = 0;
        @CAN_RadarFC::RFC_Object::RFC_Object_Obj5.MeasurementStatus = 0;
        @CAN_RadarFC::RFC_Object::RFC_Object_Obj5.OrientationYaw = -4.48;
        @CAN_RadarFC::RFC_Object::RFC_Object_Obj5.Width = 0;
        @CAN_RadarFC::RFC_Object::RFC_Object_Obj5.Length = 0;
        @CAN_RadarFC::RFC_Object::RFC_Object_Obj5.RCS = -102.4;
        @CAN_RadarFC::RFC_Object::RFC_Object_Obj5.Px = -512;
        @CAN_RadarFC::RFC_Object::RFC_Object_Obj5.Py = -128;
        @CAN_RadarFC::RFC_Object::RFC_Object_Obj5.Vx = -128;
        @CAN_RadarFC::RFC_Object::RFC_Object_Obj5.Vy = -64;
        @CAN_RadarFC::RFC_Object::RFC_Object_Obj5.Ax = -16;
        @CAN_RadarFC::RFC_Object::RFC_Object_Obj5.Ay = -16;
        @CAN_RadarFC::RFC_Object::RFC_Object_Obj5.MovingStatus = 0;
        @CAN_RadarFC::RFC_Object::RFC_Object_Obj5.Age = 0;
        @CAN_RadarFC::RFC_Object::RFC_Object_Obj5.ProbClassType = 0;
        @CAN_RadarFC::RFC_Object::RFC_Object_Obj5.ReferencePoint = 0;
        @CAN_RadarFC::RFC_Object::RFC_Object_Obj5.FilterInformation = 0;
      break;
      
    case 5:
        @CAN_RadarFC::RFC_Object::RFC_Object_Obj6.ObjId = 0;
        @CAN_RadarFC::RFC_Object::RFC_Object_Obj6.WidthVnce = 0;
        @CAN_RadarFC::RFC_Object::RFC_Object_Obj6.VxVnce = 0;
        @CAN_RadarFC::RFC_Object::RFC_Object_Obj6.AyVnce = 0;
        @CAN_RadarFC::RFC_Object::RFC_Object_Obj6.OrientationYawVnce = 0;
        @CAN_RadarFC::RFC_Object::RFC_Object_Obj6.LengthVnce = 0;
        @CAN_RadarFC::RFC_Object::RFC_Object_Obj6.AxVnce = 0;
        @CAN_RadarFC::RFC_Object::RFC_Object_Obj6.PyVnce = 0;
        @CAN_RadarFC::RFC_Object::RFC_Object_Obj6.PxVnce = 0;
        @CAN_RadarFC::RFC_Object::RFC_Object_Obj6.PxPyCoVnce = 0;
        @CAN_RadarFC::RFC_Object::RFC_Object_Obj6.PyAxCoVnce = 0;
        @CAN_RadarFC::RFC_Object::RFC_Object_Obj6.AxAyCoVnce = 0;
        @CAN_RadarFC::RFC_Object::RFC_Object_Obj6.VyAyCoVnce = 0;
        @CAN_RadarFC::RFC_Object::RFC_Object_Obj6.VyAxCoVnce = 0;
        @CAN_RadarFC::RFC_Object::RFC_Object_Obj6.VxAyCoVnce = 0;
        @CAN_RadarFC::RFC_Object::RFC_Object_Obj6.VxAxCoVnce = 0;
        @CAN_RadarFC::RFC_Object::RFC_Object_Obj6.VxVyCoVnce = 0;
        @CAN_RadarFC::RFC_Object::RFC_Object_Obj6.VyVnce = 0;
        @CAN_RadarFC::RFC_Object::RFC_Object_Obj6.PyAyCoVnce = 0;
        @CAN_RadarFC::RFC_Object::RFC_Object_Obj6.PxAyCoVnce = 0;
        @CAN_RadarFC::RFC_Object::RFC_Object_Obj6.PxAxCoVnce = 0;
        @CAN_RadarFC::RFC_Object::RFC_Object_Obj6.PyVyCoVnce = 0;
        @CAN_RadarFC::RFC_Object::RFC_Object_Obj6.PxVyCoVnce = 0;
        @CAN_RadarFC::RFC_Object::RFC_Object_Obj6.PxVxCoVnce = 0;
        @CAN_RadarFC::RFC_Object::RFC_Object_Obj6.PyVxCoVnce = 0;
        @CAN_RadarFC::RFC_Object::RFC_Object_Obj6.ExistProb = 0;
        @CAN_RadarFC::RFC_Object::RFC_Object_Obj6.ProbClassConfidence = 0;
        @CAN_RadarFC::RFC_Object::RFC_Object_Obj6.MeasurementStatus = 0;
        @CAN_RadarFC::RFC_Object::RFC_Object_Obj6.OrientationYaw = -4.48;
        @CAN_RadarFC::RFC_Object::RFC_Object_Obj6.Width = 0;
        @CAN_RadarFC::RFC_Object::RFC_Object_Obj6.Length = 0;
        @CAN_RadarFC::RFC_Object::RFC_Object_Obj6.RCS = -102.4;
        @CAN_RadarFC::RFC_Object::RFC_Object_Obj6.Px = -512;
        @CAN_RadarFC::RFC_Object::RFC_Object_Obj6.Py = -128;
        @CAN_RadarFC::RFC_Object::RFC_Object_Obj6.Vx = -128;
        @CAN_RadarFC::RFC_Object::RFC_Object_Obj6.Vy = -64;
        @CAN_RadarFC::RFC_Object::RFC_Object_Obj6.Ax = -16;
        @CAN_RadarFC::RFC_Object::RFC_Object_Obj6.Ay = -16;
        @CAN_RadarFC::RFC_Object::RFC_Object_Obj6.MovingStatus = 0;
        @CAN_RadarFC::RFC_Object::RFC_Object_Obj6.Age = 0;
        @CAN_RadarFC::RFC_Object::RFC_Object_Obj6.ProbClassType = 0;
        @CAN_RadarFC::RFC_Object::RFC_Object_Obj6.ReferencePoint = 0;
        @CAN_RadarFC::RFC_Object::RFC_Object_Obj6.FilterInformation = 0;
      break;
      
    case 6:
        @CAN_RadarFC::RFC_Object::RFC_Object_Obj7.ObjId = 0;
        @CAN_RadarFC::RFC_Object::RFC_Object_Obj7.WidthVnce = 0;
        @CAN_RadarFC::RFC_Object::RFC_Object_Obj7.VxVnce = 0;
        @CAN_RadarFC::RFC_Object::RFC_Object_Obj7.AyVnce = 0;
        @CAN_RadarFC::RFC_Object::RFC_Object_Obj7.OrientationYawVnce = 0;
        @CAN_RadarFC::RFC_Object::RFC_Object_Obj7.LengthVnce = 0;
        @CAN_RadarFC::RFC_Object::RFC_Object_Obj7.AxVnce = 0;
        @CAN_RadarFC::RFC_Object::RFC_Object_Obj7.PyVnce = 0;
        @CAN_RadarFC::RFC_Object::RFC_Object_Obj7.PxVnce = 0;
        @CAN_RadarFC::RFC_Object::RFC_Object_Obj7.PxPyCoVnce = 0;
        @CAN_RadarFC::RFC_Object::RFC_Object_Obj7.PyAxCoVnce = 0;
        @CAN_RadarFC::RFC_Object::RFC_Object_Obj7.AxAyCoVnce = 0;
        @CAN_RadarFC::RFC_Object::RFC_Object_Obj7.VyAyCoVnce = 0;
        @CAN_RadarFC::RFC_Object::RFC_Object_Obj7.VyAxCoVnce = 0;
        @CAN_RadarFC::RFC_Object::RFC_Object_Obj7.VxAyCoVnce = 0;
        @CAN_RadarFC::RFC_Object::RFC_Object_Obj7.VxAxCoVnce = 0;
        @CAN_RadarFC::RFC_Object::RFC_Object_Obj7.VxVyCoVnce = 0;
        @CAN_RadarFC::RFC_Object::RFC_Object_Obj7.VyVnce = 0;
        @CAN_RadarFC::RFC_Object::RFC_Object_Obj7.PyAyCoVnce = 0;
        @CAN_RadarFC::RFC_Object::RFC_Object_Obj7.PxAyCoVnce = 0;
        @CAN_RadarFC::RFC_Object::RFC_Object_Obj7.PxAxCoVnce = 0;
        @CAN_RadarFC::RFC_Object::RFC_Object_Obj7.PyVyCoVnce = 0;
        @CAN_RadarFC::RFC_Object::RFC_Object_Obj7.PxVyCoVnce = 0;
        @CAN_RadarFC::RFC_Object::RFC_Object_Obj7.PxVxCoVnce = 0;
        @CAN_RadarFC::RFC_Object::RFC_Object_Obj7.PyVxCoVnce = 0;
        @CAN_RadarFC::RFC_Object::RFC_Object_Obj7.ExistProb = 0;
        @CAN_RadarFC::RFC_Object::RFC_Object_Obj7.ProbClassConfidence = 0;
        @CAN_RadarFC::RFC_Object::RFC_Object_Obj7.MeasurementStatus = 0;
        @CAN_RadarFC::RFC_Object::RFC_Object_Obj7.OrientationYaw = -4.48;
        @CAN_RadarFC::RFC_Object::RFC_Object_Obj7.Width = 0;
        @CAN_RadarFC::RFC_Object::RFC_Object_Obj7.Length = 0;
        @CAN_RadarFC::RFC_Object::RFC_Object_Obj7.RCS = -102.4;
        @CAN_RadarFC::RFC_Object::RFC_Object_Obj7.Px = -512;
        @CAN_RadarFC::RFC_Object::RFC_Object_Obj7.Py = -128;
        @CAN_RadarFC::RFC_Object::RFC_Object_Obj7.Vx = -128;
        @CAN_RadarFC::RFC_Object::RFC_Object_Obj7.Vy = -64;
        @CAN_RadarFC::RFC_Object::RFC_Object_Obj7.Ax = -16;
        @CAN_RadarFC::RFC_Object::RFC_Object_Obj7.Ay = -16;
        @CAN_RadarFC::RFC_Object::RFC_Object_Obj7.MovingStatus = 0;
        @CAN_RadarFC::RFC_Object::RFC_Object_Obj7.Age = 0;
        @CAN_RadarFC::RFC_Object::RFC_Object_Obj7.ProbClassType = 0;
        @CAN_RadarFC::RFC_Object::RFC_Object_Obj7.ReferencePoint = 0;
        @CAN_RadarFC::RFC_Object::RFC_Object_Obj7.FilterInformation = 0;
      break;
      
    case 7:
        @CAN_RadarFC::RFC_Object::RFC_Object_Obj8.ObjId = 0;
        @CAN_RadarFC::RFC_Object::RFC_Object_Obj8.WidthVnce = 0;
        @CAN_RadarFC::RFC_Object::RFC_Object_Obj8.VxVnce = 0;
        @CAN_RadarFC::RFC_Object::RFC_Object_Obj8.AyVnce = 0;
        @CAN_RadarFC::RFC_Object::RFC_Object_Obj8.OrientationYawVnce = 0;
        @CAN_RadarFC::RFC_Object::RFC_Object_Obj8.LengthVnce = 0;
        @CAN_RadarFC::RFC_Object::RFC_Object_Obj8.AxVnce = 0;
        @CAN_RadarFC::RFC_Object::RFC_Object_Obj8.PyVnce = 0;
        @CAN_RadarFC::RFC_Object::RFC_Object_Obj8.PxVnce = 0;
        @CAN_RadarFC::RFC_Object::RFC_Object_Obj8.PxPyCoVnce = 0;
        @CAN_RadarFC::RFC_Object::RFC_Object_Obj8.PyAxCoVnce = 0;
        @CAN_RadarFC::RFC_Object::RFC_Object_Obj8.AxAyCoVnce = 0;
        @CAN_RadarFC::RFC_Object::RFC_Object_Obj8.VyAyCoVnce = 0;
        @CAN_RadarFC::RFC_Object::RFC_Object_Obj8.VyAxCoVnce = 0;
        @CAN_RadarFC::RFC_Object::RFC_Object_Obj8.VxAyCoVnce = 0;
        @CAN_RadarFC::RFC_Object::RFC_Object_Obj8.VxAxCoVnce = 0;
        @CAN_RadarFC::RFC_Object::RFC_Object_Obj8.VxVyCoVnce = 0;
        @CAN_RadarFC::RFC_Object::RFC_Object_Obj8.VyVnce = 0;
        @CAN_RadarFC::RFC_Object::RFC_Object_Obj8.PyAyCoVnce = 0;
        @CAN_RadarFC::RFC_Object::RFC_Object_Obj8.PxAyCoVnce = 0;
        @CAN_RadarFC::RFC_Object::RFC_Object_Obj8.PxAxCoVnce = 0;
        @CAN_RadarFC::RFC_Object::RFC_Object_Obj8.PyVyCoVnce = 0;
        @CAN_RadarFC::RFC_Object::RFC_Object_Obj8.PxVyCoVnce = 0;
        @CAN_RadarFC::RFC_Object::RFC_Object_Obj8.PxVxCoVnce = 0;
        @CAN_RadarFC::RFC_Object::RFC_Object_Obj8.PyVxCoVnce = 0;
        @CAN_RadarFC::RFC_Object::RFC_Object_Obj8.ExistProb = 0;
        @CAN_RadarFC::RFC_Object::RFC_Object_Obj8.ProbClassConfidence = 0;
        @CAN_RadarFC::RFC_Object::RFC_Object_Obj8.MeasurementStatus = 0;
        @CAN_RadarFC::RFC_Object::RFC_Object_Obj8.OrientationYaw = -4.48;
        @CAN_RadarFC::RFC_Object::RFC_Object_Obj8.Width = 0;
        @CAN_RadarFC::RFC_Object::RFC_Object_Obj8.Length = 0;
        @CAN_RadarFC::RFC_Object::RFC_Object_Obj8.RCS = -102.4;
        @CAN_RadarFC::RFC_Object::RFC_Object_Obj8.Px = -512;
        @CAN_RadarFC::RFC_Object::RFC_Object_Obj8.Py = -128;
        @CAN_RadarFC::RFC_Object::RFC_Object_Obj8.Vx = -128;
        @CAN_RadarFC::RFC_Object::RFC_Object_Obj8.Vy = -64;
        @CAN_RadarFC::RFC_Object::RFC_Object_Obj8.Ax = -16;
        @CAN_RadarFC::RFC_Object::RFC_Object_Obj8.Ay = -16;
        @CAN_RadarFC::RFC_Object::RFC_Object_Obj8.MovingStatus = 0;
        @CAN_RadarFC::RFC_Object::RFC_Object_Obj8.Age = 0;
        @CAN_RadarFC::RFC_Object::RFC_Object_Obj8.ProbClassType = 0;
        @CAN_RadarFC::RFC_Object::RFC_Object_Obj8.ReferencePoint = 0;
        @CAN_RadarFC::RFC_Object::RFC_Object_Obj8.FilterInformation = 0;
      break;
      
    case 8:
        @CAN_RadarFC::RFC_Object::RFC_Object_Obj9.ObjId = 0;
        @CAN_RadarFC::RFC_Object::RFC_Object_Obj9.WidthVnce = 0;
        @CAN_RadarFC::RFC_Object::RFC_Object_Obj9.VxVnce = 0;
        @CAN_RadarFC::RFC_Object::RFC_Object_Obj9.AyVnce = 0;
        @CAN_RadarFC::RFC_Object::RFC_Object_Obj9.OrientationYawVnce = 0;
        @CAN_RadarFC::RFC_Object::RFC_Object_Obj9.LengthVnce = 0;
        @CAN_RadarFC::RFC_Object::RFC_Object_Obj9.AxVnce = 0;
        @CAN_RadarFC::RFC_Object::RFC_Object_Obj9.PyVnce = 0;
        @CAN_RadarFC::RFC_Object::RFC_Object_Obj9.PxVnce = 0;
        @CAN_RadarFC::RFC_Object::RFC_Object_Obj9.PxPyCoVnce = 0;
        @CAN_RadarFC::RFC_Object::RFC_Object_Obj9.PyAxCoVnce = 0;
        @CAN_RadarFC::RFC_Object::RFC_Object_Obj9.AxAyCoVnce = 0;
        @CAN_RadarFC::RFC_Object::RFC_Object_Obj9.VyAyCoVnce = 0;
        @CAN_RadarFC::RFC_Object::RFC_Object_Obj9.VyAxCoVnce = 0;
        @CAN_RadarFC::RFC_Object::RFC_Object_Obj9.VxAyCoVnce = 0;
        @CAN_RadarFC::RFC_Object::RFC_Object_Obj9.VxAxCoVnce = 0;
        @CAN_RadarFC::RFC_Object::RFC_Object_Obj9.VxVyCoVnce = 0;
        @CAN_RadarFC::RFC_Object::RFC_Object_Obj9.VyVnce = 0;
        @CAN_RadarFC::RFC_Object::RFC_Object_Obj9.PyAyCoVnce = 0;
        @CAN_RadarFC::RFC_Object::RFC_Object_Obj9.PxAyCoVnce = 0;
        @CAN_RadarFC::RFC_Object::RFC_Object_Obj9.PxAxCoVnce = 0;
        @CAN_RadarFC::RFC_Object::RFC_Object_Obj9.PyVyCoVnce = 0;
        @CAN_RadarFC::RFC_Object::RFC_Object_Obj9.PxVyCoVnce = 0;
        @CAN_RadarFC::RFC_Object::RFC_Object_Obj9.PxVxCoVnce = 0;
        @CAN_RadarFC::RFC_Object::RFC_Object_Obj9.PyVxCoVnce = 0;
        @CAN_RadarFC::RFC_Object::RFC_Object_Obj9.ExistProb = 0;
        @CAN_RadarFC::RFC_Object::RFC_Object_Obj9.ProbClassConfidence = 0;
        @CAN_RadarFC::RFC_Object::RFC_Object_Obj9.MeasurementStatus = 0;
        @CAN_RadarFC::RFC_Object::RFC_Object_Obj9.OrientationYaw = -4.48;
        @CAN_RadarFC::RFC_Object::RFC_Object_Obj9.Width = 0;
        @CAN_RadarFC::RFC_Object::RFC_Object_Obj9.Length = 0;
        @CAN_RadarFC::RFC_Object::RFC_Object_Obj9.RCS = -102.4;
        @CAN_RadarFC::RFC_Object::RFC_Object_Obj9.Px = -512;
        @CAN_RadarFC::RFC_Object::RFC_Object_Obj9.Py = -128;
        @CAN_RadarFC::RFC_Object::RFC_Object_Obj9.Vx = -128;
        @CAN_RadarFC::RFC_Object::RFC_Object_Obj9.Vy = -64;
        @CAN_RadarFC::RFC_Object::RFC_Object_Obj9.Ax = -16;
        @CAN_RadarFC::RFC_Object::RFC_Object_Obj9.Ay = -16;
        @CAN_RadarFC::RFC_Object::RFC_Object_Obj9.MovingStatus = 0;
        @CAN_RadarFC::RFC_Object::RFC_Object_Obj9.Age = 0;
        @CAN_RadarFC::RFC_Object::RFC_Object_Obj9.ProbClassType = 0;
        @CAN_RadarFC::RFC_Object::RFC_Object_Obj9.ReferencePoint = 0;
        @CAN_RadarFC::RFC_Object::RFC_Object_Obj9.FilterInformation = 0;
      break;
      
  }
}

/** @brief Sets the signals to raw value 0 of the location which deletes it on the bus.
  * @param object_id ID of the location that shall be deleted.
  * @return void
  */
//void delete_radar_fc_bus_loc(byte object_id)
//{
//  target_counter_radar_fc = 0;
//  injection_counter_radar_fc = -1;
  
//  //all locations are filled into the array without holes and so being deleted in this order
//  injection_counter_radar_fc = object_id;
  
//  switch (injection_counter_radar_fc)
//  {
//    case 0:
//      $RFC_Location_000_002::RFC_Loc000_RadialDistanceVnce = 0;
//      $RFC_Location_000_002::RFC_Loc000_DistVelocityCoVnce = -0.1024;
//      $RFC_Location_000_002::RFC_Loc000_DistVelocityQuality = 0;
//      $RFC_Location_000_002::RFC_Loc000_ElevationQuality = 0;
//      $RFC_Location_000_002::RFC_Loc000_ElevationVnce = 0;
//      $RFC_Location_000_002::RFC_Loc000_AzimuthQuality = 0;
//      $RFC_Location_000_002::RFC_Loc000_AzimuthVnce = 0;
//      $RFC_Location_000_002::RFC_Loc000_RadialVelocityVnce = 0;
//      $RFC_Location_000_002::RFC_Loc000_RadarCrossSection = -102.4;
//      $RFC_Location_000_002::RFC_Loc000_RSSI = 0;
//      $RFC_Location_000_002::RFC_Loc000_AzimuthalPartnerId = 0;
//      $RFC_Location_000_002::RFC_Loc000_RadialDistance = 0;
//      $RFC_Location_000_002::RFC_Loc000_RadialVelocity = -163.84;
//      $RFC_Location_000_002::RFC_Loc000_Elevation = -51.2;
//      $RFC_Location_000_002::RFC_Loc000_Azimuth = -102.4;
//      break;
      
//    case 1:
//      $RFC_Location_000_002::RFC_Loc001_RadialDistanceVnce = 0;
//      $RFC_Location_000_002::RFC_Loc001_DistVelocityCoVnce = -0.1024;
//      $RFC_Location_000_002::RFC_Loc001_DistVelocityQuality = 0;
//      $RFC_Location_000_002::RFC_Loc001_ElevationQuality = 0;
//      $RFC_Location_000_002::RFC_Loc001_ElevationVnce = 0;
//      $RFC_Location_000_002::RFC_Loc001_AzimuthQuality = 0;
//      $RFC_Location_000_002::RFC_Loc001_AzimuthVnce = 0;
//      $RFC_Location_000_002::RFC_Loc001_RadialVelocityVnce = 0;
//      $RFC_Location_000_002::RFC_Loc001_RadarCrossSection = -102.4;
//      $RFC_Location_000_002::RFC_Loc001_RSSI = 0;
//      $RFC_Location_000_002::RFC_Loc001_AzimuthalPartnerId = 0;
//      $RFC_Location_000_002::RFC_Loc001_RadialDistance = 0;
//      $RFC_Location_000_002::RFC_Loc001_RadialVelocity = -163.84;
//      $RFC_Location_000_002::RFC_Loc001_Elevation = -51.2;
//      $RFC_Location_000_002::RFC_Loc001_Azimuth = -102.4;
//      break;
      
//    case 2:
//      $RFC_Location_000_002::RFC_Loc002_RadialDistanceVnce = 0;
//      $RFC_Location_000_002::RFC_Loc002_DistVelocityCoVnce = -0.1024;
//      $RFC_Location_000_002::RFC_Loc002_DistVelocityQuality = 0;
//      $RFC_Location_000_002::RFC_Loc002_ElevationQuality = 0;
//      $RFC_Location_000_002::RFC_Loc002_ElevationVnce = 0;
//      $RFC_Location_000_002::RFC_Loc002_AzimuthQuality = 0;
//      $RFC_Location_000_002::RFC_Loc002_AzimuthVnce = 0;
//      $RFC_Location_000_002::RFC_Loc002_RadialVelocityVnce = 0;
//      $RFC_Location_000_002::RFC_Loc002_RadarCrossSection = -102.4;
//      $RFC_Location_000_002::RFC_Loc002_RSSI = 0;
//      $RFC_Location_000_002::RFC_Loc002_AzimuthalPartnerId = 0;
//      $RFC_Location_000_002::RFC_Loc002_RadialDistance = 0;
//      $RFC_Location_000_002::RFC_Loc002_RadialVelocity = -163.84;
//      $RFC_Location_000_002::RFC_Loc002_Elevation = -51.2;
//      $RFC_Location_000_002::RFC_Loc002_Azimuth = -102.4;
//      break;
      
//    case 3:
//      $RFC_Location_003_005::RFC_Loc003_RadialDistanceVnce = 0;
//      $RFC_Location_003_005::RFC_Loc003_DistVelocityCoVnce = -0.1024;
//      $RFC_Location_003_005::RFC_Loc003_DistVelocityQuality = 0;
//      $RFC_Location_003_005::RFC_Loc003_ElevationQuality = 0;
//      $RFC_Location_003_005::RFC_Loc003_ElevationVnce = 0;
//      $RFC_Location_003_005::RFC_Loc003_AzimuthQuality = 0;
//      $RFC_Location_003_005::RFC_Loc003_AzimuthVnce = 0;
//      $RFC_Location_003_005::RFC_Loc003_RadialVelocityVnce = 0;
//      $RFC_Location_003_005::RFC_Loc003_RadarCrossSection = -102.4;
//      $RFC_Location_003_005::RFC_Loc003_RSSI = 0;
//      $RFC_Location_003_005::RFC_Loc003_AzimuthalPartnerId = 0;
//      $RFC_Location_003_005::RFC_Loc003_RadialDistance = 0;
//      $RFC_Location_003_005::RFC_Loc003_RadialVelocity = -163.84;
//      $RFC_Location_003_005::RFC_Loc003_Elevation = -51.2;
//      $RFC_Location_003_005::RFC_Loc003_Azimuth = -102.4;
//      break;
      
//    case 4:
//      $RFC_Location_003_005::RFC_Loc004_RadialDistanceVnce = 0;
//      $RFC_Location_003_005::RFC_Loc004_DistVelocityCoVnce = -0.1024;
//      $RFC_Location_003_005::RFC_Loc004_DistVelocityQuality = 0;
//      $RFC_Location_003_005::RFC_Loc004_ElevationQuality = 0;
//      $RFC_Location_003_005::RFC_Loc004_ElevationVnce = 0;
//      $RFC_Location_003_005::RFC_Loc004_AzimuthQuality = 0;
//      $RFC_Location_003_005::RFC_Loc004_AzimuthVnce = 0;
//      $RFC_Location_003_005::RFC_Loc004_RadialVelocityVnce = 0;
//      $RFC_Location_003_005::RFC_Loc004_RadarCrossSection = -102.4;
//      $RFC_Location_003_005::RFC_Loc004_RSSI = 0;
//      $RFC_Location_003_005::RFC_Loc004_AzimuthalPartnerId = 0;
//      $RFC_Location_003_005::RFC_Loc004_RadialDistance = 0;
//      $RFC_Location_003_005::RFC_Loc004_RadialVelocity = -163.84;
//      $RFC_Location_003_005::RFC_Loc004_Elevation = -51.2;
//      $RFC_Location_003_005::RFC_Loc004_Azimuth = -102.4;
//      break;
      
//    case 5:
//      $RFC_Location_003_005::RFC_Loc005_RadialDistanceVnce = 0;
//      $RFC_Location_003_005::RFC_Loc005_DistVelocityCoVnce = -0.1024;
//      $RFC_Location_003_005::RFC_Loc005_DistVelocityQuality = 0;
//      $RFC_Location_003_005::RFC_Loc005_ElevationQuality = 0;
//      $RFC_Location_003_005::RFC_Loc005_ElevationVnce = 0;
//      $RFC_Location_003_005::RFC_Loc005_AzimuthQuality = 0;
//      $RFC_Location_003_005::RFC_Loc005_AzimuthVnce = 0;
//      $RFC_Location_003_005::RFC_Loc005_RadialVelocityVnce = 0;
//      $RFC_Location_003_005::RFC_Loc005_RadarCrossSection = -102.4;
//      $RFC_Location_003_005::RFC_Loc005_RSSI = 0;
//      $RFC_Location_003_005::RFC_Loc005_AzimuthalPartnerId = 0;
//      $RFC_Location_003_005::RFC_Loc005_RadialDistance = 0;
//      $RFC_Location_003_005::RFC_Loc005_RadialVelocity = -163.84;
//      $RFC_Location_003_005::RFC_Loc005_Elevation = -51.2;
//      $RFC_Location_003_005::RFC_Loc005_Azimuth = -102.4;
//      break;
      
//    case 6:
//      $RFC_Location_006_008::RFC_Loc006_RadialDistanceVnce = 0;
//      $RFC_Location_006_008::RFC_Loc006_DistVelocityCoVnce = -0.1024;
//      $RFC_Location_006_008::RFC_Loc006_DistVelocityQuality = 0;
//      $RFC_Location_006_008::RFC_Loc006_ElevationQuality = 0;
//      $RFC_Location_006_008::RFC_Loc006_ElevationVnce = 0;
//      $RFC_Location_006_008::RFC_Loc006_AzimuthQuality = 0;
//      $RFC_Location_006_008::RFC_Loc006_AzimuthVnce = 0;
//      $RFC_Location_006_008::RFC_Loc006_RadialVelocityVnce = 0;
//      $RFC_Location_006_008::RFC_Loc006_RadarCrossSection = -102.4;
//      $RFC_Location_006_008::RFC_Loc006_RSSI = 0;
//      $RFC_Location_006_008::RFC_Loc006_AzimuthalPartnerId = 0;
//      $RFC_Location_006_008::RFC_Loc006_RadialDistance = 0;
//      $RFC_Location_006_008::RFC_Loc006_RadialVelocity = -163.84;
//      $RFC_Location_006_008::RFC_Loc006_Elevation = -51.2;
//      $RFC_Location_006_008::RFC_Loc006_Azimuth = -102.4;
//      break;
      
//    case 7:
//      $RFC_Location_006_008::RFC_Loc007_RadialDistanceVnce = 0;
//      $RFC_Location_006_008::RFC_Loc007_DistVelocityCoVnce = -0.1024;
//      $RFC_Location_006_008::RFC_Loc007_DistVelocityQuality = 0;
//      $RFC_Location_006_008::RFC_Loc007_ElevationQuality = 0;
//      $RFC_Location_006_008::RFC_Loc007_ElevationVnce = 0;
//      $RFC_Location_006_008::RFC_Loc007_AzimuthQuality = 0;
//      $RFC_Location_006_008::RFC_Loc007_AzimuthVnce = 0;
//      $RFC_Location_006_008::RFC_Loc007_RadialVelocityVnce = 0;
//      $RFC_Location_006_008::RFC_Loc007_RadarCrossSection = -102.4;
//      $RFC_Location_006_008::RFC_Loc007_RSSI = 0;
//      $RFC_Location_006_008::RFC_Loc007_AzimuthalPartnerId = 0;
//      $RFC_Location_006_008::RFC_Loc007_RadialDistance = 0;
//      $RFC_Location_006_008::RFC_Loc007_RadialVelocity = -163.84;
//      $RFC_Location_006_008::RFC_Loc007_Elevation = -51.2;
//      $RFC_Location_006_008::RFC_Loc007_Azimuth = -102.4;
//      break;
      
//    case 8:
//      $RFC_Location_006_008::RFC_Loc008_RadialDistanceVnce = 0;
//      $RFC_Location_006_008::RFC_Loc008_DistVelocityCoVnce = -0.1024;
//      $RFC_Location_006_008::RFC_Loc008_DistVelocityQuality = 0;
//      $RFC_Location_006_008::RFC_Loc008_ElevationQuality = 0;
//      $RFC_Location_006_008::RFC_Loc008_ElevationVnce = 0;
//      $RFC_Location_006_008::RFC_Loc008_AzimuthQuality = 0;
//      $RFC_Location_006_008::RFC_Loc008_AzimuthVnce = 0;
//      $RFC_Location_006_008::RFC_Loc008_RadialVelocityVnce = 0;
//      $RFC_Location_006_008::RFC_Loc008_RadarCrossSection = -102.4;
//      $RFC_Location_006_008::RFC_Loc008_RSSI = 0;
//      $RFC_Location_006_008::RFC_Loc008_AzimuthalPartnerId = 0;
//      $RFC_Location_006_008::RFC_Loc008_RadialDistance = 0;
//      $RFC_Location_006_008::RFC_Loc008_RadialVelocity = -163.84;
//      $RFC_Location_006_008::RFC_Loc008_Elevation = -51.2;
//      $RFC_Location_006_008::RFC_Loc008_Azimuth = -102.4;
//      break;
      
//    case 9:
//      $RFC_Location_009_011::RFC_Loc009_RadialDistanceVnce = 0;
//      $RFC_Location_009_011::RFC_Loc009_DistVelocityCoVnce = -0.1024;
//      $RFC_Location_009_011::RFC_Loc009_DistVelocityQuality = 0;
//      $RFC_Location_009_011::RFC_Loc009_ElevationQuality = 0;
//      $RFC_Location_009_011::RFC_Loc009_ElevationVnce = 0;
//      $RFC_Location_009_011::RFC_Loc009_AzimuthQuality = 0;
//      $RFC_Location_009_011::RFC_Loc009_AzimuthVnce = 0;
//      $RFC_Location_009_011::RFC_Loc009_RadialVelocityVnce = 0;
//      $RFC_Location_009_011::RFC_Loc009_RadarCrossSection = -102.4;
//      $RFC_Location_009_011::RFC_Loc009_RSSI = 0;
//      $RFC_Location_009_011::RFC_Loc009_AzimuthalPartnerId = 0;
//      $RFC_Location_009_011::RFC_Loc009_RadialDistance = 0;
//      $RFC_Location_009_011::RFC_Loc009_RadialVelocity = -163.84;
//      $RFC_Location_009_011::RFC_Loc009_Elevation = -51.2;
//      $RFC_Location_009_011::RFC_Loc009_Azimuth = -102.4;
//      break;
      
//    case 10:
//      $RFC_Location_009_011::RFC_Loc010_RadialDistanceVnce = 0;
//      $RFC_Location_009_011::RFC_Loc010_DistVelocityCoVnce = -0.1024;
//      $RFC_Location_009_011::RFC_Loc010_DistVelocityQuality = 0;
//      $RFC_Location_009_011::RFC_Loc010_ElevationQuality = 0;
//      $RFC_Location_009_011::RFC_Loc010_ElevationVnce = 0;
//      $RFC_Location_009_011::RFC_Loc010_AzimuthQuality = 0;
//      $RFC_Location_009_011::RFC_Loc010_AzimuthVnce = 0;
//      $RFC_Location_009_011::RFC_Loc010_RadialVelocityVnce = 0;
//      $RFC_Location_009_011::RFC_Loc010_RadarCrossSection = -102.4;
//      $RFC_Location_009_011::RFC_Loc010_RSSI = 0;
//      $RFC_Location_009_011::RFC_Loc010_AzimuthalPartnerId = 0;
//      $RFC_Location_009_011::RFC_Loc010_RadialDistance = 0;
//      $RFC_Location_009_011::RFC_Loc010_RadialVelocity = -163.84;
//      $RFC_Location_009_011::RFC_Loc010_Elevation = -51.2;
//      $RFC_Location_009_011::RFC_Loc010_Azimuth = -102.4;
//      break;
      
//    case 11:
//      $RFC_Location_009_011::RFC_Loc011_RadialDistanceVnce = 0;
//      $RFC_Location_009_011::RFC_Loc011_DistVelocityCoVnce = -0.1024;
//      $RFC_Location_009_011::RFC_Loc011_DistVelocityQuality = 0;
//      $RFC_Location_009_011::RFC_Loc011_ElevationQuality = 0;
//      $RFC_Location_009_011::RFC_Loc011_ElevationVnce = 0;
//      $RFC_Location_009_011::RFC_Loc011_AzimuthQuality = 0;
//      $RFC_Location_009_011::RFC_Loc011_AzimuthVnce = 0;
//      $RFC_Location_009_011::RFC_Loc011_RadialVelocityVnce = 0;
//      $RFC_Location_009_011::RFC_Loc011_RadarCrossSection = -102.4;
//      $RFC_Location_009_011::RFC_Loc011_RSSI = 0;
//      $RFC_Location_009_011::RFC_Loc011_AzimuthalPartnerId = 0;
//      $RFC_Location_009_011::RFC_Loc011_RadialDistance = 0;
//      $RFC_Location_009_011::RFC_Loc011_RadialVelocity = -163.84;
//      $RFC_Location_009_011::RFC_Loc011_Elevation = -51.2;
//      $RFC_Location_009_011::RFC_Loc011_Azimuth = -102.4;
//      break;
      
//    case 12:
//      $RFC_Location_012_014::RFC_Loc012_RadialDistanceVnce = 0;
//      $RFC_Location_012_014::RFC_Loc012_DistVelocityCoVnce = -0.1024;
//      $RFC_Location_012_014::RFC_Loc012_DistVelocityQuality = 0;
//      $RFC_Location_012_014::RFC_Loc012_ElevationQuality = 0;
//      $RFC_Location_012_014::RFC_Loc012_ElevationVnce = 0;
//      $RFC_Location_012_014::RFC_Loc012_AzimuthQuality = 0;
//      $RFC_Location_012_014::RFC_Loc012_AzimuthVnce = 0;
//      $RFC_Location_012_014::RFC_Loc012_RadialVelocityVnce = 0;
//      $RFC_Location_012_014::RFC_Loc012_RadarCrossSection = -102.4;
//      $RFC_Location_012_014::RFC_Loc012_RSSI = 0;
//      $RFC_Location_012_014::RFC_Loc012_AzimuthalPartnerId = 0;
//      $RFC_Location_012_014::RFC_Loc012_RadialDistance = 0;
//      $RFC_Location_012_014::RFC_Loc012_RadialVelocity = -163.84;
//      $RFC_Location_012_014::RFC_Loc012_Elevation = -51.2;
//      $RFC_Location_012_014::RFC_Loc012_Azimuth = -102.4;
//      break;
      
//    case 13:
//      $RFC_Location_012_014::RFC_Loc013_RadialDistanceVnce = 0;
//      $RFC_Location_012_014::RFC_Loc013_DistVelocityCoVnce = -0.1024;
//      $RFC_Location_012_014::RFC_Loc013_DistVelocityQuality = 0;
//      $RFC_Location_012_014::RFC_Loc013_ElevationQuality = 0;
//      $RFC_Location_012_014::RFC_Loc013_ElevationVnce = 0;
//      $RFC_Location_012_014::RFC_Loc013_AzimuthQuality = 0;
//      $RFC_Location_012_014::RFC_Loc013_AzimuthVnce = 0;
//      $RFC_Location_012_014::RFC_Loc013_RadialVelocityVnce = 0;
//      $RFC_Location_012_014::RFC_Loc013_RadarCrossSection = -102.4;
//      $RFC_Location_012_014::RFC_Loc013_RSSI = 0;
//      $RFC_Location_012_014::RFC_Loc013_AzimuthalPartnerId = 0;
//      $RFC_Location_012_014::RFC_Loc013_RadialDistance = 0;
//      $RFC_Location_012_014::RFC_Loc013_RadialVelocity = -163.84;
//      $RFC_Location_012_014::RFC_Loc013_Elevation = -51.2;
//      $RFC_Location_012_014::RFC_Loc013_Azimuth = -102.4;
//      break;
      
//    case 14:
//      $RFC_Location_012_014::RFC_Loc014_RadialDistanceVnce = 0;
//      $RFC_Location_012_014::RFC_Loc014_DistVelocityCoVnce = -0.1024;
//      $RFC_Location_012_014::RFC_Loc014_DistVelocityQuality = 0;
//      $RFC_Location_012_014::RFC_Loc014_ElevationQuality = 0;
//      $RFC_Location_012_014::RFC_Loc014_ElevationVnce = 0;
//      $RFC_Location_012_014::RFC_Loc014_AzimuthQuality = 0;
//      $RFC_Location_012_014::RFC_Loc014_AzimuthVnce = 0;
//      $RFC_Location_012_014::RFC_Loc014_RadialVelocityVnce = 0;
//      $RFC_Location_012_014::RFC_Loc014_RadarCrossSection = -102.4;
//      $RFC_Location_012_014::RFC_Loc014_RSSI = 0;
//      $RFC_Location_012_014::RFC_Loc014_AzimuthalPartnerId = 0;
//      $RFC_Location_012_014::RFC_Loc014_RadialDistance = 0;
//      $RFC_Location_012_014::RFC_Loc014_RadialVelocity = -163.84;
//      $RFC_Location_012_014::RFC_Loc014_Elevation = -51.2;
//      $RFC_Location_012_014::RFC_Loc014_Azimuth = -102.4;
//      break;
      
//    case 15:
//      $RFC_Location_015_017::RFC_Loc015_RadialDistanceVnce = 0;
//      $RFC_Location_015_017::RFC_Loc015_DistVelocityCoVnce = -0.1024;
//      $RFC_Location_015_017::RFC_Loc015_DistVelocityQuality = 0;
//      $RFC_Location_015_017::RFC_Loc015_ElevationQuality = 0;
//      $RFC_Location_015_017::RFC_Loc015_ElevationVnce = 0;
//      $RFC_Location_015_017::RFC_Loc015_AzimuthQuality = 0;
//      $RFC_Location_015_017::RFC_Loc015_AzimuthVnce = 0;
//      $RFC_Location_015_017::RFC_Loc015_RadialVelocityVnce = 0;
//      $RFC_Location_015_017::RFC_Loc015_RadarCrossSection = -102.4;
//      $RFC_Location_015_017::RFC_Loc015_RSSI = 0;
//      $RFC_Location_015_017::RFC_Loc015_AzimuthalPartnerId = 0;
//      $RFC_Location_015_017::RFC_Loc015_RadialDistance = 0;
//      $RFC_Location_015_017::RFC_Loc015_RadialVelocity = -163.84;
//      $RFC_Location_015_017::RFC_Loc015_Elevation = -51.2;
//      $RFC_Location_015_017::RFC_Loc015_Azimuth = -102.4;
//      break;
      
//    case 16:
//      $RFC_Location_015_017::RFC_Loc016_RadialDistanceVnce = 0;
//      $RFC_Location_015_017::RFC_Loc016_DistVelocityCoVnce = -0.1024;
//      $RFC_Location_015_017::RFC_Loc016_DistVelocityQuality = 0;
//      $RFC_Location_015_017::RFC_Loc016_ElevationQuality = 0;
//      $RFC_Location_015_017::RFC_Loc016_ElevationVnce = 0;
//      $RFC_Location_015_017::RFC_Loc016_AzimuthQuality = 0;
//      $RFC_Location_015_017::RFC_Loc016_AzimuthVnce = 0;
//      $RFC_Location_015_017::RFC_Loc016_RadialVelocityVnce = 0;
//      $RFC_Location_015_017::RFC_Loc016_RadarCrossSection = -102.4;
//      $RFC_Location_015_017::RFC_Loc016_RSSI = 0;
//      $RFC_Location_015_017::RFC_Loc016_AzimuthalPartnerId = 0;
//      $RFC_Location_015_017::RFC_Loc016_RadialDistance = 0;
//      $RFC_Location_015_017::RFC_Loc016_RadialVelocity = -163.84;
//      $RFC_Location_015_017::RFC_Loc016_Elevation = -51.2;
//      $RFC_Location_015_017::RFC_Loc016_Azimuth = -102.4;
//      break;
      
//    case 17:
//      $RFC_Location_015_017::RFC_Loc017_RadialDistanceVnce = 0;
//      $RFC_Location_015_017::RFC_Loc017_DistVelocityCoVnce = -0.1024;
//      $RFC_Location_015_017::RFC_Loc017_DistVelocityQuality = 0;
//      $RFC_Location_015_017::RFC_Loc017_ElevationQuality = 0;
//      $RFC_Location_015_017::RFC_Loc017_ElevationVnce = 0;
//      $RFC_Location_015_017::RFC_Loc017_AzimuthQuality = 0;
//      $RFC_Location_015_017::RFC_Loc017_AzimuthVnce = 0;
//      $RFC_Location_015_017::RFC_Loc017_RadialVelocityVnce = 0;
//      $RFC_Location_015_017::RFC_Loc017_RadarCrossSection = -102.4;
//      $RFC_Location_015_017::RFC_Loc017_RSSI = 0;
//      $RFC_Location_015_017::RFC_Loc017_AzimuthalPartnerId = 0;
//      $RFC_Location_015_017::RFC_Loc017_RadialDistance = 0;
//      $RFC_Location_015_017::RFC_Loc017_RadialVelocity = -163.84;
//      $RFC_Location_015_017::RFC_Loc017_Elevation = -51.2;
//      $RFC_Location_015_017::RFC_Loc017_Azimuth = -102.4;
//      break;
      
//    case 18:
//      $RFC_Location_018_020::RFC_Loc018_RadialDistanceVnce = 0;
//      $RFC_Location_018_020::RFC_Loc018_DistVelocityCoVnce = -0.1024;
//      $RFC_Location_018_020::RFC_Loc018_DistVelocityQuality = 0;
//      $RFC_Location_018_020::RFC_Loc018_ElevationQuality = 0;
//      $RFC_Location_018_020::RFC_Loc018_ElevationVnce = 0;
//      $RFC_Location_018_020::RFC_Loc018_AzimuthQuality = 0;
//      $RFC_Location_018_020::RFC_Loc018_AzimuthVnce = 0;
//      $RFC_Location_018_020::RFC_Loc018_RadialVelocityVnce = 0;
//      $RFC_Location_018_020::RFC_Loc018_RadarCrossSection = -102.4;
//      $RFC_Location_018_020::RFC_Loc018_RSSI = 0;
//      $RFC_Location_018_020::RFC_Loc018_AzimuthalPartnerId = 0;
//      $RFC_Location_018_020::RFC_Loc018_RadialDistance = 0;
//      $RFC_Location_018_020::RFC_Loc018_RadialVelocity = -163.84;
//      $RFC_Location_018_020::RFC_Loc018_Elevation = -51.2;
//      $RFC_Location_018_020::RFC_Loc018_Azimuth = -102.4;
//      break;
      
//    case 19:
//      $RFC_Location_018_020::RFC_Loc019_RadialDistanceVnce = 0;
//      $RFC_Location_018_020::RFC_Loc019_DistVelocityCoVnce = -0.1024;
//      $RFC_Location_018_020::RFC_Loc019_DistVelocityQuality = 0;
//      $RFC_Location_018_020::RFC_Loc019_ElevationQuality = 0;
//      $RFC_Location_018_020::RFC_Loc019_ElevationVnce = 0;
//      $RFC_Location_018_020::RFC_Loc019_AzimuthQuality = 0;
//      $RFC_Location_018_020::RFC_Loc019_AzimuthVnce = 0;
//      $RFC_Location_018_020::RFC_Loc019_RadialVelocityVnce = 0;
//      $RFC_Location_018_020::RFC_Loc019_RadarCrossSection = -102.4;
//      $RFC_Location_018_020::RFC_Loc019_RSSI = 0;
//      $RFC_Location_018_020::RFC_Loc019_AzimuthalPartnerId = 0;
//      $RFC_Location_018_020::RFC_Loc019_RadialDistance = 0;
//      $RFC_Location_018_020::RFC_Loc019_RadialVelocity = -163.84;
//      $RFC_Location_018_020::RFC_Loc019_Elevation = -51.2;
//      $RFC_Location_018_020::RFC_Loc019_Azimuth = -102.4;
//      break;
      
//    case 20:
//      $RFC_Location_018_020::RFC_Loc020_RadialDistanceVnce = 0;
//      $RFC_Location_018_020::RFC_Loc020_DistVelocityCoVnce = -0.1024;
//      $RFC_Location_018_020::RFC_Loc020_DistVelocityQuality = 0;
//      $RFC_Location_018_020::RFC_Loc020_ElevationQuality = 0;
//      $RFC_Location_018_020::RFC_Loc020_ElevationVnce = 0;
//      $RFC_Location_018_020::RFC_Loc020_AzimuthQuality = 0;
//      $RFC_Location_018_020::RFC_Loc020_AzimuthVnce = 0;
//      $RFC_Location_018_020::RFC_Loc020_RadialVelocityVnce = 0;
//      $RFC_Location_018_020::RFC_Loc020_RadarCrossSection = -102.4;
//      $RFC_Location_018_020::RFC_Loc020_RSSI = 0;
//      $RFC_Location_018_020::RFC_Loc020_AzimuthalPartnerId = 0;
//      $RFC_Location_018_020::RFC_Loc020_RadialDistance = 0;
//      $RFC_Location_018_020::RFC_Loc020_RadialVelocity = -163.84;
//      $RFC_Location_018_020::RFC_Loc020_Elevation = -51.2;
//      $RFC_Location_018_020::RFC_Loc020_Azimuth = -102.4;
//      break;
      
//    case 21:
//      $RFC_Location_021_023::RFC_Loc021_RadialDistanceVnce = 0;
//      $RFC_Location_021_023::RFC_Loc021_DistVelocityCoVnce = -0.1024;
//      $RFC_Location_021_023::RFC_Loc021_DistVelocityQuality = 0;
//      $RFC_Location_021_023::RFC_Loc021_ElevationQuality = 0;
//      $RFC_Location_021_023::RFC_Loc021_ElevationVnce = 0;
//      $RFC_Location_021_023::RFC_Loc021_AzimuthQuality = 0;
//      $RFC_Location_021_023::RFC_Loc021_AzimuthVnce = 0;
//      $RFC_Location_021_023::RFC_Loc021_RadialVelocityVnce = 0;
//      $RFC_Location_021_023::RFC_Loc021_RadarCrossSection = -102.4;
//      $RFC_Location_021_023::RFC_Loc021_RSSI = 0;
//      $RFC_Location_021_023::RFC_Loc021_AzimuthalPartnerId = 0;
//      $RFC_Location_021_023::RFC_Loc021_RadialDistance = 0;
//      $RFC_Location_021_023::RFC_Loc021_RadialVelocity = -163.84;
//      $RFC_Location_021_023::RFC_Loc021_Elevation = -51.2;
//      $RFC_Location_021_023::RFC_Loc021_Azimuth = -102.4;
//      break;
      
//    case 22:
//      $RFC_Location_021_023::RFC_Loc022_RadialDistanceVnce = 0;
//      $RFC_Location_021_023::RFC_Loc022_DistVelocityCoVnce = -0.1024;
//      $RFC_Location_021_023::RFC_Loc022_DistVelocityQuality = 0;
//      $RFC_Location_021_023::RFC_Loc022_ElevationQuality = 0;
//      $RFC_Location_021_023::RFC_Loc022_ElevationVnce = 0;
//      $RFC_Location_021_023::RFC_Loc022_AzimuthQuality = 0;
//      $RFC_Location_021_023::RFC_Loc022_AzimuthVnce = 0;
//      $RFC_Location_021_023::RFC_Loc022_RadialVelocityVnce = 0;
//      $RFC_Location_021_023::RFC_Loc022_RadarCrossSection = -102.4;
//      $RFC_Location_021_023::RFC_Loc022_RSSI = 0;
//      $RFC_Location_021_023::RFC_Loc022_AzimuthalPartnerId = 0;
//      $RFC_Location_021_023::RFC_Loc022_RadialDistance = 0;
//      $RFC_Location_021_023::RFC_Loc022_RadialVelocity = -163.84;
//      $RFC_Location_021_023::RFC_Loc022_Elevation = -51.2;
//      $RFC_Location_021_023::RFC_Loc022_Azimuth = -102.4;
//      break;
      
//    case 23:
//      $RFC_Location_021_023::RFC_Loc023_RadialDistanceVnce = 0;
//      $RFC_Location_021_023::RFC_Loc023_DistVelocityCoVnce = -0.1024;
//      $RFC_Location_021_023::RFC_Loc023_DistVelocityQuality = 0;
//      $RFC_Location_021_023::RFC_Loc023_ElevationQuality = 0;
//      $RFC_Location_021_023::RFC_Loc023_ElevationVnce = 0;
//      $RFC_Location_021_023::RFC_Loc023_AzimuthQuality = 0;
//      $RFC_Location_021_023::RFC_Loc023_AzimuthVnce = 0;
//      $RFC_Location_021_023::RFC_Loc023_RadialVelocityVnce = 0;
//      $RFC_Location_021_023::RFC_Loc023_RadarCrossSection = -102.4;
//      $RFC_Location_021_023::RFC_Loc023_RSSI = 0;
//      $RFC_Location_021_023::RFC_Loc023_AzimuthalPartnerId = 0;
//      $RFC_Location_021_023::RFC_Loc023_RadialDistance = 0;
//      $RFC_Location_021_023::RFC_Loc023_RadialVelocity = -163.84;
//      $RFC_Location_021_023::RFC_Loc023_Elevation = -51.2;
//      $RFC_Location_021_023::RFC_Loc023_Azimuth = -102.4;
//      break;
      
//    case 24:
//      $RFC_Location_024_026::RFC_Loc024_RadialDistanceVnce = 0;
//      $RFC_Location_024_026::RFC_Loc024_DistVelocityCoVnce = -0.1024;
//      $RFC_Location_024_026::RFC_Loc024_DistVelocityQuality = 0;
//      $RFC_Location_024_026::RFC_Loc024_ElevationQuality = 0;
//      $RFC_Location_024_026::RFC_Loc024_ElevationVnce = 0;
//      $RFC_Location_024_026::RFC_Loc024_AzimuthQuality = 0;
//      $RFC_Location_024_026::RFC_Loc024_AzimuthVnce = 0;
//      $RFC_Location_024_026::RFC_Loc024_RadialVelocityVnce = 0;
//      $RFC_Location_024_026::RFC_Loc024_RadarCrossSection = -102.4;
//      $RFC_Location_024_026::RFC_Loc024_RSSI = 0;
//      $RFC_Location_024_026::RFC_Loc024_AzimuthalPartnerId = 0;
//      $RFC_Location_024_026::RFC_Loc024_RadialDistance = 0;
//      $RFC_Location_024_026::RFC_Loc024_RadialVelocity = -163.84;
//      $RFC_Location_024_026::RFC_Loc024_Elevation = -51.2;
//      $RFC_Location_024_026::RFC_Loc024_Azimuth = -102.4;
//      break;
      
//    case 25:
//      $RFC_Location_024_026::RFC_Loc025_RadialDistanceVnce = 0;
//      $RFC_Location_024_026::RFC_Loc025_DistVelocityCoVnce = -0.1024;
//      $RFC_Location_024_026::RFC_Loc025_DistVelocityQuality = 0;
//      $RFC_Location_024_026::RFC_Loc025_ElevationQuality = 0;
//      $RFC_Location_024_026::RFC_Loc025_ElevationVnce = 0;
//      $RFC_Location_024_026::RFC_Loc025_AzimuthQuality = 0;
//      $RFC_Location_024_026::RFC_Loc025_AzimuthVnce = 0;
//      $RFC_Location_024_026::RFC_Loc025_RadialVelocityVnce = 0;
//      $RFC_Location_024_026::RFC_Loc025_RadarCrossSection = -102.4;
//      $RFC_Location_024_026::RFC_Loc025_RSSI = 0;
//      $RFC_Location_024_026::RFC_Loc025_AzimuthalPartnerId = 0;
//      $RFC_Location_024_026::RFC_Loc025_RadialDistance = 0;
//      $RFC_Location_024_026::RFC_Loc025_RadialVelocity = -163.84;
//      $RFC_Location_024_026::RFC_Loc025_Elevation = -51.2;
//      $RFC_Location_024_026::RFC_Loc025_Azimuth = -102.4;
//      break;
      
//    case 26:
//      $RFC_Location_024_026::RFC_Loc026_RadialDistanceVnce = 0;
//      $RFC_Location_024_026::RFC_Loc026_DistVelocityCoVnce = -0.1024;
//      $RFC_Location_024_026::RFC_Loc026_DistVelocityQuality = 0;
//      $RFC_Location_024_026::RFC_Loc026_ElevationQuality = 0;
//      $RFC_Location_024_026::RFC_Loc026_ElevationVnce = 0;
//      $RFC_Location_024_026::RFC_Loc026_AzimuthQuality = 0;
//      $RFC_Location_024_026::RFC_Loc026_AzimuthVnce = 0;
//      $RFC_Location_024_026::RFC_Loc026_RadialVelocityVnce = 0;
//      $RFC_Location_024_026::RFC_Loc026_RadarCrossSection = -102.4;
//      $RFC_Location_024_026::RFC_Loc026_RSSI = 0;
//      $RFC_Location_024_026::RFC_Loc026_AzimuthalPartnerId = 0;
//      $RFC_Location_024_026::RFC_Loc026_RadialDistance = 0;
//      $RFC_Location_024_026::RFC_Loc026_RadialVelocity = -163.84;
//      $RFC_Location_024_026::RFC_Loc026_Elevation = -51.2;
//      $RFC_Location_024_026::RFC_Loc026_Azimuth = -102.4;
//      break;
      
//    case 27:
//      $RFC_Location_027_029::RFC_Loc027_RadialDistanceVnce = 0;
//      $RFC_Location_027_029::RFC_Loc027_DistVelocityCoVnce = -0.1024;
//      $RFC_Location_027_029::RFC_Loc027_DistVelocityQuality = 0;
//      $RFC_Location_027_029::RFC_Loc027_ElevationQuality = 0;
//      $RFC_Location_027_029::RFC_Loc027_ElevationVnce = 0;
//      $RFC_Location_027_029::RFC_Loc027_AzimuthQuality = 0;
//      $RFC_Location_027_029::RFC_Loc027_AzimuthVnce = 0;
//      $RFC_Location_027_029::RFC_Loc027_RadialVelocityVnce = 0;
//      $RFC_Location_027_029::RFC_Loc027_RadarCrossSection = -102.4;
//      $RFC_Location_027_029::RFC_Loc027_RSSI = 0;
//      $RFC_Location_027_029::RFC_Loc027_AzimuthalPartnerId = 0;
//      $RFC_Location_027_029::RFC_Loc027_RadialDistance = 0;
//      $RFC_Location_027_029::RFC_Loc027_RadialVelocity = -163.84;
//      $RFC_Location_027_029::RFC_Loc027_Elevation = -51.2;
//      $RFC_Location_027_029::RFC_Loc027_Azimuth = -102.4;
//      break;
      
//    case 28:
//      $RFC_Location_027_029::RFC_Loc028_RadialDistanceVnce = 0;
//      $RFC_Location_027_029::RFC_Loc028_DistVelocityCoVnce = -0.1024;
//      $RFC_Location_027_029::RFC_Loc028_DistVelocityQuality = 0;
//      $RFC_Location_027_029::RFC_Loc028_ElevationQuality = 0;
//      $RFC_Location_027_029::RFC_Loc028_ElevationVnce = 0;
//      $RFC_Location_027_029::RFC_Loc028_AzimuthQuality = 0;
//      $RFC_Location_027_029::RFC_Loc028_AzimuthVnce = 0;
//      $RFC_Location_027_029::RFC_Loc028_RadialVelocityVnce = 0;
//      $RFC_Location_027_029::RFC_Loc028_RadarCrossSection = -102.4;
//      $RFC_Location_027_029::RFC_Loc028_RSSI = 0;
//      $RFC_Location_027_029::RFC_Loc028_AzimuthalPartnerId = 0;
//      $RFC_Location_027_029::RFC_Loc028_RadialDistance = 0;
//      $RFC_Location_027_029::RFC_Loc028_RadialVelocity = -163.84;
//      $RFC_Location_027_029::RFC_Loc028_Elevation = -51.2;
//      $RFC_Location_027_029::RFC_Loc028_Azimuth = -102.4;
//      break;
      
//    case 29:
//      $RFC_Location_027_029::RFC_Loc029_RadialDistanceVnce = 0;
//      $RFC_Location_027_029::RFC_Loc029_DistVelocityCoVnce = -0.1024;
//      $RFC_Location_027_029::RFC_Loc029_DistVelocityQuality = 0;
//      $RFC_Location_027_029::RFC_Loc029_ElevationQuality = 0;
//      $RFC_Location_027_029::RFC_Loc029_ElevationVnce = 0;
//      $RFC_Location_027_029::RFC_Loc029_AzimuthQuality = 0;
//      $RFC_Location_027_029::RFC_Loc029_AzimuthVnce = 0;
//      $RFC_Location_027_029::RFC_Loc029_RadialVelocityVnce = 0;
//      $RFC_Location_027_029::RFC_Loc029_RadarCrossSection = -102.4;
//      $RFC_Location_027_029::RFC_Loc029_RSSI = 0;
//      $RFC_Location_027_029::RFC_Loc029_AzimuthalPartnerId = 0;
//      $RFC_Location_027_029::RFC_Loc029_RadialDistance = 0;
//      $RFC_Location_027_029::RFC_Loc029_RadialVelocity = -163.84;
//      $RFC_Location_027_029::RFC_Loc029_Elevation = -51.2;
//      $RFC_Location_027_029::RFC_Loc029_Azimuth = -102.4;
//      break;
      
//    case 30:
//      $RFC_Location_030_032::RFC_Loc030_RadialDistanceVnce = 0;
//      $RFC_Location_030_032::RFC_Loc030_DistVelocityCoVnce = -0.1024;
//      $RFC_Location_030_032::RFC_Loc030_DistVelocityQuality = 0;
//      $RFC_Location_030_032::RFC_Loc030_ElevationQuality = 0;
//      $RFC_Location_030_032::RFC_Loc030_ElevationVnce = 0;
//      $RFC_Location_030_032::RFC_Loc030_AzimuthQuality = 0;
//      $RFC_Location_030_032::RFC_Loc030_AzimuthVnce = 0;
//      $RFC_Location_030_032::RFC_Loc030_RadialVelocityVnce = 0;
//      $RFC_Location_030_032::RFC_Loc030_RadarCrossSection = -102.4;
//      $RFC_Location_030_032::RFC_Loc030_RSSI = 0;
//      $RFC_Location_030_032::RFC_Loc030_AzimuthalPartnerId = 0;
//      $RFC_Location_030_032::RFC_Loc030_RadialDistance = 0;
//      $RFC_Location_030_032::RFC_Loc030_RadialVelocity = -163.84;
//      $RFC_Location_030_032::RFC_Loc030_Elevation = -51.2;
//      $RFC_Location_030_032::RFC_Loc030_Azimuth = -102.4;
//      break;
      
//    case 31:
//      $RFC_Location_030_032::RFC_Loc031_RadialDistanceVnce = 0;
//      $RFC_Location_030_032::RFC_Loc031_DistVelocityCoVnce = -0.1024;
//      $RFC_Location_030_032::RFC_Loc031_DistVelocityQuality = 0;
//      $RFC_Location_030_032::RFC_Loc031_ElevationQuality = 0;
//      $RFC_Location_030_032::RFC_Loc031_ElevationVnce = 0;
//      $RFC_Location_030_032::RFC_Loc031_AzimuthQuality = 0;
//      $RFC_Location_030_032::RFC_Loc031_AzimuthVnce = 0;
//      $RFC_Location_030_032::RFC_Loc031_RadialVelocityVnce = 0;
//      $RFC_Location_030_032::RFC_Loc031_RadarCrossSection = -102.4;
//      $RFC_Location_030_032::RFC_Loc031_RSSI = 0;
//      $RFC_Location_030_032::RFC_Loc031_AzimuthalPartnerId = 0;
//      $RFC_Location_030_032::RFC_Loc031_RadialDistance = 0;
//      $RFC_Location_030_032::RFC_Loc031_RadialVelocity = -163.84;
//      $RFC_Location_030_032::RFC_Loc031_Elevation = -51.2;
//      $RFC_Location_030_032::RFC_Loc031_Azimuth = -102.4;
//      break;
      
//    case 32:
//      $RFC_Location_030_032::RFC_Loc032_RadialDistanceVnce = 0;
//      $RFC_Location_030_032::RFC_Loc032_DistVelocityCoVnce = -0.1024;
//      $RFC_Location_030_032::RFC_Loc032_DistVelocityQuality = 0;
//      $RFC_Location_030_032::RFC_Loc032_ElevationQuality = 0;
//      $RFC_Location_030_032::RFC_Loc032_ElevationVnce = 0;
//      $RFC_Location_030_032::RFC_Loc032_AzimuthQuality = 0;
//      $RFC_Location_030_032::RFC_Loc032_AzimuthVnce = 0;
//      $RFC_Location_030_032::RFC_Loc032_RadialVelocityVnce = 0;
//      $RFC_Location_030_032::RFC_Loc032_RadarCrossSection = -102.4;
//      $RFC_Location_030_032::RFC_Loc032_RSSI = 0;
//      $RFC_Location_030_032::RFC_Loc032_AzimuthalPartnerId = 0;
//      $RFC_Location_030_032::RFC_Loc032_RadialDistance = 0;
//      $RFC_Location_030_032::RFC_Loc032_RadialVelocity = -163.84;
//      $RFC_Location_030_032::RFC_Loc032_Elevation = -51.2;
//      $RFC_Location_030_032::RFC_Loc032_Azimuth = -102.4;
//      break;
      
//    case 33:
//      $RFC_Location_033_035::RFC_Loc033_RadialDistanceVnce = 0;
//      $RFC_Location_033_035::RFC_Loc033_DistVelocityCoVnce = -0.1024;
//      $RFC_Location_033_035::RFC_Loc033_DistVelocityQuality = 0;
//      $RFC_Location_033_035::RFC_Loc033_ElevationQuality = 0;
//      $RFC_Location_033_035::RFC_Loc033_ElevationVnce = 0;
//      $RFC_Location_033_035::RFC_Loc033_AzimuthQuality = 0;
//      $RFC_Location_033_035::RFC_Loc033_AzimuthVnce = 0;
//      $RFC_Location_033_035::RFC_Loc033_RadialVelocityVnce = 0;
//      $RFC_Location_033_035::RFC_Loc033_RadarCrossSection = -102.4;
//      $RFC_Location_033_035::RFC_Loc033_RSSI = 0;
//      $RFC_Location_033_035::RFC_Loc033_AzimuthalPartnerId = 0;
//      $RFC_Location_033_035::RFC_Loc033_RadialDistance = 0;
//      $RFC_Location_033_035::RFC_Loc033_RadialVelocity = -163.84;
//      $RFC_Location_033_035::RFC_Loc033_Elevation = -51.2;
//      $RFC_Location_033_035::RFC_Loc033_Azimuth = -102.4;
//      break;
      
//    case 34:
//      $RFC_Location_033_035::RFC_Loc034_RadialDistanceVnce = 0;
//      $RFC_Location_033_035::RFC_Loc034_DistVelocityCoVnce = -0.1024;
//      $RFC_Location_033_035::RFC_Loc034_DistVelocityQuality = 0;
//      $RFC_Location_033_035::RFC_Loc034_ElevationQuality = 0;
//      $RFC_Location_033_035::RFC_Loc034_ElevationVnce = 0;
//      $RFC_Location_033_035::RFC_Loc034_AzimuthQuality = 0;
//      $RFC_Location_033_035::RFC_Loc034_AzimuthVnce = 0;
//      $RFC_Location_033_035::RFC_Loc034_RadialVelocityVnce = 0;
//      $RFC_Location_033_035::RFC_Loc034_RadarCrossSection = -102.4;
//      $RFC_Location_033_035::RFC_Loc034_RSSI = 0;
//      $RFC_Location_033_035::RFC_Loc034_AzimuthalPartnerId = 0;
//      $RFC_Location_033_035::RFC_Loc034_RadialDistance = 0;
//      $RFC_Location_033_035::RFC_Loc034_RadialVelocity = -163.84;
//      $RFC_Location_033_035::RFC_Loc034_Elevation = -51.2;
//      $RFC_Location_033_035::RFC_Loc034_Azimuth = -102.4;
//      break;
      
//    case 35:
//      $RFC_Location_033_035::RFC_Loc035_RadialDistanceVnce = 0;
//      $RFC_Location_033_035::RFC_Loc035_DistVelocityCoVnce = -0.1024;
//      $RFC_Location_033_035::RFC_Loc035_DistVelocityQuality = 0;
//      $RFC_Location_033_035::RFC_Loc035_ElevationQuality = 0;
//      $RFC_Location_033_035::RFC_Loc035_ElevationVnce = 0;
//      $RFC_Location_033_035::RFC_Loc035_AzimuthQuality = 0;
//      $RFC_Location_033_035::RFC_Loc035_AzimuthVnce = 0;
//      $RFC_Location_033_035::RFC_Loc035_RadialVelocityVnce = 0;
//      $RFC_Location_033_035::RFC_Loc035_RadarCrossSection = -102.4;
//      $RFC_Location_033_035::RFC_Loc035_RSSI = 0;
//      $RFC_Location_033_035::RFC_Loc035_AzimuthalPartnerId = 0;
//      $RFC_Location_033_035::RFC_Loc035_RadialDistance = 0;
//      $RFC_Location_033_035::RFC_Loc035_RadialVelocity = -163.84;
//      $RFC_Location_033_035::RFC_Loc035_Elevation = -51.2;
//      $RFC_Location_033_035::RFC_Loc035_Azimuth = -102.4;
//      break;
      
//    case 36:
//      $RFC_Location_036_038::RFC_Loc036_RadialDistanceVnce = 0;
//      $RFC_Location_036_038::RFC_Loc036_DistVelocityCoVnce = -0.1024;
//      $RFC_Location_036_038::RFC_Loc036_DistVelocityQuality = 0;
//      $RFC_Location_036_038::RFC_Loc036_ElevationQuality = 0;
//      $RFC_Location_036_038::RFC_Loc036_ElevationVnce = 0;
//      $RFC_Location_036_038::RFC_Loc036_AzimuthQuality = 0;
//      $RFC_Location_036_038::RFC_Loc036_AzimuthVnce = 0;
//      $RFC_Location_036_038::RFC_Loc036_RadialVelocityVnce = 0;
//      $RFC_Location_036_038::RFC_Loc036_RadarCrossSection = -102.4;
//      $RFC_Location_036_038::RFC_Loc036_RSSI = 0;
//      $RFC_Location_036_038::RFC_Loc036_AzimuthalPartnerId = 0;
//      $RFC_Location_036_038::RFC_Loc036_RadialDistance = 0;
//      $RFC_Location_036_038::RFC_Loc036_RadialVelocity = -163.84;
//      $RFC_Location_036_038::RFC_Loc036_Elevation = -51.2;
//      $RFC_Location_036_038::RFC_Loc036_Azimuth = -102.4;
//      break;
      
//    case 37:
//      $RFC_Location_036_038::RFC_Loc037_RadialDistanceVnce = 0;
//      $RFC_Location_036_038::RFC_Loc037_DistVelocityCoVnce = -0.1024;
//      $RFC_Location_036_038::RFC_Loc037_DistVelocityQuality = 0;
//      $RFC_Location_036_038::RFC_Loc037_ElevationQuality = 0;
//      $RFC_Location_036_038::RFC_Loc037_ElevationVnce = 0;
//      $RFC_Location_036_038::RFC_Loc037_AzimuthQuality = 0;
//      $RFC_Location_036_038::RFC_Loc037_AzimuthVnce = 0;
//      $RFC_Location_036_038::RFC_Loc037_RadialVelocityVnce = 0;
//      $RFC_Location_036_038::RFC_Loc037_RadarCrossSection = -102.4;
//      $RFC_Location_036_038::RFC_Loc037_RSSI = 0;
//      $RFC_Location_036_038::RFC_Loc037_AzimuthalPartnerId = 0;
//      $RFC_Location_036_038::RFC_Loc037_RadialDistance = 0;
//      $RFC_Location_036_038::RFC_Loc037_RadialVelocity = -163.84;
//      $RFC_Location_036_038::RFC_Loc037_Elevation = -51.2;
//      $RFC_Location_036_038::RFC_Loc037_Azimuth = -102.4;
//      break;
      
//    case 38:
//      $RFC_Location_036_038::RFC_Loc038_RadialDistanceVnce = 0;
//      $RFC_Location_036_038::RFC_Loc038_DistVelocityCoVnce = -0.1024;
//      $RFC_Location_036_038::RFC_Loc038_DistVelocityQuality = 0;
//      $RFC_Location_036_038::RFC_Loc038_ElevationQuality = 0;
//      $RFC_Location_036_038::RFC_Loc038_ElevationVnce = 0;
//      $RFC_Location_036_038::RFC_Loc038_AzimuthQuality = 0;
//      $RFC_Location_036_038::RFC_Loc038_AzimuthVnce = 0;
//      $RFC_Location_036_038::RFC_Loc038_RadialVelocityVnce = 0;
//      $RFC_Location_036_038::RFC_Loc038_RadarCrossSection = -102.4;
//      $RFC_Location_036_038::RFC_Loc038_RSSI = 0;
//      $RFC_Location_036_038::RFC_Loc038_AzimuthalPartnerId = 0;
//      $RFC_Location_036_038::RFC_Loc038_RadialDistance = 0;
//      $RFC_Location_036_038::RFC_Loc038_RadialVelocity = -163.84;
//      $RFC_Location_036_038::RFC_Loc038_Elevation = -51.2;
//      $RFC_Location_036_038::RFC_Loc038_Azimuth = -102.4;
//      break;
      
//    case 39:
//      $RFC_Location_039_041::RFC_Loc039_RadialDistanceVnce = 0;
//      $RFC_Location_039_041::RFC_Loc039_DistVelocityCoVnce = -0.1024;
//      $RFC_Location_039_041::RFC_Loc039_DistVelocityQuality = 0;
//      $RFC_Location_039_041::RFC_Loc039_ElevationQuality = 0;
//      $RFC_Location_039_041::RFC_Loc039_ElevationVnce = 0;
//      $RFC_Location_039_041::RFC_Loc039_AzimuthQuality = 0;
//      $RFC_Location_039_041::RFC_Loc039_AzimuthVnce = 0;
//      $RFC_Location_039_041::RFC_Loc039_RadialVelocityVnce = 0;
//      $RFC_Location_039_041::RFC_Loc039_RadarCrossSection = -102.4;
//      $RFC_Location_039_041::RFC_Loc039_RSSI = 0;
//      $RFC_Location_039_041::RFC_Loc039_AzimuthalPartnerId = 0;
//      $RFC_Location_039_041::RFC_Loc039_RadialDistance = 0;
//      $RFC_Location_039_041::RFC_Loc039_RadialVelocity = -163.84;
//      $RFC_Location_039_041::RFC_Loc039_Elevation = -51.2;
//      $RFC_Location_039_041::RFC_Loc039_Azimuth = -102.4;
//      break;
      
//    case 40:
//      $RFC_Location_039_041::RFC_Loc040_RadialDistanceVnce = 0;
//      $RFC_Location_039_041::RFC_Loc040_DistVelocityCoVnce = -0.1024;
//      $RFC_Location_039_041::RFC_Loc040_DistVelocityQuality = 0;
//      $RFC_Location_039_041::RFC_Loc040_ElevationQuality = 0;
//      $RFC_Location_039_041::RFC_Loc040_ElevationVnce = 0;
//      $RFC_Location_039_041::RFC_Loc040_AzimuthQuality = 0;
//      $RFC_Location_039_041::RFC_Loc040_AzimuthVnce = 0;
//      $RFC_Location_039_041::RFC_Loc040_RadialVelocityVnce = 0;
//      $RFC_Location_039_041::RFC_Loc040_RadarCrossSection = -102.4;
//      $RFC_Location_039_041::RFC_Loc040_RSSI = 0;
//      $RFC_Location_039_041::RFC_Loc040_AzimuthalPartnerId = 0;
//      $RFC_Location_039_041::RFC_Loc040_RadialDistance = 0;
//      $RFC_Location_039_041::RFC_Loc040_RadialVelocity = -163.84;
//      $RFC_Location_039_041::RFC_Loc040_Elevation = -51.2;
//      $RFC_Location_039_041::RFC_Loc040_Azimuth = -102.4;
//      break;
      
//    case 41:
//      $RFC_Location_039_041::RFC_Loc041_RadialDistanceVnce = 0;
//      $RFC_Location_039_041::RFC_Loc041_DistVelocityCoVnce = -0.1024;
//      $RFC_Location_039_041::RFC_Loc041_DistVelocityQuality = 0;
//      $RFC_Location_039_041::RFC_Loc041_ElevationQuality = 0;
//      $RFC_Location_039_041::RFC_Loc041_ElevationVnce = 0;
//      $RFC_Location_039_041::RFC_Loc041_AzimuthQuality = 0;
//      $RFC_Location_039_041::RFC_Loc041_AzimuthVnce = 0;
//      $RFC_Location_039_041::RFC_Loc041_RadialVelocityVnce = 0;
//      $RFC_Location_039_041::RFC_Loc041_RadarCrossSection = -102.4;
//      $RFC_Location_039_041::RFC_Loc041_RSSI = 0;
//      $RFC_Location_039_041::RFC_Loc041_AzimuthalPartnerId = 0;
//      $RFC_Location_039_041::RFC_Loc041_RadialDistance = 0;
//      $RFC_Location_039_041::RFC_Loc041_RadialVelocity = -163.84;
//      $RFC_Location_039_041::RFC_Loc041_Elevation = -51.2;
//      $RFC_Location_039_041::RFC_Loc041_Azimuth = -102.4;
//      break;
      
//    case 42:
//      $RFC_Location_042_044::RFC_Loc042_RadialDistanceVnce = 0;
//      $RFC_Location_042_044::RFC_Loc042_DistVelocityCoVnce = -0.1024;
//      $RFC_Location_042_044::RFC_Loc042_DistVelocityQuality = 0;
//      $RFC_Location_042_044::RFC_Loc042_ElevationQuality = 0;
//      $RFC_Location_042_044::RFC_Loc042_ElevationVnce = 0;
//      $RFC_Location_042_044::RFC_Loc042_AzimuthQuality = 0;
//      $RFC_Location_042_044::RFC_Loc042_AzimuthVnce = 0;
//      $RFC_Location_042_044::RFC_Loc042_RadialVelocityVnce = 0;
//      $RFC_Location_042_044::RFC_Loc042_RadarCrossSection = -102.4;
//      $RFC_Location_042_044::RFC_Loc042_RSSI = 0;
//      $RFC_Location_042_044::RFC_Loc042_AzimuthalPartnerId = 0;
//      $RFC_Location_042_044::RFC_Loc042_RadialDistance = 0;
//      $RFC_Location_042_044::RFC_Loc042_RadialVelocity = -163.84;
//      $RFC_Location_042_044::RFC_Loc042_Elevation = -51.2;
//      $RFC_Location_042_044::RFC_Loc042_Azimuth = -102.4;
//      break;
      
//    case 43:
//      $RFC_Location_042_044::RFC_Loc043_RadialDistanceVnce = 0;
//      $RFC_Location_042_044::RFC_Loc043_DistVelocityCoVnce = -0.1024;
//      $RFC_Location_042_044::RFC_Loc043_DistVelocityQuality = 0;
//      $RFC_Location_042_044::RFC_Loc043_ElevationQuality = 0;
//      $RFC_Location_042_044::RFC_Loc043_ElevationVnce = 0;
//      $RFC_Location_042_044::RFC_Loc043_AzimuthQuality = 0;
//      $RFC_Location_042_044::RFC_Loc043_AzimuthVnce = 0;
//      $RFC_Location_042_044::RFC_Loc043_RadialVelocityVnce = 0;
//      $RFC_Location_042_044::RFC_Loc043_RadarCrossSection = -102.4;
//      $RFC_Location_042_044::RFC_Loc043_RSSI = 0;
//      $RFC_Location_042_044::RFC_Loc043_AzimuthalPartnerId = 0;
//      $RFC_Location_042_044::RFC_Loc043_RadialDistance = 0;
//      $RFC_Location_042_044::RFC_Loc043_RadialVelocity = -163.84;
//      $RFC_Location_042_044::RFC_Loc043_Elevation = -51.2;
//      $RFC_Location_042_044::RFC_Loc043_Azimuth = -102.4;
//      break;
      
//    case 44:
//      $RFC_Location_042_044::RFC_Loc044_RadialDistanceVnce = 0;
//      $RFC_Location_042_044::RFC_Loc044_DistVelocityCoVnce = -0.1024;
//      $RFC_Location_042_044::RFC_Loc044_DistVelocityQuality = 0;
//      $RFC_Location_042_044::RFC_Loc044_ElevationQuality = 0;
//      $RFC_Location_042_044::RFC_Loc044_ElevationVnce = 0;
//      $RFC_Location_042_044::RFC_Loc044_AzimuthQuality = 0;
//      $RFC_Location_042_044::RFC_Loc044_AzimuthVnce = 0;
//      $RFC_Location_042_044::RFC_Loc044_RadialVelocityVnce = 0;
//      $RFC_Location_042_044::RFC_Loc044_RadarCrossSection = -102.4;
//      $RFC_Location_042_044::RFC_Loc044_RSSI = 0;
//      $RFC_Location_042_044::RFC_Loc044_AzimuthalPartnerId = 0;
//      $RFC_Location_042_044::RFC_Loc044_RadialDistance = 0;
//      $RFC_Location_042_044::RFC_Loc044_RadialVelocity = -163.84;
//      $RFC_Location_042_044::RFC_Loc044_Elevation = -51.2;
//      $RFC_Location_042_044::RFC_Loc044_Azimuth = -102.4;
//      break;
      
//    case 45:
//      $RFC_Location_045_047::RFC_Loc045_RadialDistanceVnce = 0;
//      $RFC_Location_045_047::RFC_Loc045_DistVelocityCoVnce = -0.1024;
//      $RFC_Location_045_047::RFC_Loc045_DistVelocityQuality = 0;
//      $RFC_Location_045_047::RFC_Loc045_ElevationQuality = 0;
//      $RFC_Location_045_047::RFC_Loc045_ElevationVnce = 0;
//      $RFC_Location_045_047::RFC_Loc045_AzimuthQuality = 0;
//      $RFC_Location_045_047::RFC_Loc045_AzimuthVnce = 0;
//      $RFC_Location_045_047::RFC_Loc045_RadialVelocityVnce = 0;
//      $RFC_Location_045_047::RFC_Loc045_RadarCrossSection = -102.4;
//      $RFC_Location_045_047::RFC_Loc045_RSSI = 0;
//      $RFC_Location_045_047::RFC_Loc045_AzimuthalPartnerId = 0;
//      $RFC_Location_045_047::RFC_Loc045_RadialDistance = 0;
//      $RFC_Location_045_047::RFC_Loc045_RadialVelocity = -163.84;
//      $RFC_Location_045_047::RFC_Loc045_Elevation = -51.2;
//      $RFC_Location_045_047::RFC_Loc045_Azimuth = -102.4;
//      break;
      
//    case 46:
//      $RFC_Location_045_047::RFC_Loc046_RadialDistanceVnce = 0;
//      $RFC_Location_045_047::RFC_Loc046_DistVelocityCoVnce = -0.1024;
//      $RFC_Location_045_047::RFC_Loc046_DistVelocityQuality = 0;
//      $RFC_Location_045_047::RFC_Loc046_ElevationQuality = 0;
//      $RFC_Location_045_047::RFC_Loc046_ElevationVnce = 0;
//      $RFC_Location_045_047::RFC_Loc046_AzimuthQuality = 0;
//      $RFC_Location_045_047::RFC_Loc046_AzimuthVnce = 0;
//      $RFC_Location_045_047::RFC_Loc046_RadialVelocityVnce = 0;
//      $RFC_Location_045_047::RFC_Loc046_RadarCrossSection = -102.4;
//      $RFC_Location_045_047::RFC_Loc046_RSSI = 0;
//      $RFC_Location_045_047::RFC_Loc046_AzimuthalPartnerId = 0;
//      $RFC_Location_045_047::RFC_Loc046_RadialDistance = 0;
//      $RFC_Location_045_047::RFC_Loc046_RadialVelocity = -163.84;
//      $RFC_Location_045_047::RFC_Loc046_Elevation = -51.2;
//      $RFC_Location_045_047::RFC_Loc046_Azimuth = -102.4;
//      break;
      
//    case 47:
//      $RFC_Location_045_047::RFC_Loc047_RadialDistanceVnce = 0;
//      $RFC_Location_045_047::RFC_Loc047_DistVelocityCoVnce = -0.1024;
//      $RFC_Location_045_047::RFC_Loc047_DistVelocityQuality = 0;
//      $RFC_Location_045_047::RFC_Loc047_ElevationQuality = 0;
//      $RFC_Location_045_047::RFC_Loc047_ElevationVnce = 0;
//      $RFC_Location_045_047::RFC_Loc047_AzimuthQuality = 0;
//      $RFC_Location_045_047::RFC_Loc047_AzimuthVnce = 0;
//      $RFC_Location_045_047::RFC_Loc047_RadialVelocityVnce = 0;
//      $RFC_Location_045_047::RFC_Loc047_RadarCrossSection = -102.4;
//      $RFC_Location_045_047::RFC_Loc047_RSSI = 0;
//      $RFC_Location_045_047::RFC_Loc047_AzimuthalPartnerId = 0;
//      $RFC_Location_045_047::RFC_Loc047_RadialDistance = 0;
//      $RFC_Location_045_047::RFC_Loc047_RadialVelocity = -163.84;
//      $RFC_Location_045_047::RFC_Loc047_Elevation = -51.2;
//      $RFC_Location_045_047::RFC_Loc047_Azimuth = -102.4;
//      break;
      
//    case 48:
//      $RFC_Location_048_050::RFC_Loc048_RadialDistanceVnce = 0;
//      $RFC_Location_048_050::RFC_Loc048_DistVelocityCoVnce = -0.1024;
//      $RFC_Location_048_050::RFC_Loc048_DistVelocityQuality = 0;
//      $RFC_Location_048_050::RFC_Loc048_ElevationQuality = 0;
//      $RFC_Location_048_050::RFC_Loc048_ElevationVnce = 0;
//      $RFC_Location_048_050::RFC_Loc048_AzimuthQuality = 0;
//      $RFC_Location_048_050::RFC_Loc048_AzimuthVnce = 0;
//      $RFC_Location_048_050::RFC_Loc048_RadialVelocityVnce = 0;
//      $RFC_Location_048_050::RFC_Loc048_RadarCrossSection = -102.4;
//      $RFC_Location_048_050::RFC_Loc048_RSSI = 0;
//      $RFC_Location_048_050::RFC_Loc048_AzimuthalPartnerId = 0;
//      $RFC_Location_048_050::RFC_Loc048_RadialDistance = 0;
//      $RFC_Location_048_050::RFC_Loc048_RadialVelocity = -163.84;
//      $RFC_Location_048_050::RFC_Loc048_Elevation = -51.2;
//      $RFC_Location_048_050::RFC_Loc048_Azimuth = -102.4;
//      break;
      
//    case 49:
//      $RFC_Location_048_050::RFC_Loc049_RadialDistanceVnce = 0;
//      $RFC_Location_048_050::RFC_Loc049_DistVelocityCoVnce = -0.1024;
//      $RFC_Location_048_050::RFC_Loc049_DistVelocityQuality = 0;
//      $RFC_Location_048_050::RFC_Loc049_ElevationQuality = 0;
//      $RFC_Location_048_050::RFC_Loc049_ElevationVnce = 0;
//      $RFC_Location_048_050::RFC_Loc049_AzimuthQuality = 0;
//      $RFC_Location_048_050::RFC_Loc049_AzimuthVnce = 0;
//      $RFC_Location_048_050::RFC_Loc049_RadialVelocityVnce = 0;
//      $RFC_Location_048_050::RFC_Loc049_RadarCrossSection = -102.4;
//      $RFC_Location_048_050::RFC_Loc049_RSSI = 0;
//      $RFC_Location_048_050::RFC_Loc049_AzimuthalPartnerId = 0;
//      $RFC_Location_048_050::RFC_Loc049_RadialDistance = 0;
//      $RFC_Location_048_050::RFC_Loc049_RadialVelocity = -163.84;
//      $RFC_Location_048_050::RFC_Loc049_Elevation = -51.2;
//      $RFC_Location_048_050::RFC_Loc049_Azimuth = -102.4;
//      break;
      
//    case 50:
//      $RFC_Location_048_050::RFC_Loc050_RadialDistanceVnce = 0;
//      $RFC_Location_048_050::RFC_Loc050_DistVelocityCoVnce = -0.1024;
//      $RFC_Location_048_050::RFC_Loc050_DistVelocityQuality = 0;
//      $RFC_Location_048_050::RFC_Loc050_ElevationQuality = 0;
//      $RFC_Location_048_050::RFC_Loc050_ElevationVnce = 0;
//      $RFC_Location_048_050::RFC_Loc050_AzimuthQuality = 0;
//      $RFC_Location_048_050::RFC_Loc050_AzimuthVnce = 0;
//      $RFC_Location_048_050::RFC_Loc050_RadialVelocityVnce = 0;
//      $RFC_Location_048_050::RFC_Loc050_RadarCrossSection = -102.4;
//      $RFC_Location_048_050::RFC_Loc050_RSSI = 0;
//      $RFC_Location_048_050::RFC_Loc050_AzimuthalPartnerId = 0;
//      $RFC_Location_048_050::RFC_Loc050_RadialDistance = 0;
//      $RFC_Location_048_050::RFC_Loc050_RadialVelocity = -163.84;
//      $RFC_Location_048_050::RFC_Loc050_Elevation = -51.2;
//      $RFC_Location_048_050::RFC_Loc050_Azimuth = -102.4;
//      break;
      
//    case 51:
//      $RFC_Location_051_053::RFC_Loc051_RadialDistanceVnce = 0;
//      $RFC_Location_051_053::RFC_Loc051_DistVelocityCoVnce = -0.1024;
//      $RFC_Location_051_053::RFC_Loc051_DistVelocityQuality = 0;
//      $RFC_Location_051_053::RFC_Loc051_ElevationQuality = 0;
//      $RFC_Location_051_053::RFC_Loc051_ElevationVnce = 0;
//      $RFC_Location_051_053::RFC_Loc051_AzimuthQuality = 0;
//      $RFC_Location_051_053::RFC_Loc051_AzimuthVnce = 0;
//      $RFC_Location_051_053::RFC_Loc051_RadialVelocityVnce = 0;
//      $RFC_Location_051_053::RFC_Loc051_RadarCrossSection = -102.4;
//      $RFC_Location_051_053::RFC_Loc051_RSSI = 0;
//      $RFC_Location_051_053::RFC_Loc051_AzimuthalPartnerId = 0;
//      $RFC_Location_051_053::RFC_Loc051_RadialDistance = 0;
//      $RFC_Location_051_053::RFC_Loc051_RadialVelocity = -163.84;
//      $RFC_Location_051_053::RFC_Loc051_Elevation = -51.2;
//      $RFC_Location_051_053::RFC_Loc051_Azimuth = -102.4;
//      break;
      
//    case 52:
//      $RFC_Location_051_053::RFC_Loc052_RadialDistanceVnce = 0;
//      $RFC_Location_051_053::RFC_Loc052_DistVelocityCoVnce = -0.1024;
//      $RFC_Location_051_053::RFC_Loc052_DistVelocityQuality = 0;
//      $RFC_Location_051_053::RFC_Loc052_ElevationQuality = 0;
//      $RFC_Location_051_053::RFC_Loc052_ElevationVnce = 0;
//      $RFC_Location_051_053::RFC_Loc052_AzimuthQuality = 0;
//      $RFC_Location_051_053::RFC_Loc052_AzimuthVnce = 0;
//      $RFC_Location_051_053::RFC_Loc052_RadialVelocityVnce = 0;
//      $RFC_Location_051_053::RFC_Loc052_RadarCrossSection = -102.4;
//      $RFC_Location_051_053::RFC_Loc052_RSSI = 0;
//      $RFC_Location_051_053::RFC_Loc052_AzimuthalPartnerId = 0;
//      $RFC_Location_051_053::RFC_Loc052_RadialDistance = 0;
//      $RFC_Location_051_053::RFC_Loc052_RadialVelocity = -163.84;
//      $RFC_Location_051_053::RFC_Loc052_Elevation = -51.2;
//      $RFC_Location_051_053::RFC_Loc052_Azimuth = -102.4;
//      break;
      
//    case 53:
//      $RFC_Location_051_053::RFC_Loc053_RadialDistanceVnce = 0;
//      $RFC_Location_051_053::RFC_Loc053_DistVelocityCoVnce = -0.1024;
//      $RFC_Location_051_053::RFC_Loc053_DistVelocityQuality = 0;
//      $RFC_Location_051_053::RFC_Loc053_ElevationQuality = 0;
//      $RFC_Location_051_053::RFC_Loc053_ElevationVnce = 0;
//      $RFC_Location_051_053::RFC_Loc053_AzimuthQuality = 0;
//      $RFC_Location_051_053::RFC_Loc053_AzimuthVnce = 0;
//      $RFC_Location_051_053::RFC_Loc053_RadialVelocityVnce = 0;
//      $RFC_Location_051_053::RFC_Loc053_RadarCrossSection = -102.4;
//      $RFC_Location_051_053::RFC_Loc053_RSSI = 0;
//      $RFC_Location_051_053::RFC_Loc053_AzimuthalPartnerId = 0;
//      $RFC_Location_051_053::RFC_Loc053_RadialDistance = 0;
//      $RFC_Location_051_053::RFC_Loc053_RadialVelocity = -163.84;
//      $RFC_Location_051_053::RFC_Loc053_Elevation = -51.2;
//      $RFC_Location_051_053::RFC_Loc053_Azimuth = -102.4;
//      break;
      
//    case 54:
//      $RFC_Location_054_056::RFC_Loc054_RadialDistanceVnce = 0;
//      $RFC_Location_054_056::RFC_Loc054_DistVelocityCoVnce = -0.1024;
//      $RFC_Location_054_056::RFC_Loc054_DistVelocityQuality = 0;
//      $RFC_Location_054_056::RFC_Loc054_ElevationQuality = 0;
//      $RFC_Location_054_056::RFC_Loc054_ElevationVnce = 0;
//      $RFC_Location_054_056::RFC_Loc054_AzimuthQuality = 0;
//      $RFC_Location_054_056::RFC_Loc054_AzimuthVnce = 0;
//      $RFC_Location_054_056::RFC_Loc054_RadialVelocityVnce = 0;
//      $RFC_Location_054_056::RFC_Loc054_RadarCrossSection = -102.4;
//      $RFC_Location_054_056::RFC_Loc054_RSSI = 0;
//      $RFC_Location_054_056::RFC_Loc054_AzimuthalPartnerId = 0;
//      $RFC_Location_054_056::RFC_Loc054_RadialDistance = 0;
//      $RFC_Location_054_056::RFC_Loc054_RadialVelocity = -163.84;
//      $RFC_Location_054_056::RFC_Loc054_Elevation = -51.2;
//      $RFC_Location_054_056::RFC_Loc054_Azimuth = -102.4;
//      break;
      
//    case 55:
//      $RFC_Location_054_056::RFC_Loc055_RadialDistanceVnce = 0;
//      $RFC_Location_054_056::RFC_Loc055_DistVelocityCoVnce = -0.1024;
//      $RFC_Location_054_056::RFC_Loc055_DistVelocityQuality = 0;
//      $RFC_Location_054_056::RFC_Loc055_ElevationQuality = 0;
//      $RFC_Location_054_056::RFC_Loc055_ElevationVnce = 0;
//      $RFC_Location_054_056::RFC_Loc055_AzimuthQuality = 0;
//      $RFC_Location_054_056::RFC_Loc055_AzimuthVnce = 0;
//      $RFC_Location_054_056::RFC_Loc055_RadialVelocityVnce = 0;
//      $RFC_Location_054_056::RFC_Loc055_RadarCrossSection = -102.4;
//      $RFC_Location_054_056::RFC_Loc055_RSSI = 0;
//      $RFC_Location_054_056::RFC_Loc055_AzimuthalPartnerId = 0;
//      $RFC_Location_054_056::RFC_Loc055_RadialDistance = 0;
//      $RFC_Location_054_056::RFC_Loc055_RadialVelocity = -163.84;
//      $RFC_Location_054_056::RFC_Loc055_Elevation = -51.2;
//      $RFC_Location_054_056::RFC_Loc055_Azimuth = -102.4;
//      break;
      
//    case 56:
//      $RFC_Location_054_056::RFC_Loc056_RadialDistanceVnce = 0;
//      $RFC_Location_054_056::RFC_Loc056_DistVelocityCoVnce = -0.1024;
//      $RFC_Location_054_056::RFC_Loc056_DistVelocityQuality = 0;
//      $RFC_Location_054_056::RFC_Loc056_ElevationQuality = 0;
//      $RFC_Location_054_056::RFC_Loc056_ElevationVnce = 0;
//      $RFC_Location_054_056::RFC_Loc056_AzimuthQuality = 0;
//      $RFC_Location_054_056::RFC_Loc056_AzimuthVnce = 0;
//      $RFC_Location_054_056::RFC_Loc056_RadialVelocityVnce = 0;
//      $RFC_Location_054_056::RFC_Loc056_RadarCrossSection = -102.4;
//      $RFC_Location_054_056::RFC_Loc056_RSSI = 0;
//      $RFC_Location_054_056::RFC_Loc056_AzimuthalPartnerId = 0;
//      $RFC_Location_054_056::RFC_Loc056_RadialDistance = 0;
//      $RFC_Location_054_056::RFC_Loc056_RadialVelocity = -163.84;
//      $RFC_Location_054_056::RFC_Loc056_Elevation = -51.2;
//      $RFC_Location_054_056::RFC_Loc056_Azimuth = -102.4;
//      break;
      
//    case 57:
//      $RFC_Location_057_059::RFC_Loc057_RadialDistanceVnce = 0;
//      $RFC_Location_057_059::RFC_Loc057_DistVelocityCoVnce = -0.1024;
//      $RFC_Location_057_059::RFC_Loc057_DistVelocityQuality = 0;
//      $RFC_Location_057_059::RFC_Loc057_ElevationQuality = 0;
//      $RFC_Location_057_059::RFC_Loc057_ElevationVnce = 0;
//      $RFC_Location_057_059::RFC_Loc057_AzimuthQuality = 0;
//      $RFC_Location_057_059::RFC_Loc057_AzimuthVnce = 0;
//      $RFC_Location_057_059::RFC_Loc057_RadialVelocityVnce = 0;
//      $RFC_Location_057_059::RFC_Loc057_RadarCrossSection = -102.4;
//      $RFC_Location_057_059::RFC_Loc057_RSSI = 0;
//      $RFC_Location_057_059::RFC_Loc057_AzimuthalPartnerId = 0;
//      $RFC_Location_057_059::RFC_Loc057_RadialDistance = 0;
//      $RFC_Location_057_059::RFC_Loc057_RadialVelocity = -163.84;
//      $RFC_Location_057_059::RFC_Loc057_Elevation = -51.2;
//      $RFC_Location_057_059::RFC_Loc057_Azimuth = -102.4;
//      break;
      
//    case 58:
//      $RFC_Location_057_059::RFC_Loc058_RadialDistanceVnce = 0;
//      $RFC_Location_057_059::RFC_Loc058_DistVelocityCoVnce = -0.1024;
//      $RFC_Location_057_059::RFC_Loc058_DistVelocityQuality = 0;
//      $RFC_Location_057_059::RFC_Loc058_ElevationQuality = 0;
//      $RFC_Location_057_059::RFC_Loc058_ElevationVnce = 0;
//      $RFC_Location_057_059::RFC_Loc058_AzimuthQuality = 0;
//      $RFC_Location_057_059::RFC_Loc058_AzimuthVnce = 0;
//      $RFC_Location_057_059::RFC_Loc058_RadialVelocityVnce = 0;
//      $RFC_Location_057_059::RFC_Loc058_RadarCrossSection = -102.4;
//      $RFC_Location_057_059::RFC_Loc058_RSSI = 0;
//      $RFC_Location_057_059::RFC_Loc058_AzimuthalPartnerId = 0;
//      $RFC_Location_057_059::RFC_Loc058_RadialDistance = 0;
//      $RFC_Location_057_059::RFC_Loc058_RadialVelocity = -163.84;
//      $RFC_Location_057_059::RFC_Loc058_Elevation = -51.2;
//      $RFC_Location_057_059::RFC_Loc058_Azimuth = -102.4;
//      break;
      
//    case 59:
//      $RFC_Location_057_059::RFC_Loc059_RadialDistanceVnce = 0;
//      $RFC_Location_057_059::RFC_Loc059_DistVelocityCoVnce = -0.1024;
//      $RFC_Location_057_059::RFC_Loc059_DistVelocityQuality = 0;
//      $RFC_Location_057_059::RFC_Loc059_ElevationQuality = 0;
//      $RFC_Location_057_059::RFC_Loc059_ElevationVnce = 0;
//      $RFC_Location_057_059::RFC_Loc059_AzimuthQuality = 0;
//      $RFC_Location_057_059::RFC_Loc059_AzimuthVnce = 0;
//      $RFC_Location_057_059::RFC_Loc059_RadialVelocityVnce = 0;
//      $RFC_Location_057_059::RFC_Loc059_RadarCrossSection = -102.4;
//      $RFC_Location_057_059::RFC_Loc059_RSSI = 0;
//      $RFC_Location_057_059::RFC_Loc059_AzimuthalPartnerId = 0;
//      $RFC_Location_057_059::RFC_Loc059_RadialDistance = 0;
//      $RFC_Location_057_059::RFC_Loc059_RadialVelocity = -163.84;
//      $RFC_Location_057_059::RFC_Loc059_Elevation = -51.2;
//      $RFC_Location_057_059::RFC_Loc059_Azimuth = -102.4;
//      break;
      
//    case 60:
//      $RFC_Location_060_062::RFC_Loc060_RadialDistanceVnce = 0;
//      $RFC_Location_060_062::RFC_Loc060_DistVelocityCoVnce = -0.1024;
//      $RFC_Location_060_062::RFC_Loc060_DistVelocityQuality = 0;
//      $RFC_Location_060_062::RFC_Loc060_ElevationQuality = 0;
//      $RFC_Location_060_062::RFC_Loc060_ElevationVnce = 0;
//      $RFC_Location_060_062::RFC_Loc060_AzimuthQuality = 0;
//      $RFC_Location_060_062::RFC_Loc060_AzimuthVnce = 0;
//      $RFC_Location_060_062::RFC_Loc060_RadialVelocityVnce = 0;
//      $RFC_Location_060_062::RFC_Loc060_RadarCrossSection = -102.4;
//      $RFC_Location_060_062::RFC_Loc060_RSSI = 0;
//      $RFC_Location_060_062::RFC_Loc060_AzimuthalPartnerId = 0;
//      $RFC_Location_060_062::RFC_Loc060_RadialDistance = 0;
//      $RFC_Location_060_062::RFC_Loc060_RadialVelocity = -163.84;
//      $RFC_Location_060_062::RFC_Loc060_Elevation = -51.2;
//      $RFC_Location_060_062::RFC_Loc060_Azimuth = -102.4;
//      break;
      
//    case 61:
//      $RFC_Location_060_062::RFC_Loc061_RadialDistanceVnce = 0;
//      $RFC_Location_060_062::RFC_Loc061_DistVelocityCoVnce = -0.1024;
//      $RFC_Location_060_062::RFC_Loc061_DistVelocityQuality = 0;
//      $RFC_Location_060_062::RFC_Loc061_ElevationQuality = 0;
//      $RFC_Location_060_062::RFC_Loc061_ElevationVnce = 0;
//      $RFC_Location_060_062::RFC_Loc061_AzimuthQuality = 0;
//      $RFC_Location_060_062::RFC_Loc061_AzimuthVnce = 0;
//      $RFC_Location_060_062::RFC_Loc061_RadialVelocityVnce = 0;
//      $RFC_Location_060_062::RFC_Loc061_RadarCrossSection = -102.4;
//      $RFC_Location_060_062::RFC_Loc061_RSSI = 0;
//      $RFC_Location_060_062::RFC_Loc061_AzimuthalPartnerId = 0;
//      $RFC_Location_060_062::RFC_Loc061_RadialDistance = 0;
//      $RFC_Location_060_062::RFC_Loc061_RadialVelocity = -163.84;
//      $RFC_Location_060_062::RFC_Loc061_Elevation = -51.2;
//      $RFC_Location_060_062::RFC_Loc061_Azimuth = -102.4;
//      break;
      
//    case 62:
//      $RFC_Location_060_062::RFC_Loc062_RadialDistanceVnce = 0;
//      $RFC_Location_060_062::RFC_Loc062_DistVelocityCoVnce = -0.1024;
//      $RFC_Location_060_062::RFC_Loc062_DistVelocityQuality = 0;
//      $RFC_Location_060_062::RFC_Loc062_ElevationQuality = 0;
//      $RFC_Location_060_062::RFC_Loc062_ElevationVnce = 0;
//      $RFC_Location_060_062::RFC_Loc062_AzimuthQuality = 0;
//      $RFC_Location_060_062::RFC_Loc062_AzimuthVnce = 0;
//      $RFC_Location_060_062::RFC_Loc062_RadialVelocityVnce = 0;
//      $RFC_Location_060_062::RFC_Loc062_RadarCrossSection = -102.4;
//      $RFC_Location_060_062::RFC_Loc062_RSSI = 0;
//      $RFC_Location_060_062::RFC_Loc062_AzimuthalPartnerId = 0;
//      $RFC_Location_060_062::RFC_Loc062_RadialDistance = 0;
//      $RFC_Location_060_062::RFC_Loc062_RadialVelocity = -163.84;
//      $RFC_Location_060_062::RFC_Loc062_Elevation = -51.2;
//      $RFC_Location_060_062::RFC_Loc062_Azimuth = -102.4;
//      break;
      
//    case 63:
//      $RFC_Location_063_065::RFC_Loc063_RadialDistanceVnce = 0;
//      $RFC_Location_063_065::RFC_Loc063_DistVelocityCoVnce = -0.1024;
//      $RFC_Location_063_065::RFC_Loc063_DistVelocityQuality = 0;
//      $RFC_Location_063_065::RFC_Loc063_ElevationQuality = 0;
//      $RFC_Location_063_065::RFC_Loc063_ElevationVnce = 0;
//      $RFC_Location_063_065::RFC_Loc063_AzimuthQuality = 0;
//      $RFC_Location_063_065::RFC_Loc063_AzimuthVnce = 0;
//      $RFC_Location_063_065::RFC_Loc063_RadialVelocityVnce = 0;
//      $RFC_Location_063_065::RFC_Loc063_RadarCrossSection = -102.4;
//      $RFC_Location_063_065::RFC_Loc063_RSSI = 0;
//      $RFC_Location_063_065::RFC_Loc063_AzimuthalPartnerId = 0;
//      $RFC_Location_063_065::RFC_Loc063_RadialDistance = 0;
//      $RFC_Location_063_065::RFC_Loc063_RadialVelocity = -163.84;
//      $RFC_Location_063_065::RFC_Loc063_Elevation = -51.2;
//      $RFC_Location_063_065::RFC_Loc063_Azimuth = -102.4;
//      break;
      
//    case 64:
//      $RFC_Location_063_065::RFC_Loc064_RadialDistanceVnce = 0;
//      $RFC_Location_063_065::RFC_Loc064_DistVelocityCoVnce = -0.1024;
//      $RFC_Location_063_065::RFC_Loc064_DistVelocityQuality = 0;
//      $RFC_Location_063_065::RFC_Loc064_ElevationQuality = 0;
//      $RFC_Location_063_065::RFC_Loc064_ElevationVnce = 0;
//      $RFC_Location_063_065::RFC_Loc064_AzimuthQuality = 0;
//      $RFC_Location_063_065::RFC_Loc064_AzimuthVnce = 0;
//      $RFC_Location_063_065::RFC_Loc064_RadialVelocityVnce = 0;
//      $RFC_Location_063_065::RFC_Loc064_RadarCrossSection = -102.4;
//      $RFC_Location_063_065::RFC_Loc064_RSSI = 0;
//      $RFC_Location_063_065::RFC_Loc064_AzimuthalPartnerId = 0;
//      $RFC_Location_063_065::RFC_Loc064_RadialDistance = 0;
//      $RFC_Location_063_065::RFC_Loc064_RadialVelocity = -163.84;
//      $RFC_Location_063_065::RFC_Loc064_Elevation = -51.2;
//      $RFC_Location_063_065::RFC_Loc064_Azimuth = -102.4;
//      break;
      
//    case 65:
//      $RFC_Location_063_065::RFC_Loc065_RadialDistanceVnce = 0;
//      $RFC_Location_063_065::RFC_Loc065_DistVelocityCoVnce = -0.1024;
//      $RFC_Location_063_065::RFC_Loc065_DistVelocityQuality = 0;
//      $RFC_Location_063_065::RFC_Loc065_ElevationQuality = 0;
//      $RFC_Location_063_065::RFC_Loc065_ElevationVnce = 0;
//      $RFC_Location_063_065::RFC_Loc065_AzimuthQuality = 0;
//      $RFC_Location_063_065::RFC_Loc065_AzimuthVnce = 0;
//      $RFC_Location_063_065::RFC_Loc065_RadialVelocityVnce = 0;
//      $RFC_Location_063_065::RFC_Loc065_RadarCrossSection = -102.4;
//      $RFC_Location_063_065::RFC_Loc065_RSSI = 0;
//      $RFC_Location_063_065::RFC_Loc065_AzimuthalPartnerId = 0;
//      $RFC_Location_063_065::RFC_Loc065_RadialDistance = 0;
//      $RFC_Location_063_065::RFC_Loc065_RadialVelocity = -163.84;
//      $RFC_Location_063_065::RFC_Loc065_Elevation = -51.2;
//      $RFC_Location_063_065::RFC_Loc065_Azimuth = -102.4;
//      break;
      
//    case 66:
//      $RFC_Location_066_068::RFC_Loc066_RadialDistanceVnce = 0;
//      $RFC_Location_066_068::RFC_Loc066_DistVelocityCoVnce = -0.1024;
//      $RFC_Location_066_068::RFC_Loc066_DistVelocityQuality = 0;
//      $RFC_Location_066_068::RFC_Loc066_ElevationQuality = 0;
//      $RFC_Location_066_068::RFC_Loc066_ElevationVnce = 0;
//      $RFC_Location_066_068::RFC_Loc066_AzimuthQuality = 0;
//      $RFC_Location_066_068::RFC_Loc066_AzimuthVnce = 0;
//      $RFC_Location_066_068::RFC_Loc066_RadialVelocityVnce = 0;
//      $RFC_Location_066_068::RFC_Loc066_RadarCrossSection = -102.4;
//      $RFC_Location_066_068::RFC_Loc066_RSSI = 0;
//      $RFC_Location_066_068::RFC_Loc066_AzimuthalPartnerId = 0;
//      $RFC_Location_066_068::RFC_Loc066_RadialDistance = 0;
//      $RFC_Location_066_068::RFC_Loc066_RadialVelocity = -163.84;
//      $RFC_Location_066_068::RFC_Loc066_Elevation = -51.2;
//      $RFC_Location_066_068::RFC_Loc066_Azimuth = -102.4;
//      break;
      
//    case 67:
//      $RFC_Location_066_068::RFC_Loc067_RadialDistanceVnce = 0;
//      $RFC_Location_066_068::RFC_Loc067_DistVelocityCoVnce = -0.1024;
//      $RFC_Location_066_068::RFC_Loc067_DistVelocityQuality = 0;
//      $RFC_Location_066_068::RFC_Loc067_ElevationQuality = 0;
//      $RFC_Location_066_068::RFC_Loc067_ElevationVnce = 0;
//      $RFC_Location_066_068::RFC_Loc067_AzimuthQuality = 0;
//      $RFC_Location_066_068::RFC_Loc067_AzimuthVnce = 0;
//      $RFC_Location_066_068::RFC_Loc067_RadialVelocityVnce = 0;
//      $RFC_Location_066_068::RFC_Loc067_RadarCrossSection = -102.4;
//      $RFC_Location_066_068::RFC_Loc067_RSSI = 0;
//      $RFC_Location_066_068::RFC_Loc067_AzimuthalPartnerId = 0;
//      $RFC_Location_066_068::RFC_Loc067_RadialDistance = 0;
//      $RFC_Location_066_068::RFC_Loc067_RadialVelocity = -163.84;
//      $RFC_Location_066_068::RFC_Loc067_Elevation = -51.2;
//      $RFC_Location_066_068::RFC_Loc067_Azimuth = -102.4;
//      break;
      
//    case 68:
//      $RFC_Location_066_068::RFC_Loc068_RadialDistanceVnce = 0;
//      $RFC_Location_066_068::RFC_Loc068_DistVelocityCoVnce = -0.1024;
//      $RFC_Location_066_068::RFC_Loc068_DistVelocityQuality = 0;
//      $RFC_Location_066_068::RFC_Loc068_ElevationQuality = 0;
//      $RFC_Location_066_068::RFC_Loc068_ElevationVnce = 0;
//      $RFC_Location_066_068::RFC_Loc068_AzimuthQuality = 0;
//      $RFC_Location_066_068::RFC_Loc068_AzimuthVnce = 0;
//      $RFC_Location_066_068::RFC_Loc068_RadialVelocityVnce = 0;
//      $RFC_Location_066_068::RFC_Loc068_RadarCrossSection = -102.4;
//      $RFC_Location_066_068::RFC_Loc068_RSSI = 0;
//      $RFC_Location_066_068::RFC_Loc068_AzimuthalPartnerId = 0;
//      $RFC_Location_066_068::RFC_Loc068_RadialDistance = 0;
//      $RFC_Location_066_068::RFC_Loc068_RadialVelocity = -163.84;
//      $RFC_Location_066_068::RFC_Loc068_Elevation = -51.2;
//      $RFC_Location_066_068::RFC_Loc068_Azimuth = -102.4;
//      break;
      
//    case 69:
//      $RFC_Location_069_071::RFC_Loc069_RadialDistanceVnce = 0;
//      $RFC_Location_069_071::RFC_Loc069_DistVelocityCoVnce = -0.1024;
//      $RFC_Location_069_071::RFC_Loc069_DistVelocityQuality = 0;
//      $RFC_Location_069_071::RFC_Loc069_ElevationQuality = 0;
//      $RFC_Location_069_071::RFC_Loc069_ElevationVnce = 0;
//      $RFC_Location_069_071::RFC_Loc069_AzimuthQuality = 0;
//      $RFC_Location_069_071::RFC_Loc069_AzimuthVnce = 0;
//      $RFC_Location_069_071::RFC_Loc069_RadialVelocityVnce = 0;
//      $RFC_Location_069_071::RFC_Loc069_RadarCrossSection = -102.4;
//      $RFC_Location_069_071::RFC_Loc069_RSSI = 0;
//      $RFC_Location_069_071::RFC_Loc069_AzimuthalPartnerId = 0;
//      $RFC_Location_069_071::RFC_Loc069_RadialDistance = 0;
//      $RFC_Location_069_071::RFC_Loc069_RadialVelocity = -163.84;
//      $RFC_Location_069_071::RFC_Loc069_Elevation = -51.2;
//      $RFC_Location_069_071::RFC_Loc069_Azimuth = -102.4;
//      break;
      
//    case 70:
//      $RFC_Location_069_071::RFC_Loc070_RadialDistanceVnce = 0;
//      $RFC_Location_069_071::RFC_Loc070_DistVelocityCoVnce = -0.1024;
//      $RFC_Location_069_071::RFC_Loc070_DistVelocityQuality = 0;
//      $RFC_Location_069_071::RFC_Loc070_ElevationQuality = 0;
//      $RFC_Location_069_071::RFC_Loc070_ElevationVnce = 0;
//      $RFC_Location_069_071::RFC_Loc070_AzimuthQuality = 0;
//      $RFC_Location_069_071::RFC_Loc070_AzimuthVnce = 0;
//      $RFC_Location_069_071::RFC_Loc070_RadialVelocityVnce = 0;
//      $RFC_Location_069_071::RFC_Loc070_RadarCrossSection = -102.4;
//      $RFC_Location_069_071::RFC_Loc070_RSSI = 0;
//      $RFC_Location_069_071::RFC_Loc070_AzimuthalPartnerId = 0;
//      $RFC_Location_069_071::RFC_Loc070_RadialDistance = 0;
//      $RFC_Location_069_071::RFC_Loc070_RadialVelocity = -163.84;
//      $RFC_Location_069_071::RFC_Loc070_Elevation = -51.2;
//      $RFC_Location_069_071::RFC_Loc070_Azimuth = -102.4;
//      break;
      
//    case 71:
//      $RFC_Location_069_071::RFC_Loc071_RadialDistanceVnce = 0;
//      $RFC_Location_069_071::RFC_Loc071_DistVelocityCoVnce = -0.1024;
//      $RFC_Location_069_071::RFC_Loc071_DistVelocityQuality = 0;
//      $RFC_Location_069_071::RFC_Loc071_ElevationQuality = 0;
//      $RFC_Location_069_071::RFC_Loc071_ElevationVnce = 0;
//      $RFC_Location_069_071::RFC_Loc071_AzimuthQuality = 0;
//      $RFC_Location_069_071::RFC_Loc071_AzimuthVnce = 0;
//      $RFC_Location_069_071::RFC_Loc071_RadialVelocityVnce = 0;
//      $RFC_Location_069_071::RFC_Loc071_RadarCrossSection = -102.4;
//      $RFC_Location_069_071::RFC_Loc071_RSSI = 0;
//      $RFC_Location_069_071::RFC_Loc071_AzimuthalPartnerId = 0;
//      $RFC_Location_069_071::RFC_Loc071_RadialDistance = 0;
//      $RFC_Location_069_071::RFC_Loc071_RadialVelocity = -163.84;
//      $RFC_Location_069_071::RFC_Loc071_Elevation = -51.2;
//      $RFC_Location_069_071::RFC_Loc071_Azimuth = -102.4;
//      break;
      
//    case 72:
//      $RFC_Location_072_074::RFC_Loc072_RadialDistanceVnce = 0;
//      $RFC_Location_072_074::RFC_Loc072_DistVelocityCoVnce = -0.1024;
//      $RFC_Location_072_074::RFC_Loc072_DistVelocityQuality = 0;
//      $RFC_Location_072_074::RFC_Loc072_ElevationQuality = 0;
//      $RFC_Location_072_074::RFC_Loc072_ElevationVnce = 0;
//      $RFC_Location_072_074::RFC_Loc072_AzimuthQuality = 0;
//      $RFC_Location_072_074::RFC_Loc072_AzimuthVnce = 0;
//      $RFC_Location_072_074::RFC_Loc072_RadialVelocityVnce = 0;
//      $RFC_Location_072_074::RFC_Loc072_RadarCrossSection = -102.4;
//      $RFC_Location_072_074::RFC_Loc072_RSSI = 0;
//      $RFC_Location_072_074::RFC_Loc072_AzimuthalPartnerId = 0;
//      $RFC_Location_072_074::RFC_Loc072_RadialDistance = 0;
//      $RFC_Location_072_074::RFC_Loc072_RadialVelocity = -163.84;
//      $RFC_Location_072_074::RFC_Loc072_Elevation = -51.2;
//      $RFC_Location_072_074::RFC_Loc072_Azimuth = -102.4;
//      break;
      
//    case 73:
//      $RFC_Location_072_074::RFC_Loc073_RadialDistanceVnce = 0;
//      $RFC_Location_072_074::RFC_Loc073_DistVelocityCoVnce = -0.1024;
//      $RFC_Location_072_074::RFC_Loc073_DistVelocityQuality = 0;
//      $RFC_Location_072_074::RFC_Loc073_ElevationQuality = 0;
//      $RFC_Location_072_074::RFC_Loc073_ElevationVnce = 0;
//      $RFC_Location_072_074::RFC_Loc073_AzimuthQuality = 0;
//      $RFC_Location_072_074::RFC_Loc073_AzimuthVnce = 0;
//      $RFC_Location_072_074::RFC_Loc073_RadialVelocityVnce = 0;
//      $RFC_Location_072_074::RFC_Loc073_RadarCrossSection = -102.4;
//      $RFC_Location_072_074::RFC_Loc073_RSSI = 0;
//      $RFC_Location_072_074::RFC_Loc073_AzimuthalPartnerId = 0;
//      $RFC_Location_072_074::RFC_Loc073_RadialDistance = 0;
//      $RFC_Location_072_074::RFC_Loc073_RadialVelocity = -163.84;
//      $RFC_Location_072_074::RFC_Loc073_Elevation = -51.2;
//      $RFC_Location_072_074::RFC_Loc073_Azimuth = -102.4;
//      break;
      
//    case 74:
//      $RFC_Location_072_074::RFC_Loc074_RadialDistanceVnce = 0;
//      $RFC_Location_072_074::RFC_Loc074_DistVelocityCoVnce = -0.1024;
//      $RFC_Location_072_074::RFC_Loc074_DistVelocityQuality = 0;
//      $RFC_Location_072_074::RFC_Loc074_ElevationQuality = 0;
//      $RFC_Location_072_074::RFC_Loc074_ElevationVnce = 0;
//      $RFC_Location_072_074::RFC_Loc074_AzimuthQuality = 0;
//      $RFC_Location_072_074::RFC_Loc074_AzimuthVnce = 0;
//      $RFC_Location_072_074::RFC_Loc074_RadialVelocityVnce = 0;
//      $RFC_Location_072_074::RFC_Loc074_RadarCrossSection = -102.4;
//      $RFC_Location_072_074::RFC_Loc074_RSSI = 0;
//      $RFC_Location_072_074::RFC_Loc074_AzimuthalPartnerId = 0;
//      $RFC_Location_072_074::RFC_Loc074_RadialDistance = 0;
//      $RFC_Location_072_074::RFC_Loc074_RadialVelocity = -163.84;
//      $RFC_Location_072_074::RFC_Loc074_Elevation = -51.2;
//      $RFC_Location_072_074::RFC_Loc074_Azimuth = -102.4;
//      break;
      
//    case 75:
//      $RFC_Location_075_077::RFC_Loc075_RadialDistanceVnce = 0;
//      $RFC_Location_075_077::RFC_Loc075_DistVelocityCoVnce = -0.1024;
//      $RFC_Location_075_077::RFC_Loc075_DistVelocityQuality = 0;
//      $RFC_Location_075_077::RFC_Loc075_ElevationQuality = 0;
//      $RFC_Location_075_077::RFC_Loc075_ElevationVnce = 0;
//      $RFC_Location_075_077::RFC_Loc075_AzimuthQuality = 0;
//      $RFC_Location_075_077::RFC_Loc075_AzimuthVnce = 0;
//      $RFC_Location_075_077::RFC_Loc075_RadialVelocityVnce = 0;
//      $RFC_Location_075_077::RFC_Loc075_RadarCrossSection = -102.4;
//      $RFC_Location_075_077::RFC_Loc075_RSSI = 0;
//      $RFC_Location_075_077::RFC_Loc075_AzimuthalPartnerId = 0;
//      $RFC_Location_075_077::RFC_Loc075_RadialDistance = 0;
//      $RFC_Location_075_077::RFC_Loc075_RadialVelocity = -163.84;
//      $RFC_Location_075_077::RFC_Loc075_Elevation = -51.2;
//      $RFC_Location_075_077::RFC_Loc075_Azimuth = -102.4;
//      break;
      
//    case 76:
//      $RFC_Location_075_077::RFC_Loc076_RadialDistanceVnce = 0;
//      $RFC_Location_075_077::RFC_Loc076_DistVelocityCoVnce = -0.1024;
//      $RFC_Location_075_077::RFC_Loc076_DistVelocityQuality = 0;
//      $RFC_Location_075_077::RFC_Loc076_ElevationQuality = 0;
//      $RFC_Location_075_077::RFC_Loc076_ElevationVnce = 0;
//      $RFC_Location_075_077::RFC_Loc076_AzimuthQuality = 0;
//      $RFC_Location_075_077::RFC_Loc076_AzimuthVnce = 0;
//      $RFC_Location_075_077::RFC_Loc076_RadialVelocityVnce = 0;
//      $RFC_Location_075_077::RFC_Loc076_RadarCrossSection = -102.4;
//      $RFC_Location_075_077::RFC_Loc076_RSSI = 0;
//      $RFC_Location_075_077::RFC_Loc076_AzimuthalPartnerId = 0;
//      $RFC_Location_075_077::RFC_Loc076_RadialDistance = 0;
//      $RFC_Location_075_077::RFC_Loc076_RadialVelocity = -163.84;
//      $RFC_Location_075_077::RFC_Loc076_Elevation = -51.2;
//      $RFC_Location_075_077::RFC_Loc076_Azimuth = -102.4;
//      break;
      
//    case 77:
//      $RFC_Location_075_077::RFC_Loc077_RadialDistanceVnce = 0;
//      $RFC_Location_075_077::RFC_Loc077_DistVelocityCoVnce = -0.1024;
//      $RFC_Location_075_077::RFC_Loc077_DistVelocityQuality = 0;
//      $RFC_Location_075_077::RFC_Loc077_ElevationQuality = 0;
//      $RFC_Location_075_077::RFC_Loc077_ElevationVnce = 0;
//      $RFC_Location_075_077::RFC_Loc077_AzimuthQuality = 0;
//      $RFC_Location_075_077::RFC_Loc077_AzimuthVnce = 0;
//      $RFC_Location_075_077::RFC_Loc077_RadialVelocityVnce = 0;
//      $RFC_Location_075_077::RFC_Loc077_RadarCrossSection = -102.4;
//      $RFC_Location_075_077::RFC_Loc077_RSSI = 0;
//      $RFC_Location_075_077::RFC_Loc077_AzimuthalPartnerId = 0;
//      $RFC_Location_075_077::RFC_Loc077_RadialDistance = 0;
//      $RFC_Location_075_077::RFC_Loc077_RadialVelocity = -163.84;
//      $RFC_Location_075_077::RFC_Loc077_Elevation = -51.2;
//      $RFC_Location_075_077::RFC_Loc077_Azimuth = -102.4;
//      break;
      
//    case 78:
//      $RFC_Location_078_080::RFC_Loc078_RadialDistanceVnce = 0;
//      $RFC_Location_078_080::RFC_Loc078_DistVelocityCoVnce = -0.1024;
//      $RFC_Location_078_080::RFC_Loc078_DistVelocityQuality = 0;
//      $RFC_Location_078_080::RFC_Loc078_ElevationQuality = 0;
//      $RFC_Location_078_080::RFC_Loc078_ElevationVnce = 0;
//      $RFC_Location_078_080::RFC_Loc078_AzimuthQuality = 0;
//      $RFC_Location_078_080::RFC_Loc078_AzimuthVnce = 0;
//      $RFC_Location_078_080::RFC_Loc078_RadialVelocityVnce = 0;
//      $RFC_Location_078_080::RFC_Loc078_RadarCrossSection = -102.4;
//      $RFC_Location_078_080::RFC_Loc078_RSSI = 0;
//      $RFC_Location_078_080::RFC_Loc078_AzimuthalPartnerId = 0;
//      $RFC_Location_078_080::RFC_Loc078_RadialDistance = 0;
//      $RFC_Location_078_080::RFC_Loc078_RadialVelocity = -163.84;
//      $RFC_Location_078_080::RFC_Loc078_Elevation = -51.2;
//      $RFC_Location_078_080::RFC_Loc078_Azimuth = -102.4;
//      break;
      
//    case 79:
//      $RFC_Location_078_080::RFC_Loc079_RadialDistanceVnce = 0;
//      $RFC_Location_078_080::RFC_Loc079_DistVelocityCoVnce = -0.1024;
//      $RFC_Location_078_080::RFC_Loc079_DistVelocityQuality = 0;
//      $RFC_Location_078_080::RFC_Loc079_ElevationQuality = 0;
//      $RFC_Location_078_080::RFC_Loc079_ElevationVnce = 0;
//      $RFC_Location_078_080::RFC_Loc079_AzimuthQuality = 0;
//      $RFC_Location_078_080::RFC_Loc079_AzimuthVnce = 0;
//      $RFC_Location_078_080::RFC_Loc079_RadialVelocityVnce = 0;
//      $RFC_Location_078_080::RFC_Loc079_RadarCrossSection = -102.4;
//      $RFC_Location_078_080::RFC_Loc079_RSSI = 0;
//      $RFC_Location_078_080::RFC_Loc079_AzimuthalPartnerId = 0;
//      $RFC_Location_078_080::RFC_Loc079_RadialDistance = 0;
//      $RFC_Location_078_080::RFC_Loc079_RadialVelocity = -163.84;
//      $RFC_Location_078_080::RFC_Loc079_Elevation = -51.2;
//      $RFC_Location_078_080::RFC_Loc079_Azimuth = -102.4;
//      break;
      
//    case 80:
//      $RFC_Location_078_080::RFC_Loc080_RadialDistanceVnce = 0;
//      $RFC_Location_078_080::RFC_Loc080_DistVelocityCoVnce = -0.1024;
//      $RFC_Location_078_080::RFC_Loc080_DistVelocityQuality = 0;
//      $RFC_Location_078_080::RFC_Loc080_ElevationQuality = 0;
//      $RFC_Location_078_080::RFC_Loc080_ElevationVnce = 0;
//      $RFC_Location_078_080::RFC_Loc080_AzimuthQuality = 0;
//      $RFC_Location_078_080::RFC_Loc080_AzimuthVnce = 0;
//      $RFC_Location_078_080::RFC_Loc080_RadialVelocityVnce = 0;
//      $RFC_Location_078_080::RFC_Loc080_RadarCrossSection = -102.4;
//      $RFC_Location_078_080::RFC_Loc080_RSSI = 0;
//      $RFC_Location_078_080::RFC_Loc080_AzimuthalPartnerId = 0;
//      $RFC_Location_078_080::RFC_Loc080_RadialDistance = 0;
//      $RFC_Location_078_080::RFC_Loc080_RadialVelocity = -163.84;
//      $RFC_Location_078_080::RFC_Loc080_Elevation = -51.2;
//      $RFC_Location_078_080::RFC_Loc080_Azimuth = -102.4;
//      break;
      
//    case 81:
//      $RFC_Location_081_083::RFC_Loc081_RadialDistanceVnce = 0;
//      $RFC_Location_081_083::RFC_Loc081_DistVelocityCoVnce = -0.1024;
//      $RFC_Location_081_083::RFC_Loc081_DistVelocityQuality = 0;
//      $RFC_Location_081_083::RFC_Loc081_ElevationQuality = 0;
//      $RFC_Location_081_083::RFC_Loc081_ElevationVnce = 0;
//      $RFC_Location_081_083::RFC_Loc081_AzimuthQuality = 0;
//      $RFC_Location_081_083::RFC_Loc081_AzimuthVnce = 0;
//      $RFC_Location_081_083::RFC_Loc081_RadialVelocityVnce = 0;
//      $RFC_Location_081_083::RFC_Loc081_RadarCrossSection = -102.4;
//      $RFC_Location_081_083::RFC_Loc081_RSSI = 0;
//      $RFC_Location_081_083::RFC_Loc081_AzimuthalPartnerId = 0;
//      $RFC_Location_081_083::RFC_Loc081_RadialDistance = 0;
//      $RFC_Location_081_083::RFC_Loc081_RadialVelocity = -163.84;
//      $RFC_Location_081_083::RFC_Loc081_Elevation = -51.2;
//      $RFC_Location_081_083::RFC_Loc081_Azimuth = -102.4;
//      break;
      
//    case 82:
//      $RFC_Location_081_083::RFC_Loc082_RadialDistanceVnce = 0;
//      $RFC_Location_081_083::RFC_Loc082_DistVelocityCoVnce = -0.1024;
//      $RFC_Location_081_083::RFC_Loc082_DistVelocityQuality = 0;
//      $RFC_Location_081_083::RFC_Loc082_ElevationQuality = 0;
//      $RFC_Location_081_083::RFC_Loc082_ElevationVnce = 0;
//      $RFC_Location_081_083::RFC_Loc082_AzimuthQuality = 0;
//      $RFC_Location_081_083::RFC_Loc082_AzimuthVnce = 0;
//      $RFC_Location_081_083::RFC_Loc082_RadialVelocityVnce = 0;
//      $RFC_Location_081_083::RFC_Loc082_RadarCrossSection = -102.4;
//      $RFC_Location_081_083::RFC_Loc082_RSSI = 0;
//      $RFC_Location_081_083::RFC_Loc082_AzimuthalPartnerId = 0;
//      $RFC_Location_081_083::RFC_Loc082_RadialDistance = 0;
//      $RFC_Location_081_083::RFC_Loc082_RadialVelocity = -163.84;
//      $RFC_Location_081_083::RFC_Loc082_Elevation = -51.2;
//      $RFC_Location_081_083::RFC_Loc082_Azimuth = -102.4;
//      break;
      
//    case 83:
//      $RFC_Location_081_083::RFC_Loc083_RadialDistanceVnce = 0;
//      $RFC_Location_081_083::RFC_Loc083_DistVelocityCoVnce = -0.1024;
//      $RFC_Location_081_083::RFC_Loc083_DistVelocityQuality = 0;
//      $RFC_Location_081_083::RFC_Loc083_ElevationQuality = 0;
//      $RFC_Location_081_083::RFC_Loc083_ElevationVnce = 0;
//      $RFC_Location_081_083::RFC_Loc083_AzimuthQuality = 0;
//      $RFC_Location_081_083::RFC_Loc083_AzimuthVnce = 0;
//      $RFC_Location_081_083::RFC_Loc083_RadialVelocityVnce = 0;
//      $RFC_Location_081_083::RFC_Loc083_RadarCrossSection = -102.4;
//      $RFC_Location_081_083::RFC_Loc083_RSSI = 0;
//      $RFC_Location_081_083::RFC_Loc083_AzimuthalPartnerId = 0;
//      $RFC_Location_081_083::RFC_Loc083_RadialDistance = 0;
//      $RFC_Location_081_083::RFC_Loc083_RadialVelocity = -163.84;
//      $RFC_Location_081_083::RFC_Loc083_Elevation = -51.2;
//      $RFC_Location_081_083::RFC_Loc083_Azimuth = -102.4;
//      break;
      
//    case 84:
//      $RFC_Location_084_086::RFC_Loc084_RadialDistanceVnce = 0;
//      $RFC_Location_084_086::RFC_Loc084_DistVelocityCoVnce = -0.1024;
//      $RFC_Location_084_086::RFC_Loc084_DistVelocityQuality = 0;
//      $RFC_Location_084_086::RFC_Loc084_ElevationQuality = 0;
//      $RFC_Location_084_086::RFC_Loc084_ElevationVnce = 0;
//      $RFC_Location_084_086::RFC_Loc084_AzimuthQuality = 0;
//      $RFC_Location_084_086::RFC_Loc084_AzimuthVnce = 0;
//      $RFC_Location_084_086::RFC_Loc084_RadialVelocityVnce = 0;
//      $RFC_Location_084_086::RFC_Loc084_RadarCrossSection = -102.4;
//      $RFC_Location_084_086::RFC_Loc084_RSSI = 0;
//      $RFC_Location_084_086::RFC_Loc084_AzimuthalPartnerId = 0;
//      $RFC_Location_084_086::RFC_Loc084_RadialDistance = 0;
//      $RFC_Location_084_086::RFC_Loc084_RadialVelocity = -163.84;
//      $RFC_Location_084_086::RFC_Loc084_Elevation = -51.2;
//      $RFC_Location_084_086::RFC_Loc084_Azimuth = -102.4;
//      break;
      
//    case 85:
//      $RFC_Location_084_086::RFC_Loc085_RadialDistanceVnce = 0;
//      $RFC_Location_084_086::RFC_Loc085_DistVelocityCoVnce = -0.1024;
//      $RFC_Location_084_086::RFC_Loc085_DistVelocityQuality = 0;
//      $RFC_Location_084_086::RFC_Loc085_ElevationQuality = 0;
//      $RFC_Location_084_086::RFC_Loc085_ElevationVnce = 0;
//      $RFC_Location_084_086::RFC_Loc085_AzimuthQuality = 0;
//      $RFC_Location_084_086::RFC_Loc085_AzimuthVnce = 0;
//      $RFC_Location_084_086::RFC_Loc085_RadialVelocityVnce = 0;
//      $RFC_Location_084_086::RFC_Loc085_RadarCrossSection = -102.4;
//      $RFC_Location_084_086::RFC_Loc085_RSSI = 0;
//      $RFC_Location_084_086::RFC_Loc085_AzimuthalPartnerId = 0;
//      $RFC_Location_084_086::RFC_Loc085_RadialDistance = 0;
//      $RFC_Location_084_086::RFC_Loc085_RadialVelocity = -163.84;
//      $RFC_Location_084_086::RFC_Loc085_Elevation = -51.2;
//      $RFC_Location_084_086::RFC_Loc085_Azimuth = -102.4;
//      break;
      
//    case 86:
//      $RFC_Location_084_086::RFC_Loc086_RadialDistanceVnce = 0;
//      $RFC_Location_084_086::RFC_Loc086_DistVelocityCoVnce = -0.1024;
//      $RFC_Location_084_086::RFC_Loc086_DistVelocityQuality = 0;
//      $RFC_Location_084_086::RFC_Loc086_ElevationQuality = 0;
//      $RFC_Location_084_086::RFC_Loc086_ElevationVnce = 0;
//      $RFC_Location_084_086::RFC_Loc086_AzimuthQuality = 0;
//      $RFC_Location_084_086::RFC_Loc086_AzimuthVnce = 0;
//      $RFC_Location_084_086::RFC_Loc086_RadialVelocityVnce = 0;
//      $RFC_Location_084_086::RFC_Loc086_RadarCrossSection = -102.4;
//      $RFC_Location_084_086::RFC_Loc086_RSSI = 0;
//      $RFC_Location_084_086::RFC_Loc086_AzimuthalPartnerId = 0;
//      $RFC_Location_084_086::RFC_Loc086_RadialDistance = 0;
//      $RFC_Location_084_086::RFC_Loc086_RadialVelocity = -163.84;
//      $RFC_Location_084_086::RFC_Loc086_Elevation = -51.2;
//      $RFC_Location_084_086::RFC_Loc086_Azimuth = -102.4;
//      break;
      
//    case 87:
//      $RFC_Location_087_089::RFC_Loc087_RadialDistanceVnce = 0;
//      $RFC_Location_087_089::RFC_Loc087_DistVelocityCoVnce = -0.1024;
//      $RFC_Location_087_089::RFC_Loc087_DistVelocityQuality = 0;
//      $RFC_Location_087_089::RFC_Loc087_ElevationQuality = 0;
//      $RFC_Location_087_089::RFC_Loc087_ElevationVnce = 0;
//      $RFC_Location_087_089::RFC_Loc087_AzimuthQuality = 0;
//      $RFC_Location_087_089::RFC_Loc087_AzimuthVnce = 0;
//      $RFC_Location_087_089::RFC_Loc087_RadialVelocityVnce = 0;
//      $RFC_Location_087_089::RFC_Loc087_RadarCrossSection = -102.4;
//      $RFC_Location_087_089::RFC_Loc087_RSSI = 0;
//      $RFC_Location_087_089::RFC_Loc087_AzimuthalPartnerId = 0;
//      $RFC_Location_087_089::RFC_Loc087_RadialDistance = 0;
//      $RFC_Location_087_089::RFC_Loc087_RadialVelocity = -163.84;
//      $RFC_Location_087_089::RFC_Loc087_Elevation = -51.2;
//      $RFC_Location_087_089::RFC_Loc087_Azimuth = -102.4;
//      break;
      
//    case 88:
//      $RFC_Location_087_089::RFC_Loc088_RadialDistanceVnce = 0;
//      $RFC_Location_087_089::RFC_Loc088_DistVelocityCoVnce = -0.1024;
//      $RFC_Location_087_089::RFC_Loc088_DistVelocityQuality = 0;
//      $RFC_Location_087_089::RFC_Loc088_ElevationQuality = 0;
//      $RFC_Location_087_089::RFC_Loc088_ElevationVnce = 0;
//      $RFC_Location_087_089::RFC_Loc088_AzimuthQuality = 0;
//      $RFC_Location_087_089::RFC_Loc088_AzimuthVnce = 0;
//      $RFC_Location_087_089::RFC_Loc088_RadialVelocityVnce = 0;
//      $RFC_Location_087_089::RFC_Loc088_RadarCrossSection = -102.4;
//      $RFC_Location_087_089::RFC_Loc088_RSSI = 0;
//      $RFC_Location_087_089::RFC_Loc088_AzimuthalPartnerId = 0;
//      $RFC_Location_087_089::RFC_Loc088_RadialDistance = 0;
//      $RFC_Location_087_089::RFC_Loc088_RadialVelocity = -163.84;
//      $RFC_Location_087_089::RFC_Loc088_Elevation = -51.2;
//      $RFC_Location_087_089::RFC_Loc088_Azimuth = -102.4;
//      break;
      
//    case 89:
//      $RFC_Location_087_089::RFC_Loc089_RadialDistanceVnce = 0;
//      $RFC_Location_087_089::RFC_Loc089_DistVelocityCoVnce = -0.1024;
//      $RFC_Location_087_089::RFC_Loc089_DistVelocityQuality = 0;
//      $RFC_Location_087_089::RFC_Loc089_ElevationQuality = 0;
//      $RFC_Location_087_089::RFC_Loc089_ElevationVnce = 0;
//      $RFC_Location_087_089::RFC_Loc089_AzimuthQuality = 0;
//      $RFC_Location_087_089::RFC_Loc089_AzimuthVnce = 0;
//      $RFC_Location_087_089::RFC_Loc089_RadialVelocityVnce = 0;
//      $RFC_Location_087_089::RFC_Loc089_RadarCrossSection = -102.4;
//      $RFC_Location_087_089::RFC_Loc089_RSSI = 0;
//      $RFC_Location_087_089::RFC_Loc089_AzimuthalPartnerId = 0;
//      $RFC_Location_087_089::RFC_Loc089_RadialDistance = 0;
//      $RFC_Location_087_089::RFC_Loc089_RadialVelocity = -163.84;
//      $RFC_Location_087_089::RFC_Loc089_Elevation = -51.2;
//      $RFC_Location_087_089::RFC_Loc089_Azimuth = -102.4;
//      break;
      
//  }
//}

/** @brief Sets the signals to raw value 0 of the object which deletes it on xcp.
  * @param object_id ID of the object that shall be deleted.
  * @return void
  */
void delete_radar_fc_xcp(byte object_id)
{
  target_counter_radar_fc = 0;
  injection_counter_radar_fc = -1;
  
  for(target_counter_radar_fc = 0; target_counter_radar_fc <= object_id; target_counter_radar_fc++){
    if(@target_radar_fc_sim::objdata.empty_obj[target_counter_radar_fc] == 0 || target_counter_radar_fc == object_id){
      injection_counter_radar_fc++;
    }
  }
  
    switch (injection_counter_radar_fc)
    {
      case 0: //"Object-0"
        @sysvar::XCP::RadarFC_Loc::_g_PL_AD_fw_Radar_1R1V_rpc_LocBypassingRunnable_LocBypassingRunnable_m_pad_ensRLocationsPort_par_out_local::TChangeableMemPool::_::_::_m_arrayPool::_0_::_elem::_m_LocationList::_Item::_0_::_dVar::_m_value = 0;
        @sysvar::XCP::RadarFC_Loc::_g_PL_AD_fw_Radar_1R1V_rpc_LocBypassingRunnable_LocBypassingRunnable_m_pad_ensRLocationsPort_par_out_local::TChangeableMemPool::_::_::_m_arrayPool::_0_::_elem::_m_LocationList::_Item::_0_::_dvCov::_m_value = 0;
        @sysvar::XCP::RadarFC_Loc::_g_PL_AD_fw_Radar_1R1V_rpc_LocBypassingRunnable_LocBypassingRunnable_m_pad_ensRLocationsPort_par_out_local::TChangeableMemPool::_::_::_m_arrayPool::_0_::_elem::_m_LocationList::_Item::_0_::_dvQly = 0;
        @sysvar::XCP::RadarFC_Loc::_g_PL_AD_fw_Radar_1R1V_rpc_LocBypassingRunnable_LocBypassingRunnable_m_pad_ensRLocationsPort_par_out_local::TChangeableMemPool::_::_::_m_arrayPool::_0_::_elem::_m_LocationList::_Item::_0_::_phiQly = 0;
        @sysvar::XCP::RadarFC_Loc::_g_PL_AD_fw_Radar_1R1V_rpc_LocBypassingRunnable_LocBypassingRunnable_m_pad_ensRLocationsPort_par_out_local::TChangeableMemPool::_::_::_m_arrayPool::_0_::_elem::_m_LocationList::_Item::_0_::_phiVar::_m_value = 0;
        @sysvar::XCP::RadarFC_Loc::_g_PL_AD_fw_Radar_1R1V_rpc_LocBypassingRunnable_LocBypassingRunnable_m_pad_ensRLocationsPort_par_out_local::TChangeableMemPool::_::_::_m_arrayPool::_0_::_elem::_m_LocationList::_Item::_0_::_thetaQly = 0;
        @sysvar::XCP::RadarFC_Loc::_g_PL_AD_fw_Radar_1R1V_rpc_LocBypassingRunnable_LocBypassingRunnable_m_pad_ensRLocationsPort_par_out_local::TChangeableMemPool::_::_::_m_arrayPool::_0_::_elem::_m_LocationList::_Item::_0_::_thetaVar::_m_value = 0;
        @sysvar::XCP::RadarFC_Loc::_g_PL_AD_fw_Radar_1R1V_rpc_LocBypassingRunnable_LocBypassingRunnable_m_pad_ensRLocationsPort_par_out_local::TChangeableMemPool::_::_::_m_arrayPool::_0_::_elem::_m_LocationList::_Item::_0_::_vVar::_m_value = 0;
        @sysvar::XCP::RadarFC_Loc::_g_PL_AD_fw_Radar_1R1V_rpc_LocBypassingRunnable_LocBypassingRunnable_m_pad_ensRLocationsPort_par_out_local::TChangeableMemPool::_::_::_m_arrayPool::_0_::_elem::_m_LocationList::_Item::_0_::_Rssi::_m_value = 0;
        @sysvar::XCP::RadarFC_Loc::_g_PL_AD_fw_Radar_1R1V_rpc_LocBypassingRunnable_LocBypassingRunnable_m_pad_ensRLocationsPort_par_out_local::TChangeableMemPool::_::_::_m_arrayPool::_0_::_elem::_m_LocationList::_Item::_0_::_idxAzimuthAmbiguityPeer = 0;
        @sysvar::XCP::RadarFC_Loc::_g_PL_AD_fw_Radar_1R1V_rpc_LocBypassingRunnable_LocBypassingRunnable_m_pad_ensRLocationsPort_par_out_local::TChangeableMemPool::_::_::_m_arrayPool::_0_::_elem::_m_LocationList::_Item::_0_::_measStatus = 0;
        @sysvar::XCP::RadarFC_Loc::_g_PL_AD_fw_Radar_1R1V_rpc_LocBypassingRunnable_LocBypassingRunnable_m_pad_ensRLocationsPort_par_out_local::TChangeableMemPool::_::_::_m_arrayPool::_0_::_elem::_m_LocationList::_Item::_0_::_d = 0;
        @sysvar::XCP::RadarFC_Loc::_g_PL_AD_fw_Radar_1R1V_rpc_LocBypassingRunnable_LocBypassingRunnable_m_pad_ensRLocationsPort_par_out_local::TChangeableMemPool::_::_::_m_arrayPool::_0_::_elem::_m_LocationList::_Item::_0_::_v = 0;
        @sysvar::XCP::RadarFC_Loc::_g_PL_AD_fw_Radar_1R1V_rpc_LocBypassingRunnable_LocBypassingRunnable_m_pad_ensRLocationsPort_par_out_local::TChangeableMemPool::_::_::_m_arrayPool::_0_::_elem::_m_LocationList::_Item::_0_::_phi::_m_value = 0;
        @sysvar::XCP::RadarFC_Loc::_g_PL_AD_fw_Radar_1R1V_rpc_LocBypassingRunnable_LocBypassingRunnable_m_pad_ensRLocationsPort_par_out_local::TChangeableMemPool::_::_::_m_arrayPool::_0_::_elem::_m_LocationList::_Item::_0_::_theta::_m_value = 0;
        @sysvar::XCP::RadarFC_Loc::_g_PL_AD_fw_Radar_1R1V_rpc_LocBypassingRunnable_LocBypassingRunnable_m_pad_ensRLocationsPort_par_out_local::TChangeableMemPool::_::_::_m_arrayPool::_0_::_elem::_m_LocationList::_Item::_0_::_Rcs::_m_value = 0;
        break;
        
      case 1: //"Object-1"
        @sysvar::XCP::RadarFC_Loc::_g_PL_AD_fw_Radar_1R1V_rpc_LocBypassingRunnable_LocBypassingRunnable_m_pad_ensRLocationsPort_par_out_local::TChangeableMemPool::_::_::_m_arrayPool::_0_::_elem::_m_LocationList::_Item::_1_::_dVar::_m_value = 0;
        @sysvar::XCP::RadarFC_Loc::_g_PL_AD_fw_Radar_1R1V_rpc_LocBypassingRunnable_LocBypassingRunnable_m_pad_ensRLocationsPort_par_out_local::TChangeableMemPool::_::_::_m_arrayPool::_0_::_elem::_m_LocationList::_Item::_1_::_dvCov::_m_value = 0;
        @sysvar::XCP::RadarFC_Loc::_g_PL_AD_fw_Radar_1R1V_rpc_LocBypassingRunnable_LocBypassingRunnable_m_pad_ensRLocationsPort_par_out_local::TChangeableMemPool::_::_::_m_arrayPool::_0_::_elem::_m_LocationList::_Item::_1_::_dvQly = 0;
        @sysvar::XCP::RadarFC_Loc::_g_PL_AD_fw_Radar_1R1V_rpc_LocBypassingRunnable_LocBypassingRunnable_m_pad_ensRLocationsPort_par_out_local::TChangeableMemPool::_::_::_m_arrayPool::_0_::_elem::_m_LocationList::_Item::_1_::_phiQly = 0;
        @sysvar::XCP::RadarFC_Loc::_g_PL_AD_fw_Radar_1R1V_rpc_LocBypassingRunnable_LocBypassingRunnable_m_pad_ensRLocationsPort_par_out_local::TChangeableMemPool::_::_::_m_arrayPool::_0_::_elem::_m_LocationList::_Item::_1_::_phiVar::_m_value = 0;
        @sysvar::XCP::RadarFC_Loc::_g_PL_AD_fw_Radar_1R1V_rpc_LocBypassingRunnable_LocBypassingRunnable_m_pad_ensRLocationsPort_par_out_local::TChangeableMemPool::_::_::_m_arrayPool::_0_::_elem::_m_LocationList::_Item::_1_::_thetaQly = 0;
        @sysvar::XCP::RadarFC_Loc::_g_PL_AD_fw_Radar_1R1V_rpc_LocBypassingRunnable_LocBypassingRunnable_m_pad_ensRLocationsPort_par_out_local::TChangeableMemPool::_::_::_m_arrayPool::_0_::_elem::_m_LocationList::_Item::_1_::_thetaVar::_m_value = 0;
        @sysvar::XCP::RadarFC_Loc::_g_PL_AD_fw_Radar_1R1V_rpc_LocBypassingRunnable_LocBypassingRunnable_m_pad_ensRLocationsPort_par_out_local::TChangeableMemPool::_::_::_m_arrayPool::_0_::_elem::_m_LocationList::_Item::_1_::_vVar::_m_value = 0;
        @sysvar::XCP::RadarFC_Loc::_g_PL_AD_fw_Radar_1R1V_rpc_LocBypassingRunnable_LocBypassingRunnable_m_pad_ensRLocationsPort_par_out_local::TChangeableMemPool::_::_::_m_arrayPool::_0_::_elem::_m_LocationList::_Item::_1_::_Rssi::_m_value = 0;
        @sysvar::XCP::RadarFC_Loc::_g_PL_AD_fw_Radar_1R1V_rpc_LocBypassingRunnable_LocBypassingRunnable_m_pad_ensRLocationsPort_par_out_local::TChangeableMemPool::_::_::_m_arrayPool::_0_::_elem::_m_LocationList::_Item::_1_::_idxAzimuthAmbiguityPeer = 0;
        @sysvar::XCP::RadarFC_Loc::_g_PL_AD_fw_Radar_1R1V_rpc_LocBypassingRunnable_LocBypassingRunnable_m_pad_ensRLocationsPort_par_out_local::TChangeableMemPool::_::_::_m_arrayPool::_0_::_elem::_m_LocationList::_Item::_1_::_measStatus = 0;
        @sysvar::XCP::RadarFC_Loc::_g_PL_AD_fw_Radar_1R1V_rpc_LocBypassingRunnable_LocBypassingRunnable_m_pad_ensRLocationsPort_par_out_local::TChangeableMemPool::_::_::_m_arrayPool::_0_::_elem::_m_LocationList::_Item::_1_::_d = 0;
        @sysvar::XCP::RadarFC_Loc::_g_PL_AD_fw_Radar_1R1V_rpc_LocBypassingRunnable_LocBypassingRunnable_m_pad_ensRLocationsPort_par_out_local::TChangeableMemPool::_::_::_m_arrayPool::_0_::_elem::_m_LocationList::_Item::_1_::_v = 0;
        @sysvar::XCP::RadarFC_Loc::_g_PL_AD_fw_Radar_1R1V_rpc_LocBypassingRunnable_LocBypassingRunnable_m_pad_ensRLocationsPort_par_out_local::TChangeableMemPool::_::_::_m_arrayPool::_0_::_elem::_m_LocationList::_Item::_1_::_phi::_m_value = 0;
        @sysvar::XCP::RadarFC_Loc::_g_PL_AD_fw_Radar_1R1V_rpc_LocBypassingRunnable_LocBypassingRunnable_m_pad_ensRLocationsPort_par_out_local::TChangeableMemPool::_::_::_m_arrayPool::_0_::_elem::_m_LocationList::_Item::_1_::_theta::_m_value = 0;
        @sysvar::XCP::RadarFC_Loc::_g_PL_AD_fw_Radar_1R1V_rpc_LocBypassingRunnable_LocBypassingRunnable_m_pad_ensRLocationsPort_par_out_local::TChangeableMemPool::_::_::_m_arrayPool::_0_::_elem::_m_LocationList::_Item::_1_::_Rcs::_m_value = 0;
        break;
        
      case 2: //"Object-2"
        @sysvar::XCP::RadarFC_Loc::_g_PL_AD_fw_Radar_1R1V_rpc_LocBypassingRunnable_LocBypassingRunnable_m_pad_ensRLocationsPort_par_out_local::TChangeableMemPool::_::_::_m_arrayPool::_0_::_elem::_m_LocationList::_Item::_2_::_dVar::_m_value = 0;
        @sysvar::XCP::RadarFC_Loc::_g_PL_AD_fw_Radar_1R1V_rpc_LocBypassingRunnable_LocBypassingRunnable_m_pad_ensRLocationsPort_par_out_local::TChangeableMemPool::_::_::_m_arrayPool::_0_::_elem::_m_LocationList::_Item::_2_::_dvCov::_m_value = 0;
        @sysvar::XCP::RadarFC_Loc::_g_PL_AD_fw_Radar_1R1V_rpc_LocBypassingRunnable_LocBypassingRunnable_m_pad_ensRLocationsPort_par_out_local::TChangeableMemPool::_::_::_m_arrayPool::_0_::_elem::_m_LocationList::_Item::_2_::_dvQly = 0;
        @sysvar::XCP::RadarFC_Loc::_g_PL_AD_fw_Radar_1R1V_rpc_LocBypassingRunnable_LocBypassingRunnable_m_pad_ensRLocationsPort_par_out_local::TChangeableMemPool::_::_::_m_arrayPool::_0_::_elem::_m_LocationList::_Item::_2_::_phiQly = 0;
        @sysvar::XCP::RadarFC_Loc::_g_PL_AD_fw_Radar_1R1V_rpc_LocBypassingRunnable_LocBypassingRunnable_m_pad_ensRLocationsPort_par_out_local::TChangeableMemPool::_::_::_m_arrayPool::_0_::_elem::_m_LocationList::_Item::_2_::_phiVar::_m_value = 0;
        @sysvar::XCP::RadarFC_Loc::_g_PL_AD_fw_Radar_1R1V_rpc_LocBypassingRunnable_LocBypassingRunnable_m_pad_ensRLocationsPort_par_out_local::TChangeableMemPool::_::_::_m_arrayPool::_0_::_elem::_m_LocationList::_Item::_2_::_thetaQly = 0;
        @sysvar::XCP::RadarFC_Loc::_g_PL_AD_fw_Radar_1R1V_rpc_LocBypassingRunnable_LocBypassingRunnable_m_pad_ensRLocationsPort_par_out_local::TChangeableMemPool::_::_::_m_arrayPool::_0_::_elem::_m_LocationList::_Item::_2_::_thetaVar::_m_value = 0;
        @sysvar::XCP::RadarFC_Loc::_g_PL_AD_fw_Radar_1R1V_rpc_LocBypassingRunnable_LocBypassingRunnable_m_pad_ensRLocationsPort_par_out_local::TChangeableMemPool::_::_::_m_arrayPool::_0_::_elem::_m_LocationList::_Item::_2_::_vVar::_m_value = 0;
        @sysvar::XCP::RadarFC_Loc::_g_PL_AD_fw_Radar_1R1V_rpc_LocBypassingRunnable_LocBypassingRunnable_m_pad_ensRLocationsPort_par_out_local::TChangeableMemPool::_::_::_m_arrayPool::_0_::_elem::_m_LocationList::_Item::_2_::_Rssi::_m_value = 0;
        @sysvar::XCP::RadarFC_Loc::_g_PL_AD_fw_Radar_1R1V_rpc_LocBypassingRunnable_LocBypassingRunnable_m_pad_ensRLocationsPort_par_out_local::TChangeableMemPool::_::_::_m_arrayPool::_0_::_elem::_m_LocationList::_Item::_2_::_idxAzimuthAmbiguityPeer = 0;
        @sysvar::XCP::RadarFC_Loc::_g_PL_AD_fw_Radar_1R1V_rpc_LocBypassingRunnable_LocBypassingRunnable_m_pad_ensRLocationsPort_par_out_local::TChangeableMemPool::_::_::_m_arrayPool::_0_::_elem::_m_LocationList::_Item::_2_::_measStatus = 0;
        @sysvar::XCP::RadarFC_Loc::_g_PL_AD_fw_Radar_1R1V_rpc_LocBypassingRunnable_LocBypassingRunnable_m_pad_ensRLocationsPort_par_out_local::TChangeableMemPool::_::_::_m_arrayPool::_0_::_elem::_m_LocationList::_Item::_2_::_d = 0;
        @sysvar::XCP::RadarFC_Loc::_g_PL_AD_fw_Radar_1R1V_rpc_LocBypassingRunnable_LocBypassingRunnable_m_pad_ensRLocationsPort_par_out_local::TChangeableMemPool::_::_::_m_arrayPool::_0_::_elem::_m_LocationList::_Item::_2_::_v = 0;
        @sysvar::XCP::RadarFC_Loc::_g_PL_AD_fw_Radar_1R1V_rpc_LocBypassingRunnable_LocBypassingRunnable_m_pad_ensRLocationsPort_par_out_local::TChangeableMemPool::_::_::_m_arrayPool::_0_::_elem::_m_LocationList::_Item::_2_::_phi::_m_value = 0;
        @sysvar::XCP::RadarFC_Loc::_g_PL_AD_fw_Radar_1R1V_rpc_LocBypassingRunnable_LocBypassingRunnable_m_pad_ensRLocationsPort_par_out_local::TChangeableMemPool::_::_::_m_arrayPool::_0_::_elem::_m_LocationList::_Item::_2_::_theta::_m_value = 0;
        @sysvar::XCP::RadarFC_Loc::_g_PL_AD_fw_Radar_1R1V_rpc_LocBypassingRunnable_LocBypassingRunnable_m_pad_ensRLocationsPort_par_out_local::TChangeableMemPool::_::_::_m_arrayPool::_0_::_elem::_m_LocationList::_Item::_2_::_Rcs::_m_value = 0;
        break;
        
      case 3: //"Object-3"
        @sysvar::XCP::RadarFC_Loc::_g_PL_AD_fw_Radar_1R1V_rpc_LocBypassingRunnable_LocBypassingRunnable_m_pad_ensRLocationsPort_par_out_local::TChangeableMemPool::_::_::_m_arrayPool::_0_::_elem::_m_LocationList::_Item::_3_::_dVar::_m_value = 0;
        @sysvar::XCP::RadarFC_Loc::_g_PL_AD_fw_Radar_1R1V_rpc_LocBypassingRunnable_LocBypassingRunnable_m_pad_ensRLocationsPort_par_out_local::TChangeableMemPool::_::_::_m_arrayPool::_0_::_elem::_m_LocationList::_Item::_3_::_dvCov::_m_value = 0;
        @sysvar::XCP::RadarFC_Loc::_g_PL_AD_fw_Radar_1R1V_rpc_LocBypassingRunnable_LocBypassingRunnable_m_pad_ensRLocationsPort_par_out_local::TChangeableMemPool::_::_::_m_arrayPool::_0_::_elem::_m_LocationList::_Item::_3_::_dvQly = 0;
        @sysvar::XCP::RadarFC_Loc::_g_PL_AD_fw_Radar_1R1V_rpc_LocBypassingRunnable_LocBypassingRunnable_m_pad_ensRLocationsPort_par_out_local::TChangeableMemPool::_::_::_m_arrayPool::_0_::_elem::_m_LocationList::_Item::_3_::_phiQly = 0;
        @sysvar::XCP::RadarFC_Loc::_g_PL_AD_fw_Radar_1R1V_rpc_LocBypassingRunnable_LocBypassingRunnable_m_pad_ensRLocationsPort_par_out_local::TChangeableMemPool::_::_::_m_arrayPool::_0_::_elem::_m_LocationList::_Item::_3_::_phiVar::_m_value = 0;
        @sysvar::XCP::RadarFC_Loc::_g_PL_AD_fw_Radar_1R1V_rpc_LocBypassingRunnable_LocBypassingRunnable_m_pad_ensRLocationsPort_par_out_local::TChangeableMemPool::_::_::_m_arrayPool::_0_::_elem::_m_LocationList::_Item::_3_::_thetaQly = 0;
        @sysvar::XCP::RadarFC_Loc::_g_PL_AD_fw_Radar_1R1V_rpc_LocBypassingRunnable_LocBypassingRunnable_m_pad_ensRLocationsPort_par_out_local::TChangeableMemPool::_::_::_m_arrayPool::_0_::_elem::_m_LocationList::_Item::_3_::_thetaVar::_m_value = 0;
        @sysvar::XCP::RadarFC_Loc::_g_PL_AD_fw_Radar_1R1V_rpc_LocBypassingRunnable_LocBypassingRunnable_m_pad_ensRLocationsPort_par_out_local::TChangeableMemPool::_::_::_m_arrayPool::_0_::_elem::_m_LocationList::_Item::_3_::_vVar::_m_value = 0;
        @sysvar::XCP::RadarFC_Loc::_g_PL_AD_fw_Radar_1R1V_rpc_LocBypassingRunnable_LocBypassingRunnable_m_pad_ensRLocationsPort_par_out_local::TChangeableMemPool::_::_::_m_arrayPool::_0_::_elem::_m_LocationList::_Item::_3_::_Rssi::_m_value = 0;
        @sysvar::XCP::RadarFC_Loc::_g_PL_AD_fw_Radar_1R1V_rpc_LocBypassingRunnable_LocBypassingRunnable_m_pad_ensRLocationsPort_par_out_local::TChangeableMemPool::_::_::_m_arrayPool::_0_::_elem::_m_LocationList::_Item::_3_::_idxAzimuthAmbiguityPeer = 0;
        @sysvar::XCP::RadarFC_Loc::_g_PL_AD_fw_Radar_1R1V_rpc_LocBypassingRunnable_LocBypassingRunnable_m_pad_ensRLocationsPort_par_out_local::TChangeableMemPool::_::_::_m_arrayPool::_0_::_elem::_m_LocationList::_Item::_3_::_measStatus = 0;
        @sysvar::XCP::RadarFC_Loc::_g_PL_AD_fw_Radar_1R1V_rpc_LocBypassingRunnable_LocBypassingRunnable_m_pad_ensRLocationsPort_par_out_local::TChangeableMemPool::_::_::_m_arrayPool::_0_::_elem::_m_LocationList::_Item::_3_::_d = 0;
        @sysvar::XCP::RadarFC_Loc::_g_PL_AD_fw_Radar_1R1V_rpc_LocBypassingRunnable_LocBypassingRunnable_m_pad_ensRLocationsPort_par_out_local::TChangeableMemPool::_::_::_m_arrayPool::_0_::_elem::_m_LocationList::_Item::_3_::_v = 0;
        @sysvar::XCP::RadarFC_Loc::_g_PL_AD_fw_Radar_1R1V_rpc_LocBypassingRunnable_LocBypassingRunnable_m_pad_ensRLocationsPort_par_out_local::TChangeableMemPool::_::_::_m_arrayPool::_0_::_elem::_m_LocationList::_Item::_3_::_phi::_m_value = 0;
        @sysvar::XCP::RadarFC_Loc::_g_PL_AD_fw_Radar_1R1V_rpc_LocBypassingRunnable_LocBypassingRunnable_m_pad_ensRLocationsPort_par_out_local::TChangeableMemPool::_::_::_m_arrayPool::_0_::_elem::_m_LocationList::_Item::_3_::_theta::_m_value = 0;
        @sysvar::XCP::RadarFC_Loc::_g_PL_AD_fw_Radar_1R1V_rpc_LocBypassingRunnable_LocBypassingRunnable_m_pad_ensRLocationsPort_par_out_local::TChangeableMemPool::_::_::_m_arrayPool::_0_::_elem::_m_LocationList::_Item::_3_::_Rcs::_m_value = 0;
        break;
        
      case 4: //"Object-4"
        @sysvar::XCP::RadarFC_Loc::_g_PL_AD_fw_Radar_1R1V_rpc_LocBypassingRunnable_LocBypassingRunnable_m_pad_ensRLocationsPort_par_out_local::TChangeableMemPool::_::_::_m_arrayPool::_0_::_elem::_m_LocationList::_Item::_4_::_dVar::_m_value = 0;
        @sysvar::XCP::RadarFC_Loc::_g_PL_AD_fw_Radar_1R1V_rpc_LocBypassingRunnable_LocBypassingRunnable_m_pad_ensRLocationsPort_par_out_local::TChangeableMemPool::_::_::_m_arrayPool::_0_::_elem::_m_LocationList::_Item::_4_::_dvCov::_m_value = 0;
        @sysvar::XCP::RadarFC_Loc::_g_PL_AD_fw_Radar_1R1V_rpc_LocBypassingRunnable_LocBypassingRunnable_m_pad_ensRLocationsPort_par_out_local::TChangeableMemPool::_::_::_m_arrayPool::_0_::_elem::_m_LocationList::_Item::_4_::_dvQly = 0;
        @sysvar::XCP::RadarFC_Loc::_g_PL_AD_fw_Radar_1R1V_rpc_LocBypassingRunnable_LocBypassingRunnable_m_pad_ensRLocationsPort_par_out_local::TChangeableMemPool::_::_::_m_arrayPool::_0_::_elem::_m_LocationList::_Item::_4_::_phiQly = 0;
        @sysvar::XCP::RadarFC_Loc::_g_PL_AD_fw_Radar_1R1V_rpc_LocBypassingRunnable_LocBypassingRunnable_m_pad_ensRLocationsPort_par_out_local::TChangeableMemPool::_::_::_m_arrayPool::_0_::_elem::_m_LocationList::_Item::_4_::_phiVar::_m_value = 0;
        @sysvar::XCP::RadarFC_Loc::_g_PL_AD_fw_Radar_1R1V_rpc_LocBypassingRunnable_LocBypassingRunnable_m_pad_ensRLocationsPort_par_out_local::TChangeableMemPool::_::_::_m_arrayPool::_0_::_elem::_m_LocationList::_Item::_4_::_thetaQly = 0;
        @sysvar::XCP::RadarFC_Loc::_g_PL_AD_fw_Radar_1R1V_rpc_LocBypassingRunnable_LocBypassingRunnable_m_pad_ensRLocationsPort_par_out_local::TChangeableMemPool::_::_::_m_arrayPool::_0_::_elem::_m_LocationList::_Item::_4_::_thetaVar::_m_value = 0;
        @sysvar::XCP::RadarFC_Loc::_g_PL_AD_fw_Radar_1R1V_rpc_LocBypassingRunnable_LocBypassingRunnable_m_pad_ensRLocationsPort_par_out_local::TChangeableMemPool::_::_::_m_arrayPool::_0_::_elem::_m_LocationList::_Item::_4_::_vVar::_m_value = 0;
        @sysvar::XCP::RadarFC_Loc::_g_PL_AD_fw_Radar_1R1V_rpc_LocBypassingRunnable_LocBypassingRunnable_m_pad_ensRLocationsPort_par_out_local::TChangeableMemPool::_::_::_m_arrayPool::_0_::_elem::_m_LocationList::_Item::_4_::_Rssi::_m_value = 0;
        @sysvar::XCP::RadarFC_Loc::_g_PL_AD_fw_Radar_1R1V_rpc_LocBypassingRunnable_LocBypassingRunnable_m_pad_ensRLocationsPort_par_out_local::TChangeableMemPool::_::_::_m_arrayPool::_0_::_elem::_m_LocationList::_Item::_4_::_idxAzimuthAmbiguityPeer = 0;
        @sysvar::XCP::RadarFC_Loc::_g_PL_AD_fw_Radar_1R1V_rpc_LocBypassingRunnable_LocBypassingRunnable_m_pad_ensRLocationsPort_par_out_local::TChangeableMemPool::_::_::_m_arrayPool::_0_::_elem::_m_LocationList::_Item::_4_::_measStatus = 0;
        @sysvar::XCP::RadarFC_Loc::_g_PL_AD_fw_Radar_1R1V_rpc_LocBypassingRunnable_LocBypassingRunnable_m_pad_ensRLocationsPort_par_out_local::TChangeableMemPool::_::_::_m_arrayPool::_0_::_elem::_m_LocationList::_Item::_4_::_d = 0;
        @sysvar::XCP::RadarFC_Loc::_g_PL_AD_fw_Radar_1R1V_rpc_LocBypassingRunnable_LocBypassingRunnable_m_pad_ensRLocationsPort_par_out_local::TChangeableMemPool::_::_::_m_arrayPool::_0_::_elem::_m_LocationList::_Item::_4_::_v = 0;
        @sysvar::XCP::RadarFC_Loc::_g_PL_AD_fw_Radar_1R1V_rpc_LocBypassingRunnable_LocBypassingRunnable_m_pad_ensRLocationsPort_par_out_local::TChangeableMemPool::_::_::_m_arrayPool::_0_::_elem::_m_LocationList::_Item::_4_::_phi::_m_value = 0;
        @sysvar::XCP::RadarFC_Loc::_g_PL_AD_fw_Radar_1R1V_rpc_LocBypassingRunnable_LocBypassingRunnable_m_pad_ensRLocationsPort_par_out_local::TChangeableMemPool::_::_::_m_arrayPool::_0_::_elem::_m_LocationList::_Item::_4_::_theta::_m_value = 0;
        @sysvar::XCP::RadarFC_Loc::_g_PL_AD_fw_Radar_1R1V_rpc_LocBypassingRunnable_LocBypassingRunnable_m_pad_ensRLocationsPort_par_out_local::TChangeableMemPool::_::_::_m_arrayPool::_0_::_elem::_m_LocationList::_Item::_4_::_Rcs::_m_value = 0;
        break;
        
      case 5: //"Object-5"
        @sysvar::XCP::RadarFC_Loc::_g_PL_AD_fw_Radar_1R1V_rpc_LocBypassingRunnable_LocBypassingRunnable_m_pad_ensRLocationsPort_par_out_local::TChangeableMemPool::_::_::_m_arrayPool::_0_::_elem::_m_LocationList::_Item::_5_::_dVar::_m_value = 0;
        @sysvar::XCP::RadarFC_Loc::_g_PL_AD_fw_Radar_1R1V_rpc_LocBypassingRunnable_LocBypassingRunnable_m_pad_ensRLocationsPort_par_out_local::TChangeableMemPool::_::_::_m_arrayPool::_0_::_elem::_m_LocationList::_Item::_5_::_dvCov::_m_value = 0;
        @sysvar::XCP::RadarFC_Loc::_g_PL_AD_fw_Radar_1R1V_rpc_LocBypassingRunnable_LocBypassingRunnable_m_pad_ensRLocationsPort_par_out_local::TChangeableMemPool::_::_::_m_arrayPool::_0_::_elem::_m_LocationList::_Item::_5_::_dvQly = 0;
        @sysvar::XCP::RadarFC_Loc::_g_PL_AD_fw_Radar_1R1V_rpc_LocBypassingRunnable_LocBypassingRunnable_m_pad_ensRLocationsPort_par_out_local::TChangeableMemPool::_::_::_m_arrayPool::_0_::_elem::_m_LocationList::_Item::_5_::_phiQly = 0;
        @sysvar::XCP::RadarFC_Loc::_g_PL_AD_fw_Radar_1R1V_rpc_LocBypassingRunnable_LocBypassingRunnable_m_pad_ensRLocationsPort_par_out_local::TChangeableMemPool::_::_::_m_arrayPool::_0_::_elem::_m_LocationList::_Item::_5_::_phiVar::_m_value = 0;
        @sysvar::XCP::RadarFC_Loc::_g_PL_AD_fw_Radar_1R1V_rpc_LocBypassingRunnable_LocBypassingRunnable_m_pad_ensRLocationsPort_par_out_local::TChangeableMemPool::_::_::_m_arrayPool::_0_::_elem::_m_LocationList::_Item::_5_::_thetaQly = 0;
        @sysvar::XCP::RadarFC_Loc::_g_PL_AD_fw_Radar_1R1V_rpc_LocBypassingRunnable_LocBypassingRunnable_m_pad_ensRLocationsPort_par_out_local::TChangeableMemPool::_::_::_m_arrayPool::_0_::_elem::_m_LocationList::_Item::_5_::_thetaVar::_m_value = 0;
        @sysvar::XCP::RadarFC_Loc::_g_PL_AD_fw_Radar_1R1V_rpc_LocBypassingRunnable_LocBypassingRunnable_m_pad_ensRLocationsPort_par_out_local::TChangeableMemPool::_::_::_m_arrayPool::_0_::_elem::_m_LocationList::_Item::_5_::_vVar::_m_value = 0;
        @sysvar::XCP::RadarFC_Loc::_g_PL_AD_fw_Radar_1R1V_rpc_LocBypassingRunnable_LocBypassingRunnable_m_pad_ensRLocationsPort_par_out_local::TChangeableMemPool::_::_::_m_arrayPool::_0_::_elem::_m_LocationList::_Item::_5_::_Rssi::_m_value = 0;
        @sysvar::XCP::RadarFC_Loc::_g_PL_AD_fw_Radar_1R1V_rpc_LocBypassingRunnable_LocBypassingRunnable_m_pad_ensRLocationsPort_par_out_local::TChangeableMemPool::_::_::_m_arrayPool::_0_::_elem::_m_LocationList::_Item::_5_::_idxAzimuthAmbiguityPeer = 0;
        @sysvar::XCP::RadarFC_Loc::_g_PL_AD_fw_Radar_1R1V_rpc_LocBypassingRunnable_LocBypassingRunnable_m_pad_ensRLocationsPort_par_out_local::TChangeableMemPool::_::_::_m_arrayPool::_0_::_elem::_m_LocationList::_Item::_5_::_measStatus = 0;
        @sysvar::XCP::RadarFC_Loc::_g_PL_AD_fw_Radar_1R1V_rpc_LocBypassingRunnable_LocBypassingRunnable_m_pad_ensRLocationsPort_par_out_local::TChangeableMemPool::_::_::_m_arrayPool::_0_::_elem::_m_LocationList::_Item::_5_::_d = 0;
        @sysvar::XCP::RadarFC_Loc::_g_PL_AD_fw_Radar_1R1V_rpc_LocBypassingRunnable_LocBypassingRunnable_m_pad_ensRLocationsPort_par_out_local::TChangeableMemPool::_::_::_m_arrayPool::_0_::_elem::_m_LocationList::_Item::_5_::_v = 0;
        @sysvar::XCP::RadarFC_Loc::_g_PL_AD_fw_Radar_1R1V_rpc_LocBypassingRunnable_LocBypassingRunnable_m_pad_ensRLocationsPort_par_out_local::TChangeableMemPool::_::_::_m_arrayPool::_0_::_elem::_m_LocationList::_Item::_5_::_phi::_m_value = 0;
        @sysvar::XCP::RadarFC_Loc::_g_PL_AD_fw_Radar_1R1V_rpc_LocBypassingRunnable_LocBypassingRunnable_m_pad_ensRLocationsPort_par_out_local::TChangeableMemPool::_::_::_m_arrayPool::_0_::_elem::_m_LocationList::_Item::_5_::_theta::_m_value = 0;
        @sysvar::XCP::RadarFC_Loc::_g_PL_AD_fw_Radar_1R1V_rpc_LocBypassingRunnable_LocBypassingRunnable_m_pad_ensRLocationsPort_par_out_local::TChangeableMemPool::_::_::_m_arrayPool::_0_::_elem::_m_LocationList::_Item::_5_::_Rcs::_m_value = 0;
        break;
        
      case 6: //"Object-6"
        @sysvar::XCP::RadarFC_Loc::_g_PL_AD_fw_Radar_1R1V_rpc_LocBypassingRunnable_LocBypassingRunnable_m_pad_ensRLocationsPort_par_out_local::TChangeableMemPool::_::_::_m_arrayPool::_0_::_elem::_m_LocationList::_Item::_6_::_dVar::_m_value = 0;
        @sysvar::XCP::RadarFC_Loc::_g_PL_AD_fw_Radar_1R1V_rpc_LocBypassingRunnable_LocBypassingRunnable_m_pad_ensRLocationsPort_par_out_local::TChangeableMemPool::_::_::_m_arrayPool::_0_::_elem::_m_LocationList::_Item::_6_::_dvCov::_m_value = 0;
        @sysvar::XCP::RadarFC_Loc::_g_PL_AD_fw_Radar_1R1V_rpc_LocBypassingRunnable_LocBypassingRunnable_m_pad_ensRLocationsPort_par_out_local::TChangeableMemPool::_::_::_m_arrayPool::_0_::_elem::_m_LocationList::_Item::_6_::_dvQly = 0;
        @sysvar::XCP::RadarFC_Loc::_g_PL_AD_fw_Radar_1R1V_rpc_LocBypassingRunnable_LocBypassingRunnable_m_pad_ensRLocationsPort_par_out_local::TChangeableMemPool::_::_::_m_arrayPool::_0_::_elem::_m_LocationList::_Item::_6_::_phiQly = 0;
        @sysvar::XCP::RadarFC_Loc::_g_PL_AD_fw_Radar_1R1V_rpc_LocBypassingRunnable_LocBypassingRunnable_m_pad_ensRLocationsPort_par_out_local::TChangeableMemPool::_::_::_m_arrayPool::_0_::_elem::_m_LocationList::_Item::_6_::_phiVar::_m_value = 0;
        @sysvar::XCP::RadarFC_Loc::_g_PL_AD_fw_Radar_1R1V_rpc_LocBypassingRunnable_LocBypassingRunnable_m_pad_ensRLocationsPort_par_out_local::TChangeableMemPool::_::_::_m_arrayPool::_0_::_elem::_m_LocationList::_Item::_6_::_thetaQly = 0;
        @sysvar::XCP::RadarFC_Loc::_g_PL_AD_fw_Radar_1R1V_rpc_LocBypassingRunnable_LocBypassingRunnable_m_pad_ensRLocationsPort_par_out_local::TChangeableMemPool::_::_::_m_arrayPool::_0_::_elem::_m_LocationList::_Item::_6_::_thetaVar::_m_value = 0;
        @sysvar::XCP::RadarFC_Loc::_g_PL_AD_fw_Radar_1R1V_rpc_LocBypassingRunnable_LocBypassingRunnable_m_pad_ensRLocationsPort_par_out_local::TChangeableMemPool::_::_::_m_arrayPool::_0_::_elem::_m_LocationList::_Item::_6_::_vVar::_m_value = 0;
        @sysvar::XCP::RadarFC_Loc::_g_PL_AD_fw_Radar_1R1V_rpc_LocBypassingRunnable_LocBypassingRunnable_m_pad_ensRLocationsPort_par_out_local::TChangeableMemPool::_::_::_m_arrayPool::_0_::_elem::_m_LocationList::_Item::_6_::_Rssi::_m_value = 0;
        @sysvar::XCP::RadarFC_Loc::_g_PL_AD_fw_Radar_1R1V_rpc_LocBypassingRunnable_LocBypassingRunnable_m_pad_ensRLocationsPort_par_out_local::TChangeableMemPool::_::_::_m_arrayPool::_0_::_elem::_m_LocationList::_Item::_6_::_idxAzimuthAmbiguityPeer = 0;
        @sysvar::XCP::RadarFC_Loc::_g_PL_AD_fw_Radar_1R1V_rpc_LocBypassingRunnable_LocBypassingRunnable_m_pad_ensRLocationsPort_par_out_local::TChangeableMemPool::_::_::_m_arrayPool::_0_::_elem::_m_LocationList::_Item::_6_::_measStatus = 0;
        @sysvar::XCP::RadarFC_Loc::_g_PL_AD_fw_Radar_1R1V_rpc_LocBypassingRunnable_LocBypassingRunnable_m_pad_ensRLocationsPort_par_out_local::TChangeableMemPool::_::_::_m_arrayPool::_0_::_elem::_m_LocationList::_Item::_6_::_d = 0;
        @sysvar::XCP::RadarFC_Loc::_g_PL_AD_fw_Radar_1R1V_rpc_LocBypassingRunnable_LocBypassingRunnable_m_pad_ensRLocationsPort_par_out_local::TChangeableMemPool::_::_::_m_arrayPool::_0_::_elem::_m_LocationList::_Item::_6_::_v = 0;
        @sysvar::XCP::RadarFC_Loc::_g_PL_AD_fw_Radar_1R1V_rpc_LocBypassingRunnable_LocBypassingRunnable_m_pad_ensRLocationsPort_par_out_local::TChangeableMemPool::_::_::_m_arrayPool::_0_::_elem::_m_LocationList::_Item::_6_::_phi::_m_value = 0;
        @sysvar::XCP::RadarFC_Loc::_g_PL_AD_fw_Radar_1R1V_rpc_LocBypassingRunnable_LocBypassingRunnable_m_pad_ensRLocationsPort_par_out_local::TChangeableMemPool::_::_::_m_arrayPool::_0_::_elem::_m_LocationList::_Item::_6_::_theta::_m_value = 0;
        @sysvar::XCP::RadarFC_Loc::_g_PL_AD_fw_Radar_1R1V_rpc_LocBypassingRunnable_LocBypassingRunnable_m_pad_ensRLocationsPort_par_out_local::TChangeableMemPool::_::_::_m_arrayPool::_0_::_elem::_m_LocationList::_Item::_6_::_Rcs::_m_value = 0;
        break;
        
      case 7: //"Object-7"
        @sysvar::XCP::RadarFC_Loc::_g_PL_AD_fw_Radar_1R1V_rpc_LocBypassingRunnable_LocBypassingRunnable_m_pad_ensRLocationsPort_par_out_local::TChangeableMemPool::_::_::_m_arrayPool::_0_::_elem::_m_LocationList::_Item::_7_::_dVar::_m_value = 0;
        @sysvar::XCP::RadarFC_Loc::_g_PL_AD_fw_Radar_1R1V_rpc_LocBypassingRunnable_LocBypassingRunnable_m_pad_ensRLocationsPort_par_out_local::TChangeableMemPool::_::_::_m_arrayPool::_0_::_elem::_m_LocationList::_Item::_7_::_dvCov::_m_value = 0;
        @sysvar::XCP::RadarFC_Loc::_g_PL_AD_fw_Radar_1R1V_rpc_LocBypassingRunnable_LocBypassingRunnable_m_pad_ensRLocationsPort_par_out_local::TChangeableMemPool::_::_::_m_arrayPool::_0_::_elem::_m_LocationList::_Item::_7_::_dvQly = 0;
        @sysvar::XCP::RadarFC_Loc::_g_PL_AD_fw_Radar_1R1V_rpc_LocBypassingRunnable_LocBypassingRunnable_m_pad_ensRLocationsPort_par_out_local::TChangeableMemPool::_::_::_m_arrayPool::_0_::_elem::_m_LocationList::_Item::_7_::_phiQly = 0;
        @sysvar::XCP::RadarFC_Loc::_g_PL_AD_fw_Radar_1R1V_rpc_LocBypassingRunnable_LocBypassingRunnable_m_pad_ensRLocationsPort_par_out_local::TChangeableMemPool::_::_::_m_arrayPool::_0_::_elem::_m_LocationList::_Item::_7_::_phiVar::_m_value = 0;
        @sysvar::XCP::RadarFC_Loc::_g_PL_AD_fw_Radar_1R1V_rpc_LocBypassingRunnable_LocBypassingRunnable_m_pad_ensRLocationsPort_par_out_local::TChangeableMemPool::_::_::_m_arrayPool::_0_::_elem::_m_LocationList::_Item::_7_::_thetaQly = 0;
        @sysvar::XCP::RadarFC_Loc::_g_PL_AD_fw_Radar_1R1V_rpc_LocBypassingRunnable_LocBypassingRunnable_m_pad_ensRLocationsPort_par_out_local::TChangeableMemPool::_::_::_m_arrayPool::_0_::_elem::_m_LocationList::_Item::_7_::_thetaVar::_m_value = 0;
        @sysvar::XCP::RadarFC_Loc::_g_PL_AD_fw_Radar_1R1V_rpc_LocBypassingRunnable_LocBypassingRunnable_m_pad_ensRLocationsPort_par_out_local::TChangeableMemPool::_::_::_m_arrayPool::_0_::_elem::_m_LocationList::_Item::_7_::_vVar::_m_value = 0;
        @sysvar::XCP::RadarFC_Loc::_g_PL_AD_fw_Radar_1R1V_rpc_LocBypassingRunnable_LocBypassingRunnable_m_pad_ensRLocationsPort_par_out_local::TChangeableMemPool::_::_::_m_arrayPool::_0_::_elem::_m_LocationList::_Item::_7_::_Rssi::_m_value = 0;
        @sysvar::XCP::RadarFC_Loc::_g_PL_AD_fw_Radar_1R1V_rpc_LocBypassingRunnable_LocBypassingRunnable_m_pad_ensRLocationsPort_par_out_local::TChangeableMemPool::_::_::_m_arrayPool::_0_::_elem::_m_LocationList::_Item::_7_::_idxAzimuthAmbiguityPeer = 0;
        @sysvar::XCP::RadarFC_Loc::_g_PL_AD_fw_Radar_1R1V_rpc_LocBypassingRunnable_LocBypassingRunnable_m_pad_ensRLocationsPort_par_out_local::TChangeableMemPool::_::_::_m_arrayPool::_0_::_elem::_m_LocationList::_Item::_7_::_measStatus = 0;
        @sysvar::XCP::RadarFC_Loc::_g_PL_AD_fw_Radar_1R1V_rpc_LocBypassingRunnable_LocBypassingRunnable_m_pad_ensRLocationsPort_par_out_local::TChangeableMemPool::_::_::_m_arrayPool::_0_::_elem::_m_LocationList::_Item::_7_::_d = 0;
        @sysvar::XCP::RadarFC_Loc::_g_PL_AD_fw_Radar_1R1V_rpc_LocBypassingRunnable_LocBypassingRunnable_m_pad_ensRLocationsPort_par_out_local::TChangeableMemPool::_::_::_m_arrayPool::_0_::_elem::_m_LocationList::_Item::_7_::_v = 0;
        @sysvar::XCP::RadarFC_Loc::_g_PL_AD_fw_Radar_1R1V_rpc_LocBypassingRunnable_LocBypassingRunnable_m_pad_ensRLocationsPort_par_out_local::TChangeableMemPool::_::_::_m_arrayPool::_0_::_elem::_m_LocationList::_Item::_7_::_phi::_m_value = 0;
        @sysvar::XCP::RadarFC_Loc::_g_PL_AD_fw_Radar_1R1V_rpc_LocBypassingRunnable_LocBypassingRunnable_m_pad_ensRLocationsPort_par_out_local::TChangeableMemPool::_::_::_m_arrayPool::_0_::_elem::_m_LocationList::_Item::_7_::_theta::_m_value = 0;
        @sysvar::XCP::RadarFC_Loc::_g_PL_AD_fw_Radar_1R1V_rpc_LocBypassingRunnable_LocBypassingRunnable_m_pad_ensRLocationsPort_par_out_local::TChangeableMemPool::_::_::_m_arrayPool::_0_::_elem::_m_LocationList::_Item::_7_::_Rcs::_m_value = 0;
        break;
        
      case 8: //"Object-8"
        @sysvar::XCP::RadarFC_Loc::_g_PL_AD_fw_Radar_1R1V_rpc_LocBypassingRunnable_LocBypassingRunnable_m_pad_ensRLocationsPort_par_out_local::TChangeableMemPool::_::_::_m_arrayPool::_0_::_elem::_m_LocationList::_Item::_8_::_dVar::_m_value = 0;
        @sysvar::XCP::RadarFC_Loc::_g_PL_AD_fw_Radar_1R1V_rpc_LocBypassingRunnable_LocBypassingRunnable_m_pad_ensRLocationsPort_par_out_local::TChangeableMemPool::_::_::_m_arrayPool::_0_::_elem::_m_LocationList::_Item::_8_::_dvCov::_m_value = 0;
        @sysvar::XCP::RadarFC_Loc::_g_PL_AD_fw_Radar_1R1V_rpc_LocBypassingRunnable_LocBypassingRunnable_m_pad_ensRLocationsPort_par_out_local::TChangeableMemPool::_::_::_m_arrayPool::_0_::_elem::_m_LocationList::_Item::_8_::_dvQly = 0;
        @sysvar::XCP::RadarFC_Loc::_g_PL_AD_fw_Radar_1R1V_rpc_LocBypassingRunnable_LocBypassingRunnable_m_pad_ensRLocationsPort_par_out_local::TChangeableMemPool::_::_::_m_arrayPool::_0_::_elem::_m_LocationList::_Item::_8_::_phiQly = 0;
        @sysvar::XCP::RadarFC_Loc::_g_PL_AD_fw_Radar_1R1V_rpc_LocBypassingRunnable_LocBypassingRunnable_m_pad_ensRLocationsPort_par_out_local::TChangeableMemPool::_::_::_m_arrayPool::_0_::_elem::_m_LocationList::_Item::_8_::_phiVar::_m_value = 0;
        @sysvar::XCP::RadarFC_Loc::_g_PL_AD_fw_Radar_1R1V_rpc_LocBypassingRunnable_LocBypassingRunnable_m_pad_ensRLocationsPort_par_out_local::TChangeableMemPool::_::_::_m_arrayPool::_0_::_elem::_m_LocationList::_Item::_8_::_thetaQly = 0;
        @sysvar::XCP::RadarFC_Loc::_g_PL_AD_fw_Radar_1R1V_rpc_LocBypassingRunnable_LocBypassingRunnable_m_pad_ensRLocationsPort_par_out_local::TChangeableMemPool::_::_::_m_arrayPool::_0_::_elem::_m_LocationList::_Item::_8_::_thetaVar::_m_value = 0;
        @sysvar::XCP::RadarFC_Loc::_g_PL_AD_fw_Radar_1R1V_rpc_LocBypassingRunnable_LocBypassingRunnable_m_pad_ensRLocationsPort_par_out_local::TChangeableMemPool::_::_::_m_arrayPool::_0_::_elem::_m_LocationList::_Item::_8_::_vVar::_m_value = 0;
        @sysvar::XCP::RadarFC_Loc::_g_PL_AD_fw_Radar_1R1V_rpc_LocBypassingRunnable_LocBypassingRunnable_m_pad_ensRLocationsPort_par_out_local::TChangeableMemPool::_::_::_m_arrayPool::_0_::_elem::_m_LocationList::_Item::_8_::_Rssi::_m_value = 0;
        @sysvar::XCP::RadarFC_Loc::_g_PL_AD_fw_Radar_1R1V_rpc_LocBypassingRunnable_LocBypassingRunnable_m_pad_ensRLocationsPort_par_out_local::TChangeableMemPool::_::_::_m_arrayPool::_0_::_elem::_m_LocationList::_Item::_8_::_idxAzimuthAmbiguityPeer = 0;
        @sysvar::XCP::RadarFC_Loc::_g_PL_AD_fw_Radar_1R1V_rpc_LocBypassingRunnable_LocBypassingRunnable_m_pad_ensRLocationsPort_par_out_local::TChangeableMemPool::_::_::_m_arrayPool::_0_::_elem::_m_LocationList::_Item::_8_::_measStatus = 0;
        @sysvar::XCP::RadarFC_Loc::_g_PL_AD_fw_Radar_1R1V_rpc_LocBypassingRunnable_LocBypassingRunnable_m_pad_ensRLocationsPort_par_out_local::TChangeableMemPool::_::_::_m_arrayPool::_0_::_elem::_m_LocationList::_Item::_8_::_d = 0;
        @sysvar::XCP::RadarFC_Loc::_g_PL_AD_fw_Radar_1R1V_rpc_LocBypassingRunnable_LocBypassingRunnable_m_pad_ensRLocationsPort_par_out_local::TChangeableMemPool::_::_::_m_arrayPool::_0_::_elem::_m_LocationList::_Item::_8_::_v = 0;
        @sysvar::XCP::RadarFC_Loc::_g_PL_AD_fw_Radar_1R1V_rpc_LocBypassingRunnable_LocBypassingRunnable_m_pad_ensRLocationsPort_par_out_local::TChangeableMemPool::_::_::_m_arrayPool::_0_::_elem::_m_LocationList::_Item::_8_::_phi::_m_value = 0;
        @sysvar::XCP::RadarFC_Loc::_g_PL_AD_fw_Radar_1R1V_rpc_LocBypassingRunnable_LocBypassingRunnable_m_pad_ensRLocationsPort_par_out_local::TChangeableMemPool::_::_::_m_arrayPool::_0_::_elem::_m_LocationList::_Item::_8_::_theta::_m_value = 0;
        @sysvar::XCP::RadarFC_Loc::_g_PL_AD_fw_Radar_1R1V_rpc_LocBypassingRunnable_LocBypassingRunnable_m_pad_ensRLocationsPort_par_out_local::TChangeableMemPool::_::_::_m_arrayPool::_0_::_elem::_m_LocationList::_Item::_8_::_Rcs::_m_value = 0;
        break;
        
    }
}

/** @brief Sets the signals to raw value 0 of the object which deletes it on xcp.
  * @param object_id ID of the object that shall be deleted.
  * @return void
  */
void delete_radar_fc_obj_xcp(byte object_id)
{
  switch (object_id)
  {
      case 0: //"Object-0"
        @sysvar::XCP::RadarFC_Obj::_g_PL_AD_fw_Radar_1R1V_rpc_XilObjBypassingRunnable_XilObjBypassingRunnable_m_pad_radarObjPort_par_out_local::TChangeableMemPool::_::_::_m_arrayPool::_0_::_elem::_m_objectInformation::_0_::_Valid_b = 0;
        @sysvar::XCP::RadarFC_Obj::_g_PL_AD_fw_Radar_1R1V_rpc_XilObjBypassingRunnable_XilObjBypassingRunnable_m_pad_radarObjPort_par_out_local::TChangeableMemPool::_::_::_m_arrayPool::_0_::_elem::_m_objectInformation::_0_::_m_HandleN = 0;
        @sysvar::XCP::RadarFC_Obj::_g_PL_AD_fw_Radar_1R1V_rpc_XilObjBypassingRunnable_XilObjBypassingRunnable_m_pad_radarObjPort_par_out_local::TChangeableMemPool::_::_::_m_arrayPool::_0_::_elem::_m_objectInformation::_0_::_m_alpPiVarYawAngleN = 0;
        @sysvar::XCP::RadarFC_Obj::_g_PL_AD_fw_Radar_1R1V_rpc_XilObjBypassingRunnable_XilObjBypassingRunnable_m_pad_radarObjPort_par_out_local::TChangeableMemPool::_::_::_m_arrayPool::_0_::_elem::_m_objectInformation::_0_::_m_varAxN = 0;
        @sysvar::XCP::RadarFC_Obj::_g_PL_AD_fw_Radar_1R1V_rpc_XilObjBypassingRunnable_XilObjBypassingRunnable_m_pad_radarObjPort_par_out_local::TChangeableMemPool::_::_::_m_arrayPool::_0_::_elem::_m_objectInformation::_0_::_m_varAyN = 0;
        @sysvar::XCP::RadarFC_Obj::_g_PL_AD_fw_Radar_1R1V_rpc_XilObjBypassingRunnable_XilObjBypassingRunnable_m_pad_radarObjPort_par_out_local::TChangeableMemPool::_::_::_m_arrayPool::_0_::_elem::_m_objectInformation::_0_::_m_varVxN = 0;
        @sysvar::XCP::RadarFC_Obj::_g_PL_AD_fw_Radar_1R1V_rpc_XilObjBypassingRunnable_XilObjBypassingRunnable_m_pad_radarObjPort_par_out_local::TChangeableMemPool::_::_::_m_arrayPool::_0_::_elem::_m_objectInformation::_0_::_m_varVyN = 0;
        @sysvar::XCP::RadarFC_Obj::_g_PL_AD_fw_Radar_1R1V_rpc_XilObjBypassingRunnable_XilObjBypassingRunnable_m_pad_radarObjPort_par_out_local::TChangeableMemPool::_::_::_m_arrayPool::_0_::_elem::_m_objectInformation::_0_::_m_varDxN = 0;
        @sysvar::XCP::RadarFC_Obj::_g_PL_AD_fw_Radar_1R1V_rpc_XilObjBypassingRunnable_XilObjBypassingRunnable_m_pad_radarObjPort_par_out_local::TChangeableMemPool::_::_::_m_arrayPool::_0_::_elem::_m_objectInformation::_0_::_m_varDyN = 0;
        @sysvar::XCP::RadarFC_Obj::_g_PL_AD_fw_Radar_1R1V_rpc_XilObjBypassingRunnable_XilObjBypassingRunnable_m_pad_radarObjPort_par_out_local::TChangeableMemPool::_::_::_m_arrayPool::_0_::_elem::_m_objectInformation::_0_::_m_dVarLengthN = 0;
        @sysvar::XCP::RadarFC_Obj::_g_PL_AD_fw_Radar_1R1V_rpc_XilObjBypassingRunnable_XilObjBypassingRunnable_m_pad_radarObjPort_par_out_local::TChangeableMemPool::_::_::_m_arrayPool::_0_::_elem::_m_objectInformation::_0_::_m_dVarWidthN = 0;
        @sysvar::XCP::RadarFC_Obj::_g_PL_AD_fw_Radar_1R1V_rpc_XilObjBypassingRunnable_XilObjBypassingRunnable_m_pad_radarObjPort_par_out_local::TChangeableMemPool::_::_::_m_arrayPool::_0_::_elem::_m_objectInformation::_0_::_m_wExistProbN = 0;
        @sysvar::XCP::RadarFC_Obj::_g_PL_AD_fw_Radar_1R1V_rpc_XilObjBypassingRunnable_XilObjBypassingRunnable_m_pad_radarObjPort_par_out_local::TChangeableMemPool::_::_::_m_arrayPool::_0_::_elem::_m_objectInformation::_0_::_m_isObjectAsil = 0;
        @sysvar::XCP::RadarFC_Obj::_g_PL_AD_fw_Radar_1R1V_rpc_XilObjBypassingRunnable_XilObjBypassingRunnable_m_pad_radarObjPort_par_out_local::TChangeableMemPool::_::_::_m_arrayPool::_0_::_elem::_m_objectInformation::_0_::_m_dWidthN = 0;
        @sysvar::XCP::RadarFC_Obj::_g_PL_AD_fw_Radar_1R1V_rpc_XilObjBypassingRunnable_XilObjBypassingRunnable_m_pad_radarObjPort_par_out_local::TChangeableMemPool::_::_::_m_arrayPool::_0_::_elem::_m_objectInformation::_0_::_m_dLengthN = 0;
        @sysvar::XCP::RadarFC_Obj::_g_PL_AD_fw_Radar_1R1V_rpc_XilObjBypassingRunnable_XilObjBypassingRunnable_m_pad_radarObjPort_par_out_local::TChangeableMemPool::_::_::_m_arrayPool::_0_::_elem::_m_objectInformation::_0_::_m_dxN = 0;
        @sysvar::XCP::RadarFC_Obj::_g_PL_AD_fw_Radar_1R1V_rpc_XilObjBypassingRunnable_XilObjBypassingRunnable_m_pad_radarObjPort_par_out_local::TChangeableMemPool::_::_::_m_arrayPool::_0_::_elem::_m_objectInformation::_0_::_m_dyN = 0;
        @sysvar::XCP::RadarFC_Obj::_g_PL_AD_fw_Radar_1R1V_rpc_XilObjBypassingRunnable_XilObjBypassingRunnable_m_pad_radarObjPort_par_out_local::TChangeableMemPool::_::_::_m_arrayPool::_0_::_elem::_m_objectInformation::_0_::_m_dzN = 0;
        @sysvar::XCP::RadarFC_Obj::_g_PL_AD_fw_Radar_1R1V_rpc_XilObjBypassingRunnable_XilObjBypassingRunnable_m_pad_radarObjPort_par_out_local::TChangeableMemPool::_::_::_m_arrayPool::_0_::_elem::_m_objectInformation::_0_::_m_vxN = 0;
        @sysvar::XCP::RadarFC_Obj::_g_PL_AD_fw_Radar_1R1V_rpc_XilObjBypassingRunnable_XilObjBypassingRunnable_m_pad_radarObjPort_par_out_local::TChangeableMemPool::_::_::_m_arrayPool::_0_::_elem::_m_objectInformation::_0_::_m_vyN = 0;
        @sysvar::XCP::RadarFC_Obj::_g_PL_AD_fw_Radar_1R1V_rpc_XilObjBypassingRunnable_XilObjBypassingRunnable_m_pad_radarObjPort_par_out_local::TChangeableMemPool::_::_::_m_arrayPool::_0_::_elem::_m_objectInformation::_0_::_m_axN = 0;
        @sysvar::XCP::RadarFC_Obj::_g_PL_AD_fw_Radar_1R1V_rpc_XilObjBypassingRunnable_XilObjBypassingRunnable_m_pad_radarObjPort_par_out_local::TChangeableMemPool::_::_::_m_arrayPool::_0_::_elem::_m_objectInformation::_0_::_m_ayN = 0;
        @sysvar::XCP::RadarFC_Obj::_g_PL_AD_fw_Radar_1R1V_rpc_XilObjBypassingRunnable_XilObjBypassingRunnable_m_pad_radarObjPort_par_out_local::TChangeableMemPool::_::_::_m_arrayPool::_0_::_elem::_m_objectInformation::_0_::_m_alpPiYawAngleN = 0;
        @sysvar::XCP::RadarFC_Obj::_g_PL_AD_fw_Radar_1R1V_rpc_XilObjBypassingRunnable_XilObjBypassingRunnable_m_pad_radarObjPort_par_out_local::TChangeableMemPool::_::_::_m_arrayPool::_0_::_elem::_m_objectInformation::_0_::_m_prob1HasBeenObservedMovingN = 0;
        @sysvar::XCP::RadarFC_Obj::_g_PL_AD_fw_Radar_1R1V_rpc_XilObjBypassingRunnable_XilObjBypassingRunnable_m_pad_radarObjPort_par_out_local::TChangeableMemPool::_::_::_m_arrayPool::_0_::_elem::_m_objectInformation::_0_::_m_prob1MovingN = 0;
        @sysvar::XCP::RadarFC_Obj::_g_PL_AD_fw_Radar_1R1V_rpc_XilObjBypassingRunnable_XilObjBypassingRunnable_m_pad_radarObjPort_par_out_local::TChangeableMemPool::_::_::_m_arrayPool::_0_::_elem::_m_objectInformation::_0_::_m_perObjectType::_m_prob1ObstacleN = 0;
        @sysvar::XCP::RadarFC_Obj::_g_PL_AD_fw_Radar_1R1V_rpc_XilObjBypassingRunnable_XilObjBypassingRunnable_m_pad_radarObjPort_par_out_local::TChangeableMemPool::_::_::_m_arrayPool::_0_::_elem::_m_objectInformation::_0_::_m_perObjectType::_m_prob1NonObstacleN = 0;
        @sysvar::XCP::RadarFC_Obj::_g_PL_AD_fw_Radar_1R1V_rpc_XilObjBypassingRunnable_XilObjBypassingRunnable_m_pad_radarObjPort_par_out_local::TChangeableMemPool::_::_::_m_arrayPool::_0_::_elem::_m_objectInformation::_0_::_m_perObjectType::_m_prob1MobileN = 0;
        @sysvar::XCP::RadarFC_Obj::_g_PL_AD_fw_Radar_1R1V_rpc_XilObjBypassingRunnable_XilObjBypassingRunnable_m_pad_radarObjPort_par_out_local::TChangeableMemPool::_::_::_m_arrayPool::_0_::_elem::_m_objectInformation::_0_::_m_perObjectType::_m_prob1StationaryN = 0;
        @sysvar::XCP::RadarFC_Obj::_g_PL_AD_fw_Radar_1R1V_rpc_XilObjBypassingRunnable_XilObjBypassingRunnable_m_pad_radarObjPort_par_out_local::TChangeableMemPool::_::_::_m_arrayPool::_0_::_elem::_m_objectInformation::_0_::_m_perObjectType::_m_prob1FourPlusWheelerN = 0;
        @sysvar::XCP::RadarFC_Obj::_g_PL_AD_fw_Radar_1R1V_rpc_XilObjBypassingRunnable_XilObjBypassingRunnable_m_pad_radarObjPort_par_out_local::TChangeableMemPool::_::_::_m_arrayPool::_0_::_elem::_m_objectInformation::_0_::_m_perObjectType::_m_prob1TwoWheelerN = 0;
        @sysvar::XCP::RadarFC_Obj::_g_PL_AD_fw_Radar_1R1V_rpc_XilObjBypassingRunnable_XilObjBypassingRunnable_m_pad_radarObjPort_par_out_local::TChangeableMemPool::_::_::_m_arrayPool::_0_::_elem::_m_objectInformation::_0_::_m_perObjectType::_m_prob1PedestrianN = 0;
        @sysvar::XCP::RadarFC_Obj::_g_PL_AD_fw_Radar_1R1V_rpc_XilObjBypassingRunnable_XilObjBypassingRunnable_m_pad_radarObjPort_par_out_local::TChangeableMemPool::_::_::_m_arrayPool::_0_::_elem::_m_objectInformation::_0_::_m_perObjectType::_m_prob1RoadsideBarrierN = 0;
        @sysvar::XCP::RadarFC_Obj::_g_PL_AD_fw_Radar_1R1V_rpc_XilObjBypassingRunnable_XilObjBypassingRunnable_m_pad_radarObjPort_par_out_local::TChangeableMemPool::_::_::_m_arrayPool::_0_::_elem::_m_objectInformation::_0_::_m_perObjectType::_m_prob1PassengerCarN = 0;
        @sysvar::XCP::RadarFC_Obj::_g_PL_AD_fw_Radar_1R1V_rpc_XilObjBypassingRunnable_XilObjBypassingRunnable_m_pad_radarObjPort_par_out_local::TChangeableMemPool::_::_::_m_arrayPool::_0_::_elem::_m_objectInformation::_0_::_m_perObjectType::_m_prob1TruckN = 0;
        @sysvar::XCP::RadarFC_Obj::_g_PL_AD_fw_Radar_1R1V_rpc_XilObjBypassingRunnable_XilObjBypassingRunnable_m_pad_radarObjPort_par_out_local::TChangeableMemPool::_::_::_m_arrayPool::_0_::_elem::_m_objectInformation::_0_::_m_perObjectType::_m_prob1UnknownN = 0;
        @sysvar::XCP::RadarFC_Obj::_g_PL_AD_fw_Radar_1R1V_rpc_XilObjBypassingRunnable_XilObjBypassingRunnable_m_pad_radarObjPort_par_out_local::TChangeableMemPool::_::_::_m_arrayPool::_0_::_elem::_m_objectInformation::_0_::_m_perObjectType::_m_prob1MovUnknownN = 0;
        @sysvar::XCP::RadarFC_Obj::_g_PL_AD_fw_Radar_1R1V_rpc_XilObjBypassingRunnable_XilObjBypassingRunnable_m_pad_radarObjPort_par_out_local::TChangeableMemPool::_::_::_m_arrayPool::_0_::_elem::_m_objectInformation::_0_::_m_perObjectType::_m_prob1StatUnknownN = 0;
        @sysvar::XCP::RadarFC_Obj::_g_PL_AD_fw_Radar_1R1V_rpc_XilObjBypassingRunnable_XilObjBypassingRunnable_m_pad_radarObjPort_par_out_local::TChangeableMemPool::_::_::_m_arrayPool::_0_::_elem::_m_objectInformation::_0_::_m_perObjectType::_m_prob1ObstUnknownN = 0;
        @sysvar::XCP::RadarFC_Obj::_g_PL_AD_fw_Radar_1R1V_rpc_XilObjBypassingRunnable_XilObjBypassingRunnable_m_pad_radarObjPort_par_out_local::TChangeableMemPool::_::_::_m_arrayPool::_0_::_elem::_m_objectInformation::_0_::_m_perObjectType::_m_prob1FourWheelUnknownN = 0;
        break;
        
      case 1: //"Object-1"
        @sysvar::XCP::RadarFC_Obj::_g_PL_AD_fw_Radar_1R1V_rpc_XilObjBypassingRunnable_XilObjBypassingRunnable_m_pad_radarObjPort_par_out_local::TChangeableMemPool::_::_::_m_arrayPool::_0_::_elem::_m_objectInformation::_1_::_Valid_b = 0;
        @sysvar::XCP::RadarFC_Obj::_g_PL_AD_fw_Radar_1R1V_rpc_XilObjBypassingRunnable_XilObjBypassingRunnable_m_pad_radarObjPort_par_out_local::TChangeableMemPool::_::_::_m_arrayPool::_0_::_elem::_m_objectInformation::_1_::_m_HandleN = 0;
        @sysvar::XCP::RadarFC_Obj::_g_PL_AD_fw_Radar_1R1V_rpc_XilObjBypassingRunnable_XilObjBypassingRunnable_m_pad_radarObjPort_par_out_local::TChangeableMemPool::_::_::_m_arrayPool::_0_::_elem::_m_objectInformation::_1_::_m_alpPiVarYawAngleN = 0;
        @sysvar::XCP::RadarFC_Obj::_g_PL_AD_fw_Radar_1R1V_rpc_XilObjBypassingRunnable_XilObjBypassingRunnable_m_pad_radarObjPort_par_out_local::TChangeableMemPool::_::_::_m_arrayPool::_0_::_elem::_m_objectInformation::_1_::_m_varAxN = 0;
        @sysvar::XCP::RadarFC_Obj::_g_PL_AD_fw_Radar_1R1V_rpc_XilObjBypassingRunnable_XilObjBypassingRunnable_m_pad_radarObjPort_par_out_local::TChangeableMemPool::_::_::_m_arrayPool::_0_::_elem::_m_objectInformation::_1_::_m_varAyN = 0;
        @sysvar::XCP::RadarFC_Obj::_g_PL_AD_fw_Radar_1R1V_rpc_XilObjBypassingRunnable_XilObjBypassingRunnable_m_pad_radarObjPort_par_out_local::TChangeableMemPool::_::_::_m_arrayPool::_0_::_elem::_m_objectInformation::_1_::_m_varVxN = 0;
        @sysvar::XCP::RadarFC_Obj::_g_PL_AD_fw_Radar_1R1V_rpc_XilObjBypassingRunnable_XilObjBypassingRunnable_m_pad_radarObjPort_par_out_local::TChangeableMemPool::_::_::_m_arrayPool::_0_::_elem::_m_objectInformation::_1_::_m_varVyN = 0;
        @sysvar::XCP::RadarFC_Obj::_g_PL_AD_fw_Radar_1R1V_rpc_XilObjBypassingRunnable_XilObjBypassingRunnable_m_pad_radarObjPort_par_out_local::TChangeableMemPool::_::_::_m_arrayPool::_0_::_elem::_m_objectInformation::_1_::_m_varDxN = 0;
        @sysvar::XCP::RadarFC_Obj::_g_PL_AD_fw_Radar_1R1V_rpc_XilObjBypassingRunnable_XilObjBypassingRunnable_m_pad_radarObjPort_par_out_local::TChangeableMemPool::_::_::_m_arrayPool::_0_::_elem::_m_objectInformation::_1_::_m_varDyN = 0;
        @sysvar::XCP::RadarFC_Obj::_g_PL_AD_fw_Radar_1R1V_rpc_XilObjBypassingRunnable_XilObjBypassingRunnable_m_pad_radarObjPort_par_out_local::TChangeableMemPool::_::_::_m_arrayPool::_0_::_elem::_m_objectInformation::_1_::_m_dVarLengthN = 0;
        @sysvar::XCP::RadarFC_Obj::_g_PL_AD_fw_Radar_1R1V_rpc_XilObjBypassingRunnable_XilObjBypassingRunnable_m_pad_radarObjPort_par_out_local::TChangeableMemPool::_::_::_m_arrayPool::_0_::_elem::_m_objectInformation::_1_::_m_dVarWidthN = 0;
        @sysvar::XCP::RadarFC_Obj::_g_PL_AD_fw_Radar_1R1V_rpc_XilObjBypassingRunnable_XilObjBypassingRunnable_m_pad_radarObjPort_par_out_local::TChangeableMemPool::_::_::_m_arrayPool::_0_::_elem::_m_objectInformation::_1_::_m_wExistProbN = 0;
        @sysvar::XCP::RadarFC_Obj::_g_PL_AD_fw_Radar_1R1V_rpc_XilObjBypassingRunnable_XilObjBypassingRunnable_m_pad_radarObjPort_par_out_local::TChangeableMemPool::_::_::_m_arrayPool::_0_::_elem::_m_objectInformation::_1_::_m_isObjectAsil = 0;
        @sysvar::XCP::RadarFC_Obj::_g_PL_AD_fw_Radar_1R1V_rpc_XilObjBypassingRunnable_XilObjBypassingRunnable_m_pad_radarObjPort_par_out_local::TChangeableMemPool::_::_::_m_arrayPool::_0_::_elem::_m_objectInformation::_1_::_m_dWidthN = 0;
        @sysvar::XCP::RadarFC_Obj::_g_PL_AD_fw_Radar_1R1V_rpc_XilObjBypassingRunnable_XilObjBypassingRunnable_m_pad_radarObjPort_par_out_local::TChangeableMemPool::_::_::_m_arrayPool::_0_::_elem::_m_objectInformation::_1_::_m_dLengthN = 0;
        @sysvar::XCP::RadarFC_Obj::_g_PL_AD_fw_Radar_1R1V_rpc_XilObjBypassingRunnable_XilObjBypassingRunnable_m_pad_radarObjPort_par_out_local::TChangeableMemPool::_::_::_m_arrayPool::_0_::_elem::_m_objectInformation::_1_::_m_dxN = 0;
        @sysvar::XCP::RadarFC_Obj::_g_PL_AD_fw_Radar_1R1V_rpc_XilObjBypassingRunnable_XilObjBypassingRunnable_m_pad_radarObjPort_par_out_local::TChangeableMemPool::_::_::_m_arrayPool::_0_::_elem::_m_objectInformation::_1_::_m_dyN = 0;
        @sysvar::XCP::RadarFC_Obj::_g_PL_AD_fw_Radar_1R1V_rpc_XilObjBypassingRunnable_XilObjBypassingRunnable_m_pad_radarObjPort_par_out_local::TChangeableMemPool::_::_::_m_arrayPool::_0_::_elem::_m_objectInformation::_1_::_m_dzN = 0;
        @sysvar::XCP::RadarFC_Obj::_g_PL_AD_fw_Radar_1R1V_rpc_XilObjBypassingRunnable_XilObjBypassingRunnable_m_pad_radarObjPort_par_out_local::TChangeableMemPool::_::_::_m_arrayPool::_0_::_elem::_m_objectInformation::_1_::_m_vxN = 0;
        @sysvar::XCP::RadarFC_Obj::_g_PL_AD_fw_Radar_1R1V_rpc_XilObjBypassingRunnable_XilObjBypassingRunnable_m_pad_radarObjPort_par_out_local::TChangeableMemPool::_::_::_m_arrayPool::_0_::_elem::_m_objectInformation::_1_::_m_vyN = 0;
        @sysvar::XCP::RadarFC_Obj::_g_PL_AD_fw_Radar_1R1V_rpc_XilObjBypassingRunnable_XilObjBypassingRunnable_m_pad_radarObjPort_par_out_local::TChangeableMemPool::_::_::_m_arrayPool::_0_::_elem::_m_objectInformation::_1_::_m_axN = 0;
        @sysvar::XCP::RadarFC_Obj::_g_PL_AD_fw_Radar_1R1V_rpc_XilObjBypassingRunnable_XilObjBypassingRunnable_m_pad_radarObjPort_par_out_local::TChangeableMemPool::_::_::_m_arrayPool::_0_::_elem::_m_objectInformation::_1_::_m_ayN = 0;
        @sysvar::XCP::RadarFC_Obj::_g_PL_AD_fw_Radar_1R1V_rpc_XilObjBypassingRunnable_XilObjBypassingRunnable_m_pad_radarObjPort_par_out_local::TChangeableMemPool::_::_::_m_arrayPool::_0_::_elem::_m_objectInformation::_1_::_m_alpPiYawAngleN = 0;
        @sysvar::XCP::RadarFC_Obj::_g_PL_AD_fw_Radar_1R1V_rpc_XilObjBypassingRunnable_XilObjBypassingRunnable_m_pad_radarObjPort_par_out_local::TChangeableMemPool::_::_::_m_arrayPool::_0_::_elem::_m_objectInformation::_1_::_m_prob1HasBeenObservedMovingN = 0;
        @sysvar::XCP::RadarFC_Obj::_g_PL_AD_fw_Radar_1R1V_rpc_XilObjBypassingRunnable_XilObjBypassingRunnable_m_pad_radarObjPort_par_out_local::TChangeableMemPool::_::_::_m_arrayPool::_0_::_elem::_m_objectInformation::_1_::_m_prob1MovingN = 0;
        @sysvar::XCP::RadarFC_Obj::_g_PL_AD_fw_Radar_1R1V_rpc_XilObjBypassingRunnable_XilObjBypassingRunnable_m_pad_radarObjPort_par_out_local::TChangeableMemPool::_::_::_m_arrayPool::_0_::_elem::_m_objectInformation::_1_::_m_perObjectType::_m_prob1ObstacleN = 0;
        @sysvar::XCP::RadarFC_Obj::_g_PL_AD_fw_Radar_1R1V_rpc_XilObjBypassingRunnable_XilObjBypassingRunnable_m_pad_radarObjPort_par_out_local::TChangeableMemPool::_::_::_m_arrayPool::_0_::_elem::_m_objectInformation::_1_::_m_perObjectType::_m_prob1NonObstacleN = 0;
        @sysvar::XCP::RadarFC_Obj::_g_PL_AD_fw_Radar_1R1V_rpc_XilObjBypassingRunnable_XilObjBypassingRunnable_m_pad_radarObjPort_par_out_local::TChangeableMemPool::_::_::_m_arrayPool::_0_::_elem::_m_objectInformation::_1_::_m_perObjectType::_m_prob1MobileN = 0;
        @sysvar::XCP::RadarFC_Obj::_g_PL_AD_fw_Radar_1R1V_rpc_XilObjBypassingRunnable_XilObjBypassingRunnable_m_pad_radarObjPort_par_out_local::TChangeableMemPool::_::_::_m_arrayPool::_0_::_elem::_m_objectInformation::_1_::_m_perObjectType::_m_prob1StationaryN = 0;
        @sysvar::XCP::RadarFC_Obj::_g_PL_AD_fw_Radar_1R1V_rpc_XilObjBypassingRunnable_XilObjBypassingRunnable_m_pad_radarObjPort_par_out_local::TChangeableMemPool::_::_::_m_arrayPool::_0_::_elem::_m_objectInformation::_1_::_m_perObjectType::_m_prob1FourPlusWheelerN = 0;
        @sysvar::XCP::RadarFC_Obj::_g_PL_AD_fw_Radar_1R1V_rpc_XilObjBypassingRunnable_XilObjBypassingRunnable_m_pad_radarObjPort_par_out_local::TChangeableMemPool::_::_::_m_arrayPool::_0_::_elem::_m_objectInformation::_1_::_m_perObjectType::_m_prob1TwoWheelerN = 0;
        @sysvar::XCP::RadarFC_Obj::_g_PL_AD_fw_Radar_1R1V_rpc_XilObjBypassingRunnable_XilObjBypassingRunnable_m_pad_radarObjPort_par_out_local::TChangeableMemPool::_::_::_m_arrayPool::_0_::_elem::_m_objectInformation::_1_::_m_perObjectType::_m_prob1PedestrianN = 0;
        @sysvar::XCP::RadarFC_Obj::_g_PL_AD_fw_Radar_1R1V_rpc_XilObjBypassingRunnable_XilObjBypassingRunnable_m_pad_radarObjPort_par_out_local::TChangeableMemPool::_::_::_m_arrayPool::_0_::_elem::_m_objectInformation::_1_::_m_perObjectType::_m_prob1RoadsideBarrierN = 0;
        @sysvar::XCP::RadarFC_Obj::_g_PL_AD_fw_Radar_1R1V_rpc_XilObjBypassingRunnable_XilObjBypassingRunnable_m_pad_radarObjPort_par_out_local::TChangeableMemPool::_::_::_m_arrayPool::_0_::_elem::_m_objectInformation::_1_::_m_perObjectType::_m_prob1PassengerCarN = 0;
        @sysvar::XCP::RadarFC_Obj::_g_PL_AD_fw_Radar_1R1V_rpc_XilObjBypassingRunnable_XilObjBypassingRunnable_m_pad_radarObjPort_par_out_local::TChangeableMemPool::_::_::_m_arrayPool::_0_::_elem::_m_objectInformation::_1_::_m_perObjectType::_m_prob1TruckN = 0;
        @sysvar::XCP::RadarFC_Obj::_g_PL_AD_fw_Radar_1R1V_rpc_XilObjBypassingRunnable_XilObjBypassingRunnable_m_pad_radarObjPort_par_out_local::TChangeableMemPool::_::_::_m_arrayPool::_0_::_elem::_m_objectInformation::_1_::_m_perObjectType::_m_prob1UnknownN = 0;
        @sysvar::XCP::RadarFC_Obj::_g_PL_AD_fw_Radar_1R1V_rpc_XilObjBypassingRunnable_XilObjBypassingRunnable_m_pad_radarObjPort_par_out_local::TChangeableMemPool::_::_::_m_arrayPool::_0_::_elem::_m_objectInformation::_1_::_m_perObjectType::_m_prob1MovUnknownN = 0;
        @sysvar::XCP::RadarFC_Obj::_g_PL_AD_fw_Radar_1R1V_rpc_XilObjBypassingRunnable_XilObjBypassingRunnable_m_pad_radarObjPort_par_out_local::TChangeableMemPool::_::_::_m_arrayPool::_0_::_elem::_m_objectInformation::_1_::_m_perObjectType::_m_prob1StatUnknownN = 0;
        @sysvar::XCP::RadarFC_Obj::_g_PL_AD_fw_Radar_1R1V_rpc_XilObjBypassingRunnable_XilObjBypassingRunnable_m_pad_radarObjPort_par_out_local::TChangeableMemPool::_::_::_m_arrayPool::_0_::_elem::_m_objectInformation::_1_::_m_perObjectType::_m_prob1ObstUnknownN = 0;
        @sysvar::XCP::RadarFC_Obj::_g_PL_AD_fw_Radar_1R1V_rpc_XilObjBypassingRunnable_XilObjBypassingRunnable_m_pad_radarObjPort_par_out_local::TChangeableMemPool::_::_::_m_arrayPool::_0_::_elem::_m_objectInformation::_1_::_m_perObjectType::_m_prob1FourWheelUnknownN = 0;
        break;
        
      case 2: //"Object-2"
        @sysvar::XCP::RadarFC_Obj::_g_PL_AD_fw_Radar_1R1V_rpc_XilObjBypassingRunnable_XilObjBypassingRunnable_m_pad_radarObjPort_par_out_local::TChangeableMemPool::_::_::_m_arrayPool::_0_::_elem::_m_objectInformation::_2_::_Valid_b = 0;
        @sysvar::XCP::RadarFC_Obj::_g_PL_AD_fw_Radar_1R1V_rpc_XilObjBypassingRunnable_XilObjBypassingRunnable_m_pad_radarObjPort_par_out_local::TChangeableMemPool::_::_::_m_arrayPool::_0_::_elem::_m_objectInformation::_2_::_m_HandleN = 0;
        @sysvar::XCP::RadarFC_Obj::_g_PL_AD_fw_Radar_1R1V_rpc_XilObjBypassingRunnable_XilObjBypassingRunnable_m_pad_radarObjPort_par_out_local::TChangeableMemPool::_::_::_m_arrayPool::_0_::_elem::_m_objectInformation::_2_::_m_alpPiVarYawAngleN = 0;
        @sysvar::XCP::RadarFC_Obj::_g_PL_AD_fw_Radar_1R1V_rpc_XilObjBypassingRunnable_XilObjBypassingRunnable_m_pad_radarObjPort_par_out_local::TChangeableMemPool::_::_::_m_arrayPool::_0_::_elem::_m_objectInformation::_2_::_m_varAxN = 0;
        @sysvar::XCP::RadarFC_Obj::_g_PL_AD_fw_Radar_1R1V_rpc_XilObjBypassingRunnable_XilObjBypassingRunnable_m_pad_radarObjPort_par_out_local::TChangeableMemPool::_::_::_m_arrayPool::_0_::_elem::_m_objectInformation::_2_::_m_varAyN = 0;
        @sysvar::XCP::RadarFC_Obj::_g_PL_AD_fw_Radar_1R1V_rpc_XilObjBypassingRunnable_XilObjBypassingRunnable_m_pad_radarObjPort_par_out_local::TChangeableMemPool::_::_::_m_arrayPool::_0_::_elem::_m_objectInformation::_2_::_m_varVxN = 0;
        @sysvar::XCP::RadarFC_Obj::_g_PL_AD_fw_Radar_1R1V_rpc_XilObjBypassingRunnable_XilObjBypassingRunnable_m_pad_radarObjPort_par_out_local::TChangeableMemPool::_::_::_m_arrayPool::_0_::_elem::_m_objectInformation::_2_::_m_varVyN = 0;
        @sysvar::XCP::RadarFC_Obj::_g_PL_AD_fw_Radar_1R1V_rpc_XilObjBypassingRunnable_XilObjBypassingRunnable_m_pad_radarObjPort_par_out_local::TChangeableMemPool::_::_::_m_arrayPool::_0_::_elem::_m_objectInformation::_2_::_m_varDxN = 0;
        @sysvar::XCP::RadarFC_Obj::_g_PL_AD_fw_Radar_1R1V_rpc_XilObjBypassingRunnable_XilObjBypassingRunnable_m_pad_radarObjPort_par_out_local::TChangeableMemPool::_::_::_m_arrayPool::_0_::_elem::_m_objectInformation::_2_::_m_varDyN = 0;
        @sysvar::XCP::RadarFC_Obj::_g_PL_AD_fw_Radar_1R1V_rpc_XilObjBypassingRunnable_XilObjBypassingRunnable_m_pad_radarObjPort_par_out_local::TChangeableMemPool::_::_::_m_arrayPool::_0_::_elem::_m_objectInformation::_2_::_m_dVarLengthN = 0;
        @sysvar::XCP::RadarFC_Obj::_g_PL_AD_fw_Radar_1R1V_rpc_XilObjBypassingRunnable_XilObjBypassingRunnable_m_pad_radarObjPort_par_out_local::TChangeableMemPool::_::_::_m_arrayPool::_0_::_elem::_m_objectInformation::_2_::_m_dVarWidthN = 0;
        @sysvar::XCP::RadarFC_Obj::_g_PL_AD_fw_Radar_1R1V_rpc_XilObjBypassingRunnable_XilObjBypassingRunnable_m_pad_radarObjPort_par_out_local::TChangeableMemPool::_::_::_m_arrayPool::_0_::_elem::_m_objectInformation::_2_::_m_wExistProbN = 0;
        @sysvar::XCP::RadarFC_Obj::_g_PL_AD_fw_Radar_1R1V_rpc_XilObjBypassingRunnable_XilObjBypassingRunnable_m_pad_radarObjPort_par_out_local::TChangeableMemPool::_::_::_m_arrayPool::_0_::_elem::_m_objectInformation::_2_::_m_isObjectAsil = 0;
        @sysvar::XCP::RadarFC_Obj::_g_PL_AD_fw_Radar_1R1V_rpc_XilObjBypassingRunnable_XilObjBypassingRunnable_m_pad_radarObjPort_par_out_local::TChangeableMemPool::_::_::_m_arrayPool::_0_::_elem::_m_objectInformation::_2_::_m_dWidthN = 0;
        @sysvar::XCP::RadarFC_Obj::_g_PL_AD_fw_Radar_1R1V_rpc_XilObjBypassingRunnable_XilObjBypassingRunnable_m_pad_radarObjPort_par_out_local::TChangeableMemPool::_::_::_m_arrayPool::_0_::_elem::_m_objectInformation::_2_::_m_dLengthN = 0;
        @sysvar::XCP::RadarFC_Obj::_g_PL_AD_fw_Radar_1R1V_rpc_XilObjBypassingRunnable_XilObjBypassingRunnable_m_pad_radarObjPort_par_out_local::TChangeableMemPool::_::_::_m_arrayPool::_0_::_elem::_m_objectInformation::_2_::_m_dxN = 0;
        @sysvar::XCP::RadarFC_Obj::_g_PL_AD_fw_Radar_1R1V_rpc_XilObjBypassingRunnable_XilObjBypassingRunnable_m_pad_radarObjPort_par_out_local::TChangeableMemPool::_::_::_m_arrayPool::_0_::_elem::_m_objectInformation::_2_::_m_dyN = 0;
        @sysvar::XCP::RadarFC_Obj::_g_PL_AD_fw_Radar_1R1V_rpc_XilObjBypassingRunnable_XilObjBypassingRunnable_m_pad_radarObjPort_par_out_local::TChangeableMemPool::_::_::_m_arrayPool::_0_::_elem::_m_objectInformation::_2_::_m_dzN = 0;
        @sysvar::XCP::RadarFC_Obj::_g_PL_AD_fw_Radar_1R1V_rpc_XilObjBypassingRunnable_XilObjBypassingRunnable_m_pad_radarObjPort_par_out_local::TChangeableMemPool::_::_::_m_arrayPool::_0_::_elem::_m_objectInformation::_2_::_m_vxN = 0;
        @sysvar::XCP::RadarFC_Obj::_g_PL_AD_fw_Radar_1R1V_rpc_XilObjBypassingRunnable_XilObjBypassingRunnable_m_pad_radarObjPort_par_out_local::TChangeableMemPool::_::_::_m_arrayPool::_0_::_elem::_m_objectInformation::_2_::_m_vyN = 0;
        @sysvar::XCP::RadarFC_Obj::_g_PL_AD_fw_Radar_1R1V_rpc_XilObjBypassingRunnable_XilObjBypassingRunnable_m_pad_radarObjPort_par_out_local::TChangeableMemPool::_::_::_m_arrayPool::_0_::_elem::_m_objectInformation::_2_::_m_axN = 0;
        @sysvar::XCP::RadarFC_Obj::_g_PL_AD_fw_Radar_1R1V_rpc_XilObjBypassingRunnable_XilObjBypassingRunnable_m_pad_radarObjPort_par_out_local::TChangeableMemPool::_::_::_m_arrayPool::_0_::_elem::_m_objectInformation::_2_::_m_ayN = 0;
        @sysvar::XCP::RadarFC_Obj::_g_PL_AD_fw_Radar_1R1V_rpc_XilObjBypassingRunnable_XilObjBypassingRunnable_m_pad_radarObjPort_par_out_local::TChangeableMemPool::_::_::_m_arrayPool::_0_::_elem::_m_objectInformation::_2_::_m_alpPiYawAngleN = 0;
        @sysvar::XCP::RadarFC_Obj::_g_PL_AD_fw_Radar_1R1V_rpc_XilObjBypassingRunnable_XilObjBypassingRunnable_m_pad_radarObjPort_par_out_local::TChangeableMemPool::_::_::_m_arrayPool::_0_::_elem::_m_objectInformation::_2_::_m_prob1HasBeenObservedMovingN = 0;
        @sysvar::XCP::RadarFC_Obj::_g_PL_AD_fw_Radar_1R1V_rpc_XilObjBypassingRunnable_XilObjBypassingRunnable_m_pad_radarObjPort_par_out_local::TChangeableMemPool::_::_::_m_arrayPool::_0_::_elem::_m_objectInformation::_2_::_m_prob1MovingN = 0;
        @sysvar::XCP::RadarFC_Obj::_g_PL_AD_fw_Radar_1R1V_rpc_XilObjBypassingRunnable_XilObjBypassingRunnable_m_pad_radarObjPort_par_out_local::TChangeableMemPool::_::_::_m_arrayPool::_0_::_elem::_m_objectInformation::_2_::_m_perObjectType::_m_prob1ObstacleN = 0;
        @sysvar::XCP::RadarFC_Obj::_g_PL_AD_fw_Radar_1R1V_rpc_XilObjBypassingRunnable_XilObjBypassingRunnable_m_pad_radarObjPort_par_out_local::TChangeableMemPool::_::_::_m_arrayPool::_0_::_elem::_m_objectInformation::_2_::_m_perObjectType::_m_prob1NonObstacleN = 0;
        @sysvar::XCP::RadarFC_Obj::_g_PL_AD_fw_Radar_1R1V_rpc_XilObjBypassingRunnable_XilObjBypassingRunnable_m_pad_radarObjPort_par_out_local::TChangeableMemPool::_::_::_m_arrayPool::_0_::_elem::_m_objectInformation::_2_::_m_perObjectType::_m_prob1MobileN = 0;
        @sysvar::XCP::RadarFC_Obj::_g_PL_AD_fw_Radar_1R1V_rpc_XilObjBypassingRunnable_XilObjBypassingRunnable_m_pad_radarObjPort_par_out_local::TChangeableMemPool::_::_::_m_arrayPool::_0_::_elem::_m_objectInformation::_2_::_m_perObjectType::_m_prob1StationaryN = 0;
        @sysvar::XCP::RadarFC_Obj::_g_PL_AD_fw_Radar_1R1V_rpc_XilObjBypassingRunnable_XilObjBypassingRunnable_m_pad_radarObjPort_par_out_local::TChangeableMemPool::_::_::_m_arrayPool::_0_::_elem::_m_objectInformation::_2_::_m_perObjectType::_m_prob1FourPlusWheelerN = 0;
        @sysvar::XCP::RadarFC_Obj::_g_PL_AD_fw_Radar_1R1V_rpc_XilObjBypassingRunnable_XilObjBypassingRunnable_m_pad_radarObjPort_par_out_local::TChangeableMemPool::_::_::_m_arrayPool::_0_::_elem::_m_objectInformation::_2_::_m_perObjectType::_m_prob1TwoWheelerN = 0;
        @sysvar::XCP::RadarFC_Obj::_g_PL_AD_fw_Radar_1R1V_rpc_XilObjBypassingRunnable_XilObjBypassingRunnable_m_pad_radarObjPort_par_out_local::TChangeableMemPool::_::_::_m_arrayPool::_0_::_elem::_m_objectInformation::_2_::_m_perObjectType::_m_prob1PedestrianN = 0;
        @sysvar::XCP::RadarFC_Obj::_g_PL_AD_fw_Radar_1R1V_rpc_XilObjBypassingRunnable_XilObjBypassingRunnable_m_pad_radarObjPort_par_out_local::TChangeableMemPool::_::_::_m_arrayPool::_0_::_elem::_m_objectInformation::_2_::_m_perObjectType::_m_prob1RoadsideBarrierN = 0;
        @sysvar::XCP::RadarFC_Obj::_g_PL_AD_fw_Radar_1R1V_rpc_XilObjBypassingRunnable_XilObjBypassingRunnable_m_pad_radarObjPort_par_out_local::TChangeableMemPool::_::_::_m_arrayPool::_0_::_elem::_m_objectInformation::_2_::_m_perObjectType::_m_prob1PassengerCarN = 0;
        @sysvar::XCP::RadarFC_Obj::_g_PL_AD_fw_Radar_1R1V_rpc_XilObjBypassingRunnable_XilObjBypassingRunnable_m_pad_radarObjPort_par_out_local::TChangeableMemPool::_::_::_m_arrayPool::_0_::_elem::_m_objectInformation::_2_::_m_perObjectType::_m_prob1TruckN = 0;
        @sysvar::XCP::RadarFC_Obj::_g_PL_AD_fw_Radar_1R1V_rpc_XilObjBypassingRunnable_XilObjBypassingRunnable_m_pad_radarObjPort_par_out_local::TChangeableMemPool::_::_::_m_arrayPool::_0_::_elem::_m_objectInformation::_2_::_m_perObjectType::_m_prob1UnknownN = 0;
        @sysvar::XCP::RadarFC_Obj::_g_PL_AD_fw_Radar_1R1V_rpc_XilObjBypassingRunnable_XilObjBypassingRunnable_m_pad_radarObjPort_par_out_local::TChangeableMemPool::_::_::_m_arrayPool::_0_::_elem::_m_objectInformation::_2_::_m_perObjectType::_m_prob1MovUnknownN = 0;
        @sysvar::XCP::RadarFC_Obj::_g_PL_AD_fw_Radar_1R1V_rpc_XilObjBypassingRunnable_XilObjBypassingRunnable_m_pad_radarObjPort_par_out_local::TChangeableMemPool::_::_::_m_arrayPool::_0_::_elem::_m_objectInformation::_2_::_m_perObjectType::_m_prob1StatUnknownN = 0;
        @sysvar::XCP::RadarFC_Obj::_g_PL_AD_fw_Radar_1R1V_rpc_XilObjBypassingRunnable_XilObjBypassingRunnable_m_pad_radarObjPort_par_out_local::TChangeableMemPool::_::_::_m_arrayPool::_0_::_elem::_m_objectInformation::_2_::_m_perObjectType::_m_prob1ObstUnknownN = 0;
        @sysvar::XCP::RadarFC_Obj::_g_PL_AD_fw_Radar_1R1V_rpc_XilObjBypassingRunnable_XilObjBypassingRunnable_m_pad_radarObjPort_par_out_local::TChangeableMemPool::_::_::_m_arrayPool::_0_::_elem::_m_objectInformation::_2_::_m_perObjectType::_m_prob1FourWheelUnknownN = 0;
        break;
        
      case 3: //"Object-3"
        @sysvar::XCP::RadarFC_Obj::_g_PL_AD_fw_Radar_1R1V_rpc_XilObjBypassingRunnable_XilObjBypassingRunnable_m_pad_radarObjPort_par_out_local::TChangeableMemPool::_::_::_m_arrayPool::_0_::_elem::_m_objectInformation::_3_::_Valid_b = 0;
        @sysvar::XCP::RadarFC_Obj::_g_PL_AD_fw_Radar_1R1V_rpc_XilObjBypassingRunnable_XilObjBypassingRunnable_m_pad_radarObjPort_par_out_local::TChangeableMemPool::_::_::_m_arrayPool::_0_::_elem::_m_objectInformation::_3_::_m_HandleN = 0;
        @sysvar::XCP::RadarFC_Obj::_g_PL_AD_fw_Radar_1R1V_rpc_XilObjBypassingRunnable_XilObjBypassingRunnable_m_pad_radarObjPort_par_out_local::TChangeableMemPool::_::_::_m_arrayPool::_0_::_elem::_m_objectInformation::_3_::_m_alpPiVarYawAngleN = 0;
        @sysvar::XCP::RadarFC_Obj::_g_PL_AD_fw_Radar_1R1V_rpc_XilObjBypassingRunnable_XilObjBypassingRunnable_m_pad_radarObjPort_par_out_local::TChangeableMemPool::_::_::_m_arrayPool::_0_::_elem::_m_objectInformation::_3_::_m_varAxN = 0;
        @sysvar::XCP::RadarFC_Obj::_g_PL_AD_fw_Radar_1R1V_rpc_XilObjBypassingRunnable_XilObjBypassingRunnable_m_pad_radarObjPort_par_out_local::TChangeableMemPool::_::_::_m_arrayPool::_0_::_elem::_m_objectInformation::_3_::_m_varAyN = 0;
        @sysvar::XCP::RadarFC_Obj::_g_PL_AD_fw_Radar_1R1V_rpc_XilObjBypassingRunnable_XilObjBypassingRunnable_m_pad_radarObjPort_par_out_local::TChangeableMemPool::_::_::_m_arrayPool::_0_::_elem::_m_objectInformation::_3_::_m_varVxN = 0;
        @sysvar::XCP::RadarFC_Obj::_g_PL_AD_fw_Radar_1R1V_rpc_XilObjBypassingRunnable_XilObjBypassingRunnable_m_pad_radarObjPort_par_out_local::TChangeableMemPool::_::_::_m_arrayPool::_0_::_elem::_m_objectInformation::_3_::_m_varVyN = 0;
        @sysvar::XCP::RadarFC_Obj::_g_PL_AD_fw_Radar_1R1V_rpc_XilObjBypassingRunnable_XilObjBypassingRunnable_m_pad_radarObjPort_par_out_local::TChangeableMemPool::_::_::_m_arrayPool::_0_::_elem::_m_objectInformation::_3_::_m_varDxN = 0;
        @sysvar::XCP::RadarFC_Obj::_g_PL_AD_fw_Radar_1R1V_rpc_XilObjBypassingRunnable_XilObjBypassingRunnable_m_pad_radarObjPort_par_out_local::TChangeableMemPool::_::_::_m_arrayPool::_0_::_elem::_m_objectInformation::_3_::_m_varDyN = 0;
        @sysvar::XCP::RadarFC_Obj::_g_PL_AD_fw_Radar_1R1V_rpc_XilObjBypassingRunnable_XilObjBypassingRunnable_m_pad_radarObjPort_par_out_local::TChangeableMemPool::_::_::_m_arrayPool::_0_::_elem::_m_objectInformation::_3_::_m_dVarLengthN = 0;
        @sysvar::XCP::RadarFC_Obj::_g_PL_AD_fw_Radar_1R1V_rpc_XilObjBypassingRunnable_XilObjBypassingRunnable_m_pad_radarObjPort_par_out_local::TChangeableMemPool::_::_::_m_arrayPool::_0_::_elem::_m_objectInformation::_3_::_m_dVarWidthN = 0;
        @sysvar::XCP::RadarFC_Obj::_g_PL_AD_fw_Radar_1R1V_rpc_XilObjBypassingRunnable_XilObjBypassingRunnable_m_pad_radarObjPort_par_out_local::TChangeableMemPool::_::_::_m_arrayPool::_0_::_elem::_m_objectInformation::_3_::_m_wExistProbN = 0;
        @sysvar::XCP::RadarFC_Obj::_g_PL_AD_fw_Radar_1R1V_rpc_XilObjBypassingRunnable_XilObjBypassingRunnable_m_pad_radarObjPort_par_out_local::TChangeableMemPool::_::_::_m_arrayPool::_0_::_elem::_m_objectInformation::_3_::_m_isObjectAsil = 0;
        @sysvar::XCP::RadarFC_Obj::_g_PL_AD_fw_Radar_1R1V_rpc_XilObjBypassingRunnable_XilObjBypassingRunnable_m_pad_radarObjPort_par_out_local::TChangeableMemPool::_::_::_m_arrayPool::_0_::_elem::_m_objectInformation::_3_::_m_dWidthN = 0;
        @sysvar::XCP::RadarFC_Obj::_g_PL_AD_fw_Radar_1R1V_rpc_XilObjBypassingRunnable_XilObjBypassingRunnable_m_pad_radarObjPort_par_out_local::TChangeableMemPool::_::_::_m_arrayPool::_0_::_elem::_m_objectInformation::_3_::_m_dLengthN = 0;
        @sysvar::XCP::RadarFC_Obj::_g_PL_AD_fw_Radar_1R1V_rpc_XilObjBypassingRunnable_XilObjBypassingRunnable_m_pad_radarObjPort_par_out_local::TChangeableMemPool::_::_::_m_arrayPool::_0_::_elem::_m_objectInformation::_3_::_m_dxN = 0;
        @sysvar::XCP::RadarFC_Obj::_g_PL_AD_fw_Radar_1R1V_rpc_XilObjBypassingRunnable_XilObjBypassingRunnable_m_pad_radarObjPort_par_out_local::TChangeableMemPool::_::_::_m_arrayPool::_0_::_elem::_m_objectInformation::_3_::_m_dyN = 0;
        @sysvar::XCP::RadarFC_Obj::_g_PL_AD_fw_Radar_1R1V_rpc_XilObjBypassingRunnable_XilObjBypassingRunnable_m_pad_radarObjPort_par_out_local::TChangeableMemPool::_::_::_m_arrayPool::_0_::_elem::_m_objectInformation::_3_::_m_dzN = 0;
        @sysvar::XCP::RadarFC_Obj::_g_PL_AD_fw_Radar_1R1V_rpc_XilObjBypassingRunnable_XilObjBypassingRunnable_m_pad_radarObjPort_par_out_local::TChangeableMemPool::_::_::_m_arrayPool::_0_::_elem::_m_objectInformation::_3_::_m_vxN = 0;
        @sysvar::XCP::RadarFC_Obj::_g_PL_AD_fw_Radar_1R1V_rpc_XilObjBypassingRunnable_XilObjBypassingRunnable_m_pad_radarObjPort_par_out_local::TChangeableMemPool::_::_::_m_arrayPool::_0_::_elem::_m_objectInformation::_3_::_m_vyN = 0;
        @sysvar::XCP::RadarFC_Obj::_g_PL_AD_fw_Radar_1R1V_rpc_XilObjBypassingRunnable_XilObjBypassingRunnable_m_pad_radarObjPort_par_out_local::TChangeableMemPool::_::_::_m_arrayPool::_0_::_elem::_m_objectInformation::_3_::_m_axN = 0;
        @sysvar::XCP::RadarFC_Obj::_g_PL_AD_fw_Radar_1R1V_rpc_XilObjBypassingRunnable_XilObjBypassingRunnable_m_pad_radarObjPort_par_out_local::TChangeableMemPool::_::_::_m_arrayPool::_0_::_elem::_m_objectInformation::_3_::_m_ayN = 0;
        @sysvar::XCP::RadarFC_Obj::_g_PL_AD_fw_Radar_1R1V_rpc_XilObjBypassingRunnable_XilObjBypassingRunnable_m_pad_radarObjPort_par_out_local::TChangeableMemPool::_::_::_m_arrayPool::_0_::_elem::_m_objectInformation::_3_::_m_alpPiYawAngleN = 0;
        @sysvar::XCP::RadarFC_Obj::_g_PL_AD_fw_Radar_1R1V_rpc_XilObjBypassingRunnable_XilObjBypassingRunnable_m_pad_radarObjPort_par_out_local::TChangeableMemPool::_::_::_m_arrayPool::_0_::_elem::_m_objectInformation::_3_::_m_prob1HasBeenObservedMovingN = 0;
        @sysvar::XCP::RadarFC_Obj::_g_PL_AD_fw_Radar_1R1V_rpc_XilObjBypassingRunnable_XilObjBypassingRunnable_m_pad_radarObjPort_par_out_local::TChangeableMemPool::_::_::_m_arrayPool::_0_::_elem::_m_objectInformation::_3_::_m_prob1MovingN = 0;
        @sysvar::XCP::RadarFC_Obj::_g_PL_AD_fw_Radar_1R1V_rpc_XilObjBypassingRunnable_XilObjBypassingRunnable_m_pad_radarObjPort_par_out_local::TChangeableMemPool::_::_::_m_arrayPool::_0_::_elem::_m_objectInformation::_3_::_m_perObjectType::_m_prob1ObstacleN = 0;
        @sysvar::XCP::RadarFC_Obj::_g_PL_AD_fw_Radar_1R1V_rpc_XilObjBypassingRunnable_XilObjBypassingRunnable_m_pad_radarObjPort_par_out_local::TChangeableMemPool::_::_::_m_arrayPool::_0_::_elem::_m_objectInformation::_3_::_m_perObjectType::_m_prob1NonObstacleN = 0;
        @sysvar::XCP::RadarFC_Obj::_g_PL_AD_fw_Radar_1R1V_rpc_XilObjBypassingRunnable_XilObjBypassingRunnable_m_pad_radarObjPort_par_out_local::TChangeableMemPool::_::_::_m_arrayPool::_0_::_elem::_m_objectInformation::_3_::_m_perObjectType::_m_prob1MobileN = 0;
        @sysvar::XCP::RadarFC_Obj::_g_PL_AD_fw_Radar_1R1V_rpc_XilObjBypassingRunnable_XilObjBypassingRunnable_m_pad_radarObjPort_par_out_local::TChangeableMemPool::_::_::_m_arrayPool::_0_::_elem::_m_objectInformation::_3_::_m_perObjectType::_m_prob1StationaryN = 0;
        @sysvar::XCP::RadarFC_Obj::_g_PL_AD_fw_Radar_1R1V_rpc_XilObjBypassingRunnable_XilObjBypassingRunnable_m_pad_radarObjPort_par_out_local::TChangeableMemPool::_::_::_m_arrayPool::_0_::_elem::_m_objectInformation::_3_::_m_perObjectType::_m_prob1FourPlusWheelerN = 0;
        @sysvar::XCP::RadarFC_Obj::_g_PL_AD_fw_Radar_1R1V_rpc_XilObjBypassingRunnable_XilObjBypassingRunnable_m_pad_radarObjPort_par_out_local::TChangeableMemPool::_::_::_m_arrayPool::_0_::_elem::_m_objectInformation::_3_::_m_perObjectType::_m_prob1TwoWheelerN = 0;
        @sysvar::XCP::RadarFC_Obj::_g_PL_AD_fw_Radar_1R1V_rpc_XilObjBypassingRunnable_XilObjBypassingRunnable_m_pad_radarObjPort_par_out_local::TChangeableMemPool::_::_::_m_arrayPool::_0_::_elem::_m_objectInformation::_3_::_m_perObjectType::_m_prob1PedestrianN = 0;
        @sysvar::XCP::RadarFC_Obj::_g_PL_AD_fw_Radar_1R1V_rpc_XilObjBypassingRunnable_XilObjBypassingRunnable_m_pad_radarObjPort_par_out_local::TChangeableMemPool::_::_::_m_arrayPool::_0_::_elem::_m_objectInformation::_3_::_m_perObjectType::_m_prob1RoadsideBarrierN = 0;
        @sysvar::XCP::RadarFC_Obj::_g_PL_AD_fw_Radar_1R1V_rpc_XilObjBypassingRunnable_XilObjBypassingRunnable_m_pad_radarObjPort_par_out_local::TChangeableMemPool::_::_::_m_arrayPool::_0_::_elem::_m_objectInformation::_3_::_m_perObjectType::_m_prob1PassengerCarN = 0;
        @sysvar::XCP::RadarFC_Obj::_g_PL_AD_fw_Radar_1R1V_rpc_XilObjBypassingRunnable_XilObjBypassingRunnable_m_pad_radarObjPort_par_out_local::TChangeableMemPool::_::_::_m_arrayPool::_0_::_elem::_m_objectInformation::_3_::_m_perObjectType::_m_prob1TruckN = 0;
        @sysvar::XCP::RadarFC_Obj::_g_PL_AD_fw_Radar_1R1V_rpc_XilObjBypassingRunnable_XilObjBypassingRunnable_m_pad_radarObjPort_par_out_local::TChangeableMemPool::_::_::_m_arrayPool::_0_::_elem::_m_objectInformation::_3_::_m_perObjectType::_m_prob1UnknownN = 0;
        @sysvar::XCP::RadarFC_Obj::_g_PL_AD_fw_Radar_1R1V_rpc_XilObjBypassingRunnable_XilObjBypassingRunnable_m_pad_radarObjPort_par_out_local::TChangeableMemPool::_::_::_m_arrayPool::_0_::_elem::_m_objectInformation::_3_::_m_perObjectType::_m_prob1MovUnknownN = 0;
        @sysvar::XCP::RadarFC_Obj::_g_PL_AD_fw_Radar_1R1V_rpc_XilObjBypassingRunnable_XilObjBypassingRunnable_m_pad_radarObjPort_par_out_local::TChangeableMemPool::_::_::_m_arrayPool::_0_::_elem::_m_objectInformation::_3_::_m_perObjectType::_m_prob1StatUnknownN = 0;
        @sysvar::XCP::RadarFC_Obj::_g_PL_AD_fw_Radar_1R1V_rpc_XilObjBypassingRunnable_XilObjBypassingRunnable_m_pad_radarObjPort_par_out_local::TChangeableMemPool::_::_::_m_arrayPool::_0_::_elem::_m_objectInformation::_3_::_m_perObjectType::_m_prob1ObstUnknownN = 0;
        @sysvar::XCP::RadarFC_Obj::_g_PL_AD_fw_Radar_1R1V_rpc_XilObjBypassingRunnable_XilObjBypassingRunnable_m_pad_radarObjPort_par_out_local::TChangeableMemPool::_::_::_m_arrayPool::_0_::_elem::_m_objectInformation::_3_::_m_perObjectType::_m_prob1FourWheelUnknownN = 0;
        break;
        
      case 4: //"Object-4"
        @sysvar::XCP::RadarFC_Obj::_g_PL_AD_fw_Radar_1R1V_rpc_XilObjBypassingRunnable_XilObjBypassingRunnable_m_pad_radarObjPort_par_out_local::TChangeableMemPool::_::_::_m_arrayPool::_0_::_elem::_m_objectInformation::_4_::_Valid_b = 0;
        @sysvar::XCP::RadarFC_Obj::_g_PL_AD_fw_Radar_1R1V_rpc_XilObjBypassingRunnable_XilObjBypassingRunnable_m_pad_radarObjPort_par_out_local::TChangeableMemPool::_::_::_m_arrayPool::_0_::_elem::_m_objectInformation::_4_::_m_HandleN = 0;
        @sysvar::XCP::RadarFC_Obj::_g_PL_AD_fw_Radar_1R1V_rpc_XilObjBypassingRunnable_XilObjBypassingRunnable_m_pad_radarObjPort_par_out_local::TChangeableMemPool::_::_::_m_arrayPool::_0_::_elem::_m_objectInformation::_4_::_m_alpPiVarYawAngleN = 0;
        @sysvar::XCP::RadarFC_Obj::_g_PL_AD_fw_Radar_1R1V_rpc_XilObjBypassingRunnable_XilObjBypassingRunnable_m_pad_radarObjPort_par_out_local::TChangeableMemPool::_::_::_m_arrayPool::_0_::_elem::_m_objectInformation::_4_::_m_varAxN = 0;
        @sysvar::XCP::RadarFC_Obj::_g_PL_AD_fw_Radar_1R1V_rpc_XilObjBypassingRunnable_XilObjBypassingRunnable_m_pad_radarObjPort_par_out_local::TChangeableMemPool::_::_::_m_arrayPool::_0_::_elem::_m_objectInformation::_4_::_m_varAyN = 0;
        @sysvar::XCP::RadarFC_Obj::_g_PL_AD_fw_Radar_1R1V_rpc_XilObjBypassingRunnable_XilObjBypassingRunnable_m_pad_radarObjPort_par_out_local::TChangeableMemPool::_::_::_m_arrayPool::_0_::_elem::_m_objectInformation::_4_::_m_varVxN = 0;
        @sysvar::XCP::RadarFC_Obj::_g_PL_AD_fw_Radar_1R1V_rpc_XilObjBypassingRunnable_XilObjBypassingRunnable_m_pad_radarObjPort_par_out_local::TChangeableMemPool::_::_::_m_arrayPool::_0_::_elem::_m_objectInformation::_4_::_m_varVyN = 0;
        @sysvar::XCP::RadarFC_Obj::_g_PL_AD_fw_Radar_1R1V_rpc_XilObjBypassingRunnable_XilObjBypassingRunnable_m_pad_radarObjPort_par_out_local::TChangeableMemPool::_::_::_m_arrayPool::_0_::_elem::_m_objectInformation::_4_::_m_varDxN = 0;
        @sysvar::XCP::RadarFC_Obj::_g_PL_AD_fw_Radar_1R1V_rpc_XilObjBypassingRunnable_XilObjBypassingRunnable_m_pad_radarObjPort_par_out_local::TChangeableMemPool::_::_::_m_arrayPool::_0_::_elem::_m_objectInformation::_4_::_m_varDyN = 0;
        @sysvar::XCP::RadarFC_Obj::_g_PL_AD_fw_Radar_1R1V_rpc_XilObjBypassingRunnable_XilObjBypassingRunnable_m_pad_radarObjPort_par_out_local::TChangeableMemPool::_::_::_m_arrayPool::_0_::_elem::_m_objectInformation::_4_::_m_dVarLengthN = 0;
        @sysvar::XCP::RadarFC_Obj::_g_PL_AD_fw_Radar_1R1V_rpc_XilObjBypassingRunnable_XilObjBypassingRunnable_m_pad_radarObjPort_par_out_local::TChangeableMemPool::_::_::_m_arrayPool::_0_::_elem::_m_objectInformation::_4_::_m_dVarWidthN = 0;
        @sysvar::XCP::RadarFC_Obj::_g_PL_AD_fw_Radar_1R1V_rpc_XilObjBypassingRunnable_XilObjBypassingRunnable_m_pad_radarObjPort_par_out_local::TChangeableMemPool::_::_::_m_arrayPool::_0_::_elem::_m_objectInformation::_4_::_m_wExistProbN = 0;
        @sysvar::XCP::RadarFC_Obj::_g_PL_AD_fw_Radar_1R1V_rpc_XilObjBypassingRunnable_XilObjBypassingRunnable_m_pad_radarObjPort_par_out_local::TChangeableMemPool::_::_::_m_arrayPool::_0_::_elem::_m_objectInformation::_4_::_m_isObjectAsil = 0;
        @sysvar::XCP::RadarFC_Obj::_g_PL_AD_fw_Radar_1R1V_rpc_XilObjBypassingRunnable_XilObjBypassingRunnable_m_pad_radarObjPort_par_out_local::TChangeableMemPool::_::_::_m_arrayPool::_0_::_elem::_m_objectInformation::_4_::_m_dWidthN = 0;
        @sysvar::XCP::RadarFC_Obj::_g_PL_AD_fw_Radar_1R1V_rpc_XilObjBypassingRunnable_XilObjBypassingRunnable_m_pad_radarObjPort_par_out_local::TChangeableMemPool::_::_::_m_arrayPool::_0_::_elem::_m_objectInformation::_4_::_m_dLengthN = 0;
        @sysvar::XCP::RadarFC_Obj::_g_PL_AD_fw_Radar_1R1V_rpc_XilObjBypassingRunnable_XilObjBypassingRunnable_m_pad_radarObjPort_par_out_local::TChangeableMemPool::_::_::_m_arrayPool::_0_::_elem::_m_objectInformation::_4_::_m_dxN = 0;
        @sysvar::XCP::RadarFC_Obj::_g_PL_AD_fw_Radar_1R1V_rpc_XilObjBypassingRunnable_XilObjBypassingRunnable_m_pad_radarObjPort_par_out_local::TChangeableMemPool::_::_::_m_arrayPool::_0_::_elem::_m_objectInformation::_4_::_m_dyN = 0;
        @sysvar::XCP::RadarFC_Obj::_g_PL_AD_fw_Radar_1R1V_rpc_XilObjBypassingRunnable_XilObjBypassingRunnable_m_pad_radarObjPort_par_out_local::TChangeableMemPool::_::_::_m_arrayPool::_0_::_elem::_m_objectInformation::_4_::_m_dzN = 0;
        @sysvar::XCP::RadarFC_Obj::_g_PL_AD_fw_Radar_1R1V_rpc_XilObjBypassingRunnable_XilObjBypassingRunnable_m_pad_radarObjPort_par_out_local::TChangeableMemPool::_::_::_m_arrayPool::_0_::_elem::_m_objectInformation::_4_::_m_vxN = 0;
        @sysvar::XCP::RadarFC_Obj::_g_PL_AD_fw_Radar_1R1V_rpc_XilObjBypassingRunnable_XilObjBypassingRunnable_m_pad_radarObjPort_par_out_local::TChangeableMemPool::_::_::_m_arrayPool::_0_::_elem::_m_objectInformation::_4_::_m_vyN = 0;
        @sysvar::XCP::RadarFC_Obj::_g_PL_AD_fw_Radar_1R1V_rpc_XilObjBypassingRunnable_XilObjBypassingRunnable_m_pad_radarObjPort_par_out_local::TChangeableMemPool::_::_::_m_arrayPool::_0_::_elem::_m_objectInformation::_4_::_m_axN = 0;
        @sysvar::XCP::RadarFC_Obj::_g_PL_AD_fw_Radar_1R1V_rpc_XilObjBypassingRunnable_XilObjBypassingRunnable_m_pad_radarObjPort_par_out_local::TChangeableMemPool::_::_::_m_arrayPool::_0_::_elem::_m_objectInformation::_4_::_m_ayN = 0;
        @sysvar::XCP::RadarFC_Obj::_g_PL_AD_fw_Radar_1R1V_rpc_XilObjBypassingRunnable_XilObjBypassingRunnable_m_pad_radarObjPort_par_out_local::TChangeableMemPool::_::_::_m_arrayPool::_0_::_elem::_m_objectInformation::_4_::_m_alpPiYawAngleN = 0;
        @sysvar::XCP::RadarFC_Obj::_g_PL_AD_fw_Radar_1R1V_rpc_XilObjBypassingRunnable_XilObjBypassingRunnable_m_pad_radarObjPort_par_out_local::TChangeableMemPool::_::_::_m_arrayPool::_0_::_elem::_m_objectInformation::_4_::_m_prob1HasBeenObservedMovingN = 0;
        @sysvar::XCP::RadarFC_Obj::_g_PL_AD_fw_Radar_1R1V_rpc_XilObjBypassingRunnable_XilObjBypassingRunnable_m_pad_radarObjPort_par_out_local::TChangeableMemPool::_::_::_m_arrayPool::_0_::_elem::_m_objectInformation::_4_::_m_prob1MovingN = 0;
        @sysvar::XCP::RadarFC_Obj::_g_PL_AD_fw_Radar_1R1V_rpc_XilObjBypassingRunnable_XilObjBypassingRunnable_m_pad_radarObjPort_par_out_local::TChangeableMemPool::_::_::_m_arrayPool::_0_::_elem::_m_objectInformation::_4_::_m_perObjectType::_m_prob1ObstacleN = 0;
        @sysvar::XCP::RadarFC_Obj::_g_PL_AD_fw_Radar_1R1V_rpc_XilObjBypassingRunnable_XilObjBypassingRunnable_m_pad_radarObjPort_par_out_local::TChangeableMemPool::_::_::_m_arrayPool::_0_::_elem::_m_objectInformation::_4_::_m_perObjectType::_m_prob1NonObstacleN = 0;
        @sysvar::XCP::RadarFC_Obj::_g_PL_AD_fw_Radar_1R1V_rpc_XilObjBypassingRunnable_XilObjBypassingRunnable_m_pad_radarObjPort_par_out_local::TChangeableMemPool::_::_::_m_arrayPool::_0_::_elem::_m_objectInformation::_4_::_m_perObjectType::_m_prob1MobileN = 0;
        @sysvar::XCP::RadarFC_Obj::_g_PL_AD_fw_Radar_1R1V_rpc_XilObjBypassingRunnable_XilObjBypassingRunnable_m_pad_radarObjPort_par_out_local::TChangeableMemPool::_::_::_m_arrayPool::_0_::_elem::_m_objectInformation::_4_::_m_perObjectType::_m_prob1StationaryN = 0;
        @sysvar::XCP::RadarFC_Obj::_g_PL_AD_fw_Radar_1R1V_rpc_XilObjBypassingRunnable_XilObjBypassingRunnable_m_pad_radarObjPort_par_out_local::TChangeableMemPool::_::_::_m_arrayPool::_0_::_elem::_m_objectInformation::_4_::_m_perObjectType::_m_prob1FourPlusWheelerN = 0;
        @sysvar::XCP::RadarFC_Obj::_g_PL_AD_fw_Radar_1R1V_rpc_XilObjBypassingRunnable_XilObjBypassingRunnable_m_pad_radarObjPort_par_out_local::TChangeableMemPool::_::_::_m_arrayPool::_0_::_elem::_m_objectInformation::_4_::_m_perObjectType::_m_prob1TwoWheelerN = 0;
        @sysvar::XCP::RadarFC_Obj::_g_PL_AD_fw_Radar_1R1V_rpc_XilObjBypassingRunnable_XilObjBypassingRunnable_m_pad_radarObjPort_par_out_local::TChangeableMemPool::_::_::_m_arrayPool::_0_::_elem::_m_objectInformation::_4_::_m_perObjectType::_m_prob1PedestrianN = 0;
        @sysvar::XCP::RadarFC_Obj::_g_PL_AD_fw_Radar_1R1V_rpc_XilObjBypassingRunnable_XilObjBypassingRunnable_m_pad_radarObjPort_par_out_local::TChangeableMemPool::_::_::_m_arrayPool::_0_::_elem::_m_objectInformation::_4_::_m_perObjectType::_m_prob1RoadsideBarrierN = 0;
        @sysvar::XCP::RadarFC_Obj::_g_PL_AD_fw_Radar_1R1V_rpc_XilObjBypassingRunnable_XilObjBypassingRunnable_m_pad_radarObjPort_par_out_local::TChangeableMemPool::_::_::_m_arrayPool::_0_::_elem::_m_objectInformation::_4_::_m_perObjectType::_m_prob1PassengerCarN = 0;
        @sysvar::XCP::RadarFC_Obj::_g_PL_AD_fw_Radar_1R1V_rpc_XilObjBypassingRunnable_XilObjBypassingRunnable_m_pad_radarObjPort_par_out_local::TChangeableMemPool::_::_::_m_arrayPool::_0_::_elem::_m_objectInformation::_4_::_m_perObjectType::_m_prob1TruckN = 0;
        @sysvar::XCP::RadarFC_Obj::_g_PL_AD_fw_Radar_1R1V_rpc_XilObjBypassingRunnable_XilObjBypassingRunnable_m_pad_radarObjPort_par_out_local::TChangeableMemPool::_::_::_m_arrayPool::_0_::_elem::_m_objectInformation::_4_::_m_perObjectType::_m_prob1UnknownN = 0;
        @sysvar::XCP::RadarFC_Obj::_g_PL_AD_fw_Radar_1R1V_rpc_XilObjBypassingRunnable_XilObjBypassingRunnable_m_pad_radarObjPort_par_out_local::TChangeableMemPool::_::_::_m_arrayPool::_0_::_elem::_m_objectInformation::_4_::_m_perObjectType::_m_prob1MovUnknownN = 0;
        @sysvar::XCP::RadarFC_Obj::_g_PL_AD_fw_Radar_1R1V_rpc_XilObjBypassingRunnable_XilObjBypassingRunnable_m_pad_radarObjPort_par_out_local::TChangeableMemPool::_::_::_m_arrayPool::_0_::_elem::_m_objectInformation::_4_::_m_perObjectType::_m_prob1StatUnknownN = 0;
        @sysvar::XCP::RadarFC_Obj::_g_PL_AD_fw_Radar_1R1V_rpc_XilObjBypassingRunnable_XilObjBypassingRunnable_m_pad_radarObjPort_par_out_local::TChangeableMemPool::_::_::_m_arrayPool::_0_::_elem::_m_objectInformation::_4_::_m_perObjectType::_m_prob1ObstUnknownN = 0;
        @sysvar::XCP::RadarFC_Obj::_g_PL_AD_fw_Radar_1R1V_rpc_XilObjBypassingRunnable_XilObjBypassingRunnable_m_pad_radarObjPort_par_out_local::TChangeableMemPool::_::_::_m_arrayPool::_0_::_elem::_m_objectInformation::_4_::_m_perObjectType::_m_prob1FourWheelUnknownN = 0;
        break;
        
      case 5: //"Object-5"
        @sysvar::XCP::RadarFC_Obj::_g_PL_AD_fw_Radar_1R1V_rpc_XilObjBypassingRunnable_XilObjBypassingRunnable_m_pad_radarObjPort_par_out_local::TChangeableMemPool::_::_::_m_arrayPool::_0_::_elem::_m_objectInformation::_5_::_Valid_b = 0;
        @sysvar::XCP::RadarFC_Obj::_g_PL_AD_fw_Radar_1R1V_rpc_XilObjBypassingRunnable_XilObjBypassingRunnable_m_pad_radarObjPort_par_out_local::TChangeableMemPool::_::_::_m_arrayPool::_0_::_elem::_m_objectInformation::_5_::_m_HandleN = 0;
        @sysvar::XCP::RadarFC_Obj::_g_PL_AD_fw_Radar_1R1V_rpc_XilObjBypassingRunnable_XilObjBypassingRunnable_m_pad_radarObjPort_par_out_local::TChangeableMemPool::_::_::_m_arrayPool::_0_::_elem::_m_objectInformation::_5_::_m_alpPiVarYawAngleN = 0;
        @sysvar::XCP::RadarFC_Obj::_g_PL_AD_fw_Radar_1R1V_rpc_XilObjBypassingRunnable_XilObjBypassingRunnable_m_pad_radarObjPort_par_out_local::TChangeableMemPool::_::_::_m_arrayPool::_0_::_elem::_m_objectInformation::_5_::_m_varAxN = 0;
        @sysvar::XCP::RadarFC_Obj::_g_PL_AD_fw_Radar_1R1V_rpc_XilObjBypassingRunnable_XilObjBypassingRunnable_m_pad_radarObjPort_par_out_local::TChangeableMemPool::_::_::_m_arrayPool::_0_::_elem::_m_objectInformation::_5_::_m_varAyN = 0;
        @sysvar::XCP::RadarFC_Obj::_g_PL_AD_fw_Radar_1R1V_rpc_XilObjBypassingRunnable_XilObjBypassingRunnable_m_pad_radarObjPort_par_out_local::TChangeableMemPool::_::_::_m_arrayPool::_0_::_elem::_m_objectInformation::_5_::_m_varVxN = 0;
        @sysvar::XCP::RadarFC_Obj::_g_PL_AD_fw_Radar_1R1V_rpc_XilObjBypassingRunnable_XilObjBypassingRunnable_m_pad_radarObjPort_par_out_local::TChangeableMemPool::_::_::_m_arrayPool::_0_::_elem::_m_objectInformation::_5_::_m_varVyN = 0;
        @sysvar::XCP::RadarFC_Obj::_g_PL_AD_fw_Radar_1R1V_rpc_XilObjBypassingRunnable_XilObjBypassingRunnable_m_pad_radarObjPort_par_out_local::TChangeableMemPool::_::_::_m_arrayPool::_0_::_elem::_m_objectInformation::_5_::_m_varDxN = 0;
        @sysvar::XCP::RadarFC_Obj::_g_PL_AD_fw_Radar_1R1V_rpc_XilObjBypassingRunnable_XilObjBypassingRunnable_m_pad_radarObjPort_par_out_local::TChangeableMemPool::_::_::_m_arrayPool::_0_::_elem::_m_objectInformation::_5_::_m_varDyN = 0;
        @sysvar::XCP::RadarFC_Obj::_g_PL_AD_fw_Radar_1R1V_rpc_XilObjBypassingRunnable_XilObjBypassingRunnable_m_pad_radarObjPort_par_out_local::TChangeableMemPool::_::_::_m_arrayPool::_0_::_elem::_m_objectInformation::_5_::_m_dVarLengthN = 0;
        @sysvar::XCP::RadarFC_Obj::_g_PL_AD_fw_Radar_1R1V_rpc_XilObjBypassingRunnable_XilObjBypassingRunnable_m_pad_radarObjPort_par_out_local::TChangeableMemPool::_::_::_m_arrayPool::_0_::_elem::_m_objectInformation::_5_::_m_dVarWidthN = 0;
        @sysvar::XCP::RadarFC_Obj::_g_PL_AD_fw_Radar_1R1V_rpc_XilObjBypassingRunnable_XilObjBypassingRunnable_m_pad_radarObjPort_par_out_local::TChangeableMemPool::_::_::_m_arrayPool::_0_::_elem::_m_objectInformation::_5_::_m_wExistProbN = 0;
        @sysvar::XCP::RadarFC_Obj::_g_PL_AD_fw_Radar_1R1V_rpc_XilObjBypassingRunnable_XilObjBypassingRunnable_m_pad_radarObjPort_par_out_local::TChangeableMemPool::_::_::_m_arrayPool::_0_::_elem::_m_objectInformation::_5_::_m_isObjectAsil = 0;
        @sysvar::XCP::RadarFC_Obj::_g_PL_AD_fw_Radar_1R1V_rpc_XilObjBypassingRunnable_XilObjBypassingRunnable_m_pad_radarObjPort_par_out_local::TChangeableMemPool::_::_::_m_arrayPool::_0_::_elem::_m_objectInformation::_5_::_m_dWidthN = 0;
        @sysvar::XCP::RadarFC_Obj::_g_PL_AD_fw_Radar_1R1V_rpc_XilObjBypassingRunnable_XilObjBypassingRunnable_m_pad_radarObjPort_par_out_local::TChangeableMemPool::_::_::_m_arrayPool::_0_::_elem::_m_objectInformation::_5_::_m_dLengthN = 0;
        @sysvar::XCP::RadarFC_Obj::_g_PL_AD_fw_Radar_1R1V_rpc_XilObjBypassingRunnable_XilObjBypassingRunnable_m_pad_radarObjPort_par_out_local::TChangeableMemPool::_::_::_m_arrayPool::_0_::_elem::_m_objectInformation::_5_::_m_dxN = 0;
        @sysvar::XCP::RadarFC_Obj::_g_PL_AD_fw_Radar_1R1V_rpc_XilObjBypassingRunnable_XilObjBypassingRunnable_m_pad_radarObjPort_par_out_local::TChangeableMemPool::_::_::_m_arrayPool::_0_::_elem::_m_objectInformation::_5_::_m_dyN = 0;
        @sysvar::XCP::RadarFC_Obj::_g_PL_AD_fw_Radar_1R1V_rpc_XilObjBypassingRunnable_XilObjBypassingRunnable_m_pad_radarObjPort_par_out_local::TChangeableMemPool::_::_::_m_arrayPool::_0_::_elem::_m_objectInformation::_5_::_m_dzN = 0;
        @sysvar::XCP::RadarFC_Obj::_g_PL_AD_fw_Radar_1R1V_rpc_XilObjBypassingRunnable_XilObjBypassingRunnable_m_pad_radarObjPort_par_out_local::TChangeableMemPool::_::_::_m_arrayPool::_0_::_elem::_m_objectInformation::_5_::_m_vxN = 0;
        @sysvar::XCP::RadarFC_Obj::_g_PL_AD_fw_Radar_1R1V_rpc_XilObjBypassingRunnable_XilObjBypassingRunnable_m_pad_radarObjPort_par_out_local::TChangeableMemPool::_::_::_m_arrayPool::_0_::_elem::_m_objectInformation::_5_::_m_vyN = 0;
        @sysvar::XCP::RadarFC_Obj::_g_PL_AD_fw_Radar_1R1V_rpc_XilObjBypassingRunnable_XilObjBypassingRunnable_m_pad_radarObjPort_par_out_local::TChangeableMemPool::_::_::_m_arrayPool::_0_::_elem::_m_objectInformation::_5_::_m_axN = 0;
        @sysvar::XCP::RadarFC_Obj::_g_PL_AD_fw_Radar_1R1V_rpc_XilObjBypassingRunnable_XilObjBypassingRunnable_m_pad_radarObjPort_par_out_local::TChangeableMemPool::_::_::_m_arrayPool::_0_::_elem::_m_objectInformation::_5_::_m_ayN = 0;
        @sysvar::XCP::RadarFC_Obj::_g_PL_AD_fw_Radar_1R1V_rpc_XilObjBypassingRunnable_XilObjBypassingRunnable_m_pad_radarObjPort_par_out_local::TChangeableMemPool::_::_::_m_arrayPool::_0_::_elem::_m_objectInformation::_5_::_m_alpPiYawAngleN = 0;
        @sysvar::XCP::RadarFC_Obj::_g_PL_AD_fw_Radar_1R1V_rpc_XilObjBypassingRunnable_XilObjBypassingRunnable_m_pad_radarObjPort_par_out_local::TChangeableMemPool::_::_::_m_arrayPool::_0_::_elem::_m_objectInformation::_5_::_m_prob1HasBeenObservedMovingN = 0;
        @sysvar::XCP::RadarFC_Obj::_g_PL_AD_fw_Radar_1R1V_rpc_XilObjBypassingRunnable_XilObjBypassingRunnable_m_pad_radarObjPort_par_out_local::TChangeableMemPool::_::_::_m_arrayPool::_0_::_elem::_m_objectInformation::_5_::_m_prob1MovingN = 0;
        @sysvar::XCP::RadarFC_Obj::_g_PL_AD_fw_Radar_1R1V_rpc_XilObjBypassingRunnable_XilObjBypassingRunnable_m_pad_radarObjPort_par_out_local::TChangeableMemPool::_::_::_m_arrayPool::_0_::_elem::_m_objectInformation::_5_::_m_perObjectType::_m_prob1ObstacleN = 0;
        @sysvar::XCP::RadarFC_Obj::_g_PL_AD_fw_Radar_1R1V_rpc_XilObjBypassingRunnable_XilObjBypassingRunnable_m_pad_radarObjPort_par_out_local::TChangeableMemPool::_::_::_m_arrayPool::_0_::_elem::_m_objectInformation::_5_::_m_perObjectType::_m_prob1NonObstacleN = 0;
        @sysvar::XCP::RadarFC_Obj::_g_PL_AD_fw_Radar_1R1V_rpc_XilObjBypassingRunnable_XilObjBypassingRunnable_m_pad_radarObjPort_par_out_local::TChangeableMemPool::_::_::_m_arrayPool::_0_::_elem::_m_objectInformation::_5_::_m_perObjectType::_m_prob1MobileN = 0;
        @sysvar::XCP::RadarFC_Obj::_g_PL_AD_fw_Radar_1R1V_rpc_XilObjBypassingRunnable_XilObjBypassingRunnable_m_pad_radarObjPort_par_out_local::TChangeableMemPool::_::_::_m_arrayPool::_0_::_elem::_m_objectInformation::_5_::_m_perObjectType::_m_prob1StationaryN = 0;
        @sysvar::XCP::RadarFC_Obj::_g_PL_AD_fw_Radar_1R1V_rpc_XilObjBypassingRunnable_XilObjBypassingRunnable_m_pad_radarObjPort_par_out_local::TChangeableMemPool::_::_::_m_arrayPool::_0_::_elem::_m_objectInformation::_5_::_m_perObjectType::_m_prob1FourPlusWheelerN = 0;
        @sysvar::XCP::RadarFC_Obj::_g_PL_AD_fw_Radar_1R1V_rpc_XilObjBypassingRunnable_XilObjBypassingRunnable_m_pad_radarObjPort_par_out_local::TChangeableMemPool::_::_::_m_arrayPool::_0_::_elem::_m_objectInformation::_5_::_m_perObjectType::_m_prob1TwoWheelerN = 0;
        @sysvar::XCP::RadarFC_Obj::_g_PL_AD_fw_Radar_1R1V_rpc_XilObjBypassingRunnable_XilObjBypassingRunnable_m_pad_radarObjPort_par_out_local::TChangeableMemPool::_::_::_m_arrayPool::_0_::_elem::_m_objectInformation::_5_::_m_perObjectType::_m_prob1PedestrianN = 0;
        @sysvar::XCP::RadarFC_Obj::_g_PL_AD_fw_Radar_1R1V_rpc_XilObjBypassingRunnable_XilObjBypassingRunnable_m_pad_radarObjPort_par_out_local::TChangeableMemPool::_::_::_m_arrayPool::_0_::_elem::_m_objectInformation::_5_::_m_perObjectType::_m_prob1RoadsideBarrierN = 0;
        @sysvar::XCP::RadarFC_Obj::_g_PL_AD_fw_Radar_1R1V_rpc_XilObjBypassingRunnable_XilObjBypassingRunnable_m_pad_radarObjPort_par_out_local::TChangeableMemPool::_::_::_m_arrayPool::_0_::_elem::_m_objectInformation::_5_::_m_perObjectType::_m_prob1PassengerCarN = 0;
        @sysvar::XCP::RadarFC_Obj::_g_PL_AD_fw_Radar_1R1V_rpc_XilObjBypassingRunnable_XilObjBypassingRunnable_m_pad_radarObjPort_par_out_local::TChangeableMemPool::_::_::_m_arrayPool::_0_::_elem::_m_objectInformation::_5_::_m_perObjectType::_m_prob1TruckN = 0;
        @sysvar::XCP::RadarFC_Obj::_g_PL_AD_fw_Radar_1R1V_rpc_XilObjBypassingRunnable_XilObjBypassingRunnable_m_pad_radarObjPort_par_out_local::TChangeableMemPool::_::_::_m_arrayPool::_0_::_elem::_m_objectInformation::_5_::_m_perObjectType::_m_prob1UnknownN = 0;
        @sysvar::XCP::RadarFC_Obj::_g_PL_AD_fw_Radar_1R1V_rpc_XilObjBypassingRunnable_XilObjBypassingRunnable_m_pad_radarObjPort_par_out_local::TChangeableMemPool::_::_::_m_arrayPool::_0_::_elem::_m_objectInformation::_5_::_m_perObjectType::_m_prob1MovUnknownN = 0;
        @sysvar::XCP::RadarFC_Obj::_g_PL_AD_fw_Radar_1R1V_rpc_XilObjBypassingRunnable_XilObjBypassingRunnable_m_pad_radarObjPort_par_out_local::TChangeableMemPool::_::_::_m_arrayPool::_0_::_elem::_m_objectInformation::_5_::_m_perObjectType::_m_prob1StatUnknownN = 0;
        @sysvar::XCP::RadarFC_Obj::_g_PL_AD_fw_Radar_1R1V_rpc_XilObjBypassingRunnable_XilObjBypassingRunnable_m_pad_radarObjPort_par_out_local::TChangeableMemPool::_::_::_m_arrayPool::_0_::_elem::_m_objectInformation::_5_::_m_perObjectType::_m_prob1ObstUnknownN = 0;
        @sysvar::XCP::RadarFC_Obj::_g_PL_AD_fw_Radar_1R1V_rpc_XilObjBypassingRunnable_XilObjBypassingRunnable_m_pad_radarObjPort_par_out_local::TChangeableMemPool::_::_::_m_arrayPool::_0_::_elem::_m_objectInformation::_5_::_m_perObjectType::_m_prob1FourWheelUnknownN = 0;
        break;
        
      case 6: //"Object-6"
        @sysvar::XCP::RadarFC_Obj::_g_PL_AD_fw_Radar_1R1V_rpc_XilObjBypassingRunnable_XilObjBypassingRunnable_m_pad_radarObjPort_par_out_local::TChangeableMemPool::_::_::_m_arrayPool::_0_::_elem::_m_objectInformation::_6_::_Valid_b = 0;
        @sysvar::XCP::RadarFC_Obj::_g_PL_AD_fw_Radar_1R1V_rpc_XilObjBypassingRunnable_XilObjBypassingRunnable_m_pad_radarObjPort_par_out_local::TChangeableMemPool::_::_::_m_arrayPool::_0_::_elem::_m_objectInformation::_6_::_m_HandleN = 0;
        @sysvar::XCP::RadarFC_Obj::_g_PL_AD_fw_Radar_1R1V_rpc_XilObjBypassingRunnable_XilObjBypassingRunnable_m_pad_radarObjPort_par_out_local::TChangeableMemPool::_::_::_m_arrayPool::_0_::_elem::_m_objectInformation::_6_::_m_alpPiVarYawAngleN = 0;
        @sysvar::XCP::RadarFC_Obj::_g_PL_AD_fw_Radar_1R1V_rpc_XilObjBypassingRunnable_XilObjBypassingRunnable_m_pad_radarObjPort_par_out_local::TChangeableMemPool::_::_::_m_arrayPool::_0_::_elem::_m_objectInformation::_6_::_m_varAxN = 0;
        @sysvar::XCP::RadarFC_Obj::_g_PL_AD_fw_Radar_1R1V_rpc_XilObjBypassingRunnable_XilObjBypassingRunnable_m_pad_radarObjPort_par_out_local::TChangeableMemPool::_::_::_m_arrayPool::_0_::_elem::_m_objectInformation::_6_::_m_varAyN = 0;
        @sysvar::XCP::RadarFC_Obj::_g_PL_AD_fw_Radar_1R1V_rpc_XilObjBypassingRunnable_XilObjBypassingRunnable_m_pad_radarObjPort_par_out_local::TChangeableMemPool::_::_::_m_arrayPool::_0_::_elem::_m_objectInformation::_6_::_m_varVxN = 0;
        @sysvar::XCP::RadarFC_Obj::_g_PL_AD_fw_Radar_1R1V_rpc_XilObjBypassingRunnable_XilObjBypassingRunnable_m_pad_radarObjPort_par_out_local::TChangeableMemPool::_::_::_m_arrayPool::_0_::_elem::_m_objectInformation::_6_::_m_varVyN = 0;
        @sysvar::XCP::RadarFC_Obj::_g_PL_AD_fw_Radar_1R1V_rpc_XilObjBypassingRunnable_XilObjBypassingRunnable_m_pad_radarObjPort_par_out_local::TChangeableMemPool::_::_::_m_arrayPool::_0_::_elem::_m_objectInformation::_6_::_m_varDxN = 0;
        @sysvar::XCP::RadarFC_Obj::_g_PL_AD_fw_Radar_1R1V_rpc_XilObjBypassingRunnable_XilObjBypassingRunnable_m_pad_radarObjPort_par_out_local::TChangeableMemPool::_::_::_m_arrayPool::_0_::_elem::_m_objectInformation::_6_::_m_varDyN = 0;
        @sysvar::XCP::RadarFC_Obj::_g_PL_AD_fw_Radar_1R1V_rpc_XilObjBypassingRunnable_XilObjBypassingRunnable_m_pad_radarObjPort_par_out_local::TChangeableMemPool::_::_::_m_arrayPool::_0_::_elem::_m_objectInformation::_6_::_m_dVarLengthN = 0;
        @sysvar::XCP::RadarFC_Obj::_g_PL_AD_fw_Radar_1R1V_rpc_XilObjBypassingRunnable_XilObjBypassingRunnable_m_pad_radarObjPort_par_out_local::TChangeableMemPool::_::_::_m_arrayPool::_0_::_elem::_m_objectInformation::_6_::_m_dVarWidthN = 0;
        @sysvar::XCP::RadarFC_Obj::_g_PL_AD_fw_Radar_1R1V_rpc_XilObjBypassingRunnable_XilObjBypassingRunnable_m_pad_radarObjPort_par_out_local::TChangeableMemPool::_::_::_m_arrayPool::_0_::_elem::_m_objectInformation::_6_::_m_wExistProbN = 0;
        @sysvar::XCP::RadarFC_Obj::_g_PL_AD_fw_Radar_1R1V_rpc_XilObjBypassingRunnable_XilObjBypassingRunnable_m_pad_radarObjPort_par_out_local::TChangeableMemPool::_::_::_m_arrayPool::_0_::_elem::_m_objectInformation::_6_::_m_isObjectAsil = 0;
        @sysvar::XCP::RadarFC_Obj::_g_PL_AD_fw_Radar_1R1V_rpc_XilObjBypassingRunnable_XilObjBypassingRunnable_m_pad_radarObjPort_par_out_local::TChangeableMemPool::_::_::_m_arrayPool::_0_::_elem::_m_objectInformation::_6_::_m_dWidthN = 0;
        @sysvar::XCP::RadarFC_Obj::_g_PL_AD_fw_Radar_1R1V_rpc_XilObjBypassingRunnable_XilObjBypassingRunnable_m_pad_radarObjPort_par_out_local::TChangeableMemPool::_::_::_m_arrayPool::_0_::_elem::_m_objectInformation::_6_::_m_dLengthN = 0;
        @sysvar::XCP::RadarFC_Obj::_g_PL_AD_fw_Radar_1R1V_rpc_XilObjBypassingRunnable_XilObjBypassingRunnable_m_pad_radarObjPort_par_out_local::TChangeableMemPool::_::_::_m_arrayPool::_0_::_elem::_m_objectInformation::_6_::_m_dxN = 0;
        @sysvar::XCP::RadarFC_Obj::_g_PL_AD_fw_Radar_1R1V_rpc_XilObjBypassingRunnable_XilObjBypassingRunnable_m_pad_radarObjPort_par_out_local::TChangeableMemPool::_::_::_m_arrayPool::_0_::_elem::_m_objectInformation::_6_::_m_dyN = 0;
        @sysvar::XCP::RadarFC_Obj::_g_PL_AD_fw_Radar_1R1V_rpc_XilObjBypassingRunnable_XilObjBypassingRunnable_m_pad_radarObjPort_par_out_local::TChangeableMemPool::_::_::_m_arrayPool::_0_::_elem::_m_objectInformation::_6_::_m_dzN = 0;
        @sysvar::XCP::RadarFC_Obj::_g_PL_AD_fw_Radar_1R1V_rpc_XilObjBypassingRunnable_XilObjBypassingRunnable_m_pad_radarObjPort_par_out_local::TChangeableMemPool::_::_::_m_arrayPool::_0_::_elem::_m_objectInformation::_6_::_m_vxN = 0;
        @sysvar::XCP::RadarFC_Obj::_g_PL_AD_fw_Radar_1R1V_rpc_XilObjBypassingRunnable_XilObjBypassingRunnable_m_pad_radarObjPort_par_out_local::TChangeableMemPool::_::_::_m_arrayPool::_0_::_elem::_m_objectInformation::_6_::_m_vyN = 0;
        @sysvar::XCP::RadarFC_Obj::_g_PL_AD_fw_Radar_1R1V_rpc_XilObjBypassingRunnable_XilObjBypassingRunnable_m_pad_radarObjPort_par_out_local::TChangeableMemPool::_::_::_m_arrayPool::_0_::_elem::_m_objectInformation::_6_::_m_axN = 0;
        @sysvar::XCP::RadarFC_Obj::_g_PL_AD_fw_Radar_1R1V_rpc_XilObjBypassingRunnable_XilObjBypassingRunnable_m_pad_radarObjPort_par_out_local::TChangeableMemPool::_::_::_m_arrayPool::_0_::_elem::_m_objectInformation::_6_::_m_ayN = 0;
        @sysvar::XCP::RadarFC_Obj::_g_PL_AD_fw_Radar_1R1V_rpc_XilObjBypassingRunnable_XilObjBypassingRunnable_m_pad_radarObjPort_par_out_local::TChangeableMemPool::_::_::_m_arrayPool::_0_::_elem::_m_objectInformation::_6_::_m_alpPiYawAngleN = 0;
        @sysvar::XCP::RadarFC_Obj::_g_PL_AD_fw_Radar_1R1V_rpc_XilObjBypassingRunnable_XilObjBypassingRunnable_m_pad_radarObjPort_par_out_local::TChangeableMemPool::_::_::_m_arrayPool::_0_::_elem::_m_objectInformation::_6_::_m_prob1HasBeenObservedMovingN = 0;
        @sysvar::XCP::RadarFC_Obj::_g_PL_AD_fw_Radar_1R1V_rpc_XilObjBypassingRunnable_XilObjBypassingRunnable_m_pad_radarObjPort_par_out_local::TChangeableMemPool::_::_::_m_arrayPool::_0_::_elem::_m_objectInformation::_6_::_m_prob1MovingN = 0;
        @sysvar::XCP::RadarFC_Obj::_g_PL_AD_fw_Radar_1R1V_rpc_XilObjBypassingRunnable_XilObjBypassingRunnable_m_pad_radarObjPort_par_out_local::TChangeableMemPool::_::_::_m_arrayPool::_0_::_elem::_m_objectInformation::_6_::_m_perObjectType::_m_prob1ObstacleN = 0;
        @sysvar::XCP::RadarFC_Obj::_g_PL_AD_fw_Radar_1R1V_rpc_XilObjBypassingRunnable_XilObjBypassingRunnable_m_pad_radarObjPort_par_out_local::TChangeableMemPool::_::_::_m_arrayPool::_0_::_elem::_m_objectInformation::_6_::_m_perObjectType::_m_prob1NonObstacleN = 0;
        @sysvar::XCP::RadarFC_Obj::_g_PL_AD_fw_Radar_1R1V_rpc_XilObjBypassingRunnable_XilObjBypassingRunnable_m_pad_radarObjPort_par_out_local::TChangeableMemPool::_::_::_m_arrayPool::_0_::_elem::_m_objectInformation::_6_::_m_perObjectType::_m_prob1MobileN = 0;
        @sysvar::XCP::RadarFC_Obj::_g_PL_AD_fw_Radar_1R1V_rpc_XilObjBypassingRunnable_XilObjBypassingRunnable_m_pad_radarObjPort_par_out_local::TChangeableMemPool::_::_::_m_arrayPool::_0_::_elem::_m_objectInformation::_6_::_m_perObjectType::_m_prob1StationaryN = 0;
        @sysvar::XCP::RadarFC_Obj::_g_PL_AD_fw_Radar_1R1V_rpc_XilObjBypassingRunnable_XilObjBypassingRunnable_m_pad_radarObjPort_par_out_local::TChangeableMemPool::_::_::_m_arrayPool::_0_::_elem::_m_objectInformation::_6_::_m_perObjectType::_m_prob1FourPlusWheelerN = 0;
        @sysvar::XCP::RadarFC_Obj::_g_PL_AD_fw_Radar_1R1V_rpc_XilObjBypassingRunnable_XilObjBypassingRunnable_m_pad_radarObjPort_par_out_local::TChangeableMemPool::_::_::_m_arrayPool::_0_::_elem::_m_objectInformation::_6_::_m_perObjectType::_m_prob1TwoWheelerN = 0;
        @sysvar::XCP::RadarFC_Obj::_g_PL_AD_fw_Radar_1R1V_rpc_XilObjBypassingRunnable_XilObjBypassingRunnable_m_pad_radarObjPort_par_out_local::TChangeableMemPool::_::_::_m_arrayPool::_0_::_elem::_m_objectInformation::_6_::_m_perObjectType::_m_prob1PedestrianN = 0;
        @sysvar::XCP::RadarFC_Obj::_g_PL_AD_fw_Radar_1R1V_rpc_XilObjBypassingRunnable_XilObjBypassingRunnable_m_pad_radarObjPort_par_out_local::TChangeableMemPool::_::_::_m_arrayPool::_0_::_elem::_m_objectInformation::_6_::_m_perObjectType::_m_prob1RoadsideBarrierN = 0;
        @sysvar::XCP::RadarFC_Obj::_g_PL_AD_fw_Radar_1R1V_rpc_XilObjBypassingRunnable_XilObjBypassingRunnable_m_pad_radarObjPort_par_out_local::TChangeableMemPool::_::_::_m_arrayPool::_0_::_elem::_m_objectInformation::_6_::_m_perObjectType::_m_prob1PassengerCarN = 0;
        @sysvar::XCP::RadarFC_Obj::_g_PL_AD_fw_Radar_1R1V_rpc_XilObjBypassingRunnable_XilObjBypassingRunnable_m_pad_radarObjPort_par_out_local::TChangeableMemPool::_::_::_m_arrayPool::_0_::_elem::_m_objectInformation::_6_::_m_perObjectType::_m_prob1TruckN = 0;
        @sysvar::XCP::RadarFC_Obj::_g_PL_AD_fw_Radar_1R1V_rpc_XilObjBypassingRunnable_XilObjBypassingRunnable_m_pad_radarObjPort_par_out_local::TChangeableMemPool::_::_::_m_arrayPool::_0_::_elem::_m_objectInformation::_6_::_m_perObjectType::_m_prob1UnknownN = 0;
        @sysvar::XCP::RadarFC_Obj::_g_PL_AD_fw_Radar_1R1V_rpc_XilObjBypassingRunnable_XilObjBypassingRunnable_m_pad_radarObjPort_par_out_local::TChangeableMemPool::_::_::_m_arrayPool::_0_::_elem::_m_objectInformation::_6_::_m_perObjectType::_m_prob1MovUnknownN = 0;
        @sysvar::XCP::RadarFC_Obj::_g_PL_AD_fw_Radar_1R1V_rpc_XilObjBypassingRunnable_XilObjBypassingRunnable_m_pad_radarObjPort_par_out_local::TChangeableMemPool::_::_::_m_arrayPool::_0_::_elem::_m_objectInformation::_6_::_m_perObjectType::_m_prob1StatUnknownN = 0;
        @sysvar::XCP::RadarFC_Obj::_g_PL_AD_fw_Radar_1R1V_rpc_XilObjBypassingRunnable_XilObjBypassingRunnable_m_pad_radarObjPort_par_out_local::TChangeableMemPool::_::_::_m_arrayPool::_0_::_elem::_m_objectInformation::_6_::_m_perObjectType::_m_prob1ObstUnknownN = 0;
        @sysvar::XCP::RadarFC_Obj::_g_PL_AD_fw_Radar_1R1V_rpc_XilObjBypassingRunnable_XilObjBypassingRunnable_m_pad_radarObjPort_par_out_local::TChangeableMemPool::_::_::_m_arrayPool::_0_::_elem::_m_objectInformation::_6_::_m_perObjectType::_m_prob1FourWheelUnknownN = 0;
        break;
        
      case 7: //"Object-7"
        @sysvar::XCP::RadarFC_Obj::_g_PL_AD_fw_Radar_1R1V_rpc_XilObjBypassingRunnable_XilObjBypassingRunnable_m_pad_radarObjPort_par_out_local::TChangeableMemPool::_::_::_m_arrayPool::_0_::_elem::_m_objectInformation::_7_::_Valid_b = 0;
        @sysvar::XCP::RadarFC_Obj::_g_PL_AD_fw_Radar_1R1V_rpc_XilObjBypassingRunnable_XilObjBypassingRunnable_m_pad_radarObjPort_par_out_local::TChangeableMemPool::_::_::_m_arrayPool::_0_::_elem::_m_objectInformation::_7_::_m_HandleN = 0;
        @sysvar::XCP::RadarFC_Obj::_g_PL_AD_fw_Radar_1R1V_rpc_XilObjBypassingRunnable_XilObjBypassingRunnable_m_pad_radarObjPort_par_out_local::TChangeableMemPool::_::_::_m_arrayPool::_0_::_elem::_m_objectInformation::_7_::_m_alpPiVarYawAngleN = 0;
        @sysvar::XCP::RadarFC_Obj::_g_PL_AD_fw_Radar_1R1V_rpc_XilObjBypassingRunnable_XilObjBypassingRunnable_m_pad_radarObjPort_par_out_local::TChangeableMemPool::_::_::_m_arrayPool::_0_::_elem::_m_objectInformation::_7_::_m_varAxN = 0;
        @sysvar::XCP::RadarFC_Obj::_g_PL_AD_fw_Radar_1R1V_rpc_XilObjBypassingRunnable_XilObjBypassingRunnable_m_pad_radarObjPort_par_out_local::TChangeableMemPool::_::_::_m_arrayPool::_0_::_elem::_m_objectInformation::_7_::_m_varAyN = 0;
        @sysvar::XCP::RadarFC_Obj::_g_PL_AD_fw_Radar_1R1V_rpc_XilObjBypassingRunnable_XilObjBypassingRunnable_m_pad_radarObjPort_par_out_local::TChangeableMemPool::_::_::_m_arrayPool::_0_::_elem::_m_objectInformation::_7_::_m_varVxN = 0;
        @sysvar::XCP::RadarFC_Obj::_g_PL_AD_fw_Radar_1R1V_rpc_XilObjBypassingRunnable_XilObjBypassingRunnable_m_pad_radarObjPort_par_out_local::TChangeableMemPool::_::_::_m_arrayPool::_0_::_elem::_m_objectInformation::_7_::_m_varVyN = 0;
        @sysvar::XCP::RadarFC_Obj::_g_PL_AD_fw_Radar_1R1V_rpc_XilObjBypassingRunnable_XilObjBypassingRunnable_m_pad_radarObjPort_par_out_local::TChangeableMemPool::_::_::_m_arrayPool::_0_::_elem::_m_objectInformation::_7_::_m_varDxN = 0;
        @sysvar::XCP::RadarFC_Obj::_g_PL_AD_fw_Radar_1R1V_rpc_XilObjBypassingRunnable_XilObjBypassingRunnable_m_pad_radarObjPort_par_out_local::TChangeableMemPool::_::_::_m_arrayPool::_0_::_elem::_m_objectInformation::_7_::_m_varDyN = 0;
        @sysvar::XCP::RadarFC_Obj::_g_PL_AD_fw_Radar_1R1V_rpc_XilObjBypassingRunnable_XilObjBypassingRunnable_m_pad_radarObjPort_par_out_local::TChangeableMemPool::_::_::_m_arrayPool::_0_::_elem::_m_objectInformation::_7_::_m_dVarLengthN = 0;
        @sysvar::XCP::RadarFC_Obj::_g_PL_AD_fw_Radar_1R1V_rpc_XilObjBypassingRunnable_XilObjBypassingRunnable_m_pad_radarObjPort_par_out_local::TChangeableMemPool::_::_::_m_arrayPool::_0_::_elem::_m_objectInformation::_7_::_m_dVarWidthN = 0;
        @sysvar::XCP::RadarFC_Obj::_g_PL_AD_fw_Radar_1R1V_rpc_XilObjBypassingRunnable_XilObjBypassingRunnable_m_pad_radarObjPort_par_out_local::TChangeableMemPool::_::_::_m_arrayPool::_0_::_elem::_m_objectInformation::_7_::_m_wExistProbN = 0;
        @sysvar::XCP::RadarFC_Obj::_g_PL_AD_fw_Radar_1R1V_rpc_XilObjBypassingRunnable_XilObjBypassingRunnable_m_pad_radarObjPort_par_out_local::TChangeableMemPool::_::_::_m_arrayPool::_0_::_elem::_m_objectInformation::_7_::_m_isObjectAsil = 0;
        @sysvar::XCP::RadarFC_Obj::_g_PL_AD_fw_Radar_1R1V_rpc_XilObjBypassingRunnable_XilObjBypassingRunnable_m_pad_radarObjPort_par_out_local::TChangeableMemPool::_::_::_m_arrayPool::_0_::_elem::_m_objectInformation::_7_::_m_dWidthN = 0;
        @sysvar::XCP::RadarFC_Obj::_g_PL_AD_fw_Radar_1R1V_rpc_XilObjBypassingRunnable_XilObjBypassingRunnable_m_pad_radarObjPort_par_out_local::TChangeableMemPool::_::_::_m_arrayPool::_0_::_elem::_m_objectInformation::_7_::_m_dLengthN = 0;
        @sysvar::XCP::RadarFC_Obj::_g_PL_AD_fw_Radar_1R1V_rpc_XilObjBypassingRunnable_XilObjBypassingRunnable_m_pad_radarObjPort_par_out_local::TChangeableMemPool::_::_::_m_arrayPool::_0_::_elem::_m_objectInformation::_7_::_m_dxN = 0;
        @sysvar::XCP::RadarFC_Obj::_g_PL_AD_fw_Radar_1R1V_rpc_XilObjBypassingRunnable_XilObjBypassingRunnable_m_pad_radarObjPort_par_out_local::TChangeableMemPool::_::_::_m_arrayPool::_0_::_elem::_m_objectInformation::_7_::_m_dyN = 0;
        @sysvar::XCP::RadarFC_Obj::_g_PL_AD_fw_Radar_1R1V_rpc_XilObjBypassingRunnable_XilObjBypassingRunnable_m_pad_radarObjPort_par_out_local::TChangeableMemPool::_::_::_m_arrayPool::_0_::_elem::_m_objectInformation::_7_::_m_dzN = 0;
        @sysvar::XCP::RadarFC_Obj::_g_PL_AD_fw_Radar_1R1V_rpc_XilObjBypassingRunnable_XilObjBypassingRunnable_m_pad_radarObjPort_par_out_local::TChangeableMemPool::_::_::_m_arrayPool::_0_::_elem::_m_objectInformation::_7_::_m_vxN = 0;
        @sysvar::XCP::RadarFC_Obj::_g_PL_AD_fw_Radar_1R1V_rpc_XilObjBypassingRunnable_XilObjBypassingRunnable_m_pad_radarObjPort_par_out_local::TChangeableMemPool::_::_::_m_arrayPool::_0_::_elem::_m_objectInformation::_7_::_m_vyN = 0;
        @sysvar::XCP::RadarFC_Obj::_g_PL_AD_fw_Radar_1R1V_rpc_XilObjBypassingRunnable_XilObjBypassingRunnable_m_pad_radarObjPort_par_out_local::TChangeableMemPool::_::_::_m_arrayPool::_0_::_elem::_m_objectInformation::_7_::_m_axN = 0;
        @sysvar::XCP::RadarFC_Obj::_g_PL_AD_fw_Radar_1R1V_rpc_XilObjBypassingRunnable_XilObjBypassingRunnable_m_pad_radarObjPort_par_out_local::TChangeableMemPool::_::_::_m_arrayPool::_0_::_elem::_m_objectInformation::_7_::_m_ayN = 0;
        @sysvar::XCP::RadarFC_Obj::_g_PL_AD_fw_Radar_1R1V_rpc_XilObjBypassingRunnable_XilObjBypassingRunnable_m_pad_radarObjPort_par_out_local::TChangeableMemPool::_::_::_m_arrayPool::_0_::_elem::_m_objectInformation::_7_::_m_alpPiYawAngleN = 0;
        @sysvar::XCP::RadarFC_Obj::_g_PL_AD_fw_Radar_1R1V_rpc_XilObjBypassingRunnable_XilObjBypassingRunnable_m_pad_radarObjPort_par_out_local::TChangeableMemPool::_::_::_m_arrayPool::_0_::_elem::_m_objectInformation::_7_::_m_prob1HasBeenObservedMovingN = 0;
        @sysvar::XCP::RadarFC_Obj::_g_PL_AD_fw_Radar_1R1V_rpc_XilObjBypassingRunnable_XilObjBypassingRunnable_m_pad_radarObjPort_par_out_local::TChangeableMemPool::_::_::_m_arrayPool::_0_::_elem::_m_objectInformation::_7_::_m_prob1MovingN = 0;
        @sysvar::XCP::RadarFC_Obj::_g_PL_AD_fw_Radar_1R1V_rpc_XilObjBypassingRunnable_XilObjBypassingRunnable_m_pad_radarObjPort_par_out_local::TChangeableMemPool::_::_::_m_arrayPool::_0_::_elem::_m_objectInformation::_7_::_m_perObjectType::_m_prob1ObstacleN = 0;
        @sysvar::XCP::RadarFC_Obj::_g_PL_AD_fw_Radar_1R1V_rpc_XilObjBypassingRunnable_XilObjBypassingRunnable_m_pad_radarObjPort_par_out_local::TChangeableMemPool::_::_::_m_arrayPool::_0_::_elem::_m_objectInformation::_7_::_m_perObjectType::_m_prob1NonObstacleN = 0;
        @sysvar::XCP::RadarFC_Obj::_g_PL_AD_fw_Radar_1R1V_rpc_XilObjBypassingRunnable_XilObjBypassingRunnable_m_pad_radarObjPort_par_out_local::TChangeableMemPool::_::_::_m_arrayPool::_0_::_elem::_m_objectInformation::_7_::_m_perObjectType::_m_prob1MobileN = 0;
        @sysvar::XCP::RadarFC_Obj::_g_PL_AD_fw_Radar_1R1V_rpc_XilObjBypassingRunnable_XilObjBypassingRunnable_m_pad_radarObjPort_par_out_local::TChangeableMemPool::_::_::_m_arrayPool::_0_::_elem::_m_objectInformation::_7_::_m_perObjectType::_m_prob1StationaryN = 0;
        @sysvar::XCP::RadarFC_Obj::_g_PL_AD_fw_Radar_1R1V_rpc_XilObjBypassingRunnable_XilObjBypassingRunnable_m_pad_radarObjPort_par_out_local::TChangeableMemPool::_::_::_m_arrayPool::_0_::_elem::_m_objectInformation::_7_::_m_perObjectType::_m_prob1FourPlusWheelerN = 0;
        @sysvar::XCP::RadarFC_Obj::_g_PL_AD_fw_Radar_1R1V_rpc_XilObjBypassingRunnable_XilObjBypassingRunnable_m_pad_radarObjPort_par_out_local::TChangeableMemPool::_::_::_m_arrayPool::_0_::_elem::_m_objectInformation::_7_::_m_perObjectType::_m_prob1TwoWheelerN = 0;
        @sysvar::XCP::RadarFC_Obj::_g_PL_AD_fw_Radar_1R1V_rpc_XilObjBypassingRunnable_XilObjBypassingRunnable_m_pad_radarObjPort_par_out_local::TChangeableMemPool::_::_::_m_arrayPool::_0_::_elem::_m_objectInformation::_7_::_m_perObjectType::_m_prob1PedestrianN = 0;
        @sysvar::XCP::RadarFC_Obj::_g_PL_AD_fw_Radar_1R1V_rpc_XilObjBypassingRunnable_XilObjBypassingRunnable_m_pad_radarObjPort_par_out_local::TChangeableMemPool::_::_::_m_arrayPool::_0_::_elem::_m_objectInformation::_7_::_m_perObjectType::_m_prob1RoadsideBarrierN = 0;
        @sysvar::XCP::RadarFC_Obj::_g_PL_AD_fw_Radar_1R1V_rpc_XilObjBypassingRunnable_XilObjBypassingRunnable_m_pad_radarObjPort_par_out_local::TChangeableMemPool::_::_::_m_arrayPool::_0_::_elem::_m_objectInformation::_7_::_m_perObjectType::_m_prob1PassengerCarN = 0;
        @sysvar::XCP::RadarFC_Obj::_g_PL_AD_fw_Radar_1R1V_rpc_XilObjBypassingRunnable_XilObjBypassingRunnable_m_pad_radarObjPort_par_out_local::TChangeableMemPool::_::_::_m_arrayPool::_0_::_elem::_m_objectInformation::_7_::_m_perObjectType::_m_prob1TruckN = 0;
        @sysvar::XCP::RadarFC_Obj::_g_PL_AD_fw_Radar_1R1V_rpc_XilObjBypassingRunnable_XilObjBypassingRunnable_m_pad_radarObjPort_par_out_local::TChangeableMemPool::_::_::_m_arrayPool::_0_::_elem::_m_objectInformation::_7_::_m_perObjectType::_m_prob1UnknownN = 0;
        @sysvar::XCP::RadarFC_Obj::_g_PL_AD_fw_Radar_1R1V_rpc_XilObjBypassingRunnable_XilObjBypassingRunnable_m_pad_radarObjPort_par_out_local::TChangeableMemPool::_::_::_m_arrayPool::_0_::_elem::_m_objectInformation::_7_::_m_perObjectType::_m_prob1MovUnknownN = 0;
        @sysvar::XCP::RadarFC_Obj::_g_PL_AD_fw_Radar_1R1V_rpc_XilObjBypassingRunnable_XilObjBypassingRunnable_m_pad_radarObjPort_par_out_local::TChangeableMemPool::_::_::_m_arrayPool::_0_::_elem::_m_objectInformation::_7_::_m_perObjectType::_m_prob1StatUnknownN = 0;
        @sysvar::XCP::RadarFC_Obj::_g_PL_AD_fw_Radar_1R1V_rpc_XilObjBypassingRunnable_XilObjBypassingRunnable_m_pad_radarObjPort_par_out_local::TChangeableMemPool::_::_::_m_arrayPool::_0_::_elem::_m_objectInformation::_7_::_m_perObjectType::_m_prob1ObstUnknownN = 0;
        @sysvar::XCP::RadarFC_Obj::_g_PL_AD_fw_Radar_1R1V_rpc_XilObjBypassingRunnable_XilObjBypassingRunnable_m_pad_radarObjPort_par_out_local::TChangeableMemPool::_::_::_m_arrayPool::_0_::_elem::_m_objectInformation::_7_::_m_perObjectType::_m_prob1FourWheelUnknownN = 0;
        break;
        
      case 8: //"Object-8"
        @sysvar::XCP::RadarFC_Obj::_g_PL_AD_fw_Radar_1R1V_rpc_XilObjBypassingRunnable_XilObjBypassingRunnable_m_pad_radarObjPort_par_out_local::TChangeableMemPool::_::_::_m_arrayPool::_0_::_elem::_m_objectInformation::_8_::_Valid_b = 0;
        @sysvar::XCP::RadarFC_Obj::_g_PL_AD_fw_Radar_1R1V_rpc_XilObjBypassingRunnable_XilObjBypassingRunnable_m_pad_radarObjPort_par_out_local::TChangeableMemPool::_::_::_m_arrayPool::_0_::_elem::_m_objectInformation::_8_::_m_HandleN = 0;
        @sysvar::XCP::RadarFC_Obj::_g_PL_AD_fw_Radar_1R1V_rpc_XilObjBypassingRunnable_XilObjBypassingRunnable_m_pad_radarObjPort_par_out_local::TChangeableMemPool::_::_::_m_arrayPool::_0_::_elem::_m_objectInformation::_8_::_m_alpPiVarYawAngleN = 0;
        @sysvar::XCP::RadarFC_Obj::_g_PL_AD_fw_Radar_1R1V_rpc_XilObjBypassingRunnable_XilObjBypassingRunnable_m_pad_radarObjPort_par_out_local::TChangeableMemPool::_::_::_m_arrayPool::_0_::_elem::_m_objectInformation::_8_::_m_varAxN = 0;
        @sysvar::XCP::RadarFC_Obj::_g_PL_AD_fw_Radar_1R1V_rpc_XilObjBypassingRunnable_XilObjBypassingRunnable_m_pad_radarObjPort_par_out_local::TChangeableMemPool::_::_::_m_arrayPool::_0_::_elem::_m_objectInformation::_8_::_m_varAyN = 0;
        @sysvar::XCP::RadarFC_Obj::_g_PL_AD_fw_Radar_1R1V_rpc_XilObjBypassingRunnable_XilObjBypassingRunnable_m_pad_radarObjPort_par_out_local::TChangeableMemPool::_::_::_m_arrayPool::_0_::_elem::_m_objectInformation::_8_::_m_varVxN = 0;
        @sysvar::XCP::RadarFC_Obj::_g_PL_AD_fw_Radar_1R1V_rpc_XilObjBypassingRunnable_XilObjBypassingRunnable_m_pad_radarObjPort_par_out_local::TChangeableMemPool::_::_::_m_arrayPool::_0_::_elem::_m_objectInformation::_8_::_m_varVyN = 0;
        @sysvar::XCP::RadarFC_Obj::_g_PL_AD_fw_Radar_1R1V_rpc_XilObjBypassingRunnable_XilObjBypassingRunnable_m_pad_radarObjPort_par_out_local::TChangeableMemPool::_::_::_m_arrayPool::_0_::_elem::_m_objectInformation::_8_::_m_varDxN = 0;
        @sysvar::XCP::RadarFC_Obj::_g_PL_AD_fw_Radar_1R1V_rpc_XilObjBypassingRunnable_XilObjBypassingRunnable_m_pad_radarObjPort_par_out_local::TChangeableMemPool::_::_::_m_arrayPool::_0_::_elem::_m_objectInformation::_8_::_m_varDyN = 0;
        @sysvar::XCP::RadarFC_Obj::_g_PL_AD_fw_Radar_1R1V_rpc_XilObjBypassingRunnable_XilObjBypassingRunnable_m_pad_radarObjPort_par_out_local::TChangeableMemPool::_::_::_m_arrayPool::_0_::_elem::_m_objectInformation::_8_::_m_dVarLengthN = 0;
        @sysvar::XCP::RadarFC_Obj::_g_PL_AD_fw_Radar_1R1V_rpc_XilObjBypassingRunnable_XilObjBypassingRunnable_m_pad_radarObjPort_par_out_local::TChangeableMemPool::_::_::_m_arrayPool::_0_::_elem::_m_objectInformation::_8_::_m_dVarWidthN = 0;
        @sysvar::XCP::RadarFC_Obj::_g_PL_AD_fw_Radar_1R1V_rpc_XilObjBypassingRunnable_XilObjBypassingRunnable_m_pad_radarObjPort_par_out_local::TChangeableMemPool::_::_::_m_arrayPool::_0_::_elem::_m_objectInformation::_8_::_m_wExistProbN = 0;
        @sysvar::XCP::RadarFC_Obj::_g_PL_AD_fw_Radar_1R1V_rpc_XilObjBypassingRunnable_XilObjBypassingRunnable_m_pad_radarObjPort_par_out_local::TChangeableMemPool::_::_::_m_arrayPool::_0_::_elem::_m_objectInformation::_8_::_m_isObjectAsil = 0;
        @sysvar::XCP::RadarFC_Obj::_g_PL_AD_fw_Radar_1R1V_rpc_XilObjBypassingRunnable_XilObjBypassingRunnable_m_pad_radarObjPort_par_out_local::TChangeableMemPool::_::_::_m_arrayPool::_0_::_elem::_m_objectInformation::_8_::_m_dWidthN = 0;
        @sysvar::XCP::RadarFC_Obj::_g_PL_AD_fw_Radar_1R1V_rpc_XilObjBypassingRunnable_XilObjBypassingRunnable_m_pad_radarObjPort_par_out_local::TChangeableMemPool::_::_::_m_arrayPool::_0_::_elem::_m_objectInformation::_8_::_m_dLengthN = 0;
        @sysvar::XCP::RadarFC_Obj::_g_PL_AD_fw_Radar_1R1V_rpc_XilObjBypassingRunnable_XilObjBypassingRunnable_m_pad_radarObjPort_par_out_local::TChangeableMemPool::_::_::_m_arrayPool::_0_::_elem::_m_objectInformation::_8_::_m_dxN = 0;
        @sysvar::XCP::RadarFC_Obj::_g_PL_AD_fw_Radar_1R1V_rpc_XilObjBypassingRunnable_XilObjBypassingRunnable_m_pad_radarObjPort_par_out_local::TChangeableMemPool::_::_::_m_arrayPool::_0_::_elem::_m_objectInformation::_8_::_m_dyN = 0;
        @sysvar::XCP::RadarFC_Obj::_g_PL_AD_fw_Radar_1R1V_rpc_XilObjBypassingRunnable_XilObjBypassingRunnable_m_pad_radarObjPort_par_out_local::TChangeableMemPool::_::_::_m_arrayPool::_0_::_elem::_m_objectInformation::_8_::_m_dzN = 0;
        @sysvar::XCP::RadarFC_Obj::_g_PL_AD_fw_Radar_1R1V_rpc_XilObjBypassingRunnable_XilObjBypassingRunnable_m_pad_radarObjPort_par_out_local::TChangeableMemPool::_::_::_m_arrayPool::_0_::_elem::_m_objectInformation::_8_::_m_vxN = 0;
        @sysvar::XCP::RadarFC_Obj::_g_PL_AD_fw_Radar_1R1V_rpc_XilObjBypassingRunnable_XilObjBypassingRunnable_m_pad_radarObjPort_par_out_local::TChangeableMemPool::_::_::_m_arrayPool::_0_::_elem::_m_objectInformation::_8_::_m_vyN = 0;
        @sysvar::XCP::RadarFC_Obj::_g_PL_AD_fw_Radar_1R1V_rpc_XilObjBypassingRunnable_XilObjBypassingRunnable_m_pad_radarObjPort_par_out_local::TChangeableMemPool::_::_::_m_arrayPool::_0_::_elem::_m_objectInformation::_8_::_m_axN = 0;
        @sysvar::XCP::RadarFC_Obj::_g_PL_AD_fw_Radar_1R1V_rpc_XilObjBypassingRunnable_XilObjBypassingRunnable_m_pad_radarObjPort_par_out_local::TChangeableMemPool::_::_::_m_arrayPool::_0_::_elem::_m_objectInformation::_8_::_m_ayN = 0;
        @sysvar::XCP::RadarFC_Obj::_g_PL_AD_fw_Radar_1R1V_rpc_XilObjBypassingRunnable_XilObjBypassingRunnable_m_pad_radarObjPort_par_out_local::TChangeableMemPool::_::_::_m_arrayPool::_0_::_elem::_m_objectInformation::_8_::_m_alpPiYawAngleN = 0;
        @sysvar::XCP::RadarFC_Obj::_g_PL_AD_fw_Radar_1R1V_rpc_XilObjBypassingRunnable_XilObjBypassingRunnable_m_pad_radarObjPort_par_out_local::TChangeableMemPool::_::_::_m_arrayPool::_0_::_elem::_m_objectInformation::_8_::_m_prob1HasBeenObservedMovingN = 0;
        @sysvar::XCP::RadarFC_Obj::_g_PL_AD_fw_Radar_1R1V_rpc_XilObjBypassingRunnable_XilObjBypassingRunnable_m_pad_radarObjPort_par_out_local::TChangeableMemPool::_::_::_m_arrayPool::_0_::_elem::_m_objectInformation::_8_::_m_prob1MovingN = 0;
        @sysvar::XCP::RadarFC_Obj::_g_PL_AD_fw_Radar_1R1V_rpc_XilObjBypassingRunnable_XilObjBypassingRunnable_m_pad_radarObjPort_par_out_local::TChangeableMemPool::_::_::_m_arrayPool::_0_::_elem::_m_objectInformation::_8_::_m_perObjectType::_m_prob1ObstacleN = 0;
        @sysvar::XCP::RadarFC_Obj::_g_PL_AD_fw_Radar_1R1V_rpc_XilObjBypassingRunnable_XilObjBypassingRunnable_m_pad_radarObjPort_par_out_local::TChangeableMemPool::_::_::_m_arrayPool::_0_::_elem::_m_objectInformation::_8_::_m_perObjectType::_m_prob1NonObstacleN = 0;
        @sysvar::XCP::RadarFC_Obj::_g_PL_AD_fw_Radar_1R1V_rpc_XilObjBypassingRunnable_XilObjBypassingRunnable_m_pad_radarObjPort_par_out_local::TChangeableMemPool::_::_::_m_arrayPool::_0_::_elem::_m_objectInformation::_8_::_m_perObjectType::_m_prob1MobileN = 0;
        @sysvar::XCP::RadarFC_Obj::_g_PL_AD_fw_Radar_1R1V_rpc_XilObjBypassingRunnable_XilObjBypassingRunnable_m_pad_radarObjPort_par_out_local::TChangeableMemPool::_::_::_m_arrayPool::_0_::_elem::_m_objectInformation::_8_::_m_perObjectType::_m_prob1StationaryN = 0;
        @sysvar::XCP::RadarFC_Obj::_g_PL_AD_fw_Radar_1R1V_rpc_XilObjBypassingRunnable_XilObjBypassingRunnable_m_pad_radarObjPort_par_out_local::TChangeableMemPool::_::_::_m_arrayPool::_0_::_elem::_m_objectInformation::_8_::_m_perObjectType::_m_prob1FourPlusWheelerN = 0;
        @sysvar::XCP::RadarFC_Obj::_g_PL_AD_fw_Radar_1R1V_rpc_XilObjBypassingRunnable_XilObjBypassingRunnable_m_pad_radarObjPort_par_out_local::TChangeableMemPool::_::_::_m_arrayPool::_0_::_elem::_m_objectInformation::_8_::_m_perObjectType::_m_prob1TwoWheelerN = 0;
        @sysvar::XCP::RadarFC_Obj::_g_PL_AD_fw_Radar_1R1V_rpc_XilObjBypassingRunnable_XilObjBypassingRunnable_m_pad_radarObjPort_par_out_local::TChangeableMemPool::_::_::_m_arrayPool::_0_::_elem::_m_objectInformation::_8_::_m_perObjectType::_m_prob1PedestrianN = 0;
        @sysvar::XCP::RadarFC_Obj::_g_PL_AD_fw_Radar_1R1V_rpc_XilObjBypassingRunnable_XilObjBypassingRunnable_m_pad_radarObjPort_par_out_local::TChangeableMemPool::_::_::_m_arrayPool::_0_::_elem::_m_objectInformation::_8_::_m_perObjectType::_m_prob1RoadsideBarrierN = 0;
        @sysvar::XCP::RadarFC_Obj::_g_PL_AD_fw_Radar_1R1V_rpc_XilObjBypassingRunnable_XilObjBypassingRunnable_m_pad_radarObjPort_par_out_local::TChangeableMemPool::_::_::_m_arrayPool::_0_::_elem::_m_objectInformation::_8_::_m_perObjectType::_m_prob1PassengerCarN = 0;
        @sysvar::XCP::RadarFC_Obj::_g_PL_AD_fw_Radar_1R1V_rpc_XilObjBypassingRunnable_XilObjBypassingRunnable_m_pad_radarObjPort_par_out_local::TChangeableMemPool::_::_::_m_arrayPool::_0_::_elem::_m_objectInformation::_8_::_m_perObjectType::_m_prob1TruckN = 0;
        @sysvar::XCP::RadarFC_Obj::_g_PL_AD_fw_Radar_1R1V_rpc_XilObjBypassingRunnable_XilObjBypassingRunnable_m_pad_radarObjPort_par_out_local::TChangeableMemPool::_::_::_m_arrayPool::_0_::_elem::_m_objectInformation::_8_::_m_perObjectType::_m_prob1UnknownN = 0;
        @sysvar::XCP::RadarFC_Obj::_g_PL_AD_fw_Radar_1R1V_rpc_XilObjBypassingRunnable_XilObjBypassingRunnable_m_pad_radarObjPort_par_out_local::TChangeableMemPool::_::_::_m_arrayPool::_0_::_elem::_m_objectInformation::_8_::_m_perObjectType::_m_prob1MovUnknownN = 0;
        @sysvar::XCP::RadarFC_Obj::_g_PL_AD_fw_Radar_1R1V_rpc_XilObjBypassingRunnable_XilObjBypassingRunnable_m_pad_radarObjPort_par_out_local::TChangeableMemPool::_::_::_m_arrayPool::_0_::_elem::_m_objectInformation::_8_::_m_perObjectType::_m_prob1StatUnknownN = 0;
        @sysvar::XCP::RadarFC_Obj::_g_PL_AD_fw_Radar_1R1V_rpc_XilObjBypassingRunnable_XilObjBypassingRunnable_m_pad_radarObjPort_par_out_local::TChangeableMemPool::_::_::_m_arrayPool::_0_::_elem::_m_objectInformation::_8_::_m_perObjectType::_m_prob1ObstUnknownN = 0;
        @sysvar::XCP::RadarFC_Obj::_g_PL_AD_fw_Radar_1R1V_rpc_XilObjBypassingRunnable_XilObjBypassingRunnable_m_pad_radarObjPort_par_out_local::TChangeableMemPool::_::_::_m_arrayPool::_0_::_elem::_m_objectInformation::_8_::_m_perObjectType::_m_prob1FourWheelUnknownN = 0;
        break;
        
    }
}
