/*@!Encoding:1252*/
/**
 * @file Road_Obj.can
 * @author Anton Rommel, Rafael Herrera
 * @date 19.08.2021
 * @brief Handles Radar object injection into XCP
 */

includes
{
}

variables
{
  /*
Integers in form of
byte (unsigned, 1 Byte)
word (unsigned, 2 Byte)
dword (unsigned, 4 Byte)
int (signed, 2 Byte)
long (signed, 4 Byte)
int64(signed, 8 Byte)
qword(unsigned, 8 Byte)
Individual character
char (1 Byte)
Floating point numbers
float (8 Byte)
double (8 Byte)
*/  
}


void obj_sim_update_CRadarFL_xcp(byte object_id)
{
//  //header
  @sysvar::XCP::RadarFL::_g_PlReCoFw_PlReCoPer_ObjBypassingRunnable_ObjBypassingRunnable_m_pad_radarObjPort_par_out_local::TChangeableMemPool::_::_::_m_arrayPool::_0_::_elem::port_ens_r_obj_sensor_base::_::_m_alignment::_m_alpAzimuthAngOffsetN = -1146;
  @sysvar::XCP::RadarFL::_g_PlReCoFw_PlReCoPer_ObjBypassingRunnable_ObjBypassingRunnable_m_pad_radarObjPort_par_out_local::TChangeableMemPool::_::_::_m_arrayPool::_0_::_elem::port_ens_r_obj_sensor_base::_::_m_alignment::_m_alpMountAngleN = 0;
  @sysvar::XCP::RadarFL::_g_PlReCoFw_PlReCoPer_ObjBypassingRunnable_ObjBypassingRunnable_m_pad_radarObjPort_par_out_local::TChangeableMemPool::_::_::_m_arrayPool::_0_::_elem::port_ens_r_obj_sensor_base::_::_m_alignment::_m_dLongitudinalOffsetRearAxisN = 455;
  @sysvar::XCP::RadarFL::_g_PlReCoFw_PlReCoPer_ObjBypassingRunnable_ObjBypassingRunnable_m_pad_radarObjPort_par_out_local::TChangeableMemPool::_::_::_m_arrayPool::_0_::_elem::port_ens_r_obj_sensor_base::_::_m_alignment::_m_dMountElevationN = 20;
  @sysvar::XCP::RadarFL::_g_PlReCoFw_PlReCoPer_ObjBypassingRunnable_ObjBypassingRunnable_m_pad_radarObjPort_par_out_local::TChangeableMemPool::_::_::_m_arrayPool::_0_::_elem::port_ens_r_obj_sensor_base::_::_m_alignment::_m_dMountOffsetN = 0;
  
  switch (@Classe_Obj_Sim::objdata.obj_id[object_id])

 {
    case 0: //"Object-0"
//    //constant
    @sysvar::XCP::RadarFL::_g_PlReCoFw_PlReCoPer_ObjBypassingRunnable_ObjBypassingRunnable_m_pad_radarObjPort_par_out_local::TChangeableMemPool::_::_::_m_arrayPool::_0_::_elem::port_ens_r_obj_sensor_base::_::_m_movObjectInformation::_0_::STA_OBJECT_INFORMATION_ST::_::_Meas_b = 1;
    @sysvar::XCP::RadarFL::_g_PlReCoFw_PlReCoPer_ObjBypassingRunnable_ObjBypassingRunnable_m_pad_radarObjPort_par_out_local::TChangeableMemPool::_::_::_m_arrayPool::_0_::_elem::port_ens_r_obj_sensor_base::_::_m_movObjectInformation::_0_::STA_OBJECT_INFORMATION_ST::_::_Measurable_b = 1;
    @sysvar::XCP::RadarFL::_g_PlReCoFw_PlReCoPer_ObjBypassingRunnable_ObjBypassingRunnable_m_pad_radarObjPort_par_out_local::TChangeableMemPool::_::_::_m_arrayPool::_0_::_elem::port_ens_r_obj_sensor_base::_::_m_movObjectInformation::_0_::STA_OBJECT_INFORMATION_ST::_::_Valid_b = 1;
    @sysvar::XCP::RadarFL::_g_PlReCoFw_PlReCoPer_ObjBypassingRunnable_ObjBypassingRunnable_m_pad_radarObjPort_par_out_local::TChangeableMemPool::_::_::_m_arrayPool::_0_::_elem::port_ens_r_obj_sensor_base::_::_m_movObjectInformation::_0_::_m_covarDxAxN = 0;
    @sysvar::XCP::RadarFL::_g_PlReCoFw_PlReCoPer_ObjBypassingRunnable_ObjBypassingRunnable_m_pad_radarObjPort_par_out_local::TChangeableMemPool::_::_::_m_arrayPool::_0_::_elem::port_ens_r_obj_sensor_base::_::_m_movObjectInformation::_0_::_m_covarDxVxN = 0;
    @sysvar::XCP::RadarFL::_g_PlReCoFw_PlReCoPer_ObjBypassingRunnable_ObjBypassingRunnable_m_pad_radarObjPort_par_out_local::TChangeableMemPool::_::_::_m_arrayPool::_0_::_elem::port_ens_r_obj_sensor_base::_::_m_movObjectInformation::_0_::_m_covarDyVyN = 0;
    @sysvar::XCP::RadarFL::_g_PlReCoFw_PlReCoPer_ObjBypassingRunnable_ObjBypassingRunnable_m_pad_radarObjPort_par_out_local::TChangeableMemPool::_::_::_m_arrayPool::_0_::_elem::port_ens_r_obj_sensor_base::_::_m_movObjectInformation::_0_::_m_covarDyWidthN = 0;
    @sysvar::XCP::RadarFL::_g_PlReCoFw_PlReCoPer_ObjBypassingRunnable_ObjBypassingRunnable_m_pad_radarObjPort_par_out_local::TChangeableMemPool::_::_::_m_arrayPool::_0_::_elem::port_ens_r_obj_sensor_base::_::_m_movObjectInformation::_0_::_m_covarVxAxN = 0;
    @sysvar::XCP::RadarFL::_g_PlReCoFw_PlReCoPer_ObjBypassingRunnable_ObjBypassingRunnable_m_pad_radarObjPort_par_out_local::TChangeableMemPool::_::_::_m_arrayPool::_0_::_elem::port_ens_r_obj_sensor_base::_::_m_movObjectInformation::_0_::_m_varAxN = 0;
    @sysvar::XCP::RadarFL::_g_PlReCoFw_PlReCoPer_ObjBypassingRunnable_ObjBypassingRunnable_m_pad_radarObjPort_par_out_local::TChangeableMemPool::_::_::_m_arrayPool::_0_::_elem::port_ens_r_obj_sensor_base::_::_m_movObjectInformation::_0_::_m_varAyN = 0;
    @sysvar::XCP::RadarFL::_g_PlReCoFw_PlReCoPer_ObjBypassingRunnable_ObjBypassingRunnable_m_pad_radarObjPort_par_out_local::TChangeableMemPool::_::_::_m_arrayPool::_0_::_elem::port_ens_r_obj_sensor_base::_::_m_movObjectInformation::_0_::_m_varVxN = 0;
    @sysvar::XCP::RadarFL::_g_PlReCoFw_PlReCoPer_ObjBypassingRunnable_ObjBypassingRunnable_m_pad_radarObjPort_par_out_local::TChangeableMemPool::_::_::_m_arrayPool::_0_::_elem::port_ens_r_obj_sensor_base::_::_m_movObjectInformation::_0_::_m_varVyN = 0;
    @sysvar::XCP::RadarFL::_g_PlReCoFw_PlReCoPer_ObjBypassingRunnable_ObjBypassingRunnable_m_pad_radarObjPort_par_out_local::TChangeableMemPool::_::_::_m_arrayPool::_0_::_elem::port_ens_r_obj_sensor_base::_::_m_movObjectInformation::_0_::STA_OBJECT_INFORMATION_ST::_::_m_varDxN = 0;
    @sysvar::XCP::RadarFL::_g_PlReCoFw_PlReCoPer_ObjBypassingRunnable_ObjBypassingRunnable_m_pad_radarObjPort_par_out_local::TChangeableMemPool::_::_::_m_arrayPool::_0_::_elem::port_ens_r_obj_sensor_base::_::_m_movObjectInformation::_0_::STA_OBJECT_INFORMATION_ST::_::_m_varDyN = 0;
    @sysvar::XCP::RadarFL::_g_PlReCoFw_PlReCoPer_ObjBypassingRunnable_ObjBypassingRunnable_m_pad_radarObjPort_par_out_local::TChangeableMemPool::_::_::_m_arrayPool::_0_::_elem::port_ens_r_obj_sensor_base::_::_m_movObjectInformation::_0_::_m_dVarLengthN = 0;
    @sysvar::XCP::RadarFL::_g_PlReCoFw_PlReCoPer_ObjBypassingRunnable_ObjBypassingRunnable_m_pad_radarObjPort_par_out_local::TChangeableMemPool::_::_::_m_arrayPool::_0_::_elem::port_ens_r_obj_sensor_base::_::_m_movObjectInformation::_0_::_m_dVarWidthN = 0;
    @sysvar::XCP::RadarFL::_g_PlReCoFw_PlReCoPer_ObjBypassingRunnable_ObjBypassingRunnable_m_pad_radarObjPort_par_out_local::TChangeableMemPool::_::_::_m_arrayPool::_0_::_elem::port_ens_r_obj_sensor_base::_::_m_movObjectInformation::_0_::STA_OBJECT_INFORMATION_ST::_::_m_wExistProbN = 64880;
    @sysvar::XCP::RadarFL::_g_PlReCoFw_PlReCoPer_ObjBypassingRunnable_ObjBypassingRunnable_m_pad_radarObjPort_par_out_local::TChangeableMemPool::_::_::_m_arrayPool::_0_::_elem::port_ens_r_obj_sensor_base::_::_m_movObjectInformation::_0_::_m_referencePtPosIndexN = 10;
    @sysvar::XCP::RadarFL::_g_PlReCoFw_PlReCoPer_ObjBypassingRunnable_ObjBypassingRunnable_m_pad_radarObjPort_par_out_local::TChangeableMemPool::_::_::_m_arrayPool::_0_::_elem::port_ens_r_obj_sensor_base::_::_m_movObjectInformation::_0_::_m_alpPiVarYawAngleN = 0;
    @sysvar::XCP::RadarFL::_g_PlReCoFw_PlReCoPer_ObjBypassingRunnable_ObjBypassingRunnable_m_pad_radarObjPort_par_out_local::TChangeableMemPool::_::_::_m_arrayPool::_0_::_elem::port_ens_r_obj_sensor_base::_::_m_movObjectInformation::_0_::_m_alpPiYawAngleN = 0;

//    //target movement

    @sysvar::XCP::RadarFL::_g_PlReCoFw_PlReCoPer_ObjBypassingRunnable_ObjBypassingRunnable_m_pad_radarObjPort_par_out_local::TChangeableMemPool::_::_::_m_arrayPool::_0_::_elem::port_ens_r_obj_sensor_base::_::_m_movObjectInformation::_0_::STA_OBJECT_INFORMATION_ST::_::_m_dxN = @Classe_Obj_Sim::objdata.obj_dx[0] * 128;
    @sysvar::XCP::RadarFL::_g_PlReCoFw_PlReCoPer_ObjBypassingRunnable_ObjBypassingRunnable_m_pad_radarObjPort_par_out_local::TChangeableMemPool::_::_::_m_arrayPool::_0_::_elem::port_ens_r_obj_sensor_base::_::_m_movObjectInformation::_0_::STA_OBJECT_INFORMATION_ST::_::_m_dyN = @Classe_Obj_Sim::objdata.obj_dy[0] * 128;
    @sysvar::XCP::RadarFL::_g_PlReCoFw_PlReCoPer_ObjBypassingRunnable_ObjBypassingRunnable_m_pad_radarObjPort_par_out_local::TChangeableMemPool::_::_::_m_arrayPool::_0_::_elem::port_ens_r_obj_sensor_base::_::_m_movObjectInformation::_0_::STA_OBJECT_INFORMATION_ST::_::_m_dzN = 0;
    @sysvar::XCP::RadarFL::_g_PlReCoFw_PlReCoPer_ObjBypassingRunnable_ObjBypassingRunnable_m_pad_radarObjPort_par_out_local::TChangeableMemPool::_::_::_m_arrayPool::_0_::_elem::port_ens_r_obj_sensor_base::_::_m_movObjectInformation::_0_::_m_vxN = @Classe_Obj_Sim::objdata.obj_relative_vx[0] * 256;
    @sysvar::XCP::RadarFL::_g_PlReCoFw_PlReCoPer_ObjBypassingRunnable_ObjBypassingRunnable_m_pad_radarObjPort_par_out_local::TChangeableMemPool::_::_::_m_arrayPool::_0_::_elem::port_ens_r_obj_sensor_base::_::_m_movObjectInformation::_0_::_m_vyN = @Classe_Obj_Sim::objdata.obj_relative_vy[0] * 256;
    @sysvar::XCP::RadarFL::_g_PlReCoFw_PlReCoPer_ObjBypassingRunnable_ObjBypassingRunnable_m_pad_radarObjPort_par_out_local::TChangeableMemPool::_::_::_m_arrayPool::_0_::_elem::port_ens_r_obj_sensor_base::_::_m_movObjectInformation::_0_::_m_axN = 0;
    @sysvar::XCP::RadarFL::_g_PlReCoFw_PlReCoPer_ObjBypassingRunnable_ObjBypassingRunnable_m_pad_radarObjPort_par_out_local::TChangeableMemPool::_::_::_m_arrayPool::_0_::_elem::port_ens_r_obj_sensor_base::_::_m_movObjectInformation::_0_::_m_ayN = 0;

//    //target object moving or not
    if (abs(@Classe_Obj_Sim::objdata.obj_relative_vx[0]) != 0)
    {
      @sysvar::XCP::RadarFL::_g_PlReCoFw_PlReCoPer_ObjBypassingRunnable_ObjBypassingRunnable_m_pad_radarObjPort_par_out_local::TChangeableMemPool::_::_::_m_arrayPool::_0_::_elem::port_ens_r_obj_sensor_base::_::_m_movObjectInformation::_0_::STA_OBJECT_INFORMATION_ST::_::_m_prob1HasBeenObservedMovingN = 126;
      @sysvar::XCP::RadarFL::_g_PlReCoFw_PlReCoPer_ObjBypassingRunnable_ObjBypassingRunnable_m_pad_radarObjPort_par_out_local::TChangeableMemPool::_::_::_m_arrayPool::_0_::_elem::port_ens_r_obj_sensor_base::_::_m_movObjectInformation::_0_::STA_OBJECT_INFORMATION_ST::_::_m_prob1MovingN = 126;
      @sysvar::XCP::RadarFL::_g_PlReCoFw_PlReCoPer_ObjBypassingRunnable_ObjBypassingRunnable_m_pad_radarObjPort_par_out_local::TChangeableMemPool::_::_::_m_arrayPool::_0_::_elem::port_ens_r_obj_sensor_base::_::_m_movObjectInformation::_0_::STA_OBJECT_INFORMATION_ST::_::_m_ohyObjectType_st::_m_probObstacle_st::_m_prob1MobileN = 128;
      @sysvar::XCP::RadarFL::_g_PlReCoFw_PlReCoPer_ObjBypassingRunnable_ObjBypassingRunnable_m_pad_radarObjPort_par_out_local::TChangeableMemPool::_::_::_m_arrayPool::_0_::_elem::port_ens_r_obj_sensor_base::_::_m_movObjectInformation::_0_::STA_OBJECT_INFORMATION_ST::_::_m_ohyObjectType_st::_m_probObstacle_st::_m_prob1StationaryN = 0;
    }
    else
    {
      @sysvar::XCP::RadarFL::_g_PlReCoFw_PlReCoPer_ObjBypassingRunnable_ObjBypassingRunnable_m_pad_radarObjPort_par_out_local::TChangeableMemPool::_::_::_m_arrayPool::_0_::_elem::port_ens_r_obj_sensor_base::_::_m_movObjectInformation::_0_::STA_OBJECT_INFORMATION_ST::_::_m_prob1HasBeenObservedMovingN = 0;
      @sysvar::XCP::RadarFL::_g_PlReCoFw_PlReCoPer_ObjBypassingRunnable_ObjBypassingRunnable_m_pad_radarObjPort_par_out_local::TChangeableMemPool::_::_::_m_arrayPool::_0_::_elem::port_ens_r_obj_sensor_base::_::_m_movObjectInformation::_0_::STA_OBJECT_INFORMATION_ST::_::_m_prob1MovingN = 0;
      @sysvar::XCP::RadarFL::_g_PlReCoFw_PlReCoPer_ObjBypassingRunnable_ObjBypassingRunnable_m_pad_radarObjPort_par_out_local::TChangeableMemPool::_::_::_m_arrayPool::_0_::_elem::port_ens_r_obj_sensor_base::_::_m_movObjectInformation::_0_::STA_OBJECT_INFORMATION_ST::_::_m_ohyObjectType_st::_m_probObstacle_st::_m_prob1MobileN = 0;
      @sysvar::XCP::RadarFL::_g_PlReCoFw_PlReCoPer_ObjBypassingRunnable_ObjBypassingRunnable_m_pad_radarObjPort_par_out_local::TChangeableMemPool::_::_::_m_arrayPool::_0_::_elem::port_ens_r_obj_sensor_base::_::_m_movObjectInformation::_0_::STA_OBJECT_INFORMATION_ST::_::_m_ohyObjectType_st::_m_probObstacle_st::_m_prob1StationaryN = 128;
    }

      //object classification
    switch (@Classe_Obj_Sim::objdata.obj_type[0])
    {
      case 0: //"Non-Obstacle"
        @sysvar::XCP::RadarFL::_g_PlReCoFw_PlReCoPer_ObjBypassingRunnable_ObjBypassingRunnable_m_pad_radarObjPort_par_out_local::TChangeableMemPool::_::_::_m_arrayPool::_0_::_elem::port_ens_r_obj_sensor_base::_::_m_movObjectInformation::_0_::STA_OBJECT_INFORMATION_ST::_::_m_ohyObjectType_st::_m_prob1NonObstacleN = 128;
        @sysvar::XCP::RadarFL::_g_PlReCoFw_PlReCoPer_ObjBypassingRunnable_ObjBypassingRunnable_m_pad_radarObjPort_par_out_local::TChangeableMemPool::_::_::_m_arrayPool::_0_::_elem::port_ens_r_obj_sensor_base::_::_m_movObjectInformation::_0_::STA_OBJECT_INFORMATION_ST::_::_m_ohyObjectType_st::_m_prob1ObstacleN = 0;
        @sysvar::XCP::RadarFL::_g_PlReCoFw_PlReCoPer_ObjBypassingRunnable_ObjBypassingRunnable_m_pad_radarObjPort_par_out_local::TChangeableMemPool::_::_::_m_arrayPool::_0_::_elem::port_ens_r_obj_sensor_base::_::_m_movObjectInformation::_0_::STA_OBJECT_INFORMATION_ST::_::_m_ohyObjectType_st::_m_prob1UnknownN = 0;
        @sysvar::XCP::RadarFL::_g_PlReCoFw_PlReCoPer_ObjBypassingRunnable_ObjBypassingRunnable_m_pad_radarObjPort_par_out_local::TChangeableMemPool::_::_::_m_arrayPool::_0_::_elem::port_ens_r_obj_sensor_base::_::_m_movObjectInformation::_0_::STA_OBJECT_INFORMATION_ST::_::_m_ohyObjectType_st::_m_probObstacle_st::_m_prob1UnknownN = 128;
        @sysvar::XCP::RadarFL::_g_PlReCoFw_PlReCoPer_ObjBypassingRunnable_ObjBypassingRunnable_m_pad_radarObjPort_par_out_local::TChangeableMemPool::_::_::_m_arrayPool::_0_::_elem::port_ens_r_obj_sensor_base::_::_m_movObjectInformation::_0_::STA_OBJECT_INFORMATION_ST::_::_m_ohyObjectType_st::_m_probObstacle_st::_m_probMobile_st::_m_prob1FourPlusWheelerN = 0;
        @sysvar::XCP::RadarFL::_g_PlReCoFw_PlReCoPer_ObjBypassingRunnable_ObjBypassingRunnable_m_pad_radarObjPort_par_out_local::TChangeableMemPool::_::_::_m_arrayPool::_0_::_elem::port_ens_r_obj_sensor_base::_::_m_movObjectInformation::_0_::STA_OBJECT_INFORMATION_ST::_::_m_ohyObjectType_st::_m_probObstacle_st::_m_probMobile_st::_m_prob1PedestrianN = 0;
        @sysvar::XCP::RadarFL::_g_PlReCoFw_PlReCoPer_ObjBypassingRunnable_ObjBypassingRunnable_m_pad_radarObjPort_par_out_local::TChangeableMemPool::_::_::_m_arrayPool::_0_::_elem::port_ens_r_obj_sensor_base::_::_m_movObjectInformation::_0_::STA_OBJECT_INFORMATION_ST::_::_m_ohyObjectType_st::_m_probObstacle_st::_m_probMobile_st::_m_prob1TwoWheelerN = 0;
        @sysvar::XCP::RadarFL::_g_PlReCoFw_PlReCoPer_ObjBypassingRunnable_ObjBypassingRunnable_m_pad_radarObjPort_par_out_local::TChangeableMemPool::_::_::_m_arrayPool::_0_::_elem::port_ens_r_obj_sensor_base::_::_m_movObjectInformation::_0_::STA_OBJECT_INFORMATION_ST::_::_m_ohyObjectType_st::_m_probObstacle_st::_m_probMobile_st::_m_prob1UnknownN = 128;
        @sysvar::XCP::RadarFL::_g_PlReCoFw_PlReCoPer_ObjBypassingRunnable_ObjBypassingRunnable_m_pad_radarObjPort_par_out_local::TChangeableMemPool::_::_::_m_arrayPool::_0_::_elem::port_ens_r_obj_sensor_base::_::_m_movObjectInformation::_0_::STA_OBJECT_INFORMATION_ST::_::_m_ohyObjectType_st::_m_probObstacle_st::_m_probMobile_st::_m_probFourPlusWheeler_st::_m_prob1PassengerCarN = 0;
        @sysvar::XCP::RadarFL::_g_PlReCoFw_PlReCoPer_ObjBypassingRunnable_ObjBypassingRunnable_m_pad_radarObjPort_par_out_local::TChangeableMemPool::_::_::_m_arrayPool::_0_::_elem::port_ens_r_obj_sensor_base::_::_m_movObjectInformation::_0_::STA_OBJECT_INFORMATION_ST::_::_m_ohyObjectType_st::_m_probObstacle_st::_m_probMobile_st::_m_probFourPlusWheeler_st::_m_prob1TruckN = 0;
        @sysvar::XCP::RadarFL::_g_PlReCoFw_PlReCoPer_ObjBypassingRunnable_ObjBypassingRunnable_m_pad_radarObjPort_par_out_local::TChangeableMemPool::_::_::_m_arrayPool::_0_::_elem::port_ens_r_obj_sensor_base::_::_m_movObjectInformation::_0_::STA_OBJECT_INFORMATION_ST::_::_m_ohyObjectType_st::_m_probObstacle_st::_m_probMobile_st::_m_probFourPlusWheeler_st::_m_prob1UnknownN = 128;
        @sysvar::XCP::RadarFL::_g_PlReCoFw_PlReCoPer_ObjBypassingRunnable_ObjBypassingRunnable_m_pad_radarObjPort_par_out_local::TChangeableMemPool::_::_::_m_arrayPool::_0_::_elem::port_ens_r_obj_sensor_base::_::_m_movObjectInformation::_0_::STA_OBJECT_INFORMATION_ST::_::_m_ohyObjectType_st::_m_probObstacle_st::_m_probStationary_st::_m_prob1RoadsideBarrierN = 0;
        @sysvar::XCP::RadarFL::_g_PlReCoFw_PlReCoPer_ObjBypassingRunnable_ObjBypassingRunnable_m_pad_radarObjPort_par_out_local::TChangeableMemPool::_::_::_m_arrayPool::_0_::_elem::port_ens_r_obj_sensor_base::_::_m_movObjectInformation::_0_::STA_OBJECT_INFORMATION_ST::_::_m_ohyObjectType_st::_m_probObstacle_st::_m_probStationary_st::_m_prob1UnknownN = 128;
        @sysvar::XCP::RadarFL::_g_PlReCoFw_PlReCoPer_ObjBypassingRunnable_ObjBypassingRunnable_m_pad_radarObjPort_par_out_local::TChangeableMemPool::_::_::_m_arrayPool::_0_::_elem::port_ens_r_obj_sensor_base::_::_m_movObjectInformation::_0_::_m_dLengthN = 64;
        @sysvar::XCP::RadarFL::_g_PlReCoFw_PlReCoPer_ObjBypassingRunnable_ObjBypassingRunnable_m_pad_radarObjPort_par_out_local::TChangeableMemPool::_::_::_m_arrayPool::_0_::_elem::port_ens_r_obj_sensor_base::_::_m_movObjectInformation::_0_::_m_dWidthN = @Classe_Obj_Sim::objdata.obj_width[0] * 128;
        break;

      case 1: //"unknown"
        @sysvar::XCP::RadarFL::_g_PlReCoFw_PlReCoPer_ObjBypassingRunnable_ObjBypassingRunnable_m_pad_radarObjPort_par_out_local::TChangeableMemPool::_::_::_m_arrayPool::_0_::_elem::port_ens_r_obj_sensor_base::_::_m_movObjectInformation::_0_::STA_OBJECT_INFORMATION_ST::_::_m_ohyObjectType_st::_m_prob1NonObstacleN = 0;
        @sysvar::XCP::RadarFL::_g_PlReCoFw_PlReCoPer_ObjBypassingRunnable_ObjBypassingRunnable_m_pad_radarObjPort_par_out_local::TChangeableMemPool::_::_::_m_arrayPool::_0_::_elem::port_ens_r_obj_sensor_base::_::_m_movObjectInformation::_0_::STA_OBJECT_INFORMATION_ST::_::_m_ohyObjectType_st::_m_prob1ObstacleN = 0;
        @sysvar::XCP::RadarFL::_g_PlReCoFw_PlReCoPer_ObjBypassingRunnable_ObjBypassingRunnable_m_pad_radarObjPort_par_out_local::TChangeableMemPool::_::_::_m_arrayPool::_0_::_elem::port_ens_r_obj_sensor_base::_::_m_movObjectInformation::_0_::STA_OBJECT_INFORMATION_ST::_::_m_ohyObjectType_st::_m_prob1UnknownN = 128;
        @sysvar::XCP::RadarFL::_g_PlReCoFw_PlReCoPer_ObjBypassingRunnable_ObjBypassingRunnable_m_pad_radarObjPort_par_out_local::TChangeableMemPool::_::_::_m_arrayPool::_0_::_elem::port_ens_r_obj_sensor_base::_::_m_movObjectInformation::_0_::STA_OBJECT_INFORMATION_ST::_::_m_ohyObjectType_st::_m_probObstacle_st::_m_prob1UnknownN = 128;
        @sysvar::XCP::RadarFL::_g_PlReCoFw_PlReCoPer_ObjBypassingRunnable_ObjBypassingRunnable_m_pad_radarObjPort_par_out_local::TChangeableMemPool::_::_::_m_arrayPool::_0_::_elem::port_ens_r_obj_sensor_base::_::_m_movObjectInformation::_0_::STA_OBJECT_INFORMATION_ST::_::_m_ohyObjectType_st::_m_probObstacle_st::_m_probMobile_st::_m_prob1FourPlusWheelerN = 0;
        @sysvar::XCP::RadarFL::_g_PlReCoFw_PlReCoPer_ObjBypassingRunnable_ObjBypassingRunnable_m_pad_radarObjPort_par_out_local::TChangeableMemPool::_::_::_m_arrayPool::_0_::_elem::port_ens_r_obj_sensor_base::_::_m_movObjectInformation::_0_::STA_OBJECT_INFORMATION_ST::_::_m_ohyObjectType_st::_m_probObstacle_st::_m_probMobile_st::_m_prob1PedestrianN = 0;
        @sysvar::XCP::RadarFL::_g_PlReCoFw_PlReCoPer_ObjBypassingRunnable_ObjBypassingRunnable_m_pad_radarObjPort_par_out_local::TChangeableMemPool::_::_::_m_arrayPool::_0_::_elem::port_ens_r_obj_sensor_base::_::_m_movObjectInformation::_0_::STA_OBJECT_INFORMATION_ST::_::_m_ohyObjectType_st::_m_probObstacle_st::_m_probMobile_st::_m_prob1TwoWheelerN = 0;
        @sysvar::XCP::RadarFL::_g_PlReCoFw_PlReCoPer_ObjBypassingRunnable_ObjBypassingRunnable_m_pad_radarObjPort_par_out_local::TChangeableMemPool::_::_::_m_arrayPool::_0_::_elem::port_ens_r_obj_sensor_base::_::_m_movObjectInformation::_0_::STA_OBJECT_INFORMATION_ST::_::_m_ohyObjectType_st::_m_probObstacle_st::_m_probMobile_st::_m_prob1UnknownN = 128;
        @sysvar::XCP::RadarFL::_g_PlReCoFw_PlReCoPer_ObjBypassingRunnable_ObjBypassingRunnable_m_pad_radarObjPort_par_out_local::TChangeableMemPool::_::_::_m_arrayPool::_0_::_elem::port_ens_r_obj_sensor_base::_::_m_movObjectInformation::_0_::STA_OBJECT_INFORMATION_ST::_::_m_ohyObjectType_st::_m_probObstacle_st::_m_probMobile_st::_m_probFourPlusWheeler_st::_m_prob1PassengerCarN = 0;
        @sysvar::XCP::RadarFL::_g_PlReCoFw_PlReCoPer_ObjBypassingRunnable_ObjBypassingRunnable_m_pad_radarObjPort_par_out_local::TChangeableMemPool::_::_::_m_arrayPool::_0_::_elem::port_ens_r_obj_sensor_base::_::_m_movObjectInformation::_0_::STA_OBJECT_INFORMATION_ST::_::_m_ohyObjectType_st::_m_probObstacle_st::_m_probMobile_st::_m_probFourPlusWheeler_st::_m_prob1TruckN = 0;
        @sysvar::XCP::RadarFL::_g_PlReCoFw_PlReCoPer_ObjBypassingRunnable_ObjBypassingRunnable_m_pad_radarObjPort_par_out_local::TChangeableMemPool::_::_::_m_arrayPool::_0_::_elem::port_ens_r_obj_sensor_base::_::_m_movObjectInformation::_0_::STA_OBJECT_INFORMATION_ST::_::_m_ohyObjectType_st::_m_probObstacle_st::_m_probMobile_st::_m_probFourPlusWheeler_st::_m_prob1UnknownN = 128;
        @sysvar::XCP::RadarFL::_g_PlReCoFw_PlReCoPer_ObjBypassingRunnable_ObjBypassingRunnable_m_pad_radarObjPort_par_out_local::TChangeableMemPool::_::_::_m_arrayPool::_0_::_elem::port_ens_r_obj_sensor_base::_::_m_movObjectInformation::_0_::STA_OBJECT_INFORMATION_ST::_::_m_ohyObjectType_st::_m_probObstacle_st::_m_probStationary_st::_m_prob1RoadsideBarrierN = 0;
        @sysvar::XCP::RadarFL::_g_PlReCoFw_PlReCoPer_ObjBypassingRunnable_ObjBypassingRunnable_m_pad_radarObjPort_par_out_local::TChangeableMemPool::_::_::_m_arrayPool::_0_::_elem::port_ens_r_obj_sensor_base::_::_m_movObjectInformation::_0_::STA_OBJECT_INFORMATION_ST::_::_m_ohyObjectType_st::_m_probObstacle_st::_m_probStationary_st::_m_prob1UnknownN = 128;
        @sysvar::XCP::RadarFL::_g_PlReCoFw_PlReCoPer_ObjBypassingRunnable_ObjBypassingRunnable_m_pad_radarObjPort_par_out_local::TChangeableMemPool::_::_::_m_arrayPool::_0_::_elem::port_ens_r_obj_sensor_base::_::_m_movObjectInformation::_0_::_m_dLengthN = 0;
        @sysvar::XCP::RadarFL::_g_PlReCoFw_PlReCoPer_ObjBypassingRunnable_ObjBypassingRunnable_m_pad_radarObjPort_par_out_local::TChangeableMemPool::_::_::_m_arrayPool::_0_::_elem::port_ens_r_obj_sensor_base::_::_m_movObjectInformation::_0_::_m_dWidthN = @Classe_Obj_Sim::objdata.obj_width[0] * 128;
        break;

      case 2: //"RoadSideBarrier"
        @sysvar::XCP::RadarFL::_g_PlReCoFw_PlReCoPer_ObjBypassingRunnable_ObjBypassingRunnable_m_pad_radarObjPort_par_out_local::TChangeableMemPool::_::_::_m_arrayPool::_0_::_elem::port_ens_r_obj_sensor_base::_::_m_movObjectInformation::_0_::STA_OBJECT_INFORMATION_ST::_::_m_ohyObjectType_st::_m_prob1NonObstacleN = 0;
        @sysvar::XCP::RadarFL::_g_PlReCoFw_PlReCoPer_ObjBypassingRunnable_ObjBypassingRunnable_m_pad_radarObjPort_par_out_local::TChangeableMemPool::_::_::_m_arrayPool::_0_::_elem::port_ens_r_obj_sensor_base::_::_m_movObjectInformation::_0_::STA_OBJECT_INFORMATION_ST::_::_m_ohyObjectType_st::_m_prob1ObstacleN = 128;
        @sysvar::XCP::RadarFL::_g_PlReCoFw_PlReCoPer_ObjBypassingRunnable_ObjBypassingRunnable_m_pad_radarObjPort_par_out_local::TChangeableMemPool::_::_::_m_arrayPool::_0_::_elem::port_ens_r_obj_sensor_base::_::_m_movObjectInformation::_0_::STA_OBJECT_INFORMATION_ST::_::_m_ohyObjectType_st::_m_prob1UnknownN = 0;
        @sysvar::XCP::RadarFL::_g_PlReCoFw_PlReCoPer_ObjBypassingRunnable_ObjBypassingRunnable_m_pad_radarObjPort_par_out_local::TChangeableMemPool::_::_::_m_arrayPool::_0_::_elem::port_ens_r_obj_sensor_base::_::_m_movObjectInformation::_0_::STA_OBJECT_INFORMATION_ST::_::_m_ohyObjectType_st::_m_probObstacle_st::_m_prob1MobileN = 0;
        @sysvar::XCP::RadarFL::_g_PlReCoFw_PlReCoPer_ObjBypassingRunnable_ObjBypassingRunnable_m_pad_radarObjPort_par_out_local::TChangeableMemPool::_::_::_m_arrayPool::_0_::_elem::port_ens_r_obj_sensor_base::_::_m_movObjectInformation::_0_::STA_OBJECT_INFORMATION_ST::_::_m_ohyObjectType_st::_m_probObstacle_st::_m_prob1StationaryN = 128;
        @sysvar::XCP::RadarFL::_g_PlReCoFw_PlReCoPer_ObjBypassingRunnable_ObjBypassingRunnable_m_pad_radarObjPort_par_out_local::TChangeableMemPool::_::_::_m_arrayPool::_0_::_elem::port_ens_r_obj_sensor_base::_::_m_movObjectInformation::_0_::STA_OBJECT_INFORMATION_ST::_::_m_ohyObjectType_st::_m_probObstacle_st::_m_prob1UnknownN = 0;
        @sysvar::XCP::RadarFL::_g_PlReCoFw_PlReCoPer_ObjBypassingRunnable_ObjBypassingRunnable_m_pad_radarObjPort_par_out_local::TChangeableMemPool::_::_::_m_arrayPool::_0_::_elem::port_ens_r_obj_sensor_base::_::_m_movObjectInformation::_0_::STA_OBJECT_INFORMATION_ST::_::_m_ohyObjectType_st::_m_probObstacle_st::_m_probMobile_st::_m_prob1FourPlusWheelerN = 0;
        @sysvar::XCP::RadarFL::_g_PlReCoFw_PlReCoPer_ObjBypassingRunnable_ObjBypassingRunnable_m_pad_radarObjPort_par_out_local::TChangeableMemPool::_::_::_m_arrayPool::_0_::_elem::port_ens_r_obj_sensor_base::_::_m_movObjectInformation::_0_::STA_OBJECT_INFORMATION_ST::_::_m_ohyObjectType_st::_m_probObstacle_st::_m_probMobile_st::_m_prob1PedestrianN = 0;
        @sysvar::XCP::RadarFL::_g_PlReCoFw_PlReCoPer_ObjBypassingRunnable_ObjBypassingRunnable_m_pad_radarObjPort_par_out_local::TChangeableMemPool::_::_::_m_arrayPool::_0_::_elem::port_ens_r_obj_sensor_base::_::_m_movObjectInformation::_0_::STA_OBJECT_INFORMATION_ST::_::_m_ohyObjectType_st::_m_probObstacle_st::_m_probMobile_st::_m_prob1TwoWheelerN = 0;
        @sysvar::XCP::RadarFL::_g_PlReCoFw_PlReCoPer_ObjBypassingRunnable_ObjBypassingRunnable_m_pad_radarObjPort_par_out_local::TChangeableMemPool::_::_::_m_arrayPool::_0_::_elem::port_ens_r_obj_sensor_base::_::_m_movObjectInformation::_0_::STA_OBJECT_INFORMATION_ST::_::_m_ohyObjectType_st::_m_probObstacle_st::_m_probMobile_st::_m_prob1UnknownN = 0;
        @sysvar::XCP::RadarFL::_g_PlReCoFw_PlReCoPer_ObjBypassingRunnable_ObjBypassingRunnable_m_pad_radarObjPort_par_out_local::TChangeableMemPool::_::_::_m_arrayPool::_0_::_elem::port_ens_r_obj_sensor_base::_::_m_movObjectInformation::_0_::STA_OBJECT_INFORMATION_ST::_::_m_ohyObjectType_st::_m_probObstacle_st::_m_probMobile_st::_m_probFourPlusWheeler_st::_m_prob1PassengerCarN = 0;
        @sysvar::XCP::RadarFL::_g_PlReCoFw_PlReCoPer_ObjBypassingRunnable_ObjBypassingRunnable_m_pad_radarObjPort_par_out_local::TChangeableMemPool::_::_::_m_arrayPool::_0_::_elem::port_ens_r_obj_sensor_base::_::_m_movObjectInformation::_0_::STA_OBJECT_INFORMATION_ST::_::_m_ohyObjectType_st::_m_probObstacle_st::_m_probMobile_st::_m_probFourPlusWheeler_st::_m_prob1TruckN = 0;
        @sysvar::XCP::RadarFL::_g_PlReCoFw_PlReCoPer_ObjBypassingRunnable_ObjBypassingRunnable_m_pad_radarObjPort_par_out_local::TChangeableMemPool::_::_::_m_arrayPool::_0_::_elem::port_ens_r_obj_sensor_base::_::_m_movObjectInformation::_0_::STA_OBJECT_INFORMATION_ST::_::_m_ohyObjectType_st::_m_probObstacle_st::_m_probMobile_st::_m_probFourPlusWheeler_st::_m_prob1UnknownN = 0;
        @sysvar::XCP::RadarFL::_g_PlReCoFw_PlReCoPer_ObjBypassingRunnable_ObjBypassingRunnable_m_pad_radarObjPort_par_out_local::TChangeableMemPool::_::_::_m_arrayPool::_0_::_elem::port_ens_r_obj_sensor_base::_::_m_movObjectInformation::_0_::STA_OBJECT_INFORMATION_ST::_::_m_ohyObjectType_st::_m_probObstacle_st::_m_probStationary_st::_m_prob1RoadsideBarrierN = 128;
        @sysvar::XCP::RadarFL::_g_PlReCoFw_PlReCoPer_ObjBypassingRunnable_ObjBypassingRunnable_m_pad_radarObjPort_par_out_local::TChangeableMemPool::_::_::_m_arrayPool::_0_::_elem::port_ens_r_obj_sensor_base::_::_m_movObjectInformation::_0_::STA_OBJECT_INFORMATION_ST::_::_m_ohyObjectType_st::_m_probObstacle_st::_m_probStationary_st::_m_prob1UnknownN = 0;
        @sysvar::XCP::RadarFL::_g_PlReCoFw_PlReCoPer_ObjBypassingRunnable_ObjBypassingRunnable_m_pad_radarObjPort_par_out_local::TChangeableMemPool::_::_::_m_arrayPool::_0_::_elem::port_ens_r_obj_sensor_base::_::_m_movObjectInformation::_0_::_m_dLengthN = 64;
        @sysvar::XCP::RadarFL::_g_PlReCoFw_PlReCoPer_ObjBypassingRunnable_ObjBypassingRunnable_m_pad_radarObjPort_par_out_local::TChangeableMemPool::_::_::_m_arrayPool::_0_::_elem::port_ens_r_obj_sensor_base::_::_m_movObjectInformation::_0_::_m_dWidthN = @Classe_Obj_Sim::objdata.obj_width[0] * 128;
        break;

      case 3: //"2Wheeler"
        @sysvar::XCP::RadarFL::_g_PlReCoFw_PlReCoPer_ObjBypassingRunnable_ObjBypassingRunnable_m_pad_radarObjPort_par_out_local::TChangeableMemPool::_::_::_m_arrayPool::_0_::_elem::port_ens_r_obj_sensor_base::_::_m_movObjectInformation::_0_::STA_OBJECT_INFORMATION_ST::_::_m_ohyObjectType_st::_m_prob1NonObstacleN = 0;
        @sysvar::XCP::RadarFL::_g_PlReCoFw_PlReCoPer_ObjBypassingRunnable_ObjBypassingRunnable_m_pad_radarObjPort_par_out_local::TChangeableMemPool::_::_::_m_arrayPool::_0_::_elem::port_ens_r_obj_sensor_base::_::_m_movObjectInformation::_0_::STA_OBJECT_INFORMATION_ST::_::_m_ohyObjectType_st::_m_prob1ObstacleN = 128;
        @sysvar::XCP::RadarFL::_g_PlReCoFw_PlReCoPer_ObjBypassingRunnable_ObjBypassingRunnable_m_pad_radarObjPort_par_out_local::TChangeableMemPool::_::_::_m_arrayPool::_0_::_elem::port_ens_r_obj_sensor_base::_::_m_movObjectInformation::_0_::STA_OBJECT_INFORMATION_ST::_::_m_ohyObjectType_st::_m_prob1UnknownN = 0;
        @sysvar::XCP::RadarFL::_g_PlReCoFw_PlReCoPer_ObjBypassingRunnable_ObjBypassingRunnable_m_pad_radarObjPort_par_out_local::TChangeableMemPool::_::_::_m_arrayPool::_0_::_elem::port_ens_r_obj_sensor_base::_::_m_movObjectInformation::_0_::STA_OBJECT_INFORMATION_ST::_::_m_ohyObjectType_st::_m_probObstacle_st::_m_prob1UnknownN = 0;
        @sysvar::XCP::RadarFL::_g_PlReCoFw_PlReCoPer_ObjBypassingRunnable_ObjBypassingRunnable_m_pad_radarObjPort_par_out_local::TChangeableMemPool::_::_::_m_arrayPool::_0_::_elem::port_ens_r_obj_sensor_base::_::_m_movObjectInformation::_0_::STA_OBJECT_INFORMATION_ST::_::_m_ohyObjectType_st::_m_probObstacle_st::_m_probMobile_st::_m_prob1FourPlusWheelerN = 0;
        @sysvar::XCP::RadarFL::_g_PlReCoFw_PlReCoPer_ObjBypassingRunnable_ObjBypassingRunnable_m_pad_radarObjPort_par_out_local::TChangeableMemPool::_::_::_m_arrayPool::_0_::_elem::port_ens_r_obj_sensor_base::_::_m_movObjectInformation::_0_::STA_OBJECT_INFORMATION_ST::_::_m_ohyObjectType_st::_m_probObstacle_st::_m_probMobile_st::_m_prob1PedestrianN = 0;
        @sysvar::XCP::RadarFL::_g_PlReCoFw_PlReCoPer_ObjBypassingRunnable_ObjBypassingRunnable_m_pad_radarObjPort_par_out_local::TChangeableMemPool::_::_::_m_arrayPool::_0_::_elem::port_ens_r_obj_sensor_base::_::_m_movObjectInformation::_0_::STA_OBJECT_INFORMATION_ST::_::_m_ohyObjectType_st::_m_probObstacle_st::_m_probMobile_st::_m_prob1TwoWheelerN = 128;
        @sysvar::XCP::RadarFL::_g_PlReCoFw_PlReCoPer_ObjBypassingRunnable_ObjBypassingRunnable_m_pad_radarObjPort_par_out_local::TChangeableMemPool::_::_::_m_arrayPool::_0_::_elem::port_ens_r_obj_sensor_base::_::_m_movObjectInformation::_0_::STA_OBJECT_INFORMATION_ST::_::_m_ohyObjectType_st::_m_probObstacle_st::_m_probMobile_st::_m_prob1UnknownN = 0;
        @sysvar::XCP::RadarFL::_g_PlReCoFw_PlReCoPer_ObjBypassingRunnable_ObjBypassingRunnable_m_pad_radarObjPort_par_out_local::TChangeableMemPool::_::_::_m_arrayPool::_0_::_elem::port_ens_r_obj_sensor_base::_::_m_movObjectInformation::_0_::STA_OBJECT_INFORMATION_ST::_::_m_ohyObjectType_st::_m_probObstacle_st::_m_probMobile_st::_m_probFourPlusWheeler_st::_m_prob1PassengerCarN = 0;
        @sysvar::XCP::RadarFL::_g_PlReCoFw_PlReCoPer_ObjBypassingRunnable_ObjBypassingRunnable_m_pad_radarObjPort_par_out_local::TChangeableMemPool::_::_::_m_arrayPool::_0_::_elem::port_ens_r_obj_sensor_base::_::_m_movObjectInformation::_0_::STA_OBJECT_INFORMATION_ST::_::_m_ohyObjectType_st::_m_probObstacle_st::_m_probMobile_st::_m_probFourPlusWheeler_st::_m_prob1TruckN = 0;
        @sysvar::XCP::RadarFL::_g_PlReCoFw_PlReCoPer_ObjBypassingRunnable_ObjBypassingRunnable_m_pad_radarObjPort_par_out_local::TChangeableMemPool::_::_::_m_arrayPool::_0_::_elem::port_ens_r_obj_sensor_base::_::_m_movObjectInformation::_0_::STA_OBJECT_INFORMATION_ST::_::_m_ohyObjectType_st::_m_probObstacle_st::_m_probMobile_st::_m_probFourPlusWheeler_st::_m_prob1UnknownN = 128;
        @sysvar::XCP::RadarFL::_g_PlReCoFw_PlReCoPer_ObjBypassingRunnable_ObjBypassingRunnable_m_pad_radarObjPort_par_out_local::TChangeableMemPool::_::_::_m_arrayPool::_0_::_elem::port_ens_r_obj_sensor_base::_::_m_movObjectInformation::_0_::STA_OBJECT_INFORMATION_ST::_::_m_ohyObjectType_st::_m_probObstacle_st::_m_probStationary_st::_m_prob1RoadsideBarrierN = 0;
        @sysvar::XCP::RadarFL::_g_PlReCoFw_PlReCoPer_ObjBypassingRunnable_ObjBypassingRunnable_m_pad_radarObjPort_par_out_local::TChangeableMemPool::_::_::_m_arrayPool::_0_::_elem::port_ens_r_obj_sensor_base::_::_m_movObjectInformation::_0_::STA_OBJECT_INFORMATION_ST::_::_m_ohyObjectType_st::_m_probObstacle_st::_m_probStationary_st::_m_prob1UnknownN = 0;
        @sysvar::XCP::RadarFL::_g_PlReCoFw_PlReCoPer_ObjBypassingRunnable_ObjBypassingRunnable_m_pad_radarObjPort_par_out_local::TChangeableMemPool::_::_::_m_arrayPool::_0_::_elem::port_ens_r_obj_sensor_base::_::_m_movObjectInformation::_0_::_m_dLengthN = 64;
        @sysvar::XCP::RadarFL::_g_PlReCoFw_PlReCoPer_ObjBypassingRunnable_ObjBypassingRunnable_m_pad_radarObjPort_par_out_local::TChangeableMemPool::_::_::_m_arrayPool::_0_::_elem::port_ens_r_obj_sensor_base::_::_m_movObjectInformation::_0_::_m_dWidthN = @Classe_Obj_Sim::objdata.obj_width[0] * 128;
        break;

      case 4: //"Pedestrian"
        @sysvar::XCP::RadarFL::_g_PlReCoFw_PlReCoPer_ObjBypassingRunnable_ObjBypassingRunnable_m_pad_radarObjPort_par_out_local::TChangeableMemPool::_::_::_m_arrayPool::_0_::_elem::port_ens_r_obj_sensor_base::_::_m_movObjectInformation::_0_::STA_OBJECT_INFORMATION_ST::_::_m_ohyObjectType_st::_m_prob1NonObstacleN = 0;
        @sysvar::XCP::RadarFL::_g_PlReCoFw_PlReCoPer_ObjBypassingRunnable_ObjBypassingRunnable_m_pad_radarObjPort_par_out_local::TChangeableMemPool::_::_::_m_arrayPool::_0_::_elem::port_ens_r_obj_sensor_base::_::_m_movObjectInformation::_0_::STA_OBJECT_INFORMATION_ST::_::_m_ohyObjectType_st::_m_prob1ObstacleN = 128;
        @sysvar::XCP::RadarFL::_g_PlReCoFw_PlReCoPer_ObjBypassingRunnable_ObjBypassingRunnable_m_pad_radarObjPort_par_out_local::TChangeableMemPool::_::_::_m_arrayPool::_0_::_elem::port_ens_r_obj_sensor_base::_::_m_movObjectInformation::_0_::STA_OBJECT_INFORMATION_ST::_::_m_ohyObjectType_st::_m_prob1UnknownN = 0;
        @sysvar::XCP::RadarFL::_g_PlReCoFw_PlReCoPer_ObjBypassingRunnable_ObjBypassingRunnable_m_pad_radarObjPort_par_out_local::TChangeableMemPool::_::_::_m_arrayPool::_0_::_elem::port_ens_r_obj_sensor_base::_::_m_movObjectInformation::_0_::STA_OBJECT_INFORMATION_ST::_::_m_ohyObjectType_st::_m_probObstacle_st::_m_prob1UnknownN = 0;
        @sysvar::XCP::RadarFL::_g_PlReCoFw_PlReCoPer_ObjBypassingRunnable_ObjBypassingRunnable_m_pad_radarObjPort_par_out_local::TChangeableMemPool::_::_::_m_arrayPool::_0_::_elem::port_ens_r_obj_sensor_base::_::_m_movObjectInformation::_0_::STA_OBJECT_INFORMATION_ST::_::_m_ohyObjectType_st::_m_probObstacle_st::_m_probMobile_st::_m_prob1FourPlusWheelerN = 0;
        @sysvar::XCP::RadarFL::_g_PlReCoFw_PlReCoPer_ObjBypassingRunnable_ObjBypassingRunnable_m_pad_radarObjPort_par_out_local::TChangeableMemPool::_::_::_m_arrayPool::_0_::_elem::port_ens_r_obj_sensor_base::_::_m_movObjectInformation::_0_::STA_OBJECT_INFORMATION_ST::_::_m_ohyObjectType_st::_m_probObstacle_st::_m_probMobile_st::_m_prob1PedestrianN = 128;
        @sysvar::XCP::RadarFL::_g_PlReCoFw_PlReCoPer_ObjBypassingRunnable_ObjBypassingRunnable_m_pad_radarObjPort_par_out_local::TChangeableMemPool::_::_::_m_arrayPool::_0_::_elem::port_ens_r_obj_sensor_base::_::_m_movObjectInformation::_0_::STA_OBJECT_INFORMATION_ST::_::_m_ohyObjectType_st::_m_probObstacle_st::_m_probMobile_st::_m_prob1TwoWheelerN = 0;
        @sysvar::XCP::RadarFL::_g_PlReCoFw_PlReCoPer_ObjBypassingRunnable_ObjBypassingRunnable_m_pad_radarObjPort_par_out_local::TChangeableMemPool::_::_::_m_arrayPool::_0_::_elem::port_ens_r_obj_sensor_base::_::_m_movObjectInformation::_0_::STA_OBJECT_INFORMATION_ST::_::_m_ohyObjectType_st::_m_probObstacle_st::_m_probMobile_st::_m_prob1UnknownN = 0;
        @sysvar::XCP::RadarFL::_g_PlReCoFw_PlReCoPer_ObjBypassingRunnable_ObjBypassingRunnable_m_pad_radarObjPort_par_out_local::TChangeableMemPool::_::_::_m_arrayPool::_0_::_elem::port_ens_r_obj_sensor_base::_::_m_movObjectInformation::_0_::STA_OBJECT_INFORMATION_ST::_::_m_ohyObjectType_st::_m_probObstacle_st::_m_probMobile_st::_m_probFourPlusWheeler_st::_m_prob1PassengerCarN = 0;
        @sysvar::XCP::RadarFL::_g_PlReCoFw_PlReCoPer_ObjBypassingRunnable_ObjBypassingRunnable_m_pad_radarObjPort_par_out_local::TChangeableMemPool::_::_::_m_arrayPool::_0_::_elem::port_ens_r_obj_sensor_base::_::_m_movObjectInformation::_0_::STA_OBJECT_INFORMATION_ST::_::_m_ohyObjectType_st::_m_probObstacle_st::_m_probMobile_st::_m_probFourPlusWheeler_st::_m_prob1TruckN = 0;
        @sysvar::XCP::RadarFL::_g_PlReCoFw_PlReCoPer_ObjBypassingRunnable_ObjBypassingRunnable_m_pad_radarObjPort_par_out_local::TChangeableMemPool::_::_::_m_arrayPool::_0_::_elem::port_ens_r_obj_sensor_base::_::_m_movObjectInformation::_0_::STA_OBJECT_INFORMATION_ST::_::_m_ohyObjectType_st::_m_probObstacle_st::_m_probMobile_st::_m_probFourPlusWheeler_st::_m_prob1UnknownN = 128;
        @sysvar::XCP::RadarFL::_g_PlReCoFw_PlReCoPer_ObjBypassingRunnable_ObjBypassingRunnable_m_pad_radarObjPort_par_out_local::TChangeableMemPool::_::_::_m_arrayPool::_0_::_elem::port_ens_r_obj_sensor_base::_::_m_movObjectInformation::_0_::STA_OBJECT_INFORMATION_ST::_::_m_ohyObjectType_st::_m_probObstacle_st::_m_probStationary_st::_m_prob1RoadsideBarrierN = 0;
        @sysvar::XCP::RadarFL::_g_PlReCoFw_PlReCoPer_ObjBypassingRunnable_ObjBypassingRunnable_m_pad_radarObjPort_par_out_local::TChangeableMemPool::_::_::_m_arrayPool::_0_::_elem::port_ens_r_obj_sensor_base::_::_m_movObjectInformation::_0_::STA_OBJECT_INFORMATION_ST::_::_m_ohyObjectType_st::_m_probObstacle_st::_m_probStationary_st::_m_prob1UnknownN = 0;
        @sysvar::XCP::RadarFL::_g_PlReCoFw_PlReCoPer_ObjBypassingRunnable_ObjBypassingRunnable_m_pad_radarObjPort_par_out_local::TChangeableMemPool::_::_::_m_arrayPool::_0_::_elem::port_ens_r_obj_sensor_base::_::_m_movObjectInformation::_0_::_m_dLengthN = 64;
        @sysvar::XCP::RadarFL::_g_PlReCoFw_PlReCoPer_ObjBypassingRunnable_ObjBypassingRunnable_m_pad_radarObjPort_par_out_local::TChangeableMemPool::_::_::_m_arrayPool::_0_::_elem::port_ens_r_obj_sensor_base::_::_m_movObjectInformation::_0_::_m_dWidthN = @Classe_Obj_Sim::objdata.obj_width[0] * 128;
        break;

      case 5: //"Truck"
        @sysvar::XCP::RadarFL::_g_PlReCoFw_PlReCoPer_ObjBypassingRunnable_ObjBypassingRunnable_m_pad_radarObjPort_par_out_local::TChangeableMemPool::_::_::_m_arrayPool::_0_::_elem::port_ens_r_obj_sensor_base::_::_m_movObjectInformation::_0_::STA_OBJECT_INFORMATION_ST::_::_m_ohyObjectType_st::_m_prob1NonObstacleN = 0;
        @sysvar::XCP::RadarFL::_g_PlReCoFw_PlReCoPer_ObjBypassingRunnable_ObjBypassingRunnable_m_pad_radarObjPort_par_out_local::TChangeableMemPool::_::_::_m_arrayPool::_0_::_elem::port_ens_r_obj_sensor_base::_::_m_movObjectInformation::_0_::STA_OBJECT_INFORMATION_ST::_::_m_ohyObjectType_st::_m_prob1ObstacleN = 128;
        @sysvar::XCP::RadarFL::_g_PlReCoFw_PlReCoPer_ObjBypassingRunnable_ObjBypassingRunnable_m_pad_radarObjPort_par_out_local::TChangeableMemPool::_::_::_m_arrayPool::_0_::_elem::port_ens_r_obj_sensor_base::_::_m_movObjectInformation::_0_::STA_OBJECT_INFORMATION_ST::_::_m_ohyObjectType_st::_m_prob1UnknownN = 0;
        @sysvar::XCP::RadarFL::_g_PlReCoFw_PlReCoPer_ObjBypassingRunnable_ObjBypassingRunnable_m_pad_radarObjPort_par_out_local::TChangeableMemPool::_::_::_m_arrayPool::_0_::_elem::port_ens_r_obj_sensor_base::_::_m_movObjectInformation::_0_::STA_OBJECT_INFORMATION_ST::_::_m_ohyObjectType_st::_m_probObstacle_st::_m_prob1UnknownN = 0;
        @sysvar::XCP::RadarFL::_g_PlReCoFw_PlReCoPer_ObjBypassingRunnable_ObjBypassingRunnable_m_pad_radarObjPort_par_out_local::TChangeableMemPool::_::_::_m_arrayPool::_0_::_elem::port_ens_r_obj_sensor_base::_::_m_movObjectInformation::_0_::STA_OBJECT_INFORMATION_ST::_::_m_ohyObjectType_st::_m_probObstacle_st::_m_probMobile_st::_m_prob1FourPlusWheelerN = 128;
        @sysvar::XCP::RadarFL::_g_PlReCoFw_PlReCoPer_ObjBypassingRunnable_ObjBypassingRunnable_m_pad_radarObjPort_par_out_local::TChangeableMemPool::_::_::_m_arrayPool::_0_::_elem::port_ens_r_obj_sensor_base::_::_m_movObjectInformation::_0_::STA_OBJECT_INFORMATION_ST::_::_m_ohyObjectType_st::_m_probObstacle_st::_m_probMobile_st::_m_prob1PedestrianN = 0;
        @sysvar::XCP::RadarFL::_g_PlReCoFw_PlReCoPer_ObjBypassingRunnable_ObjBypassingRunnable_m_pad_radarObjPort_par_out_local::TChangeableMemPool::_::_::_m_arrayPool::_0_::_elem::port_ens_r_obj_sensor_base::_::_m_movObjectInformation::_0_::STA_OBJECT_INFORMATION_ST::_::_m_ohyObjectType_st::_m_probObstacle_st::_m_probMobile_st::_m_prob1TwoWheelerN = 0;
        @sysvar::XCP::RadarFL::_g_PlReCoFw_PlReCoPer_ObjBypassingRunnable_ObjBypassingRunnable_m_pad_radarObjPort_par_out_local::TChangeableMemPool::_::_::_m_arrayPool::_0_::_elem::port_ens_r_obj_sensor_base::_::_m_movObjectInformation::_0_::STA_OBJECT_INFORMATION_ST::_::_m_ohyObjectType_st::_m_probObstacle_st::_m_probMobile_st::_m_prob1UnknownN = 0;
        @sysvar::XCP::RadarFL::_g_PlReCoFw_PlReCoPer_ObjBypassingRunnable_ObjBypassingRunnable_m_pad_radarObjPort_par_out_local::TChangeableMemPool::_::_::_m_arrayPool::_0_::_elem::port_ens_r_obj_sensor_base::_::_m_movObjectInformation::_0_::STA_OBJECT_INFORMATION_ST::_::_m_ohyObjectType_st::_m_probObstacle_st::_m_probMobile_st::_m_probFourPlusWheeler_st::_m_prob1PassengerCarN = 0;
        @sysvar::XCP::RadarFL::_g_PlReCoFw_PlReCoPer_ObjBypassingRunnable_ObjBypassingRunnable_m_pad_radarObjPort_par_out_local::TChangeableMemPool::_::_::_m_arrayPool::_0_::_elem::port_ens_r_obj_sensor_base::_::_m_movObjectInformation::_0_::STA_OBJECT_INFORMATION_ST::_::_m_ohyObjectType_st::_m_probObstacle_st::_m_probMobile_st::_m_probFourPlusWheeler_st::_m_prob1TruckN = 128;
        @sysvar::XCP::RadarFL::_g_PlReCoFw_PlReCoPer_ObjBypassingRunnable_ObjBypassingRunnable_m_pad_radarObjPort_par_out_local::TChangeableMemPool::_::_::_m_arrayPool::_0_::_elem::port_ens_r_obj_sensor_base::_::_m_movObjectInformation::_0_::STA_OBJECT_INFORMATION_ST::_::_m_ohyObjectType_st::_m_probObstacle_st::_m_probMobile_st::_m_probFourPlusWheeler_st::_m_prob1UnknownN = 0;
        @sysvar::XCP::RadarFL::_g_PlReCoFw_PlReCoPer_ObjBypassingRunnable_ObjBypassingRunnable_m_pad_radarObjPort_par_out_local::TChangeableMemPool::_::_::_m_arrayPool::_0_::_elem::port_ens_r_obj_sensor_base::_::_m_movObjectInformation::_0_::STA_OBJECT_INFORMATION_ST::_::_m_ohyObjectType_st::_m_probObstacle_st::_m_probStationary_st::_m_prob1RoadsideBarrierN = 0;
        @sysvar::XCP::RadarFL::_g_PlReCoFw_PlReCoPer_ObjBypassingRunnable_ObjBypassingRunnable_m_pad_radarObjPort_par_out_local::TChangeableMemPool::_::_::_m_arrayPool::_0_::_elem::port_ens_r_obj_sensor_base::_::_m_movObjectInformation::_0_::STA_OBJECT_INFORMATION_ST::_::_m_ohyObjectType_st::_m_probObstacle_st::_m_probStationary_st::_m_prob1UnknownN = 0;
        @sysvar::XCP::RadarFL::_g_PlReCoFw_PlReCoPer_ObjBypassingRunnable_ObjBypassingRunnable_m_pad_radarObjPort_par_out_local::TChangeableMemPool::_::_::_m_arrayPool::_0_::_elem::port_ens_r_obj_sensor_base::_::_m_movObjectInformation::_0_::_m_dLengthN = 64;
        @sysvar::XCP::RadarFL::_g_PlReCoFw_PlReCoPer_ObjBypassingRunnable_ObjBypassingRunnable_m_pad_radarObjPort_par_out_local::TChangeableMemPool::_::_::_m_arrayPool::_0_::_elem::port_ens_r_obj_sensor_base::_::_m_movObjectInformation::_0_::_m_dWidthN = @Classe_Obj_Sim::objdata.obj_width[0] * 128;
        break;

      case 6: //"PassengerCar"
        @sysvar::XCP::RadarFL::_g_PlReCoFw_PlReCoPer_ObjBypassingRunnable_ObjBypassingRunnable_m_pad_radarObjPort_par_out_local::TChangeableMemPool::_::_::_m_arrayPool::_0_::_elem::port_ens_r_obj_sensor_base::_::_m_movObjectInformation::_0_::STA_OBJECT_INFORMATION_ST::_::_m_ohyObjectType_st::_m_prob1NonObstacleN = 0;
        @sysvar::XCP::RadarFL::_g_PlReCoFw_PlReCoPer_ObjBypassingRunnable_ObjBypassingRunnable_m_pad_radarObjPort_par_out_local::TChangeableMemPool::_::_::_m_arrayPool::_0_::_elem::port_ens_r_obj_sensor_base::_::_m_movObjectInformation::_0_::STA_OBJECT_INFORMATION_ST::_::_m_ohyObjectType_st::_m_prob1ObstacleN = 128;
        @sysvar::XCP::RadarFL::_g_PlReCoFw_PlReCoPer_ObjBypassingRunnable_ObjBypassingRunnable_m_pad_radarObjPort_par_out_local::TChangeableMemPool::_::_::_m_arrayPool::_0_::_elem::port_ens_r_obj_sensor_base::_::_m_movObjectInformation::_0_::STA_OBJECT_INFORMATION_ST::_::_m_ohyObjectType_st::_m_prob1UnknownN = 0;
        @sysvar::XCP::RadarFL::_g_PlReCoFw_PlReCoPer_ObjBypassingRunnable_ObjBypassingRunnable_m_pad_radarObjPort_par_out_local::TChangeableMemPool::_::_::_m_arrayPool::_0_::_elem::port_ens_r_obj_sensor_base::_::_m_movObjectInformation::_0_::STA_OBJECT_INFORMATION_ST::_::_m_ohyObjectType_st::_m_probObstacle_st::_m_prob1UnknownN = 0;
        @sysvar::XCP::RadarFL::_g_PlReCoFw_PlReCoPer_ObjBypassingRunnable_ObjBypassingRunnable_m_pad_radarObjPort_par_out_local::TChangeableMemPool::_::_::_m_arrayPool::_0_::_elem::port_ens_r_obj_sensor_base::_::_m_movObjectInformation::_0_::STA_OBJECT_INFORMATION_ST::_::_m_ohyObjectType_st::_m_probObstacle_st::_m_probMobile_st::_m_prob1FourPlusWheelerN = 128;
        @sysvar::XCP::RadarFL::_g_PlReCoFw_PlReCoPer_ObjBypassingRunnable_ObjBypassingRunnable_m_pad_radarObjPort_par_out_local::TChangeableMemPool::_::_::_m_arrayPool::_0_::_elem::port_ens_r_obj_sensor_base::_::_m_movObjectInformation::_0_::STA_OBJECT_INFORMATION_ST::_::_m_ohyObjectType_st::_m_probObstacle_st::_m_probMobile_st::_m_prob1PedestrianN = 0;
        @sysvar::XCP::RadarFL::_g_PlReCoFw_PlReCoPer_ObjBypassingRunnable_ObjBypassingRunnable_m_pad_radarObjPort_par_out_local::TChangeableMemPool::_::_::_m_arrayPool::_0_::_elem::port_ens_r_obj_sensor_base::_::_m_movObjectInformation::_0_::STA_OBJECT_INFORMATION_ST::_::_m_ohyObjectType_st::_m_probObstacle_st::_m_probMobile_st::_m_prob1TwoWheelerN = 0;
        @sysvar::XCP::RadarFL::_g_PlReCoFw_PlReCoPer_ObjBypassingRunnable_ObjBypassingRunnable_m_pad_radarObjPort_par_out_local::TChangeableMemPool::_::_::_m_arrayPool::_0_::_elem::port_ens_r_obj_sensor_base::_::_m_movObjectInformation::_0_::STA_OBJECT_INFORMATION_ST::_::_m_ohyObjectType_st::_m_probObstacle_st::_m_probMobile_st::_m_prob1UnknownN = 0;
        @sysvar::XCP::RadarFL::_g_PlReCoFw_PlReCoPer_ObjBypassingRunnable_ObjBypassingRunnable_m_pad_radarObjPort_par_out_local::TChangeableMemPool::_::_::_m_arrayPool::_0_::_elem::port_ens_r_obj_sensor_base::_::_m_movObjectInformation::_0_::STA_OBJECT_INFORMATION_ST::_::_m_ohyObjectType_st::_m_probObstacle_st::_m_probMobile_st::_m_probFourPlusWheeler_st::_m_prob1PassengerCarN = 128;
        @sysvar::XCP::RadarFL::_g_PlReCoFw_PlReCoPer_ObjBypassingRunnable_ObjBypassingRunnable_m_pad_radarObjPort_par_out_local::TChangeableMemPool::_::_::_m_arrayPool::_0_::_elem::port_ens_r_obj_sensor_base::_::_m_movObjectInformation::_0_::STA_OBJECT_INFORMATION_ST::_::_m_ohyObjectType_st::_m_probObstacle_st::_m_probMobile_st::_m_probFourPlusWheeler_st::_m_prob1TruckN = 0;
        @sysvar::XCP::RadarFL::_g_PlReCoFw_PlReCoPer_ObjBypassingRunnable_ObjBypassingRunnable_m_pad_radarObjPort_par_out_local::TChangeableMemPool::_::_::_m_arrayPool::_0_::_elem::port_ens_r_obj_sensor_base::_::_m_movObjectInformation::_0_::STA_OBJECT_INFORMATION_ST::_::_m_ohyObjectType_st::_m_probObstacle_st::_m_probMobile_st::_m_probFourPlusWheeler_st::_m_prob1UnknownN = 0;
        @sysvar::XCP::RadarFL::_g_PlReCoFw_PlReCoPer_ObjBypassingRunnable_ObjBypassingRunnable_m_pad_radarObjPort_par_out_local::TChangeableMemPool::_::_::_m_arrayPool::_0_::_elem::port_ens_r_obj_sensor_base::_::_m_movObjectInformation::_0_::STA_OBJECT_INFORMATION_ST::_::_m_ohyObjectType_st::_m_probObstacle_st::_m_probStationary_st::_m_prob1RoadsideBarrierN = 0;
        @sysvar::XCP::RadarFL::_g_PlReCoFw_PlReCoPer_ObjBypassingRunnable_ObjBypassingRunnable_m_pad_radarObjPort_par_out_local::TChangeableMemPool::_::_::_m_arrayPool::_0_::_elem::port_ens_r_obj_sensor_base::_::_m_movObjectInformation::_0_::STA_OBJECT_INFORMATION_ST::_::_m_ohyObjectType_st::_m_probObstacle_st::_m_probStationary_st::_m_prob1UnknownN = 0;
        @sysvar::XCP::RadarFL::_g_PlReCoFw_PlReCoPer_ObjBypassingRunnable_ObjBypassingRunnable_m_pad_radarObjPort_par_out_local::TChangeableMemPool::_::_::_m_arrayPool::_0_::_elem::port_ens_r_obj_sensor_base::_::_m_movObjectInformation::_0_::_m_dLengthN = 64;
        @sysvar::XCP::RadarFL::_g_PlReCoFw_PlReCoPer_ObjBypassingRunnable_ObjBypassingRunnable_m_pad_radarObjPort_par_out_local::TChangeableMemPool::_::_::_m_arrayPool::_0_::_elem::port_ens_r_obj_sensor_base::_::_m_movObjectInformation::_0_::_m_dWidthN = @Classe_Obj_Sim::objdata.obj_width[0] * 128;
        break;
   }
  break;
//
//    case 1: //"Object-1"
//    //constant
//    @sysvar::XCP::RadarFL::_g_PlReCoFw_PlReCoPer_ObjBypassingRunnable_ObjBypassingRunnable_m_pad_radarObjPort_par_out_local::TChangeableMemPool::_::_::_m_arrayPool::_0_::_elem::port_ens_r_obj_sensor_base::_::_m_movObjectInformation::_1_::STA_OBJECT_INFORMATION_ST::_::_Meas_b = 1;
//    @sysvar::XCP::RadarFL::_g_PlReCoFw_PlReCoPer_ObjBypassingRunnable_ObjBypassingRunnable_m_pad_radarObjPort_par_out_local::TChangeableMemPool::_::_::_m_arrayPool::_0_::_elem::port_ens_r_obj_sensor_base::_::_m_movObjectInformation::_1_::STA_OBJECT_INFORMATION_ST::_::_Measurable_b = 1;
//    @sysvar::XCP::RadarFL::_g_PlReCoFw_PlReCoPer_ObjBypassingRunnable_ObjBypassingRunnable_m_pad_radarObjPort_par_out_local::TChangeableMemPool::_::_::_m_arrayPool::_0_::_elem::port_ens_r_obj_sensor_base::_::_m_movObjectInformation::_1_::STA_OBJECT_INFORMATION_ST::_::_Valid_b = 1;
//    @sysvar::XCP::RadarFL::_g_PlReCoFw_PlReCoPer_ObjBypassingRunnable_ObjBypassingRunnable_m_pad_radarObjPort_par_out_local::TChangeableMemPool::_::_::_m_arrayPool::_0_::_elem::port_ens_r_obj_sensor_base::_::_m_movObjectInformation::_1_::_m_covarDxAxN = 0;
//    @sysvar::XCP::RadarFL::_g_PlReCoFw_PlReCoPer_ObjBypassingRunnable_ObjBypassingRunnable_m_pad_radarObjPort_par_out_local::TChangeableMemPool::_::_::_m_arrayPool::_0_::_elem::port_ens_r_obj_sensor_base::_::_m_movObjectInformation::_1_::_m_covarDxVxN = 0;
//    @sysvar::XCP::RadarFL::_g_PlReCoFw_PlReCoPer_ObjBypassingRunnable_ObjBypassingRunnable_m_pad_radarObjPort_par_out_local::TChangeableMemPool::_::_::_m_arrayPool::_0_::_elem::port_ens_r_obj_sensor_base::_::_m_movObjectInformation::_1_::_m_covarDyVyN = 0;
//    @sysvar::XCP::RadarFL::_g_PlReCoFw_PlReCoPer_ObjBypassingRunnable_ObjBypassingRunnable_m_pad_radarObjPort_par_out_local::TChangeableMemPool::_::_::_m_arrayPool::_0_::_elem::port_ens_r_obj_sensor_base::_::_m_movObjectInformation::_1_::_m_covarDyWidthN = 0;
//    @sysvar::XCP::RadarFL::_g_PlReCoFw_PlReCoPer_ObjBypassingRunnable_ObjBypassingRunnable_m_pad_radarObjPort_par_out_local::TChangeableMemPool::_::_::_m_arrayPool::_0_::_elem::port_ens_r_obj_sensor_base::_::_m_movObjectInformation::_1_::_m_covarVxAxN = 0;
//    @sysvar::XCP::RadarFL::_g_PlReCoFw_PlReCoPer_ObjBypassingRunnable_ObjBypassingRunnable_m_pad_radarObjPort_par_out_local::TChangeableMemPool::_::_::_m_arrayPool::_0_::_elem::port_ens_r_obj_sensor_base::_::_m_movObjectInformation::_1_::_m_varAxN = 0;
//    @sysvar::XCP::RadarFL::_g_PlReCoFw_PlReCoPer_ObjBypassingRunnable_ObjBypassingRunnable_m_pad_radarObjPort_par_out_local::TChangeableMemPool::_::_::_m_arrayPool::_0_::_elem::port_ens_r_obj_sensor_base::_::_m_movObjectInformation::_1_::_m_varAyN = 0;
//    @sysvar::XCP::RadarFL::_g_PlReCoFw_PlReCoPer_ObjBypassingRunnable_ObjBypassingRunnable_m_pad_radarObjPort_par_out_local::TChangeableMemPool::_::_::_m_arrayPool::_0_::_elem::port_ens_r_obj_sensor_base::_::_m_movObjectInformation::_1_::_m_varVxN = 0;
//    @sysvar::XCP::RadarFL::_g_PlReCoFw_PlReCoPer_ObjBypassingRunnable_ObjBypassingRunnable_m_pad_radarObjPort_par_out_local::TChangeableMemPool::_::_::_m_arrayPool::_0_::_elem::port_ens_r_obj_sensor_base::_::_m_movObjectInformation::_1_::_m_varVyN = 0;
//    @sysvar::XCP::RadarFL::_g_PlReCoFw_PlReCoPer_ObjBypassingRunnable_ObjBypassingRunnable_m_pad_radarObjPort_par_out_local::TChangeableMemPool::_::_::_m_arrayPool::_0_::_elem::port_ens_r_obj_sensor_base::_::_m_movObjectInformation::_1_::STA_OBJECT_INFORMATION_ST::_::_m_varDxN = 0;
//    @sysvar::XCP::RadarFL::_g_PlReCoFw_PlReCoPer_ObjBypassingRunnable_ObjBypassingRunnable_m_pad_radarObjPort_par_out_local::TChangeableMemPool::_::_::_m_arrayPool::_0_::_elem::port_ens_r_obj_sensor_base::_::_m_movObjectInformation::_1_::STA_OBJECT_INFORMATION_ST::_::_m_varDyN = 0;
//    @sysvar::XCP::RadarFL::_g_PlReCoFw_PlReCoPer_ObjBypassingRunnable_ObjBypassingRunnable_m_pad_radarObjPort_par_out_local::TChangeableMemPool::_::_::_m_arrayPool::_0_::_elem::port_ens_r_obj_sensor_base::_::_m_movObjectInformation::_1_::_m_dVarLengthN = 0;
//    @sysvar::XCP::RadarFL::_g_PlReCoFw_PlReCoPer_ObjBypassingRunnable_ObjBypassingRunnable_m_pad_radarObjPort_par_out_local::TChangeableMemPool::_::_::_m_arrayPool::_0_::_elem::port_ens_r_obj_sensor_base::_::_m_movObjectInformation::_1_::_m_dVarWidthN = 0;
//    @sysvar::XCP::RadarFL::_g_PlReCoFw_PlReCoPer_ObjBypassingRunnable_ObjBypassingRunnable_m_pad_radarObjPort_par_out_local::TChangeableMemPool::_::_::_m_arrayPool::_0_::_elem::port_ens_r_obj_sensor_base::_::_m_movObjectInformation::_1_::STA_OBJECT_INFORMATION_ST::_::_m_wExistProbN = 64880;
//    @sysvar::XCP::RadarFL::_g_PlReCoFw_PlReCoPer_ObjBypassingRunnable_ObjBypassingRunnable_m_pad_radarObjPort_par_out_local::TChangeableMemPool::_::_::_m_arrayPool::_0_::_elem::port_ens_r_obj_sensor_base::_::_m_movObjectInformation::_1_::_m_referencePtPosIndexN = 10;
//    @sysvar::XCP::RadarFL::_g_PlReCoFw_PlReCoPer_ObjBypassingRunnable_ObjBypassingRunnable_m_pad_radarObjPort_par_out_local::TChangeableMemPool::_::_::_m_arrayPool::_0_::_elem::port_ens_r_obj_sensor_base::_::_m_movObjectInformation::_1_::_m_alpPiVarYawAngleN = 0;
//    @sysvar::XCP::RadarFL::_g_PlReCoFw_PlReCoPer_ObjBypassingRunnable_ObjBypassingRunnable_m_pad_radarObjPort_par_out_local::TChangeableMemPool::_::_::_m_arrayPool::_0_::_elem::port_ens_r_obj_sensor_base::_::_m_movObjectInformation::_1_::_m_alpPiYawAngleN = 0;
//
//    //target movement
//
//    @sysvar::XCP::RadarFL::_g_PlReCoFw_PlReCoPer_ObjBypassingRunnable_ObjBypassingRunnable_m_pad_radarObjPort_par_out_local::TChangeableMemPool::_::_::_m_arrayPool::_0_::_elem::port_ens_r_obj_sensor_base::_::_m_movObjectInformation::_1_::STA_OBJECT_INFORMATION_ST::_::_m_dxN = @Classe_Obj_Sim::objdata.obj_dx[1] * 128;
//    @sysvar::XCP::RadarFL::_g_PlReCoFw_PlReCoPer_ObjBypassingRunnable_ObjBypassingRunnable_m_pad_radarObjPort_par_out_local::TChangeableMemPool::_::_::_m_arrayPool::_0_::_elem::port_ens_r_obj_sensor_base::_::_m_movObjectInformation::_1_::STA_OBJECT_INFORMATION_ST::_::_m_dyN = @Classe_Obj_Sim::objdata.obj_dy[1] * 128;
//    @sysvar::XCP::RadarFL::_g_PlReCoFw_PlReCoPer_ObjBypassingRunnable_ObjBypassingRunnable_m_pad_radarObjPort_par_out_local::TChangeableMemPool::_::_::_m_arrayPool::_0_::_elem::port_ens_r_obj_sensor_base::_::_m_movObjectInformation::_1_::STA_OBJECT_INFORMATION_ST::_::_m_dzN = 0;
//    @sysvar::XCP::RadarFL::_g_PlReCoFw_PlReCoPer_ObjBypassingRunnable_ObjBypassingRunnable_m_pad_radarObjPort_par_out_local::TChangeableMemPool::_::_::_m_arrayPool::_0_::_elem::port_ens_r_obj_sensor_base::_::_m_movObjectInformation::_1_::_m_vxN = @Classe_Obj_Sim::objdata.obj_relative_vx[1] * 256;
//    @sysvar::XCP::RadarFL::_g_PlReCoFw_PlReCoPer_ObjBypassingRunnable_ObjBypassingRunnable_m_pad_radarObjPort_par_out_local::TChangeableMemPool::_::_::_m_arrayPool::_0_::_elem::port_ens_r_obj_sensor_base::_::_m_movObjectInformation::_1_::_m_vyN = @Classe_Obj_Sim::objdata.obj_relative_vy[1] * 256;
//    @sysvar::XCP::RadarFL::_g_PlReCoFw_PlReCoPer_ObjBypassingRunnable_ObjBypassingRunnable_m_pad_radarObjPort_par_out_local::TChangeableMemPool::_::_::_m_arrayPool::_0_::_elem::port_ens_r_obj_sensor_base::_::_m_movObjectInformation::_1_::_m_axN = 0;
//    @sysvar::XCP::RadarFL::_g_PlReCoFw_PlReCoPer_ObjBypassingRunnable_ObjBypassingRunnable_m_pad_radarObjPort_par_out_local::TChangeableMemPool::_::_::_m_arrayPool::_0_::_elem::port_ens_r_obj_sensor_base::_::_m_movObjectInformation::_1_::_m_ayN = 0;
//
//    //target object moving or not
//    if (abs(@Classe_Obj_Sim::objdata.obj_relative_vx[1]) != 0)
//    {
//      @sysvar::XCP::RadarFL::_g_PlReCoFw_PlReCoPer_ObjBypassingRunnable_ObjBypassingRunnable_m_pad_radarObjPort_par_out_local::TChangeableMemPool::_::_::_m_arrayPool::_0_::_elem::port_ens_r_obj_sensor_base::_::_m_movObjectInformation::_1_::STA_OBJECT_INFORMATION_ST::_::_m_prob1HasBeenObservedMovingN = 126;
//      @sysvar::XCP::RadarFL::_g_PlReCoFw_PlReCoPer_ObjBypassingRunnable_ObjBypassingRunnable_m_pad_radarObjPort_par_out_local::TChangeableMemPool::_::_::_m_arrayPool::_0_::_elem::port_ens_r_obj_sensor_base::_::_m_movObjectInformation::_1_::STA_OBJECT_INFORMATION_ST::_::_m_prob1MovingN = 126;
//      @sysvar::XCP::RadarFL::_g_PlReCoFw_PlReCoPer_ObjBypassingRunnable_ObjBypassingRunnable_m_pad_radarObjPort_par_out_local::TChangeableMemPool::_::_::_m_arrayPool::_0_::_elem::port_ens_r_obj_sensor_base::_::_m_movObjectInformation::_1_::STA_OBJECT_INFORMATION_ST::_::_m_ohyObjectType_st::_m_probObstacle_st::_m_prob1MobileN = 128;
//      @sysvar::XCP::RadarFL::_g_PlReCoFw_PlReCoPer_ObjBypassingRunnable_ObjBypassingRunnable_m_pad_radarObjPort_par_out_local::TChangeableMemPool::_::_::_m_arrayPool::_0_::_elem::port_ens_r_obj_sensor_base::_::_m_movObjectInformation::_1_::STA_OBJECT_INFORMATION_ST::_::_m_ohyObjectType_st::_m_probObstacle_st::_m_prob1StationaryN = 0;
//    }
//    else
//    {
//      @sysvar::XCP::RadarFL::_g_PlReCoFw_PlReCoPer_ObjBypassingRunnable_ObjBypassingRunnable_m_pad_radarObjPort_par_out_local::TChangeableMemPool::_::_::_m_arrayPool::_0_::_elem::port_ens_r_obj_sensor_base::_::_m_movObjectInformation::_1_::STA_OBJECT_INFORMATION_ST::_::_m_prob1HasBeenObservedMovingN = 0;
//      @sysvar::XCP::RadarFL::_g_PlReCoFw_PlReCoPer_ObjBypassingRunnable_ObjBypassingRunnable_m_pad_radarObjPort_par_out_local::TChangeableMemPool::_::_::_m_arrayPool::_0_::_elem::port_ens_r_obj_sensor_base::_::_m_movObjectInformation::_1_::STA_OBJECT_INFORMATION_ST::_::_m_prob1MovingN = 0;
//      @sysvar::XCP::RadarFL::_g_PlReCoFw_PlReCoPer_ObjBypassingRunnable_ObjBypassingRunnable_m_pad_radarObjPort_par_out_local::TChangeableMemPool::_::_::_m_arrayPool::_0_::_elem::port_ens_r_obj_sensor_base::_::_m_movObjectInformation::_1_::STA_OBJECT_INFORMATION_ST::_::_m_ohyObjectType_st::_m_probObstacle_st::_m_prob1MobileN = 0;
//      @sysvar::XCP::RadarFL::_g_PlReCoFw_PlReCoPer_ObjBypassingRunnable_ObjBypassingRunnable_m_pad_radarObjPort_par_out_local::TChangeableMemPool::_::_::_m_arrayPool::_0_::_elem::port_ens_r_obj_sensor_base::_::_m_movObjectInformation::_1_::STA_OBJECT_INFORMATION_ST::_::_m_ohyObjectType_st::_m_probObstacle_st::_m_prob1StationaryN = 128;
//    }
//
//      //object classification
//    switch (@Classe_Obj_Sim::objdata.obj_type[1])
//    {
//      case 0: //"Non-Obstacle"
//        @sysvar::XCP::RadarFL::_g_PlReCoFw_PlReCoPer_ObjBypassingRunnable_ObjBypassingRunnable_m_pad_radarObjPort_par_out_local::TChangeableMemPool::_::_::_m_arrayPool::_0_::_elem::port_ens_r_obj_sensor_base::_::_m_movObjectInformation::_1_::STA_OBJECT_INFORMATION_ST::_::_m_ohyObjectType_st::_m_prob1NonObstacleN = 128;
//        @sysvar::XCP::RadarFL::_g_PlReCoFw_PlReCoPer_ObjBypassingRunnable_ObjBypassingRunnable_m_pad_radarObjPort_par_out_local::TChangeableMemPool::_::_::_m_arrayPool::_0_::_elem::port_ens_r_obj_sensor_base::_::_m_movObjectInformation::_1_::STA_OBJECT_INFORMATION_ST::_::_m_ohyObjectType_st::_m_prob1ObstacleN = 0;
//        @sysvar::XCP::RadarFL::_g_PlReCoFw_PlReCoPer_ObjBypassingRunnable_ObjBypassingRunnable_m_pad_radarObjPort_par_out_local::TChangeableMemPool::_::_::_m_arrayPool::_0_::_elem::port_ens_r_obj_sensor_base::_::_m_movObjectInformation::_1_::STA_OBJECT_INFORMATION_ST::_::_m_ohyObjectType_st::_m_prob1UnknownN = 0;
//        @sysvar::XCP::RadarFL::_g_PlReCoFw_PlReCoPer_ObjBypassingRunnable_ObjBypassingRunnable_m_pad_radarObjPort_par_out_local::TChangeableMemPool::_::_::_m_arrayPool::_0_::_elem::port_ens_r_obj_sensor_base::_::_m_movObjectInformation::_1_::STA_OBJECT_INFORMATION_ST::_::_m_ohyObjectType_st::_m_probObstacle_st::_m_prob1UnknownN = 128;
//        @sysvar::XCP::RadarFL::_g_PlReCoFw_PlReCoPer_ObjBypassingRunnable_ObjBypassingRunnable_m_pad_radarObjPort_par_out_local::TChangeableMemPool::_::_::_m_arrayPool::_0_::_elem::port_ens_r_obj_sensor_base::_::_m_movObjectInformation::_1_::STA_OBJECT_INFORMATION_ST::_::_m_ohyObjectType_st::_m_probObstacle_st::_m_probMobile_st::_m_prob1FourPlusWheelerN = 0;
//        @sysvar::XCP::RadarFL::_g_PlReCoFw_PlReCoPer_ObjBypassingRunnable_ObjBypassingRunnable_m_pad_radarObjPort_par_out_local::TChangeableMemPool::_::_::_m_arrayPool::_0_::_elem::port_ens_r_obj_sensor_base::_::_m_movObjectInformation::_1_::STA_OBJECT_INFORMATION_ST::_::_m_ohyObjectType_st::_m_probObstacle_st::_m_probMobile_st::_m_prob1PedestrianN = 0;
//        @sysvar::XCP::RadarFL::_g_PlReCoFw_PlReCoPer_ObjBypassingRunnable_ObjBypassingRunnable_m_pad_radarObjPort_par_out_local::TChangeableMemPool::_::_::_m_arrayPool::_0_::_elem::port_ens_r_obj_sensor_base::_::_m_movObjectInformation::_1_::STA_OBJECT_INFORMATION_ST::_::_m_ohyObjectType_st::_m_probObstacle_st::_m_probMobile_st::_m_prob1TwoWheelerN = 0;
//        @sysvar::XCP::RadarFL::_g_PlReCoFw_PlReCoPer_ObjBypassingRunnable_ObjBypassingRunnable_m_pad_radarObjPort_par_out_local::TChangeableMemPool::_::_::_m_arrayPool::_0_::_elem::port_ens_r_obj_sensor_base::_::_m_movObjectInformation::_1_::STA_OBJECT_INFORMATION_ST::_::_m_ohyObjectType_st::_m_probObstacle_st::_m_probMobile_st::_m_prob1UnknownN = 128;
//        @sysvar::XCP::RadarFL::_g_PlReCoFw_PlReCoPer_ObjBypassingRunnable_ObjBypassingRunnable_m_pad_radarObjPort_par_out_local::TChangeableMemPool::_::_::_m_arrayPool::_0_::_elem::port_ens_r_obj_sensor_base::_::_m_movObjectInformation::_1_::STA_OBJECT_INFORMATION_ST::_::_m_ohyObjectType_st::_m_probObstacle_st::_m_probMobile_st::_m_probFourPlusWheeler_st::_m_prob1PassengerCarN = 0;
//        @sysvar::XCP::RadarFL::_g_PlReCoFw_PlReCoPer_ObjBypassingRunnable_ObjBypassingRunnable_m_pad_radarObjPort_par_out_local::TChangeableMemPool::_::_::_m_arrayPool::_0_::_elem::port_ens_r_obj_sensor_base::_::_m_movObjectInformation::_1_::STA_OBJECT_INFORMATION_ST::_::_m_ohyObjectType_st::_m_probObstacle_st::_m_probMobile_st::_m_probFourPlusWheeler_st::_m_prob1TruckN = 0;
//        @sysvar::XCP::RadarFL::_g_PlReCoFw_PlReCoPer_ObjBypassingRunnable_ObjBypassingRunnable_m_pad_radarObjPort_par_out_local::TChangeableMemPool::_::_::_m_arrayPool::_0_::_elem::port_ens_r_obj_sensor_base::_::_m_movObjectInformation::_1_::STA_OBJECT_INFORMATION_ST::_::_m_ohyObjectType_st::_m_probObstacle_st::_m_probMobile_st::_m_probFourPlusWheeler_st::_m_prob1UnknownN = 128;
//        @sysvar::XCP::RadarFL::_g_PlReCoFw_PlReCoPer_ObjBypassingRunnable_ObjBypassingRunnable_m_pad_radarObjPort_par_out_local::TChangeableMemPool::_::_::_m_arrayPool::_0_::_elem::port_ens_r_obj_sensor_base::_::_m_movObjectInformation::_1_::STA_OBJECT_INFORMATION_ST::_::_m_ohyObjectType_st::_m_probObstacle_st::_m_probStationary_st::_m_prob1RoadsideBarrierN = 0;
//        @sysvar::XCP::RadarFL::_g_PlReCoFw_PlReCoPer_ObjBypassingRunnable_ObjBypassingRunnable_m_pad_radarObjPort_par_out_local::TChangeableMemPool::_::_::_m_arrayPool::_0_::_elem::port_ens_r_obj_sensor_base::_::_m_movObjectInformation::_1_::STA_OBJECT_INFORMATION_ST::_::_m_ohyObjectType_st::_m_probObstacle_st::_m_probStationary_st::_m_prob1UnknownN = 128;
//        @sysvar::XCP::RadarFL::_g_PlReCoFw_PlReCoPer_ObjBypassingRunnable_ObjBypassingRunnable_m_pad_radarObjPort_par_out_local::TChangeableMemPool::_::_::_m_arrayPool::_0_::_elem::port_ens_r_obj_sensor_base::_::_m_movObjectInformation::_1_::_m_dLengthN = 64;
//        @sysvar::XCP::RadarFL::_g_PlReCoFw_PlReCoPer_ObjBypassingRunnable_ObjBypassingRunnable_m_pad_radarObjPort_par_out_local::TChangeableMemPool::_::_::_m_arrayPool::_0_::_elem::port_ens_r_obj_sensor_base::_::_m_movObjectInformation::_1_::_m_dWidthN = @Classe_Obj_Sim::objdata.obj_width[1] * 128;
//        break;
//
//      case 1: //"unknown"
//        @sysvar::XCP::RadarFL::_g_PlReCoFw_PlReCoPer_ObjBypassingRunnable_ObjBypassingRunnable_m_pad_radarObjPort_par_out_local::TChangeableMemPool::_::_::_m_arrayPool::_0_::_elem::port_ens_r_obj_sensor_base::_::_m_movObjectInformation::_1_::STA_OBJECT_INFORMATION_ST::_::_m_ohyObjectType_st::_m_prob1NonObstacleN = 0;
//        @sysvar::XCP::RadarFL::_g_PlReCoFw_PlReCoPer_ObjBypassingRunnable_ObjBypassingRunnable_m_pad_radarObjPort_par_out_local::TChangeableMemPool::_::_::_m_arrayPool::_0_::_elem::port_ens_r_obj_sensor_base::_::_m_movObjectInformation::_1_::STA_OBJECT_INFORMATION_ST::_::_m_ohyObjectType_st::_m_prob1ObstacleN = 0;
//        @sysvar::XCP::RadarFL::_g_PlReCoFw_PlReCoPer_ObjBypassingRunnable_ObjBypassingRunnable_m_pad_radarObjPort_par_out_local::TChangeableMemPool::_::_::_m_arrayPool::_0_::_elem::port_ens_r_obj_sensor_base::_::_m_movObjectInformation::_1_::STA_OBJECT_INFORMATION_ST::_::_m_ohyObjectType_st::_m_prob1UnknownN = 128;
//        @sysvar::XCP::RadarFL::_g_PlReCoFw_PlReCoPer_ObjBypassingRunnable_ObjBypassingRunnable_m_pad_radarObjPort_par_out_local::TChangeableMemPool::_::_::_m_arrayPool::_0_::_elem::port_ens_r_obj_sensor_base::_::_m_movObjectInformation::_1_::STA_OBJECT_INFORMATION_ST::_::_m_ohyObjectType_st::_m_probObstacle_st::_m_prob1UnknownN = 128;
//        @sysvar::XCP::RadarFL::_g_PlReCoFw_PlReCoPer_ObjBypassingRunnable_ObjBypassingRunnable_m_pad_radarObjPort_par_out_local::TChangeableMemPool::_::_::_m_arrayPool::_0_::_elem::port_ens_r_obj_sensor_base::_::_m_movObjectInformation::_1_::STA_OBJECT_INFORMATION_ST::_::_m_ohyObjectType_st::_m_probObstacle_st::_m_probMobile_st::_m_prob1FourPlusWheelerN = 0;
//        @sysvar::XCP::RadarFL::_g_PlReCoFw_PlReCoPer_ObjBypassingRunnable_ObjBypassingRunnable_m_pad_radarObjPort_par_out_local::TChangeableMemPool::_::_::_m_arrayPool::_0_::_elem::port_ens_r_obj_sensor_base::_::_m_movObjectInformation::_1_::STA_OBJECT_INFORMATION_ST::_::_m_ohyObjectType_st::_m_probObstacle_st::_m_probMobile_st::_m_prob1PedestrianN = 0;
//        @sysvar::XCP::RadarFL::_g_PlReCoFw_PlReCoPer_ObjBypassingRunnable_ObjBypassingRunnable_m_pad_radarObjPort_par_out_local::TChangeableMemPool::_::_::_m_arrayPool::_0_::_elem::port_ens_r_obj_sensor_base::_::_m_movObjectInformation::_1_::STA_OBJECT_INFORMATION_ST::_::_m_ohyObjectType_st::_m_probObstacle_st::_m_probMobile_st::_m_prob1TwoWheelerN = 0;
//        @sysvar::XCP::RadarFL::_g_PlReCoFw_PlReCoPer_ObjBypassingRunnable_ObjBypassingRunnable_m_pad_radarObjPort_par_out_local::TChangeableMemPool::_::_::_m_arrayPool::_0_::_elem::port_ens_r_obj_sensor_base::_::_m_movObjectInformation::_1_::STA_OBJECT_INFORMATION_ST::_::_m_ohyObjectType_st::_m_probObstacle_st::_m_probMobile_st::_m_prob1UnknownN = 128;
//        @sysvar::XCP::RadarFL::_g_PlReCoFw_PlReCoPer_ObjBypassingRunnable_ObjBypassingRunnable_m_pad_radarObjPort_par_out_local::TChangeableMemPool::_::_::_m_arrayPool::_0_::_elem::port_ens_r_obj_sensor_base::_::_m_movObjectInformation::_1_::STA_OBJECT_INFORMATION_ST::_::_m_ohyObjectType_st::_m_probObstacle_st::_m_probMobile_st::_m_probFourPlusWheeler_st::_m_prob1PassengerCarN = 0;
//        @sysvar::XCP::RadarFL::_g_PlReCoFw_PlReCoPer_ObjBypassingRunnable_ObjBypassingRunnable_m_pad_radarObjPort_par_out_local::TChangeableMemPool::_::_::_m_arrayPool::_0_::_elem::port_ens_r_obj_sensor_base::_::_m_movObjectInformation::_1_::STA_OBJECT_INFORMATION_ST::_::_m_ohyObjectType_st::_m_probObstacle_st::_m_probMobile_st::_m_probFourPlusWheeler_st::_m_prob1TruckN = 0;
//        @sysvar::XCP::RadarFL::_g_PlReCoFw_PlReCoPer_ObjBypassingRunnable_ObjBypassingRunnable_m_pad_radarObjPort_par_out_local::TChangeableMemPool::_::_::_m_arrayPool::_0_::_elem::port_ens_r_obj_sensor_base::_::_m_movObjectInformation::_1_::STA_OBJECT_INFORMATION_ST::_::_m_ohyObjectType_st::_m_probObstacle_st::_m_probMobile_st::_m_probFourPlusWheeler_st::_m_prob1UnknownN = 128;
//        @sysvar::XCP::RadarFL::_g_PlReCoFw_PlReCoPer_ObjBypassingRunnable_ObjBypassingRunnable_m_pad_radarObjPort_par_out_local::TChangeableMemPool::_::_::_m_arrayPool::_0_::_elem::port_ens_r_obj_sensor_base::_::_m_movObjectInformation::_1_::STA_OBJECT_INFORMATION_ST::_::_m_ohyObjectType_st::_m_probObstacle_st::_m_probStationary_st::_m_prob1RoadsideBarrierN = 0;
//        @sysvar::XCP::RadarFL::_g_PlReCoFw_PlReCoPer_ObjBypassingRunnable_ObjBypassingRunnable_m_pad_radarObjPort_par_out_local::TChangeableMemPool::_::_::_m_arrayPool::_0_::_elem::port_ens_r_obj_sensor_base::_::_m_movObjectInformation::_1_::STA_OBJECT_INFORMATION_ST::_::_m_ohyObjectType_st::_m_probObstacle_st::_m_probStationary_st::_m_prob1UnknownN = 128;
//        @sysvar::XCP::RadarFL::_g_PlReCoFw_PlReCoPer_ObjBypassingRunnable_ObjBypassingRunnable_m_pad_radarObjPort_par_out_local::TChangeableMemPool::_::_::_m_arrayPool::_0_::_elem::port_ens_r_obj_sensor_base::_::_m_movObjectInformation::_1_::_m_dLengthN = 0;
//        @sysvar::XCP::RadarFL::_g_PlReCoFw_PlReCoPer_ObjBypassingRunnable_ObjBypassingRunnable_m_pad_radarObjPort_par_out_local::TChangeableMemPool::_::_::_m_arrayPool::_0_::_elem::port_ens_r_obj_sensor_base::_::_m_movObjectInformation::_1_::_m_dWidthN = @Classe_Obj_Sim::objdata.obj_width[1] * 128;
//        break;
//
//      case 2: //"RoadSideBarrier"
//        @sysvar::XCP::RadarFL::_g_PlReCoFw_PlReCoPer_ObjBypassingRunnable_ObjBypassingRunnable_m_pad_radarObjPort_par_out_local::TChangeableMemPool::_::_::_m_arrayPool::_0_::_elem::port_ens_r_obj_sensor_base::_::_m_movObjectInformation::_1_::STA_OBJECT_INFORMATION_ST::_::_m_ohyObjectType_st::_m_prob1NonObstacleN = 0;
//        @sysvar::XCP::RadarFL::_g_PlReCoFw_PlReCoPer_ObjBypassingRunnable_ObjBypassingRunnable_m_pad_radarObjPort_par_out_local::TChangeableMemPool::_::_::_m_arrayPool::_0_::_elem::port_ens_r_obj_sensor_base::_::_m_movObjectInformation::_1_::STA_OBJECT_INFORMATION_ST::_::_m_ohyObjectType_st::_m_prob1ObstacleN = 128;
//        @sysvar::XCP::RadarFL::_g_PlReCoFw_PlReCoPer_ObjBypassingRunnable_ObjBypassingRunnable_m_pad_radarObjPort_par_out_local::TChangeableMemPool::_::_::_m_arrayPool::_0_::_elem::port_ens_r_obj_sensor_base::_::_m_movObjectInformation::_1_::STA_OBJECT_INFORMATION_ST::_::_m_ohyObjectType_st::_m_prob1UnknownN = 0;
//        @sysvar::XCP::RadarFL::_g_PlReCoFw_PlReCoPer_ObjBypassingRunnable_ObjBypassingRunnable_m_pad_radarObjPort_par_out_local::TChangeableMemPool::_::_::_m_arrayPool::_0_::_elem::port_ens_r_obj_sensor_base::_::_m_movObjectInformation::_1_::STA_OBJECT_INFORMATION_ST::_::_m_ohyObjectType_st::_m_probObstacle_st::_m_prob1MobileN = 0;
//        @sysvar::XCP::RadarFL::_g_PlReCoFw_PlReCoPer_ObjBypassingRunnable_ObjBypassingRunnable_m_pad_radarObjPort_par_out_local::TChangeableMemPool::_::_::_m_arrayPool::_0_::_elem::port_ens_r_obj_sensor_base::_::_m_movObjectInformation::_1_::STA_OBJECT_INFORMATION_ST::_::_m_ohyObjectType_st::_m_probObstacle_st::_m_prob1StationaryN = 128;
//        @sysvar::XCP::RadarFL::_g_PlReCoFw_PlReCoPer_ObjBypassingRunnable_ObjBypassingRunnable_m_pad_radarObjPort_par_out_local::TChangeableMemPool::_::_::_m_arrayPool::_0_::_elem::port_ens_r_obj_sensor_base::_::_m_movObjectInformation::_1_::STA_OBJECT_INFORMATION_ST::_::_m_ohyObjectType_st::_m_probObstacle_st::_m_prob1UnknownN = 0;
//        @sysvar::XCP::RadarFL::_g_PlReCoFw_PlReCoPer_ObjBypassingRunnable_ObjBypassingRunnable_m_pad_radarObjPort_par_out_local::TChangeableMemPool::_::_::_m_arrayPool::_0_::_elem::port_ens_r_obj_sensor_base::_::_m_movObjectInformation::_1_::STA_OBJECT_INFORMATION_ST::_::_m_ohyObjectType_st::_m_probObstacle_st::_m_probMobile_st::_m_prob1FourPlusWheelerN = 0;
//        @sysvar::XCP::RadarFL::_g_PlReCoFw_PlReCoPer_ObjBypassingRunnable_ObjBypassingRunnable_m_pad_radarObjPort_par_out_local::TChangeableMemPool::_::_::_m_arrayPool::_0_::_elem::port_ens_r_obj_sensor_base::_::_m_movObjectInformation::_1_::STA_OBJECT_INFORMATION_ST::_::_m_ohyObjectType_st::_m_probObstacle_st::_m_probMobile_st::_m_prob1PedestrianN = 0;
//        @sysvar::XCP::RadarFL::_g_PlReCoFw_PlReCoPer_ObjBypassingRunnable_ObjBypassingRunnable_m_pad_radarObjPort_par_out_local::TChangeableMemPool::_::_::_m_arrayPool::_0_::_elem::port_ens_r_obj_sensor_base::_::_m_movObjectInformation::_1_::STA_OBJECT_INFORMATION_ST::_::_m_ohyObjectType_st::_m_probObstacle_st::_m_probMobile_st::_m_prob1TwoWheelerN = 0;
//        @sysvar::XCP::RadarFL::_g_PlReCoFw_PlReCoPer_ObjBypassingRunnable_ObjBypassingRunnable_m_pad_radarObjPort_par_out_local::TChangeableMemPool::_::_::_m_arrayPool::_0_::_elem::port_ens_r_obj_sensor_base::_::_m_movObjectInformation::_1_::STA_OBJECT_INFORMATION_ST::_::_m_ohyObjectType_st::_m_probObstacle_st::_m_probMobile_st::_m_prob1UnknownN = 0;
//        @sysvar::XCP::RadarFL::_g_PlReCoFw_PlReCoPer_ObjBypassingRunnable_ObjBypassingRunnable_m_pad_radarObjPort_par_out_local::TChangeableMemPool::_::_::_m_arrayPool::_0_::_elem::port_ens_r_obj_sensor_base::_::_m_movObjectInformation::_1_::STA_OBJECT_INFORMATION_ST::_::_m_ohyObjectType_st::_m_probObstacle_st::_m_probMobile_st::_m_probFourPlusWheeler_st::_m_prob1PassengerCarN = 0;
//        @sysvar::XCP::RadarFL::_g_PlReCoFw_PlReCoPer_ObjBypassingRunnable_ObjBypassingRunnable_m_pad_radarObjPort_par_out_local::TChangeableMemPool::_::_::_m_arrayPool::_0_::_elem::port_ens_r_obj_sensor_base::_::_m_movObjectInformation::_1_::STA_OBJECT_INFORMATION_ST::_::_m_ohyObjectType_st::_m_probObstacle_st::_m_probMobile_st::_m_probFourPlusWheeler_st::_m_prob1TruckN = 0;
//        @sysvar::XCP::RadarFL::_g_PlReCoFw_PlReCoPer_ObjBypassingRunnable_ObjBypassingRunnable_m_pad_radarObjPort_par_out_local::TChangeableMemPool::_::_::_m_arrayPool::_0_::_elem::port_ens_r_obj_sensor_base::_::_m_movObjectInformation::_1_::STA_OBJECT_INFORMATION_ST::_::_m_ohyObjectType_st::_m_probObstacle_st::_m_probMobile_st::_m_probFourPlusWheeler_st::_m_prob1UnknownN = 0;
//        @sysvar::XCP::RadarFL::_g_PlReCoFw_PlReCoPer_ObjBypassingRunnable_ObjBypassingRunnable_m_pad_radarObjPort_par_out_local::TChangeableMemPool::_::_::_m_arrayPool::_0_::_elem::port_ens_r_obj_sensor_base::_::_m_movObjectInformation::_1_::STA_OBJECT_INFORMATION_ST::_::_m_ohyObjectType_st::_m_probObstacle_st::_m_probStationary_st::_m_prob1RoadsideBarrierN = 128;
//        @sysvar::XCP::RadarFL::_g_PlReCoFw_PlReCoPer_ObjBypassingRunnable_ObjBypassingRunnable_m_pad_radarObjPort_par_out_local::TChangeableMemPool::_::_::_m_arrayPool::_0_::_elem::port_ens_r_obj_sensor_base::_::_m_movObjectInformation::_1_::STA_OBJECT_INFORMATION_ST::_::_m_ohyObjectType_st::_m_probObstacle_st::_m_probStationary_st::_m_prob1UnknownN = 0;
//        @sysvar::XCP::RadarFL::_g_PlReCoFw_PlReCoPer_ObjBypassingRunnable_ObjBypassingRunnable_m_pad_radarObjPort_par_out_local::TChangeableMemPool::_::_::_m_arrayPool::_0_::_elem::port_ens_r_obj_sensor_base::_::_m_movObjectInformation::_1_::_m_dLengthN = 64;
//        @sysvar::XCP::RadarFL::_g_PlReCoFw_PlReCoPer_ObjBypassingRunnable_ObjBypassingRunnable_m_pad_radarObjPort_par_out_local::TChangeableMemPool::_::_::_m_arrayPool::_0_::_elem::port_ens_r_obj_sensor_base::_::_m_movObjectInformation::_1_::_m_dWidthN = @Classe_Obj_Sim::objdata.obj_width[1] * 128;
//        break;
//
//      case 3: //"2Wheeler"
//        @sysvar::XCP::RadarFL::_g_PlReCoFw_PlReCoPer_ObjBypassingRunnable_ObjBypassingRunnable_m_pad_radarObjPort_par_out_local::TChangeableMemPool::_::_::_m_arrayPool::_0_::_elem::port_ens_r_obj_sensor_base::_::_m_movObjectInformation::_1_::STA_OBJECT_INFORMATION_ST::_::_m_ohyObjectType_st::_m_prob1NonObstacleN = 0;
//        @sysvar::XCP::RadarFL::_g_PlReCoFw_PlReCoPer_ObjBypassingRunnable_ObjBypassingRunnable_m_pad_radarObjPort_par_out_local::TChangeableMemPool::_::_::_m_arrayPool::_0_::_elem::port_ens_r_obj_sensor_base::_::_m_movObjectInformation::_1_::STA_OBJECT_INFORMATION_ST::_::_m_ohyObjectType_st::_m_prob1ObstacleN = 128;
//        @sysvar::XCP::RadarFL::_g_PlReCoFw_PlReCoPer_ObjBypassingRunnable_ObjBypassingRunnable_m_pad_radarObjPort_par_out_local::TChangeableMemPool::_::_::_m_arrayPool::_0_::_elem::port_ens_r_obj_sensor_base::_::_m_movObjectInformation::_1_::STA_OBJECT_INFORMATION_ST::_::_m_ohyObjectType_st::_m_prob1UnknownN = 0;
//        @sysvar::XCP::RadarFL::_g_PlReCoFw_PlReCoPer_ObjBypassingRunnable_ObjBypassingRunnable_m_pad_radarObjPort_par_out_local::TChangeableMemPool::_::_::_m_arrayPool::_0_::_elem::port_ens_r_obj_sensor_base::_::_m_movObjectInformation::_1_::STA_OBJECT_INFORMATION_ST::_::_m_ohyObjectType_st::_m_probObstacle_st::_m_prob1UnknownN = 0;
//        @sysvar::XCP::RadarFL::_g_PlReCoFw_PlReCoPer_ObjBypassingRunnable_ObjBypassingRunnable_m_pad_radarObjPort_par_out_local::TChangeableMemPool::_::_::_m_arrayPool::_0_::_elem::port_ens_r_obj_sensor_base::_::_m_movObjectInformation::_1_::STA_OBJECT_INFORMATION_ST::_::_m_ohyObjectType_st::_m_probObstacle_st::_m_probMobile_st::_m_prob1FourPlusWheelerN = 0;
//        @sysvar::XCP::RadarFL::_g_PlReCoFw_PlReCoPer_ObjBypassingRunnable_ObjBypassingRunnable_m_pad_radarObjPort_par_out_local::TChangeableMemPool::_::_::_m_arrayPool::_0_::_elem::port_ens_r_obj_sensor_base::_::_m_movObjectInformation::_1_::STA_OBJECT_INFORMATION_ST::_::_m_ohyObjectType_st::_m_probObstacle_st::_m_probMobile_st::_m_prob1PedestrianN = 0;
//        @sysvar::XCP::RadarFL::_g_PlReCoFw_PlReCoPer_ObjBypassingRunnable_ObjBypassingRunnable_m_pad_radarObjPort_par_out_local::TChangeableMemPool::_::_::_m_arrayPool::_0_::_elem::port_ens_r_obj_sensor_base::_::_m_movObjectInformation::_1_::STA_OBJECT_INFORMATION_ST::_::_m_ohyObjectType_st::_m_probObstacle_st::_m_probMobile_st::_m_prob1TwoWheelerN = 128;
//        @sysvar::XCP::RadarFL::_g_PlReCoFw_PlReCoPer_ObjBypassingRunnable_ObjBypassingRunnable_m_pad_radarObjPort_par_out_local::TChangeableMemPool::_::_::_m_arrayPool::_0_::_elem::port_ens_r_obj_sensor_base::_::_m_movObjectInformation::_1_::STA_OBJECT_INFORMATION_ST::_::_m_ohyObjectType_st::_m_probObstacle_st::_m_probMobile_st::_m_prob1UnknownN = 0;
//        @sysvar::XCP::RadarFL::_g_PlReCoFw_PlReCoPer_ObjBypassingRunnable_ObjBypassingRunnable_m_pad_radarObjPort_par_out_local::TChangeableMemPool::_::_::_m_arrayPool::_0_::_elem::port_ens_r_obj_sensor_base::_::_m_movObjectInformation::_1_::STA_OBJECT_INFORMATION_ST::_::_m_ohyObjectType_st::_m_probObstacle_st::_m_probMobile_st::_m_probFourPlusWheeler_st::_m_prob1PassengerCarN = 0;
//        @sysvar::XCP::RadarFL::_g_PlReCoFw_PlReCoPer_ObjBypassingRunnable_ObjBypassingRunnable_m_pad_radarObjPort_par_out_local::TChangeableMemPool::_::_::_m_arrayPool::_0_::_elem::port_ens_r_obj_sensor_base::_::_m_movObjectInformation::_1_::STA_OBJECT_INFORMATION_ST::_::_m_ohyObjectType_st::_m_probObstacle_st::_m_probMobile_st::_m_probFourPlusWheeler_st::_m_prob1TruckN = 0;
//        @sysvar::XCP::RadarFL::_g_PlReCoFw_PlReCoPer_ObjBypassingRunnable_ObjBypassingRunnable_m_pad_radarObjPort_par_out_local::TChangeableMemPool::_::_::_m_arrayPool::_0_::_elem::port_ens_r_obj_sensor_base::_::_m_movObjectInformation::_1_::STA_OBJECT_INFORMATION_ST::_::_m_ohyObjectType_st::_m_probObstacle_st::_m_probMobile_st::_m_probFourPlusWheeler_st::_m_prob1UnknownN = 128;
//        @sysvar::XCP::RadarFL::_g_PlReCoFw_PlReCoPer_ObjBypassingRunnable_ObjBypassingRunnable_m_pad_radarObjPort_par_out_local::TChangeableMemPool::_::_::_m_arrayPool::_0_::_elem::port_ens_r_obj_sensor_base::_::_m_movObjectInformation::_1_::STA_OBJECT_INFORMATION_ST::_::_m_ohyObjectType_st::_m_probObstacle_st::_m_probStationary_st::_m_prob1RoadsideBarrierN = 0;
//        @sysvar::XCP::RadarFL::_g_PlReCoFw_PlReCoPer_ObjBypassingRunnable_ObjBypassingRunnable_m_pad_radarObjPort_par_out_local::TChangeableMemPool::_::_::_m_arrayPool::_0_::_elem::port_ens_r_obj_sensor_base::_::_m_movObjectInformation::_1_::STA_OBJECT_INFORMATION_ST::_::_m_ohyObjectType_st::_m_probObstacle_st::_m_probStationary_st::_m_prob1UnknownN = 0;
//        @sysvar::XCP::RadarFL::_g_PlReCoFw_PlReCoPer_ObjBypassingRunnable_ObjBypassingRunnable_m_pad_radarObjPort_par_out_local::TChangeableMemPool::_::_::_m_arrayPool::_0_::_elem::port_ens_r_obj_sensor_base::_::_m_movObjectInformation::_1_::_m_dLengthN = 64;
//        @sysvar::XCP::RadarFL::_g_PlReCoFw_PlReCoPer_ObjBypassingRunnable_ObjBypassingRunnable_m_pad_radarObjPort_par_out_local::TChangeableMemPool::_::_::_m_arrayPool::_0_::_elem::port_ens_r_obj_sensor_base::_::_m_movObjectInformation::_1_::_m_dWidthN = @Classe_Obj_Sim::objdata.obj_width[1] * 128;
//        break;
//
//      case 4: //"Pedestrian"
//        @sysvar::XCP::RadarFL::_g_PlReCoFw_PlReCoPer_ObjBypassingRunnable_ObjBypassingRunnable_m_pad_radarObjPort_par_out_local::TChangeableMemPool::_::_::_m_arrayPool::_0_::_elem::port_ens_r_obj_sensor_base::_::_m_movObjectInformation::_1_::STA_OBJECT_INFORMATION_ST::_::_m_ohyObjectType_st::_m_prob1NonObstacleN = 0;
//        @sysvar::XCP::RadarFL::_g_PlReCoFw_PlReCoPer_ObjBypassingRunnable_ObjBypassingRunnable_m_pad_radarObjPort_par_out_local::TChangeableMemPool::_::_::_m_arrayPool::_0_::_elem::port_ens_r_obj_sensor_base::_::_m_movObjectInformation::_1_::STA_OBJECT_INFORMATION_ST::_::_m_ohyObjectType_st::_m_prob1ObstacleN = 128;
//        @sysvar::XCP::RadarFL::_g_PlReCoFw_PlReCoPer_ObjBypassingRunnable_ObjBypassingRunnable_m_pad_radarObjPort_par_out_local::TChangeableMemPool::_::_::_m_arrayPool::_0_::_elem::port_ens_r_obj_sensor_base::_::_m_movObjectInformation::_1_::STA_OBJECT_INFORMATION_ST::_::_m_ohyObjectType_st::_m_prob1UnknownN = 0;
//        @sysvar::XCP::RadarFL::_g_PlReCoFw_PlReCoPer_ObjBypassingRunnable_ObjBypassingRunnable_m_pad_radarObjPort_par_out_local::TChangeableMemPool::_::_::_m_arrayPool::_0_::_elem::port_ens_r_obj_sensor_base::_::_m_movObjectInformation::_1_::STA_OBJECT_INFORMATION_ST::_::_m_ohyObjectType_st::_m_probObstacle_st::_m_prob1UnknownN = 0;
//        @sysvar::XCP::RadarFL::_g_PlReCoFw_PlReCoPer_ObjBypassingRunnable_ObjBypassingRunnable_m_pad_radarObjPort_par_out_local::TChangeableMemPool::_::_::_m_arrayPool::_0_::_elem::port_ens_r_obj_sensor_base::_::_m_movObjectInformation::_1_::STA_OBJECT_INFORMATION_ST::_::_m_ohyObjectType_st::_m_probObstacle_st::_m_probMobile_st::_m_prob1FourPlusWheelerN = 0;
//        @sysvar::XCP::RadarFL::_g_PlReCoFw_PlReCoPer_ObjBypassingRunnable_ObjBypassingRunnable_m_pad_radarObjPort_par_out_local::TChangeableMemPool::_::_::_m_arrayPool::_0_::_elem::port_ens_r_obj_sensor_base::_::_m_movObjectInformation::_1_::STA_OBJECT_INFORMATION_ST::_::_m_ohyObjectType_st::_m_probObstacle_st::_m_probMobile_st::_m_prob1PedestrianN = 128;
//        @sysvar::XCP::RadarFL::_g_PlReCoFw_PlReCoPer_ObjBypassingRunnable_ObjBypassingRunnable_m_pad_radarObjPort_par_out_local::TChangeableMemPool::_::_::_m_arrayPool::_0_::_elem::port_ens_r_obj_sensor_base::_::_m_movObjectInformation::_1_::STA_OBJECT_INFORMATION_ST::_::_m_ohyObjectType_st::_m_probObstacle_st::_m_probMobile_st::_m_prob1TwoWheelerN = 0;
//        @sysvar::XCP::RadarFL::_g_PlReCoFw_PlReCoPer_ObjBypassingRunnable_ObjBypassingRunnable_m_pad_radarObjPort_par_out_local::TChangeableMemPool::_::_::_m_arrayPool::_0_::_elem::port_ens_r_obj_sensor_base::_::_m_movObjectInformation::_1_::STA_OBJECT_INFORMATION_ST::_::_m_ohyObjectType_st::_m_probObstacle_st::_m_probMobile_st::_m_prob1UnknownN = 0;
//        @sysvar::XCP::RadarFL::_g_PlReCoFw_PlReCoPer_ObjBypassingRunnable_ObjBypassingRunnable_m_pad_radarObjPort_par_out_local::TChangeableMemPool::_::_::_m_arrayPool::_0_::_elem::port_ens_r_obj_sensor_base::_::_m_movObjectInformation::_1_::STA_OBJECT_INFORMATION_ST::_::_m_ohyObjectType_st::_m_probObstacle_st::_m_probMobile_st::_m_probFourPlusWheeler_st::_m_prob1PassengerCarN = 0;
//        @sysvar::XCP::RadarFL::_g_PlReCoFw_PlReCoPer_ObjBypassingRunnable_ObjBypassingRunnable_m_pad_radarObjPort_par_out_local::TChangeableMemPool::_::_::_m_arrayPool::_0_::_elem::port_ens_r_obj_sensor_base::_::_m_movObjectInformation::_1_::STA_OBJECT_INFORMATION_ST::_::_m_ohyObjectType_st::_m_probObstacle_st::_m_probMobile_st::_m_probFourPlusWheeler_st::_m_prob1TruckN = 0;
//        @sysvar::XCP::RadarFL::_g_PlReCoFw_PlReCoPer_ObjBypassingRunnable_ObjBypassingRunnable_m_pad_radarObjPort_par_out_local::TChangeableMemPool::_::_::_m_arrayPool::_0_::_elem::port_ens_r_obj_sensor_base::_::_m_movObjectInformation::_1_::STA_OBJECT_INFORMATION_ST::_::_m_ohyObjectType_st::_m_probObstacle_st::_m_probMobile_st::_m_probFourPlusWheeler_st::_m_prob1UnknownN = 128;
//        @sysvar::XCP::RadarFL::_g_PlReCoFw_PlReCoPer_ObjBypassingRunnable_ObjBypassingRunnable_m_pad_radarObjPort_par_out_local::TChangeableMemPool::_::_::_m_arrayPool::_0_::_elem::port_ens_r_obj_sensor_base::_::_m_movObjectInformation::_1_::STA_OBJECT_INFORMATION_ST::_::_m_ohyObjectType_st::_m_probObstacle_st::_m_probStationary_st::_m_prob1RoadsideBarrierN = 0;
//        @sysvar::XCP::RadarFL::_g_PlReCoFw_PlReCoPer_ObjBypassingRunnable_ObjBypassingRunnable_m_pad_radarObjPort_par_out_local::TChangeableMemPool::_::_::_m_arrayPool::_0_::_elem::port_ens_r_obj_sensor_base::_::_m_movObjectInformation::_1_::STA_OBJECT_INFORMATION_ST::_::_m_ohyObjectType_st::_m_probObstacle_st::_m_probStationary_st::_m_prob1UnknownN = 0;
//        @sysvar::XCP::RadarFL::_g_PlReCoFw_PlReCoPer_ObjBypassingRunnable_ObjBypassingRunnable_m_pad_radarObjPort_par_out_local::TChangeableMemPool::_::_::_m_arrayPool::_0_::_elem::port_ens_r_obj_sensor_base::_::_m_movObjectInformation::_1_::_m_dLengthN = 64;
//        @sysvar::XCP::RadarFL::_g_PlReCoFw_PlReCoPer_ObjBypassingRunnable_ObjBypassingRunnable_m_pad_radarObjPort_par_out_local::TChangeableMemPool::_::_::_m_arrayPool::_0_::_elem::port_ens_r_obj_sensor_base::_::_m_movObjectInformation::_1_::_m_dWidthN = @Classe_Obj_Sim::objdata.obj_width[1] * 128;
//        break;
//
//      case 5: //"Truck"
//        @sysvar::XCP::RadarFL::_g_PlReCoFw_PlReCoPer_ObjBypassingRunnable_ObjBypassingRunnable_m_pad_radarObjPort_par_out_local::TChangeableMemPool::_::_::_m_arrayPool::_0_::_elem::port_ens_r_obj_sensor_base::_::_m_movObjectInformation::_1_::STA_OBJECT_INFORMATION_ST::_::_m_ohyObjectType_st::_m_prob1NonObstacleN = 0;
//        @sysvar::XCP::RadarFL::_g_PlReCoFw_PlReCoPer_ObjBypassingRunnable_ObjBypassingRunnable_m_pad_radarObjPort_par_out_local::TChangeableMemPool::_::_::_m_arrayPool::_0_::_elem::port_ens_r_obj_sensor_base::_::_m_movObjectInformation::_1_::STA_OBJECT_INFORMATION_ST::_::_m_ohyObjectType_st::_m_prob1ObstacleN = 128;
//        @sysvar::XCP::RadarFL::_g_PlReCoFw_PlReCoPer_ObjBypassingRunnable_ObjBypassingRunnable_m_pad_radarObjPort_par_out_local::TChangeableMemPool::_::_::_m_arrayPool::_0_::_elem::port_ens_r_obj_sensor_base::_::_m_movObjectInformation::_1_::STA_OBJECT_INFORMATION_ST::_::_m_ohyObjectType_st::_m_prob1UnknownN = 0;
//        @sysvar::XCP::RadarFL::_g_PlReCoFw_PlReCoPer_ObjBypassingRunnable_ObjBypassingRunnable_m_pad_radarObjPort_par_out_local::TChangeableMemPool::_::_::_m_arrayPool::_0_::_elem::port_ens_r_obj_sensor_base::_::_m_movObjectInformation::_1_::STA_OBJECT_INFORMATION_ST::_::_m_ohyObjectType_st::_m_probObstacle_st::_m_prob1UnknownN = 0;
//        @sysvar::XCP::RadarFL::_g_PlReCoFw_PlReCoPer_ObjBypassingRunnable_ObjBypassingRunnable_m_pad_radarObjPort_par_out_local::TChangeableMemPool::_::_::_m_arrayPool::_0_::_elem::port_ens_r_obj_sensor_base::_::_m_movObjectInformation::_1_::STA_OBJECT_INFORMATION_ST::_::_m_ohyObjectType_st::_m_probObstacle_st::_m_probMobile_st::_m_prob1FourPlusWheelerN = 128;
//        @sysvar::XCP::RadarFL::_g_PlReCoFw_PlReCoPer_ObjBypassingRunnable_ObjBypassingRunnable_m_pad_radarObjPort_par_out_local::TChangeableMemPool::_::_::_m_arrayPool::_0_::_elem::port_ens_r_obj_sensor_base::_::_m_movObjectInformation::_1_::STA_OBJECT_INFORMATION_ST::_::_m_ohyObjectType_st::_m_probObstacle_st::_m_probMobile_st::_m_prob1PedestrianN = 0;
//        @sysvar::XCP::RadarFL::_g_PlReCoFw_PlReCoPer_ObjBypassingRunnable_ObjBypassingRunnable_m_pad_radarObjPort_par_out_local::TChangeableMemPool::_::_::_m_arrayPool::_0_::_elem::port_ens_r_obj_sensor_base::_::_m_movObjectInformation::_1_::STA_OBJECT_INFORMATION_ST::_::_m_ohyObjectType_st::_m_probObstacle_st::_m_probMobile_st::_m_prob1TwoWheelerN = 0;
//        @sysvar::XCP::RadarFL::_g_PlReCoFw_PlReCoPer_ObjBypassingRunnable_ObjBypassingRunnable_m_pad_radarObjPort_par_out_local::TChangeableMemPool::_::_::_m_arrayPool::_0_::_elem::port_ens_r_obj_sensor_base::_::_m_movObjectInformation::_1_::STA_OBJECT_INFORMATION_ST::_::_m_ohyObjectType_st::_m_probObstacle_st::_m_probMobile_st::_m_prob1UnknownN = 0;
//        @sysvar::XCP::RadarFL::_g_PlReCoFw_PlReCoPer_ObjBypassingRunnable_ObjBypassingRunnable_m_pad_radarObjPort_par_out_local::TChangeableMemPool::_::_::_m_arrayPool::_0_::_elem::port_ens_r_obj_sensor_base::_::_m_movObjectInformation::_1_::STA_OBJECT_INFORMATION_ST::_::_m_ohyObjectType_st::_m_probObstacle_st::_m_probMobile_st::_m_probFourPlusWheeler_st::_m_prob1PassengerCarN = 0;
//        @sysvar::XCP::RadarFL::_g_PlReCoFw_PlReCoPer_ObjBypassingRunnable_ObjBypassingRunnable_m_pad_radarObjPort_par_out_local::TChangeableMemPool::_::_::_m_arrayPool::_0_::_elem::port_ens_r_obj_sensor_base::_::_m_movObjectInformation::_1_::STA_OBJECT_INFORMATION_ST::_::_m_ohyObjectType_st::_m_probObstacle_st::_m_probMobile_st::_m_probFourPlusWheeler_st::_m_prob1TruckN = 128;
//        @sysvar::XCP::RadarFL::_g_PlReCoFw_PlReCoPer_ObjBypassingRunnable_ObjBypassingRunnable_m_pad_radarObjPort_par_out_local::TChangeableMemPool::_::_::_m_arrayPool::_0_::_elem::port_ens_r_obj_sensor_base::_::_m_movObjectInformation::_1_::STA_OBJECT_INFORMATION_ST::_::_m_ohyObjectType_st::_m_probObstacle_st::_m_probMobile_st::_m_probFourPlusWheeler_st::_m_prob1UnknownN = 0;
//        @sysvar::XCP::RadarFL::_g_PlReCoFw_PlReCoPer_ObjBypassingRunnable_ObjBypassingRunnable_m_pad_radarObjPort_par_out_local::TChangeableMemPool::_::_::_m_arrayPool::_0_::_elem::port_ens_r_obj_sensor_base::_::_m_movObjectInformation::_1_::STA_OBJECT_INFORMATION_ST::_::_m_ohyObjectType_st::_m_probObstacle_st::_m_probStationary_st::_m_prob1RoadsideBarrierN = 0;
//        @sysvar::XCP::RadarFL::_g_PlReCoFw_PlReCoPer_ObjBypassingRunnable_ObjBypassingRunnable_m_pad_radarObjPort_par_out_local::TChangeableMemPool::_::_::_m_arrayPool::_0_::_elem::port_ens_r_obj_sensor_base::_::_m_movObjectInformation::_1_::STA_OBJECT_INFORMATION_ST::_::_m_ohyObjectType_st::_m_probObstacle_st::_m_probStationary_st::_m_prob1UnknownN = 0;
//        @sysvar::XCP::RadarFL::_g_PlReCoFw_PlReCoPer_ObjBypassingRunnable_ObjBypassingRunnable_m_pad_radarObjPort_par_out_local::TChangeableMemPool::_::_::_m_arrayPool::_0_::_elem::port_ens_r_obj_sensor_base::_::_m_movObjectInformation::_1_::_m_dLengthN = 64;
//        @sysvar::XCP::RadarFL::_g_PlReCoFw_PlReCoPer_ObjBypassingRunnable_ObjBypassingRunnable_m_pad_radarObjPort_par_out_local::TChangeableMemPool::_::_::_m_arrayPool::_0_::_elem::port_ens_r_obj_sensor_base::_::_m_movObjectInformation::_1_::_m_dWidthN = @Classe_Obj_Sim::objdata.obj_width[1] * 128;
//        break;
//
//      case 6: //"PassengerCar"
//        @sysvar::XCP::RadarFL::_g_PlReCoFw_PlReCoPer_ObjBypassingRunnable_ObjBypassingRunnable_m_pad_radarObjPort_par_out_local::TChangeableMemPool::_::_::_m_arrayPool::_0_::_elem::port_ens_r_obj_sensor_base::_::_m_movObjectInformation::_1_::STA_OBJECT_INFORMATION_ST::_::_m_ohyObjectType_st::_m_prob1NonObstacleN = 0;
//        @sysvar::XCP::RadarFL::_g_PlReCoFw_PlReCoPer_ObjBypassingRunnable_ObjBypassingRunnable_m_pad_radarObjPort_par_out_local::TChangeableMemPool::_::_::_m_arrayPool::_0_::_elem::port_ens_r_obj_sensor_base::_::_m_movObjectInformation::_1_::STA_OBJECT_INFORMATION_ST::_::_m_ohyObjectType_st::_m_prob1ObstacleN = 128;
//        @sysvar::XCP::RadarFL::_g_PlReCoFw_PlReCoPer_ObjBypassingRunnable_ObjBypassingRunnable_m_pad_radarObjPort_par_out_local::TChangeableMemPool::_::_::_m_arrayPool::_0_::_elem::port_ens_r_obj_sensor_base::_::_m_movObjectInformation::_1_::STA_OBJECT_INFORMATION_ST::_::_m_ohyObjectType_st::_m_prob1UnknownN = 0;
//        @sysvar::XCP::RadarFL::_g_PlReCoFw_PlReCoPer_ObjBypassingRunnable_ObjBypassingRunnable_m_pad_radarObjPort_par_out_local::TChangeableMemPool::_::_::_m_arrayPool::_0_::_elem::port_ens_r_obj_sensor_base::_::_m_movObjectInformation::_1_::STA_OBJECT_INFORMATION_ST::_::_m_ohyObjectType_st::_m_probObstacle_st::_m_prob1UnknownN = 0;
//        @sysvar::XCP::RadarFL::_g_PlReCoFw_PlReCoPer_ObjBypassingRunnable_ObjBypassingRunnable_m_pad_radarObjPort_par_out_local::TChangeableMemPool::_::_::_m_arrayPool::_0_::_elem::port_ens_r_obj_sensor_base::_::_m_movObjectInformation::_1_::STA_OBJECT_INFORMATION_ST::_::_m_ohyObjectType_st::_m_probObstacle_st::_m_probMobile_st::_m_prob1FourPlusWheelerN = 128;
//        @sysvar::XCP::RadarFL::_g_PlReCoFw_PlReCoPer_ObjBypassingRunnable_ObjBypassingRunnable_m_pad_radarObjPort_par_out_local::TChangeableMemPool::_::_::_m_arrayPool::_0_::_elem::port_ens_r_obj_sensor_base::_::_m_movObjectInformation::_1_::STA_OBJECT_INFORMATION_ST::_::_m_ohyObjectType_st::_m_probObstacle_st::_m_probMobile_st::_m_prob1PedestrianN = 0;
//        @sysvar::XCP::RadarFL::_g_PlReCoFw_PlReCoPer_ObjBypassingRunnable_ObjBypassingRunnable_m_pad_radarObjPort_par_out_local::TChangeableMemPool::_::_::_m_arrayPool::_0_::_elem::port_ens_r_obj_sensor_base::_::_m_movObjectInformation::_1_::STA_OBJECT_INFORMATION_ST::_::_m_ohyObjectType_st::_m_probObstacle_st::_m_probMobile_st::_m_prob1TwoWheelerN = 0;
//        @sysvar::XCP::RadarFL::_g_PlReCoFw_PlReCoPer_ObjBypassingRunnable_ObjBypassingRunnable_m_pad_radarObjPort_par_out_local::TChangeableMemPool::_::_::_m_arrayPool::_0_::_elem::port_ens_r_obj_sensor_base::_::_m_movObjectInformation::_1_::STA_OBJECT_INFORMATION_ST::_::_m_ohyObjectType_st::_m_probObstacle_st::_m_probMobile_st::_m_prob1UnknownN = 0;
//        @sysvar::XCP::RadarFL::_g_PlReCoFw_PlReCoPer_ObjBypassingRunnable_ObjBypassingRunnable_m_pad_radarObjPort_par_out_local::TChangeableMemPool::_::_::_m_arrayPool::_0_::_elem::port_ens_r_obj_sensor_base::_::_m_movObjectInformation::_1_::STA_OBJECT_INFORMATION_ST::_::_m_ohyObjectType_st::_m_probObstacle_st::_m_probMobile_st::_m_probFourPlusWheeler_st::_m_prob1PassengerCarN = 128;
//        @sysvar::XCP::RadarFL::_g_PlReCoFw_PlReCoPer_ObjBypassingRunnable_ObjBypassingRunnable_m_pad_radarObjPort_par_out_local::TChangeableMemPool::_::_::_m_arrayPool::_0_::_elem::port_ens_r_obj_sensor_base::_::_m_movObjectInformation::_1_::STA_OBJECT_INFORMATION_ST::_::_m_ohyObjectType_st::_m_probObstacle_st::_m_probMobile_st::_m_probFourPlusWheeler_st::_m_prob1TruckN = 0;
//        @sysvar::XCP::RadarFL::_g_PlReCoFw_PlReCoPer_ObjBypassingRunnable_ObjBypassingRunnable_m_pad_radarObjPort_par_out_local::TChangeableMemPool::_::_::_m_arrayPool::_0_::_elem::port_ens_r_obj_sensor_base::_::_m_movObjectInformation::_1_::STA_OBJECT_INFORMATION_ST::_::_m_ohyObjectType_st::_m_probObstacle_st::_m_probMobile_st::_m_probFourPlusWheeler_st::_m_prob1UnknownN = 0;
//        @sysvar::XCP::RadarFL::_g_PlReCoFw_PlReCoPer_ObjBypassingRunnable_ObjBypassingRunnable_m_pad_radarObjPort_par_out_local::TChangeableMemPool::_::_::_m_arrayPool::_0_::_elem::port_ens_r_obj_sensor_base::_::_m_movObjectInformation::_1_::STA_OBJECT_INFORMATION_ST::_::_m_ohyObjectType_st::_m_probObstacle_st::_m_probStationary_st::_m_prob1RoadsideBarrierN = 0;
//        @sysvar::XCP::RadarFL::_g_PlReCoFw_PlReCoPer_ObjBypassingRunnable_ObjBypassingRunnable_m_pad_radarObjPort_par_out_local::TChangeableMemPool::_::_::_m_arrayPool::_0_::_elem::port_ens_r_obj_sensor_base::_::_m_movObjectInformation::_1_::STA_OBJECT_INFORMATION_ST::_::_m_ohyObjectType_st::_m_probObstacle_st::_m_probStationary_st::_m_prob1UnknownN = 0;
//        @sysvar::XCP::RadarFL::_g_PlReCoFw_PlReCoPer_ObjBypassingRunnable_ObjBypassingRunnable_m_pad_radarObjPort_par_out_local::TChangeableMemPool::_::_::_m_arrayPool::_0_::_elem::port_ens_r_obj_sensor_base::_::_m_movObjectInformation::_1_::_m_dLengthN = 64;
//        @sysvar::XCP::RadarFL::_g_PlReCoFw_PlReCoPer_ObjBypassingRunnable_ObjBypassingRunnable_m_pad_radarObjPort_par_out_local::TChangeableMemPool::_::_::_m_arrayPool::_0_::_elem::port_ens_r_obj_sensor_base::_::_m_movObjectInformation::_1_::_m_dWidthN = @Classe_Obj_Sim::objdata.obj_width[1] * 128;
//        break;
//    }
//    break;
  }
}