/*@!Encoding:1252*/
/**
 * @file Road_Obj_FRadar_XCP.cin
 * @author ADAS_HIL_TEAM
 * @date 10-04-2022
 * @brief  Handles Radar object injection into XCP
 *
 * ################################################################
 * C O P Y R I G H T S
 * ----------------------------------------------------------------
 * Copyright (c) 2022-2023 by Robert Bosch GmbH. All rights reserved.
 
 * The reproduction, distribution and utilization of this file as
 * well as the communication of its contents to others without express
 * authorization is prohibited. Offenders will be held liable for the
 * payment of damages. All rights reserved in the event of the grant
 * of a patent, utility model or design.
 *
 * ################################################################
*/

includes
{
}

variables
{
  /*
Integers in form of
byte (unsigned, 1 Byte)
word (unsigned, 2 Byte)
dword (unsigned, 4 Byte)
int (signed, 2 Byte)
long (signed, 4 Byte)
int64(signed, 8 Byte)
qword(unsigned, 8 Byte)
Individual character
char (1 Byte)
Floating point numbers
float (8 Byte)
double (8 Byte)
*/  
}

/** @brief Injects calculated location data stored in the target_radar_fc_sim arrays.
  * @param object_id ID of the location that shall be injected.
  * @return void
  */
void obj_sim_update_fradar_xcp(byte object_id)
{
  //header
@sysvar::XCP::RadarFC_Obj::_g_PL_AD_fw_Radar_1R1V_rpc_XilObjBypassingRunnable_XilObjBypassingRunnable_m_pad_radarObjPort_par_out_local::TChangeableMemPool::_::_::_m_arrayPool::_0_::_elem::_m_alignment::_m_alpAzimuthAngOffsetN = -1146;
@sysvar::XCP::RadarFC_Obj::_g_PL_AD_fw_Radar_1R1V_rpc_XilObjBypassingRunnable_XilObjBypassingRunnable_m_pad_radarObjPort_par_out_local::TChangeableMemPool::_::_::_m_arrayPool::_0_::_elem::_m_alignment::_m_alpMountAngleN = 0;
@sysvar::XCP::RadarFC_Obj::_g_PL_AD_fw_Radar_1R1V_rpc_XilObjBypassingRunnable_XilObjBypassingRunnable_m_pad_radarObjPort_par_out_local::TChangeableMemPool::_::_::_m_arrayPool::_0_::_elem::_m_alignment::_m_dLongitudinalOffsetRearAxisN = 455;
@sysvar::XCP::RadarFC_Obj::_g_PL_AD_fw_Radar_1R1V_rpc_XilObjBypassingRunnable_XilObjBypassingRunnable_m_pad_radarObjPort_par_out_local::TChangeableMemPool::_::_::_m_arrayPool::_0_::_elem::_m_alignment::_m_dMountElevationN = 20;
@sysvar::XCP::RadarFC_Obj::_g_PL_AD_fw_Radar_1R1V_rpc_XilObjBypassingRunnable_XilObjBypassingRunnable_m_pad_radarObjPort_par_out_local::TChangeableMemPool::_::_::_m_arrayPool::_0_::_elem::_m_alignment::_m_dMountOffsetN = 0;

  switch (@target_radar_fc_sim::objdata.obj_id[object_id])
  {
    case 0: //"Object-0"
    //constant
  @sysvar::XCP::RadarFC_Obj::_g_PL_AD_fw_Radar_1R1V_rpc_XilObjBypassingRunnable_XilObjBypassingRunnable_m_pad_radarObjPort_par_out_local::TChangeableMemPool::_::_::_m_arrayPool::_0_::_elem::_m_objectInformation::_0_::_Valid_b = 1;
  @sysvar::XCP::RadarFC_Obj::_g_PL_AD_fw_Radar_1R1V_rpc_XilObjBypassingRunnable_XilObjBypassingRunnable_m_pad_radarObjPort_par_out_local::TChangeableMemPool::_::_::_m_arrayPool::_0_::_elem::_m_objectInformation::_0_::_m_HandleN = 1;
  @sysvar::XCP::RadarFC_Obj::_g_PL_AD_fw_Radar_1R1V_rpc_XilObjBypassingRunnable_XilObjBypassingRunnable_m_pad_radarObjPort_par_out_local::TChangeableMemPool::_::_::_m_arrayPool::_0_::_elem::_m_objectInformation::_0_::_m_alpPiVarYawAngleN = 0;
  @sysvar::XCP::RadarFC_Obj::_g_PL_AD_fw_Radar_1R1V_rpc_XilObjBypassingRunnable_XilObjBypassingRunnable_m_pad_radarObjPort_par_out_local::TChangeableMemPool::_::_::_m_arrayPool::_0_::_elem::_m_objectInformation::_0_::_m_alpPiYawAngleN = 0;
  @sysvar::XCP::RadarFC_Obj::_g_PL_AD_fw_Radar_1R1V_rpc_XilObjBypassingRunnable_XilObjBypassingRunnable_m_pad_radarObjPort_par_out_local::TChangeableMemPool::_::_::_m_arrayPool::_0_::_elem::_m_objectInformation::_0_::_m_varAxN = 0;
  @sysvar::XCP::RadarFC_Obj::_g_PL_AD_fw_Radar_1R1V_rpc_XilObjBypassingRunnable_XilObjBypassingRunnable_m_pad_radarObjPort_par_out_local::TChangeableMemPool::_::_::_m_arrayPool::_0_::_elem::_m_objectInformation::_0_::_m_varAyN = 0;
  @sysvar::XCP::RadarFC_Obj::_g_PL_AD_fw_Radar_1R1V_rpc_XilObjBypassingRunnable_XilObjBypassingRunnable_m_pad_radarObjPort_par_out_local::TChangeableMemPool::_::_::_m_arrayPool::_0_::_elem::_m_objectInformation::_0_::_m_varVxN = 0;
  @sysvar::XCP::RadarFC_Obj::_g_PL_AD_fw_Radar_1R1V_rpc_XilObjBypassingRunnable_XilObjBypassingRunnable_m_pad_radarObjPort_par_out_local::TChangeableMemPool::_::_::_m_arrayPool::_0_::_elem::_m_objectInformation::_0_::_m_varVyN = 0;
  @sysvar::XCP::RadarFC_Obj::_g_PL_AD_fw_Radar_1R1V_rpc_XilObjBypassingRunnable_XilObjBypassingRunnable_m_pad_radarObjPort_par_out_local::TChangeableMemPool::_::_::_m_arrayPool::_0_::_elem::_m_objectInformation::_0_::_m_varDxN = 0;
  @sysvar::XCP::RadarFC_Obj::_g_PL_AD_fw_Radar_1R1V_rpc_XilObjBypassingRunnable_XilObjBypassingRunnable_m_pad_radarObjPort_par_out_local::TChangeableMemPool::_::_::_m_arrayPool::_0_::_elem::_m_objectInformation::_0_::_m_varDyN = 0;
  @sysvar::XCP::RadarFC_Obj::_g_PL_AD_fw_Radar_1R1V_rpc_XilObjBypassingRunnable_XilObjBypassingRunnable_m_pad_radarObjPort_par_out_local::TChangeableMemPool::_::_::_m_arrayPool::_0_::_elem::_m_objectInformation::_0_::_m_dVarLengthN = 0;
  @sysvar::XCP::RadarFC_Obj::_g_PL_AD_fw_Radar_1R1V_rpc_XilObjBypassingRunnable_XilObjBypassingRunnable_m_pad_radarObjPort_par_out_local::TChangeableMemPool::_::_::_m_arrayPool::_0_::_elem::_m_objectInformation::_0_::_m_dVarWidthN = 0;
  @sysvar::XCP::RadarFC_Obj::_g_PL_AD_fw_Radar_1R1V_rpc_XilObjBypassingRunnable_XilObjBypassingRunnable_m_pad_radarObjPort_par_out_local::TChangeableMemPool::_::_::_m_arrayPool::_0_::_elem::_m_objectInformation::_0_::_m_wExistProbN = 64880;
  @sysvar::XCP::RadarFC_Obj::_g_PL_AD_fw_Radar_1R1V_rpc_XilObjBypassingRunnable_XilObjBypassingRunnable_m_pad_radarObjPort_par_out_local::TChangeableMemPool::_::_::_m_arrayPool::_0_::_elem::_m_objectInformation::_0_::_m_isObjectAsil = 1;
  @sysvar::XCP::RadarFC_Obj::_g_PL_AD_fw_Radar_1R1V_rpc_XilObjBypassingRunnable_XilObjBypassingRunnable_m_pad_radarObjPort_par_out_local::TChangeableMemPool::_::_::_m_arrayPool::_0_::_elem::_m_objectInformation::_0_::_m_dLengthN = 128;//dllGetRadarFCInputObjectLength(@hil_ctrl::Handle_RoadObj, 0) * 128;

    //target movement

  @sysvar::XCP::RadarFC_Obj::_g_PL_AD_fw_Radar_1R1V_rpc_XilObjBypassingRunnable_XilObjBypassingRunnable_m_pad_radarObjPort_par_out_local::TChangeableMemPool::_::_::_m_arrayPool::_0_::_elem::_m_objectInformation::_0_::_m_dxN = dllGetRadarFCInputObjectDistX(@hil_ctrl::Handle_RoadObj, 0) * 128; //dllGetRadarFCObjDistX(@hil_ctrl::Handle_RoadObj, 0) * 128;
  @sysvar::XCP::RadarFC_Obj::_g_PL_AD_fw_Radar_1R1V_rpc_XilObjBypassingRunnable_XilObjBypassingRunnable_m_pad_radarObjPort_par_out_local::TChangeableMemPool::_::_::_m_arrayPool::_0_::_elem::_m_objectInformation::_0_::_m_dyN = dllGetRadarFCInputObjectDistY(@hil_ctrl::Handle_RoadObj, 0) * 128; //dllGetRadarFCObjDistY(@hil_ctrl::Handle_RoadObj, 0) * 128;
  @sysvar::XCP::RadarFC_Obj::_g_PL_AD_fw_Radar_1R1V_rpc_XilObjBypassingRunnable_XilObjBypassingRunnable_m_pad_radarObjPort_par_out_local::TChangeableMemPool::_::_::_m_arrayPool::_0_::_elem::_m_objectInformation::_0_::_m_dzN = 0;
  @sysvar::XCP::RadarFC_Obj::_g_PL_AD_fw_Radar_1R1V_rpc_XilObjBypassingRunnable_XilObjBypassingRunnable_m_pad_radarObjPort_par_out_local::TChangeableMemPool::_::_::_m_arrayPool::_0_::_elem::_m_objectInformation::_0_::_m_vxN = dllGetRadarFCInputObjectVelX(@hil_ctrl::Handle_RoadObj, 0) * 256;
  @sysvar::XCP::RadarFC_Obj::_g_PL_AD_fw_Radar_1R1V_rpc_XilObjBypassingRunnable_XilObjBypassingRunnable_m_pad_radarObjPort_par_out_local::TChangeableMemPool::_::_::_m_arrayPool::_0_::_elem::_m_objectInformation::_0_::_m_vyN = dllGetRadarFCInputObjectVelY(@hil_ctrl::Handle_RoadObj, 0) * 256;
  @sysvar::XCP::RadarFC_Obj::_g_PL_AD_fw_Radar_1R1V_rpc_XilObjBypassingRunnable_XilObjBypassingRunnable_m_pad_radarObjPort_par_out_local::TChangeableMemPool::_::_::_m_arrayPool::_0_::_elem::_m_objectInformation::_0_::_m_axN = 0;
  @sysvar::XCP::RadarFC_Obj::_g_PL_AD_fw_Radar_1R1V_rpc_XilObjBypassingRunnable_XilObjBypassingRunnable_m_pad_radarObjPort_par_out_local::TChangeableMemPool::_::_::_m_arrayPool::_0_::_elem::_m_objectInformation::_0_::_m_ayN = 0;

    //target object moving or not
    if (abs(dllGetRadarFCInputObjectVelX(@hil_ctrl::Handle_RoadObj, 0)) != 0)
    {
    @sysvar::XCP::RadarFC_Obj::_g_PL_AD_fw_Radar_1R1V_rpc_XilObjBypassingRunnable_XilObjBypassingRunnable_m_pad_radarObjPort_par_out_local::TChangeableMemPool::_::_::_m_arrayPool::_0_::_elem::_m_objectInformation::_0_::_m_prob1HasBeenObservedMovingN = 126;
    @sysvar::XCP::RadarFC_Obj::_g_PL_AD_fw_Radar_1R1V_rpc_XilObjBypassingRunnable_XilObjBypassingRunnable_m_pad_radarObjPort_par_out_local::TChangeableMemPool::_::_::_m_arrayPool::_0_::_elem::_m_objectInformation::_0_::_m_prob1MovingN = 126;
    }
    else
    {
    @sysvar::XCP::RadarFC_Obj::_g_PL_AD_fw_Radar_1R1V_rpc_XilObjBypassingRunnable_XilObjBypassingRunnable_m_pad_radarObjPort_par_out_local::TChangeableMemPool::_::_::_m_arrayPool::_0_::_elem::_m_objectInformation::_0_::_m_prob1HasBeenObservedMovingN = 0;
    @sysvar::XCP::RadarFC_Obj::_g_PL_AD_fw_Radar_1R1V_rpc_XilObjBypassingRunnable_XilObjBypassingRunnable_m_pad_radarObjPort_par_out_local::TChangeableMemPool::_::_::_m_arrayPool::_0_::_elem::_m_objectInformation::_0_::_m_prob1MovingN = 0;
    }

      //object classification
    switch (dllGetRadarFCInputObjectType(@hil_ctrl::Handle_RoadObj, 0))
    {
      case 0: //"Non-Obstacle"
      @sysvar::XCP::RadarFC_Obj::_g_PL_AD_fw_Radar_1R1V_rpc_XilObjBypassingRunnable_XilObjBypassingRunnable_m_pad_radarObjPort_par_out_local::TChangeableMemPool::_::_::_m_arrayPool::_0_::_elem::_m_objectInformation::_0_::_m_perObjectType::_m_prob1ObstacleN = 0;
      @sysvar::XCP::RadarFC_Obj::_g_PL_AD_fw_Radar_1R1V_rpc_XilObjBypassingRunnable_XilObjBypassingRunnable_m_pad_radarObjPort_par_out_local::TChangeableMemPool::_::_::_m_arrayPool::_0_::_elem::_m_objectInformation::_0_::_m_perObjectType::_m_prob1NonObstacleN = 128;
      @sysvar::XCP::RadarFC_Obj::_g_PL_AD_fw_Radar_1R1V_rpc_XilObjBypassingRunnable_XilObjBypassingRunnable_m_pad_radarObjPort_par_out_local::TChangeableMemPool::_::_::_m_arrayPool::_0_::_elem::_m_objectInformation::_0_::_m_perObjectType::_m_prob1UnknownN = 0;
      @sysvar::XCP::RadarFC_Obj::_g_PL_AD_fw_Radar_1R1V_rpc_XilObjBypassingRunnable_XilObjBypassingRunnable_m_pad_radarObjPort_par_out_local::TChangeableMemPool::_::_::_m_arrayPool::_0_::_elem::_m_objectInformation::_0_::_m_perObjectType::_m_prob1MobileN = 0;
      @sysvar::XCP::RadarFC_Obj::_g_PL_AD_fw_Radar_1R1V_rpc_XilObjBypassingRunnable_XilObjBypassingRunnable_m_pad_radarObjPort_par_out_local::TChangeableMemPool::_::_::_m_arrayPool::_0_::_elem::_m_objectInformation::_0_::_m_perObjectType::_m_prob1StationaryN = 0;
      @sysvar::XCP::RadarFC_Obj::_g_PL_AD_fw_Radar_1R1V_rpc_XilObjBypassingRunnable_XilObjBypassingRunnable_m_pad_radarObjPort_par_out_local::TChangeableMemPool::_::_::_m_arrayPool::_0_::_elem::_m_objectInformation::_0_::_m_perObjectType::_m_prob1ObstUnknownN = 128;
      @sysvar::XCP::RadarFC_Obj::_g_PL_AD_fw_Radar_1R1V_rpc_XilObjBypassingRunnable_XilObjBypassingRunnable_m_pad_radarObjPort_par_out_local::TChangeableMemPool::_::_::_m_arrayPool::_0_::_elem::_m_objectInformation::_0_::_m_perObjectType::_m_prob1FourPlusWheelerN = 0;
      @sysvar::XCP::RadarFC_Obj::_g_PL_AD_fw_Radar_1R1V_rpc_XilObjBypassingRunnable_XilObjBypassingRunnable_m_pad_radarObjPort_par_out_local::TChangeableMemPool::_::_::_m_arrayPool::_0_::_elem::_m_objectInformation::_0_::_m_perObjectType::_m_prob1TwoWheelerN = 0;
      @sysvar::XCP::RadarFC_Obj::_g_PL_AD_fw_Radar_1R1V_rpc_XilObjBypassingRunnable_XilObjBypassingRunnable_m_pad_radarObjPort_par_out_local::TChangeableMemPool::_::_::_m_arrayPool::_0_::_elem::_m_objectInformation::_0_::_m_perObjectType::_m_prob1PedestrianN = 0;
      @sysvar::XCP::RadarFC_Obj::_g_PL_AD_fw_Radar_1R1V_rpc_XilObjBypassingRunnable_XilObjBypassingRunnable_m_pad_radarObjPort_par_out_local::TChangeableMemPool::_::_::_m_arrayPool::_0_::_elem::_m_objectInformation::_0_::_m_perObjectType::_m_prob1MovUnknownN = 128;
      @sysvar::XCP::RadarFC_Obj::_g_PL_AD_fw_Radar_1R1V_rpc_XilObjBypassingRunnable_XilObjBypassingRunnable_m_pad_radarObjPort_par_out_local::TChangeableMemPool::_::_::_m_arrayPool::_0_::_elem::_m_objectInformation::_0_::_m_perObjectType::_m_prob1RoadsideBarrierN = 0;
      @sysvar::XCP::RadarFC_Obj::_g_PL_AD_fw_Radar_1R1V_rpc_XilObjBypassingRunnable_XilObjBypassingRunnable_m_pad_radarObjPort_par_out_local::TChangeableMemPool::_::_::_m_arrayPool::_0_::_elem::_m_objectInformation::_0_::_m_perObjectType::_m_prob1StatUnknownN = 128;
      @sysvar::XCP::RadarFC_Obj::_g_PL_AD_fw_Radar_1R1V_rpc_XilObjBypassingRunnable_XilObjBypassingRunnable_m_pad_radarObjPort_par_out_local::TChangeableMemPool::_::_::_m_arrayPool::_0_::_elem::_m_objectInformation::_0_::_m_perObjectType::_m_prob1PassengerCarN = 0;
      @sysvar::XCP::RadarFC_Obj::_g_PL_AD_fw_Radar_1R1V_rpc_XilObjBypassingRunnable_XilObjBypassingRunnable_m_pad_radarObjPort_par_out_local::TChangeableMemPool::_::_::_m_arrayPool::_0_::_elem::_m_objectInformation::_0_::_m_perObjectType::_m_prob1TruckN = 0;
      @sysvar::XCP::RadarFC_Obj::_g_PL_AD_fw_Radar_1R1V_rpc_XilObjBypassingRunnable_XilObjBypassingRunnable_m_pad_radarObjPort_par_out_local::TChangeableMemPool::_::_::_m_arrayPool::_0_::_elem::_m_objectInformation::_0_::_m_perObjectType::_m_prob1FourWheelUnknownN = 128;
      @sysvar::XCP::RadarFC_Obj::_g_PL_AD_fw_Radar_1R1V_rpc_XilObjBypassingRunnable_XilObjBypassingRunnable_m_pad_radarObjPort_par_out_local::TChangeableMemPool::_::_::_m_arrayPool::_0_::_elem::_m_objectInformation::_0_::_m_dWidthN = 256;
        break;

      case 1: //"unknown"
      @sysvar::XCP::RadarFC_Obj::_g_PL_AD_fw_Radar_1R1V_rpc_XilObjBypassingRunnable_XilObjBypassingRunnable_m_pad_radarObjPort_par_out_local::TChangeableMemPool::_::_::_m_arrayPool::_0_::_elem::_m_objectInformation::_0_::_m_perObjectType::_m_prob1ObstacleN = 0;
      @sysvar::XCP::RadarFC_Obj::_g_PL_AD_fw_Radar_1R1V_rpc_XilObjBypassingRunnable_XilObjBypassingRunnable_m_pad_radarObjPort_par_out_local::TChangeableMemPool::_::_::_m_arrayPool::_0_::_elem::_m_objectInformation::_0_::_m_perObjectType::_m_prob1NonObstacleN = 0;
      @sysvar::XCP::RadarFC_Obj::_g_PL_AD_fw_Radar_1R1V_rpc_XilObjBypassingRunnable_XilObjBypassingRunnable_m_pad_radarObjPort_par_out_local::TChangeableMemPool::_::_::_m_arrayPool::_0_::_elem::_m_objectInformation::_0_::_m_perObjectType::_m_prob1UnknownN = 128;
      @sysvar::XCP::RadarFC_Obj::_g_PL_AD_fw_Radar_1R1V_rpc_XilObjBypassingRunnable_XilObjBypassingRunnable_m_pad_radarObjPort_par_out_local::TChangeableMemPool::_::_::_m_arrayPool::_0_::_elem::_m_objectInformation::_0_::_m_perObjectType::_m_prob1MobileN = 0;
      @sysvar::XCP::RadarFC_Obj::_g_PL_AD_fw_Radar_1R1V_rpc_XilObjBypassingRunnable_XilObjBypassingRunnable_m_pad_radarObjPort_par_out_local::TChangeableMemPool::_::_::_m_arrayPool::_0_::_elem::_m_objectInformation::_0_::_m_perObjectType::_m_prob1StationaryN = 0;
      @sysvar::XCP::RadarFC_Obj::_g_PL_AD_fw_Radar_1R1V_rpc_XilObjBypassingRunnable_XilObjBypassingRunnable_m_pad_radarObjPort_par_out_local::TChangeableMemPool::_::_::_m_arrayPool::_0_::_elem::_m_objectInformation::_0_::_m_perObjectType::_m_prob1ObstUnknownN = 128;
      @sysvar::XCP::RadarFC_Obj::_g_PL_AD_fw_Radar_1R1V_rpc_XilObjBypassingRunnable_XilObjBypassingRunnable_m_pad_radarObjPort_par_out_local::TChangeableMemPool::_::_::_m_arrayPool::_0_::_elem::_m_objectInformation::_0_::_m_perObjectType::_m_prob1FourPlusWheelerN = 0;
      @sysvar::XCP::RadarFC_Obj::_g_PL_AD_fw_Radar_1R1V_rpc_XilObjBypassingRunnable_XilObjBypassingRunnable_m_pad_radarObjPort_par_out_local::TChangeableMemPool::_::_::_m_arrayPool::_0_::_elem::_m_objectInformation::_0_::_m_perObjectType::_m_prob1TwoWheelerN = 0;
      @sysvar::XCP::RadarFC_Obj::_g_PL_AD_fw_Radar_1R1V_rpc_XilObjBypassingRunnable_XilObjBypassingRunnable_m_pad_radarObjPort_par_out_local::TChangeableMemPool::_::_::_m_arrayPool::_0_::_elem::_m_objectInformation::_0_::_m_perObjectType::_m_prob1PedestrianN = 0;
      @sysvar::XCP::RadarFC_Obj::_g_PL_AD_fw_Radar_1R1V_rpc_XilObjBypassingRunnable_XilObjBypassingRunnable_m_pad_radarObjPort_par_out_local::TChangeableMemPool::_::_::_m_arrayPool::_0_::_elem::_m_objectInformation::_0_::_m_perObjectType::_m_prob1MovUnknownN = 128;
      @sysvar::XCP::RadarFC_Obj::_g_PL_AD_fw_Radar_1R1V_rpc_XilObjBypassingRunnable_XilObjBypassingRunnable_m_pad_radarObjPort_par_out_local::TChangeableMemPool::_::_::_m_arrayPool::_0_::_elem::_m_objectInformation::_0_::_m_perObjectType::_m_prob1RoadsideBarrierN = 0;
      @sysvar::XCP::RadarFC_Obj::_g_PL_AD_fw_Radar_1R1V_rpc_XilObjBypassingRunnable_XilObjBypassingRunnable_m_pad_radarObjPort_par_out_local::TChangeableMemPool::_::_::_m_arrayPool::_0_::_elem::_m_objectInformation::_0_::_m_perObjectType::_m_prob1StatUnknownN = 128;
      @sysvar::XCP::RadarFC_Obj::_g_PL_AD_fw_Radar_1R1V_rpc_XilObjBypassingRunnable_XilObjBypassingRunnable_m_pad_radarObjPort_par_out_local::TChangeableMemPool::_::_::_m_arrayPool::_0_::_elem::_m_objectInformation::_0_::_m_perObjectType::_m_prob1PassengerCarN = 0;
      @sysvar::XCP::RadarFC_Obj::_g_PL_AD_fw_Radar_1R1V_rpc_XilObjBypassingRunnable_XilObjBypassingRunnable_m_pad_radarObjPort_par_out_local::TChangeableMemPool::_::_::_m_arrayPool::_0_::_elem::_m_objectInformation::_0_::_m_perObjectType::_m_prob1TruckN = 0;
      @sysvar::XCP::RadarFC_Obj::_g_PL_AD_fw_Radar_1R1V_rpc_XilObjBypassingRunnable_XilObjBypassingRunnable_m_pad_radarObjPort_par_out_local::TChangeableMemPool::_::_::_m_arrayPool::_0_::_elem::_m_objectInformation::_0_::_m_perObjectType::_m_prob1FourWheelUnknownN = 128;
      @sysvar::XCP::RadarFC_Obj::_g_PL_AD_fw_Radar_1R1V_rpc_XilObjBypassingRunnable_XilObjBypassingRunnable_m_pad_radarObjPort_par_out_local::TChangeableMemPool::_::_::_m_arrayPool::_0_::_elem::_m_objectInformation::_0_::_m_dWidthN = 256;
        break;

      case 2: //"RoadSideBarrier"
      @sysvar::XCP::RadarFC_Obj::_g_PL_AD_fw_Radar_1R1V_rpc_XilObjBypassingRunnable_XilObjBypassingRunnable_m_pad_radarObjPort_par_out_local::TChangeableMemPool::_::_::_m_arrayPool::_0_::_elem::_m_objectInformation::_0_::_m_perObjectType::_m_prob1ObstacleN = 128;
      @sysvar::XCP::RadarFC_Obj::_g_PL_AD_fw_Radar_1R1V_rpc_XilObjBypassingRunnable_XilObjBypassingRunnable_m_pad_radarObjPort_par_out_local::TChangeableMemPool::_::_::_m_arrayPool::_0_::_elem::_m_objectInformation::_0_::_m_perObjectType::_m_prob1NonObstacleN = 0;
      @sysvar::XCP::RadarFC_Obj::_g_PL_AD_fw_Radar_1R1V_rpc_XilObjBypassingRunnable_XilObjBypassingRunnable_m_pad_radarObjPort_par_out_local::TChangeableMemPool::_::_::_m_arrayPool::_0_::_elem::_m_objectInformation::_0_::_m_perObjectType::_m_prob1UnknownN = 0;
      @sysvar::XCP::RadarFC_Obj::_g_PL_AD_fw_Radar_1R1V_rpc_XilObjBypassingRunnable_XilObjBypassingRunnable_m_pad_radarObjPort_par_out_local::TChangeableMemPool::_::_::_m_arrayPool::_0_::_elem::_m_objectInformation::_0_::_m_perObjectType::_m_prob1MobileN = 0;
      @sysvar::XCP::RadarFC_Obj::_g_PL_AD_fw_Radar_1R1V_rpc_XilObjBypassingRunnable_XilObjBypassingRunnable_m_pad_radarObjPort_par_out_local::TChangeableMemPool::_::_::_m_arrayPool::_0_::_elem::_m_objectInformation::_0_::_m_perObjectType::_m_prob1StationaryN = 128;
      @sysvar::XCP::RadarFC_Obj::_g_PL_AD_fw_Radar_1R1V_rpc_XilObjBypassingRunnable_XilObjBypassingRunnable_m_pad_radarObjPort_par_out_local::TChangeableMemPool::_::_::_m_arrayPool::_0_::_elem::_m_objectInformation::_0_::_m_perObjectType::_m_prob1ObstUnknownN = 0;
      @sysvar::XCP::RadarFC_Obj::_g_PL_AD_fw_Radar_1R1V_rpc_XilObjBypassingRunnable_XilObjBypassingRunnable_m_pad_radarObjPort_par_out_local::TChangeableMemPool::_::_::_m_arrayPool::_0_::_elem::_m_objectInformation::_0_::_m_perObjectType::_m_prob1FourPlusWheelerN = 0;
      @sysvar::XCP::RadarFC_Obj::_g_PL_AD_fw_Radar_1R1V_rpc_XilObjBypassingRunnable_XilObjBypassingRunnable_m_pad_radarObjPort_par_out_local::TChangeableMemPool::_::_::_m_arrayPool::_0_::_elem::_m_objectInformation::_0_::_m_perObjectType::_m_prob1TwoWheelerN = 0;
      @sysvar::XCP::RadarFC_Obj::_g_PL_AD_fw_Radar_1R1V_rpc_XilObjBypassingRunnable_XilObjBypassingRunnable_m_pad_radarObjPort_par_out_local::TChangeableMemPool::_::_::_m_arrayPool::_0_::_elem::_m_objectInformation::_0_::_m_perObjectType::_m_prob1PedestrianN = 0;
      @sysvar::XCP::RadarFC_Obj::_g_PL_AD_fw_Radar_1R1V_rpc_XilObjBypassingRunnable_XilObjBypassingRunnable_m_pad_radarObjPort_par_out_local::TChangeableMemPool::_::_::_m_arrayPool::_0_::_elem::_m_objectInformation::_0_::_m_perObjectType::_m_prob1MovUnknownN = 128;
      @sysvar::XCP::RadarFC_Obj::_g_PL_AD_fw_Radar_1R1V_rpc_XilObjBypassingRunnable_XilObjBypassingRunnable_m_pad_radarObjPort_par_out_local::TChangeableMemPool::_::_::_m_arrayPool::_0_::_elem::_m_objectInformation::_0_::_m_perObjectType::_m_prob1RoadsideBarrierN = 128;
      @sysvar::XCP::RadarFC_Obj::_g_PL_AD_fw_Radar_1R1V_rpc_XilObjBypassingRunnable_XilObjBypassingRunnable_m_pad_radarObjPort_par_out_local::TChangeableMemPool::_::_::_m_arrayPool::_0_::_elem::_m_objectInformation::_0_::_m_perObjectType::_m_prob1StatUnknownN = 0;
      @sysvar::XCP::RadarFC_Obj::_g_PL_AD_fw_Radar_1R1V_rpc_XilObjBypassingRunnable_XilObjBypassingRunnable_m_pad_radarObjPort_par_out_local::TChangeableMemPool::_::_::_m_arrayPool::_0_::_elem::_m_objectInformation::_0_::_m_perObjectType::_m_prob1PassengerCarN = 0;
      @sysvar::XCP::RadarFC_Obj::_g_PL_AD_fw_Radar_1R1V_rpc_XilObjBypassingRunnable_XilObjBypassingRunnable_m_pad_radarObjPort_par_out_local::TChangeableMemPool::_::_::_m_arrayPool::_0_::_elem::_m_objectInformation::_0_::_m_perObjectType::_m_prob1TruckN = 0;
      @sysvar::XCP::RadarFC_Obj::_g_PL_AD_fw_Radar_1R1V_rpc_XilObjBypassingRunnable_XilObjBypassingRunnable_m_pad_radarObjPort_par_out_local::TChangeableMemPool::_::_::_m_arrayPool::_0_::_elem::_m_objectInformation::_0_::_m_perObjectType::_m_prob1FourWheelUnknownN = 128;
      @sysvar::XCP::RadarFC_Obj::_g_PL_AD_fw_Radar_1R1V_rpc_XilObjBypassingRunnable_XilObjBypassingRunnable_m_pad_radarObjPort_par_out_local::TChangeableMemPool::_::_::_m_arrayPool::_0_::_elem::_m_objectInformation::_0_::_m_dWidthN = 256;
        break;

      case 3: //"2Wheeler"
      @sysvar::XCP::RadarFC_Obj::_g_PL_AD_fw_Radar_1R1V_rpc_XilObjBypassingRunnable_XilObjBypassingRunnable_m_pad_radarObjPort_par_out_local::TChangeableMemPool::_::_::_m_arrayPool::_0_::_elem::_m_objectInformation::_0_::_m_perObjectType::_m_prob1ObstacleN = 128;
      @sysvar::XCP::RadarFC_Obj::_g_PL_AD_fw_Radar_1R1V_rpc_XilObjBypassingRunnable_XilObjBypassingRunnable_m_pad_radarObjPort_par_out_local::TChangeableMemPool::_::_::_m_arrayPool::_0_::_elem::_m_objectInformation::_0_::_m_perObjectType::_m_prob1NonObstacleN = 0;
      @sysvar::XCP::RadarFC_Obj::_g_PL_AD_fw_Radar_1R1V_rpc_XilObjBypassingRunnable_XilObjBypassingRunnable_m_pad_radarObjPort_par_out_local::TChangeableMemPool::_::_::_m_arrayPool::_0_::_elem::_m_objectInformation::_0_::_m_perObjectType::_m_prob1UnknownN = 0;
      @sysvar::XCP::RadarFC_Obj::_g_PL_AD_fw_Radar_1R1V_rpc_XilObjBypassingRunnable_XilObjBypassingRunnable_m_pad_radarObjPort_par_out_local::TChangeableMemPool::_::_::_m_arrayPool::_0_::_elem::_m_objectInformation::_0_::_m_perObjectType::_m_prob1MobileN = 128;
      @sysvar::XCP::RadarFC_Obj::_g_PL_AD_fw_Radar_1R1V_rpc_XilObjBypassingRunnable_XilObjBypassingRunnable_m_pad_radarObjPort_par_out_local::TChangeableMemPool::_::_::_m_arrayPool::_0_::_elem::_m_objectInformation::_0_::_m_perObjectType::_m_prob1StationaryN = 0;
      @sysvar::XCP::RadarFC_Obj::_g_PL_AD_fw_Radar_1R1V_rpc_XilObjBypassingRunnable_XilObjBypassingRunnable_m_pad_radarObjPort_par_out_local::TChangeableMemPool::_::_::_m_arrayPool::_0_::_elem::_m_objectInformation::_0_::_m_perObjectType::_m_prob1ObstUnknownN = 0;
      @sysvar::XCP::RadarFC_Obj::_g_PL_AD_fw_Radar_1R1V_rpc_XilObjBypassingRunnable_XilObjBypassingRunnable_m_pad_radarObjPort_par_out_local::TChangeableMemPool::_::_::_m_arrayPool::_0_::_elem::_m_objectInformation::_0_::_m_perObjectType::_m_prob1FourPlusWheelerN = 0;
      @sysvar::XCP::RadarFC_Obj::_g_PL_AD_fw_Radar_1R1V_rpc_XilObjBypassingRunnable_XilObjBypassingRunnable_m_pad_radarObjPort_par_out_local::TChangeableMemPool::_::_::_m_arrayPool::_0_::_elem::_m_objectInformation::_0_::_m_perObjectType::_m_prob1TwoWheelerN = 128;
      @sysvar::XCP::RadarFC_Obj::_g_PL_AD_fw_Radar_1R1V_rpc_XilObjBypassingRunnable_XilObjBypassingRunnable_m_pad_radarObjPort_par_out_local::TChangeableMemPool::_::_::_m_arrayPool::_0_::_elem::_m_objectInformation::_0_::_m_perObjectType::_m_prob1PedestrianN = 0;
      @sysvar::XCP::RadarFC_Obj::_g_PL_AD_fw_Radar_1R1V_rpc_XilObjBypassingRunnable_XilObjBypassingRunnable_m_pad_radarObjPort_par_out_local::TChangeableMemPool::_::_::_m_arrayPool::_0_::_elem::_m_objectInformation::_0_::_m_perObjectType::_m_prob1MovUnknownN = 0;
      @sysvar::XCP::RadarFC_Obj::_g_PL_AD_fw_Radar_1R1V_rpc_XilObjBypassingRunnable_XilObjBypassingRunnable_m_pad_radarObjPort_par_out_local::TChangeableMemPool::_::_::_m_arrayPool::_0_::_elem::_m_objectInformation::_0_::_m_perObjectType::_m_prob1RoadsideBarrierN = 0;
      @sysvar::XCP::RadarFC_Obj::_g_PL_AD_fw_Radar_1R1V_rpc_XilObjBypassingRunnable_XilObjBypassingRunnable_m_pad_radarObjPort_par_out_local::TChangeableMemPool::_::_::_m_arrayPool::_0_::_elem::_m_objectInformation::_0_::_m_perObjectType::_m_prob1StatUnknownN = 128;
      @sysvar::XCP::RadarFC_Obj::_g_PL_AD_fw_Radar_1R1V_rpc_XilObjBypassingRunnable_XilObjBypassingRunnable_m_pad_radarObjPort_par_out_local::TChangeableMemPool::_::_::_m_arrayPool::_0_::_elem::_m_objectInformation::_0_::_m_perObjectType::_m_prob1PassengerCarN = 0;
      @sysvar::XCP::RadarFC_Obj::_g_PL_AD_fw_Radar_1R1V_rpc_XilObjBypassingRunnable_XilObjBypassingRunnable_m_pad_radarObjPort_par_out_local::TChangeableMemPool::_::_::_m_arrayPool::_0_::_elem::_m_objectInformation::_0_::_m_perObjectType::_m_prob1TruckN = 0;
      @sysvar::XCP::RadarFC_Obj::_g_PL_AD_fw_Radar_1R1V_rpc_XilObjBypassingRunnable_XilObjBypassingRunnable_m_pad_radarObjPort_par_out_local::TChangeableMemPool::_::_::_m_arrayPool::_0_::_elem::_m_objectInformation::_0_::_m_perObjectType::_m_prob1FourWheelUnknownN = 128;
      @sysvar::XCP::RadarFC_Obj::_g_PL_AD_fw_Radar_1R1V_rpc_XilObjBypassingRunnable_XilObjBypassingRunnable_m_pad_radarObjPort_par_out_local::TChangeableMemPool::_::_::_m_arrayPool::_0_::_elem::_m_objectInformation::_0_::_m_dWidthN = 64;
        break;

      case 4: //"Pedestrian"
      @sysvar::XCP::RadarFC_Obj::_g_PL_AD_fw_Radar_1R1V_rpc_XilObjBypassingRunnable_XilObjBypassingRunnable_m_pad_radarObjPort_par_out_local::TChangeableMemPool::_::_::_m_arrayPool::_0_::_elem::_m_objectInformation::_0_::_m_perObjectType::_m_prob1ObstacleN = 128;
      @sysvar::XCP::RadarFC_Obj::_g_PL_AD_fw_Radar_1R1V_rpc_XilObjBypassingRunnable_XilObjBypassingRunnable_m_pad_radarObjPort_par_out_local::TChangeableMemPool::_::_::_m_arrayPool::_0_::_elem::_m_objectInformation::_0_::_m_perObjectType::_m_prob1NonObstacleN = 0;
      @sysvar::XCP::RadarFC_Obj::_g_PL_AD_fw_Radar_1R1V_rpc_XilObjBypassingRunnable_XilObjBypassingRunnable_m_pad_radarObjPort_par_out_local::TChangeableMemPool::_::_::_m_arrayPool::_0_::_elem::_m_objectInformation::_0_::_m_perObjectType::_m_prob1UnknownN = 0;
      @sysvar::XCP::RadarFC_Obj::_g_PL_AD_fw_Radar_1R1V_rpc_XilObjBypassingRunnable_XilObjBypassingRunnable_m_pad_radarObjPort_par_out_local::TChangeableMemPool::_::_::_m_arrayPool::_0_::_elem::_m_objectInformation::_0_::_m_perObjectType::_m_prob1MobileN = 128;
      @sysvar::XCP::RadarFC_Obj::_g_PL_AD_fw_Radar_1R1V_rpc_XilObjBypassingRunnable_XilObjBypassingRunnable_m_pad_radarObjPort_par_out_local::TChangeableMemPool::_::_::_m_arrayPool::_0_::_elem::_m_objectInformation::_0_::_m_perObjectType::_m_prob1StationaryN = 0;
      @sysvar::XCP::RadarFC_Obj::_g_PL_AD_fw_Radar_1R1V_rpc_XilObjBypassingRunnable_XilObjBypassingRunnable_m_pad_radarObjPort_par_out_local::TChangeableMemPool::_::_::_m_arrayPool::_0_::_elem::_m_objectInformation::_0_::_m_perObjectType::_m_prob1ObstUnknownN = 0;
      @sysvar::XCP::RadarFC_Obj::_g_PL_AD_fw_Radar_1R1V_rpc_XilObjBypassingRunnable_XilObjBypassingRunnable_m_pad_radarObjPort_par_out_local::TChangeableMemPool::_::_::_m_arrayPool::_0_::_elem::_m_objectInformation::_0_::_m_perObjectType::_m_prob1FourPlusWheelerN = 0;
      @sysvar::XCP::RadarFC_Obj::_g_PL_AD_fw_Radar_1R1V_rpc_XilObjBypassingRunnable_XilObjBypassingRunnable_m_pad_radarObjPort_par_out_local::TChangeableMemPool::_::_::_m_arrayPool::_0_::_elem::_m_objectInformation::_0_::_m_perObjectType::_m_prob1TwoWheelerN = 0;
      @sysvar::XCP::RadarFC_Obj::_g_PL_AD_fw_Radar_1R1V_rpc_XilObjBypassingRunnable_XilObjBypassingRunnable_m_pad_radarObjPort_par_out_local::TChangeableMemPool::_::_::_m_arrayPool::_0_::_elem::_m_objectInformation::_0_::_m_perObjectType::_m_prob1PedestrianN = 128;
      @sysvar::XCP::RadarFC_Obj::_g_PL_AD_fw_Radar_1R1V_rpc_XilObjBypassingRunnable_XilObjBypassingRunnable_m_pad_radarObjPort_par_out_local::TChangeableMemPool::_::_::_m_arrayPool::_0_::_elem::_m_objectInformation::_0_::_m_perObjectType::_m_prob1MovUnknownN = 0;
      @sysvar::XCP::RadarFC_Obj::_g_PL_AD_fw_Radar_1R1V_rpc_XilObjBypassingRunnable_XilObjBypassingRunnable_m_pad_radarObjPort_par_out_local::TChangeableMemPool::_::_::_m_arrayPool::_0_::_elem::_m_objectInformation::_0_::_m_perObjectType::_m_prob1RoadsideBarrierN = 0;
      @sysvar::XCP::RadarFC_Obj::_g_PL_AD_fw_Radar_1R1V_rpc_XilObjBypassingRunnable_XilObjBypassingRunnable_m_pad_radarObjPort_par_out_local::TChangeableMemPool::_::_::_m_arrayPool::_0_::_elem::_m_objectInformation::_0_::_m_perObjectType::_m_prob1StatUnknownN = 128;
      @sysvar::XCP::RadarFC_Obj::_g_PL_AD_fw_Radar_1R1V_rpc_XilObjBypassingRunnable_XilObjBypassingRunnable_m_pad_radarObjPort_par_out_local::TChangeableMemPool::_::_::_m_arrayPool::_0_::_elem::_m_objectInformation::_0_::_m_perObjectType::_m_prob1PassengerCarN = 0;
      @sysvar::XCP::RadarFC_Obj::_g_PL_AD_fw_Radar_1R1V_rpc_XilObjBypassingRunnable_XilObjBypassingRunnable_m_pad_radarObjPort_par_out_local::TChangeableMemPool::_::_::_m_arrayPool::_0_::_elem::_m_objectInformation::_0_::_m_perObjectType::_m_prob1TruckN = 0;
      @sysvar::XCP::RadarFC_Obj::_g_PL_AD_fw_Radar_1R1V_rpc_XilObjBypassingRunnable_XilObjBypassingRunnable_m_pad_radarObjPort_par_out_local::TChangeableMemPool::_::_::_m_arrayPool::_0_::_elem::_m_objectInformation::_0_::_m_perObjectType::_m_prob1FourWheelUnknownN = 128;
      @sysvar::XCP::RadarFC_Obj::_g_PL_AD_fw_Radar_1R1V_rpc_XilObjBypassingRunnable_XilObjBypassingRunnable_m_pad_radarObjPort_par_out_local::TChangeableMemPool::_::_::_m_arrayPool::_0_::_elem::_m_objectInformation::_0_::_m_dWidthN = 64;
        break;

      case 5: //"Truck"
      @sysvar::XCP::RadarFC_Obj::_g_PL_AD_fw_Radar_1R1V_rpc_XilObjBypassingRunnable_XilObjBypassingRunnable_m_pad_radarObjPort_par_out_local::TChangeableMemPool::_::_::_m_arrayPool::_0_::_elem::_m_objectInformation::_0_::_m_perObjectType::_m_prob1ObstacleN = 128;
      @sysvar::XCP::RadarFC_Obj::_g_PL_AD_fw_Radar_1R1V_rpc_XilObjBypassingRunnable_XilObjBypassingRunnable_m_pad_radarObjPort_par_out_local::TChangeableMemPool::_::_::_m_arrayPool::_0_::_elem::_m_objectInformation::_0_::_m_perObjectType::_m_prob1NonObstacleN = 0;
      @sysvar::XCP::RadarFC_Obj::_g_PL_AD_fw_Radar_1R1V_rpc_XilObjBypassingRunnable_XilObjBypassingRunnable_m_pad_radarObjPort_par_out_local::TChangeableMemPool::_::_::_m_arrayPool::_0_::_elem::_m_objectInformation::_0_::_m_perObjectType::_m_prob1UnknownN = 0;
      @sysvar::XCP::RadarFC_Obj::_g_PL_AD_fw_Radar_1R1V_rpc_XilObjBypassingRunnable_XilObjBypassingRunnable_m_pad_radarObjPort_par_out_local::TChangeableMemPool::_::_::_m_arrayPool::_0_::_elem::_m_objectInformation::_0_::_m_perObjectType::_m_prob1MobileN = 128;
      @sysvar::XCP::RadarFC_Obj::_g_PL_AD_fw_Radar_1R1V_rpc_XilObjBypassingRunnable_XilObjBypassingRunnable_m_pad_radarObjPort_par_out_local::TChangeableMemPool::_::_::_m_arrayPool::_0_::_elem::_m_objectInformation::_0_::_m_perObjectType::_m_prob1StationaryN = 0;
      @sysvar::XCP::RadarFC_Obj::_g_PL_AD_fw_Radar_1R1V_rpc_XilObjBypassingRunnable_XilObjBypassingRunnable_m_pad_radarObjPort_par_out_local::TChangeableMemPool::_::_::_m_arrayPool::_0_::_elem::_m_objectInformation::_0_::_m_perObjectType::_m_prob1ObstUnknownN = 0;
      @sysvar::XCP::RadarFC_Obj::_g_PL_AD_fw_Radar_1R1V_rpc_XilObjBypassingRunnable_XilObjBypassingRunnable_m_pad_radarObjPort_par_out_local::TChangeableMemPool::_::_::_m_arrayPool::_0_::_elem::_m_objectInformation::_0_::_m_perObjectType::_m_prob1FourPlusWheelerN = 128;
      @sysvar::XCP::RadarFC_Obj::_g_PL_AD_fw_Radar_1R1V_rpc_XilObjBypassingRunnable_XilObjBypassingRunnable_m_pad_radarObjPort_par_out_local::TChangeableMemPool::_::_::_m_arrayPool::_0_::_elem::_m_objectInformation::_0_::_m_perObjectType::_m_prob1TwoWheelerN = 0;
      @sysvar::XCP::RadarFC_Obj::_g_PL_AD_fw_Radar_1R1V_rpc_XilObjBypassingRunnable_XilObjBypassingRunnable_m_pad_radarObjPort_par_out_local::TChangeableMemPool::_::_::_m_arrayPool::_0_::_elem::_m_objectInformation::_0_::_m_perObjectType::_m_prob1PedestrianN = 0;
      @sysvar::XCP::RadarFC_Obj::_g_PL_AD_fw_Radar_1R1V_rpc_XilObjBypassingRunnable_XilObjBypassingRunnable_m_pad_radarObjPort_par_out_local::TChangeableMemPool::_::_::_m_arrayPool::_0_::_elem::_m_objectInformation::_0_::_m_perObjectType::_m_prob1MovUnknownN = 0;
      @sysvar::XCP::RadarFC_Obj::_g_PL_AD_fw_Radar_1R1V_rpc_XilObjBypassingRunnable_XilObjBypassingRunnable_m_pad_radarObjPort_par_out_local::TChangeableMemPool::_::_::_m_arrayPool::_0_::_elem::_m_objectInformation::_0_::_m_perObjectType::_m_prob1RoadsideBarrierN = 0;
      @sysvar::XCP::RadarFC_Obj::_g_PL_AD_fw_Radar_1R1V_rpc_XilObjBypassingRunnable_XilObjBypassingRunnable_m_pad_radarObjPort_par_out_local::TChangeableMemPool::_::_::_m_arrayPool::_0_::_elem::_m_objectInformation::_0_::_m_perObjectType::_m_prob1StatUnknownN = 128;
      @sysvar::XCP::RadarFC_Obj::_g_PL_AD_fw_Radar_1R1V_rpc_XilObjBypassingRunnable_XilObjBypassingRunnable_m_pad_radarObjPort_par_out_local::TChangeableMemPool::_::_::_m_arrayPool::_0_::_elem::_m_objectInformation::_0_::_m_perObjectType::_m_prob1PassengerCarN = 0;
      @sysvar::XCP::RadarFC_Obj::_g_PL_AD_fw_Radar_1R1V_rpc_XilObjBypassingRunnable_XilObjBypassingRunnable_m_pad_radarObjPort_par_out_local::TChangeableMemPool::_::_::_m_arrayPool::_0_::_elem::_m_objectInformation::_0_::_m_perObjectType::_m_prob1TruckN = 128;
      @sysvar::XCP::RadarFC_Obj::_g_PL_AD_fw_Radar_1R1V_rpc_XilObjBypassingRunnable_XilObjBypassingRunnable_m_pad_radarObjPort_par_out_local::TChangeableMemPool::_::_::_m_arrayPool::_0_::_elem::_m_objectInformation::_0_::_m_perObjectType::_m_prob1FourWheelUnknownN = 0;
      @sysvar::XCP::RadarFC_Obj::_g_PL_AD_fw_Radar_1R1V_rpc_XilObjBypassingRunnable_XilObjBypassingRunnable_m_pad_radarObjPort_par_out_local::TChangeableMemPool::_::_::_m_arrayPool::_0_::_elem::_m_objectInformation::_0_::_m_dWidthN = 256;
        break;

      case 6: //"PassengerCar"
            @sysvar::XCP::RadarFC_Obj::_g_PL_AD_fw_Radar_1R1V_rpc_XilObjBypassingRunnable_XilObjBypassingRunnable_m_pad_radarObjPort_par_out_local::TChangeableMemPool::_::_::_m_arrayPool::_0_::_elem::_m_objectInformation::_0_::_m_perObjectType::_m_prob1ObstacleN = 128;
      @sysvar::XCP::RadarFC_Obj::_g_PL_AD_fw_Radar_1R1V_rpc_XilObjBypassingRunnable_XilObjBypassingRunnable_m_pad_radarObjPort_par_out_local::TChangeableMemPool::_::_::_m_arrayPool::_0_::_elem::_m_objectInformation::_0_::_m_perObjectType::_m_prob1NonObstacleN = 0;
      @sysvar::XCP::RadarFC_Obj::_g_PL_AD_fw_Radar_1R1V_rpc_XilObjBypassingRunnable_XilObjBypassingRunnable_m_pad_radarObjPort_par_out_local::TChangeableMemPool::_::_::_m_arrayPool::_0_::_elem::_m_objectInformation::_0_::_m_perObjectType::_m_prob1UnknownN = 0;
      @sysvar::XCP::RadarFC_Obj::_g_PL_AD_fw_Radar_1R1V_rpc_XilObjBypassingRunnable_XilObjBypassingRunnable_m_pad_radarObjPort_par_out_local::TChangeableMemPool::_::_::_m_arrayPool::_0_::_elem::_m_objectInformation::_0_::_m_perObjectType::_m_prob1MobileN = 128;
      @sysvar::XCP::RadarFC_Obj::_g_PL_AD_fw_Radar_1R1V_rpc_XilObjBypassingRunnable_XilObjBypassingRunnable_m_pad_radarObjPort_par_out_local::TChangeableMemPool::_::_::_m_arrayPool::_0_::_elem::_m_objectInformation::_0_::_m_perObjectType::_m_prob1StationaryN = 0;
      @sysvar::XCP::RadarFC_Obj::_g_PL_AD_fw_Radar_1R1V_rpc_XilObjBypassingRunnable_XilObjBypassingRunnable_m_pad_radarObjPort_par_out_local::TChangeableMemPool::_::_::_m_arrayPool::_0_::_elem::_m_objectInformation::_0_::_m_perObjectType::_m_prob1ObstUnknownN = 0;
      @sysvar::XCP::RadarFC_Obj::_g_PL_AD_fw_Radar_1R1V_rpc_XilObjBypassingRunnable_XilObjBypassingRunnable_m_pad_radarObjPort_par_out_local::TChangeableMemPool::_::_::_m_arrayPool::_0_::_elem::_m_objectInformation::_0_::_m_perObjectType::_m_prob1FourPlusWheelerN = 128;
      @sysvar::XCP::RadarFC_Obj::_g_PL_AD_fw_Radar_1R1V_rpc_XilObjBypassingRunnable_XilObjBypassingRunnable_m_pad_radarObjPort_par_out_local::TChangeableMemPool::_::_::_m_arrayPool::_0_::_elem::_m_objectInformation::_0_::_m_perObjectType::_m_prob1TwoWheelerN = 0;
      @sysvar::XCP::RadarFC_Obj::_g_PL_AD_fw_Radar_1R1V_rpc_XilObjBypassingRunnable_XilObjBypassingRunnable_m_pad_radarObjPort_par_out_local::TChangeableMemPool::_::_::_m_arrayPool::_0_::_elem::_m_objectInformation::_0_::_m_perObjectType::_m_prob1PedestrianN = 0;
      @sysvar::XCP::RadarFC_Obj::_g_PL_AD_fw_Radar_1R1V_rpc_XilObjBypassingRunnable_XilObjBypassingRunnable_m_pad_radarObjPort_par_out_local::TChangeableMemPool::_::_::_m_arrayPool::_0_::_elem::_m_objectInformation::_0_::_m_perObjectType::_m_prob1MovUnknownN = 0;
      @sysvar::XCP::RadarFC_Obj::_g_PL_AD_fw_Radar_1R1V_rpc_XilObjBypassingRunnable_XilObjBypassingRunnable_m_pad_radarObjPort_par_out_local::TChangeableMemPool::_::_::_m_arrayPool::_0_::_elem::_m_objectInformation::_0_::_m_perObjectType::_m_prob1RoadsideBarrierN = 0;
      @sysvar::XCP::RadarFC_Obj::_g_PL_AD_fw_Radar_1R1V_rpc_XilObjBypassingRunnable_XilObjBypassingRunnable_m_pad_radarObjPort_par_out_local::TChangeableMemPool::_::_::_m_arrayPool::_0_::_elem::_m_objectInformation::_0_::_m_perObjectType::_m_prob1StatUnknownN = 128;
      @sysvar::XCP::RadarFC_Obj::_g_PL_AD_fw_Radar_1R1V_rpc_XilObjBypassingRunnable_XilObjBypassingRunnable_m_pad_radarObjPort_par_out_local::TChangeableMemPool::_::_::_m_arrayPool::_0_::_elem::_m_objectInformation::_0_::_m_perObjectType::_m_prob1PassengerCarN = 128;
      @sysvar::XCP::RadarFC_Obj::_g_PL_AD_fw_Radar_1R1V_rpc_XilObjBypassingRunnable_XilObjBypassingRunnable_m_pad_radarObjPort_par_out_local::TChangeableMemPool::_::_::_m_arrayPool::_0_::_elem::_m_objectInformation::_0_::_m_perObjectType::_m_prob1TruckN = 0;
      @sysvar::XCP::RadarFC_Obj::_g_PL_AD_fw_Radar_1R1V_rpc_XilObjBypassingRunnable_XilObjBypassingRunnable_m_pad_radarObjPort_par_out_local::TChangeableMemPool::_::_::_m_arrayPool::_0_::_elem::_m_objectInformation::_0_::_m_perObjectType::_m_prob1FourWheelUnknownN = 0;
      @sysvar::XCP::RadarFC_Obj::_g_PL_AD_fw_Radar_1R1V_rpc_XilObjBypassingRunnable_XilObjBypassingRunnable_m_pad_radarObjPort_par_out_local::TChangeableMemPool::_::_::_m_arrayPool::_0_::_elem::_m_objectInformation::_0_::_m_dWidthN = 256;
        break;
    }
    break;

    case 1: //"Object-1"
    //constant
  @sysvar::XCP::RadarFC_Obj::_g_PL_AD_fw_Radar_1R1V_rpc_XilObjBypassingRunnable_XilObjBypassingRunnable_m_pad_radarObjPort_par_out_local::TChangeableMemPool::_::_::_m_arrayPool::_0_::_elem::_m_objectInformation::_1_::_Valid_b = 1;
  @sysvar::XCP::RadarFC_Obj::_g_PL_AD_fw_Radar_1R1V_rpc_XilObjBypassingRunnable_XilObjBypassingRunnable_m_pad_radarObjPort_par_out_local::TChangeableMemPool::_::_::_m_arrayPool::_0_::_elem::_m_objectInformation::_1_::_m_HandleN = 1;
  @sysvar::XCP::RadarFC_Obj::_g_PL_AD_fw_Radar_1R1V_rpc_XilObjBypassingRunnable_XilObjBypassingRunnable_m_pad_radarObjPort_par_out_local::TChangeableMemPool::_::_::_m_arrayPool::_0_::_elem::_m_objectInformation::_1_::_m_alpPiVarYawAngleN = 0;
  @sysvar::XCP::RadarFC_Obj::_g_PL_AD_fw_Radar_1R1V_rpc_XilObjBypassingRunnable_XilObjBypassingRunnable_m_pad_radarObjPort_par_out_local::TChangeableMemPool::_::_::_m_arrayPool::_0_::_elem::_m_objectInformation::_1_::_m_alpPiYawAngleN = 0;
  @sysvar::XCP::RadarFC_Obj::_g_PL_AD_fw_Radar_1R1V_rpc_XilObjBypassingRunnable_XilObjBypassingRunnable_m_pad_radarObjPort_par_out_local::TChangeableMemPool::_::_::_m_arrayPool::_0_::_elem::_m_objectInformation::_1_::_m_varAxN = 0;
  @sysvar::XCP::RadarFC_Obj::_g_PL_AD_fw_Radar_1R1V_rpc_XilObjBypassingRunnable_XilObjBypassingRunnable_m_pad_radarObjPort_par_out_local::TChangeableMemPool::_::_::_m_arrayPool::_0_::_elem::_m_objectInformation::_1_::_m_varAyN = 0;
  @sysvar::XCP::RadarFC_Obj::_g_PL_AD_fw_Radar_1R1V_rpc_XilObjBypassingRunnable_XilObjBypassingRunnable_m_pad_radarObjPort_par_out_local::TChangeableMemPool::_::_::_m_arrayPool::_0_::_elem::_m_objectInformation::_1_::_m_varVxN = 0;
  @sysvar::XCP::RadarFC_Obj::_g_PL_AD_fw_Radar_1R1V_rpc_XilObjBypassingRunnable_XilObjBypassingRunnable_m_pad_radarObjPort_par_out_local::TChangeableMemPool::_::_::_m_arrayPool::_0_::_elem::_m_objectInformation::_1_::_m_varVyN = 0;
  @sysvar::XCP::RadarFC_Obj::_g_PL_AD_fw_Radar_1R1V_rpc_XilObjBypassingRunnable_XilObjBypassingRunnable_m_pad_radarObjPort_par_out_local::TChangeableMemPool::_::_::_m_arrayPool::_0_::_elem::_m_objectInformation::_1_::_m_varDxN = 0;
  @sysvar::XCP::RadarFC_Obj::_g_PL_AD_fw_Radar_1R1V_rpc_XilObjBypassingRunnable_XilObjBypassingRunnable_m_pad_radarObjPort_par_out_local::TChangeableMemPool::_::_::_m_arrayPool::_0_::_elem::_m_objectInformation::_1_::_m_varDyN = 0;
  @sysvar::XCP::RadarFC_Obj::_g_PL_AD_fw_Radar_1R1V_rpc_XilObjBypassingRunnable_XilObjBypassingRunnable_m_pad_radarObjPort_par_out_local::TChangeableMemPool::_::_::_m_arrayPool::_0_::_elem::_m_objectInformation::_1_::_m_dVarLengthN = 0;
  @sysvar::XCP::RadarFC_Obj::_g_PL_AD_fw_Radar_1R1V_rpc_XilObjBypassingRunnable_XilObjBypassingRunnable_m_pad_radarObjPort_par_out_local::TChangeableMemPool::_::_::_m_arrayPool::_0_::_elem::_m_objectInformation::_1_::_m_dVarWidthN = 0;
  @sysvar::XCP::RadarFC_Obj::_g_PL_AD_fw_Radar_1R1V_rpc_XilObjBypassingRunnable_XilObjBypassingRunnable_m_pad_radarObjPort_par_out_local::TChangeableMemPool::_::_::_m_arrayPool::_0_::_elem::_m_objectInformation::_1_::_m_wExistProbN = 64880;
  @sysvar::XCP::RadarFC_Obj::_g_PL_AD_fw_Radar_1R1V_rpc_XilObjBypassingRunnable_XilObjBypassingRunnable_m_pad_radarObjPort_par_out_local::TChangeableMemPool::_::_::_m_arrayPool::_0_::_elem::_m_objectInformation::_1_::_m_isObjectAsil = 1;
  @sysvar::XCP::RadarFC_Obj::_g_PL_AD_fw_Radar_1R1V_rpc_XilObjBypassingRunnable_XilObjBypassingRunnable_m_pad_radarObjPort_par_out_local::TChangeableMemPool::_::_::_m_arrayPool::_0_::_elem::_m_objectInformation::_1_::_m_dLengthN = 128;

    //target movement

  @sysvar::XCP::RadarFC_Obj::_g_PL_AD_fw_Radar_1R1V_rpc_XilObjBypassingRunnable_XilObjBypassingRunnable_m_pad_radarObjPort_par_out_local::TChangeableMemPool::_::_::_m_arrayPool::_0_::_elem::_m_objectInformation::_1_::_m_dxN = @target_radar_fc_sim::objdata.obj_distance_x[1] * 128;
  @sysvar::XCP::RadarFC_Obj::_g_PL_AD_fw_Radar_1R1V_rpc_XilObjBypassingRunnable_XilObjBypassingRunnable_m_pad_radarObjPort_par_out_local::TChangeableMemPool::_::_::_m_arrayPool::_0_::_elem::_m_objectInformation::_1_::_m_dyN = @target_radar_fc_sim::objdata.obj_distance_y[1] * 128;
  @sysvar::XCP::RadarFC_Obj::_g_PL_AD_fw_Radar_1R1V_rpc_XilObjBypassingRunnable_XilObjBypassingRunnable_m_pad_radarObjPort_par_out_local::TChangeableMemPool::_::_::_m_arrayPool::_0_::_elem::_m_objectInformation::_1_::_m_dzN = 0;
  @sysvar::XCP::RadarFC_Obj::_g_PL_AD_fw_Radar_1R1V_rpc_XilObjBypassingRunnable_XilObjBypassingRunnable_m_pad_radarObjPort_par_out_local::TChangeableMemPool::_::_::_m_arrayPool::_0_::_elem::_m_objectInformation::_1_::_m_vxN = @target_radar_fc_sim::objdata.obj_velocity_x[1] * 256;
  @sysvar::XCP::RadarFC_Obj::_g_PL_AD_fw_Radar_1R1V_rpc_XilObjBypassingRunnable_XilObjBypassingRunnable_m_pad_radarObjPort_par_out_local::TChangeableMemPool::_::_::_m_arrayPool::_0_::_elem::_m_objectInformation::_1_::_m_vyN = @target_radar_fc_sim::objdata.obj_velocity_y[1] * 256;
  @sysvar::XCP::RadarFC_Obj::_g_PL_AD_fw_Radar_1R1V_rpc_XilObjBypassingRunnable_XilObjBypassingRunnable_m_pad_radarObjPort_par_out_local::TChangeableMemPool::_::_::_m_arrayPool::_0_::_elem::_m_objectInformation::_1_::_m_axN = 0;
  @sysvar::XCP::RadarFC_Obj::_g_PL_AD_fw_Radar_1R1V_rpc_XilObjBypassingRunnable_XilObjBypassingRunnable_m_pad_radarObjPort_par_out_local::TChangeableMemPool::_::_::_m_arrayPool::_0_::_elem::_m_objectInformation::_1_::_m_ayN = 0;

    //target object moving or not
    if (abs(@target_radar_fc_sim::objdata.obj_velocity_x[1]) != 0)
    {
    @sysvar::XCP::RadarFC_Obj::_g_PL_AD_fw_Radar_1R1V_rpc_XilObjBypassingRunnable_XilObjBypassingRunnable_m_pad_radarObjPort_par_out_local::TChangeableMemPool::_::_::_m_arrayPool::_0_::_elem::_m_objectInformation::_1_::_m_prob1HasBeenObservedMovingN = 126;
    @sysvar::XCP::RadarFC_Obj::_g_PL_AD_fw_Radar_1R1V_rpc_XilObjBypassingRunnable_XilObjBypassingRunnable_m_pad_radarObjPort_par_out_local::TChangeableMemPool::_::_::_m_arrayPool::_0_::_elem::_m_objectInformation::_1_::_m_prob1MovingN = 126;
    }
    else
    {
    @sysvar::XCP::RadarFC_Obj::_g_PL_AD_fw_Radar_1R1V_rpc_XilObjBypassingRunnable_XilObjBypassingRunnable_m_pad_radarObjPort_par_out_local::TChangeableMemPool::_::_::_m_arrayPool::_0_::_elem::_m_objectInformation::_1_::_m_prob1HasBeenObservedMovingN = 0;
    @sysvar::XCP::RadarFC_Obj::_g_PL_AD_fw_Radar_1R1V_rpc_XilObjBypassingRunnable_XilObjBypassingRunnable_m_pad_radarObjPort_par_out_local::TChangeableMemPool::_::_::_m_arrayPool::_0_::_elem::_m_objectInformation::_1_::_m_prob1MovingN = 0;
    }

      //object classification
    switch (@target_radar_fc_sim::objdata.obj_type[1])
    {
      case 0: //"Non-Obstacle"
      @sysvar::XCP::RadarFC_Obj::_g_PL_AD_fw_Radar_1R1V_rpc_XilObjBypassingRunnable_XilObjBypassingRunnable_m_pad_radarObjPort_par_out_local::TChangeableMemPool::_::_::_m_arrayPool::_0_::_elem::_m_objectInformation::_1_::_m_perObjectType::_m_prob1ObstacleN = 0;
      @sysvar::XCP::RadarFC_Obj::_g_PL_AD_fw_Radar_1R1V_rpc_XilObjBypassingRunnable_XilObjBypassingRunnable_m_pad_radarObjPort_par_out_local::TChangeableMemPool::_::_::_m_arrayPool::_0_::_elem::_m_objectInformation::_1_::_m_perObjectType::_m_prob1NonObstacleN = 128;
      @sysvar::XCP::RadarFC_Obj::_g_PL_AD_fw_Radar_1R1V_rpc_XilObjBypassingRunnable_XilObjBypassingRunnable_m_pad_radarObjPort_par_out_local::TChangeableMemPool::_::_::_m_arrayPool::_0_::_elem::_m_objectInformation::_1_::_m_perObjectType::_m_prob1UnknownN = 0;
      @sysvar::XCP::RadarFC_Obj::_g_PL_AD_fw_Radar_1R1V_rpc_XilObjBypassingRunnable_XilObjBypassingRunnable_m_pad_radarObjPort_par_out_local::TChangeableMemPool::_::_::_m_arrayPool::_0_::_elem::_m_objectInformation::_1_::_m_perObjectType::_m_prob1MobileN = 0;
      @sysvar::XCP::RadarFC_Obj::_g_PL_AD_fw_Radar_1R1V_rpc_XilObjBypassingRunnable_XilObjBypassingRunnable_m_pad_radarObjPort_par_out_local::TChangeableMemPool::_::_::_m_arrayPool::_0_::_elem::_m_objectInformation::_1_::_m_perObjectType::_m_prob1StationaryN = 0;
      @sysvar::XCP::RadarFC_Obj::_g_PL_AD_fw_Radar_1R1V_rpc_XilObjBypassingRunnable_XilObjBypassingRunnable_m_pad_radarObjPort_par_out_local::TChangeableMemPool::_::_::_m_arrayPool::_0_::_elem::_m_objectInformation::_1_::_m_perObjectType::_m_prob1ObstUnknownN = 128;
      @sysvar::XCP::RadarFC_Obj::_g_PL_AD_fw_Radar_1R1V_rpc_XilObjBypassingRunnable_XilObjBypassingRunnable_m_pad_radarObjPort_par_out_local::TChangeableMemPool::_::_::_m_arrayPool::_0_::_elem::_m_objectInformation::_1_::_m_perObjectType::_m_prob1FourPlusWheelerN = 0;
      @sysvar::XCP::RadarFC_Obj::_g_PL_AD_fw_Radar_1R1V_rpc_XilObjBypassingRunnable_XilObjBypassingRunnable_m_pad_radarObjPort_par_out_local::TChangeableMemPool::_::_::_m_arrayPool::_0_::_elem::_m_objectInformation::_1_::_m_perObjectType::_m_prob1TwoWheelerN = 0;
      @sysvar::XCP::RadarFC_Obj::_g_PL_AD_fw_Radar_1R1V_rpc_XilObjBypassingRunnable_XilObjBypassingRunnable_m_pad_radarObjPort_par_out_local::TChangeableMemPool::_::_::_m_arrayPool::_0_::_elem::_m_objectInformation::_1_::_m_perObjectType::_m_prob1PedestrianN = 0;
      @sysvar::XCP::RadarFC_Obj::_g_PL_AD_fw_Radar_1R1V_rpc_XilObjBypassingRunnable_XilObjBypassingRunnable_m_pad_radarObjPort_par_out_local::TChangeableMemPool::_::_::_m_arrayPool::_0_::_elem::_m_objectInformation::_1_::_m_perObjectType::_m_prob1MovUnknownN = 128;
      @sysvar::XCP::RadarFC_Obj::_g_PL_AD_fw_Radar_1R1V_rpc_XilObjBypassingRunnable_XilObjBypassingRunnable_m_pad_radarObjPort_par_out_local::TChangeableMemPool::_::_::_m_arrayPool::_0_::_elem::_m_objectInformation::_1_::_m_perObjectType::_m_prob1RoadsideBarrierN = 0;
      @sysvar::XCP::RadarFC_Obj::_g_PL_AD_fw_Radar_1R1V_rpc_XilObjBypassingRunnable_XilObjBypassingRunnable_m_pad_radarObjPort_par_out_local::TChangeableMemPool::_::_::_m_arrayPool::_0_::_elem::_m_objectInformation::_1_::_m_perObjectType::_m_prob1StatUnknownN = 128;
      @sysvar::XCP::RadarFC_Obj::_g_PL_AD_fw_Radar_1R1V_rpc_XilObjBypassingRunnable_XilObjBypassingRunnable_m_pad_radarObjPort_par_out_local::TChangeableMemPool::_::_::_m_arrayPool::_0_::_elem::_m_objectInformation::_1_::_m_perObjectType::_m_prob1PassengerCarN = 0;
      @sysvar::XCP::RadarFC_Obj::_g_PL_AD_fw_Radar_1R1V_rpc_XilObjBypassingRunnable_XilObjBypassingRunnable_m_pad_radarObjPort_par_out_local::TChangeableMemPool::_::_::_m_arrayPool::_0_::_elem::_m_objectInformation::_1_::_m_perObjectType::_m_prob1TruckN = 0;
      @sysvar::XCP::RadarFC_Obj::_g_PL_AD_fw_Radar_1R1V_rpc_XilObjBypassingRunnable_XilObjBypassingRunnable_m_pad_radarObjPort_par_out_local::TChangeableMemPool::_::_::_m_arrayPool::_0_::_elem::_m_objectInformation::_1_::_m_perObjectType::_m_prob1FourWheelUnknownN = 128;
      @sysvar::XCP::RadarFC_Obj::_g_PL_AD_fw_Radar_1R1V_rpc_XilObjBypassingRunnable_XilObjBypassingRunnable_m_pad_radarObjPort_par_out_local::TChangeableMemPool::_::_::_m_arrayPool::_0_::_elem::_m_objectInformation::_1_::_m_dWidthN = 256;
        break;

      case 1: //"unknown"
      @sysvar::XCP::RadarFC_Obj::_g_PL_AD_fw_Radar_1R1V_rpc_XilObjBypassingRunnable_XilObjBypassingRunnable_m_pad_radarObjPort_par_out_local::TChangeableMemPool::_::_::_m_arrayPool::_0_::_elem::_m_objectInformation::_1_::_m_perObjectType::_m_prob1ObstacleN = 0;
      @sysvar::XCP::RadarFC_Obj::_g_PL_AD_fw_Radar_1R1V_rpc_XilObjBypassingRunnable_XilObjBypassingRunnable_m_pad_radarObjPort_par_out_local::TChangeableMemPool::_::_::_m_arrayPool::_0_::_elem::_m_objectInformation::_1_::_m_perObjectType::_m_prob1NonObstacleN = 0;
      @sysvar::XCP::RadarFC_Obj::_g_PL_AD_fw_Radar_1R1V_rpc_XilObjBypassingRunnable_XilObjBypassingRunnable_m_pad_radarObjPort_par_out_local::TChangeableMemPool::_::_::_m_arrayPool::_0_::_elem::_m_objectInformation::_1_::_m_perObjectType::_m_prob1UnknownN = 128;
      @sysvar::XCP::RadarFC_Obj::_g_PL_AD_fw_Radar_1R1V_rpc_XilObjBypassingRunnable_XilObjBypassingRunnable_m_pad_radarObjPort_par_out_local::TChangeableMemPool::_::_::_m_arrayPool::_0_::_elem::_m_objectInformation::_1_::_m_perObjectType::_m_prob1MobileN = 0;
      @sysvar::XCP::RadarFC_Obj::_g_PL_AD_fw_Radar_1R1V_rpc_XilObjBypassingRunnable_XilObjBypassingRunnable_m_pad_radarObjPort_par_out_local::TChangeableMemPool::_::_::_m_arrayPool::_0_::_elem::_m_objectInformation::_1_::_m_perObjectType::_m_prob1StationaryN = 0;
      @sysvar::XCP::RadarFC_Obj::_g_PL_AD_fw_Radar_1R1V_rpc_XilObjBypassingRunnable_XilObjBypassingRunnable_m_pad_radarObjPort_par_out_local::TChangeableMemPool::_::_::_m_arrayPool::_0_::_elem::_m_objectInformation::_1_::_m_perObjectType::_m_prob1ObstUnknownN = 128;
      @sysvar::XCP::RadarFC_Obj::_g_PL_AD_fw_Radar_1R1V_rpc_XilObjBypassingRunnable_XilObjBypassingRunnable_m_pad_radarObjPort_par_out_local::TChangeableMemPool::_::_::_m_arrayPool::_0_::_elem::_m_objectInformation::_1_::_m_perObjectType::_m_prob1FourPlusWheelerN = 0;
      @sysvar::XCP::RadarFC_Obj::_g_PL_AD_fw_Radar_1R1V_rpc_XilObjBypassingRunnable_XilObjBypassingRunnable_m_pad_radarObjPort_par_out_local::TChangeableMemPool::_::_::_m_arrayPool::_0_::_elem::_m_objectInformation::_1_::_m_perObjectType::_m_prob1TwoWheelerN = 0;
      @sysvar::XCP::RadarFC_Obj::_g_PL_AD_fw_Radar_1R1V_rpc_XilObjBypassingRunnable_XilObjBypassingRunnable_m_pad_radarObjPort_par_out_local::TChangeableMemPool::_::_::_m_arrayPool::_0_::_elem::_m_objectInformation::_1_::_m_perObjectType::_m_prob1PedestrianN = 0;
      @sysvar::XCP::RadarFC_Obj::_g_PL_AD_fw_Radar_1R1V_rpc_XilObjBypassingRunnable_XilObjBypassingRunnable_m_pad_radarObjPort_par_out_local::TChangeableMemPool::_::_::_m_arrayPool::_0_::_elem::_m_objectInformation::_1_::_m_perObjectType::_m_prob1MovUnknownN = 128;
      @sysvar::XCP::RadarFC_Obj::_g_PL_AD_fw_Radar_1R1V_rpc_XilObjBypassingRunnable_XilObjBypassingRunnable_m_pad_radarObjPort_par_out_local::TChangeableMemPool::_::_::_m_arrayPool::_0_::_elem::_m_objectInformation::_1_::_m_perObjectType::_m_prob1RoadsideBarrierN = 0;
      @sysvar::XCP::RadarFC_Obj::_g_PL_AD_fw_Radar_1R1V_rpc_XilObjBypassingRunnable_XilObjBypassingRunnable_m_pad_radarObjPort_par_out_local::TChangeableMemPool::_::_::_m_arrayPool::_0_::_elem::_m_objectInformation::_1_::_m_perObjectType::_m_prob1StatUnknownN = 128;
      @sysvar::XCP::RadarFC_Obj::_g_PL_AD_fw_Radar_1R1V_rpc_XilObjBypassingRunnable_XilObjBypassingRunnable_m_pad_radarObjPort_par_out_local::TChangeableMemPool::_::_::_m_arrayPool::_0_::_elem::_m_objectInformation::_1_::_m_perObjectType::_m_prob1PassengerCarN = 0;
      @sysvar::XCP::RadarFC_Obj::_g_PL_AD_fw_Radar_1R1V_rpc_XilObjBypassingRunnable_XilObjBypassingRunnable_m_pad_radarObjPort_par_out_local::TChangeableMemPool::_::_::_m_arrayPool::_0_::_elem::_m_objectInformation::_1_::_m_perObjectType::_m_prob1TruckN = 0;
      @sysvar::XCP::RadarFC_Obj::_g_PL_AD_fw_Radar_1R1V_rpc_XilObjBypassingRunnable_XilObjBypassingRunnable_m_pad_radarObjPort_par_out_local::TChangeableMemPool::_::_::_m_arrayPool::_0_::_elem::_m_objectInformation::_1_::_m_perObjectType::_m_prob1FourWheelUnknownN = 128;
      @sysvar::XCP::RadarFC_Obj::_g_PL_AD_fw_Radar_1R1V_rpc_XilObjBypassingRunnable_XilObjBypassingRunnable_m_pad_radarObjPort_par_out_local::TChangeableMemPool::_::_::_m_arrayPool::_0_::_elem::_m_objectInformation::_1_::_m_dWidthN = 256;
        break;

      case 2: //"RoadSideBarrier"
      @sysvar::XCP::RadarFC_Obj::_g_PL_AD_fw_Radar_1R1V_rpc_XilObjBypassingRunnable_XilObjBypassingRunnable_m_pad_radarObjPort_par_out_local::TChangeableMemPool::_::_::_m_arrayPool::_0_::_elem::_m_objectInformation::_1_::_m_perObjectType::_m_prob1ObstacleN = 128;
      @sysvar::XCP::RadarFC_Obj::_g_PL_AD_fw_Radar_1R1V_rpc_XilObjBypassingRunnable_XilObjBypassingRunnable_m_pad_radarObjPort_par_out_local::TChangeableMemPool::_::_::_m_arrayPool::_0_::_elem::_m_objectInformation::_1_::_m_perObjectType::_m_prob1NonObstacleN = 0;
      @sysvar::XCP::RadarFC_Obj::_g_PL_AD_fw_Radar_1R1V_rpc_XilObjBypassingRunnable_XilObjBypassingRunnable_m_pad_radarObjPort_par_out_local::TChangeableMemPool::_::_::_m_arrayPool::_0_::_elem::_m_objectInformation::_1_::_m_perObjectType::_m_prob1UnknownN = 0;
      @sysvar::XCP::RadarFC_Obj::_g_PL_AD_fw_Radar_1R1V_rpc_XilObjBypassingRunnable_XilObjBypassingRunnable_m_pad_radarObjPort_par_out_local::TChangeableMemPool::_::_::_m_arrayPool::_0_::_elem::_m_objectInformation::_1_::_m_perObjectType::_m_prob1MobileN = 0;
      @sysvar::XCP::RadarFC_Obj::_g_PL_AD_fw_Radar_1R1V_rpc_XilObjBypassingRunnable_XilObjBypassingRunnable_m_pad_radarObjPort_par_out_local::TChangeableMemPool::_::_::_m_arrayPool::_0_::_elem::_m_objectInformation::_1_::_m_perObjectType::_m_prob1StationaryN = 128;
      @sysvar::XCP::RadarFC_Obj::_g_PL_AD_fw_Radar_1R1V_rpc_XilObjBypassingRunnable_XilObjBypassingRunnable_m_pad_radarObjPort_par_out_local::TChangeableMemPool::_::_::_m_arrayPool::_0_::_elem::_m_objectInformation::_1_::_m_perObjectType::_m_prob1ObstUnknownN = 0;
      @sysvar::XCP::RadarFC_Obj::_g_PL_AD_fw_Radar_1R1V_rpc_XilObjBypassingRunnable_XilObjBypassingRunnable_m_pad_radarObjPort_par_out_local::TChangeableMemPool::_::_::_m_arrayPool::_0_::_elem::_m_objectInformation::_1_::_m_perObjectType::_m_prob1FourPlusWheelerN = 0;
      @sysvar::XCP::RadarFC_Obj::_g_PL_AD_fw_Radar_1R1V_rpc_XilObjBypassingRunnable_XilObjBypassingRunnable_m_pad_radarObjPort_par_out_local::TChangeableMemPool::_::_::_m_arrayPool::_0_::_elem::_m_objectInformation::_1_::_m_perObjectType::_m_prob1TwoWheelerN = 0;
      @sysvar::XCP::RadarFC_Obj::_g_PL_AD_fw_Radar_1R1V_rpc_XilObjBypassingRunnable_XilObjBypassingRunnable_m_pad_radarObjPort_par_out_local::TChangeableMemPool::_::_::_m_arrayPool::_0_::_elem::_m_objectInformation::_1_::_m_perObjectType::_m_prob1PedestrianN = 0;
      @sysvar::XCP::RadarFC_Obj::_g_PL_AD_fw_Radar_1R1V_rpc_XilObjBypassingRunnable_XilObjBypassingRunnable_m_pad_radarObjPort_par_out_local::TChangeableMemPool::_::_::_m_arrayPool::_0_::_elem::_m_objectInformation::_1_::_m_perObjectType::_m_prob1MovUnknownN = 128;
      @sysvar::XCP::RadarFC_Obj::_g_PL_AD_fw_Radar_1R1V_rpc_XilObjBypassingRunnable_XilObjBypassingRunnable_m_pad_radarObjPort_par_out_local::TChangeableMemPool::_::_::_m_arrayPool::_0_::_elem::_m_objectInformation::_1_::_m_perObjectType::_m_prob1RoadsideBarrierN = 128;
      @sysvar::XCP::RadarFC_Obj::_g_PL_AD_fw_Radar_1R1V_rpc_XilObjBypassingRunnable_XilObjBypassingRunnable_m_pad_radarObjPort_par_out_local::TChangeableMemPool::_::_::_m_arrayPool::_0_::_elem::_m_objectInformation::_1_::_m_perObjectType::_m_prob1StatUnknownN = 0;
      @sysvar::XCP::RadarFC_Obj::_g_PL_AD_fw_Radar_1R1V_rpc_XilObjBypassingRunnable_XilObjBypassingRunnable_m_pad_radarObjPort_par_out_local::TChangeableMemPool::_::_::_m_arrayPool::_0_::_elem::_m_objectInformation::_1_::_m_perObjectType::_m_prob1PassengerCarN = 0;
      @sysvar::XCP::RadarFC_Obj::_g_PL_AD_fw_Radar_1R1V_rpc_XilObjBypassingRunnable_XilObjBypassingRunnable_m_pad_radarObjPort_par_out_local::TChangeableMemPool::_::_::_m_arrayPool::_0_::_elem::_m_objectInformation::_1_::_m_perObjectType::_m_prob1TruckN = 0;
      @sysvar::XCP::RadarFC_Obj::_g_PL_AD_fw_Radar_1R1V_rpc_XilObjBypassingRunnable_XilObjBypassingRunnable_m_pad_radarObjPort_par_out_local::TChangeableMemPool::_::_::_m_arrayPool::_0_::_elem::_m_objectInformation::_1_::_m_perObjectType::_m_prob1FourWheelUnknownN = 128;
      @sysvar::XCP::RadarFC_Obj::_g_PL_AD_fw_Radar_1R1V_rpc_XilObjBypassingRunnable_XilObjBypassingRunnable_m_pad_radarObjPort_par_out_local::TChangeableMemPool::_::_::_m_arrayPool::_0_::_elem::_m_objectInformation::_1_::_m_dWidthN = 256;
        break;

      case 3: //"2Wheeler"
      @sysvar::XCP::RadarFC_Obj::_g_PL_AD_fw_Radar_1R1V_rpc_XilObjBypassingRunnable_XilObjBypassingRunnable_m_pad_radarObjPort_par_out_local::TChangeableMemPool::_::_::_m_arrayPool::_0_::_elem::_m_objectInformation::_1_::_m_perObjectType::_m_prob1ObstacleN = 128;
      @sysvar::XCP::RadarFC_Obj::_g_PL_AD_fw_Radar_1R1V_rpc_XilObjBypassingRunnable_XilObjBypassingRunnable_m_pad_radarObjPort_par_out_local::TChangeableMemPool::_::_::_m_arrayPool::_0_::_elem::_m_objectInformation::_1_::_m_perObjectType::_m_prob1NonObstacleN = 0;
      @sysvar::XCP::RadarFC_Obj::_g_PL_AD_fw_Radar_1R1V_rpc_XilObjBypassingRunnable_XilObjBypassingRunnable_m_pad_radarObjPort_par_out_local::TChangeableMemPool::_::_::_m_arrayPool::_0_::_elem::_m_objectInformation::_1_::_m_perObjectType::_m_prob1UnknownN = 0;
      @sysvar::XCP::RadarFC_Obj::_g_PL_AD_fw_Radar_1R1V_rpc_XilObjBypassingRunnable_XilObjBypassingRunnable_m_pad_radarObjPort_par_out_local::TChangeableMemPool::_::_::_m_arrayPool::_0_::_elem::_m_objectInformation::_1_::_m_perObjectType::_m_prob1MobileN = 128;
      @sysvar::XCP::RadarFC_Obj::_g_PL_AD_fw_Radar_1R1V_rpc_XilObjBypassingRunnable_XilObjBypassingRunnable_m_pad_radarObjPort_par_out_local::TChangeableMemPool::_::_::_m_arrayPool::_0_::_elem::_m_objectInformation::_1_::_m_perObjectType::_m_prob1StationaryN = 0;
      @sysvar::XCP::RadarFC_Obj::_g_PL_AD_fw_Radar_1R1V_rpc_XilObjBypassingRunnable_XilObjBypassingRunnable_m_pad_radarObjPort_par_out_local::TChangeableMemPool::_::_::_m_arrayPool::_0_::_elem::_m_objectInformation::_1_::_m_perObjectType::_m_prob1ObstUnknownN = 0;
      @sysvar::XCP::RadarFC_Obj::_g_PL_AD_fw_Radar_1R1V_rpc_XilObjBypassingRunnable_XilObjBypassingRunnable_m_pad_radarObjPort_par_out_local::TChangeableMemPool::_::_::_m_arrayPool::_0_::_elem::_m_objectInformation::_1_::_m_perObjectType::_m_prob1FourPlusWheelerN = 0;
      @sysvar::XCP::RadarFC_Obj::_g_PL_AD_fw_Radar_1R1V_rpc_XilObjBypassingRunnable_XilObjBypassingRunnable_m_pad_radarObjPort_par_out_local::TChangeableMemPool::_::_::_m_arrayPool::_0_::_elem::_m_objectInformation::_1_::_m_perObjectType::_m_prob1TwoWheelerN = 128;
      @sysvar::XCP::RadarFC_Obj::_g_PL_AD_fw_Radar_1R1V_rpc_XilObjBypassingRunnable_XilObjBypassingRunnable_m_pad_radarObjPort_par_out_local::TChangeableMemPool::_::_::_m_arrayPool::_0_::_elem::_m_objectInformation::_1_::_m_perObjectType::_m_prob1PedestrianN = 0;
      @sysvar::XCP::RadarFC_Obj::_g_PL_AD_fw_Radar_1R1V_rpc_XilObjBypassingRunnable_XilObjBypassingRunnable_m_pad_radarObjPort_par_out_local::TChangeableMemPool::_::_::_m_arrayPool::_0_::_elem::_m_objectInformation::_1_::_m_perObjectType::_m_prob1MovUnknownN = 0;
      @sysvar::XCP::RadarFC_Obj::_g_PL_AD_fw_Radar_1R1V_rpc_XilObjBypassingRunnable_XilObjBypassingRunnable_m_pad_radarObjPort_par_out_local::TChangeableMemPool::_::_::_m_arrayPool::_0_::_elem::_m_objectInformation::_1_::_m_perObjectType::_m_prob1RoadsideBarrierN = 0;
      @sysvar::XCP::RadarFC_Obj::_g_PL_AD_fw_Radar_1R1V_rpc_XilObjBypassingRunnable_XilObjBypassingRunnable_m_pad_radarObjPort_par_out_local::TChangeableMemPool::_::_::_m_arrayPool::_0_::_elem::_m_objectInformation::_1_::_m_perObjectType::_m_prob1StatUnknownN = 128;
      @sysvar::XCP::RadarFC_Obj::_g_PL_AD_fw_Radar_1R1V_rpc_XilObjBypassingRunnable_XilObjBypassingRunnable_m_pad_radarObjPort_par_out_local::TChangeableMemPool::_::_::_m_arrayPool::_0_::_elem::_m_objectInformation::_1_::_m_perObjectType::_m_prob1PassengerCarN = 0;
      @sysvar::XCP::RadarFC_Obj::_g_PL_AD_fw_Radar_1R1V_rpc_XilObjBypassingRunnable_XilObjBypassingRunnable_m_pad_radarObjPort_par_out_local::TChangeableMemPool::_::_::_m_arrayPool::_0_::_elem::_m_objectInformation::_1_::_m_perObjectType::_m_prob1TruckN = 0;
      @sysvar::XCP::RadarFC_Obj::_g_PL_AD_fw_Radar_1R1V_rpc_XilObjBypassingRunnable_XilObjBypassingRunnable_m_pad_radarObjPort_par_out_local::TChangeableMemPool::_::_::_m_arrayPool::_0_::_elem::_m_objectInformation::_1_::_m_perObjectType::_m_prob1FourWheelUnknownN = 128;
      @sysvar::XCP::RadarFC_Obj::_g_PL_AD_fw_Radar_1R1V_rpc_XilObjBypassingRunnable_XilObjBypassingRunnable_m_pad_radarObjPort_par_out_local::TChangeableMemPool::_::_::_m_arrayPool::_0_::_elem::_m_objectInformation::_1_::_m_dWidthN = 64;
        break;

      case 4: //"Pedestrian"
      @sysvar::XCP::RadarFC_Obj::_g_PL_AD_fw_Radar_1R1V_rpc_XilObjBypassingRunnable_XilObjBypassingRunnable_m_pad_radarObjPort_par_out_local::TChangeableMemPool::_::_::_m_arrayPool::_0_::_elem::_m_objectInformation::_1_::_m_perObjectType::_m_prob1ObstacleN = 128;
      @sysvar::XCP::RadarFC_Obj::_g_PL_AD_fw_Radar_1R1V_rpc_XilObjBypassingRunnable_XilObjBypassingRunnable_m_pad_radarObjPort_par_out_local::TChangeableMemPool::_::_::_m_arrayPool::_0_::_elem::_m_objectInformation::_1_::_m_perObjectType::_m_prob1NonObstacleN = 0;
      @sysvar::XCP::RadarFC_Obj::_g_PL_AD_fw_Radar_1R1V_rpc_XilObjBypassingRunnable_XilObjBypassingRunnable_m_pad_radarObjPort_par_out_local::TChangeableMemPool::_::_::_m_arrayPool::_0_::_elem::_m_objectInformation::_1_::_m_perObjectType::_m_prob1UnknownN = 0;
      @sysvar::XCP::RadarFC_Obj::_g_PL_AD_fw_Radar_1R1V_rpc_XilObjBypassingRunnable_XilObjBypassingRunnable_m_pad_radarObjPort_par_out_local::TChangeableMemPool::_::_::_m_arrayPool::_0_::_elem::_m_objectInformation::_1_::_m_perObjectType::_m_prob1MobileN = 128;
      @sysvar::XCP::RadarFC_Obj::_g_PL_AD_fw_Radar_1R1V_rpc_XilObjBypassingRunnable_XilObjBypassingRunnable_m_pad_radarObjPort_par_out_local::TChangeableMemPool::_::_::_m_arrayPool::_0_::_elem::_m_objectInformation::_1_::_m_perObjectType::_m_prob1StationaryN = 0;
      @sysvar::XCP::RadarFC_Obj::_g_PL_AD_fw_Radar_1R1V_rpc_XilObjBypassingRunnable_XilObjBypassingRunnable_m_pad_radarObjPort_par_out_local::TChangeableMemPool::_::_::_m_arrayPool::_0_::_elem::_m_objectInformation::_1_::_m_perObjectType::_m_prob1ObstUnknownN = 0;
      @sysvar::XCP::RadarFC_Obj::_g_PL_AD_fw_Radar_1R1V_rpc_XilObjBypassingRunnable_XilObjBypassingRunnable_m_pad_radarObjPort_par_out_local::TChangeableMemPool::_::_::_m_arrayPool::_0_::_elem::_m_objectInformation::_1_::_m_perObjectType::_m_prob1FourPlusWheelerN = 0;
      @sysvar::XCP::RadarFC_Obj::_g_PL_AD_fw_Radar_1R1V_rpc_XilObjBypassingRunnable_XilObjBypassingRunnable_m_pad_radarObjPort_par_out_local::TChangeableMemPool::_::_::_m_arrayPool::_0_::_elem::_m_objectInformation::_1_::_m_perObjectType::_m_prob1TwoWheelerN = 0;
      @sysvar::XCP::RadarFC_Obj::_g_PL_AD_fw_Radar_1R1V_rpc_XilObjBypassingRunnable_XilObjBypassingRunnable_m_pad_radarObjPort_par_out_local::TChangeableMemPool::_::_::_m_arrayPool::_0_::_elem::_m_objectInformation::_1_::_m_perObjectType::_m_prob1PedestrianN = 128;
      @sysvar::XCP::RadarFC_Obj::_g_PL_AD_fw_Radar_1R1V_rpc_XilObjBypassingRunnable_XilObjBypassingRunnable_m_pad_radarObjPort_par_out_local::TChangeableMemPool::_::_::_m_arrayPool::_0_::_elem::_m_objectInformation::_1_::_m_perObjectType::_m_prob1MovUnknownN = 0;
      @sysvar::XCP::RadarFC_Obj::_g_PL_AD_fw_Radar_1R1V_rpc_XilObjBypassingRunnable_XilObjBypassingRunnable_m_pad_radarObjPort_par_out_local::TChangeableMemPool::_::_::_m_arrayPool::_0_::_elem::_m_objectInformation::_1_::_m_perObjectType::_m_prob1RoadsideBarrierN = 0;
      @sysvar::XCP::RadarFC_Obj::_g_PL_AD_fw_Radar_1R1V_rpc_XilObjBypassingRunnable_XilObjBypassingRunnable_m_pad_radarObjPort_par_out_local::TChangeableMemPool::_::_::_m_arrayPool::_0_::_elem::_m_objectInformation::_1_::_m_perObjectType::_m_prob1StatUnknownN = 128;
      @sysvar::XCP::RadarFC_Obj::_g_PL_AD_fw_Radar_1R1V_rpc_XilObjBypassingRunnable_XilObjBypassingRunnable_m_pad_radarObjPort_par_out_local::TChangeableMemPool::_::_::_m_arrayPool::_0_::_elem::_m_objectInformation::_1_::_m_perObjectType::_m_prob1PassengerCarN = 0;
      @sysvar::XCP::RadarFC_Obj::_g_PL_AD_fw_Radar_1R1V_rpc_XilObjBypassingRunnable_XilObjBypassingRunnable_m_pad_radarObjPort_par_out_local::TChangeableMemPool::_::_::_m_arrayPool::_0_::_elem::_m_objectInformation::_1_::_m_perObjectType::_m_prob1TruckN = 0;
      @sysvar::XCP::RadarFC_Obj::_g_PL_AD_fw_Radar_1R1V_rpc_XilObjBypassingRunnable_XilObjBypassingRunnable_m_pad_radarObjPort_par_out_local::TChangeableMemPool::_::_::_m_arrayPool::_0_::_elem::_m_objectInformation::_1_::_m_perObjectType::_m_prob1FourWheelUnknownN = 128;
      @sysvar::XCP::RadarFC_Obj::_g_PL_AD_fw_Radar_1R1V_rpc_XilObjBypassingRunnable_XilObjBypassingRunnable_m_pad_radarObjPort_par_out_local::TChangeableMemPool::_::_::_m_arrayPool::_0_::_elem::_m_objectInformation::_1_::_m_dWidthN = 64;
        break;

      case 5: //"Truck"
      @sysvar::XCP::RadarFC_Obj::_g_PL_AD_fw_Radar_1R1V_rpc_XilObjBypassingRunnable_XilObjBypassingRunnable_m_pad_radarObjPort_par_out_local::TChangeableMemPool::_::_::_m_arrayPool::_0_::_elem::_m_objectInformation::_1_::_m_perObjectType::_m_prob1ObstacleN = 128;
      @sysvar::XCP::RadarFC_Obj::_g_PL_AD_fw_Radar_1R1V_rpc_XilObjBypassingRunnable_XilObjBypassingRunnable_m_pad_radarObjPort_par_out_local::TChangeableMemPool::_::_::_m_arrayPool::_0_::_elem::_m_objectInformation::_1_::_m_perObjectType::_m_prob1NonObstacleN = 0;
      @sysvar::XCP::RadarFC_Obj::_g_PL_AD_fw_Radar_1R1V_rpc_XilObjBypassingRunnable_XilObjBypassingRunnable_m_pad_radarObjPort_par_out_local::TChangeableMemPool::_::_::_m_arrayPool::_0_::_elem::_m_objectInformation::_1_::_m_perObjectType::_m_prob1UnknownN = 0;
      @sysvar::XCP::RadarFC_Obj::_g_PL_AD_fw_Radar_1R1V_rpc_XilObjBypassingRunnable_XilObjBypassingRunnable_m_pad_radarObjPort_par_out_local::TChangeableMemPool::_::_::_m_arrayPool::_0_::_elem::_m_objectInformation::_1_::_m_perObjectType::_m_prob1MobileN = 128;
      @sysvar::XCP::RadarFC_Obj::_g_PL_AD_fw_Radar_1R1V_rpc_XilObjBypassingRunnable_XilObjBypassingRunnable_m_pad_radarObjPort_par_out_local::TChangeableMemPool::_::_::_m_arrayPool::_0_::_elem::_m_objectInformation::_1_::_m_perObjectType::_m_prob1StationaryN = 0;
      @sysvar::XCP::RadarFC_Obj::_g_PL_AD_fw_Radar_1R1V_rpc_XilObjBypassingRunnable_XilObjBypassingRunnable_m_pad_radarObjPort_par_out_local::TChangeableMemPool::_::_::_m_arrayPool::_0_::_elem::_m_objectInformation::_1_::_m_perObjectType::_m_prob1ObstUnknownN = 0;
      @sysvar::XCP::RadarFC_Obj::_g_PL_AD_fw_Radar_1R1V_rpc_XilObjBypassingRunnable_XilObjBypassingRunnable_m_pad_radarObjPort_par_out_local::TChangeableMemPool::_::_::_m_arrayPool::_0_::_elem::_m_objectInformation::_1_::_m_perObjectType::_m_prob1FourPlusWheelerN = 128;
      @sysvar::XCP::RadarFC_Obj::_g_PL_AD_fw_Radar_1R1V_rpc_XilObjBypassingRunnable_XilObjBypassingRunnable_m_pad_radarObjPort_par_out_local::TChangeableMemPool::_::_::_m_arrayPool::_0_::_elem::_m_objectInformation::_1_::_m_perObjectType::_m_prob1TwoWheelerN = 0;
      @sysvar::XCP::RadarFC_Obj::_g_PL_AD_fw_Radar_1R1V_rpc_XilObjBypassingRunnable_XilObjBypassingRunnable_m_pad_radarObjPort_par_out_local::TChangeableMemPool::_::_::_m_arrayPool::_0_::_elem::_m_objectInformation::_1_::_m_perObjectType::_m_prob1PedestrianN = 0;
      @sysvar::XCP::RadarFC_Obj::_g_PL_AD_fw_Radar_1R1V_rpc_XilObjBypassingRunnable_XilObjBypassingRunnable_m_pad_radarObjPort_par_out_local::TChangeableMemPool::_::_::_m_arrayPool::_0_::_elem::_m_objectInformation::_1_::_m_perObjectType::_m_prob1MovUnknownN = 0;
      @sysvar::XCP::RadarFC_Obj::_g_PL_AD_fw_Radar_1R1V_rpc_XilObjBypassingRunnable_XilObjBypassingRunnable_m_pad_radarObjPort_par_out_local::TChangeableMemPool::_::_::_m_arrayPool::_0_::_elem::_m_objectInformation::_1_::_m_perObjectType::_m_prob1RoadsideBarrierN = 0;
      @sysvar::XCP::RadarFC_Obj::_g_PL_AD_fw_Radar_1R1V_rpc_XilObjBypassingRunnable_XilObjBypassingRunnable_m_pad_radarObjPort_par_out_local::TChangeableMemPool::_::_::_m_arrayPool::_0_::_elem::_m_objectInformation::_1_::_m_perObjectType::_m_prob1StatUnknownN = 128;
      @sysvar::XCP::RadarFC_Obj::_g_PL_AD_fw_Radar_1R1V_rpc_XilObjBypassingRunnable_XilObjBypassingRunnable_m_pad_radarObjPort_par_out_local::TChangeableMemPool::_::_::_m_arrayPool::_0_::_elem::_m_objectInformation::_1_::_m_perObjectType::_m_prob1PassengerCarN = 0;
      @sysvar::XCP::RadarFC_Obj::_g_PL_AD_fw_Radar_1R1V_rpc_XilObjBypassingRunnable_XilObjBypassingRunnable_m_pad_radarObjPort_par_out_local::TChangeableMemPool::_::_::_m_arrayPool::_0_::_elem::_m_objectInformation::_1_::_m_perObjectType::_m_prob1TruckN = 128;
      @sysvar::XCP::RadarFC_Obj::_g_PL_AD_fw_Radar_1R1V_rpc_XilObjBypassingRunnable_XilObjBypassingRunnable_m_pad_radarObjPort_par_out_local::TChangeableMemPool::_::_::_m_arrayPool::_0_::_elem::_m_objectInformation::_1_::_m_perObjectType::_m_prob1FourWheelUnknownN = 0;
      @sysvar::XCP::RadarFC_Obj::_g_PL_AD_fw_Radar_1R1V_rpc_XilObjBypassingRunnable_XilObjBypassingRunnable_m_pad_radarObjPort_par_out_local::TChangeableMemPool::_::_::_m_arrayPool::_0_::_elem::_m_objectInformation::_1_::_m_dWidthN = 256;
        break;

      case 6: //"PassengerCar"
      @sysvar::XCP::RadarFC_Obj::_g_PL_AD_fw_Radar_1R1V_rpc_XilObjBypassingRunnable_XilObjBypassingRunnable_m_pad_radarObjPort_par_out_local::TChangeableMemPool::_::_::_m_arrayPool::_0_::_elem::_m_objectInformation::_1_::_m_perObjectType::_m_prob1ObstacleN = 128;
      @sysvar::XCP::RadarFC_Obj::_g_PL_AD_fw_Radar_1R1V_rpc_XilObjBypassingRunnable_XilObjBypassingRunnable_m_pad_radarObjPort_par_out_local::TChangeableMemPool::_::_::_m_arrayPool::_0_::_elem::_m_objectInformation::_1_::_m_perObjectType::_m_prob1NonObstacleN = 0;
      @sysvar::XCP::RadarFC_Obj::_g_PL_AD_fw_Radar_1R1V_rpc_XilObjBypassingRunnable_XilObjBypassingRunnable_m_pad_radarObjPort_par_out_local::TChangeableMemPool::_::_::_m_arrayPool::_0_::_elem::_m_objectInformation::_1_::_m_perObjectType::_m_prob1UnknownN = 0;
      @sysvar::XCP::RadarFC_Obj::_g_PL_AD_fw_Radar_1R1V_rpc_XilObjBypassingRunnable_XilObjBypassingRunnable_m_pad_radarObjPort_par_out_local::TChangeableMemPool::_::_::_m_arrayPool::_0_::_elem::_m_objectInformation::_1_::_m_perObjectType::_m_prob1MobileN = 128;
      @sysvar::XCP::RadarFC_Obj::_g_PL_AD_fw_Radar_1R1V_rpc_XilObjBypassingRunnable_XilObjBypassingRunnable_m_pad_radarObjPort_par_out_local::TChangeableMemPool::_::_::_m_arrayPool::_0_::_elem::_m_objectInformation::_1_::_m_perObjectType::_m_prob1StationaryN = 0;
      @sysvar::XCP::RadarFC_Obj::_g_PL_AD_fw_Radar_1R1V_rpc_XilObjBypassingRunnable_XilObjBypassingRunnable_m_pad_radarObjPort_par_out_local::TChangeableMemPool::_::_::_m_arrayPool::_0_::_elem::_m_objectInformation::_1_::_m_perObjectType::_m_prob1ObstUnknownN = 0;
      @sysvar::XCP::RadarFC_Obj::_g_PL_AD_fw_Radar_1R1V_rpc_XilObjBypassingRunnable_XilObjBypassingRunnable_m_pad_radarObjPort_par_out_local::TChangeableMemPool::_::_::_m_arrayPool::_0_::_elem::_m_objectInformation::_1_::_m_perObjectType::_m_prob1FourPlusWheelerN = 128;
      @sysvar::XCP::RadarFC_Obj::_g_PL_AD_fw_Radar_1R1V_rpc_XilObjBypassingRunnable_XilObjBypassingRunnable_m_pad_radarObjPort_par_out_local::TChangeableMemPool::_::_::_m_arrayPool::_0_::_elem::_m_objectInformation::_1_::_m_perObjectType::_m_prob1TwoWheelerN = 0;
      @sysvar::XCP::RadarFC_Obj::_g_PL_AD_fw_Radar_1R1V_rpc_XilObjBypassingRunnable_XilObjBypassingRunnable_m_pad_radarObjPort_par_out_local::TChangeableMemPool::_::_::_m_arrayPool::_0_::_elem::_m_objectInformation::_1_::_m_perObjectType::_m_prob1PedestrianN = 0;
      @sysvar::XCP::RadarFC_Obj::_g_PL_AD_fw_Radar_1R1V_rpc_XilObjBypassingRunnable_XilObjBypassingRunnable_m_pad_radarObjPort_par_out_local::TChangeableMemPool::_::_::_m_arrayPool::_0_::_elem::_m_objectInformation::_1_::_m_perObjectType::_m_prob1MovUnknownN = 0;
      @sysvar::XCP::RadarFC_Obj::_g_PL_AD_fw_Radar_1R1V_rpc_XilObjBypassingRunnable_XilObjBypassingRunnable_m_pad_radarObjPort_par_out_local::TChangeableMemPool::_::_::_m_arrayPool::_0_::_elem::_m_objectInformation::_1_::_m_perObjectType::_m_prob1RoadsideBarrierN = 0;
      @sysvar::XCP::RadarFC_Obj::_g_PL_AD_fw_Radar_1R1V_rpc_XilObjBypassingRunnable_XilObjBypassingRunnable_m_pad_radarObjPort_par_out_local::TChangeableMemPool::_::_::_m_arrayPool::_0_::_elem::_m_objectInformation::_1_::_m_perObjectType::_m_prob1StatUnknownN = 128;
      @sysvar::XCP::RadarFC_Obj::_g_PL_AD_fw_Radar_1R1V_rpc_XilObjBypassingRunnable_XilObjBypassingRunnable_m_pad_radarObjPort_par_out_local::TChangeableMemPool::_::_::_m_arrayPool::_0_::_elem::_m_objectInformation::_1_::_m_perObjectType::_m_prob1PassengerCarN = 128;
      @sysvar::XCP::RadarFC_Obj::_g_PL_AD_fw_Radar_1R1V_rpc_XilObjBypassingRunnable_XilObjBypassingRunnable_m_pad_radarObjPort_par_out_local::TChangeableMemPool::_::_::_m_arrayPool::_0_::_elem::_m_objectInformation::_1_::_m_perObjectType::_m_prob1TruckN = 0;
      @sysvar::XCP::RadarFC_Obj::_g_PL_AD_fw_Radar_1R1V_rpc_XilObjBypassingRunnable_XilObjBypassingRunnable_m_pad_radarObjPort_par_out_local::TChangeableMemPool::_::_::_m_arrayPool::_0_::_elem::_m_objectInformation::_1_::_m_perObjectType::_m_prob1FourWheelUnknownN = 0;
      @sysvar::XCP::RadarFC_Obj::_g_PL_AD_fw_Radar_1R1V_rpc_XilObjBypassingRunnable_XilObjBypassingRunnable_m_pad_radarObjPort_par_out_local::TChangeableMemPool::_::_::_m_arrayPool::_0_::_elem::_m_objectInformation::_1_::_m_dWidthN = 256;
        break;
    }
    break;

    case 2: //"Object-2"
    //constant
  @sysvar::XCP::RadarFC_Obj::_g_PL_AD_fw_Radar_1R1V_rpc_XilObjBypassingRunnable_XilObjBypassingRunnable_m_pad_radarObjPort_par_out_local::TChangeableMemPool::_::_::_m_arrayPool::_0_::_elem::_m_objectInformation::_2_::_Valid_b = 1;
  @sysvar::XCP::RadarFC_Obj::_g_PL_AD_fw_Radar_1R1V_rpc_XilObjBypassingRunnable_XilObjBypassingRunnable_m_pad_radarObjPort_par_out_local::TChangeableMemPool::_::_::_m_arrayPool::_0_::_elem::_m_objectInformation::_2_::_m_HandleN = 1;
  @sysvar::XCP::RadarFC_Obj::_g_PL_AD_fw_Radar_1R1V_rpc_XilObjBypassingRunnable_XilObjBypassingRunnable_m_pad_radarObjPort_par_out_local::TChangeableMemPool::_::_::_m_arrayPool::_0_::_elem::_m_objectInformation::_2_::_m_alpPiVarYawAngleN = 0;
  @sysvar::XCP::RadarFC_Obj::_g_PL_AD_fw_Radar_1R1V_rpc_XilObjBypassingRunnable_XilObjBypassingRunnable_m_pad_radarObjPort_par_out_local::TChangeableMemPool::_::_::_m_arrayPool::_0_::_elem::_m_objectInformation::_2_::_m_alpPiYawAngleN = 0;
  @sysvar::XCP::RadarFC_Obj::_g_PL_AD_fw_Radar_1R1V_rpc_XilObjBypassingRunnable_XilObjBypassingRunnable_m_pad_radarObjPort_par_out_local::TChangeableMemPool::_::_::_m_arrayPool::_0_::_elem::_m_objectInformation::_2_::_m_varAxN = 0;
  @sysvar::XCP::RadarFC_Obj::_g_PL_AD_fw_Radar_1R1V_rpc_XilObjBypassingRunnable_XilObjBypassingRunnable_m_pad_radarObjPort_par_out_local::TChangeableMemPool::_::_::_m_arrayPool::_0_::_elem::_m_objectInformation::_2_::_m_varAyN = 0;
  @sysvar::XCP::RadarFC_Obj::_g_PL_AD_fw_Radar_1R1V_rpc_XilObjBypassingRunnable_XilObjBypassingRunnable_m_pad_radarObjPort_par_out_local::TChangeableMemPool::_::_::_m_arrayPool::_0_::_elem::_m_objectInformation::_2_::_m_varVxN = 0;
  @sysvar::XCP::RadarFC_Obj::_g_PL_AD_fw_Radar_1R1V_rpc_XilObjBypassingRunnable_XilObjBypassingRunnable_m_pad_radarObjPort_par_out_local::TChangeableMemPool::_::_::_m_arrayPool::_0_::_elem::_m_objectInformation::_2_::_m_varVyN = 0;
  @sysvar::XCP::RadarFC_Obj::_g_PL_AD_fw_Radar_1R1V_rpc_XilObjBypassingRunnable_XilObjBypassingRunnable_m_pad_radarObjPort_par_out_local::TChangeableMemPool::_::_::_m_arrayPool::_0_::_elem::_m_objectInformation::_2_::_m_varDxN = 0;
  @sysvar::XCP::RadarFC_Obj::_g_PL_AD_fw_Radar_1R1V_rpc_XilObjBypassingRunnable_XilObjBypassingRunnable_m_pad_radarObjPort_par_out_local::TChangeableMemPool::_::_::_m_arrayPool::_0_::_elem::_m_objectInformation::_2_::_m_varDyN = 0;
  @sysvar::XCP::RadarFC_Obj::_g_PL_AD_fw_Radar_1R1V_rpc_XilObjBypassingRunnable_XilObjBypassingRunnable_m_pad_radarObjPort_par_out_local::TChangeableMemPool::_::_::_m_arrayPool::_0_::_elem::_m_objectInformation::_2_::_m_dVarLengthN = 0;
  @sysvar::XCP::RadarFC_Obj::_g_PL_AD_fw_Radar_1R1V_rpc_XilObjBypassingRunnable_XilObjBypassingRunnable_m_pad_radarObjPort_par_out_local::TChangeableMemPool::_::_::_m_arrayPool::_0_::_elem::_m_objectInformation::_2_::_m_dVarWidthN = 0;
  @sysvar::XCP::RadarFC_Obj::_g_PL_AD_fw_Radar_1R1V_rpc_XilObjBypassingRunnable_XilObjBypassingRunnable_m_pad_radarObjPort_par_out_local::TChangeableMemPool::_::_::_m_arrayPool::_0_::_elem::_m_objectInformation::_2_::_m_wExistProbN = 64880;
  @sysvar::XCP::RadarFC_Obj::_g_PL_AD_fw_Radar_1R1V_rpc_XilObjBypassingRunnable_XilObjBypassingRunnable_m_pad_radarObjPort_par_out_local::TChangeableMemPool::_::_::_m_arrayPool::_0_::_elem::_m_objectInformation::_2_::_m_isObjectAsil = 1;
  @sysvar::XCP::RadarFC_Obj::_g_PL_AD_fw_Radar_1R1V_rpc_XilObjBypassingRunnable_XilObjBypassingRunnable_m_pad_radarObjPort_par_out_local::TChangeableMemPool::_::_::_m_arrayPool::_0_::_elem::_m_objectInformation::_2_::_m_dLengthN = 128;

    //target movement

  @sysvar::XCP::RadarFC_Obj::_g_PL_AD_fw_Radar_1R1V_rpc_XilObjBypassingRunnable_XilObjBypassingRunnable_m_pad_radarObjPort_par_out_local::TChangeableMemPool::_::_::_m_arrayPool::_0_::_elem::_m_objectInformation::_2_::_m_dxN = @target_radar_fc_sim::objdata.obj_distance_x[2] * 128;
  @sysvar::XCP::RadarFC_Obj::_g_PL_AD_fw_Radar_1R1V_rpc_XilObjBypassingRunnable_XilObjBypassingRunnable_m_pad_radarObjPort_par_out_local::TChangeableMemPool::_::_::_m_arrayPool::_0_::_elem::_m_objectInformation::_2_::_m_dyN = @target_radar_fc_sim::objdata.obj_distance_y[2] * 128;
  @sysvar::XCP::RadarFC_Obj::_g_PL_AD_fw_Radar_1R1V_rpc_XilObjBypassingRunnable_XilObjBypassingRunnable_m_pad_radarObjPort_par_out_local::TChangeableMemPool::_::_::_m_arrayPool::_0_::_elem::_m_objectInformation::_2_::_m_dzN = 0;
  @sysvar::XCP::RadarFC_Obj::_g_PL_AD_fw_Radar_1R1V_rpc_XilObjBypassingRunnable_XilObjBypassingRunnable_m_pad_radarObjPort_par_out_local::TChangeableMemPool::_::_::_m_arrayPool::_0_::_elem::_m_objectInformation::_2_::_m_vxN = @target_radar_fc_sim::objdata.obj_velocity_x[2] * 256;
  @sysvar::XCP::RadarFC_Obj::_g_PL_AD_fw_Radar_1R1V_rpc_XilObjBypassingRunnable_XilObjBypassingRunnable_m_pad_radarObjPort_par_out_local::TChangeableMemPool::_::_::_m_arrayPool::_0_::_elem::_m_objectInformation::_2_::_m_vyN = @target_radar_fc_sim::objdata.obj_velocity_y[2] * 256;
  @sysvar::XCP::RadarFC_Obj::_g_PL_AD_fw_Radar_1R1V_rpc_XilObjBypassingRunnable_XilObjBypassingRunnable_m_pad_radarObjPort_par_out_local::TChangeableMemPool::_::_::_m_arrayPool::_0_::_elem::_m_objectInformation::_2_::_m_axN = 0;
  @sysvar::XCP::RadarFC_Obj::_g_PL_AD_fw_Radar_1R1V_rpc_XilObjBypassingRunnable_XilObjBypassingRunnable_m_pad_radarObjPort_par_out_local::TChangeableMemPool::_::_::_m_arrayPool::_0_::_elem::_m_objectInformation::_2_::_m_ayN = 0;

    //target object moving or not
    if (abs(@target_radar_fc_sim::objdata.obj_velocity_x[2]) != 0)
    {
    @sysvar::XCP::RadarFC_Obj::_g_PL_AD_fw_Radar_1R1V_rpc_XilObjBypassingRunnable_XilObjBypassingRunnable_m_pad_radarObjPort_par_out_local::TChangeableMemPool::_::_::_m_arrayPool::_0_::_elem::_m_objectInformation::_2_::_m_prob1HasBeenObservedMovingN = 126;
    @sysvar::XCP::RadarFC_Obj::_g_PL_AD_fw_Radar_1R1V_rpc_XilObjBypassingRunnable_XilObjBypassingRunnable_m_pad_radarObjPort_par_out_local::TChangeableMemPool::_::_::_m_arrayPool::_0_::_elem::_m_objectInformation::_2_::_m_prob1MovingN = 126;
    }
    else
    {
    @sysvar::XCP::RadarFC_Obj::_g_PL_AD_fw_Radar_1R1V_rpc_XilObjBypassingRunnable_XilObjBypassingRunnable_m_pad_radarObjPort_par_out_local::TChangeableMemPool::_::_::_m_arrayPool::_0_::_elem::_m_objectInformation::_2_::_m_prob1HasBeenObservedMovingN = 0;
    @sysvar::XCP::RadarFC_Obj::_g_PL_AD_fw_Radar_1R1V_rpc_XilObjBypassingRunnable_XilObjBypassingRunnable_m_pad_radarObjPort_par_out_local::TChangeableMemPool::_::_::_m_arrayPool::_0_::_elem::_m_objectInformation::_2_::_m_prob1MovingN = 0;
    }

      //object classification
    switch (@target_radar_fc_sim::objdata.obj_type[2])
    {
      case 0: //"Non-Obstacle"
      @sysvar::XCP::RadarFC_Obj::_g_PL_AD_fw_Radar_1R1V_rpc_XilObjBypassingRunnable_XilObjBypassingRunnable_m_pad_radarObjPort_par_out_local::TChangeableMemPool::_::_::_m_arrayPool::_0_::_elem::_m_objectInformation::_2_::_m_perObjectType::_m_prob1ObstacleN = 0;
      @sysvar::XCP::RadarFC_Obj::_g_PL_AD_fw_Radar_1R1V_rpc_XilObjBypassingRunnable_XilObjBypassingRunnable_m_pad_radarObjPort_par_out_local::TChangeableMemPool::_::_::_m_arrayPool::_0_::_elem::_m_objectInformation::_2_::_m_perObjectType::_m_prob1NonObstacleN = 128;
      @sysvar::XCP::RadarFC_Obj::_g_PL_AD_fw_Radar_1R1V_rpc_XilObjBypassingRunnable_XilObjBypassingRunnable_m_pad_radarObjPort_par_out_local::TChangeableMemPool::_::_::_m_arrayPool::_0_::_elem::_m_objectInformation::_2_::_m_perObjectType::_m_prob1UnknownN = 0;
      @sysvar::XCP::RadarFC_Obj::_g_PL_AD_fw_Radar_1R1V_rpc_XilObjBypassingRunnable_XilObjBypassingRunnable_m_pad_radarObjPort_par_out_local::TChangeableMemPool::_::_::_m_arrayPool::_0_::_elem::_m_objectInformation::_2_::_m_perObjectType::_m_prob1MobileN = 0;
      @sysvar::XCP::RadarFC_Obj::_g_PL_AD_fw_Radar_1R1V_rpc_XilObjBypassingRunnable_XilObjBypassingRunnable_m_pad_radarObjPort_par_out_local::TChangeableMemPool::_::_::_m_arrayPool::_0_::_elem::_m_objectInformation::_2_::_m_perObjectType::_m_prob1StationaryN = 0;
      @sysvar::XCP::RadarFC_Obj::_g_PL_AD_fw_Radar_1R1V_rpc_XilObjBypassingRunnable_XilObjBypassingRunnable_m_pad_radarObjPort_par_out_local::TChangeableMemPool::_::_::_m_arrayPool::_0_::_elem::_m_objectInformation::_2_::_m_perObjectType::_m_prob1ObstUnknownN = 128;
      @sysvar::XCP::RadarFC_Obj::_g_PL_AD_fw_Radar_1R1V_rpc_XilObjBypassingRunnable_XilObjBypassingRunnable_m_pad_radarObjPort_par_out_local::TChangeableMemPool::_::_::_m_arrayPool::_0_::_elem::_m_objectInformation::_2_::_m_perObjectType::_m_prob1FourPlusWheelerN = 0;
      @sysvar::XCP::RadarFC_Obj::_g_PL_AD_fw_Radar_1R1V_rpc_XilObjBypassingRunnable_XilObjBypassingRunnable_m_pad_radarObjPort_par_out_local::TChangeableMemPool::_::_::_m_arrayPool::_0_::_elem::_m_objectInformation::_2_::_m_perObjectType::_m_prob1TwoWheelerN = 0;
      @sysvar::XCP::RadarFC_Obj::_g_PL_AD_fw_Radar_1R1V_rpc_XilObjBypassingRunnable_XilObjBypassingRunnable_m_pad_radarObjPort_par_out_local::TChangeableMemPool::_::_::_m_arrayPool::_0_::_elem::_m_objectInformation::_2_::_m_perObjectType::_m_prob1PedestrianN = 0;
      @sysvar::XCP::RadarFC_Obj::_g_PL_AD_fw_Radar_1R1V_rpc_XilObjBypassingRunnable_XilObjBypassingRunnable_m_pad_radarObjPort_par_out_local::TChangeableMemPool::_::_::_m_arrayPool::_0_::_elem::_m_objectInformation::_2_::_m_perObjectType::_m_prob1MovUnknownN = 128;
      @sysvar::XCP::RadarFC_Obj::_g_PL_AD_fw_Radar_1R1V_rpc_XilObjBypassingRunnable_XilObjBypassingRunnable_m_pad_radarObjPort_par_out_local::TChangeableMemPool::_::_::_m_arrayPool::_0_::_elem::_m_objectInformation::_2_::_m_perObjectType::_m_prob1RoadsideBarrierN = 0;
      @sysvar::XCP::RadarFC_Obj::_g_PL_AD_fw_Radar_1R1V_rpc_XilObjBypassingRunnable_XilObjBypassingRunnable_m_pad_radarObjPort_par_out_local::TChangeableMemPool::_::_::_m_arrayPool::_0_::_elem::_m_objectInformation::_2_::_m_perObjectType::_m_prob1StatUnknownN = 128;
      @sysvar::XCP::RadarFC_Obj::_g_PL_AD_fw_Radar_1R1V_rpc_XilObjBypassingRunnable_XilObjBypassingRunnable_m_pad_radarObjPort_par_out_local::TChangeableMemPool::_::_::_m_arrayPool::_0_::_elem::_m_objectInformation::_2_::_m_perObjectType::_m_prob1PassengerCarN = 0;
      @sysvar::XCP::RadarFC_Obj::_g_PL_AD_fw_Radar_1R1V_rpc_XilObjBypassingRunnable_XilObjBypassingRunnable_m_pad_radarObjPort_par_out_local::TChangeableMemPool::_::_::_m_arrayPool::_0_::_elem::_m_objectInformation::_2_::_m_perObjectType::_m_prob1TruckN = 0;
      @sysvar::XCP::RadarFC_Obj::_g_PL_AD_fw_Radar_1R1V_rpc_XilObjBypassingRunnable_XilObjBypassingRunnable_m_pad_radarObjPort_par_out_local::TChangeableMemPool::_::_::_m_arrayPool::_0_::_elem::_m_objectInformation::_2_::_m_perObjectType::_m_prob1FourWheelUnknownN = 128;
      @sysvar::XCP::RadarFC_Obj::_g_PL_AD_fw_Radar_1R1V_rpc_XilObjBypassingRunnable_XilObjBypassingRunnable_m_pad_radarObjPort_par_out_local::TChangeableMemPool::_::_::_m_arrayPool::_0_::_elem::_m_objectInformation::_2_::_m_dWidthN = 256;
        break;

      case 1: //"unknown"
      @sysvar::XCP::RadarFC_Obj::_g_PL_AD_fw_Radar_1R1V_rpc_XilObjBypassingRunnable_XilObjBypassingRunnable_m_pad_radarObjPort_par_out_local::TChangeableMemPool::_::_::_m_arrayPool::_0_::_elem::_m_objectInformation::_2_::_m_perObjectType::_m_prob1ObstacleN = 0;
      @sysvar::XCP::RadarFC_Obj::_g_PL_AD_fw_Radar_1R1V_rpc_XilObjBypassingRunnable_XilObjBypassingRunnable_m_pad_radarObjPort_par_out_local::TChangeableMemPool::_::_::_m_arrayPool::_0_::_elem::_m_objectInformation::_2_::_m_perObjectType::_m_prob1NonObstacleN = 0;
      @sysvar::XCP::RadarFC_Obj::_g_PL_AD_fw_Radar_1R1V_rpc_XilObjBypassingRunnable_XilObjBypassingRunnable_m_pad_radarObjPort_par_out_local::TChangeableMemPool::_::_::_m_arrayPool::_0_::_elem::_m_objectInformation::_2_::_m_perObjectType::_m_prob1UnknownN = 128;
      @sysvar::XCP::RadarFC_Obj::_g_PL_AD_fw_Radar_1R1V_rpc_XilObjBypassingRunnable_XilObjBypassingRunnable_m_pad_radarObjPort_par_out_local::TChangeableMemPool::_::_::_m_arrayPool::_0_::_elem::_m_objectInformation::_2_::_m_perObjectType::_m_prob1MobileN = 0;
      @sysvar::XCP::RadarFC_Obj::_g_PL_AD_fw_Radar_1R1V_rpc_XilObjBypassingRunnable_XilObjBypassingRunnable_m_pad_radarObjPort_par_out_local::TChangeableMemPool::_::_::_m_arrayPool::_0_::_elem::_m_objectInformation::_2_::_m_perObjectType::_m_prob1StationaryN = 0;
      @sysvar::XCP::RadarFC_Obj::_g_PL_AD_fw_Radar_1R1V_rpc_XilObjBypassingRunnable_XilObjBypassingRunnable_m_pad_radarObjPort_par_out_local::TChangeableMemPool::_::_::_m_arrayPool::_0_::_elem::_m_objectInformation::_2_::_m_perObjectType::_m_prob1ObstUnknownN = 128;
      @sysvar::XCP::RadarFC_Obj::_g_PL_AD_fw_Radar_1R1V_rpc_XilObjBypassingRunnable_XilObjBypassingRunnable_m_pad_radarObjPort_par_out_local::TChangeableMemPool::_::_::_m_arrayPool::_0_::_elem::_m_objectInformation::_2_::_m_perObjectType::_m_prob1FourPlusWheelerN = 0;
      @sysvar::XCP::RadarFC_Obj::_g_PL_AD_fw_Radar_1R1V_rpc_XilObjBypassingRunnable_XilObjBypassingRunnable_m_pad_radarObjPort_par_out_local::TChangeableMemPool::_::_::_m_arrayPool::_0_::_elem::_m_objectInformation::_2_::_m_perObjectType::_m_prob1TwoWheelerN = 0;
      @sysvar::XCP::RadarFC_Obj::_g_PL_AD_fw_Radar_1R1V_rpc_XilObjBypassingRunnable_XilObjBypassingRunnable_m_pad_radarObjPort_par_out_local::TChangeableMemPool::_::_::_m_arrayPool::_0_::_elem::_m_objectInformation::_2_::_m_perObjectType::_m_prob1PedestrianN = 0;
      @sysvar::XCP::RadarFC_Obj::_g_PL_AD_fw_Radar_1R1V_rpc_XilObjBypassingRunnable_XilObjBypassingRunnable_m_pad_radarObjPort_par_out_local::TChangeableMemPool::_::_::_m_arrayPool::_0_::_elem::_m_objectInformation::_2_::_m_perObjectType::_m_prob1MovUnknownN = 128;
      @sysvar::XCP::RadarFC_Obj::_g_PL_AD_fw_Radar_1R1V_rpc_XilObjBypassingRunnable_XilObjBypassingRunnable_m_pad_radarObjPort_par_out_local::TChangeableMemPool::_::_::_m_arrayPool::_0_::_elem::_m_objectInformation::_2_::_m_perObjectType::_m_prob1RoadsideBarrierN = 0;
      @sysvar::XCP::RadarFC_Obj::_g_PL_AD_fw_Radar_1R1V_rpc_XilObjBypassingRunnable_XilObjBypassingRunnable_m_pad_radarObjPort_par_out_local::TChangeableMemPool::_::_::_m_arrayPool::_0_::_elem::_m_objectInformation::_2_::_m_perObjectType::_m_prob1StatUnknownN = 128;
      @sysvar::XCP::RadarFC_Obj::_g_PL_AD_fw_Radar_1R1V_rpc_XilObjBypassingRunnable_XilObjBypassingRunnable_m_pad_radarObjPort_par_out_local::TChangeableMemPool::_::_::_m_arrayPool::_0_::_elem::_m_objectInformation::_2_::_m_perObjectType::_m_prob1PassengerCarN = 0;
      @sysvar::XCP::RadarFC_Obj::_g_PL_AD_fw_Radar_1R1V_rpc_XilObjBypassingRunnable_XilObjBypassingRunnable_m_pad_radarObjPort_par_out_local::TChangeableMemPool::_::_::_m_arrayPool::_0_::_elem::_m_objectInformation::_2_::_m_perObjectType::_m_prob1TruckN = 0;
      @sysvar::XCP::RadarFC_Obj::_g_PL_AD_fw_Radar_1R1V_rpc_XilObjBypassingRunnable_XilObjBypassingRunnable_m_pad_radarObjPort_par_out_local::TChangeableMemPool::_::_::_m_arrayPool::_0_::_elem::_m_objectInformation::_2_::_m_perObjectType::_m_prob1FourWheelUnknownN = 128;
      @sysvar::XCP::RadarFC_Obj::_g_PL_AD_fw_Radar_1R1V_rpc_XilObjBypassingRunnable_XilObjBypassingRunnable_m_pad_radarObjPort_par_out_local::TChangeableMemPool::_::_::_m_arrayPool::_0_::_elem::_m_objectInformation::_2_::_m_dWidthN = 256;
        break;

      case 2: //"RoadSideBarrier"
      @sysvar::XCP::RadarFC_Obj::_g_PL_AD_fw_Radar_1R1V_rpc_XilObjBypassingRunnable_XilObjBypassingRunnable_m_pad_radarObjPort_par_out_local::TChangeableMemPool::_::_::_m_arrayPool::_0_::_elem::_m_objectInformation::_2_::_m_perObjectType::_m_prob1ObstacleN = 128;
      @sysvar::XCP::RadarFC_Obj::_g_PL_AD_fw_Radar_1R1V_rpc_XilObjBypassingRunnable_XilObjBypassingRunnable_m_pad_radarObjPort_par_out_local::TChangeableMemPool::_::_::_m_arrayPool::_0_::_elem::_m_objectInformation::_2_::_m_perObjectType::_m_prob1NonObstacleN = 0;
      @sysvar::XCP::RadarFC_Obj::_g_PL_AD_fw_Radar_1R1V_rpc_XilObjBypassingRunnable_XilObjBypassingRunnable_m_pad_radarObjPort_par_out_local::TChangeableMemPool::_::_::_m_arrayPool::_0_::_elem::_m_objectInformation::_2_::_m_perObjectType::_m_prob1UnknownN = 0;
      @sysvar::XCP::RadarFC_Obj::_g_PL_AD_fw_Radar_1R1V_rpc_XilObjBypassingRunnable_XilObjBypassingRunnable_m_pad_radarObjPort_par_out_local::TChangeableMemPool::_::_::_m_arrayPool::_0_::_elem::_m_objectInformation::_2_::_m_perObjectType::_m_prob1MobileN = 0;
      @sysvar::XCP::RadarFC_Obj::_g_PL_AD_fw_Radar_1R1V_rpc_XilObjBypassingRunnable_XilObjBypassingRunnable_m_pad_radarObjPort_par_out_local::TChangeableMemPool::_::_::_m_arrayPool::_0_::_elem::_m_objectInformation::_2_::_m_perObjectType::_m_prob1StationaryN = 128;
      @sysvar::XCP::RadarFC_Obj::_g_PL_AD_fw_Radar_1R1V_rpc_XilObjBypassingRunnable_XilObjBypassingRunnable_m_pad_radarObjPort_par_out_local::TChangeableMemPool::_::_::_m_arrayPool::_0_::_elem::_m_objectInformation::_2_::_m_perObjectType::_m_prob1ObstUnknownN = 0;
      @sysvar::XCP::RadarFC_Obj::_g_PL_AD_fw_Radar_1R1V_rpc_XilObjBypassingRunnable_XilObjBypassingRunnable_m_pad_radarObjPort_par_out_local::TChangeableMemPool::_::_::_m_arrayPool::_0_::_elem::_m_objectInformation::_2_::_m_perObjectType::_m_prob1FourPlusWheelerN = 0;
      @sysvar::XCP::RadarFC_Obj::_g_PL_AD_fw_Radar_1R1V_rpc_XilObjBypassingRunnable_XilObjBypassingRunnable_m_pad_radarObjPort_par_out_local::TChangeableMemPool::_::_::_m_arrayPool::_0_::_elem::_m_objectInformation::_2_::_m_perObjectType::_m_prob1TwoWheelerN = 0;
      @sysvar::XCP::RadarFC_Obj::_g_PL_AD_fw_Radar_1R1V_rpc_XilObjBypassingRunnable_XilObjBypassingRunnable_m_pad_radarObjPort_par_out_local::TChangeableMemPool::_::_::_m_arrayPool::_0_::_elem::_m_objectInformation::_2_::_m_perObjectType::_m_prob1PedestrianN = 0;
      @sysvar::XCP::RadarFC_Obj::_g_PL_AD_fw_Radar_1R1V_rpc_XilObjBypassingRunnable_XilObjBypassingRunnable_m_pad_radarObjPort_par_out_local::TChangeableMemPool::_::_::_m_arrayPool::_0_::_elem::_m_objectInformation::_2_::_m_perObjectType::_m_prob1MovUnknownN = 128;
      @sysvar::XCP::RadarFC_Obj::_g_PL_AD_fw_Radar_1R1V_rpc_XilObjBypassingRunnable_XilObjBypassingRunnable_m_pad_radarObjPort_par_out_local::TChangeableMemPool::_::_::_m_arrayPool::_0_::_elem::_m_objectInformation::_2_::_m_perObjectType::_m_prob1RoadsideBarrierN = 128;
      @sysvar::XCP::RadarFC_Obj::_g_PL_AD_fw_Radar_1R1V_rpc_XilObjBypassingRunnable_XilObjBypassingRunnable_m_pad_radarObjPort_par_out_local::TChangeableMemPool::_::_::_m_arrayPool::_0_::_elem::_m_objectInformation::_2_::_m_perObjectType::_m_prob1StatUnknownN = 0;
      @sysvar::XCP::RadarFC_Obj::_g_PL_AD_fw_Radar_1R1V_rpc_XilObjBypassingRunnable_XilObjBypassingRunnable_m_pad_radarObjPort_par_out_local::TChangeableMemPool::_::_::_m_arrayPool::_0_::_elem::_m_objectInformation::_2_::_m_perObjectType::_m_prob1PassengerCarN = 0;
      @sysvar::XCP::RadarFC_Obj::_g_PL_AD_fw_Radar_1R1V_rpc_XilObjBypassingRunnable_XilObjBypassingRunnable_m_pad_radarObjPort_par_out_local::TChangeableMemPool::_::_::_m_arrayPool::_0_::_elem::_m_objectInformation::_2_::_m_perObjectType::_m_prob1TruckN = 0;
      @sysvar::XCP::RadarFC_Obj::_g_PL_AD_fw_Radar_1R1V_rpc_XilObjBypassingRunnable_XilObjBypassingRunnable_m_pad_radarObjPort_par_out_local::TChangeableMemPool::_::_::_m_arrayPool::_0_::_elem::_m_objectInformation::_2_::_m_perObjectType::_m_prob1FourWheelUnknownN = 128;
      @sysvar::XCP::RadarFC_Obj::_g_PL_AD_fw_Radar_1R1V_rpc_XilObjBypassingRunnable_XilObjBypassingRunnable_m_pad_radarObjPort_par_out_local::TChangeableMemPool::_::_::_m_arrayPool::_0_::_elem::_m_objectInformation::_2_::_m_dWidthN = 256;
        break;

      case 3: //"2Wheeler"
      @sysvar::XCP::RadarFC_Obj::_g_PL_AD_fw_Radar_1R1V_rpc_XilObjBypassingRunnable_XilObjBypassingRunnable_m_pad_radarObjPort_par_out_local::TChangeableMemPool::_::_::_m_arrayPool::_0_::_elem::_m_objectInformation::_2_::_m_perObjectType::_m_prob1ObstacleN = 128;
      @sysvar::XCP::RadarFC_Obj::_g_PL_AD_fw_Radar_1R1V_rpc_XilObjBypassingRunnable_XilObjBypassingRunnable_m_pad_radarObjPort_par_out_local::TChangeableMemPool::_::_::_m_arrayPool::_0_::_elem::_m_objectInformation::_2_::_m_perObjectType::_m_prob1NonObstacleN = 0;
      @sysvar::XCP::RadarFC_Obj::_g_PL_AD_fw_Radar_1R1V_rpc_XilObjBypassingRunnable_XilObjBypassingRunnable_m_pad_radarObjPort_par_out_local::TChangeableMemPool::_::_::_m_arrayPool::_0_::_elem::_m_objectInformation::_2_::_m_perObjectType::_m_prob1UnknownN = 0;
      @sysvar::XCP::RadarFC_Obj::_g_PL_AD_fw_Radar_1R1V_rpc_XilObjBypassingRunnable_XilObjBypassingRunnable_m_pad_radarObjPort_par_out_local::TChangeableMemPool::_::_::_m_arrayPool::_0_::_elem::_m_objectInformation::_2_::_m_perObjectType::_m_prob1MobileN = 128;
      @sysvar::XCP::RadarFC_Obj::_g_PL_AD_fw_Radar_1R1V_rpc_XilObjBypassingRunnable_XilObjBypassingRunnable_m_pad_radarObjPort_par_out_local::TChangeableMemPool::_::_::_m_arrayPool::_0_::_elem::_m_objectInformation::_2_::_m_perObjectType::_m_prob1StationaryN = 0;
      @sysvar::XCP::RadarFC_Obj::_g_PL_AD_fw_Radar_1R1V_rpc_XilObjBypassingRunnable_XilObjBypassingRunnable_m_pad_radarObjPort_par_out_local::TChangeableMemPool::_::_::_m_arrayPool::_0_::_elem::_m_objectInformation::_2_::_m_perObjectType::_m_prob1ObstUnknownN = 0;
      @sysvar::XCP::RadarFC_Obj::_g_PL_AD_fw_Radar_1R1V_rpc_XilObjBypassingRunnable_XilObjBypassingRunnable_m_pad_radarObjPort_par_out_local::TChangeableMemPool::_::_::_m_arrayPool::_0_::_elem::_m_objectInformation::_2_::_m_perObjectType::_m_prob1FourPlusWheelerN = 0;
      @sysvar::XCP::RadarFC_Obj::_g_PL_AD_fw_Radar_1R1V_rpc_XilObjBypassingRunnable_XilObjBypassingRunnable_m_pad_radarObjPort_par_out_local::TChangeableMemPool::_::_::_m_arrayPool::_0_::_elem::_m_objectInformation::_2_::_m_perObjectType::_m_prob1TwoWheelerN = 128;
      @sysvar::XCP::RadarFC_Obj::_g_PL_AD_fw_Radar_1R1V_rpc_XilObjBypassingRunnable_XilObjBypassingRunnable_m_pad_radarObjPort_par_out_local::TChangeableMemPool::_::_::_m_arrayPool::_0_::_elem::_m_objectInformation::_2_::_m_perObjectType::_m_prob1PedestrianN = 0;
      @sysvar::XCP::RadarFC_Obj::_g_PL_AD_fw_Radar_1R1V_rpc_XilObjBypassingRunnable_XilObjBypassingRunnable_m_pad_radarObjPort_par_out_local::TChangeableMemPool::_::_::_m_arrayPool::_0_::_elem::_m_objectInformation::_2_::_m_perObjectType::_m_prob1MovUnknownN = 0;
      @sysvar::XCP::RadarFC_Obj::_g_PL_AD_fw_Radar_1R1V_rpc_XilObjBypassingRunnable_XilObjBypassingRunnable_m_pad_radarObjPort_par_out_local::TChangeableMemPool::_::_::_m_arrayPool::_0_::_elem::_m_objectInformation::_2_::_m_perObjectType::_m_prob1RoadsideBarrierN = 0;
      @sysvar::XCP::RadarFC_Obj::_g_PL_AD_fw_Radar_1R1V_rpc_XilObjBypassingRunnable_XilObjBypassingRunnable_m_pad_radarObjPort_par_out_local::TChangeableMemPool::_::_::_m_arrayPool::_0_::_elem::_m_objectInformation::_2_::_m_perObjectType::_m_prob1StatUnknownN = 128;
      @sysvar::XCP::RadarFC_Obj::_g_PL_AD_fw_Radar_1R1V_rpc_XilObjBypassingRunnable_XilObjBypassingRunnable_m_pad_radarObjPort_par_out_local::TChangeableMemPool::_::_::_m_arrayPool::_0_::_elem::_m_objectInformation::_2_::_m_perObjectType::_m_prob1PassengerCarN = 0;
      @sysvar::XCP::RadarFC_Obj::_g_PL_AD_fw_Radar_1R1V_rpc_XilObjBypassingRunnable_XilObjBypassingRunnable_m_pad_radarObjPort_par_out_local::TChangeableMemPool::_::_::_m_arrayPool::_0_::_elem::_m_objectInformation::_2_::_m_perObjectType::_m_prob1TruckN = 0;
      @sysvar::XCP::RadarFC_Obj::_g_PL_AD_fw_Radar_1R1V_rpc_XilObjBypassingRunnable_XilObjBypassingRunnable_m_pad_radarObjPort_par_out_local::TChangeableMemPool::_::_::_m_arrayPool::_0_::_elem::_m_objectInformation::_2_::_m_perObjectType::_m_prob1FourWheelUnknownN = 128;
      @sysvar::XCP::RadarFC_Obj::_g_PL_AD_fw_Radar_1R1V_rpc_XilObjBypassingRunnable_XilObjBypassingRunnable_m_pad_radarObjPort_par_out_local::TChangeableMemPool::_::_::_m_arrayPool::_0_::_elem::_m_objectInformation::_2_::_m_dWidthN = 64;
        break;

      case 4: //"Pedestrian"
      @sysvar::XCP::RadarFC_Obj::_g_PL_AD_fw_Radar_1R1V_rpc_XilObjBypassingRunnable_XilObjBypassingRunnable_m_pad_radarObjPort_par_out_local::TChangeableMemPool::_::_::_m_arrayPool::_0_::_elem::_m_objectInformation::_2_::_m_perObjectType::_m_prob1ObstacleN = 128;
      @sysvar::XCP::RadarFC_Obj::_g_PL_AD_fw_Radar_1R1V_rpc_XilObjBypassingRunnable_XilObjBypassingRunnable_m_pad_radarObjPort_par_out_local::TChangeableMemPool::_::_::_m_arrayPool::_0_::_elem::_m_objectInformation::_2_::_m_perObjectType::_m_prob1NonObstacleN = 0;
      @sysvar::XCP::RadarFC_Obj::_g_PL_AD_fw_Radar_1R1V_rpc_XilObjBypassingRunnable_XilObjBypassingRunnable_m_pad_radarObjPort_par_out_local::TChangeableMemPool::_::_::_m_arrayPool::_0_::_elem::_m_objectInformation::_2_::_m_perObjectType::_m_prob1UnknownN = 0;
      @sysvar::XCP::RadarFC_Obj::_g_PL_AD_fw_Radar_1R1V_rpc_XilObjBypassingRunnable_XilObjBypassingRunnable_m_pad_radarObjPort_par_out_local::TChangeableMemPool::_::_::_m_arrayPool::_0_::_elem::_m_objectInformation::_2_::_m_perObjectType::_m_prob1MobileN = 128;
      @sysvar::XCP::RadarFC_Obj::_g_PL_AD_fw_Radar_1R1V_rpc_XilObjBypassingRunnable_XilObjBypassingRunnable_m_pad_radarObjPort_par_out_local::TChangeableMemPool::_::_::_m_arrayPool::_0_::_elem::_m_objectInformation::_2_::_m_perObjectType::_m_prob1StationaryN = 0;
      @sysvar::XCP::RadarFC_Obj::_g_PL_AD_fw_Radar_1R1V_rpc_XilObjBypassingRunnable_XilObjBypassingRunnable_m_pad_radarObjPort_par_out_local::TChangeableMemPool::_::_::_m_arrayPool::_0_::_elem::_m_objectInformation::_2_::_m_perObjectType::_m_prob1ObstUnknownN = 0;
      @sysvar::XCP::RadarFC_Obj::_g_PL_AD_fw_Radar_1R1V_rpc_XilObjBypassingRunnable_XilObjBypassingRunnable_m_pad_radarObjPort_par_out_local::TChangeableMemPool::_::_::_m_arrayPool::_0_::_elem::_m_objectInformation::_2_::_m_perObjectType::_m_prob1FourPlusWheelerN = 0;
      @sysvar::XCP::RadarFC_Obj::_g_PL_AD_fw_Radar_1R1V_rpc_XilObjBypassingRunnable_XilObjBypassingRunnable_m_pad_radarObjPort_par_out_local::TChangeableMemPool::_::_::_m_arrayPool::_0_::_elem::_m_objectInformation::_2_::_m_perObjectType::_m_prob1TwoWheelerN = 0;
      @sysvar::XCP::RadarFC_Obj::_g_PL_AD_fw_Radar_1R1V_rpc_XilObjBypassingRunnable_XilObjBypassingRunnable_m_pad_radarObjPort_par_out_local::TChangeableMemPool::_::_::_m_arrayPool::_0_::_elem::_m_objectInformation::_2_::_m_perObjectType::_m_prob1PedestrianN = 128;
      @sysvar::XCP::RadarFC_Obj::_g_PL_AD_fw_Radar_1R1V_rpc_XilObjBypassingRunnable_XilObjBypassingRunnable_m_pad_radarObjPort_par_out_local::TChangeableMemPool::_::_::_m_arrayPool::_0_::_elem::_m_objectInformation::_2_::_m_perObjectType::_m_prob1MovUnknownN = 0;
      @sysvar::XCP::RadarFC_Obj::_g_PL_AD_fw_Radar_1R1V_rpc_XilObjBypassingRunnable_XilObjBypassingRunnable_m_pad_radarObjPort_par_out_local::TChangeableMemPool::_::_::_m_arrayPool::_0_::_elem::_m_objectInformation::_2_::_m_perObjectType::_m_prob1RoadsideBarrierN = 0;
      @sysvar::XCP::RadarFC_Obj::_g_PL_AD_fw_Radar_1R1V_rpc_XilObjBypassingRunnable_XilObjBypassingRunnable_m_pad_radarObjPort_par_out_local::TChangeableMemPool::_::_::_m_arrayPool::_0_::_elem::_m_objectInformation::_2_::_m_perObjectType::_m_prob1StatUnknownN = 128;
      @sysvar::XCP::RadarFC_Obj::_g_PL_AD_fw_Radar_1R1V_rpc_XilObjBypassingRunnable_XilObjBypassingRunnable_m_pad_radarObjPort_par_out_local::TChangeableMemPool::_::_::_m_arrayPool::_0_::_elem::_m_objectInformation::_2_::_m_perObjectType::_m_prob1PassengerCarN = 0;
      @sysvar::XCP::RadarFC_Obj::_g_PL_AD_fw_Radar_1R1V_rpc_XilObjBypassingRunnable_XilObjBypassingRunnable_m_pad_radarObjPort_par_out_local::TChangeableMemPool::_::_::_m_arrayPool::_0_::_elem::_m_objectInformation::_2_::_m_perObjectType::_m_prob1TruckN = 0;
      @sysvar::XCP::RadarFC_Obj::_g_PL_AD_fw_Radar_1R1V_rpc_XilObjBypassingRunnable_XilObjBypassingRunnable_m_pad_radarObjPort_par_out_local::TChangeableMemPool::_::_::_m_arrayPool::_0_::_elem::_m_objectInformation::_2_::_m_perObjectType::_m_prob1FourWheelUnknownN = 128;
      @sysvar::XCP::RadarFC_Obj::_g_PL_AD_fw_Radar_1R1V_rpc_XilObjBypassingRunnable_XilObjBypassingRunnable_m_pad_radarObjPort_par_out_local::TChangeableMemPool::_::_::_m_arrayPool::_0_::_elem::_m_objectInformation::_2_::_m_dWidthN = 64;
        break;

      case 5: //"Truck"
      @sysvar::XCP::RadarFC_Obj::_g_PL_AD_fw_Radar_1R1V_rpc_XilObjBypassingRunnable_XilObjBypassingRunnable_m_pad_radarObjPort_par_out_local::TChangeableMemPool::_::_::_m_arrayPool::_0_::_elem::_m_objectInformation::_2_::_m_perObjectType::_m_prob1ObstacleN = 128;
      @sysvar::XCP::RadarFC_Obj::_g_PL_AD_fw_Radar_1R1V_rpc_XilObjBypassingRunnable_XilObjBypassingRunnable_m_pad_radarObjPort_par_out_local::TChangeableMemPool::_::_::_m_arrayPool::_0_::_elem::_m_objectInformation::_2_::_m_perObjectType::_m_prob1NonObstacleN = 0;
      @sysvar::XCP::RadarFC_Obj::_g_PL_AD_fw_Radar_1R1V_rpc_XilObjBypassingRunnable_XilObjBypassingRunnable_m_pad_radarObjPort_par_out_local::TChangeableMemPool::_::_::_m_arrayPool::_0_::_elem::_m_objectInformation::_2_::_m_perObjectType::_m_prob1UnknownN = 0;
      @sysvar::XCP::RadarFC_Obj::_g_PL_AD_fw_Radar_1R1V_rpc_XilObjBypassingRunnable_XilObjBypassingRunnable_m_pad_radarObjPort_par_out_local::TChangeableMemPool::_::_::_m_arrayPool::_0_::_elem::_m_objectInformation::_2_::_m_perObjectType::_m_prob1MobileN = 128;
      @sysvar::XCP::RadarFC_Obj::_g_PL_AD_fw_Radar_1R1V_rpc_XilObjBypassingRunnable_XilObjBypassingRunnable_m_pad_radarObjPort_par_out_local::TChangeableMemPool::_::_::_m_arrayPool::_0_::_elem::_m_objectInformation::_2_::_m_perObjectType::_m_prob1StationaryN = 0;
      @sysvar::XCP::RadarFC_Obj::_g_PL_AD_fw_Radar_1R1V_rpc_XilObjBypassingRunnable_XilObjBypassingRunnable_m_pad_radarObjPort_par_out_local::TChangeableMemPool::_::_::_m_arrayPool::_0_::_elem::_m_objectInformation::_2_::_m_perObjectType::_m_prob1ObstUnknownN = 0;
      @sysvar::XCP::RadarFC_Obj::_g_PL_AD_fw_Radar_1R1V_rpc_XilObjBypassingRunnable_XilObjBypassingRunnable_m_pad_radarObjPort_par_out_local::TChangeableMemPool::_::_::_m_arrayPool::_0_::_elem::_m_objectInformation::_2_::_m_perObjectType::_m_prob1FourPlusWheelerN = 128;
      @sysvar::XCP::RadarFC_Obj::_g_PL_AD_fw_Radar_1R1V_rpc_XilObjBypassingRunnable_XilObjBypassingRunnable_m_pad_radarObjPort_par_out_local::TChangeableMemPool::_::_::_m_arrayPool::_0_::_elem::_m_objectInformation::_2_::_m_perObjectType::_m_prob1TwoWheelerN = 0;
      @sysvar::XCP::RadarFC_Obj::_g_PL_AD_fw_Radar_1R1V_rpc_XilObjBypassingRunnable_XilObjBypassingRunnable_m_pad_radarObjPort_par_out_local::TChangeableMemPool::_::_::_m_arrayPool::_0_::_elem::_m_objectInformation::_2_::_m_perObjectType::_m_prob1PedestrianN = 0;
      @sysvar::XCP::RadarFC_Obj::_g_PL_AD_fw_Radar_1R1V_rpc_XilObjBypassingRunnable_XilObjBypassingRunnable_m_pad_radarObjPort_par_out_local::TChangeableMemPool::_::_::_m_arrayPool::_0_::_elem::_m_objectInformation::_2_::_m_perObjectType::_m_prob1MovUnknownN = 0;
      @sysvar::XCP::RadarFC_Obj::_g_PL_AD_fw_Radar_1R1V_rpc_XilObjBypassingRunnable_XilObjBypassingRunnable_m_pad_radarObjPort_par_out_local::TChangeableMemPool::_::_::_m_arrayPool::_0_::_elem::_m_objectInformation::_2_::_m_perObjectType::_m_prob1RoadsideBarrierN = 0;
      @sysvar::XCP::RadarFC_Obj::_g_PL_AD_fw_Radar_1R1V_rpc_XilObjBypassingRunnable_XilObjBypassingRunnable_m_pad_radarObjPort_par_out_local::TChangeableMemPool::_::_::_m_arrayPool::_0_::_elem::_m_objectInformation::_2_::_m_perObjectType::_m_prob1StatUnknownN = 128;
      @sysvar::XCP::RadarFC_Obj::_g_PL_AD_fw_Radar_1R1V_rpc_XilObjBypassingRunnable_XilObjBypassingRunnable_m_pad_radarObjPort_par_out_local::TChangeableMemPool::_::_::_m_arrayPool::_0_::_elem::_m_objectInformation::_2_::_m_perObjectType::_m_prob1PassengerCarN = 0;
      @sysvar::XCP::RadarFC_Obj::_g_PL_AD_fw_Radar_1R1V_rpc_XilObjBypassingRunnable_XilObjBypassingRunnable_m_pad_radarObjPort_par_out_local::TChangeableMemPool::_::_::_m_arrayPool::_0_::_elem::_m_objectInformation::_2_::_m_perObjectType::_m_prob1TruckN = 128;
      @sysvar::XCP::RadarFC_Obj::_g_PL_AD_fw_Radar_1R1V_rpc_XilObjBypassingRunnable_XilObjBypassingRunnable_m_pad_radarObjPort_par_out_local::TChangeableMemPool::_::_::_m_arrayPool::_0_::_elem::_m_objectInformation::_2_::_m_perObjectType::_m_prob1FourWheelUnknownN = 0;
      @sysvar::XCP::RadarFC_Obj::_g_PL_AD_fw_Radar_1R1V_rpc_XilObjBypassingRunnable_XilObjBypassingRunnable_m_pad_radarObjPort_par_out_local::TChangeableMemPool::_::_::_m_arrayPool::_0_::_elem::_m_objectInformation::_2_::_m_dWidthN = 256;
        break;

      case 6: //"PassengerCar"
      @sysvar::XCP::RadarFC_Obj::_g_PL_AD_fw_Radar_1R1V_rpc_XilObjBypassingRunnable_XilObjBypassingRunnable_m_pad_radarObjPort_par_out_local::TChangeableMemPool::_::_::_m_arrayPool::_0_::_elem::_m_objectInformation::_2_::_m_perObjectType::_m_prob1ObstacleN = 128;
      @sysvar::XCP::RadarFC_Obj::_g_PL_AD_fw_Radar_1R1V_rpc_XilObjBypassingRunnable_XilObjBypassingRunnable_m_pad_radarObjPort_par_out_local::TChangeableMemPool::_::_::_m_arrayPool::_0_::_elem::_m_objectInformation::_2_::_m_perObjectType::_m_prob1NonObstacleN = 0;
      @sysvar::XCP::RadarFC_Obj::_g_PL_AD_fw_Radar_1R1V_rpc_XilObjBypassingRunnable_XilObjBypassingRunnable_m_pad_radarObjPort_par_out_local::TChangeableMemPool::_::_::_m_arrayPool::_0_::_elem::_m_objectInformation::_2_::_m_perObjectType::_m_prob1UnknownN = 0;
      @sysvar::XCP::RadarFC_Obj::_g_PL_AD_fw_Radar_1R1V_rpc_XilObjBypassingRunnable_XilObjBypassingRunnable_m_pad_radarObjPort_par_out_local::TChangeableMemPool::_::_::_m_arrayPool::_0_::_elem::_m_objectInformation::_2_::_m_perObjectType::_m_prob1MobileN = 128;
      @sysvar::XCP::RadarFC_Obj::_g_PL_AD_fw_Radar_1R1V_rpc_XilObjBypassingRunnable_XilObjBypassingRunnable_m_pad_radarObjPort_par_out_local::TChangeableMemPool::_::_::_m_arrayPool::_0_::_elem::_m_objectInformation::_2_::_m_perObjectType::_m_prob1StationaryN = 0;
      @sysvar::XCP::RadarFC_Obj::_g_PL_AD_fw_Radar_1R1V_rpc_XilObjBypassingRunnable_XilObjBypassingRunnable_m_pad_radarObjPort_par_out_local::TChangeableMemPool::_::_::_m_arrayPool::_0_::_elem::_m_objectInformation::_2_::_m_perObjectType::_m_prob1ObstUnknownN = 0;
      @sysvar::XCP::RadarFC_Obj::_g_PL_AD_fw_Radar_1R1V_rpc_XilObjBypassingRunnable_XilObjBypassingRunnable_m_pad_radarObjPort_par_out_local::TChangeableMemPool::_::_::_m_arrayPool::_0_::_elem::_m_objectInformation::_2_::_m_perObjectType::_m_prob1FourPlusWheelerN = 128;
      @sysvar::XCP::RadarFC_Obj::_g_PL_AD_fw_Radar_1R1V_rpc_XilObjBypassingRunnable_XilObjBypassingRunnable_m_pad_radarObjPort_par_out_local::TChangeableMemPool::_::_::_m_arrayPool::_0_::_elem::_m_objectInformation::_2_::_m_perObjectType::_m_prob1TwoWheelerN = 0;
      @sysvar::XCP::RadarFC_Obj::_g_PL_AD_fw_Radar_1R1V_rpc_XilObjBypassingRunnable_XilObjBypassingRunnable_m_pad_radarObjPort_par_out_local::TChangeableMemPool::_::_::_m_arrayPool::_0_::_elem::_m_objectInformation::_2_::_m_perObjectType::_m_prob1PedestrianN = 0;
      @sysvar::XCP::RadarFC_Obj::_g_PL_AD_fw_Radar_1R1V_rpc_XilObjBypassingRunnable_XilObjBypassingRunnable_m_pad_radarObjPort_par_out_local::TChangeableMemPool::_::_::_m_arrayPool::_0_::_elem::_m_objectInformation::_2_::_m_perObjectType::_m_prob1MovUnknownN = 0;
      @sysvar::XCP::RadarFC_Obj::_g_PL_AD_fw_Radar_1R1V_rpc_XilObjBypassingRunnable_XilObjBypassingRunnable_m_pad_radarObjPort_par_out_local::TChangeableMemPool::_::_::_m_arrayPool::_0_::_elem::_m_objectInformation::_2_::_m_perObjectType::_m_prob1RoadsideBarrierN = 0;
      @sysvar::XCP::RadarFC_Obj::_g_PL_AD_fw_Radar_1R1V_rpc_XilObjBypassingRunnable_XilObjBypassingRunnable_m_pad_radarObjPort_par_out_local::TChangeableMemPool::_::_::_m_arrayPool::_0_::_elem::_m_objectInformation::_2_::_m_perObjectType::_m_prob1StatUnknownN = 128;
      @sysvar::XCP::RadarFC_Obj::_g_PL_AD_fw_Radar_1R1V_rpc_XilObjBypassingRunnable_XilObjBypassingRunnable_m_pad_radarObjPort_par_out_local::TChangeableMemPool::_::_::_m_arrayPool::_0_::_elem::_m_objectInformation::_2_::_m_perObjectType::_m_prob1PassengerCarN = 128;
      @sysvar::XCP::RadarFC_Obj::_g_PL_AD_fw_Radar_1R1V_rpc_XilObjBypassingRunnable_XilObjBypassingRunnable_m_pad_radarObjPort_par_out_local::TChangeableMemPool::_::_::_m_arrayPool::_0_::_elem::_m_objectInformation::_2_::_m_perObjectType::_m_prob1TruckN = 0;
      @sysvar::XCP::RadarFC_Obj::_g_PL_AD_fw_Radar_1R1V_rpc_XilObjBypassingRunnable_XilObjBypassingRunnable_m_pad_radarObjPort_par_out_local::TChangeableMemPool::_::_::_m_arrayPool::_0_::_elem::_m_objectInformation::_2_::_m_perObjectType::_m_prob1FourWheelUnknownN = 0;
      @sysvar::XCP::RadarFC_Obj::_g_PL_AD_fw_Radar_1R1V_rpc_XilObjBypassingRunnable_XilObjBypassingRunnable_m_pad_radarObjPort_par_out_local::TChangeableMemPool::_::_::_m_arrayPool::_0_::_elem::_m_objectInformation::_2_::_m_dWidthN = 256;
        break;
    }
    break;

    case 3: //"Object-3"
    //constant
  @sysvar::XCP::RadarFC_Obj::_g_PL_AD_fw_Radar_1R1V_rpc_XilObjBypassingRunnable_XilObjBypassingRunnable_m_pad_radarObjPort_par_out_local::TChangeableMemPool::_::_::_m_arrayPool::_0_::_elem::_m_objectInformation::_3_::_Valid_b = 1;
  @sysvar::XCP::RadarFC_Obj::_g_PL_AD_fw_Radar_1R1V_rpc_XilObjBypassingRunnable_XilObjBypassingRunnable_m_pad_radarObjPort_par_out_local::TChangeableMemPool::_::_::_m_arrayPool::_0_::_elem::_m_objectInformation::_3_::_m_HandleN = 1;
  @sysvar::XCP::RadarFC_Obj::_g_PL_AD_fw_Radar_1R1V_rpc_XilObjBypassingRunnable_XilObjBypassingRunnable_m_pad_radarObjPort_par_out_local::TChangeableMemPool::_::_::_m_arrayPool::_0_::_elem::_m_objectInformation::_3_::_m_alpPiVarYawAngleN = 0;
  @sysvar::XCP::RadarFC_Obj::_g_PL_AD_fw_Radar_1R1V_rpc_XilObjBypassingRunnable_XilObjBypassingRunnable_m_pad_radarObjPort_par_out_local::TChangeableMemPool::_::_::_m_arrayPool::_0_::_elem::_m_objectInformation::_3_::_m_alpPiYawAngleN = 0;
  @sysvar::XCP::RadarFC_Obj::_g_PL_AD_fw_Radar_1R1V_rpc_XilObjBypassingRunnable_XilObjBypassingRunnable_m_pad_radarObjPort_par_out_local::TChangeableMemPool::_::_::_m_arrayPool::_0_::_elem::_m_objectInformation::_3_::_m_varAxN = 0;
  @sysvar::XCP::RadarFC_Obj::_g_PL_AD_fw_Radar_1R1V_rpc_XilObjBypassingRunnable_XilObjBypassingRunnable_m_pad_radarObjPort_par_out_local::TChangeableMemPool::_::_::_m_arrayPool::_0_::_elem::_m_objectInformation::_3_::_m_varAyN = 0;
  @sysvar::XCP::RadarFC_Obj::_g_PL_AD_fw_Radar_1R1V_rpc_XilObjBypassingRunnable_XilObjBypassingRunnable_m_pad_radarObjPort_par_out_local::TChangeableMemPool::_::_::_m_arrayPool::_0_::_elem::_m_objectInformation::_3_::_m_varVxN = 0;
  @sysvar::XCP::RadarFC_Obj::_g_PL_AD_fw_Radar_1R1V_rpc_XilObjBypassingRunnable_XilObjBypassingRunnable_m_pad_radarObjPort_par_out_local::TChangeableMemPool::_::_::_m_arrayPool::_0_::_elem::_m_objectInformation::_3_::_m_varVyN = 0;
  @sysvar::XCP::RadarFC_Obj::_g_PL_AD_fw_Radar_1R1V_rpc_XilObjBypassingRunnable_XilObjBypassingRunnable_m_pad_radarObjPort_par_out_local::TChangeableMemPool::_::_::_m_arrayPool::_0_::_elem::_m_objectInformation::_3_::_m_varDxN = 0;
  @sysvar::XCP::RadarFC_Obj::_g_PL_AD_fw_Radar_1R1V_rpc_XilObjBypassingRunnable_XilObjBypassingRunnable_m_pad_radarObjPort_par_out_local::TChangeableMemPool::_::_::_m_arrayPool::_0_::_elem::_m_objectInformation::_3_::_m_varDyN = 0;
  @sysvar::XCP::RadarFC_Obj::_g_PL_AD_fw_Radar_1R1V_rpc_XilObjBypassingRunnable_XilObjBypassingRunnable_m_pad_radarObjPort_par_out_local::TChangeableMemPool::_::_::_m_arrayPool::_0_::_elem::_m_objectInformation::_3_::_m_dVarLengthN = 0;
  @sysvar::XCP::RadarFC_Obj::_g_PL_AD_fw_Radar_1R1V_rpc_XilObjBypassingRunnable_XilObjBypassingRunnable_m_pad_radarObjPort_par_out_local::TChangeableMemPool::_::_::_m_arrayPool::_0_::_elem::_m_objectInformation::_3_::_m_dVarWidthN = 0;
  @sysvar::XCP::RadarFC_Obj::_g_PL_AD_fw_Radar_1R1V_rpc_XilObjBypassingRunnable_XilObjBypassingRunnable_m_pad_radarObjPort_par_out_local::TChangeableMemPool::_::_::_m_arrayPool::_0_::_elem::_m_objectInformation::_3_::_m_wExistProbN = 64880;
  @sysvar::XCP::RadarFC_Obj::_g_PL_AD_fw_Radar_1R1V_rpc_XilObjBypassingRunnable_XilObjBypassingRunnable_m_pad_radarObjPort_par_out_local::TChangeableMemPool::_::_::_m_arrayPool::_0_::_elem::_m_objectInformation::_3_::_m_isObjectAsil = 1;
  @sysvar::XCP::RadarFC_Obj::_g_PL_AD_fw_Radar_1R1V_rpc_XilObjBypassingRunnable_XilObjBypassingRunnable_m_pad_radarObjPort_par_out_local::TChangeableMemPool::_::_::_m_arrayPool::_0_::_elem::_m_objectInformation::_3_::_m_dLengthN = 128;

    //target movement

  @sysvar::XCP::RadarFC_Obj::_g_PL_AD_fw_Radar_1R1V_rpc_XilObjBypassingRunnable_XilObjBypassingRunnable_m_pad_radarObjPort_par_out_local::TChangeableMemPool::_::_::_m_arrayPool::_0_::_elem::_m_objectInformation::_3_::_m_dxN = @target_radar_fc_sim::objdata.obj_distance_x[3] * 128;
  @sysvar::XCP::RadarFC_Obj::_g_PL_AD_fw_Radar_1R1V_rpc_XilObjBypassingRunnable_XilObjBypassingRunnable_m_pad_radarObjPort_par_out_local::TChangeableMemPool::_::_::_m_arrayPool::_0_::_elem::_m_objectInformation::_3_::_m_dyN = @target_radar_fc_sim::objdata.obj_distance_y[3] * 128;
  @sysvar::XCP::RadarFC_Obj::_g_PL_AD_fw_Radar_1R1V_rpc_XilObjBypassingRunnable_XilObjBypassingRunnable_m_pad_radarObjPort_par_out_local::TChangeableMemPool::_::_::_m_arrayPool::_0_::_elem::_m_objectInformation::_3_::_m_dzN = 0;
  @sysvar::XCP::RadarFC_Obj::_g_PL_AD_fw_Radar_1R1V_rpc_XilObjBypassingRunnable_XilObjBypassingRunnable_m_pad_radarObjPort_par_out_local::TChangeableMemPool::_::_::_m_arrayPool::_0_::_elem::_m_objectInformation::_3_::_m_vxN = @target_radar_fc_sim::objdata.obj_velocity_x[3] * 256;
  @sysvar::XCP::RadarFC_Obj::_g_PL_AD_fw_Radar_1R1V_rpc_XilObjBypassingRunnable_XilObjBypassingRunnable_m_pad_radarObjPort_par_out_local::TChangeableMemPool::_::_::_m_arrayPool::_0_::_elem::_m_objectInformation::_3_::_m_vyN = @target_radar_fc_sim::objdata.obj_velocity_y[3] * 256;
  @sysvar::XCP::RadarFC_Obj::_g_PL_AD_fw_Radar_1R1V_rpc_XilObjBypassingRunnable_XilObjBypassingRunnable_m_pad_radarObjPort_par_out_local::TChangeableMemPool::_::_::_m_arrayPool::_0_::_elem::_m_objectInformation::_3_::_m_axN = 0;
  @sysvar::XCP::RadarFC_Obj::_g_PL_AD_fw_Radar_1R1V_rpc_XilObjBypassingRunnable_XilObjBypassingRunnable_m_pad_radarObjPort_par_out_local::TChangeableMemPool::_::_::_m_arrayPool::_0_::_elem::_m_objectInformation::_3_::_m_ayN = 0;

    //target object moving or not
    if (abs(@target_radar_fc_sim::objdata.obj_velocity_x[3]) != 0)
    {
    @sysvar::XCP::RadarFC_Obj::_g_PL_AD_fw_Radar_1R1V_rpc_XilObjBypassingRunnable_XilObjBypassingRunnable_m_pad_radarObjPort_par_out_local::TChangeableMemPool::_::_::_m_arrayPool::_0_::_elem::_m_objectInformation::_3_::_m_prob1HasBeenObservedMovingN = 126;
    @sysvar::XCP::RadarFC_Obj::_g_PL_AD_fw_Radar_1R1V_rpc_XilObjBypassingRunnable_XilObjBypassingRunnable_m_pad_radarObjPort_par_out_local::TChangeableMemPool::_::_::_m_arrayPool::_0_::_elem::_m_objectInformation::_3_::_m_prob1MovingN = 126;
    }
    else
    {
    @sysvar::XCP::RadarFC_Obj::_g_PL_AD_fw_Radar_1R1V_rpc_XilObjBypassingRunnable_XilObjBypassingRunnable_m_pad_radarObjPort_par_out_local::TChangeableMemPool::_::_::_m_arrayPool::_0_::_elem::_m_objectInformation::_3_::_m_prob1HasBeenObservedMovingN = 0;
    @sysvar::XCP::RadarFC_Obj::_g_PL_AD_fw_Radar_1R1V_rpc_XilObjBypassingRunnable_XilObjBypassingRunnable_m_pad_radarObjPort_par_out_local::TChangeableMemPool::_::_::_m_arrayPool::_0_::_elem::_m_objectInformation::_3_::_m_prob1MovingN = 0;
    }

      //object classification
    switch (@target_radar_fc_sim::objdata.obj_type[3])
    {
      case 0: //"Non-Obstacle"
      @sysvar::XCP::RadarFC_Obj::_g_PL_AD_fw_Radar_1R1V_rpc_XilObjBypassingRunnable_XilObjBypassingRunnable_m_pad_radarObjPort_par_out_local::TChangeableMemPool::_::_::_m_arrayPool::_0_::_elem::_m_objectInformation::_3_::_m_perObjectType::_m_prob1ObstacleN = 0;
      @sysvar::XCP::RadarFC_Obj::_g_PL_AD_fw_Radar_1R1V_rpc_XilObjBypassingRunnable_XilObjBypassingRunnable_m_pad_radarObjPort_par_out_local::TChangeableMemPool::_::_::_m_arrayPool::_0_::_elem::_m_objectInformation::_3_::_m_perObjectType::_m_prob1NonObstacleN = 128;
      @sysvar::XCP::RadarFC_Obj::_g_PL_AD_fw_Radar_1R1V_rpc_XilObjBypassingRunnable_XilObjBypassingRunnable_m_pad_radarObjPort_par_out_local::TChangeableMemPool::_::_::_m_arrayPool::_0_::_elem::_m_objectInformation::_3_::_m_perObjectType::_m_prob1UnknownN = 0;
      @sysvar::XCP::RadarFC_Obj::_g_PL_AD_fw_Radar_1R1V_rpc_XilObjBypassingRunnable_XilObjBypassingRunnable_m_pad_radarObjPort_par_out_local::TChangeableMemPool::_::_::_m_arrayPool::_0_::_elem::_m_objectInformation::_3_::_m_perObjectType::_m_prob1MobileN = 0;
      @sysvar::XCP::RadarFC_Obj::_g_PL_AD_fw_Radar_1R1V_rpc_XilObjBypassingRunnable_XilObjBypassingRunnable_m_pad_radarObjPort_par_out_local::TChangeableMemPool::_::_::_m_arrayPool::_0_::_elem::_m_objectInformation::_3_::_m_perObjectType::_m_prob1StationaryN = 0;
      @sysvar::XCP::RadarFC_Obj::_g_PL_AD_fw_Radar_1R1V_rpc_XilObjBypassingRunnable_XilObjBypassingRunnable_m_pad_radarObjPort_par_out_local::TChangeableMemPool::_::_::_m_arrayPool::_0_::_elem::_m_objectInformation::_3_::_m_perObjectType::_m_prob1ObstUnknownN = 128;
      @sysvar::XCP::RadarFC_Obj::_g_PL_AD_fw_Radar_1R1V_rpc_XilObjBypassingRunnable_XilObjBypassingRunnable_m_pad_radarObjPort_par_out_local::TChangeableMemPool::_::_::_m_arrayPool::_0_::_elem::_m_objectInformation::_3_::_m_perObjectType::_m_prob1FourPlusWheelerN = 0;
      @sysvar::XCP::RadarFC_Obj::_g_PL_AD_fw_Radar_1R1V_rpc_XilObjBypassingRunnable_XilObjBypassingRunnable_m_pad_radarObjPort_par_out_local::TChangeableMemPool::_::_::_m_arrayPool::_0_::_elem::_m_objectInformation::_3_::_m_perObjectType::_m_prob1TwoWheelerN = 0;
      @sysvar::XCP::RadarFC_Obj::_g_PL_AD_fw_Radar_1R1V_rpc_XilObjBypassingRunnable_XilObjBypassingRunnable_m_pad_radarObjPort_par_out_local::TChangeableMemPool::_::_::_m_arrayPool::_0_::_elem::_m_objectInformation::_3_::_m_perObjectType::_m_prob1PedestrianN = 0;
      @sysvar::XCP::RadarFC_Obj::_g_PL_AD_fw_Radar_1R1V_rpc_XilObjBypassingRunnable_XilObjBypassingRunnable_m_pad_radarObjPort_par_out_local::TChangeableMemPool::_::_::_m_arrayPool::_0_::_elem::_m_objectInformation::_3_::_m_perObjectType::_m_prob1MovUnknownN = 128;
      @sysvar::XCP::RadarFC_Obj::_g_PL_AD_fw_Radar_1R1V_rpc_XilObjBypassingRunnable_XilObjBypassingRunnable_m_pad_radarObjPort_par_out_local::TChangeableMemPool::_::_::_m_arrayPool::_0_::_elem::_m_objectInformation::_3_::_m_perObjectType::_m_prob1RoadsideBarrierN = 0;
      @sysvar::XCP::RadarFC_Obj::_g_PL_AD_fw_Radar_1R1V_rpc_XilObjBypassingRunnable_XilObjBypassingRunnable_m_pad_radarObjPort_par_out_local::TChangeableMemPool::_::_::_m_arrayPool::_0_::_elem::_m_objectInformation::_3_::_m_perObjectType::_m_prob1StatUnknownN = 128;
      @sysvar::XCP::RadarFC_Obj::_g_PL_AD_fw_Radar_1R1V_rpc_XilObjBypassingRunnable_XilObjBypassingRunnable_m_pad_radarObjPort_par_out_local::TChangeableMemPool::_::_::_m_arrayPool::_0_::_elem::_m_objectInformation::_3_::_m_perObjectType::_m_prob1PassengerCarN = 0;
      @sysvar::XCP::RadarFC_Obj::_g_PL_AD_fw_Radar_1R1V_rpc_XilObjBypassingRunnable_XilObjBypassingRunnable_m_pad_radarObjPort_par_out_local::TChangeableMemPool::_::_::_m_arrayPool::_0_::_elem::_m_objectInformation::_3_::_m_perObjectType::_m_prob1TruckN = 0;
      @sysvar::XCP::RadarFC_Obj::_g_PL_AD_fw_Radar_1R1V_rpc_XilObjBypassingRunnable_XilObjBypassingRunnable_m_pad_radarObjPort_par_out_local::TChangeableMemPool::_::_::_m_arrayPool::_0_::_elem::_m_objectInformation::_3_::_m_perObjectType::_m_prob1FourWheelUnknownN = 128;
      @sysvar::XCP::RadarFC_Obj::_g_PL_AD_fw_Radar_1R1V_rpc_XilObjBypassingRunnable_XilObjBypassingRunnable_m_pad_radarObjPort_par_out_local::TChangeableMemPool::_::_::_m_arrayPool::_0_::_elem::_m_objectInformation::_3_::_m_dWidthN = 256;
        break;

      case 1: //"unknown"
      @sysvar::XCP::RadarFC_Obj::_g_PL_AD_fw_Radar_1R1V_rpc_XilObjBypassingRunnable_XilObjBypassingRunnable_m_pad_radarObjPort_par_out_local::TChangeableMemPool::_::_::_m_arrayPool::_0_::_elem::_m_objectInformation::_3_::_m_perObjectType::_m_prob1ObstacleN = 0;
      @sysvar::XCP::RadarFC_Obj::_g_PL_AD_fw_Radar_1R1V_rpc_XilObjBypassingRunnable_XilObjBypassingRunnable_m_pad_radarObjPort_par_out_local::TChangeableMemPool::_::_::_m_arrayPool::_0_::_elem::_m_objectInformation::_3_::_m_perObjectType::_m_prob1NonObstacleN = 0;
      @sysvar::XCP::RadarFC_Obj::_g_PL_AD_fw_Radar_1R1V_rpc_XilObjBypassingRunnable_XilObjBypassingRunnable_m_pad_radarObjPort_par_out_local::TChangeableMemPool::_::_::_m_arrayPool::_0_::_elem::_m_objectInformation::_3_::_m_perObjectType::_m_prob1UnknownN = 128;
      @sysvar::XCP::RadarFC_Obj::_g_PL_AD_fw_Radar_1R1V_rpc_XilObjBypassingRunnable_XilObjBypassingRunnable_m_pad_radarObjPort_par_out_local::TChangeableMemPool::_::_::_m_arrayPool::_0_::_elem::_m_objectInformation::_3_::_m_perObjectType::_m_prob1MobileN = 0;
      @sysvar::XCP::RadarFC_Obj::_g_PL_AD_fw_Radar_1R1V_rpc_XilObjBypassingRunnable_XilObjBypassingRunnable_m_pad_radarObjPort_par_out_local::TChangeableMemPool::_::_::_m_arrayPool::_0_::_elem::_m_objectInformation::_3_::_m_perObjectType::_m_prob1StationaryN = 0;
      @sysvar::XCP::RadarFC_Obj::_g_PL_AD_fw_Radar_1R1V_rpc_XilObjBypassingRunnable_XilObjBypassingRunnable_m_pad_radarObjPort_par_out_local::TChangeableMemPool::_::_::_m_arrayPool::_0_::_elem::_m_objectInformation::_3_::_m_perObjectType::_m_prob1ObstUnknownN = 128;
      @sysvar::XCP::RadarFC_Obj::_g_PL_AD_fw_Radar_1R1V_rpc_XilObjBypassingRunnable_XilObjBypassingRunnable_m_pad_radarObjPort_par_out_local::TChangeableMemPool::_::_::_m_arrayPool::_0_::_elem::_m_objectInformation::_3_::_m_perObjectType::_m_prob1FourPlusWheelerN = 0;
      @sysvar::XCP::RadarFC_Obj::_g_PL_AD_fw_Radar_1R1V_rpc_XilObjBypassingRunnable_XilObjBypassingRunnable_m_pad_radarObjPort_par_out_local::TChangeableMemPool::_::_::_m_arrayPool::_0_::_elem::_m_objectInformation::_3_::_m_perObjectType::_m_prob1TwoWheelerN = 0;
      @sysvar::XCP::RadarFC_Obj::_g_PL_AD_fw_Radar_1R1V_rpc_XilObjBypassingRunnable_XilObjBypassingRunnable_m_pad_radarObjPort_par_out_local::TChangeableMemPool::_::_::_m_arrayPool::_0_::_elem::_m_objectInformation::_3_::_m_perObjectType::_m_prob1PedestrianN = 0;
      @sysvar::XCP::RadarFC_Obj::_g_PL_AD_fw_Radar_1R1V_rpc_XilObjBypassingRunnable_XilObjBypassingRunnable_m_pad_radarObjPort_par_out_local::TChangeableMemPool::_::_::_m_arrayPool::_0_::_elem::_m_objectInformation::_3_::_m_perObjectType::_m_prob1MovUnknownN = 128;
      @sysvar::XCP::RadarFC_Obj::_g_PL_AD_fw_Radar_1R1V_rpc_XilObjBypassingRunnable_XilObjBypassingRunnable_m_pad_radarObjPort_par_out_local::TChangeableMemPool::_::_::_m_arrayPool::_0_::_elem::_m_objectInformation::_3_::_m_perObjectType::_m_prob1RoadsideBarrierN = 0;
      @sysvar::XCP::RadarFC_Obj::_g_PL_AD_fw_Radar_1R1V_rpc_XilObjBypassingRunnable_XilObjBypassingRunnable_m_pad_radarObjPort_par_out_local::TChangeableMemPool::_::_::_m_arrayPool::_0_::_elem::_m_objectInformation::_3_::_m_perObjectType::_m_prob1StatUnknownN = 128;
      @sysvar::XCP::RadarFC_Obj::_g_PL_AD_fw_Radar_1R1V_rpc_XilObjBypassingRunnable_XilObjBypassingRunnable_m_pad_radarObjPort_par_out_local::TChangeableMemPool::_::_::_m_arrayPool::_0_::_elem::_m_objectInformation::_3_::_m_perObjectType::_m_prob1PassengerCarN = 0;
      @sysvar::XCP::RadarFC_Obj::_g_PL_AD_fw_Radar_1R1V_rpc_XilObjBypassingRunnable_XilObjBypassingRunnable_m_pad_radarObjPort_par_out_local::TChangeableMemPool::_::_::_m_arrayPool::_0_::_elem::_m_objectInformation::_3_::_m_perObjectType::_m_prob1TruckN = 0;
      @sysvar::XCP::RadarFC_Obj::_g_PL_AD_fw_Radar_1R1V_rpc_XilObjBypassingRunnable_XilObjBypassingRunnable_m_pad_radarObjPort_par_out_local::TChangeableMemPool::_::_::_m_arrayPool::_0_::_elem::_m_objectInformation::_3_::_m_perObjectType::_m_prob1FourWheelUnknownN = 128;
      @sysvar::XCP::RadarFC_Obj::_g_PL_AD_fw_Radar_1R1V_rpc_XilObjBypassingRunnable_XilObjBypassingRunnable_m_pad_radarObjPort_par_out_local::TChangeableMemPool::_::_::_m_arrayPool::_0_::_elem::_m_objectInformation::_3_::_m_dWidthN = 256;
        break;

      case 2: //"RoadSideBarrier"
      @sysvar::XCP::RadarFC_Obj::_g_PL_AD_fw_Radar_1R1V_rpc_XilObjBypassingRunnable_XilObjBypassingRunnable_m_pad_radarObjPort_par_out_local::TChangeableMemPool::_::_::_m_arrayPool::_0_::_elem::_m_objectInformation::_3_::_m_perObjectType::_m_prob1ObstacleN = 128;
      @sysvar::XCP::RadarFC_Obj::_g_PL_AD_fw_Radar_1R1V_rpc_XilObjBypassingRunnable_XilObjBypassingRunnable_m_pad_radarObjPort_par_out_local::TChangeableMemPool::_::_::_m_arrayPool::_0_::_elem::_m_objectInformation::_3_::_m_perObjectType::_m_prob1NonObstacleN = 0;
      @sysvar::XCP::RadarFC_Obj::_g_PL_AD_fw_Radar_1R1V_rpc_XilObjBypassingRunnable_XilObjBypassingRunnable_m_pad_radarObjPort_par_out_local::TChangeableMemPool::_::_::_m_arrayPool::_0_::_elem::_m_objectInformation::_3_::_m_perObjectType::_m_prob1UnknownN = 0;
      @sysvar::XCP::RadarFC_Obj::_g_PL_AD_fw_Radar_1R1V_rpc_XilObjBypassingRunnable_XilObjBypassingRunnable_m_pad_radarObjPort_par_out_local::TChangeableMemPool::_::_::_m_arrayPool::_0_::_elem::_m_objectInformation::_3_::_m_perObjectType::_m_prob1MobileN = 0;
      @sysvar::XCP::RadarFC_Obj::_g_PL_AD_fw_Radar_1R1V_rpc_XilObjBypassingRunnable_XilObjBypassingRunnable_m_pad_radarObjPort_par_out_local::TChangeableMemPool::_::_::_m_arrayPool::_0_::_elem::_m_objectInformation::_3_::_m_perObjectType::_m_prob1StationaryN = 128;
      @sysvar::XCP::RadarFC_Obj::_g_PL_AD_fw_Radar_1R1V_rpc_XilObjBypassingRunnable_XilObjBypassingRunnable_m_pad_radarObjPort_par_out_local::TChangeableMemPool::_::_::_m_arrayPool::_0_::_elem::_m_objectInformation::_3_::_m_perObjectType::_m_prob1ObstUnknownN = 0;
      @sysvar::XCP::RadarFC_Obj::_g_PL_AD_fw_Radar_1R1V_rpc_XilObjBypassingRunnable_XilObjBypassingRunnable_m_pad_radarObjPort_par_out_local::TChangeableMemPool::_::_::_m_arrayPool::_0_::_elem::_m_objectInformation::_3_::_m_perObjectType::_m_prob1FourPlusWheelerN = 0;
      @sysvar::XCP::RadarFC_Obj::_g_PL_AD_fw_Radar_1R1V_rpc_XilObjBypassingRunnable_XilObjBypassingRunnable_m_pad_radarObjPort_par_out_local::TChangeableMemPool::_::_::_m_arrayPool::_0_::_elem::_m_objectInformation::_3_::_m_perObjectType::_m_prob1TwoWheelerN = 0;
      @sysvar::XCP::RadarFC_Obj::_g_PL_AD_fw_Radar_1R1V_rpc_XilObjBypassingRunnable_XilObjBypassingRunnable_m_pad_radarObjPort_par_out_local::TChangeableMemPool::_::_::_m_arrayPool::_0_::_elem::_m_objectInformation::_3_::_m_perObjectType::_m_prob1PedestrianN = 0;
      @sysvar::XCP::RadarFC_Obj::_g_PL_AD_fw_Radar_1R1V_rpc_XilObjBypassingRunnable_XilObjBypassingRunnable_m_pad_radarObjPort_par_out_local::TChangeableMemPool::_::_::_m_arrayPool::_0_::_elem::_m_objectInformation::_3_::_m_perObjectType::_m_prob1MovUnknownN = 128;
      @sysvar::XCP::RadarFC_Obj::_g_PL_AD_fw_Radar_1R1V_rpc_XilObjBypassingRunnable_XilObjBypassingRunnable_m_pad_radarObjPort_par_out_local::TChangeableMemPool::_::_::_m_arrayPool::_0_::_elem::_m_objectInformation::_3_::_m_perObjectType::_m_prob1RoadsideBarrierN = 128;
      @sysvar::XCP::RadarFC_Obj::_g_PL_AD_fw_Radar_1R1V_rpc_XilObjBypassingRunnable_XilObjBypassingRunnable_m_pad_radarObjPort_par_out_local::TChangeableMemPool::_::_::_m_arrayPool::_0_::_elem::_m_objectInformation::_3_::_m_perObjectType::_m_prob1StatUnknownN = 0;
      @sysvar::XCP::RadarFC_Obj::_g_PL_AD_fw_Radar_1R1V_rpc_XilObjBypassingRunnable_XilObjBypassingRunnable_m_pad_radarObjPort_par_out_local::TChangeableMemPool::_::_::_m_arrayPool::_0_::_elem::_m_objectInformation::_3_::_m_perObjectType::_m_prob1PassengerCarN = 0;
      @sysvar::XCP::RadarFC_Obj::_g_PL_AD_fw_Radar_1R1V_rpc_XilObjBypassingRunnable_XilObjBypassingRunnable_m_pad_radarObjPort_par_out_local::TChangeableMemPool::_::_::_m_arrayPool::_0_::_elem::_m_objectInformation::_3_::_m_perObjectType::_m_prob1TruckN = 0;
      @sysvar::XCP::RadarFC_Obj::_g_PL_AD_fw_Radar_1R1V_rpc_XilObjBypassingRunnable_XilObjBypassingRunnable_m_pad_radarObjPort_par_out_local::TChangeableMemPool::_::_::_m_arrayPool::_0_::_elem::_m_objectInformation::_3_::_m_perObjectType::_m_prob1FourWheelUnknownN = 128;
      @sysvar::XCP::RadarFC_Obj::_g_PL_AD_fw_Radar_1R1V_rpc_XilObjBypassingRunnable_XilObjBypassingRunnable_m_pad_radarObjPort_par_out_local::TChangeableMemPool::_::_::_m_arrayPool::_0_::_elem::_m_objectInformation::_3_::_m_dWidthN = 256;
        break;

      case 3: //"2Wheeler"
      @sysvar::XCP::RadarFC_Obj::_g_PL_AD_fw_Radar_1R1V_rpc_XilObjBypassingRunnable_XilObjBypassingRunnable_m_pad_radarObjPort_par_out_local::TChangeableMemPool::_::_::_m_arrayPool::_0_::_elem::_m_objectInformation::_3_::_m_perObjectType::_m_prob1ObstacleN = 128;
      @sysvar::XCP::RadarFC_Obj::_g_PL_AD_fw_Radar_1R1V_rpc_XilObjBypassingRunnable_XilObjBypassingRunnable_m_pad_radarObjPort_par_out_local::TChangeableMemPool::_::_::_m_arrayPool::_0_::_elem::_m_objectInformation::_3_::_m_perObjectType::_m_prob1NonObstacleN = 0;
      @sysvar::XCP::RadarFC_Obj::_g_PL_AD_fw_Radar_1R1V_rpc_XilObjBypassingRunnable_XilObjBypassingRunnable_m_pad_radarObjPort_par_out_local::TChangeableMemPool::_::_::_m_arrayPool::_0_::_elem::_m_objectInformation::_3_::_m_perObjectType::_m_prob1UnknownN = 0;
      @sysvar::XCP::RadarFC_Obj::_g_PL_AD_fw_Radar_1R1V_rpc_XilObjBypassingRunnable_XilObjBypassingRunnable_m_pad_radarObjPort_par_out_local::TChangeableMemPool::_::_::_m_arrayPool::_0_::_elem::_m_objectInformation::_3_::_m_perObjectType::_m_prob1MobileN = 128;
      @sysvar::XCP::RadarFC_Obj::_g_PL_AD_fw_Radar_1R1V_rpc_XilObjBypassingRunnable_XilObjBypassingRunnable_m_pad_radarObjPort_par_out_local::TChangeableMemPool::_::_::_m_arrayPool::_0_::_elem::_m_objectInformation::_3_::_m_perObjectType::_m_prob1StationaryN = 0;
      @sysvar::XCP::RadarFC_Obj::_g_PL_AD_fw_Radar_1R1V_rpc_XilObjBypassingRunnable_XilObjBypassingRunnable_m_pad_radarObjPort_par_out_local::TChangeableMemPool::_::_::_m_arrayPool::_0_::_elem::_m_objectInformation::_3_::_m_perObjectType::_m_prob1ObstUnknownN = 0;
      @sysvar::XCP::RadarFC_Obj::_g_PL_AD_fw_Radar_1R1V_rpc_XilObjBypassingRunnable_XilObjBypassingRunnable_m_pad_radarObjPort_par_out_local::TChangeableMemPool::_::_::_m_arrayPool::_0_::_elem::_m_objectInformation::_3_::_m_perObjectType::_m_prob1FourPlusWheelerN = 0;
      @sysvar::XCP::RadarFC_Obj::_g_PL_AD_fw_Radar_1R1V_rpc_XilObjBypassingRunnable_XilObjBypassingRunnable_m_pad_radarObjPort_par_out_local::TChangeableMemPool::_::_::_m_arrayPool::_0_::_elem::_m_objectInformation::_3_::_m_perObjectType::_m_prob1TwoWheelerN = 128;
      @sysvar::XCP::RadarFC_Obj::_g_PL_AD_fw_Radar_1R1V_rpc_XilObjBypassingRunnable_XilObjBypassingRunnable_m_pad_radarObjPort_par_out_local::TChangeableMemPool::_::_::_m_arrayPool::_0_::_elem::_m_objectInformation::_3_::_m_perObjectType::_m_prob1PedestrianN = 0;
      @sysvar::XCP::RadarFC_Obj::_g_PL_AD_fw_Radar_1R1V_rpc_XilObjBypassingRunnable_XilObjBypassingRunnable_m_pad_radarObjPort_par_out_local::TChangeableMemPool::_::_::_m_arrayPool::_0_::_elem::_m_objectInformation::_3_::_m_perObjectType::_m_prob1MovUnknownN = 0;
      @sysvar::XCP::RadarFC_Obj::_g_PL_AD_fw_Radar_1R1V_rpc_XilObjBypassingRunnable_XilObjBypassingRunnable_m_pad_radarObjPort_par_out_local::TChangeableMemPool::_::_::_m_arrayPool::_0_::_elem::_m_objectInformation::_3_::_m_perObjectType::_m_prob1RoadsideBarrierN = 0;
      @sysvar::XCP::RadarFC_Obj::_g_PL_AD_fw_Radar_1R1V_rpc_XilObjBypassingRunnable_XilObjBypassingRunnable_m_pad_radarObjPort_par_out_local::TChangeableMemPool::_::_::_m_arrayPool::_0_::_elem::_m_objectInformation::_3_::_m_perObjectType::_m_prob1StatUnknownN = 128;
      @sysvar::XCP::RadarFC_Obj::_g_PL_AD_fw_Radar_1R1V_rpc_XilObjBypassingRunnable_XilObjBypassingRunnable_m_pad_radarObjPort_par_out_local::TChangeableMemPool::_::_::_m_arrayPool::_0_::_elem::_m_objectInformation::_3_::_m_perObjectType::_m_prob1PassengerCarN = 0;
      @sysvar::XCP::RadarFC_Obj::_g_PL_AD_fw_Radar_1R1V_rpc_XilObjBypassingRunnable_XilObjBypassingRunnable_m_pad_radarObjPort_par_out_local::TChangeableMemPool::_::_::_m_arrayPool::_0_::_elem::_m_objectInformation::_3_::_m_perObjectType::_m_prob1TruckN = 0;
      @sysvar::XCP::RadarFC_Obj::_g_PL_AD_fw_Radar_1R1V_rpc_XilObjBypassingRunnable_XilObjBypassingRunnable_m_pad_radarObjPort_par_out_local::TChangeableMemPool::_::_::_m_arrayPool::_0_::_elem::_m_objectInformation::_3_::_m_perObjectType::_m_prob1FourWheelUnknownN = 128;
      @sysvar::XCP::RadarFC_Obj::_g_PL_AD_fw_Radar_1R1V_rpc_XilObjBypassingRunnable_XilObjBypassingRunnable_m_pad_radarObjPort_par_out_local::TChangeableMemPool::_::_::_m_arrayPool::_0_::_elem::_m_objectInformation::_3_::_m_dWidthN = 64;
        break;

      case 4: //"Pedestrian"
      @sysvar::XCP::RadarFC_Obj::_g_PL_AD_fw_Radar_1R1V_rpc_XilObjBypassingRunnable_XilObjBypassingRunnable_m_pad_radarObjPort_par_out_local::TChangeableMemPool::_::_::_m_arrayPool::_0_::_elem::_m_objectInformation::_3_::_m_perObjectType::_m_prob1ObstacleN = 128;
      @sysvar::XCP::RadarFC_Obj::_g_PL_AD_fw_Radar_1R1V_rpc_XilObjBypassingRunnable_XilObjBypassingRunnable_m_pad_radarObjPort_par_out_local::TChangeableMemPool::_::_::_m_arrayPool::_0_::_elem::_m_objectInformation::_3_::_m_perObjectType::_m_prob1NonObstacleN = 0;
      @sysvar::XCP::RadarFC_Obj::_g_PL_AD_fw_Radar_1R1V_rpc_XilObjBypassingRunnable_XilObjBypassingRunnable_m_pad_radarObjPort_par_out_local::TChangeableMemPool::_::_::_m_arrayPool::_0_::_elem::_m_objectInformation::_3_::_m_perObjectType::_m_prob1UnknownN = 0;
      @sysvar::XCP::RadarFC_Obj::_g_PL_AD_fw_Radar_1R1V_rpc_XilObjBypassingRunnable_XilObjBypassingRunnable_m_pad_radarObjPort_par_out_local::TChangeableMemPool::_::_::_m_arrayPool::_0_::_elem::_m_objectInformation::_3_::_m_perObjectType::_m_prob1MobileN = 128;
      @sysvar::XCP::RadarFC_Obj::_g_PL_AD_fw_Radar_1R1V_rpc_XilObjBypassingRunnable_XilObjBypassingRunnable_m_pad_radarObjPort_par_out_local::TChangeableMemPool::_::_::_m_arrayPool::_0_::_elem::_m_objectInformation::_3_::_m_perObjectType::_m_prob1StationaryN = 0;
      @sysvar::XCP::RadarFC_Obj::_g_PL_AD_fw_Radar_1R1V_rpc_XilObjBypassingRunnable_XilObjBypassingRunnable_m_pad_radarObjPort_par_out_local::TChangeableMemPool::_::_::_m_arrayPool::_0_::_elem::_m_objectInformation::_3_::_m_perObjectType::_m_prob1ObstUnknownN = 0;
      @sysvar::XCP::RadarFC_Obj::_g_PL_AD_fw_Radar_1R1V_rpc_XilObjBypassingRunnable_XilObjBypassingRunnable_m_pad_radarObjPort_par_out_local::TChangeableMemPool::_::_::_m_arrayPool::_0_::_elem::_m_objectInformation::_3_::_m_perObjectType::_m_prob1FourPlusWheelerN = 0;
      @sysvar::XCP::RadarFC_Obj::_g_PL_AD_fw_Radar_1R1V_rpc_XilObjBypassingRunnable_XilObjBypassingRunnable_m_pad_radarObjPort_par_out_local::TChangeableMemPool::_::_::_m_arrayPool::_0_::_elem::_m_objectInformation::_3_::_m_perObjectType::_m_prob1TwoWheelerN = 0;
      @sysvar::XCP::RadarFC_Obj::_g_PL_AD_fw_Radar_1R1V_rpc_XilObjBypassingRunnable_XilObjBypassingRunnable_m_pad_radarObjPort_par_out_local::TChangeableMemPool::_::_::_m_arrayPool::_0_::_elem::_m_objectInformation::_3_::_m_perObjectType::_m_prob1PedestrianN = 128;
      @sysvar::XCP::RadarFC_Obj::_g_PL_AD_fw_Radar_1R1V_rpc_XilObjBypassingRunnable_XilObjBypassingRunnable_m_pad_radarObjPort_par_out_local::TChangeableMemPool::_::_::_m_arrayPool::_0_::_elem::_m_objectInformation::_3_::_m_perObjectType::_m_prob1MovUnknownN = 0;
      @sysvar::XCP::RadarFC_Obj::_g_PL_AD_fw_Radar_1R1V_rpc_XilObjBypassingRunnable_XilObjBypassingRunnable_m_pad_radarObjPort_par_out_local::TChangeableMemPool::_::_::_m_arrayPool::_0_::_elem::_m_objectInformation::_3_::_m_perObjectType::_m_prob1RoadsideBarrierN = 0;
      @sysvar::XCP::RadarFC_Obj::_g_PL_AD_fw_Radar_1R1V_rpc_XilObjBypassingRunnable_XilObjBypassingRunnable_m_pad_radarObjPort_par_out_local::TChangeableMemPool::_::_::_m_arrayPool::_0_::_elem::_m_objectInformation::_3_::_m_perObjectType::_m_prob1StatUnknownN = 128;
      @sysvar::XCP::RadarFC_Obj::_g_PL_AD_fw_Radar_1R1V_rpc_XilObjBypassingRunnable_XilObjBypassingRunnable_m_pad_radarObjPort_par_out_local::TChangeableMemPool::_::_::_m_arrayPool::_0_::_elem::_m_objectInformation::_3_::_m_perObjectType::_m_prob1PassengerCarN = 0;
      @sysvar::XCP::RadarFC_Obj::_g_PL_AD_fw_Radar_1R1V_rpc_XilObjBypassingRunnable_XilObjBypassingRunnable_m_pad_radarObjPort_par_out_local::TChangeableMemPool::_::_::_m_arrayPool::_0_::_elem::_m_objectInformation::_3_::_m_perObjectType::_m_prob1TruckN = 0;
      @sysvar::XCP::RadarFC_Obj::_g_PL_AD_fw_Radar_1R1V_rpc_XilObjBypassingRunnable_XilObjBypassingRunnable_m_pad_radarObjPort_par_out_local::TChangeableMemPool::_::_::_m_arrayPool::_0_::_elem::_m_objectInformation::_3_::_m_perObjectType::_m_prob1FourWheelUnknownN = 128;
      @sysvar::XCP::RadarFC_Obj::_g_PL_AD_fw_Radar_1R1V_rpc_XilObjBypassingRunnable_XilObjBypassingRunnable_m_pad_radarObjPort_par_out_local::TChangeableMemPool::_::_::_m_arrayPool::_0_::_elem::_m_objectInformation::_3_::_m_dWidthN = 64;
        break;

      case 5: //"Truck"
      @sysvar::XCP::RadarFC_Obj::_g_PL_AD_fw_Radar_1R1V_rpc_XilObjBypassingRunnable_XilObjBypassingRunnable_m_pad_radarObjPort_par_out_local::TChangeableMemPool::_::_::_m_arrayPool::_0_::_elem::_m_objectInformation::_3_::_m_perObjectType::_m_prob1ObstacleN = 128;
      @sysvar::XCP::RadarFC_Obj::_g_PL_AD_fw_Radar_1R1V_rpc_XilObjBypassingRunnable_XilObjBypassingRunnable_m_pad_radarObjPort_par_out_local::TChangeableMemPool::_::_::_m_arrayPool::_0_::_elem::_m_objectInformation::_3_::_m_perObjectType::_m_prob1NonObstacleN = 0;
      @sysvar::XCP::RadarFC_Obj::_g_PL_AD_fw_Radar_1R1V_rpc_XilObjBypassingRunnable_XilObjBypassingRunnable_m_pad_radarObjPort_par_out_local::TChangeableMemPool::_::_::_m_arrayPool::_0_::_elem::_m_objectInformation::_3_::_m_perObjectType::_m_prob1UnknownN = 0;
      @sysvar::XCP::RadarFC_Obj::_g_PL_AD_fw_Radar_1R1V_rpc_XilObjBypassingRunnable_XilObjBypassingRunnable_m_pad_radarObjPort_par_out_local::TChangeableMemPool::_::_::_m_arrayPool::_0_::_elem::_m_objectInformation::_3_::_m_perObjectType::_m_prob1MobileN = 128;
      @sysvar::XCP::RadarFC_Obj::_g_PL_AD_fw_Radar_1R1V_rpc_XilObjBypassingRunnable_XilObjBypassingRunnable_m_pad_radarObjPort_par_out_local::TChangeableMemPool::_::_::_m_arrayPool::_0_::_elem::_m_objectInformation::_3_::_m_perObjectType::_m_prob1StationaryN = 0;
      @sysvar::XCP::RadarFC_Obj::_g_PL_AD_fw_Radar_1R1V_rpc_XilObjBypassingRunnable_XilObjBypassingRunnable_m_pad_radarObjPort_par_out_local::TChangeableMemPool::_::_::_m_arrayPool::_0_::_elem::_m_objectInformation::_3_::_m_perObjectType::_m_prob1ObstUnknownN = 0;
      @sysvar::XCP::RadarFC_Obj::_g_PL_AD_fw_Radar_1R1V_rpc_XilObjBypassingRunnable_XilObjBypassingRunnable_m_pad_radarObjPort_par_out_local::TChangeableMemPool::_::_::_m_arrayPool::_0_::_elem::_m_objectInformation::_3_::_m_perObjectType::_m_prob1FourPlusWheelerN = 128;
      @sysvar::XCP::RadarFC_Obj::_g_PL_AD_fw_Radar_1R1V_rpc_XilObjBypassingRunnable_XilObjBypassingRunnable_m_pad_radarObjPort_par_out_local::TChangeableMemPool::_::_::_m_arrayPool::_0_::_elem::_m_objectInformation::_3_::_m_perObjectType::_m_prob1TwoWheelerN = 0;
      @sysvar::XCP::RadarFC_Obj::_g_PL_AD_fw_Radar_1R1V_rpc_XilObjBypassingRunnable_XilObjBypassingRunnable_m_pad_radarObjPort_par_out_local::TChangeableMemPool::_::_::_m_arrayPool::_0_::_elem::_m_objectInformation::_3_::_m_perObjectType::_m_prob1PedestrianN = 0;
      @sysvar::XCP::RadarFC_Obj::_g_PL_AD_fw_Radar_1R1V_rpc_XilObjBypassingRunnable_XilObjBypassingRunnable_m_pad_radarObjPort_par_out_local::TChangeableMemPool::_::_::_m_arrayPool::_0_::_elem::_m_objectInformation::_3_::_m_perObjectType::_m_prob1MovUnknownN = 0;
      @sysvar::XCP::RadarFC_Obj::_g_PL_AD_fw_Radar_1R1V_rpc_XilObjBypassingRunnable_XilObjBypassingRunnable_m_pad_radarObjPort_par_out_local::TChangeableMemPool::_::_::_m_arrayPool::_0_::_elem::_m_objectInformation::_3_::_m_perObjectType::_m_prob1RoadsideBarrierN = 0;
      @sysvar::XCP::RadarFC_Obj::_g_PL_AD_fw_Radar_1R1V_rpc_XilObjBypassingRunnable_XilObjBypassingRunnable_m_pad_radarObjPort_par_out_local::TChangeableMemPool::_::_::_m_arrayPool::_0_::_elem::_m_objectInformation::_3_::_m_perObjectType::_m_prob1StatUnknownN = 128;
      @sysvar::XCP::RadarFC_Obj::_g_PL_AD_fw_Radar_1R1V_rpc_XilObjBypassingRunnable_XilObjBypassingRunnable_m_pad_radarObjPort_par_out_local::TChangeableMemPool::_::_::_m_arrayPool::_0_::_elem::_m_objectInformation::_3_::_m_perObjectType::_m_prob1PassengerCarN = 0;
      @sysvar::XCP::RadarFC_Obj::_g_PL_AD_fw_Radar_1R1V_rpc_XilObjBypassingRunnable_XilObjBypassingRunnable_m_pad_radarObjPort_par_out_local::TChangeableMemPool::_::_::_m_arrayPool::_0_::_elem::_m_objectInformation::_3_::_m_perObjectType::_m_prob1TruckN = 128;
      @sysvar::XCP::RadarFC_Obj::_g_PL_AD_fw_Radar_1R1V_rpc_XilObjBypassingRunnable_XilObjBypassingRunnable_m_pad_radarObjPort_par_out_local::TChangeableMemPool::_::_::_m_arrayPool::_0_::_elem::_m_objectInformation::_3_::_m_perObjectType::_m_prob1FourWheelUnknownN = 0;
      @sysvar::XCP::RadarFC_Obj::_g_PL_AD_fw_Radar_1R1V_rpc_XilObjBypassingRunnable_XilObjBypassingRunnable_m_pad_radarObjPort_par_out_local::TChangeableMemPool::_::_::_m_arrayPool::_0_::_elem::_m_objectInformation::_3_::_m_dWidthN = 256;
        break;

      case 6: //"PassengerCar"
      @sysvar::XCP::RadarFC_Obj::_g_PL_AD_fw_Radar_1R1V_rpc_XilObjBypassingRunnable_XilObjBypassingRunnable_m_pad_radarObjPort_par_out_local::TChangeableMemPool::_::_::_m_arrayPool::_0_::_elem::_m_objectInformation::_3_::_m_perObjectType::_m_prob1ObstacleN = 128;
      @sysvar::XCP::RadarFC_Obj::_g_PL_AD_fw_Radar_1R1V_rpc_XilObjBypassingRunnable_XilObjBypassingRunnable_m_pad_radarObjPort_par_out_local::TChangeableMemPool::_::_::_m_arrayPool::_0_::_elem::_m_objectInformation::_3_::_m_perObjectType::_m_prob1NonObstacleN = 0;
      @sysvar::XCP::RadarFC_Obj::_g_PL_AD_fw_Radar_1R1V_rpc_XilObjBypassingRunnable_XilObjBypassingRunnable_m_pad_radarObjPort_par_out_local::TChangeableMemPool::_::_::_m_arrayPool::_0_::_elem::_m_objectInformation::_3_::_m_perObjectType::_m_prob1UnknownN = 0;
      @sysvar::XCP::RadarFC_Obj::_g_PL_AD_fw_Radar_1R1V_rpc_XilObjBypassingRunnable_XilObjBypassingRunnable_m_pad_radarObjPort_par_out_local::TChangeableMemPool::_::_::_m_arrayPool::_0_::_elem::_m_objectInformation::_3_::_m_perObjectType::_m_prob1MobileN = 128;
      @sysvar::XCP::RadarFC_Obj::_g_PL_AD_fw_Radar_1R1V_rpc_XilObjBypassingRunnable_XilObjBypassingRunnable_m_pad_radarObjPort_par_out_local::TChangeableMemPool::_::_::_m_arrayPool::_0_::_elem::_m_objectInformation::_3_::_m_perObjectType::_m_prob1StationaryN = 0;
      @sysvar::XCP::RadarFC_Obj::_g_PL_AD_fw_Radar_1R1V_rpc_XilObjBypassingRunnable_XilObjBypassingRunnable_m_pad_radarObjPort_par_out_local::TChangeableMemPool::_::_::_m_arrayPool::_0_::_elem::_m_objectInformation::_3_::_m_perObjectType::_m_prob1ObstUnknownN = 0;
      @sysvar::XCP::RadarFC_Obj::_g_PL_AD_fw_Radar_1R1V_rpc_XilObjBypassingRunnable_XilObjBypassingRunnable_m_pad_radarObjPort_par_out_local::TChangeableMemPool::_::_::_m_arrayPool::_0_::_elem::_m_objectInformation::_3_::_m_perObjectType::_m_prob1FourPlusWheelerN = 128;
      @sysvar::XCP::RadarFC_Obj::_g_PL_AD_fw_Radar_1R1V_rpc_XilObjBypassingRunnable_XilObjBypassingRunnable_m_pad_radarObjPort_par_out_local::TChangeableMemPool::_::_::_m_arrayPool::_0_::_elem::_m_objectInformation::_3_::_m_perObjectType::_m_prob1TwoWheelerN = 0;
      @sysvar::XCP::RadarFC_Obj::_g_PL_AD_fw_Radar_1R1V_rpc_XilObjBypassingRunnable_XilObjBypassingRunnable_m_pad_radarObjPort_par_out_local::TChangeableMemPool::_::_::_m_arrayPool::_0_::_elem::_m_objectInformation::_3_::_m_perObjectType::_m_prob1PedestrianN = 0;
      @sysvar::XCP::RadarFC_Obj::_g_PL_AD_fw_Radar_1R1V_rpc_XilObjBypassingRunnable_XilObjBypassingRunnable_m_pad_radarObjPort_par_out_local::TChangeableMemPool::_::_::_m_arrayPool::_0_::_elem::_m_objectInformation::_3_::_m_perObjectType::_m_prob1MovUnknownN = 0;
      @sysvar::XCP::RadarFC_Obj::_g_PL_AD_fw_Radar_1R1V_rpc_XilObjBypassingRunnable_XilObjBypassingRunnable_m_pad_radarObjPort_par_out_local::TChangeableMemPool::_::_::_m_arrayPool::_0_::_elem::_m_objectInformation::_3_::_m_perObjectType::_m_prob1RoadsideBarrierN = 0;
      @sysvar::XCP::RadarFC_Obj::_g_PL_AD_fw_Radar_1R1V_rpc_XilObjBypassingRunnable_XilObjBypassingRunnable_m_pad_radarObjPort_par_out_local::TChangeableMemPool::_::_::_m_arrayPool::_0_::_elem::_m_objectInformation::_3_::_m_perObjectType::_m_prob1StatUnknownN = 128;
      @sysvar::XCP::RadarFC_Obj::_g_PL_AD_fw_Radar_1R1V_rpc_XilObjBypassingRunnable_XilObjBypassingRunnable_m_pad_radarObjPort_par_out_local::TChangeableMemPool::_::_::_m_arrayPool::_0_::_elem::_m_objectInformation::_3_::_m_perObjectType::_m_prob1PassengerCarN = 128;
      @sysvar::XCP::RadarFC_Obj::_g_PL_AD_fw_Radar_1R1V_rpc_XilObjBypassingRunnable_XilObjBypassingRunnable_m_pad_radarObjPort_par_out_local::TChangeableMemPool::_::_::_m_arrayPool::_0_::_elem::_m_objectInformation::_3_::_m_perObjectType::_m_prob1TruckN = 0;
      @sysvar::XCP::RadarFC_Obj::_g_PL_AD_fw_Radar_1R1V_rpc_XilObjBypassingRunnable_XilObjBypassingRunnable_m_pad_radarObjPort_par_out_local::TChangeableMemPool::_::_::_m_arrayPool::_0_::_elem::_m_objectInformation::_3_::_m_perObjectType::_m_prob1FourWheelUnknownN = 0;
      @sysvar::XCP::RadarFC_Obj::_g_PL_AD_fw_Radar_1R1V_rpc_XilObjBypassingRunnable_XilObjBypassingRunnable_m_pad_radarObjPort_par_out_local::TChangeableMemPool::_::_::_m_arrayPool::_0_::_elem::_m_objectInformation::_3_::_m_dWidthN = 256;
        break;
    }
    break;

    case 4: //"Object-4"
    //constant
  @sysvar::XCP::RadarFC_Obj::_g_PL_AD_fw_Radar_1R1V_rpc_XilObjBypassingRunnable_XilObjBypassingRunnable_m_pad_radarObjPort_par_out_local::TChangeableMemPool::_::_::_m_arrayPool::_0_::_elem::_m_objectInformation::_4_::_Valid_b = 1;
  @sysvar::XCP::RadarFC_Obj::_g_PL_AD_fw_Radar_1R1V_rpc_XilObjBypassingRunnable_XilObjBypassingRunnable_m_pad_radarObjPort_par_out_local::TChangeableMemPool::_::_::_m_arrayPool::_0_::_elem::_m_objectInformation::_4_::_m_HandleN = 1;
  @sysvar::XCP::RadarFC_Obj::_g_PL_AD_fw_Radar_1R1V_rpc_XilObjBypassingRunnable_XilObjBypassingRunnable_m_pad_radarObjPort_par_out_local::TChangeableMemPool::_::_::_m_arrayPool::_0_::_elem::_m_objectInformation::_4_::_m_alpPiVarYawAngleN = 0;
  @sysvar::XCP::RadarFC_Obj::_g_PL_AD_fw_Radar_1R1V_rpc_XilObjBypassingRunnable_XilObjBypassingRunnable_m_pad_radarObjPort_par_out_local::TChangeableMemPool::_::_::_m_arrayPool::_0_::_elem::_m_objectInformation::_4_::_m_alpPiYawAngleN = 0;
  @sysvar::XCP::RadarFC_Obj::_g_PL_AD_fw_Radar_1R1V_rpc_XilObjBypassingRunnable_XilObjBypassingRunnable_m_pad_radarObjPort_par_out_local::TChangeableMemPool::_::_::_m_arrayPool::_0_::_elem::_m_objectInformation::_4_::_m_varAxN = 0;
  @sysvar::XCP::RadarFC_Obj::_g_PL_AD_fw_Radar_1R1V_rpc_XilObjBypassingRunnable_XilObjBypassingRunnable_m_pad_radarObjPort_par_out_local::TChangeableMemPool::_::_::_m_arrayPool::_0_::_elem::_m_objectInformation::_4_::_m_varAyN = 0;
  @sysvar::XCP::RadarFC_Obj::_g_PL_AD_fw_Radar_1R1V_rpc_XilObjBypassingRunnable_XilObjBypassingRunnable_m_pad_radarObjPort_par_out_local::TChangeableMemPool::_::_::_m_arrayPool::_0_::_elem::_m_objectInformation::_4_::_m_varVxN = 0;
  @sysvar::XCP::RadarFC_Obj::_g_PL_AD_fw_Radar_1R1V_rpc_XilObjBypassingRunnable_XilObjBypassingRunnable_m_pad_radarObjPort_par_out_local::TChangeableMemPool::_::_::_m_arrayPool::_0_::_elem::_m_objectInformation::_4_::_m_varVyN = 0;
  @sysvar::XCP::RadarFC_Obj::_g_PL_AD_fw_Radar_1R1V_rpc_XilObjBypassingRunnable_XilObjBypassingRunnable_m_pad_radarObjPort_par_out_local::TChangeableMemPool::_::_::_m_arrayPool::_0_::_elem::_m_objectInformation::_4_::_m_varDxN = 0;
  @sysvar::XCP::RadarFC_Obj::_g_PL_AD_fw_Radar_1R1V_rpc_XilObjBypassingRunnable_XilObjBypassingRunnable_m_pad_radarObjPort_par_out_local::TChangeableMemPool::_::_::_m_arrayPool::_0_::_elem::_m_objectInformation::_4_::_m_varDyN = 0;
  @sysvar::XCP::RadarFC_Obj::_g_PL_AD_fw_Radar_1R1V_rpc_XilObjBypassingRunnable_XilObjBypassingRunnable_m_pad_radarObjPort_par_out_local::TChangeableMemPool::_::_::_m_arrayPool::_0_::_elem::_m_objectInformation::_4_::_m_dVarLengthN = 0;
  @sysvar::XCP::RadarFC_Obj::_g_PL_AD_fw_Radar_1R1V_rpc_XilObjBypassingRunnable_XilObjBypassingRunnable_m_pad_radarObjPort_par_out_local::TChangeableMemPool::_::_::_m_arrayPool::_0_::_elem::_m_objectInformation::_4_::_m_dVarWidthN = 0;
  @sysvar::XCP::RadarFC_Obj::_g_PL_AD_fw_Radar_1R1V_rpc_XilObjBypassingRunnable_XilObjBypassingRunnable_m_pad_radarObjPort_par_out_local::TChangeableMemPool::_::_::_m_arrayPool::_0_::_elem::_m_objectInformation::_4_::_m_wExistProbN = 64880;
  @sysvar::XCP::RadarFC_Obj::_g_PL_AD_fw_Radar_1R1V_rpc_XilObjBypassingRunnable_XilObjBypassingRunnable_m_pad_radarObjPort_par_out_local::TChangeableMemPool::_::_::_m_arrayPool::_0_::_elem::_m_objectInformation::_4_::_m_isObjectAsil = 1;
  @sysvar::XCP::RadarFC_Obj::_g_PL_AD_fw_Radar_1R1V_rpc_XilObjBypassingRunnable_XilObjBypassingRunnable_m_pad_radarObjPort_par_out_local::TChangeableMemPool::_::_::_m_arrayPool::_0_::_elem::_m_objectInformation::_4_::_m_dLengthN = 128;

    //target movement

  @sysvar::XCP::RadarFC_Obj::_g_PL_AD_fw_Radar_1R1V_rpc_XilObjBypassingRunnable_XilObjBypassingRunnable_m_pad_radarObjPort_par_out_local::TChangeableMemPool::_::_::_m_arrayPool::_0_::_elem::_m_objectInformation::_4_::_m_dxN = @target_radar_fc_sim::objdata.obj_distance_x[4] * 128;
  @sysvar::XCP::RadarFC_Obj::_g_PL_AD_fw_Radar_1R1V_rpc_XilObjBypassingRunnable_XilObjBypassingRunnable_m_pad_radarObjPort_par_out_local::TChangeableMemPool::_::_::_m_arrayPool::_0_::_elem::_m_objectInformation::_4_::_m_dyN = @target_radar_fc_sim::objdata.obj_distance_y[4] * 128;
  @sysvar::XCP::RadarFC_Obj::_g_PL_AD_fw_Radar_1R1V_rpc_XilObjBypassingRunnable_XilObjBypassingRunnable_m_pad_radarObjPort_par_out_local::TChangeableMemPool::_::_::_m_arrayPool::_0_::_elem::_m_objectInformation::_4_::_m_dzN = 0;
  @sysvar::XCP::RadarFC_Obj::_g_PL_AD_fw_Radar_1R1V_rpc_XilObjBypassingRunnable_XilObjBypassingRunnable_m_pad_radarObjPort_par_out_local::TChangeableMemPool::_::_::_m_arrayPool::_0_::_elem::_m_objectInformation::_4_::_m_vxN = @target_radar_fc_sim::objdata.obj_velocity_x[4] * 256;
  @sysvar::XCP::RadarFC_Obj::_g_PL_AD_fw_Radar_1R1V_rpc_XilObjBypassingRunnable_XilObjBypassingRunnable_m_pad_radarObjPort_par_out_local::TChangeableMemPool::_::_::_m_arrayPool::_0_::_elem::_m_objectInformation::_4_::_m_vyN = @target_radar_fc_sim::objdata.obj_velocity_y[4] * 256;
  @sysvar::XCP::RadarFC_Obj::_g_PL_AD_fw_Radar_1R1V_rpc_XilObjBypassingRunnable_XilObjBypassingRunnable_m_pad_radarObjPort_par_out_local::TChangeableMemPool::_::_::_m_arrayPool::_0_::_elem::_m_objectInformation::_4_::_m_axN = 0;
  @sysvar::XCP::RadarFC_Obj::_g_PL_AD_fw_Radar_1R1V_rpc_XilObjBypassingRunnable_XilObjBypassingRunnable_m_pad_radarObjPort_par_out_local::TChangeableMemPool::_::_::_m_arrayPool::_0_::_elem::_m_objectInformation::_4_::_m_ayN = 0;

    //target object moving or not
    if (abs(@target_radar_fc_sim::objdata.obj_velocity_x[4]) != 0)
    {
    @sysvar::XCP::RadarFC_Obj::_g_PL_AD_fw_Radar_1R1V_rpc_XilObjBypassingRunnable_XilObjBypassingRunnable_m_pad_radarObjPort_par_out_local::TChangeableMemPool::_::_::_m_arrayPool::_0_::_elem::_m_objectInformation::_4_::_m_prob1HasBeenObservedMovingN = 126;
    @sysvar::XCP::RadarFC_Obj::_g_PL_AD_fw_Radar_1R1V_rpc_XilObjBypassingRunnable_XilObjBypassingRunnable_m_pad_radarObjPort_par_out_local::TChangeableMemPool::_::_::_m_arrayPool::_0_::_elem::_m_objectInformation::_4_::_m_prob1MovingN = 126;
    }
    else
    {
    @sysvar::XCP::RadarFC_Obj::_g_PL_AD_fw_Radar_1R1V_rpc_XilObjBypassingRunnable_XilObjBypassingRunnable_m_pad_radarObjPort_par_out_local::TChangeableMemPool::_::_::_m_arrayPool::_0_::_elem::_m_objectInformation::_4_::_m_prob1HasBeenObservedMovingN = 0;
    @sysvar::XCP::RadarFC_Obj::_g_PL_AD_fw_Radar_1R1V_rpc_XilObjBypassingRunnable_XilObjBypassingRunnable_m_pad_radarObjPort_par_out_local::TChangeableMemPool::_::_::_m_arrayPool::_0_::_elem::_m_objectInformation::_4_::_m_prob1MovingN = 0;
    }

      //object classification
    switch (@target_radar_fc_sim::objdata.obj_type[4])
    {
      case 0: //"Non-Obstacle"
      @sysvar::XCP::RadarFC_Obj::_g_PL_AD_fw_Radar_1R1V_rpc_XilObjBypassingRunnable_XilObjBypassingRunnable_m_pad_radarObjPort_par_out_local::TChangeableMemPool::_::_::_m_arrayPool::_0_::_elem::_m_objectInformation::_4_::_m_perObjectType::_m_prob1ObstacleN = 0;
      @sysvar::XCP::RadarFC_Obj::_g_PL_AD_fw_Radar_1R1V_rpc_XilObjBypassingRunnable_XilObjBypassingRunnable_m_pad_radarObjPort_par_out_local::TChangeableMemPool::_::_::_m_arrayPool::_0_::_elem::_m_objectInformation::_4_::_m_perObjectType::_m_prob1NonObstacleN = 128;
      @sysvar::XCP::RadarFC_Obj::_g_PL_AD_fw_Radar_1R1V_rpc_XilObjBypassingRunnable_XilObjBypassingRunnable_m_pad_radarObjPort_par_out_local::TChangeableMemPool::_::_::_m_arrayPool::_0_::_elem::_m_objectInformation::_4_::_m_perObjectType::_m_prob1UnknownN = 0;
      @sysvar::XCP::RadarFC_Obj::_g_PL_AD_fw_Radar_1R1V_rpc_XilObjBypassingRunnable_XilObjBypassingRunnable_m_pad_radarObjPort_par_out_local::TChangeableMemPool::_::_::_m_arrayPool::_0_::_elem::_m_objectInformation::_4_::_m_perObjectType::_m_prob1MobileN = 0;
      @sysvar::XCP::RadarFC_Obj::_g_PL_AD_fw_Radar_1R1V_rpc_XilObjBypassingRunnable_XilObjBypassingRunnable_m_pad_radarObjPort_par_out_local::TChangeableMemPool::_::_::_m_arrayPool::_0_::_elem::_m_objectInformation::_4_::_m_perObjectType::_m_prob1StationaryN = 0;
      @sysvar::XCP::RadarFC_Obj::_g_PL_AD_fw_Radar_1R1V_rpc_XilObjBypassingRunnable_XilObjBypassingRunnable_m_pad_radarObjPort_par_out_local::TChangeableMemPool::_::_::_m_arrayPool::_0_::_elem::_m_objectInformation::_4_::_m_perObjectType::_m_prob1ObstUnknownN = 128;
      @sysvar::XCP::RadarFC_Obj::_g_PL_AD_fw_Radar_1R1V_rpc_XilObjBypassingRunnable_XilObjBypassingRunnable_m_pad_radarObjPort_par_out_local::TChangeableMemPool::_::_::_m_arrayPool::_0_::_elem::_m_objectInformation::_4_::_m_perObjectType::_m_prob1FourPlusWheelerN = 0;
      @sysvar::XCP::RadarFC_Obj::_g_PL_AD_fw_Radar_1R1V_rpc_XilObjBypassingRunnable_XilObjBypassingRunnable_m_pad_radarObjPort_par_out_local::TChangeableMemPool::_::_::_m_arrayPool::_0_::_elem::_m_objectInformation::_4_::_m_perObjectType::_m_prob1TwoWheelerN = 0;
      @sysvar::XCP::RadarFC_Obj::_g_PL_AD_fw_Radar_1R1V_rpc_XilObjBypassingRunnable_XilObjBypassingRunnable_m_pad_radarObjPort_par_out_local::TChangeableMemPool::_::_::_m_arrayPool::_0_::_elem::_m_objectInformation::_4_::_m_perObjectType::_m_prob1PedestrianN = 0;
      @sysvar::XCP::RadarFC_Obj::_g_PL_AD_fw_Radar_1R1V_rpc_XilObjBypassingRunnable_XilObjBypassingRunnable_m_pad_radarObjPort_par_out_local::TChangeableMemPool::_::_::_m_arrayPool::_0_::_elem::_m_objectInformation::_4_::_m_perObjectType::_m_prob1MovUnknownN = 128;
      @sysvar::XCP::RadarFC_Obj::_g_PL_AD_fw_Radar_1R1V_rpc_XilObjBypassingRunnable_XilObjBypassingRunnable_m_pad_radarObjPort_par_out_local::TChangeableMemPool::_::_::_m_arrayPool::_0_::_elem::_m_objectInformation::_4_::_m_perObjectType::_m_prob1RoadsideBarrierN = 0;
      @sysvar::XCP::RadarFC_Obj::_g_PL_AD_fw_Radar_1R1V_rpc_XilObjBypassingRunnable_XilObjBypassingRunnable_m_pad_radarObjPort_par_out_local::TChangeableMemPool::_::_::_m_arrayPool::_0_::_elem::_m_objectInformation::_4_::_m_perObjectType::_m_prob1StatUnknownN = 128;
      @sysvar::XCP::RadarFC_Obj::_g_PL_AD_fw_Radar_1R1V_rpc_XilObjBypassingRunnable_XilObjBypassingRunnable_m_pad_radarObjPort_par_out_local::TChangeableMemPool::_::_::_m_arrayPool::_0_::_elem::_m_objectInformation::_4_::_m_perObjectType::_m_prob1PassengerCarN = 0;
      @sysvar::XCP::RadarFC_Obj::_g_PL_AD_fw_Radar_1R1V_rpc_XilObjBypassingRunnable_XilObjBypassingRunnable_m_pad_radarObjPort_par_out_local::TChangeableMemPool::_::_::_m_arrayPool::_0_::_elem::_m_objectInformation::_4_::_m_perObjectType::_m_prob1TruckN = 0;
      @sysvar::XCP::RadarFC_Obj::_g_PL_AD_fw_Radar_1R1V_rpc_XilObjBypassingRunnable_XilObjBypassingRunnable_m_pad_radarObjPort_par_out_local::TChangeableMemPool::_::_::_m_arrayPool::_0_::_elem::_m_objectInformation::_4_::_m_perObjectType::_m_prob1FourWheelUnknownN = 128;
      @sysvar::XCP::RadarFC_Obj::_g_PL_AD_fw_Radar_1R1V_rpc_XilObjBypassingRunnable_XilObjBypassingRunnable_m_pad_radarObjPort_par_out_local::TChangeableMemPool::_::_::_m_arrayPool::_0_::_elem::_m_objectInformation::_4_::_m_dWidthN = 256;
        break;

      case 1: //"unknown"
      @sysvar::XCP::RadarFC_Obj::_g_PL_AD_fw_Radar_1R1V_rpc_XilObjBypassingRunnable_XilObjBypassingRunnable_m_pad_radarObjPort_par_out_local::TChangeableMemPool::_::_::_m_arrayPool::_0_::_elem::_m_objectInformation::_4_::_m_perObjectType::_m_prob1ObstacleN = 0;
      @sysvar::XCP::RadarFC_Obj::_g_PL_AD_fw_Radar_1R1V_rpc_XilObjBypassingRunnable_XilObjBypassingRunnable_m_pad_radarObjPort_par_out_local::TChangeableMemPool::_::_::_m_arrayPool::_0_::_elem::_m_objectInformation::_4_::_m_perObjectType::_m_prob1NonObstacleN = 0;
      @sysvar::XCP::RadarFC_Obj::_g_PL_AD_fw_Radar_1R1V_rpc_XilObjBypassingRunnable_XilObjBypassingRunnable_m_pad_radarObjPort_par_out_local::TChangeableMemPool::_::_::_m_arrayPool::_0_::_elem::_m_objectInformation::_4_::_m_perObjectType::_m_prob1UnknownN = 128;
      @sysvar::XCP::RadarFC_Obj::_g_PL_AD_fw_Radar_1R1V_rpc_XilObjBypassingRunnable_XilObjBypassingRunnable_m_pad_radarObjPort_par_out_local::TChangeableMemPool::_::_::_m_arrayPool::_0_::_elem::_m_objectInformation::_4_::_m_perObjectType::_m_prob1MobileN = 0;
      @sysvar::XCP::RadarFC_Obj::_g_PL_AD_fw_Radar_1R1V_rpc_XilObjBypassingRunnable_XilObjBypassingRunnable_m_pad_radarObjPort_par_out_local::TChangeableMemPool::_::_::_m_arrayPool::_0_::_elem::_m_objectInformation::_4_::_m_perObjectType::_m_prob1StationaryN = 0;
      @sysvar::XCP::RadarFC_Obj::_g_PL_AD_fw_Radar_1R1V_rpc_XilObjBypassingRunnable_XilObjBypassingRunnable_m_pad_radarObjPort_par_out_local::TChangeableMemPool::_::_::_m_arrayPool::_0_::_elem::_m_objectInformation::_4_::_m_perObjectType::_m_prob1ObstUnknownN = 128;
      @sysvar::XCP::RadarFC_Obj::_g_PL_AD_fw_Radar_1R1V_rpc_XilObjBypassingRunnable_XilObjBypassingRunnable_m_pad_radarObjPort_par_out_local::TChangeableMemPool::_::_::_m_arrayPool::_0_::_elem::_m_objectInformation::_4_::_m_perObjectType::_m_prob1FourPlusWheelerN = 0;
      @sysvar::XCP::RadarFC_Obj::_g_PL_AD_fw_Radar_1R1V_rpc_XilObjBypassingRunnable_XilObjBypassingRunnable_m_pad_radarObjPort_par_out_local::TChangeableMemPool::_::_::_m_arrayPool::_0_::_elem::_m_objectInformation::_4_::_m_perObjectType::_m_prob1TwoWheelerN = 0;
      @sysvar::XCP::RadarFC_Obj::_g_PL_AD_fw_Radar_1R1V_rpc_XilObjBypassingRunnable_XilObjBypassingRunnable_m_pad_radarObjPort_par_out_local::TChangeableMemPool::_::_::_m_arrayPool::_0_::_elem::_m_objectInformation::_4_::_m_perObjectType::_m_prob1PedestrianN = 0;
      @sysvar::XCP::RadarFC_Obj::_g_PL_AD_fw_Radar_1R1V_rpc_XilObjBypassingRunnable_XilObjBypassingRunnable_m_pad_radarObjPort_par_out_local::TChangeableMemPool::_::_::_m_arrayPool::_0_::_elem::_m_objectInformation::_4_::_m_perObjectType::_m_prob1MovUnknownN = 128;
      @sysvar::XCP::RadarFC_Obj::_g_PL_AD_fw_Radar_1R1V_rpc_XilObjBypassingRunnable_XilObjBypassingRunnable_m_pad_radarObjPort_par_out_local::TChangeableMemPool::_::_::_m_arrayPool::_0_::_elem::_m_objectInformation::_4_::_m_perObjectType::_m_prob1RoadsideBarrierN = 0;
      @sysvar::XCP::RadarFC_Obj::_g_PL_AD_fw_Radar_1R1V_rpc_XilObjBypassingRunnable_XilObjBypassingRunnable_m_pad_radarObjPort_par_out_local::TChangeableMemPool::_::_::_m_arrayPool::_0_::_elem::_m_objectInformation::_4_::_m_perObjectType::_m_prob1StatUnknownN = 128;
      @sysvar::XCP::RadarFC_Obj::_g_PL_AD_fw_Radar_1R1V_rpc_XilObjBypassingRunnable_XilObjBypassingRunnable_m_pad_radarObjPort_par_out_local::TChangeableMemPool::_::_::_m_arrayPool::_0_::_elem::_m_objectInformation::_4_::_m_perObjectType::_m_prob1PassengerCarN = 0;
      @sysvar::XCP::RadarFC_Obj::_g_PL_AD_fw_Radar_1R1V_rpc_XilObjBypassingRunnable_XilObjBypassingRunnable_m_pad_radarObjPort_par_out_local::TChangeableMemPool::_::_::_m_arrayPool::_0_::_elem::_m_objectInformation::_4_::_m_perObjectType::_m_prob1TruckN = 0;
      @sysvar::XCP::RadarFC_Obj::_g_PL_AD_fw_Radar_1R1V_rpc_XilObjBypassingRunnable_XilObjBypassingRunnable_m_pad_radarObjPort_par_out_local::TChangeableMemPool::_::_::_m_arrayPool::_0_::_elem::_m_objectInformation::_4_::_m_perObjectType::_m_prob1FourWheelUnknownN = 128;
      @sysvar::XCP::RadarFC_Obj::_g_PL_AD_fw_Radar_1R1V_rpc_XilObjBypassingRunnable_XilObjBypassingRunnable_m_pad_radarObjPort_par_out_local::TChangeableMemPool::_::_::_m_arrayPool::_0_::_elem::_m_objectInformation::_4_::_m_dWidthN = 256;
        break;

      case 2: //"RoadSideBarrier"
      @sysvar::XCP::RadarFC_Obj::_g_PL_AD_fw_Radar_1R1V_rpc_XilObjBypassingRunnable_XilObjBypassingRunnable_m_pad_radarObjPort_par_out_local::TChangeableMemPool::_::_::_m_arrayPool::_0_::_elem::_m_objectInformation::_4_::_m_perObjectType::_m_prob1ObstacleN = 128;
      @sysvar::XCP::RadarFC_Obj::_g_PL_AD_fw_Radar_1R1V_rpc_XilObjBypassingRunnable_XilObjBypassingRunnable_m_pad_radarObjPort_par_out_local::TChangeableMemPool::_::_::_m_arrayPool::_0_::_elem::_m_objectInformation::_4_::_m_perObjectType::_m_prob1NonObstacleN = 0;
      @sysvar::XCP::RadarFC_Obj::_g_PL_AD_fw_Radar_1R1V_rpc_XilObjBypassingRunnable_XilObjBypassingRunnable_m_pad_radarObjPort_par_out_local::TChangeableMemPool::_::_::_m_arrayPool::_0_::_elem::_m_objectInformation::_4_::_m_perObjectType::_m_prob1UnknownN = 0;
      @sysvar::XCP::RadarFC_Obj::_g_PL_AD_fw_Radar_1R1V_rpc_XilObjBypassingRunnable_XilObjBypassingRunnable_m_pad_radarObjPort_par_out_local::TChangeableMemPool::_::_::_m_arrayPool::_0_::_elem::_m_objectInformation::_4_::_m_perObjectType::_m_prob1MobileN = 0;
      @sysvar::XCP::RadarFC_Obj::_g_PL_AD_fw_Radar_1R1V_rpc_XilObjBypassingRunnable_XilObjBypassingRunnable_m_pad_radarObjPort_par_out_local::TChangeableMemPool::_::_::_m_arrayPool::_0_::_elem::_m_objectInformation::_4_::_m_perObjectType::_m_prob1StationaryN = 128;
      @sysvar::XCP::RadarFC_Obj::_g_PL_AD_fw_Radar_1R1V_rpc_XilObjBypassingRunnable_XilObjBypassingRunnable_m_pad_radarObjPort_par_out_local::TChangeableMemPool::_::_::_m_arrayPool::_0_::_elem::_m_objectInformation::_4_::_m_perObjectType::_m_prob1ObstUnknownN = 0;
      @sysvar::XCP::RadarFC_Obj::_g_PL_AD_fw_Radar_1R1V_rpc_XilObjBypassingRunnable_XilObjBypassingRunnable_m_pad_radarObjPort_par_out_local::TChangeableMemPool::_::_::_m_arrayPool::_0_::_elem::_m_objectInformation::_4_::_m_perObjectType::_m_prob1FourPlusWheelerN = 0;
      @sysvar::XCP::RadarFC_Obj::_g_PL_AD_fw_Radar_1R1V_rpc_XilObjBypassingRunnable_XilObjBypassingRunnable_m_pad_radarObjPort_par_out_local::TChangeableMemPool::_::_::_m_arrayPool::_0_::_elem::_m_objectInformation::_4_::_m_perObjectType::_m_prob1TwoWheelerN = 0;
      @sysvar::XCP::RadarFC_Obj::_g_PL_AD_fw_Radar_1R1V_rpc_XilObjBypassingRunnable_XilObjBypassingRunnable_m_pad_radarObjPort_par_out_local::TChangeableMemPool::_::_::_m_arrayPool::_0_::_elem::_m_objectInformation::_4_::_m_perObjectType::_m_prob1PedestrianN = 0;
      @sysvar::XCP::RadarFC_Obj::_g_PL_AD_fw_Radar_1R1V_rpc_XilObjBypassingRunnable_XilObjBypassingRunnable_m_pad_radarObjPort_par_out_local::TChangeableMemPool::_::_::_m_arrayPool::_0_::_elem::_m_objectInformation::_4_::_m_perObjectType::_m_prob1MovUnknownN = 128;
      @sysvar::XCP::RadarFC_Obj::_g_PL_AD_fw_Radar_1R1V_rpc_XilObjBypassingRunnable_XilObjBypassingRunnable_m_pad_radarObjPort_par_out_local::TChangeableMemPool::_::_::_m_arrayPool::_0_::_elem::_m_objectInformation::_4_::_m_perObjectType::_m_prob1RoadsideBarrierN = 128;
      @sysvar::XCP::RadarFC_Obj::_g_PL_AD_fw_Radar_1R1V_rpc_XilObjBypassingRunnable_XilObjBypassingRunnable_m_pad_radarObjPort_par_out_local::TChangeableMemPool::_::_::_m_arrayPool::_0_::_elem::_m_objectInformation::_4_::_m_perObjectType::_m_prob1StatUnknownN = 0;
      @sysvar::XCP::RadarFC_Obj::_g_PL_AD_fw_Radar_1R1V_rpc_XilObjBypassingRunnable_XilObjBypassingRunnable_m_pad_radarObjPort_par_out_local::TChangeableMemPool::_::_::_m_arrayPool::_0_::_elem::_m_objectInformation::_4_::_m_perObjectType::_m_prob1PassengerCarN = 0;
      @sysvar::XCP::RadarFC_Obj::_g_PL_AD_fw_Radar_1R1V_rpc_XilObjBypassingRunnable_XilObjBypassingRunnable_m_pad_radarObjPort_par_out_local::TChangeableMemPool::_::_::_m_arrayPool::_0_::_elem::_m_objectInformation::_4_::_m_perObjectType::_m_prob1TruckN = 0;
      @sysvar::XCP::RadarFC_Obj::_g_PL_AD_fw_Radar_1R1V_rpc_XilObjBypassingRunnable_XilObjBypassingRunnable_m_pad_radarObjPort_par_out_local::TChangeableMemPool::_::_::_m_arrayPool::_0_::_elem::_m_objectInformation::_4_::_m_perObjectType::_m_prob1FourWheelUnknownN = 128;
      @sysvar::XCP::RadarFC_Obj::_g_PL_AD_fw_Radar_1R1V_rpc_XilObjBypassingRunnable_XilObjBypassingRunnable_m_pad_radarObjPort_par_out_local::TChangeableMemPool::_::_::_m_arrayPool::_0_::_elem::_m_objectInformation::_4_::_m_dWidthN = 256;
        break;

      case 3: //"2Wheeler"
      @sysvar::XCP::RadarFC_Obj::_g_PL_AD_fw_Radar_1R1V_rpc_XilObjBypassingRunnable_XilObjBypassingRunnable_m_pad_radarObjPort_par_out_local::TChangeableMemPool::_::_::_m_arrayPool::_0_::_elem::_m_objectInformation::_4_::_m_perObjectType::_m_prob1ObstacleN = 128;
      @sysvar::XCP::RadarFC_Obj::_g_PL_AD_fw_Radar_1R1V_rpc_XilObjBypassingRunnable_XilObjBypassingRunnable_m_pad_radarObjPort_par_out_local::TChangeableMemPool::_::_::_m_arrayPool::_0_::_elem::_m_objectInformation::_4_::_m_perObjectType::_m_prob1NonObstacleN = 0;
      @sysvar::XCP::RadarFC_Obj::_g_PL_AD_fw_Radar_1R1V_rpc_XilObjBypassingRunnable_XilObjBypassingRunnable_m_pad_radarObjPort_par_out_local::TChangeableMemPool::_::_::_m_arrayPool::_0_::_elem::_m_objectInformation::_4_::_m_perObjectType::_m_prob1UnknownN = 0;
      @sysvar::XCP::RadarFC_Obj::_g_PL_AD_fw_Radar_1R1V_rpc_XilObjBypassingRunnable_XilObjBypassingRunnable_m_pad_radarObjPort_par_out_local::TChangeableMemPool::_::_::_m_arrayPool::_0_::_elem::_m_objectInformation::_4_::_m_perObjectType::_m_prob1MobileN = 128;
      @sysvar::XCP::RadarFC_Obj::_g_PL_AD_fw_Radar_1R1V_rpc_XilObjBypassingRunnable_XilObjBypassingRunnable_m_pad_radarObjPort_par_out_local::TChangeableMemPool::_::_::_m_arrayPool::_0_::_elem::_m_objectInformation::_4_::_m_perObjectType::_m_prob1StationaryN = 0;
      @sysvar::XCP::RadarFC_Obj::_g_PL_AD_fw_Radar_1R1V_rpc_XilObjBypassingRunnable_XilObjBypassingRunnable_m_pad_radarObjPort_par_out_local::TChangeableMemPool::_::_::_m_arrayPool::_0_::_elem::_m_objectInformation::_4_::_m_perObjectType::_m_prob1ObstUnknownN = 0;
      @sysvar::XCP::RadarFC_Obj::_g_PL_AD_fw_Radar_1R1V_rpc_XilObjBypassingRunnable_XilObjBypassingRunnable_m_pad_radarObjPort_par_out_local::TChangeableMemPool::_::_::_m_arrayPool::_0_::_elem::_m_objectInformation::_4_::_m_perObjectType::_m_prob1FourPlusWheelerN = 0;
      @sysvar::XCP::RadarFC_Obj::_g_PL_AD_fw_Radar_1R1V_rpc_XilObjBypassingRunnable_XilObjBypassingRunnable_m_pad_radarObjPort_par_out_local::TChangeableMemPool::_::_::_m_arrayPool::_0_::_elem::_m_objectInformation::_4_::_m_perObjectType::_m_prob1TwoWheelerN = 128;
      @sysvar::XCP::RadarFC_Obj::_g_PL_AD_fw_Radar_1R1V_rpc_XilObjBypassingRunnable_XilObjBypassingRunnable_m_pad_radarObjPort_par_out_local::TChangeableMemPool::_::_::_m_arrayPool::_0_::_elem::_m_objectInformation::_4_::_m_perObjectType::_m_prob1PedestrianN = 0;
      @sysvar::XCP::RadarFC_Obj::_g_PL_AD_fw_Radar_1R1V_rpc_XilObjBypassingRunnable_XilObjBypassingRunnable_m_pad_radarObjPort_par_out_local::TChangeableMemPool::_::_::_m_arrayPool::_0_::_elem::_m_objectInformation::_4_::_m_perObjectType::_m_prob1MovUnknownN = 0;
      @sysvar::XCP::RadarFC_Obj::_g_PL_AD_fw_Radar_1R1V_rpc_XilObjBypassingRunnable_XilObjBypassingRunnable_m_pad_radarObjPort_par_out_local::TChangeableMemPool::_::_::_m_arrayPool::_0_::_elem::_m_objectInformation::_4_::_m_perObjectType::_m_prob1RoadsideBarrierN = 0;
      @sysvar::XCP::RadarFC_Obj::_g_PL_AD_fw_Radar_1R1V_rpc_XilObjBypassingRunnable_XilObjBypassingRunnable_m_pad_radarObjPort_par_out_local::TChangeableMemPool::_::_::_m_arrayPool::_0_::_elem::_m_objectInformation::_4_::_m_perObjectType::_m_prob1StatUnknownN = 128;
      @sysvar::XCP::RadarFC_Obj::_g_PL_AD_fw_Radar_1R1V_rpc_XilObjBypassingRunnable_XilObjBypassingRunnable_m_pad_radarObjPort_par_out_local::TChangeableMemPool::_::_::_m_arrayPool::_0_::_elem::_m_objectInformation::_4_::_m_perObjectType::_m_prob1PassengerCarN = 0;
      @sysvar::XCP::RadarFC_Obj::_g_PL_AD_fw_Radar_1R1V_rpc_XilObjBypassingRunnable_XilObjBypassingRunnable_m_pad_radarObjPort_par_out_local::TChangeableMemPool::_::_::_m_arrayPool::_0_::_elem::_m_objectInformation::_4_::_m_perObjectType::_m_prob1TruckN = 0;
      @sysvar::XCP::RadarFC_Obj::_g_PL_AD_fw_Radar_1R1V_rpc_XilObjBypassingRunnable_XilObjBypassingRunnable_m_pad_radarObjPort_par_out_local::TChangeableMemPool::_::_::_m_arrayPool::_0_::_elem::_m_objectInformation::_4_::_m_perObjectType::_m_prob1FourWheelUnknownN = 128;
      @sysvar::XCP::RadarFC_Obj::_g_PL_AD_fw_Radar_1R1V_rpc_XilObjBypassingRunnable_XilObjBypassingRunnable_m_pad_radarObjPort_par_out_local::TChangeableMemPool::_::_::_m_arrayPool::_0_::_elem::_m_objectInformation::_4_::_m_dWidthN = 64;
        break;

      case 4: //"Pedestrian"
      @sysvar::XCP::RadarFC_Obj::_g_PL_AD_fw_Radar_1R1V_rpc_XilObjBypassingRunnable_XilObjBypassingRunnable_m_pad_radarObjPort_par_out_local::TChangeableMemPool::_::_::_m_arrayPool::_0_::_elem::_m_objectInformation::_4_::_m_perObjectType::_m_prob1ObstacleN = 128;
      @sysvar::XCP::RadarFC_Obj::_g_PL_AD_fw_Radar_1R1V_rpc_XilObjBypassingRunnable_XilObjBypassingRunnable_m_pad_radarObjPort_par_out_local::TChangeableMemPool::_::_::_m_arrayPool::_0_::_elem::_m_objectInformation::_4_::_m_perObjectType::_m_prob1NonObstacleN = 0;
      @sysvar::XCP::RadarFC_Obj::_g_PL_AD_fw_Radar_1R1V_rpc_XilObjBypassingRunnable_XilObjBypassingRunnable_m_pad_radarObjPort_par_out_local::TChangeableMemPool::_::_::_m_arrayPool::_0_::_elem::_m_objectInformation::_4_::_m_perObjectType::_m_prob1UnknownN = 0;
      @sysvar::XCP::RadarFC_Obj::_g_PL_AD_fw_Radar_1R1V_rpc_XilObjBypassingRunnable_XilObjBypassingRunnable_m_pad_radarObjPort_par_out_local::TChangeableMemPool::_::_::_m_arrayPool::_0_::_elem::_m_objectInformation::_4_::_m_perObjectType::_m_prob1MobileN = 128;
      @sysvar::XCP::RadarFC_Obj::_g_PL_AD_fw_Radar_1R1V_rpc_XilObjBypassingRunnable_XilObjBypassingRunnable_m_pad_radarObjPort_par_out_local::TChangeableMemPool::_::_::_m_arrayPool::_0_::_elem::_m_objectInformation::_4_::_m_perObjectType::_m_prob1StationaryN = 0;
      @sysvar::XCP::RadarFC_Obj::_g_PL_AD_fw_Radar_1R1V_rpc_XilObjBypassingRunnable_XilObjBypassingRunnable_m_pad_radarObjPort_par_out_local::TChangeableMemPool::_::_::_m_arrayPool::_0_::_elem::_m_objectInformation::_4_::_m_perObjectType::_m_prob1ObstUnknownN = 0;
      @sysvar::XCP::RadarFC_Obj::_g_PL_AD_fw_Radar_1R1V_rpc_XilObjBypassingRunnable_XilObjBypassingRunnable_m_pad_radarObjPort_par_out_local::TChangeableMemPool::_::_::_m_arrayPool::_0_::_elem::_m_objectInformation::_4_::_m_perObjectType::_m_prob1FourPlusWheelerN = 0;
      @sysvar::XCP::RadarFC_Obj::_g_PL_AD_fw_Radar_1R1V_rpc_XilObjBypassingRunnable_XilObjBypassingRunnable_m_pad_radarObjPort_par_out_local::TChangeableMemPool::_::_::_m_arrayPool::_0_::_elem::_m_objectInformation::_4_::_m_perObjectType::_m_prob1TwoWheelerN = 0;
      @sysvar::XCP::RadarFC_Obj::_g_PL_AD_fw_Radar_1R1V_rpc_XilObjBypassingRunnable_XilObjBypassingRunnable_m_pad_radarObjPort_par_out_local::TChangeableMemPool::_::_::_m_arrayPool::_0_::_elem::_m_objectInformation::_4_::_m_perObjectType::_m_prob1PedestrianN = 128;
      @sysvar::XCP::RadarFC_Obj::_g_PL_AD_fw_Radar_1R1V_rpc_XilObjBypassingRunnable_XilObjBypassingRunnable_m_pad_radarObjPort_par_out_local::TChangeableMemPool::_::_::_m_arrayPool::_0_::_elem::_m_objectInformation::_4_::_m_perObjectType::_m_prob1MovUnknownN = 0;
      @sysvar::XCP::RadarFC_Obj::_g_PL_AD_fw_Radar_1R1V_rpc_XilObjBypassingRunnable_XilObjBypassingRunnable_m_pad_radarObjPort_par_out_local::TChangeableMemPool::_::_::_m_arrayPool::_0_::_elem::_m_objectInformation::_4_::_m_perObjectType::_m_prob1RoadsideBarrierN = 0;
      @sysvar::XCP::RadarFC_Obj::_g_PL_AD_fw_Radar_1R1V_rpc_XilObjBypassingRunnable_XilObjBypassingRunnable_m_pad_radarObjPort_par_out_local::TChangeableMemPool::_::_::_m_arrayPool::_0_::_elem::_m_objectInformation::_4_::_m_perObjectType::_m_prob1StatUnknownN = 128;
      @sysvar::XCP::RadarFC_Obj::_g_PL_AD_fw_Radar_1R1V_rpc_XilObjBypassingRunnable_XilObjBypassingRunnable_m_pad_radarObjPort_par_out_local::TChangeableMemPool::_::_::_m_arrayPool::_0_::_elem::_m_objectInformation::_4_::_m_perObjectType::_m_prob1PassengerCarN = 0;
      @sysvar::XCP::RadarFC_Obj::_g_PL_AD_fw_Radar_1R1V_rpc_XilObjBypassingRunnable_XilObjBypassingRunnable_m_pad_radarObjPort_par_out_local::TChangeableMemPool::_::_::_m_arrayPool::_0_::_elem::_m_objectInformation::_4_::_m_perObjectType::_m_prob1TruckN = 0;
      @sysvar::XCP::RadarFC_Obj::_g_PL_AD_fw_Radar_1R1V_rpc_XilObjBypassingRunnable_XilObjBypassingRunnable_m_pad_radarObjPort_par_out_local::TChangeableMemPool::_::_::_m_arrayPool::_0_::_elem::_m_objectInformation::_4_::_m_perObjectType::_m_prob1FourWheelUnknownN = 128;
      @sysvar::XCP::RadarFC_Obj::_g_PL_AD_fw_Radar_1R1V_rpc_XilObjBypassingRunnable_XilObjBypassingRunnable_m_pad_radarObjPort_par_out_local::TChangeableMemPool::_::_::_m_arrayPool::_0_::_elem::_m_objectInformation::_4_::_m_dWidthN = 64;
        break;

      case 5: //"Truck"
      @sysvar::XCP::RadarFC_Obj::_g_PL_AD_fw_Radar_1R1V_rpc_XilObjBypassingRunnable_XilObjBypassingRunnable_m_pad_radarObjPort_par_out_local::TChangeableMemPool::_::_::_m_arrayPool::_0_::_elem::_m_objectInformation::_4_::_m_perObjectType::_m_prob1ObstacleN = 128;
      @sysvar::XCP::RadarFC_Obj::_g_PL_AD_fw_Radar_1R1V_rpc_XilObjBypassingRunnable_XilObjBypassingRunnable_m_pad_radarObjPort_par_out_local::TChangeableMemPool::_::_::_m_arrayPool::_0_::_elem::_m_objectInformation::_4_::_m_perObjectType::_m_prob1NonObstacleN = 0;
      @sysvar::XCP::RadarFC_Obj::_g_PL_AD_fw_Radar_1R1V_rpc_XilObjBypassingRunnable_XilObjBypassingRunnable_m_pad_radarObjPort_par_out_local::TChangeableMemPool::_::_::_m_arrayPool::_0_::_elem::_m_objectInformation::_4_::_m_perObjectType::_m_prob1UnknownN = 0;
      @sysvar::XCP::RadarFC_Obj::_g_PL_AD_fw_Radar_1R1V_rpc_XilObjBypassingRunnable_XilObjBypassingRunnable_m_pad_radarObjPort_par_out_local::TChangeableMemPool::_::_::_m_arrayPool::_0_::_elem::_m_objectInformation::_4_::_m_perObjectType::_m_prob1MobileN = 128;
      @sysvar::XCP::RadarFC_Obj::_g_PL_AD_fw_Radar_1R1V_rpc_XilObjBypassingRunnable_XilObjBypassingRunnable_m_pad_radarObjPort_par_out_local::TChangeableMemPool::_::_::_m_arrayPool::_0_::_elem::_m_objectInformation::_4_::_m_perObjectType::_m_prob1StationaryN = 0;
      @sysvar::XCP::RadarFC_Obj::_g_PL_AD_fw_Radar_1R1V_rpc_XilObjBypassingRunnable_XilObjBypassingRunnable_m_pad_radarObjPort_par_out_local::TChangeableMemPool::_::_::_m_arrayPool::_0_::_elem::_m_objectInformation::_4_::_m_perObjectType::_m_prob1ObstUnknownN = 0;
      @sysvar::XCP::RadarFC_Obj::_g_PL_AD_fw_Radar_1R1V_rpc_XilObjBypassingRunnable_XilObjBypassingRunnable_m_pad_radarObjPort_par_out_local::TChangeableMemPool::_::_::_m_arrayPool::_0_::_elem::_m_objectInformation::_4_::_m_perObjectType::_m_prob1FourPlusWheelerN = 128;
      @sysvar::XCP::RadarFC_Obj::_g_PL_AD_fw_Radar_1R1V_rpc_XilObjBypassingRunnable_XilObjBypassingRunnable_m_pad_radarObjPort_par_out_local::TChangeableMemPool::_::_::_m_arrayPool::_0_::_elem::_m_objectInformation::_4_::_m_perObjectType::_m_prob1TwoWheelerN = 0;
      @sysvar::XCP::RadarFC_Obj::_g_PL_AD_fw_Radar_1R1V_rpc_XilObjBypassingRunnable_XilObjBypassingRunnable_m_pad_radarObjPort_par_out_local::TChangeableMemPool::_::_::_m_arrayPool::_0_::_elem::_m_objectInformation::_4_::_m_perObjectType::_m_prob1PedestrianN = 0;
      @sysvar::XCP::RadarFC_Obj::_g_PL_AD_fw_Radar_1R1V_rpc_XilObjBypassingRunnable_XilObjBypassingRunnable_m_pad_radarObjPort_par_out_local::TChangeableMemPool::_::_::_m_arrayPool::_0_::_elem::_m_objectInformation::_4_::_m_perObjectType::_m_prob1MovUnknownN = 0;
      @sysvar::XCP::RadarFC_Obj::_g_PL_AD_fw_Radar_1R1V_rpc_XilObjBypassingRunnable_XilObjBypassingRunnable_m_pad_radarObjPort_par_out_local::TChangeableMemPool::_::_::_m_arrayPool::_0_::_elem::_m_objectInformation::_4_::_m_perObjectType::_m_prob1RoadsideBarrierN = 0;
      @sysvar::XCP::RadarFC_Obj::_g_PL_AD_fw_Radar_1R1V_rpc_XilObjBypassingRunnable_XilObjBypassingRunnable_m_pad_radarObjPort_par_out_local::TChangeableMemPool::_::_::_m_arrayPool::_0_::_elem::_m_objectInformation::_4_::_m_perObjectType::_m_prob1StatUnknownN = 128;
      @sysvar::XCP::RadarFC_Obj::_g_PL_AD_fw_Radar_1R1V_rpc_XilObjBypassingRunnable_XilObjBypassingRunnable_m_pad_radarObjPort_par_out_local::TChangeableMemPool::_::_::_m_arrayPool::_0_::_elem::_m_objectInformation::_4_::_m_perObjectType::_m_prob1PassengerCarN = 0;
      @sysvar::XCP::RadarFC_Obj::_g_PL_AD_fw_Radar_1R1V_rpc_XilObjBypassingRunnable_XilObjBypassingRunnable_m_pad_radarObjPort_par_out_local::TChangeableMemPool::_::_::_m_arrayPool::_0_::_elem::_m_objectInformation::_4_::_m_perObjectType::_m_prob1TruckN = 128;
      @sysvar::XCP::RadarFC_Obj::_g_PL_AD_fw_Radar_1R1V_rpc_XilObjBypassingRunnable_XilObjBypassingRunnable_m_pad_radarObjPort_par_out_local::TChangeableMemPool::_::_::_m_arrayPool::_0_::_elem::_m_objectInformation::_4_::_m_perObjectType::_m_prob1FourWheelUnknownN = 0;
      @sysvar::XCP::RadarFC_Obj::_g_PL_AD_fw_Radar_1R1V_rpc_XilObjBypassingRunnable_XilObjBypassingRunnable_m_pad_radarObjPort_par_out_local::TChangeableMemPool::_::_::_m_arrayPool::_0_::_elem::_m_objectInformation::_4_::_m_dWidthN = 256;
        break;

      case 6: //"PassengerCar"
      @sysvar::XCP::RadarFC_Obj::_g_PL_AD_fw_Radar_1R1V_rpc_XilObjBypassingRunnable_XilObjBypassingRunnable_m_pad_radarObjPort_par_out_local::TChangeableMemPool::_::_::_m_arrayPool::_0_::_elem::_m_objectInformation::_4_::_m_perObjectType::_m_prob1ObstacleN = 128;
      @sysvar::XCP::RadarFC_Obj::_g_PL_AD_fw_Radar_1R1V_rpc_XilObjBypassingRunnable_XilObjBypassingRunnable_m_pad_radarObjPort_par_out_local::TChangeableMemPool::_::_::_m_arrayPool::_0_::_elem::_m_objectInformation::_4_::_m_perObjectType::_m_prob1NonObstacleN = 0;
      @sysvar::XCP::RadarFC_Obj::_g_PL_AD_fw_Radar_1R1V_rpc_XilObjBypassingRunnable_XilObjBypassingRunnable_m_pad_radarObjPort_par_out_local::TChangeableMemPool::_::_::_m_arrayPool::_0_::_elem::_m_objectInformation::_4_::_m_perObjectType::_m_prob1UnknownN = 0;
      @sysvar::XCP::RadarFC_Obj::_g_PL_AD_fw_Radar_1R1V_rpc_XilObjBypassingRunnable_XilObjBypassingRunnable_m_pad_radarObjPort_par_out_local::TChangeableMemPool::_::_::_m_arrayPool::_0_::_elem::_m_objectInformation::_4_::_m_perObjectType::_m_prob1MobileN = 128;
      @sysvar::XCP::RadarFC_Obj::_g_PL_AD_fw_Radar_1R1V_rpc_XilObjBypassingRunnable_XilObjBypassingRunnable_m_pad_radarObjPort_par_out_local::TChangeableMemPool::_::_::_m_arrayPool::_0_::_elem::_m_objectInformation::_4_::_m_perObjectType::_m_prob1StationaryN = 0;
      @sysvar::XCP::RadarFC_Obj::_g_PL_AD_fw_Radar_1R1V_rpc_XilObjBypassingRunnable_XilObjBypassingRunnable_m_pad_radarObjPort_par_out_local::TChangeableMemPool::_::_::_m_arrayPool::_0_::_elem::_m_objectInformation::_4_::_m_perObjectType::_m_prob1ObstUnknownN = 0;
      @sysvar::XCP::RadarFC_Obj::_g_PL_AD_fw_Radar_1R1V_rpc_XilObjBypassingRunnable_XilObjBypassingRunnable_m_pad_radarObjPort_par_out_local::TChangeableMemPool::_::_::_m_arrayPool::_0_::_elem::_m_objectInformation::_4_::_m_perObjectType::_m_prob1FourPlusWheelerN = 128;
      @sysvar::XCP::RadarFC_Obj::_g_PL_AD_fw_Radar_1R1V_rpc_XilObjBypassingRunnable_XilObjBypassingRunnable_m_pad_radarObjPort_par_out_local::TChangeableMemPool::_::_::_m_arrayPool::_0_::_elem::_m_objectInformation::_4_::_m_perObjectType::_m_prob1TwoWheelerN = 0;
      @sysvar::XCP::RadarFC_Obj::_g_PL_AD_fw_Radar_1R1V_rpc_XilObjBypassingRunnable_XilObjBypassingRunnable_m_pad_radarObjPort_par_out_local::TChangeableMemPool::_::_::_m_arrayPool::_0_::_elem::_m_objectInformation::_4_::_m_perObjectType::_m_prob1PedestrianN = 0;
      @sysvar::XCP::RadarFC_Obj::_g_PL_AD_fw_Radar_1R1V_rpc_XilObjBypassingRunnable_XilObjBypassingRunnable_m_pad_radarObjPort_par_out_local::TChangeableMemPool::_::_::_m_arrayPool::_0_::_elem::_m_objectInformation::_4_::_m_perObjectType::_m_prob1MovUnknownN = 0;
      @sysvar::XCP::RadarFC_Obj::_g_PL_AD_fw_Radar_1R1V_rpc_XilObjBypassingRunnable_XilObjBypassingRunnable_m_pad_radarObjPort_par_out_local::TChangeableMemPool::_::_::_m_arrayPool::_0_::_elem::_m_objectInformation::_4_::_m_perObjectType::_m_prob1RoadsideBarrierN = 0;
      @sysvar::XCP::RadarFC_Obj::_g_PL_AD_fw_Radar_1R1V_rpc_XilObjBypassingRunnable_XilObjBypassingRunnable_m_pad_radarObjPort_par_out_local::TChangeableMemPool::_::_::_m_arrayPool::_0_::_elem::_m_objectInformation::_4_::_m_perObjectType::_m_prob1StatUnknownN = 128;
      @sysvar::XCP::RadarFC_Obj::_g_PL_AD_fw_Radar_1R1V_rpc_XilObjBypassingRunnable_XilObjBypassingRunnable_m_pad_radarObjPort_par_out_local::TChangeableMemPool::_::_::_m_arrayPool::_0_::_elem::_m_objectInformation::_4_::_m_perObjectType::_m_prob1PassengerCarN = 128;
      @sysvar::XCP::RadarFC_Obj::_g_PL_AD_fw_Radar_1R1V_rpc_XilObjBypassingRunnable_XilObjBypassingRunnable_m_pad_radarObjPort_par_out_local::TChangeableMemPool::_::_::_m_arrayPool::_0_::_elem::_m_objectInformation::_4_::_m_perObjectType::_m_prob1TruckN = 0;
      @sysvar::XCP::RadarFC_Obj::_g_PL_AD_fw_Radar_1R1V_rpc_XilObjBypassingRunnable_XilObjBypassingRunnable_m_pad_radarObjPort_par_out_local::TChangeableMemPool::_::_::_m_arrayPool::_0_::_elem::_m_objectInformation::_4_::_m_perObjectType::_m_prob1FourWheelUnknownN = 0;
      @sysvar::XCP::RadarFC_Obj::_g_PL_AD_fw_Radar_1R1V_rpc_XilObjBypassingRunnable_XilObjBypassingRunnable_m_pad_radarObjPort_par_out_local::TChangeableMemPool::_::_::_m_arrayPool::_0_::_elem::_m_objectInformation::_4_::_m_dWidthN = 256;
        break;
    }
    break;

    case 5: //"Object-5"
    //constant
  @sysvar::XCP::RadarFC_Obj::_g_PL_AD_fw_Radar_1R1V_rpc_XilObjBypassingRunnable_XilObjBypassingRunnable_m_pad_radarObjPort_par_out_local::TChangeableMemPool::_::_::_m_arrayPool::_0_::_elem::_m_objectInformation::_5_::_Valid_b = 1;
  @sysvar::XCP::RadarFC_Obj::_g_PL_AD_fw_Radar_1R1V_rpc_XilObjBypassingRunnable_XilObjBypassingRunnable_m_pad_radarObjPort_par_out_local::TChangeableMemPool::_::_::_m_arrayPool::_0_::_elem::_m_objectInformation::_5_::_m_HandleN = 1;
  @sysvar::XCP::RadarFC_Obj::_g_PL_AD_fw_Radar_1R1V_rpc_XilObjBypassingRunnable_XilObjBypassingRunnable_m_pad_radarObjPort_par_out_local::TChangeableMemPool::_::_::_m_arrayPool::_0_::_elem::_m_objectInformation::_5_::_m_alpPiVarYawAngleN = 0;
  @sysvar::XCP::RadarFC_Obj::_g_PL_AD_fw_Radar_1R1V_rpc_XilObjBypassingRunnable_XilObjBypassingRunnable_m_pad_radarObjPort_par_out_local::TChangeableMemPool::_::_::_m_arrayPool::_0_::_elem::_m_objectInformation::_5_::_m_alpPiYawAngleN = 0;
  @sysvar::XCP::RadarFC_Obj::_g_PL_AD_fw_Radar_1R1V_rpc_XilObjBypassingRunnable_XilObjBypassingRunnable_m_pad_radarObjPort_par_out_local::TChangeableMemPool::_::_::_m_arrayPool::_0_::_elem::_m_objectInformation::_5_::_m_varAxN = 0;
  @sysvar::XCP::RadarFC_Obj::_g_PL_AD_fw_Radar_1R1V_rpc_XilObjBypassingRunnable_XilObjBypassingRunnable_m_pad_radarObjPort_par_out_local::TChangeableMemPool::_::_::_m_arrayPool::_0_::_elem::_m_objectInformation::_5_::_m_varAyN = 0;
  @sysvar::XCP::RadarFC_Obj::_g_PL_AD_fw_Radar_1R1V_rpc_XilObjBypassingRunnable_XilObjBypassingRunnable_m_pad_radarObjPort_par_out_local::TChangeableMemPool::_::_::_m_arrayPool::_0_::_elem::_m_objectInformation::_5_::_m_varVxN = 0;
  @sysvar::XCP::RadarFC_Obj::_g_PL_AD_fw_Radar_1R1V_rpc_XilObjBypassingRunnable_XilObjBypassingRunnable_m_pad_radarObjPort_par_out_local::TChangeableMemPool::_::_::_m_arrayPool::_0_::_elem::_m_objectInformation::_5_::_m_varVyN = 0;
  @sysvar::XCP::RadarFC_Obj::_g_PL_AD_fw_Radar_1R1V_rpc_XilObjBypassingRunnable_XilObjBypassingRunnable_m_pad_radarObjPort_par_out_local::TChangeableMemPool::_::_::_m_arrayPool::_0_::_elem::_m_objectInformation::_5_::_m_varDxN = 0;
  @sysvar::XCP::RadarFC_Obj::_g_PL_AD_fw_Radar_1R1V_rpc_XilObjBypassingRunnable_XilObjBypassingRunnable_m_pad_radarObjPort_par_out_local::TChangeableMemPool::_::_::_m_arrayPool::_0_::_elem::_m_objectInformation::_5_::_m_varDyN = 0;
  @sysvar::XCP::RadarFC_Obj::_g_PL_AD_fw_Radar_1R1V_rpc_XilObjBypassingRunnable_XilObjBypassingRunnable_m_pad_radarObjPort_par_out_local::TChangeableMemPool::_::_::_m_arrayPool::_0_::_elem::_m_objectInformation::_5_::_m_dVarLengthN = 0;
  @sysvar::XCP::RadarFC_Obj::_g_PL_AD_fw_Radar_1R1V_rpc_XilObjBypassingRunnable_XilObjBypassingRunnable_m_pad_radarObjPort_par_out_local::TChangeableMemPool::_::_::_m_arrayPool::_0_::_elem::_m_objectInformation::_5_::_m_dVarWidthN = 0;
  @sysvar::XCP::RadarFC_Obj::_g_PL_AD_fw_Radar_1R1V_rpc_XilObjBypassingRunnable_XilObjBypassingRunnable_m_pad_radarObjPort_par_out_local::TChangeableMemPool::_::_::_m_arrayPool::_0_::_elem::_m_objectInformation::_5_::_m_wExistProbN = 64880;
  @sysvar::XCP::RadarFC_Obj::_g_PL_AD_fw_Radar_1R1V_rpc_XilObjBypassingRunnable_XilObjBypassingRunnable_m_pad_radarObjPort_par_out_local::TChangeableMemPool::_::_::_m_arrayPool::_0_::_elem::_m_objectInformation::_5_::_m_isObjectAsil = 1;
  @sysvar::XCP::RadarFC_Obj::_g_PL_AD_fw_Radar_1R1V_rpc_XilObjBypassingRunnable_XilObjBypassingRunnable_m_pad_radarObjPort_par_out_local::TChangeableMemPool::_::_::_m_arrayPool::_0_::_elem::_m_objectInformation::_5_::_m_dLengthN = 128;

    //target movement

  @sysvar::XCP::RadarFC_Obj::_g_PL_AD_fw_Radar_1R1V_rpc_XilObjBypassingRunnable_XilObjBypassingRunnable_m_pad_radarObjPort_par_out_local::TChangeableMemPool::_::_::_m_arrayPool::_0_::_elem::_m_objectInformation::_5_::_m_dxN = @target_radar_fc_sim::objdata.obj_distance_x[5] * 128;
  @sysvar::XCP::RadarFC_Obj::_g_PL_AD_fw_Radar_1R1V_rpc_XilObjBypassingRunnable_XilObjBypassingRunnable_m_pad_radarObjPort_par_out_local::TChangeableMemPool::_::_::_m_arrayPool::_0_::_elem::_m_objectInformation::_5_::_m_dyN = @target_radar_fc_sim::objdata.obj_distance_y[5] * 128;
  @sysvar::XCP::RadarFC_Obj::_g_PL_AD_fw_Radar_1R1V_rpc_XilObjBypassingRunnable_XilObjBypassingRunnable_m_pad_radarObjPort_par_out_local::TChangeableMemPool::_::_::_m_arrayPool::_0_::_elem::_m_objectInformation::_5_::_m_dzN = 0;
  @sysvar::XCP::RadarFC_Obj::_g_PL_AD_fw_Radar_1R1V_rpc_XilObjBypassingRunnable_XilObjBypassingRunnable_m_pad_radarObjPort_par_out_local::TChangeableMemPool::_::_::_m_arrayPool::_0_::_elem::_m_objectInformation::_5_::_m_vxN = @target_radar_fc_sim::objdata.obj_velocity_x[5] * 256;
  @sysvar::XCP::RadarFC_Obj::_g_PL_AD_fw_Radar_1R1V_rpc_XilObjBypassingRunnable_XilObjBypassingRunnable_m_pad_radarObjPort_par_out_local::TChangeableMemPool::_::_::_m_arrayPool::_0_::_elem::_m_objectInformation::_5_::_m_vyN = @target_radar_fc_sim::objdata.obj_velocity_y[5] * 256;
  @sysvar::XCP::RadarFC_Obj::_g_PL_AD_fw_Radar_1R1V_rpc_XilObjBypassingRunnable_XilObjBypassingRunnable_m_pad_radarObjPort_par_out_local::TChangeableMemPool::_::_::_m_arrayPool::_0_::_elem::_m_objectInformation::_5_::_m_axN = 0;
  @sysvar::XCP::RadarFC_Obj::_g_PL_AD_fw_Radar_1R1V_rpc_XilObjBypassingRunnable_XilObjBypassingRunnable_m_pad_radarObjPort_par_out_local::TChangeableMemPool::_::_::_m_arrayPool::_0_::_elem::_m_objectInformation::_5_::_m_ayN = 0;

    //target object moving or not
    if (abs(@target_radar_fc_sim::objdata.obj_velocity_x[5]) != 0)
    {
    @sysvar::XCP::RadarFC_Obj::_g_PL_AD_fw_Radar_1R1V_rpc_XilObjBypassingRunnable_XilObjBypassingRunnable_m_pad_radarObjPort_par_out_local::TChangeableMemPool::_::_::_m_arrayPool::_0_::_elem::_m_objectInformation::_5_::_m_prob1HasBeenObservedMovingN = 126;
    @sysvar::XCP::RadarFC_Obj::_g_PL_AD_fw_Radar_1R1V_rpc_XilObjBypassingRunnable_XilObjBypassingRunnable_m_pad_radarObjPort_par_out_local::TChangeableMemPool::_::_::_m_arrayPool::_0_::_elem::_m_objectInformation::_5_::_m_prob1MovingN = 126;
    }
    else
    {
    @sysvar::XCP::RadarFC_Obj::_g_PL_AD_fw_Radar_1R1V_rpc_XilObjBypassingRunnable_XilObjBypassingRunnable_m_pad_radarObjPort_par_out_local::TChangeableMemPool::_::_::_m_arrayPool::_0_::_elem::_m_objectInformation::_5_::_m_prob1HasBeenObservedMovingN = 0;
    @sysvar::XCP::RadarFC_Obj::_g_PL_AD_fw_Radar_1R1V_rpc_XilObjBypassingRunnable_XilObjBypassingRunnable_m_pad_radarObjPort_par_out_local::TChangeableMemPool::_::_::_m_arrayPool::_0_::_elem::_m_objectInformation::_5_::_m_prob1MovingN = 0;
    }

      //object classification
    switch (@target_radar_fc_sim::objdata.obj_type[5])
    {
      case 0: //"Non-Obstacle"
      @sysvar::XCP::RadarFC_Obj::_g_PL_AD_fw_Radar_1R1V_rpc_XilObjBypassingRunnable_XilObjBypassingRunnable_m_pad_radarObjPort_par_out_local::TChangeableMemPool::_::_::_m_arrayPool::_0_::_elem::_m_objectInformation::_5_::_m_perObjectType::_m_prob1ObstacleN = 0;
      @sysvar::XCP::RadarFC_Obj::_g_PL_AD_fw_Radar_1R1V_rpc_XilObjBypassingRunnable_XilObjBypassingRunnable_m_pad_radarObjPort_par_out_local::TChangeableMemPool::_::_::_m_arrayPool::_0_::_elem::_m_objectInformation::_5_::_m_perObjectType::_m_prob1NonObstacleN = 128;
      @sysvar::XCP::RadarFC_Obj::_g_PL_AD_fw_Radar_1R1V_rpc_XilObjBypassingRunnable_XilObjBypassingRunnable_m_pad_radarObjPort_par_out_local::TChangeableMemPool::_::_::_m_arrayPool::_0_::_elem::_m_objectInformation::_5_::_m_perObjectType::_m_prob1UnknownN = 0;
      @sysvar::XCP::RadarFC_Obj::_g_PL_AD_fw_Radar_1R1V_rpc_XilObjBypassingRunnable_XilObjBypassingRunnable_m_pad_radarObjPort_par_out_local::TChangeableMemPool::_::_::_m_arrayPool::_0_::_elem::_m_objectInformation::_5_::_m_perObjectType::_m_prob1MobileN = 0;
      @sysvar::XCP::RadarFC_Obj::_g_PL_AD_fw_Radar_1R1V_rpc_XilObjBypassingRunnable_XilObjBypassingRunnable_m_pad_radarObjPort_par_out_local::TChangeableMemPool::_::_::_m_arrayPool::_0_::_elem::_m_objectInformation::_5_::_m_perObjectType::_m_prob1StationaryN = 0;
      @sysvar::XCP::RadarFC_Obj::_g_PL_AD_fw_Radar_1R1V_rpc_XilObjBypassingRunnable_XilObjBypassingRunnable_m_pad_radarObjPort_par_out_local::TChangeableMemPool::_::_::_m_arrayPool::_0_::_elem::_m_objectInformation::_5_::_m_perObjectType::_m_prob1ObstUnknownN = 128;
      @sysvar::XCP::RadarFC_Obj::_g_PL_AD_fw_Radar_1R1V_rpc_XilObjBypassingRunnable_XilObjBypassingRunnable_m_pad_radarObjPort_par_out_local::TChangeableMemPool::_::_::_m_arrayPool::_0_::_elem::_m_objectInformation::_5_::_m_perObjectType::_m_prob1FourPlusWheelerN = 0;
      @sysvar::XCP::RadarFC_Obj::_g_PL_AD_fw_Radar_1R1V_rpc_XilObjBypassingRunnable_XilObjBypassingRunnable_m_pad_radarObjPort_par_out_local::TChangeableMemPool::_::_::_m_arrayPool::_0_::_elem::_m_objectInformation::_5_::_m_perObjectType::_m_prob1TwoWheelerN = 0;
      @sysvar::XCP::RadarFC_Obj::_g_PL_AD_fw_Radar_1R1V_rpc_XilObjBypassingRunnable_XilObjBypassingRunnable_m_pad_radarObjPort_par_out_local::TChangeableMemPool::_::_::_m_arrayPool::_0_::_elem::_m_objectInformation::_5_::_m_perObjectType::_m_prob1PedestrianN = 0;
      @sysvar::XCP::RadarFC_Obj::_g_PL_AD_fw_Radar_1R1V_rpc_XilObjBypassingRunnable_XilObjBypassingRunnable_m_pad_radarObjPort_par_out_local::TChangeableMemPool::_::_::_m_arrayPool::_0_::_elem::_m_objectInformation::_5_::_m_perObjectType::_m_prob1MovUnknownN = 128;
      @sysvar::XCP::RadarFC_Obj::_g_PL_AD_fw_Radar_1R1V_rpc_XilObjBypassingRunnable_XilObjBypassingRunnable_m_pad_radarObjPort_par_out_local::TChangeableMemPool::_::_::_m_arrayPool::_0_::_elem::_m_objectInformation::_5_::_m_perObjectType::_m_prob1RoadsideBarrierN = 0;
      @sysvar::XCP::RadarFC_Obj::_g_PL_AD_fw_Radar_1R1V_rpc_XilObjBypassingRunnable_XilObjBypassingRunnable_m_pad_radarObjPort_par_out_local::TChangeableMemPool::_::_::_m_arrayPool::_0_::_elem::_m_objectInformation::_5_::_m_perObjectType::_m_prob1StatUnknownN = 128;
      @sysvar::XCP::RadarFC_Obj::_g_PL_AD_fw_Radar_1R1V_rpc_XilObjBypassingRunnable_XilObjBypassingRunnable_m_pad_radarObjPort_par_out_local::TChangeableMemPool::_::_::_m_arrayPool::_0_::_elem::_m_objectInformation::_5_::_m_perObjectType::_m_prob1PassengerCarN = 0;
      @sysvar::XCP::RadarFC_Obj::_g_PL_AD_fw_Radar_1R1V_rpc_XilObjBypassingRunnable_XilObjBypassingRunnable_m_pad_radarObjPort_par_out_local::TChangeableMemPool::_::_::_m_arrayPool::_0_::_elem::_m_objectInformation::_5_::_m_perObjectType::_m_prob1TruckN = 0;
      @sysvar::XCP::RadarFC_Obj::_g_PL_AD_fw_Radar_1R1V_rpc_XilObjBypassingRunnable_XilObjBypassingRunnable_m_pad_radarObjPort_par_out_local::TChangeableMemPool::_::_::_m_arrayPool::_0_::_elem::_m_objectInformation::_5_::_m_perObjectType::_m_prob1FourWheelUnknownN = 128;
      @sysvar::XCP::RadarFC_Obj::_g_PL_AD_fw_Radar_1R1V_rpc_XilObjBypassingRunnable_XilObjBypassingRunnable_m_pad_radarObjPort_par_out_local::TChangeableMemPool::_::_::_m_arrayPool::_0_::_elem::_m_objectInformation::_5_::_m_dWidthN = 256;
        break;

      case 1: //"unknown"
      @sysvar::XCP::RadarFC_Obj::_g_PL_AD_fw_Radar_1R1V_rpc_XilObjBypassingRunnable_XilObjBypassingRunnable_m_pad_radarObjPort_par_out_local::TChangeableMemPool::_::_::_m_arrayPool::_0_::_elem::_m_objectInformation::_5_::_m_perObjectType::_m_prob1ObstacleN = 0;
      @sysvar::XCP::RadarFC_Obj::_g_PL_AD_fw_Radar_1R1V_rpc_XilObjBypassingRunnable_XilObjBypassingRunnable_m_pad_radarObjPort_par_out_local::TChangeableMemPool::_::_::_m_arrayPool::_0_::_elem::_m_objectInformation::_5_::_m_perObjectType::_m_prob1NonObstacleN = 0;
      @sysvar::XCP::RadarFC_Obj::_g_PL_AD_fw_Radar_1R1V_rpc_XilObjBypassingRunnable_XilObjBypassingRunnable_m_pad_radarObjPort_par_out_local::TChangeableMemPool::_::_::_m_arrayPool::_0_::_elem::_m_objectInformation::_5_::_m_perObjectType::_m_prob1UnknownN = 128;
      @sysvar::XCP::RadarFC_Obj::_g_PL_AD_fw_Radar_1R1V_rpc_XilObjBypassingRunnable_XilObjBypassingRunnable_m_pad_radarObjPort_par_out_local::TChangeableMemPool::_::_::_m_arrayPool::_0_::_elem::_m_objectInformation::_5_::_m_perObjectType::_m_prob1MobileN = 0;
      @sysvar::XCP::RadarFC_Obj::_g_PL_AD_fw_Radar_1R1V_rpc_XilObjBypassingRunnable_XilObjBypassingRunnable_m_pad_radarObjPort_par_out_local::TChangeableMemPool::_::_::_m_arrayPool::_0_::_elem::_m_objectInformation::_5_::_m_perObjectType::_m_prob1StationaryN = 0;
      @sysvar::XCP::RadarFC_Obj::_g_PL_AD_fw_Radar_1R1V_rpc_XilObjBypassingRunnable_XilObjBypassingRunnable_m_pad_radarObjPort_par_out_local::TChangeableMemPool::_::_::_m_arrayPool::_0_::_elem::_m_objectInformation::_5_::_m_perObjectType::_m_prob1ObstUnknownN = 128;
      @sysvar::XCP::RadarFC_Obj::_g_PL_AD_fw_Radar_1R1V_rpc_XilObjBypassingRunnable_XilObjBypassingRunnable_m_pad_radarObjPort_par_out_local::TChangeableMemPool::_::_::_m_arrayPool::_0_::_elem::_m_objectInformation::_5_::_m_perObjectType::_m_prob1FourPlusWheelerN = 0;
      @sysvar::XCP::RadarFC_Obj::_g_PL_AD_fw_Radar_1R1V_rpc_XilObjBypassingRunnable_XilObjBypassingRunnable_m_pad_radarObjPort_par_out_local::TChangeableMemPool::_::_::_m_arrayPool::_0_::_elem::_m_objectInformation::_5_::_m_perObjectType::_m_prob1TwoWheelerN = 0;
      @sysvar::XCP::RadarFC_Obj::_g_PL_AD_fw_Radar_1R1V_rpc_XilObjBypassingRunnable_XilObjBypassingRunnable_m_pad_radarObjPort_par_out_local::TChangeableMemPool::_::_::_m_arrayPool::_0_::_elem::_m_objectInformation::_5_::_m_perObjectType::_m_prob1PedestrianN = 0;
      @sysvar::XCP::RadarFC_Obj::_g_PL_AD_fw_Radar_1R1V_rpc_XilObjBypassingRunnable_XilObjBypassingRunnable_m_pad_radarObjPort_par_out_local::TChangeableMemPool::_::_::_m_arrayPool::_0_::_elem::_m_objectInformation::_5_::_m_perObjectType::_m_prob1MovUnknownN = 128;
      @sysvar::XCP::RadarFC_Obj::_g_PL_AD_fw_Radar_1R1V_rpc_XilObjBypassingRunnable_XilObjBypassingRunnable_m_pad_radarObjPort_par_out_local::TChangeableMemPool::_::_::_m_arrayPool::_0_::_elem::_m_objectInformation::_5_::_m_perObjectType::_m_prob1RoadsideBarrierN = 0;
      @sysvar::XCP::RadarFC_Obj::_g_PL_AD_fw_Radar_1R1V_rpc_XilObjBypassingRunnable_XilObjBypassingRunnable_m_pad_radarObjPort_par_out_local::TChangeableMemPool::_::_::_m_arrayPool::_0_::_elem::_m_objectInformation::_5_::_m_perObjectType::_m_prob1StatUnknownN = 128;
      @sysvar::XCP::RadarFC_Obj::_g_PL_AD_fw_Radar_1R1V_rpc_XilObjBypassingRunnable_XilObjBypassingRunnable_m_pad_radarObjPort_par_out_local::TChangeableMemPool::_::_::_m_arrayPool::_0_::_elem::_m_objectInformation::_5_::_m_perObjectType::_m_prob1PassengerCarN = 0;
      @sysvar::XCP::RadarFC_Obj::_g_PL_AD_fw_Radar_1R1V_rpc_XilObjBypassingRunnable_XilObjBypassingRunnable_m_pad_radarObjPort_par_out_local::TChangeableMemPool::_::_::_m_arrayPool::_0_::_elem::_m_objectInformation::_5_::_m_perObjectType::_m_prob1TruckN = 0;
      @sysvar::XCP::RadarFC_Obj::_g_PL_AD_fw_Radar_1R1V_rpc_XilObjBypassingRunnable_XilObjBypassingRunnable_m_pad_radarObjPort_par_out_local::TChangeableMemPool::_::_::_m_arrayPool::_0_::_elem::_m_objectInformation::_5_::_m_perObjectType::_m_prob1FourWheelUnknownN = 128;
      @sysvar::XCP::RadarFC_Obj::_g_PL_AD_fw_Radar_1R1V_rpc_XilObjBypassingRunnable_XilObjBypassingRunnable_m_pad_radarObjPort_par_out_local::TChangeableMemPool::_::_::_m_arrayPool::_0_::_elem::_m_objectInformation::_5_::_m_dWidthN = 256;
        break;

      case 2: //"RoadSideBarrier"
      @sysvar::XCP::RadarFC_Obj::_g_PL_AD_fw_Radar_1R1V_rpc_XilObjBypassingRunnable_XilObjBypassingRunnable_m_pad_radarObjPort_par_out_local::TChangeableMemPool::_::_::_m_arrayPool::_0_::_elem::_m_objectInformation::_5_::_m_perObjectType::_m_prob1ObstacleN = 128;
      @sysvar::XCP::RadarFC_Obj::_g_PL_AD_fw_Radar_1R1V_rpc_XilObjBypassingRunnable_XilObjBypassingRunnable_m_pad_radarObjPort_par_out_local::TChangeableMemPool::_::_::_m_arrayPool::_0_::_elem::_m_objectInformation::_5_::_m_perObjectType::_m_prob1NonObstacleN = 0;
      @sysvar::XCP::RadarFC_Obj::_g_PL_AD_fw_Radar_1R1V_rpc_XilObjBypassingRunnable_XilObjBypassingRunnable_m_pad_radarObjPort_par_out_local::TChangeableMemPool::_::_::_m_arrayPool::_0_::_elem::_m_objectInformation::_5_::_m_perObjectType::_m_prob1UnknownN = 0;
      @sysvar::XCP::RadarFC_Obj::_g_PL_AD_fw_Radar_1R1V_rpc_XilObjBypassingRunnable_XilObjBypassingRunnable_m_pad_radarObjPort_par_out_local::TChangeableMemPool::_::_::_m_arrayPool::_0_::_elem::_m_objectInformation::_5_::_m_perObjectType::_m_prob1MobileN = 0;
      @sysvar::XCP::RadarFC_Obj::_g_PL_AD_fw_Radar_1R1V_rpc_XilObjBypassingRunnable_XilObjBypassingRunnable_m_pad_radarObjPort_par_out_local::TChangeableMemPool::_::_::_m_arrayPool::_0_::_elem::_m_objectInformation::_5_::_m_perObjectType::_m_prob1StationaryN = 128;
      @sysvar::XCP::RadarFC_Obj::_g_PL_AD_fw_Radar_1R1V_rpc_XilObjBypassingRunnable_XilObjBypassingRunnable_m_pad_radarObjPort_par_out_local::TChangeableMemPool::_::_::_m_arrayPool::_0_::_elem::_m_objectInformation::_5_::_m_perObjectType::_m_prob1ObstUnknownN = 0;
      @sysvar::XCP::RadarFC_Obj::_g_PL_AD_fw_Radar_1R1V_rpc_XilObjBypassingRunnable_XilObjBypassingRunnable_m_pad_radarObjPort_par_out_local::TChangeableMemPool::_::_::_m_arrayPool::_0_::_elem::_m_objectInformation::_5_::_m_perObjectType::_m_prob1FourPlusWheelerN = 0;
      @sysvar::XCP::RadarFC_Obj::_g_PL_AD_fw_Radar_1R1V_rpc_XilObjBypassingRunnable_XilObjBypassingRunnable_m_pad_radarObjPort_par_out_local::TChangeableMemPool::_::_::_m_arrayPool::_0_::_elem::_m_objectInformation::_5_::_m_perObjectType::_m_prob1TwoWheelerN = 0;
      @sysvar::XCP::RadarFC_Obj::_g_PL_AD_fw_Radar_1R1V_rpc_XilObjBypassingRunnable_XilObjBypassingRunnable_m_pad_radarObjPort_par_out_local::TChangeableMemPool::_::_::_m_arrayPool::_0_::_elem::_m_objectInformation::_5_::_m_perObjectType::_m_prob1PedestrianN = 0;
      @sysvar::XCP::RadarFC_Obj::_g_PL_AD_fw_Radar_1R1V_rpc_XilObjBypassingRunnable_XilObjBypassingRunnable_m_pad_radarObjPort_par_out_local::TChangeableMemPool::_::_::_m_arrayPool::_0_::_elem::_m_objectInformation::_5_::_m_perObjectType::_m_prob1MovUnknownN = 128;
      @sysvar::XCP::RadarFC_Obj::_g_PL_AD_fw_Radar_1R1V_rpc_XilObjBypassingRunnable_XilObjBypassingRunnable_m_pad_radarObjPort_par_out_local::TChangeableMemPool::_::_::_m_arrayPool::_0_::_elem::_m_objectInformation::_5_::_m_perObjectType::_m_prob1RoadsideBarrierN = 128;
      @sysvar::XCP::RadarFC_Obj::_g_PL_AD_fw_Radar_1R1V_rpc_XilObjBypassingRunnable_XilObjBypassingRunnable_m_pad_radarObjPort_par_out_local::TChangeableMemPool::_::_::_m_arrayPool::_0_::_elem::_m_objectInformation::_5_::_m_perObjectType::_m_prob1StatUnknownN = 0;
      @sysvar::XCP::RadarFC_Obj::_g_PL_AD_fw_Radar_1R1V_rpc_XilObjBypassingRunnable_XilObjBypassingRunnable_m_pad_radarObjPort_par_out_local::TChangeableMemPool::_::_::_m_arrayPool::_0_::_elem::_m_objectInformation::_5_::_m_perObjectType::_m_prob1PassengerCarN = 0;
      @sysvar::XCP::RadarFC_Obj::_g_PL_AD_fw_Radar_1R1V_rpc_XilObjBypassingRunnable_XilObjBypassingRunnable_m_pad_radarObjPort_par_out_local::TChangeableMemPool::_::_::_m_arrayPool::_0_::_elem::_m_objectInformation::_5_::_m_perObjectType::_m_prob1TruckN = 0;
      @sysvar::XCP::RadarFC_Obj::_g_PL_AD_fw_Radar_1R1V_rpc_XilObjBypassingRunnable_XilObjBypassingRunnable_m_pad_radarObjPort_par_out_local::TChangeableMemPool::_::_::_m_arrayPool::_0_::_elem::_m_objectInformation::_5_::_m_perObjectType::_m_prob1FourWheelUnknownN = 128;
      @sysvar::XCP::RadarFC_Obj::_g_PL_AD_fw_Radar_1R1V_rpc_XilObjBypassingRunnable_XilObjBypassingRunnable_m_pad_radarObjPort_par_out_local::TChangeableMemPool::_::_::_m_arrayPool::_0_::_elem::_m_objectInformation::_5_::_m_dWidthN = 256;
        break;

      case 3: //"2Wheeler"
      @sysvar::XCP::RadarFC_Obj::_g_PL_AD_fw_Radar_1R1V_rpc_XilObjBypassingRunnable_XilObjBypassingRunnable_m_pad_radarObjPort_par_out_local::TChangeableMemPool::_::_::_m_arrayPool::_0_::_elem::_m_objectInformation::_5_::_m_perObjectType::_m_prob1ObstacleN = 128;
      @sysvar::XCP::RadarFC_Obj::_g_PL_AD_fw_Radar_1R1V_rpc_XilObjBypassingRunnable_XilObjBypassingRunnable_m_pad_radarObjPort_par_out_local::TChangeableMemPool::_::_::_m_arrayPool::_0_::_elem::_m_objectInformation::_5_::_m_perObjectType::_m_prob1NonObstacleN = 0;
      @sysvar::XCP::RadarFC_Obj::_g_PL_AD_fw_Radar_1R1V_rpc_XilObjBypassingRunnable_XilObjBypassingRunnable_m_pad_radarObjPort_par_out_local::TChangeableMemPool::_::_::_m_arrayPool::_0_::_elem::_m_objectInformation::_5_::_m_perObjectType::_m_prob1UnknownN = 0;
      @sysvar::XCP::RadarFC_Obj::_g_PL_AD_fw_Radar_1R1V_rpc_XilObjBypassingRunnable_XilObjBypassingRunnable_m_pad_radarObjPort_par_out_local::TChangeableMemPool::_::_::_m_arrayPool::_0_::_elem::_m_objectInformation::_5_::_m_perObjectType::_m_prob1MobileN = 128;
      @sysvar::XCP::RadarFC_Obj::_g_PL_AD_fw_Radar_1R1V_rpc_XilObjBypassingRunnable_XilObjBypassingRunnable_m_pad_radarObjPort_par_out_local::TChangeableMemPool::_::_::_m_arrayPool::_0_::_elem::_m_objectInformation::_5_::_m_perObjectType::_m_prob1StationaryN = 0;
      @sysvar::XCP::RadarFC_Obj::_g_PL_AD_fw_Radar_1R1V_rpc_XilObjBypassingRunnable_XilObjBypassingRunnable_m_pad_radarObjPort_par_out_local::TChangeableMemPool::_::_::_m_arrayPool::_0_::_elem::_m_objectInformation::_5_::_m_perObjectType::_m_prob1ObstUnknownN = 0;
      @sysvar::XCP::RadarFC_Obj::_g_PL_AD_fw_Radar_1R1V_rpc_XilObjBypassingRunnable_XilObjBypassingRunnable_m_pad_radarObjPort_par_out_local::TChangeableMemPool::_::_::_m_arrayPool::_0_::_elem::_m_objectInformation::_5_::_m_perObjectType::_m_prob1FourPlusWheelerN = 0;
      @sysvar::XCP::RadarFC_Obj::_g_PL_AD_fw_Radar_1R1V_rpc_XilObjBypassingRunnable_XilObjBypassingRunnable_m_pad_radarObjPort_par_out_local::TChangeableMemPool::_::_::_m_arrayPool::_0_::_elem::_m_objectInformation::_5_::_m_perObjectType::_m_prob1TwoWheelerN = 128;
      @sysvar::XCP::RadarFC_Obj::_g_PL_AD_fw_Radar_1R1V_rpc_XilObjBypassingRunnable_XilObjBypassingRunnable_m_pad_radarObjPort_par_out_local::TChangeableMemPool::_::_::_m_arrayPool::_0_::_elem::_m_objectInformation::_5_::_m_perObjectType::_m_prob1PedestrianN = 0;
      @sysvar::XCP::RadarFC_Obj::_g_PL_AD_fw_Radar_1R1V_rpc_XilObjBypassingRunnable_XilObjBypassingRunnable_m_pad_radarObjPort_par_out_local::TChangeableMemPool::_::_::_m_arrayPool::_0_::_elem::_m_objectInformation::_5_::_m_perObjectType::_m_prob1MovUnknownN = 0;
      @sysvar::XCP::RadarFC_Obj::_g_PL_AD_fw_Radar_1R1V_rpc_XilObjBypassingRunnable_XilObjBypassingRunnable_m_pad_radarObjPort_par_out_local::TChangeableMemPool::_::_::_m_arrayPool::_0_::_elem::_m_objectInformation::_5_::_m_perObjectType::_m_prob1RoadsideBarrierN = 0;
      @sysvar::XCP::RadarFC_Obj::_g_PL_AD_fw_Radar_1R1V_rpc_XilObjBypassingRunnable_XilObjBypassingRunnable_m_pad_radarObjPort_par_out_local::TChangeableMemPool::_::_::_m_arrayPool::_0_::_elem::_m_objectInformation::_5_::_m_perObjectType::_m_prob1StatUnknownN = 128;
      @sysvar::XCP::RadarFC_Obj::_g_PL_AD_fw_Radar_1R1V_rpc_XilObjBypassingRunnable_XilObjBypassingRunnable_m_pad_radarObjPort_par_out_local::TChangeableMemPool::_::_::_m_arrayPool::_0_::_elem::_m_objectInformation::_5_::_m_perObjectType::_m_prob1PassengerCarN = 0;
      @sysvar::XCP::RadarFC_Obj::_g_PL_AD_fw_Radar_1R1V_rpc_XilObjBypassingRunnable_XilObjBypassingRunnable_m_pad_radarObjPort_par_out_local::TChangeableMemPool::_::_::_m_arrayPool::_0_::_elem::_m_objectInformation::_5_::_m_perObjectType::_m_prob1TruckN = 0;
      @sysvar::XCP::RadarFC_Obj::_g_PL_AD_fw_Radar_1R1V_rpc_XilObjBypassingRunnable_XilObjBypassingRunnable_m_pad_radarObjPort_par_out_local::TChangeableMemPool::_::_::_m_arrayPool::_0_::_elem::_m_objectInformation::_5_::_m_perObjectType::_m_prob1FourWheelUnknownN = 128;
      @sysvar::XCP::RadarFC_Obj::_g_PL_AD_fw_Radar_1R1V_rpc_XilObjBypassingRunnable_XilObjBypassingRunnable_m_pad_radarObjPort_par_out_local::TChangeableMemPool::_::_::_m_arrayPool::_0_::_elem::_m_objectInformation::_5_::_m_dWidthN = 64;
        break;

      case 4: //"Pedestrian"
      @sysvar::XCP::RadarFC_Obj::_g_PL_AD_fw_Radar_1R1V_rpc_XilObjBypassingRunnable_XilObjBypassingRunnable_m_pad_radarObjPort_par_out_local::TChangeableMemPool::_::_::_m_arrayPool::_0_::_elem::_m_objectInformation::_5_::_m_perObjectType::_m_prob1ObstacleN = 128;
      @sysvar::XCP::RadarFC_Obj::_g_PL_AD_fw_Radar_1R1V_rpc_XilObjBypassingRunnable_XilObjBypassingRunnable_m_pad_radarObjPort_par_out_local::TChangeableMemPool::_::_::_m_arrayPool::_0_::_elem::_m_objectInformation::_5_::_m_perObjectType::_m_prob1NonObstacleN = 0;
      @sysvar::XCP::RadarFC_Obj::_g_PL_AD_fw_Radar_1R1V_rpc_XilObjBypassingRunnable_XilObjBypassingRunnable_m_pad_radarObjPort_par_out_local::TChangeableMemPool::_::_::_m_arrayPool::_0_::_elem::_m_objectInformation::_5_::_m_perObjectType::_m_prob1UnknownN = 0;
      @sysvar::XCP::RadarFC_Obj::_g_PL_AD_fw_Radar_1R1V_rpc_XilObjBypassingRunnable_XilObjBypassingRunnable_m_pad_radarObjPort_par_out_local::TChangeableMemPool::_::_::_m_arrayPool::_0_::_elem::_m_objectInformation::_5_::_m_perObjectType::_m_prob1MobileN = 128;
      @sysvar::XCP::RadarFC_Obj::_g_PL_AD_fw_Radar_1R1V_rpc_XilObjBypassingRunnable_XilObjBypassingRunnable_m_pad_radarObjPort_par_out_local::TChangeableMemPool::_::_::_m_arrayPool::_0_::_elem::_m_objectInformation::_5_::_m_perObjectType::_m_prob1StationaryN = 0;
      @sysvar::XCP::RadarFC_Obj::_g_PL_AD_fw_Radar_1R1V_rpc_XilObjBypassingRunnable_XilObjBypassingRunnable_m_pad_radarObjPort_par_out_local::TChangeableMemPool::_::_::_m_arrayPool::_0_::_elem::_m_objectInformation::_5_::_m_perObjectType::_m_prob1ObstUnknownN = 0;
      @sysvar::XCP::RadarFC_Obj::_g_PL_AD_fw_Radar_1R1V_rpc_XilObjBypassingRunnable_XilObjBypassingRunnable_m_pad_radarObjPort_par_out_local::TChangeableMemPool::_::_::_m_arrayPool::_0_::_elem::_m_objectInformation::_5_::_m_perObjectType::_m_prob1FourPlusWheelerN = 0;
      @sysvar::XCP::RadarFC_Obj::_g_PL_AD_fw_Radar_1R1V_rpc_XilObjBypassingRunnable_XilObjBypassingRunnable_m_pad_radarObjPort_par_out_local::TChangeableMemPool::_::_::_m_arrayPool::_0_::_elem::_m_objectInformation::_5_::_m_perObjectType::_m_prob1TwoWheelerN = 0;
      @sysvar::XCP::RadarFC_Obj::_g_PL_AD_fw_Radar_1R1V_rpc_XilObjBypassingRunnable_XilObjBypassingRunnable_m_pad_radarObjPort_par_out_local::TChangeableMemPool::_::_::_m_arrayPool::_0_::_elem::_m_objectInformation::_5_::_m_perObjectType::_m_prob1PedestrianN = 128;
      @sysvar::XCP::RadarFC_Obj::_g_PL_AD_fw_Radar_1R1V_rpc_XilObjBypassingRunnable_XilObjBypassingRunnable_m_pad_radarObjPort_par_out_local::TChangeableMemPool::_::_::_m_arrayPool::_0_::_elem::_m_objectInformation::_5_::_m_perObjectType::_m_prob1MovUnknownN = 0;
      @sysvar::XCP::RadarFC_Obj::_g_PL_AD_fw_Radar_1R1V_rpc_XilObjBypassingRunnable_XilObjBypassingRunnable_m_pad_radarObjPort_par_out_local::TChangeableMemPool::_::_::_m_arrayPool::_0_::_elem::_m_objectInformation::_5_::_m_perObjectType::_m_prob1RoadsideBarrierN = 0;
      @sysvar::XCP::RadarFC_Obj::_g_PL_AD_fw_Radar_1R1V_rpc_XilObjBypassingRunnable_XilObjBypassingRunnable_m_pad_radarObjPort_par_out_local::TChangeableMemPool::_::_::_m_arrayPool::_0_::_elem::_m_objectInformation::_5_::_m_perObjectType::_m_prob1StatUnknownN = 128;
      @sysvar::XCP::RadarFC_Obj::_g_PL_AD_fw_Radar_1R1V_rpc_XilObjBypassingRunnable_XilObjBypassingRunnable_m_pad_radarObjPort_par_out_local::TChangeableMemPool::_::_::_m_arrayPool::_0_::_elem::_m_objectInformation::_5_::_m_perObjectType::_m_prob1PassengerCarN = 0;
      @sysvar::XCP::RadarFC_Obj::_g_PL_AD_fw_Radar_1R1V_rpc_XilObjBypassingRunnable_XilObjBypassingRunnable_m_pad_radarObjPort_par_out_local::TChangeableMemPool::_::_::_m_arrayPool::_0_::_elem::_m_objectInformation::_5_::_m_perObjectType::_m_prob1TruckN = 0;
      @sysvar::XCP::RadarFC_Obj::_g_PL_AD_fw_Radar_1R1V_rpc_XilObjBypassingRunnable_XilObjBypassingRunnable_m_pad_radarObjPort_par_out_local::TChangeableMemPool::_::_::_m_arrayPool::_0_::_elem::_m_objectInformation::_5_::_m_perObjectType::_m_prob1FourWheelUnknownN = 128;
      @sysvar::XCP::RadarFC_Obj::_g_PL_AD_fw_Radar_1R1V_rpc_XilObjBypassingRunnable_XilObjBypassingRunnable_m_pad_radarObjPort_par_out_local::TChangeableMemPool::_::_::_m_arrayPool::_0_::_elem::_m_objectInformation::_5_::_m_dWidthN = 64;
        break;

      case 5: //"Truck"
      @sysvar::XCP::RadarFC_Obj::_g_PL_AD_fw_Radar_1R1V_rpc_XilObjBypassingRunnable_XilObjBypassingRunnable_m_pad_radarObjPort_par_out_local::TChangeableMemPool::_::_::_m_arrayPool::_0_::_elem::_m_objectInformation::_5_::_m_perObjectType::_m_prob1ObstacleN = 128;
      @sysvar::XCP::RadarFC_Obj::_g_PL_AD_fw_Radar_1R1V_rpc_XilObjBypassingRunnable_XilObjBypassingRunnable_m_pad_radarObjPort_par_out_local::TChangeableMemPool::_::_::_m_arrayPool::_0_::_elem::_m_objectInformation::_5_::_m_perObjectType::_m_prob1NonObstacleN = 0;
      @sysvar::XCP::RadarFC_Obj::_g_PL_AD_fw_Radar_1R1V_rpc_XilObjBypassingRunnable_XilObjBypassingRunnable_m_pad_radarObjPort_par_out_local::TChangeableMemPool::_::_::_m_arrayPool::_0_::_elem::_m_objectInformation::_5_::_m_perObjectType::_m_prob1UnknownN = 0;
      @sysvar::XCP::RadarFC_Obj::_g_PL_AD_fw_Radar_1R1V_rpc_XilObjBypassingRunnable_XilObjBypassingRunnable_m_pad_radarObjPort_par_out_local::TChangeableMemPool::_::_::_m_arrayPool::_0_::_elem::_m_objectInformation::_5_::_m_perObjectType::_m_prob1MobileN = 128;
      @sysvar::XCP::RadarFC_Obj::_g_PL_AD_fw_Radar_1R1V_rpc_XilObjBypassingRunnable_XilObjBypassingRunnable_m_pad_radarObjPort_par_out_local::TChangeableMemPool::_::_::_m_arrayPool::_0_::_elem::_m_objectInformation::_5_::_m_perObjectType::_m_prob1StationaryN = 0;
      @sysvar::XCP::RadarFC_Obj::_g_PL_AD_fw_Radar_1R1V_rpc_XilObjBypassingRunnable_XilObjBypassingRunnable_m_pad_radarObjPort_par_out_local::TChangeableMemPool::_::_::_m_arrayPool::_0_::_elem::_m_objectInformation::_5_::_m_perObjectType::_m_prob1ObstUnknownN = 0;
      @sysvar::XCP::RadarFC_Obj::_g_PL_AD_fw_Radar_1R1V_rpc_XilObjBypassingRunnable_XilObjBypassingRunnable_m_pad_radarObjPort_par_out_local::TChangeableMemPool::_::_::_m_arrayPool::_0_::_elem::_m_objectInformation::_5_::_m_perObjectType::_m_prob1FourPlusWheelerN = 128;
      @sysvar::XCP::RadarFC_Obj::_g_PL_AD_fw_Radar_1R1V_rpc_XilObjBypassingRunnable_XilObjBypassingRunnable_m_pad_radarObjPort_par_out_local::TChangeableMemPool::_::_::_m_arrayPool::_0_::_elem::_m_objectInformation::_5_::_m_perObjectType::_m_prob1TwoWheelerN = 0;
      @sysvar::XCP::RadarFC_Obj::_g_PL_AD_fw_Radar_1R1V_rpc_XilObjBypassingRunnable_XilObjBypassingRunnable_m_pad_radarObjPort_par_out_local::TChangeableMemPool::_::_::_m_arrayPool::_0_::_elem::_m_objectInformation::_5_::_m_perObjectType::_m_prob1PedestrianN = 0;
      @sysvar::XCP::RadarFC_Obj::_g_PL_AD_fw_Radar_1R1V_rpc_XilObjBypassingRunnable_XilObjBypassingRunnable_m_pad_radarObjPort_par_out_local::TChangeableMemPool::_::_::_m_arrayPool::_0_::_elem::_m_objectInformation::_5_::_m_perObjectType::_m_prob1MovUnknownN = 0;
      @sysvar::XCP::RadarFC_Obj::_g_PL_AD_fw_Radar_1R1V_rpc_XilObjBypassingRunnable_XilObjBypassingRunnable_m_pad_radarObjPort_par_out_local::TChangeableMemPool::_::_::_m_arrayPool::_0_::_elem::_m_objectInformation::_5_::_m_perObjectType::_m_prob1RoadsideBarrierN = 0;
      @sysvar::XCP::RadarFC_Obj::_g_PL_AD_fw_Radar_1R1V_rpc_XilObjBypassingRunnable_XilObjBypassingRunnable_m_pad_radarObjPort_par_out_local::TChangeableMemPool::_::_::_m_arrayPool::_0_::_elem::_m_objectInformation::_5_::_m_perObjectType::_m_prob1StatUnknownN = 128;
      @sysvar::XCP::RadarFC_Obj::_g_PL_AD_fw_Radar_1R1V_rpc_XilObjBypassingRunnable_XilObjBypassingRunnable_m_pad_radarObjPort_par_out_local::TChangeableMemPool::_::_::_m_arrayPool::_0_::_elem::_m_objectInformation::_5_::_m_perObjectType::_m_prob1PassengerCarN = 0;
      @sysvar::XCP::RadarFC_Obj::_g_PL_AD_fw_Radar_1R1V_rpc_XilObjBypassingRunnable_XilObjBypassingRunnable_m_pad_radarObjPort_par_out_local::TChangeableMemPool::_::_::_m_arrayPool::_0_::_elem::_m_objectInformation::_5_::_m_perObjectType::_m_prob1TruckN = 128;
      @sysvar::XCP::RadarFC_Obj::_g_PL_AD_fw_Radar_1R1V_rpc_XilObjBypassingRunnable_XilObjBypassingRunnable_m_pad_radarObjPort_par_out_local::TChangeableMemPool::_::_::_m_arrayPool::_0_::_elem::_m_objectInformation::_5_::_m_perObjectType::_m_prob1FourWheelUnknownN = 0;
      @sysvar::XCP::RadarFC_Obj::_g_PL_AD_fw_Radar_1R1V_rpc_XilObjBypassingRunnable_XilObjBypassingRunnable_m_pad_radarObjPort_par_out_local::TChangeableMemPool::_::_::_m_arrayPool::_0_::_elem::_m_objectInformation::_5_::_m_dWidthN = 256;
        break;

      case 6: //"PassengerCar"
      @sysvar::XCP::RadarFC_Obj::_g_PL_AD_fw_Radar_1R1V_rpc_XilObjBypassingRunnable_XilObjBypassingRunnable_m_pad_radarObjPort_par_out_local::TChangeableMemPool::_::_::_m_arrayPool::_0_::_elem::_m_objectInformation::_5_::_m_perObjectType::_m_prob1ObstacleN = 128;
      @sysvar::XCP::RadarFC_Obj::_g_PL_AD_fw_Radar_1R1V_rpc_XilObjBypassingRunnable_XilObjBypassingRunnable_m_pad_radarObjPort_par_out_local::TChangeableMemPool::_::_::_m_arrayPool::_0_::_elem::_m_objectInformation::_5_::_m_perObjectType::_m_prob1NonObstacleN = 0;
      @sysvar::XCP::RadarFC_Obj::_g_PL_AD_fw_Radar_1R1V_rpc_XilObjBypassingRunnable_XilObjBypassingRunnable_m_pad_radarObjPort_par_out_local::TChangeableMemPool::_::_::_m_arrayPool::_0_::_elem::_m_objectInformation::_5_::_m_perObjectType::_m_prob1UnknownN = 0;
      @sysvar::XCP::RadarFC_Obj::_g_PL_AD_fw_Radar_1R1V_rpc_XilObjBypassingRunnable_XilObjBypassingRunnable_m_pad_radarObjPort_par_out_local::TChangeableMemPool::_::_::_m_arrayPool::_0_::_elem::_m_objectInformation::_5_::_m_perObjectType::_m_prob1MobileN = 128;
      @sysvar::XCP::RadarFC_Obj::_g_PL_AD_fw_Radar_1R1V_rpc_XilObjBypassingRunnable_XilObjBypassingRunnable_m_pad_radarObjPort_par_out_local::TChangeableMemPool::_::_::_m_arrayPool::_0_::_elem::_m_objectInformation::_5_::_m_perObjectType::_m_prob1StationaryN = 0;
      @sysvar::XCP::RadarFC_Obj::_g_PL_AD_fw_Radar_1R1V_rpc_XilObjBypassingRunnable_XilObjBypassingRunnable_m_pad_radarObjPort_par_out_local::TChangeableMemPool::_::_::_m_arrayPool::_0_::_elem::_m_objectInformation::_5_::_m_perObjectType::_m_prob1ObstUnknownN = 0;
      @sysvar::XCP::RadarFC_Obj::_g_PL_AD_fw_Radar_1R1V_rpc_XilObjBypassingRunnable_XilObjBypassingRunnable_m_pad_radarObjPort_par_out_local::TChangeableMemPool::_::_::_m_arrayPool::_0_::_elem::_m_objectInformation::_5_::_m_perObjectType::_m_prob1FourPlusWheelerN = 128;
      @sysvar::XCP::RadarFC_Obj::_g_PL_AD_fw_Radar_1R1V_rpc_XilObjBypassingRunnable_XilObjBypassingRunnable_m_pad_radarObjPort_par_out_local::TChangeableMemPool::_::_::_m_arrayPool::_0_::_elem::_m_objectInformation::_5_::_m_perObjectType::_m_prob1TwoWheelerN = 0;
      @sysvar::XCP::RadarFC_Obj::_g_PL_AD_fw_Radar_1R1V_rpc_XilObjBypassingRunnable_XilObjBypassingRunnable_m_pad_radarObjPort_par_out_local::TChangeableMemPool::_::_::_m_arrayPool::_0_::_elem::_m_objectInformation::_5_::_m_perObjectType::_m_prob1PedestrianN = 0;
      @sysvar::XCP::RadarFC_Obj::_g_PL_AD_fw_Radar_1R1V_rpc_XilObjBypassingRunnable_XilObjBypassingRunnable_m_pad_radarObjPort_par_out_local::TChangeableMemPool::_::_::_m_arrayPool::_0_::_elem::_m_objectInformation::_5_::_m_perObjectType::_m_prob1MovUnknownN = 0;
      @sysvar::XCP::RadarFC_Obj::_g_PL_AD_fw_Radar_1R1V_rpc_XilObjBypassingRunnable_XilObjBypassingRunnable_m_pad_radarObjPort_par_out_local::TChangeableMemPool::_::_::_m_arrayPool::_0_::_elem::_m_objectInformation::_5_::_m_perObjectType::_m_prob1RoadsideBarrierN = 0;
      @sysvar::XCP::RadarFC_Obj::_g_PL_AD_fw_Radar_1R1V_rpc_XilObjBypassingRunnable_XilObjBypassingRunnable_m_pad_radarObjPort_par_out_local::TChangeableMemPool::_::_::_m_arrayPool::_0_::_elem::_m_objectInformation::_5_::_m_perObjectType::_m_prob1StatUnknownN = 128;
      @sysvar::XCP::RadarFC_Obj::_g_PL_AD_fw_Radar_1R1V_rpc_XilObjBypassingRunnable_XilObjBypassingRunnable_m_pad_radarObjPort_par_out_local::TChangeableMemPool::_::_::_m_arrayPool::_0_::_elem::_m_objectInformation::_5_::_m_perObjectType::_m_prob1PassengerCarN = 128;
      @sysvar::XCP::RadarFC_Obj::_g_PL_AD_fw_Radar_1R1V_rpc_XilObjBypassingRunnable_XilObjBypassingRunnable_m_pad_radarObjPort_par_out_local::TChangeableMemPool::_::_::_m_arrayPool::_0_::_elem::_m_objectInformation::_5_::_m_perObjectType::_m_prob1TruckN = 0;
      @sysvar::XCP::RadarFC_Obj::_g_PL_AD_fw_Radar_1R1V_rpc_XilObjBypassingRunnable_XilObjBypassingRunnable_m_pad_radarObjPort_par_out_local::TChangeableMemPool::_::_::_m_arrayPool::_0_::_elem::_m_objectInformation::_5_::_m_perObjectType::_m_prob1FourWheelUnknownN = 0;
      @sysvar::XCP::RadarFC_Obj::_g_PL_AD_fw_Radar_1R1V_rpc_XilObjBypassingRunnable_XilObjBypassingRunnable_m_pad_radarObjPort_par_out_local::TChangeableMemPool::_::_::_m_arrayPool::_0_::_elem::_m_objectInformation::_5_::_m_dWidthN = 256;
        break;
    }
    break;

    case 6: //"Object-6"
    //constant
  @sysvar::XCP::RadarFC_Obj::_g_PL_AD_fw_Radar_1R1V_rpc_XilObjBypassingRunnable_XilObjBypassingRunnable_m_pad_radarObjPort_par_out_local::TChangeableMemPool::_::_::_m_arrayPool::_0_::_elem::_m_objectInformation::_6_::_Valid_b = 1;
  @sysvar::XCP::RadarFC_Obj::_g_PL_AD_fw_Radar_1R1V_rpc_XilObjBypassingRunnable_XilObjBypassingRunnable_m_pad_radarObjPort_par_out_local::TChangeableMemPool::_::_::_m_arrayPool::_0_::_elem::_m_objectInformation::_6_::_m_HandleN = 1;
  @sysvar::XCP::RadarFC_Obj::_g_PL_AD_fw_Radar_1R1V_rpc_XilObjBypassingRunnable_XilObjBypassingRunnable_m_pad_radarObjPort_par_out_local::TChangeableMemPool::_::_::_m_arrayPool::_0_::_elem::_m_objectInformation::_6_::_m_alpPiVarYawAngleN = 0;
  @sysvar::XCP::RadarFC_Obj::_g_PL_AD_fw_Radar_1R1V_rpc_XilObjBypassingRunnable_XilObjBypassingRunnable_m_pad_radarObjPort_par_out_local::TChangeableMemPool::_::_::_m_arrayPool::_0_::_elem::_m_objectInformation::_6_::_m_alpPiYawAngleN = 0;
  @sysvar::XCP::RadarFC_Obj::_g_PL_AD_fw_Radar_1R1V_rpc_XilObjBypassingRunnable_XilObjBypassingRunnable_m_pad_radarObjPort_par_out_local::TChangeableMemPool::_::_::_m_arrayPool::_0_::_elem::_m_objectInformation::_6_::_m_varAxN = 0;
  @sysvar::XCP::RadarFC_Obj::_g_PL_AD_fw_Radar_1R1V_rpc_XilObjBypassingRunnable_XilObjBypassingRunnable_m_pad_radarObjPort_par_out_local::TChangeableMemPool::_::_::_m_arrayPool::_0_::_elem::_m_objectInformation::_6_::_m_varAyN = 0;
  @sysvar::XCP::RadarFC_Obj::_g_PL_AD_fw_Radar_1R1V_rpc_XilObjBypassingRunnable_XilObjBypassingRunnable_m_pad_radarObjPort_par_out_local::TChangeableMemPool::_::_::_m_arrayPool::_0_::_elem::_m_objectInformation::_6_::_m_varVxN = 0;
  @sysvar::XCP::RadarFC_Obj::_g_PL_AD_fw_Radar_1R1V_rpc_XilObjBypassingRunnable_XilObjBypassingRunnable_m_pad_radarObjPort_par_out_local::TChangeableMemPool::_::_::_m_arrayPool::_0_::_elem::_m_objectInformation::_6_::_m_varVyN = 0;
  @sysvar::XCP::RadarFC_Obj::_g_PL_AD_fw_Radar_1R1V_rpc_XilObjBypassingRunnable_XilObjBypassingRunnable_m_pad_radarObjPort_par_out_local::TChangeableMemPool::_::_::_m_arrayPool::_0_::_elem::_m_objectInformation::_6_::_m_varDxN = 0;
  @sysvar::XCP::RadarFC_Obj::_g_PL_AD_fw_Radar_1R1V_rpc_XilObjBypassingRunnable_XilObjBypassingRunnable_m_pad_radarObjPort_par_out_local::TChangeableMemPool::_::_::_m_arrayPool::_0_::_elem::_m_objectInformation::_6_::_m_varDyN = 0;
  @sysvar::XCP::RadarFC_Obj::_g_PL_AD_fw_Radar_1R1V_rpc_XilObjBypassingRunnable_XilObjBypassingRunnable_m_pad_radarObjPort_par_out_local::TChangeableMemPool::_::_::_m_arrayPool::_0_::_elem::_m_objectInformation::_6_::_m_dVarLengthN = 0;
  @sysvar::XCP::RadarFC_Obj::_g_PL_AD_fw_Radar_1R1V_rpc_XilObjBypassingRunnable_XilObjBypassingRunnable_m_pad_radarObjPort_par_out_local::TChangeableMemPool::_::_::_m_arrayPool::_0_::_elem::_m_objectInformation::_6_::_m_dVarWidthN = 0;
  @sysvar::XCP::RadarFC_Obj::_g_PL_AD_fw_Radar_1R1V_rpc_XilObjBypassingRunnable_XilObjBypassingRunnable_m_pad_radarObjPort_par_out_local::TChangeableMemPool::_::_::_m_arrayPool::_0_::_elem::_m_objectInformation::_6_::_m_wExistProbN = 64880;
  @sysvar::XCP::RadarFC_Obj::_g_PL_AD_fw_Radar_1R1V_rpc_XilObjBypassingRunnable_XilObjBypassingRunnable_m_pad_radarObjPort_par_out_local::TChangeableMemPool::_::_::_m_arrayPool::_0_::_elem::_m_objectInformation::_6_::_m_isObjectAsil = 1;
  @sysvar::XCP::RadarFC_Obj::_g_PL_AD_fw_Radar_1R1V_rpc_XilObjBypassingRunnable_XilObjBypassingRunnable_m_pad_radarObjPort_par_out_local::TChangeableMemPool::_::_::_m_arrayPool::_0_::_elem::_m_objectInformation::_6_::_m_dLengthN = 128;

    //target movement

  @sysvar::XCP::RadarFC_Obj::_g_PL_AD_fw_Radar_1R1V_rpc_XilObjBypassingRunnable_XilObjBypassingRunnable_m_pad_radarObjPort_par_out_local::TChangeableMemPool::_::_::_m_arrayPool::_0_::_elem::_m_objectInformation::_6_::_m_dxN = @target_radar_fc_sim::objdata.obj_distance_x[6] * 128;
  @sysvar::XCP::RadarFC_Obj::_g_PL_AD_fw_Radar_1R1V_rpc_XilObjBypassingRunnable_XilObjBypassingRunnable_m_pad_radarObjPort_par_out_local::TChangeableMemPool::_::_::_m_arrayPool::_0_::_elem::_m_objectInformation::_6_::_m_dyN = @target_radar_fc_sim::objdata.obj_distance_y[6] * 128;
  @sysvar::XCP::RadarFC_Obj::_g_PL_AD_fw_Radar_1R1V_rpc_XilObjBypassingRunnable_XilObjBypassingRunnable_m_pad_radarObjPort_par_out_local::TChangeableMemPool::_::_::_m_arrayPool::_0_::_elem::_m_objectInformation::_6_::_m_dzN = 0;
  @sysvar::XCP::RadarFC_Obj::_g_PL_AD_fw_Radar_1R1V_rpc_XilObjBypassingRunnable_XilObjBypassingRunnable_m_pad_radarObjPort_par_out_local::TChangeableMemPool::_::_::_m_arrayPool::_0_::_elem::_m_objectInformation::_6_::_m_vxN = @target_radar_fc_sim::objdata.obj_velocity_x[6] * 256;
  @sysvar::XCP::RadarFC_Obj::_g_PL_AD_fw_Radar_1R1V_rpc_XilObjBypassingRunnable_XilObjBypassingRunnable_m_pad_radarObjPort_par_out_local::TChangeableMemPool::_::_::_m_arrayPool::_0_::_elem::_m_objectInformation::_6_::_m_vyN = @target_radar_fc_sim::objdata.obj_velocity_y[6] * 256;
  @sysvar::XCP::RadarFC_Obj::_g_PL_AD_fw_Radar_1R1V_rpc_XilObjBypassingRunnable_XilObjBypassingRunnable_m_pad_radarObjPort_par_out_local::TChangeableMemPool::_::_::_m_arrayPool::_0_::_elem::_m_objectInformation::_6_::_m_axN = 0;
  @sysvar::XCP::RadarFC_Obj::_g_PL_AD_fw_Radar_1R1V_rpc_XilObjBypassingRunnable_XilObjBypassingRunnable_m_pad_radarObjPort_par_out_local::TChangeableMemPool::_::_::_m_arrayPool::_0_::_elem::_m_objectInformation::_6_::_m_ayN = 0;

    //target object moving or not
    if (abs(@target_radar_fc_sim::objdata.obj_velocity_x[6]) != 0)
    {
    @sysvar::XCP::RadarFC_Obj::_g_PL_AD_fw_Radar_1R1V_rpc_XilObjBypassingRunnable_XilObjBypassingRunnable_m_pad_radarObjPort_par_out_local::TChangeableMemPool::_::_::_m_arrayPool::_0_::_elem::_m_objectInformation::_6_::_m_prob1HasBeenObservedMovingN = 126;
    @sysvar::XCP::RadarFC_Obj::_g_PL_AD_fw_Radar_1R1V_rpc_XilObjBypassingRunnable_XilObjBypassingRunnable_m_pad_radarObjPort_par_out_local::TChangeableMemPool::_::_::_m_arrayPool::_0_::_elem::_m_objectInformation::_6_::_m_prob1MovingN = 126;
    }
    else
    {
    @sysvar::XCP::RadarFC_Obj::_g_PL_AD_fw_Radar_1R1V_rpc_XilObjBypassingRunnable_XilObjBypassingRunnable_m_pad_radarObjPort_par_out_local::TChangeableMemPool::_::_::_m_arrayPool::_0_::_elem::_m_objectInformation::_6_::_m_prob1HasBeenObservedMovingN = 0;
    @sysvar::XCP::RadarFC_Obj::_g_PL_AD_fw_Radar_1R1V_rpc_XilObjBypassingRunnable_XilObjBypassingRunnable_m_pad_radarObjPort_par_out_local::TChangeableMemPool::_::_::_m_arrayPool::_0_::_elem::_m_objectInformation::_6_::_m_prob1MovingN = 0;
    }

      //object classification
    switch (@target_radar_fc_sim::objdata.obj_type[6])
    {
      case 0: //"Non-Obstacle"
      @sysvar::XCP::RadarFC_Obj::_g_PL_AD_fw_Radar_1R1V_rpc_XilObjBypassingRunnable_XilObjBypassingRunnable_m_pad_radarObjPort_par_out_local::TChangeableMemPool::_::_::_m_arrayPool::_0_::_elem::_m_objectInformation::_6_::_m_perObjectType::_m_prob1ObstacleN = 0;
      @sysvar::XCP::RadarFC_Obj::_g_PL_AD_fw_Radar_1R1V_rpc_XilObjBypassingRunnable_XilObjBypassingRunnable_m_pad_radarObjPort_par_out_local::TChangeableMemPool::_::_::_m_arrayPool::_0_::_elem::_m_objectInformation::_6_::_m_perObjectType::_m_prob1NonObstacleN = 128;
      @sysvar::XCP::RadarFC_Obj::_g_PL_AD_fw_Radar_1R1V_rpc_XilObjBypassingRunnable_XilObjBypassingRunnable_m_pad_radarObjPort_par_out_local::TChangeableMemPool::_::_::_m_arrayPool::_0_::_elem::_m_objectInformation::_6_::_m_perObjectType::_m_prob1UnknownN = 0;
      @sysvar::XCP::RadarFC_Obj::_g_PL_AD_fw_Radar_1R1V_rpc_XilObjBypassingRunnable_XilObjBypassingRunnable_m_pad_radarObjPort_par_out_local::TChangeableMemPool::_::_::_m_arrayPool::_0_::_elem::_m_objectInformation::_6_::_m_perObjectType::_m_prob1MobileN = 0;
      @sysvar::XCP::RadarFC_Obj::_g_PL_AD_fw_Radar_1R1V_rpc_XilObjBypassingRunnable_XilObjBypassingRunnable_m_pad_radarObjPort_par_out_local::TChangeableMemPool::_::_::_m_arrayPool::_0_::_elem::_m_objectInformation::_6_::_m_perObjectType::_m_prob1StationaryN = 0;
      @sysvar::XCP::RadarFC_Obj::_g_PL_AD_fw_Radar_1R1V_rpc_XilObjBypassingRunnable_XilObjBypassingRunnable_m_pad_radarObjPort_par_out_local::TChangeableMemPool::_::_::_m_arrayPool::_0_::_elem::_m_objectInformation::_6_::_m_perObjectType::_m_prob1ObstUnknownN = 128;
      @sysvar::XCP::RadarFC_Obj::_g_PL_AD_fw_Radar_1R1V_rpc_XilObjBypassingRunnable_XilObjBypassingRunnable_m_pad_radarObjPort_par_out_local::TChangeableMemPool::_::_::_m_arrayPool::_0_::_elem::_m_objectInformation::_6_::_m_perObjectType::_m_prob1FourPlusWheelerN = 0;
      @sysvar::XCP::RadarFC_Obj::_g_PL_AD_fw_Radar_1R1V_rpc_XilObjBypassingRunnable_XilObjBypassingRunnable_m_pad_radarObjPort_par_out_local::TChangeableMemPool::_::_::_m_arrayPool::_0_::_elem::_m_objectInformation::_6_::_m_perObjectType::_m_prob1TwoWheelerN = 0;
      @sysvar::XCP::RadarFC_Obj::_g_PL_AD_fw_Radar_1R1V_rpc_XilObjBypassingRunnable_XilObjBypassingRunnable_m_pad_radarObjPort_par_out_local::TChangeableMemPool::_::_::_m_arrayPool::_0_::_elem::_m_objectInformation::_6_::_m_perObjectType::_m_prob1PedestrianN = 0;
      @sysvar::XCP::RadarFC_Obj::_g_PL_AD_fw_Radar_1R1V_rpc_XilObjBypassingRunnable_XilObjBypassingRunnable_m_pad_radarObjPort_par_out_local::TChangeableMemPool::_::_::_m_arrayPool::_0_::_elem::_m_objectInformation::_6_::_m_perObjectType::_m_prob1MovUnknownN = 128;
      @sysvar::XCP::RadarFC_Obj::_g_PL_AD_fw_Radar_1R1V_rpc_XilObjBypassingRunnable_XilObjBypassingRunnable_m_pad_radarObjPort_par_out_local::TChangeableMemPool::_::_::_m_arrayPool::_0_::_elem::_m_objectInformation::_6_::_m_perObjectType::_m_prob1RoadsideBarrierN = 0;
      @sysvar::XCP::RadarFC_Obj::_g_PL_AD_fw_Radar_1R1V_rpc_XilObjBypassingRunnable_XilObjBypassingRunnable_m_pad_radarObjPort_par_out_local::TChangeableMemPool::_::_::_m_arrayPool::_0_::_elem::_m_objectInformation::_6_::_m_perObjectType::_m_prob1StatUnknownN = 128;
      @sysvar::XCP::RadarFC_Obj::_g_PL_AD_fw_Radar_1R1V_rpc_XilObjBypassingRunnable_XilObjBypassingRunnable_m_pad_radarObjPort_par_out_local::TChangeableMemPool::_::_::_m_arrayPool::_0_::_elem::_m_objectInformation::_6_::_m_perObjectType::_m_prob1PassengerCarN = 0;
      @sysvar::XCP::RadarFC_Obj::_g_PL_AD_fw_Radar_1R1V_rpc_XilObjBypassingRunnable_XilObjBypassingRunnable_m_pad_radarObjPort_par_out_local::TChangeableMemPool::_::_::_m_arrayPool::_0_::_elem::_m_objectInformation::_6_::_m_perObjectType::_m_prob1TruckN = 0;
      @sysvar::XCP::RadarFC_Obj::_g_PL_AD_fw_Radar_1R1V_rpc_XilObjBypassingRunnable_XilObjBypassingRunnable_m_pad_radarObjPort_par_out_local::TChangeableMemPool::_::_::_m_arrayPool::_0_::_elem::_m_objectInformation::_6_::_m_perObjectType::_m_prob1FourWheelUnknownN = 128;
      @sysvar::XCP::RadarFC_Obj::_g_PL_AD_fw_Radar_1R1V_rpc_XilObjBypassingRunnable_XilObjBypassingRunnable_m_pad_radarObjPort_par_out_local::TChangeableMemPool::_::_::_m_arrayPool::_0_::_elem::_m_objectInformation::_6_::_m_dWidthN = 256;
        break;

      case 1: //"unknown"
      @sysvar::XCP::RadarFC_Obj::_g_PL_AD_fw_Radar_1R1V_rpc_XilObjBypassingRunnable_XilObjBypassingRunnable_m_pad_radarObjPort_par_out_local::TChangeableMemPool::_::_::_m_arrayPool::_0_::_elem::_m_objectInformation::_6_::_m_perObjectType::_m_prob1ObstacleN = 0;
      @sysvar::XCP::RadarFC_Obj::_g_PL_AD_fw_Radar_1R1V_rpc_XilObjBypassingRunnable_XilObjBypassingRunnable_m_pad_radarObjPort_par_out_local::TChangeableMemPool::_::_::_m_arrayPool::_0_::_elem::_m_objectInformation::_6_::_m_perObjectType::_m_prob1NonObstacleN = 0;
      @sysvar::XCP::RadarFC_Obj::_g_PL_AD_fw_Radar_1R1V_rpc_XilObjBypassingRunnable_XilObjBypassingRunnable_m_pad_radarObjPort_par_out_local::TChangeableMemPool::_::_::_m_arrayPool::_0_::_elem::_m_objectInformation::_6_::_m_perObjectType::_m_prob1UnknownN = 128;
      @sysvar::XCP::RadarFC_Obj::_g_PL_AD_fw_Radar_1R1V_rpc_XilObjBypassingRunnable_XilObjBypassingRunnable_m_pad_radarObjPort_par_out_local::TChangeableMemPool::_::_::_m_arrayPool::_0_::_elem::_m_objectInformation::_6_::_m_perObjectType::_m_prob1MobileN = 0;
      @sysvar::XCP::RadarFC_Obj::_g_PL_AD_fw_Radar_1R1V_rpc_XilObjBypassingRunnable_XilObjBypassingRunnable_m_pad_radarObjPort_par_out_local::TChangeableMemPool::_::_::_m_arrayPool::_0_::_elem::_m_objectInformation::_6_::_m_perObjectType::_m_prob1StationaryN = 0;
      @sysvar::XCP::RadarFC_Obj::_g_PL_AD_fw_Radar_1R1V_rpc_XilObjBypassingRunnable_XilObjBypassingRunnable_m_pad_radarObjPort_par_out_local::TChangeableMemPool::_::_::_m_arrayPool::_0_::_elem::_m_objectInformation::_6_::_m_perObjectType::_m_prob1ObstUnknownN = 128;
      @sysvar::XCP::RadarFC_Obj::_g_PL_AD_fw_Radar_1R1V_rpc_XilObjBypassingRunnable_XilObjBypassingRunnable_m_pad_radarObjPort_par_out_local::TChangeableMemPool::_::_::_m_arrayPool::_0_::_elem::_m_objectInformation::_6_::_m_perObjectType::_m_prob1FourPlusWheelerN = 0;
      @sysvar::XCP::RadarFC_Obj::_g_PL_AD_fw_Radar_1R1V_rpc_XilObjBypassingRunnable_XilObjBypassingRunnable_m_pad_radarObjPort_par_out_local::TChangeableMemPool::_::_::_m_arrayPool::_0_::_elem::_m_objectInformation::_6_::_m_perObjectType::_m_prob1TwoWheelerN = 0;
      @sysvar::XCP::RadarFC_Obj::_g_PL_AD_fw_Radar_1R1V_rpc_XilObjBypassingRunnable_XilObjBypassingRunnable_m_pad_radarObjPort_par_out_local::TChangeableMemPool::_::_::_m_arrayPool::_0_::_elem::_m_objectInformation::_6_::_m_perObjectType::_m_prob1PedestrianN = 0;
      @sysvar::XCP::RadarFC_Obj::_g_PL_AD_fw_Radar_1R1V_rpc_XilObjBypassingRunnable_XilObjBypassingRunnable_m_pad_radarObjPort_par_out_local::TChangeableMemPool::_::_::_m_arrayPool::_0_::_elem::_m_objectInformation::_6_::_m_perObjectType::_m_prob1MovUnknownN = 128;
      @sysvar::XCP::RadarFC_Obj::_g_PL_AD_fw_Radar_1R1V_rpc_XilObjBypassingRunnable_XilObjBypassingRunnable_m_pad_radarObjPort_par_out_local::TChangeableMemPool::_::_::_m_arrayPool::_0_::_elem::_m_objectInformation::_6_::_m_perObjectType::_m_prob1RoadsideBarrierN = 0;
      @sysvar::XCP::RadarFC_Obj::_g_PL_AD_fw_Radar_1R1V_rpc_XilObjBypassingRunnable_XilObjBypassingRunnable_m_pad_radarObjPort_par_out_local::TChangeableMemPool::_::_::_m_arrayPool::_0_::_elem::_m_objectInformation::_6_::_m_perObjectType::_m_prob1StatUnknownN = 128;
      @sysvar::XCP::RadarFC_Obj::_g_PL_AD_fw_Radar_1R1V_rpc_XilObjBypassingRunnable_XilObjBypassingRunnable_m_pad_radarObjPort_par_out_local::TChangeableMemPool::_::_::_m_arrayPool::_0_::_elem::_m_objectInformation::_6_::_m_perObjectType::_m_prob1PassengerCarN = 0;
      @sysvar::XCP::RadarFC_Obj::_g_PL_AD_fw_Radar_1R1V_rpc_XilObjBypassingRunnable_XilObjBypassingRunnable_m_pad_radarObjPort_par_out_local::TChangeableMemPool::_::_::_m_arrayPool::_0_::_elem::_m_objectInformation::_6_::_m_perObjectType::_m_prob1TruckN = 0;
      @sysvar::XCP::RadarFC_Obj::_g_PL_AD_fw_Radar_1R1V_rpc_XilObjBypassingRunnable_XilObjBypassingRunnable_m_pad_radarObjPort_par_out_local::TChangeableMemPool::_::_::_m_arrayPool::_0_::_elem::_m_objectInformation::_6_::_m_perObjectType::_m_prob1FourWheelUnknownN = 128;
      @sysvar::XCP::RadarFC_Obj::_g_PL_AD_fw_Radar_1R1V_rpc_XilObjBypassingRunnable_XilObjBypassingRunnable_m_pad_radarObjPort_par_out_local::TChangeableMemPool::_::_::_m_arrayPool::_0_::_elem::_m_objectInformation::_6_::_m_dWidthN = 256;
        break;

      case 2: //"RoadSideBarrier"
      @sysvar::XCP::RadarFC_Obj::_g_PL_AD_fw_Radar_1R1V_rpc_XilObjBypassingRunnable_XilObjBypassingRunnable_m_pad_radarObjPort_par_out_local::TChangeableMemPool::_::_::_m_arrayPool::_0_::_elem::_m_objectInformation::_6_::_m_perObjectType::_m_prob1ObstacleN = 128;
      @sysvar::XCP::RadarFC_Obj::_g_PL_AD_fw_Radar_1R1V_rpc_XilObjBypassingRunnable_XilObjBypassingRunnable_m_pad_radarObjPort_par_out_local::TChangeableMemPool::_::_::_m_arrayPool::_0_::_elem::_m_objectInformation::_6_::_m_perObjectType::_m_prob1NonObstacleN = 0;
      @sysvar::XCP::RadarFC_Obj::_g_PL_AD_fw_Radar_1R1V_rpc_XilObjBypassingRunnable_XilObjBypassingRunnable_m_pad_radarObjPort_par_out_local::TChangeableMemPool::_::_::_m_arrayPool::_0_::_elem::_m_objectInformation::_6_::_m_perObjectType::_m_prob1UnknownN = 0;
      @sysvar::XCP::RadarFC_Obj::_g_PL_AD_fw_Radar_1R1V_rpc_XilObjBypassingRunnable_XilObjBypassingRunnable_m_pad_radarObjPort_par_out_local::TChangeableMemPool::_::_::_m_arrayPool::_0_::_elem::_m_objectInformation::_6_::_m_perObjectType::_m_prob1MobileN = 0;
      @sysvar::XCP::RadarFC_Obj::_g_PL_AD_fw_Radar_1R1V_rpc_XilObjBypassingRunnable_XilObjBypassingRunnable_m_pad_radarObjPort_par_out_local::TChangeableMemPool::_::_::_m_arrayPool::_0_::_elem::_m_objectInformation::_6_::_m_perObjectType::_m_prob1StationaryN = 128;
      @sysvar::XCP::RadarFC_Obj::_g_PL_AD_fw_Radar_1R1V_rpc_XilObjBypassingRunnable_XilObjBypassingRunnable_m_pad_radarObjPort_par_out_local::TChangeableMemPool::_::_::_m_arrayPool::_0_::_elem::_m_objectInformation::_6_::_m_perObjectType::_m_prob1ObstUnknownN = 0;
      @sysvar::XCP::RadarFC_Obj::_g_PL_AD_fw_Radar_1R1V_rpc_XilObjBypassingRunnable_XilObjBypassingRunnable_m_pad_radarObjPort_par_out_local::TChangeableMemPool::_::_::_m_arrayPool::_0_::_elem::_m_objectInformation::_6_::_m_perObjectType::_m_prob1FourPlusWheelerN = 0;
      @sysvar::XCP::RadarFC_Obj::_g_PL_AD_fw_Radar_1R1V_rpc_XilObjBypassingRunnable_XilObjBypassingRunnable_m_pad_radarObjPort_par_out_local::TChangeableMemPool::_::_::_m_arrayPool::_0_::_elem::_m_objectInformation::_6_::_m_perObjectType::_m_prob1TwoWheelerN = 0;
      @sysvar::XCP::RadarFC_Obj::_g_PL_AD_fw_Radar_1R1V_rpc_XilObjBypassingRunnable_XilObjBypassingRunnable_m_pad_radarObjPort_par_out_local::TChangeableMemPool::_::_::_m_arrayPool::_0_::_elem::_m_objectInformation::_6_::_m_perObjectType::_m_prob1PedestrianN = 0;
      @sysvar::XCP::RadarFC_Obj::_g_PL_AD_fw_Radar_1R1V_rpc_XilObjBypassingRunnable_XilObjBypassingRunnable_m_pad_radarObjPort_par_out_local::TChangeableMemPool::_::_::_m_arrayPool::_0_::_elem::_m_objectInformation::_6_::_m_perObjectType::_m_prob1MovUnknownN = 128;
      @sysvar::XCP::RadarFC_Obj::_g_PL_AD_fw_Radar_1R1V_rpc_XilObjBypassingRunnable_XilObjBypassingRunnable_m_pad_radarObjPort_par_out_local::TChangeableMemPool::_::_::_m_arrayPool::_0_::_elem::_m_objectInformation::_6_::_m_perObjectType::_m_prob1RoadsideBarrierN = 128;
      @sysvar::XCP::RadarFC_Obj::_g_PL_AD_fw_Radar_1R1V_rpc_XilObjBypassingRunnable_XilObjBypassingRunnable_m_pad_radarObjPort_par_out_local::TChangeableMemPool::_::_::_m_arrayPool::_0_::_elem::_m_objectInformation::_6_::_m_perObjectType::_m_prob1StatUnknownN = 0;
      @sysvar::XCP::RadarFC_Obj::_g_PL_AD_fw_Radar_1R1V_rpc_XilObjBypassingRunnable_XilObjBypassingRunnable_m_pad_radarObjPort_par_out_local::TChangeableMemPool::_::_::_m_arrayPool::_0_::_elem::_m_objectInformation::_6_::_m_perObjectType::_m_prob1PassengerCarN = 0;
      @sysvar::XCP::RadarFC_Obj::_g_PL_AD_fw_Radar_1R1V_rpc_XilObjBypassingRunnable_XilObjBypassingRunnable_m_pad_radarObjPort_par_out_local::TChangeableMemPool::_::_::_m_arrayPool::_0_::_elem::_m_objectInformation::_6_::_m_perObjectType::_m_prob1TruckN = 0;
      @sysvar::XCP::RadarFC_Obj::_g_PL_AD_fw_Radar_1R1V_rpc_XilObjBypassingRunnable_XilObjBypassingRunnable_m_pad_radarObjPort_par_out_local::TChangeableMemPool::_::_::_m_arrayPool::_0_::_elem::_m_objectInformation::_6_::_m_perObjectType::_m_prob1FourWheelUnknownN = 128;
      @sysvar::XCP::RadarFC_Obj::_g_PL_AD_fw_Radar_1R1V_rpc_XilObjBypassingRunnable_XilObjBypassingRunnable_m_pad_radarObjPort_par_out_local::TChangeableMemPool::_::_::_m_arrayPool::_0_::_elem::_m_objectInformation::_6_::_m_dWidthN = 256;
        break;

      case 3: //"2Wheeler"
      @sysvar::XCP::RadarFC_Obj::_g_PL_AD_fw_Radar_1R1V_rpc_XilObjBypassingRunnable_XilObjBypassingRunnable_m_pad_radarObjPort_par_out_local::TChangeableMemPool::_::_::_m_arrayPool::_0_::_elem::_m_objectInformation::_6_::_m_perObjectType::_m_prob1ObstacleN = 128;
      @sysvar::XCP::RadarFC_Obj::_g_PL_AD_fw_Radar_1R1V_rpc_XilObjBypassingRunnable_XilObjBypassingRunnable_m_pad_radarObjPort_par_out_local::TChangeableMemPool::_::_::_m_arrayPool::_0_::_elem::_m_objectInformation::_6_::_m_perObjectType::_m_prob1NonObstacleN = 0;
      @sysvar::XCP::RadarFC_Obj::_g_PL_AD_fw_Radar_1R1V_rpc_XilObjBypassingRunnable_XilObjBypassingRunnable_m_pad_radarObjPort_par_out_local::TChangeableMemPool::_::_::_m_arrayPool::_0_::_elem::_m_objectInformation::_6_::_m_perObjectType::_m_prob1UnknownN = 0;
      @sysvar::XCP::RadarFC_Obj::_g_PL_AD_fw_Radar_1R1V_rpc_XilObjBypassingRunnable_XilObjBypassingRunnable_m_pad_radarObjPort_par_out_local::TChangeableMemPool::_::_::_m_arrayPool::_0_::_elem::_m_objectInformation::_6_::_m_perObjectType::_m_prob1MobileN = 128;
      @sysvar::XCP::RadarFC_Obj::_g_PL_AD_fw_Radar_1R1V_rpc_XilObjBypassingRunnable_XilObjBypassingRunnable_m_pad_radarObjPort_par_out_local::TChangeableMemPool::_::_::_m_arrayPool::_0_::_elem::_m_objectInformation::_6_::_m_perObjectType::_m_prob1StationaryN = 0;
      @sysvar::XCP::RadarFC_Obj::_g_PL_AD_fw_Radar_1R1V_rpc_XilObjBypassingRunnable_XilObjBypassingRunnable_m_pad_radarObjPort_par_out_local::TChangeableMemPool::_::_::_m_arrayPool::_0_::_elem::_m_objectInformation::_6_::_m_perObjectType::_m_prob1ObstUnknownN = 0;
      @sysvar::XCP::RadarFC_Obj::_g_PL_AD_fw_Radar_1R1V_rpc_XilObjBypassingRunnable_XilObjBypassingRunnable_m_pad_radarObjPort_par_out_local::TChangeableMemPool::_::_::_m_arrayPool::_0_::_elem::_m_objectInformation::_6_::_m_perObjectType::_m_prob1FourPlusWheelerN = 0;
      @sysvar::XCP::RadarFC_Obj::_g_PL_AD_fw_Radar_1R1V_rpc_XilObjBypassingRunnable_XilObjBypassingRunnable_m_pad_radarObjPort_par_out_local::TChangeableMemPool::_::_::_m_arrayPool::_0_::_elem::_m_objectInformation::_6_::_m_perObjectType::_m_prob1TwoWheelerN = 128;
      @sysvar::XCP::RadarFC_Obj::_g_PL_AD_fw_Radar_1R1V_rpc_XilObjBypassingRunnable_XilObjBypassingRunnable_m_pad_radarObjPort_par_out_local::TChangeableMemPool::_::_::_m_arrayPool::_0_::_elem::_m_objectInformation::_6_::_m_perObjectType::_m_prob1PedestrianN = 0;
      @sysvar::XCP::RadarFC_Obj::_g_PL_AD_fw_Radar_1R1V_rpc_XilObjBypassingRunnable_XilObjBypassingRunnable_m_pad_radarObjPort_par_out_local::TChangeableMemPool::_::_::_m_arrayPool::_0_::_elem::_m_objectInformation::_6_::_m_perObjectType::_m_prob1MovUnknownN = 0;
      @sysvar::XCP::RadarFC_Obj::_g_PL_AD_fw_Radar_1R1V_rpc_XilObjBypassingRunnable_XilObjBypassingRunnable_m_pad_radarObjPort_par_out_local::TChangeableMemPool::_::_::_m_arrayPool::_0_::_elem::_m_objectInformation::_6_::_m_perObjectType::_m_prob1RoadsideBarrierN = 0;
      @sysvar::XCP::RadarFC_Obj::_g_PL_AD_fw_Radar_1R1V_rpc_XilObjBypassingRunnable_XilObjBypassingRunnable_m_pad_radarObjPort_par_out_local::TChangeableMemPool::_::_::_m_arrayPool::_0_::_elem::_m_objectInformation::_6_::_m_perObjectType::_m_prob1StatUnknownN = 128;
      @sysvar::XCP::RadarFC_Obj::_g_PL_AD_fw_Radar_1R1V_rpc_XilObjBypassingRunnable_XilObjBypassingRunnable_m_pad_radarObjPort_par_out_local::TChangeableMemPool::_::_::_m_arrayPool::_0_::_elem::_m_objectInformation::_6_::_m_perObjectType::_m_prob1PassengerCarN = 0;
      @sysvar::XCP::RadarFC_Obj::_g_PL_AD_fw_Radar_1R1V_rpc_XilObjBypassingRunnable_XilObjBypassingRunnable_m_pad_radarObjPort_par_out_local::TChangeableMemPool::_::_::_m_arrayPool::_0_::_elem::_m_objectInformation::_6_::_m_perObjectType::_m_prob1TruckN = 0;
      @sysvar::XCP::RadarFC_Obj::_g_PL_AD_fw_Radar_1R1V_rpc_XilObjBypassingRunnable_XilObjBypassingRunnable_m_pad_radarObjPort_par_out_local::TChangeableMemPool::_::_::_m_arrayPool::_0_::_elem::_m_objectInformation::_6_::_m_perObjectType::_m_prob1FourWheelUnknownN = 128;
      @sysvar::XCP::RadarFC_Obj::_g_PL_AD_fw_Radar_1R1V_rpc_XilObjBypassingRunnable_XilObjBypassingRunnable_m_pad_radarObjPort_par_out_local::TChangeableMemPool::_::_::_m_arrayPool::_0_::_elem::_m_objectInformation::_6_::_m_dWidthN = 64;
        break;

      case 4: //"Pedestrian"
      @sysvar::XCP::RadarFC_Obj::_g_PL_AD_fw_Radar_1R1V_rpc_XilObjBypassingRunnable_XilObjBypassingRunnable_m_pad_radarObjPort_par_out_local::TChangeableMemPool::_::_::_m_arrayPool::_0_::_elem::_m_objectInformation::_6_::_m_perObjectType::_m_prob1ObstacleN = 128;
      @sysvar::XCP::RadarFC_Obj::_g_PL_AD_fw_Radar_1R1V_rpc_XilObjBypassingRunnable_XilObjBypassingRunnable_m_pad_radarObjPort_par_out_local::TChangeableMemPool::_::_::_m_arrayPool::_0_::_elem::_m_objectInformation::_6_::_m_perObjectType::_m_prob1NonObstacleN = 0;
      @sysvar::XCP::RadarFC_Obj::_g_PL_AD_fw_Radar_1R1V_rpc_XilObjBypassingRunnable_XilObjBypassingRunnable_m_pad_radarObjPort_par_out_local::TChangeableMemPool::_::_::_m_arrayPool::_0_::_elem::_m_objectInformation::_6_::_m_perObjectType::_m_prob1UnknownN = 0;
      @sysvar::XCP::RadarFC_Obj::_g_PL_AD_fw_Radar_1R1V_rpc_XilObjBypassingRunnable_XilObjBypassingRunnable_m_pad_radarObjPort_par_out_local::TChangeableMemPool::_::_::_m_arrayPool::_0_::_elem::_m_objectInformation::_6_::_m_perObjectType::_m_prob1MobileN = 128;
      @sysvar::XCP::RadarFC_Obj::_g_PL_AD_fw_Radar_1R1V_rpc_XilObjBypassingRunnable_XilObjBypassingRunnable_m_pad_radarObjPort_par_out_local::TChangeableMemPool::_::_::_m_arrayPool::_0_::_elem::_m_objectInformation::_6_::_m_perObjectType::_m_prob1StationaryN = 0;
      @sysvar::XCP::RadarFC_Obj::_g_PL_AD_fw_Radar_1R1V_rpc_XilObjBypassingRunnable_XilObjBypassingRunnable_m_pad_radarObjPort_par_out_local::TChangeableMemPool::_::_::_m_arrayPool::_0_::_elem::_m_objectInformation::_6_::_m_perObjectType::_m_prob1ObstUnknownN = 0;
      @sysvar::XCP::RadarFC_Obj::_g_PL_AD_fw_Radar_1R1V_rpc_XilObjBypassingRunnable_XilObjBypassingRunnable_m_pad_radarObjPort_par_out_local::TChangeableMemPool::_::_::_m_arrayPool::_0_::_elem::_m_objectInformation::_6_::_m_perObjectType::_m_prob1FourPlusWheelerN = 0;
      @sysvar::XCP::RadarFC_Obj::_g_PL_AD_fw_Radar_1R1V_rpc_XilObjBypassingRunnable_XilObjBypassingRunnable_m_pad_radarObjPort_par_out_local::TChangeableMemPool::_::_::_m_arrayPool::_0_::_elem::_m_objectInformation::_6_::_m_perObjectType::_m_prob1TwoWheelerN = 0;
      @sysvar::XCP::RadarFC_Obj::_g_PL_AD_fw_Radar_1R1V_rpc_XilObjBypassingRunnable_XilObjBypassingRunnable_m_pad_radarObjPort_par_out_local::TChangeableMemPool::_::_::_m_arrayPool::_0_::_elem::_m_objectInformation::_6_::_m_perObjectType::_m_prob1PedestrianN = 128;
      @sysvar::XCP::RadarFC_Obj::_g_PL_AD_fw_Radar_1R1V_rpc_XilObjBypassingRunnable_XilObjBypassingRunnable_m_pad_radarObjPort_par_out_local::TChangeableMemPool::_::_::_m_arrayPool::_0_::_elem::_m_objectInformation::_6_::_m_perObjectType::_m_prob1MovUnknownN = 0;
      @sysvar::XCP::RadarFC_Obj::_g_PL_AD_fw_Radar_1R1V_rpc_XilObjBypassingRunnable_XilObjBypassingRunnable_m_pad_radarObjPort_par_out_local::TChangeableMemPool::_::_::_m_arrayPool::_0_::_elem::_m_objectInformation::_6_::_m_perObjectType::_m_prob1RoadsideBarrierN = 0;
      @sysvar::XCP::RadarFC_Obj::_g_PL_AD_fw_Radar_1R1V_rpc_XilObjBypassingRunnable_XilObjBypassingRunnable_m_pad_radarObjPort_par_out_local::TChangeableMemPool::_::_::_m_arrayPool::_0_::_elem::_m_objectInformation::_6_::_m_perObjectType::_m_prob1StatUnknownN = 128;
      @sysvar::XCP::RadarFC_Obj::_g_PL_AD_fw_Radar_1R1V_rpc_XilObjBypassingRunnable_XilObjBypassingRunnable_m_pad_radarObjPort_par_out_local::TChangeableMemPool::_::_::_m_arrayPool::_0_::_elem::_m_objectInformation::_6_::_m_perObjectType::_m_prob1PassengerCarN = 0;
      @sysvar::XCP::RadarFC_Obj::_g_PL_AD_fw_Radar_1R1V_rpc_XilObjBypassingRunnable_XilObjBypassingRunnable_m_pad_radarObjPort_par_out_local::TChangeableMemPool::_::_::_m_arrayPool::_0_::_elem::_m_objectInformation::_6_::_m_perObjectType::_m_prob1TruckN = 0;
      @sysvar::XCP::RadarFC_Obj::_g_PL_AD_fw_Radar_1R1V_rpc_XilObjBypassingRunnable_XilObjBypassingRunnable_m_pad_radarObjPort_par_out_local::TChangeableMemPool::_::_::_m_arrayPool::_0_::_elem::_m_objectInformation::_6_::_m_perObjectType::_m_prob1FourWheelUnknownN = 128;
      @sysvar::XCP::RadarFC_Obj::_g_PL_AD_fw_Radar_1R1V_rpc_XilObjBypassingRunnable_XilObjBypassingRunnable_m_pad_radarObjPort_par_out_local::TChangeableMemPool::_::_::_m_arrayPool::_0_::_elem::_m_objectInformation::_6_::_m_dWidthN = 64;
        break;

      case 5: //"Truck"
      @sysvar::XCP::RadarFC_Obj::_g_PL_AD_fw_Radar_1R1V_rpc_XilObjBypassingRunnable_XilObjBypassingRunnable_m_pad_radarObjPort_par_out_local::TChangeableMemPool::_::_::_m_arrayPool::_0_::_elem::_m_objectInformation::_6_::_m_perObjectType::_m_prob1ObstacleN = 128;
      @sysvar::XCP::RadarFC_Obj::_g_PL_AD_fw_Radar_1R1V_rpc_XilObjBypassingRunnable_XilObjBypassingRunnable_m_pad_radarObjPort_par_out_local::TChangeableMemPool::_::_::_m_arrayPool::_0_::_elem::_m_objectInformation::_6_::_m_perObjectType::_m_prob1NonObstacleN = 0;
      @sysvar::XCP::RadarFC_Obj::_g_PL_AD_fw_Radar_1R1V_rpc_XilObjBypassingRunnable_XilObjBypassingRunnable_m_pad_radarObjPort_par_out_local::TChangeableMemPool::_::_::_m_arrayPool::_0_::_elem::_m_objectInformation::_6_::_m_perObjectType::_m_prob1UnknownN = 0;
      @sysvar::XCP::RadarFC_Obj::_g_PL_AD_fw_Radar_1R1V_rpc_XilObjBypassingRunnable_XilObjBypassingRunnable_m_pad_radarObjPort_par_out_local::TChangeableMemPool::_::_::_m_arrayPool::_0_::_elem::_m_objectInformation::_6_::_m_perObjectType::_m_prob1MobileN = 128;
      @sysvar::XCP::RadarFC_Obj::_g_PL_AD_fw_Radar_1R1V_rpc_XilObjBypassingRunnable_XilObjBypassingRunnable_m_pad_radarObjPort_par_out_local::TChangeableMemPool::_::_::_m_arrayPool::_0_::_elem::_m_objectInformation::_6_::_m_perObjectType::_m_prob1StationaryN = 0;
      @sysvar::XCP::RadarFC_Obj::_g_PL_AD_fw_Radar_1R1V_rpc_XilObjBypassingRunnable_XilObjBypassingRunnable_m_pad_radarObjPort_par_out_local::TChangeableMemPool::_::_::_m_arrayPool::_0_::_elem::_m_objectInformation::_6_::_m_perObjectType::_m_prob1ObstUnknownN = 0;
      @sysvar::XCP::RadarFC_Obj::_g_PL_AD_fw_Radar_1R1V_rpc_XilObjBypassingRunnable_XilObjBypassingRunnable_m_pad_radarObjPort_par_out_local::TChangeableMemPool::_::_::_m_arrayPool::_0_::_elem::_m_objectInformation::_6_::_m_perObjectType::_m_prob1FourPlusWheelerN = 128;
      @sysvar::XCP::RadarFC_Obj::_g_PL_AD_fw_Radar_1R1V_rpc_XilObjBypassingRunnable_XilObjBypassingRunnable_m_pad_radarObjPort_par_out_local::TChangeableMemPool::_::_::_m_arrayPool::_0_::_elem::_m_objectInformation::_6_::_m_perObjectType::_m_prob1TwoWheelerN = 0;
      @sysvar::XCP::RadarFC_Obj::_g_PL_AD_fw_Radar_1R1V_rpc_XilObjBypassingRunnable_XilObjBypassingRunnable_m_pad_radarObjPort_par_out_local::TChangeableMemPool::_::_::_m_arrayPool::_0_::_elem::_m_objectInformation::_6_::_m_perObjectType::_m_prob1PedestrianN = 0;
      @sysvar::XCP::RadarFC_Obj::_g_PL_AD_fw_Radar_1R1V_rpc_XilObjBypassingRunnable_XilObjBypassingRunnable_m_pad_radarObjPort_par_out_local::TChangeableMemPool::_::_::_m_arrayPool::_0_::_elem::_m_objectInformation::_6_::_m_perObjectType::_m_prob1MovUnknownN = 0;
      @sysvar::XCP::RadarFC_Obj::_g_PL_AD_fw_Radar_1R1V_rpc_XilObjBypassingRunnable_XilObjBypassingRunnable_m_pad_radarObjPort_par_out_local::TChangeableMemPool::_::_::_m_arrayPool::_0_::_elem::_m_objectInformation::_6_::_m_perObjectType::_m_prob1RoadsideBarrierN = 0;
      @sysvar::XCP::RadarFC_Obj::_g_PL_AD_fw_Radar_1R1V_rpc_XilObjBypassingRunnable_XilObjBypassingRunnable_m_pad_radarObjPort_par_out_local::TChangeableMemPool::_::_::_m_arrayPool::_0_::_elem::_m_objectInformation::_6_::_m_perObjectType::_m_prob1StatUnknownN = 128;
      @sysvar::XCP::RadarFC_Obj::_g_PL_AD_fw_Radar_1R1V_rpc_XilObjBypassingRunnable_XilObjBypassingRunnable_m_pad_radarObjPort_par_out_local::TChangeableMemPool::_::_::_m_arrayPool::_0_::_elem::_m_objectInformation::_6_::_m_perObjectType::_m_prob1PassengerCarN = 0;
      @sysvar::XCP::RadarFC_Obj::_g_PL_AD_fw_Radar_1R1V_rpc_XilObjBypassingRunnable_XilObjBypassingRunnable_m_pad_radarObjPort_par_out_local::TChangeableMemPool::_::_::_m_arrayPool::_0_::_elem::_m_objectInformation::_6_::_m_perObjectType::_m_prob1TruckN = 128;
      @sysvar::XCP::RadarFC_Obj::_g_PL_AD_fw_Radar_1R1V_rpc_XilObjBypassingRunnable_XilObjBypassingRunnable_m_pad_radarObjPort_par_out_local::TChangeableMemPool::_::_::_m_arrayPool::_0_::_elem::_m_objectInformation::_6_::_m_perObjectType::_m_prob1FourWheelUnknownN = 0;
      @sysvar::XCP::RadarFC_Obj::_g_PL_AD_fw_Radar_1R1V_rpc_XilObjBypassingRunnable_XilObjBypassingRunnable_m_pad_radarObjPort_par_out_local::TChangeableMemPool::_::_::_m_arrayPool::_0_::_elem::_m_objectInformation::_6_::_m_dWidthN = 256;
        break;

      case 6: //"PassengerCar"
      @sysvar::XCP::RadarFC_Obj::_g_PL_AD_fw_Radar_1R1V_rpc_XilObjBypassingRunnable_XilObjBypassingRunnable_m_pad_radarObjPort_par_out_local::TChangeableMemPool::_::_::_m_arrayPool::_0_::_elem::_m_objectInformation::_6_::_m_perObjectType::_m_prob1ObstacleN = 128;
      @sysvar::XCP::RadarFC_Obj::_g_PL_AD_fw_Radar_1R1V_rpc_XilObjBypassingRunnable_XilObjBypassingRunnable_m_pad_radarObjPort_par_out_local::TChangeableMemPool::_::_::_m_arrayPool::_0_::_elem::_m_objectInformation::_6_::_m_perObjectType::_m_prob1NonObstacleN = 0;
      @sysvar::XCP::RadarFC_Obj::_g_PL_AD_fw_Radar_1R1V_rpc_XilObjBypassingRunnable_XilObjBypassingRunnable_m_pad_radarObjPort_par_out_local::TChangeableMemPool::_::_::_m_arrayPool::_0_::_elem::_m_objectInformation::_6_::_m_perObjectType::_m_prob1UnknownN = 0;
      @sysvar::XCP::RadarFC_Obj::_g_PL_AD_fw_Radar_1R1V_rpc_XilObjBypassingRunnable_XilObjBypassingRunnable_m_pad_radarObjPort_par_out_local::TChangeableMemPool::_::_::_m_arrayPool::_0_::_elem::_m_objectInformation::_6_::_m_perObjectType::_m_prob1MobileN = 128;
      @sysvar::XCP::RadarFC_Obj::_g_PL_AD_fw_Radar_1R1V_rpc_XilObjBypassingRunnable_XilObjBypassingRunnable_m_pad_radarObjPort_par_out_local::TChangeableMemPool::_::_::_m_arrayPool::_0_::_elem::_m_objectInformation::_6_::_m_perObjectType::_m_prob1StationaryN = 0;
      @sysvar::XCP::RadarFC_Obj::_g_PL_AD_fw_Radar_1R1V_rpc_XilObjBypassingRunnable_XilObjBypassingRunnable_m_pad_radarObjPort_par_out_local::TChangeableMemPool::_::_::_m_arrayPool::_0_::_elem::_m_objectInformation::_6_::_m_perObjectType::_m_prob1ObstUnknownN = 0;
      @sysvar::XCP::RadarFC_Obj::_g_PL_AD_fw_Radar_1R1V_rpc_XilObjBypassingRunnable_XilObjBypassingRunnable_m_pad_radarObjPort_par_out_local::TChangeableMemPool::_::_::_m_arrayPool::_0_::_elem::_m_objectInformation::_6_::_m_perObjectType::_m_prob1FourPlusWheelerN = 128;
      @sysvar::XCP::RadarFC_Obj::_g_PL_AD_fw_Radar_1R1V_rpc_XilObjBypassingRunnable_XilObjBypassingRunnable_m_pad_radarObjPort_par_out_local::TChangeableMemPool::_::_::_m_arrayPool::_0_::_elem::_m_objectInformation::_6_::_m_perObjectType::_m_prob1TwoWheelerN = 0;
      @sysvar::XCP::RadarFC_Obj::_g_PL_AD_fw_Radar_1R1V_rpc_XilObjBypassingRunnable_XilObjBypassingRunnable_m_pad_radarObjPort_par_out_local::TChangeableMemPool::_::_::_m_arrayPool::_0_::_elem::_m_objectInformation::_6_::_m_perObjectType::_m_prob1PedestrianN = 0;
      @sysvar::XCP::RadarFC_Obj::_g_PL_AD_fw_Radar_1R1V_rpc_XilObjBypassingRunnable_XilObjBypassingRunnable_m_pad_radarObjPort_par_out_local::TChangeableMemPool::_::_::_m_arrayPool::_0_::_elem::_m_objectInformation::_6_::_m_perObjectType::_m_prob1MovUnknownN = 0;
      @sysvar::XCP::RadarFC_Obj::_g_PL_AD_fw_Radar_1R1V_rpc_XilObjBypassingRunnable_XilObjBypassingRunnable_m_pad_radarObjPort_par_out_local::TChangeableMemPool::_::_::_m_arrayPool::_0_::_elem::_m_objectInformation::_6_::_m_perObjectType::_m_prob1RoadsideBarrierN = 0;
      @sysvar::XCP::RadarFC_Obj::_g_PL_AD_fw_Radar_1R1V_rpc_XilObjBypassingRunnable_XilObjBypassingRunnable_m_pad_radarObjPort_par_out_local::TChangeableMemPool::_::_::_m_arrayPool::_0_::_elem::_m_objectInformation::_6_::_m_perObjectType::_m_prob1StatUnknownN = 128;
      @sysvar::XCP::RadarFC_Obj::_g_PL_AD_fw_Radar_1R1V_rpc_XilObjBypassingRunnable_XilObjBypassingRunnable_m_pad_radarObjPort_par_out_local::TChangeableMemPool::_::_::_m_arrayPool::_0_::_elem::_m_objectInformation::_6_::_m_perObjectType::_m_prob1PassengerCarN = 128;
      @sysvar::XCP::RadarFC_Obj::_g_PL_AD_fw_Radar_1R1V_rpc_XilObjBypassingRunnable_XilObjBypassingRunnable_m_pad_radarObjPort_par_out_local::TChangeableMemPool::_::_::_m_arrayPool::_0_::_elem::_m_objectInformation::_6_::_m_perObjectType::_m_prob1TruckN = 0;
      @sysvar::XCP::RadarFC_Obj::_g_PL_AD_fw_Radar_1R1V_rpc_XilObjBypassingRunnable_XilObjBypassingRunnable_m_pad_radarObjPort_par_out_local::TChangeableMemPool::_::_::_m_arrayPool::_0_::_elem::_m_objectInformation::_6_::_m_perObjectType::_m_prob1FourWheelUnknownN = 0;
      @sysvar::XCP::RadarFC_Obj::_g_PL_AD_fw_Radar_1R1V_rpc_XilObjBypassingRunnable_XilObjBypassingRunnable_m_pad_radarObjPort_par_out_local::TChangeableMemPool::_::_::_m_arrayPool::_0_::_elem::_m_objectInformation::_6_::_m_dWidthN = 256;
        break;
    }
    break;

    case 7: //"Object-7"
    //constant
  @sysvar::XCP::RadarFC_Obj::_g_PL_AD_fw_Radar_1R1V_rpc_XilObjBypassingRunnable_XilObjBypassingRunnable_m_pad_radarObjPort_par_out_local::TChangeableMemPool::_::_::_m_arrayPool::_0_::_elem::_m_objectInformation::_7_::_Valid_b = 1;
  @sysvar::XCP::RadarFC_Obj::_g_PL_AD_fw_Radar_1R1V_rpc_XilObjBypassingRunnable_XilObjBypassingRunnable_m_pad_radarObjPort_par_out_local::TChangeableMemPool::_::_::_m_arrayPool::_0_::_elem::_m_objectInformation::_7_::_m_HandleN = 1;
  @sysvar::XCP::RadarFC_Obj::_g_PL_AD_fw_Radar_1R1V_rpc_XilObjBypassingRunnable_XilObjBypassingRunnable_m_pad_radarObjPort_par_out_local::TChangeableMemPool::_::_::_m_arrayPool::_0_::_elem::_m_objectInformation::_7_::_m_alpPiVarYawAngleN = 0;
  @sysvar::XCP::RadarFC_Obj::_g_PL_AD_fw_Radar_1R1V_rpc_XilObjBypassingRunnable_XilObjBypassingRunnable_m_pad_radarObjPort_par_out_local::TChangeableMemPool::_::_::_m_arrayPool::_0_::_elem::_m_objectInformation::_7_::_m_alpPiYawAngleN = 0;
  @sysvar::XCP::RadarFC_Obj::_g_PL_AD_fw_Radar_1R1V_rpc_XilObjBypassingRunnable_XilObjBypassingRunnable_m_pad_radarObjPort_par_out_local::TChangeableMemPool::_::_::_m_arrayPool::_0_::_elem::_m_objectInformation::_7_::_m_varAxN = 0;
  @sysvar::XCP::RadarFC_Obj::_g_PL_AD_fw_Radar_1R1V_rpc_XilObjBypassingRunnable_XilObjBypassingRunnable_m_pad_radarObjPort_par_out_local::TChangeableMemPool::_::_::_m_arrayPool::_0_::_elem::_m_objectInformation::_7_::_m_varAyN = 0;
  @sysvar::XCP::RadarFC_Obj::_g_PL_AD_fw_Radar_1R1V_rpc_XilObjBypassingRunnable_XilObjBypassingRunnable_m_pad_radarObjPort_par_out_local::TChangeableMemPool::_::_::_m_arrayPool::_0_::_elem::_m_objectInformation::_7_::_m_varVxN = 0;
  @sysvar::XCP::RadarFC_Obj::_g_PL_AD_fw_Radar_1R1V_rpc_XilObjBypassingRunnable_XilObjBypassingRunnable_m_pad_radarObjPort_par_out_local::TChangeableMemPool::_::_::_m_arrayPool::_0_::_elem::_m_objectInformation::_7_::_m_varVyN = 0;
  @sysvar::XCP::RadarFC_Obj::_g_PL_AD_fw_Radar_1R1V_rpc_XilObjBypassingRunnable_XilObjBypassingRunnable_m_pad_radarObjPort_par_out_local::TChangeableMemPool::_::_::_m_arrayPool::_0_::_elem::_m_objectInformation::_7_::_m_varDxN = 0;
  @sysvar::XCP::RadarFC_Obj::_g_PL_AD_fw_Radar_1R1V_rpc_XilObjBypassingRunnable_XilObjBypassingRunnable_m_pad_radarObjPort_par_out_local::TChangeableMemPool::_::_::_m_arrayPool::_0_::_elem::_m_objectInformation::_7_::_m_varDyN = 0;
  @sysvar::XCP::RadarFC_Obj::_g_PL_AD_fw_Radar_1R1V_rpc_XilObjBypassingRunnable_XilObjBypassingRunnable_m_pad_radarObjPort_par_out_local::TChangeableMemPool::_::_::_m_arrayPool::_0_::_elem::_m_objectInformation::_7_::_m_dVarLengthN = 0;
  @sysvar::XCP::RadarFC_Obj::_g_PL_AD_fw_Radar_1R1V_rpc_XilObjBypassingRunnable_XilObjBypassingRunnable_m_pad_radarObjPort_par_out_local::TChangeableMemPool::_::_::_m_arrayPool::_0_::_elem::_m_objectInformation::_7_::_m_dVarWidthN = 0;
  @sysvar::XCP::RadarFC_Obj::_g_PL_AD_fw_Radar_1R1V_rpc_XilObjBypassingRunnable_XilObjBypassingRunnable_m_pad_radarObjPort_par_out_local::TChangeableMemPool::_::_::_m_arrayPool::_0_::_elem::_m_objectInformation::_7_::_m_wExistProbN = 64880;
  @sysvar::XCP::RadarFC_Obj::_g_PL_AD_fw_Radar_1R1V_rpc_XilObjBypassingRunnable_XilObjBypassingRunnable_m_pad_radarObjPort_par_out_local::TChangeableMemPool::_::_::_m_arrayPool::_0_::_elem::_m_objectInformation::_7_::_m_isObjectAsil = 1;
  @sysvar::XCP::RadarFC_Obj::_g_PL_AD_fw_Radar_1R1V_rpc_XilObjBypassingRunnable_XilObjBypassingRunnable_m_pad_radarObjPort_par_out_local::TChangeableMemPool::_::_::_m_arrayPool::_0_::_elem::_m_objectInformation::_7_::_m_dLengthN = 128;

    //target movement

  @sysvar::XCP::RadarFC_Obj::_g_PL_AD_fw_Radar_1R1V_rpc_XilObjBypassingRunnable_XilObjBypassingRunnable_m_pad_radarObjPort_par_out_local::TChangeableMemPool::_::_::_m_arrayPool::_0_::_elem::_m_objectInformation::_7_::_m_dxN = @target_radar_fc_sim::objdata.obj_distance_x[7] * 128;
  @sysvar::XCP::RadarFC_Obj::_g_PL_AD_fw_Radar_1R1V_rpc_XilObjBypassingRunnable_XilObjBypassingRunnable_m_pad_radarObjPort_par_out_local::TChangeableMemPool::_::_::_m_arrayPool::_0_::_elem::_m_objectInformation::_7_::_m_dyN = @target_radar_fc_sim::objdata.obj_distance_y[7] * 128;
  @sysvar::XCP::RadarFC_Obj::_g_PL_AD_fw_Radar_1R1V_rpc_XilObjBypassingRunnable_XilObjBypassingRunnable_m_pad_radarObjPort_par_out_local::TChangeableMemPool::_::_::_m_arrayPool::_0_::_elem::_m_objectInformation::_7_::_m_dzN = 0;
  @sysvar::XCP::RadarFC_Obj::_g_PL_AD_fw_Radar_1R1V_rpc_XilObjBypassingRunnable_XilObjBypassingRunnable_m_pad_radarObjPort_par_out_local::TChangeableMemPool::_::_::_m_arrayPool::_0_::_elem::_m_objectInformation::_7_::_m_vxN = @target_radar_fc_sim::objdata.obj_velocity_x[7] * 256;
  @sysvar::XCP::RadarFC_Obj::_g_PL_AD_fw_Radar_1R1V_rpc_XilObjBypassingRunnable_XilObjBypassingRunnable_m_pad_radarObjPort_par_out_local::TChangeableMemPool::_::_::_m_arrayPool::_0_::_elem::_m_objectInformation::_7_::_m_vyN = @target_radar_fc_sim::objdata.obj_velocity_y[7] * 256;
  @sysvar::XCP::RadarFC_Obj::_g_PL_AD_fw_Radar_1R1V_rpc_XilObjBypassingRunnable_XilObjBypassingRunnable_m_pad_radarObjPort_par_out_local::TChangeableMemPool::_::_::_m_arrayPool::_0_::_elem::_m_objectInformation::_7_::_m_axN = 0;
  @sysvar::XCP::RadarFC_Obj::_g_PL_AD_fw_Radar_1R1V_rpc_XilObjBypassingRunnable_XilObjBypassingRunnable_m_pad_radarObjPort_par_out_local::TChangeableMemPool::_::_::_m_arrayPool::_0_::_elem::_m_objectInformation::_7_::_m_ayN = 0;

    //target object moving or not
    if (abs(@target_radar_fc_sim::objdata.obj_velocity_x[7]) != 0)
    {
    @sysvar::XCP::RadarFC_Obj::_g_PL_AD_fw_Radar_1R1V_rpc_XilObjBypassingRunnable_XilObjBypassingRunnable_m_pad_radarObjPort_par_out_local::TChangeableMemPool::_::_::_m_arrayPool::_0_::_elem::_m_objectInformation::_7_::_m_prob1HasBeenObservedMovingN = 126;
    @sysvar::XCP::RadarFC_Obj::_g_PL_AD_fw_Radar_1R1V_rpc_XilObjBypassingRunnable_XilObjBypassingRunnable_m_pad_radarObjPort_par_out_local::TChangeableMemPool::_::_::_m_arrayPool::_0_::_elem::_m_objectInformation::_7_::_m_prob1MovingN = 126;
    }
    else
    {
    @sysvar::XCP::RadarFC_Obj::_g_PL_AD_fw_Radar_1R1V_rpc_XilObjBypassingRunnable_XilObjBypassingRunnable_m_pad_radarObjPort_par_out_local::TChangeableMemPool::_::_::_m_arrayPool::_0_::_elem::_m_objectInformation::_7_::_m_prob1HasBeenObservedMovingN = 0;
    @sysvar::XCP::RadarFC_Obj::_g_PL_AD_fw_Radar_1R1V_rpc_XilObjBypassingRunnable_XilObjBypassingRunnable_m_pad_radarObjPort_par_out_local::TChangeableMemPool::_::_::_m_arrayPool::_0_::_elem::_m_objectInformation::_7_::_m_prob1MovingN = 0;
    }

      //object classification
    switch (@target_radar_fc_sim::objdata.obj_type[7])
    {
      case 0: //"Non-Obstacle"
      @sysvar::XCP::RadarFC_Obj::_g_PL_AD_fw_Radar_1R1V_rpc_XilObjBypassingRunnable_XilObjBypassingRunnable_m_pad_radarObjPort_par_out_local::TChangeableMemPool::_::_::_m_arrayPool::_0_::_elem::_m_objectInformation::_7_::_m_perObjectType::_m_prob1ObstacleN = 0;
      @sysvar::XCP::RadarFC_Obj::_g_PL_AD_fw_Radar_1R1V_rpc_XilObjBypassingRunnable_XilObjBypassingRunnable_m_pad_radarObjPort_par_out_local::TChangeableMemPool::_::_::_m_arrayPool::_0_::_elem::_m_objectInformation::_7_::_m_perObjectType::_m_prob1NonObstacleN = 128;
      @sysvar::XCP::RadarFC_Obj::_g_PL_AD_fw_Radar_1R1V_rpc_XilObjBypassingRunnable_XilObjBypassingRunnable_m_pad_radarObjPort_par_out_local::TChangeableMemPool::_::_::_m_arrayPool::_0_::_elem::_m_objectInformation::_7_::_m_perObjectType::_m_prob1UnknownN = 0;
      @sysvar::XCP::RadarFC_Obj::_g_PL_AD_fw_Radar_1R1V_rpc_XilObjBypassingRunnable_XilObjBypassingRunnable_m_pad_radarObjPort_par_out_local::TChangeableMemPool::_::_::_m_arrayPool::_0_::_elem::_m_objectInformation::_7_::_m_perObjectType::_m_prob1MobileN = 0;
      @sysvar::XCP::RadarFC_Obj::_g_PL_AD_fw_Radar_1R1V_rpc_XilObjBypassingRunnable_XilObjBypassingRunnable_m_pad_radarObjPort_par_out_local::TChangeableMemPool::_::_::_m_arrayPool::_0_::_elem::_m_objectInformation::_7_::_m_perObjectType::_m_prob1StationaryN = 0;
      @sysvar::XCP::RadarFC_Obj::_g_PL_AD_fw_Radar_1R1V_rpc_XilObjBypassingRunnable_XilObjBypassingRunnable_m_pad_radarObjPort_par_out_local::TChangeableMemPool::_::_::_m_arrayPool::_0_::_elem::_m_objectInformation::_7_::_m_perObjectType::_m_prob1ObstUnknownN = 128;
      @sysvar::XCP::RadarFC_Obj::_g_PL_AD_fw_Radar_1R1V_rpc_XilObjBypassingRunnable_XilObjBypassingRunnable_m_pad_radarObjPort_par_out_local::TChangeableMemPool::_::_::_m_arrayPool::_0_::_elem::_m_objectInformation::_7_::_m_perObjectType::_m_prob1FourPlusWheelerN = 0;
      @sysvar::XCP::RadarFC_Obj::_g_PL_AD_fw_Radar_1R1V_rpc_XilObjBypassingRunnable_XilObjBypassingRunnable_m_pad_radarObjPort_par_out_local::TChangeableMemPool::_::_::_m_arrayPool::_0_::_elem::_m_objectInformation::_7_::_m_perObjectType::_m_prob1TwoWheelerN = 0;
      @sysvar::XCP::RadarFC_Obj::_g_PL_AD_fw_Radar_1R1V_rpc_XilObjBypassingRunnable_XilObjBypassingRunnable_m_pad_radarObjPort_par_out_local::TChangeableMemPool::_::_::_m_arrayPool::_0_::_elem::_m_objectInformation::_7_::_m_perObjectType::_m_prob1PedestrianN = 0;
      @sysvar::XCP::RadarFC_Obj::_g_PL_AD_fw_Radar_1R1V_rpc_XilObjBypassingRunnable_XilObjBypassingRunnable_m_pad_radarObjPort_par_out_local::TChangeableMemPool::_::_::_m_arrayPool::_0_::_elem::_m_objectInformation::_7_::_m_perObjectType::_m_prob1MovUnknownN = 128;
      @sysvar::XCP::RadarFC_Obj::_g_PL_AD_fw_Radar_1R1V_rpc_XilObjBypassingRunnable_XilObjBypassingRunnable_m_pad_radarObjPort_par_out_local::TChangeableMemPool::_::_::_m_arrayPool::_0_::_elem::_m_objectInformation::_7_::_m_perObjectType::_m_prob1RoadsideBarrierN = 0;
      @sysvar::XCP::RadarFC_Obj::_g_PL_AD_fw_Radar_1R1V_rpc_XilObjBypassingRunnable_XilObjBypassingRunnable_m_pad_radarObjPort_par_out_local::TChangeableMemPool::_::_::_m_arrayPool::_0_::_elem::_m_objectInformation::_7_::_m_perObjectType::_m_prob1StatUnknownN = 128;
      @sysvar::XCP::RadarFC_Obj::_g_PL_AD_fw_Radar_1R1V_rpc_XilObjBypassingRunnable_XilObjBypassingRunnable_m_pad_radarObjPort_par_out_local::TChangeableMemPool::_::_::_m_arrayPool::_0_::_elem::_m_objectInformation::_7_::_m_perObjectType::_m_prob1PassengerCarN = 0;
      @sysvar::XCP::RadarFC_Obj::_g_PL_AD_fw_Radar_1R1V_rpc_XilObjBypassingRunnable_XilObjBypassingRunnable_m_pad_radarObjPort_par_out_local::TChangeableMemPool::_::_::_m_arrayPool::_0_::_elem::_m_objectInformation::_7_::_m_perObjectType::_m_prob1TruckN = 0;
      @sysvar::XCP::RadarFC_Obj::_g_PL_AD_fw_Radar_1R1V_rpc_XilObjBypassingRunnable_XilObjBypassingRunnable_m_pad_radarObjPort_par_out_local::TChangeableMemPool::_::_::_m_arrayPool::_0_::_elem::_m_objectInformation::_7_::_m_perObjectType::_m_prob1FourWheelUnknownN = 128;
      @sysvar::XCP::RadarFC_Obj::_g_PL_AD_fw_Radar_1R1V_rpc_XilObjBypassingRunnable_XilObjBypassingRunnable_m_pad_radarObjPort_par_out_local::TChangeableMemPool::_::_::_m_arrayPool::_0_::_elem::_m_objectInformation::_7_::_m_dWidthN = 256;
        break;

      case 1: //"unknown"
      @sysvar::XCP::RadarFC_Obj::_g_PL_AD_fw_Radar_1R1V_rpc_XilObjBypassingRunnable_XilObjBypassingRunnable_m_pad_radarObjPort_par_out_local::TChangeableMemPool::_::_::_m_arrayPool::_0_::_elem::_m_objectInformation::_7_::_m_perObjectType::_m_prob1ObstacleN = 0;
      @sysvar::XCP::RadarFC_Obj::_g_PL_AD_fw_Radar_1R1V_rpc_XilObjBypassingRunnable_XilObjBypassingRunnable_m_pad_radarObjPort_par_out_local::TChangeableMemPool::_::_::_m_arrayPool::_0_::_elem::_m_objectInformation::_7_::_m_perObjectType::_m_prob1NonObstacleN = 0;
      @sysvar::XCP::RadarFC_Obj::_g_PL_AD_fw_Radar_1R1V_rpc_XilObjBypassingRunnable_XilObjBypassingRunnable_m_pad_radarObjPort_par_out_local::TChangeableMemPool::_::_::_m_arrayPool::_0_::_elem::_m_objectInformation::_7_::_m_perObjectType::_m_prob1UnknownN = 128;
      @sysvar::XCP::RadarFC_Obj::_g_PL_AD_fw_Radar_1R1V_rpc_XilObjBypassingRunnable_XilObjBypassingRunnable_m_pad_radarObjPort_par_out_local::TChangeableMemPool::_::_::_m_arrayPool::_0_::_elem::_m_objectInformation::_7_::_m_perObjectType::_m_prob1MobileN = 0;
      @sysvar::XCP::RadarFC_Obj::_g_PL_AD_fw_Radar_1R1V_rpc_XilObjBypassingRunnable_XilObjBypassingRunnable_m_pad_radarObjPort_par_out_local::TChangeableMemPool::_::_::_m_arrayPool::_0_::_elem::_m_objectInformation::_7_::_m_perObjectType::_m_prob1StationaryN = 0;
      @sysvar::XCP::RadarFC_Obj::_g_PL_AD_fw_Radar_1R1V_rpc_XilObjBypassingRunnable_XilObjBypassingRunnable_m_pad_radarObjPort_par_out_local::TChangeableMemPool::_::_::_m_arrayPool::_0_::_elem::_m_objectInformation::_7_::_m_perObjectType::_m_prob1ObstUnknownN = 128;
      @sysvar::XCP::RadarFC_Obj::_g_PL_AD_fw_Radar_1R1V_rpc_XilObjBypassingRunnable_XilObjBypassingRunnable_m_pad_radarObjPort_par_out_local::TChangeableMemPool::_::_::_m_arrayPool::_0_::_elem::_m_objectInformation::_7_::_m_perObjectType::_m_prob1FourPlusWheelerN = 0;
      @sysvar::XCP::RadarFC_Obj::_g_PL_AD_fw_Radar_1R1V_rpc_XilObjBypassingRunnable_XilObjBypassingRunnable_m_pad_radarObjPort_par_out_local::TChangeableMemPool::_::_::_m_arrayPool::_0_::_elem::_m_objectInformation::_7_::_m_perObjectType::_m_prob1TwoWheelerN = 0;
      @sysvar::XCP::RadarFC_Obj::_g_PL_AD_fw_Radar_1R1V_rpc_XilObjBypassingRunnable_XilObjBypassingRunnable_m_pad_radarObjPort_par_out_local::TChangeableMemPool::_::_::_m_arrayPool::_0_::_elem::_m_objectInformation::_7_::_m_perObjectType::_m_prob1PedestrianN = 0;
      @sysvar::XCP::RadarFC_Obj::_g_PL_AD_fw_Radar_1R1V_rpc_XilObjBypassingRunnable_XilObjBypassingRunnable_m_pad_radarObjPort_par_out_local::TChangeableMemPool::_::_::_m_arrayPool::_0_::_elem::_m_objectInformation::_7_::_m_perObjectType::_m_prob1MovUnknownN = 128;
      @sysvar::XCP::RadarFC_Obj::_g_PL_AD_fw_Radar_1R1V_rpc_XilObjBypassingRunnable_XilObjBypassingRunnable_m_pad_radarObjPort_par_out_local::TChangeableMemPool::_::_::_m_arrayPool::_0_::_elem::_m_objectInformation::_7_::_m_perObjectType::_m_prob1RoadsideBarrierN = 0;
      @sysvar::XCP::RadarFC_Obj::_g_PL_AD_fw_Radar_1R1V_rpc_XilObjBypassingRunnable_XilObjBypassingRunnable_m_pad_radarObjPort_par_out_local::TChangeableMemPool::_::_::_m_arrayPool::_0_::_elem::_m_objectInformation::_7_::_m_perObjectType::_m_prob1StatUnknownN = 128;
      @sysvar::XCP::RadarFC_Obj::_g_PL_AD_fw_Radar_1R1V_rpc_XilObjBypassingRunnable_XilObjBypassingRunnable_m_pad_radarObjPort_par_out_local::TChangeableMemPool::_::_::_m_arrayPool::_0_::_elem::_m_objectInformation::_7_::_m_perObjectType::_m_prob1PassengerCarN = 0;
      @sysvar::XCP::RadarFC_Obj::_g_PL_AD_fw_Radar_1R1V_rpc_XilObjBypassingRunnable_XilObjBypassingRunnable_m_pad_radarObjPort_par_out_local::TChangeableMemPool::_::_::_m_arrayPool::_0_::_elem::_m_objectInformation::_7_::_m_perObjectType::_m_prob1TruckN = 0;
      @sysvar::XCP::RadarFC_Obj::_g_PL_AD_fw_Radar_1R1V_rpc_XilObjBypassingRunnable_XilObjBypassingRunnable_m_pad_radarObjPort_par_out_local::TChangeableMemPool::_::_::_m_arrayPool::_0_::_elem::_m_objectInformation::_7_::_m_perObjectType::_m_prob1FourWheelUnknownN = 128;
      @sysvar::XCP::RadarFC_Obj::_g_PL_AD_fw_Radar_1R1V_rpc_XilObjBypassingRunnable_XilObjBypassingRunnable_m_pad_radarObjPort_par_out_local::TChangeableMemPool::_::_::_m_arrayPool::_0_::_elem::_m_objectInformation::_7_::_m_dWidthN = 256;
        break;

      case 2: //"RoadSideBarrier"
      @sysvar::XCP::RadarFC_Obj::_g_PL_AD_fw_Radar_1R1V_rpc_XilObjBypassingRunnable_XilObjBypassingRunnable_m_pad_radarObjPort_par_out_local::TChangeableMemPool::_::_::_m_arrayPool::_0_::_elem::_m_objectInformation::_7_::_m_perObjectType::_m_prob1ObstacleN = 128;
      @sysvar::XCP::RadarFC_Obj::_g_PL_AD_fw_Radar_1R1V_rpc_XilObjBypassingRunnable_XilObjBypassingRunnable_m_pad_radarObjPort_par_out_local::TChangeableMemPool::_::_::_m_arrayPool::_0_::_elem::_m_objectInformation::_7_::_m_perObjectType::_m_prob1NonObstacleN = 0;
      @sysvar::XCP::RadarFC_Obj::_g_PL_AD_fw_Radar_1R1V_rpc_XilObjBypassingRunnable_XilObjBypassingRunnable_m_pad_radarObjPort_par_out_local::TChangeableMemPool::_::_::_m_arrayPool::_0_::_elem::_m_objectInformation::_7_::_m_perObjectType::_m_prob1UnknownN = 0;
      @sysvar::XCP::RadarFC_Obj::_g_PL_AD_fw_Radar_1R1V_rpc_XilObjBypassingRunnable_XilObjBypassingRunnable_m_pad_radarObjPort_par_out_local::TChangeableMemPool::_::_::_m_arrayPool::_0_::_elem::_m_objectInformation::_7_::_m_perObjectType::_m_prob1MobileN = 0;
      @sysvar::XCP::RadarFC_Obj::_g_PL_AD_fw_Radar_1R1V_rpc_XilObjBypassingRunnable_XilObjBypassingRunnable_m_pad_radarObjPort_par_out_local::TChangeableMemPool::_::_::_m_arrayPool::_0_::_elem::_m_objectInformation::_7_::_m_perObjectType::_m_prob1StationaryN = 128;
      @sysvar::XCP::RadarFC_Obj::_g_PL_AD_fw_Radar_1R1V_rpc_XilObjBypassingRunnable_XilObjBypassingRunnable_m_pad_radarObjPort_par_out_local::TChangeableMemPool::_::_::_m_arrayPool::_0_::_elem::_m_objectInformation::_7_::_m_perObjectType::_m_prob1ObstUnknownN = 0;
      @sysvar::XCP::RadarFC_Obj::_g_PL_AD_fw_Radar_1R1V_rpc_XilObjBypassingRunnable_XilObjBypassingRunnable_m_pad_radarObjPort_par_out_local::TChangeableMemPool::_::_::_m_arrayPool::_0_::_elem::_m_objectInformation::_7_::_m_perObjectType::_m_prob1FourPlusWheelerN = 0;
      @sysvar::XCP::RadarFC_Obj::_g_PL_AD_fw_Radar_1R1V_rpc_XilObjBypassingRunnable_XilObjBypassingRunnable_m_pad_radarObjPort_par_out_local::TChangeableMemPool::_::_::_m_arrayPool::_0_::_elem::_m_objectInformation::_7_::_m_perObjectType::_m_prob1TwoWheelerN = 0;
      @sysvar::XCP::RadarFC_Obj::_g_PL_AD_fw_Radar_1R1V_rpc_XilObjBypassingRunnable_XilObjBypassingRunnable_m_pad_radarObjPort_par_out_local::TChangeableMemPool::_::_::_m_arrayPool::_0_::_elem::_m_objectInformation::_7_::_m_perObjectType::_m_prob1PedestrianN = 0;
      @sysvar::XCP::RadarFC_Obj::_g_PL_AD_fw_Radar_1R1V_rpc_XilObjBypassingRunnable_XilObjBypassingRunnable_m_pad_radarObjPort_par_out_local::TChangeableMemPool::_::_::_m_arrayPool::_0_::_elem::_m_objectInformation::_7_::_m_perObjectType::_m_prob1MovUnknownN = 128;
      @sysvar::XCP::RadarFC_Obj::_g_PL_AD_fw_Radar_1R1V_rpc_XilObjBypassingRunnable_XilObjBypassingRunnable_m_pad_radarObjPort_par_out_local::TChangeableMemPool::_::_::_m_arrayPool::_0_::_elem::_m_objectInformation::_7_::_m_perObjectType::_m_prob1RoadsideBarrierN = 128;
      @sysvar::XCP::RadarFC_Obj::_g_PL_AD_fw_Radar_1R1V_rpc_XilObjBypassingRunnable_XilObjBypassingRunnable_m_pad_radarObjPort_par_out_local::TChangeableMemPool::_::_::_m_arrayPool::_0_::_elem::_m_objectInformation::_7_::_m_perObjectType::_m_prob1StatUnknownN = 0;
      @sysvar::XCP::RadarFC_Obj::_g_PL_AD_fw_Radar_1R1V_rpc_XilObjBypassingRunnable_XilObjBypassingRunnable_m_pad_radarObjPort_par_out_local::TChangeableMemPool::_::_::_m_arrayPool::_0_::_elem::_m_objectInformation::_7_::_m_perObjectType::_m_prob1PassengerCarN = 0;
      @sysvar::XCP::RadarFC_Obj::_g_PL_AD_fw_Radar_1R1V_rpc_XilObjBypassingRunnable_XilObjBypassingRunnable_m_pad_radarObjPort_par_out_local::TChangeableMemPool::_::_::_m_arrayPool::_0_::_elem::_m_objectInformation::_7_::_m_perObjectType::_m_prob1TruckN = 0;
      @sysvar::XCP::RadarFC_Obj::_g_PL_AD_fw_Radar_1R1V_rpc_XilObjBypassingRunnable_XilObjBypassingRunnable_m_pad_radarObjPort_par_out_local::TChangeableMemPool::_::_::_m_arrayPool::_0_::_elem::_m_objectInformation::_7_::_m_perObjectType::_m_prob1FourWheelUnknownN = 128;
      @sysvar::XCP::RadarFC_Obj::_g_PL_AD_fw_Radar_1R1V_rpc_XilObjBypassingRunnable_XilObjBypassingRunnable_m_pad_radarObjPort_par_out_local::TChangeableMemPool::_::_::_m_arrayPool::_0_::_elem::_m_objectInformation::_7_::_m_dWidthN = 256;
        break;

      case 3: //"2Wheeler"
      @sysvar::XCP::RadarFC_Obj::_g_PL_AD_fw_Radar_1R1V_rpc_XilObjBypassingRunnable_XilObjBypassingRunnable_m_pad_radarObjPort_par_out_local::TChangeableMemPool::_::_::_m_arrayPool::_0_::_elem::_m_objectInformation::_7_::_m_perObjectType::_m_prob1ObstacleN = 128;
      @sysvar::XCP::RadarFC_Obj::_g_PL_AD_fw_Radar_1R1V_rpc_XilObjBypassingRunnable_XilObjBypassingRunnable_m_pad_radarObjPort_par_out_local::TChangeableMemPool::_::_::_m_arrayPool::_0_::_elem::_m_objectInformation::_7_::_m_perObjectType::_m_prob1NonObstacleN = 0;
      @sysvar::XCP::RadarFC_Obj::_g_PL_AD_fw_Radar_1R1V_rpc_XilObjBypassingRunnable_XilObjBypassingRunnable_m_pad_radarObjPort_par_out_local::TChangeableMemPool::_::_::_m_arrayPool::_0_::_elem::_m_objectInformation::_7_::_m_perObjectType::_m_prob1UnknownN = 0;
      @sysvar::XCP::RadarFC_Obj::_g_PL_AD_fw_Radar_1R1V_rpc_XilObjBypassingRunnable_XilObjBypassingRunnable_m_pad_radarObjPort_par_out_local::TChangeableMemPool::_::_::_m_arrayPool::_0_::_elem::_m_objectInformation::_7_::_m_perObjectType::_m_prob1MobileN = 128;
      @sysvar::XCP::RadarFC_Obj::_g_PL_AD_fw_Radar_1R1V_rpc_XilObjBypassingRunnable_XilObjBypassingRunnable_m_pad_radarObjPort_par_out_local::TChangeableMemPool::_::_::_m_arrayPool::_0_::_elem::_m_objectInformation::_7_::_m_perObjectType::_m_prob1StationaryN = 0;
      @sysvar::XCP::RadarFC_Obj::_g_PL_AD_fw_Radar_1R1V_rpc_XilObjBypassingRunnable_XilObjBypassingRunnable_m_pad_radarObjPort_par_out_local::TChangeableMemPool::_::_::_m_arrayPool::_0_::_elem::_m_objectInformation::_7_::_m_perObjectType::_m_prob1ObstUnknownN = 0;
      @sysvar::XCP::RadarFC_Obj::_g_PL_AD_fw_Radar_1R1V_rpc_XilObjBypassingRunnable_XilObjBypassingRunnable_m_pad_radarObjPort_par_out_local::TChangeableMemPool::_::_::_m_arrayPool::_0_::_elem::_m_objectInformation::_7_::_m_perObjectType::_m_prob1FourPlusWheelerN = 0;
      @sysvar::XCP::RadarFC_Obj::_g_PL_AD_fw_Radar_1R1V_rpc_XilObjBypassingRunnable_XilObjBypassingRunnable_m_pad_radarObjPort_par_out_local::TChangeableMemPool::_::_::_m_arrayPool::_0_::_elem::_m_objectInformation::_7_::_m_perObjectType::_m_prob1TwoWheelerN = 128;
      @sysvar::XCP::RadarFC_Obj::_g_PL_AD_fw_Radar_1R1V_rpc_XilObjBypassingRunnable_XilObjBypassingRunnable_m_pad_radarObjPort_par_out_local::TChangeableMemPool::_::_::_m_arrayPool::_0_::_elem::_m_objectInformation::_7_::_m_perObjectType::_m_prob1PedestrianN = 0;
      @sysvar::XCP::RadarFC_Obj::_g_PL_AD_fw_Radar_1R1V_rpc_XilObjBypassingRunnable_XilObjBypassingRunnable_m_pad_radarObjPort_par_out_local::TChangeableMemPool::_::_::_m_arrayPool::_0_::_elem::_m_objectInformation::_7_::_m_perObjectType::_m_prob1MovUnknownN = 0;
      @sysvar::XCP::RadarFC_Obj::_g_PL_AD_fw_Radar_1R1V_rpc_XilObjBypassingRunnable_XilObjBypassingRunnable_m_pad_radarObjPort_par_out_local::TChangeableMemPool::_::_::_m_arrayPool::_0_::_elem::_m_objectInformation::_7_::_m_perObjectType::_m_prob1RoadsideBarrierN = 0;
      @sysvar::XCP::RadarFC_Obj::_g_PL_AD_fw_Radar_1R1V_rpc_XilObjBypassingRunnable_XilObjBypassingRunnable_m_pad_radarObjPort_par_out_local::TChangeableMemPool::_::_::_m_arrayPool::_0_::_elem::_m_objectInformation::_7_::_m_perObjectType::_m_prob1StatUnknownN = 128;
      @sysvar::XCP::RadarFC_Obj::_g_PL_AD_fw_Radar_1R1V_rpc_XilObjBypassingRunnable_XilObjBypassingRunnable_m_pad_radarObjPort_par_out_local::TChangeableMemPool::_::_::_m_arrayPool::_0_::_elem::_m_objectInformation::_7_::_m_perObjectType::_m_prob1PassengerCarN = 0;
      @sysvar::XCP::RadarFC_Obj::_g_PL_AD_fw_Radar_1R1V_rpc_XilObjBypassingRunnable_XilObjBypassingRunnable_m_pad_radarObjPort_par_out_local::TChangeableMemPool::_::_::_m_arrayPool::_0_::_elem::_m_objectInformation::_7_::_m_perObjectType::_m_prob1TruckN = 0;
      @sysvar::XCP::RadarFC_Obj::_g_PL_AD_fw_Radar_1R1V_rpc_XilObjBypassingRunnable_XilObjBypassingRunnable_m_pad_radarObjPort_par_out_local::TChangeableMemPool::_::_::_m_arrayPool::_0_::_elem::_m_objectInformation::_7_::_m_perObjectType::_m_prob1FourWheelUnknownN = 128;
      @sysvar::XCP::RadarFC_Obj::_g_PL_AD_fw_Radar_1R1V_rpc_XilObjBypassingRunnable_XilObjBypassingRunnable_m_pad_radarObjPort_par_out_local::TChangeableMemPool::_::_::_m_arrayPool::_0_::_elem::_m_objectInformation::_7_::_m_dWidthN = 64;
        break;

      case 4: //"Pedestrian"
      @sysvar::XCP::RadarFC_Obj::_g_PL_AD_fw_Radar_1R1V_rpc_XilObjBypassingRunnable_XilObjBypassingRunnable_m_pad_radarObjPort_par_out_local::TChangeableMemPool::_::_::_m_arrayPool::_0_::_elem::_m_objectInformation::_7_::_m_perObjectType::_m_prob1ObstacleN = 128;
      @sysvar::XCP::RadarFC_Obj::_g_PL_AD_fw_Radar_1R1V_rpc_XilObjBypassingRunnable_XilObjBypassingRunnable_m_pad_radarObjPort_par_out_local::TChangeableMemPool::_::_::_m_arrayPool::_0_::_elem::_m_objectInformation::_7_::_m_perObjectType::_m_prob1NonObstacleN = 0;
      @sysvar::XCP::RadarFC_Obj::_g_PL_AD_fw_Radar_1R1V_rpc_XilObjBypassingRunnable_XilObjBypassingRunnable_m_pad_radarObjPort_par_out_local::TChangeableMemPool::_::_::_m_arrayPool::_0_::_elem::_m_objectInformation::_7_::_m_perObjectType::_m_prob1UnknownN = 0;
      @sysvar::XCP::RadarFC_Obj::_g_PL_AD_fw_Radar_1R1V_rpc_XilObjBypassingRunnable_XilObjBypassingRunnable_m_pad_radarObjPort_par_out_local::TChangeableMemPool::_::_::_m_arrayPool::_0_::_elem::_m_objectInformation::_7_::_m_perObjectType::_m_prob1MobileN = 128;
      @sysvar::XCP::RadarFC_Obj::_g_PL_AD_fw_Radar_1R1V_rpc_XilObjBypassingRunnable_XilObjBypassingRunnable_m_pad_radarObjPort_par_out_local::TChangeableMemPool::_::_::_m_arrayPool::_0_::_elem::_m_objectInformation::_7_::_m_perObjectType::_m_prob1StationaryN = 0;
      @sysvar::XCP::RadarFC_Obj::_g_PL_AD_fw_Radar_1R1V_rpc_XilObjBypassingRunnable_XilObjBypassingRunnable_m_pad_radarObjPort_par_out_local::TChangeableMemPool::_::_::_m_arrayPool::_0_::_elem::_m_objectInformation::_7_::_m_perObjectType::_m_prob1ObstUnknownN = 0;
      @sysvar::XCP::RadarFC_Obj::_g_PL_AD_fw_Radar_1R1V_rpc_XilObjBypassingRunnable_XilObjBypassingRunnable_m_pad_radarObjPort_par_out_local::TChangeableMemPool::_::_::_m_arrayPool::_0_::_elem::_m_objectInformation::_7_::_m_perObjectType::_m_prob1FourPlusWheelerN = 0;
      @sysvar::XCP::RadarFC_Obj::_g_PL_AD_fw_Radar_1R1V_rpc_XilObjBypassingRunnable_XilObjBypassingRunnable_m_pad_radarObjPort_par_out_local::TChangeableMemPool::_::_::_m_arrayPool::_0_::_elem::_m_objectInformation::_7_::_m_perObjectType::_m_prob1TwoWheelerN = 0;
      @sysvar::XCP::RadarFC_Obj::_g_PL_AD_fw_Radar_1R1V_rpc_XilObjBypassingRunnable_XilObjBypassingRunnable_m_pad_radarObjPort_par_out_local::TChangeableMemPool::_::_::_m_arrayPool::_0_::_elem::_m_objectInformation::_7_::_m_perObjectType::_m_prob1PedestrianN = 128;
      @sysvar::XCP::RadarFC_Obj::_g_PL_AD_fw_Radar_1R1V_rpc_XilObjBypassingRunnable_XilObjBypassingRunnable_m_pad_radarObjPort_par_out_local::TChangeableMemPool::_::_::_m_arrayPool::_0_::_elem::_m_objectInformation::_7_::_m_perObjectType::_m_prob1MovUnknownN = 0;
      @sysvar::XCP::RadarFC_Obj::_g_PL_AD_fw_Radar_1R1V_rpc_XilObjBypassingRunnable_XilObjBypassingRunnable_m_pad_radarObjPort_par_out_local::TChangeableMemPool::_::_::_m_arrayPool::_0_::_elem::_m_objectInformation::_7_::_m_perObjectType::_m_prob1RoadsideBarrierN = 0;
      @sysvar::XCP::RadarFC_Obj::_g_PL_AD_fw_Radar_1R1V_rpc_XilObjBypassingRunnable_XilObjBypassingRunnable_m_pad_radarObjPort_par_out_local::TChangeableMemPool::_::_::_m_arrayPool::_0_::_elem::_m_objectInformation::_7_::_m_perObjectType::_m_prob1StatUnknownN = 128;
      @sysvar::XCP::RadarFC_Obj::_g_PL_AD_fw_Radar_1R1V_rpc_XilObjBypassingRunnable_XilObjBypassingRunnable_m_pad_radarObjPort_par_out_local::TChangeableMemPool::_::_::_m_arrayPool::_0_::_elem::_m_objectInformation::_7_::_m_perObjectType::_m_prob1PassengerCarN = 0;
      @sysvar::XCP::RadarFC_Obj::_g_PL_AD_fw_Radar_1R1V_rpc_XilObjBypassingRunnable_XilObjBypassingRunnable_m_pad_radarObjPort_par_out_local::TChangeableMemPool::_::_::_m_arrayPool::_0_::_elem::_m_objectInformation::_7_::_m_perObjectType::_m_prob1TruckN = 0;
      @sysvar::XCP::RadarFC_Obj::_g_PL_AD_fw_Radar_1R1V_rpc_XilObjBypassingRunnable_XilObjBypassingRunnable_m_pad_radarObjPort_par_out_local::TChangeableMemPool::_::_::_m_arrayPool::_0_::_elem::_m_objectInformation::_7_::_m_perObjectType::_m_prob1FourWheelUnknownN = 128;
      @sysvar::XCP::RadarFC_Obj::_g_PL_AD_fw_Radar_1R1V_rpc_XilObjBypassingRunnable_XilObjBypassingRunnable_m_pad_radarObjPort_par_out_local::TChangeableMemPool::_::_::_m_arrayPool::_0_::_elem::_m_objectInformation::_7_::_m_dWidthN = 64;
        break;

      case 5: //"Truck"
      @sysvar::XCP::RadarFC_Obj::_g_PL_AD_fw_Radar_1R1V_rpc_XilObjBypassingRunnable_XilObjBypassingRunnable_m_pad_radarObjPort_par_out_local::TChangeableMemPool::_::_::_m_arrayPool::_0_::_elem::_m_objectInformation::_7_::_m_perObjectType::_m_prob1ObstacleN = 128;
      @sysvar::XCP::RadarFC_Obj::_g_PL_AD_fw_Radar_1R1V_rpc_XilObjBypassingRunnable_XilObjBypassingRunnable_m_pad_radarObjPort_par_out_local::TChangeableMemPool::_::_::_m_arrayPool::_0_::_elem::_m_objectInformation::_7_::_m_perObjectType::_m_prob1NonObstacleN = 0;
      @sysvar::XCP::RadarFC_Obj::_g_PL_AD_fw_Radar_1R1V_rpc_XilObjBypassingRunnable_XilObjBypassingRunnable_m_pad_radarObjPort_par_out_local::TChangeableMemPool::_::_::_m_arrayPool::_0_::_elem::_m_objectInformation::_7_::_m_perObjectType::_m_prob1UnknownN = 0;
      @sysvar::XCP::RadarFC_Obj::_g_PL_AD_fw_Radar_1R1V_rpc_XilObjBypassingRunnable_XilObjBypassingRunnable_m_pad_radarObjPort_par_out_local::TChangeableMemPool::_::_::_m_arrayPool::_0_::_elem::_m_objectInformation::_7_::_m_perObjectType::_m_prob1MobileN = 128;
      @sysvar::XCP::RadarFC_Obj::_g_PL_AD_fw_Radar_1R1V_rpc_XilObjBypassingRunnable_XilObjBypassingRunnable_m_pad_radarObjPort_par_out_local::TChangeableMemPool::_::_::_m_arrayPool::_0_::_elem::_m_objectInformation::_7_::_m_perObjectType::_m_prob1StationaryN = 0;
      @sysvar::XCP::RadarFC_Obj::_g_PL_AD_fw_Radar_1R1V_rpc_XilObjBypassingRunnable_XilObjBypassingRunnable_m_pad_radarObjPort_par_out_local::TChangeableMemPool::_::_::_m_arrayPool::_0_::_elem::_m_objectInformation::_7_::_m_perObjectType::_m_prob1ObstUnknownN = 0;
      @sysvar::XCP::RadarFC_Obj::_g_PL_AD_fw_Radar_1R1V_rpc_XilObjBypassingRunnable_XilObjBypassingRunnable_m_pad_radarObjPort_par_out_local::TChangeableMemPool::_::_::_m_arrayPool::_0_::_elem::_m_objectInformation::_7_::_m_perObjectType::_m_prob1FourPlusWheelerN = 128;
      @sysvar::XCP::RadarFC_Obj::_g_PL_AD_fw_Radar_1R1V_rpc_XilObjBypassingRunnable_XilObjBypassingRunnable_m_pad_radarObjPort_par_out_local::TChangeableMemPool::_::_::_m_arrayPool::_0_::_elem::_m_objectInformation::_7_::_m_perObjectType::_m_prob1TwoWheelerN = 0;
      @sysvar::XCP::RadarFC_Obj::_g_PL_AD_fw_Radar_1R1V_rpc_XilObjBypassingRunnable_XilObjBypassingRunnable_m_pad_radarObjPort_par_out_local::TChangeableMemPool::_::_::_m_arrayPool::_0_::_elem::_m_objectInformation::_7_::_m_perObjectType::_m_prob1PedestrianN = 0;
      @sysvar::XCP::RadarFC_Obj::_g_PL_AD_fw_Radar_1R1V_rpc_XilObjBypassingRunnable_XilObjBypassingRunnable_m_pad_radarObjPort_par_out_local::TChangeableMemPool::_::_::_m_arrayPool::_0_::_elem::_m_objectInformation::_7_::_m_perObjectType::_m_prob1MovUnknownN = 0;
      @sysvar::XCP::RadarFC_Obj::_g_PL_AD_fw_Radar_1R1V_rpc_XilObjBypassingRunnable_XilObjBypassingRunnable_m_pad_radarObjPort_par_out_local::TChangeableMemPool::_::_::_m_arrayPool::_0_::_elem::_m_objectInformation::_7_::_m_perObjectType::_m_prob1RoadsideBarrierN = 0;
      @sysvar::XCP::RadarFC_Obj::_g_PL_AD_fw_Radar_1R1V_rpc_XilObjBypassingRunnable_XilObjBypassingRunnable_m_pad_radarObjPort_par_out_local::TChangeableMemPool::_::_::_m_arrayPool::_0_::_elem::_m_objectInformation::_7_::_m_perObjectType::_m_prob1StatUnknownN = 128;
      @sysvar::XCP::RadarFC_Obj::_g_PL_AD_fw_Radar_1R1V_rpc_XilObjBypassingRunnable_XilObjBypassingRunnable_m_pad_radarObjPort_par_out_local::TChangeableMemPool::_::_::_m_arrayPool::_0_::_elem::_m_objectInformation::_7_::_m_perObjectType::_m_prob1PassengerCarN = 0;
      @sysvar::XCP::RadarFC_Obj::_g_PL_AD_fw_Radar_1R1V_rpc_XilObjBypassingRunnable_XilObjBypassingRunnable_m_pad_radarObjPort_par_out_local::TChangeableMemPool::_::_::_m_arrayPool::_0_::_elem::_m_objectInformation::_7_::_m_perObjectType::_m_prob1TruckN = 128;
      @sysvar::XCP::RadarFC_Obj::_g_PL_AD_fw_Radar_1R1V_rpc_XilObjBypassingRunnable_XilObjBypassingRunnable_m_pad_radarObjPort_par_out_local::TChangeableMemPool::_::_::_m_arrayPool::_0_::_elem::_m_objectInformation::_7_::_m_perObjectType::_m_prob1FourWheelUnknownN = 0;
      @sysvar::XCP::RadarFC_Obj::_g_PL_AD_fw_Radar_1R1V_rpc_XilObjBypassingRunnable_XilObjBypassingRunnable_m_pad_radarObjPort_par_out_local::TChangeableMemPool::_::_::_m_arrayPool::_0_::_elem::_m_objectInformation::_7_::_m_dWidthN = 256;
        break;

      case 6: //"PassengerCar"
      @sysvar::XCP::RadarFC_Obj::_g_PL_AD_fw_Radar_1R1V_rpc_XilObjBypassingRunnable_XilObjBypassingRunnable_m_pad_radarObjPort_par_out_local::TChangeableMemPool::_::_::_m_arrayPool::_0_::_elem::_m_objectInformation::_7_::_m_perObjectType::_m_prob1ObstacleN = 128;
      @sysvar::XCP::RadarFC_Obj::_g_PL_AD_fw_Radar_1R1V_rpc_XilObjBypassingRunnable_XilObjBypassingRunnable_m_pad_radarObjPort_par_out_local::TChangeableMemPool::_::_::_m_arrayPool::_0_::_elem::_m_objectInformation::_7_::_m_perObjectType::_m_prob1NonObstacleN = 0;
      @sysvar::XCP::RadarFC_Obj::_g_PL_AD_fw_Radar_1R1V_rpc_XilObjBypassingRunnable_XilObjBypassingRunnable_m_pad_radarObjPort_par_out_local::TChangeableMemPool::_::_::_m_arrayPool::_0_::_elem::_m_objectInformation::_7_::_m_perObjectType::_m_prob1UnknownN = 0;
      @sysvar::XCP::RadarFC_Obj::_g_PL_AD_fw_Radar_1R1V_rpc_XilObjBypassingRunnable_XilObjBypassingRunnable_m_pad_radarObjPort_par_out_local::TChangeableMemPool::_::_::_m_arrayPool::_0_::_elem::_m_objectInformation::_7_::_m_perObjectType::_m_prob1MobileN = 128;
      @sysvar::XCP::RadarFC_Obj::_g_PL_AD_fw_Radar_1R1V_rpc_XilObjBypassingRunnable_XilObjBypassingRunnable_m_pad_radarObjPort_par_out_local::TChangeableMemPool::_::_::_m_arrayPool::_0_::_elem::_m_objectInformation::_7_::_m_perObjectType::_m_prob1StationaryN = 0;
      @sysvar::XCP::RadarFC_Obj::_g_PL_AD_fw_Radar_1R1V_rpc_XilObjBypassingRunnable_XilObjBypassingRunnable_m_pad_radarObjPort_par_out_local::TChangeableMemPool::_::_::_m_arrayPool::_0_::_elem::_m_objectInformation::_7_::_m_perObjectType::_m_prob1ObstUnknownN = 0;
      @sysvar::XCP::RadarFC_Obj::_g_PL_AD_fw_Radar_1R1V_rpc_XilObjBypassingRunnable_XilObjBypassingRunnable_m_pad_radarObjPort_par_out_local::TChangeableMemPool::_::_::_m_arrayPool::_0_::_elem::_m_objectInformation::_7_::_m_perObjectType::_m_prob1FourPlusWheelerN = 128;
      @sysvar::XCP::RadarFC_Obj::_g_PL_AD_fw_Radar_1R1V_rpc_XilObjBypassingRunnable_XilObjBypassingRunnable_m_pad_radarObjPort_par_out_local::TChangeableMemPool::_::_::_m_arrayPool::_0_::_elem::_m_objectInformation::_7_::_m_perObjectType::_m_prob1TwoWheelerN = 0;
      @sysvar::XCP::RadarFC_Obj::_g_PL_AD_fw_Radar_1R1V_rpc_XilObjBypassingRunnable_XilObjBypassingRunnable_m_pad_radarObjPort_par_out_local::TChangeableMemPool::_::_::_m_arrayPool::_0_::_elem::_m_objectInformation::_7_::_m_perObjectType::_m_prob1PedestrianN = 0;
      @sysvar::XCP::RadarFC_Obj::_g_PL_AD_fw_Radar_1R1V_rpc_XilObjBypassingRunnable_XilObjBypassingRunnable_m_pad_radarObjPort_par_out_local::TChangeableMemPool::_::_::_m_arrayPool::_0_::_elem::_m_objectInformation::_7_::_m_perObjectType::_m_prob1MovUnknownN = 0;
      @sysvar::XCP::RadarFC_Obj::_g_PL_AD_fw_Radar_1R1V_rpc_XilObjBypassingRunnable_XilObjBypassingRunnable_m_pad_radarObjPort_par_out_local::TChangeableMemPool::_::_::_m_arrayPool::_0_::_elem::_m_objectInformation::_7_::_m_perObjectType::_m_prob1RoadsideBarrierN = 0;
      @sysvar::XCP::RadarFC_Obj::_g_PL_AD_fw_Radar_1R1V_rpc_XilObjBypassingRunnable_XilObjBypassingRunnable_m_pad_radarObjPort_par_out_local::TChangeableMemPool::_::_::_m_arrayPool::_0_::_elem::_m_objectInformation::_7_::_m_perObjectType::_m_prob1StatUnknownN = 128;
      @sysvar::XCP::RadarFC_Obj::_g_PL_AD_fw_Radar_1R1V_rpc_XilObjBypassingRunnable_XilObjBypassingRunnable_m_pad_radarObjPort_par_out_local::TChangeableMemPool::_::_::_m_arrayPool::_0_::_elem::_m_objectInformation::_7_::_m_perObjectType::_m_prob1PassengerCarN = 128;
      @sysvar::XCP::RadarFC_Obj::_g_PL_AD_fw_Radar_1R1V_rpc_XilObjBypassingRunnable_XilObjBypassingRunnable_m_pad_radarObjPort_par_out_local::TChangeableMemPool::_::_::_m_arrayPool::_0_::_elem::_m_objectInformation::_7_::_m_perObjectType::_m_prob1TruckN = 0;
      @sysvar::XCP::RadarFC_Obj::_g_PL_AD_fw_Radar_1R1V_rpc_XilObjBypassingRunnable_XilObjBypassingRunnable_m_pad_radarObjPort_par_out_local::TChangeableMemPool::_::_::_m_arrayPool::_0_::_elem::_m_objectInformation::_7_::_m_perObjectType::_m_prob1FourWheelUnknownN = 0;
      @sysvar::XCP::RadarFC_Obj::_g_PL_AD_fw_Radar_1R1V_rpc_XilObjBypassingRunnable_XilObjBypassingRunnable_m_pad_radarObjPort_par_out_local::TChangeableMemPool::_::_::_m_arrayPool::_0_::_elem::_m_objectInformation::_7_::_m_dWidthN = 256;
        break;
    }
    break;

    case 8: //"Object-8"
    //constant
  @sysvar::XCP::RadarFC_Obj::_g_PL_AD_fw_Radar_1R1V_rpc_XilObjBypassingRunnable_XilObjBypassingRunnable_m_pad_radarObjPort_par_out_local::TChangeableMemPool::_::_::_m_arrayPool::_0_::_elem::_m_objectInformation::_8_::_Valid_b = 1;
  @sysvar::XCP::RadarFC_Obj::_g_PL_AD_fw_Radar_1R1V_rpc_XilObjBypassingRunnable_XilObjBypassingRunnable_m_pad_radarObjPort_par_out_local::TChangeableMemPool::_::_::_m_arrayPool::_0_::_elem::_m_objectInformation::_8_::_m_HandleN = 1;
  @sysvar::XCP::RadarFC_Obj::_g_PL_AD_fw_Radar_1R1V_rpc_XilObjBypassingRunnable_XilObjBypassingRunnable_m_pad_radarObjPort_par_out_local::TChangeableMemPool::_::_::_m_arrayPool::_0_::_elem::_m_objectInformation::_8_::_m_alpPiVarYawAngleN = 0;
  @sysvar::XCP::RadarFC_Obj::_g_PL_AD_fw_Radar_1R1V_rpc_XilObjBypassingRunnable_XilObjBypassingRunnable_m_pad_radarObjPort_par_out_local::TChangeableMemPool::_::_::_m_arrayPool::_0_::_elem::_m_objectInformation::_8_::_m_alpPiYawAngleN = 0;
  @sysvar::XCP::RadarFC_Obj::_g_PL_AD_fw_Radar_1R1V_rpc_XilObjBypassingRunnable_XilObjBypassingRunnable_m_pad_radarObjPort_par_out_local::TChangeableMemPool::_::_::_m_arrayPool::_0_::_elem::_m_objectInformation::_8_::_m_varAxN = 0;
  @sysvar::XCP::RadarFC_Obj::_g_PL_AD_fw_Radar_1R1V_rpc_XilObjBypassingRunnable_XilObjBypassingRunnable_m_pad_radarObjPort_par_out_local::TChangeableMemPool::_::_::_m_arrayPool::_0_::_elem::_m_objectInformation::_8_::_m_varAyN = 0;
  @sysvar::XCP::RadarFC_Obj::_g_PL_AD_fw_Radar_1R1V_rpc_XilObjBypassingRunnable_XilObjBypassingRunnable_m_pad_radarObjPort_par_out_local::TChangeableMemPool::_::_::_m_arrayPool::_0_::_elem::_m_objectInformation::_8_::_m_varVxN = 0;
  @sysvar::XCP::RadarFC_Obj::_g_PL_AD_fw_Radar_1R1V_rpc_XilObjBypassingRunnable_XilObjBypassingRunnable_m_pad_radarObjPort_par_out_local::TChangeableMemPool::_::_::_m_arrayPool::_0_::_elem::_m_objectInformation::_8_::_m_varVyN = 0;
  @sysvar::XCP::RadarFC_Obj::_g_PL_AD_fw_Radar_1R1V_rpc_XilObjBypassingRunnable_XilObjBypassingRunnable_m_pad_radarObjPort_par_out_local::TChangeableMemPool::_::_::_m_arrayPool::_0_::_elem::_m_objectInformation::_8_::_m_varDxN = 0;
  @sysvar::XCP::RadarFC_Obj::_g_PL_AD_fw_Radar_1R1V_rpc_XilObjBypassingRunnable_XilObjBypassingRunnable_m_pad_radarObjPort_par_out_local::TChangeableMemPool::_::_::_m_arrayPool::_0_::_elem::_m_objectInformation::_8_::_m_varDyN = 0;
  @sysvar::XCP::RadarFC_Obj::_g_PL_AD_fw_Radar_1R1V_rpc_XilObjBypassingRunnable_XilObjBypassingRunnable_m_pad_radarObjPort_par_out_local::TChangeableMemPool::_::_::_m_arrayPool::_0_::_elem::_m_objectInformation::_8_::_m_dVarLengthN = 0;
  @sysvar::XCP::RadarFC_Obj::_g_PL_AD_fw_Radar_1R1V_rpc_XilObjBypassingRunnable_XilObjBypassingRunnable_m_pad_radarObjPort_par_out_local::TChangeableMemPool::_::_::_m_arrayPool::_0_::_elem::_m_objectInformation::_8_::_m_dVarWidthN = 0;
  @sysvar::XCP::RadarFC_Obj::_g_PL_AD_fw_Radar_1R1V_rpc_XilObjBypassingRunnable_XilObjBypassingRunnable_m_pad_radarObjPort_par_out_local::TChangeableMemPool::_::_::_m_arrayPool::_0_::_elem::_m_objectInformation::_8_::_m_wExistProbN = 64880;
  @sysvar::XCP::RadarFC_Obj::_g_PL_AD_fw_Radar_1R1V_rpc_XilObjBypassingRunnable_XilObjBypassingRunnable_m_pad_radarObjPort_par_out_local::TChangeableMemPool::_::_::_m_arrayPool::_0_::_elem::_m_objectInformation::_8_::_m_isObjectAsil = 1;
  @sysvar::XCP::RadarFC_Obj::_g_PL_AD_fw_Radar_1R1V_rpc_XilObjBypassingRunnable_XilObjBypassingRunnable_m_pad_radarObjPort_par_out_local::TChangeableMemPool::_::_::_m_arrayPool::_0_::_elem::_m_objectInformation::_8_::_m_dLengthN = 128;

    //target movement

  @sysvar::XCP::RadarFC_Obj::_g_PL_AD_fw_Radar_1R1V_rpc_XilObjBypassingRunnable_XilObjBypassingRunnable_m_pad_radarObjPort_par_out_local::TChangeableMemPool::_::_::_m_arrayPool::_0_::_elem::_m_objectInformation::_8_::_m_dxN = @target_radar_fc_sim::objdata.obj_distance_x[8] * 128;
  @sysvar::XCP::RadarFC_Obj::_g_PL_AD_fw_Radar_1R1V_rpc_XilObjBypassingRunnable_XilObjBypassingRunnable_m_pad_radarObjPort_par_out_local::TChangeableMemPool::_::_::_m_arrayPool::_0_::_elem::_m_objectInformation::_8_::_m_dyN = @target_radar_fc_sim::objdata.obj_distance_y[8] * 128;
  @sysvar::XCP::RadarFC_Obj::_g_PL_AD_fw_Radar_1R1V_rpc_XilObjBypassingRunnable_XilObjBypassingRunnable_m_pad_radarObjPort_par_out_local::TChangeableMemPool::_::_::_m_arrayPool::_0_::_elem::_m_objectInformation::_8_::_m_dzN = 0;
  @sysvar::XCP::RadarFC_Obj::_g_PL_AD_fw_Radar_1R1V_rpc_XilObjBypassingRunnable_XilObjBypassingRunnable_m_pad_radarObjPort_par_out_local::TChangeableMemPool::_::_::_m_arrayPool::_0_::_elem::_m_objectInformation::_8_::_m_vxN = @target_radar_fc_sim::objdata.obj_velocity_x[8] * 256;
  @sysvar::XCP::RadarFC_Obj::_g_PL_AD_fw_Radar_1R1V_rpc_XilObjBypassingRunnable_XilObjBypassingRunnable_m_pad_radarObjPort_par_out_local::TChangeableMemPool::_::_::_m_arrayPool::_0_::_elem::_m_objectInformation::_8_::_m_vyN = @target_radar_fc_sim::objdata.obj_velocity_y[8] * 256;
  @sysvar::XCP::RadarFC_Obj::_g_PL_AD_fw_Radar_1R1V_rpc_XilObjBypassingRunnable_XilObjBypassingRunnable_m_pad_radarObjPort_par_out_local::TChangeableMemPool::_::_::_m_arrayPool::_0_::_elem::_m_objectInformation::_8_::_m_axN = 0;
  @sysvar::XCP::RadarFC_Obj::_g_PL_AD_fw_Radar_1R1V_rpc_XilObjBypassingRunnable_XilObjBypassingRunnable_m_pad_radarObjPort_par_out_local::TChangeableMemPool::_::_::_m_arrayPool::_0_::_elem::_m_objectInformation::_8_::_m_ayN = 0;

    //target object moving or not
    if (abs(@target_radar_fc_sim::objdata.obj_velocity_x[8]) != 0)
    {
    @sysvar::XCP::RadarFC_Obj::_g_PL_AD_fw_Radar_1R1V_rpc_XilObjBypassingRunnable_XilObjBypassingRunnable_m_pad_radarObjPort_par_out_local::TChangeableMemPool::_::_::_m_arrayPool::_0_::_elem::_m_objectInformation::_8_::_m_prob1HasBeenObservedMovingN = 126;
    @sysvar::XCP::RadarFC_Obj::_g_PL_AD_fw_Radar_1R1V_rpc_XilObjBypassingRunnable_XilObjBypassingRunnable_m_pad_radarObjPort_par_out_local::TChangeableMemPool::_::_::_m_arrayPool::_0_::_elem::_m_objectInformation::_8_::_m_prob1MovingN = 126;
    }
    else
    {
    @sysvar::XCP::RadarFC_Obj::_g_PL_AD_fw_Radar_1R1V_rpc_XilObjBypassingRunnable_XilObjBypassingRunnable_m_pad_radarObjPort_par_out_local::TChangeableMemPool::_::_::_m_arrayPool::_0_::_elem::_m_objectInformation::_8_::_m_prob1HasBeenObservedMovingN = 0;
    @sysvar::XCP::RadarFC_Obj::_g_PL_AD_fw_Radar_1R1V_rpc_XilObjBypassingRunnable_XilObjBypassingRunnable_m_pad_radarObjPort_par_out_local::TChangeableMemPool::_::_::_m_arrayPool::_0_::_elem::_m_objectInformation::_8_::_m_prob1MovingN = 0;
    }

      //object classification
    switch (@target_radar_fc_sim::objdata.obj_type[8])
    {
      case 0: //"Non-Obstacle"
      @sysvar::XCP::RadarFC_Obj::_g_PL_AD_fw_Radar_1R1V_rpc_XilObjBypassingRunnable_XilObjBypassingRunnable_m_pad_radarObjPort_par_out_local::TChangeableMemPool::_::_::_m_arrayPool::_0_::_elem::_m_objectInformation::_8_::_m_perObjectType::_m_prob1ObstacleN = 0;
      @sysvar::XCP::RadarFC_Obj::_g_PL_AD_fw_Radar_1R1V_rpc_XilObjBypassingRunnable_XilObjBypassingRunnable_m_pad_radarObjPort_par_out_local::TChangeableMemPool::_::_::_m_arrayPool::_0_::_elem::_m_objectInformation::_8_::_m_perObjectType::_m_prob1NonObstacleN = 128;
      @sysvar::XCP::RadarFC_Obj::_g_PL_AD_fw_Radar_1R1V_rpc_XilObjBypassingRunnable_XilObjBypassingRunnable_m_pad_radarObjPort_par_out_local::TChangeableMemPool::_::_::_m_arrayPool::_0_::_elem::_m_objectInformation::_8_::_m_perObjectType::_m_prob1UnknownN = 0;
      @sysvar::XCP::RadarFC_Obj::_g_PL_AD_fw_Radar_1R1V_rpc_XilObjBypassingRunnable_XilObjBypassingRunnable_m_pad_radarObjPort_par_out_local::TChangeableMemPool::_::_::_m_arrayPool::_0_::_elem::_m_objectInformation::_8_::_m_perObjectType::_m_prob1MobileN = 0;
      @sysvar::XCP::RadarFC_Obj::_g_PL_AD_fw_Radar_1R1V_rpc_XilObjBypassingRunnable_XilObjBypassingRunnable_m_pad_radarObjPort_par_out_local::TChangeableMemPool::_::_::_m_arrayPool::_0_::_elem::_m_objectInformation::_8_::_m_perObjectType::_m_prob1StationaryN = 0;
      @sysvar::XCP::RadarFC_Obj::_g_PL_AD_fw_Radar_1R1V_rpc_XilObjBypassingRunnable_XilObjBypassingRunnable_m_pad_radarObjPort_par_out_local::TChangeableMemPool::_::_::_m_arrayPool::_0_::_elem::_m_objectInformation::_8_::_m_perObjectType::_m_prob1ObstUnknownN = 128;
      @sysvar::XCP::RadarFC_Obj::_g_PL_AD_fw_Radar_1R1V_rpc_XilObjBypassingRunnable_XilObjBypassingRunnable_m_pad_radarObjPort_par_out_local::TChangeableMemPool::_::_::_m_arrayPool::_0_::_elem::_m_objectInformation::_8_::_m_perObjectType::_m_prob1FourPlusWheelerN = 0;
      @sysvar::XCP::RadarFC_Obj::_g_PL_AD_fw_Radar_1R1V_rpc_XilObjBypassingRunnable_XilObjBypassingRunnable_m_pad_radarObjPort_par_out_local::TChangeableMemPool::_::_::_m_arrayPool::_0_::_elem::_m_objectInformation::_8_::_m_perObjectType::_m_prob1TwoWheelerN = 0;
      @sysvar::XCP::RadarFC_Obj::_g_PL_AD_fw_Radar_1R1V_rpc_XilObjBypassingRunnable_XilObjBypassingRunnable_m_pad_radarObjPort_par_out_local::TChangeableMemPool::_::_::_m_arrayPool::_0_::_elem::_m_objectInformation::_8_::_m_perObjectType::_m_prob1PedestrianN = 0;
      @sysvar::XCP::RadarFC_Obj::_g_PL_AD_fw_Radar_1R1V_rpc_XilObjBypassingRunnable_XilObjBypassingRunnable_m_pad_radarObjPort_par_out_local::TChangeableMemPool::_::_::_m_arrayPool::_0_::_elem::_m_objectInformation::_8_::_m_perObjectType::_m_prob1MovUnknownN = 128;
      @sysvar::XCP::RadarFC_Obj::_g_PL_AD_fw_Radar_1R1V_rpc_XilObjBypassingRunnable_XilObjBypassingRunnable_m_pad_radarObjPort_par_out_local::TChangeableMemPool::_::_::_m_arrayPool::_0_::_elem::_m_objectInformation::_8_::_m_perObjectType::_m_prob1RoadsideBarrierN = 0;
      @sysvar::XCP::RadarFC_Obj::_g_PL_AD_fw_Radar_1R1V_rpc_XilObjBypassingRunnable_XilObjBypassingRunnable_m_pad_radarObjPort_par_out_local::TChangeableMemPool::_::_::_m_arrayPool::_0_::_elem::_m_objectInformation::_8_::_m_perObjectType::_m_prob1StatUnknownN = 128;
      @sysvar::XCP::RadarFC_Obj::_g_PL_AD_fw_Radar_1R1V_rpc_XilObjBypassingRunnable_XilObjBypassingRunnable_m_pad_radarObjPort_par_out_local::TChangeableMemPool::_::_::_m_arrayPool::_0_::_elem::_m_objectInformation::_8_::_m_perObjectType::_m_prob1PassengerCarN = 0;
      @sysvar::XCP::RadarFC_Obj::_g_PL_AD_fw_Radar_1R1V_rpc_XilObjBypassingRunnable_XilObjBypassingRunnable_m_pad_radarObjPort_par_out_local::TChangeableMemPool::_::_::_m_arrayPool::_0_::_elem::_m_objectInformation::_8_::_m_perObjectType::_m_prob1TruckN = 0;
      @sysvar::XCP::RadarFC_Obj::_g_PL_AD_fw_Radar_1R1V_rpc_XilObjBypassingRunnable_XilObjBypassingRunnable_m_pad_radarObjPort_par_out_local::TChangeableMemPool::_::_::_m_arrayPool::_0_::_elem::_m_objectInformation::_8_::_m_perObjectType::_m_prob1FourWheelUnknownN = 128;
      @sysvar::XCP::RadarFC_Obj::_g_PL_AD_fw_Radar_1R1V_rpc_XilObjBypassingRunnable_XilObjBypassingRunnable_m_pad_radarObjPort_par_out_local::TChangeableMemPool::_::_::_m_arrayPool::_0_::_elem::_m_objectInformation::_8_::_m_dWidthN = 256;
        break;

      case 1: //"unknown"
      @sysvar::XCP::RadarFC_Obj::_g_PL_AD_fw_Radar_1R1V_rpc_XilObjBypassingRunnable_XilObjBypassingRunnable_m_pad_radarObjPort_par_out_local::TChangeableMemPool::_::_::_m_arrayPool::_0_::_elem::_m_objectInformation::_8_::_m_perObjectType::_m_prob1ObstacleN = 0;
      @sysvar::XCP::RadarFC_Obj::_g_PL_AD_fw_Radar_1R1V_rpc_XilObjBypassingRunnable_XilObjBypassingRunnable_m_pad_radarObjPort_par_out_local::TChangeableMemPool::_::_::_m_arrayPool::_0_::_elem::_m_objectInformation::_8_::_m_perObjectType::_m_prob1NonObstacleN = 0;
      @sysvar::XCP::RadarFC_Obj::_g_PL_AD_fw_Radar_1R1V_rpc_XilObjBypassingRunnable_XilObjBypassingRunnable_m_pad_radarObjPort_par_out_local::TChangeableMemPool::_::_::_m_arrayPool::_0_::_elem::_m_objectInformation::_8_::_m_perObjectType::_m_prob1UnknownN = 128;
      @sysvar::XCP::RadarFC_Obj::_g_PL_AD_fw_Radar_1R1V_rpc_XilObjBypassingRunnable_XilObjBypassingRunnable_m_pad_radarObjPort_par_out_local::TChangeableMemPool::_::_::_m_arrayPool::_0_::_elem::_m_objectInformation::_8_::_m_perObjectType::_m_prob1MobileN = 0;
      @sysvar::XCP::RadarFC_Obj::_g_PL_AD_fw_Radar_1R1V_rpc_XilObjBypassingRunnable_XilObjBypassingRunnable_m_pad_radarObjPort_par_out_local::TChangeableMemPool::_::_::_m_arrayPool::_0_::_elem::_m_objectInformation::_8_::_m_perObjectType::_m_prob1StationaryN = 0;
      @sysvar::XCP::RadarFC_Obj::_g_PL_AD_fw_Radar_1R1V_rpc_XilObjBypassingRunnable_XilObjBypassingRunnable_m_pad_radarObjPort_par_out_local::TChangeableMemPool::_::_::_m_arrayPool::_0_::_elem::_m_objectInformation::_8_::_m_perObjectType::_m_prob1ObstUnknownN = 128;
      @sysvar::XCP::RadarFC_Obj::_g_PL_AD_fw_Radar_1R1V_rpc_XilObjBypassingRunnable_XilObjBypassingRunnable_m_pad_radarObjPort_par_out_local::TChangeableMemPool::_::_::_m_arrayPool::_0_::_elem::_m_objectInformation::_8_::_m_perObjectType::_m_prob1FourPlusWheelerN = 0;
      @sysvar::XCP::RadarFC_Obj::_g_PL_AD_fw_Radar_1R1V_rpc_XilObjBypassingRunnable_XilObjBypassingRunnable_m_pad_radarObjPort_par_out_local::TChangeableMemPool::_::_::_m_arrayPool::_0_::_elem::_m_objectInformation::_8_::_m_perObjectType::_m_prob1TwoWheelerN = 0;
      @sysvar::XCP::RadarFC_Obj::_g_PL_AD_fw_Radar_1R1V_rpc_XilObjBypassingRunnable_XilObjBypassingRunnable_m_pad_radarObjPort_par_out_local::TChangeableMemPool::_::_::_m_arrayPool::_0_::_elem::_m_objectInformation::_8_::_m_perObjectType::_m_prob1PedestrianN = 0;
      @sysvar::XCP::RadarFC_Obj::_g_PL_AD_fw_Radar_1R1V_rpc_XilObjBypassingRunnable_XilObjBypassingRunnable_m_pad_radarObjPort_par_out_local::TChangeableMemPool::_::_::_m_arrayPool::_0_::_elem::_m_objectInformation::_8_::_m_perObjectType::_m_prob1MovUnknownN = 128;
      @sysvar::XCP::RadarFC_Obj::_g_PL_AD_fw_Radar_1R1V_rpc_XilObjBypassingRunnable_XilObjBypassingRunnable_m_pad_radarObjPort_par_out_local::TChangeableMemPool::_::_::_m_arrayPool::_0_::_elem::_m_objectInformation::_8_::_m_perObjectType::_m_prob1RoadsideBarrierN = 0;
      @sysvar::XCP::RadarFC_Obj::_g_PL_AD_fw_Radar_1R1V_rpc_XilObjBypassingRunnable_XilObjBypassingRunnable_m_pad_radarObjPort_par_out_local::TChangeableMemPool::_::_::_m_arrayPool::_0_::_elem::_m_objectInformation::_8_::_m_perObjectType::_m_prob1StatUnknownN = 128;
      @sysvar::XCP::RadarFC_Obj::_g_PL_AD_fw_Radar_1R1V_rpc_XilObjBypassingRunnable_XilObjBypassingRunnable_m_pad_radarObjPort_par_out_local::TChangeableMemPool::_::_::_m_arrayPool::_0_::_elem::_m_objectInformation::_8_::_m_perObjectType::_m_prob1PassengerCarN = 0;
      @sysvar::XCP::RadarFC_Obj::_g_PL_AD_fw_Radar_1R1V_rpc_XilObjBypassingRunnable_XilObjBypassingRunnable_m_pad_radarObjPort_par_out_local::TChangeableMemPool::_::_::_m_arrayPool::_0_::_elem::_m_objectInformation::_8_::_m_perObjectType::_m_prob1TruckN = 0;
      @sysvar::XCP::RadarFC_Obj::_g_PL_AD_fw_Radar_1R1V_rpc_XilObjBypassingRunnable_XilObjBypassingRunnable_m_pad_radarObjPort_par_out_local::TChangeableMemPool::_::_::_m_arrayPool::_0_::_elem::_m_objectInformation::_8_::_m_perObjectType::_m_prob1FourWheelUnknownN = 128;
      @sysvar::XCP::RadarFC_Obj::_g_PL_AD_fw_Radar_1R1V_rpc_XilObjBypassingRunnable_XilObjBypassingRunnable_m_pad_radarObjPort_par_out_local::TChangeableMemPool::_::_::_m_arrayPool::_0_::_elem::_m_objectInformation::_8_::_m_dWidthN = 256;
        break;

      case 2: //"RoadSideBarrier"
      @sysvar::XCP::RadarFC_Obj::_g_PL_AD_fw_Radar_1R1V_rpc_XilObjBypassingRunnable_XilObjBypassingRunnable_m_pad_radarObjPort_par_out_local::TChangeableMemPool::_::_::_m_arrayPool::_0_::_elem::_m_objectInformation::_8_::_m_perObjectType::_m_prob1ObstacleN = 128;
      @sysvar::XCP::RadarFC_Obj::_g_PL_AD_fw_Radar_1R1V_rpc_XilObjBypassingRunnable_XilObjBypassingRunnable_m_pad_radarObjPort_par_out_local::TChangeableMemPool::_::_::_m_arrayPool::_0_::_elem::_m_objectInformation::_8_::_m_perObjectType::_m_prob1NonObstacleN = 0;
      @sysvar::XCP::RadarFC_Obj::_g_PL_AD_fw_Radar_1R1V_rpc_XilObjBypassingRunnable_XilObjBypassingRunnable_m_pad_radarObjPort_par_out_local::TChangeableMemPool::_::_::_m_arrayPool::_0_::_elem::_m_objectInformation::_8_::_m_perObjectType::_m_prob1UnknownN = 0;
      @sysvar::XCP::RadarFC_Obj::_g_PL_AD_fw_Radar_1R1V_rpc_XilObjBypassingRunnable_XilObjBypassingRunnable_m_pad_radarObjPort_par_out_local::TChangeableMemPool::_::_::_m_arrayPool::_0_::_elem::_m_objectInformation::_8_::_m_perObjectType::_m_prob1MobileN = 0;
      @sysvar::XCP::RadarFC_Obj::_g_PL_AD_fw_Radar_1R1V_rpc_XilObjBypassingRunnable_XilObjBypassingRunnable_m_pad_radarObjPort_par_out_local::TChangeableMemPool::_::_::_m_arrayPool::_0_::_elem::_m_objectInformation::_8_::_m_perObjectType::_m_prob1StationaryN = 128;
      @sysvar::XCP::RadarFC_Obj::_g_PL_AD_fw_Radar_1R1V_rpc_XilObjBypassingRunnable_XilObjBypassingRunnable_m_pad_radarObjPort_par_out_local::TChangeableMemPool::_::_::_m_arrayPool::_0_::_elem::_m_objectInformation::_8_::_m_perObjectType::_m_prob1ObstUnknownN = 0;
      @sysvar::XCP::RadarFC_Obj::_g_PL_AD_fw_Radar_1R1V_rpc_XilObjBypassingRunnable_XilObjBypassingRunnable_m_pad_radarObjPort_par_out_local::TChangeableMemPool::_::_::_m_arrayPool::_0_::_elem::_m_objectInformation::_8_::_m_perObjectType::_m_prob1FourPlusWheelerN = 0;
      @sysvar::XCP::RadarFC_Obj::_g_PL_AD_fw_Radar_1R1V_rpc_XilObjBypassingRunnable_XilObjBypassingRunnable_m_pad_radarObjPort_par_out_local::TChangeableMemPool::_::_::_m_arrayPool::_0_::_elem::_m_objectInformation::_8_::_m_perObjectType::_m_prob1TwoWheelerN = 0;
      @sysvar::XCP::RadarFC_Obj::_g_PL_AD_fw_Radar_1R1V_rpc_XilObjBypassingRunnable_XilObjBypassingRunnable_m_pad_radarObjPort_par_out_local::TChangeableMemPool::_::_::_m_arrayPool::_0_::_elem::_m_objectInformation::_8_::_m_perObjectType::_m_prob1PedestrianN = 0;
      @sysvar::XCP::RadarFC_Obj::_g_PL_AD_fw_Radar_1R1V_rpc_XilObjBypassingRunnable_XilObjBypassingRunnable_m_pad_radarObjPort_par_out_local::TChangeableMemPool::_::_::_m_arrayPool::_0_::_elem::_m_objectInformation::_8_::_m_perObjectType::_m_prob1MovUnknownN = 128;
      @sysvar::XCP::RadarFC_Obj::_g_PL_AD_fw_Radar_1R1V_rpc_XilObjBypassingRunnable_XilObjBypassingRunnable_m_pad_radarObjPort_par_out_local::TChangeableMemPool::_::_::_m_arrayPool::_0_::_elem::_m_objectInformation::_8_::_m_perObjectType::_m_prob1RoadsideBarrierN = 128;
      @sysvar::XCP::RadarFC_Obj::_g_PL_AD_fw_Radar_1R1V_rpc_XilObjBypassingRunnable_XilObjBypassingRunnable_m_pad_radarObjPort_par_out_local::TChangeableMemPool::_::_::_m_arrayPool::_0_::_elem::_m_objectInformation::_8_::_m_perObjectType::_m_prob1StatUnknownN = 0;
      @sysvar::XCP::RadarFC_Obj::_g_PL_AD_fw_Radar_1R1V_rpc_XilObjBypassingRunnable_XilObjBypassingRunnable_m_pad_radarObjPort_par_out_local::TChangeableMemPool::_::_::_m_arrayPool::_0_::_elem::_m_objectInformation::_8_::_m_perObjectType::_m_prob1PassengerCarN = 0;
      @sysvar::XCP::RadarFC_Obj::_g_PL_AD_fw_Radar_1R1V_rpc_XilObjBypassingRunnable_XilObjBypassingRunnable_m_pad_radarObjPort_par_out_local::TChangeableMemPool::_::_::_m_arrayPool::_0_::_elem::_m_objectInformation::_8_::_m_perObjectType::_m_prob1TruckN = 0;
      @sysvar::XCP::RadarFC_Obj::_g_PL_AD_fw_Radar_1R1V_rpc_XilObjBypassingRunnable_XilObjBypassingRunnable_m_pad_radarObjPort_par_out_local::TChangeableMemPool::_::_::_m_arrayPool::_0_::_elem::_m_objectInformation::_8_::_m_perObjectType::_m_prob1FourWheelUnknownN = 128;
      @sysvar::XCP::RadarFC_Obj::_g_PL_AD_fw_Radar_1R1V_rpc_XilObjBypassingRunnable_XilObjBypassingRunnable_m_pad_radarObjPort_par_out_local::TChangeableMemPool::_::_::_m_arrayPool::_0_::_elem::_m_objectInformation::_8_::_m_dWidthN = 256;
        break;

      case 3: //"2Wheeler"
      @sysvar::XCP::RadarFC_Obj::_g_PL_AD_fw_Radar_1R1V_rpc_XilObjBypassingRunnable_XilObjBypassingRunnable_m_pad_radarObjPort_par_out_local::TChangeableMemPool::_::_::_m_arrayPool::_0_::_elem::_m_objectInformation::_8_::_m_perObjectType::_m_prob1ObstacleN = 128;
      @sysvar::XCP::RadarFC_Obj::_g_PL_AD_fw_Radar_1R1V_rpc_XilObjBypassingRunnable_XilObjBypassingRunnable_m_pad_radarObjPort_par_out_local::TChangeableMemPool::_::_::_m_arrayPool::_0_::_elem::_m_objectInformation::_8_::_m_perObjectType::_m_prob1NonObstacleN = 0;
      @sysvar::XCP::RadarFC_Obj::_g_PL_AD_fw_Radar_1R1V_rpc_XilObjBypassingRunnable_XilObjBypassingRunnable_m_pad_radarObjPort_par_out_local::TChangeableMemPool::_::_::_m_arrayPool::_0_::_elem::_m_objectInformation::_8_::_m_perObjectType::_m_prob1UnknownN = 0;
      @sysvar::XCP::RadarFC_Obj::_g_PL_AD_fw_Radar_1R1V_rpc_XilObjBypassingRunnable_XilObjBypassingRunnable_m_pad_radarObjPort_par_out_local::TChangeableMemPool::_::_::_m_arrayPool::_0_::_elem::_m_objectInformation::_8_::_m_perObjectType::_m_prob1MobileN = 128;
      @sysvar::XCP::RadarFC_Obj::_g_PL_AD_fw_Radar_1R1V_rpc_XilObjBypassingRunnable_XilObjBypassingRunnable_m_pad_radarObjPort_par_out_local::TChangeableMemPool::_::_::_m_arrayPool::_0_::_elem::_m_objectInformation::_8_::_m_perObjectType::_m_prob1StationaryN = 0;
      @sysvar::XCP::RadarFC_Obj::_g_PL_AD_fw_Radar_1R1V_rpc_XilObjBypassingRunnable_XilObjBypassingRunnable_m_pad_radarObjPort_par_out_local::TChangeableMemPool::_::_::_m_arrayPool::_0_::_elem::_m_objectInformation::_8_::_m_perObjectType::_m_prob1ObstUnknownN = 0;
      @sysvar::XCP::RadarFC_Obj::_g_PL_AD_fw_Radar_1R1V_rpc_XilObjBypassingRunnable_XilObjBypassingRunnable_m_pad_radarObjPort_par_out_local::TChangeableMemPool::_::_::_m_arrayPool::_0_::_elem::_m_objectInformation::_8_::_m_perObjectType::_m_prob1FourPlusWheelerN = 0;
      @sysvar::XCP::RadarFC_Obj::_g_PL_AD_fw_Radar_1R1V_rpc_XilObjBypassingRunnable_XilObjBypassingRunnable_m_pad_radarObjPort_par_out_local::TChangeableMemPool::_::_::_m_arrayPool::_0_::_elem::_m_objectInformation::_8_::_m_perObjectType::_m_prob1TwoWheelerN = 128;
      @sysvar::XCP::RadarFC_Obj::_g_PL_AD_fw_Radar_1R1V_rpc_XilObjBypassingRunnable_XilObjBypassingRunnable_m_pad_radarObjPort_par_out_local::TChangeableMemPool::_::_::_m_arrayPool::_0_::_elem::_m_objectInformation::_8_::_m_perObjectType::_m_prob1PedestrianN = 0;
      @sysvar::XCP::RadarFC_Obj::_g_PL_AD_fw_Radar_1R1V_rpc_XilObjBypassingRunnable_XilObjBypassingRunnable_m_pad_radarObjPort_par_out_local::TChangeableMemPool::_::_::_m_arrayPool::_0_::_elem::_m_objectInformation::_8_::_m_perObjectType::_m_prob1MovUnknownN = 0;
      @sysvar::XCP::RadarFC_Obj::_g_PL_AD_fw_Radar_1R1V_rpc_XilObjBypassingRunnable_XilObjBypassingRunnable_m_pad_radarObjPort_par_out_local::TChangeableMemPool::_::_::_m_arrayPool::_0_::_elem::_m_objectInformation::_8_::_m_perObjectType::_m_prob1RoadsideBarrierN = 0;
      @sysvar::XCP::RadarFC_Obj::_g_PL_AD_fw_Radar_1R1V_rpc_XilObjBypassingRunnable_XilObjBypassingRunnable_m_pad_radarObjPort_par_out_local::TChangeableMemPool::_::_::_m_arrayPool::_0_::_elem::_m_objectInformation::_8_::_m_perObjectType::_m_prob1StatUnknownN = 128;
      @sysvar::XCP::RadarFC_Obj::_g_PL_AD_fw_Radar_1R1V_rpc_XilObjBypassingRunnable_XilObjBypassingRunnable_m_pad_radarObjPort_par_out_local::TChangeableMemPool::_::_::_m_arrayPool::_0_::_elem::_m_objectInformation::_8_::_m_perObjectType::_m_prob1PassengerCarN = 0;
      @sysvar::XCP::RadarFC_Obj::_g_PL_AD_fw_Radar_1R1V_rpc_XilObjBypassingRunnable_XilObjBypassingRunnable_m_pad_radarObjPort_par_out_local::TChangeableMemPool::_::_::_m_arrayPool::_0_::_elem::_m_objectInformation::_8_::_m_perObjectType::_m_prob1TruckN = 0;
      @sysvar::XCP::RadarFC_Obj::_g_PL_AD_fw_Radar_1R1V_rpc_XilObjBypassingRunnable_XilObjBypassingRunnable_m_pad_radarObjPort_par_out_local::TChangeableMemPool::_::_::_m_arrayPool::_0_::_elem::_m_objectInformation::_8_::_m_perObjectType::_m_prob1FourWheelUnknownN = 128;
      @sysvar::XCP::RadarFC_Obj::_g_PL_AD_fw_Radar_1R1V_rpc_XilObjBypassingRunnable_XilObjBypassingRunnable_m_pad_radarObjPort_par_out_local::TChangeableMemPool::_::_::_m_arrayPool::_0_::_elem::_m_objectInformation::_8_::_m_dWidthN = 64;
        break;

      case 4: //"Pedestrian"
      @sysvar::XCP::RadarFC_Obj::_g_PL_AD_fw_Radar_1R1V_rpc_XilObjBypassingRunnable_XilObjBypassingRunnable_m_pad_radarObjPort_par_out_local::TChangeableMemPool::_::_::_m_arrayPool::_0_::_elem::_m_objectInformation::_8_::_m_perObjectType::_m_prob1ObstacleN = 128;
      @sysvar::XCP::RadarFC_Obj::_g_PL_AD_fw_Radar_1R1V_rpc_XilObjBypassingRunnable_XilObjBypassingRunnable_m_pad_radarObjPort_par_out_local::TChangeableMemPool::_::_::_m_arrayPool::_0_::_elem::_m_objectInformation::_8_::_m_perObjectType::_m_prob1NonObstacleN = 0;
      @sysvar::XCP::RadarFC_Obj::_g_PL_AD_fw_Radar_1R1V_rpc_XilObjBypassingRunnable_XilObjBypassingRunnable_m_pad_radarObjPort_par_out_local::TChangeableMemPool::_::_::_m_arrayPool::_0_::_elem::_m_objectInformation::_8_::_m_perObjectType::_m_prob1UnknownN = 0;
      @sysvar::XCP::RadarFC_Obj::_g_PL_AD_fw_Radar_1R1V_rpc_XilObjBypassingRunnable_XilObjBypassingRunnable_m_pad_radarObjPort_par_out_local::TChangeableMemPool::_::_::_m_arrayPool::_0_::_elem::_m_objectInformation::_8_::_m_perObjectType::_m_prob1MobileN = 128;
      @sysvar::XCP::RadarFC_Obj::_g_PL_AD_fw_Radar_1R1V_rpc_XilObjBypassingRunnable_XilObjBypassingRunnable_m_pad_radarObjPort_par_out_local::TChangeableMemPool::_::_::_m_arrayPool::_0_::_elem::_m_objectInformation::_8_::_m_perObjectType::_m_prob1StationaryN = 0;
      @sysvar::XCP::RadarFC_Obj::_g_PL_AD_fw_Radar_1R1V_rpc_XilObjBypassingRunnable_XilObjBypassingRunnable_m_pad_radarObjPort_par_out_local::TChangeableMemPool::_::_::_m_arrayPool::_0_::_elem::_m_objectInformation::_8_::_m_perObjectType::_m_prob1ObstUnknownN = 0;
      @sysvar::XCP::RadarFC_Obj::_g_PL_AD_fw_Radar_1R1V_rpc_XilObjBypassingRunnable_XilObjBypassingRunnable_m_pad_radarObjPort_par_out_local::TChangeableMemPool::_::_::_m_arrayPool::_0_::_elem::_m_objectInformation::_8_::_m_perObjectType::_m_prob1FourPlusWheelerN = 0;
      @sysvar::XCP::RadarFC_Obj::_g_PL_AD_fw_Radar_1R1V_rpc_XilObjBypassingRunnable_XilObjBypassingRunnable_m_pad_radarObjPort_par_out_local::TChangeableMemPool::_::_::_m_arrayPool::_0_::_elem::_m_objectInformation::_8_::_m_perObjectType::_m_prob1TwoWheelerN = 0;
      @sysvar::XCP::RadarFC_Obj::_g_PL_AD_fw_Radar_1R1V_rpc_XilObjBypassingRunnable_XilObjBypassingRunnable_m_pad_radarObjPort_par_out_local::TChangeableMemPool::_::_::_m_arrayPool::_0_::_elem::_m_objectInformation::_8_::_m_perObjectType::_m_prob1PedestrianN = 128;
      @sysvar::XCP::RadarFC_Obj::_g_PL_AD_fw_Radar_1R1V_rpc_XilObjBypassingRunnable_XilObjBypassingRunnable_m_pad_radarObjPort_par_out_local::TChangeableMemPool::_::_::_m_arrayPool::_0_::_elem::_m_objectInformation::_8_::_m_perObjectType::_m_prob1MovUnknownN = 0;
      @sysvar::XCP::RadarFC_Obj::_g_PL_AD_fw_Radar_1R1V_rpc_XilObjBypassingRunnable_XilObjBypassingRunnable_m_pad_radarObjPort_par_out_local::TChangeableMemPool::_::_::_m_arrayPool::_0_::_elem::_m_objectInformation::_8_::_m_perObjectType::_m_prob1RoadsideBarrierN = 0;
      @sysvar::XCP::RadarFC_Obj::_g_PL_AD_fw_Radar_1R1V_rpc_XilObjBypassingRunnable_XilObjBypassingRunnable_m_pad_radarObjPort_par_out_local::TChangeableMemPool::_::_::_m_arrayPool::_0_::_elem::_m_objectInformation::_8_::_m_perObjectType::_m_prob1StatUnknownN = 128;
      @sysvar::XCP::RadarFC_Obj::_g_PL_AD_fw_Radar_1R1V_rpc_XilObjBypassingRunnable_XilObjBypassingRunnable_m_pad_radarObjPort_par_out_local::TChangeableMemPool::_::_::_m_arrayPool::_0_::_elem::_m_objectInformation::_8_::_m_perObjectType::_m_prob1PassengerCarN = 0;
      @sysvar::XCP::RadarFC_Obj::_g_PL_AD_fw_Radar_1R1V_rpc_XilObjBypassingRunnable_XilObjBypassingRunnable_m_pad_radarObjPort_par_out_local::TChangeableMemPool::_::_::_m_arrayPool::_0_::_elem::_m_objectInformation::_8_::_m_perObjectType::_m_prob1TruckN = 0;
      @sysvar::XCP::RadarFC_Obj::_g_PL_AD_fw_Radar_1R1V_rpc_XilObjBypassingRunnable_XilObjBypassingRunnable_m_pad_radarObjPort_par_out_local::TChangeableMemPool::_::_::_m_arrayPool::_0_::_elem::_m_objectInformation::_8_::_m_perObjectType::_m_prob1FourWheelUnknownN = 128;
      @sysvar::XCP::RadarFC_Obj::_g_PL_AD_fw_Radar_1R1V_rpc_XilObjBypassingRunnable_XilObjBypassingRunnable_m_pad_radarObjPort_par_out_local::TChangeableMemPool::_::_::_m_arrayPool::_0_::_elem::_m_objectInformation::_8_::_m_dWidthN = 64;
        break;

      case 5: //"Truck"
      @sysvar::XCP::RadarFC_Obj::_g_PL_AD_fw_Radar_1R1V_rpc_XilObjBypassingRunnable_XilObjBypassingRunnable_m_pad_radarObjPort_par_out_local::TChangeableMemPool::_::_::_m_arrayPool::_0_::_elem::_m_objectInformation::_8_::_m_perObjectType::_m_prob1ObstacleN = 128;
      @sysvar::XCP::RadarFC_Obj::_g_PL_AD_fw_Radar_1R1V_rpc_XilObjBypassingRunnable_XilObjBypassingRunnable_m_pad_radarObjPort_par_out_local::TChangeableMemPool::_::_::_m_arrayPool::_0_::_elem::_m_objectInformation::_8_::_m_perObjectType::_m_prob1NonObstacleN = 0;
      @sysvar::XCP::RadarFC_Obj::_g_PL_AD_fw_Radar_1R1V_rpc_XilObjBypassingRunnable_XilObjBypassingRunnable_m_pad_radarObjPort_par_out_local::TChangeableMemPool::_::_::_m_arrayPool::_0_::_elem::_m_objectInformation::_8_::_m_perObjectType::_m_prob1UnknownN = 0;
      @sysvar::XCP::RadarFC_Obj::_g_PL_AD_fw_Radar_1R1V_rpc_XilObjBypassingRunnable_XilObjBypassingRunnable_m_pad_radarObjPort_par_out_local::TChangeableMemPool::_::_::_m_arrayPool::_0_::_elem::_m_objectInformation::_8_::_m_perObjectType::_m_prob1MobileN = 128;
      @sysvar::XCP::RadarFC_Obj::_g_PL_AD_fw_Radar_1R1V_rpc_XilObjBypassingRunnable_XilObjBypassingRunnable_m_pad_radarObjPort_par_out_local::TChangeableMemPool::_::_::_m_arrayPool::_0_::_elem::_m_objectInformation::_8_::_m_perObjectType::_m_prob1StationaryN = 0;
      @sysvar::XCP::RadarFC_Obj::_g_PL_AD_fw_Radar_1R1V_rpc_XilObjBypassingRunnable_XilObjBypassingRunnable_m_pad_radarObjPort_par_out_local::TChangeableMemPool::_::_::_m_arrayPool::_0_::_elem::_m_objectInformation::_8_::_m_perObjectType::_m_prob1ObstUnknownN = 0;
      @sysvar::XCP::RadarFC_Obj::_g_PL_AD_fw_Radar_1R1V_rpc_XilObjBypassingRunnable_XilObjBypassingRunnable_m_pad_radarObjPort_par_out_local::TChangeableMemPool::_::_::_m_arrayPool::_0_::_elem::_m_objectInformation::_8_::_m_perObjectType::_m_prob1FourPlusWheelerN = 128;
      @sysvar::XCP::RadarFC_Obj::_g_PL_AD_fw_Radar_1R1V_rpc_XilObjBypassingRunnable_XilObjBypassingRunnable_m_pad_radarObjPort_par_out_local::TChangeableMemPool::_::_::_m_arrayPool::_0_::_elem::_m_objectInformation::_8_::_m_perObjectType::_m_prob1TwoWheelerN = 0;
      @sysvar::XCP::RadarFC_Obj::_g_PL_AD_fw_Radar_1R1V_rpc_XilObjBypassingRunnable_XilObjBypassingRunnable_m_pad_radarObjPort_par_out_local::TChangeableMemPool::_::_::_m_arrayPool::_0_::_elem::_m_objectInformation::_8_::_m_perObjectType::_m_prob1PedestrianN = 0;
      @sysvar::XCP::RadarFC_Obj::_g_PL_AD_fw_Radar_1R1V_rpc_XilObjBypassingRunnable_XilObjBypassingRunnable_m_pad_radarObjPort_par_out_local::TChangeableMemPool::_::_::_m_arrayPool::_0_::_elem::_m_objectInformation::_8_::_m_perObjectType::_m_prob1MovUnknownN = 0;
      @sysvar::XCP::RadarFC_Obj::_g_PL_AD_fw_Radar_1R1V_rpc_XilObjBypassingRunnable_XilObjBypassingRunnable_m_pad_radarObjPort_par_out_local::TChangeableMemPool::_::_::_m_arrayPool::_0_::_elem::_m_objectInformation::_8_::_m_perObjectType::_m_prob1RoadsideBarrierN = 0;
      @sysvar::XCP::RadarFC_Obj::_g_PL_AD_fw_Radar_1R1V_rpc_XilObjBypassingRunnable_XilObjBypassingRunnable_m_pad_radarObjPort_par_out_local::TChangeableMemPool::_::_::_m_arrayPool::_0_::_elem::_m_objectInformation::_8_::_m_perObjectType::_m_prob1StatUnknownN = 128;
      @sysvar::XCP::RadarFC_Obj::_g_PL_AD_fw_Radar_1R1V_rpc_XilObjBypassingRunnable_XilObjBypassingRunnable_m_pad_radarObjPort_par_out_local::TChangeableMemPool::_::_::_m_arrayPool::_0_::_elem::_m_objectInformation::_8_::_m_perObjectType::_m_prob1PassengerCarN = 0;
      @sysvar::XCP::RadarFC_Obj::_g_PL_AD_fw_Radar_1R1V_rpc_XilObjBypassingRunnable_XilObjBypassingRunnable_m_pad_radarObjPort_par_out_local::TChangeableMemPool::_::_::_m_arrayPool::_0_::_elem::_m_objectInformation::_8_::_m_perObjectType::_m_prob1TruckN = 128;
      @sysvar::XCP::RadarFC_Obj::_g_PL_AD_fw_Radar_1R1V_rpc_XilObjBypassingRunnable_XilObjBypassingRunnable_m_pad_radarObjPort_par_out_local::TChangeableMemPool::_::_::_m_arrayPool::_0_::_elem::_m_objectInformation::_8_::_m_perObjectType::_m_prob1FourWheelUnknownN = 0;
      @sysvar::XCP::RadarFC_Obj::_g_PL_AD_fw_Radar_1R1V_rpc_XilObjBypassingRunnable_XilObjBypassingRunnable_m_pad_radarObjPort_par_out_local::TChangeableMemPool::_::_::_m_arrayPool::_0_::_elem::_m_objectInformation::_8_::_m_dWidthN = 256;
        break;

      case 6: //"PassengerCar"
      @sysvar::XCP::RadarFC_Obj::_g_PL_AD_fw_Radar_1R1V_rpc_XilObjBypassingRunnable_XilObjBypassingRunnable_m_pad_radarObjPort_par_out_local::TChangeableMemPool::_::_::_m_arrayPool::_0_::_elem::_m_objectInformation::_8_::_m_perObjectType::_m_prob1ObstacleN = 128;
      @sysvar::XCP::RadarFC_Obj::_g_PL_AD_fw_Radar_1R1V_rpc_XilObjBypassingRunnable_XilObjBypassingRunnable_m_pad_radarObjPort_par_out_local::TChangeableMemPool::_::_::_m_arrayPool::_0_::_elem::_m_objectInformation::_8_::_m_perObjectType::_m_prob1NonObstacleN = 0;
      @sysvar::XCP::RadarFC_Obj::_g_PL_AD_fw_Radar_1R1V_rpc_XilObjBypassingRunnable_XilObjBypassingRunnable_m_pad_radarObjPort_par_out_local::TChangeableMemPool::_::_::_m_arrayPool::_0_::_elem::_m_objectInformation::_8_::_m_perObjectType::_m_prob1UnknownN = 0;
      @sysvar::XCP::RadarFC_Obj::_g_PL_AD_fw_Radar_1R1V_rpc_XilObjBypassingRunnable_XilObjBypassingRunnable_m_pad_radarObjPort_par_out_local::TChangeableMemPool::_::_::_m_arrayPool::_0_::_elem::_m_objectInformation::_8_::_m_perObjectType::_m_prob1MobileN = 128;
      @sysvar::XCP::RadarFC_Obj::_g_PL_AD_fw_Radar_1R1V_rpc_XilObjBypassingRunnable_XilObjBypassingRunnable_m_pad_radarObjPort_par_out_local::TChangeableMemPool::_::_::_m_arrayPool::_0_::_elem::_m_objectInformation::_8_::_m_perObjectType::_m_prob1StationaryN = 0;
      @sysvar::XCP::RadarFC_Obj::_g_PL_AD_fw_Radar_1R1V_rpc_XilObjBypassingRunnable_XilObjBypassingRunnable_m_pad_radarObjPort_par_out_local::TChangeableMemPool::_::_::_m_arrayPool::_0_::_elem::_m_objectInformation::_8_::_m_perObjectType::_m_prob1ObstUnknownN = 0;
      @sysvar::XCP::RadarFC_Obj::_g_PL_AD_fw_Radar_1R1V_rpc_XilObjBypassingRunnable_XilObjBypassingRunnable_m_pad_radarObjPort_par_out_local::TChangeableMemPool::_::_::_m_arrayPool::_0_::_elem::_m_objectInformation::_8_::_m_perObjectType::_m_prob1FourPlusWheelerN = 128;
      @sysvar::XCP::RadarFC_Obj::_g_PL_AD_fw_Radar_1R1V_rpc_XilObjBypassingRunnable_XilObjBypassingRunnable_m_pad_radarObjPort_par_out_local::TChangeableMemPool::_::_::_m_arrayPool::_0_::_elem::_m_objectInformation::_8_::_m_perObjectType::_m_prob1TwoWheelerN = 0;
      @sysvar::XCP::RadarFC_Obj::_g_PL_AD_fw_Radar_1R1V_rpc_XilObjBypassingRunnable_XilObjBypassingRunnable_m_pad_radarObjPort_par_out_local::TChangeableMemPool::_::_::_m_arrayPool::_0_::_elem::_m_objectInformation::_8_::_m_perObjectType::_m_prob1PedestrianN = 0;
      @sysvar::XCP::RadarFC_Obj::_g_PL_AD_fw_Radar_1R1V_rpc_XilObjBypassingRunnable_XilObjBypassingRunnable_m_pad_radarObjPort_par_out_local::TChangeableMemPool::_::_::_m_arrayPool::_0_::_elem::_m_objectInformation::_8_::_m_perObjectType::_m_prob1MovUnknownN = 0;
      @sysvar::XCP::RadarFC_Obj::_g_PL_AD_fw_Radar_1R1V_rpc_XilObjBypassingRunnable_XilObjBypassingRunnable_m_pad_radarObjPort_par_out_local::TChangeableMemPool::_::_::_m_arrayPool::_0_::_elem::_m_objectInformation::_8_::_m_perObjectType::_m_prob1RoadsideBarrierN = 0;
      @sysvar::XCP::RadarFC_Obj::_g_PL_AD_fw_Radar_1R1V_rpc_XilObjBypassingRunnable_XilObjBypassingRunnable_m_pad_radarObjPort_par_out_local::TChangeableMemPool::_::_::_m_arrayPool::_0_::_elem::_m_objectInformation::_8_::_m_perObjectType::_m_prob1StatUnknownN = 128;
      @sysvar::XCP::RadarFC_Obj::_g_PL_AD_fw_Radar_1R1V_rpc_XilObjBypassingRunnable_XilObjBypassingRunnable_m_pad_radarObjPort_par_out_local::TChangeableMemPool::_::_::_m_arrayPool::_0_::_elem::_m_objectInformation::_8_::_m_perObjectType::_m_prob1PassengerCarN = 128;
      @sysvar::XCP::RadarFC_Obj::_g_PL_AD_fw_Radar_1R1V_rpc_XilObjBypassingRunnable_XilObjBypassingRunnable_m_pad_radarObjPort_par_out_local::TChangeableMemPool::_::_::_m_arrayPool::_0_::_elem::_m_objectInformation::_8_::_m_perObjectType::_m_prob1TruckN = 0;
      @sysvar::XCP::RadarFC_Obj::_g_PL_AD_fw_Radar_1R1V_rpc_XilObjBypassingRunnable_XilObjBypassingRunnable_m_pad_radarObjPort_par_out_local::TChangeableMemPool::_::_::_m_arrayPool::_0_::_elem::_m_objectInformation::_8_::_m_perObjectType::_m_prob1FourWheelUnknownN = 0;
      @sysvar::XCP::RadarFC_Obj::_g_PL_AD_fw_Radar_1R1V_rpc_XilObjBypassingRunnable_XilObjBypassingRunnable_m_pad_radarObjPort_par_out_local::TChangeableMemPool::_::_::_m_arrayPool::_0_::_elem::_m_objectInformation::_8_::_m_dWidthN = 256;
        break;
    }
    break;
  }
}

/** @brief Sets the signals to raw value 0 of the object which deletes it on xcp.
  * @param object_id ID of the object which shall be deleted.
  * @return void
  */
void obj_sim_delete_fradar_xcp(byte object_id)
{
switch (@target_radar_fc_sim::objdata.obj_id[object_id])
  {
    case 0: //"Object-0"
    //constant
  @sysvar::XCP::RadarFC_Obj::_g_PL_AD_fw_Radar_1R1V_rpc_XilObjBypassingRunnable_XilObjBypassingRunnable_m_pad_radarObjPort_par_out_local::TChangeableMemPool::_::_::_m_arrayPool::_0_::_elem::_m_objectInformation::_0_::_Valid_b = 0;
  @sysvar::XCP::RadarFC_Obj::_g_PL_AD_fw_Radar_1R1V_rpc_XilObjBypassingRunnable_XilObjBypassingRunnable_m_pad_radarObjPort_par_out_local::TChangeableMemPool::_::_::_m_arrayPool::_0_::_elem::_m_objectInformation::_0_::_m_HandleN = 0;
  @sysvar::XCP::RadarFC_Obj::_g_PL_AD_fw_Radar_1R1V_rpc_XilObjBypassingRunnable_XilObjBypassingRunnable_m_pad_radarObjPort_par_out_local::TChangeableMemPool::_::_::_m_arrayPool::_0_::_elem::_m_objectInformation::_0_::_m_alpPiVarYawAngleN = 0;
  @sysvar::XCP::RadarFC_Obj::_g_PL_AD_fw_Radar_1R1V_rpc_XilObjBypassingRunnable_XilObjBypassingRunnable_m_pad_radarObjPort_par_out_local::TChangeableMemPool::_::_::_m_arrayPool::_0_::_elem::_m_objectInformation::_0_::_m_alpPiYawAngleN = 0;
  @sysvar::XCP::RadarFC_Obj::_g_PL_AD_fw_Radar_1R1V_rpc_XilObjBypassingRunnable_XilObjBypassingRunnable_m_pad_radarObjPort_par_out_local::TChangeableMemPool::_::_::_m_arrayPool::_0_::_elem::_m_objectInformation::_0_::_m_varAxN = 0;
  @sysvar::XCP::RadarFC_Obj::_g_PL_AD_fw_Radar_1R1V_rpc_XilObjBypassingRunnable_XilObjBypassingRunnable_m_pad_radarObjPort_par_out_local::TChangeableMemPool::_::_::_m_arrayPool::_0_::_elem::_m_objectInformation::_0_::_m_varAyN = 0;
  @sysvar::XCP::RadarFC_Obj::_g_PL_AD_fw_Radar_1R1V_rpc_XilObjBypassingRunnable_XilObjBypassingRunnable_m_pad_radarObjPort_par_out_local::TChangeableMemPool::_::_::_m_arrayPool::_0_::_elem::_m_objectInformation::_0_::_m_varVxN = 0;
  @sysvar::XCP::RadarFC_Obj::_g_PL_AD_fw_Radar_1R1V_rpc_XilObjBypassingRunnable_XilObjBypassingRunnable_m_pad_radarObjPort_par_out_local::TChangeableMemPool::_::_::_m_arrayPool::_0_::_elem::_m_objectInformation::_0_::_m_varVyN = 0;
  @sysvar::XCP::RadarFC_Obj::_g_PL_AD_fw_Radar_1R1V_rpc_XilObjBypassingRunnable_XilObjBypassingRunnable_m_pad_radarObjPort_par_out_local::TChangeableMemPool::_::_::_m_arrayPool::_0_::_elem::_m_objectInformation::_0_::_m_varDxN = 0;
  @sysvar::XCP::RadarFC_Obj::_g_PL_AD_fw_Radar_1R1V_rpc_XilObjBypassingRunnable_XilObjBypassingRunnable_m_pad_radarObjPort_par_out_local::TChangeableMemPool::_::_::_m_arrayPool::_0_::_elem::_m_objectInformation::_0_::_m_varDyN = 0;
  @sysvar::XCP::RadarFC_Obj::_g_PL_AD_fw_Radar_1R1V_rpc_XilObjBypassingRunnable_XilObjBypassingRunnable_m_pad_radarObjPort_par_out_local::TChangeableMemPool::_::_::_m_arrayPool::_0_::_elem::_m_objectInformation::_0_::_m_dVarLengthN = 0;
  @sysvar::XCP::RadarFC_Obj::_g_PL_AD_fw_Radar_1R1V_rpc_XilObjBypassingRunnable_XilObjBypassingRunnable_m_pad_radarObjPort_par_out_local::TChangeableMemPool::_::_::_m_arrayPool::_0_::_elem::_m_objectInformation::_0_::_m_dVarWidthN = 0;
  @sysvar::XCP::RadarFC_Obj::_g_PL_AD_fw_Radar_1R1V_rpc_XilObjBypassingRunnable_XilObjBypassingRunnable_m_pad_radarObjPort_par_out_local::TChangeableMemPool::_::_::_m_arrayPool::_0_::_elem::_m_objectInformation::_0_::_m_wExistProbN = 0;
  @sysvar::XCP::RadarFC_Obj::_g_PL_AD_fw_Radar_1R1V_rpc_XilObjBypassingRunnable_XilObjBypassingRunnable_m_pad_radarObjPort_par_out_local::TChangeableMemPool::_::_::_m_arrayPool::_0_::_elem::_m_objectInformation::_0_::_m_isObjectAsil = 1;
  @sysvar::XCP::RadarFC_Obj::_g_PL_AD_fw_Radar_1R1V_rpc_XilObjBypassingRunnable_XilObjBypassingRunnable_m_pad_radarObjPort_par_out_local::TChangeableMemPool::_::_::_m_arrayPool::_0_::_elem::_m_objectInformation::_0_::_m_dLengthN = 0;
  @sysvar::XCP::RadarFC_Obj::_g_PL_AD_fw_Radar_1R1V_rpc_XilObjBypassingRunnable_XilObjBypassingRunnable_m_pad_radarObjPort_par_out_local::TChangeableMemPool::_::_::_m_arrayPool::_0_::_elem::_m_objectInformation::_0_::_m_dxN = 0;
  @sysvar::XCP::RadarFC_Obj::_g_PL_AD_fw_Radar_1R1V_rpc_XilObjBypassingRunnable_XilObjBypassingRunnable_m_pad_radarObjPort_par_out_local::TChangeableMemPool::_::_::_m_arrayPool::_0_::_elem::_m_objectInformation::_0_::_m_dyN = 0;
  @sysvar::XCP::RadarFC_Obj::_g_PL_AD_fw_Radar_1R1V_rpc_XilObjBypassingRunnable_XilObjBypassingRunnable_m_pad_radarObjPort_par_out_local::TChangeableMemPool::_::_::_m_arrayPool::_0_::_elem::_m_objectInformation::_0_::_m_dzN = 0;
  @sysvar::XCP::RadarFC_Obj::_g_PL_AD_fw_Radar_1R1V_rpc_XilObjBypassingRunnable_XilObjBypassingRunnable_m_pad_radarObjPort_par_out_local::TChangeableMemPool::_::_::_m_arrayPool::_0_::_elem::_m_objectInformation::_0_::_m_vxN = 0;
  @sysvar::XCP::RadarFC_Obj::_g_PL_AD_fw_Radar_1R1V_rpc_XilObjBypassingRunnable_XilObjBypassingRunnable_m_pad_radarObjPort_par_out_local::TChangeableMemPool::_::_::_m_arrayPool::_0_::_elem::_m_objectInformation::_0_::_m_vyN = 0;
  @sysvar::XCP::RadarFC_Obj::_g_PL_AD_fw_Radar_1R1V_rpc_XilObjBypassingRunnable_XilObjBypassingRunnable_m_pad_radarObjPort_par_out_local::TChangeableMemPool::_::_::_m_arrayPool::_0_::_elem::_m_objectInformation::_0_::_m_axN = 0;
  @sysvar::XCP::RadarFC_Obj::_g_PL_AD_fw_Radar_1R1V_rpc_XilObjBypassingRunnable_XilObjBypassingRunnable_m_pad_radarObjPort_par_out_local::TChangeableMemPool::_::_::_m_arrayPool::_0_::_elem::_m_objectInformation::_0_::_m_ayN = 0;
  @sysvar::XCP::RadarFC_Obj::_g_PL_AD_fw_Radar_1R1V_rpc_XilObjBypassingRunnable_XilObjBypassingRunnable_m_pad_radarObjPort_par_out_local::TChangeableMemPool::_::_::_m_arrayPool::_0_::_elem::_m_objectInformation::_0_::_m_prob1HasBeenObservedMovingN = 0;
  @sysvar::XCP::RadarFC_Obj::_g_PL_AD_fw_Radar_1R1V_rpc_XilObjBypassingRunnable_XilObjBypassingRunnable_m_pad_radarObjPort_par_out_local::TChangeableMemPool::_::_::_m_arrayPool::_0_::_elem::_m_objectInformation::_0_::_m_prob1MovingN = 0;
  @sysvar::XCP::RadarFC_Obj::_g_PL_AD_fw_Radar_1R1V_rpc_XilObjBypassingRunnable_XilObjBypassingRunnable_m_pad_radarObjPort_par_out_local::TChangeableMemPool::_::_::_m_arrayPool::_0_::_elem::_m_objectInformation::_0_::_m_prob1HasBeenObservedMovingN = 0;
  @sysvar::XCP::RadarFC_Obj::_g_PL_AD_fw_Radar_1R1V_rpc_XilObjBypassingRunnable_XilObjBypassingRunnable_m_pad_radarObjPort_par_out_local::TChangeableMemPool::_::_::_m_arrayPool::_0_::_elem::_m_objectInformation::_0_::_m_prob1MovingN = 0;
  @sysvar::XCP::RadarFC_Obj::_g_PL_AD_fw_Radar_1R1V_rpc_XilObjBypassingRunnable_XilObjBypassingRunnable_m_pad_radarObjPort_par_out_local::TChangeableMemPool::_::_::_m_arrayPool::_0_::_elem::_m_objectInformation::_0_::_m_perObjectType::_m_prob1ObstacleN = 0;
  @sysvar::XCP::RadarFC_Obj::_g_PL_AD_fw_Radar_1R1V_rpc_XilObjBypassingRunnable_XilObjBypassingRunnable_m_pad_radarObjPort_par_out_local::TChangeableMemPool::_::_::_m_arrayPool::_0_::_elem::_m_objectInformation::_0_::_m_perObjectType::_m_prob1NonObstacleN = 0;
  @sysvar::XCP::RadarFC_Obj::_g_PL_AD_fw_Radar_1R1V_rpc_XilObjBypassingRunnable_XilObjBypassingRunnable_m_pad_radarObjPort_par_out_local::TChangeableMemPool::_::_::_m_arrayPool::_0_::_elem::_m_objectInformation::_0_::_m_perObjectType::_m_prob1UnknownN = 0;
  @sysvar::XCP::RadarFC_Obj::_g_PL_AD_fw_Radar_1R1V_rpc_XilObjBypassingRunnable_XilObjBypassingRunnable_m_pad_radarObjPort_par_out_local::TChangeableMemPool::_::_::_m_arrayPool::_0_::_elem::_m_objectInformation::_0_::_m_perObjectType::_m_prob1MobileN = 0;
  @sysvar::XCP::RadarFC_Obj::_g_PL_AD_fw_Radar_1R1V_rpc_XilObjBypassingRunnable_XilObjBypassingRunnable_m_pad_radarObjPort_par_out_local::TChangeableMemPool::_::_::_m_arrayPool::_0_::_elem::_m_objectInformation::_0_::_m_perObjectType::_m_prob1StationaryN = 0;
  @sysvar::XCP::RadarFC_Obj::_g_PL_AD_fw_Radar_1R1V_rpc_XilObjBypassingRunnable_XilObjBypassingRunnable_m_pad_radarObjPort_par_out_local::TChangeableMemPool::_::_::_m_arrayPool::_0_::_elem::_m_objectInformation::_0_::_m_perObjectType::_m_prob1ObstUnknownN = 0;
  @sysvar::XCP::RadarFC_Obj::_g_PL_AD_fw_Radar_1R1V_rpc_XilObjBypassingRunnable_XilObjBypassingRunnable_m_pad_radarObjPort_par_out_local::TChangeableMemPool::_::_::_m_arrayPool::_0_::_elem::_m_objectInformation::_0_::_m_perObjectType::_m_prob1FourPlusWheelerN = 0;
  @sysvar::XCP::RadarFC_Obj::_g_PL_AD_fw_Radar_1R1V_rpc_XilObjBypassingRunnable_XilObjBypassingRunnable_m_pad_radarObjPort_par_out_local::TChangeableMemPool::_::_::_m_arrayPool::_0_::_elem::_m_objectInformation::_0_::_m_perObjectType::_m_prob1TwoWheelerN = 0;
  @sysvar::XCP::RadarFC_Obj::_g_PL_AD_fw_Radar_1R1V_rpc_XilObjBypassingRunnable_XilObjBypassingRunnable_m_pad_radarObjPort_par_out_local::TChangeableMemPool::_::_::_m_arrayPool::_0_::_elem::_m_objectInformation::_0_::_m_perObjectType::_m_prob1PedestrianN = 0;
  @sysvar::XCP::RadarFC_Obj::_g_PL_AD_fw_Radar_1R1V_rpc_XilObjBypassingRunnable_XilObjBypassingRunnable_m_pad_radarObjPort_par_out_local::TChangeableMemPool::_::_::_m_arrayPool::_0_::_elem::_m_objectInformation::_0_::_m_perObjectType::_m_prob1MovUnknownN = 0;
  @sysvar::XCP::RadarFC_Obj::_g_PL_AD_fw_Radar_1R1V_rpc_XilObjBypassingRunnable_XilObjBypassingRunnable_m_pad_radarObjPort_par_out_local::TChangeableMemPool::_::_::_m_arrayPool::_0_::_elem::_m_objectInformation::_0_::_m_perObjectType::_m_prob1RoadsideBarrierN = 0;
  @sysvar::XCP::RadarFC_Obj::_g_PL_AD_fw_Radar_1R1V_rpc_XilObjBypassingRunnable_XilObjBypassingRunnable_m_pad_radarObjPort_par_out_local::TChangeableMemPool::_::_::_m_arrayPool::_0_::_elem::_m_objectInformation::_0_::_m_perObjectType::_m_prob1StatUnknownN = 0;
  @sysvar::XCP::RadarFC_Obj::_g_PL_AD_fw_Radar_1R1V_rpc_XilObjBypassingRunnable_XilObjBypassingRunnable_m_pad_radarObjPort_par_out_local::TChangeableMemPool::_::_::_m_arrayPool::_0_::_elem::_m_objectInformation::_0_::_m_perObjectType::_m_prob1PassengerCarN = 0;
  @sysvar::XCP::RadarFC_Obj::_g_PL_AD_fw_Radar_1R1V_rpc_XilObjBypassingRunnable_XilObjBypassingRunnable_m_pad_radarObjPort_par_out_local::TChangeableMemPool::_::_::_m_arrayPool::_0_::_elem::_m_objectInformation::_0_::_m_perObjectType::_m_prob1TruckN = 0;
  @sysvar::XCP::RadarFC_Obj::_g_PL_AD_fw_Radar_1R1V_rpc_XilObjBypassingRunnable_XilObjBypassingRunnable_m_pad_radarObjPort_par_out_local::TChangeableMemPool::_::_::_m_arrayPool::_0_::_elem::_m_objectInformation::_0_::_m_perObjectType::_m_prob1FourWheelUnknownN = 0;
  @sysvar::XCP::RadarFC_Obj::_g_PL_AD_fw_Radar_1R1V_rpc_XilObjBypassingRunnable_XilObjBypassingRunnable_m_pad_radarObjPort_par_out_local::TChangeableMemPool::_::_::_m_arrayPool::_0_::_elem::_m_objectInformation::_0_::_m_dWidthN = 0;


    case 1: //"Object-1"
    //constant
  @sysvar::XCP::RadarFC_Obj::_g_PL_AD_fw_Radar_1R1V_rpc_XilObjBypassingRunnable_XilObjBypassingRunnable_m_pad_radarObjPort_par_out_local::TChangeableMemPool::_::_::_m_arrayPool::_0_::_elem::_m_objectInformation::_1_::_Valid_b = 1;
  @sysvar::XCP::RadarFC_Obj::_g_PL_AD_fw_Radar_1R1V_rpc_XilObjBypassingRunnable_XilObjBypassingRunnable_m_pad_radarObjPort_par_out_local::TChangeableMemPool::_::_::_m_arrayPool::_0_::_elem::_m_objectInformation::_1_::_m_HandleN = 1;
  @sysvar::XCP::RadarFC_Obj::_g_PL_AD_fw_Radar_1R1V_rpc_XilObjBypassingRunnable_XilObjBypassingRunnable_m_pad_radarObjPort_par_out_local::TChangeableMemPool::_::_::_m_arrayPool::_0_::_elem::_m_objectInformation::_1_::_m_alpPiVarYawAngleN = 0;
  @sysvar::XCP::RadarFC_Obj::_g_PL_AD_fw_Radar_1R1V_rpc_XilObjBypassingRunnable_XilObjBypassingRunnable_m_pad_radarObjPort_par_out_local::TChangeableMemPool::_::_::_m_arrayPool::_0_::_elem::_m_objectInformation::_1_::_m_alpPiYawAngleN = 0;
  @sysvar::XCP::RadarFC_Obj::_g_PL_AD_fw_Radar_1R1V_rpc_XilObjBypassingRunnable_XilObjBypassingRunnable_m_pad_radarObjPort_par_out_local::TChangeableMemPool::_::_::_m_arrayPool::_0_::_elem::_m_objectInformation::_1_::_m_varAxN = 0;
  @sysvar::XCP::RadarFC_Obj::_g_PL_AD_fw_Radar_1R1V_rpc_XilObjBypassingRunnable_XilObjBypassingRunnable_m_pad_radarObjPort_par_out_local::TChangeableMemPool::_::_::_m_arrayPool::_0_::_elem::_m_objectInformation::_1_::_m_varAyN = 0;
  @sysvar::XCP::RadarFC_Obj::_g_PL_AD_fw_Radar_1R1V_rpc_XilObjBypassingRunnable_XilObjBypassingRunnable_m_pad_radarObjPort_par_out_local::TChangeableMemPool::_::_::_m_arrayPool::_0_::_elem::_m_objectInformation::_1_::_m_varVxN = 0;
  @sysvar::XCP::RadarFC_Obj::_g_PL_AD_fw_Radar_1R1V_rpc_XilObjBypassingRunnable_XilObjBypassingRunnable_m_pad_radarObjPort_par_out_local::TChangeableMemPool::_::_::_m_arrayPool::_0_::_elem::_m_objectInformation::_1_::_m_varVyN = 0;
  @sysvar::XCP::RadarFC_Obj::_g_PL_AD_fw_Radar_1R1V_rpc_XilObjBypassingRunnable_XilObjBypassingRunnable_m_pad_radarObjPort_par_out_local::TChangeableMemPool::_::_::_m_arrayPool::_0_::_elem::_m_objectInformation::_1_::_m_varDxN = 0;
  @sysvar::XCP::RadarFC_Obj::_g_PL_AD_fw_Radar_1R1V_rpc_XilObjBypassingRunnable_XilObjBypassingRunnable_m_pad_radarObjPort_par_out_local::TChangeableMemPool::_::_::_m_arrayPool::_0_::_elem::_m_objectInformation::_1_::_m_varDyN = 0;
  @sysvar::XCP::RadarFC_Obj::_g_PL_AD_fw_Radar_1R1V_rpc_XilObjBypassingRunnable_XilObjBypassingRunnable_m_pad_radarObjPort_par_out_local::TChangeableMemPool::_::_::_m_arrayPool::_0_::_elem::_m_objectInformation::_1_::_m_dVarLengthN = 0;
  @sysvar::XCP::RadarFC_Obj::_g_PL_AD_fw_Radar_1R1V_rpc_XilObjBypassingRunnable_XilObjBypassingRunnable_m_pad_radarObjPort_par_out_local::TChangeableMemPool::_::_::_m_arrayPool::_0_::_elem::_m_objectInformation::_1_::_m_dVarWidthN = 0;
  @sysvar::XCP::RadarFC_Obj::_g_PL_AD_fw_Radar_1R1V_rpc_XilObjBypassingRunnable_XilObjBypassingRunnable_m_pad_radarObjPort_par_out_local::TChangeableMemPool::_::_::_m_arrayPool::_0_::_elem::_m_objectInformation::_1_::_m_wExistProbN = 64880;
  @sysvar::XCP::RadarFC_Obj::_g_PL_AD_fw_Radar_1R1V_rpc_XilObjBypassingRunnable_XilObjBypassingRunnable_m_pad_radarObjPort_par_out_local::TChangeableMemPool::_::_::_m_arrayPool::_0_::_elem::_m_objectInformation::_1_::_m_isObjectAsil = 1;
  @sysvar::XCP::RadarFC_Obj::_g_PL_AD_fw_Radar_1R1V_rpc_XilObjBypassingRunnable_XilObjBypassingRunnable_m_pad_radarObjPort_par_out_local::TChangeableMemPool::_::_::_m_arrayPool::_0_::_elem::_m_objectInformation::_1_::_m_dLengthN = 128;

    //target movement

  @sysvar::XCP::RadarFC_Obj::_g_PL_AD_fw_Radar_1R1V_rpc_XilObjBypassingRunnable_XilObjBypassingRunnable_m_pad_radarObjPort_par_out_local::TChangeableMemPool::_::_::_m_arrayPool::_0_::_elem::_m_objectInformation::_1_::_m_dxN = @target_radar_fc_sim::objdata.obj_distance_x[1] * 128;
  @sysvar::XCP::RadarFC_Obj::_g_PL_AD_fw_Radar_1R1V_rpc_XilObjBypassingRunnable_XilObjBypassingRunnable_m_pad_radarObjPort_par_out_local::TChangeableMemPool::_::_::_m_arrayPool::_0_::_elem::_m_objectInformation::_1_::_m_dyN = @target_radar_fc_sim::objdata.obj_distance_y[1] * 128;
  @sysvar::XCP::RadarFC_Obj::_g_PL_AD_fw_Radar_1R1V_rpc_XilObjBypassingRunnable_XilObjBypassingRunnable_m_pad_radarObjPort_par_out_local::TChangeableMemPool::_::_::_m_arrayPool::_0_::_elem::_m_objectInformation::_1_::_m_dzN = 0;
  @sysvar::XCP::RadarFC_Obj::_g_PL_AD_fw_Radar_1R1V_rpc_XilObjBypassingRunnable_XilObjBypassingRunnable_m_pad_radarObjPort_par_out_local::TChangeableMemPool::_::_::_m_arrayPool::_0_::_elem::_m_objectInformation::_1_::_m_vxN = @target_radar_fc_sim::objdata.obj_velocity_x[1] * 256;
  @sysvar::XCP::RadarFC_Obj::_g_PL_AD_fw_Radar_1R1V_rpc_XilObjBypassingRunnable_XilObjBypassingRunnable_m_pad_radarObjPort_par_out_local::TChangeableMemPool::_::_::_m_arrayPool::_0_::_elem::_m_objectInformation::_1_::_m_vyN = @target_radar_fc_sim::objdata.obj_velocity_y[1] * 256;
  @sysvar::XCP::RadarFC_Obj::_g_PL_AD_fw_Radar_1R1V_rpc_XilObjBypassingRunnable_XilObjBypassingRunnable_m_pad_radarObjPort_par_out_local::TChangeableMemPool::_::_::_m_arrayPool::_0_::_elem::_m_objectInformation::_1_::_m_axN = 0;
  @sysvar::XCP::RadarFC_Obj::_g_PL_AD_fw_Radar_1R1V_rpc_XilObjBypassingRunnable_XilObjBypassingRunnable_m_pad_radarObjPort_par_out_local::TChangeableMemPool::_::_::_m_arrayPool::_0_::_elem::_m_objectInformation::_1_::_m_ayN = 0;

    //target object moving or not
    if (abs(@target_radar_fc_sim::objdata.obj_velocity_x[1]) != 0)
    {
    @sysvar::XCP::RadarFC_Obj::_g_PL_AD_fw_Radar_1R1V_rpc_XilObjBypassingRunnable_XilObjBypassingRunnable_m_pad_radarObjPort_par_out_local::TChangeableMemPool::_::_::_m_arrayPool::_0_::_elem::_m_objectInformation::_1_::_m_prob1HasBeenObservedMovingN = 126;
    @sysvar::XCP::RadarFC_Obj::_g_PL_AD_fw_Radar_1R1V_rpc_XilObjBypassingRunnable_XilObjBypassingRunnable_m_pad_radarObjPort_par_out_local::TChangeableMemPool::_::_::_m_arrayPool::_0_::_elem::_m_objectInformation::_1_::_m_prob1MovingN = 126;
    }
    else
    {
    @sysvar::XCP::RadarFC_Obj::_g_PL_AD_fw_Radar_1R1V_rpc_XilObjBypassingRunnable_XilObjBypassingRunnable_m_pad_radarObjPort_par_out_local::TChangeableMemPool::_::_::_m_arrayPool::_0_::_elem::_m_objectInformation::_1_::_m_prob1HasBeenObservedMovingN = 0;
    @sysvar::XCP::RadarFC_Obj::_g_PL_AD_fw_Radar_1R1V_rpc_XilObjBypassingRunnable_XilObjBypassingRunnable_m_pad_radarObjPort_par_out_local::TChangeableMemPool::_::_::_m_arrayPool::_0_::_elem::_m_objectInformation::_1_::_m_prob1MovingN = 0;
    }

      //object classification
    switch (@target_radar_fc_sim::objdata.obj_type[1])
    {
      case 0: //"Non-Obstacle"
      @sysvar::XCP::RadarFC_Obj::_g_PL_AD_fw_Radar_1R1V_rpc_XilObjBypassingRunnable_XilObjBypassingRunnable_m_pad_radarObjPort_par_out_local::TChangeableMemPool::_::_::_m_arrayPool::_0_::_elem::_m_objectInformation::_1_::_m_perObjectType::_m_prob1ObstacleN = 0;
      @sysvar::XCP::RadarFC_Obj::_g_PL_AD_fw_Radar_1R1V_rpc_XilObjBypassingRunnable_XilObjBypassingRunnable_m_pad_radarObjPort_par_out_local::TChangeableMemPool::_::_::_m_arrayPool::_0_::_elem::_m_objectInformation::_1_::_m_perObjectType::_m_prob1NonObstacleN = 128;
      @sysvar::XCP::RadarFC_Obj::_g_PL_AD_fw_Radar_1R1V_rpc_XilObjBypassingRunnable_XilObjBypassingRunnable_m_pad_radarObjPort_par_out_local::TChangeableMemPool::_::_::_m_arrayPool::_0_::_elem::_m_objectInformation::_1_::_m_perObjectType::_m_prob1UnknownN = 0;
      @sysvar::XCP::RadarFC_Obj::_g_PL_AD_fw_Radar_1R1V_rpc_XilObjBypassingRunnable_XilObjBypassingRunnable_m_pad_radarObjPort_par_out_local::TChangeableMemPool::_::_::_m_arrayPool::_0_::_elem::_m_objectInformation::_1_::_m_perObjectType::_m_prob1MobileN = 0;
      @sysvar::XCP::RadarFC_Obj::_g_PL_AD_fw_Radar_1R1V_rpc_XilObjBypassingRunnable_XilObjBypassingRunnable_m_pad_radarObjPort_par_out_local::TChangeableMemPool::_::_::_m_arrayPool::_0_::_elem::_m_objectInformation::_1_::_m_perObjectType::_m_prob1StationaryN = 0;
      @sysvar::XCP::RadarFC_Obj::_g_PL_AD_fw_Radar_1R1V_rpc_XilObjBypassingRunnable_XilObjBypassingRunnable_m_pad_radarObjPort_par_out_local::TChangeableMemPool::_::_::_m_arrayPool::_0_::_elem::_m_objectInformation::_1_::_m_perObjectType::_m_prob1ObstUnknownN = 128;
      @sysvar::XCP::RadarFC_Obj::_g_PL_AD_fw_Radar_1R1V_rpc_XilObjBypassingRunnable_XilObjBypassingRunnable_m_pad_radarObjPort_par_out_local::TChangeableMemPool::_::_::_m_arrayPool::_0_::_elem::_m_objectInformation::_1_::_m_perObjectType::_m_prob1FourPlusWheelerN = 0;
      @sysvar::XCP::RadarFC_Obj::_g_PL_AD_fw_Radar_1R1V_rpc_XilObjBypassingRunnable_XilObjBypassingRunnable_m_pad_radarObjPort_par_out_local::TChangeableMemPool::_::_::_m_arrayPool::_0_::_elem::_m_objectInformation::_1_::_m_perObjectType::_m_prob1TwoWheelerN = 0;
      @sysvar::XCP::RadarFC_Obj::_g_PL_AD_fw_Radar_1R1V_rpc_XilObjBypassingRunnable_XilObjBypassingRunnable_m_pad_radarObjPort_par_out_local::TChangeableMemPool::_::_::_m_arrayPool::_0_::_elem::_m_objectInformation::_1_::_m_perObjectType::_m_prob1PedestrianN = 0;
      @sysvar::XCP::RadarFC_Obj::_g_PL_AD_fw_Radar_1R1V_rpc_XilObjBypassingRunnable_XilObjBypassingRunnable_m_pad_radarObjPort_par_out_local::TChangeableMemPool::_::_::_m_arrayPool::_0_::_elem::_m_objectInformation::_1_::_m_perObjectType::_m_prob1MovUnknownN = 128;
      @sysvar::XCP::RadarFC_Obj::_g_PL_AD_fw_Radar_1R1V_rpc_XilObjBypassingRunnable_XilObjBypassingRunnable_m_pad_radarObjPort_par_out_local::TChangeableMemPool::_::_::_m_arrayPool::_0_::_elem::_m_objectInformation::_1_::_m_perObjectType::_m_prob1RoadsideBarrierN = 0;
      @sysvar::XCP::RadarFC_Obj::_g_PL_AD_fw_Radar_1R1V_rpc_XilObjBypassingRunnable_XilObjBypassingRunnable_m_pad_radarObjPort_par_out_local::TChangeableMemPool::_::_::_m_arrayPool::_0_::_elem::_m_objectInformation::_1_::_m_perObjectType::_m_prob1StatUnknownN = 128;
      @sysvar::XCP::RadarFC_Obj::_g_PL_AD_fw_Radar_1R1V_rpc_XilObjBypassingRunnable_XilObjBypassingRunnable_m_pad_radarObjPort_par_out_local::TChangeableMemPool::_::_::_m_arrayPool::_0_::_elem::_m_objectInformation::_1_::_m_perObjectType::_m_prob1PassengerCarN = 0;
      @sysvar::XCP::RadarFC_Obj::_g_PL_AD_fw_Radar_1R1V_rpc_XilObjBypassingRunnable_XilObjBypassingRunnable_m_pad_radarObjPort_par_out_local::TChangeableMemPool::_::_::_m_arrayPool::_0_::_elem::_m_objectInformation::_1_::_m_perObjectType::_m_prob1TruckN = 0;
      @sysvar::XCP::RadarFC_Obj::_g_PL_AD_fw_Radar_1R1V_rpc_XilObjBypassingRunnable_XilObjBypassingRunnable_m_pad_radarObjPort_par_out_local::TChangeableMemPool::_::_::_m_arrayPool::_0_::_elem::_m_objectInformation::_1_::_m_perObjectType::_m_prob1FourWheelUnknownN = 128;
      @sysvar::XCP::RadarFC_Obj::_g_PL_AD_fw_Radar_1R1V_rpc_XilObjBypassingRunnable_XilObjBypassingRunnable_m_pad_radarObjPort_par_out_local::TChangeableMemPool::_::_::_m_arrayPool::_0_::_elem::_m_objectInformation::_1_::_m_dWidthN = 256;
        break;

      case 1: //"unknown"
      @sysvar::XCP::RadarFC_Obj::_g_PL_AD_fw_Radar_1R1V_rpc_XilObjBypassingRunnable_XilObjBypassingRunnable_m_pad_radarObjPort_par_out_local::TChangeableMemPool::_::_::_m_arrayPool::_0_::_elem::_m_objectInformation::_1_::_m_perObjectType::_m_prob1ObstacleN = 0;
      @sysvar::XCP::RadarFC_Obj::_g_PL_AD_fw_Radar_1R1V_rpc_XilObjBypassingRunnable_XilObjBypassingRunnable_m_pad_radarObjPort_par_out_local::TChangeableMemPool::_::_::_m_arrayPool::_0_::_elem::_m_objectInformation::_1_::_m_perObjectType::_m_prob1NonObstacleN = 0;
      @sysvar::XCP::RadarFC_Obj::_g_PL_AD_fw_Radar_1R1V_rpc_XilObjBypassingRunnable_XilObjBypassingRunnable_m_pad_radarObjPort_par_out_local::TChangeableMemPool::_::_::_m_arrayPool::_0_::_elem::_m_objectInformation::_1_::_m_perObjectType::_m_prob1UnknownN = 128;
      @sysvar::XCP::RadarFC_Obj::_g_PL_AD_fw_Radar_1R1V_rpc_XilObjBypassingRunnable_XilObjBypassingRunnable_m_pad_radarObjPort_par_out_local::TChangeableMemPool::_::_::_m_arrayPool::_0_::_elem::_m_objectInformation::_1_::_m_perObjectType::_m_prob1MobileN = 0;
      @sysvar::XCP::RadarFC_Obj::_g_PL_AD_fw_Radar_1R1V_rpc_XilObjBypassingRunnable_XilObjBypassingRunnable_m_pad_radarObjPort_par_out_local::TChangeableMemPool::_::_::_m_arrayPool::_0_::_elem::_m_objectInformation::_1_::_m_perObjectType::_m_prob1StationaryN = 0;
      @sysvar::XCP::RadarFC_Obj::_g_PL_AD_fw_Radar_1R1V_rpc_XilObjBypassingRunnable_XilObjBypassingRunnable_m_pad_radarObjPort_par_out_local::TChangeableMemPool::_::_::_m_arrayPool::_0_::_elem::_m_objectInformation::_1_::_m_perObjectType::_m_prob1ObstUnknownN = 128;
      @sysvar::XCP::RadarFC_Obj::_g_PL_AD_fw_Radar_1R1V_rpc_XilObjBypassingRunnable_XilObjBypassingRunnable_m_pad_radarObjPort_par_out_local::TChangeableMemPool::_::_::_m_arrayPool::_0_::_elem::_m_objectInformation::_1_::_m_perObjectType::_m_prob1FourPlusWheelerN = 0;
      @sysvar::XCP::RadarFC_Obj::_g_PL_AD_fw_Radar_1R1V_rpc_XilObjBypassingRunnable_XilObjBypassingRunnable_m_pad_radarObjPort_par_out_local::TChangeableMemPool::_::_::_m_arrayPool::_0_::_elem::_m_objectInformation::_1_::_m_perObjectType::_m_prob1TwoWheelerN = 0;
      @sysvar::XCP::RadarFC_Obj::_g_PL_AD_fw_Radar_1R1V_rpc_XilObjBypassingRunnable_XilObjBypassingRunnable_m_pad_radarObjPort_par_out_local::TChangeableMemPool::_::_::_m_arrayPool::_0_::_elem::_m_objectInformation::_1_::_m_perObjectType::_m_prob1PedestrianN = 0;
      @sysvar::XCP::RadarFC_Obj::_g_PL_AD_fw_Radar_1R1V_rpc_XilObjBypassingRunnable_XilObjBypassingRunnable_m_pad_radarObjPort_par_out_local::TChangeableMemPool::_::_::_m_arrayPool::_0_::_elem::_m_objectInformation::_1_::_m_perObjectType::_m_prob1MovUnknownN = 128;
      @sysvar::XCP::RadarFC_Obj::_g_PL_AD_fw_Radar_1R1V_rpc_XilObjBypassingRunnable_XilObjBypassingRunnable_m_pad_radarObjPort_par_out_local::TChangeableMemPool::_::_::_m_arrayPool::_0_::_elem::_m_objectInformation::_1_::_m_perObjectType::_m_prob1RoadsideBarrierN = 0;
      @sysvar::XCP::RadarFC_Obj::_g_PL_AD_fw_Radar_1R1V_rpc_XilObjBypassingRunnable_XilObjBypassingRunnable_m_pad_radarObjPort_par_out_local::TChangeableMemPool::_::_::_m_arrayPool::_0_::_elem::_m_objectInformation::_1_::_m_perObjectType::_m_prob1StatUnknownN = 128;
      @sysvar::XCP::RadarFC_Obj::_g_PL_AD_fw_Radar_1R1V_rpc_XilObjBypassingRunnable_XilObjBypassingRunnable_m_pad_radarObjPort_par_out_local::TChangeableMemPool::_::_::_m_arrayPool::_0_::_elem::_m_objectInformation::_1_::_m_perObjectType::_m_prob1PassengerCarN = 0;
      @sysvar::XCP::RadarFC_Obj::_g_PL_AD_fw_Radar_1R1V_rpc_XilObjBypassingRunnable_XilObjBypassingRunnable_m_pad_radarObjPort_par_out_local::TChangeableMemPool::_::_::_m_arrayPool::_0_::_elem::_m_objectInformation::_1_::_m_perObjectType::_m_prob1TruckN = 0;
      @sysvar::XCP::RadarFC_Obj::_g_PL_AD_fw_Radar_1R1V_rpc_XilObjBypassingRunnable_XilObjBypassingRunnable_m_pad_radarObjPort_par_out_local::TChangeableMemPool::_::_::_m_arrayPool::_0_::_elem::_m_objectInformation::_1_::_m_perObjectType::_m_prob1FourWheelUnknownN = 128;
      @sysvar::XCP::RadarFC_Obj::_g_PL_AD_fw_Radar_1R1V_rpc_XilObjBypassingRunnable_XilObjBypassingRunnable_m_pad_radarObjPort_par_out_local::TChangeableMemPool::_::_::_m_arrayPool::_0_::_elem::_m_objectInformation::_1_::_m_dWidthN = 256;
        break;

      case 2: //"RoadSideBarrier"
      @sysvar::XCP::RadarFC_Obj::_g_PL_AD_fw_Radar_1R1V_rpc_XilObjBypassingRunnable_XilObjBypassingRunnable_m_pad_radarObjPort_par_out_local::TChangeableMemPool::_::_::_m_arrayPool::_0_::_elem::_m_objectInformation::_1_::_m_perObjectType::_m_prob1ObstacleN = 128;
      @sysvar::XCP::RadarFC_Obj::_g_PL_AD_fw_Radar_1R1V_rpc_XilObjBypassingRunnable_XilObjBypassingRunnable_m_pad_radarObjPort_par_out_local::TChangeableMemPool::_::_::_m_arrayPool::_0_::_elem::_m_objectInformation::_1_::_m_perObjectType::_m_prob1NonObstacleN = 0;
      @sysvar::XCP::RadarFC_Obj::_g_PL_AD_fw_Radar_1R1V_rpc_XilObjBypassingRunnable_XilObjBypassingRunnable_m_pad_radarObjPort_par_out_local::TChangeableMemPool::_::_::_m_arrayPool::_0_::_elem::_m_objectInformation::_1_::_m_perObjectType::_m_prob1UnknownN = 0;
      @sysvar::XCP::RadarFC_Obj::_g_PL_AD_fw_Radar_1R1V_rpc_XilObjBypassingRunnable_XilObjBypassingRunnable_m_pad_radarObjPort_par_out_local::TChangeableMemPool::_::_::_m_arrayPool::_0_::_elem::_m_objectInformation::_1_::_m_perObjectType::_m_prob1MobileN = 0;
      @sysvar::XCP::RadarFC_Obj::_g_PL_AD_fw_Radar_1R1V_rpc_XilObjBypassingRunnable_XilObjBypassingRunnable_m_pad_radarObjPort_par_out_local::TChangeableMemPool::_::_::_m_arrayPool::_0_::_elem::_m_objectInformation::_1_::_m_perObjectType::_m_prob1StationaryN = 128;
      @sysvar::XCP::RadarFC_Obj::_g_PL_AD_fw_Radar_1R1V_rpc_XilObjBypassingRunnable_XilObjBypassingRunnable_m_pad_radarObjPort_par_out_local::TChangeableMemPool::_::_::_m_arrayPool::_0_::_elem::_m_objectInformation::_1_::_m_perObjectType::_m_prob1ObstUnknownN = 0;
      @sysvar::XCP::RadarFC_Obj::_g_PL_AD_fw_Radar_1R1V_rpc_XilObjBypassingRunnable_XilObjBypassingRunnable_m_pad_radarObjPort_par_out_local::TChangeableMemPool::_::_::_m_arrayPool::_0_::_elem::_m_objectInformation::_1_::_m_perObjectType::_m_prob1FourPlusWheelerN = 0;
      @sysvar::XCP::RadarFC_Obj::_g_PL_AD_fw_Radar_1R1V_rpc_XilObjBypassingRunnable_XilObjBypassingRunnable_m_pad_radarObjPort_par_out_local::TChangeableMemPool::_::_::_m_arrayPool::_0_::_elem::_m_objectInformation::_1_::_m_perObjectType::_m_prob1TwoWheelerN = 0;
      @sysvar::XCP::RadarFC_Obj::_g_PL_AD_fw_Radar_1R1V_rpc_XilObjBypassingRunnable_XilObjBypassingRunnable_m_pad_radarObjPort_par_out_local::TChangeableMemPool::_::_::_m_arrayPool::_0_::_elem::_m_objectInformation::_1_::_m_perObjectType::_m_prob1PedestrianN = 0;
      @sysvar::XCP::RadarFC_Obj::_g_PL_AD_fw_Radar_1R1V_rpc_XilObjBypassingRunnable_XilObjBypassingRunnable_m_pad_radarObjPort_par_out_local::TChangeableMemPool::_::_::_m_arrayPool::_0_::_elem::_m_objectInformation::_1_::_m_perObjectType::_m_prob1MovUnknownN = 128;
      @sysvar::XCP::RadarFC_Obj::_g_PL_AD_fw_Radar_1R1V_rpc_XilObjBypassingRunnable_XilObjBypassingRunnable_m_pad_radarObjPort_par_out_local::TChangeableMemPool::_::_::_m_arrayPool::_0_::_elem::_m_objectInformation::_1_::_m_perObjectType::_m_prob1RoadsideBarrierN = 128;
      @sysvar::XCP::RadarFC_Obj::_g_PL_AD_fw_Radar_1R1V_rpc_XilObjBypassingRunnable_XilObjBypassingRunnable_m_pad_radarObjPort_par_out_local::TChangeableMemPool::_::_::_m_arrayPool::_0_::_elem::_m_objectInformation::_1_::_m_perObjectType::_m_prob1StatUnknownN = 0;
      @sysvar::XCP::RadarFC_Obj::_g_PL_AD_fw_Radar_1R1V_rpc_XilObjBypassingRunnable_XilObjBypassingRunnable_m_pad_radarObjPort_par_out_local::TChangeableMemPool::_::_::_m_arrayPool::_0_::_elem::_m_objectInformation::_1_::_m_perObjectType::_m_prob1PassengerCarN = 0;
      @sysvar::XCP::RadarFC_Obj::_g_PL_AD_fw_Radar_1R1V_rpc_XilObjBypassingRunnable_XilObjBypassingRunnable_m_pad_radarObjPort_par_out_local::TChangeableMemPool::_::_::_m_arrayPool::_0_::_elem::_m_objectInformation::_1_::_m_perObjectType::_m_prob1TruckN = 0;
      @sysvar::XCP::RadarFC_Obj::_g_PL_AD_fw_Radar_1R1V_rpc_XilObjBypassingRunnable_XilObjBypassingRunnable_m_pad_radarObjPort_par_out_local::TChangeableMemPool::_::_::_m_arrayPool::_0_::_elem::_m_objectInformation::_1_::_m_perObjectType::_m_prob1FourWheelUnknownN = 128;
      @sysvar::XCP::RadarFC_Obj::_g_PL_AD_fw_Radar_1R1V_rpc_XilObjBypassingRunnable_XilObjBypassingRunnable_m_pad_radarObjPort_par_out_local::TChangeableMemPool::_::_::_m_arrayPool::_0_::_elem::_m_objectInformation::_1_::_m_dWidthN = 256;
        break;

      case 3: //"2Wheeler"
      @sysvar::XCP::RadarFC_Obj::_g_PL_AD_fw_Radar_1R1V_rpc_XilObjBypassingRunnable_XilObjBypassingRunnable_m_pad_radarObjPort_par_out_local::TChangeableMemPool::_::_::_m_arrayPool::_0_::_elem::_m_objectInformation::_1_::_m_perObjectType::_m_prob1ObstacleN = 128;
      @sysvar::XCP::RadarFC_Obj::_g_PL_AD_fw_Radar_1R1V_rpc_XilObjBypassingRunnable_XilObjBypassingRunnable_m_pad_radarObjPort_par_out_local::TChangeableMemPool::_::_::_m_arrayPool::_0_::_elem::_m_objectInformation::_1_::_m_perObjectType::_m_prob1NonObstacleN = 0;
      @sysvar::XCP::RadarFC_Obj::_g_PL_AD_fw_Radar_1R1V_rpc_XilObjBypassingRunnable_XilObjBypassingRunnable_m_pad_radarObjPort_par_out_local::TChangeableMemPool::_::_::_m_arrayPool::_0_::_elem::_m_objectInformation::_1_::_m_perObjectType::_m_prob1UnknownN = 0;
      @sysvar::XCP::RadarFC_Obj::_g_PL_AD_fw_Radar_1R1V_rpc_XilObjBypassingRunnable_XilObjBypassingRunnable_m_pad_radarObjPort_par_out_local::TChangeableMemPool::_::_::_m_arrayPool::_0_::_elem::_m_objectInformation::_1_::_m_perObjectType::_m_prob1MobileN = 128;
      @sysvar::XCP::RadarFC_Obj::_g_PL_AD_fw_Radar_1R1V_rpc_XilObjBypassingRunnable_XilObjBypassingRunnable_m_pad_radarObjPort_par_out_local::TChangeableMemPool::_::_::_m_arrayPool::_0_::_elem::_m_objectInformation::_1_::_m_perObjectType::_m_prob1StationaryN = 0;
      @sysvar::XCP::RadarFC_Obj::_g_PL_AD_fw_Radar_1R1V_rpc_XilObjBypassingRunnable_XilObjBypassingRunnable_m_pad_radarObjPort_par_out_local::TChangeableMemPool::_::_::_m_arrayPool::_0_::_elem::_m_objectInformation::_1_::_m_perObjectType::_m_prob1ObstUnknownN = 0;
      @sysvar::XCP::RadarFC_Obj::_g_PL_AD_fw_Radar_1R1V_rpc_XilObjBypassingRunnable_XilObjBypassingRunnable_m_pad_radarObjPort_par_out_local::TChangeableMemPool::_::_::_m_arrayPool::_0_::_elem::_m_objectInformation::_1_::_m_perObjectType::_m_prob1FourPlusWheelerN = 0;
      @sysvar::XCP::RadarFC_Obj::_g_PL_AD_fw_Radar_1R1V_rpc_XilObjBypassingRunnable_XilObjBypassingRunnable_m_pad_radarObjPort_par_out_local::TChangeableMemPool::_::_::_m_arrayPool::_0_::_elem::_m_objectInformation::_1_::_m_perObjectType::_m_prob1TwoWheelerN = 128;
      @sysvar::XCP::RadarFC_Obj::_g_PL_AD_fw_Radar_1R1V_rpc_XilObjBypassingRunnable_XilObjBypassingRunnable_m_pad_radarObjPort_par_out_local::TChangeableMemPool::_::_::_m_arrayPool::_0_::_elem::_m_objectInformation::_1_::_m_perObjectType::_m_prob1PedestrianN = 0;
      @sysvar::XCP::RadarFC_Obj::_g_PL_AD_fw_Radar_1R1V_rpc_XilObjBypassingRunnable_XilObjBypassingRunnable_m_pad_radarObjPort_par_out_local::TChangeableMemPool::_::_::_m_arrayPool::_0_::_elem::_m_objectInformation::_1_::_m_perObjectType::_m_prob1MovUnknownN = 0;
      @sysvar::XCP::RadarFC_Obj::_g_PL_AD_fw_Radar_1R1V_rpc_XilObjBypassingRunnable_XilObjBypassingRunnable_m_pad_radarObjPort_par_out_local::TChangeableMemPool::_::_::_m_arrayPool::_0_::_elem::_m_objectInformation::_1_::_m_perObjectType::_m_prob1RoadsideBarrierN = 0;
      @sysvar::XCP::RadarFC_Obj::_g_PL_AD_fw_Radar_1R1V_rpc_XilObjBypassingRunnable_XilObjBypassingRunnable_m_pad_radarObjPort_par_out_local::TChangeableMemPool::_::_::_m_arrayPool::_0_::_elem::_m_objectInformation::_1_::_m_perObjectType::_m_prob1StatUnknownN = 128;
      @sysvar::XCP::RadarFC_Obj::_g_PL_AD_fw_Radar_1R1V_rpc_XilObjBypassingRunnable_XilObjBypassingRunnable_m_pad_radarObjPort_par_out_local::TChangeableMemPool::_::_::_m_arrayPool::_0_::_elem::_m_objectInformation::_1_::_m_perObjectType::_m_prob1PassengerCarN = 0;
      @sysvar::XCP::RadarFC_Obj::_g_PL_AD_fw_Radar_1R1V_rpc_XilObjBypassingRunnable_XilObjBypassingRunnable_m_pad_radarObjPort_par_out_local::TChangeableMemPool::_::_::_m_arrayPool::_0_::_elem::_m_objectInformation::_1_::_m_perObjectType::_m_prob1TruckN = 0;
      @sysvar::XCP::RadarFC_Obj::_g_PL_AD_fw_Radar_1R1V_rpc_XilObjBypassingRunnable_XilObjBypassingRunnable_m_pad_radarObjPort_par_out_local::TChangeableMemPool::_::_::_m_arrayPool::_0_::_elem::_m_objectInformation::_1_::_m_perObjectType::_m_prob1FourWheelUnknownN = 128;
      @sysvar::XCP::RadarFC_Obj::_g_PL_AD_fw_Radar_1R1V_rpc_XilObjBypassingRunnable_XilObjBypassingRunnable_m_pad_radarObjPort_par_out_local::TChangeableMemPool::_::_::_m_arrayPool::_0_::_elem::_m_objectInformation::_1_::_m_dWidthN = 64;
        break;

      case 4: //"Pedestrian"
      @sysvar::XCP::RadarFC_Obj::_g_PL_AD_fw_Radar_1R1V_rpc_XilObjBypassingRunnable_XilObjBypassingRunnable_m_pad_radarObjPort_par_out_local::TChangeableMemPool::_::_::_m_arrayPool::_0_::_elem::_m_objectInformation::_1_::_m_perObjectType::_m_prob1ObstacleN = 128;
      @sysvar::XCP::RadarFC_Obj::_g_PL_AD_fw_Radar_1R1V_rpc_XilObjBypassingRunnable_XilObjBypassingRunnable_m_pad_radarObjPort_par_out_local::TChangeableMemPool::_::_::_m_arrayPool::_0_::_elem::_m_objectInformation::_1_::_m_perObjectType::_m_prob1NonObstacleN = 0;
      @sysvar::XCP::RadarFC_Obj::_g_PL_AD_fw_Radar_1R1V_rpc_XilObjBypassingRunnable_XilObjBypassingRunnable_m_pad_radarObjPort_par_out_local::TChangeableMemPool::_::_::_m_arrayPool::_0_::_elem::_m_objectInformation::_1_::_m_perObjectType::_m_prob1UnknownN = 0;
      @sysvar::XCP::RadarFC_Obj::_g_PL_AD_fw_Radar_1R1V_rpc_XilObjBypassingRunnable_XilObjBypassingRunnable_m_pad_radarObjPort_par_out_local::TChangeableMemPool::_::_::_m_arrayPool::_0_::_elem::_m_objectInformation::_1_::_m_perObjectType::_m_prob1MobileN = 128;
      @sysvar::XCP::RadarFC_Obj::_g_PL_AD_fw_Radar_1R1V_rpc_XilObjBypassingRunnable_XilObjBypassingRunnable_m_pad_radarObjPort_par_out_local::TChangeableMemPool::_::_::_m_arrayPool::_0_::_elem::_m_objectInformation::_1_::_m_perObjectType::_m_prob1StationaryN = 0;
      @sysvar::XCP::RadarFC_Obj::_g_PL_AD_fw_Radar_1R1V_rpc_XilObjBypassingRunnable_XilObjBypassingRunnable_m_pad_radarObjPort_par_out_local::TChangeableMemPool::_::_::_m_arrayPool::_0_::_elem::_m_objectInformation::_1_::_m_perObjectType::_m_prob1ObstUnknownN = 0;
      @sysvar::XCP::RadarFC_Obj::_g_PL_AD_fw_Radar_1R1V_rpc_XilObjBypassingRunnable_XilObjBypassingRunnable_m_pad_radarObjPort_par_out_local::TChangeableMemPool::_::_::_m_arrayPool::_0_::_elem::_m_objectInformation::_1_::_m_perObjectType::_m_prob1FourPlusWheelerN = 0;
      @sysvar::XCP::RadarFC_Obj::_g_PL_AD_fw_Radar_1R1V_rpc_XilObjBypassingRunnable_XilObjBypassingRunnable_m_pad_radarObjPort_par_out_local::TChangeableMemPool::_::_::_m_arrayPool::_0_::_elem::_m_objectInformation::_1_::_m_perObjectType::_m_prob1TwoWheelerN = 0;
      @sysvar::XCP::RadarFC_Obj::_g_PL_AD_fw_Radar_1R1V_rpc_XilObjBypassingRunnable_XilObjBypassingRunnable_m_pad_radarObjPort_par_out_local::TChangeableMemPool::_::_::_m_arrayPool::_0_::_elem::_m_objectInformation::_1_::_m_perObjectType::_m_prob1PedestrianN = 128;
      @sysvar::XCP::RadarFC_Obj::_g_PL_AD_fw_Radar_1R1V_rpc_XilObjBypassingRunnable_XilObjBypassingRunnable_m_pad_radarObjPort_par_out_local::TChangeableMemPool::_::_::_m_arrayPool::_0_::_elem::_m_objectInformation::_1_::_m_perObjectType::_m_prob1MovUnknownN = 0;
      @sysvar::XCP::RadarFC_Obj::_g_PL_AD_fw_Radar_1R1V_rpc_XilObjBypassingRunnable_XilObjBypassingRunnable_m_pad_radarObjPort_par_out_local::TChangeableMemPool::_::_::_m_arrayPool::_0_::_elem::_m_objectInformation::_1_::_m_perObjectType::_m_prob1RoadsideBarrierN = 0;
      @sysvar::XCP::RadarFC_Obj::_g_PL_AD_fw_Radar_1R1V_rpc_XilObjBypassingRunnable_XilObjBypassingRunnable_m_pad_radarObjPort_par_out_local::TChangeableMemPool::_::_::_m_arrayPool::_0_::_elem::_m_objectInformation::_1_::_m_perObjectType::_m_prob1StatUnknownN = 128;
      @sysvar::XCP::RadarFC_Obj::_g_PL_AD_fw_Radar_1R1V_rpc_XilObjBypassingRunnable_XilObjBypassingRunnable_m_pad_radarObjPort_par_out_local::TChangeableMemPool::_::_::_m_arrayPool::_0_::_elem::_m_objectInformation::_1_::_m_perObjectType::_m_prob1PassengerCarN = 0;
      @sysvar::XCP::RadarFC_Obj::_g_PL_AD_fw_Radar_1R1V_rpc_XilObjBypassingRunnable_XilObjBypassingRunnable_m_pad_radarObjPort_par_out_local::TChangeableMemPool::_::_::_m_arrayPool::_0_::_elem::_m_objectInformation::_1_::_m_perObjectType::_m_prob1TruckN = 0;
      @sysvar::XCP::RadarFC_Obj::_g_PL_AD_fw_Radar_1R1V_rpc_XilObjBypassingRunnable_XilObjBypassingRunnable_m_pad_radarObjPort_par_out_local::TChangeableMemPool::_::_::_m_arrayPool::_0_::_elem::_m_objectInformation::_1_::_m_perObjectType::_m_prob1FourWheelUnknownN = 128;
      @sysvar::XCP::RadarFC_Obj::_g_PL_AD_fw_Radar_1R1V_rpc_XilObjBypassingRunnable_XilObjBypassingRunnable_m_pad_radarObjPort_par_out_local::TChangeableMemPool::_::_::_m_arrayPool::_0_::_elem::_m_objectInformation::_1_::_m_dWidthN = 64;
        break;

      case 5: //"Truck"
      @sysvar::XCP::RadarFC_Obj::_g_PL_AD_fw_Radar_1R1V_rpc_XilObjBypassingRunnable_XilObjBypassingRunnable_m_pad_radarObjPort_par_out_local::TChangeableMemPool::_::_::_m_arrayPool::_0_::_elem::_m_objectInformation::_1_::_m_perObjectType::_m_prob1ObstacleN = 128;
      @sysvar::XCP::RadarFC_Obj::_g_PL_AD_fw_Radar_1R1V_rpc_XilObjBypassingRunnable_XilObjBypassingRunnable_m_pad_radarObjPort_par_out_local::TChangeableMemPool::_::_::_m_arrayPool::_0_::_elem::_m_objectInformation::_1_::_m_perObjectType::_m_prob1NonObstacleN = 0;
      @sysvar::XCP::RadarFC_Obj::_g_PL_AD_fw_Radar_1R1V_rpc_XilObjBypassingRunnable_XilObjBypassingRunnable_m_pad_radarObjPort_par_out_local::TChangeableMemPool::_::_::_m_arrayPool::_0_::_elem::_m_objectInformation::_1_::_m_perObjectType::_m_prob1UnknownN = 0;
      @sysvar::XCP::RadarFC_Obj::_g_PL_AD_fw_Radar_1R1V_rpc_XilObjBypassingRunnable_XilObjBypassingRunnable_m_pad_radarObjPort_par_out_local::TChangeableMemPool::_::_::_m_arrayPool::_0_::_elem::_m_objectInformation::_1_::_m_perObjectType::_m_prob1MobileN = 128;
      @sysvar::XCP::RadarFC_Obj::_g_PL_AD_fw_Radar_1R1V_rpc_XilObjBypassingRunnable_XilObjBypassingRunnable_m_pad_radarObjPort_par_out_local::TChangeableMemPool::_::_::_m_arrayPool::_0_::_elem::_m_objectInformation::_1_::_m_perObjectType::_m_prob1StationaryN = 0;
      @sysvar::XCP::RadarFC_Obj::_g_PL_AD_fw_Radar_1R1V_rpc_XilObjBypassingRunnable_XilObjBypassingRunnable_m_pad_radarObjPort_par_out_local::TChangeableMemPool::_::_::_m_arrayPool::_0_::_elem::_m_objectInformation::_1_::_m_perObjectType::_m_prob1ObstUnknownN = 0;
      @sysvar::XCP::RadarFC_Obj::_g_PL_AD_fw_Radar_1R1V_rpc_XilObjBypassingRunnable_XilObjBypassingRunnable_m_pad_radarObjPort_par_out_local::TChangeableMemPool::_::_::_m_arrayPool::_0_::_elem::_m_objectInformation::_1_::_m_perObjectType::_m_prob1FourPlusWheelerN = 128;
      @sysvar::XCP::RadarFC_Obj::_g_PL_AD_fw_Radar_1R1V_rpc_XilObjBypassingRunnable_XilObjBypassingRunnable_m_pad_radarObjPort_par_out_local::TChangeableMemPool::_::_::_m_arrayPool::_0_::_elem::_m_objectInformation::_1_::_m_perObjectType::_m_prob1TwoWheelerN = 0;
      @sysvar::XCP::RadarFC_Obj::_g_PL_AD_fw_Radar_1R1V_rpc_XilObjBypassingRunnable_XilObjBypassingRunnable_m_pad_radarObjPort_par_out_local::TChangeableMemPool::_::_::_m_arrayPool::_0_::_elem::_m_objectInformation::_1_::_m_perObjectType::_m_prob1PedestrianN = 0;
      @sysvar::XCP::RadarFC_Obj::_g_PL_AD_fw_Radar_1R1V_rpc_XilObjBypassingRunnable_XilObjBypassingRunnable_m_pad_radarObjPort_par_out_local::TChangeableMemPool::_::_::_m_arrayPool::_0_::_elem::_m_objectInformation::_1_::_m_perObjectType::_m_prob1MovUnknownN = 0;
      @sysvar::XCP::RadarFC_Obj::_g_PL_AD_fw_Radar_1R1V_rpc_XilObjBypassingRunnable_XilObjBypassingRunnable_m_pad_radarObjPort_par_out_local::TChangeableMemPool::_::_::_m_arrayPool::_0_::_elem::_m_objectInformation::_1_::_m_perObjectType::_m_prob1RoadsideBarrierN = 0;
      @sysvar::XCP::RadarFC_Obj::_g_PL_AD_fw_Radar_1R1V_rpc_XilObjBypassingRunnable_XilObjBypassingRunnable_m_pad_radarObjPort_par_out_local::TChangeableMemPool::_::_::_m_arrayPool::_0_::_elem::_m_objectInformation::_1_::_m_perObjectType::_m_prob1StatUnknownN = 128;
      @sysvar::XCP::RadarFC_Obj::_g_PL_AD_fw_Radar_1R1V_rpc_XilObjBypassingRunnable_XilObjBypassingRunnable_m_pad_radarObjPort_par_out_local::TChangeableMemPool::_::_::_m_arrayPool::_0_::_elem::_m_objectInformation::_1_::_m_perObjectType::_m_prob1PassengerCarN = 0;
      @sysvar::XCP::RadarFC_Obj::_g_PL_AD_fw_Radar_1R1V_rpc_XilObjBypassingRunnable_XilObjBypassingRunnable_m_pad_radarObjPort_par_out_local::TChangeableMemPool::_::_::_m_arrayPool::_0_::_elem::_m_objectInformation::_1_::_m_perObjectType::_m_prob1TruckN = 128;
      @sysvar::XCP::RadarFC_Obj::_g_PL_AD_fw_Radar_1R1V_rpc_XilObjBypassingRunnable_XilObjBypassingRunnable_m_pad_radarObjPort_par_out_local::TChangeableMemPool::_::_::_m_arrayPool::_0_::_elem::_m_objectInformation::_1_::_m_perObjectType::_m_prob1FourWheelUnknownN = 0;
      @sysvar::XCP::RadarFC_Obj::_g_PL_AD_fw_Radar_1R1V_rpc_XilObjBypassingRunnable_XilObjBypassingRunnable_m_pad_radarObjPort_par_out_local::TChangeableMemPool::_::_::_m_arrayPool::_0_::_elem::_m_objectInformation::_1_::_m_dWidthN = 256;
        break;

      case 6: //"PassengerCar"
      @sysvar::XCP::RadarFC_Obj::_g_PL_AD_fw_Radar_1R1V_rpc_XilObjBypassingRunnable_XilObjBypassingRunnable_m_pad_radarObjPort_par_out_local::TChangeableMemPool::_::_::_m_arrayPool::_0_::_elem::_m_objectInformation::_1_::_m_perObjectType::_m_prob1ObstacleN = 128;
      @sysvar::XCP::RadarFC_Obj::_g_PL_AD_fw_Radar_1R1V_rpc_XilObjBypassingRunnable_XilObjBypassingRunnable_m_pad_radarObjPort_par_out_local::TChangeableMemPool::_::_::_m_arrayPool::_0_::_elem::_m_objectInformation::_1_::_m_perObjectType::_m_prob1NonObstacleN = 0;
      @sysvar::XCP::RadarFC_Obj::_g_PL_AD_fw_Radar_1R1V_rpc_XilObjBypassingRunnable_XilObjBypassingRunnable_m_pad_radarObjPort_par_out_local::TChangeableMemPool::_::_::_m_arrayPool::_0_::_elem::_m_objectInformation::_1_::_m_perObjectType::_m_prob1UnknownN = 0;
      @sysvar::XCP::RadarFC_Obj::_g_PL_AD_fw_Radar_1R1V_rpc_XilObjBypassingRunnable_XilObjBypassingRunnable_m_pad_radarObjPort_par_out_local::TChangeableMemPool::_::_::_m_arrayPool::_0_::_elem::_m_objectInformation::_1_::_m_perObjectType::_m_prob1MobileN = 128;
      @sysvar::XCP::RadarFC_Obj::_g_PL_AD_fw_Radar_1R1V_rpc_XilObjBypassingRunnable_XilObjBypassingRunnable_m_pad_radarObjPort_par_out_local::TChangeableMemPool::_::_::_m_arrayPool::_0_::_elem::_m_objectInformation::_1_::_m_perObjectType::_m_prob1StationaryN = 0;
      @sysvar::XCP::RadarFC_Obj::_g_PL_AD_fw_Radar_1R1V_rpc_XilObjBypassingRunnable_XilObjBypassingRunnable_m_pad_radarObjPort_par_out_local::TChangeableMemPool::_::_::_m_arrayPool::_0_::_elem::_m_objectInformation::_1_::_m_perObjectType::_m_prob1ObstUnknownN = 0;
      @sysvar::XCP::RadarFC_Obj::_g_PL_AD_fw_Radar_1R1V_rpc_XilObjBypassingRunnable_XilObjBypassingRunnable_m_pad_radarObjPort_par_out_local::TChangeableMemPool::_::_::_m_arrayPool::_0_::_elem::_m_objectInformation::_1_::_m_perObjectType::_m_prob1FourPlusWheelerN = 128;
      @sysvar::XCP::RadarFC_Obj::_g_PL_AD_fw_Radar_1R1V_rpc_XilObjBypassingRunnable_XilObjBypassingRunnable_m_pad_radarObjPort_par_out_local::TChangeableMemPool::_::_::_m_arrayPool::_0_::_elem::_m_objectInformation::_1_::_m_perObjectType::_m_prob1TwoWheelerN = 0;
      @sysvar::XCP::RadarFC_Obj::_g_PL_AD_fw_Radar_1R1V_rpc_XilObjBypassingRunnable_XilObjBypassingRunnable_m_pad_radarObjPort_par_out_local::TChangeableMemPool::_::_::_m_arrayPool::_0_::_elem::_m_objectInformation::_1_::_m_perObjectType::_m_prob1PedestrianN = 0;
      @sysvar::XCP::RadarFC_Obj::_g_PL_AD_fw_Radar_1R1V_rpc_XilObjBypassingRunnable_XilObjBypassingRunnable_m_pad_radarObjPort_par_out_local::TChangeableMemPool::_::_::_m_arrayPool::_0_::_elem::_m_objectInformation::_1_::_m_perObjectType::_m_prob1MovUnknownN = 0;
      @sysvar::XCP::RadarFC_Obj::_g_PL_AD_fw_Radar_1R1V_rpc_XilObjBypassingRunnable_XilObjBypassingRunnable_m_pad_radarObjPort_par_out_local::TChangeableMemPool::_::_::_m_arrayPool::_0_::_elem::_m_objectInformation::_1_::_m_perObjectType::_m_prob1RoadsideBarrierN = 0;
      @sysvar::XCP::RadarFC_Obj::_g_PL_AD_fw_Radar_1R1V_rpc_XilObjBypassingRunnable_XilObjBypassingRunnable_m_pad_radarObjPort_par_out_local::TChangeableMemPool::_::_::_m_arrayPool::_0_::_elem::_m_objectInformation::_1_::_m_perObjectType::_m_prob1StatUnknownN = 128;
      @sysvar::XCP::RadarFC_Obj::_g_PL_AD_fw_Radar_1R1V_rpc_XilObjBypassingRunnable_XilObjBypassingRunnable_m_pad_radarObjPort_par_out_local::TChangeableMemPool::_::_::_m_arrayPool::_0_::_elem::_m_objectInformation::_1_::_m_perObjectType::_m_prob1PassengerCarN = 128;
      @sysvar::XCP::RadarFC_Obj::_g_PL_AD_fw_Radar_1R1V_rpc_XilObjBypassingRunnable_XilObjBypassingRunnable_m_pad_radarObjPort_par_out_local::TChangeableMemPool::_::_::_m_arrayPool::_0_::_elem::_m_objectInformation::_1_::_m_perObjectType::_m_prob1TruckN = 0;
      @sysvar::XCP::RadarFC_Obj::_g_PL_AD_fw_Radar_1R1V_rpc_XilObjBypassingRunnable_XilObjBypassingRunnable_m_pad_radarObjPort_par_out_local::TChangeableMemPool::_::_::_m_arrayPool::_0_::_elem::_m_objectInformation::_1_::_m_perObjectType::_m_prob1FourWheelUnknownN = 0;
      @sysvar::XCP::RadarFC_Obj::_g_PL_AD_fw_Radar_1R1V_rpc_XilObjBypassingRunnable_XilObjBypassingRunnable_m_pad_radarObjPort_par_out_local::TChangeableMemPool::_::_::_m_arrayPool::_0_::_elem::_m_objectInformation::_1_::_m_dWidthN = 256;
        break;
    }
    break;

    case 2: //"Object-2"
    //constant
  @sysvar::XCP::RadarFC_Obj::_g_PL_AD_fw_Radar_1R1V_rpc_XilObjBypassingRunnable_XilObjBypassingRunnable_m_pad_radarObjPort_par_out_local::TChangeableMemPool::_::_::_m_arrayPool::_0_::_elem::_m_objectInformation::_2_::_Valid_b = 1;
  @sysvar::XCP::RadarFC_Obj::_g_PL_AD_fw_Radar_1R1V_rpc_XilObjBypassingRunnable_XilObjBypassingRunnable_m_pad_radarObjPort_par_out_local::TChangeableMemPool::_::_::_m_arrayPool::_0_::_elem::_m_objectInformation::_2_::_m_HandleN = 1;
  @sysvar::XCP::RadarFC_Obj::_g_PL_AD_fw_Radar_1R1V_rpc_XilObjBypassingRunnable_XilObjBypassingRunnable_m_pad_radarObjPort_par_out_local::TChangeableMemPool::_::_::_m_arrayPool::_0_::_elem::_m_objectInformation::_2_::_m_alpPiVarYawAngleN = 0;
  @sysvar::XCP::RadarFC_Obj::_g_PL_AD_fw_Radar_1R1V_rpc_XilObjBypassingRunnable_XilObjBypassingRunnable_m_pad_radarObjPort_par_out_local::TChangeableMemPool::_::_::_m_arrayPool::_0_::_elem::_m_objectInformation::_2_::_m_alpPiYawAngleN = 0;
  @sysvar::XCP::RadarFC_Obj::_g_PL_AD_fw_Radar_1R1V_rpc_XilObjBypassingRunnable_XilObjBypassingRunnable_m_pad_radarObjPort_par_out_local::TChangeableMemPool::_::_::_m_arrayPool::_0_::_elem::_m_objectInformation::_2_::_m_varAxN = 0;
  @sysvar::XCP::RadarFC_Obj::_g_PL_AD_fw_Radar_1R1V_rpc_XilObjBypassingRunnable_XilObjBypassingRunnable_m_pad_radarObjPort_par_out_local::TChangeableMemPool::_::_::_m_arrayPool::_0_::_elem::_m_objectInformation::_2_::_m_varAyN = 0;
  @sysvar::XCP::RadarFC_Obj::_g_PL_AD_fw_Radar_1R1V_rpc_XilObjBypassingRunnable_XilObjBypassingRunnable_m_pad_radarObjPort_par_out_local::TChangeableMemPool::_::_::_m_arrayPool::_0_::_elem::_m_objectInformation::_2_::_m_varVxN = 0;
  @sysvar::XCP::RadarFC_Obj::_g_PL_AD_fw_Radar_1R1V_rpc_XilObjBypassingRunnable_XilObjBypassingRunnable_m_pad_radarObjPort_par_out_local::TChangeableMemPool::_::_::_m_arrayPool::_0_::_elem::_m_objectInformation::_2_::_m_varVyN = 0;
  @sysvar::XCP::RadarFC_Obj::_g_PL_AD_fw_Radar_1R1V_rpc_XilObjBypassingRunnable_XilObjBypassingRunnable_m_pad_radarObjPort_par_out_local::TChangeableMemPool::_::_::_m_arrayPool::_0_::_elem::_m_objectInformation::_2_::_m_varDxN = 0;
  @sysvar::XCP::RadarFC_Obj::_g_PL_AD_fw_Radar_1R1V_rpc_XilObjBypassingRunnable_XilObjBypassingRunnable_m_pad_radarObjPort_par_out_local::TChangeableMemPool::_::_::_m_arrayPool::_0_::_elem::_m_objectInformation::_2_::_m_varDyN = 0;
  @sysvar::XCP::RadarFC_Obj::_g_PL_AD_fw_Radar_1R1V_rpc_XilObjBypassingRunnable_XilObjBypassingRunnable_m_pad_radarObjPort_par_out_local::TChangeableMemPool::_::_::_m_arrayPool::_0_::_elem::_m_objectInformation::_2_::_m_dVarLengthN = 0;
  @sysvar::XCP::RadarFC_Obj::_g_PL_AD_fw_Radar_1R1V_rpc_XilObjBypassingRunnable_XilObjBypassingRunnable_m_pad_radarObjPort_par_out_local::TChangeableMemPool::_::_::_m_arrayPool::_0_::_elem::_m_objectInformation::_2_::_m_dVarWidthN = 0;
  @sysvar::XCP::RadarFC_Obj::_g_PL_AD_fw_Radar_1R1V_rpc_XilObjBypassingRunnable_XilObjBypassingRunnable_m_pad_radarObjPort_par_out_local::TChangeableMemPool::_::_::_m_arrayPool::_0_::_elem::_m_objectInformation::_2_::_m_wExistProbN = 64880;
  @sysvar::XCP::RadarFC_Obj::_g_PL_AD_fw_Radar_1R1V_rpc_XilObjBypassingRunnable_XilObjBypassingRunnable_m_pad_radarObjPort_par_out_local::TChangeableMemPool::_::_::_m_arrayPool::_0_::_elem::_m_objectInformation::_2_::_m_isObjectAsil = 1;
  @sysvar::XCP::RadarFC_Obj::_g_PL_AD_fw_Radar_1R1V_rpc_XilObjBypassingRunnable_XilObjBypassingRunnable_m_pad_radarObjPort_par_out_local::TChangeableMemPool::_::_::_m_arrayPool::_0_::_elem::_m_objectInformation::_2_::_m_dLengthN = 128;

    //target movement

  @sysvar::XCP::RadarFC_Obj::_g_PL_AD_fw_Radar_1R1V_rpc_XilObjBypassingRunnable_XilObjBypassingRunnable_m_pad_radarObjPort_par_out_local::TChangeableMemPool::_::_::_m_arrayPool::_0_::_elem::_m_objectInformation::_2_::_m_dxN = @target_radar_fc_sim::objdata.obj_distance_x[2] * 128;
  @sysvar::XCP::RadarFC_Obj::_g_PL_AD_fw_Radar_1R1V_rpc_XilObjBypassingRunnable_XilObjBypassingRunnable_m_pad_radarObjPort_par_out_local::TChangeableMemPool::_::_::_m_arrayPool::_0_::_elem::_m_objectInformation::_2_::_m_dyN = @target_radar_fc_sim::objdata.obj_distance_y[2] * 128;
  @sysvar::XCP::RadarFC_Obj::_g_PL_AD_fw_Radar_1R1V_rpc_XilObjBypassingRunnable_XilObjBypassingRunnable_m_pad_radarObjPort_par_out_local::TChangeableMemPool::_::_::_m_arrayPool::_0_::_elem::_m_objectInformation::_2_::_m_dzN = 0;
  @sysvar::XCP::RadarFC_Obj::_g_PL_AD_fw_Radar_1R1V_rpc_XilObjBypassingRunnable_XilObjBypassingRunnable_m_pad_radarObjPort_par_out_local::TChangeableMemPool::_::_::_m_arrayPool::_0_::_elem::_m_objectInformation::_2_::_m_vxN = @target_radar_fc_sim::objdata.obj_velocity_x[2] * 256;
  @sysvar::XCP::RadarFC_Obj::_g_PL_AD_fw_Radar_1R1V_rpc_XilObjBypassingRunnable_XilObjBypassingRunnable_m_pad_radarObjPort_par_out_local::TChangeableMemPool::_::_::_m_arrayPool::_0_::_elem::_m_objectInformation::_2_::_m_vyN = @target_radar_fc_sim::objdata.obj_velocity_y[2] * 256;
  @sysvar::XCP::RadarFC_Obj::_g_PL_AD_fw_Radar_1R1V_rpc_XilObjBypassingRunnable_XilObjBypassingRunnable_m_pad_radarObjPort_par_out_local::TChangeableMemPool::_::_::_m_arrayPool::_0_::_elem::_m_objectInformation::_2_::_m_axN = 0;
  @sysvar::XCP::RadarFC_Obj::_g_PL_AD_fw_Radar_1R1V_rpc_XilObjBypassingRunnable_XilObjBypassingRunnable_m_pad_radarObjPort_par_out_local::TChangeableMemPool::_::_::_m_arrayPool::_0_::_elem::_m_objectInformation::_2_::_m_ayN = 0;

    //target object moving or not
    if (abs(@target_radar_fc_sim::objdata.obj_velocity_x[2]) != 0)
    {
    @sysvar::XCP::RadarFC_Obj::_g_PL_AD_fw_Radar_1R1V_rpc_XilObjBypassingRunnable_XilObjBypassingRunnable_m_pad_radarObjPort_par_out_local::TChangeableMemPool::_::_::_m_arrayPool::_0_::_elem::_m_objectInformation::_2_::_m_prob1HasBeenObservedMovingN = 126;
    @sysvar::XCP::RadarFC_Obj::_g_PL_AD_fw_Radar_1R1V_rpc_XilObjBypassingRunnable_XilObjBypassingRunnable_m_pad_radarObjPort_par_out_local::TChangeableMemPool::_::_::_m_arrayPool::_0_::_elem::_m_objectInformation::_2_::_m_prob1MovingN = 126;
    }
    else
    {
    @sysvar::XCP::RadarFC_Obj::_g_PL_AD_fw_Radar_1R1V_rpc_XilObjBypassingRunnable_XilObjBypassingRunnable_m_pad_radarObjPort_par_out_local::TChangeableMemPool::_::_::_m_arrayPool::_0_::_elem::_m_objectInformation::_2_::_m_prob1HasBeenObservedMovingN = 0;
    @sysvar::XCP::RadarFC_Obj::_g_PL_AD_fw_Radar_1R1V_rpc_XilObjBypassingRunnable_XilObjBypassingRunnable_m_pad_radarObjPort_par_out_local::TChangeableMemPool::_::_::_m_arrayPool::_0_::_elem::_m_objectInformation::_2_::_m_prob1MovingN = 0;
    }

      //object classification
    switch (@target_radar_fc_sim::objdata.obj_type[2])
    {
      case 0: //"Non-Obstacle"
      @sysvar::XCP::RadarFC_Obj::_g_PL_AD_fw_Radar_1R1V_rpc_XilObjBypassingRunnable_XilObjBypassingRunnable_m_pad_radarObjPort_par_out_local::TChangeableMemPool::_::_::_m_arrayPool::_0_::_elem::_m_objectInformation::_2_::_m_perObjectType::_m_prob1ObstacleN = 0;
      @sysvar::XCP::RadarFC_Obj::_g_PL_AD_fw_Radar_1R1V_rpc_XilObjBypassingRunnable_XilObjBypassingRunnable_m_pad_radarObjPort_par_out_local::TChangeableMemPool::_::_::_m_arrayPool::_0_::_elem::_m_objectInformation::_2_::_m_perObjectType::_m_prob1NonObstacleN = 128;
      @sysvar::XCP::RadarFC_Obj::_g_PL_AD_fw_Radar_1R1V_rpc_XilObjBypassingRunnable_XilObjBypassingRunnable_m_pad_radarObjPort_par_out_local::TChangeableMemPool::_::_::_m_arrayPool::_0_::_elem::_m_objectInformation::_2_::_m_perObjectType::_m_prob1UnknownN = 0;
      @sysvar::XCP::RadarFC_Obj::_g_PL_AD_fw_Radar_1R1V_rpc_XilObjBypassingRunnable_XilObjBypassingRunnable_m_pad_radarObjPort_par_out_local::TChangeableMemPool::_::_::_m_arrayPool::_0_::_elem::_m_objectInformation::_2_::_m_perObjectType::_m_prob1MobileN = 0;
      @sysvar::XCP::RadarFC_Obj::_g_PL_AD_fw_Radar_1R1V_rpc_XilObjBypassingRunnable_XilObjBypassingRunnable_m_pad_radarObjPort_par_out_local::TChangeableMemPool::_::_::_m_arrayPool::_0_::_elem::_m_objectInformation::_2_::_m_perObjectType::_m_prob1StationaryN = 0;
      @sysvar::XCP::RadarFC_Obj::_g_PL_AD_fw_Radar_1R1V_rpc_XilObjBypassingRunnable_XilObjBypassingRunnable_m_pad_radarObjPort_par_out_local::TChangeableMemPool::_::_::_m_arrayPool::_0_::_elem::_m_objectInformation::_2_::_m_perObjectType::_m_prob1ObstUnknownN = 128;
      @sysvar::XCP::RadarFC_Obj::_g_PL_AD_fw_Radar_1R1V_rpc_XilObjBypassingRunnable_XilObjBypassingRunnable_m_pad_radarObjPort_par_out_local::TChangeableMemPool::_::_::_m_arrayPool::_0_::_elem::_m_objectInformation::_2_::_m_perObjectType::_m_prob1FourPlusWheelerN = 0;
      @sysvar::XCP::RadarFC_Obj::_g_PL_AD_fw_Radar_1R1V_rpc_XilObjBypassingRunnable_XilObjBypassingRunnable_m_pad_radarObjPort_par_out_local::TChangeableMemPool::_::_::_m_arrayPool::_0_::_elem::_m_objectInformation::_2_::_m_perObjectType::_m_prob1TwoWheelerN = 0;
      @sysvar::XCP::RadarFC_Obj::_g_PL_AD_fw_Radar_1R1V_rpc_XilObjBypassingRunnable_XilObjBypassingRunnable_m_pad_radarObjPort_par_out_local::TChangeableMemPool::_::_::_m_arrayPool::_0_::_elem::_m_objectInformation::_2_::_m_perObjectType::_m_prob1PedestrianN = 0;
      @sysvar::XCP::RadarFC_Obj::_g_PL_AD_fw_Radar_1R1V_rpc_XilObjBypassingRunnable_XilObjBypassingRunnable_m_pad_radarObjPort_par_out_local::TChangeableMemPool::_::_::_m_arrayPool::_0_::_elem::_m_objectInformation::_2_::_m_perObjectType::_m_prob1MovUnknownN = 128;
      @sysvar::XCP::RadarFC_Obj::_g_PL_AD_fw_Radar_1R1V_rpc_XilObjBypassingRunnable_XilObjBypassingRunnable_m_pad_radarObjPort_par_out_local::TChangeableMemPool::_::_::_m_arrayPool::_0_::_elem::_m_objectInformation::_2_::_m_perObjectType::_m_prob1RoadsideBarrierN = 0;
      @sysvar::XCP::RadarFC_Obj::_g_PL_AD_fw_Radar_1R1V_rpc_XilObjBypassingRunnable_XilObjBypassingRunnable_m_pad_radarObjPort_par_out_local::TChangeableMemPool::_::_::_m_arrayPool::_0_::_elem::_m_objectInformation::_2_::_m_perObjectType::_m_prob1StatUnknownN = 128;
      @sysvar::XCP::RadarFC_Obj::_g_PL_AD_fw_Radar_1R1V_rpc_XilObjBypassingRunnable_XilObjBypassingRunnable_m_pad_radarObjPort_par_out_local::TChangeableMemPool::_::_::_m_arrayPool::_0_::_elem::_m_objectInformation::_2_::_m_perObjectType::_m_prob1PassengerCarN = 0;
      @sysvar::XCP::RadarFC_Obj::_g_PL_AD_fw_Radar_1R1V_rpc_XilObjBypassingRunnable_XilObjBypassingRunnable_m_pad_radarObjPort_par_out_local::TChangeableMemPool::_::_::_m_arrayPool::_0_::_elem::_m_objectInformation::_2_::_m_perObjectType::_m_prob1TruckN = 0;
      @sysvar::XCP::RadarFC_Obj::_g_PL_AD_fw_Radar_1R1V_rpc_XilObjBypassingRunnable_XilObjBypassingRunnable_m_pad_radarObjPort_par_out_local::TChangeableMemPool::_::_::_m_arrayPool::_0_::_elem::_m_objectInformation::_2_::_m_perObjectType::_m_prob1FourWheelUnknownN = 128;
      @sysvar::XCP::RadarFC_Obj::_g_PL_AD_fw_Radar_1R1V_rpc_XilObjBypassingRunnable_XilObjBypassingRunnable_m_pad_radarObjPort_par_out_local::TChangeableMemPool::_::_::_m_arrayPool::_0_::_elem::_m_objectInformation::_2_::_m_dWidthN = 256;
        break;

      case 1: //"unknown"
      @sysvar::XCP::RadarFC_Obj::_g_PL_AD_fw_Radar_1R1V_rpc_XilObjBypassingRunnable_XilObjBypassingRunnable_m_pad_radarObjPort_par_out_local::TChangeableMemPool::_::_::_m_arrayPool::_0_::_elem::_m_objectInformation::_2_::_m_perObjectType::_m_prob1ObstacleN = 0;
      @sysvar::XCP::RadarFC_Obj::_g_PL_AD_fw_Radar_1R1V_rpc_XilObjBypassingRunnable_XilObjBypassingRunnable_m_pad_radarObjPort_par_out_local::TChangeableMemPool::_::_::_m_arrayPool::_0_::_elem::_m_objectInformation::_2_::_m_perObjectType::_m_prob1NonObstacleN = 0;
      @sysvar::XCP::RadarFC_Obj::_g_PL_AD_fw_Radar_1R1V_rpc_XilObjBypassingRunnable_XilObjBypassingRunnable_m_pad_radarObjPort_par_out_local::TChangeableMemPool::_::_::_m_arrayPool::_0_::_elem::_m_objectInformation::_2_::_m_perObjectType::_m_prob1UnknownN = 128;
      @sysvar::XCP::RadarFC_Obj::_g_PL_AD_fw_Radar_1R1V_rpc_XilObjBypassingRunnable_XilObjBypassingRunnable_m_pad_radarObjPort_par_out_local::TChangeableMemPool::_::_::_m_arrayPool::_0_::_elem::_m_objectInformation::_2_::_m_perObjectType::_m_prob1MobileN = 0;
      @sysvar::XCP::RadarFC_Obj::_g_PL_AD_fw_Radar_1R1V_rpc_XilObjBypassingRunnable_XilObjBypassingRunnable_m_pad_radarObjPort_par_out_local::TChangeableMemPool::_::_::_m_arrayPool::_0_::_elem::_m_objectInformation::_2_::_m_perObjectType::_m_prob1StationaryN = 0;
      @sysvar::XCP::RadarFC_Obj::_g_PL_AD_fw_Radar_1R1V_rpc_XilObjBypassingRunnable_XilObjBypassingRunnable_m_pad_radarObjPort_par_out_local::TChangeableMemPool::_::_::_m_arrayPool::_0_::_elem::_m_objectInformation::_2_::_m_perObjectType::_m_prob1ObstUnknownN = 128;
      @sysvar::XCP::RadarFC_Obj::_g_PL_AD_fw_Radar_1R1V_rpc_XilObjBypassingRunnable_XilObjBypassingRunnable_m_pad_radarObjPort_par_out_local::TChangeableMemPool::_::_::_m_arrayPool::_0_::_elem::_m_objectInformation::_2_::_m_perObjectType::_m_prob1FourPlusWheelerN = 0;
      @sysvar::XCP::RadarFC_Obj::_g_PL_AD_fw_Radar_1R1V_rpc_XilObjBypassingRunnable_XilObjBypassingRunnable_m_pad_radarObjPort_par_out_local::TChangeableMemPool::_::_::_m_arrayPool::_0_::_elem::_m_objectInformation::_2_::_m_perObjectType::_m_prob1TwoWheelerN = 0;
      @sysvar::XCP::RadarFC_Obj::_g_PL_AD_fw_Radar_1R1V_rpc_XilObjBypassingRunnable_XilObjBypassingRunnable_m_pad_radarObjPort_par_out_local::TChangeableMemPool::_::_::_m_arrayPool::_0_::_elem::_m_objectInformation::_2_::_m_perObjectType::_m_prob1PedestrianN = 0;
      @sysvar::XCP::RadarFC_Obj::_g_PL_AD_fw_Radar_1R1V_rpc_XilObjBypassingRunnable_XilObjBypassingRunnable_m_pad_radarObjPort_par_out_local::TChangeableMemPool::_::_::_m_arrayPool::_0_::_elem::_m_objectInformation::_2_::_m_perObjectType::_m_prob1MovUnknownN = 128;
      @sysvar::XCP::RadarFC_Obj::_g_PL_AD_fw_Radar_1R1V_rpc_XilObjBypassingRunnable_XilObjBypassingRunnable_m_pad_radarObjPort_par_out_local::TChangeableMemPool::_::_::_m_arrayPool::_0_::_elem::_m_objectInformation::_2_::_m_perObjectType::_m_prob1RoadsideBarrierN = 0;
      @sysvar::XCP::RadarFC_Obj::_g_PL_AD_fw_Radar_1R1V_rpc_XilObjBypassingRunnable_XilObjBypassingRunnable_m_pad_radarObjPort_par_out_local::TChangeableMemPool::_::_::_m_arrayPool::_0_::_elem::_m_objectInformation::_2_::_m_perObjectType::_m_prob1StatUnknownN = 128;
      @sysvar::XCP::RadarFC_Obj::_g_PL_AD_fw_Radar_1R1V_rpc_XilObjBypassingRunnable_XilObjBypassingRunnable_m_pad_radarObjPort_par_out_local::TChangeableMemPool::_::_::_m_arrayPool::_0_::_elem::_m_objectInformation::_2_::_m_perObjectType::_m_prob1PassengerCarN = 0;
      @sysvar::XCP::RadarFC_Obj::_g_PL_AD_fw_Radar_1R1V_rpc_XilObjBypassingRunnable_XilObjBypassingRunnable_m_pad_radarObjPort_par_out_local::TChangeableMemPool::_::_::_m_arrayPool::_0_::_elem::_m_objectInformation::_2_::_m_perObjectType::_m_prob1TruckN = 0;
      @sysvar::XCP::RadarFC_Obj::_g_PL_AD_fw_Radar_1R1V_rpc_XilObjBypassingRunnable_XilObjBypassingRunnable_m_pad_radarObjPort_par_out_local::TChangeableMemPool::_::_::_m_arrayPool::_0_::_elem::_m_objectInformation::_2_::_m_perObjectType::_m_prob1FourWheelUnknownN = 128;
      @sysvar::XCP::RadarFC_Obj::_g_PL_AD_fw_Radar_1R1V_rpc_XilObjBypassingRunnable_XilObjBypassingRunnable_m_pad_radarObjPort_par_out_local::TChangeableMemPool::_::_::_m_arrayPool::_0_::_elem::_m_objectInformation::_2_::_m_dWidthN = 256;
        break;

      case 2: //"RoadSideBarrier"
      @sysvar::XCP::RadarFC_Obj::_g_PL_AD_fw_Radar_1R1V_rpc_XilObjBypassingRunnable_XilObjBypassingRunnable_m_pad_radarObjPort_par_out_local::TChangeableMemPool::_::_::_m_arrayPool::_0_::_elem::_m_objectInformation::_2_::_m_perObjectType::_m_prob1ObstacleN = 128;
      @sysvar::XCP::RadarFC_Obj::_g_PL_AD_fw_Radar_1R1V_rpc_XilObjBypassingRunnable_XilObjBypassingRunnable_m_pad_radarObjPort_par_out_local::TChangeableMemPool::_::_::_m_arrayPool::_0_::_elem::_m_objectInformation::_2_::_m_perObjectType::_m_prob1NonObstacleN = 0;
      @sysvar::XCP::RadarFC_Obj::_g_PL_AD_fw_Radar_1R1V_rpc_XilObjBypassingRunnable_XilObjBypassingRunnable_m_pad_radarObjPort_par_out_local::TChangeableMemPool::_::_::_m_arrayPool::_0_::_elem::_m_objectInformation::_2_::_m_perObjectType::_m_prob1UnknownN = 0;
      @sysvar::XCP::RadarFC_Obj::_g_PL_AD_fw_Radar_1R1V_rpc_XilObjBypassingRunnable_XilObjBypassingRunnable_m_pad_radarObjPort_par_out_local::TChangeableMemPool::_::_::_m_arrayPool::_0_::_elem::_m_objectInformation::_2_::_m_perObjectType::_m_prob1MobileN = 0;
      @sysvar::XCP::RadarFC_Obj::_g_PL_AD_fw_Radar_1R1V_rpc_XilObjBypassingRunnable_XilObjBypassingRunnable_m_pad_radarObjPort_par_out_local::TChangeableMemPool::_::_::_m_arrayPool::_0_::_elem::_m_objectInformation::_2_::_m_perObjectType::_m_prob1StationaryN = 128;
      @sysvar::XCP::RadarFC_Obj::_g_PL_AD_fw_Radar_1R1V_rpc_XilObjBypassingRunnable_XilObjBypassingRunnable_m_pad_radarObjPort_par_out_local::TChangeableMemPool::_::_::_m_arrayPool::_0_::_elem::_m_objectInformation::_2_::_m_perObjectType::_m_prob1ObstUnknownN = 0;
      @sysvar::XCP::RadarFC_Obj::_g_PL_AD_fw_Radar_1R1V_rpc_XilObjBypassingRunnable_XilObjBypassingRunnable_m_pad_radarObjPort_par_out_local::TChangeableMemPool::_::_::_m_arrayPool::_0_::_elem::_m_objectInformation::_2_::_m_perObjectType::_m_prob1FourPlusWheelerN = 0;
      @sysvar::XCP::RadarFC_Obj::_g_PL_AD_fw_Radar_1R1V_rpc_XilObjBypassingRunnable_XilObjBypassingRunnable_m_pad_radarObjPort_par_out_local::TChangeableMemPool::_::_::_m_arrayPool::_0_::_elem::_m_objectInformation::_2_::_m_perObjectType::_m_prob1TwoWheelerN = 0;
      @sysvar::XCP::RadarFC_Obj::_g_PL_AD_fw_Radar_1R1V_rpc_XilObjBypassingRunnable_XilObjBypassingRunnable_m_pad_radarObjPort_par_out_local::TChangeableMemPool::_::_::_m_arrayPool::_0_::_elem::_m_objectInformation::_2_::_m_perObjectType::_m_prob1PedestrianN = 0;
      @sysvar::XCP::RadarFC_Obj::_g_PL_AD_fw_Radar_1R1V_rpc_XilObjBypassingRunnable_XilObjBypassingRunnable_m_pad_radarObjPort_par_out_local::TChangeableMemPool::_::_::_m_arrayPool::_0_::_elem::_m_objectInformation::_2_::_m_perObjectType::_m_prob1MovUnknownN = 128;
      @sysvar::XCP::RadarFC_Obj::_g_PL_AD_fw_Radar_1R1V_rpc_XilObjBypassingRunnable_XilObjBypassingRunnable_m_pad_radarObjPort_par_out_local::TChangeableMemPool::_::_::_m_arrayPool::_0_::_elem::_m_objectInformation::_2_::_m_perObjectType::_m_prob1RoadsideBarrierN = 128;
      @sysvar::XCP::RadarFC_Obj::_g_PL_AD_fw_Radar_1R1V_rpc_XilObjBypassingRunnable_XilObjBypassingRunnable_m_pad_radarObjPort_par_out_local::TChangeableMemPool::_::_::_m_arrayPool::_0_::_elem::_m_objectInformation::_2_::_m_perObjectType::_m_prob1StatUnknownN = 0;
      @sysvar::XCP::RadarFC_Obj::_g_PL_AD_fw_Radar_1R1V_rpc_XilObjBypassingRunnable_XilObjBypassingRunnable_m_pad_radarObjPort_par_out_local::TChangeableMemPool::_::_::_m_arrayPool::_0_::_elem::_m_objectInformation::_2_::_m_perObjectType::_m_prob1PassengerCarN = 0;
      @sysvar::XCP::RadarFC_Obj::_g_PL_AD_fw_Radar_1R1V_rpc_XilObjBypassingRunnable_XilObjBypassingRunnable_m_pad_radarObjPort_par_out_local::TChangeableMemPool::_::_::_m_arrayPool::_0_::_elem::_m_objectInformation::_2_::_m_perObjectType::_m_prob1TruckN = 0;
      @sysvar::XCP::RadarFC_Obj::_g_PL_AD_fw_Radar_1R1V_rpc_XilObjBypassingRunnable_XilObjBypassingRunnable_m_pad_radarObjPort_par_out_local::TChangeableMemPool::_::_::_m_arrayPool::_0_::_elem::_m_objectInformation::_2_::_m_perObjectType::_m_prob1FourWheelUnknownN = 128;
      @sysvar::XCP::RadarFC_Obj::_g_PL_AD_fw_Radar_1R1V_rpc_XilObjBypassingRunnable_XilObjBypassingRunnable_m_pad_radarObjPort_par_out_local::TChangeableMemPool::_::_::_m_arrayPool::_0_::_elem::_m_objectInformation::_2_::_m_dWidthN = 256;
        break;

      case 3: //"2Wheeler"
      @sysvar::XCP::RadarFC_Obj::_g_PL_AD_fw_Radar_1R1V_rpc_XilObjBypassingRunnable_XilObjBypassingRunnable_m_pad_radarObjPort_par_out_local::TChangeableMemPool::_::_::_m_arrayPool::_0_::_elem::_m_objectInformation::_2_::_m_perObjectType::_m_prob1ObstacleN = 128;
      @sysvar::XCP::RadarFC_Obj::_g_PL_AD_fw_Radar_1R1V_rpc_XilObjBypassingRunnable_XilObjBypassingRunnable_m_pad_radarObjPort_par_out_local::TChangeableMemPool::_::_::_m_arrayPool::_0_::_elem::_m_objectInformation::_2_::_m_perObjectType::_m_prob1NonObstacleN = 0;
      @sysvar::XCP::RadarFC_Obj::_g_PL_AD_fw_Radar_1R1V_rpc_XilObjBypassingRunnable_XilObjBypassingRunnable_m_pad_radarObjPort_par_out_local::TChangeableMemPool::_::_::_m_arrayPool::_0_::_elem::_m_objectInformation::_2_::_m_perObjectType::_m_prob1UnknownN = 0;
      @sysvar::XCP::RadarFC_Obj::_g_PL_AD_fw_Radar_1R1V_rpc_XilObjBypassingRunnable_XilObjBypassingRunnable_m_pad_radarObjPort_par_out_local::TChangeableMemPool::_::_::_m_arrayPool::_0_::_elem::_m_objectInformation::_2_::_m_perObjectType::_m_prob1MobileN = 128;
      @sysvar::XCP::RadarFC_Obj::_g_PL_AD_fw_Radar_1R1V_rpc_XilObjBypassingRunnable_XilObjBypassingRunnable_m_pad_radarObjPort_par_out_local::TChangeableMemPool::_::_::_m_arrayPool::_0_::_elem::_m_objectInformation::_2_::_m_perObjectType::_m_prob1StationaryN = 0;
      @sysvar::XCP::RadarFC_Obj::_g_PL_AD_fw_Radar_1R1V_rpc_XilObjBypassingRunnable_XilObjBypassingRunnable_m_pad_radarObjPort_par_out_local::TChangeableMemPool::_::_::_m_arrayPool::_0_::_elem::_m_objectInformation::_2_::_m_perObjectType::_m_prob1ObstUnknownN = 0;
      @sysvar::XCP::RadarFC_Obj::_g_PL_AD_fw_Radar_1R1V_rpc_XilObjBypassingRunnable_XilObjBypassingRunnable_m_pad_radarObjPort_par_out_local::TChangeableMemPool::_::_::_m_arrayPool::_0_::_elem::_m_objectInformation::_2_::_m_perObjectType::_m_prob1FourPlusWheelerN = 0;
      @sysvar::XCP::RadarFC_Obj::_g_PL_AD_fw_Radar_1R1V_rpc_XilObjBypassingRunnable_XilObjBypassingRunnable_m_pad_radarObjPort_par_out_local::TChangeableMemPool::_::_::_m_arrayPool::_0_::_elem::_m_objectInformation::_2_::_m_perObjectType::_m_prob1TwoWheelerN = 128;
      @sysvar::XCP::RadarFC_Obj::_g_PL_AD_fw_Radar_1R1V_rpc_XilObjBypassingRunnable_XilObjBypassingRunnable_m_pad_radarObjPort_par_out_local::TChangeableMemPool::_::_::_m_arrayPool::_0_::_elem::_m_objectInformation::_2_::_m_perObjectType::_m_prob1PedestrianN = 0;
      @sysvar::XCP::RadarFC_Obj::_g_PL_AD_fw_Radar_1R1V_rpc_XilObjBypassingRunnable_XilObjBypassingRunnable_m_pad_radarObjPort_par_out_local::TChangeableMemPool::_::_::_m_arrayPool::_0_::_elem::_m_objectInformation::_2_::_m_perObjectType::_m_prob1MovUnknownN = 0;
      @sysvar::XCP::RadarFC_Obj::_g_PL_AD_fw_Radar_1R1V_rpc_XilObjBypassingRunnable_XilObjBypassingRunnable_m_pad_radarObjPort_par_out_local::TChangeableMemPool::_::_::_m_arrayPool::_0_::_elem::_m_objectInformation::_2_::_m_perObjectType::_m_prob1RoadsideBarrierN = 0;
      @sysvar::XCP::RadarFC_Obj::_g_PL_AD_fw_Radar_1R1V_rpc_XilObjBypassingRunnable_XilObjBypassingRunnable_m_pad_radarObjPort_par_out_local::TChangeableMemPool::_::_::_m_arrayPool::_0_::_elem::_m_objectInformation::_2_::_m_perObjectType::_m_prob1StatUnknownN = 128;
      @sysvar::XCP::RadarFC_Obj::_g_PL_AD_fw_Radar_1R1V_rpc_XilObjBypassingRunnable_XilObjBypassingRunnable_m_pad_radarObjPort_par_out_local::TChangeableMemPool::_::_::_m_arrayPool::_0_::_elem::_m_objectInformation::_2_::_m_perObjectType::_m_prob1PassengerCarN = 0;
      @sysvar::XCP::RadarFC_Obj::_g_PL_AD_fw_Radar_1R1V_rpc_XilObjBypassingRunnable_XilObjBypassingRunnable_m_pad_radarObjPort_par_out_local::TChangeableMemPool::_::_::_m_arrayPool::_0_::_elem::_m_objectInformation::_2_::_m_perObjectType::_m_prob1TruckN = 0;
      @sysvar::XCP::RadarFC_Obj::_g_PL_AD_fw_Radar_1R1V_rpc_XilObjBypassingRunnable_XilObjBypassingRunnable_m_pad_radarObjPort_par_out_local::TChangeableMemPool::_::_::_m_arrayPool::_0_::_elem::_m_objectInformation::_2_::_m_perObjectType::_m_prob1FourWheelUnknownN = 128;
      @sysvar::XCP::RadarFC_Obj::_g_PL_AD_fw_Radar_1R1V_rpc_XilObjBypassingRunnable_XilObjBypassingRunnable_m_pad_radarObjPort_par_out_local::TChangeableMemPool::_::_::_m_arrayPool::_0_::_elem::_m_objectInformation::_2_::_m_dWidthN = 64;
        break;

      case 4: //"Pedestrian"
      @sysvar::XCP::RadarFC_Obj::_g_PL_AD_fw_Radar_1R1V_rpc_XilObjBypassingRunnable_XilObjBypassingRunnable_m_pad_radarObjPort_par_out_local::TChangeableMemPool::_::_::_m_arrayPool::_0_::_elem::_m_objectInformation::_2_::_m_perObjectType::_m_prob1ObstacleN = 128;
      @sysvar::XCP::RadarFC_Obj::_g_PL_AD_fw_Radar_1R1V_rpc_XilObjBypassingRunnable_XilObjBypassingRunnable_m_pad_radarObjPort_par_out_local::TChangeableMemPool::_::_::_m_arrayPool::_0_::_elem::_m_objectInformation::_2_::_m_perObjectType::_m_prob1NonObstacleN = 0;
      @sysvar::XCP::RadarFC_Obj::_g_PL_AD_fw_Radar_1R1V_rpc_XilObjBypassingRunnable_XilObjBypassingRunnable_m_pad_radarObjPort_par_out_local::TChangeableMemPool::_::_::_m_arrayPool::_0_::_elem::_m_objectInformation::_2_::_m_perObjectType::_m_prob1UnknownN = 0;
      @sysvar::XCP::RadarFC_Obj::_g_PL_AD_fw_Radar_1R1V_rpc_XilObjBypassingRunnable_XilObjBypassingRunnable_m_pad_radarObjPort_par_out_local::TChangeableMemPool::_::_::_m_arrayPool::_0_::_elem::_m_objectInformation::_2_::_m_perObjectType::_m_prob1MobileN = 128;
      @sysvar::XCP::RadarFC_Obj::_g_PL_AD_fw_Radar_1R1V_rpc_XilObjBypassingRunnable_XilObjBypassingRunnable_m_pad_radarObjPort_par_out_local::TChangeableMemPool::_::_::_m_arrayPool::_0_::_elem::_m_objectInformation::_2_::_m_perObjectType::_m_prob1StationaryN = 0;
      @sysvar::XCP::RadarFC_Obj::_g_PL_AD_fw_Radar_1R1V_rpc_XilObjBypassingRunnable_XilObjBypassingRunnable_m_pad_radarObjPort_par_out_local::TChangeableMemPool::_::_::_m_arrayPool::_0_::_elem::_m_objectInformation::_2_::_m_perObjectType::_m_prob1ObstUnknownN = 0;
      @sysvar::XCP::RadarFC_Obj::_g_PL_AD_fw_Radar_1R1V_rpc_XilObjBypassingRunnable_XilObjBypassingRunnable_m_pad_radarObjPort_par_out_local::TChangeableMemPool::_::_::_m_arrayPool::_0_::_elem::_m_objectInformation::_2_::_m_perObjectType::_m_prob1FourPlusWheelerN = 0;
      @sysvar::XCP::RadarFC_Obj::_g_PL_AD_fw_Radar_1R1V_rpc_XilObjBypassingRunnable_XilObjBypassingRunnable_m_pad_radarObjPort_par_out_local::TChangeableMemPool::_::_::_m_arrayPool::_0_::_elem::_m_objectInformation::_2_::_m_perObjectType::_m_prob1TwoWheelerN = 0;
      @sysvar::XCP::RadarFC_Obj::_g_PL_AD_fw_Radar_1R1V_rpc_XilObjBypassingRunnable_XilObjBypassingRunnable_m_pad_radarObjPort_par_out_local::TChangeableMemPool::_::_::_m_arrayPool::_0_::_elem::_m_objectInformation::_2_::_m_perObjectType::_m_prob1PedestrianN = 128;
      @sysvar::XCP::RadarFC_Obj::_g_PL_AD_fw_Radar_1R1V_rpc_XilObjBypassingRunnable_XilObjBypassingRunnable_m_pad_radarObjPort_par_out_local::TChangeableMemPool::_::_::_m_arrayPool::_0_::_elem::_m_objectInformation::_2_::_m_perObjectType::_m_prob1MovUnknownN = 0;
      @sysvar::XCP::RadarFC_Obj::_g_PL_AD_fw_Radar_1R1V_rpc_XilObjBypassingRunnable_XilObjBypassingRunnable_m_pad_radarObjPort_par_out_local::TChangeableMemPool::_::_::_m_arrayPool::_0_::_elem::_m_objectInformation::_2_::_m_perObjectType::_m_prob1RoadsideBarrierN = 0;
      @sysvar::XCP::RadarFC_Obj::_g_PL_AD_fw_Radar_1R1V_rpc_XilObjBypassingRunnable_XilObjBypassingRunnable_m_pad_radarObjPort_par_out_local::TChangeableMemPool::_::_::_m_arrayPool::_0_::_elem::_m_objectInformation::_2_::_m_perObjectType::_m_prob1StatUnknownN = 128;
      @sysvar::XCP::RadarFC_Obj::_g_PL_AD_fw_Radar_1R1V_rpc_XilObjBypassingRunnable_XilObjBypassingRunnable_m_pad_radarObjPort_par_out_local::TChangeableMemPool::_::_::_m_arrayPool::_0_::_elem::_m_objectInformation::_2_::_m_perObjectType::_m_prob1PassengerCarN = 0;
      @sysvar::XCP::RadarFC_Obj::_g_PL_AD_fw_Radar_1R1V_rpc_XilObjBypassingRunnable_XilObjBypassingRunnable_m_pad_radarObjPort_par_out_local::TChangeableMemPool::_::_::_m_arrayPool::_0_::_elem::_m_objectInformation::_2_::_m_perObjectType::_m_prob1TruckN = 0;
      @sysvar::XCP::RadarFC_Obj::_g_PL_AD_fw_Radar_1R1V_rpc_XilObjBypassingRunnable_XilObjBypassingRunnable_m_pad_radarObjPort_par_out_local::TChangeableMemPool::_::_::_m_arrayPool::_0_::_elem::_m_objectInformation::_2_::_m_perObjectType::_m_prob1FourWheelUnknownN = 128;
      @sysvar::XCP::RadarFC_Obj::_g_PL_AD_fw_Radar_1R1V_rpc_XilObjBypassingRunnable_XilObjBypassingRunnable_m_pad_radarObjPort_par_out_local::TChangeableMemPool::_::_::_m_arrayPool::_0_::_elem::_m_objectInformation::_2_::_m_dWidthN = 64;
        break;

      case 5: //"Truck"
      @sysvar::XCP::RadarFC_Obj::_g_PL_AD_fw_Radar_1R1V_rpc_XilObjBypassingRunnable_XilObjBypassingRunnable_m_pad_radarObjPort_par_out_local::TChangeableMemPool::_::_::_m_arrayPool::_0_::_elem::_m_objectInformation::_2_::_m_perObjectType::_m_prob1ObstacleN = 128;
      @sysvar::XCP::RadarFC_Obj::_g_PL_AD_fw_Radar_1R1V_rpc_XilObjBypassingRunnable_XilObjBypassingRunnable_m_pad_radarObjPort_par_out_local::TChangeableMemPool::_::_::_m_arrayPool::_0_::_elem::_m_objectInformation::_2_::_m_perObjectType::_m_prob1NonObstacleN = 0;
      @sysvar::XCP::RadarFC_Obj::_g_PL_AD_fw_Radar_1R1V_rpc_XilObjBypassingRunnable_XilObjBypassingRunnable_m_pad_radarObjPort_par_out_local::TChangeableMemPool::_::_::_m_arrayPool::_0_::_elem::_m_objectInformation::_2_::_m_perObjectType::_m_prob1UnknownN = 0;
      @sysvar::XCP::RadarFC_Obj::_g_PL_AD_fw_Radar_1R1V_rpc_XilObjBypassingRunnable_XilObjBypassingRunnable_m_pad_radarObjPort_par_out_local::TChangeableMemPool::_::_::_m_arrayPool::_0_::_elem::_m_objectInformation::_2_::_m_perObjectType::_m_prob1MobileN = 128;
      @sysvar::XCP::RadarFC_Obj::_g_PL_AD_fw_Radar_1R1V_rpc_XilObjBypassingRunnable_XilObjBypassingRunnable_m_pad_radarObjPort_par_out_local::TChangeableMemPool::_::_::_m_arrayPool::_0_::_elem::_m_objectInformation::_2_::_m_perObjectType::_m_prob1StationaryN = 0;
      @sysvar::XCP::RadarFC_Obj::_g_PL_AD_fw_Radar_1R1V_rpc_XilObjBypassingRunnable_XilObjBypassingRunnable_m_pad_radarObjPort_par_out_local::TChangeableMemPool::_::_::_m_arrayPool::_0_::_elem::_m_objectInformation::_2_::_m_perObjectType::_m_prob1ObstUnknownN = 0;
      @sysvar::XCP::RadarFC_Obj::_g_PL_AD_fw_Radar_1R1V_rpc_XilObjBypassingRunnable_XilObjBypassingRunnable_m_pad_radarObjPort_par_out_local::TChangeableMemPool::_::_::_m_arrayPool::_0_::_elem::_m_objectInformation::_2_::_m_perObjectType::_m_prob1FourPlusWheelerN = 128;
      @sysvar::XCP::RadarFC_Obj::_g_PL_AD_fw_Radar_1R1V_rpc_XilObjBypassingRunnable_XilObjBypassingRunnable_m_pad_radarObjPort_par_out_local::TChangeableMemPool::_::_::_m_arrayPool::_0_::_elem::_m_objectInformation::_2_::_m_perObjectType::_m_prob1TwoWheelerN = 0;
      @sysvar::XCP::RadarFC_Obj::_g_PL_AD_fw_Radar_1R1V_rpc_XilObjBypassingRunnable_XilObjBypassingRunnable_m_pad_radarObjPort_par_out_local::TChangeableMemPool::_::_::_m_arrayPool::_0_::_elem::_m_objectInformation::_2_::_m_perObjectType::_m_prob1PedestrianN = 0;
      @sysvar::XCP::RadarFC_Obj::_g_PL_AD_fw_Radar_1R1V_rpc_XilObjBypassingRunnable_XilObjBypassingRunnable_m_pad_radarObjPort_par_out_local::TChangeableMemPool::_::_::_m_arrayPool::_0_::_elem::_m_objectInformation::_2_::_m_perObjectType::_m_prob1MovUnknownN = 0;
      @sysvar::XCP::RadarFC_Obj::_g_PL_AD_fw_Radar_1R1V_rpc_XilObjBypassingRunnable_XilObjBypassingRunnable_m_pad_radarObjPort_par_out_local::TChangeableMemPool::_::_::_m_arrayPool::_0_::_elem::_m_objectInformation::_2_::_m_perObjectType::_m_prob1RoadsideBarrierN = 0;
      @sysvar::XCP::RadarFC_Obj::_g_PL_AD_fw_Radar_1R1V_rpc_XilObjBypassingRunnable_XilObjBypassingRunnable_m_pad_radarObjPort_par_out_local::TChangeableMemPool::_::_::_m_arrayPool::_0_::_elem::_m_objectInformation::_2_::_m_perObjectType::_m_prob1StatUnknownN = 128;
      @sysvar::XCP::RadarFC_Obj::_g_PL_AD_fw_Radar_1R1V_rpc_XilObjBypassingRunnable_XilObjBypassingRunnable_m_pad_radarObjPort_par_out_local::TChangeableMemPool::_::_::_m_arrayPool::_0_::_elem::_m_objectInformation::_2_::_m_perObjectType::_m_prob1PassengerCarN = 0;
      @sysvar::XCP::RadarFC_Obj::_g_PL_AD_fw_Radar_1R1V_rpc_XilObjBypassingRunnable_XilObjBypassingRunnable_m_pad_radarObjPort_par_out_local::TChangeableMemPool::_::_::_m_arrayPool::_0_::_elem::_m_objectInformation::_2_::_m_perObjectType::_m_prob1TruckN = 128;
      @sysvar::XCP::RadarFC_Obj::_g_PL_AD_fw_Radar_1R1V_rpc_XilObjBypassingRunnable_XilObjBypassingRunnable_m_pad_radarObjPort_par_out_local::TChangeableMemPool::_::_::_m_arrayPool::_0_::_elem::_m_objectInformation::_2_::_m_perObjectType::_m_prob1FourWheelUnknownN = 0;
      @sysvar::XCP::RadarFC_Obj::_g_PL_AD_fw_Radar_1R1V_rpc_XilObjBypassingRunnable_XilObjBypassingRunnable_m_pad_radarObjPort_par_out_local::TChangeableMemPool::_::_::_m_arrayPool::_0_::_elem::_m_objectInformation::_2_::_m_dWidthN = 256;
        break;

      case 6: //"PassengerCar"
      @sysvar::XCP::RadarFC_Obj::_g_PL_AD_fw_Radar_1R1V_rpc_XilObjBypassingRunnable_XilObjBypassingRunnable_m_pad_radarObjPort_par_out_local::TChangeableMemPool::_::_::_m_arrayPool::_0_::_elem::_m_objectInformation::_2_::_m_perObjectType::_m_prob1ObstacleN = 128;
      @sysvar::XCP::RadarFC_Obj::_g_PL_AD_fw_Radar_1R1V_rpc_XilObjBypassingRunnable_XilObjBypassingRunnable_m_pad_radarObjPort_par_out_local::TChangeableMemPool::_::_::_m_arrayPool::_0_::_elem::_m_objectInformation::_2_::_m_perObjectType::_m_prob1NonObstacleN = 0;
      @sysvar::XCP::RadarFC_Obj::_g_PL_AD_fw_Radar_1R1V_rpc_XilObjBypassingRunnable_XilObjBypassingRunnable_m_pad_radarObjPort_par_out_local::TChangeableMemPool::_::_::_m_arrayPool::_0_::_elem::_m_objectInformation::_2_::_m_perObjectType::_m_prob1UnknownN = 0;
      @sysvar::XCP::RadarFC_Obj::_g_PL_AD_fw_Radar_1R1V_rpc_XilObjBypassingRunnable_XilObjBypassingRunnable_m_pad_radarObjPort_par_out_local::TChangeableMemPool::_::_::_m_arrayPool::_0_::_elem::_m_objectInformation::_2_::_m_perObjectType::_m_prob1MobileN = 128;
      @sysvar::XCP::RadarFC_Obj::_g_PL_AD_fw_Radar_1R1V_rpc_XilObjBypassingRunnable_XilObjBypassingRunnable_m_pad_radarObjPort_par_out_local::TChangeableMemPool::_::_::_m_arrayPool::_0_::_elem::_m_objectInformation::_2_::_m_perObjectType::_m_prob1StationaryN = 0;
      @sysvar::XCP::RadarFC_Obj::_g_PL_AD_fw_Radar_1R1V_rpc_XilObjBypassingRunnable_XilObjBypassingRunnable_m_pad_radarObjPort_par_out_local::TChangeableMemPool::_::_::_m_arrayPool::_0_::_elem::_m_objectInformation::_2_::_m_perObjectType::_m_prob1ObstUnknownN = 0;
      @sysvar::XCP::RadarFC_Obj::_g_PL_AD_fw_Radar_1R1V_rpc_XilObjBypassingRunnable_XilObjBypassingRunnable_m_pad_radarObjPort_par_out_local::TChangeableMemPool::_::_::_m_arrayPool::_0_::_elem::_m_objectInformation::_2_::_m_perObjectType::_m_prob1FourPlusWheelerN = 128;
      @sysvar::XCP::RadarFC_Obj::_g_PL_AD_fw_Radar_1R1V_rpc_XilObjBypassingRunnable_XilObjBypassingRunnable_m_pad_radarObjPort_par_out_local::TChangeableMemPool::_::_::_m_arrayPool::_0_::_elem::_m_objectInformation::_2_::_m_perObjectType::_m_prob1TwoWheelerN = 0;
      @sysvar::XCP::RadarFC_Obj::_g_PL_AD_fw_Radar_1R1V_rpc_XilObjBypassingRunnable_XilObjBypassingRunnable_m_pad_radarObjPort_par_out_local::TChangeableMemPool::_::_::_m_arrayPool::_0_::_elem::_m_objectInformation::_2_::_m_perObjectType::_m_prob1PedestrianN = 0;
      @sysvar::XCP::RadarFC_Obj::_g_PL_AD_fw_Radar_1R1V_rpc_XilObjBypassingRunnable_XilObjBypassingRunnable_m_pad_radarObjPort_par_out_local::TChangeableMemPool::_::_::_m_arrayPool::_0_::_elem::_m_objectInformation::_2_::_m_perObjectType::_m_prob1MovUnknownN = 0;
      @sysvar::XCP::RadarFC_Obj::_g_PL_AD_fw_Radar_1R1V_rpc_XilObjBypassingRunnable_XilObjBypassingRunnable_m_pad_radarObjPort_par_out_local::TChangeableMemPool::_::_::_m_arrayPool::_0_::_elem::_m_objectInformation::_2_::_m_perObjectType::_m_prob1RoadsideBarrierN = 0;
      @sysvar::XCP::RadarFC_Obj::_g_PL_AD_fw_Radar_1R1V_rpc_XilObjBypassingRunnable_XilObjBypassingRunnable_m_pad_radarObjPort_par_out_local::TChangeableMemPool::_::_::_m_arrayPool::_0_::_elem::_m_objectInformation::_2_::_m_perObjectType::_m_prob1StatUnknownN = 128;
      @sysvar::XCP::RadarFC_Obj::_g_PL_AD_fw_Radar_1R1V_rpc_XilObjBypassingRunnable_XilObjBypassingRunnable_m_pad_radarObjPort_par_out_local::TChangeableMemPool::_::_::_m_arrayPool::_0_::_elem::_m_objectInformation::_2_::_m_perObjectType::_m_prob1PassengerCarN = 128;
      @sysvar::XCP::RadarFC_Obj::_g_PL_AD_fw_Radar_1R1V_rpc_XilObjBypassingRunnable_XilObjBypassingRunnable_m_pad_radarObjPort_par_out_local::TChangeableMemPool::_::_::_m_arrayPool::_0_::_elem::_m_objectInformation::_2_::_m_perObjectType::_m_prob1TruckN = 0;
      @sysvar::XCP::RadarFC_Obj::_g_PL_AD_fw_Radar_1R1V_rpc_XilObjBypassingRunnable_XilObjBypassingRunnable_m_pad_radarObjPort_par_out_local::TChangeableMemPool::_::_::_m_arrayPool::_0_::_elem::_m_objectInformation::_2_::_m_perObjectType::_m_prob1FourWheelUnknownN = 0;
      @sysvar::XCP::RadarFC_Obj::_g_PL_AD_fw_Radar_1R1V_rpc_XilObjBypassingRunnable_XilObjBypassingRunnable_m_pad_radarObjPort_par_out_local::TChangeableMemPool::_::_::_m_arrayPool::_0_::_elem::_m_objectInformation::_2_::_m_dWidthN = 256;
        break;
    }
    break;

    case 3: //"Object-3"
    //constant
  @sysvar::XCP::RadarFC_Obj::_g_PL_AD_fw_Radar_1R1V_rpc_XilObjBypassingRunnable_XilObjBypassingRunnable_m_pad_radarObjPort_par_out_local::TChangeableMemPool::_::_::_m_arrayPool::_0_::_elem::_m_objectInformation::_3_::_Valid_b = 1;
  @sysvar::XCP::RadarFC_Obj::_g_PL_AD_fw_Radar_1R1V_rpc_XilObjBypassingRunnable_XilObjBypassingRunnable_m_pad_radarObjPort_par_out_local::TChangeableMemPool::_::_::_m_arrayPool::_0_::_elem::_m_objectInformation::_3_::_m_HandleN = 1;
  @sysvar::XCP::RadarFC_Obj::_g_PL_AD_fw_Radar_1R1V_rpc_XilObjBypassingRunnable_XilObjBypassingRunnable_m_pad_radarObjPort_par_out_local::TChangeableMemPool::_::_::_m_arrayPool::_0_::_elem::_m_objectInformation::_3_::_m_alpPiVarYawAngleN = 0;
  @sysvar::XCP::RadarFC_Obj::_g_PL_AD_fw_Radar_1R1V_rpc_XilObjBypassingRunnable_XilObjBypassingRunnable_m_pad_radarObjPort_par_out_local::TChangeableMemPool::_::_::_m_arrayPool::_0_::_elem::_m_objectInformation::_3_::_m_alpPiYawAngleN = 0;
  @sysvar::XCP::RadarFC_Obj::_g_PL_AD_fw_Radar_1R1V_rpc_XilObjBypassingRunnable_XilObjBypassingRunnable_m_pad_radarObjPort_par_out_local::TChangeableMemPool::_::_::_m_arrayPool::_0_::_elem::_m_objectInformation::_3_::_m_varAxN = 0;
  @sysvar::XCP::RadarFC_Obj::_g_PL_AD_fw_Radar_1R1V_rpc_XilObjBypassingRunnable_XilObjBypassingRunnable_m_pad_radarObjPort_par_out_local::TChangeableMemPool::_::_::_m_arrayPool::_0_::_elem::_m_objectInformation::_3_::_m_varAyN = 0;
  @sysvar::XCP::RadarFC_Obj::_g_PL_AD_fw_Radar_1R1V_rpc_XilObjBypassingRunnable_XilObjBypassingRunnable_m_pad_radarObjPort_par_out_local::TChangeableMemPool::_::_::_m_arrayPool::_0_::_elem::_m_objectInformation::_3_::_m_varVxN = 0;
  @sysvar::XCP::RadarFC_Obj::_g_PL_AD_fw_Radar_1R1V_rpc_XilObjBypassingRunnable_XilObjBypassingRunnable_m_pad_radarObjPort_par_out_local::TChangeableMemPool::_::_::_m_arrayPool::_0_::_elem::_m_objectInformation::_3_::_m_varVyN = 0;
  @sysvar::XCP::RadarFC_Obj::_g_PL_AD_fw_Radar_1R1V_rpc_XilObjBypassingRunnable_XilObjBypassingRunnable_m_pad_radarObjPort_par_out_local::TChangeableMemPool::_::_::_m_arrayPool::_0_::_elem::_m_objectInformation::_3_::_m_varDxN = 0;
  @sysvar::XCP::RadarFC_Obj::_g_PL_AD_fw_Radar_1R1V_rpc_XilObjBypassingRunnable_XilObjBypassingRunnable_m_pad_radarObjPort_par_out_local::TChangeableMemPool::_::_::_m_arrayPool::_0_::_elem::_m_objectInformation::_3_::_m_varDyN = 0;
  @sysvar::XCP::RadarFC_Obj::_g_PL_AD_fw_Radar_1R1V_rpc_XilObjBypassingRunnable_XilObjBypassingRunnable_m_pad_radarObjPort_par_out_local::TChangeableMemPool::_::_::_m_arrayPool::_0_::_elem::_m_objectInformation::_3_::_m_dVarLengthN = 0;
  @sysvar::XCP::RadarFC_Obj::_g_PL_AD_fw_Radar_1R1V_rpc_XilObjBypassingRunnable_XilObjBypassingRunnable_m_pad_radarObjPort_par_out_local::TChangeableMemPool::_::_::_m_arrayPool::_0_::_elem::_m_objectInformation::_3_::_m_dVarWidthN = 0;
  @sysvar::XCP::RadarFC_Obj::_g_PL_AD_fw_Radar_1R1V_rpc_XilObjBypassingRunnable_XilObjBypassingRunnable_m_pad_radarObjPort_par_out_local::TChangeableMemPool::_::_::_m_arrayPool::_0_::_elem::_m_objectInformation::_3_::_m_wExistProbN = 64880;
  @sysvar::XCP::RadarFC_Obj::_g_PL_AD_fw_Radar_1R1V_rpc_XilObjBypassingRunnable_XilObjBypassingRunnable_m_pad_radarObjPort_par_out_local::TChangeableMemPool::_::_::_m_arrayPool::_0_::_elem::_m_objectInformation::_3_::_m_isObjectAsil = 1;
  @sysvar::XCP::RadarFC_Obj::_g_PL_AD_fw_Radar_1R1V_rpc_XilObjBypassingRunnable_XilObjBypassingRunnable_m_pad_radarObjPort_par_out_local::TChangeableMemPool::_::_::_m_arrayPool::_0_::_elem::_m_objectInformation::_3_::_m_dLengthN = 128;

    //target movement

  @sysvar::XCP::RadarFC_Obj::_g_PL_AD_fw_Radar_1R1V_rpc_XilObjBypassingRunnable_XilObjBypassingRunnable_m_pad_radarObjPort_par_out_local::TChangeableMemPool::_::_::_m_arrayPool::_0_::_elem::_m_objectInformation::_3_::_m_dxN = @target_radar_fc_sim::objdata.obj_distance_x[3] * 128;
  @sysvar::XCP::RadarFC_Obj::_g_PL_AD_fw_Radar_1R1V_rpc_XilObjBypassingRunnable_XilObjBypassingRunnable_m_pad_radarObjPort_par_out_local::TChangeableMemPool::_::_::_m_arrayPool::_0_::_elem::_m_objectInformation::_3_::_m_dyN = @target_radar_fc_sim::objdata.obj_distance_y[3] * 128;
  @sysvar::XCP::RadarFC_Obj::_g_PL_AD_fw_Radar_1R1V_rpc_XilObjBypassingRunnable_XilObjBypassingRunnable_m_pad_radarObjPort_par_out_local::TChangeableMemPool::_::_::_m_arrayPool::_0_::_elem::_m_objectInformation::_3_::_m_dzN = 0;
  @sysvar::XCP::RadarFC_Obj::_g_PL_AD_fw_Radar_1R1V_rpc_XilObjBypassingRunnable_XilObjBypassingRunnable_m_pad_radarObjPort_par_out_local::TChangeableMemPool::_::_::_m_arrayPool::_0_::_elem::_m_objectInformation::_3_::_m_vxN = @target_radar_fc_sim::objdata.obj_velocity_x[3] * 256;
  @sysvar::XCP::RadarFC_Obj::_g_PL_AD_fw_Radar_1R1V_rpc_XilObjBypassingRunnable_XilObjBypassingRunnable_m_pad_radarObjPort_par_out_local::TChangeableMemPool::_::_::_m_arrayPool::_0_::_elem::_m_objectInformation::_3_::_m_vyN = @target_radar_fc_sim::objdata.obj_velocity_y[3] * 256;
  @sysvar::XCP::RadarFC_Obj::_g_PL_AD_fw_Radar_1R1V_rpc_XilObjBypassingRunnable_XilObjBypassingRunnable_m_pad_radarObjPort_par_out_local::TChangeableMemPool::_::_::_m_arrayPool::_0_::_elem::_m_objectInformation::_3_::_m_axN = 0;
  @sysvar::XCP::RadarFC_Obj::_g_PL_AD_fw_Radar_1R1V_rpc_XilObjBypassingRunnable_XilObjBypassingRunnable_m_pad_radarObjPort_par_out_local::TChangeableMemPool::_::_::_m_arrayPool::_0_::_elem::_m_objectInformation::_3_::_m_ayN = 0;

    //target object moving or not
    if (abs(@target_radar_fc_sim::objdata.obj_velocity_x[3]) != 0)
    {
    @sysvar::XCP::RadarFC_Obj::_g_PL_AD_fw_Radar_1R1V_rpc_XilObjBypassingRunnable_XilObjBypassingRunnable_m_pad_radarObjPort_par_out_local::TChangeableMemPool::_::_::_m_arrayPool::_0_::_elem::_m_objectInformation::_3_::_m_prob1HasBeenObservedMovingN = 126;
    @sysvar::XCP::RadarFC_Obj::_g_PL_AD_fw_Radar_1R1V_rpc_XilObjBypassingRunnable_XilObjBypassingRunnable_m_pad_radarObjPort_par_out_local::TChangeableMemPool::_::_::_m_arrayPool::_0_::_elem::_m_objectInformation::_3_::_m_prob1MovingN = 126;
    }
    else
    {
    @sysvar::XCP::RadarFC_Obj::_g_PL_AD_fw_Radar_1R1V_rpc_XilObjBypassingRunnable_XilObjBypassingRunnable_m_pad_radarObjPort_par_out_local::TChangeableMemPool::_::_::_m_arrayPool::_0_::_elem::_m_objectInformation::_3_::_m_prob1HasBeenObservedMovingN = 0;
    @sysvar::XCP::RadarFC_Obj::_g_PL_AD_fw_Radar_1R1V_rpc_XilObjBypassingRunnable_XilObjBypassingRunnable_m_pad_radarObjPort_par_out_local::TChangeableMemPool::_::_::_m_arrayPool::_0_::_elem::_m_objectInformation::_3_::_m_prob1MovingN = 0;
    }

      //object classification
    switch (@target_radar_fc_sim::objdata.obj_type[3])
    {
      case 0: //"Non-Obstacle"
      @sysvar::XCP::RadarFC_Obj::_g_PL_AD_fw_Radar_1R1V_rpc_XilObjBypassingRunnable_XilObjBypassingRunnable_m_pad_radarObjPort_par_out_local::TChangeableMemPool::_::_::_m_arrayPool::_0_::_elem::_m_objectInformation::_3_::_m_perObjectType::_m_prob1ObstacleN = 0;
      @sysvar::XCP::RadarFC_Obj::_g_PL_AD_fw_Radar_1R1V_rpc_XilObjBypassingRunnable_XilObjBypassingRunnable_m_pad_radarObjPort_par_out_local::TChangeableMemPool::_::_::_m_arrayPool::_0_::_elem::_m_objectInformation::_3_::_m_perObjectType::_m_prob1NonObstacleN = 128;
      @sysvar::XCP::RadarFC_Obj::_g_PL_AD_fw_Radar_1R1V_rpc_XilObjBypassingRunnable_XilObjBypassingRunnable_m_pad_radarObjPort_par_out_local::TChangeableMemPool::_::_::_m_arrayPool::_0_::_elem::_m_objectInformation::_3_::_m_perObjectType::_m_prob1UnknownN = 0;
      @sysvar::XCP::RadarFC_Obj::_g_PL_AD_fw_Radar_1R1V_rpc_XilObjBypassingRunnable_XilObjBypassingRunnable_m_pad_radarObjPort_par_out_local::TChangeableMemPool::_::_::_m_arrayPool::_0_::_elem::_m_objectInformation::_3_::_m_perObjectType::_m_prob1MobileN = 0;
      @sysvar::XCP::RadarFC_Obj::_g_PL_AD_fw_Radar_1R1V_rpc_XilObjBypassingRunnable_XilObjBypassingRunnable_m_pad_radarObjPort_par_out_local::TChangeableMemPool::_::_::_m_arrayPool::_0_::_elem::_m_objectInformation::_3_::_m_perObjectType::_m_prob1StationaryN = 0;
      @sysvar::XCP::RadarFC_Obj::_g_PL_AD_fw_Radar_1R1V_rpc_XilObjBypassingRunnable_XilObjBypassingRunnable_m_pad_radarObjPort_par_out_local::TChangeableMemPool::_::_::_m_arrayPool::_0_::_elem::_m_objectInformation::_3_::_m_perObjectType::_m_prob1ObstUnknownN = 128;
      @sysvar::XCP::RadarFC_Obj::_g_PL_AD_fw_Radar_1R1V_rpc_XilObjBypassingRunnable_XilObjBypassingRunnable_m_pad_radarObjPort_par_out_local::TChangeableMemPool::_::_::_m_arrayPool::_0_::_elem::_m_objectInformation::_3_::_m_perObjectType::_m_prob1FourPlusWheelerN = 0;
      @sysvar::XCP::RadarFC_Obj::_g_PL_AD_fw_Radar_1R1V_rpc_XilObjBypassingRunnable_XilObjBypassingRunnable_m_pad_radarObjPort_par_out_local::TChangeableMemPool::_::_::_m_arrayPool::_0_::_elem::_m_objectInformation::_3_::_m_perObjectType::_m_prob1TwoWheelerN = 0;
      @sysvar::XCP::RadarFC_Obj::_g_PL_AD_fw_Radar_1R1V_rpc_XilObjBypassingRunnable_XilObjBypassingRunnable_m_pad_radarObjPort_par_out_local::TChangeableMemPool::_::_::_m_arrayPool::_0_::_elem::_m_objectInformation::_3_::_m_perObjectType::_m_prob1PedestrianN = 0;
      @sysvar::XCP::RadarFC_Obj::_g_PL_AD_fw_Radar_1R1V_rpc_XilObjBypassingRunnable_XilObjBypassingRunnable_m_pad_radarObjPort_par_out_local::TChangeableMemPool::_::_::_m_arrayPool::_0_::_elem::_m_objectInformation::_3_::_m_perObjectType::_m_prob1MovUnknownN = 128;
      @sysvar::XCP::RadarFC_Obj::_g_PL_AD_fw_Radar_1R1V_rpc_XilObjBypassingRunnable_XilObjBypassingRunnable_m_pad_radarObjPort_par_out_local::TChangeableMemPool::_::_::_m_arrayPool::_0_::_elem::_m_objectInformation::_3_::_m_perObjectType::_m_prob1RoadsideBarrierN = 0;
      @sysvar::XCP::RadarFC_Obj::_g_PL_AD_fw_Radar_1R1V_rpc_XilObjBypassingRunnable_XilObjBypassingRunnable_m_pad_radarObjPort_par_out_local::TChangeableMemPool::_::_::_m_arrayPool::_0_::_elem::_m_objectInformation::_3_::_m_perObjectType::_m_prob1StatUnknownN = 128;
      @sysvar::XCP::RadarFC_Obj::_g_PL_AD_fw_Radar_1R1V_rpc_XilObjBypassingRunnable_XilObjBypassingRunnable_m_pad_radarObjPort_par_out_local::TChangeableMemPool::_::_::_m_arrayPool::_0_::_elem::_m_objectInformation::_3_::_m_perObjectType::_m_prob1PassengerCarN = 0;
      @sysvar::XCP::RadarFC_Obj::_g_PL_AD_fw_Radar_1R1V_rpc_XilObjBypassingRunnable_XilObjBypassingRunnable_m_pad_radarObjPort_par_out_local::TChangeableMemPool::_::_::_m_arrayPool::_0_::_elem::_m_objectInformation::_3_::_m_perObjectType::_m_prob1TruckN = 0;
      @sysvar::XCP::RadarFC_Obj::_g_PL_AD_fw_Radar_1R1V_rpc_XilObjBypassingRunnable_XilObjBypassingRunnable_m_pad_radarObjPort_par_out_local::TChangeableMemPool::_::_::_m_arrayPool::_0_::_elem::_m_objectInformation::_3_::_m_perObjectType::_m_prob1FourWheelUnknownN = 128;
      @sysvar::XCP::RadarFC_Obj::_g_PL_AD_fw_Radar_1R1V_rpc_XilObjBypassingRunnable_XilObjBypassingRunnable_m_pad_radarObjPort_par_out_local::TChangeableMemPool::_::_::_m_arrayPool::_0_::_elem::_m_objectInformation::_3_::_m_dWidthN = 256;
        break;

      case 1: //"unknown"
      @sysvar::XCP::RadarFC_Obj::_g_PL_AD_fw_Radar_1R1V_rpc_XilObjBypassingRunnable_XilObjBypassingRunnable_m_pad_radarObjPort_par_out_local::TChangeableMemPool::_::_::_m_arrayPool::_0_::_elem::_m_objectInformation::_3_::_m_perObjectType::_m_prob1ObstacleN = 0;
      @sysvar::XCP::RadarFC_Obj::_g_PL_AD_fw_Radar_1R1V_rpc_XilObjBypassingRunnable_XilObjBypassingRunnable_m_pad_radarObjPort_par_out_local::TChangeableMemPool::_::_::_m_arrayPool::_0_::_elem::_m_objectInformation::_3_::_m_perObjectType::_m_prob1NonObstacleN = 0;
      @sysvar::XCP::RadarFC_Obj::_g_PL_AD_fw_Radar_1R1V_rpc_XilObjBypassingRunnable_XilObjBypassingRunnable_m_pad_radarObjPort_par_out_local::TChangeableMemPool::_::_::_m_arrayPool::_0_::_elem::_m_objectInformation::_3_::_m_perObjectType::_m_prob1UnknownN = 128;
      @sysvar::XCP::RadarFC_Obj::_g_PL_AD_fw_Radar_1R1V_rpc_XilObjBypassingRunnable_XilObjBypassingRunnable_m_pad_radarObjPort_par_out_local::TChangeableMemPool::_::_::_m_arrayPool::_0_::_elem::_m_objectInformation::_3_::_m_perObjectType::_m_prob1MobileN = 0;
      @sysvar::XCP::RadarFC_Obj::_g_PL_AD_fw_Radar_1R1V_rpc_XilObjBypassingRunnable_XilObjBypassingRunnable_m_pad_radarObjPort_par_out_local::TChangeableMemPool::_::_::_m_arrayPool::_0_::_elem::_m_objectInformation::_3_::_m_perObjectType::_m_prob1StationaryN = 0;
      @sysvar::XCP::RadarFC_Obj::_g_PL_AD_fw_Radar_1R1V_rpc_XilObjBypassingRunnable_XilObjBypassingRunnable_m_pad_radarObjPort_par_out_local::TChangeableMemPool::_::_::_m_arrayPool::_0_::_elem::_m_objectInformation::_3_::_m_perObjectType::_m_prob1ObstUnknownN = 128;
      @sysvar::XCP::RadarFC_Obj::_g_PL_AD_fw_Radar_1R1V_rpc_XilObjBypassingRunnable_XilObjBypassingRunnable_m_pad_radarObjPort_par_out_local::TChangeableMemPool::_::_::_m_arrayPool::_0_::_elem::_m_objectInformation::_3_::_m_perObjectType::_m_prob1FourPlusWheelerN = 0;
      @sysvar::XCP::RadarFC_Obj::_g_PL_AD_fw_Radar_1R1V_rpc_XilObjBypassingRunnable_XilObjBypassingRunnable_m_pad_radarObjPort_par_out_local::TChangeableMemPool::_::_::_m_arrayPool::_0_::_elem::_m_objectInformation::_3_::_m_perObjectType::_m_prob1TwoWheelerN = 0;
      @sysvar::XCP::RadarFC_Obj::_g_PL_AD_fw_Radar_1R1V_rpc_XilObjBypassingRunnable_XilObjBypassingRunnable_m_pad_radarObjPort_par_out_local::TChangeableMemPool::_::_::_m_arrayPool::_0_::_elem::_m_objectInformation::_3_::_m_perObjectType::_m_prob1PedestrianN = 0;
      @sysvar::XCP::RadarFC_Obj::_g_PL_AD_fw_Radar_1R1V_rpc_XilObjBypassingRunnable_XilObjBypassingRunnable_m_pad_radarObjPort_par_out_local::TChangeableMemPool::_::_::_m_arrayPool::_0_::_elem::_m_objectInformation::_3_::_m_perObjectType::_m_prob1MovUnknownN = 128;
      @sysvar::XCP::RadarFC_Obj::_g_PL_AD_fw_Radar_1R1V_rpc_XilObjBypassingRunnable_XilObjBypassingRunnable_m_pad_radarObjPort_par_out_local::TChangeableMemPool::_::_::_m_arrayPool::_0_::_elem::_m_objectInformation::_3_::_m_perObjectType::_m_prob1RoadsideBarrierN = 0;
      @sysvar::XCP::RadarFC_Obj::_g_PL_AD_fw_Radar_1R1V_rpc_XilObjBypassingRunnable_XilObjBypassingRunnable_m_pad_radarObjPort_par_out_local::TChangeableMemPool::_::_::_m_arrayPool::_0_::_elem::_m_objectInformation::_3_::_m_perObjectType::_m_prob1StatUnknownN = 128;
      @sysvar::XCP::RadarFC_Obj::_g_PL_AD_fw_Radar_1R1V_rpc_XilObjBypassingRunnable_XilObjBypassingRunnable_m_pad_radarObjPort_par_out_local::TChangeableMemPool::_::_::_m_arrayPool::_0_::_elem::_m_objectInformation::_3_::_m_perObjectType::_m_prob1PassengerCarN = 0;
      @sysvar::XCP::RadarFC_Obj::_g_PL_AD_fw_Radar_1R1V_rpc_XilObjBypassingRunnable_XilObjBypassingRunnable_m_pad_radarObjPort_par_out_local::TChangeableMemPool::_::_::_m_arrayPool::_0_::_elem::_m_objectInformation::_3_::_m_perObjectType::_m_prob1TruckN = 0;
      @sysvar::XCP::RadarFC_Obj::_g_PL_AD_fw_Radar_1R1V_rpc_XilObjBypassingRunnable_XilObjBypassingRunnable_m_pad_radarObjPort_par_out_local::TChangeableMemPool::_::_::_m_arrayPool::_0_::_elem::_m_objectInformation::_3_::_m_perObjectType::_m_prob1FourWheelUnknownN = 128;
      @sysvar::XCP::RadarFC_Obj::_g_PL_AD_fw_Radar_1R1V_rpc_XilObjBypassingRunnable_XilObjBypassingRunnable_m_pad_radarObjPort_par_out_local::TChangeableMemPool::_::_::_m_arrayPool::_0_::_elem::_m_objectInformation::_3_::_m_dWidthN = 256;
        break;

      case 2: //"RoadSideBarrier"
      @sysvar::XCP::RadarFC_Obj::_g_PL_AD_fw_Radar_1R1V_rpc_XilObjBypassingRunnable_XilObjBypassingRunnable_m_pad_radarObjPort_par_out_local::TChangeableMemPool::_::_::_m_arrayPool::_0_::_elem::_m_objectInformation::_3_::_m_perObjectType::_m_prob1ObstacleN = 128;
      @sysvar::XCP::RadarFC_Obj::_g_PL_AD_fw_Radar_1R1V_rpc_XilObjBypassingRunnable_XilObjBypassingRunnable_m_pad_radarObjPort_par_out_local::TChangeableMemPool::_::_::_m_arrayPool::_0_::_elem::_m_objectInformation::_3_::_m_perObjectType::_m_prob1NonObstacleN = 0;
      @sysvar::XCP::RadarFC_Obj::_g_PL_AD_fw_Radar_1R1V_rpc_XilObjBypassingRunnable_XilObjBypassingRunnable_m_pad_radarObjPort_par_out_local::TChangeableMemPool::_::_::_m_arrayPool::_0_::_elem::_m_objectInformation::_3_::_m_perObjectType::_m_prob1UnknownN = 0;
      @sysvar::XCP::RadarFC_Obj::_g_PL_AD_fw_Radar_1R1V_rpc_XilObjBypassingRunnable_XilObjBypassingRunnable_m_pad_radarObjPort_par_out_local::TChangeableMemPool::_::_::_m_arrayPool::_0_::_elem::_m_objectInformation::_3_::_m_perObjectType::_m_prob1MobileN = 0;
      @sysvar::XCP::RadarFC_Obj::_g_PL_AD_fw_Radar_1R1V_rpc_XilObjBypassingRunnable_XilObjBypassingRunnable_m_pad_radarObjPort_par_out_local::TChangeableMemPool::_::_::_m_arrayPool::_0_::_elem::_m_objectInformation::_3_::_m_perObjectType::_m_prob1StationaryN = 128;
      @sysvar::XCP::RadarFC_Obj::_g_PL_AD_fw_Radar_1R1V_rpc_XilObjBypassingRunnable_XilObjBypassingRunnable_m_pad_radarObjPort_par_out_local::TChangeableMemPool::_::_::_m_arrayPool::_0_::_elem::_m_objectInformation::_3_::_m_perObjectType::_m_prob1ObstUnknownN = 0;
      @sysvar::XCP::RadarFC_Obj::_g_PL_AD_fw_Radar_1R1V_rpc_XilObjBypassingRunnable_XilObjBypassingRunnable_m_pad_radarObjPort_par_out_local::TChangeableMemPool::_::_::_m_arrayPool::_0_::_elem::_m_objectInformation::_3_::_m_perObjectType::_m_prob1FourPlusWheelerN = 0;
      @sysvar::XCP::RadarFC_Obj::_g_PL_AD_fw_Radar_1R1V_rpc_XilObjBypassingRunnable_XilObjBypassingRunnable_m_pad_radarObjPort_par_out_local::TChangeableMemPool::_::_::_m_arrayPool::_0_::_elem::_m_objectInformation::_3_::_m_perObjectType::_m_prob1TwoWheelerN = 0;
      @sysvar::XCP::RadarFC_Obj::_g_PL_AD_fw_Radar_1R1V_rpc_XilObjBypassingRunnable_XilObjBypassingRunnable_m_pad_radarObjPort_par_out_local::TChangeableMemPool::_::_::_m_arrayPool::_0_::_elem::_m_objectInformation::_3_::_m_perObjectType::_m_prob1PedestrianN = 0;
      @sysvar::XCP::RadarFC_Obj::_g_PL_AD_fw_Radar_1R1V_rpc_XilObjBypassingRunnable_XilObjBypassingRunnable_m_pad_radarObjPort_par_out_local::TChangeableMemPool::_::_::_m_arrayPool::_0_::_elem::_m_objectInformation::_3_::_m_perObjectType::_m_prob1MovUnknownN = 128;
      @sysvar::XCP::RadarFC_Obj::_g_PL_AD_fw_Radar_1R1V_rpc_XilObjBypassingRunnable_XilObjBypassingRunnable_m_pad_radarObjPort_par_out_local::TChangeableMemPool::_::_::_m_arrayPool::_0_::_elem::_m_objectInformation::_3_::_m_perObjectType::_m_prob1RoadsideBarrierN = 128;
      @sysvar::XCP::RadarFC_Obj::_g_PL_AD_fw_Radar_1R1V_rpc_XilObjBypassingRunnable_XilObjBypassingRunnable_m_pad_radarObjPort_par_out_local::TChangeableMemPool::_::_::_m_arrayPool::_0_::_elem::_m_objectInformation::_3_::_m_perObjectType::_m_prob1StatUnknownN = 0;
      @sysvar::XCP::RadarFC_Obj::_g_PL_AD_fw_Radar_1R1V_rpc_XilObjBypassingRunnable_XilObjBypassingRunnable_m_pad_radarObjPort_par_out_local::TChangeableMemPool::_::_::_m_arrayPool::_0_::_elem::_m_objectInformation::_3_::_m_perObjectType::_m_prob1PassengerCarN = 0;
      @sysvar::XCP::RadarFC_Obj::_g_PL_AD_fw_Radar_1R1V_rpc_XilObjBypassingRunnable_XilObjBypassingRunnable_m_pad_radarObjPort_par_out_local::TChangeableMemPool::_::_::_m_arrayPool::_0_::_elem::_m_objectInformation::_3_::_m_perObjectType::_m_prob1TruckN = 0;
      @sysvar::XCP::RadarFC_Obj::_g_PL_AD_fw_Radar_1R1V_rpc_XilObjBypassingRunnable_XilObjBypassingRunnable_m_pad_radarObjPort_par_out_local::TChangeableMemPool::_::_::_m_arrayPool::_0_::_elem::_m_objectInformation::_3_::_m_perObjectType::_m_prob1FourWheelUnknownN = 128;
      @sysvar::XCP::RadarFC_Obj::_g_PL_AD_fw_Radar_1R1V_rpc_XilObjBypassingRunnable_XilObjBypassingRunnable_m_pad_radarObjPort_par_out_local::TChangeableMemPool::_::_::_m_arrayPool::_0_::_elem::_m_objectInformation::_3_::_m_dWidthN = 256;
        break;

      case 3: //"2Wheeler"
      @sysvar::XCP::RadarFC_Obj::_g_PL_AD_fw_Radar_1R1V_rpc_XilObjBypassingRunnable_XilObjBypassingRunnable_m_pad_radarObjPort_par_out_local::TChangeableMemPool::_::_::_m_arrayPool::_0_::_elem::_m_objectInformation::_3_::_m_perObjectType::_m_prob1ObstacleN = 128;
      @sysvar::XCP::RadarFC_Obj::_g_PL_AD_fw_Radar_1R1V_rpc_XilObjBypassingRunnable_XilObjBypassingRunnable_m_pad_radarObjPort_par_out_local::TChangeableMemPool::_::_::_m_arrayPool::_0_::_elem::_m_objectInformation::_3_::_m_perObjectType::_m_prob1NonObstacleN = 0;
      @sysvar::XCP::RadarFC_Obj::_g_PL_AD_fw_Radar_1R1V_rpc_XilObjBypassingRunnable_XilObjBypassingRunnable_m_pad_radarObjPort_par_out_local::TChangeableMemPool::_::_::_m_arrayPool::_0_::_elem::_m_objectInformation::_3_::_m_perObjectType::_m_prob1UnknownN = 0;
      @sysvar::XCP::RadarFC_Obj::_g_PL_AD_fw_Radar_1R1V_rpc_XilObjBypassingRunnable_XilObjBypassingRunnable_m_pad_radarObjPort_par_out_local::TChangeableMemPool::_::_::_m_arrayPool::_0_::_elem::_m_objectInformation::_3_::_m_perObjectType::_m_prob1MobileN = 128;
      @sysvar::XCP::RadarFC_Obj::_g_PL_AD_fw_Radar_1R1V_rpc_XilObjBypassingRunnable_XilObjBypassingRunnable_m_pad_radarObjPort_par_out_local::TChangeableMemPool::_::_::_m_arrayPool::_0_::_elem::_m_objectInformation::_3_::_m_perObjectType::_m_prob1StationaryN = 0;
      @sysvar::XCP::RadarFC_Obj::_g_PL_AD_fw_Radar_1R1V_rpc_XilObjBypassingRunnable_XilObjBypassingRunnable_m_pad_radarObjPort_par_out_local::TChangeableMemPool::_::_::_m_arrayPool::_0_::_elem::_m_objectInformation::_3_::_m_perObjectType::_m_prob1ObstUnknownN = 0;
      @sysvar::XCP::RadarFC_Obj::_g_PL_AD_fw_Radar_1R1V_rpc_XilObjBypassingRunnable_XilObjBypassingRunnable_m_pad_radarObjPort_par_out_local::TChangeableMemPool::_::_::_m_arrayPool::_0_::_elem::_m_objectInformation::_3_::_m_perObjectType::_m_prob1FourPlusWheelerN = 0;
      @sysvar::XCP::RadarFC_Obj::_g_PL_AD_fw_Radar_1R1V_rpc_XilObjBypassingRunnable_XilObjBypassingRunnable_m_pad_radarObjPort_par_out_local::TChangeableMemPool::_::_::_m_arrayPool::_0_::_elem::_m_objectInformation::_3_::_m_perObjectType::_m_prob1TwoWheelerN = 128;
      @sysvar::XCP::RadarFC_Obj::_g_PL_AD_fw_Radar_1R1V_rpc_XilObjBypassingRunnable_XilObjBypassingRunnable_m_pad_radarObjPort_par_out_local::TChangeableMemPool::_::_::_m_arrayPool::_0_::_elem::_m_objectInformation::_3_::_m_perObjectType::_m_prob1PedestrianN = 0;
      @sysvar::XCP::RadarFC_Obj::_g_PL_AD_fw_Radar_1R1V_rpc_XilObjBypassingRunnable_XilObjBypassingRunnable_m_pad_radarObjPort_par_out_local::TChangeableMemPool::_::_::_m_arrayPool::_0_::_elem::_m_objectInformation::_3_::_m_perObjectType::_m_prob1MovUnknownN = 0;
      @sysvar::XCP::RadarFC_Obj::_g_PL_AD_fw_Radar_1R1V_rpc_XilObjBypassingRunnable_XilObjBypassingRunnable_m_pad_radarObjPort_par_out_local::TChangeableMemPool::_::_::_m_arrayPool::_0_::_elem::_m_objectInformation::_3_::_m_perObjectType::_m_prob1RoadsideBarrierN = 0;
      @sysvar::XCP::RadarFC_Obj::_g_PL_AD_fw_Radar_1R1V_rpc_XilObjBypassingRunnable_XilObjBypassingRunnable_m_pad_radarObjPort_par_out_local::TChangeableMemPool::_::_::_m_arrayPool::_0_::_elem::_m_objectInformation::_3_::_m_perObjectType::_m_prob1StatUnknownN = 128;
      @sysvar::XCP::RadarFC_Obj::_g_PL_AD_fw_Radar_1R1V_rpc_XilObjBypassingRunnable_XilObjBypassingRunnable_m_pad_radarObjPort_par_out_local::TChangeableMemPool::_::_::_m_arrayPool::_0_::_elem::_m_objectInformation::_3_::_m_perObjectType::_m_prob1PassengerCarN = 0;
      @sysvar::XCP::RadarFC_Obj::_g_PL_AD_fw_Radar_1R1V_rpc_XilObjBypassingRunnable_XilObjBypassingRunnable_m_pad_radarObjPort_par_out_local::TChangeableMemPool::_::_::_m_arrayPool::_0_::_elem::_m_objectInformation::_3_::_m_perObjectType::_m_prob1TruckN = 0;
      @sysvar::XCP::RadarFC_Obj::_g_PL_AD_fw_Radar_1R1V_rpc_XilObjBypassingRunnable_XilObjBypassingRunnable_m_pad_radarObjPort_par_out_local::TChangeableMemPool::_::_::_m_arrayPool::_0_::_elem::_m_objectInformation::_3_::_m_perObjectType::_m_prob1FourWheelUnknownN = 128;
      @sysvar::XCP::RadarFC_Obj::_g_PL_AD_fw_Radar_1R1V_rpc_XilObjBypassingRunnable_XilObjBypassingRunnable_m_pad_radarObjPort_par_out_local::TChangeableMemPool::_::_::_m_arrayPool::_0_::_elem::_m_objectInformation::_3_::_m_dWidthN = 64;
        break;

      case 4: //"Pedestrian"
      @sysvar::XCP::RadarFC_Obj::_g_PL_AD_fw_Radar_1R1V_rpc_XilObjBypassingRunnable_XilObjBypassingRunnable_m_pad_radarObjPort_par_out_local::TChangeableMemPool::_::_::_m_arrayPool::_0_::_elem::_m_objectInformation::_3_::_m_perObjectType::_m_prob1ObstacleN = 128;
      @sysvar::XCP::RadarFC_Obj::_g_PL_AD_fw_Radar_1R1V_rpc_XilObjBypassingRunnable_XilObjBypassingRunnable_m_pad_radarObjPort_par_out_local::TChangeableMemPool::_::_::_m_arrayPool::_0_::_elem::_m_objectInformation::_3_::_m_perObjectType::_m_prob1NonObstacleN = 0;
      @sysvar::XCP::RadarFC_Obj::_g_PL_AD_fw_Radar_1R1V_rpc_XilObjBypassingRunnable_XilObjBypassingRunnable_m_pad_radarObjPort_par_out_local::TChangeableMemPool::_::_::_m_arrayPool::_0_::_elem::_m_objectInformation::_3_::_m_perObjectType::_m_prob1UnknownN = 0;
      @sysvar::XCP::RadarFC_Obj::_g_PL_AD_fw_Radar_1R1V_rpc_XilObjBypassingRunnable_XilObjBypassingRunnable_m_pad_radarObjPort_par_out_local::TChangeableMemPool::_::_::_m_arrayPool::_0_::_elem::_m_objectInformation::_3_::_m_perObjectType::_m_prob1MobileN = 128;
      @sysvar::XCP::RadarFC_Obj::_g_PL_AD_fw_Radar_1R1V_rpc_XilObjBypassingRunnable_XilObjBypassingRunnable_m_pad_radarObjPort_par_out_local::TChangeableMemPool::_::_::_m_arrayPool::_0_::_elem::_m_objectInformation::_3_::_m_perObjectType::_m_prob1StationaryN = 0;
      @sysvar::XCP::RadarFC_Obj::_g_PL_AD_fw_Radar_1R1V_rpc_XilObjBypassingRunnable_XilObjBypassingRunnable_m_pad_radarObjPort_par_out_local::TChangeableMemPool::_::_::_m_arrayPool::_0_::_elem::_m_objectInformation::_3_::_m_perObjectType::_m_prob1ObstUnknownN = 0;
      @sysvar::XCP::RadarFC_Obj::_g_PL_AD_fw_Radar_1R1V_rpc_XilObjBypassingRunnable_XilObjBypassingRunnable_m_pad_radarObjPort_par_out_local::TChangeableMemPool::_::_::_m_arrayPool::_0_::_elem::_m_objectInformation::_3_::_m_perObjectType::_m_prob1FourPlusWheelerN = 0;
      @sysvar::XCP::RadarFC_Obj::_g_PL_AD_fw_Radar_1R1V_rpc_XilObjBypassingRunnable_XilObjBypassingRunnable_m_pad_radarObjPort_par_out_local::TChangeableMemPool::_::_::_m_arrayPool::_0_::_elem::_m_objectInformation::_3_::_m_perObjectType::_m_prob1TwoWheelerN = 0;
      @sysvar::XCP::RadarFC_Obj::_g_PL_AD_fw_Radar_1R1V_rpc_XilObjBypassingRunnable_XilObjBypassingRunnable_m_pad_radarObjPort_par_out_local::TChangeableMemPool::_::_::_m_arrayPool::_0_::_elem::_m_objectInformation::_3_::_m_perObjectType::_m_prob1PedestrianN = 128;
      @sysvar::XCP::RadarFC_Obj::_g_PL_AD_fw_Radar_1R1V_rpc_XilObjBypassingRunnable_XilObjBypassingRunnable_m_pad_radarObjPort_par_out_local::TChangeableMemPool::_::_::_m_arrayPool::_0_::_elem::_m_objectInformation::_3_::_m_perObjectType::_m_prob1MovUnknownN = 0;
      @sysvar::XCP::RadarFC_Obj::_g_PL_AD_fw_Radar_1R1V_rpc_XilObjBypassingRunnable_XilObjBypassingRunnable_m_pad_radarObjPort_par_out_local::TChangeableMemPool::_::_::_m_arrayPool::_0_::_elem::_m_objectInformation::_3_::_m_perObjectType::_m_prob1RoadsideBarrierN = 0;
      @sysvar::XCP::RadarFC_Obj::_g_PL_AD_fw_Radar_1R1V_rpc_XilObjBypassingRunnable_XilObjBypassingRunnable_m_pad_radarObjPort_par_out_local::TChangeableMemPool::_::_::_m_arrayPool::_0_::_elem::_m_objectInformation::_3_::_m_perObjectType::_m_prob1StatUnknownN = 128;
      @sysvar::XCP::RadarFC_Obj::_g_PL_AD_fw_Radar_1R1V_rpc_XilObjBypassingRunnable_XilObjBypassingRunnable_m_pad_radarObjPort_par_out_local::TChangeableMemPool::_::_::_m_arrayPool::_0_::_elem::_m_objectInformation::_3_::_m_perObjectType::_m_prob1PassengerCarN = 0;
      @sysvar::XCP::RadarFC_Obj::_g_PL_AD_fw_Radar_1R1V_rpc_XilObjBypassingRunnable_XilObjBypassingRunnable_m_pad_radarObjPort_par_out_local::TChangeableMemPool::_::_::_m_arrayPool::_0_::_elem::_m_objectInformation::_3_::_m_perObjectType::_m_prob1TruckN = 0;
      @sysvar::XCP::RadarFC_Obj::_g_PL_AD_fw_Radar_1R1V_rpc_XilObjBypassingRunnable_XilObjBypassingRunnable_m_pad_radarObjPort_par_out_local::TChangeableMemPool::_::_::_m_arrayPool::_0_::_elem::_m_objectInformation::_3_::_m_perObjectType::_m_prob1FourWheelUnknownN = 128;
      @sysvar::XCP::RadarFC_Obj::_g_PL_AD_fw_Radar_1R1V_rpc_XilObjBypassingRunnable_XilObjBypassingRunnable_m_pad_radarObjPort_par_out_local::TChangeableMemPool::_::_::_m_arrayPool::_0_::_elem::_m_objectInformation::_3_::_m_dWidthN = 64;
        break;

      case 5: //"Truck"
      @sysvar::XCP::RadarFC_Obj::_g_PL_AD_fw_Radar_1R1V_rpc_XilObjBypassingRunnable_XilObjBypassingRunnable_m_pad_radarObjPort_par_out_local::TChangeableMemPool::_::_::_m_arrayPool::_0_::_elem::_m_objectInformation::_3_::_m_perObjectType::_m_prob1ObstacleN = 128;
      @sysvar::XCP::RadarFC_Obj::_g_PL_AD_fw_Radar_1R1V_rpc_XilObjBypassingRunnable_XilObjBypassingRunnable_m_pad_radarObjPort_par_out_local::TChangeableMemPool::_::_::_m_arrayPool::_0_::_elem::_m_objectInformation::_3_::_m_perObjectType::_m_prob1NonObstacleN = 0;
      @sysvar::XCP::RadarFC_Obj::_g_PL_AD_fw_Radar_1R1V_rpc_XilObjBypassingRunnable_XilObjBypassingRunnable_m_pad_radarObjPort_par_out_local::TChangeableMemPool::_::_::_m_arrayPool::_0_::_elem::_m_objectInformation::_3_::_m_perObjectType::_m_prob1UnknownN = 0;
      @sysvar::XCP::RadarFC_Obj::_g_PL_AD_fw_Radar_1R1V_rpc_XilObjBypassingRunnable_XilObjBypassingRunnable_m_pad_radarObjPort_par_out_local::TChangeableMemPool::_::_::_m_arrayPool::_0_::_elem::_m_objectInformation::_3_::_m_perObjectType::_m_prob1MobileN = 128;
      @sysvar::XCP::RadarFC_Obj::_g_PL_AD_fw_Radar_1R1V_rpc_XilObjBypassingRunnable_XilObjBypassingRunnable_m_pad_radarObjPort_par_out_local::TChangeableMemPool::_::_::_m_arrayPool::_0_::_elem::_m_objectInformation::_3_::_m_perObjectType::_m_prob1StationaryN = 0;
      @sysvar::XCP::RadarFC_Obj::_g_PL_AD_fw_Radar_1R1V_rpc_XilObjBypassingRunnable_XilObjBypassingRunnable_m_pad_radarObjPort_par_out_local::TChangeableMemPool::_::_::_m_arrayPool::_0_::_elem::_m_objectInformation::_3_::_m_perObjectType::_m_prob1ObstUnknownN = 0;
      @sysvar::XCP::RadarFC_Obj::_g_PL_AD_fw_Radar_1R1V_rpc_XilObjBypassingRunnable_XilObjBypassingRunnable_m_pad_radarObjPort_par_out_local::TChangeableMemPool::_::_::_m_arrayPool::_0_::_elem::_m_objectInformation::_3_::_m_perObjectType::_m_prob1FourPlusWheelerN = 128;
      @sysvar::XCP::RadarFC_Obj::_g_PL_AD_fw_Radar_1R1V_rpc_XilObjBypassingRunnable_XilObjBypassingRunnable_m_pad_radarObjPort_par_out_local::TChangeableMemPool::_::_::_m_arrayPool::_0_::_elem::_m_objectInformation::_3_::_m_perObjectType::_m_prob1TwoWheelerN = 0;
      @sysvar::XCP::RadarFC_Obj::_g_PL_AD_fw_Radar_1R1V_rpc_XilObjBypassingRunnable_XilObjBypassingRunnable_m_pad_radarObjPort_par_out_local::TChangeableMemPool::_::_::_m_arrayPool::_0_::_elem::_m_objectInformation::_3_::_m_perObjectType::_m_prob1PedestrianN = 0;
      @sysvar::XCP::RadarFC_Obj::_g_PL_AD_fw_Radar_1R1V_rpc_XilObjBypassingRunnable_XilObjBypassingRunnable_m_pad_radarObjPort_par_out_local::TChangeableMemPool::_::_::_m_arrayPool::_0_::_elem::_m_objectInformation::_3_::_m_perObjectType::_m_prob1MovUnknownN = 0;
      @sysvar::XCP::RadarFC_Obj::_g_PL_AD_fw_Radar_1R1V_rpc_XilObjBypassingRunnable_XilObjBypassingRunnable_m_pad_radarObjPort_par_out_local::TChangeableMemPool::_::_::_m_arrayPool::_0_::_elem::_m_objectInformation::_3_::_m_perObjectType::_m_prob1RoadsideBarrierN = 0;
      @sysvar::XCP::RadarFC_Obj::_g_PL_AD_fw_Radar_1R1V_rpc_XilObjBypassingRunnable_XilObjBypassingRunnable_m_pad_radarObjPort_par_out_local::TChangeableMemPool::_::_::_m_arrayPool::_0_::_elem::_m_objectInformation::_3_::_m_perObjectType::_m_prob1StatUnknownN = 128;
      @sysvar::XCP::RadarFC_Obj::_g_PL_AD_fw_Radar_1R1V_rpc_XilObjBypassingRunnable_XilObjBypassingRunnable_m_pad_radarObjPort_par_out_local::TChangeableMemPool::_::_::_m_arrayPool::_0_::_elem::_m_objectInformation::_3_::_m_perObjectType::_m_prob1PassengerCarN = 0;
      @sysvar::XCP::RadarFC_Obj::_g_PL_AD_fw_Radar_1R1V_rpc_XilObjBypassingRunnable_XilObjBypassingRunnable_m_pad_radarObjPort_par_out_local::TChangeableMemPool::_::_::_m_arrayPool::_0_::_elem::_m_objectInformation::_3_::_m_perObjectType::_m_prob1TruckN = 128;
      @sysvar::XCP::RadarFC_Obj::_g_PL_AD_fw_Radar_1R1V_rpc_XilObjBypassingRunnable_XilObjBypassingRunnable_m_pad_radarObjPort_par_out_local::TChangeableMemPool::_::_::_m_arrayPool::_0_::_elem::_m_objectInformation::_3_::_m_perObjectType::_m_prob1FourWheelUnknownN = 0;
      @sysvar::XCP::RadarFC_Obj::_g_PL_AD_fw_Radar_1R1V_rpc_XilObjBypassingRunnable_XilObjBypassingRunnable_m_pad_radarObjPort_par_out_local::TChangeableMemPool::_::_::_m_arrayPool::_0_::_elem::_m_objectInformation::_3_::_m_dWidthN = 256;
        break;

      case 6: //"PassengerCar"
      @sysvar::XCP::RadarFC_Obj::_g_PL_AD_fw_Radar_1R1V_rpc_XilObjBypassingRunnable_XilObjBypassingRunnable_m_pad_radarObjPort_par_out_local::TChangeableMemPool::_::_::_m_arrayPool::_0_::_elem::_m_objectInformation::_3_::_m_perObjectType::_m_prob1ObstacleN = 128;
      @sysvar::XCP::RadarFC_Obj::_g_PL_AD_fw_Radar_1R1V_rpc_XilObjBypassingRunnable_XilObjBypassingRunnable_m_pad_radarObjPort_par_out_local::TChangeableMemPool::_::_::_m_arrayPool::_0_::_elem::_m_objectInformation::_3_::_m_perObjectType::_m_prob1NonObstacleN = 0;
      @sysvar::XCP::RadarFC_Obj::_g_PL_AD_fw_Radar_1R1V_rpc_XilObjBypassingRunnable_XilObjBypassingRunnable_m_pad_radarObjPort_par_out_local::TChangeableMemPool::_::_::_m_arrayPool::_0_::_elem::_m_objectInformation::_3_::_m_perObjectType::_m_prob1UnknownN = 0;
      @sysvar::XCP::RadarFC_Obj::_g_PL_AD_fw_Radar_1R1V_rpc_XilObjBypassingRunnable_XilObjBypassingRunnable_m_pad_radarObjPort_par_out_local::TChangeableMemPool::_::_::_m_arrayPool::_0_::_elem::_m_objectInformation::_3_::_m_perObjectType::_m_prob1MobileN = 128;
      @sysvar::XCP::RadarFC_Obj::_g_PL_AD_fw_Radar_1R1V_rpc_XilObjBypassingRunnable_XilObjBypassingRunnable_m_pad_radarObjPort_par_out_local::TChangeableMemPool::_::_::_m_arrayPool::_0_::_elem::_m_objectInformation::_3_::_m_perObjectType::_m_prob1StationaryN = 0;
      @sysvar::XCP::RadarFC_Obj::_g_PL_AD_fw_Radar_1R1V_rpc_XilObjBypassingRunnable_XilObjBypassingRunnable_m_pad_radarObjPort_par_out_local::TChangeableMemPool::_::_::_m_arrayPool::_0_::_elem::_m_objectInformation::_3_::_m_perObjectType::_m_prob1ObstUnknownN = 0;
      @sysvar::XCP::RadarFC_Obj::_g_PL_AD_fw_Radar_1R1V_rpc_XilObjBypassingRunnable_XilObjBypassingRunnable_m_pad_radarObjPort_par_out_local::TChangeableMemPool::_::_::_m_arrayPool::_0_::_elem::_m_objectInformation::_3_::_m_perObjectType::_m_prob1FourPlusWheelerN = 128;
      @sysvar::XCP::RadarFC_Obj::_g_PL_AD_fw_Radar_1R1V_rpc_XilObjBypassingRunnable_XilObjBypassingRunnable_m_pad_radarObjPort_par_out_local::TChangeableMemPool::_::_::_m_arrayPool::_0_::_elem::_m_objectInformation::_3_::_m_perObjectType::_m_prob1TwoWheelerN = 0;
      @sysvar::XCP::RadarFC_Obj::_g_PL_AD_fw_Radar_1R1V_rpc_XilObjBypassingRunnable_XilObjBypassingRunnable_m_pad_radarObjPort_par_out_local::TChangeableMemPool::_::_::_m_arrayPool::_0_::_elem::_m_objectInformation::_3_::_m_perObjectType::_m_prob1PedestrianN = 0;
      @sysvar::XCP::RadarFC_Obj::_g_PL_AD_fw_Radar_1R1V_rpc_XilObjBypassingRunnable_XilObjBypassingRunnable_m_pad_radarObjPort_par_out_local::TChangeableMemPool::_::_::_m_arrayPool::_0_::_elem::_m_objectInformation::_3_::_m_perObjectType::_m_prob1MovUnknownN = 0;
      @sysvar::XCP::RadarFC_Obj::_g_PL_AD_fw_Radar_1R1V_rpc_XilObjBypassingRunnable_XilObjBypassingRunnable_m_pad_radarObjPort_par_out_local::TChangeableMemPool::_::_::_m_arrayPool::_0_::_elem::_m_objectInformation::_3_::_m_perObjectType::_m_prob1RoadsideBarrierN = 0;
      @sysvar::XCP::RadarFC_Obj::_g_PL_AD_fw_Radar_1R1V_rpc_XilObjBypassingRunnable_XilObjBypassingRunnable_m_pad_radarObjPort_par_out_local::TChangeableMemPool::_::_::_m_arrayPool::_0_::_elem::_m_objectInformation::_3_::_m_perObjectType::_m_prob1StatUnknownN = 128;
      @sysvar::XCP::RadarFC_Obj::_g_PL_AD_fw_Radar_1R1V_rpc_XilObjBypassingRunnable_XilObjBypassingRunnable_m_pad_radarObjPort_par_out_local::TChangeableMemPool::_::_::_m_arrayPool::_0_::_elem::_m_objectInformation::_3_::_m_perObjectType::_m_prob1PassengerCarN = 128;
      @sysvar::XCP::RadarFC_Obj::_g_PL_AD_fw_Radar_1R1V_rpc_XilObjBypassingRunnable_XilObjBypassingRunnable_m_pad_radarObjPort_par_out_local::TChangeableMemPool::_::_::_m_arrayPool::_0_::_elem::_m_objectInformation::_3_::_m_perObjectType::_m_prob1TruckN = 0;
      @sysvar::XCP::RadarFC_Obj::_g_PL_AD_fw_Radar_1R1V_rpc_XilObjBypassingRunnable_XilObjBypassingRunnable_m_pad_radarObjPort_par_out_local::TChangeableMemPool::_::_::_m_arrayPool::_0_::_elem::_m_objectInformation::_3_::_m_perObjectType::_m_prob1FourWheelUnknownN = 0;
      @sysvar::XCP::RadarFC_Obj::_g_PL_AD_fw_Radar_1R1V_rpc_XilObjBypassingRunnable_XilObjBypassingRunnable_m_pad_radarObjPort_par_out_local::TChangeableMemPool::_::_::_m_arrayPool::_0_::_elem::_m_objectInformation::_3_::_m_dWidthN = 256;
        break;
    }
    break;

    case 4: //"Object-4"
    //constant
  @sysvar::XCP::RadarFC_Obj::_g_PL_AD_fw_Radar_1R1V_rpc_XilObjBypassingRunnable_XilObjBypassingRunnable_m_pad_radarObjPort_par_out_local::TChangeableMemPool::_::_::_m_arrayPool::_0_::_elem::_m_objectInformation::_4_::_Valid_b = 1;
  @sysvar::XCP::RadarFC_Obj::_g_PL_AD_fw_Radar_1R1V_rpc_XilObjBypassingRunnable_XilObjBypassingRunnable_m_pad_radarObjPort_par_out_local::TChangeableMemPool::_::_::_m_arrayPool::_0_::_elem::_m_objectInformation::_4_::_m_HandleN = 1;
  @sysvar::XCP::RadarFC_Obj::_g_PL_AD_fw_Radar_1R1V_rpc_XilObjBypassingRunnable_XilObjBypassingRunnable_m_pad_radarObjPort_par_out_local::TChangeableMemPool::_::_::_m_arrayPool::_0_::_elem::_m_objectInformation::_4_::_m_alpPiVarYawAngleN = 0;
  @sysvar::XCP::RadarFC_Obj::_g_PL_AD_fw_Radar_1R1V_rpc_XilObjBypassingRunnable_XilObjBypassingRunnable_m_pad_radarObjPort_par_out_local::TChangeableMemPool::_::_::_m_arrayPool::_0_::_elem::_m_objectInformation::_4_::_m_alpPiYawAngleN = 0;
  @sysvar::XCP::RadarFC_Obj::_g_PL_AD_fw_Radar_1R1V_rpc_XilObjBypassingRunnable_XilObjBypassingRunnable_m_pad_radarObjPort_par_out_local::TChangeableMemPool::_::_::_m_arrayPool::_0_::_elem::_m_objectInformation::_4_::_m_varAxN = 0;
  @sysvar::XCP::RadarFC_Obj::_g_PL_AD_fw_Radar_1R1V_rpc_XilObjBypassingRunnable_XilObjBypassingRunnable_m_pad_radarObjPort_par_out_local::TChangeableMemPool::_::_::_m_arrayPool::_0_::_elem::_m_objectInformation::_4_::_m_varAyN = 0;
  @sysvar::XCP::RadarFC_Obj::_g_PL_AD_fw_Radar_1R1V_rpc_XilObjBypassingRunnable_XilObjBypassingRunnable_m_pad_radarObjPort_par_out_local::TChangeableMemPool::_::_::_m_arrayPool::_0_::_elem::_m_objectInformation::_4_::_m_varVxN = 0;
  @sysvar::XCP::RadarFC_Obj::_g_PL_AD_fw_Radar_1R1V_rpc_XilObjBypassingRunnable_XilObjBypassingRunnable_m_pad_radarObjPort_par_out_local::TChangeableMemPool::_::_::_m_arrayPool::_0_::_elem::_m_objectInformation::_4_::_m_varVyN = 0;
  @sysvar::XCP::RadarFC_Obj::_g_PL_AD_fw_Radar_1R1V_rpc_XilObjBypassingRunnable_XilObjBypassingRunnable_m_pad_radarObjPort_par_out_local::TChangeableMemPool::_::_::_m_arrayPool::_0_::_elem::_m_objectInformation::_4_::_m_varDxN = 0;
  @sysvar::XCP::RadarFC_Obj::_g_PL_AD_fw_Radar_1R1V_rpc_XilObjBypassingRunnable_XilObjBypassingRunnable_m_pad_radarObjPort_par_out_local::TChangeableMemPool::_::_::_m_arrayPool::_0_::_elem::_m_objectInformation::_4_::_m_varDyN = 0;
  @sysvar::XCP::RadarFC_Obj::_g_PL_AD_fw_Radar_1R1V_rpc_XilObjBypassingRunnable_XilObjBypassingRunnable_m_pad_radarObjPort_par_out_local::TChangeableMemPool::_::_::_m_arrayPool::_0_::_elem::_m_objectInformation::_4_::_m_dVarLengthN = 0;
  @sysvar::XCP::RadarFC_Obj::_g_PL_AD_fw_Radar_1R1V_rpc_XilObjBypassingRunnable_XilObjBypassingRunnable_m_pad_radarObjPort_par_out_local::TChangeableMemPool::_::_::_m_arrayPool::_0_::_elem::_m_objectInformation::_4_::_m_dVarWidthN = 0;
  @sysvar::XCP::RadarFC_Obj::_g_PL_AD_fw_Radar_1R1V_rpc_XilObjBypassingRunnable_XilObjBypassingRunnable_m_pad_radarObjPort_par_out_local::TChangeableMemPool::_::_::_m_arrayPool::_0_::_elem::_m_objectInformation::_4_::_m_wExistProbN = 64880;
  @sysvar::XCP::RadarFC_Obj::_g_PL_AD_fw_Radar_1R1V_rpc_XilObjBypassingRunnable_XilObjBypassingRunnable_m_pad_radarObjPort_par_out_local::TChangeableMemPool::_::_::_m_arrayPool::_0_::_elem::_m_objectInformation::_4_::_m_isObjectAsil = 1;
  @sysvar::XCP::RadarFC_Obj::_g_PL_AD_fw_Radar_1R1V_rpc_XilObjBypassingRunnable_XilObjBypassingRunnable_m_pad_radarObjPort_par_out_local::TChangeableMemPool::_::_::_m_arrayPool::_0_::_elem::_m_objectInformation::_4_::_m_dLengthN = 128;

    //target movement

  @sysvar::XCP::RadarFC_Obj::_g_PL_AD_fw_Radar_1R1V_rpc_XilObjBypassingRunnable_XilObjBypassingRunnable_m_pad_radarObjPort_par_out_local::TChangeableMemPool::_::_::_m_arrayPool::_0_::_elem::_m_objectInformation::_4_::_m_dxN = @target_radar_fc_sim::objdata.obj_distance_x[4] * 128;
  @sysvar::XCP::RadarFC_Obj::_g_PL_AD_fw_Radar_1R1V_rpc_XilObjBypassingRunnable_XilObjBypassingRunnable_m_pad_radarObjPort_par_out_local::TChangeableMemPool::_::_::_m_arrayPool::_0_::_elem::_m_objectInformation::_4_::_m_dyN = @target_radar_fc_sim::objdata.obj_distance_y[4] * 128;
  @sysvar::XCP::RadarFC_Obj::_g_PL_AD_fw_Radar_1R1V_rpc_XilObjBypassingRunnable_XilObjBypassingRunnable_m_pad_radarObjPort_par_out_local::TChangeableMemPool::_::_::_m_arrayPool::_0_::_elem::_m_objectInformation::_4_::_m_dzN = 0;
  @sysvar::XCP::RadarFC_Obj::_g_PL_AD_fw_Radar_1R1V_rpc_XilObjBypassingRunnable_XilObjBypassingRunnable_m_pad_radarObjPort_par_out_local::TChangeableMemPool::_::_::_m_arrayPool::_0_::_elem::_m_objectInformation::_4_::_m_vxN = @target_radar_fc_sim::objdata.obj_velocity_x[4] * 256;
  @sysvar::XCP::RadarFC_Obj::_g_PL_AD_fw_Radar_1R1V_rpc_XilObjBypassingRunnable_XilObjBypassingRunnable_m_pad_radarObjPort_par_out_local::TChangeableMemPool::_::_::_m_arrayPool::_0_::_elem::_m_objectInformation::_4_::_m_vyN = @target_radar_fc_sim::objdata.obj_velocity_y[4] * 256;
  @sysvar::XCP::RadarFC_Obj::_g_PL_AD_fw_Radar_1R1V_rpc_XilObjBypassingRunnable_XilObjBypassingRunnable_m_pad_radarObjPort_par_out_local::TChangeableMemPool::_::_::_m_arrayPool::_0_::_elem::_m_objectInformation::_4_::_m_axN = 0;
  @sysvar::XCP::RadarFC_Obj::_g_PL_AD_fw_Radar_1R1V_rpc_XilObjBypassingRunnable_XilObjBypassingRunnable_m_pad_radarObjPort_par_out_local::TChangeableMemPool::_::_::_m_arrayPool::_0_::_elem::_m_objectInformation::_4_::_m_ayN = 0;

    //target object moving or not
    if (abs(@target_radar_fc_sim::objdata.obj_velocity_x[4]) != 0)
    {
    @sysvar::XCP::RadarFC_Obj::_g_PL_AD_fw_Radar_1R1V_rpc_XilObjBypassingRunnable_XilObjBypassingRunnable_m_pad_radarObjPort_par_out_local::TChangeableMemPool::_::_::_m_arrayPool::_0_::_elem::_m_objectInformation::_4_::_m_prob1HasBeenObservedMovingN = 126;
    @sysvar::XCP::RadarFC_Obj::_g_PL_AD_fw_Radar_1R1V_rpc_XilObjBypassingRunnable_XilObjBypassingRunnable_m_pad_radarObjPort_par_out_local::TChangeableMemPool::_::_::_m_arrayPool::_0_::_elem::_m_objectInformation::_4_::_m_prob1MovingN = 126;
    }
    else
    {
    @sysvar::XCP::RadarFC_Obj::_g_PL_AD_fw_Radar_1R1V_rpc_XilObjBypassingRunnable_XilObjBypassingRunnable_m_pad_radarObjPort_par_out_local::TChangeableMemPool::_::_::_m_arrayPool::_0_::_elem::_m_objectInformation::_4_::_m_prob1HasBeenObservedMovingN = 0;
    @sysvar::XCP::RadarFC_Obj::_g_PL_AD_fw_Radar_1R1V_rpc_XilObjBypassingRunnable_XilObjBypassingRunnable_m_pad_radarObjPort_par_out_local::TChangeableMemPool::_::_::_m_arrayPool::_0_::_elem::_m_objectInformation::_4_::_m_prob1MovingN = 0;
    }

      //object classification
    switch (@target_radar_fc_sim::objdata.obj_type[4])
    {
      case 0: //"Non-Obstacle"
      @sysvar::XCP::RadarFC_Obj::_g_PL_AD_fw_Radar_1R1V_rpc_XilObjBypassingRunnable_XilObjBypassingRunnable_m_pad_radarObjPort_par_out_local::TChangeableMemPool::_::_::_m_arrayPool::_0_::_elem::_m_objectInformation::_4_::_m_perObjectType::_m_prob1ObstacleN = 0;
      @sysvar::XCP::RadarFC_Obj::_g_PL_AD_fw_Radar_1R1V_rpc_XilObjBypassingRunnable_XilObjBypassingRunnable_m_pad_radarObjPort_par_out_local::TChangeableMemPool::_::_::_m_arrayPool::_0_::_elem::_m_objectInformation::_4_::_m_perObjectType::_m_prob1NonObstacleN = 128;
      @sysvar::XCP::RadarFC_Obj::_g_PL_AD_fw_Radar_1R1V_rpc_XilObjBypassingRunnable_XilObjBypassingRunnable_m_pad_radarObjPort_par_out_local::TChangeableMemPool::_::_::_m_arrayPool::_0_::_elem::_m_objectInformation::_4_::_m_perObjectType::_m_prob1UnknownN = 0;
      @sysvar::XCP::RadarFC_Obj::_g_PL_AD_fw_Radar_1R1V_rpc_XilObjBypassingRunnable_XilObjBypassingRunnable_m_pad_radarObjPort_par_out_local::TChangeableMemPool::_::_::_m_arrayPool::_0_::_elem::_m_objectInformation::_4_::_m_perObjectType::_m_prob1MobileN = 0;
      @sysvar::XCP::RadarFC_Obj::_g_PL_AD_fw_Radar_1R1V_rpc_XilObjBypassingRunnable_XilObjBypassingRunnable_m_pad_radarObjPort_par_out_local::TChangeableMemPool::_::_::_m_arrayPool::_0_::_elem::_m_objectInformation::_4_::_m_perObjectType::_m_prob1StationaryN = 0;
      @sysvar::XCP::RadarFC_Obj::_g_PL_AD_fw_Radar_1R1V_rpc_XilObjBypassingRunnable_XilObjBypassingRunnable_m_pad_radarObjPort_par_out_local::TChangeableMemPool::_::_::_m_arrayPool::_0_::_elem::_m_objectInformation::_4_::_m_perObjectType::_m_prob1ObstUnknownN = 128;
      @sysvar::XCP::RadarFC_Obj::_g_PL_AD_fw_Radar_1R1V_rpc_XilObjBypassingRunnable_XilObjBypassingRunnable_m_pad_radarObjPort_par_out_local::TChangeableMemPool::_::_::_m_arrayPool::_0_::_elem::_m_objectInformation::_4_::_m_perObjectType::_m_prob1FourPlusWheelerN = 0;
      @sysvar::XCP::RadarFC_Obj::_g_PL_AD_fw_Radar_1R1V_rpc_XilObjBypassingRunnable_XilObjBypassingRunnable_m_pad_radarObjPort_par_out_local::TChangeableMemPool::_::_::_m_arrayPool::_0_::_elem::_m_objectInformation::_4_::_m_perObjectType::_m_prob1TwoWheelerN = 0;
      @sysvar::XCP::RadarFC_Obj::_g_PL_AD_fw_Radar_1R1V_rpc_XilObjBypassingRunnable_XilObjBypassingRunnable_m_pad_radarObjPort_par_out_local::TChangeableMemPool::_::_::_m_arrayPool::_0_::_elem::_m_objectInformation::_4_::_m_perObjectType::_m_prob1PedestrianN = 0;
      @sysvar::XCP::RadarFC_Obj::_g_PL_AD_fw_Radar_1R1V_rpc_XilObjBypassingRunnable_XilObjBypassingRunnable_m_pad_radarObjPort_par_out_local::TChangeableMemPool::_::_::_m_arrayPool::_0_::_elem::_m_objectInformation::_4_::_m_perObjectType::_m_prob1MovUnknownN = 128;
      @sysvar::XCP::RadarFC_Obj::_g_PL_AD_fw_Radar_1R1V_rpc_XilObjBypassingRunnable_XilObjBypassingRunnable_m_pad_radarObjPort_par_out_local::TChangeableMemPool::_::_::_m_arrayPool::_0_::_elem::_m_objectInformation::_4_::_m_perObjectType::_m_prob1RoadsideBarrierN = 0;
      @sysvar::XCP::RadarFC_Obj::_g_PL_AD_fw_Radar_1R1V_rpc_XilObjBypassingRunnable_XilObjBypassingRunnable_m_pad_radarObjPort_par_out_local::TChangeableMemPool::_::_::_m_arrayPool::_0_::_elem::_m_objectInformation::_4_::_m_perObjectType::_m_prob1StatUnknownN = 128;
      @sysvar::XCP::RadarFC_Obj::_g_PL_AD_fw_Radar_1R1V_rpc_XilObjBypassingRunnable_XilObjBypassingRunnable_m_pad_radarObjPort_par_out_local::TChangeableMemPool::_::_::_m_arrayPool::_0_::_elem::_m_objectInformation::_4_::_m_perObjectType::_m_prob1PassengerCarN = 0;
      @sysvar::XCP::RadarFC_Obj::_g_PL_AD_fw_Radar_1R1V_rpc_XilObjBypassingRunnable_XilObjBypassingRunnable_m_pad_radarObjPort_par_out_local::TChangeableMemPool::_::_::_m_arrayPool::_0_::_elem::_m_objectInformation::_4_::_m_perObjectType::_m_prob1TruckN = 0;
      @sysvar::XCP::RadarFC_Obj::_g_PL_AD_fw_Radar_1R1V_rpc_XilObjBypassingRunnable_XilObjBypassingRunnable_m_pad_radarObjPort_par_out_local::TChangeableMemPool::_::_::_m_arrayPool::_0_::_elem::_m_objectInformation::_4_::_m_perObjectType::_m_prob1FourWheelUnknownN = 128;
      @sysvar::XCP::RadarFC_Obj::_g_PL_AD_fw_Radar_1R1V_rpc_XilObjBypassingRunnable_XilObjBypassingRunnable_m_pad_radarObjPort_par_out_local::TChangeableMemPool::_::_::_m_arrayPool::_0_::_elem::_m_objectInformation::_4_::_m_dWidthN = 256;
        break;

      case 1: //"unknown"
      @sysvar::XCP::RadarFC_Obj::_g_PL_AD_fw_Radar_1R1V_rpc_XilObjBypassingRunnable_XilObjBypassingRunnable_m_pad_radarObjPort_par_out_local::TChangeableMemPool::_::_::_m_arrayPool::_0_::_elem::_m_objectInformation::_4_::_m_perObjectType::_m_prob1ObstacleN = 0;
      @sysvar::XCP::RadarFC_Obj::_g_PL_AD_fw_Radar_1R1V_rpc_XilObjBypassingRunnable_XilObjBypassingRunnable_m_pad_radarObjPort_par_out_local::TChangeableMemPool::_::_::_m_arrayPool::_0_::_elem::_m_objectInformation::_4_::_m_perObjectType::_m_prob1NonObstacleN = 0;
      @sysvar::XCP::RadarFC_Obj::_g_PL_AD_fw_Radar_1R1V_rpc_XilObjBypassingRunnable_XilObjBypassingRunnable_m_pad_radarObjPort_par_out_local::TChangeableMemPool::_::_::_m_arrayPool::_0_::_elem::_m_objectInformation::_4_::_m_perObjectType::_m_prob1UnknownN = 128;
      @sysvar::XCP::RadarFC_Obj::_g_PL_AD_fw_Radar_1R1V_rpc_XilObjBypassingRunnable_XilObjBypassingRunnable_m_pad_radarObjPort_par_out_local::TChangeableMemPool::_::_::_m_arrayPool::_0_::_elem::_m_objectInformation::_4_::_m_perObjectType::_m_prob1MobileN = 0;
      @sysvar::XCP::RadarFC_Obj::_g_PL_AD_fw_Radar_1R1V_rpc_XilObjBypassingRunnable_XilObjBypassingRunnable_m_pad_radarObjPort_par_out_local::TChangeableMemPool::_::_::_m_arrayPool::_0_::_elem::_m_objectInformation::_4_::_m_perObjectType::_m_prob1StationaryN = 0;
      @sysvar::XCP::RadarFC_Obj::_g_PL_AD_fw_Radar_1R1V_rpc_XilObjBypassingRunnable_XilObjBypassingRunnable_m_pad_radarObjPort_par_out_local::TChangeableMemPool::_::_::_m_arrayPool::_0_::_elem::_m_objectInformation::_4_::_m_perObjectType::_m_prob1ObstUnknownN = 128;
      @sysvar::XCP::RadarFC_Obj::_g_PL_AD_fw_Radar_1R1V_rpc_XilObjBypassingRunnable_XilObjBypassingRunnable_m_pad_radarObjPort_par_out_local::TChangeableMemPool::_::_::_m_arrayPool::_0_::_elem::_m_objectInformation::_4_::_m_perObjectType::_m_prob1FourPlusWheelerN = 0;
      @sysvar::XCP::RadarFC_Obj::_g_PL_AD_fw_Radar_1R1V_rpc_XilObjBypassingRunnable_XilObjBypassingRunnable_m_pad_radarObjPort_par_out_local::TChangeableMemPool::_::_::_m_arrayPool::_0_::_elem::_m_objectInformation::_4_::_m_perObjectType::_m_prob1TwoWheelerN = 0;
      @sysvar::XCP::RadarFC_Obj::_g_PL_AD_fw_Radar_1R1V_rpc_XilObjBypassingRunnable_XilObjBypassingRunnable_m_pad_radarObjPort_par_out_local::TChangeableMemPool::_::_::_m_arrayPool::_0_::_elem::_m_objectInformation::_4_::_m_perObjectType::_m_prob1PedestrianN = 0;
      @sysvar::XCP::RadarFC_Obj::_g_PL_AD_fw_Radar_1R1V_rpc_XilObjBypassingRunnable_XilObjBypassingRunnable_m_pad_radarObjPort_par_out_local::TChangeableMemPool::_::_::_m_arrayPool::_0_::_elem::_m_objectInformation::_4_::_m_perObjectType::_m_prob1MovUnknownN = 128;
      @sysvar::XCP::RadarFC_Obj::_g_PL_AD_fw_Radar_1R1V_rpc_XilObjBypassingRunnable_XilObjBypassingRunnable_m_pad_radarObjPort_par_out_local::TChangeableMemPool::_::_::_m_arrayPool::_0_::_elem::_m_objectInformation::_4_::_m_perObjectType::_m_prob1RoadsideBarrierN = 0;
      @sysvar::XCP::RadarFC_Obj::_g_PL_AD_fw_Radar_1R1V_rpc_XilObjBypassingRunnable_XilObjBypassingRunnable_m_pad_radarObjPort_par_out_local::TChangeableMemPool::_::_::_m_arrayPool::_0_::_elem::_m_objectInformation::_4_::_m_perObjectType::_m_prob1StatUnknownN = 128;
      @sysvar::XCP::RadarFC_Obj::_g_PL_AD_fw_Radar_1R1V_rpc_XilObjBypassingRunnable_XilObjBypassingRunnable_m_pad_radarObjPort_par_out_local::TChangeableMemPool::_::_::_m_arrayPool::_0_::_elem::_m_objectInformation::_4_::_m_perObjectType::_m_prob1PassengerCarN = 0;
      @sysvar::XCP::RadarFC_Obj::_g_PL_AD_fw_Radar_1R1V_rpc_XilObjBypassingRunnable_XilObjBypassingRunnable_m_pad_radarObjPort_par_out_local::TChangeableMemPool::_::_::_m_arrayPool::_0_::_elem::_m_objectInformation::_4_::_m_perObjectType::_m_prob1TruckN = 0;
      @sysvar::XCP::RadarFC_Obj::_g_PL_AD_fw_Radar_1R1V_rpc_XilObjBypassingRunnable_XilObjBypassingRunnable_m_pad_radarObjPort_par_out_local::TChangeableMemPool::_::_::_m_arrayPool::_0_::_elem::_m_objectInformation::_4_::_m_perObjectType::_m_prob1FourWheelUnknownN = 128;
      @sysvar::XCP::RadarFC_Obj::_g_PL_AD_fw_Radar_1R1V_rpc_XilObjBypassingRunnable_XilObjBypassingRunnable_m_pad_radarObjPort_par_out_local::TChangeableMemPool::_::_::_m_arrayPool::_0_::_elem::_m_objectInformation::_4_::_m_dWidthN = 256;
        break;

      case 2: //"RoadSideBarrier"
      @sysvar::XCP::RadarFC_Obj::_g_PL_AD_fw_Radar_1R1V_rpc_XilObjBypassingRunnable_XilObjBypassingRunnable_m_pad_radarObjPort_par_out_local::TChangeableMemPool::_::_::_m_arrayPool::_0_::_elem::_m_objectInformation::_4_::_m_perObjectType::_m_prob1ObstacleN = 128;
      @sysvar::XCP::RadarFC_Obj::_g_PL_AD_fw_Radar_1R1V_rpc_XilObjBypassingRunnable_XilObjBypassingRunnable_m_pad_radarObjPort_par_out_local::TChangeableMemPool::_::_::_m_arrayPool::_0_::_elem::_m_objectInformation::_4_::_m_perObjectType::_m_prob1NonObstacleN = 0;
      @sysvar::XCP::RadarFC_Obj::_g_PL_AD_fw_Radar_1R1V_rpc_XilObjBypassingRunnable_XilObjBypassingRunnable_m_pad_radarObjPort_par_out_local::TChangeableMemPool::_::_::_m_arrayPool::_0_::_elem::_m_objectInformation::_4_::_m_perObjectType::_m_prob1UnknownN = 0;
      @sysvar::XCP::RadarFC_Obj::_g_PL_AD_fw_Radar_1R1V_rpc_XilObjBypassingRunnable_XilObjBypassingRunnable_m_pad_radarObjPort_par_out_local::TChangeableMemPool::_::_::_m_arrayPool::_0_::_elem::_m_objectInformation::_4_::_m_perObjectType::_m_prob1MobileN = 0;
      @sysvar::XCP::RadarFC_Obj::_g_PL_AD_fw_Radar_1R1V_rpc_XilObjBypassingRunnable_XilObjBypassingRunnable_m_pad_radarObjPort_par_out_local::TChangeableMemPool::_::_::_m_arrayPool::_0_::_elem::_m_objectInformation::_4_::_m_perObjectType::_m_prob1StationaryN = 128;
      @sysvar::XCP::RadarFC_Obj::_g_PL_AD_fw_Radar_1R1V_rpc_XilObjBypassingRunnable_XilObjBypassingRunnable_m_pad_radarObjPort_par_out_local::TChangeableMemPool::_::_::_m_arrayPool::_0_::_elem::_m_objectInformation::_4_::_m_perObjectType::_m_prob1ObstUnknownN = 0;
      @sysvar::XCP::RadarFC_Obj::_g_PL_AD_fw_Radar_1R1V_rpc_XilObjBypassingRunnable_XilObjBypassingRunnable_m_pad_radarObjPort_par_out_local::TChangeableMemPool::_::_::_m_arrayPool::_0_::_elem::_m_objectInformation::_4_::_m_perObjectType::_m_prob1FourPlusWheelerN = 0;
      @sysvar::XCP::RadarFC_Obj::_g_PL_AD_fw_Radar_1R1V_rpc_XilObjBypassingRunnable_XilObjBypassingRunnable_m_pad_radarObjPort_par_out_local::TChangeableMemPool::_::_::_m_arrayPool::_0_::_elem::_m_objectInformation::_4_::_m_perObjectType::_m_prob1TwoWheelerN = 0;
      @sysvar::XCP::RadarFC_Obj::_g_PL_AD_fw_Radar_1R1V_rpc_XilObjBypassingRunnable_XilObjBypassingRunnable_m_pad_radarObjPort_par_out_local::TChangeableMemPool::_::_::_m_arrayPool::_0_::_elem::_m_objectInformation::_4_::_m_perObjectType::_m_prob1PedestrianN = 0;
      @sysvar::XCP::RadarFC_Obj::_g_PL_AD_fw_Radar_1R1V_rpc_XilObjBypassingRunnable_XilObjBypassingRunnable_m_pad_radarObjPort_par_out_local::TChangeableMemPool::_::_::_m_arrayPool::_0_::_elem::_m_objectInformation::_4_::_m_perObjectType::_m_prob1MovUnknownN = 128;
      @sysvar::XCP::RadarFC_Obj::_g_PL_AD_fw_Radar_1R1V_rpc_XilObjBypassingRunnable_XilObjBypassingRunnable_m_pad_radarObjPort_par_out_local::TChangeableMemPool::_::_::_m_arrayPool::_0_::_elem::_m_objectInformation::_4_::_m_perObjectType::_m_prob1RoadsideBarrierN = 128;
      @sysvar::XCP::RadarFC_Obj::_g_PL_AD_fw_Radar_1R1V_rpc_XilObjBypassingRunnable_XilObjBypassingRunnable_m_pad_radarObjPort_par_out_local::TChangeableMemPool::_::_::_m_arrayPool::_0_::_elem::_m_objectInformation::_4_::_m_perObjectType::_m_prob1StatUnknownN = 0;
      @sysvar::XCP::RadarFC_Obj::_g_PL_AD_fw_Radar_1R1V_rpc_XilObjBypassingRunnable_XilObjBypassingRunnable_m_pad_radarObjPort_par_out_local::TChangeableMemPool::_::_::_m_arrayPool::_0_::_elem::_m_objectInformation::_4_::_m_perObjectType::_m_prob1PassengerCarN = 0;
      @sysvar::XCP::RadarFC_Obj::_g_PL_AD_fw_Radar_1R1V_rpc_XilObjBypassingRunnable_XilObjBypassingRunnable_m_pad_radarObjPort_par_out_local::TChangeableMemPool::_::_::_m_arrayPool::_0_::_elem::_m_objectInformation::_4_::_m_perObjectType::_m_prob1TruckN = 0;
      @sysvar::XCP::RadarFC_Obj::_g_PL_AD_fw_Radar_1R1V_rpc_XilObjBypassingRunnable_XilObjBypassingRunnable_m_pad_radarObjPort_par_out_local::TChangeableMemPool::_::_::_m_arrayPool::_0_::_elem::_m_objectInformation::_4_::_m_perObjectType::_m_prob1FourWheelUnknownN = 128;
      @sysvar::XCP::RadarFC_Obj::_g_PL_AD_fw_Radar_1R1V_rpc_XilObjBypassingRunnable_XilObjBypassingRunnable_m_pad_radarObjPort_par_out_local::TChangeableMemPool::_::_::_m_arrayPool::_0_::_elem::_m_objectInformation::_4_::_m_dWidthN = 256;
        break;

      case 3: //"2Wheeler"
      @sysvar::XCP::RadarFC_Obj::_g_PL_AD_fw_Radar_1R1V_rpc_XilObjBypassingRunnable_XilObjBypassingRunnable_m_pad_radarObjPort_par_out_local::TChangeableMemPool::_::_::_m_arrayPool::_0_::_elem::_m_objectInformation::_4_::_m_perObjectType::_m_prob1ObstacleN = 128;
      @sysvar::XCP::RadarFC_Obj::_g_PL_AD_fw_Radar_1R1V_rpc_XilObjBypassingRunnable_XilObjBypassingRunnable_m_pad_radarObjPort_par_out_local::TChangeableMemPool::_::_::_m_arrayPool::_0_::_elem::_m_objectInformation::_4_::_m_perObjectType::_m_prob1NonObstacleN = 0;
      @sysvar::XCP::RadarFC_Obj::_g_PL_AD_fw_Radar_1R1V_rpc_XilObjBypassingRunnable_XilObjBypassingRunnable_m_pad_radarObjPort_par_out_local::TChangeableMemPool::_::_::_m_arrayPool::_0_::_elem::_m_objectInformation::_4_::_m_perObjectType::_m_prob1UnknownN = 0;
      @sysvar::XCP::RadarFC_Obj::_g_PL_AD_fw_Radar_1R1V_rpc_XilObjBypassingRunnable_XilObjBypassingRunnable_m_pad_radarObjPort_par_out_local::TChangeableMemPool::_::_::_m_arrayPool::_0_::_elem::_m_objectInformation::_4_::_m_perObjectType::_m_prob1MobileN = 128;
      @sysvar::XCP::RadarFC_Obj::_g_PL_AD_fw_Radar_1R1V_rpc_XilObjBypassingRunnable_XilObjBypassingRunnable_m_pad_radarObjPort_par_out_local::TChangeableMemPool::_::_::_m_arrayPool::_0_::_elem::_m_objectInformation::_4_::_m_perObjectType::_m_prob1StationaryN = 0;
      @sysvar::XCP::RadarFC_Obj::_g_PL_AD_fw_Radar_1R1V_rpc_XilObjBypassingRunnable_XilObjBypassingRunnable_m_pad_radarObjPort_par_out_local::TChangeableMemPool::_::_::_m_arrayPool::_0_::_elem::_m_objectInformation::_4_::_m_perObjectType::_m_prob1ObstUnknownN = 0;
      @sysvar::XCP::RadarFC_Obj::_g_PL_AD_fw_Radar_1R1V_rpc_XilObjBypassingRunnable_XilObjBypassingRunnable_m_pad_radarObjPort_par_out_local::TChangeableMemPool::_::_::_m_arrayPool::_0_::_elem::_m_objectInformation::_4_::_m_perObjectType::_m_prob1FourPlusWheelerN = 0;
      @sysvar::XCP::RadarFC_Obj::_g_PL_AD_fw_Radar_1R1V_rpc_XilObjBypassingRunnable_XilObjBypassingRunnable_m_pad_radarObjPort_par_out_local::TChangeableMemPool::_::_::_m_arrayPool::_0_::_elem::_m_objectInformation::_4_::_m_perObjectType::_m_prob1TwoWheelerN = 128;
      @sysvar::XCP::RadarFC_Obj::_g_PL_AD_fw_Radar_1R1V_rpc_XilObjBypassingRunnable_XilObjBypassingRunnable_m_pad_radarObjPort_par_out_local::TChangeableMemPool::_::_::_m_arrayPool::_0_::_elem::_m_objectInformation::_4_::_m_perObjectType::_m_prob1PedestrianN = 0;
      @sysvar::XCP::RadarFC_Obj::_g_PL_AD_fw_Radar_1R1V_rpc_XilObjBypassingRunnable_XilObjBypassingRunnable_m_pad_radarObjPort_par_out_local::TChangeableMemPool::_::_::_m_arrayPool::_0_::_elem::_m_objectInformation::_4_::_m_perObjectType::_m_prob1MovUnknownN = 0;
      @sysvar::XCP::RadarFC_Obj::_g_PL_AD_fw_Radar_1R1V_rpc_XilObjBypassingRunnable_XilObjBypassingRunnable_m_pad_radarObjPort_par_out_local::TChangeableMemPool::_::_::_m_arrayPool::_0_::_elem::_m_objectInformation::_4_::_m_perObjectType::_m_prob1RoadsideBarrierN = 0;
      @sysvar::XCP::RadarFC_Obj::_g_PL_AD_fw_Radar_1R1V_rpc_XilObjBypassingRunnable_XilObjBypassingRunnable_m_pad_radarObjPort_par_out_local::TChangeableMemPool::_::_::_m_arrayPool::_0_::_elem::_m_objectInformation::_4_::_m_perObjectType::_m_prob1StatUnknownN = 128;
      @sysvar::XCP::RadarFC_Obj::_g_PL_AD_fw_Radar_1R1V_rpc_XilObjBypassingRunnable_XilObjBypassingRunnable_m_pad_radarObjPort_par_out_local::TChangeableMemPool::_::_::_m_arrayPool::_0_::_elem::_m_objectInformation::_4_::_m_perObjectType::_m_prob1PassengerCarN = 0;
      @sysvar::XCP::RadarFC_Obj::_g_PL_AD_fw_Radar_1R1V_rpc_XilObjBypassingRunnable_XilObjBypassingRunnable_m_pad_radarObjPort_par_out_local::TChangeableMemPool::_::_::_m_arrayPool::_0_::_elem::_m_objectInformation::_4_::_m_perObjectType::_m_prob1TruckN = 0;
      @sysvar::XCP::RadarFC_Obj::_g_PL_AD_fw_Radar_1R1V_rpc_XilObjBypassingRunnable_XilObjBypassingRunnable_m_pad_radarObjPort_par_out_local::TChangeableMemPool::_::_::_m_arrayPool::_0_::_elem::_m_objectInformation::_4_::_m_perObjectType::_m_prob1FourWheelUnknownN = 128;
      @sysvar::XCP::RadarFC_Obj::_g_PL_AD_fw_Radar_1R1V_rpc_XilObjBypassingRunnable_XilObjBypassingRunnable_m_pad_radarObjPort_par_out_local::TChangeableMemPool::_::_::_m_arrayPool::_0_::_elem::_m_objectInformation::_4_::_m_dWidthN = 64;
        break;

      case 4: //"Pedestrian"
      @sysvar::XCP::RadarFC_Obj::_g_PL_AD_fw_Radar_1R1V_rpc_XilObjBypassingRunnable_XilObjBypassingRunnable_m_pad_radarObjPort_par_out_local::TChangeableMemPool::_::_::_m_arrayPool::_0_::_elem::_m_objectInformation::_4_::_m_perObjectType::_m_prob1ObstacleN = 128;
      @sysvar::XCP::RadarFC_Obj::_g_PL_AD_fw_Radar_1R1V_rpc_XilObjBypassingRunnable_XilObjBypassingRunnable_m_pad_radarObjPort_par_out_local::TChangeableMemPool::_::_::_m_arrayPool::_0_::_elem::_m_objectInformation::_4_::_m_perObjectType::_m_prob1NonObstacleN = 0;
      @sysvar::XCP::RadarFC_Obj::_g_PL_AD_fw_Radar_1R1V_rpc_XilObjBypassingRunnable_XilObjBypassingRunnable_m_pad_radarObjPort_par_out_local::TChangeableMemPool::_::_::_m_arrayPool::_0_::_elem::_m_objectInformation::_4_::_m_perObjectType::_m_prob1UnknownN = 0;
      @sysvar::XCP::RadarFC_Obj::_g_PL_AD_fw_Radar_1R1V_rpc_XilObjBypassingRunnable_XilObjBypassingRunnable_m_pad_radarObjPort_par_out_local::TChangeableMemPool::_::_::_m_arrayPool::_0_::_elem::_m_objectInformation::_4_::_m_perObjectType::_m_prob1MobileN = 128;
      @sysvar::XCP::RadarFC_Obj::_g_PL_AD_fw_Radar_1R1V_rpc_XilObjBypassingRunnable_XilObjBypassingRunnable_m_pad_radarObjPort_par_out_local::TChangeableMemPool::_::_::_m_arrayPool::_0_::_elem::_m_objectInformation::_4_::_m_perObjectType::_m_prob1StationaryN = 0;
      @sysvar::XCP::RadarFC_Obj::_g_PL_AD_fw_Radar_1R1V_rpc_XilObjBypassingRunnable_XilObjBypassingRunnable_m_pad_radarObjPort_par_out_local::TChangeableMemPool::_::_::_m_arrayPool::_0_::_elem::_m_objectInformation::_4_::_m_perObjectType::_m_prob1ObstUnknownN = 0;
      @sysvar::XCP::RadarFC_Obj::_g_PL_AD_fw_Radar_1R1V_rpc_XilObjBypassingRunnable_XilObjBypassingRunnable_m_pad_radarObjPort_par_out_local::TChangeableMemPool::_::_::_m_arrayPool::_0_::_elem::_m_objectInformation::_4_::_m_perObjectType::_m_prob1FourPlusWheelerN = 0;
      @sysvar::XCP::RadarFC_Obj::_g_PL_AD_fw_Radar_1R1V_rpc_XilObjBypassingRunnable_XilObjBypassingRunnable_m_pad_radarObjPort_par_out_local::TChangeableMemPool::_::_::_m_arrayPool::_0_::_elem::_m_objectInformation::_4_::_m_perObjectType::_m_prob1TwoWheelerN = 0;
      @sysvar::XCP::RadarFC_Obj::_g_PL_AD_fw_Radar_1R1V_rpc_XilObjBypassingRunnable_XilObjBypassingRunnable_m_pad_radarObjPort_par_out_local::TChangeableMemPool::_::_::_m_arrayPool::_0_::_elem::_m_objectInformation::_4_::_m_perObjectType::_m_prob1PedestrianN = 128;
      @sysvar::XCP::RadarFC_Obj::_g_PL_AD_fw_Radar_1R1V_rpc_XilObjBypassingRunnable_XilObjBypassingRunnable_m_pad_radarObjPort_par_out_local::TChangeableMemPool::_::_::_m_arrayPool::_0_::_elem::_m_objectInformation::_4_::_m_perObjectType::_m_prob1MovUnknownN = 0;
      @sysvar::XCP::RadarFC_Obj::_g_PL_AD_fw_Radar_1R1V_rpc_XilObjBypassingRunnable_XilObjBypassingRunnable_m_pad_radarObjPort_par_out_local::TChangeableMemPool::_::_::_m_arrayPool::_0_::_elem::_m_objectInformation::_4_::_m_perObjectType::_m_prob1RoadsideBarrierN = 0;
      @sysvar::XCP::RadarFC_Obj::_g_PL_AD_fw_Radar_1R1V_rpc_XilObjBypassingRunnable_XilObjBypassingRunnable_m_pad_radarObjPort_par_out_local::TChangeableMemPool::_::_::_m_arrayPool::_0_::_elem::_m_objectInformation::_4_::_m_perObjectType::_m_prob1StatUnknownN = 128;
      @sysvar::XCP::RadarFC_Obj::_g_PL_AD_fw_Radar_1R1V_rpc_XilObjBypassingRunnable_XilObjBypassingRunnable_m_pad_radarObjPort_par_out_local::TChangeableMemPool::_::_::_m_arrayPool::_0_::_elem::_m_objectInformation::_4_::_m_perObjectType::_m_prob1PassengerCarN = 0;
      @sysvar::XCP::RadarFC_Obj::_g_PL_AD_fw_Radar_1R1V_rpc_XilObjBypassingRunnable_XilObjBypassingRunnable_m_pad_radarObjPort_par_out_local::TChangeableMemPool::_::_::_m_arrayPool::_0_::_elem::_m_objectInformation::_4_::_m_perObjectType::_m_prob1TruckN = 0;
      @sysvar::XCP::RadarFC_Obj::_g_PL_AD_fw_Radar_1R1V_rpc_XilObjBypassingRunnable_XilObjBypassingRunnable_m_pad_radarObjPort_par_out_local::TChangeableMemPool::_::_::_m_arrayPool::_0_::_elem::_m_objectInformation::_4_::_m_perObjectType::_m_prob1FourWheelUnknownN = 128;
      @sysvar::XCP::RadarFC_Obj::_g_PL_AD_fw_Radar_1R1V_rpc_XilObjBypassingRunnable_XilObjBypassingRunnable_m_pad_radarObjPort_par_out_local::TChangeableMemPool::_::_::_m_arrayPool::_0_::_elem::_m_objectInformation::_4_::_m_dWidthN = 64;
        break;

      case 5: //"Truck"
      @sysvar::XCP::RadarFC_Obj::_g_PL_AD_fw_Radar_1R1V_rpc_XilObjBypassingRunnable_XilObjBypassingRunnable_m_pad_radarObjPort_par_out_local::TChangeableMemPool::_::_::_m_arrayPool::_0_::_elem::_m_objectInformation::_4_::_m_perObjectType::_m_prob1ObstacleN = 128;
      @sysvar::XCP::RadarFC_Obj::_g_PL_AD_fw_Radar_1R1V_rpc_XilObjBypassingRunnable_XilObjBypassingRunnable_m_pad_radarObjPort_par_out_local::TChangeableMemPool::_::_::_m_arrayPool::_0_::_elem::_m_objectInformation::_4_::_m_perObjectType::_m_prob1NonObstacleN = 0;
      @sysvar::XCP::RadarFC_Obj::_g_PL_AD_fw_Radar_1R1V_rpc_XilObjBypassingRunnable_XilObjBypassingRunnable_m_pad_radarObjPort_par_out_local::TChangeableMemPool::_::_::_m_arrayPool::_0_::_elem::_m_objectInformation::_4_::_m_perObjectType::_m_prob1UnknownN = 0;
      @sysvar::XCP::RadarFC_Obj::_g_PL_AD_fw_Radar_1R1V_rpc_XilObjBypassingRunnable_XilObjBypassingRunnable_m_pad_radarObjPort_par_out_local::TChangeableMemPool::_::_::_m_arrayPool::_0_::_elem::_m_objectInformation::_4_::_m_perObjectType::_m_prob1MobileN = 128;
      @sysvar::XCP::RadarFC_Obj::_g_PL_AD_fw_Radar_1R1V_rpc_XilObjBypassingRunnable_XilObjBypassingRunnable_m_pad_radarObjPort_par_out_local::TChangeableMemPool::_::_::_m_arrayPool::_0_::_elem::_m_objectInformation::_4_::_m_perObjectType::_m_prob1StationaryN = 0;
      @sysvar::XCP::RadarFC_Obj::_g_PL_AD_fw_Radar_1R1V_rpc_XilObjBypassingRunnable_XilObjBypassingRunnable_m_pad_radarObjPort_par_out_local::TChangeableMemPool::_::_::_m_arrayPool::_0_::_elem::_m_objectInformation::_4_::_m_perObjectType::_m_prob1ObstUnknownN = 0;
      @sysvar::XCP::RadarFC_Obj::_g_PL_AD_fw_Radar_1R1V_rpc_XilObjBypassingRunnable_XilObjBypassingRunnable_m_pad_radarObjPort_par_out_local::TChangeableMemPool::_::_::_m_arrayPool::_0_::_elem::_m_objectInformation::_4_::_m_perObjectType::_m_prob1FourPlusWheelerN = 128;
      @sysvar::XCP::RadarFC_Obj::_g_PL_AD_fw_Radar_1R1V_rpc_XilObjBypassingRunnable_XilObjBypassingRunnable_m_pad_radarObjPort_par_out_local::TChangeableMemPool::_::_::_m_arrayPool::_0_::_elem::_m_objectInformation::_4_::_m_perObjectType::_m_prob1TwoWheelerN = 0;
      @sysvar::XCP::RadarFC_Obj::_g_PL_AD_fw_Radar_1R1V_rpc_XilObjBypassingRunnable_XilObjBypassingRunnable_m_pad_radarObjPort_par_out_local::TChangeableMemPool::_::_::_m_arrayPool::_0_::_elem::_m_objectInformation::_4_::_m_perObjectType::_m_prob1PedestrianN = 0;
      @sysvar::XCP::RadarFC_Obj::_g_PL_AD_fw_Radar_1R1V_rpc_XilObjBypassingRunnable_XilObjBypassingRunnable_m_pad_radarObjPort_par_out_local::TChangeableMemPool::_::_::_m_arrayPool::_0_::_elem::_m_objectInformation::_4_::_m_perObjectType::_m_prob1MovUnknownN = 0;
      @sysvar::XCP::RadarFC_Obj::_g_PL_AD_fw_Radar_1R1V_rpc_XilObjBypassingRunnable_XilObjBypassingRunnable_m_pad_radarObjPort_par_out_local::TChangeableMemPool::_::_::_m_arrayPool::_0_::_elem::_m_objectInformation::_4_::_m_perObjectType::_m_prob1RoadsideBarrierN = 0;
      @sysvar::XCP::RadarFC_Obj::_g_PL_AD_fw_Radar_1R1V_rpc_XilObjBypassingRunnable_XilObjBypassingRunnable_m_pad_radarObjPort_par_out_local::TChangeableMemPool::_::_::_m_arrayPool::_0_::_elem::_m_objectInformation::_4_::_m_perObjectType::_m_prob1StatUnknownN = 128;
      @sysvar::XCP::RadarFC_Obj::_g_PL_AD_fw_Radar_1R1V_rpc_XilObjBypassingRunnable_XilObjBypassingRunnable_m_pad_radarObjPort_par_out_local::TChangeableMemPool::_::_::_m_arrayPool::_0_::_elem::_m_objectInformation::_4_::_m_perObjectType::_m_prob1PassengerCarN = 0;
      @sysvar::XCP::RadarFC_Obj::_g_PL_AD_fw_Radar_1R1V_rpc_XilObjBypassingRunnable_XilObjBypassingRunnable_m_pad_radarObjPort_par_out_local::TChangeableMemPool::_::_::_m_arrayPool::_0_::_elem::_m_objectInformation::_4_::_m_perObjectType::_m_prob1TruckN = 128;
      @sysvar::XCP::RadarFC_Obj::_g_PL_AD_fw_Radar_1R1V_rpc_XilObjBypassingRunnable_XilObjBypassingRunnable_m_pad_radarObjPort_par_out_local::TChangeableMemPool::_::_::_m_arrayPool::_0_::_elem::_m_objectInformation::_4_::_m_perObjectType::_m_prob1FourWheelUnknownN = 0;
      @sysvar::XCP::RadarFC_Obj::_g_PL_AD_fw_Radar_1R1V_rpc_XilObjBypassingRunnable_XilObjBypassingRunnable_m_pad_radarObjPort_par_out_local::TChangeableMemPool::_::_::_m_arrayPool::_0_::_elem::_m_objectInformation::_4_::_m_dWidthN = 256;
        break;

      case 6: //"PassengerCar"
      @sysvar::XCP::RadarFC_Obj::_g_PL_AD_fw_Radar_1R1V_rpc_XilObjBypassingRunnable_XilObjBypassingRunnable_m_pad_radarObjPort_par_out_local::TChangeableMemPool::_::_::_m_arrayPool::_0_::_elem::_m_objectInformation::_4_::_m_perObjectType::_m_prob1ObstacleN = 128;
      @sysvar::XCP::RadarFC_Obj::_g_PL_AD_fw_Radar_1R1V_rpc_XilObjBypassingRunnable_XilObjBypassingRunnable_m_pad_radarObjPort_par_out_local::TChangeableMemPool::_::_::_m_arrayPool::_0_::_elem::_m_objectInformation::_4_::_m_perObjectType::_m_prob1NonObstacleN = 0;
      @sysvar::XCP::RadarFC_Obj::_g_PL_AD_fw_Radar_1R1V_rpc_XilObjBypassingRunnable_XilObjBypassingRunnable_m_pad_radarObjPort_par_out_local::TChangeableMemPool::_::_::_m_arrayPool::_0_::_elem::_m_objectInformation::_4_::_m_perObjectType::_m_prob1UnknownN = 0;
      @sysvar::XCP::RadarFC_Obj::_g_PL_AD_fw_Radar_1R1V_rpc_XilObjBypassingRunnable_XilObjBypassingRunnable_m_pad_radarObjPort_par_out_local::TChangeableMemPool::_::_::_m_arrayPool::_0_::_elem::_m_objectInformation::_4_::_m_perObjectType::_m_prob1MobileN = 128;
      @sysvar::XCP::RadarFC_Obj::_g_PL_AD_fw_Radar_1R1V_rpc_XilObjBypassingRunnable_XilObjBypassingRunnable_m_pad_radarObjPort_par_out_local::TChangeableMemPool::_::_::_m_arrayPool::_0_::_elem::_m_objectInformation::_4_::_m_perObjectType::_m_prob1StationaryN = 0;
      @sysvar::XCP::RadarFC_Obj::_g_PL_AD_fw_Radar_1R1V_rpc_XilObjBypassingRunnable_XilObjBypassingRunnable_m_pad_radarObjPort_par_out_local::TChangeableMemPool::_::_::_m_arrayPool::_0_::_elem::_m_objectInformation::_4_::_m_perObjectType::_m_prob1ObstUnknownN = 0;
      @sysvar::XCP::RadarFC_Obj::_g_PL_AD_fw_Radar_1R1V_rpc_XilObjBypassingRunnable_XilObjBypassingRunnable_m_pad_radarObjPort_par_out_local::TChangeableMemPool::_::_::_m_arrayPool::_0_::_elem::_m_objectInformation::_4_::_m_perObjectType::_m_prob1FourPlusWheelerN = 128;
      @sysvar::XCP::RadarFC_Obj::_g_PL_AD_fw_Radar_1R1V_rpc_XilObjBypassingRunnable_XilObjBypassingRunnable_m_pad_radarObjPort_par_out_local::TChangeableMemPool::_::_::_m_arrayPool::_0_::_elem::_m_objectInformation::_4_::_m_perObjectType::_m_prob1TwoWheelerN = 0;
      @sysvar::XCP::RadarFC_Obj::_g_PL_AD_fw_Radar_1R1V_rpc_XilObjBypassingRunnable_XilObjBypassingRunnable_m_pad_radarObjPort_par_out_local::TChangeableMemPool::_::_::_m_arrayPool::_0_::_elem::_m_objectInformation::_4_::_m_perObjectType::_m_prob1PedestrianN = 0;
      @sysvar::XCP::RadarFC_Obj::_g_PL_AD_fw_Radar_1R1V_rpc_XilObjBypassingRunnable_XilObjBypassingRunnable_m_pad_radarObjPort_par_out_local::TChangeableMemPool::_::_::_m_arrayPool::_0_::_elem::_m_objectInformation::_4_::_m_perObjectType::_m_prob1MovUnknownN = 0;
      @sysvar::XCP::RadarFC_Obj::_g_PL_AD_fw_Radar_1R1V_rpc_XilObjBypassingRunnable_XilObjBypassingRunnable_m_pad_radarObjPort_par_out_local::TChangeableMemPool::_::_::_m_arrayPool::_0_::_elem::_m_objectInformation::_4_::_m_perObjectType::_m_prob1RoadsideBarrierN = 0;
      @sysvar::XCP::RadarFC_Obj::_g_PL_AD_fw_Radar_1R1V_rpc_XilObjBypassingRunnable_XilObjBypassingRunnable_m_pad_radarObjPort_par_out_local::TChangeableMemPool::_::_::_m_arrayPool::_0_::_elem::_m_objectInformation::_4_::_m_perObjectType::_m_prob1StatUnknownN = 128;
      @sysvar::XCP::RadarFC_Obj::_g_PL_AD_fw_Radar_1R1V_rpc_XilObjBypassingRunnable_XilObjBypassingRunnable_m_pad_radarObjPort_par_out_local::TChangeableMemPool::_::_::_m_arrayPool::_0_::_elem::_m_objectInformation::_4_::_m_perObjectType::_m_prob1PassengerCarN = 128;
      @sysvar::XCP::RadarFC_Obj::_g_PL_AD_fw_Radar_1R1V_rpc_XilObjBypassingRunnable_XilObjBypassingRunnable_m_pad_radarObjPort_par_out_local::TChangeableMemPool::_::_::_m_arrayPool::_0_::_elem::_m_objectInformation::_4_::_m_perObjectType::_m_prob1TruckN = 0;
      @sysvar::XCP::RadarFC_Obj::_g_PL_AD_fw_Radar_1R1V_rpc_XilObjBypassingRunnable_XilObjBypassingRunnable_m_pad_radarObjPort_par_out_local::TChangeableMemPool::_::_::_m_arrayPool::_0_::_elem::_m_objectInformation::_4_::_m_perObjectType::_m_prob1FourWheelUnknownN = 0;
      @sysvar::XCP::RadarFC_Obj::_g_PL_AD_fw_Radar_1R1V_rpc_XilObjBypassingRunnable_XilObjBypassingRunnable_m_pad_radarObjPort_par_out_local::TChangeableMemPool::_::_::_m_arrayPool::_0_::_elem::_m_objectInformation::_4_::_m_dWidthN = 256;
        break;
    }
    break;

    case 5: //"Object-5"
    //constant
  @sysvar::XCP::RadarFC_Obj::_g_PL_AD_fw_Radar_1R1V_rpc_XilObjBypassingRunnable_XilObjBypassingRunnable_m_pad_radarObjPort_par_out_local::TChangeableMemPool::_::_::_m_arrayPool::_0_::_elem::_m_objectInformation::_5_::_Valid_b = 1;
  @sysvar::XCP::RadarFC_Obj::_g_PL_AD_fw_Radar_1R1V_rpc_XilObjBypassingRunnable_XilObjBypassingRunnable_m_pad_radarObjPort_par_out_local::TChangeableMemPool::_::_::_m_arrayPool::_0_::_elem::_m_objectInformation::_5_::_m_HandleN = 1;
  @sysvar::XCP::RadarFC_Obj::_g_PL_AD_fw_Radar_1R1V_rpc_XilObjBypassingRunnable_XilObjBypassingRunnable_m_pad_radarObjPort_par_out_local::TChangeableMemPool::_::_::_m_arrayPool::_0_::_elem::_m_objectInformation::_5_::_m_alpPiVarYawAngleN = 0;
  @sysvar::XCP::RadarFC_Obj::_g_PL_AD_fw_Radar_1R1V_rpc_XilObjBypassingRunnable_XilObjBypassingRunnable_m_pad_radarObjPort_par_out_local::TChangeableMemPool::_::_::_m_arrayPool::_0_::_elem::_m_objectInformation::_5_::_m_alpPiYawAngleN = 0;
  @sysvar::XCP::RadarFC_Obj::_g_PL_AD_fw_Radar_1R1V_rpc_XilObjBypassingRunnable_XilObjBypassingRunnable_m_pad_radarObjPort_par_out_local::TChangeableMemPool::_::_::_m_arrayPool::_0_::_elem::_m_objectInformation::_5_::_m_varAxN = 0;
  @sysvar::XCP::RadarFC_Obj::_g_PL_AD_fw_Radar_1R1V_rpc_XilObjBypassingRunnable_XilObjBypassingRunnable_m_pad_radarObjPort_par_out_local::TChangeableMemPool::_::_::_m_arrayPool::_0_::_elem::_m_objectInformation::_5_::_m_varAyN = 0;
  @sysvar::XCP::RadarFC_Obj::_g_PL_AD_fw_Radar_1R1V_rpc_XilObjBypassingRunnable_XilObjBypassingRunnable_m_pad_radarObjPort_par_out_local::TChangeableMemPool::_::_::_m_arrayPool::_0_::_elem::_m_objectInformation::_5_::_m_varVxN = 0;
  @sysvar::XCP::RadarFC_Obj::_g_PL_AD_fw_Radar_1R1V_rpc_XilObjBypassingRunnable_XilObjBypassingRunnable_m_pad_radarObjPort_par_out_local::TChangeableMemPool::_::_::_m_arrayPool::_0_::_elem::_m_objectInformation::_5_::_m_varVyN = 0;
  @sysvar::XCP::RadarFC_Obj::_g_PL_AD_fw_Radar_1R1V_rpc_XilObjBypassingRunnable_XilObjBypassingRunnable_m_pad_radarObjPort_par_out_local::TChangeableMemPool::_::_::_m_arrayPool::_0_::_elem::_m_objectInformation::_5_::_m_varDxN = 0;
  @sysvar::XCP::RadarFC_Obj::_g_PL_AD_fw_Radar_1R1V_rpc_XilObjBypassingRunnable_XilObjBypassingRunnable_m_pad_radarObjPort_par_out_local::TChangeableMemPool::_::_::_m_arrayPool::_0_::_elem::_m_objectInformation::_5_::_m_varDyN = 0;
  @sysvar::XCP::RadarFC_Obj::_g_PL_AD_fw_Radar_1R1V_rpc_XilObjBypassingRunnable_XilObjBypassingRunnable_m_pad_radarObjPort_par_out_local::TChangeableMemPool::_::_::_m_arrayPool::_0_::_elem::_m_objectInformation::_5_::_m_dVarLengthN = 0;
  @sysvar::XCP::RadarFC_Obj::_g_PL_AD_fw_Radar_1R1V_rpc_XilObjBypassingRunnable_XilObjBypassingRunnable_m_pad_radarObjPort_par_out_local::TChangeableMemPool::_::_::_m_arrayPool::_0_::_elem::_m_objectInformation::_5_::_m_dVarWidthN = 0;
  @sysvar::XCP::RadarFC_Obj::_g_PL_AD_fw_Radar_1R1V_rpc_XilObjBypassingRunnable_XilObjBypassingRunnable_m_pad_radarObjPort_par_out_local::TChangeableMemPool::_::_::_m_arrayPool::_0_::_elem::_m_objectInformation::_5_::_m_wExistProbN = 64880;
  @sysvar::XCP::RadarFC_Obj::_g_PL_AD_fw_Radar_1R1V_rpc_XilObjBypassingRunnable_XilObjBypassingRunnable_m_pad_radarObjPort_par_out_local::TChangeableMemPool::_::_::_m_arrayPool::_0_::_elem::_m_objectInformation::_5_::_m_isObjectAsil = 1;
  @sysvar::XCP::RadarFC_Obj::_g_PL_AD_fw_Radar_1R1V_rpc_XilObjBypassingRunnable_XilObjBypassingRunnable_m_pad_radarObjPort_par_out_local::TChangeableMemPool::_::_::_m_arrayPool::_0_::_elem::_m_objectInformation::_5_::_m_dLengthN = 128;

    //target movement

  @sysvar::XCP::RadarFC_Obj::_g_PL_AD_fw_Radar_1R1V_rpc_XilObjBypassingRunnable_XilObjBypassingRunnable_m_pad_radarObjPort_par_out_local::TChangeableMemPool::_::_::_m_arrayPool::_0_::_elem::_m_objectInformation::_5_::_m_dxN = @target_radar_fc_sim::objdata.obj_distance_x[5] * 128;
  @sysvar::XCP::RadarFC_Obj::_g_PL_AD_fw_Radar_1R1V_rpc_XilObjBypassingRunnable_XilObjBypassingRunnable_m_pad_radarObjPort_par_out_local::TChangeableMemPool::_::_::_m_arrayPool::_0_::_elem::_m_objectInformation::_5_::_m_dyN = @target_radar_fc_sim::objdata.obj_distance_y[5] * 128;
  @sysvar::XCP::RadarFC_Obj::_g_PL_AD_fw_Radar_1R1V_rpc_XilObjBypassingRunnable_XilObjBypassingRunnable_m_pad_radarObjPort_par_out_local::TChangeableMemPool::_::_::_m_arrayPool::_0_::_elem::_m_objectInformation::_5_::_m_dzN = 0;
  @sysvar::XCP::RadarFC_Obj::_g_PL_AD_fw_Radar_1R1V_rpc_XilObjBypassingRunnable_XilObjBypassingRunnable_m_pad_radarObjPort_par_out_local::TChangeableMemPool::_::_::_m_arrayPool::_0_::_elem::_m_objectInformation::_5_::_m_vxN = @target_radar_fc_sim::objdata.obj_velocity_x[5] * 256;
  @sysvar::XCP::RadarFC_Obj::_g_PL_AD_fw_Radar_1R1V_rpc_XilObjBypassingRunnable_XilObjBypassingRunnable_m_pad_radarObjPort_par_out_local::TChangeableMemPool::_::_::_m_arrayPool::_0_::_elem::_m_objectInformation::_5_::_m_vyN = @target_radar_fc_sim::objdata.obj_velocity_y[5] * 256;
  @sysvar::XCP::RadarFC_Obj::_g_PL_AD_fw_Radar_1R1V_rpc_XilObjBypassingRunnable_XilObjBypassingRunnable_m_pad_radarObjPort_par_out_local::TChangeableMemPool::_::_::_m_arrayPool::_0_::_elem::_m_objectInformation::_5_::_m_axN = 0;
  @sysvar::XCP::RadarFC_Obj::_g_PL_AD_fw_Radar_1R1V_rpc_XilObjBypassingRunnable_XilObjBypassingRunnable_m_pad_radarObjPort_par_out_local::TChangeableMemPool::_::_::_m_arrayPool::_0_::_elem::_m_objectInformation::_5_::_m_ayN = 0;

    //target object moving or not
    if (abs(@target_radar_fc_sim::objdata.obj_velocity_x[5]) != 0)
    {
    @sysvar::XCP::RadarFC_Obj::_g_PL_AD_fw_Radar_1R1V_rpc_XilObjBypassingRunnable_XilObjBypassingRunnable_m_pad_radarObjPort_par_out_local::TChangeableMemPool::_::_::_m_arrayPool::_0_::_elem::_m_objectInformation::_5_::_m_prob1HasBeenObservedMovingN = 126;
    @sysvar::XCP::RadarFC_Obj::_g_PL_AD_fw_Radar_1R1V_rpc_XilObjBypassingRunnable_XilObjBypassingRunnable_m_pad_radarObjPort_par_out_local::TChangeableMemPool::_::_::_m_arrayPool::_0_::_elem::_m_objectInformation::_5_::_m_prob1MovingN = 126;
    }
    else
    {
    @sysvar::XCP::RadarFC_Obj::_g_PL_AD_fw_Radar_1R1V_rpc_XilObjBypassingRunnable_XilObjBypassingRunnable_m_pad_radarObjPort_par_out_local::TChangeableMemPool::_::_::_m_arrayPool::_0_::_elem::_m_objectInformation::_5_::_m_prob1HasBeenObservedMovingN = 0;
    @sysvar::XCP::RadarFC_Obj::_g_PL_AD_fw_Radar_1R1V_rpc_XilObjBypassingRunnable_XilObjBypassingRunnable_m_pad_radarObjPort_par_out_local::TChangeableMemPool::_::_::_m_arrayPool::_0_::_elem::_m_objectInformation::_5_::_m_prob1MovingN = 0;
    }

      //object classification
    switch (@target_radar_fc_sim::objdata.obj_type[5])
    {
      case 0: //"Non-Obstacle"
      @sysvar::XCP::RadarFC_Obj::_g_PL_AD_fw_Radar_1R1V_rpc_XilObjBypassingRunnable_XilObjBypassingRunnable_m_pad_radarObjPort_par_out_local::TChangeableMemPool::_::_::_m_arrayPool::_0_::_elem::_m_objectInformation::_5_::_m_perObjectType::_m_prob1ObstacleN = 0;
      @sysvar::XCP::RadarFC_Obj::_g_PL_AD_fw_Radar_1R1V_rpc_XilObjBypassingRunnable_XilObjBypassingRunnable_m_pad_radarObjPort_par_out_local::TChangeableMemPool::_::_::_m_arrayPool::_0_::_elem::_m_objectInformation::_5_::_m_perObjectType::_m_prob1NonObstacleN = 128;
      @sysvar::XCP::RadarFC_Obj::_g_PL_AD_fw_Radar_1R1V_rpc_XilObjBypassingRunnable_XilObjBypassingRunnable_m_pad_radarObjPort_par_out_local::TChangeableMemPool::_::_::_m_arrayPool::_0_::_elem::_m_objectInformation::_5_::_m_perObjectType::_m_prob1UnknownN = 0;
      @sysvar::XCP::RadarFC_Obj::_g_PL_AD_fw_Radar_1R1V_rpc_XilObjBypassingRunnable_XilObjBypassingRunnable_m_pad_radarObjPort_par_out_local::TChangeableMemPool::_::_::_m_arrayPool::_0_::_elem::_m_objectInformation::_5_::_m_perObjectType::_m_prob1MobileN = 0;
      @sysvar::XCP::RadarFC_Obj::_g_PL_AD_fw_Radar_1R1V_rpc_XilObjBypassingRunnable_XilObjBypassingRunnable_m_pad_radarObjPort_par_out_local::TChangeableMemPool::_::_::_m_arrayPool::_0_::_elem::_m_objectInformation::_5_::_m_perObjectType::_m_prob1StationaryN = 0;
      @sysvar::XCP::RadarFC_Obj::_g_PL_AD_fw_Radar_1R1V_rpc_XilObjBypassingRunnable_XilObjBypassingRunnable_m_pad_radarObjPort_par_out_local::TChangeableMemPool::_::_::_m_arrayPool::_0_::_elem::_m_objectInformation::_5_::_m_perObjectType::_m_prob1ObstUnknownN = 128;
      @sysvar::XCP::RadarFC_Obj::_g_PL_AD_fw_Radar_1R1V_rpc_XilObjBypassingRunnable_XilObjBypassingRunnable_m_pad_radarObjPort_par_out_local::TChangeableMemPool::_::_::_m_arrayPool::_0_::_elem::_m_objectInformation::_5_::_m_perObjectType::_m_prob1FourPlusWheelerN = 0;
      @sysvar::XCP::RadarFC_Obj::_g_PL_AD_fw_Radar_1R1V_rpc_XilObjBypassingRunnable_XilObjBypassingRunnable_m_pad_radarObjPort_par_out_local::TChangeableMemPool::_::_::_m_arrayPool::_0_::_elem::_m_objectInformation::_5_::_m_perObjectType::_m_prob1TwoWheelerN = 0;
      @sysvar::XCP::RadarFC_Obj::_g_PL_AD_fw_Radar_1R1V_rpc_XilObjBypassingRunnable_XilObjBypassingRunnable_m_pad_radarObjPort_par_out_local::TChangeableMemPool::_::_::_m_arrayPool::_0_::_elem::_m_objectInformation::_5_::_m_perObjectType::_m_prob1PedestrianN = 0;
      @sysvar::XCP::RadarFC_Obj::_g_PL_AD_fw_Radar_1R1V_rpc_XilObjBypassingRunnable_XilObjBypassingRunnable_m_pad_radarObjPort_par_out_local::TChangeableMemPool::_::_::_m_arrayPool::_0_::_elem::_m_objectInformation::_5_::_m_perObjectType::_m_prob1MovUnknownN = 128;
      @sysvar::XCP::RadarFC_Obj::_g_PL_AD_fw_Radar_1R1V_rpc_XilObjBypassingRunnable_XilObjBypassingRunnable_m_pad_radarObjPort_par_out_local::TChangeableMemPool::_::_::_m_arrayPool::_0_::_elem::_m_objectInformation::_5_::_m_perObjectType::_m_prob1RoadsideBarrierN = 0;
      @sysvar::XCP::RadarFC_Obj::_g_PL_AD_fw_Radar_1R1V_rpc_XilObjBypassingRunnable_XilObjBypassingRunnable_m_pad_radarObjPort_par_out_local::TChangeableMemPool::_::_::_m_arrayPool::_0_::_elem::_m_objectInformation::_5_::_m_perObjectType::_m_prob1StatUnknownN = 128;
      @sysvar::XCP::RadarFC_Obj::_g_PL_AD_fw_Radar_1R1V_rpc_XilObjBypassingRunnable_XilObjBypassingRunnable_m_pad_radarObjPort_par_out_local::TChangeableMemPool::_::_::_m_arrayPool::_0_::_elem::_m_objectInformation::_5_::_m_perObjectType::_m_prob1PassengerCarN = 0;
      @sysvar::XCP::RadarFC_Obj::_g_PL_AD_fw_Radar_1R1V_rpc_XilObjBypassingRunnable_XilObjBypassingRunnable_m_pad_radarObjPort_par_out_local::TChangeableMemPool::_::_::_m_arrayPool::_0_::_elem::_m_objectInformation::_5_::_m_perObjectType::_m_prob1TruckN = 0;
      @sysvar::XCP::RadarFC_Obj::_g_PL_AD_fw_Radar_1R1V_rpc_XilObjBypassingRunnable_XilObjBypassingRunnable_m_pad_radarObjPort_par_out_local::TChangeableMemPool::_::_::_m_arrayPool::_0_::_elem::_m_objectInformation::_5_::_m_perObjectType::_m_prob1FourWheelUnknownN = 128;
      @sysvar::XCP::RadarFC_Obj::_g_PL_AD_fw_Radar_1R1V_rpc_XilObjBypassingRunnable_XilObjBypassingRunnable_m_pad_radarObjPort_par_out_local::TChangeableMemPool::_::_::_m_arrayPool::_0_::_elem::_m_objectInformation::_5_::_m_dWidthN = 256;
        break;

      case 1: //"unknown"
      @sysvar::XCP::RadarFC_Obj::_g_PL_AD_fw_Radar_1R1V_rpc_XilObjBypassingRunnable_XilObjBypassingRunnable_m_pad_radarObjPort_par_out_local::TChangeableMemPool::_::_::_m_arrayPool::_0_::_elem::_m_objectInformation::_5_::_m_perObjectType::_m_prob1ObstacleN = 0;
      @sysvar::XCP::RadarFC_Obj::_g_PL_AD_fw_Radar_1R1V_rpc_XilObjBypassingRunnable_XilObjBypassingRunnable_m_pad_radarObjPort_par_out_local::TChangeableMemPool::_::_::_m_arrayPool::_0_::_elem::_m_objectInformation::_5_::_m_perObjectType::_m_prob1NonObstacleN = 0;
      @sysvar::XCP::RadarFC_Obj::_g_PL_AD_fw_Radar_1R1V_rpc_XilObjBypassingRunnable_XilObjBypassingRunnable_m_pad_radarObjPort_par_out_local::TChangeableMemPool::_::_::_m_arrayPool::_0_::_elem::_m_objectInformation::_5_::_m_perObjectType::_m_prob1UnknownN = 128;
      @sysvar::XCP::RadarFC_Obj::_g_PL_AD_fw_Radar_1R1V_rpc_XilObjBypassingRunnable_XilObjBypassingRunnable_m_pad_radarObjPort_par_out_local::TChangeableMemPool::_::_::_m_arrayPool::_0_::_elem::_m_objectInformation::_5_::_m_perObjectType::_m_prob1MobileN = 0;
      @sysvar::XCP::RadarFC_Obj::_g_PL_AD_fw_Radar_1R1V_rpc_XilObjBypassingRunnable_XilObjBypassingRunnable_m_pad_radarObjPort_par_out_local::TChangeableMemPool::_::_::_m_arrayPool::_0_::_elem::_m_objectInformation::_5_::_m_perObjectType::_m_prob1StationaryN = 0;
      @sysvar::XCP::RadarFC_Obj::_g_PL_AD_fw_Radar_1R1V_rpc_XilObjBypassingRunnable_XilObjBypassingRunnable_m_pad_radarObjPort_par_out_local::TChangeableMemPool::_::_::_m_arrayPool::_0_::_elem::_m_objectInformation::_5_::_m_perObjectType::_m_prob1ObstUnknownN = 128;
      @sysvar::XCP::RadarFC_Obj::_g_PL_AD_fw_Radar_1R1V_rpc_XilObjBypassingRunnable_XilObjBypassingRunnable_m_pad_radarObjPort_par_out_local::TChangeableMemPool::_::_::_m_arrayPool::_0_::_elem::_m_objectInformation::_5_::_m_perObjectType::_m_prob1FourPlusWheelerN = 0;
      @sysvar::XCP::RadarFC_Obj::_g_PL_AD_fw_Radar_1R1V_rpc_XilObjBypassingRunnable_XilObjBypassingRunnable_m_pad_radarObjPort_par_out_local::TChangeableMemPool::_::_::_m_arrayPool::_0_::_elem::_m_objectInformation::_5_::_m_perObjectType::_m_prob1TwoWheelerN = 0;
      @sysvar::XCP::RadarFC_Obj::_g_PL_AD_fw_Radar_1R1V_rpc_XilObjBypassingRunnable_XilObjBypassingRunnable_m_pad_radarObjPort_par_out_local::TChangeableMemPool::_::_::_m_arrayPool::_0_::_elem::_m_objectInformation::_5_::_m_perObjectType::_m_prob1PedestrianN = 0;
      @sysvar::XCP::RadarFC_Obj::_g_PL_AD_fw_Radar_1R1V_rpc_XilObjBypassingRunnable_XilObjBypassingRunnable_m_pad_radarObjPort_par_out_local::TChangeableMemPool::_::_::_m_arrayPool::_0_::_elem::_m_objectInformation::_5_::_m_perObjectType::_m_prob1MovUnknownN = 128;
      @sysvar::XCP::RadarFC_Obj::_g_PL_AD_fw_Radar_1R1V_rpc_XilObjBypassingRunnable_XilObjBypassingRunnable_m_pad_radarObjPort_par_out_local::TChangeableMemPool::_::_::_m_arrayPool::_0_::_elem::_m_objectInformation::_5_::_m_perObjectType::_m_prob1RoadsideBarrierN = 0;
      @sysvar::XCP::RadarFC_Obj::_g_PL_AD_fw_Radar_1R1V_rpc_XilObjBypassingRunnable_XilObjBypassingRunnable_m_pad_radarObjPort_par_out_local::TChangeableMemPool::_::_::_m_arrayPool::_0_::_elem::_m_objectInformation::_5_::_m_perObjectType::_m_prob1StatUnknownN = 128;
      @sysvar::XCP::RadarFC_Obj::_g_PL_AD_fw_Radar_1R1V_rpc_XilObjBypassingRunnable_XilObjBypassingRunnable_m_pad_radarObjPort_par_out_local::TChangeableMemPool::_::_::_m_arrayPool::_0_::_elem::_m_objectInformation::_5_::_m_perObjectType::_m_prob1PassengerCarN = 0;
      @sysvar::XCP::RadarFC_Obj::_g_PL_AD_fw_Radar_1R1V_rpc_XilObjBypassingRunnable_XilObjBypassingRunnable_m_pad_radarObjPort_par_out_local::TChangeableMemPool::_::_::_m_arrayPool::_0_::_elem::_m_objectInformation::_5_::_m_perObjectType::_m_prob1TruckN = 0;
      @sysvar::XCP::RadarFC_Obj::_g_PL_AD_fw_Radar_1R1V_rpc_XilObjBypassingRunnable_XilObjBypassingRunnable_m_pad_radarObjPort_par_out_local::TChangeableMemPool::_::_::_m_arrayPool::_0_::_elem::_m_objectInformation::_5_::_m_perObjectType::_m_prob1FourWheelUnknownN = 128;
      @sysvar::XCP::RadarFC_Obj::_g_PL_AD_fw_Radar_1R1V_rpc_XilObjBypassingRunnable_XilObjBypassingRunnable_m_pad_radarObjPort_par_out_local::TChangeableMemPool::_::_::_m_arrayPool::_0_::_elem::_m_objectInformation::_5_::_m_dWidthN = 256;
        break;

      case 2: //"RoadSideBarrier"
      @sysvar::XCP::RadarFC_Obj::_g_PL_AD_fw_Radar_1R1V_rpc_XilObjBypassingRunnable_XilObjBypassingRunnable_m_pad_radarObjPort_par_out_local::TChangeableMemPool::_::_::_m_arrayPool::_0_::_elem::_m_objectInformation::_5_::_m_perObjectType::_m_prob1ObstacleN = 128;
      @sysvar::XCP::RadarFC_Obj::_g_PL_AD_fw_Radar_1R1V_rpc_XilObjBypassingRunnable_XilObjBypassingRunnable_m_pad_radarObjPort_par_out_local::TChangeableMemPool::_::_::_m_arrayPool::_0_::_elem::_m_objectInformation::_5_::_m_perObjectType::_m_prob1NonObstacleN = 0;
      @sysvar::XCP::RadarFC_Obj::_g_PL_AD_fw_Radar_1R1V_rpc_XilObjBypassingRunnable_XilObjBypassingRunnable_m_pad_radarObjPort_par_out_local::TChangeableMemPool::_::_::_m_arrayPool::_0_::_elem::_m_objectInformation::_5_::_m_perObjectType::_m_prob1UnknownN = 0;
      @sysvar::XCP::RadarFC_Obj::_g_PL_AD_fw_Radar_1R1V_rpc_XilObjBypassingRunnable_XilObjBypassingRunnable_m_pad_radarObjPort_par_out_local::TChangeableMemPool::_::_::_m_arrayPool::_0_::_elem::_m_objectInformation::_5_::_m_perObjectType::_m_prob1MobileN = 0;
      @sysvar::XCP::RadarFC_Obj::_g_PL_AD_fw_Radar_1R1V_rpc_XilObjBypassingRunnable_XilObjBypassingRunnable_m_pad_radarObjPort_par_out_local::TChangeableMemPool::_::_::_m_arrayPool::_0_::_elem::_m_objectInformation::_5_::_m_perObjectType::_m_prob1StationaryN = 128;
      @sysvar::XCP::RadarFC_Obj::_g_PL_AD_fw_Radar_1R1V_rpc_XilObjBypassingRunnable_XilObjBypassingRunnable_m_pad_radarObjPort_par_out_local::TChangeableMemPool::_::_::_m_arrayPool::_0_::_elem::_m_objectInformation::_5_::_m_perObjectType::_m_prob1ObstUnknownN = 0;
      @sysvar::XCP::RadarFC_Obj::_g_PL_AD_fw_Radar_1R1V_rpc_XilObjBypassingRunnable_XilObjBypassingRunnable_m_pad_radarObjPort_par_out_local::TChangeableMemPool::_::_::_m_arrayPool::_0_::_elem::_m_objectInformation::_5_::_m_perObjectType::_m_prob1FourPlusWheelerN = 0;
      @sysvar::XCP::RadarFC_Obj::_g_PL_AD_fw_Radar_1R1V_rpc_XilObjBypassingRunnable_XilObjBypassingRunnable_m_pad_radarObjPort_par_out_local::TChangeableMemPool::_::_::_m_arrayPool::_0_::_elem::_m_objectInformation::_5_::_m_perObjectType::_m_prob1TwoWheelerN = 0;
      @sysvar::XCP::RadarFC_Obj::_g_PL_AD_fw_Radar_1R1V_rpc_XilObjBypassingRunnable_XilObjBypassingRunnable_m_pad_radarObjPort_par_out_local::TChangeableMemPool::_::_::_m_arrayPool::_0_::_elem::_m_objectInformation::_5_::_m_perObjectType::_m_prob1PedestrianN = 0;
      @sysvar::XCP::RadarFC_Obj::_g_PL_AD_fw_Radar_1R1V_rpc_XilObjBypassingRunnable_XilObjBypassingRunnable_m_pad_radarObjPort_par_out_local::TChangeableMemPool::_::_::_m_arrayPool::_0_::_elem::_m_objectInformation::_5_::_m_perObjectType::_m_prob1MovUnknownN = 128;
      @sysvar::XCP::RadarFC_Obj::_g_PL_AD_fw_Radar_1R1V_rpc_XilObjBypassingRunnable_XilObjBypassingRunnable_m_pad_radarObjPort_par_out_local::TChangeableMemPool::_::_::_m_arrayPool::_0_::_elem::_m_objectInformation::_5_::_m_perObjectType::_m_prob1RoadsideBarrierN = 128;
      @sysvar::XCP::RadarFC_Obj::_g_PL_AD_fw_Radar_1R1V_rpc_XilObjBypassingRunnable_XilObjBypassingRunnable_m_pad_radarObjPort_par_out_local::TChangeableMemPool::_::_::_m_arrayPool::_0_::_elem::_m_objectInformation::_5_::_m_perObjectType::_m_prob1StatUnknownN = 0;
      @sysvar::XCP::RadarFC_Obj::_g_PL_AD_fw_Radar_1R1V_rpc_XilObjBypassingRunnable_XilObjBypassingRunnable_m_pad_radarObjPort_par_out_local::TChangeableMemPool::_::_::_m_arrayPool::_0_::_elem::_m_objectInformation::_5_::_m_perObjectType::_m_prob1PassengerCarN = 0;
      @sysvar::XCP::RadarFC_Obj::_g_PL_AD_fw_Radar_1R1V_rpc_XilObjBypassingRunnable_XilObjBypassingRunnable_m_pad_radarObjPort_par_out_local::TChangeableMemPool::_::_::_m_arrayPool::_0_::_elem::_m_objectInformation::_5_::_m_perObjectType::_m_prob1TruckN = 0;
      @sysvar::XCP::RadarFC_Obj::_g_PL_AD_fw_Radar_1R1V_rpc_XilObjBypassingRunnable_XilObjBypassingRunnable_m_pad_radarObjPort_par_out_local::TChangeableMemPool::_::_::_m_arrayPool::_0_::_elem::_m_objectInformation::_5_::_m_perObjectType::_m_prob1FourWheelUnknownN = 128;
      @sysvar::XCP::RadarFC_Obj::_g_PL_AD_fw_Radar_1R1V_rpc_XilObjBypassingRunnable_XilObjBypassingRunnable_m_pad_radarObjPort_par_out_local::TChangeableMemPool::_::_::_m_arrayPool::_0_::_elem::_m_objectInformation::_5_::_m_dWidthN = 256;
        break;

      case 3: //"2Wheeler"
      @sysvar::XCP::RadarFC_Obj::_g_PL_AD_fw_Radar_1R1V_rpc_XilObjBypassingRunnable_XilObjBypassingRunnable_m_pad_radarObjPort_par_out_local::TChangeableMemPool::_::_::_m_arrayPool::_0_::_elem::_m_objectInformation::_5_::_m_perObjectType::_m_prob1ObstacleN = 128;
      @sysvar::XCP::RadarFC_Obj::_g_PL_AD_fw_Radar_1R1V_rpc_XilObjBypassingRunnable_XilObjBypassingRunnable_m_pad_radarObjPort_par_out_local::TChangeableMemPool::_::_::_m_arrayPool::_0_::_elem::_m_objectInformation::_5_::_m_perObjectType::_m_prob1NonObstacleN = 0;
      @sysvar::XCP::RadarFC_Obj::_g_PL_AD_fw_Radar_1R1V_rpc_XilObjBypassingRunnable_XilObjBypassingRunnable_m_pad_radarObjPort_par_out_local::TChangeableMemPool::_::_::_m_arrayPool::_0_::_elem::_m_objectInformation::_5_::_m_perObjectType::_m_prob1UnknownN = 0;
      @sysvar::XCP::RadarFC_Obj::_g_PL_AD_fw_Radar_1R1V_rpc_XilObjBypassingRunnable_XilObjBypassingRunnable_m_pad_radarObjPort_par_out_local::TChangeableMemPool::_::_::_m_arrayPool::_0_::_elem::_m_objectInformation::_5_::_m_perObjectType::_m_prob1MobileN = 128;
      @sysvar::XCP::RadarFC_Obj::_g_PL_AD_fw_Radar_1R1V_rpc_XilObjBypassingRunnable_XilObjBypassingRunnable_m_pad_radarObjPort_par_out_local::TChangeableMemPool::_::_::_m_arrayPool::_0_::_elem::_m_objectInformation::_5_::_m_perObjectType::_m_prob1StationaryN = 0;
      @sysvar::XCP::RadarFC_Obj::_g_PL_AD_fw_Radar_1R1V_rpc_XilObjBypassingRunnable_XilObjBypassingRunnable_m_pad_radarObjPort_par_out_local::TChangeableMemPool::_::_::_m_arrayPool::_0_::_elem::_m_objectInformation::_5_::_m_perObjectType::_m_prob1ObstUnknownN = 0;
      @sysvar::XCP::RadarFC_Obj::_g_PL_AD_fw_Radar_1R1V_rpc_XilObjBypassingRunnable_XilObjBypassingRunnable_m_pad_radarObjPort_par_out_local::TChangeableMemPool::_::_::_m_arrayPool::_0_::_elem::_m_objectInformation::_5_::_m_perObjectType::_m_prob1FourPlusWheelerN = 0;
      @sysvar::XCP::RadarFC_Obj::_g_PL_AD_fw_Radar_1R1V_rpc_XilObjBypassingRunnable_XilObjBypassingRunnable_m_pad_radarObjPort_par_out_local::TChangeableMemPool::_::_::_m_arrayPool::_0_::_elem::_m_objectInformation::_5_::_m_perObjectType::_m_prob1TwoWheelerN = 128;
      @sysvar::XCP::RadarFC_Obj::_g_PL_AD_fw_Radar_1R1V_rpc_XilObjBypassingRunnable_XilObjBypassingRunnable_m_pad_radarObjPort_par_out_local::TChangeableMemPool::_::_::_m_arrayPool::_0_::_elem::_m_objectInformation::_5_::_m_perObjectType::_m_prob1PedestrianN = 0;
      @sysvar::XCP::RadarFC_Obj::_g_PL_AD_fw_Radar_1R1V_rpc_XilObjBypassingRunnable_XilObjBypassingRunnable_m_pad_radarObjPort_par_out_local::TChangeableMemPool::_::_::_m_arrayPool::_0_::_elem::_m_objectInformation::_5_::_m_perObjectType::_m_prob1MovUnknownN = 0;
      @sysvar::XCP::RadarFC_Obj::_g_PL_AD_fw_Radar_1R1V_rpc_XilObjBypassingRunnable_XilObjBypassingRunnable_m_pad_radarObjPort_par_out_local::TChangeableMemPool::_::_::_m_arrayPool::_0_::_elem::_m_objectInformation::_5_::_m_perObjectType::_m_prob1RoadsideBarrierN = 0;
      @sysvar::XCP::RadarFC_Obj::_g_PL_AD_fw_Radar_1R1V_rpc_XilObjBypassingRunnable_XilObjBypassingRunnable_m_pad_radarObjPort_par_out_local::TChangeableMemPool::_::_::_m_arrayPool::_0_::_elem::_m_objectInformation::_5_::_m_perObjectType::_m_prob1StatUnknownN = 128;
      @sysvar::XCP::RadarFC_Obj::_g_PL_AD_fw_Radar_1R1V_rpc_XilObjBypassingRunnable_XilObjBypassingRunnable_m_pad_radarObjPort_par_out_local::TChangeableMemPool::_::_::_m_arrayPool::_0_::_elem::_m_objectInformation::_5_::_m_perObjectType::_m_prob1PassengerCarN = 0;
      @sysvar::XCP::RadarFC_Obj::_g_PL_AD_fw_Radar_1R1V_rpc_XilObjBypassingRunnable_XilObjBypassingRunnable_m_pad_radarObjPort_par_out_local::TChangeableMemPool::_::_::_m_arrayPool::_0_::_elem::_m_objectInformation::_5_::_m_perObjectType::_m_prob1TruckN = 0;
      @sysvar::XCP::RadarFC_Obj::_g_PL_AD_fw_Radar_1R1V_rpc_XilObjBypassingRunnable_XilObjBypassingRunnable_m_pad_radarObjPort_par_out_local::TChangeableMemPool::_::_::_m_arrayPool::_0_::_elem::_m_objectInformation::_5_::_m_perObjectType::_m_prob1FourWheelUnknownN = 128;
      @sysvar::XCP::RadarFC_Obj::_g_PL_AD_fw_Radar_1R1V_rpc_XilObjBypassingRunnable_XilObjBypassingRunnable_m_pad_radarObjPort_par_out_local::TChangeableMemPool::_::_::_m_arrayPool::_0_::_elem::_m_objectInformation::_5_::_m_dWidthN = 64;
        break;

      case 4: //"Pedestrian"
      @sysvar::XCP::RadarFC_Obj::_g_PL_AD_fw_Radar_1R1V_rpc_XilObjBypassingRunnable_XilObjBypassingRunnable_m_pad_radarObjPort_par_out_local::TChangeableMemPool::_::_::_m_arrayPool::_0_::_elem::_m_objectInformation::_5_::_m_perObjectType::_m_prob1ObstacleN = 128;
      @sysvar::XCP::RadarFC_Obj::_g_PL_AD_fw_Radar_1R1V_rpc_XilObjBypassingRunnable_XilObjBypassingRunnable_m_pad_radarObjPort_par_out_local::TChangeableMemPool::_::_::_m_arrayPool::_0_::_elem::_m_objectInformation::_5_::_m_perObjectType::_m_prob1NonObstacleN = 0;
      @sysvar::XCP::RadarFC_Obj::_g_PL_AD_fw_Radar_1R1V_rpc_XilObjBypassingRunnable_XilObjBypassingRunnable_m_pad_radarObjPort_par_out_local::TChangeableMemPool::_::_::_m_arrayPool::_0_::_elem::_m_objectInformation::_5_::_m_perObjectType::_m_prob1UnknownN = 0;
      @sysvar::XCP::RadarFC_Obj::_g_PL_AD_fw_Radar_1R1V_rpc_XilObjBypassingRunnable_XilObjBypassingRunnable_m_pad_radarObjPort_par_out_local::TChangeableMemPool::_::_::_m_arrayPool::_0_::_elem::_m_objectInformation::_5_::_m_perObjectType::_m_prob1MobileN = 128;
      @sysvar::XCP::RadarFC_Obj::_g_PL_AD_fw_Radar_1R1V_rpc_XilObjBypassingRunnable_XilObjBypassingRunnable_m_pad_radarObjPort_par_out_local::TChangeableMemPool::_::_::_m_arrayPool::_0_::_elem::_m_objectInformation::_5_::_m_perObjectType::_m_prob1StationaryN = 0;
      @sysvar::XCP::RadarFC_Obj::_g_PL_AD_fw_Radar_1R1V_rpc_XilObjBypassingRunnable_XilObjBypassingRunnable_m_pad_radarObjPort_par_out_local::TChangeableMemPool::_::_::_m_arrayPool::_0_::_elem::_m_objectInformation::_5_::_m_perObjectType::_m_prob1ObstUnknownN = 0;
      @sysvar::XCP::RadarFC_Obj::_g_PL_AD_fw_Radar_1R1V_rpc_XilObjBypassingRunnable_XilObjBypassingRunnable_m_pad_radarObjPort_par_out_local::TChangeableMemPool::_::_::_m_arrayPool::_0_::_elem::_m_objectInformation::_5_::_m_perObjectType::_m_prob1FourPlusWheelerN = 0;
      @sysvar::XCP::RadarFC_Obj::_g_PL_AD_fw_Radar_1R1V_rpc_XilObjBypassingRunnable_XilObjBypassingRunnable_m_pad_radarObjPort_par_out_local::TChangeableMemPool::_::_::_m_arrayPool::_0_::_elem::_m_objectInformation::_5_::_m_perObjectType::_m_prob1TwoWheelerN = 0;
      @sysvar::XCP::RadarFC_Obj::_g_PL_AD_fw_Radar_1R1V_rpc_XilObjBypassingRunnable_XilObjBypassingRunnable_m_pad_radarObjPort_par_out_local::TChangeableMemPool::_::_::_m_arrayPool::_0_::_elem::_m_objectInformation::_5_::_m_perObjectType::_m_prob1PedestrianN = 128;
      @sysvar::XCP::RadarFC_Obj::_g_PL_AD_fw_Radar_1R1V_rpc_XilObjBypassingRunnable_XilObjBypassingRunnable_m_pad_radarObjPort_par_out_local::TChangeableMemPool::_::_::_m_arrayPool::_0_::_elem::_m_objectInformation::_5_::_m_perObjectType::_m_prob1MovUnknownN = 0;
      @sysvar::XCP::RadarFC_Obj::_g_PL_AD_fw_Radar_1R1V_rpc_XilObjBypassingRunnable_XilObjBypassingRunnable_m_pad_radarObjPort_par_out_local::TChangeableMemPool::_::_::_m_arrayPool::_0_::_elem::_m_objectInformation::_5_::_m_perObjectType::_m_prob1RoadsideBarrierN = 0;
      @sysvar::XCP::RadarFC_Obj::_g_PL_AD_fw_Radar_1R1V_rpc_XilObjBypassingRunnable_XilObjBypassingRunnable_m_pad_radarObjPort_par_out_local::TChangeableMemPool::_::_::_m_arrayPool::_0_::_elem::_m_objectInformation::_5_::_m_perObjectType::_m_prob1StatUnknownN = 128;
      @sysvar::XCP::RadarFC_Obj::_g_PL_AD_fw_Radar_1R1V_rpc_XilObjBypassingRunnable_XilObjBypassingRunnable_m_pad_radarObjPort_par_out_local::TChangeableMemPool::_::_::_m_arrayPool::_0_::_elem::_m_objectInformation::_5_::_m_perObjectType::_m_prob1PassengerCarN = 0;
      @sysvar::XCP::RadarFC_Obj::_g_PL_AD_fw_Radar_1R1V_rpc_XilObjBypassingRunnable_XilObjBypassingRunnable_m_pad_radarObjPort_par_out_local::TChangeableMemPool::_::_::_m_arrayPool::_0_::_elem::_m_objectInformation::_5_::_m_perObjectType::_m_prob1TruckN = 0;
      @sysvar::XCP::RadarFC_Obj::_g_PL_AD_fw_Radar_1R1V_rpc_XilObjBypassingRunnable_XilObjBypassingRunnable_m_pad_radarObjPort_par_out_local::TChangeableMemPool::_::_::_m_arrayPool::_0_::_elem::_m_objectInformation::_5_::_m_perObjectType::_m_prob1FourWheelUnknownN = 128;
      @sysvar::XCP::RadarFC_Obj::_g_PL_AD_fw_Radar_1R1V_rpc_XilObjBypassingRunnable_XilObjBypassingRunnable_m_pad_radarObjPort_par_out_local::TChangeableMemPool::_::_::_m_arrayPool::_0_::_elem::_m_objectInformation::_5_::_m_dWidthN = 64;
        break;

      case 5: //"Truck"
      @sysvar::XCP::RadarFC_Obj::_g_PL_AD_fw_Radar_1R1V_rpc_XilObjBypassingRunnable_XilObjBypassingRunnable_m_pad_radarObjPort_par_out_local::TChangeableMemPool::_::_::_m_arrayPool::_0_::_elem::_m_objectInformation::_5_::_m_perObjectType::_m_prob1ObstacleN = 128;
      @sysvar::XCP::RadarFC_Obj::_g_PL_AD_fw_Radar_1R1V_rpc_XilObjBypassingRunnable_XilObjBypassingRunnable_m_pad_radarObjPort_par_out_local::TChangeableMemPool::_::_::_m_arrayPool::_0_::_elem::_m_objectInformation::_5_::_m_perObjectType::_m_prob1NonObstacleN = 0;
      @sysvar::XCP::RadarFC_Obj::_g_PL_AD_fw_Radar_1R1V_rpc_XilObjBypassingRunnable_XilObjBypassingRunnable_m_pad_radarObjPort_par_out_local::TChangeableMemPool::_::_::_m_arrayPool::_0_::_elem::_m_objectInformation::_5_::_m_perObjectType::_m_prob1UnknownN = 0;
      @sysvar::XCP::RadarFC_Obj::_g_PL_AD_fw_Radar_1R1V_rpc_XilObjBypassingRunnable_XilObjBypassingRunnable_m_pad_radarObjPort_par_out_local::TChangeableMemPool::_::_::_m_arrayPool::_0_::_elem::_m_objectInformation::_5_::_m_perObjectType::_m_prob1MobileN = 128;
      @sysvar::XCP::RadarFC_Obj::_g_PL_AD_fw_Radar_1R1V_rpc_XilObjBypassingRunnable_XilObjBypassingRunnable_m_pad_radarObjPort_par_out_local::TChangeableMemPool::_::_::_m_arrayPool::_0_::_elem::_m_objectInformation::_5_::_m_perObjectType::_m_prob1StationaryN = 0;
      @sysvar::XCP::RadarFC_Obj::_g_PL_AD_fw_Radar_1R1V_rpc_XilObjBypassingRunnable_XilObjBypassingRunnable_m_pad_radarObjPort_par_out_local::TChangeableMemPool::_::_::_m_arrayPool::_0_::_elem::_m_objectInformation::_5_::_m_perObjectType::_m_prob1ObstUnknownN = 0;
      @sysvar::XCP::RadarFC_Obj::_g_PL_AD_fw_Radar_1R1V_rpc_XilObjBypassingRunnable_XilObjBypassingRunnable_m_pad_radarObjPort_par_out_local::TChangeableMemPool::_::_::_m_arrayPool::_0_::_elem::_m_objectInformation::_5_::_m_perObjectType::_m_prob1FourPlusWheelerN = 128;
      @sysvar::XCP::RadarFC_Obj::_g_PL_AD_fw_Radar_1R1V_rpc_XilObjBypassingRunnable_XilObjBypassingRunnable_m_pad_radarObjPort_par_out_local::TChangeableMemPool::_::_::_m_arrayPool::_0_::_elem::_m_objectInformation::_5_::_m_perObjectType::_m_prob1TwoWheelerN = 0;
      @sysvar::XCP::RadarFC_Obj::_g_PL_AD_fw_Radar_1R1V_rpc_XilObjBypassingRunnable_XilObjBypassingRunnable_m_pad_radarObjPort_par_out_local::TChangeableMemPool::_::_::_m_arrayPool::_0_::_elem::_m_objectInformation::_5_::_m_perObjectType::_m_prob1PedestrianN = 0;
      @sysvar::XCP::RadarFC_Obj::_g_PL_AD_fw_Radar_1R1V_rpc_XilObjBypassingRunnable_XilObjBypassingRunnable_m_pad_radarObjPort_par_out_local::TChangeableMemPool::_::_::_m_arrayPool::_0_::_elem::_m_objectInformation::_5_::_m_perObjectType::_m_prob1MovUnknownN = 0;
      @sysvar::XCP::RadarFC_Obj::_g_PL_AD_fw_Radar_1R1V_rpc_XilObjBypassingRunnable_XilObjBypassingRunnable_m_pad_radarObjPort_par_out_local::TChangeableMemPool::_::_::_m_arrayPool::_0_::_elem::_m_objectInformation::_5_::_m_perObjectType::_m_prob1RoadsideBarrierN = 0;
      @sysvar::XCP::RadarFC_Obj::_g_PL_AD_fw_Radar_1R1V_rpc_XilObjBypassingRunnable_XilObjBypassingRunnable_m_pad_radarObjPort_par_out_local::TChangeableMemPool::_::_::_m_arrayPool::_0_::_elem::_m_objectInformation::_5_::_m_perObjectType::_m_prob1StatUnknownN = 128;
      @sysvar::XCP::RadarFC_Obj::_g_PL_AD_fw_Radar_1R1V_rpc_XilObjBypassingRunnable_XilObjBypassingRunnable_m_pad_radarObjPort_par_out_local::TChangeableMemPool::_::_::_m_arrayPool::_0_::_elem::_m_objectInformation::_5_::_m_perObjectType::_m_prob1PassengerCarN = 0;
      @sysvar::XCP::RadarFC_Obj::_g_PL_AD_fw_Radar_1R1V_rpc_XilObjBypassingRunnable_XilObjBypassingRunnable_m_pad_radarObjPort_par_out_local::TChangeableMemPool::_::_::_m_arrayPool::_0_::_elem::_m_objectInformation::_5_::_m_perObjectType::_m_prob1TruckN = 128;
      @sysvar::XCP::RadarFC_Obj::_g_PL_AD_fw_Radar_1R1V_rpc_XilObjBypassingRunnable_XilObjBypassingRunnable_m_pad_radarObjPort_par_out_local::TChangeableMemPool::_::_::_m_arrayPool::_0_::_elem::_m_objectInformation::_5_::_m_perObjectType::_m_prob1FourWheelUnknownN = 0;
      @sysvar::XCP::RadarFC_Obj::_g_PL_AD_fw_Radar_1R1V_rpc_XilObjBypassingRunnable_XilObjBypassingRunnable_m_pad_radarObjPort_par_out_local::TChangeableMemPool::_::_::_m_arrayPool::_0_::_elem::_m_objectInformation::_5_::_m_dWidthN = 256;
        break;

      case 6: //"PassengerCar"
      @sysvar::XCP::RadarFC_Obj::_g_PL_AD_fw_Radar_1R1V_rpc_XilObjBypassingRunnable_XilObjBypassingRunnable_m_pad_radarObjPort_par_out_local::TChangeableMemPool::_::_::_m_arrayPool::_0_::_elem::_m_objectInformation::_5_::_m_perObjectType::_m_prob1ObstacleN = 128;
      @sysvar::XCP::RadarFC_Obj::_g_PL_AD_fw_Radar_1R1V_rpc_XilObjBypassingRunnable_XilObjBypassingRunnable_m_pad_radarObjPort_par_out_local::TChangeableMemPool::_::_::_m_arrayPool::_0_::_elem::_m_objectInformation::_5_::_m_perObjectType::_m_prob1NonObstacleN = 0;
      @sysvar::XCP::RadarFC_Obj::_g_PL_AD_fw_Radar_1R1V_rpc_XilObjBypassingRunnable_XilObjBypassingRunnable_m_pad_radarObjPort_par_out_local::TChangeableMemPool::_::_::_m_arrayPool::_0_::_elem::_m_objectInformation::_5_::_m_perObjectType::_m_prob1UnknownN = 0;
      @sysvar::XCP::RadarFC_Obj::_g_PL_AD_fw_Radar_1R1V_rpc_XilObjBypassingRunnable_XilObjBypassingRunnable_m_pad_radarObjPort_par_out_local::TChangeableMemPool::_::_::_m_arrayPool::_0_::_elem::_m_objectInformation::_5_::_m_perObjectType::_m_prob1MobileN = 128;
      @sysvar::XCP::RadarFC_Obj::_g_PL_AD_fw_Radar_1R1V_rpc_XilObjBypassingRunnable_XilObjBypassingRunnable_m_pad_radarObjPort_par_out_local::TChangeableMemPool::_::_::_m_arrayPool::_0_::_elem::_m_objectInformation::_5_::_m_perObjectType::_m_prob1StationaryN = 0;
      @sysvar::XCP::RadarFC_Obj::_g_PL_AD_fw_Radar_1R1V_rpc_XilObjBypassingRunnable_XilObjBypassingRunnable_m_pad_radarObjPort_par_out_local::TChangeableMemPool::_::_::_m_arrayPool::_0_::_elem::_m_objectInformation::_5_::_m_perObjectType::_m_prob1ObstUnknownN = 0;
      @sysvar::XCP::RadarFC_Obj::_g_PL_AD_fw_Radar_1R1V_rpc_XilObjBypassingRunnable_XilObjBypassingRunnable_m_pad_radarObjPort_par_out_local::TChangeableMemPool::_::_::_m_arrayPool::_0_::_elem::_m_objectInformation::_5_::_m_perObjectType::_m_prob1FourPlusWheelerN = 128;
      @sysvar::XCP::RadarFC_Obj::_g_PL_AD_fw_Radar_1R1V_rpc_XilObjBypassingRunnable_XilObjBypassingRunnable_m_pad_radarObjPort_par_out_local::TChangeableMemPool::_::_::_m_arrayPool::_0_::_elem::_m_objectInformation::_5_::_m_perObjectType::_m_prob1TwoWheelerN = 0;
      @sysvar::XCP::RadarFC_Obj::_g_PL_AD_fw_Radar_1R1V_rpc_XilObjBypassingRunnable_XilObjBypassingRunnable_m_pad_radarObjPort_par_out_local::TChangeableMemPool::_::_::_m_arrayPool::_0_::_elem::_m_objectInformation::_5_::_m_perObjectType::_m_prob1PedestrianN = 0;
      @sysvar::XCP::RadarFC_Obj::_g_PL_AD_fw_Radar_1R1V_rpc_XilObjBypassingRunnable_XilObjBypassingRunnable_m_pad_radarObjPort_par_out_local::TChangeableMemPool::_::_::_m_arrayPool::_0_::_elem::_m_objectInformation::_5_::_m_perObjectType::_m_prob1MovUnknownN = 0;
      @sysvar::XCP::RadarFC_Obj::_g_PL_AD_fw_Radar_1R1V_rpc_XilObjBypassingRunnable_XilObjBypassingRunnable_m_pad_radarObjPort_par_out_local::TChangeableMemPool::_::_::_m_arrayPool::_0_::_elem::_m_objectInformation::_5_::_m_perObjectType::_m_prob1RoadsideBarrierN = 0;
      @sysvar::XCP::RadarFC_Obj::_g_PL_AD_fw_Radar_1R1V_rpc_XilObjBypassingRunnable_XilObjBypassingRunnable_m_pad_radarObjPort_par_out_local::TChangeableMemPool::_::_::_m_arrayPool::_0_::_elem::_m_objectInformation::_5_::_m_perObjectType::_m_prob1StatUnknownN = 128;
      @sysvar::XCP::RadarFC_Obj::_g_PL_AD_fw_Radar_1R1V_rpc_XilObjBypassingRunnable_XilObjBypassingRunnable_m_pad_radarObjPort_par_out_local::TChangeableMemPool::_::_::_m_arrayPool::_0_::_elem::_m_objectInformation::_5_::_m_perObjectType::_m_prob1PassengerCarN = 128;
      @sysvar::XCP::RadarFC_Obj::_g_PL_AD_fw_Radar_1R1V_rpc_XilObjBypassingRunnable_XilObjBypassingRunnable_m_pad_radarObjPort_par_out_local::TChangeableMemPool::_::_::_m_arrayPool::_0_::_elem::_m_objectInformation::_5_::_m_perObjectType::_m_prob1TruckN = 0;
      @sysvar::XCP::RadarFC_Obj::_g_PL_AD_fw_Radar_1R1V_rpc_XilObjBypassingRunnable_XilObjBypassingRunnable_m_pad_radarObjPort_par_out_local::TChangeableMemPool::_::_::_m_arrayPool::_0_::_elem::_m_objectInformation::_5_::_m_perObjectType::_m_prob1FourWheelUnknownN = 0;
      @sysvar::XCP::RadarFC_Obj::_g_PL_AD_fw_Radar_1R1V_rpc_XilObjBypassingRunnable_XilObjBypassingRunnable_m_pad_radarObjPort_par_out_local::TChangeableMemPool::_::_::_m_arrayPool::_0_::_elem::_m_objectInformation::_5_::_m_dWidthN = 256;
        break;
    }
    break;

    case 6: //"Object-6"
    //constant
  @sysvar::XCP::RadarFC_Obj::_g_PL_AD_fw_Radar_1R1V_rpc_XilObjBypassingRunnable_XilObjBypassingRunnable_m_pad_radarObjPort_par_out_local::TChangeableMemPool::_::_::_m_arrayPool::_0_::_elem::_m_objectInformation::_6_::_Valid_b = 1;
  @sysvar::XCP::RadarFC_Obj::_g_PL_AD_fw_Radar_1R1V_rpc_XilObjBypassingRunnable_XilObjBypassingRunnable_m_pad_radarObjPort_par_out_local::TChangeableMemPool::_::_::_m_arrayPool::_0_::_elem::_m_objectInformation::_6_::_m_HandleN = 1;
  @sysvar::XCP::RadarFC_Obj::_g_PL_AD_fw_Radar_1R1V_rpc_XilObjBypassingRunnable_XilObjBypassingRunnable_m_pad_radarObjPort_par_out_local::TChangeableMemPool::_::_::_m_arrayPool::_0_::_elem::_m_objectInformation::_6_::_m_alpPiVarYawAngleN = 0;
  @sysvar::XCP::RadarFC_Obj::_g_PL_AD_fw_Radar_1R1V_rpc_XilObjBypassingRunnable_XilObjBypassingRunnable_m_pad_radarObjPort_par_out_local::TChangeableMemPool::_::_::_m_arrayPool::_0_::_elem::_m_objectInformation::_6_::_m_alpPiYawAngleN = 0;
  @sysvar::XCP::RadarFC_Obj::_g_PL_AD_fw_Radar_1R1V_rpc_XilObjBypassingRunnable_XilObjBypassingRunnable_m_pad_radarObjPort_par_out_local::TChangeableMemPool::_::_::_m_arrayPool::_0_::_elem::_m_objectInformation::_6_::_m_varAxN = 0;
  @sysvar::XCP::RadarFC_Obj::_g_PL_AD_fw_Radar_1R1V_rpc_XilObjBypassingRunnable_XilObjBypassingRunnable_m_pad_radarObjPort_par_out_local::TChangeableMemPool::_::_::_m_arrayPool::_0_::_elem::_m_objectInformation::_6_::_m_varAyN = 0;
  @sysvar::XCP::RadarFC_Obj::_g_PL_AD_fw_Radar_1R1V_rpc_XilObjBypassingRunnable_XilObjBypassingRunnable_m_pad_radarObjPort_par_out_local::TChangeableMemPool::_::_::_m_arrayPool::_0_::_elem::_m_objectInformation::_6_::_m_varVxN = 0;
  @sysvar::XCP::RadarFC_Obj::_g_PL_AD_fw_Radar_1R1V_rpc_XilObjBypassingRunnable_XilObjBypassingRunnable_m_pad_radarObjPort_par_out_local::TChangeableMemPool::_::_::_m_arrayPool::_0_::_elem::_m_objectInformation::_6_::_m_varVyN = 0;
  @sysvar::XCP::RadarFC_Obj::_g_PL_AD_fw_Radar_1R1V_rpc_XilObjBypassingRunnable_XilObjBypassingRunnable_m_pad_radarObjPort_par_out_local::TChangeableMemPool::_::_::_m_arrayPool::_0_::_elem::_m_objectInformation::_6_::_m_varDxN = 0;
  @sysvar::XCP::RadarFC_Obj::_g_PL_AD_fw_Radar_1R1V_rpc_XilObjBypassingRunnable_XilObjBypassingRunnable_m_pad_radarObjPort_par_out_local::TChangeableMemPool::_::_::_m_arrayPool::_0_::_elem::_m_objectInformation::_6_::_m_varDyN = 0;
  @sysvar::XCP::RadarFC_Obj::_g_PL_AD_fw_Radar_1R1V_rpc_XilObjBypassingRunnable_XilObjBypassingRunnable_m_pad_radarObjPort_par_out_local::TChangeableMemPool::_::_::_m_arrayPool::_0_::_elem::_m_objectInformation::_6_::_m_dVarLengthN = 0;
  @sysvar::XCP::RadarFC_Obj::_g_PL_AD_fw_Radar_1R1V_rpc_XilObjBypassingRunnable_XilObjBypassingRunnable_m_pad_radarObjPort_par_out_local::TChangeableMemPool::_::_::_m_arrayPool::_0_::_elem::_m_objectInformation::_6_::_m_dVarWidthN = 0;
  @sysvar::XCP::RadarFC_Obj::_g_PL_AD_fw_Radar_1R1V_rpc_XilObjBypassingRunnable_XilObjBypassingRunnable_m_pad_radarObjPort_par_out_local::TChangeableMemPool::_::_::_m_arrayPool::_0_::_elem::_m_objectInformation::_6_::_m_wExistProbN = 64880;
  @sysvar::XCP::RadarFC_Obj::_g_PL_AD_fw_Radar_1R1V_rpc_XilObjBypassingRunnable_XilObjBypassingRunnable_m_pad_radarObjPort_par_out_local::TChangeableMemPool::_::_::_m_arrayPool::_0_::_elem::_m_objectInformation::_6_::_m_isObjectAsil = 1;
  @sysvar::XCP::RadarFC_Obj::_g_PL_AD_fw_Radar_1R1V_rpc_XilObjBypassingRunnable_XilObjBypassingRunnable_m_pad_radarObjPort_par_out_local::TChangeableMemPool::_::_::_m_arrayPool::_0_::_elem::_m_objectInformation::_6_::_m_dLengthN = 128;

    //target movement

  @sysvar::XCP::RadarFC_Obj::_g_PL_AD_fw_Radar_1R1V_rpc_XilObjBypassingRunnable_XilObjBypassingRunnable_m_pad_radarObjPort_par_out_local::TChangeableMemPool::_::_::_m_arrayPool::_0_::_elem::_m_objectInformation::_6_::_m_dxN = @target_radar_fc_sim::objdata.obj_distance_x[6] * 128;
  @sysvar::XCP::RadarFC_Obj::_g_PL_AD_fw_Radar_1R1V_rpc_XilObjBypassingRunnable_XilObjBypassingRunnable_m_pad_radarObjPort_par_out_local::TChangeableMemPool::_::_::_m_arrayPool::_0_::_elem::_m_objectInformation::_6_::_m_dyN = @target_radar_fc_sim::objdata.obj_distance_y[6] * 128;
  @sysvar::XCP::RadarFC_Obj::_g_PL_AD_fw_Radar_1R1V_rpc_XilObjBypassingRunnable_XilObjBypassingRunnable_m_pad_radarObjPort_par_out_local::TChangeableMemPool::_::_::_m_arrayPool::_0_::_elem::_m_objectInformation::_6_::_m_dzN = 0;
  @sysvar::XCP::RadarFC_Obj::_g_PL_AD_fw_Radar_1R1V_rpc_XilObjBypassingRunnable_XilObjBypassingRunnable_m_pad_radarObjPort_par_out_local::TChangeableMemPool::_::_::_m_arrayPool::_0_::_elem::_m_objectInformation::_6_::_m_vxN = @target_radar_fc_sim::objdata.obj_velocity_x[6] * 256;
  @sysvar::XCP::RadarFC_Obj::_g_PL_AD_fw_Radar_1R1V_rpc_XilObjBypassingRunnable_XilObjBypassingRunnable_m_pad_radarObjPort_par_out_local::TChangeableMemPool::_::_::_m_arrayPool::_0_::_elem::_m_objectInformation::_6_::_m_vyN = @target_radar_fc_sim::objdata.obj_velocity_y[6] * 256;
  @sysvar::XCP::RadarFC_Obj::_g_PL_AD_fw_Radar_1R1V_rpc_XilObjBypassingRunnable_XilObjBypassingRunnable_m_pad_radarObjPort_par_out_local::TChangeableMemPool::_::_::_m_arrayPool::_0_::_elem::_m_objectInformation::_6_::_m_axN = 0;
  @sysvar::XCP::RadarFC_Obj::_g_PL_AD_fw_Radar_1R1V_rpc_XilObjBypassingRunnable_XilObjBypassingRunnable_m_pad_radarObjPort_par_out_local::TChangeableMemPool::_::_::_m_arrayPool::_0_::_elem::_m_objectInformation::_6_::_m_ayN = 0;

    //target object moving or not
    if (abs(@target_radar_fc_sim::objdata.obj_velocity_x[6]) != 0)
    {
    @sysvar::XCP::RadarFC_Obj::_g_PL_AD_fw_Radar_1R1V_rpc_XilObjBypassingRunnable_XilObjBypassingRunnable_m_pad_radarObjPort_par_out_local::TChangeableMemPool::_::_::_m_arrayPool::_0_::_elem::_m_objectInformation::_6_::_m_prob1HasBeenObservedMovingN = 126;
    @sysvar::XCP::RadarFC_Obj::_g_PL_AD_fw_Radar_1R1V_rpc_XilObjBypassingRunnable_XilObjBypassingRunnable_m_pad_radarObjPort_par_out_local::TChangeableMemPool::_::_::_m_arrayPool::_0_::_elem::_m_objectInformation::_6_::_m_prob1MovingN = 126;
    }
    else
    {
    @sysvar::XCP::RadarFC_Obj::_g_PL_AD_fw_Radar_1R1V_rpc_XilObjBypassingRunnable_XilObjBypassingRunnable_m_pad_radarObjPort_par_out_local::TChangeableMemPool::_::_::_m_arrayPool::_0_::_elem::_m_objectInformation::_6_::_m_prob1HasBeenObservedMovingN = 0;
    @sysvar::XCP::RadarFC_Obj::_g_PL_AD_fw_Radar_1R1V_rpc_XilObjBypassingRunnable_XilObjBypassingRunnable_m_pad_radarObjPort_par_out_local::TChangeableMemPool::_::_::_m_arrayPool::_0_::_elem::_m_objectInformation::_6_::_m_prob1MovingN = 0;
    }

      //object classification
    switch (@target_radar_fc_sim::objdata.obj_type[6])
    {
      case 0: //"Non-Obstacle"
      @sysvar::XCP::RadarFC_Obj::_g_PL_AD_fw_Radar_1R1V_rpc_XilObjBypassingRunnable_XilObjBypassingRunnable_m_pad_radarObjPort_par_out_local::TChangeableMemPool::_::_::_m_arrayPool::_0_::_elem::_m_objectInformation::_6_::_m_perObjectType::_m_prob1ObstacleN = 0;
      @sysvar::XCP::RadarFC_Obj::_g_PL_AD_fw_Radar_1R1V_rpc_XilObjBypassingRunnable_XilObjBypassingRunnable_m_pad_radarObjPort_par_out_local::TChangeableMemPool::_::_::_m_arrayPool::_0_::_elem::_m_objectInformation::_6_::_m_perObjectType::_m_prob1NonObstacleN = 128;
      @sysvar::XCP::RadarFC_Obj::_g_PL_AD_fw_Radar_1R1V_rpc_XilObjBypassingRunnable_XilObjBypassingRunnable_m_pad_radarObjPort_par_out_local::TChangeableMemPool::_::_::_m_arrayPool::_0_::_elem::_m_objectInformation::_6_::_m_perObjectType::_m_prob1UnknownN = 0;
      @sysvar::XCP::RadarFC_Obj::_g_PL_AD_fw_Radar_1R1V_rpc_XilObjBypassingRunnable_XilObjBypassingRunnable_m_pad_radarObjPort_par_out_local::TChangeableMemPool::_::_::_m_arrayPool::_0_::_elem::_m_objectInformation::_6_::_m_perObjectType::_m_prob1MobileN = 0;
      @sysvar::XCP::RadarFC_Obj::_g_PL_AD_fw_Radar_1R1V_rpc_XilObjBypassingRunnable_XilObjBypassingRunnable_m_pad_radarObjPort_par_out_local::TChangeableMemPool::_::_::_m_arrayPool::_0_::_elem::_m_objectInformation::_6_::_m_perObjectType::_m_prob1StationaryN = 0;
      @sysvar::XCP::RadarFC_Obj::_g_PL_AD_fw_Radar_1R1V_rpc_XilObjBypassingRunnable_XilObjBypassingRunnable_m_pad_radarObjPort_par_out_local::TChangeableMemPool::_::_::_m_arrayPool::_0_::_elem::_m_objectInformation::_6_::_m_perObjectType::_m_prob1ObstUnknownN = 128;
      @sysvar::XCP::RadarFC_Obj::_g_PL_AD_fw_Radar_1R1V_rpc_XilObjBypassingRunnable_XilObjBypassingRunnable_m_pad_radarObjPort_par_out_local::TChangeableMemPool::_::_::_m_arrayPool::_0_::_elem::_m_objectInformation::_6_::_m_perObjectType::_m_prob1FourPlusWheelerN = 0;
      @sysvar::XCP::RadarFC_Obj::_g_PL_AD_fw_Radar_1R1V_rpc_XilObjBypassingRunnable_XilObjBypassingRunnable_m_pad_radarObjPort_par_out_local::TChangeableMemPool::_::_::_m_arrayPool::_0_::_elem::_m_objectInformation::_6_::_m_perObjectType::_m_prob1TwoWheelerN = 0;
      @sysvar::XCP::RadarFC_Obj::_g_PL_AD_fw_Radar_1R1V_rpc_XilObjBypassingRunnable_XilObjBypassingRunnable_m_pad_radarObjPort_par_out_local::TChangeableMemPool::_::_::_m_arrayPool::_0_::_elem::_m_objectInformation::_6_::_m_perObjectType::_m_prob1PedestrianN = 0;
      @sysvar::XCP::RadarFC_Obj::_g_PL_AD_fw_Radar_1R1V_rpc_XilObjBypassingRunnable_XilObjBypassingRunnable_m_pad_radarObjPort_par_out_local::TChangeableMemPool::_::_::_m_arrayPool::_0_::_elem::_m_objectInformation::_6_::_m_perObjectType::_m_prob1MovUnknownN = 128;
      @sysvar::XCP::RadarFC_Obj::_g_PL_AD_fw_Radar_1R1V_rpc_XilObjBypassingRunnable_XilObjBypassingRunnable_m_pad_radarObjPort_par_out_local::TChangeableMemPool::_::_::_m_arrayPool::_0_::_elem::_m_objectInformation::_6_::_m_perObjectType::_m_prob1RoadsideBarrierN = 0;
      @sysvar::XCP::RadarFC_Obj::_g_PL_AD_fw_Radar_1R1V_rpc_XilObjBypassingRunnable_XilObjBypassingRunnable_m_pad_radarObjPort_par_out_local::TChangeableMemPool::_::_::_m_arrayPool::_0_::_elem::_m_objectInformation::_6_::_m_perObjectType::_m_prob1StatUnknownN = 128;
      @sysvar::XCP::RadarFC_Obj::_g_PL_AD_fw_Radar_1R1V_rpc_XilObjBypassingRunnable_XilObjBypassingRunnable_m_pad_radarObjPort_par_out_local::TChangeableMemPool::_::_::_m_arrayPool::_0_::_elem::_m_objectInformation::_6_::_m_perObjectType::_m_prob1PassengerCarN = 0;
      @sysvar::XCP::RadarFC_Obj::_g_PL_AD_fw_Radar_1R1V_rpc_XilObjBypassingRunnable_XilObjBypassingRunnable_m_pad_radarObjPort_par_out_local::TChangeableMemPool::_::_::_m_arrayPool::_0_::_elem::_m_objectInformation::_6_::_m_perObjectType::_m_prob1TruckN = 0;
      @sysvar::XCP::RadarFC_Obj::_g_PL_AD_fw_Radar_1R1V_rpc_XilObjBypassingRunnable_XilObjBypassingRunnable_m_pad_radarObjPort_par_out_local::TChangeableMemPool::_::_::_m_arrayPool::_0_::_elem::_m_objectInformation::_6_::_m_perObjectType::_m_prob1FourWheelUnknownN = 128;
      @sysvar::XCP::RadarFC_Obj::_g_PL_AD_fw_Radar_1R1V_rpc_XilObjBypassingRunnable_XilObjBypassingRunnable_m_pad_radarObjPort_par_out_local::TChangeableMemPool::_::_::_m_arrayPool::_0_::_elem::_m_objectInformation::_6_::_m_dWidthN = 256;
        break;

      case 1: //"unknown"
      @sysvar::XCP::RadarFC_Obj::_g_PL_AD_fw_Radar_1R1V_rpc_XilObjBypassingRunnable_XilObjBypassingRunnable_m_pad_radarObjPort_par_out_local::TChangeableMemPool::_::_::_m_arrayPool::_0_::_elem::_m_objectInformation::_6_::_m_perObjectType::_m_prob1ObstacleN = 0;
      @sysvar::XCP::RadarFC_Obj::_g_PL_AD_fw_Radar_1R1V_rpc_XilObjBypassingRunnable_XilObjBypassingRunnable_m_pad_radarObjPort_par_out_local::TChangeableMemPool::_::_::_m_arrayPool::_0_::_elem::_m_objectInformation::_6_::_m_perObjectType::_m_prob1NonObstacleN = 0;
      @sysvar::XCP::RadarFC_Obj::_g_PL_AD_fw_Radar_1R1V_rpc_XilObjBypassingRunnable_XilObjBypassingRunnable_m_pad_radarObjPort_par_out_local::TChangeableMemPool::_::_::_m_arrayPool::_0_::_elem::_m_objectInformation::_6_::_m_perObjectType::_m_prob1UnknownN = 128;
      @sysvar::XCP::RadarFC_Obj::_g_PL_AD_fw_Radar_1R1V_rpc_XilObjBypassingRunnable_XilObjBypassingRunnable_m_pad_radarObjPort_par_out_local::TChangeableMemPool::_::_::_m_arrayPool::_0_::_elem::_m_objectInformation::_6_::_m_perObjectType::_m_prob1MobileN = 0;
      @sysvar::XCP::RadarFC_Obj::_g_PL_AD_fw_Radar_1R1V_rpc_XilObjBypassingRunnable_XilObjBypassingRunnable_m_pad_radarObjPort_par_out_local::TChangeableMemPool::_::_::_m_arrayPool::_0_::_elem::_m_objectInformation::_6_::_m_perObjectType::_m_prob1StationaryN = 0;
      @sysvar::XCP::RadarFC_Obj::_g_PL_AD_fw_Radar_1R1V_rpc_XilObjBypassingRunnable_XilObjBypassingRunnable_m_pad_radarObjPort_par_out_local::TChangeableMemPool::_::_::_m_arrayPool::_0_::_elem::_m_objectInformation::_6_::_m_perObjectType::_m_prob1ObstUnknownN = 128;
      @sysvar::XCP::RadarFC_Obj::_g_PL_AD_fw_Radar_1R1V_rpc_XilObjBypassingRunnable_XilObjBypassingRunnable_m_pad_radarObjPort_par_out_local::TChangeableMemPool::_::_::_m_arrayPool::_0_::_elem::_m_objectInformation::_6_::_m_perObjectType::_m_prob1FourPlusWheelerN = 0;
      @sysvar::XCP::RadarFC_Obj::_g_PL_AD_fw_Radar_1R1V_rpc_XilObjBypassingRunnable_XilObjBypassingRunnable_m_pad_radarObjPort_par_out_local::TChangeableMemPool::_::_::_m_arrayPool::_0_::_elem::_m_objectInformation::_6_::_m_perObjectType::_m_prob1TwoWheelerN = 0;
      @sysvar::XCP::RadarFC_Obj::_g_PL_AD_fw_Radar_1R1V_rpc_XilObjBypassingRunnable_XilObjBypassingRunnable_m_pad_radarObjPort_par_out_local::TChangeableMemPool::_::_::_m_arrayPool::_0_::_elem::_m_objectInformation::_6_::_m_perObjectType::_m_prob1PedestrianN = 0;
      @sysvar::XCP::RadarFC_Obj::_g_PL_AD_fw_Radar_1R1V_rpc_XilObjBypassingRunnable_XilObjBypassingRunnable_m_pad_radarObjPort_par_out_local::TChangeableMemPool::_::_::_m_arrayPool::_0_::_elem::_m_objectInformation::_6_::_m_perObjectType::_m_prob1MovUnknownN = 128;
      @sysvar::XCP::RadarFC_Obj::_g_PL_AD_fw_Radar_1R1V_rpc_XilObjBypassingRunnable_XilObjBypassingRunnable_m_pad_radarObjPort_par_out_local::TChangeableMemPool::_::_::_m_arrayPool::_0_::_elem::_m_objectInformation::_6_::_m_perObjectType::_m_prob1RoadsideBarrierN = 0;
      @sysvar::XCP::RadarFC_Obj::_g_PL_AD_fw_Radar_1R1V_rpc_XilObjBypassingRunnable_XilObjBypassingRunnable_m_pad_radarObjPort_par_out_local::TChangeableMemPool::_::_::_m_arrayPool::_0_::_elem::_m_objectInformation::_6_::_m_perObjectType::_m_prob1StatUnknownN = 128;
      @sysvar::XCP::RadarFC_Obj::_g_PL_AD_fw_Radar_1R1V_rpc_XilObjBypassingRunnable_XilObjBypassingRunnable_m_pad_radarObjPort_par_out_local::TChangeableMemPool::_::_::_m_arrayPool::_0_::_elem::_m_objectInformation::_6_::_m_perObjectType::_m_prob1PassengerCarN = 0;
      @sysvar::XCP::RadarFC_Obj::_g_PL_AD_fw_Radar_1R1V_rpc_XilObjBypassingRunnable_XilObjBypassingRunnable_m_pad_radarObjPort_par_out_local::TChangeableMemPool::_::_::_m_arrayPool::_0_::_elem::_m_objectInformation::_6_::_m_perObjectType::_m_prob1TruckN = 0;
      @sysvar::XCP::RadarFC_Obj::_g_PL_AD_fw_Radar_1R1V_rpc_XilObjBypassingRunnable_XilObjBypassingRunnable_m_pad_radarObjPort_par_out_local::TChangeableMemPool::_::_::_m_arrayPool::_0_::_elem::_m_objectInformation::_6_::_m_perObjectType::_m_prob1FourWheelUnknownN = 128;
      @sysvar::XCP::RadarFC_Obj::_g_PL_AD_fw_Radar_1R1V_rpc_XilObjBypassingRunnable_XilObjBypassingRunnable_m_pad_radarObjPort_par_out_local::TChangeableMemPool::_::_::_m_arrayPool::_0_::_elem::_m_objectInformation::_6_::_m_dWidthN = 256;
        break;

      case 2: //"RoadSideBarrier"
      @sysvar::XCP::RadarFC_Obj::_g_PL_AD_fw_Radar_1R1V_rpc_XilObjBypassingRunnable_XilObjBypassingRunnable_m_pad_radarObjPort_par_out_local::TChangeableMemPool::_::_::_m_arrayPool::_0_::_elem::_m_objectInformation::_6_::_m_perObjectType::_m_prob1ObstacleN = 128;
      @sysvar::XCP::RadarFC_Obj::_g_PL_AD_fw_Radar_1R1V_rpc_XilObjBypassingRunnable_XilObjBypassingRunnable_m_pad_radarObjPort_par_out_local::TChangeableMemPool::_::_::_m_arrayPool::_0_::_elem::_m_objectInformation::_6_::_m_perObjectType::_m_prob1NonObstacleN = 0;
      @sysvar::XCP::RadarFC_Obj::_g_PL_AD_fw_Radar_1R1V_rpc_XilObjBypassingRunnable_XilObjBypassingRunnable_m_pad_radarObjPort_par_out_local::TChangeableMemPool::_::_::_m_arrayPool::_0_::_elem::_m_objectInformation::_6_::_m_perObjectType::_m_prob1UnknownN = 0;
      @sysvar::XCP::RadarFC_Obj::_g_PL_AD_fw_Radar_1R1V_rpc_XilObjBypassingRunnable_XilObjBypassingRunnable_m_pad_radarObjPort_par_out_local::TChangeableMemPool::_::_::_m_arrayPool::_0_::_elem::_m_objectInformation::_6_::_m_perObjectType::_m_prob1MobileN = 0;
      @sysvar::XCP::RadarFC_Obj::_g_PL_AD_fw_Radar_1R1V_rpc_XilObjBypassingRunnable_XilObjBypassingRunnable_m_pad_radarObjPort_par_out_local::TChangeableMemPool::_::_::_m_arrayPool::_0_::_elem::_m_objectInformation::_6_::_m_perObjectType::_m_prob1StationaryN = 128;
      @sysvar::XCP::RadarFC_Obj::_g_PL_AD_fw_Radar_1R1V_rpc_XilObjBypassingRunnable_XilObjBypassingRunnable_m_pad_radarObjPort_par_out_local::TChangeableMemPool::_::_::_m_arrayPool::_0_::_elem::_m_objectInformation::_6_::_m_perObjectType::_m_prob1ObstUnknownN = 0;
      @sysvar::XCP::RadarFC_Obj::_g_PL_AD_fw_Radar_1R1V_rpc_XilObjBypassingRunnable_XilObjBypassingRunnable_m_pad_radarObjPort_par_out_local::TChangeableMemPool::_::_::_m_arrayPool::_0_::_elem::_m_objectInformation::_6_::_m_perObjectType::_m_prob1FourPlusWheelerN = 0;
      @sysvar::XCP::RadarFC_Obj::_g_PL_AD_fw_Radar_1R1V_rpc_XilObjBypassingRunnable_XilObjBypassingRunnable_m_pad_radarObjPort_par_out_local::TChangeableMemPool::_::_::_m_arrayPool::_0_::_elem::_m_objectInformation::_6_::_m_perObjectType::_m_prob1TwoWheelerN = 0;
      @sysvar::XCP::RadarFC_Obj::_g_PL_AD_fw_Radar_1R1V_rpc_XilObjBypassingRunnable_XilObjBypassingRunnable_m_pad_radarObjPort_par_out_local::TChangeableMemPool::_::_::_m_arrayPool::_0_::_elem::_m_objectInformation::_6_::_m_perObjectType::_m_prob1PedestrianN = 0;
      @sysvar::XCP::RadarFC_Obj::_g_PL_AD_fw_Radar_1R1V_rpc_XilObjBypassingRunnable_XilObjBypassingRunnable_m_pad_radarObjPort_par_out_local::TChangeableMemPool::_::_::_m_arrayPool::_0_::_elem::_m_objectInformation::_6_::_m_perObjectType::_m_prob1MovUnknownN = 128;
      @sysvar::XCP::RadarFC_Obj::_g_PL_AD_fw_Radar_1R1V_rpc_XilObjBypassingRunnable_XilObjBypassingRunnable_m_pad_radarObjPort_par_out_local::TChangeableMemPool::_::_::_m_arrayPool::_0_::_elem::_m_objectInformation::_6_::_m_perObjectType::_m_prob1RoadsideBarrierN = 128;
      @sysvar::XCP::RadarFC_Obj::_g_PL_AD_fw_Radar_1R1V_rpc_XilObjBypassingRunnable_XilObjBypassingRunnable_m_pad_radarObjPort_par_out_local::TChangeableMemPool::_::_::_m_arrayPool::_0_::_elem::_m_objectInformation::_6_::_m_perObjectType::_m_prob1StatUnknownN = 0;
      @sysvar::XCP::RadarFC_Obj::_g_PL_AD_fw_Radar_1R1V_rpc_XilObjBypassingRunnable_XilObjBypassingRunnable_m_pad_radarObjPort_par_out_local::TChangeableMemPool::_::_::_m_arrayPool::_0_::_elem::_m_objectInformation::_6_::_m_perObjectType::_m_prob1PassengerCarN = 0;
      @sysvar::XCP::RadarFC_Obj::_g_PL_AD_fw_Radar_1R1V_rpc_XilObjBypassingRunnable_XilObjBypassingRunnable_m_pad_radarObjPort_par_out_local::TChangeableMemPool::_::_::_m_arrayPool::_0_::_elem::_m_objectInformation::_6_::_m_perObjectType::_m_prob1TruckN = 0;
      @sysvar::XCP::RadarFC_Obj::_g_PL_AD_fw_Radar_1R1V_rpc_XilObjBypassingRunnable_XilObjBypassingRunnable_m_pad_radarObjPort_par_out_local::TChangeableMemPool::_::_::_m_arrayPool::_0_::_elem::_m_objectInformation::_6_::_m_perObjectType::_m_prob1FourWheelUnknownN = 128;
      @sysvar::XCP::RadarFC_Obj::_g_PL_AD_fw_Radar_1R1V_rpc_XilObjBypassingRunnable_XilObjBypassingRunnable_m_pad_radarObjPort_par_out_local::TChangeableMemPool::_::_::_m_arrayPool::_0_::_elem::_m_objectInformation::_6_::_m_dWidthN = 256;
        break;

      case 3: //"2Wheeler"
      @sysvar::XCP::RadarFC_Obj::_g_PL_AD_fw_Radar_1R1V_rpc_XilObjBypassingRunnable_XilObjBypassingRunnable_m_pad_radarObjPort_par_out_local::TChangeableMemPool::_::_::_m_arrayPool::_0_::_elem::_m_objectInformation::_6_::_m_perObjectType::_m_prob1ObstacleN = 128;
      @sysvar::XCP::RadarFC_Obj::_g_PL_AD_fw_Radar_1R1V_rpc_XilObjBypassingRunnable_XilObjBypassingRunnable_m_pad_radarObjPort_par_out_local::TChangeableMemPool::_::_::_m_arrayPool::_0_::_elem::_m_objectInformation::_6_::_m_perObjectType::_m_prob1NonObstacleN = 0;
      @sysvar::XCP::RadarFC_Obj::_g_PL_AD_fw_Radar_1R1V_rpc_XilObjBypassingRunnable_XilObjBypassingRunnable_m_pad_radarObjPort_par_out_local::TChangeableMemPool::_::_::_m_arrayPool::_0_::_elem::_m_objectInformation::_6_::_m_perObjectType::_m_prob1UnknownN = 0;
      @sysvar::XCP::RadarFC_Obj::_g_PL_AD_fw_Radar_1R1V_rpc_XilObjBypassingRunnable_XilObjBypassingRunnable_m_pad_radarObjPort_par_out_local::TChangeableMemPool::_::_::_m_arrayPool::_0_::_elem::_m_objectInformation::_6_::_m_perObjectType::_m_prob1MobileN = 128;
      @sysvar::XCP::RadarFC_Obj::_g_PL_AD_fw_Radar_1R1V_rpc_XilObjBypassingRunnable_XilObjBypassingRunnable_m_pad_radarObjPort_par_out_local::TChangeableMemPool::_::_::_m_arrayPool::_0_::_elem::_m_objectInformation::_6_::_m_perObjectType::_m_prob1StationaryN = 0;
      @sysvar::XCP::RadarFC_Obj::_g_PL_AD_fw_Radar_1R1V_rpc_XilObjBypassingRunnable_XilObjBypassingRunnable_m_pad_radarObjPort_par_out_local::TChangeableMemPool::_::_::_m_arrayPool::_0_::_elem::_m_objectInformation::_6_::_m_perObjectType::_m_prob1ObstUnknownN = 0;
      @sysvar::XCP::RadarFC_Obj::_g_PL_AD_fw_Radar_1R1V_rpc_XilObjBypassingRunnable_XilObjBypassingRunnable_m_pad_radarObjPort_par_out_local::TChangeableMemPool::_::_::_m_arrayPool::_0_::_elem::_m_objectInformation::_6_::_m_perObjectType::_m_prob1FourPlusWheelerN = 0;
      @sysvar::XCP::RadarFC_Obj::_g_PL_AD_fw_Radar_1R1V_rpc_XilObjBypassingRunnable_XilObjBypassingRunnable_m_pad_radarObjPort_par_out_local::TChangeableMemPool::_::_::_m_arrayPool::_0_::_elem::_m_objectInformation::_6_::_m_perObjectType::_m_prob1TwoWheelerN = 128;
      @sysvar::XCP::RadarFC_Obj::_g_PL_AD_fw_Radar_1R1V_rpc_XilObjBypassingRunnable_XilObjBypassingRunnable_m_pad_radarObjPort_par_out_local::TChangeableMemPool::_::_::_m_arrayPool::_0_::_elem::_m_objectInformation::_6_::_m_perObjectType::_m_prob1PedestrianN = 0;
      @sysvar::XCP::RadarFC_Obj::_g_PL_AD_fw_Radar_1R1V_rpc_XilObjBypassingRunnable_XilObjBypassingRunnable_m_pad_radarObjPort_par_out_local::TChangeableMemPool::_::_::_m_arrayPool::_0_::_elem::_m_objectInformation::_6_::_m_perObjectType::_m_prob1MovUnknownN = 0;
      @sysvar::XCP::RadarFC_Obj::_g_PL_AD_fw_Radar_1R1V_rpc_XilObjBypassingRunnable_XilObjBypassingRunnable_m_pad_radarObjPort_par_out_local::TChangeableMemPool::_::_::_m_arrayPool::_0_::_elem::_m_objectInformation::_6_::_m_perObjectType::_m_prob1RoadsideBarrierN = 0;
      @sysvar::XCP::RadarFC_Obj::_g_PL_AD_fw_Radar_1R1V_rpc_XilObjBypassingRunnable_XilObjBypassingRunnable_m_pad_radarObjPort_par_out_local::TChangeableMemPool::_::_::_m_arrayPool::_0_::_elem::_m_objectInformation::_6_::_m_perObjectType::_m_prob1StatUnknownN = 128;
      @sysvar::XCP::RadarFC_Obj::_g_PL_AD_fw_Radar_1R1V_rpc_XilObjBypassingRunnable_XilObjBypassingRunnable_m_pad_radarObjPort_par_out_local::TChangeableMemPool::_::_::_m_arrayPool::_0_::_elem::_m_objectInformation::_6_::_m_perObjectType::_m_prob1PassengerCarN = 0;
      @sysvar::XCP::RadarFC_Obj::_g_PL_AD_fw_Radar_1R1V_rpc_XilObjBypassingRunnable_XilObjBypassingRunnable_m_pad_radarObjPort_par_out_local::TChangeableMemPool::_::_::_m_arrayPool::_0_::_elem::_m_objectInformation::_6_::_m_perObjectType::_m_prob1TruckN = 0;
      @sysvar::XCP::RadarFC_Obj::_g_PL_AD_fw_Radar_1R1V_rpc_XilObjBypassingRunnable_XilObjBypassingRunnable_m_pad_radarObjPort_par_out_local::TChangeableMemPool::_::_::_m_arrayPool::_0_::_elem::_m_objectInformation::_6_::_m_perObjectType::_m_prob1FourWheelUnknownN = 128;
      @sysvar::XCP::RadarFC_Obj::_g_PL_AD_fw_Radar_1R1V_rpc_XilObjBypassingRunnable_XilObjBypassingRunnable_m_pad_radarObjPort_par_out_local::TChangeableMemPool::_::_::_m_arrayPool::_0_::_elem::_m_objectInformation::_6_::_m_dWidthN = 64;
        break;

      case 4: //"Pedestrian"
      @sysvar::XCP::RadarFC_Obj::_g_PL_AD_fw_Radar_1R1V_rpc_XilObjBypassingRunnable_XilObjBypassingRunnable_m_pad_radarObjPort_par_out_local::TChangeableMemPool::_::_::_m_arrayPool::_0_::_elem::_m_objectInformation::_6_::_m_perObjectType::_m_prob1ObstacleN = 128;
      @sysvar::XCP::RadarFC_Obj::_g_PL_AD_fw_Radar_1R1V_rpc_XilObjBypassingRunnable_XilObjBypassingRunnable_m_pad_radarObjPort_par_out_local::TChangeableMemPool::_::_::_m_arrayPool::_0_::_elem::_m_objectInformation::_6_::_m_perObjectType::_m_prob1NonObstacleN = 0;
      @sysvar::XCP::RadarFC_Obj::_g_PL_AD_fw_Radar_1R1V_rpc_XilObjBypassingRunnable_XilObjBypassingRunnable_m_pad_radarObjPort_par_out_local::TChangeableMemPool::_::_::_m_arrayPool::_0_::_elem::_m_objectInformation::_6_::_m_perObjectType::_m_prob1UnknownN = 0;
      @sysvar::XCP::RadarFC_Obj::_g_PL_AD_fw_Radar_1R1V_rpc_XilObjBypassingRunnable_XilObjBypassingRunnable_m_pad_radarObjPort_par_out_local::TChangeableMemPool::_::_::_m_arrayPool::_0_::_elem::_m_objectInformation::_6_::_m_perObjectType::_m_prob1MobileN = 128;
      @sysvar::XCP::RadarFC_Obj::_g_PL_AD_fw_Radar_1R1V_rpc_XilObjBypassingRunnable_XilObjBypassingRunnable_m_pad_radarObjPort_par_out_local::TChangeableMemPool::_::_::_m_arrayPool::_0_::_elem::_m_objectInformation::_6_::_m_perObjectType::_m_prob1StationaryN = 0;
      @sysvar::XCP::RadarFC_Obj::_g_PL_AD_fw_Radar_1R1V_rpc_XilObjBypassingRunnable_XilObjBypassingRunnable_m_pad_radarObjPort_par_out_local::TChangeableMemPool::_::_::_m_arrayPool::_0_::_elem::_m_objectInformation::_6_::_m_perObjectType::_m_prob1ObstUnknownN = 0;
      @sysvar::XCP::RadarFC_Obj::_g_PL_AD_fw_Radar_1R1V_rpc_XilObjBypassingRunnable_XilObjBypassingRunnable_m_pad_radarObjPort_par_out_local::TChangeableMemPool::_::_::_m_arrayPool::_0_::_elem::_m_objectInformation::_6_::_m_perObjectType::_m_prob1FourPlusWheelerN = 0;
      @sysvar::XCP::RadarFC_Obj::_g_PL_AD_fw_Radar_1R1V_rpc_XilObjBypassingRunnable_XilObjBypassingRunnable_m_pad_radarObjPort_par_out_local::TChangeableMemPool::_::_::_m_arrayPool::_0_::_elem::_m_objectInformation::_6_::_m_perObjectType::_m_prob1TwoWheelerN = 0;
      @sysvar::XCP::RadarFC_Obj::_g_PL_AD_fw_Radar_1R1V_rpc_XilObjBypassingRunnable_XilObjBypassingRunnable_m_pad_radarObjPort_par_out_local::TChangeableMemPool::_::_::_m_arrayPool::_0_::_elem::_m_objectInformation::_6_::_m_perObjectType::_m_prob1PedestrianN = 128;
      @sysvar::XCP::RadarFC_Obj::_g_PL_AD_fw_Radar_1R1V_rpc_XilObjBypassingRunnable_XilObjBypassingRunnable_m_pad_radarObjPort_par_out_local::TChangeableMemPool::_::_::_m_arrayPool::_0_::_elem::_m_objectInformation::_6_::_m_perObjectType::_m_prob1MovUnknownN = 0;
      @sysvar::XCP::RadarFC_Obj::_g_PL_AD_fw_Radar_1R1V_rpc_XilObjBypassingRunnable_XilObjBypassingRunnable_m_pad_radarObjPort_par_out_local::TChangeableMemPool::_::_::_m_arrayPool::_0_::_elem::_m_objectInformation::_6_::_m_perObjectType::_m_prob1RoadsideBarrierN = 0;
      @sysvar::XCP::RadarFC_Obj::_g_PL_AD_fw_Radar_1R1V_rpc_XilObjBypassingRunnable_XilObjBypassingRunnable_m_pad_radarObjPort_par_out_local::TChangeableMemPool::_::_::_m_arrayPool::_0_::_elem::_m_objectInformation::_6_::_m_perObjectType::_m_prob1StatUnknownN = 128;
      @sysvar::XCP::RadarFC_Obj::_g_PL_AD_fw_Radar_1R1V_rpc_XilObjBypassingRunnable_XilObjBypassingRunnable_m_pad_radarObjPort_par_out_local::TChangeableMemPool::_::_::_m_arrayPool::_0_::_elem::_m_objectInformation::_6_::_m_perObjectType::_m_prob1PassengerCarN = 0;
      @sysvar::XCP::RadarFC_Obj::_g_PL_AD_fw_Radar_1R1V_rpc_XilObjBypassingRunnable_XilObjBypassingRunnable_m_pad_radarObjPort_par_out_local::TChangeableMemPool::_::_::_m_arrayPool::_0_::_elem::_m_objectInformation::_6_::_m_perObjectType::_m_prob1TruckN = 0;
      @sysvar::XCP::RadarFC_Obj::_g_PL_AD_fw_Radar_1R1V_rpc_XilObjBypassingRunnable_XilObjBypassingRunnable_m_pad_radarObjPort_par_out_local::TChangeableMemPool::_::_::_m_arrayPool::_0_::_elem::_m_objectInformation::_6_::_m_perObjectType::_m_prob1FourWheelUnknownN = 128;
      @sysvar::XCP::RadarFC_Obj::_g_PL_AD_fw_Radar_1R1V_rpc_XilObjBypassingRunnable_XilObjBypassingRunnable_m_pad_radarObjPort_par_out_local::TChangeableMemPool::_::_::_m_arrayPool::_0_::_elem::_m_objectInformation::_6_::_m_dWidthN = 64;
        break;

      case 5: //"Truck"
      @sysvar::XCP::RadarFC_Obj::_g_PL_AD_fw_Radar_1R1V_rpc_XilObjBypassingRunnable_XilObjBypassingRunnable_m_pad_radarObjPort_par_out_local::TChangeableMemPool::_::_::_m_arrayPool::_0_::_elem::_m_objectInformation::_6_::_m_perObjectType::_m_prob1ObstacleN = 128;
      @sysvar::XCP::RadarFC_Obj::_g_PL_AD_fw_Radar_1R1V_rpc_XilObjBypassingRunnable_XilObjBypassingRunnable_m_pad_radarObjPort_par_out_local::TChangeableMemPool::_::_::_m_arrayPool::_0_::_elem::_m_objectInformation::_6_::_m_perObjectType::_m_prob1NonObstacleN = 0;
      @sysvar::XCP::RadarFC_Obj::_g_PL_AD_fw_Radar_1R1V_rpc_XilObjBypassingRunnable_XilObjBypassingRunnable_m_pad_radarObjPort_par_out_local::TChangeableMemPool::_::_::_m_arrayPool::_0_::_elem::_m_objectInformation::_6_::_m_perObjectType::_m_prob1UnknownN = 0;
      @sysvar::XCP::RadarFC_Obj::_g_PL_AD_fw_Radar_1R1V_rpc_XilObjBypassingRunnable_XilObjBypassingRunnable_m_pad_radarObjPort_par_out_local::TChangeableMemPool::_::_::_m_arrayPool::_0_::_elem::_m_objectInformation::_6_::_m_perObjectType::_m_prob1MobileN = 128;
      @sysvar::XCP::RadarFC_Obj::_g_PL_AD_fw_Radar_1R1V_rpc_XilObjBypassingRunnable_XilObjBypassingRunnable_m_pad_radarObjPort_par_out_local::TChangeableMemPool::_::_::_m_arrayPool::_0_::_elem::_m_objectInformation::_6_::_m_perObjectType::_m_prob1StationaryN = 0;
      @sysvar::XCP::RadarFC_Obj::_g_PL_AD_fw_Radar_1R1V_rpc_XilObjBypassingRunnable_XilObjBypassingRunnable_m_pad_radarObjPort_par_out_local::TChangeableMemPool::_::_::_m_arrayPool::_0_::_elem::_m_objectInformation::_6_::_m_perObjectType::_m_prob1ObstUnknownN = 0;
      @sysvar::XCP::RadarFC_Obj::_g_PL_AD_fw_Radar_1R1V_rpc_XilObjBypassingRunnable_XilObjBypassingRunnable_m_pad_radarObjPort_par_out_local::TChangeableMemPool::_::_::_m_arrayPool::_0_::_elem::_m_objectInformation::_6_::_m_perObjectType::_m_prob1FourPlusWheelerN = 128;
      @sysvar::XCP::RadarFC_Obj::_g_PL_AD_fw_Radar_1R1V_rpc_XilObjBypassingRunnable_XilObjBypassingRunnable_m_pad_radarObjPort_par_out_local::TChangeableMemPool::_::_::_m_arrayPool::_0_::_elem::_m_objectInformation::_6_::_m_perObjectType::_m_prob1TwoWheelerN = 0;
      @sysvar::XCP::RadarFC_Obj::_g_PL_AD_fw_Radar_1R1V_rpc_XilObjBypassingRunnable_XilObjBypassingRunnable_m_pad_radarObjPort_par_out_local::TChangeableMemPool::_::_::_m_arrayPool::_0_::_elem::_m_objectInformation::_6_::_m_perObjectType::_m_prob1PedestrianN = 0;
      @sysvar::XCP::RadarFC_Obj::_g_PL_AD_fw_Radar_1R1V_rpc_XilObjBypassingRunnable_XilObjBypassingRunnable_m_pad_radarObjPort_par_out_local::TChangeableMemPool::_::_::_m_arrayPool::_0_::_elem::_m_objectInformation::_6_::_m_perObjectType::_m_prob1MovUnknownN = 0;
      @sysvar::XCP::RadarFC_Obj::_g_PL_AD_fw_Radar_1R1V_rpc_XilObjBypassingRunnable_XilObjBypassingRunnable_m_pad_radarObjPort_par_out_local::TChangeableMemPool::_::_::_m_arrayPool::_0_::_elem::_m_objectInformation::_6_::_m_perObjectType::_m_prob1RoadsideBarrierN = 0;
      @sysvar::XCP::RadarFC_Obj::_g_PL_AD_fw_Radar_1R1V_rpc_XilObjBypassingRunnable_XilObjBypassingRunnable_m_pad_radarObjPort_par_out_local::TChangeableMemPool::_::_::_m_arrayPool::_0_::_elem::_m_objectInformation::_6_::_m_perObjectType::_m_prob1StatUnknownN = 128;
      @sysvar::XCP::RadarFC_Obj::_g_PL_AD_fw_Radar_1R1V_rpc_XilObjBypassingRunnable_XilObjBypassingRunnable_m_pad_radarObjPort_par_out_local::TChangeableMemPool::_::_::_m_arrayPool::_0_::_elem::_m_objectInformation::_6_::_m_perObjectType::_m_prob1PassengerCarN = 0;
      @sysvar::XCP::RadarFC_Obj::_g_PL_AD_fw_Radar_1R1V_rpc_XilObjBypassingRunnable_XilObjBypassingRunnable_m_pad_radarObjPort_par_out_local::TChangeableMemPool::_::_::_m_arrayPool::_0_::_elem::_m_objectInformation::_6_::_m_perObjectType::_m_prob1TruckN = 128;
      @sysvar::XCP::RadarFC_Obj::_g_PL_AD_fw_Radar_1R1V_rpc_XilObjBypassingRunnable_XilObjBypassingRunnable_m_pad_radarObjPort_par_out_local::TChangeableMemPool::_::_::_m_arrayPool::_0_::_elem::_m_objectInformation::_6_::_m_perObjectType::_m_prob1FourWheelUnknownN = 0;
      @sysvar::XCP::RadarFC_Obj::_g_PL_AD_fw_Radar_1R1V_rpc_XilObjBypassingRunnable_XilObjBypassingRunnable_m_pad_radarObjPort_par_out_local::TChangeableMemPool::_::_::_m_arrayPool::_0_::_elem::_m_objectInformation::_6_::_m_dWidthN = 256;
        break;

      case 6: //"PassengerCar"
      @sysvar::XCP::RadarFC_Obj::_g_PL_AD_fw_Radar_1R1V_rpc_XilObjBypassingRunnable_XilObjBypassingRunnable_m_pad_radarObjPort_par_out_local::TChangeableMemPool::_::_::_m_arrayPool::_0_::_elem::_m_objectInformation::_6_::_m_perObjectType::_m_prob1ObstacleN = 128;
      @sysvar::XCP::RadarFC_Obj::_g_PL_AD_fw_Radar_1R1V_rpc_XilObjBypassingRunnable_XilObjBypassingRunnable_m_pad_radarObjPort_par_out_local::TChangeableMemPool::_::_::_m_arrayPool::_0_::_elem::_m_objectInformation::_6_::_m_perObjectType::_m_prob1NonObstacleN = 0;
      @sysvar::XCP::RadarFC_Obj::_g_PL_AD_fw_Radar_1R1V_rpc_XilObjBypassingRunnable_XilObjBypassingRunnable_m_pad_radarObjPort_par_out_local::TChangeableMemPool::_::_::_m_arrayPool::_0_::_elem::_m_objectInformation::_6_::_m_perObjectType::_m_prob1UnknownN = 0;
      @sysvar::XCP::RadarFC_Obj::_g_PL_AD_fw_Radar_1R1V_rpc_XilObjBypassingRunnable_XilObjBypassingRunnable_m_pad_radarObjPort_par_out_local::TChangeableMemPool::_::_::_m_arrayPool::_0_::_elem::_m_objectInformation::_6_::_m_perObjectType::_m_prob1MobileN = 128;
      @sysvar::XCP::RadarFC_Obj::_g_PL_AD_fw_Radar_1R1V_rpc_XilObjBypassingRunnable_XilObjBypassingRunnable_m_pad_radarObjPort_par_out_local::TChangeableMemPool::_::_::_m_arrayPool::_0_::_elem::_m_objectInformation::_6_::_m_perObjectType::_m_prob1StationaryN = 0;
      @sysvar::XCP::RadarFC_Obj::_g_PL_AD_fw_Radar_1R1V_rpc_XilObjBypassingRunnable_XilObjBypassingRunnable_m_pad_radarObjPort_par_out_local::TChangeableMemPool::_::_::_m_arrayPool::_0_::_elem::_m_objectInformation::_6_::_m_perObjectType::_m_prob1ObstUnknownN = 0;
      @sysvar::XCP::RadarFC_Obj::_g_PL_AD_fw_Radar_1R1V_rpc_XilObjBypassingRunnable_XilObjBypassingRunnable_m_pad_radarObjPort_par_out_local::TChangeableMemPool::_::_::_m_arrayPool::_0_::_elem::_m_objectInformation::_6_::_m_perObjectType::_m_prob1FourPlusWheelerN = 128;
      @sysvar::XCP::RadarFC_Obj::_g_PL_AD_fw_Radar_1R1V_rpc_XilObjBypassingRunnable_XilObjBypassingRunnable_m_pad_radarObjPort_par_out_local::TChangeableMemPool::_::_::_m_arrayPool::_0_::_elem::_m_objectInformation::_6_::_m_perObjectType::_m_prob1TwoWheelerN = 0;
      @sysvar::XCP::RadarFC_Obj::_g_PL_AD_fw_Radar_1R1V_rpc_XilObjBypassingRunnable_XilObjBypassingRunnable_m_pad_radarObjPort_par_out_local::TChangeableMemPool::_::_::_m_arrayPool::_0_::_elem::_m_objectInformation::_6_::_m_perObjectType::_m_prob1PedestrianN = 0;
      @sysvar::XCP::RadarFC_Obj::_g_PL_AD_fw_Radar_1R1V_rpc_XilObjBypassingRunnable_XilObjBypassingRunnable_m_pad_radarObjPort_par_out_local::TChangeableMemPool::_::_::_m_arrayPool::_0_::_elem::_m_objectInformation::_6_::_m_perObjectType::_m_prob1MovUnknownN = 0;
      @sysvar::XCP::RadarFC_Obj::_g_PL_AD_fw_Radar_1R1V_rpc_XilObjBypassingRunnable_XilObjBypassingRunnable_m_pad_radarObjPort_par_out_local::TChangeableMemPool::_::_::_m_arrayPool::_0_::_elem::_m_objectInformation::_6_::_m_perObjectType::_m_prob1RoadsideBarrierN = 0;
      @sysvar::XCP::RadarFC_Obj::_g_PL_AD_fw_Radar_1R1V_rpc_XilObjBypassingRunnable_XilObjBypassingRunnable_m_pad_radarObjPort_par_out_local::TChangeableMemPool::_::_::_m_arrayPool::_0_::_elem::_m_objectInformation::_6_::_m_perObjectType::_m_prob1StatUnknownN = 128;
      @sysvar::XCP::RadarFC_Obj::_g_PL_AD_fw_Radar_1R1V_rpc_XilObjBypassingRunnable_XilObjBypassingRunnable_m_pad_radarObjPort_par_out_local::TChangeableMemPool::_::_::_m_arrayPool::_0_::_elem::_m_objectInformation::_6_::_m_perObjectType::_m_prob1PassengerCarN = 128;
      @sysvar::XCP::RadarFC_Obj::_g_PL_AD_fw_Radar_1R1V_rpc_XilObjBypassingRunnable_XilObjBypassingRunnable_m_pad_radarObjPort_par_out_local::TChangeableMemPool::_::_::_m_arrayPool::_0_::_elem::_m_objectInformation::_6_::_m_perObjectType::_m_prob1TruckN = 0;
      @sysvar::XCP::RadarFC_Obj::_g_PL_AD_fw_Radar_1R1V_rpc_XilObjBypassingRunnable_XilObjBypassingRunnable_m_pad_radarObjPort_par_out_local::TChangeableMemPool::_::_::_m_arrayPool::_0_::_elem::_m_objectInformation::_6_::_m_perObjectType::_m_prob1FourWheelUnknownN = 0;
      @sysvar::XCP::RadarFC_Obj::_g_PL_AD_fw_Radar_1R1V_rpc_XilObjBypassingRunnable_XilObjBypassingRunnable_m_pad_radarObjPort_par_out_local::TChangeableMemPool::_::_::_m_arrayPool::_0_::_elem::_m_objectInformation::_6_::_m_dWidthN = 256;
        break;
    }
    break;

    case 7: //"Object-7"
    //constant
  @sysvar::XCP::RadarFC_Obj::_g_PL_AD_fw_Radar_1R1V_rpc_XilObjBypassingRunnable_XilObjBypassingRunnable_m_pad_radarObjPort_par_out_local::TChangeableMemPool::_::_::_m_arrayPool::_0_::_elem::_m_objectInformation::_7_::_Valid_b = 1;
  @sysvar::XCP::RadarFC_Obj::_g_PL_AD_fw_Radar_1R1V_rpc_XilObjBypassingRunnable_XilObjBypassingRunnable_m_pad_radarObjPort_par_out_local::TChangeableMemPool::_::_::_m_arrayPool::_0_::_elem::_m_objectInformation::_7_::_m_HandleN = 1;
  @sysvar::XCP::RadarFC_Obj::_g_PL_AD_fw_Radar_1R1V_rpc_XilObjBypassingRunnable_XilObjBypassingRunnable_m_pad_radarObjPort_par_out_local::TChangeableMemPool::_::_::_m_arrayPool::_0_::_elem::_m_objectInformation::_7_::_m_alpPiVarYawAngleN = 0;
  @sysvar::XCP::RadarFC_Obj::_g_PL_AD_fw_Radar_1R1V_rpc_XilObjBypassingRunnable_XilObjBypassingRunnable_m_pad_radarObjPort_par_out_local::TChangeableMemPool::_::_::_m_arrayPool::_0_::_elem::_m_objectInformation::_7_::_m_alpPiYawAngleN = 0;
  @sysvar::XCP::RadarFC_Obj::_g_PL_AD_fw_Radar_1R1V_rpc_XilObjBypassingRunnable_XilObjBypassingRunnable_m_pad_radarObjPort_par_out_local::TChangeableMemPool::_::_::_m_arrayPool::_0_::_elem::_m_objectInformation::_7_::_m_varAxN = 0;
  @sysvar::XCP::RadarFC_Obj::_g_PL_AD_fw_Radar_1R1V_rpc_XilObjBypassingRunnable_XilObjBypassingRunnable_m_pad_radarObjPort_par_out_local::TChangeableMemPool::_::_::_m_arrayPool::_0_::_elem::_m_objectInformation::_7_::_m_varAyN = 0;
  @sysvar::XCP::RadarFC_Obj::_g_PL_AD_fw_Radar_1R1V_rpc_XilObjBypassingRunnable_XilObjBypassingRunnable_m_pad_radarObjPort_par_out_local::TChangeableMemPool::_::_::_m_arrayPool::_0_::_elem::_m_objectInformation::_7_::_m_varVxN = 0;
  @sysvar::XCP::RadarFC_Obj::_g_PL_AD_fw_Radar_1R1V_rpc_XilObjBypassingRunnable_XilObjBypassingRunnable_m_pad_radarObjPort_par_out_local::TChangeableMemPool::_::_::_m_arrayPool::_0_::_elem::_m_objectInformation::_7_::_m_varVyN = 0;
  @sysvar::XCP::RadarFC_Obj::_g_PL_AD_fw_Radar_1R1V_rpc_XilObjBypassingRunnable_XilObjBypassingRunnable_m_pad_radarObjPort_par_out_local::TChangeableMemPool::_::_::_m_arrayPool::_0_::_elem::_m_objectInformation::_7_::_m_varDxN = 0;
  @sysvar::XCP::RadarFC_Obj::_g_PL_AD_fw_Radar_1R1V_rpc_XilObjBypassingRunnable_XilObjBypassingRunnable_m_pad_radarObjPort_par_out_local::TChangeableMemPool::_::_::_m_arrayPool::_0_::_elem::_m_objectInformation::_7_::_m_varDyN = 0;
  @sysvar::XCP::RadarFC_Obj::_g_PL_AD_fw_Radar_1R1V_rpc_XilObjBypassingRunnable_XilObjBypassingRunnable_m_pad_radarObjPort_par_out_local::TChangeableMemPool::_::_::_m_arrayPool::_0_::_elem::_m_objectInformation::_7_::_m_dVarLengthN = 0;
  @sysvar::XCP::RadarFC_Obj::_g_PL_AD_fw_Radar_1R1V_rpc_XilObjBypassingRunnable_XilObjBypassingRunnable_m_pad_radarObjPort_par_out_local::TChangeableMemPool::_::_::_m_arrayPool::_0_::_elem::_m_objectInformation::_7_::_m_dVarWidthN = 0;
  @sysvar::XCP::RadarFC_Obj::_g_PL_AD_fw_Radar_1R1V_rpc_XilObjBypassingRunnable_XilObjBypassingRunnable_m_pad_radarObjPort_par_out_local::TChangeableMemPool::_::_::_m_arrayPool::_0_::_elem::_m_objectInformation::_7_::_m_wExistProbN = 64880;
  @sysvar::XCP::RadarFC_Obj::_g_PL_AD_fw_Radar_1R1V_rpc_XilObjBypassingRunnable_XilObjBypassingRunnable_m_pad_radarObjPort_par_out_local::TChangeableMemPool::_::_::_m_arrayPool::_0_::_elem::_m_objectInformation::_7_::_m_isObjectAsil = 1;
  @sysvar::XCP::RadarFC_Obj::_g_PL_AD_fw_Radar_1R1V_rpc_XilObjBypassingRunnable_XilObjBypassingRunnable_m_pad_radarObjPort_par_out_local::TChangeableMemPool::_::_::_m_arrayPool::_0_::_elem::_m_objectInformation::_7_::_m_dLengthN = 128;

    //target movement

  @sysvar::XCP::RadarFC_Obj::_g_PL_AD_fw_Radar_1R1V_rpc_XilObjBypassingRunnable_XilObjBypassingRunnable_m_pad_radarObjPort_par_out_local::TChangeableMemPool::_::_::_m_arrayPool::_0_::_elem::_m_objectInformation::_7_::_m_dxN = @target_radar_fc_sim::objdata.obj_distance_x[7] * 128;
  @sysvar::XCP::RadarFC_Obj::_g_PL_AD_fw_Radar_1R1V_rpc_XilObjBypassingRunnable_XilObjBypassingRunnable_m_pad_radarObjPort_par_out_local::TChangeableMemPool::_::_::_m_arrayPool::_0_::_elem::_m_objectInformation::_7_::_m_dyN = @target_radar_fc_sim::objdata.obj_distance_y[7] * 128;
  @sysvar::XCP::RadarFC_Obj::_g_PL_AD_fw_Radar_1R1V_rpc_XilObjBypassingRunnable_XilObjBypassingRunnable_m_pad_radarObjPort_par_out_local::TChangeableMemPool::_::_::_m_arrayPool::_0_::_elem::_m_objectInformation::_7_::_m_dzN = 0;
  @sysvar::XCP::RadarFC_Obj::_g_PL_AD_fw_Radar_1R1V_rpc_XilObjBypassingRunnable_XilObjBypassingRunnable_m_pad_radarObjPort_par_out_local::TChangeableMemPool::_::_::_m_arrayPool::_0_::_elem::_m_objectInformation::_7_::_m_vxN = @target_radar_fc_sim::objdata.obj_velocity_x[7] * 256;
  @sysvar::XCP::RadarFC_Obj::_g_PL_AD_fw_Radar_1R1V_rpc_XilObjBypassingRunnable_XilObjBypassingRunnable_m_pad_radarObjPort_par_out_local::TChangeableMemPool::_::_::_m_arrayPool::_0_::_elem::_m_objectInformation::_7_::_m_vyN = @target_radar_fc_sim::objdata.obj_velocity_y[7] * 256;
  @sysvar::XCP::RadarFC_Obj::_g_PL_AD_fw_Radar_1R1V_rpc_XilObjBypassingRunnable_XilObjBypassingRunnable_m_pad_radarObjPort_par_out_local::TChangeableMemPool::_::_::_m_arrayPool::_0_::_elem::_m_objectInformation::_7_::_m_axN = 0;
  @sysvar::XCP::RadarFC_Obj::_g_PL_AD_fw_Radar_1R1V_rpc_XilObjBypassingRunnable_XilObjBypassingRunnable_m_pad_radarObjPort_par_out_local::TChangeableMemPool::_::_::_m_arrayPool::_0_::_elem::_m_objectInformation::_7_::_m_ayN = 0;

    //target object moving or not
    if (abs(@target_radar_fc_sim::objdata.obj_velocity_x[7]) != 0)
    {
    @sysvar::XCP::RadarFC_Obj::_g_PL_AD_fw_Radar_1R1V_rpc_XilObjBypassingRunnable_XilObjBypassingRunnable_m_pad_radarObjPort_par_out_local::TChangeableMemPool::_::_::_m_arrayPool::_0_::_elem::_m_objectInformation::_7_::_m_prob1HasBeenObservedMovingN = 126;
    @sysvar::XCP::RadarFC_Obj::_g_PL_AD_fw_Radar_1R1V_rpc_XilObjBypassingRunnable_XilObjBypassingRunnable_m_pad_radarObjPort_par_out_local::TChangeableMemPool::_::_::_m_arrayPool::_0_::_elem::_m_objectInformation::_7_::_m_prob1MovingN = 126;
    }
    else
    {
    @sysvar::XCP::RadarFC_Obj::_g_PL_AD_fw_Radar_1R1V_rpc_XilObjBypassingRunnable_XilObjBypassingRunnable_m_pad_radarObjPort_par_out_local::TChangeableMemPool::_::_::_m_arrayPool::_0_::_elem::_m_objectInformation::_7_::_m_prob1HasBeenObservedMovingN = 0;
    @sysvar::XCP::RadarFC_Obj::_g_PL_AD_fw_Radar_1R1V_rpc_XilObjBypassingRunnable_XilObjBypassingRunnable_m_pad_radarObjPort_par_out_local::TChangeableMemPool::_::_::_m_arrayPool::_0_::_elem::_m_objectInformation::_7_::_m_prob1MovingN = 0;
    }

      //object classification
    switch (@target_radar_fc_sim::objdata.obj_type[7])
    {
      case 0: //"Non-Obstacle"
      @sysvar::XCP::RadarFC_Obj::_g_PL_AD_fw_Radar_1R1V_rpc_XilObjBypassingRunnable_XilObjBypassingRunnable_m_pad_radarObjPort_par_out_local::TChangeableMemPool::_::_::_m_arrayPool::_0_::_elem::_m_objectInformation::_7_::_m_perObjectType::_m_prob1ObstacleN = 0;
      @sysvar::XCP::RadarFC_Obj::_g_PL_AD_fw_Radar_1R1V_rpc_XilObjBypassingRunnable_XilObjBypassingRunnable_m_pad_radarObjPort_par_out_local::TChangeableMemPool::_::_::_m_arrayPool::_0_::_elem::_m_objectInformation::_7_::_m_perObjectType::_m_prob1NonObstacleN = 128;
      @sysvar::XCP::RadarFC_Obj::_g_PL_AD_fw_Radar_1R1V_rpc_XilObjBypassingRunnable_XilObjBypassingRunnable_m_pad_radarObjPort_par_out_local::TChangeableMemPool::_::_::_m_arrayPool::_0_::_elem::_m_objectInformation::_7_::_m_perObjectType::_m_prob1UnknownN = 0;
      @sysvar::XCP::RadarFC_Obj::_g_PL_AD_fw_Radar_1R1V_rpc_XilObjBypassingRunnable_XilObjBypassingRunnable_m_pad_radarObjPort_par_out_local::TChangeableMemPool::_::_::_m_arrayPool::_0_::_elem::_m_objectInformation::_7_::_m_perObjectType::_m_prob1MobileN = 0;
      @sysvar::XCP::RadarFC_Obj::_g_PL_AD_fw_Radar_1R1V_rpc_XilObjBypassingRunnable_XilObjBypassingRunnable_m_pad_radarObjPort_par_out_local::TChangeableMemPool::_::_::_m_arrayPool::_0_::_elem::_m_objectInformation::_7_::_m_perObjectType::_m_prob1StationaryN = 0;
      @sysvar::XCP::RadarFC_Obj::_g_PL_AD_fw_Radar_1R1V_rpc_XilObjBypassingRunnable_XilObjBypassingRunnable_m_pad_radarObjPort_par_out_local::TChangeableMemPool::_::_::_m_arrayPool::_0_::_elem::_m_objectInformation::_7_::_m_perObjectType::_m_prob1ObstUnknownN = 128;
      @sysvar::XCP::RadarFC_Obj::_g_PL_AD_fw_Radar_1R1V_rpc_XilObjBypassingRunnable_XilObjBypassingRunnable_m_pad_radarObjPort_par_out_local::TChangeableMemPool::_::_::_m_arrayPool::_0_::_elem::_m_objectInformation::_7_::_m_perObjectType::_m_prob1FourPlusWheelerN = 0;
      @sysvar::XCP::RadarFC_Obj::_g_PL_AD_fw_Radar_1R1V_rpc_XilObjBypassingRunnable_XilObjBypassingRunnable_m_pad_radarObjPort_par_out_local::TChangeableMemPool::_::_::_m_arrayPool::_0_::_elem::_m_objectInformation::_7_::_m_perObjectType::_m_prob1TwoWheelerN = 0;
      @sysvar::XCP::RadarFC_Obj::_g_PL_AD_fw_Radar_1R1V_rpc_XilObjBypassingRunnable_XilObjBypassingRunnable_m_pad_radarObjPort_par_out_local::TChangeableMemPool::_::_::_m_arrayPool::_0_::_elem::_m_objectInformation::_7_::_m_perObjectType::_m_prob1PedestrianN = 0;
      @sysvar::XCP::RadarFC_Obj::_g_PL_AD_fw_Radar_1R1V_rpc_XilObjBypassingRunnable_XilObjBypassingRunnable_m_pad_radarObjPort_par_out_local::TChangeableMemPool::_::_::_m_arrayPool::_0_::_elem::_m_objectInformation::_7_::_m_perObjectType::_m_prob1MovUnknownN = 128;
      @sysvar::XCP::RadarFC_Obj::_g_PL_AD_fw_Radar_1R1V_rpc_XilObjBypassingRunnable_XilObjBypassingRunnable_m_pad_radarObjPort_par_out_local::TChangeableMemPool::_::_::_m_arrayPool::_0_::_elem::_m_objectInformation::_7_::_m_perObjectType::_m_prob1RoadsideBarrierN = 0;
      @sysvar::XCP::RadarFC_Obj::_g_PL_AD_fw_Radar_1R1V_rpc_XilObjBypassingRunnable_XilObjBypassingRunnable_m_pad_radarObjPort_par_out_local::TChangeableMemPool::_::_::_m_arrayPool::_0_::_elem::_m_objectInformation::_7_::_m_perObjectType::_m_prob1StatUnknownN = 128;
      @sysvar::XCP::RadarFC_Obj::_g_PL_AD_fw_Radar_1R1V_rpc_XilObjBypassingRunnable_XilObjBypassingRunnable_m_pad_radarObjPort_par_out_local::TChangeableMemPool::_::_::_m_arrayPool::_0_::_elem::_m_objectInformation::_7_::_m_perObjectType::_m_prob1PassengerCarN = 0;
      @sysvar::XCP::RadarFC_Obj::_g_PL_AD_fw_Radar_1R1V_rpc_XilObjBypassingRunnable_XilObjBypassingRunnable_m_pad_radarObjPort_par_out_local::TChangeableMemPool::_::_::_m_arrayPool::_0_::_elem::_m_objectInformation::_7_::_m_perObjectType::_m_prob1TruckN = 0;
      @sysvar::XCP::RadarFC_Obj::_g_PL_AD_fw_Radar_1R1V_rpc_XilObjBypassingRunnable_XilObjBypassingRunnable_m_pad_radarObjPort_par_out_local::TChangeableMemPool::_::_::_m_arrayPool::_0_::_elem::_m_objectInformation::_7_::_m_perObjectType::_m_prob1FourWheelUnknownN = 128;
      @sysvar::XCP::RadarFC_Obj::_g_PL_AD_fw_Radar_1R1V_rpc_XilObjBypassingRunnable_XilObjBypassingRunnable_m_pad_radarObjPort_par_out_local::TChangeableMemPool::_::_::_m_arrayPool::_0_::_elem::_m_objectInformation::_7_::_m_dWidthN = 256;
        break;

      case 1: //"unknown"
      @sysvar::XCP::RadarFC_Obj::_g_PL_AD_fw_Radar_1R1V_rpc_XilObjBypassingRunnable_XilObjBypassingRunnable_m_pad_radarObjPort_par_out_local::TChangeableMemPool::_::_::_m_arrayPool::_0_::_elem::_m_objectInformation::_7_::_m_perObjectType::_m_prob1ObstacleN = 0;
      @sysvar::XCP::RadarFC_Obj::_g_PL_AD_fw_Radar_1R1V_rpc_XilObjBypassingRunnable_XilObjBypassingRunnable_m_pad_radarObjPort_par_out_local::TChangeableMemPool::_::_::_m_arrayPool::_0_::_elem::_m_objectInformation::_7_::_m_perObjectType::_m_prob1NonObstacleN = 0;
      @sysvar::XCP::RadarFC_Obj::_g_PL_AD_fw_Radar_1R1V_rpc_XilObjBypassingRunnable_XilObjBypassingRunnable_m_pad_radarObjPort_par_out_local::TChangeableMemPool::_::_::_m_arrayPool::_0_::_elem::_m_objectInformation::_7_::_m_perObjectType::_m_prob1UnknownN = 128;
      @sysvar::XCP::RadarFC_Obj::_g_PL_AD_fw_Radar_1R1V_rpc_XilObjBypassingRunnable_XilObjBypassingRunnable_m_pad_radarObjPort_par_out_local::TChangeableMemPool::_::_::_m_arrayPool::_0_::_elem::_m_objectInformation::_7_::_m_perObjectType::_m_prob1MobileN = 0;
      @sysvar::XCP::RadarFC_Obj::_g_PL_AD_fw_Radar_1R1V_rpc_XilObjBypassingRunnable_XilObjBypassingRunnable_m_pad_radarObjPort_par_out_local::TChangeableMemPool::_::_::_m_arrayPool::_0_::_elem::_m_objectInformation::_7_::_m_perObjectType::_m_prob1StationaryN = 0;
      @sysvar::XCP::RadarFC_Obj::_g_PL_AD_fw_Radar_1R1V_rpc_XilObjBypassingRunnable_XilObjBypassingRunnable_m_pad_radarObjPort_par_out_local::TChangeableMemPool::_::_::_m_arrayPool::_0_::_elem::_m_objectInformation::_7_::_m_perObjectType::_m_prob1ObstUnknownN = 128;
      @sysvar::XCP::RadarFC_Obj::_g_PL_AD_fw_Radar_1R1V_rpc_XilObjBypassingRunnable_XilObjBypassingRunnable_m_pad_radarObjPort_par_out_local::TChangeableMemPool::_::_::_m_arrayPool::_0_::_elem::_m_objectInformation::_7_::_m_perObjectType::_m_prob1FourPlusWheelerN = 0;
      @sysvar::XCP::RadarFC_Obj::_g_PL_AD_fw_Radar_1R1V_rpc_XilObjBypassingRunnable_XilObjBypassingRunnable_m_pad_radarObjPort_par_out_local::TChangeableMemPool::_::_::_m_arrayPool::_0_::_elem::_m_objectInformation::_7_::_m_perObjectType::_m_prob1TwoWheelerN = 0;
      @sysvar::XCP::RadarFC_Obj::_g_PL_AD_fw_Radar_1R1V_rpc_XilObjBypassingRunnable_XilObjBypassingRunnable_m_pad_radarObjPort_par_out_local::TChangeableMemPool::_::_::_m_arrayPool::_0_::_elem::_m_objectInformation::_7_::_m_perObjectType::_m_prob1PedestrianN = 0;
      @sysvar::XCP::RadarFC_Obj::_g_PL_AD_fw_Radar_1R1V_rpc_XilObjBypassingRunnable_XilObjBypassingRunnable_m_pad_radarObjPort_par_out_local::TChangeableMemPool::_::_::_m_arrayPool::_0_::_elem::_m_objectInformation::_7_::_m_perObjectType::_m_prob1MovUnknownN = 128;
      @sysvar::XCP::RadarFC_Obj::_g_PL_AD_fw_Radar_1R1V_rpc_XilObjBypassingRunnable_XilObjBypassingRunnable_m_pad_radarObjPort_par_out_local::TChangeableMemPool::_::_::_m_arrayPool::_0_::_elem::_m_objectInformation::_7_::_m_perObjectType::_m_prob1RoadsideBarrierN = 0;
      @sysvar::XCP::RadarFC_Obj::_g_PL_AD_fw_Radar_1R1V_rpc_XilObjBypassingRunnable_XilObjBypassingRunnable_m_pad_radarObjPort_par_out_local::TChangeableMemPool::_::_::_m_arrayPool::_0_::_elem::_m_objectInformation::_7_::_m_perObjectType::_m_prob1StatUnknownN = 128;
      @sysvar::XCP::RadarFC_Obj::_g_PL_AD_fw_Radar_1R1V_rpc_XilObjBypassingRunnable_XilObjBypassingRunnable_m_pad_radarObjPort_par_out_local::TChangeableMemPool::_::_::_m_arrayPool::_0_::_elem::_m_objectInformation::_7_::_m_perObjectType::_m_prob1PassengerCarN = 0;
      @sysvar::XCP::RadarFC_Obj::_g_PL_AD_fw_Radar_1R1V_rpc_XilObjBypassingRunnable_XilObjBypassingRunnable_m_pad_radarObjPort_par_out_local::TChangeableMemPool::_::_::_m_arrayPool::_0_::_elem::_m_objectInformation::_7_::_m_perObjectType::_m_prob1TruckN = 0;
      @sysvar::XCP::RadarFC_Obj::_g_PL_AD_fw_Radar_1R1V_rpc_XilObjBypassingRunnable_XilObjBypassingRunnable_m_pad_radarObjPort_par_out_local::TChangeableMemPool::_::_::_m_arrayPool::_0_::_elem::_m_objectInformation::_7_::_m_perObjectType::_m_prob1FourWheelUnknownN = 128;
      @sysvar::XCP::RadarFC_Obj::_g_PL_AD_fw_Radar_1R1V_rpc_XilObjBypassingRunnable_XilObjBypassingRunnable_m_pad_radarObjPort_par_out_local::TChangeableMemPool::_::_::_m_arrayPool::_0_::_elem::_m_objectInformation::_7_::_m_dWidthN = 256;
        break;

      case 2: //"RoadSideBarrier"
      @sysvar::XCP::RadarFC_Obj::_g_PL_AD_fw_Radar_1R1V_rpc_XilObjBypassingRunnable_XilObjBypassingRunnable_m_pad_radarObjPort_par_out_local::TChangeableMemPool::_::_::_m_arrayPool::_0_::_elem::_m_objectInformation::_7_::_m_perObjectType::_m_prob1ObstacleN = 128;
      @sysvar::XCP::RadarFC_Obj::_g_PL_AD_fw_Radar_1R1V_rpc_XilObjBypassingRunnable_XilObjBypassingRunnable_m_pad_radarObjPort_par_out_local::TChangeableMemPool::_::_::_m_arrayPool::_0_::_elem::_m_objectInformation::_7_::_m_perObjectType::_m_prob1NonObstacleN = 0;
      @sysvar::XCP::RadarFC_Obj::_g_PL_AD_fw_Radar_1R1V_rpc_XilObjBypassingRunnable_XilObjBypassingRunnable_m_pad_radarObjPort_par_out_local::TChangeableMemPool::_::_::_m_arrayPool::_0_::_elem::_m_objectInformation::_7_::_m_perObjectType::_m_prob1UnknownN = 0;
      @sysvar::XCP::RadarFC_Obj::_g_PL_AD_fw_Radar_1R1V_rpc_XilObjBypassingRunnable_XilObjBypassingRunnable_m_pad_radarObjPort_par_out_local::TChangeableMemPool::_::_::_m_arrayPool::_0_::_elem::_m_objectInformation::_7_::_m_perObjectType::_m_prob1MobileN = 0;
      @sysvar::XCP::RadarFC_Obj::_g_PL_AD_fw_Radar_1R1V_rpc_XilObjBypassingRunnable_XilObjBypassingRunnable_m_pad_radarObjPort_par_out_local::TChangeableMemPool::_::_::_m_arrayPool::_0_::_elem::_m_objectInformation::_7_::_m_perObjectType::_m_prob1StationaryN = 128;
      @sysvar::XCP::RadarFC_Obj::_g_PL_AD_fw_Radar_1R1V_rpc_XilObjBypassingRunnable_XilObjBypassingRunnable_m_pad_radarObjPort_par_out_local::TChangeableMemPool::_::_::_m_arrayPool::_0_::_elem::_m_objectInformation::_7_::_m_perObjectType::_m_prob1ObstUnknownN = 0;
      @sysvar::XCP::RadarFC_Obj::_g_PL_AD_fw_Radar_1R1V_rpc_XilObjBypassingRunnable_XilObjBypassingRunnable_m_pad_radarObjPort_par_out_local::TChangeableMemPool::_::_::_m_arrayPool::_0_::_elem::_m_objectInformation::_7_::_m_perObjectType::_m_prob1FourPlusWheelerN = 0;
      @sysvar::XCP::RadarFC_Obj::_g_PL_AD_fw_Radar_1R1V_rpc_XilObjBypassingRunnable_XilObjBypassingRunnable_m_pad_radarObjPort_par_out_local::TChangeableMemPool::_::_::_m_arrayPool::_0_::_elem::_m_objectInformation::_7_::_m_perObjectType::_m_prob1TwoWheelerN = 0;
      @sysvar::XCP::RadarFC_Obj::_g_PL_AD_fw_Radar_1R1V_rpc_XilObjBypassingRunnable_XilObjBypassingRunnable_m_pad_radarObjPort_par_out_local::TChangeableMemPool::_::_::_m_arrayPool::_0_::_elem::_m_objectInformation::_7_::_m_perObjectType::_m_prob1PedestrianN = 0;
      @sysvar::XCP::RadarFC_Obj::_g_PL_AD_fw_Radar_1R1V_rpc_XilObjBypassingRunnable_XilObjBypassingRunnable_m_pad_radarObjPort_par_out_local::TChangeableMemPool::_::_::_m_arrayPool::_0_::_elem::_m_objectInformation::_7_::_m_perObjectType::_m_prob1MovUnknownN = 128;
      @sysvar::XCP::RadarFC_Obj::_g_PL_AD_fw_Radar_1R1V_rpc_XilObjBypassingRunnable_XilObjBypassingRunnable_m_pad_radarObjPort_par_out_local::TChangeableMemPool::_::_::_m_arrayPool::_0_::_elem::_m_objectInformation::_7_::_m_perObjectType::_m_prob1RoadsideBarrierN = 128;
      @sysvar::XCP::RadarFC_Obj::_g_PL_AD_fw_Radar_1R1V_rpc_XilObjBypassingRunnable_XilObjBypassingRunnable_m_pad_radarObjPort_par_out_local::TChangeableMemPool::_::_::_m_arrayPool::_0_::_elem::_m_objectInformation::_7_::_m_perObjectType::_m_prob1StatUnknownN = 0;
      @sysvar::XCP::RadarFC_Obj::_g_PL_AD_fw_Radar_1R1V_rpc_XilObjBypassingRunnable_XilObjBypassingRunnable_m_pad_radarObjPort_par_out_local::TChangeableMemPool::_::_::_m_arrayPool::_0_::_elem::_m_objectInformation::_7_::_m_perObjectType::_m_prob1PassengerCarN = 0;
      @sysvar::XCP::RadarFC_Obj::_g_PL_AD_fw_Radar_1R1V_rpc_XilObjBypassingRunnable_XilObjBypassingRunnable_m_pad_radarObjPort_par_out_local::TChangeableMemPool::_::_::_m_arrayPool::_0_::_elem::_m_objectInformation::_7_::_m_perObjectType::_m_prob1TruckN = 0;
      @sysvar::XCP::RadarFC_Obj::_g_PL_AD_fw_Radar_1R1V_rpc_XilObjBypassingRunnable_XilObjBypassingRunnable_m_pad_radarObjPort_par_out_local::TChangeableMemPool::_::_::_m_arrayPool::_0_::_elem::_m_objectInformation::_7_::_m_perObjectType::_m_prob1FourWheelUnknownN = 128;
      @sysvar::XCP::RadarFC_Obj::_g_PL_AD_fw_Radar_1R1V_rpc_XilObjBypassingRunnable_XilObjBypassingRunnable_m_pad_radarObjPort_par_out_local::TChangeableMemPool::_::_::_m_arrayPool::_0_::_elem::_m_objectInformation::_7_::_m_dWidthN = 256;
        break;

      case 3: //"2Wheeler"
      @sysvar::XCP::RadarFC_Obj::_g_PL_AD_fw_Radar_1R1V_rpc_XilObjBypassingRunnable_XilObjBypassingRunnable_m_pad_radarObjPort_par_out_local::TChangeableMemPool::_::_::_m_arrayPool::_0_::_elem::_m_objectInformation::_7_::_m_perObjectType::_m_prob1ObstacleN = 128;
      @sysvar::XCP::RadarFC_Obj::_g_PL_AD_fw_Radar_1R1V_rpc_XilObjBypassingRunnable_XilObjBypassingRunnable_m_pad_radarObjPort_par_out_local::TChangeableMemPool::_::_::_m_arrayPool::_0_::_elem::_m_objectInformation::_7_::_m_perObjectType::_m_prob1NonObstacleN = 0;
      @sysvar::XCP::RadarFC_Obj::_g_PL_AD_fw_Radar_1R1V_rpc_XilObjBypassingRunnable_XilObjBypassingRunnable_m_pad_radarObjPort_par_out_local::TChangeableMemPool::_::_::_m_arrayPool::_0_::_elem::_m_objectInformation::_7_::_m_perObjectType::_m_prob1UnknownN = 0;
      @sysvar::XCP::RadarFC_Obj::_g_PL_AD_fw_Radar_1R1V_rpc_XilObjBypassingRunnable_XilObjBypassingRunnable_m_pad_radarObjPort_par_out_local::TChangeableMemPool::_::_::_m_arrayPool::_0_::_elem::_m_objectInformation::_7_::_m_perObjectType::_m_prob1MobileN = 128;
      @sysvar::XCP::RadarFC_Obj::_g_PL_AD_fw_Radar_1R1V_rpc_XilObjBypassingRunnable_XilObjBypassingRunnable_m_pad_radarObjPort_par_out_local::TChangeableMemPool::_::_::_m_arrayPool::_0_::_elem::_m_objectInformation::_7_::_m_perObjectType::_m_prob1StationaryN = 0;
      @sysvar::XCP::RadarFC_Obj::_g_PL_AD_fw_Radar_1R1V_rpc_XilObjBypassingRunnable_XilObjBypassingRunnable_m_pad_radarObjPort_par_out_local::TChangeableMemPool::_::_::_m_arrayPool::_0_::_elem::_m_objectInformation::_7_::_m_perObjectType::_m_prob1ObstUnknownN = 0;
      @sysvar::XCP::RadarFC_Obj::_g_PL_AD_fw_Radar_1R1V_rpc_XilObjBypassingRunnable_XilObjBypassingRunnable_m_pad_radarObjPort_par_out_local::TChangeableMemPool::_::_::_m_arrayPool::_0_::_elem::_m_objectInformation::_7_::_m_perObjectType::_m_prob1FourPlusWheelerN = 0;
      @sysvar::XCP::RadarFC_Obj::_g_PL_AD_fw_Radar_1R1V_rpc_XilObjBypassingRunnable_XilObjBypassingRunnable_m_pad_radarObjPort_par_out_local::TChangeableMemPool::_::_::_m_arrayPool::_0_::_elem::_m_objectInformation::_7_::_m_perObjectType::_m_prob1TwoWheelerN = 128;
      @sysvar::XCP::RadarFC_Obj::_g_PL_AD_fw_Radar_1R1V_rpc_XilObjBypassingRunnable_XilObjBypassingRunnable_m_pad_radarObjPort_par_out_local::TChangeableMemPool::_::_::_m_arrayPool::_0_::_elem::_m_objectInformation::_7_::_m_perObjectType::_m_prob1PedestrianN = 0;
      @sysvar::XCP::RadarFC_Obj::_g_PL_AD_fw_Radar_1R1V_rpc_XilObjBypassingRunnable_XilObjBypassingRunnable_m_pad_radarObjPort_par_out_local::TChangeableMemPool::_::_::_m_arrayPool::_0_::_elem::_m_objectInformation::_7_::_m_perObjectType::_m_prob1MovUnknownN = 0;
      @sysvar::XCP::RadarFC_Obj::_g_PL_AD_fw_Radar_1R1V_rpc_XilObjBypassingRunnable_XilObjBypassingRunnable_m_pad_radarObjPort_par_out_local::TChangeableMemPool::_::_::_m_arrayPool::_0_::_elem::_m_objectInformation::_7_::_m_perObjectType::_m_prob1RoadsideBarrierN = 0;
      @sysvar::XCP::RadarFC_Obj::_g_PL_AD_fw_Radar_1R1V_rpc_XilObjBypassingRunnable_XilObjBypassingRunnable_m_pad_radarObjPort_par_out_local::TChangeableMemPool::_::_::_m_arrayPool::_0_::_elem::_m_objectInformation::_7_::_m_perObjectType::_m_prob1StatUnknownN = 128;
      @sysvar::XCP::RadarFC_Obj::_g_PL_AD_fw_Radar_1R1V_rpc_XilObjBypassingRunnable_XilObjBypassingRunnable_m_pad_radarObjPort_par_out_local::TChangeableMemPool::_::_::_m_arrayPool::_0_::_elem::_m_objectInformation::_7_::_m_perObjectType::_m_prob1PassengerCarN = 0;
      @sysvar::XCP::RadarFC_Obj::_g_PL_AD_fw_Radar_1R1V_rpc_XilObjBypassingRunnable_XilObjBypassingRunnable_m_pad_radarObjPort_par_out_local::TChangeableMemPool::_::_::_m_arrayPool::_0_::_elem::_m_objectInformation::_7_::_m_perObjectType::_m_prob1TruckN = 0;
      @sysvar::XCP::RadarFC_Obj::_g_PL_AD_fw_Radar_1R1V_rpc_XilObjBypassingRunnable_XilObjBypassingRunnable_m_pad_radarObjPort_par_out_local::TChangeableMemPool::_::_::_m_arrayPool::_0_::_elem::_m_objectInformation::_7_::_m_perObjectType::_m_prob1FourWheelUnknownN = 128;
      @sysvar::XCP::RadarFC_Obj::_g_PL_AD_fw_Radar_1R1V_rpc_XilObjBypassingRunnable_XilObjBypassingRunnable_m_pad_radarObjPort_par_out_local::TChangeableMemPool::_::_::_m_arrayPool::_0_::_elem::_m_objectInformation::_7_::_m_dWidthN = 64;
        break;

      case 4: //"Pedestrian"
      @sysvar::XCP::RadarFC_Obj::_g_PL_AD_fw_Radar_1R1V_rpc_XilObjBypassingRunnable_XilObjBypassingRunnable_m_pad_radarObjPort_par_out_local::TChangeableMemPool::_::_::_m_arrayPool::_0_::_elem::_m_objectInformation::_7_::_m_perObjectType::_m_prob1ObstacleN = 128;
      @sysvar::XCP::RadarFC_Obj::_g_PL_AD_fw_Radar_1R1V_rpc_XilObjBypassingRunnable_XilObjBypassingRunnable_m_pad_radarObjPort_par_out_local::TChangeableMemPool::_::_::_m_arrayPool::_0_::_elem::_m_objectInformation::_7_::_m_perObjectType::_m_prob1NonObstacleN = 0;
      @sysvar::XCP::RadarFC_Obj::_g_PL_AD_fw_Radar_1R1V_rpc_XilObjBypassingRunnable_XilObjBypassingRunnable_m_pad_radarObjPort_par_out_local::TChangeableMemPool::_::_::_m_arrayPool::_0_::_elem::_m_objectInformation::_7_::_m_perObjectType::_m_prob1UnknownN = 0;
      @sysvar::XCP::RadarFC_Obj::_g_PL_AD_fw_Radar_1R1V_rpc_XilObjBypassingRunnable_XilObjBypassingRunnable_m_pad_radarObjPort_par_out_local::TChangeableMemPool::_::_::_m_arrayPool::_0_::_elem::_m_objectInformation::_7_::_m_perObjectType::_m_prob1MobileN = 128;
      @sysvar::XCP::RadarFC_Obj::_g_PL_AD_fw_Radar_1R1V_rpc_XilObjBypassingRunnable_XilObjBypassingRunnable_m_pad_radarObjPort_par_out_local::TChangeableMemPool::_::_::_m_arrayPool::_0_::_elem::_m_objectInformation::_7_::_m_perObjectType::_m_prob1StationaryN = 0;
      @sysvar::XCP::RadarFC_Obj::_g_PL_AD_fw_Radar_1R1V_rpc_XilObjBypassingRunnable_XilObjBypassingRunnable_m_pad_radarObjPort_par_out_local::TChangeableMemPool::_::_::_m_arrayPool::_0_::_elem::_m_objectInformation::_7_::_m_perObjectType::_m_prob1ObstUnknownN = 0;
      @sysvar::XCP::RadarFC_Obj::_g_PL_AD_fw_Radar_1R1V_rpc_XilObjBypassingRunnable_XilObjBypassingRunnable_m_pad_radarObjPort_par_out_local::TChangeableMemPool::_::_::_m_arrayPool::_0_::_elem::_m_objectInformation::_7_::_m_perObjectType::_m_prob1FourPlusWheelerN = 0;
      @sysvar::XCP::RadarFC_Obj::_g_PL_AD_fw_Radar_1R1V_rpc_XilObjBypassingRunnable_XilObjBypassingRunnable_m_pad_radarObjPort_par_out_local::TChangeableMemPool::_::_::_m_arrayPool::_0_::_elem::_m_objectInformation::_7_::_m_perObjectType::_m_prob1TwoWheelerN = 0;
      @sysvar::XCP::RadarFC_Obj::_g_PL_AD_fw_Radar_1R1V_rpc_XilObjBypassingRunnable_XilObjBypassingRunnable_m_pad_radarObjPort_par_out_local::TChangeableMemPool::_::_::_m_arrayPool::_0_::_elem::_m_objectInformation::_7_::_m_perObjectType::_m_prob1PedestrianN = 128;
      @sysvar::XCP::RadarFC_Obj::_g_PL_AD_fw_Radar_1R1V_rpc_XilObjBypassingRunnable_XilObjBypassingRunnable_m_pad_radarObjPort_par_out_local::TChangeableMemPool::_::_::_m_arrayPool::_0_::_elem::_m_objectInformation::_7_::_m_perObjectType::_m_prob1MovUnknownN = 0;
      @sysvar::XCP::RadarFC_Obj::_g_PL_AD_fw_Radar_1R1V_rpc_XilObjBypassingRunnable_XilObjBypassingRunnable_m_pad_radarObjPort_par_out_local::TChangeableMemPool::_::_::_m_arrayPool::_0_::_elem::_m_objectInformation::_7_::_m_perObjectType::_m_prob1RoadsideBarrierN = 0;
      @sysvar::XCP::RadarFC_Obj::_g_PL_AD_fw_Radar_1R1V_rpc_XilObjBypassingRunnable_XilObjBypassingRunnable_m_pad_radarObjPort_par_out_local::TChangeableMemPool::_::_::_m_arrayPool::_0_::_elem::_m_objectInformation::_7_::_m_perObjectType::_m_prob1StatUnknownN = 128;
      @sysvar::XCP::RadarFC_Obj::_g_PL_AD_fw_Radar_1R1V_rpc_XilObjBypassingRunnable_XilObjBypassingRunnable_m_pad_radarObjPort_par_out_local::TChangeableMemPool::_::_::_m_arrayPool::_0_::_elem::_m_objectInformation::_7_::_m_perObjectType::_m_prob1PassengerCarN = 0;
      @sysvar::XCP::RadarFC_Obj::_g_PL_AD_fw_Radar_1R1V_rpc_XilObjBypassingRunnable_XilObjBypassingRunnable_m_pad_radarObjPort_par_out_local::TChangeableMemPool::_::_::_m_arrayPool::_0_::_elem::_m_objectInformation::_7_::_m_perObjectType::_m_prob1TruckN = 0;
      @sysvar::XCP::RadarFC_Obj::_g_PL_AD_fw_Radar_1R1V_rpc_XilObjBypassingRunnable_XilObjBypassingRunnable_m_pad_radarObjPort_par_out_local::TChangeableMemPool::_::_::_m_arrayPool::_0_::_elem::_m_objectInformation::_7_::_m_perObjectType::_m_prob1FourWheelUnknownN = 128;
      @sysvar::XCP::RadarFC_Obj::_g_PL_AD_fw_Radar_1R1V_rpc_XilObjBypassingRunnable_XilObjBypassingRunnable_m_pad_radarObjPort_par_out_local::TChangeableMemPool::_::_::_m_arrayPool::_0_::_elem::_m_objectInformation::_7_::_m_dWidthN = 64;
        break;

      case 5: //"Truck"
      @sysvar::XCP::RadarFC_Obj::_g_PL_AD_fw_Radar_1R1V_rpc_XilObjBypassingRunnable_XilObjBypassingRunnable_m_pad_radarObjPort_par_out_local::TChangeableMemPool::_::_::_m_arrayPool::_0_::_elem::_m_objectInformation::_7_::_m_perObjectType::_m_prob1ObstacleN = 128;
      @sysvar::XCP::RadarFC_Obj::_g_PL_AD_fw_Radar_1R1V_rpc_XilObjBypassingRunnable_XilObjBypassingRunnable_m_pad_radarObjPort_par_out_local::TChangeableMemPool::_::_::_m_arrayPool::_0_::_elem::_m_objectInformation::_7_::_m_perObjectType::_m_prob1NonObstacleN = 0;
      @sysvar::XCP::RadarFC_Obj::_g_PL_AD_fw_Radar_1R1V_rpc_XilObjBypassingRunnable_XilObjBypassingRunnable_m_pad_radarObjPort_par_out_local::TChangeableMemPool::_::_::_m_arrayPool::_0_::_elem::_m_objectInformation::_7_::_m_perObjectType::_m_prob1UnknownN = 0;
      @sysvar::XCP::RadarFC_Obj::_g_PL_AD_fw_Radar_1R1V_rpc_XilObjBypassingRunnable_XilObjBypassingRunnable_m_pad_radarObjPort_par_out_local::TChangeableMemPool::_::_::_m_arrayPool::_0_::_elem::_m_objectInformation::_7_::_m_perObjectType::_m_prob1MobileN = 128;
      @sysvar::XCP::RadarFC_Obj::_g_PL_AD_fw_Radar_1R1V_rpc_XilObjBypassingRunnable_XilObjBypassingRunnable_m_pad_radarObjPort_par_out_local::TChangeableMemPool::_::_::_m_arrayPool::_0_::_elem::_m_objectInformation::_7_::_m_perObjectType::_m_prob1StationaryN = 0;
      @sysvar::XCP::RadarFC_Obj::_g_PL_AD_fw_Radar_1R1V_rpc_XilObjBypassingRunnable_XilObjBypassingRunnable_m_pad_radarObjPort_par_out_local::TChangeableMemPool::_::_::_m_arrayPool::_0_::_elem::_m_objectInformation::_7_::_m_perObjectType::_m_prob1ObstUnknownN = 0;
      @sysvar::XCP::RadarFC_Obj::_g_PL_AD_fw_Radar_1R1V_rpc_XilObjBypassingRunnable_XilObjBypassingRunnable_m_pad_radarObjPort_par_out_local::TChangeableMemPool::_::_::_m_arrayPool::_0_::_elem::_m_objectInformation::_7_::_m_perObjectType::_m_prob1FourPlusWheelerN = 128;
      @sysvar::XCP::RadarFC_Obj::_g_PL_AD_fw_Radar_1R1V_rpc_XilObjBypassingRunnable_XilObjBypassingRunnable_m_pad_radarObjPort_par_out_local::TChangeableMemPool::_::_::_m_arrayPool::_0_::_elem::_m_objectInformation::_7_::_m_perObjectType::_m_prob1TwoWheelerN = 0;
      @sysvar::XCP::RadarFC_Obj::_g_PL_AD_fw_Radar_1R1V_rpc_XilObjBypassingRunnable_XilObjBypassingRunnable_m_pad_radarObjPort_par_out_local::TChangeableMemPool::_::_::_m_arrayPool::_0_::_elem::_m_objectInformation::_7_::_m_perObjectType::_m_prob1PedestrianN = 0;
      @sysvar::XCP::RadarFC_Obj::_g_PL_AD_fw_Radar_1R1V_rpc_XilObjBypassingRunnable_XilObjBypassingRunnable_m_pad_radarObjPort_par_out_local::TChangeableMemPool::_::_::_m_arrayPool::_0_::_elem::_m_objectInformation::_7_::_m_perObjectType::_m_prob1MovUnknownN = 0;
      @sysvar::XCP::RadarFC_Obj::_g_PL_AD_fw_Radar_1R1V_rpc_XilObjBypassingRunnable_XilObjBypassingRunnable_m_pad_radarObjPort_par_out_local::TChangeableMemPool::_::_::_m_arrayPool::_0_::_elem::_m_objectInformation::_7_::_m_perObjectType::_m_prob1RoadsideBarrierN = 0;
      @sysvar::XCP::RadarFC_Obj::_g_PL_AD_fw_Radar_1R1V_rpc_XilObjBypassingRunnable_XilObjBypassingRunnable_m_pad_radarObjPort_par_out_local::TChangeableMemPool::_::_::_m_arrayPool::_0_::_elem::_m_objectInformation::_7_::_m_perObjectType::_m_prob1StatUnknownN = 128;
      @sysvar::XCP::RadarFC_Obj::_g_PL_AD_fw_Radar_1R1V_rpc_XilObjBypassingRunnable_XilObjBypassingRunnable_m_pad_radarObjPort_par_out_local::TChangeableMemPool::_::_::_m_arrayPool::_0_::_elem::_m_objectInformation::_7_::_m_perObjectType::_m_prob1PassengerCarN = 0;
      @sysvar::XCP::RadarFC_Obj::_g_PL_AD_fw_Radar_1R1V_rpc_XilObjBypassingRunnable_XilObjBypassingRunnable_m_pad_radarObjPort_par_out_local::TChangeableMemPool::_::_::_m_arrayPool::_0_::_elem::_m_objectInformation::_7_::_m_perObjectType::_m_prob1TruckN = 128;
      @sysvar::XCP::RadarFC_Obj::_g_PL_AD_fw_Radar_1R1V_rpc_XilObjBypassingRunnable_XilObjBypassingRunnable_m_pad_radarObjPort_par_out_local::TChangeableMemPool::_::_::_m_arrayPool::_0_::_elem::_m_objectInformation::_7_::_m_perObjectType::_m_prob1FourWheelUnknownN = 0;
      @sysvar::XCP::RadarFC_Obj::_g_PL_AD_fw_Radar_1R1V_rpc_XilObjBypassingRunnable_XilObjBypassingRunnable_m_pad_radarObjPort_par_out_local::TChangeableMemPool::_::_::_m_arrayPool::_0_::_elem::_m_objectInformation::_7_::_m_dWidthN = 256;
        break;

      case 6: //"PassengerCar"
      @sysvar::XCP::RadarFC_Obj::_g_PL_AD_fw_Radar_1R1V_rpc_XilObjBypassingRunnable_XilObjBypassingRunnable_m_pad_radarObjPort_par_out_local::TChangeableMemPool::_::_::_m_arrayPool::_0_::_elem::_m_objectInformation::_7_::_m_perObjectType::_m_prob1ObstacleN = 128;
      @sysvar::XCP::RadarFC_Obj::_g_PL_AD_fw_Radar_1R1V_rpc_XilObjBypassingRunnable_XilObjBypassingRunnable_m_pad_radarObjPort_par_out_local::TChangeableMemPool::_::_::_m_arrayPool::_0_::_elem::_m_objectInformation::_7_::_m_perObjectType::_m_prob1NonObstacleN = 0;
      @sysvar::XCP::RadarFC_Obj::_g_PL_AD_fw_Radar_1R1V_rpc_XilObjBypassingRunnable_XilObjBypassingRunnable_m_pad_radarObjPort_par_out_local::TChangeableMemPool::_::_::_m_arrayPool::_0_::_elem::_m_objectInformation::_7_::_m_perObjectType::_m_prob1UnknownN = 0;
      @sysvar::XCP::RadarFC_Obj::_g_PL_AD_fw_Radar_1R1V_rpc_XilObjBypassingRunnable_XilObjBypassingRunnable_m_pad_radarObjPort_par_out_local::TChangeableMemPool::_::_::_m_arrayPool::_0_::_elem::_m_objectInformation::_7_::_m_perObjectType::_m_prob1MobileN = 128;
      @sysvar::XCP::RadarFC_Obj::_g_PL_AD_fw_Radar_1R1V_rpc_XilObjBypassingRunnable_XilObjBypassingRunnable_m_pad_radarObjPort_par_out_local::TChangeableMemPool::_::_::_m_arrayPool::_0_::_elem::_m_objectInformation::_7_::_m_perObjectType::_m_prob1StationaryN = 0;
      @sysvar::XCP::RadarFC_Obj::_g_PL_AD_fw_Radar_1R1V_rpc_XilObjBypassingRunnable_XilObjBypassingRunnable_m_pad_radarObjPort_par_out_local::TChangeableMemPool::_::_::_m_arrayPool::_0_::_elem::_m_objectInformation::_7_::_m_perObjectType::_m_prob1ObstUnknownN = 0;
      @sysvar::XCP::RadarFC_Obj::_g_PL_AD_fw_Radar_1R1V_rpc_XilObjBypassingRunnable_XilObjBypassingRunnable_m_pad_radarObjPort_par_out_local::TChangeableMemPool::_::_::_m_arrayPool::_0_::_elem::_m_objectInformation::_7_::_m_perObjectType::_m_prob1FourPlusWheelerN = 128;
      @sysvar::XCP::RadarFC_Obj::_g_PL_AD_fw_Radar_1R1V_rpc_XilObjBypassingRunnable_XilObjBypassingRunnable_m_pad_radarObjPort_par_out_local::TChangeableMemPool::_::_::_m_arrayPool::_0_::_elem::_m_objectInformation::_7_::_m_perObjectType::_m_prob1TwoWheelerN = 0;
      @sysvar::XCP::RadarFC_Obj::_g_PL_AD_fw_Radar_1R1V_rpc_XilObjBypassingRunnable_XilObjBypassingRunnable_m_pad_radarObjPort_par_out_local::TChangeableMemPool::_::_::_m_arrayPool::_0_::_elem::_m_objectInformation::_7_::_m_perObjectType::_m_prob1PedestrianN = 0;
      @sysvar::XCP::RadarFC_Obj::_g_PL_AD_fw_Radar_1R1V_rpc_XilObjBypassingRunnable_XilObjBypassingRunnable_m_pad_radarObjPort_par_out_local::TChangeableMemPool::_::_::_m_arrayPool::_0_::_elem::_m_objectInformation::_7_::_m_perObjectType::_m_prob1MovUnknownN = 0;
      @sysvar::XCP::RadarFC_Obj::_g_PL_AD_fw_Radar_1R1V_rpc_XilObjBypassingRunnable_XilObjBypassingRunnable_m_pad_radarObjPort_par_out_local::TChangeableMemPool::_::_::_m_arrayPool::_0_::_elem::_m_objectInformation::_7_::_m_perObjectType::_m_prob1RoadsideBarrierN = 0;
      @sysvar::XCP::RadarFC_Obj::_g_PL_AD_fw_Radar_1R1V_rpc_XilObjBypassingRunnable_XilObjBypassingRunnable_m_pad_radarObjPort_par_out_local::TChangeableMemPool::_::_::_m_arrayPool::_0_::_elem::_m_objectInformation::_7_::_m_perObjectType::_m_prob1StatUnknownN = 128;
      @sysvar::XCP::RadarFC_Obj::_g_PL_AD_fw_Radar_1R1V_rpc_XilObjBypassingRunnable_XilObjBypassingRunnable_m_pad_radarObjPort_par_out_local::TChangeableMemPool::_::_::_m_arrayPool::_0_::_elem::_m_objectInformation::_7_::_m_perObjectType::_m_prob1PassengerCarN = 128;
      @sysvar::XCP::RadarFC_Obj::_g_PL_AD_fw_Radar_1R1V_rpc_XilObjBypassingRunnable_XilObjBypassingRunnable_m_pad_radarObjPort_par_out_local::TChangeableMemPool::_::_::_m_arrayPool::_0_::_elem::_m_objectInformation::_7_::_m_perObjectType::_m_prob1TruckN = 0;
      @sysvar::XCP::RadarFC_Obj::_g_PL_AD_fw_Radar_1R1V_rpc_XilObjBypassingRunnable_XilObjBypassingRunnable_m_pad_radarObjPort_par_out_local::TChangeableMemPool::_::_::_m_arrayPool::_0_::_elem::_m_objectInformation::_7_::_m_perObjectType::_m_prob1FourWheelUnknownN = 0;
      @sysvar::XCP::RadarFC_Obj::_g_PL_AD_fw_Radar_1R1V_rpc_XilObjBypassingRunnable_XilObjBypassingRunnable_m_pad_radarObjPort_par_out_local::TChangeableMemPool::_::_::_m_arrayPool::_0_::_elem::_m_objectInformation::_7_::_m_dWidthN = 256;
        break;
    }
    break;

    case 8: //"Object-8"
    //constant
  @sysvar::XCP::RadarFC_Obj::_g_PL_AD_fw_Radar_1R1V_rpc_XilObjBypassingRunnable_XilObjBypassingRunnable_m_pad_radarObjPort_par_out_local::TChangeableMemPool::_::_::_m_arrayPool::_0_::_elem::_m_objectInformation::_8_::_Valid_b = 1;
  @sysvar::XCP::RadarFC_Obj::_g_PL_AD_fw_Radar_1R1V_rpc_XilObjBypassingRunnable_XilObjBypassingRunnable_m_pad_radarObjPort_par_out_local::TChangeableMemPool::_::_::_m_arrayPool::_0_::_elem::_m_objectInformation::_8_::_m_HandleN = 1;
  @sysvar::XCP::RadarFC_Obj::_g_PL_AD_fw_Radar_1R1V_rpc_XilObjBypassingRunnable_XilObjBypassingRunnable_m_pad_radarObjPort_par_out_local::TChangeableMemPool::_::_::_m_arrayPool::_0_::_elem::_m_objectInformation::_8_::_m_alpPiVarYawAngleN = 0;
  @sysvar::XCP::RadarFC_Obj::_g_PL_AD_fw_Radar_1R1V_rpc_XilObjBypassingRunnable_XilObjBypassingRunnable_m_pad_radarObjPort_par_out_local::TChangeableMemPool::_::_::_m_arrayPool::_0_::_elem::_m_objectInformation::_8_::_m_alpPiYawAngleN = 0;
  @sysvar::XCP::RadarFC_Obj::_g_PL_AD_fw_Radar_1R1V_rpc_XilObjBypassingRunnable_XilObjBypassingRunnable_m_pad_radarObjPort_par_out_local::TChangeableMemPool::_::_::_m_arrayPool::_0_::_elem::_m_objectInformation::_8_::_m_varAxN = 0;
  @sysvar::XCP::RadarFC_Obj::_g_PL_AD_fw_Radar_1R1V_rpc_XilObjBypassingRunnable_XilObjBypassingRunnable_m_pad_radarObjPort_par_out_local::TChangeableMemPool::_::_::_m_arrayPool::_0_::_elem::_m_objectInformation::_8_::_m_varAyN = 0;
  @sysvar::XCP::RadarFC_Obj::_g_PL_AD_fw_Radar_1R1V_rpc_XilObjBypassingRunnable_XilObjBypassingRunnable_m_pad_radarObjPort_par_out_local::TChangeableMemPool::_::_::_m_arrayPool::_0_::_elem::_m_objectInformation::_8_::_m_varVxN = 0;
  @sysvar::XCP::RadarFC_Obj::_g_PL_AD_fw_Radar_1R1V_rpc_XilObjBypassingRunnable_XilObjBypassingRunnable_m_pad_radarObjPort_par_out_local::TChangeableMemPool::_::_::_m_arrayPool::_0_::_elem::_m_objectInformation::_8_::_m_varVyN = 0;
  @sysvar::XCP::RadarFC_Obj::_g_PL_AD_fw_Radar_1R1V_rpc_XilObjBypassingRunnable_XilObjBypassingRunnable_m_pad_radarObjPort_par_out_local::TChangeableMemPool::_::_::_m_arrayPool::_0_::_elem::_m_objectInformation::_8_::_m_varDxN = 0;
  @sysvar::XCP::RadarFC_Obj::_g_PL_AD_fw_Radar_1R1V_rpc_XilObjBypassingRunnable_XilObjBypassingRunnable_m_pad_radarObjPort_par_out_local::TChangeableMemPool::_::_::_m_arrayPool::_0_::_elem::_m_objectInformation::_8_::_m_varDyN = 0;
  @sysvar::XCP::RadarFC_Obj::_g_PL_AD_fw_Radar_1R1V_rpc_XilObjBypassingRunnable_XilObjBypassingRunnable_m_pad_radarObjPort_par_out_local::TChangeableMemPool::_::_::_m_arrayPool::_0_::_elem::_m_objectInformation::_8_::_m_dVarLengthN = 0;
  @sysvar::XCP::RadarFC_Obj::_g_PL_AD_fw_Radar_1R1V_rpc_XilObjBypassingRunnable_XilObjBypassingRunnable_m_pad_radarObjPort_par_out_local::TChangeableMemPool::_::_::_m_arrayPool::_0_::_elem::_m_objectInformation::_8_::_m_dVarWidthN = 0;
  @sysvar::XCP::RadarFC_Obj::_g_PL_AD_fw_Radar_1R1V_rpc_XilObjBypassingRunnable_XilObjBypassingRunnable_m_pad_radarObjPort_par_out_local::TChangeableMemPool::_::_::_m_arrayPool::_0_::_elem::_m_objectInformation::_8_::_m_wExistProbN = 64880;
  @sysvar::XCP::RadarFC_Obj::_g_PL_AD_fw_Radar_1R1V_rpc_XilObjBypassingRunnable_XilObjBypassingRunnable_m_pad_radarObjPort_par_out_local::TChangeableMemPool::_::_::_m_arrayPool::_0_::_elem::_m_objectInformation::_8_::_m_isObjectAsil = 1;
  @sysvar::XCP::RadarFC_Obj::_g_PL_AD_fw_Radar_1R1V_rpc_XilObjBypassingRunnable_XilObjBypassingRunnable_m_pad_radarObjPort_par_out_local::TChangeableMemPool::_::_::_m_arrayPool::_0_::_elem::_m_objectInformation::_8_::_m_dLengthN = 128;

    //target movement

  @sysvar::XCP::RadarFC_Obj::_g_PL_AD_fw_Radar_1R1V_rpc_XilObjBypassingRunnable_XilObjBypassingRunnable_m_pad_radarObjPort_par_out_local::TChangeableMemPool::_::_::_m_arrayPool::_0_::_elem::_m_objectInformation::_8_::_m_dxN = @target_radar_fc_sim::objdata.obj_distance_x[8] * 128;
  @sysvar::XCP::RadarFC_Obj::_g_PL_AD_fw_Radar_1R1V_rpc_XilObjBypassingRunnable_XilObjBypassingRunnable_m_pad_radarObjPort_par_out_local::TChangeableMemPool::_::_::_m_arrayPool::_0_::_elem::_m_objectInformation::_8_::_m_dyN = @target_radar_fc_sim::objdata.obj_distance_y[8] * 128;
  @sysvar::XCP::RadarFC_Obj::_g_PL_AD_fw_Radar_1R1V_rpc_XilObjBypassingRunnable_XilObjBypassingRunnable_m_pad_radarObjPort_par_out_local::TChangeableMemPool::_::_::_m_arrayPool::_0_::_elem::_m_objectInformation::_8_::_m_dzN = 0;
  @sysvar::XCP::RadarFC_Obj::_g_PL_AD_fw_Radar_1R1V_rpc_XilObjBypassingRunnable_XilObjBypassingRunnable_m_pad_radarObjPort_par_out_local::TChangeableMemPool::_::_::_m_arrayPool::_0_::_elem::_m_objectInformation::_8_::_m_vxN = @target_radar_fc_sim::objdata.obj_velocity_x[8] * 256;
  @sysvar::XCP::RadarFC_Obj::_g_PL_AD_fw_Radar_1R1V_rpc_XilObjBypassingRunnable_XilObjBypassingRunnable_m_pad_radarObjPort_par_out_local::TChangeableMemPool::_::_::_m_arrayPool::_0_::_elem::_m_objectInformation::_8_::_m_vyN = @target_radar_fc_sim::objdata.obj_velocity_y[8] * 256;
  @sysvar::XCP::RadarFC_Obj::_g_PL_AD_fw_Radar_1R1V_rpc_XilObjBypassingRunnable_XilObjBypassingRunnable_m_pad_radarObjPort_par_out_local::TChangeableMemPool::_::_::_m_arrayPool::_0_::_elem::_m_objectInformation::_8_::_m_axN = 0;
  @sysvar::XCP::RadarFC_Obj::_g_PL_AD_fw_Radar_1R1V_rpc_XilObjBypassingRunnable_XilObjBypassingRunnable_m_pad_radarObjPort_par_out_local::TChangeableMemPool::_::_::_m_arrayPool::_0_::_elem::_m_objectInformation::_8_::_m_ayN = 0;

    //target object moving or not
    if (abs(@target_radar_fc_sim::objdata.obj_velocity_x[8]) != 0)
    {
    @sysvar::XCP::RadarFC_Obj::_g_PL_AD_fw_Radar_1R1V_rpc_XilObjBypassingRunnable_XilObjBypassingRunnable_m_pad_radarObjPort_par_out_local::TChangeableMemPool::_::_::_m_arrayPool::_0_::_elem::_m_objectInformation::_8_::_m_prob1HasBeenObservedMovingN = 126;
    @sysvar::XCP::RadarFC_Obj::_g_PL_AD_fw_Radar_1R1V_rpc_XilObjBypassingRunnable_XilObjBypassingRunnable_m_pad_radarObjPort_par_out_local::TChangeableMemPool::_::_::_m_arrayPool::_0_::_elem::_m_objectInformation::_8_::_m_prob1MovingN = 126;
    }
    else
    {
    @sysvar::XCP::RadarFC_Obj::_g_PL_AD_fw_Radar_1R1V_rpc_XilObjBypassingRunnable_XilObjBypassingRunnable_m_pad_radarObjPort_par_out_local::TChangeableMemPool::_::_::_m_arrayPool::_0_::_elem::_m_objectInformation::_8_::_m_prob1HasBeenObservedMovingN = 0;
    @sysvar::XCP::RadarFC_Obj::_g_PL_AD_fw_Radar_1R1V_rpc_XilObjBypassingRunnable_XilObjBypassingRunnable_m_pad_radarObjPort_par_out_local::TChangeableMemPool::_::_::_m_arrayPool::_0_::_elem::_m_objectInformation::_8_::_m_prob1MovingN = 0;
    }

      //object classification
    switch (@target_radar_fc_sim::objdata.obj_type[8])
    {
      case 0: //"Non-Obstacle"
      @sysvar::XCP::RadarFC_Obj::_g_PL_AD_fw_Radar_1R1V_rpc_XilObjBypassingRunnable_XilObjBypassingRunnable_m_pad_radarObjPort_par_out_local::TChangeableMemPool::_::_::_m_arrayPool::_0_::_elem::_m_objectInformation::_8_::_m_perObjectType::_m_prob1ObstacleN = 0;
      @sysvar::XCP::RadarFC_Obj::_g_PL_AD_fw_Radar_1R1V_rpc_XilObjBypassingRunnable_XilObjBypassingRunnable_m_pad_radarObjPort_par_out_local::TChangeableMemPool::_::_::_m_arrayPool::_0_::_elem::_m_objectInformation::_8_::_m_perObjectType::_m_prob1NonObstacleN = 128;
      @sysvar::XCP::RadarFC_Obj::_g_PL_AD_fw_Radar_1R1V_rpc_XilObjBypassingRunnable_XilObjBypassingRunnable_m_pad_radarObjPort_par_out_local::TChangeableMemPool::_::_::_m_arrayPool::_0_::_elem::_m_objectInformation::_8_::_m_perObjectType::_m_prob1UnknownN = 0;
      @sysvar::XCP::RadarFC_Obj::_g_PL_AD_fw_Radar_1R1V_rpc_XilObjBypassingRunnable_XilObjBypassingRunnable_m_pad_radarObjPort_par_out_local::TChangeableMemPool::_::_::_m_arrayPool::_0_::_elem::_m_objectInformation::_8_::_m_perObjectType::_m_prob1MobileN = 0;
      @sysvar::XCP::RadarFC_Obj::_g_PL_AD_fw_Radar_1R1V_rpc_XilObjBypassingRunnable_XilObjBypassingRunnable_m_pad_radarObjPort_par_out_local::TChangeableMemPool::_::_::_m_arrayPool::_0_::_elem::_m_objectInformation::_8_::_m_perObjectType::_m_prob1StationaryN = 0;
      @sysvar::XCP::RadarFC_Obj::_g_PL_AD_fw_Radar_1R1V_rpc_XilObjBypassingRunnable_XilObjBypassingRunnable_m_pad_radarObjPort_par_out_local::TChangeableMemPool::_::_::_m_arrayPool::_0_::_elem::_m_objectInformation::_8_::_m_perObjectType::_m_prob1ObstUnknownN = 128;
      @sysvar::XCP::RadarFC_Obj::_g_PL_AD_fw_Radar_1R1V_rpc_XilObjBypassingRunnable_XilObjBypassingRunnable_m_pad_radarObjPort_par_out_local::TChangeableMemPool::_::_::_m_arrayPool::_0_::_elem::_m_objectInformation::_8_::_m_perObjectType::_m_prob1FourPlusWheelerN = 0;
      @sysvar::XCP::RadarFC_Obj::_g_PL_AD_fw_Radar_1R1V_rpc_XilObjBypassingRunnable_XilObjBypassingRunnable_m_pad_radarObjPort_par_out_local::TChangeableMemPool::_::_::_m_arrayPool::_0_::_elem::_m_objectInformation::_8_::_m_perObjectType::_m_prob1TwoWheelerN = 0;
      @sysvar::XCP::RadarFC_Obj::_g_PL_AD_fw_Radar_1R1V_rpc_XilObjBypassingRunnable_XilObjBypassingRunnable_m_pad_radarObjPort_par_out_local::TChangeableMemPool::_::_::_m_arrayPool::_0_::_elem::_m_objectInformation::_8_::_m_perObjectType::_m_prob1PedestrianN = 0;
      @sysvar::XCP::RadarFC_Obj::_g_PL_AD_fw_Radar_1R1V_rpc_XilObjBypassingRunnable_XilObjBypassingRunnable_m_pad_radarObjPort_par_out_local::TChangeableMemPool::_::_::_m_arrayPool::_0_::_elem::_m_objectInformation::_8_::_m_perObjectType::_m_prob1MovUnknownN = 128;
      @sysvar::XCP::RadarFC_Obj::_g_PL_AD_fw_Radar_1R1V_rpc_XilObjBypassingRunnable_XilObjBypassingRunnable_m_pad_radarObjPort_par_out_local::TChangeableMemPool::_::_::_m_arrayPool::_0_::_elem::_m_objectInformation::_8_::_m_perObjectType::_m_prob1RoadsideBarrierN = 0;
      @sysvar::XCP::RadarFC_Obj::_g_PL_AD_fw_Radar_1R1V_rpc_XilObjBypassingRunnable_XilObjBypassingRunnable_m_pad_radarObjPort_par_out_local::TChangeableMemPool::_::_::_m_arrayPool::_0_::_elem::_m_objectInformation::_8_::_m_perObjectType::_m_prob1StatUnknownN = 128;
      @sysvar::XCP::RadarFC_Obj::_g_PL_AD_fw_Radar_1R1V_rpc_XilObjBypassingRunnable_XilObjBypassingRunnable_m_pad_radarObjPort_par_out_local::TChangeableMemPool::_::_::_m_arrayPool::_0_::_elem::_m_objectInformation::_8_::_m_perObjectType::_m_prob1PassengerCarN = 0;
      @sysvar::XCP::RadarFC_Obj::_g_PL_AD_fw_Radar_1R1V_rpc_XilObjBypassingRunnable_XilObjBypassingRunnable_m_pad_radarObjPort_par_out_local::TChangeableMemPool::_::_::_m_arrayPool::_0_::_elem::_m_objectInformation::_8_::_m_perObjectType::_m_prob1TruckN = 0;
      @sysvar::XCP::RadarFC_Obj::_g_PL_AD_fw_Radar_1R1V_rpc_XilObjBypassingRunnable_XilObjBypassingRunnable_m_pad_radarObjPort_par_out_local::TChangeableMemPool::_::_::_m_arrayPool::_0_::_elem::_m_objectInformation::_8_::_m_perObjectType::_m_prob1FourWheelUnknownN = 128;
      @sysvar::XCP::RadarFC_Obj::_g_PL_AD_fw_Radar_1R1V_rpc_XilObjBypassingRunnable_XilObjBypassingRunnable_m_pad_radarObjPort_par_out_local::TChangeableMemPool::_::_::_m_arrayPool::_0_::_elem::_m_objectInformation::_8_::_m_dWidthN = 256;
        break;

      case 1: //"unknown"
      @sysvar::XCP::RadarFC_Obj::_g_PL_AD_fw_Radar_1R1V_rpc_XilObjBypassingRunnable_XilObjBypassingRunnable_m_pad_radarObjPort_par_out_local::TChangeableMemPool::_::_::_m_arrayPool::_0_::_elem::_m_objectInformation::_8_::_m_perObjectType::_m_prob1ObstacleN = 0;
      @sysvar::XCP::RadarFC_Obj::_g_PL_AD_fw_Radar_1R1V_rpc_XilObjBypassingRunnable_XilObjBypassingRunnable_m_pad_radarObjPort_par_out_local::TChangeableMemPool::_::_::_m_arrayPool::_0_::_elem::_m_objectInformation::_8_::_m_perObjectType::_m_prob1NonObstacleN = 0;
      @sysvar::XCP::RadarFC_Obj::_g_PL_AD_fw_Radar_1R1V_rpc_XilObjBypassingRunnable_XilObjBypassingRunnable_m_pad_radarObjPort_par_out_local::TChangeableMemPool::_::_::_m_arrayPool::_0_::_elem::_m_objectInformation::_8_::_m_perObjectType::_m_prob1UnknownN = 128;
      @sysvar::XCP::RadarFC_Obj::_g_PL_AD_fw_Radar_1R1V_rpc_XilObjBypassingRunnable_XilObjBypassingRunnable_m_pad_radarObjPort_par_out_local::TChangeableMemPool::_::_::_m_arrayPool::_0_::_elem::_m_objectInformation::_8_::_m_perObjectType::_m_prob1MobileN = 0;
      @sysvar::XCP::RadarFC_Obj::_g_PL_AD_fw_Radar_1R1V_rpc_XilObjBypassingRunnable_XilObjBypassingRunnable_m_pad_radarObjPort_par_out_local::TChangeableMemPool::_::_::_m_arrayPool::_0_::_elem::_m_objectInformation::_8_::_m_perObjectType::_m_prob1StationaryN = 0;
      @sysvar::XCP::RadarFC_Obj::_g_PL_AD_fw_Radar_1R1V_rpc_XilObjBypassingRunnable_XilObjBypassingRunnable_m_pad_radarObjPort_par_out_local::TChangeableMemPool::_::_::_m_arrayPool::_0_::_elem::_m_objectInformation::_8_::_m_perObjectType::_m_prob1ObstUnknownN = 128;
      @sysvar::XCP::RadarFC_Obj::_g_PL_AD_fw_Radar_1R1V_rpc_XilObjBypassingRunnable_XilObjBypassingRunnable_m_pad_radarObjPort_par_out_local::TChangeableMemPool::_::_::_m_arrayPool::_0_::_elem::_m_objectInformation::_8_::_m_perObjectType::_m_prob1FourPlusWheelerN = 0;
      @sysvar::XCP::RadarFC_Obj::_g_PL_AD_fw_Radar_1R1V_rpc_XilObjBypassingRunnable_XilObjBypassingRunnable_m_pad_radarObjPort_par_out_local::TChangeableMemPool::_::_::_m_arrayPool::_0_::_elem::_m_objectInformation::_8_::_m_perObjectType::_m_prob1TwoWheelerN = 0;
      @sysvar::XCP::RadarFC_Obj::_g_PL_AD_fw_Radar_1R1V_rpc_XilObjBypassingRunnable_XilObjBypassingRunnable_m_pad_radarObjPort_par_out_local::TChangeableMemPool::_::_::_m_arrayPool::_0_::_elem::_m_objectInformation::_8_::_m_perObjectType::_m_prob1PedestrianN = 0;
      @sysvar::XCP::RadarFC_Obj::_g_PL_AD_fw_Radar_1R1V_rpc_XilObjBypassingRunnable_XilObjBypassingRunnable_m_pad_radarObjPort_par_out_local::TChangeableMemPool::_::_::_m_arrayPool::_0_::_elem::_m_objectInformation::_8_::_m_perObjectType::_m_prob1MovUnknownN = 128;
      @sysvar::XCP::RadarFC_Obj::_g_PL_AD_fw_Radar_1R1V_rpc_XilObjBypassingRunnable_XilObjBypassingRunnable_m_pad_radarObjPort_par_out_local::TChangeableMemPool::_::_::_m_arrayPool::_0_::_elem::_m_objectInformation::_8_::_m_perObjectType::_m_prob1RoadsideBarrierN = 0;
      @sysvar::XCP::RadarFC_Obj::_g_PL_AD_fw_Radar_1R1V_rpc_XilObjBypassingRunnable_XilObjBypassingRunnable_m_pad_radarObjPort_par_out_local::TChangeableMemPool::_::_::_m_arrayPool::_0_::_elem::_m_objectInformation::_8_::_m_perObjectType::_m_prob1StatUnknownN = 128;
      @sysvar::XCP::RadarFC_Obj::_g_PL_AD_fw_Radar_1R1V_rpc_XilObjBypassingRunnable_XilObjBypassingRunnable_m_pad_radarObjPort_par_out_local::TChangeableMemPool::_::_::_m_arrayPool::_0_::_elem::_m_objectInformation::_8_::_m_perObjectType::_m_prob1PassengerCarN = 0;
      @sysvar::XCP::RadarFC_Obj::_g_PL_AD_fw_Radar_1R1V_rpc_XilObjBypassingRunnable_XilObjBypassingRunnable_m_pad_radarObjPort_par_out_local::TChangeableMemPool::_::_::_m_arrayPool::_0_::_elem::_m_objectInformation::_8_::_m_perObjectType::_m_prob1TruckN = 0;
      @sysvar::XCP::RadarFC_Obj::_g_PL_AD_fw_Radar_1R1V_rpc_XilObjBypassingRunnable_XilObjBypassingRunnable_m_pad_radarObjPort_par_out_local::TChangeableMemPool::_::_::_m_arrayPool::_0_::_elem::_m_objectInformation::_8_::_m_perObjectType::_m_prob1FourWheelUnknownN = 128;
      @sysvar::XCP::RadarFC_Obj::_g_PL_AD_fw_Radar_1R1V_rpc_XilObjBypassingRunnable_XilObjBypassingRunnable_m_pad_radarObjPort_par_out_local::TChangeableMemPool::_::_::_m_arrayPool::_0_::_elem::_m_objectInformation::_8_::_m_dWidthN = 256;
        break;

      case 2: //"RoadSideBarrier"
      @sysvar::XCP::RadarFC_Obj::_g_PL_AD_fw_Radar_1R1V_rpc_XilObjBypassingRunnable_XilObjBypassingRunnable_m_pad_radarObjPort_par_out_local::TChangeableMemPool::_::_::_m_arrayPool::_0_::_elem::_m_objectInformation::_8_::_m_perObjectType::_m_prob1ObstacleN = 128;
      @sysvar::XCP::RadarFC_Obj::_g_PL_AD_fw_Radar_1R1V_rpc_XilObjBypassingRunnable_XilObjBypassingRunnable_m_pad_radarObjPort_par_out_local::TChangeableMemPool::_::_::_m_arrayPool::_0_::_elem::_m_objectInformation::_8_::_m_perObjectType::_m_prob1NonObstacleN = 0;
      @sysvar::XCP::RadarFC_Obj::_g_PL_AD_fw_Radar_1R1V_rpc_XilObjBypassingRunnable_XilObjBypassingRunnable_m_pad_radarObjPort_par_out_local::TChangeableMemPool::_::_::_m_arrayPool::_0_::_elem::_m_objectInformation::_8_::_m_perObjectType::_m_prob1UnknownN = 0;
      @sysvar::XCP::RadarFC_Obj::_g_PL_AD_fw_Radar_1R1V_rpc_XilObjBypassingRunnable_XilObjBypassingRunnable_m_pad_radarObjPort_par_out_local::TChangeableMemPool::_::_::_m_arrayPool::_0_::_elem::_m_objectInformation::_8_::_m_perObjectType::_m_prob1MobileN = 0;
      @sysvar::XCP::RadarFC_Obj::_g_PL_AD_fw_Radar_1R1V_rpc_XilObjBypassingRunnable_XilObjBypassingRunnable_m_pad_radarObjPort_par_out_local::TChangeableMemPool::_::_::_m_arrayPool::_0_::_elem::_m_objectInformation::_8_::_m_perObjectType::_m_prob1StationaryN = 128;
      @sysvar::XCP::RadarFC_Obj::_g_PL_AD_fw_Radar_1R1V_rpc_XilObjBypassingRunnable_XilObjBypassingRunnable_m_pad_radarObjPort_par_out_local::TChangeableMemPool::_::_::_m_arrayPool::_0_::_elem::_m_objectInformation::_8_::_m_perObjectType::_m_prob1ObstUnknownN = 0;
      @sysvar::XCP::RadarFC_Obj::_g_PL_AD_fw_Radar_1R1V_rpc_XilObjBypassingRunnable_XilObjBypassingRunnable_m_pad_radarObjPort_par_out_local::TChangeableMemPool::_::_::_m_arrayPool::_0_::_elem::_m_objectInformation::_8_::_m_perObjectType::_m_prob1FourPlusWheelerN = 0;
      @sysvar::XCP::RadarFC_Obj::_g_PL_AD_fw_Radar_1R1V_rpc_XilObjBypassingRunnable_XilObjBypassingRunnable_m_pad_radarObjPort_par_out_local::TChangeableMemPool::_::_::_m_arrayPool::_0_::_elem::_m_objectInformation::_8_::_m_perObjectType::_m_prob1TwoWheelerN = 0;
      @sysvar::XCP::RadarFC_Obj::_g_PL_AD_fw_Radar_1R1V_rpc_XilObjBypassingRunnable_XilObjBypassingRunnable_m_pad_radarObjPort_par_out_local::TChangeableMemPool::_::_::_m_arrayPool::_0_::_elem::_m_objectInformation::_8_::_m_perObjectType::_m_prob1PedestrianN = 0;
      @sysvar::XCP::RadarFC_Obj::_g_PL_AD_fw_Radar_1R1V_rpc_XilObjBypassingRunnable_XilObjBypassingRunnable_m_pad_radarObjPort_par_out_local::TChangeableMemPool::_::_::_m_arrayPool::_0_::_elem::_m_objectInformation::_8_::_m_perObjectType::_m_prob1MovUnknownN = 128;
      @sysvar::XCP::RadarFC_Obj::_g_PL_AD_fw_Radar_1R1V_rpc_XilObjBypassingRunnable_XilObjBypassingRunnable_m_pad_radarObjPort_par_out_local::TChangeableMemPool::_::_::_m_arrayPool::_0_::_elem::_m_objectInformation::_8_::_m_perObjectType::_m_prob1RoadsideBarrierN = 128;
      @sysvar::XCP::RadarFC_Obj::_g_PL_AD_fw_Radar_1R1V_rpc_XilObjBypassingRunnable_XilObjBypassingRunnable_m_pad_radarObjPort_par_out_local::TChangeableMemPool::_::_::_m_arrayPool::_0_::_elem::_m_objectInformation::_8_::_m_perObjectType::_m_prob1StatUnknownN = 0;
      @sysvar::XCP::RadarFC_Obj::_g_PL_AD_fw_Radar_1R1V_rpc_XilObjBypassingRunnable_XilObjBypassingRunnable_m_pad_radarObjPort_par_out_local::TChangeableMemPool::_::_::_m_arrayPool::_0_::_elem::_m_objectInformation::_8_::_m_perObjectType::_m_prob1PassengerCarN = 0;
      @sysvar::XCP::RadarFC_Obj::_g_PL_AD_fw_Radar_1R1V_rpc_XilObjBypassingRunnable_XilObjBypassingRunnable_m_pad_radarObjPort_par_out_local::TChangeableMemPool::_::_::_m_arrayPool::_0_::_elem::_m_objectInformation::_8_::_m_perObjectType::_m_prob1TruckN = 0;
      @sysvar::XCP::RadarFC_Obj::_g_PL_AD_fw_Radar_1R1V_rpc_XilObjBypassingRunnable_XilObjBypassingRunnable_m_pad_radarObjPort_par_out_local::TChangeableMemPool::_::_::_m_arrayPool::_0_::_elem::_m_objectInformation::_8_::_m_perObjectType::_m_prob1FourWheelUnknownN = 128;
      @sysvar::XCP::RadarFC_Obj::_g_PL_AD_fw_Radar_1R1V_rpc_XilObjBypassingRunnable_XilObjBypassingRunnable_m_pad_radarObjPort_par_out_local::TChangeableMemPool::_::_::_m_arrayPool::_0_::_elem::_m_objectInformation::_8_::_m_dWidthN = 256;
        break;

      case 3: //"2Wheeler"
      @sysvar::XCP::RadarFC_Obj::_g_PL_AD_fw_Radar_1R1V_rpc_XilObjBypassingRunnable_XilObjBypassingRunnable_m_pad_radarObjPort_par_out_local::TChangeableMemPool::_::_::_m_arrayPool::_0_::_elem::_m_objectInformation::_8_::_m_perObjectType::_m_prob1ObstacleN = 128;
      @sysvar::XCP::RadarFC_Obj::_g_PL_AD_fw_Radar_1R1V_rpc_XilObjBypassingRunnable_XilObjBypassingRunnable_m_pad_radarObjPort_par_out_local::TChangeableMemPool::_::_::_m_arrayPool::_0_::_elem::_m_objectInformation::_8_::_m_perObjectType::_m_prob1NonObstacleN = 0;
      @sysvar::XCP::RadarFC_Obj::_g_PL_AD_fw_Radar_1R1V_rpc_XilObjBypassingRunnable_XilObjBypassingRunnable_m_pad_radarObjPort_par_out_local::TChangeableMemPool::_::_::_m_arrayPool::_0_::_elem::_m_objectInformation::_8_::_m_perObjectType::_m_prob1UnknownN = 0;
      @sysvar::XCP::RadarFC_Obj::_g_PL_AD_fw_Radar_1R1V_rpc_XilObjBypassingRunnable_XilObjBypassingRunnable_m_pad_radarObjPort_par_out_local::TChangeableMemPool::_::_::_m_arrayPool::_0_::_elem::_m_objectInformation::_8_::_m_perObjectType::_m_prob1MobileN = 128;
      @sysvar::XCP::RadarFC_Obj::_g_PL_AD_fw_Radar_1R1V_rpc_XilObjBypassingRunnable_XilObjBypassingRunnable_m_pad_radarObjPort_par_out_local::TChangeableMemPool::_::_::_m_arrayPool::_0_::_elem::_m_objectInformation::_8_::_m_perObjectType::_m_prob1StationaryN = 0;
      @sysvar::XCP::RadarFC_Obj::_g_PL_AD_fw_Radar_1R1V_rpc_XilObjBypassingRunnable_XilObjBypassingRunnable_m_pad_radarObjPort_par_out_local::TChangeableMemPool::_::_::_m_arrayPool::_0_::_elem::_m_objectInformation::_8_::_m_perObjectType::_m_prob1ObstUnknownN = 0;
      @sysvar::XCP::RadarFC_Obj::_g_PL_AD_fw_Radar_1R1V_rpc_XilObjBypassingRunnable_XilObjBypassingRunnable_m_pad_radarObjPort_par_out_local::TChangeableMemPool::_::_::_m_arrayPool::_0_::_elem::_m_objectInformation::_8_::_m_perObjectType::_m_prob1FourPlusWheelerN = 0;
      @sysvar::XCP::RadarFC_Obj::_g_PL_AD_fw_Radar_1R1V_rpc_XilObjBypassingRunnable_XilObjBypassingRunnable_m_pad_radarObjPort_par_out_local::TChangeableMemPool::_::_::_m_arrayPool::_0_::_elem::_m_objectInformation::_8_::_m_perObjectType::_m_prob1TwoWheelerN = 128;
      @sysvar::XCP::RadarFC_Obj::_g_PL_AD_fw_Radar_1R1V_rpc_XilObjBypassingRunnable_XilObjBypassingRunnable_m_pad_radarObjPort_par_out_local::TChangeableMemPool::_::_::_m_arrayPool::_0_::_elem::_m_objectInformation::_8_::_m_perObjectType::_m_prob1PedestrianN = 0;
      @sysvar::XCP::RadarFC_Obj::_g_PL_AD_fw_Radar_1R1V_rpc_XilObjBypassingRunnable_XilObjBypassingRunnable_m_pad_radarObjPort_par_out_local::TChangeableMemPool::_::_::_m_arrayPool::_0_::_elem::_m_objectInformation::_8_::_m_perObjectType::_m_prob1MovUnknownN = 0;
      @sysvar::XCP::RadarFC_Obj::_g_PL_AD_fw_Radar_1R1V_rpc_XilObjBypassingRunnable_XilObjBypassingRunnable_m_pad_radarObjPort_par_out_local::TChangeableMemPool::_::_::_m_arrayPool::_0_::_elem::_m_objectInformation::_8_::_m_perObjectType::_m_prob1RoadsideBarrierN = 0;
      @sysvar::XCP::RadarFC_Obj::_g_PL_AD_fw_Radar_1R1V_rpc_XilObjBypassingRunnable_XilObjBypassingRunnable_m_pad_radarObjPort_par_out_local::TChangeableMemPool::_::_::_m_arrayPool::_0_::_elem::_m_objectInformation::_8_::_m_perObjectType::_m_prob1StatUnknownN = 128;
      @sysvar::XCP::RadarFC_Obj::_g_PL_AD_fw_Radar_1R1V_rpc_XilObjBypassingRunnable_XilObjBypassingRunnable_m_pad_radarObjPort_par_out_local::TChangeableMemPool::_::_::_m_arrayPool::_0_::_elem::_m_objectInformation::_8_::_m_perObjectType::_m_prob1PassengerCarN = 0;
      @sysvar::XCP::RadarFC_Obj::_g_PL_AD_fw_Radar_1R1V_rpc_XilObjBypassingRunnable_XilObjBypassingRunnable_m_pad_radarObjPort_par_out_local::TChangeableMemPool::_::_::_m_arrayPool::_0_::_elem::_m_objectInformation::_8_::_m_perObjectType::_m_prob1TruckN = 0;
      @sysvar::XCP::RadarFC_Obj::_g_PL_AD_fw_Radar_1R1V_rpc_XilObjBypassingRunnable_XilObjBypassingRunnable_m_pad_radarObjPort_par_out_local::TChangeableMemPool::_::_::_m_arrayPool::_0_::_elem::_m_objectInformation::_8_::_m_perObjectType::_m_prob1FourWheelUnknownN = 128;
      @sysvar::XCP::RadarFC_Obj::_g_PL_AD_fw_Radar_1R1V_rpc_XilObjBypassingRunnable_XilObjBypassingRunnable_m_pad_radarObjPort_par_out_local::TChangeableMemPool::_::_::_m_arrayPool::_0_::_elem::_m_objectInformation::_8_::_m_dWidthN = 64;
        break;

      case 4: //"Pedestrian"
      @sysvar::XCP::RadarFC_Obj::_g_PL_AD_fw_Radar_1R1V_rpc_XilObjBypassingRunnable_XilObjBypassingRunnable_m_pad_radarObjPort_par_out_local::TChangeableMemPool::_::_::_m_arrayPool::_0_::_elem::_m_objectInformation::_8_::_m_perObjectType::_m_prob1ObstacleN = 128;
      @sysvar::XCP::RadarFC_Obj::_g_PL_AD_fw_Radar_1R1V_rpc_XilObjBypassingRunnable_XilObjBypassingRunnable_m_pad_radarObjPort_par_out_local::TChangeableMemPool::_::_::_m_arrayPool::_0_::_elem::_m_objectInformation::_8_::_m_perObjectType::_m_prob1NonObstacleN = 0;
      @sysvar::XCP::RadarFC_Obj::_g_PL_AD_fw_Radar_1R1V_rpc_XilObjBypassingRunnable_XilObjBypassingRunnable_m_pad_radarObjPort_par_out_local::TChangeableMemPool::_::_::_m_arrayPool::_0_::_elem::_m_objectInformation::_8_::_m_perObjectType::_m_prob1UnknownN = 0;
      @sysvar::XCP::RadarFC_Obj::_g_PL_AD_fw_Radar_1R1V_rpc_XilObjBypassingRunnable_XilObjBypassingRunnable_m_pad_radarObjPort_par_out_local::TChangeableMemPool::_::_::_m_arrayPool::_0_::_elem::_m_objectInformation::_8_::_m_perObjectType::_m_prob1MobileN = 128;
      @sysvar::XCP::RadarFC_Obj::_g_PL_AD_fw_Radar_1R1V_rpc_XilObjBypassingRunnable_XilObjBypassingRunnable_m_pad_radarObjPort_par_out_local::TChangeableMemPool::_::_::_m_arrayPool::_0_::_elem::_m_objectInformation::_8_::_m_perObjectType::_m_prob1StationaryN = 0;
      @sysvar::XCP::RadarFC_Obj::_g_PL_AD_fw_Radar_1R1V_rpc_XilObjBypassingRunnable_XilObjBypassingRunnable_m_pad_radarObjPort_par_out_local::TChangeableMemPool::_::_::_m_arrayPool::_0_::_elem::_m_objectInformation::_8_::_m_perObjectType::_m_prob1ObstUnknownN = 0;
      @sysvar::XCP::RadarFC_Obj::_g_PL_AD_fw_Radar_1R1V_rpc_XilObjBypassingRunnable_XilObjBypassingRunnable_m_pad_radarObjPort_par_out_local::TChangeableMemPool::_::_::_m_arrayPool::_0_::_elem::_m_objectInformation::_8_::_m_perObjectType::_m_prob1FourPlusWheelerN = 0;
      @sysvar::XCP::RadarFC_Obj::_g_PL_AD_fw_Radar_1R1V_rpc_XilObjBypassingRunnable_XilObjBypassingRunnable_m_pad_radarObjPort_par_out_local::TChangeableMemPool::_::_::_m_arrayPool::_0_::_elem::_m_objectInformation::_8_::_m_perObjectType::_m_prob1TwoWheelerN = 0;
      @sysvar::XCP::RadarFC_Obj::_g_PL_AD_fw_Radar_1R1V_rpc_XilObjBypassingRunnable_XilObjBypassingRunnable_m_pad_radarObjPort_par_out_local::TChangeableMemPool::_::_::_m_arrayPool::_0_::_elem::_m_objectInformation::_8_::_m_perObjectType::_m_prob1PedestrianN = 128;
      @sysvar::XCP::RadarFC_Obj::_g_PL_AD_fw_Radar_1R1V_rpc_XilObjBypassingRunnable_XilObjBypassingRunnable_m_pad_radarObjPort_par_out_local::TChangeableMemPool::_::_::_m_arrayPool::_0_::_elem::_m_objectInformation::_8_::_m_perObjectType::_m_prob1MovUnknownN = 0;
      @sysvar::XCP::RadarFC_Obj::_g_PL_AD_fw_Radar_1R1V_rpc_XilObjBypassingRunnable_XilObjBypassingRunnable_m_pad_radarObjPort_par_out_local::TChangeableMemPool::_::_::_m_arrayPool::_0_::_elem::_m_objectInformation::_8_::_m_perObjectType::_m_prob1RoadsideBarrierN = 0;
      @sysvar::XCP::RadarFC_Obj::_g_PL_AD_fw_Radar_1R1V_rpc_XilObjBypassingRunnable_XilObjBypassingRunnable_m_pad_radarObjPort_par_out_local::TChangeableMemPool::_::_::_m_arrayPool::_0_::_elem::_m_objectInformation::_8_::_m_perObjectType::_m_prob1StatUnknownN = 128;
      @sysvar::XCP::RadarFC_Obj::_g_PL_AD_fw_Radar_1R1V_rpc_XilObjBypassingRunnable_XilObjBypassingRunnable_m_pad_radarObjPort_par_out_local::TChangeableMemPool::_::_::_m_arrayPool::_0_::_elem::_m_objectInformation::_8_::_m_perObjectType::_m_prob1PassengerCarN = 0;
      @sysvar::XCP::RadarFC_Obj::_g_PL_AD_fw_Radar_1R1V_rpc_XilObjBypassingRunnable_XilObjBypassingRunnable_m_pad_radarObjPort_par_out_local::TChangeableMemPool::_::_::_m_arrayPool::_0_::_elem::_m_objectInformation::_8_::_m_perObjectType::_m_prob1TruckN = 0;
      @sysvar::XCP::RadarFC_Obj::_g_PL_AD_fw_Radar_1R1V_rpc_XilObjBypassingRunnable_XilObjBypassingRunnable_m_pad_radarObjPort_par_out_local::TChangeableMemPool::_::_::_m_arrayPool::_0_::_elem::_m_objectInformation::_8_::_m_perObjectType::_m_prob1FourWheelUnknownN = 128;
      @sysvar::XCP::RadarFC_Obj::_g_PL_AD_fw_Radar_1R1V_rpc_XilObjBypassingRunnable_XilObjBypassingRunnable_m_pad_radarObjPort_par_out_local::TChangeableMemPool::_::_::_m_arrayPool::_0_::_elem::_m_objectInformation::_8_::_m_dWidthN = 64;
        break;

      case 5: //"Truck"
      @sysvar::XCP::RadarFC_Obj::_g_PL_AD_fw_Radar_1R1V_rpc_XilObjBypassingRunnable_XilObjBypassingRunnable_m_pad_radarObjPort_par_out_local::TChangeableMemPool::_::_::_m_arrayPool::_0_::_elem::_m_objectInformation::_8_::_m_perObjectType::_m_prob1ObstacleN = 128;
      @sysvar::XCP::RadarFC_Obj::_g_PL_AD_fw_Radar_1R1V_rpc_XilObjBypassingRunnable_XilObjBypassingRunnable_m_pad_radarObjPort_par_out_local::TChangeableMemPool::_::_::_m_arrayPool::_0_::_elem::_m_objectInformation::_8_::_m_perObjectType::_m_prob1NonObstacleN = 0;
      @sysvar::XCP::RadarFC_Obj::_g_PL_AD_fw_Radar_1R1V_rpc_XilObjBypassingRunnable_XilObjBypassingRunnable_m_pad_radarObjPort_par_out_local::TChangeableMemPool::_::_::_m_arrayPool::_0_::_elem::_m_objectInformation::_8_::_m_perObjectType::_m_prob1UnknownN = 0;
      @sysvar::XCP::RadarFC_Obj::_g_PL_AD_fw_Radar_1R1V_rpc_XilObjBypassingRunnable_XilObjBypassingRunnable_m_pad_radarObjPort_par_out_local::TChangeableMemPool::_::_::_m_arrayPool::_0_::_elem::_m_objectInformation::_8_::_m_perObjectType::_m_prob1MobileN = 128;
      @sysvar::XCP::RadarFC_Obj::_g_PL_AD_fw_Radar_1R1V_rpc_XilObjBypassingRunnable_XilObjBypassingRunnable_m_pad_radarObjPort_par_out_local::TChangeableMemPool::_::_::_m_arrayPool::_0_::_elem::_m_objectInformation::_8_::_m_perObjectType::_m_prob1StationaryN = 0;
      @sysvar::XCP::RadarFC_Obj::_g_PL_AD_fw_Radar_1R1V_rpc_XilObjBypassingRunnable_XilObjBypassingRunnable_m_pad_radarObjPort_par_out_local::TChangeableMemPool::_::_::_m_arrayPool::_0_::_elem::_m_objectInformation::_8_::_m_perObjectType::_m_prob1ObstUnknownN = 0;
      @sysvar::XCP::RadarFC_Obj::_g_PL_AD_fw_Radar_1R1V_rpc_XilObjBypassingRunnable_XilObjBypassingRunnable_m_pad_radarObjPort_par_out_local::TChangeableMemPool::_::_::_m_arrayPool::_0_::_elem::_m_objectInformation::_8_::_m_perObjectType::_m_prob1FourPlusWheelerN = 128;
      @sysvar::XCP::RadarFC_Obj::_g_PL_AD_fw_Radar_1R1V_rpc_XilObjBypassingRunnable_XilObjBypassingRunnable_m_pad_radarObjPort_par_out_local::TChangeableMemPool::_::_::_m_arrayPool::_0_::_elem::_m_objectInformation::_8_::_m_perObjectType::_m_prob1TwoWheelerN = 0;
      @sysvar::XCP::RadarFC_Obj::_g_PL_AD_fw_Radar_1R1V_rpc_XilObjBypassingRunnable_XilObjBypassingRunnable_m_pad_radarObjPort_par_out_local::TChangeableMemPool::_::_::_m_arrayPool::_0_::_elem::_m_objectInformation::_8_::_m_perObjectType::_m_prob1PedestrianN = 0;
      @sysvar::XCP::RadarFC_Obj::_g_PL_AD_fw_Radar_1R1V_rpc_XilObjBypassingRunnable_XilObjBypassingRunnable_m_pad_radarObjPort_par_out_local::TChangeableMemPool::_::_::_m_arrayPool::_0_::_elem::_m_objectInformation::_8_::_m_perObjectType::_m_prob1MovUnknownN = 0;
      @sysvar::XCP::RadarFC_Obj::_g_PL_AD_fw_Radar_1R1V_rpc_XilObjBypassingRunnable_XilObjBypassingRunnable_m_pad_radarObjPort_par_out_local::TChangeableMemPool::_::_::_m_arrayPool::_0_::_elem::_m_objectInformation::_8_::_m_perObjectType::_m_prob1RoadsideBarrierN = 0;
      @sysvar::XCP::RadarFC_Obj::_g_PL_AD_fw_Radar_1R1V_rpc_XilObjBypassingRunnable_XilObjBypassingRunnable_m_pad_radarObjPort_par_out_local::TChangeableMemPool::_::_::_m_arrayPool::_0_::_elem::_m_objectInformation::_8_::_m_perObjectType::_m_prob1StatUnknownN = 128;
      @sysvar::XCP::RadarFC_Obj::_g_PL_AD_fw_Radar_1R1V_rpc_XilObjBypassingRunnable_XilObjBypassingRunnable_m_pad_radarObjPort_par_out_local::TChangeableMemPool::_::_::_m_arrayPool::_0_::_elem::_m_objectInformation::_8_::_m_perObjectType::_m_prob1PassengerCarN = 0;
      @sysvar::XCP::RadarFC_Obj::_g_PL_AD_fw_Radar_1R1V_rpc_XilObjBypassingRunnable_XilObjBypassingRunnable_m_pad_radarObjPort_par_out_local::TChangeableMemPool::_::_::_m_arrayPool::_0_::_elem::_m_objectInformation::_8_::_m_perObjectType::_m_prob1TruckN = 128;
      @sysvar::XCP::RadarFC_Obj::_g_PL_AD_fw_Radar_1R1V_rpc_XilObjBypassingRunnable_XilObjBypassingRunnable_m_pad_radarObjPort_par_out_local::TChangeableMemPool::_::_::_m_arrayPool::_0_::_elem::_m_objectInformation::_8_::_m_perObjectType::_m_prob1FourWheelUnknownN = 0;
      @sysvar::XCP::RadarFC_Obj::_g_PL_AD_fw_Radar_1R1V_rpc_XilObjBypassingRunnable_XilObjBypassingRunnable_m_pad_radarObjPort_par_out_local::TChangeableMemPool::_::_::_m_arrayPool::_0_::_elem::_m_objectInformation::_8_::_m_dWidthN = 256;
        break;

      case 6: //"PassengerCar"
      @sysvar::XCP::RadarFC_Obj::_g_PL_AD_fw_Radar_1R1V_rpc_XilObjBypassingRunnable_XilObjBypassingRunnable_m_pad_radarObjPort_par_out_local::TChangeableMemPool::_::_::_m_arrayPool::_0_::_elem::_m_objectInformation::_8_::_m_perObjectType::_m_prob1ObstacleN = 128;
      @sysvar::XCP::RadarFC_Obj::_g_PL_AD_fw_Radar_1R1V_rpc_XilObjBypassingRunnable_XilObjBypassingRunnable_m_pad_radarObjPort_par_out_local::TChangeableMemPool::_::_::_m_arrayPool::_0_::_elem::_m_objectInformation::_8_::_m_perObjectType::_m_prob1NonObstacleN = 0;
      @sysvar::XCP::RadarFC_Obj::_g_PL_AD_fw_Radar_1R1V_rpc_XilObjBypassingRunnable_XilObjBypassingRunnable_m_pad_radarObjPort_par_out_local::TChangeableMemPool::_::_::_m_arrayPool::_0_::_elem::_m_objectInformation::_8_::_m_perObjectType::_m_prob1UnknownN = 0;
      @sysvar::XCP::RadarFC_Obj::_g_PL_AD_fw_Radar_1R1V_rpc_XilObjBypassingRunnable_XilObjBypassingRunnable_m_pad_radarObjPort_par_out_local::TChangeableMemPool::_::_::_m_arrayPool::_0_::_elem::_m_objectInformation::_8_::_m_perObjectType::_m_prob1MobileN = 128;
      @sysvar::XCP::RadarFC_Obj::_g_PL_AD_fw_Radar_1R1V_rpc_XilObjBypassingRunnable_XilObjBypassingRunnable_m_pad_radarObjPort_par_out_local::TChangeableMemPool::_::_::_m_arrayPool::_0_::_elem::_m_objectInformation::_8_::_m_perObjectType::_m_prob1StationaryN = 0;
      @sysvar::XCP::RadarFC_Obj::_g_PL_AD_fw_Radar_1R1V_rpc_XilObjBypassingRunnable_XilObjBypassingRunnable_m_pad_radarObjPort_par_out_local::TChangeableMemPool::_::_::_m_arrayPool::_0_::_elem::_m_objectInformation::_8_::_m_perObjectType::_m_prob1ObstUnknownN = 0;
      @sysvar::XCP::RadarFC_Obj::_g_PL_AD_fw_Radar_1R1V_rpc_XilObjBypassingRunnable_XilObjBypassingRunnable_m_pad_radarObjPort_par_out_local::TChangeableMemPool::_::_::_m_arrayPool::_0_::_elem::_m_objectInformation::_8_::_m_perObjectType::_m_prob1FourPlusWheelerN = 128;
      @sysvar::XCP::RadarFC_Obj::_g_PL_AD_fw_Radar_1R1V_rpc_XilObjBypassingRunnable_XilObjBypassingRunnable_m_pad_radarObjPort_par_out_local::TChangeableMemPool::_::_::_m_arrayPool::_0_::_elem::_m_objectInformation::_8_::_m_perObjectType::_m_prob1TwoWheelerN = 0;
      @sysvar::XCP::RadarFC_Obj::_g_PL_AD_fw_Radar_1R1V_rpc_XilObjBypassingRunnable_XilObjBypassingRunnable_m_pad_radarObjPort_par_out_local::TChangeableMemPool::_::_::_m_arrayPool::_0_::_elem::_m_objectInformation::_8_::_m_perObjectType::_m_prob1PedestrianN = 0;
      @sysvar::XCP::RadarFC_Obj::_g_PL_AD_fw_Radar_1R1V_rpc_XilObjBypassingRunnable_XilObjBypassingRunnable_m_pad_radarObjPort_par_out_local::TChangeableMemPool::_::_::_m_arrayPool::_0_::_elem::_m_objectInformation::_8_::_m_perObjectType::_m_prob1MovUnknownN = 0;
      @sysvar::XCP::RadarFC_Obj::_g_PL_AD_fw_Radar_1R1V_rpc_XilObjBypassingRunnable_XilObjBypassingRunnable_m_pad_radarObjPort_par_out_local::TChangeableMemPool::_::_::_m_arrayPool::_0_::_elem::_m_objectInformation::_8_::_m_perObjectType::_m_prob1RoadsideBarrierN = 0;
      @sysvar::XCP::RadarFC_Obj::_g_PL_AD_fw_Radar_1R1V_rpc_XilObjBypassingRunnable_XilObjBypassingRunnable_m_pad_radarObjPort_par_out_local::TChangeableMemPool::_::_::_m_arrayPool::_0_::_elem::_m_objectInformation::_8_::_m_perObjectType::_m_prob1StatUnknownN = 128;
      @sysvar::XCP::RadarFC_Obj::_g_PL_AD_fw_Radar_1R1V_rpc_XilObjBypassingRunnable_XilObjBypassingRunnable_m_pad_radarObjPort_par_out_local::TChangeableMemPool::_::_::_m_arrayPool::_0_::_elem::_m_objectInformation::_8_::_m_perObjectType::_m_prob1PassengerCarN = 128;
      @sysvar::XCP::RadarFC_Obj::_g_PL_AD_fw_Radar_1R1V_rpc_XilObjBypassingRunnable_XilObjBypassingRunnable_m_pad_radarObjPort_par_out_local::TChangeableMemPool::_::_::_m_arrayPool::_0_::_elem::_m_objectInformation::_8_::_m_perObjectType::_m_prob1TruckN = 0;
      @sysvar::XCP::RadarFC_Obj::_g_PL_AD_fw_Radar_1R1V_rpc_XilObjBypassingRunnable_XilObjBypassingRunnable_m_pad_radarObjPort_par_out_local::TChangeableMemPool::_::_::_m_arrayPool::_0_::_elem::_m_objectInformation::_8_::_m_perObjectType::_m_prob1FourWheelUnknownN = 0;
      @sysvar::XCP::RadarFC_Obj::_g_PL_AD_fw_Radar_1R1V_rpc_XilObjBypassingRunnable_XilObjBypassingRunnable_m_pad_radarObjPort_par_out_local::TChangeableMemPool::_::_::_m_arrayPool::_0_::_elem::_m_objectInformation::_8_::_m_dWidthN = 256;
        break;
    }
    break;
  }
}