/*@!Encoding:1252*/
/**
 * @file TrafficSign_Map_FDX.cin
 * @author ADAS_HIL_TEAM
 * @date 10-04-2022
 * @brief  Contains functions to receive Traffic Sign Map objects via FDX
 *
 * ################################################################
 * C O P Y R I G H T S
 * ----------------------------------------------------------------
 * Copyright (c) 2022-2023 by Robert Bosch GmbH. All rights reserved.
 
 * The reproduction, distribution and utilization of this file as
 * well as the communication of its contents to others without express
 * authorization is prohibited. Offenders will be held liable for the
 * payment of damages. All rights reserved in the event of the grant
 * of a patent, utility model or design.
 *
 * ################################################################
*/

includes
{
}

variables
{
}

int f_TS_FDXTrafficSignIsValid(byte ts_id)
{
  int result;
  
  // TBD : here, check the traffic sign from FDX in position 'ts_id' is valid
  
  return result; // 0 - invalid; 1 - valid
}

void f_TS_Update_From_FDX(byte ts_id)
{
  /*
  @sysvar::Traffic_Sign::ts_traffic_sign_input_array.ts_additional_sign_array[ts_id] = @FDX_in_HIL_specific_TS::FDX_in_TS_additional_sign[ts_id];
  @sysvar::Traffic_Sign::ts_traffic_sign_input_array.ts_lane_id_of_traffic_sign_array[ts_id] = @FDX_in_HIL_specific_TS::FDX_in_TS_lane_id_of_traffic_sign[ts_id];
  @sysvar::Traffic_Sign::ts_traffic_sign_input_array.ts_sign_location_array[ts_id] = @FDX_in_HIL_specific_TS::FDX_in_TS_sign_location[ts_id];
  @sysvar::Traffic_Sign::ts_traffic_sign_input_array.ts_sign_offset_calculated_array[ts_id] = @FDX_in_HIL_specific_TS::FDX_in_TS_sign_offset[ts_id];
  
  // get sign type : main and effective (according to applied structure on TS panel)
  @sysvar::Traffic_Sign::ts_traffic_sign_input_array.ts_sign_type_array[ts_id] = g_TS_SignTypeOfEffSignType[@FDX_in_HIL_specific_TS::FDX_in_TS_effective_sign_type[ts_id]];
  if(@sysvar::Traffic_Sign::ts_traffic_sign_input_array.ts_sign_type_array[ts_id] == TS_SIGNTYPE_INFO)
  {
    @sysvar::Traffic_Sign::ts_traffic_sign_input_array.ts_sign_type_effective_info_array[ts_id] = g_TS_PanelIdxOfEffSignType[@FDX_in_HIL_specific_TS::FDX_in_TS_effective_sign_type[ts_id]];
  }
  else if(@sysvar::Traffic_Sign::ts_traffic_sign_input_array.ts_sign_type_array[ts_id] == TS_SIGNTYPE_OTHER)
  {
    @sysvar::Traffic_Sign::ts_traffic_sign_input_array.ts_sign_type_effective_other_array[ts_id] = g_TS_PanelIdxOfEffSignType[@FDX_in_HIL_specific_TS::FDX_in_TS_effective_sign_type[ts_id]];
  }
  else if(@sysvar::Traffic_Sign::ts_traffic_sign_input_array.ts_sign_type_array[ts_id] == TS_SIGNTYPE_PRIO)
  {
    @sysvar::Traffic_Sign::ts_traffic_sign_input_array.ts_sign_type_effective_prio_array[ts_id] = g_TS_PanelIdxOfEffSignType[@FDX_in_HIL_specific_TS::FDX_in_TS_effective_sign_type[ts_id]];
  }
  else if(@sysvar::Traffic_Sign::ts_traffic_sign_input_array.ts_sign_type_array[ts_id] == TS_SIGNTYPE_PROHIBITION)
  {
    @sysvar::Traffic_Sign::ts_traffic_sign_input_array.ts_sign_type_effective_prohibition_array[ts_id] = g_TS_PanelIdxOfEffSignType[@FDX_in_HIL_specific_TS::FDX_in_TS_effective_sign_type[ts_id]];
  }
  else if(@sysvar::Traffic_Sign::ts_traffic_sign_input_array.ts_sign_type_array[ts_id] == TS_SIGNTYPE_SL)
  {
    @sysvar::Traffic_Sign::ts_traffic_sign_input_array.ts_sign_type_effective_SL_array[ts_id] = g_TS_PanelIdxOfEffSignType[@FDX_in_HIL_specific_TS::FDX_in_TS_effective_sign_type[ts_id]];
  }
  else if(@sysvar::Traffic_Sign::ts_traffic_sign_input_array.ts_sign_type_array[ts_id] == TS_SIGNTYPE_WARN)
  {
    @sysvar::Traffic_Sign::ts_traffic_sign_input_array.ts_sign_type_effective_warning_array[ts_id] = g_TS_PanelIdxOfEffSignType[@FDX_in_HIL_specific_TS::FDX_in_TS_effective_sign_type[ts_id]];
  }
  
  @sysvar::Traffic_Sign::ts_traffic_sign_input_array.ts_simulated_distance_array[ts_id] = g_TS_SIMULATED_DISTANCE;
  @sysvar::Traffic_Sign::ts_traffic_sign_input_array.ts_simulation_protocol_array[ts_id] = TS_FDX;
  @sysvar::Traffic_Sign::ts_traffic_sign_input_array.ts_source_array[ts_id] = @FDX_in_HIL_specific_TS::FDX_in_TS_simulation_source[ts_id];
  @sysvar::Traffic_Sign::ts_traffic_sign_input_array.ts_time_condition_array[ts_id] = @FDX_in_HIL_specific_TS::FDX_in_TS_time_condition[ts_id];
  @sysvar::Traffic_Sign::ts_traffic_sign_input_array.ts_traffic_sign_id_array[ts_id] = @FDX_in_HIL_specific_TS::FDX_in_TS_traffic_sign_id[ts_id];
  */
}