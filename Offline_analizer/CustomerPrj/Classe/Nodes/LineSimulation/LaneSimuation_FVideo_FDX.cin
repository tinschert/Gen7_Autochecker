/*@!Encoding:1252*/
/**
 * @file LaneSimuation_FVideo_FDX.cin
 * @author ADAS_HIL_TEAM
 * @date 10-04-2022
 * @brief  Contains functions to process lane segment info received via FDX
 *
 * ################################################################
 * C O P Y R I G H T S
 * ----------------------------------------------------------------
 * Copyright (c) 2022-2023 by Robert Bosch GmbH. All rights reserved.
 
 * The reproduction, distribution and utilization of this file as
 * well as the communication of its contents to others without express
 * authorization is prohibited. Offenders will be held liable for the
 * payment of damages. All rights reserved in the event of the grant
 * of a patent, utility model or design.
 *
 * ################################################################
*/

includes
{
}

variables
{
}

void f_LaneSim_UpdateLaneSegmentsFromFDX()
{
  // TBD : get Lane segment data from FDX content (sysvars)
}