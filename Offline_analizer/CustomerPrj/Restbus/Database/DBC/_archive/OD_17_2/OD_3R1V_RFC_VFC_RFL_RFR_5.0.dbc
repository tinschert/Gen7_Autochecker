VERSION "created by canmatrix"

NS_ :

BS_:

BU_: RadarFrontCenter VideoFrontCenter RadarFrontLeft RadarFrontRight ReceiveECU

BO_ 247 VFC_TrafficSign09: 48 VideoFrontCenter
 SG_ VFC_TS09_CRC : 0|16@1+ (1,0) [0|65535] ""  RadarFrontCenter
 SG_ VFC_TS09_AliveCtr : 16|8@1+ (1,0) [0|255] ""  RadarFrontCenter
 SG_ VFC_TS09_ProtBlockCtr : 24|4@1+ (1,0) [0|15] ""  RadarFrontCenter
 SG_ VFC_TS09_ProtOrderIndex : 32|4@1+ (1,0) [0|15] ""  RadarFrontCenter
 SG_ VFC_TS09_ID : 40|8@1+ (1,0) [1|255] ""  RadarFrontCenter
 SG_ VFC_TS09_Class : 48|8@1+ (1,0) [0|206] ""  RadarFrontCenter
 SG_ VFC_TS09_TSProb : 56|6@1+ (2,0) [0|100] "%"  RadarFrontCenter
 SG_ VFC_TS09_Dx : 64|9@1+ (0.2,0) [0|102.2] "m"  RadarFrontCenter
 SG_ VFC_TS09_Dy : 80|8@1+ (0.2,-25.6) [-25.6|25.4] "m"  RadarFrontCenter
 SG_ VFC_TS09_Dz : 88|6@1+ (0.2,0) [0|12.6] "m"  RadarFrontCenter
 SG_ VFC_TS09_DxStdDev : 96|8@1+ (0.25,0) [0|63.75] "m"  RadarFrontCenter
 SG_ VFC_TS09_DyStdDev : 104|7@1+ (0.1,0) [0|12.7] "m"  RadarFrontCenter
 SG_ VFC_TS09_DzStdDev : 112|6@1+ (0.1,0) [0|6.3] "m"  RadarFrontCenter
 SG_ VFC_TS09_Width : 120|7@1+ (0.1,0) [0|12.7] "m"  RadarFrontCenter
 SG_ VFC_TS09_Height : 128|6@1+ (0.1,0) [0|6.3] "m"  RadarFrontCenter
 SG_ VFC_TS09_EmbedFlag : 136|3@1+ (1,0) [0|7] ""  RadarFrontCenter
 SG_ VFC_TS09_Quality : 139|1@1+ (1,0) [0|1] ""  RadarFrontCenter
 SG_ VFC_TS09_VMS : 140|1@1+ (1,0) [0|1] ""  RadarFrontCenter
 SG_ VFC_TS09_Stable : 141|1@1+ (1,0) [0|1] ""  RadarFrontCenter
 SG_ VFC_TS09_VehicleSticker : 142|1@1+ (1,0) [0|1] ""  RadarFrontCenter
 SG_ VFC_TS09_InternalTrack : 143|1@1+ (1,0) [0|1] ""  RadarFrontCenter
 SG_ VFC_TS09_ValidLanes : 144|5@1+ (1,0) [0|31] ""  RadarFrontCenter
 SG_ VFC_TS09_ValidDay : 152|7@1+ (1,0) [0|127] ""  RadarFrontCenter
 SG_ VFC_TS09_ValidTimeRange1Start : 160|7@1+ (15,0) [0|1440] "min"  RadarFrontCenter
 SG_ VFC_TS09_ValidTimeRange1End : 168|7@1+ (15,0) [0|1440] "min"  RadarFrontCenter
 SG_ VFC_TS09_ValidTimeRange2Start : 176|7@1+ (15,0) [0|1440] "min"  RadarFrontCenter
 SG_ VFC_TS09_ValidTimeRange2End : 184|7@1+ (15,0) [0|1440] "min"  RadarFrontCenter
 SG_ VFC_TS09_ValidInDist : 192|10@1+ (10,0) [0|10230] "m"  RadarFrontCenter
 SG_ VFC_TS09_ValidDist : 208|10@1+ (10,0) [0|10230] "m"  RadarFrontCenter
 SG_ VFC_TS09_AddTSCount : 232|3@1+ (1,0) [0|6] ""  RadarFrontCenter
 SG_ VFC_TS09_AddTS1Class : 240|8@1+ (1,0) [0|68] ""  RadarFrontCenter
 SG_ VFC_TS09_AddTS1Prob : 248|6@1+ (2,0) [0|100] "%"  RadarFrontCenter
 SG_ VFC_TS09_AddTS1Quality : 254|1@1+ (1,0) [0|1] ""  RadarFrontCenter
 SG_ VFC_TS09_AddTS1VMS : 255|1@1+ (1,0) [0|1] ""  RadarFrontCenter
 SG_ VFC_TS09_AddTS2Class : 256|8@1+ (1,0) [0|68] ""  RadarFrontCenter
 SG_ VFC_TS09_AddTS2Prob : 264|6@1+ (2,0) [0|100] "%"  RadarFrontCenter
 SG_ VFC_TS09_AddTS2Quality : 270|1@1+ (1,0) [0|1] ""  RadarFrontCenter
 SG_ VFC_TS09_AddTS2VMS : 271|1@1+ (1,0) [0|1] ""  RadarFrontCenter
 SG_ VFC_TS09_AddTS3Class : 272|8@1+ (1,0) [0|68] ""  RadarFrontCenter
 SG_ VFC_TS09_AddTS3Prob : 280|6@1+ (2,0) [0|100] "%"  RadarFrontCenter
 SG_ VFC_TS09_AddTS3Quality : 286|1@1+ (1,0) [0|1] ""  RadarFrontCenter
 SG_ VFC_TS09_AddTS3VMS : 287|1@1+ (1,0) [0|1] ""  RadarFrontCenter
 SG_ VFC_TS09_AddTS4Class : 288|8@1+ (1,0) [0|68] ""  RadarFrontCenter
 SG_ VFC_TS09_AddTS4Prob : 296|6@1+ (2,0) [0|100] "%"  RadarFrontCenter
 SG_ VFC_TS09_AddTS4Quality : 302|1@1+ (1,0) [0|1] ""  RadarFrontCenter
 SG_ VFC_TS09_AddTS4VMS : 303|1@1+ (1,0) [0|1] ""  RadarFrontCenter
 SG_ VFC_TS09_AddTS5Class : 304|8@1+ (1,0) [0|68] ""  RadarFrontCenter
 SG_ VFC_TS09_AddTS5Prob : 312|6@1+ (2,0) [0|100] "%"  RadarFrontCenter
 SG_ VFC_TS09_AddTS5Quality : 318|1@1+ (1,0) [0|1] ""  RadarFrontCenter
 SG_ VFC_TS09_AddTS5VMS : 319|1@1+ (1,0) [0|1] ""  RadarFrontCenter
 SG_ VFC_TS09_AddTS6Class : 320|8@1+ (1,0) [0|68] ""  RadarFrontCenter
 SG_ VFC_TS09_AddTS6Prob : 328|6@1+ (2,0) [0|100] "%"  RadarFrontCenter
 SG_ VFC_TS09_AddTS6Quality : 334|1@1+ (1,0) [0|1] ""  RadarFrontCenter
 SG_ VFC_TS09_AddTS6VMS : 335|1@1+ (1,0) [0|1] ""  RadarFrontCenter

BO_ 248 VFC_TrafficSign10: 48 VideoFrontCenter
 SG_ VFC_TS10_CRC : 0|16@1+ (1,0) [0|65535] ""  RadarFrontCenter
 SG_ VFC_TS10_AliveCtr : 16|8@1+ (1,0) [0|255] ""  RadarFrontCenter
 SG_ VFC_TS10_ProtBlockCtr : 24|4@1+ (1,0) [0|15] ""  RadarFrontCenter
 SG_ VFC_TS10_ProtOrderIndex : 32|4@1+ (1,0) [0|15] ""  RadarFrontCenter
 SG_ VFC_TS10_ID : 40|8@1+ (1,0) [1|255] ""  RadarFrontCenter
 SG_ VFC_TS10_Class : 48|8@1+ (1,0) [0|206] ""  RadarFrontCenter
 SG_ VFC_TS10_TSProb : 56|6@1+ (2,0) [0|100] "%"  RadarFrontCenter
 SG_ VFC_TS10_Dx : 64|9@1+ (0.2,0) [0|102.2] "m"  RadarFrontCenter
 SG_ VFC_TS10_Dy : 80|8@1+ (0.2,-25.6) [-25.6|25.4] "m"  RadarFrontCenter
 SG_ VFC_TS10_Dz : 88|6@1+ (0.2,0) [0|12.6] "m"  RadarFrontCenter
 SG_ VFC_TS10_DxStdDev : 96|8@1+ (0.25,0) [0|63.75] "m"  RadarFrontCenter
 SG_ VFC_TS10_DyStdDev : 104|7@1+ (0.1,0) [0|12.7] "m"  RadarFrontCenter
 SG_ VFC_TS10_DzStdDev : 112|6@1+ (0.1,0) [0|6.3] "m"  RadarFrontCenter
 SG_ VFC_TS10_Width : 120|7@1+ (0.1,0) [0|12.7] "m"  RadarFrontCenter
 SG_ VFC_TS10_Height : 128|6@1+ (0.1,0) [0|6.3] "m"  RadarFrontCenter
 SG_ VFC_TS10_EmbedFlag : 136|3@1+ (1,0) [0|7] ""  RadarFrontCenter
 SG_ VFC_TS10_Quality : 139|1@1+ (1,0) [0|1] ""  RadarFrontCenter
 SG_ VFC_TS10_VMS : 140|1@1+ (1,0) [0|1] ""  RadarFrontCenter
 SG_ VFC_TS10_Stable : 141|1@1+ (1,0) [0|1] ""  RadarFrontCenter
 SG_ VFC_TS10_VehicleSticker : 142|1@1+ (1,0) [0|1] ""  RadarFrontCenter
 SG_ VFC_TS10_InternalTrack : 143|1@1+ (1,0) [0|1] ""  RadarFrontCenter
 SG_ VFC_TS10_ValidLanes : 144|5@1+ (1,0) [0|31] ""  RadarFrontCenter
 SG_ VFC_TS10_ValidDay : 152|7@1+ (1,0) [0|127] ""  RadarFrontCenter
 SG_ VFC_TS10_ValidTimeRange1Start : 160|7@1+ (15,0) [0|1440] "min"  RadarFrontCenter
 SG_ VFC_TS10_ValidTimeRange1End : 168|7@1+ (15,0) [0|1440] "min"  RadarFrontCenter
 SG_ VFC_TS10_ValidTimeRange2Start : 176|7@1+ (15,0) [0|1440] "min"  RadarFrontCenter
 SG_ VFC_TS10_ValidTimeRange2End : 184|7@1+ (15,0) [0|1440] "min"  RadarFrontCenter
 SG_ VFC_TS10_ValidInDist : 192|10@1+ (10,0) [0|10230] "m"  RadarFrontCenter
 SG_ VFC_TS10_ValidDist : 208|10@1+ (10,0) [0|10230] "m"  RadarFrontCenter
 SG_ VFC_TS10_AddTSCount : 232|3@1+ (1,0) [0|6] ""  RadarFrontCenter
 SG_ VFC_TS10_AddTS1Class : 240|8@1+ (1,0) [0|68] ""  RadarFrontCenter
 SG_ VFC_TS10_AddTS1Prob : 248|6@1+ (2,0) [0|100] "%"  RadarFrontCenter
 SG_ VFC_TS10_AddTS1Quality : 254|1@1+ (1,0) [0|1] ""  RadarFrontCenter
 SG_ VFC_TS10_AddTS1VMS : 255|1@1+ (1,0) [0|1] ""  RadarFrontCenter
 SG_ VFC_TS10_AddTS2Class : 256|8@1+ (1,0) [0|68] ""  RadarFrontCenter
 SG_ VFC_TS10_AddTS2Prob : 264|6@1+ (2,0) [0|100] "%"  RadarFrontCenter
 SG_ VFC_TS10_AddTS2Quality : 270|1@1+ (1,0) [0|1] ""  RadarFrontCenter
 SG_ VFC_TS10_AddTS2VMS : 271|1@1+ (1,0) [0|1] ""  RadarFrontCenter
 SG_ VFC_TS10_AddTS3Class : 272|8@1+ (1,0) [0|68] ""  RadarFrontCenter
 SG_ VFC_TS10_AddTS3Prob : 280|6@1+ (2,0) [0|100] "%"  RadarFrontCenter
 SG_ VFC_TS10_AddTS3Quality : 286|1@1+ (1,0) [0|1] ""  RadarFrontCenter
 SG_ VFC_TS10_AddTS3VMS : 287|1@1+ (1,0) [0|1] ""  RadarFrontCenter
 SG_ VFC_TS10_AddTS4Class : 288|8@1+ (1,0) [0|68] ""  RadarFrontCenter
 SG_ VFC_TS10_AddTS4Prob : 296|6@1+ (2,0) [0|100] "%"  RadarFrontCenter
 SG_ VFC_TS10_AddTS4Quality : 302|1@1+ (1,0) [0|1] ""  RadarFrontCenter
 SG_ VFC_TS10_AddTS4VMS : 303|1@1+ (1,0) [0|1] ""  RadarFrontCenter
 SG_ VFC_TS10_AddTS5Class : 304|8@1+ (1,0) [0|68] ""  RadarFrontCenter
 SG_ VFC_TS10_AddTS5Prob : 312|6@1+ (2,0) [0|100] "%"  RadarFrontCenter
 SG_ VFC_TS10_AddTS5Quality : 318|1@1+ (1,0) [0|1] ""  RadarFrontCenter
 SG_ VFC_TS10_AddTS5VMS : 319|1@1+ (1,0) [0|1] ""  RadarFrontCenter
 SG_ VFC_TS10_AddTS6Class : 320|8@1+ (1,0) [0|68] ""  RadarFrontCenter
 SG_ VFC_TS10_AddTS6Prob : 328|6@1+ (2,0) [0|100] "%"  RadarFrontCenter
 SG_ VFC_TS10_AddTS6Quality : 334|1@1+ (1,0) [0|1] ""  RadarFrontCenter
 SG_ VFC_TS10_AddTS6VMS : 335|1@1+ (1,0) [0|1] ""  RadarFrontCenter

BO_ 249 VFC_TrafficSign11: 48 VideoFrontCenter
 SG_ VFC_TS11_CRC : 0|16@1+ (1,0) [0|65535] ""  RadarFrontCenter
 SG_ VFC_TS11_AliveCtr : 16|8@1+ (1,0) [0|255] ""  RadarFrontCenter
 SG_ VFC_TS11_ProtBlockCtr : 24|4@1+ (1,0) [0|15] ""  RadarFrontCenter
 SG_ VFC_TS11_ProtOrderIndex : 32|4@1+ (1,0) [0|15] ""  RadarFrontCenter
 SG_ VFC_TS11_ID : 40|8@1+ (1,0) [1|255] ""  RadarFrontCenter
 SG_ VFC_TS11_Class : 48|8@1+ (1,0) [0|206] ""  RadarFrontCenter
 SG_ VFC_TS11_TSProb : 56|6@1+ (2,0) [0|100] "%"  RadarFrontCenter
 SG_ VFC_TS11_Dx : 64|9@1+ (0.2,0) [0|102.2] "m"  RadarFrontCenter
 SG_ VFC_TS11_Dy : 80|8@1+ (0.2,-25.6) [-25.6|25.4] "m"  RadarFrontCenter
 SG_ VFC_TS11_Dz : 88|6@1+ (0.2,0) [0|12.6] "m"  RadarFrontCenter
 SG_ VFC_TS11_DxStdDev : 96|8@1+ (0.25,0) [0|63.75] "m"  RadarFrontCenter
 SG_ VFC_TS11_DyStdDev : 104|7@1+ (0.1,0) [0|12.7] "m"  RadarFrontCenter
 SG_ VFC_TS11_DzStdDev : 112|6@1+ (0.1,0) [0|6.3] "m"  RadarFrontCenter
 SG_ VFC_TS11_Width : 120|7@1+ (0.1,0) [0|12.7] "m"  RadarFrontCenter
 SG_ VFC_TS11_Height : 128|6@1+ (0.1,0) [0|6.3] "m"  RadarFrontCenter
 SG_ VFC_TS11_EmbedFlag : 136|3@1+ (1,0) [0|7] ""  RadarFrontCenter
 SG_ VFC_TS11_Quality : 139|1@1+ (1,0) [0|1] ""  RadarFrontCenter
 SG_ VFC_TS11_VMS : 140|1@1+ (1,0) [0|1] ""  RadarFrontCenter
 SG_ VFC_TS11_Stable : 141|1@1+ (1,0) [0|1] ""  RadarFrontCenter
 SG_ VFC_TS11_VehicleSticker : 142|1@1+ (1,0) [0|1] ""  RadarFrontCenter
 SG_ VFC_TS11_InternalTrack : 143|1@1+ (1,0) [0|1] ""  RadarFrontCenter
 SG_ VFC_TS11_ValidLanes : 144|5@1+ (1,0) [0|31] ""  RadarFrontCenter
 SG_ VFC_TS11_ValidDay : 152|7@1+ (1,0) [0|127] ""  RadarFrontCenter
 SG_ VFC_TS11_ValidTimeRange1Start : 160|7@1+ (15,0) [0|1440] "min"  RadarFrontCenter
 SG_ VFC_TS11_ValidTimeRange1End : 168|7@1+ (15,0) [0|1440] "min"  RadarFrontCenter
 SG_ VFC_TS11_ValidTimeRange2Start : 176|7@1+ (15,0) [0|1440] "min"  RadarFrontCenter
 SG_ VFC_TS11_ValidTimeRange2End : 184|7@1+ (15,0) [0|1440] "min"  RadarFrontCenter
 SG_ VFC_TS11_ValidInDist : 192|10@1+ (10,0) [0|10230] "m"  RadarFrontCenter
 SG_ VFC_TS11_ValidDist : 208|10@1+ (10,0) [0|10230] "m"  RadarFrontCenter
 SG_ VFC_TS11_AddTSCount : 232|3@1+ (1,0) [0|6] ""  RadarFrontCenter
 SG_ VFC_TS11_AddTS1Class : 240|8@1+ (1,0) [0|68] ""  RadarFrontCenter
 SG_ VFC_TS11_AddTS1Prob : 248|6@1+ (2,0) [0|100] "%"  RadarFrontCenter
 SG_ VFC_TS11_AddTS1Quality : 254|1@1+ (1,0) [0|1] ""  RadarFrontCenter
 SG_ VFC_TS11_AddTS1VMS : 255|1@1+ (1,0) [0|1] ""  RadarFrontCenter
 SG_ VFC_TS11_AddTS2Class : 256|8@1+ (1,0) [0|68] ""  RadarFrontCenter
 SG_ VFC_TS11_AddTS2Prob : 264|6@1+ (2,0) [0|100] "%"  RadarFrontCenter
 SG_ VFC_TS11_AddTS2Quality : 270|1@1+ (1,0) [0|1] ""  RadarFrontCenter
 SG_ VFC_TS11_AddTS2VMS : 271|1@1+ (1,0) [0|1] ""  RadarFrontCenter
 SG_ VFC_TS11_AddTS3Class : 272|8@1+ (1,0) [0|68] ""  RadarFrontCenter
 SG_ VFC_TS11_AddTS3Prob : 280|6@1+ (2,0) [0|100] "%"  RadarFrontCenter
 SG_ VFC_TS11_AddTS3Quality : 286|1@1+ (1,0) [0|1] ""  RadarFrontCenter
 SG_ VFC_TS11_AddTS3VMS : 287|1@1+ (1,0) [0|1] ""  RadarFrontCenter
 SG_ VFC_TS11_AddTS4Class : 288|8@1+ (1,0) [0|68] ""  RadarFrontCenter
 SG_ VFC_TS11_AddTS4Prob : 296|6@1+ (2,0) [0|100] "%"  RadarFrontCenter
 SG_ VFC_TS11_AddTS4Quality : 302|1@1+ (1,0) [0|1] ""  RadarFrontCenter
 SG_ VFC_TS11_AddTS4VMS : 303|1@1+ (1,0) [0|1] ""  RadarFrontCenter
 SG_ VFC_TS11_AddTS5Class : 304|8@1+ (1,0) [0|68] ""  RadarFrontCenter
 SG_ VFC_TS11_AddTS5Prob : 312|6@1+ (2,0) [0|100] "%"  RadarFrontCenter
 SG_ VFC_TS11_AddTS5Quality : 318|1@1+ (1,0) [0|1] ""  RadarFrontCenter
 SG_ VFC_TS11_AddTS5VMS : 319|1@1+ (1,0) [0|1] ""  RadarFrontCenter
 SG_ VFC_TS11_AddTS6Class : 320|8@1+ (1,0) [0|68] ""  RadarFrontCenter
 SG_ VFC_TS11_AddTS6Prob : 328|6@1+ (2,0) [0|100] "%"  RadarFrontCenter
 SG_ VFC_TS11_AddTS6Quality : 334|1@1+ (1,0) [0|1] ""  RadarFrontCenter
 SG_ VFC_TS11_AddTS6VMS : 335|1@1+ (1,0) [0|1] ""  RadarFrontCenter

BO_ 250 VFC_TrafficSign12: 48 VideoFrontCenter
 SG_ VFC_TS12_CRC : 0|16@1+ (1,0) [0|65535] ""  RadarFrontCenter
 SG_ VFC_TS12_AliveCtr : 16|8@1+ (1,0) [0|255] ""  RadarFrontCenter
 SG_ VFC_TS12_ProtBlockCtr : 24|4@1+ (1,0) [0|15] ""  RadarFrontCenter
 SG_ VFC_TS12_ProtOrderIndex : 32|4@1+ (1,0) [0|15] ""  RadarFrontCenter
 SG_ VFC_TS12_ID : 40|8@1+ (1,0) [1|255] ""  RadarFrontCenter
 SG_ VFC_TS12_Class : 48|8@1+ (1,0) [0|206] ""  RadarFrontCenter
 SG_ VFC_TS12_TSProb : 56|6@1+ (2,0) [0|100] "%"  RadarFrontCenter
 SG_ VFC_TS12_Dx : 64|9@1+ (0.2,0) [0|102.2] "m"  RadarFrontCenter
 SG_ VFC_TS12_Dy : 80|8@1+ (0.2,-25.6) [-25.6|25.4] "m"  RadarFrontCenter
 SG_ VFC_TS12_Dz : 88|6@1+ (0.2,0) [0|12.6] "m"  RadarFrontCenter
 SG_ VFC_TS12_DxStdDev : 96|8@1+ (0.25,0) [0|63.75] "m"  RadarFrontCenter
 SG_ VFC_TS12_DyStdDev : 104|7@1+ (0.1,0) [0|12.7] "m"  RadarFrontCenter
 SG_ VFC_TS12_DzStdDev : 112|6@1+ (0.1,0) [0|6.3] "m"  RadarFrontCenter
 SG_ VFC_TS12_Width : 120|7@1+ (0.1,0) [0|12.7] "m"  RadarFrontCenter
 SG_ VFC_TS12_Height : 128|6@1+ (0.1,0) [0|6.3] "m"  RadarFrontCenter
 SG_ VFC_TS12_EmbedFlag : 136|3@1+ (1,0) [0|7] ""  RadarFrontCenter
 SG_ VFC_TS12_Quality : 139|1@1+ (1,0) [0|1] ""  RadarFrontCenter
 SG_ VFC_TS12_VMS : 140|1@1+ (1,0) [0|1] ""  RadarFrontCenter
 SG_ VFC_TS12_Stable : 141|1@1+ (1,0) [0|1] ""  RadarFrontCenter
 SG_ VFC_TS12_VehicleSticker : 142|1@1+ (1,0) [0|1] ""  RadarFrontCenter
 SG_ VFC_TS12_InternalTrack : 143|1@1+ (1,0) [0|1] ""  RadarFrontCenter
 SG_ VFC_TS12_ValidLanes : 144|5@1+ (1,0) [0|31] ""  RadarFrontCenter
 SG_ VFC_TS12_ValidDay : 152|7@1+ (1,0) [0|127] ""  RadarFrontCenter
 SG_ VFC_TS12_ValidTimeRange1Start : 160|7@1+ (15,0) [0|1440] "min"  RadarFrontCenter
 SG_ VFC_TS12_ValidTimeRange1End : 168|7@1+ (15,0) [0|1440] "min"  RadarFrontCenter
 SG_ VFC_TS12_ValidTimeRange2Start : 176|7@1+ (15,0) [0|1440] "min"  RadarFrontCenter
 SG_ VFC_TS12_ValidTimeRange2End : 184|7@1+ (15,0) [0|1440] "min"  RadarFrontCenter
 SG_ VFC_TS12_ValidInDist : 192|10@1+ (10,0) [0|10230] "m"  RadarFrontCenter
 SG_ VFC_TS12_ValidDist : 208|10@1+ (10,0) [0|10230] "m"  RadarFrontCenter
 SG_ VFC_TS12_AddTSCount : 232|3@1+ (1,0) [0|6] ""  RadarFrontCenter
 SG_ VFC_TS12_AddTS1Class : 240|8@1+ (1,0) [0|68] ""  RadarFrontCenter
 SG_ VFC_TS12_AddTS1Prob : 248|6@1+ (2,0) [0|100] "%"  RadarFrontCenter
 SG_ VFC_TS12_AddTS1Quality : 254|1@1+ (1,0) [0|1] ""  RadarFrontCenter
 SG_ VFC_TS12_AddTS1VMS : 255|1@1+ (1,0) [0|1] ""  RadarFrontCenter
 SG_ VFC_TS12_AddTS2Class : 256|8@1+ (1,0) [0|68] ""  RadarFrontCenter
 SG_ VFC_TS12_AddTS2Prob : 264|6@1+ (2,0) [0|100] "%"  RadarFrontCenter
 SG_ VFC_TS12_AddTS2Quality : 270|1@1+ (1,0) [0|1] ""  RadarFrontCenter
 SG_ VFC_TS12_AddTS2VMS : 271|1@1+ (1,0) [0|1] ""  RadarFrontCenter
 SG_ VFC_TS12_AddTS3Class : 272|8@1+ (1,0) [0|68] ""  RadarFrontCenter
 SG_ VFC_TS12_AddTS3Prob : 280|6@1+ (2,0) [0|100] "%"  RadarFrontCenter
 SG_ VFC_TS12_AddTS3Quality : 286|1@1+ (1,0) [0|1] ""  RadarFrontCenter
 SG_ VFC_TS12_AddTS3VMS : 287|1@1+ (1,0) [0|1] ""  RadarFrontCenter
 SG_ VFC_TS12_AddTS4Class : 288|8@1+ (1,0) [0|68] ""  RadarFrontCenter
 SG_ VFC_TS12_AddTS4Prob : 296|6@1+ (2,0) [0|100] "%"  RadarFrontCenter
 SG_ VFC_TS12_AddTS4Quality : 302|1@1+ (1,0) [0|1] ""  RadarFrontCenter
 SG_ VFC_TS12_AddTS4VMS : 303|1@1+ (1,0) [0|1] ""  RadarFrontCenter
 SG_ VFC_TS12_AddTS5Class : 304|8@1+ (1,0) [0|68] ""  RadarFrontCenter
 SG_ VFC_TS12_AddTS5Prob : 312|6@1+ (2,0) [0|100] "%"  RadarFrontCenter
 SG_ VFC_TS12_AddTS5Quality : 318|1@1+ (1,0) [0|1] ""  RadarFrontCenter
 SG_ VFC_TS12_AddTS5VMS : 319|1@1+ (1,0) [0|1] ""  RadarFrontCenter
 SG_ VFC_TS12_AddTS6Class : 320|8@1+ (1,0) [0|68] ""  RadarFrontCenter
 SG_ VFC_TS12_AddTS6Prob : 328|6@1+ (2,0) [0|100] "%"  RadarFrontCenter
 SG_ VFC_TS12_AddTS6Quality : 334|1@1+ (1,0) [0|1] ""  RadarFrontCenter
 SG_ VFC_TS12_AddTS6VMS : 335|1@1+ (1,0) [0|1] ""  RadarFrontCenter

BO_ 251 VFC_TrafficSign13: 48 VideoFrontCenter
 SG_ VFC_TS13_CRC : 0|16@1+ (1,0) [0|65535] ""  RadarFrontCenter
 SG_ VFC_TS13_AliveCtr : 16|8@1+ (1,0) [0|255] ""  RadarFrontCenter
 SG_ VFC_TS13_ProtBlockCtr : 24|4@1+ (1,0) [0|15] ""  RadarFrontCenter
 SG_ VFC_TS13_ProtOrderIndex : 32|4@1+ (1,0) [0|15] ""  RadarFrontCenter
 SG_ VFC_TS13_ID : 40|8@1+ (1,0) [1|255] ""  RadarFrontCenter
 SG_ VFC_TS13_Class : 48|8@1+ (1,0) [0|206] ""  RadarFrontCenter
 SG_ VFC_TS13_TSProb : 56|6@1+ (2,0) [0|100] "%"  RadarFrontCenter
 SG_ VFC_TS13_Dx : 64|9@1+ (0.2,0) [0|102.2] "m"  RadarFrontCenter
 SG_ VFC_TS13_Dy : 80|8@1+ (0.2,-25.6) [-25.6|25.4] "m"  RadarFrontCenter
 SG_ VFC_TS13_Dz : 88|6@1+ (0.2,0) [0|12.6] "m"  RadarFrontCenter
 SG_ VFC_TS13_DxStdDev : 96|8@1+ (0.25,0) [0|63.75] "m"  RadarFrontCenter
 SG_ VFC_TS13_DyStdDev : 104|7@1+ (0.1,0) [0|12.7] "m"  RadarFrontCenter
 SG_ VFC_TS13_DzStdDev : 112|6@1+ (0.1,0) [0|6.3] "m"  RadarFrontCenter
 SG_ VFC_TS13_Width : 120|7@1+ (0.1,0) [0|12.7] "m"  RadarFrontCenter
 SG_ VFC_TS13_Height : 128|6@1+ (0.1,0) [0|6.3] "m"  RadarFrontCenter
 SG_ VFC_TS13_EmbedFlag : 136|3@1+ (1,0) [0|7] ""  RadarFrontCenter
 SG_ VFC_TS13_Quality : 139|1@1+ (1,0) [0|1] ""  RadarFrontCenter
 SG_ VFC_TS13_VMS : 140|1@1+ (1,0) [0|1] ""  RadarFrontCenter
 SG_ VFC_TS13_Stable : 141|1@1+ (1,0) [0|1] ""  RadarFrontCenter
 SG_ VFC_TS13_VehicleSticker : 142|1@1+ (1,0) [0|1] ""  RadarFrontCenter
 SG_ VFC_TS13_InternalTrack : 143|1@1+ (1,0) [0|1] ""  RadarFrontCenter
 SG_ VFC_TS13_ValidLanes : 144|5@1+ (1,0) [0|31] ""  RadarFrontCenter
 SG_ VFC_TS13_ValidDay : 152|7@1+ (1,0) [0|127] ""  RadarFrontCenter
 SG_ VFC_TS13_ValidTimeRange1Start : 160|7@1+ (15,0) [0|1440] "min"  RadarFrontCenter
 SG_ VFC_TS13_ValidTimeRange1End : 168|7@1+ (15,0) [0|1440] "min"  RadarFrontCenter
 SG_ VFC_TS13_ValidTimeRange2Start : 176|7@1+ (15,0) [0|1440] "min"  RadarFrontCenter
 SG_ VFC_TS13_ValidTimeRange2End : 184|7@1+ (15,0) [0|1440] "min"  RadarFrontCenter
 SG_ VFC_TS13_ValidInDist : 192|10@1+ (10,0) [0|10230] "m"  RadarFrontCenter
 SG_ VFC_TS13_ValidDist : 208|10@1+ (10,0) [0|10230] "m"  RadarFrontCenter
 SG_ VFC_TS13_AddTSCount : 232|3@1+ (1,0) [0|6] ""  RadarFrontCenter
 SG_ VFC_TS13_AddTS1Class : 240|8@1+ (1,0) [0|68] ""  RadarFrontCenter
 SG_ VFC_TS13_AddTS1Prob : 248|6@1+ (2,0) [0|100] "%"  RadarFrontCenter
 SG_ VFC_TS13_AddTS1Quality : 254|1@1+ (1,0) [0|1] ""  RadarFrontCenter
 SG_ VFC_TS13_AddTS1VMS : 255|1@1+ (1,0) [0|1] ""  RadarFrontCenter
 SG_ VFC_TS13_AddTS2Class : 256|8@1+ (1,0) [0|68] ""  RadarFrontCenter
 SG_ VFC_TS13_AddTS2Prob : 264|6@1+ (2,0) [0|100] "%"  RadarFrontCenter
 SG_ VFC_TS13_AddTS2Quality : 270|1@1+ (1,0) [0|1] ""  RadarFrontCenter
 SG_ VFC_TS13_AddTS2VMS : 271|1@1+ (1,0) [0|1] ""  RadarFrontCenter
 SG_ VFC_TS13_AddTS3Class : 272|8@1+ (1,0) [0|68] ""  RadarFrontCenter
 SG_ VFC_TS13_AddTS3Prob : 280|6@1+ (2,0) [0|100] "%"  RadarFrontCenter
 SG_ VFC_TS13_AddTS3Quality : 286|1@1+ (1,0) [0|1] ""  RadarFrontCenter
 SG_ VFC_TS13_AddTS3VMS : 287|1@1+ (1,0) [0|1] ""  RadarFrontCenter
 SG_ VFC_TS13_AddTS4Class : 288|8@1+ (1,0) [0|68] ""  RadarFrontCenter
 SG_ VFC_TS13_AddTS4Prob : 296|6@1+ (2,0) [0|100] "%"  RadarFrontCenter
 SG_ VFC_TS13_AddTS4Quality : 302|1@1+ (1,0) [0|1] ""  RadarFrontCenter
 SG_ VFC_TS13_AddTS4VMS : 303|1@1+ (1,0) [0|1] ""  RadarFrontCenter
 SG_ VFC_TS13_AddTS5Class : 304|8@1+ (1,0) [0|68] ""  RadarFrontCenter
 SG_ VFC_TS13_AddTS5Prob : 312|6@1+ (2,0) [0|100] "%"  RadarFrontCenter
 SG_ VFC_TS13_AddTS5Quality : 318|1@1+ (1,0) [0|1] ""  RadarFrontCenter
 SG_ VFC_TS13_AddTS5VMS : 319|1@1+ (1,0) [0|1] ""  RadarFrontCenter
 SG_ VFC_TS13_AddTS6Class : 320|8@1+ (1,0) [0|68] ""  RadarFrontCenter
 SG_ VFC_TS13_AddTS6Prob : 328|6@1+ (2,0) [0|100] "%"  RadarFrontCenter
 SG_ VFC_TS13_AddTS6Quality : 334|1@1+ (1,0) [0|1] ""  RadarFrontCenter
 SG_ VFC_TS13_AddTS6VMS : 335|1@1+ (1,0) [0|1] ""  RadarFrontCenter

BO_ 252 VFC_TrafficSign14: 48 VideoFrontCenter
 SG_ VFC_TS14_CRC : 0|16@1+ (1,0) [0|65535] ""  RadarFrontCenter
 SG_ VFC_TS14_AliveCtr : 16|8@1+ (1,0) [0|255] ""  RadarFrontCenter
 SG_ VFC_TS14_ProtBlockCtr : 24|4@1+ (1,0) [0|15] ""  RadarFrontCenter
 SG_ VFC_TS14_ProtOrderIndex : 32|4@1+ (1,0) [0|15] ""  RadarFrontCenter
 SG_ VFC_TS14_ID : 40|8@1+ (1,0) [1|255] ""  RadarFrontCenter
 SG_ VFC_TS14_Class : 48|8@1+ (1,0) [0|206] ""  RadarFrontCenter
 SG_ VFC_TS14_TSProb : 56|6@1+ (2,0) [0|100] "%"  RadarFrontCenter
 SG_ VFC_TS14_Dx : 64|9@1+ (0.2,0) [0|102.2] "m"  RadarFrontCenter
 SG_ VFC_TS14_Dy : 80|8@1+ (0.2,-25.6) [-25.6|25.4] "m"  RadarFrontCenter
 SG_ VFC_TS14_Dz : 88|6@1+ (0.2,0) [0|12.6] "m"  RadarFrontCenter
 SG_ VFC_TS14_DxStdDev : 96|8@1+ (0.25,0) [0|63.75] "m"  RadarFrontCenter
 SG_ VFC_TS14_DyStdDev : 104|7@1+ (0.1,0) [0|12.7] "m"  RadarFrontCenter
 SG_ VFC_TS14_DzStdDev : 112|6@1+ (0.1,0) [0|6.3] "m"  RadarFrontCenter
 SG_ VFC_TS14_Width : 120|7@1+ (0.1,0) [0|12.7] "m"  RadarFrontCenter
 SG_ VFC_TS14_Height : 128|6@1+ (0.1,0) [0|6.3] "m"  RadarFrontCenter
 SG_ VFC_TS14_EmbedFlag : 136|3@1+ (1,0) [0|7] ""  RadarFrontCenter
 SG_ VFC_TS14_Quality : 139|1@1+ (1,0) [0|1] ""  RadarFrontCenter
 SG_ VFC_TS14_VMS : 140|1@1+ (1,0) [0|1] ""  RadarFrontCenter
 SG_ VFC_TS14_Stable : 141|1@1+ (1,0) [0|1] ""  RadarFrontCenter
 SG_ VFC_TS14_VehicleSticker : 142|1@1+ (1,0) [0|1] ""  RadarFrontCenter
 SG_ VFC_TS14_InternalTrack : 143|1@1+ (1,0) [0|1] ""  RadarFrontCenter
 SG_ VFC_TS14_ValidLanes : 144|5@1+ (1,0) [0|31] ""  RadarFrontCenter
 SG_ VFC_TS14_ValidDay : 152|7@1+ (1,0) [0|127] ""  RadarFrontCenter
 SG_ VFC_TS14_ValidTimeRange1Start : 160|7@1+ (15,0) [0|1440] "min"  RadarFrontCenter
 SG_ VFC_TS14_ValidTimeRange1End : 168|7@1+ (15,0) [0|1440] "min"  RadarFrontCenter
 SG_ VFC_TS14_ValidTimeRange2Start : 176|7@1+ (15,0) [0|1440] "min"  RadarFrontCenter
 SG_ VFC_TS14_ValidTimeRange2End : 184|7@1+ (15,0) [0|1440] "min"  RadarFrontCenter
 SG_ VFC_TS14_ValidInDist : 192|10@1+ (10,0) [0|10230] "m"  RadarFrontCenter
 SG_ VFC_TS14_ValidDist : 208|10@1+ (10,0) [0|10230] "m"  RadarFrontCenter
 SG_ VFC_TS14_AddTSCount : 232|3@1+ (1,0) [0|6] ""  RadarFrontCenter
 SG_ VFC_TS14_AddTS1Class : 240|8@1+ (1,0) [0|68] ""  RadarFrontCenter
 SG_ VFC_TS14_AddTS1Prob : 248|6@1+ (2,0) [0|100] "%"  RadarFrontCenter
 SG_ VFC_TS14_AddTS1Quality : 254|1@1+ (1,0) [0|1] ""  RadarFrontCenter
 SG_ VFC_TS14_AddTS1VMS : 255|1@1+ (1,0) [0|1] ""  RadarFrontCenter
 SG_ VFC_TS14_AddTS2Class : 256|8@1+ (1,0) [0|68] ""  RadarFrontCenter
 SG_ VFC_TS14_AddTS2Prob : 264|6@1+ (2,0) [0|100] "%"  RadarFrontCenter
 SG_ VFC_TS14_AddTS2Quality : 270|1@1+ (1,0) [0|1] ""  RadarFrontCenter
 SG_ VFC_TS14_AddTS2VMS : 271|1@1+ (1,0) [0|1] ""  RadarFrontCenter
 SG_ VFC_TS14_AddTS3Class : 272|8@1+ (1,0) [0|68] ""  RadarFrontCenter
 SG_ VFC_TS14_AddTS3Prob : 280|6@1+ (2,0) [0|100] "%"  RadarFrontCenter
 SG_ VFC_TS14_AddTS3Quality : 286|1@1+ (1,0) [0|1] ""  RadarFrontCenter
 SG_ VFC_TS14_AddTS3VMS : 287|1@1+ (1,0) [0|1] ""  RadarFrontCenter
 SG_ VFC_TS14_AddTS4Class : 288|8@1+ (1,0) [0|68] ""  RadarFrontCenter
 SG_ VFC_TS14_AddTS4Prob : 296|6@1+ (2,0) [0|100] "%"  RadarFrontCenter
 SG_ VFC_TS14_AddTS4Quality : 302|1@1+ (1,0) [0|1] ""  RadarFrontCenter
 SG_ VFC_TS14_AddTS4VMS : 303|1@1+ (1,0) [0|1] ""  RadarFrontCenter
 SG_ VFC_TS14_AddTS5Class : 304|8@1+ (1,0) [0|68] ""  RadarFrontCenter
 SG_ VFC_TS14_AddTS5Prob : 312|6@1+ (2,0) [0|100] "%"  RadarFrontCenter
 SG_ VFC_TS14_AddTS5Quality : 318|1@1+ (1,0) [0|1] ""  RadarFrontCenter
 SG_ VFC_TS14_AddTS5VMS : 319|1@1+ (1,0) [0|1] ""  RadarFrontCenter
 SG_ VFC_TS14_AddTS6Class : 320|8@1+ (1,0) [0|68] ""  RadarFrontCenter
 SG_ VFC_TS14_AddTS6Prob : 328|6@1+ (2,0) [0|100] "%"  RadarFrontCenter
 SG_ VFC_TS14_AddTS6Quality : 334|1@1+ (1,0) [0|1] ""  RadarFrontCenter
 SG_ VFC_TS14_AddTS6VMS : 335|1@1+ (1,0) [0|1] ""  RadarFrontCenter

BO_ 253 VFC_TrafficSign15: 48 VideoFrontCenter
 SG_ VFC_TS15_CRC : 0|16@1+ (1,0) [0|65535] ""  RadarFrontCenter
 SG_ VFC_TS15_AliveCtr : 16|8@1+ (1,0) [0|255] ""  RadarFrontCenter
 SG_ VFC_TS15_ProtBlockCtr : 24|4@1+ (1,0) [0|15] ""  RadarFrontCenter
 SG_ VFC_TS15_ProtOrderIndex : 32|4@1+ (1,0) [0|15] ""  RadarFrontCenter
 SG_ VFC_TS15_ID : 40|8@1+ (1,0) [1|255] ""  RadarFrontCenter
 SG_ VFC_TS15_Class : 48|8@1+ (1,0) [0|206] ""  RadarFrontCenter
 SG_ VFC_TS15_TSProb : 56|6@1+ (2,0) [0|100] "%"  RadarFrontCenter
 SG_ VFC_TS15_Dx : 64|9@1+ (0.2,0) [0|102.2] "m"  RadarFrontCenter
 SG_ VFC_TS15_Dy : 80|8@1+ (0.2,-25.6) [-25.6|25.4] "m"  RadarFrontCenter
 SG_ VFC_TS15_Dz : 88|6@1+ (0.2,0) [0|12.6] "m"  RadarFrontCenter
 SG_ VFC_TS15_DxStdDev : 96|8@1+ (0.25,0) [0|63.75] "m"  RadarFrontCenter
 SG_ VFC_TS15_DyStdDev : 104|7@1+ (0.1,0) [0|12.7] "m"  RadarFrontCenter
 SG_ VFC_TS15_DzStdDev : 112|6@1+ (0.1,0) [0|6.3] "m"  RadarFrontCenter
 SG_ VFC_TS15_Width : 120|7@1+ (0.1,0) [0|12.7] "m"  RadarFrontCenter
 SG_ VFC_TS15_Height : 128|6@1+ (0.1,0) [0|6.3] "m"  RadarFrontCenter
 SG_ VFC_TS15_EmbedFlag : 136|3@1+ (1,0) [0|7] ""  RadarFrontCenter
 SG_ VFC_TS15_Quality : 139|1@1+ (1,0) [0|1] ""  RadarFrontCenter
 SG_ VFC_TS15_VMS : 140|1@1+ (1,0) [0|1] ""  RadarFrontCenter
 SG_ VFC_TS15_Stable : 141|1@1+ (1,0) [0|1] ""  RadarFrontCenter
 SG_ VFC_TS15_VehicleSticker : 142|1@1+ (1,0) [0|1] ""  RadarFrontCenter
 SG_ VFC_TS15_InternalTrack : 143|1@1+ (1,0) [0|1] ""  RadarFrontCenter
 SG_ VFC_TS15_ValidLanes : 144|5@1+ (1,0) [0|31] ""  RadarFrontCenter
 SG_ VFC_TS15_ValidDay : 152|7@1+ (1,0) [0|127] ""  RadarFrontCenter
 SG_ VFC_TS15_ValidTimeRange1Start : 160|7@1+ (15,0) [0|1440] "min"  RadarFrontCenter
 SG_ VFC_TS15_ValidTimeRange1End : 168|7@1+ (15,0) [0|1440] "min"  RadarFrontCenter
 SG_ VFC_TS15_ValidTimeRange2Start : 176|7@1+ (15,0) [0|1440] "min"  RadarFrontCenter
 SG_ VFC_TS15_ValidTimeRange2End : 184|7@1+ (15,0) [0|1440] "min"  RadarFrontCenter
 SG_ VFC_TS15_ValidInDist : 192|10@1+ (10,0) [0|10230] "m"  RadarFrontCenter
 SG_ VFC_TS15_ValidDist : 208|10@1+ (10,0) [0|10230] "m"  RadarFrontCenter
 SG_ VFC_TS15_AddTSCount : 232|3@1+ (1,0) [0|6] ""  RadarFrontCenter
 SG_ VFC_TS15_AddTS1Class : 240|8@1+ (1,0) [0|68] ""  RadarFrontCenter
 SG_ VFC_TS15_AddTS1Prob : 248|6@1+ (2,0) [0|100] "%"  RadarFrontCenter
 SG_ VFC_TS15_AddTS1Quality : 254|1@1+ (1,0) [0|1] ""  RadarFrontCenter
 SG_ VFC_TS15_AddTS1VMS : 255|1@1+ (1,0) [0|1] ""  RadarFrontCenter
 SG_ VFC_TS15_AddTS2Class : 256|8@1+ (1,0) [0|68] ""  RadarFrontCenter
 SG_ VFC_TS15_AddTS2Prob : 264|6@1+ (2,0) [0|100] "%"  RadarFrontCenter
 SG_ VFC_TS15_AddTS2Quality : 270|1@1+ (1,0) [0|1] ""  RadarFrontCenter
 SG_ VFC_TS15_AddTS2VMS : 271|1@1+ (1,0) [0|1] ""  RadarFrontCenter
 SG_ VFC_TS15_AddTS3Class : 272|8@1+ (1,0) [0|68] ""  RadarFrontCenter
 SG_ VFC_TS15_AddTS3Prob : 280|6@1+ (2,0) [0|100] "%"  RadarFrontCenter
 SG_ VFC_TS15_AddTS3Quality : 286|1@1+ (1,0) [0|1] ""  RadarFrontCenter
 SG_ VFC_TS15_AddTS3VMS : 287|1@1+ (1,0) [0|1] ""  RadarFrontCenter
 SG_ VFC_TS15_AddTS4Class : 288|8@1+ (1,0) [0|68] ""  RadarFrontCenter
 SG_ VFC_TS15_AddTS4Prob : 296|6@1+ (2,0) [0|100] "%"  RadarFrontCenter
 SG_ VFC_TS15_AddTS4Quality : 302|1@1+ (1,0) [0|1] ""  RadarFrontCenter
 SG_ VFC_TS15_AddTS4VMS : 303|1@1+ (1,0) [0|1] ""  RadarFrontCenter
 SG_ VFC_TS15_AddTS5Class : 304|8@1+ (1,0) [0|68] ""  RadarFrontCenter
 SG_ VFC_TS15_AddTS5Prob : 312|6@1+ (2,0) [0|100] "%"  RadarFrontCenter
 SG_ VFC_TS15_AddTS5Quality : 318|1@1+ (1,0) [0|1] ""  RadarFrontCenter
 SG_ VFC_TS15_AddTS5VMS : 319|1@1+ (1,0) [0|1] ""  RadarFrontCenter
 SG_ VFC_TS15_AddTS6Class : 320|8@1+ (1,0) [0|68] ""  RadarFrontCenter
 SG_ VFC_TS15_AddTS6Prob : 328|6@1+ (2,0) [0|100] "%"  RadarFrontCenter
 SG_ VFC_TS15_AddTS6Quality : 334|1@1+ (1,0) [0|1] ""  RadarFrontCenter
 SG_ VFC_TS15_AddTS6VMS : 335|1@1+ (1,0) [0|1] ""  RadarFrontCenter

BO_ 517 RFL_ObjHdr: 48 RadarFrontLeft
 SG_ RFL_ObjHdr_CRC : 0|16@1+ (1,0) [0|65535] ""  RadarFrontCenter
 SG_ RFL_ObjHdr_AliveCtr : 16|8@1+ (1,0) [0|255] ""  RadarFrontCenter
 SG_ RFL_ObjHdr_ProtBlockCtr : 24|4@1+ (1,0) [0|15] ""  RadarFrontCenter
 SG_ RFL_ObjHdr_SensorState : 28|4@1+ (1,0) [0|15] ""  RadarFrontCenter
 SG_ RFL_ObjHdr_ProtocolVersion : 32|16@1+ (1,0) [0|65535] ""  RadarFrontCenter
 SG_ RFL_ObjHdr_ProtObjectCount : 48|6@1+ (1,0) [0|40] ""  RadarFrontCenter
 SG_ RFL_ObjHdr_ProtRSBSegmentCount : 56|4@1+ (1,0) [0|4] ""  RadarFrontCenter
 SG_ RFL_ObjHdr_ProtRSBPointCount : 64|6@1+ (1,0) [0|32] ""  RadarFrontCenter
 SG_ RFL_ObjHdr_TimeStampStatus : 88|8@1+ (1,0) [0|255] ""  RadarFrontCenter
 SG_ RFL_ObjHdr_TimeStamp : 96|26@1+ (1,0) [0|67108863] "ms"  RadarFrontCenter
 SG_ RFL_ObjHdr_MountPosY : 128|8@1+ (0.01,-1.28) [-1.28|1.27] "m"  RadarFrontCenter
 SG_ RFL_ObjHdr_MountPosX : 136|9@1+ (0.02,-5.12) [-5.12|5.1] "m"  RadarFrontCenter
 SG_ RFL_ObjHdr_MountPosZ : 145|5@1+ (0.05,0) [0|1.55] "m"  RadarFrontCenter
 SG_ RFL_ObjHdr_ObjectDownSel : 151|1@1+ (1,0) [0|1] ""  RadarFrontCenter
 SG_ RFL_ObjHdr_YawMountAngle : 152|16@1+ (0.00017,-5.57056) [-3.2|3.2] "rad"  RadarFrontCenter
 SG_ RFL_ObjHdr_YawAngleLower : 168|15@1+ (0.00017,-2.78528) [-1.6|1.6] "rad"  RadarFrontCenter
 SG_ RFL_ObjHdr_AziOutOfSpec : 183|1@1+ (1,0) [0|1] ""  RadarFrontCenter
 SG_ RFL_ObjHdr_YawAngleUpper : 184|15@1+ (0.00017,-2.78528) [-1.6|1.6] "rad"  RadarFrontCenter
 SG_ RFL_ObjHdr_ElevOutOfSpec : 199|1@1+ (1,0) [0|1] ""  RadarFrontCenter
 SG_ RFL_ObjHdr_PitchMountAngle : 200|12@1+ (0.00017,-0.34816) [-0.34816|0.34799] "rad"  RadarFrontCenter
 SG_ RFL_ObjHdr_PitchAngleLower : 212|12@1+ (0.00017,-0.34816) [-0.34816|0.34799] "rad"  RadarFrontCenter
 SG_ RFL_ObjHdr_PitchAngleUpper : 224|12@1+ (0.00017,-0.34816) [-0.34816|0.34799] "rad"  RadarFrontCenter
 SG_ RFL_ObjHdr_RollMountAngle : 236|12@1+ (0.00017,-0.34816) [-0.2|0.2] "rad"  RadarFrontCenter
 SG_ RFL_ObjHdr_DetectionRange : 248|9@1+ (1,0) [0|511] "m"  RadarFrontCenter
 SG_ RFL_ObjHdr_TimeStampLocal : 264|26@1+ (1,0) [0|67108863] "ms"  RadarFrontCenter

BO_ 528 RFL_Obj00A: 64 RadarFrontLeft
 SG_ RFL_Obj00A_CRC : 0|16@1+ (1,0) [0|65535] ""  RadarFrontCenter
 SG_ RFL_Obj00A_AliveCtr : 16|8@1+ (1,0) [0|255] ""  RadarFrontCenter
 SG_ RFL_Obj00A_ProtBlockCtr : 24|4@1+ (1,0) [0|15] ""  RadarFrontCenter
 SG_ RFL_Obj00A_ID : 32|7@1+ (1,0) [0|127] ""  RadarFrontCenter
 SG_ RFL_Obj00A_Measured : 39|1@1+ (1,0) [0|1] ""  RadarFrontCenter
 SG_ RFL_Obj00A_Dx : 40|13@1+ (0.0625,-256) [-256|255.9375] "m"  RadarFrontCenter
 SG_ RFL_Obj00A_Dz : 53|6@1+ (0.25,-5) [-5|10.75] "m"  RadarFrontCenter
 SG_ RFL_Obj00A_Dy : 59|11@1+ (0.125,-128) [-128|127.875] "m"  RadarFrontCenter
 SG_ RFL_Obj00A_Valid : 70|1@1+ (1,0) [0|1] ""  RadarFrontCenter
 SG_ RFL_Obj00A_Vx : 71|12@1+ (0.0625,-128) [-128|127.9375] "m/s"  RadarFrontCenter
 SG_ RFL_Obj00A_Vy : 83|10@1+ (0.125,-64) [-64|63.875] "m/s"  RadarFrontCenter
 SG_ RFL_Obj00A_Ax : 93|10@1+ (0.03125,-16) [-16|15.96875] "m/s^2"  RadarFrontCenter
 SG_ RFL_Obj00A_Ay : 103|9@1+ (0.0625,-16) [-16|15.9375] "m/s^2"  RadarFrontCenter
 SG_ RFL_Obj00A_HeadingYawAngle : 112|9@1+ (0.0175,-4.48) [-3.15|3.15] "rad"  RadarFrontCenter
 SG_ RFL_Obj00A_Length : 121|7@1+ (0.125,0) [0|15.875] "m"  RadarFrontCenter
 SG_ RFL_Obj00A_Width : 128|7@1+ (0.125,0) [0|15.875] "m"  RadarFrontCenter
 SG_ RFL_Obj00A_Height : 135|7@1+ (0.125,0) [0|15.875] "m"  RadarFrontCenter
 SG_ RFL_Obj00A_DxVnce : 142|12@1+ (0.01,0) [0|30] "m^2"  RadarFrontCenter
 SG_ RFL_Obj00A_DyVnce : 154|12@1+ (0.01,0) [0|30] "m^2"  RadarFrontCenter
 SG_ RFL_Obj00A_DzVnce : 166|10@1+ (0.01,0) [0|10] "m^2"  RadarFrontCenter
 SG_ RFL_Obj00A_VxVnce : 176|12@1+ (0.01,0) [0|30] "m^2/s^2"  RadarFrontCenter
 SG_ RFL_Obj00A_VyVnce : 188|12@1+ (0.01,0) [0|30] "m^2/s^2"  RadarFrontCenter
 SG_ RFL_Obj00A_AxVnce : 200|12@1+ (0.01,0) [0|30] "m^2/s^4"  RadarFrontCenter
 SG_ RFL_Obj00A_AyVnce : 212|12@1+ (0.01,0) [0|30] "m^2/s^4"  RadarFrontCenter
 SG_ RFL_Obj00A_RefPosIndex : 224|4@1+ (1,0) [0|15] ""  RadarFrontCenter
 SG_ RFL_Obj00A_DxDyCoVnce : 228|12@1+ (0.01,0) [0|30] "m^2"  RadarFrontCenter
 SG_ RFL_Obj00A_DxVxCoVnce : 240|12@1+ (0.01,0) [0|30] "m^2/s"  RadarFrontCenter
 SG_ RFL_Obj00A_DyVxCoVnce : 252|12@1+ (0.01,0) [0|30] "m^2/s"  RadarFrontCenter
 SG_ RFL_Obj00A_DxVyCoVnce : 264|12@1+ (0.01,0) [0|30] "m^2/s"  RadarFrontCenter
 SG_ RFL_Obj00A_DyVyCoVnce : 276|12@1+ (0.01,0) [0|30] "m^2/s"  RadarFrontCenter
 SG_ RFL_Obj00A_VxVyCoVnce : 288|12@1+ (0.01,0) [0|30] "m^2/s^2"  RadarFrontCenter
 SG_ RFL_Obj00A_DxAxCoVnce : 300|12@1+ (0.01,0) [0|30] "m^2/s^2"  RadarFrontCenter
 SG_ RFL_Obj00A_DyAxCoVnce : 312|12@1+ (0.01,0) [0|30] "m^2/s^2"  RadarFrontCenter
 SG_ RFL_Obj00A_VxAxCoVnce : 324|12@1+ (0.01,0) [0|30] "m^2/s^3"  RadarFrontCenter
 SG_ RFL_Obj00A_VyAxCoVnce : 336|12@1+ (0.01,0) [0|30] "m^2/s^3"  RadarFrontCenter
 SG_ RFL_Obj00A_DxAyCoVnce : 348|12@1+ (0.01,0) [0|30] "m^2/s^2"  RadarFrontCenter
 SG_ RFL_Obj00A_DyAyCoVnce : 360|12@1+ (0.01,0) [0|30] "m^2/s^2"  RadarFrontCenter
 SG_ RFL_Obj00A_VxAyCoVnce : 372|12@1+ (0.01,0) [0|30] "m^2/s^3"  RadarFrontCenter
 SG_ RFL_Obj00A_VyAyCoVnce : 384|12@1+ (0.01,0) [0|30] "m^2/s^3"  RadarFrontCenter
 SG_ RFL_Obj00A_AxAyCoVnce : 396|12@1+ (0.01,0) [0|30] "m^2/s^4"  RadarFrontCenter
 SG_ RFL_Obj00A_HeadingYawAngleVnce : 408|12@1+ (0.0003,0) [0|1] "rad^2"  RadarFrontCenter
 SG_ RFL_Obj00A_LengthVnce : 420|12@1+ (0.01,0) [0|30] "m^2"  RadarFrontCenter
 SG_ RFL_Obj00A_WidthVnce : 432|12@1+ (0.01,0) [0|30] "m^2"  RadarFrontCenter
 SG_ RFL_Obj00A_HeightVnce : 444|12@1+ (0.01,0) [0|30] "m^2"  RadarFrontCenter
 SG_ RFL_Obj00A_ProbExist : 456|6@1+ (2,0) [0|100] "%"  RadarFrontCenter
 SG_ RFL_Obj00A_ProbObstacle : 462|6@1+ (2,0) [0|100] "%"  RadarFrontCenter
 SG_ RFL_Obj00A_ProbNonObstacle : 468|6@1+ (2,0) [0|100] "%"  RadarFrontCenter
 SG_ RFL_Obj00A_ProbMobileObst : 474|6@1+ (2,0) [0|100] "%"  RadarFrontCenter

BO_ 529 RFL_Obj00B: 16 RadarFrontLeft
 SG_ RFL_Obj00B_CRC : 0|16@1+ (1,0) [0|65535] ""  RadarFrontCenter
 SG_ RFL_Obj00B_AliveCtr : 16|8@1+ (1,0) [0|255] ""  RadarFrontCenter
 SG_ RFL_Obj00B_ProtBlockCtr : 24|4@1+ (1,0) [0|15] ""  RadarFrontCenter
 SG_ RFL_Obj00B_ProbMob4PlusWhl : 28|6@1+ (2,0) [0|100] "%"  RadarFrontCenter
 SG_ RFL_Obj00B_ProbMob2Whl : 34|6@1+ (2,0) [0|100] "%"  RadarFrontCenter
 SG_ RFL_Obj00B_ProbMobPed : 40|6@1+ (2,0) [0|100] "%"  RadarFrontCenter
 SG_ RFL_Obj00B_Prob4PlusWhlCAR : 46|6@1+ (2,0) [0|100] "%"  RadarFrontCenter
 SG_ RFL_Obj00B_Prob4PlusWhlbHGV : 52|6@1+ (2,0) [0|100] "%"  RadarFrontCenter
 SG_ RFL_Obj00B_ProbGNDReflex : 58|6@1+ (2,0) [0|100] "%"  RadarFrontCenter
 SG_ RFL_Obj00B_ProbStatBarrier : 64|6@1+ (2,0) [0|100] "%"  RadarFrontCenter
 SG_ RFL_Obj00B_ProbStatObst : 70|6@1+ (2,0) [0|100] "%"  RadarFrontCenter
 SG_ RFL_Obj00B_MovingProbability : 76|6@1+ (2,0) [0|100] "%"  RadarFrontCenter
 SG_ RFL_Obj00B_MovingObserved : 82|6@1+ (2,0) [0|100] "%"  RadarFrontCenter
 SG_ RFL_Obj00B_BehaviorType : 88|3@1+ (1,0) [0|7] ""  RadarFrontCenter

BO_ 530 RFL_Obj01A: 64 RadarFrontLeft
 SG_ RFL_Obj01A_CRC : 0|16@1+ (1,0) [0|65535] ""  RadarFrontCenter
 SG_ RFL_Obj01A_AliveCtr : 16|8@1+ (1,0) [0|255] ""  RadarFrontCenter
 SG_ RFL_Obj01A_ProtBlockCtr : 24|4@1+ (1,0) [0|15] ""  RadarFrontCenter
 SG_ RFL_Obj01A_ID : 32|7@1+ (1,0) [0|127] ""  RadarFrontCenter
 SG_ RFL_Obj01A_Measured : 39|1@1+ (1,0) [0|1] ""  RadarFrontCenter
 SG_ RFL_Obj01A_Dx : 40|13@1+ (0.0625,-256) [-256|255.9375] "m"  RadarFrontCenter
 SG_ RFL_Obj01A_Dz : 53|6@1+ (0.25,-5) [-5|10.75] "m"  RadarFrontCenter
 SG_ RFL_Obj01A_Dy : 59|11@1+ (0.125,-128) [-128|127.875] "m"  RadarFrontCenter
 SG_ RFL_Obj01A_Valid : 70|1@1+ (1,0) [0|1] ""  RadarFrontCenter
 SG_ RFL_Obj01A_Vx : 71|12@1+ (0.0625,-128) [-128|127.9375] "m/s"  RadarFrontCenter
 SG_ RFL_Obj01A_Vy : 83|10@1+ (0.125,-64) [-64|63.875] "m/s"  RadarFrontCenter
 SG_ RFL_Obj01A_Ax : 93|10@1+ (0.03125,-16) [-16|15.96875] "m/s^2"  RadarFrontCenter
 SG_ RFL_Obj01A_Ay : 103|9@1+ (0.0625,-16) [-16|15.9375] "m/s^2"  RadarFrontCenter
 SG_ RFL_Obj01A_HeadingYawAngle : 112|9@1+ (0.0175,-4.48) [-3.15|3.15] "rad"  RadarFrontCenter
 SG_ RFL_Obj01A_Length : 121|7@1+ (0.125,0) [0|15.875] "m"  RadarFrontCenter
 SG_ RFL_Obj01A_Width : 128|7@1+ (0.125,0) [0|15.875] "m"  RadarFrontCenter
 SG_ RFL_Obj01A_Height : 135|7@1+ (0.125,0) [0|15.875] "m"  RadarFrontCenter
 SG_ RFL_Obj01A_DxVnce : 142|12@1+ (0.01,0) [0|30] "m^2"  RadarFrontCenter
 SG_ RFL_Obj01A_DyVnce : 154|12@1+ (0.01,0) [0|30] "m^2"  RadarFrontCenter
 SG_ RFL_Obj01A_DzVnce : 166|10@1+ (0.01,0) [0|10] "m^2"  RadarFrontCenter
 SG_ RFL_Obj01A_VxVnce : 176|12@1+ (0.01,0) [0|30] "m^2/s^2"  RadarFrontCenter
 SG_ RFL_Obj01A_VyVnce : 188|12@1+ (0.01,0) [0|30] "m^2/s^2"  RadarFrontCenter
 SG_ RFL_Obj01A_AxVnce : 200|12@1+ (0.01,0) [0|30] "m^2/s^4"  RadarFrontCenter
 SG_ RFL_Obj01A_AyVnce : 212|12@1+ (0.01,0) [0|30] "m^2/s^4"  RadarFrontCenter
 SG_ RFL_Obj01A_RefPosIndex : 224|4@1+ (1,0) [0|15] ""  RadarFrontCenter
 SG_ RFL_Obj01A_DxDyCoVnce : 228|12@1+ (0.01,0) [0|30] "m^2"  RadarFrontCenter
 SG_ RFL_Obj01A_DxVxCoVnce : 240|12@1+ (0.01,0) [0|30] "m^2/s"  RadarFrontCenter
 SG_ RFL_Obj01A_DyVxCoVnce : 252|12@1+ (0.01,0) [0|30] "m^2/s"  RadarFrontCenter
 SG_ RFL_Obj01A_DxVyCoVnce : 264|12@1+ (0.01,0) [0|30] "m^2/s"  RadarFrontCenter
 SG_ RFL_Obj01A_DyVyCoVnce : 276|12@1+ (0.01,0) [0|30] "m^2/s"  RadarFrontCenter
 SG_ RFL_Obj01A_VxVyCoVnce : 288|12@1+ (0.01,0) [0|30] "m^2/s^2"  RadarFrontCenter
 SG_ RFL_Obj01A_DxAxCoVnce : 300|12@1+ (0.01,0) [0|30] "m^2/s^2"  RadarFrontCenter
 SG_ RFL_Obj01A_DyAxCoVnce : 312|12@1+ (0.01,0) [0|30] "m^2/s^2"  RadarFrontCenter
 SG_ RFL_Obj01A_VxAxCoVnce : 324|12@1+ (0.01,0) [0|30] "m^2/s^3"  RadarFrontCenter
 SG_ RFL_Obj01A_VyAxCoVnce : 336|12@1+ (0.01,0) [0|30] "m^2/s^3"  RadarFrontCenter
 SG_ RFL_Obj01A_DxAyCoVnce : 348|12@1+ (0.01,0) [0|30] "m^2/s^2"  RadarFrontCenter
 SG_ RFL_Obj01A_DyAyCoVnce : 360|12@1+ (0.01,0) [0|30] "m^2/s^2"  RadarFrontCenter
 SG_ RFL_Obj01A_VxAyCoVnce : 372|12@1+ (0.01,0) [0|30] "m^2/s^3"  RadarFrontCenter
 SG_ RFL_Obj01A_VyAyCoVnce : 384|12@1+ (0.01,0) [0|30] "m^2/s^3"  RadarFrontCenter
 SG_ RFL_Obj01A_AxAyCoVnce : 396|12@1+ (0.01,0) [0|30] "m^2/s^4"  RadarFrontCenter
 SG_ RFL_Obj01A_HeadingYawAngleVnce : 408|12@1+ (0.0003,0) [0|1] "rad^2"  RadarFrontCenter
 SG_ RFL_Obj01A_LengthVnce : 420|12@1+ (0.01,0) [0|30] "m^2"  RadarFrontCenter
 SG_ RFL_Obj01A_WidthVnce : 432|12@1+ (0.01,0) [0|30] "m^2"  RadarFrontCenter
 SG_ RFL_Obj01A_HeightVnce : 444|12@1+ (0.01,0) [0|30] "m^2"  RadarFrontCenter
 SG_ RFL_Obj01A_ProbExist : 456|6@1+ (2,0) [0|100] "%"  RadarFrontCenter
 SG_ RFL_Obj01A_ProbObstacle : 462|6@1+ (2,0) [0|100] "%"  RadarFrontCenter
 SG_ RFL_Obj01A_ProbNonObstacle : 468|6@1+ (2,0) [0|100] "%"  RadarFrontCenter
 SG_ RFL_Obj01A_ProbMobileObst : 474|6@1+ (2,0) [0|100] "%"  RadarFrontCenter

BO_ 531 RFL_Obj01B: 16 RadarFrontLeft
 SG_ RFL_Obj01B_CRC : 0|16@1+ (1,0) [0|65535] ""  RadarFrontCenter
 SG_ RFL_Obj01B_AliveCtr : 16|8@1+ (1,0) [0|255] ""  RadarFrontCenter
 SG_ RFL_Obj01B_ProtBlockCtr : 24|4@1+ (1,0) [0|15] ""  RadarFrontCenter
 SG_ RFL_Obj01B_ProbMob4PlusWhl : 28|6@1+ (2,0) [0|100] "%"  RadarFrontCenter
 SG_ RFL_Obj01B_ProbMob2Whl : 34|6@1+ (2,0) [0|100] "%"  RadarFrontCenter
 SG_ RFL_Obj01B_ProbMobPed : 40|6@1+ (2,0) [0|100] "%"  RadarFrontCenter
 SG_ RFL_Obj01B_Prob4PlusWhlCAR : 46|6@1+ (2,0) [0|100] "%"  RadarFrontCenter
 SG_ RFL_Obj01B_Prob4PlusWhlbHGV : 52|6@1+ (2,0) [0|100] "%"  RadarFrontCenter
 SG_ RFL_Obj01B_ProbGNDReflex : 58|6@1+ (2,0) [0|100] "%"  RadarFrontCenter
 SG_ RFL_Obj01B_ProbStatBarrier : 64|6@1+ (2,0) [0|100] "%"  RadarFrontCenter
 SG_ RFL_Obj01B_ProbStatObst : 70|6@1+ (2,0) [0|100] "%"  RadarFrontCenter
 SG_ RFL_Obj01B_MovingProbability : 76|6@1+ (2,0) [0|100] "%"  RadarFrontCenter
 SG_ RFL_Obj01B_MovingObserved : 82|6@1+ (2,0) [0|100] "%"  RadarFrontCenter
 SG_ RFL_Obj01B_BehaviorType : 88|3@1+ (1,0) [0|7] ""  RadarFrontCenter

BO_ 532 RFL_Obj02A: 64 RadarFrontLeft
 SG_ RFL_Obj02A_CRC : 0|16@1+ (1,0) [0|65535] ""  RadarFrontCenter
 SG_ RFL_Obj02A_AliveCtr : 16|8@1+ (1,0) [0|255] ""  RadarFrontCenter
 SG_ RFL_Obj02A_ProtBlockCtr : 24|4@1+ (1,0) [0|15] ""  RadarFrontCenter
 SG_ RFL_Obj02A_ID : 32|7@1+ (1,0) [0|127] ""  RadarFrontCenter
 SG_ RFL_Obj02A_Measured : 39|1@1+ (1,0) [0|1] ""  RadarFrontCenter
 SG_ RFL_Obj02A_Dx : 40|13@1+ (0.0625,-256) [-256|255.9375] "m"  RadarFrontCenter
 SG_ RFL_Obj02A_Dz : 53|6@1+ (0.25,-5) [-5|10.75] "m"  RadarFrontCenter
 SG_ RFL_Obj02A_Dy : 59|11@1+ (0.125,-128) [-128|127.875] "m"  RadarFrontCenter
 SG_ RFL_Obj02A_Valid : 70|1@1+ (1,0) [0|1] ""  RadarFrontCenter
 SG_ RFL_Obj02A_Vx : 71|12@1+ (0.0625,-128) [-128|127.9375] "m/s"  RadarFrontCenter
 SG_ RFL_Obj02A_Vy : 83|10@1+ (0.125,-64) [-64|63.875] "m/s"  RadarFrontCenter
 SG_ RFL_Obj02A_Ax : 93|10@1+ (0.03125,-16) [-16|15.96875] "m/s^2"  RadarFrontCenter
 SG_ RFL_Obj02A_Ay : 103|9@1+ (0.0625,-16) [-16|15.9375] "m/s^2"  RadarFrontCenter
 SG_ RFL_Obj02A_HeadingYawAngle : 112|9@1+ (0.0175,-4.48) [-3.15|3.15] "rad"  RadarFrontCenter
 SG_ RFL_Obj02A_Length : 121|7@1+ (0.125,0) [0|15.875] "m"  RadarFrontCenter
 SG_ RFL_Obj02A_Width : 128|7@1+ (0.125,0) [0|15.875] "m"  RadarFrontCenter
 SG_ RFL_Obj02A_Height : 135|7@1+ (0.125,0) [0|15.875] "m"  RadarFrontCenter
 SG_ RFL_Obj02A_DxVnce : 142|12@1+ (0.01,0) [0|30] "m^2"  RadarFrontCenter
 SG_ RFL_Obj02A_DyVnce : 154|12@1+ (0.01,0) [0|30] "m^2"  RadarFrontCenter
 SG_ RFL_Obj02A_DzVnce : 166|10@1+ (0.01,0) [0|10] "m^2"  RadarFrontCenter
 SG_ RFL_Obj02A_VxVnce : 176|12@1+ (0.01,0) [0|30] "m^2/s^2"  RadarFrontCenter
 SG_ RFL_Obj02A_VyVnce : 188|12@1+ (0.01,0) [0|30] "m^2/s^2"  RadarFrontCenter
 SG_ RFL_Obj02A_AxVnce : 200|12@1+ (0.01,0) [0|30] "m^2/s^4"  RadarFrontCenter
 SG_ RFL_Obj02A_AyVnce : 212|12@1+ (0.01,0) [0|30] "m^2/s^4"  RadarFrontCenter
 SG_ RFL_Obj02A_RefPosIndex : 224|4@1+ (1,0) [0|15] ""  RadarFrontCenter
 SG_ RFL_Obj02A_DxDyCoVnce : 228|12@1+ (0.01,0) [0|30] "m^2"  RadarFrontCenter
 SG_ RFL_Obj02A_DxVxCoVnce : 240|12@1+ (0.01,0) [0|30] "m^2/s"  RadarFrontCenter
 SG_ RFL_Obj02A_DyVxCoVnce : 252|12@1+ (0.01,0) [0|30] "m^2/s"  RadarFrontCenter
 SG_ RFL_Obj02A_DxVyCoVnce : 264|12@1+ (0.01,0) [0|30] "m^2/s"  RadarFrontCenter
 SG_ RFL_Obj02A_DyVyCoVnce : 276|12@1+ (0.01,0) [0|30] "m^2/s"  RadarFrontCenter
 SG_ RFL_Obj02A_VxVyCoVnce : 288|12@1+ (0.01,0) [0|30] "m^2/s^2"  RadarFrontCenter
 SG_ RFL_Obj02A_DxAxCoVnce : 300|12@1+ (0.01,0) [0|30] "m^2/s^2"  RadarFrontCenter
 SG_ RFL_Obj02A_DyAxCoVnce : 312|12@1+ (0.01,0) [0|30] "m^2/s^2"  RadarFrontCenter
 SG_ RFL_Obj02A_VxAxCoVnce : 324|12@1+ (0.01,0) [0|30] "m^2/s^3"  RadarFrontCenter
 SG_ RFL_Obj02A_VyAxCoVnce : 336|12@1+ (0.01,0) [0|30] "m^2/s^3"  RadarFrontCenter
 SG_ RFL_Obj02A_DxAyCoVnce : 348|12@1+ (0.01,0) [0|30] "m^2/s^2"  RadarFrontCenter
 SG_ RFL_Obj02A_DyAyCoVnce : 360|12@1+ (0.01,0) [0|30] "m^2/s^2"  RadarFrontCenter
 SG_ RFL_Obj02A_VxAyCoVnce : 372|12@1+ (0.01,0) [0|30] "m^2/s^3"  RadarFrontCenter
 SG_ RFL_Obj02A_VyAyCoVnce : 384|12@1+ (0.01,0) [0|30] "m^2/s^3"  RadarFrontCenter
 SG_ RFL_Obj02A_AxAyCoVnce : 396|12@1+ (0.01,0) [0|30] "m^2/s^4"  RadarFrontCenter
 SG_ RFL_Obj02A_HeadingYawAngleVnce : 408|12@1+ (0.0003,0) [0|1] "rad^2"  RadarFrontCenter
 SG_ RFL_Obj02A_LengthVnce : 420|12@1+ (0.01,0) [0|30] "m^2"  RadarFrontCenter
 SG_ RFL_Obj02A_WidthVnce : 432|12@1+ (0.01,0) [0|30] "m^2"  RadarFrontCenter
 SG_ RFL_Obj02A_HeightVnce : 444|12@1+ (0.01,0) [0|30] "m^2"  RadarFrontCenter
 SG_ RFL_Obj02A_ProbExist : 456|6@1+ (2,0) [0|100] "%"  RadarFrontCenter
 SG_ RFL_Obj02A_ProbObstacle : 462|6@1+ (2,0) [0|100] "%"  RadarFrontCenter
 SG_ RFL_Obj02A_ProbNonObstacle : 468|6@1+ (2,0) [0|100] "%"  RadarFrontCenter
 SG_ RFL_Obj02A_ProbMobileObst : 474|6@1+ (2,0) [0|100] "%"  RadarFrontCenter

BO_ 533 RFL_Obj02B: 16 RadarFrontLeft
 SG_ RFL_Obj02B_CRC : 0|16@1+ (1,0) [0|65535] ""  RadarFrontCenter
 SG_ RFL_Obj02B_AliveCtr : 16|8@1+ (1,0) [0|255] ""  RadarFrontCenter
 SG_ RFL_Obj02B_ProtBlockCtr : 24|4@1+ (1,0) [0|15] ""  RadarFrontCenter
 SG_ RFL_Obj02B_ProbMob4PlusWhl : 28|6@1+ (2,0) [0|100] "%"  RadarFrontCenter
 SG_ RFL_Obj02B_ProbMob2Whl : 34|6@1+ (2,0) [0|100] "%"  RadarFrontCenter
 SG_ RFL_Obj02B_ProbMobPed : 40|6@1+ (2,0) [0|100] "%"  RadarFrontCenter
 SG_ RFL_Obj02B_Prob4PlusWhlCAR : 46|6@1+ (2,0) [0|100] "%"  RadarFrontCenter
 SG_ RFL_Obj02B_Prob4PlusWhlbHGV : 52|6@1+ (2,0) [0|100] "%"  RadarFrontCenter
 SG_ RFL_Obj02B_ProbGNDReflex : 58|6@1+ (2,0) [0|100] "%"  RadarFrontCenter
 SG_ RFL_Obj02B_ProbStatBarrier : 64|6@1+ (2,0) [0|100] "%"  RadarFrontCenter
 SG_ RFL_Obj02B_ProbStatObst : 70|6@1+ (2,0) [0|100] "%"  RadarFrontCenter
 SG_ RFL_Obj02B_MovingProbability : 76|6@1+ (2,0) [0|100] "%"  RadarFrontCenter
 SG_ RFL_Obj02B_MovingObserved : 82|6@1+ (2,0) [0|100] "%"  RadarFrontCenter
 SG_ RFL_Obj02B_BehaviorType : 88|3@1+ (1,0) [0|7] ""  RadarFrontCenter

BO_ 534 RFL_Obj03A: 64 RadarFrontLeft
 SG_ RFL_Obj03A_CRC : 0|16@1+ (1,0) [0|65535] ""  RadarFrontCenter
 SG_ RFL_Obj03A_AliveCtr : 16|8@1+ (1,0) [0|255] ""  RadarFrontCenter
 SG_ RFL_Obj03A_ProtBlockCtr : 24|4@1+ (1,0) [0|15] ""  RadarFrontCenter
 SG_ RFL_Obj03A_ID : 32|7@1+ (1,0) [0|127] ""  RadarFrontCenter
 SG_ RFL_Obj03A_Measured : 39|1@1+ (1,0) [0|1] ""  RadarFrontCenter
 SG_ RFL_Obj03A_Dx : 40|13@1+ (0.0625,-256) [-256|255.9375] "m"  RadarFrontCenter
 SG_ RFL_Obj03A_Dz : 53|6@1+ (0.25,-5) [-5|10.75] "m"  RadarFrontCenter
 SG_ RFL_Obj03A_Dy : 59|11@1+ (0.125,-128) [-128|127.875] "m"  RadarFrontCenter
 SG_ RFL_Obj03A_Valid : 70|1@1+ (1,0) [0|1] ""  RadarFrontCenter
 SG_ RFL_Obj03A_Vx : 71|12@1+ (0.0625,-128) [-128|127.9375] "m/s"  RadarFrontCenter
 SG_ RFL_Obj03A_Vy : 83|10@1+ (0.125,-64) [-64|63.875] "m/s"  RadarFrontCenter
 SG_ RFL_Obj03A_Ax : 93|10@1+ (0.03125,-16) [-16|15.96875] "m/s^2"  RadarFrontCenter
 SG_ RFL_Obj03A_Ay : 103|9@1+ (0.0625,-16) [-16|15.9375] "m/s^2"  RadarFrontCenter
 SG_ RFL_Obj03A_HeadingYawAngle : 112|9@1+ (0.0175,-4.48) [-3.15|3.15] "rad"  RadarFrontCenter
 SG_ RFL_Obj03A_Length : 121|7@1+ (0.125,0) [0|15.875] "m"  RadarFrontCenter
 SG_ RFL_Obj03A_Width : 128|7@1+ (0.125,0) [0|15.875] "m"  RadarFrontCenter
 SG_ RFL_Obj03A_Height : 135|7@1+ (0.125,0) [0|15.875] "m"  RadarFrontCenter
 SG_ RFL_Obj03A_DxVnce : 142|12@1+ (0.01,0) [0|30] "m^2"  RadarFrontCenter
 SG_ RFL_Obj03A_DyVnce : 154|12@1+ (0.01,0) [0|30] "m^2"  RadarFrontCenter
 SG_ RFL_Obj03A_DzVnce : 166|10@1+ (0.01,0) [0|10] "m^2"  RadarFrontCenter
 SG_ RFL_Obj03A_VxVnce : 176|12@1+ (0.01,0) [0|30] "m^2/s^2"  RadarFrontCenter
 SG_ RFL_Obj03A_VyVnce : 188|12@1+ (0.01,0) [0|30] "m^2/s^2"  RadarFrontCenter
 SG_ RFL_Obj03A_AxVnce : 200|12@1+ (0.01,0) [0|30] "m^2/s^4"  RadarFrontCenter
 SG_ RFL_Obj03A_AyVnce : 212|12@1+ (0.01,0) [0|30] "m^2/s^4"  RadarFrontCenter
 SG_ RFL_Obj03A_RefPosIndex : 224|4@1+ (1,0) [0|15] ""  RadarFrontCenter
 SG_ RFL_Obj03A_DxDyCoVnce : 228|12@1+ (0.01,0) [0|30] "m^2"  RadarFrontCenter
 SG_ RFL_Obj03A_DxVxCoVnce : 240|12@1+ (0.01,0) [0|30] "m^2/s"  RadarFrontCenter
 SG_ RFL_Obj03A_DyVxCoVnce : 252|12@1+ (0.01,0) [0|30] "m^2/s"  RadarFrontCenter
 SG_ RFL_Obj03A_DxVyCoVnce : 264|12@1+ (0.01,0) [0|30] "m^2/s"  RadarFrontCenter
 SG_ RFL_Obj03A_DyVyCoVnce : 276|12@1+ (0.01,0) [0|30] "m^2/s"  RadarFrontCenter
 SG_ RFL_Obj03A_VxVyCoVnce : 288|12@1+ (0.01,0) [0|30] "m^2/s^2"  RadarFrontCenter
 SG_ RFL_Obj03A_DxAxCoVnce : 300|12@1+ (0.01,0) [0|30] "m^2/s^2"  RadarFrontCenter
 SG_ RFL_Obj03A_DyAxCoVnce : 312|12@1+ (0.01,0) [0|30] "m^2/s^2"  RadarFrontCenter
 SG_ RFL_Obj03A_VxAxCoVnce : 324|12@1+ (0.01,0) [0|30] "m^2/s^3"  RadarFrontCenter
 SG_ RFL_Obj03A_VyAxCoVnce : 336|12@1+ (0.01,0) [0|30] "m^2/s^3"  RadarFrontCenter
 SG_ RFL_Obj03A_DxAyCoVnce : 348|12@1+ (0.01,0) [0|30] "m^2/s^2"  RadarFrontCenter
 SG_ RFL_Obj03A_DyAyCoVnce : 360|12@1+ (0.01,0) [0|30] "m^2/s^2"  RadarFrontCenter
 SG_ RFL_Obj03A_VxAyCoVnce : 372|12@1+ (0.01,0) [0|30] "m^2/s^3"  RadarFrontCenter
 SG_ RFL_Obj03A_VyAyCoVnce : 384|12@1+ (0.01,0) [0|30] "m^2/s^3"  RadarFrontCenter
 SG_ RFL_Obj03A_AxAyCoVnce : 396|12@1+ (0.01,0) [0|30] "m^2/s^4"  RadarFrontCenter
 SG_ RFL_Obj03A_HeadingYawAngleVnce : 408|12@1+ (0.0003,0) [0|1] "rad^2"  RadarFrontCenter
 SG_ RFL_Obj03A_LengthVnce : 420|12@1+ (0.01,0) [0|30] "m^2"  RadarFrontCenter
 SG_ RFL_Obj03A_WidthVnce : 432|12@1+ (0.01,0) [0|30] "m^2"  RadarFrontCenter
 SG_ RFL_Obj03A_HeightVnce : 444|12@1+ (0.01,0) [0|30] "m^2"  RadarFrontCenter
 SG_ RFL_Obj03A_ProbExist : 456|6@1+ (2,0) [0|100] "%"  RadarFrontCenter
 SG_ RFL_Obj03A_ProbObstacle : 462|6@1+ (2,0) [0|100] "%"  RadarFrontCenter
 SG_ RFL_Obj03A_ProbNonObstacle : 468|6@1+ (2,0) [0|100] "%"  RadarFrontCenter
 SG_ RFL_Obj03A_ProbMobileObst : 474|6@1+ (2,0) [0|100] "%"  RadarFrontCenter

BO_ 535 RFL_Obj03B: 16 RadarFrontLeft
 SG_ RFL_Obj03B_CRC : 0|16@1+ (1,0) [0|65535] ""  RadarFrontCenter
 SG_ RFL_Obj03B_AliveCtr : 16|8@1+ (1,0) [0|255] ""  RadarFrontCenter
 SG_ RFL_Obj03B_ProtBlockCtr : 24|4@1+ (1,0) [0|15] ""  RadarFrontCenter
 SG_ RFL_Obj03B_ProbMob4PlusWhl : 28|6@1+ (2,0) [0|100] "%"  RadarFrontCenter
 SG_ RFL_Obj03B_ProbMob2Whl : 34|6@1+ (2,0) [0|100] "%"  RadarFrontCenter
 SG_ RFL_Obj03B_ProbMobPed : 40|6@1+ (2,0) [0|100] "%"  RadarFrontCenter
 SG_ RFL_Obj03B_Prob4PlusWhlCAR : 46|6@1+ (2,0) [0|100] "%"  RadarFrontCenter
 SG_ RFL_Obj03B_Prob4PlusWhlbHGV : 52|6@1+ (2,0) [0|100] "%"  RadarFrontCenter
 SG_ RFL_Obj03B_ProbGNDReflex : 58|6@1+ (2,0) [0|100] "%"  RadarFrontCenter
 SG_ RFL_Obj03B_ProbStatBarrier : 64|6@1+ (2,0) [0|100] "%"  RadarFrontCenter
 SG_ RFL_Obj03B_ProbStatObst : 70|6@1+ (2,0) [0|100] "%"  RadarFrontCenter
 SG_ RFL_Obj03B_MovingProbability : 76|6@1+ (2,0) [0|100] "%"  RadarFrontCenter
 SG_ RFL_Obj03B_MovingObserved : 82|6@1+ (2,0) [0|100] "%"  RadarFrontCenter
 SG_ RFL_Obj03B_BehaviorType : 88|3@1+ (1,0) [0|7] ""  RadarFrontCenter

CM_ SG_ 247 VFC_TS09_CRC "CRC - Autosar E2E Profile 5";
CM_ SG_ 247 VFC_TS09_AliveCtr "Alive counter - Autosar E2E Profile 5";
CM_ SG_ 247 VFC_TS09_ProtBlockCtr "Protocol-Signal: Block-Counter";
CM_ SG_ 247 VFC_TS09_ProtOrderIndex "Protocol-Signal: Index to ensure same order in Tx and Rx (Ethernet only)";
CM_ SG_ 247 VFC_TS09_ID "Unique Traffic Sign ID";
CM_ SG_ 247 VFC_TS09_Class "The type of main sign that has been detected by the vision system";
CM_ SG_ 247 VFC_TS09_TSProb "Probability that the sign is a traffic sign";
CM_ SG_ 247 VFC_TS09_Dx "Traffic sign distance in longitudinal direction";
CM_ SG_ 247 VFC_TS09_Dy "Traffic sign distance in lateral direction";
CM_ SG_ 247 VFC_TS09_Dz "Traffic sign distance in vertical direction";
CM_ SG_ 247 VFC_TS09_DxStdDev "Standard deviation of Traffic sign distance in longitudinal direction";
CM_ SG_ 247 VFC_TS09_DyStdDev "Standard deviation of Traffic sign distance in lateral direction";
CM_ SG_ 247 VFC_TS09_DzStdDev "Standard deviation of Traffic sign distance in vertical direction";
CM_ SG_ 247 VFC_TS09_Width "Width of the sign";
CM_ SG_ 247 VFC_TS09_Height "Height of the sign";
CM_ SG_ 247 VFC_TS09_EmbedFlag "Determines whether the sign is embedded or not";
CM_ SG_ 247 VFC_TS09_Quality "A flag that determines the quality of the sign";
CM_ SG_ 247 VFC_TS09_VMS "Variable-message sign: Determines whether the traffic sign is Variable or fixed";
CM_ SG_ 247 VFC_TS09_Stable "Determines whether the object is stable";
CM_ SG_ 247 VFC_TS09_VehicleSticker "Flag which indicates whether the detected traffic sign is a invalid sign on a vehicle or not";
CM_ SG_ 247 VFC_TS09_InternalTrack "Flag which indicates if this sign is an internal track, i.e. an sign hypothesis of low quality";
CM_ SG_ 247 VFC_TS09_ValidLanes "Indicates on which lane the detected sign is valid. Bitfield:
Bit 0: valid on first right hand lane
Bit 1: valid on second right hand lane
Bit 2: valid on third right hand lane
Bit 3: valid on fourth right hand lane
Bit 4: valid on fifth right hand lane";
CM_ SG_ 247 VFC_TS09_ValidDay "The video sensor shall provide the week days for which the main traffic sign is valid. Bitfield:
Bit 0: MONDAY
Bit 1: TUESDAY
Bit 2: WEDNESDAY
Bit 3: THURSDAY
Bit 4: FRIDAY
Bit 5: SATURDAY
Bit 6: SUNDAY";
CM_ SG_ 247 VFC_TS09_ValidTimeRange1Start "Start time for the first time range in which the main traffic sign is valid. Minutes since midnight.";
CM_ SG_ 247 VFC_TS09_ValidTimeRange1End "End time for the first time range in which the main traffic sign is valid. Minutes since midnight.";
CM_ SG_ 247 VFC_TS09_ValidTimeRange2Start "Start time for the first time range in which the main traffic sign is valid. Minutes since midnight.";
CM_ SG_ 247 VFC_TS09_ValidTimeRange2End "End time for the first time range in which the main traffic sign is valid. Minutes since midnight.";
CM_ SG_ 247 VFC_TS09_ValidInDist "Indicates the longitudinal distance in which the validity of the main TSR starts";
CM_ SG_ 247 VFC_TS09_ValidDist "Indicates the longitudinal distance for which the main traffic sign is valid";
CM_ SG_ 247 VFC_TS09_AddTSCount "Number of additional signs attached to the main sign. This can be a minimum of 0 and a maximum of 6.";
CM_ SG_ 247 VFC_TS09_AddTS1Class "The type of additonal sign that has been detected by the vision system";
CM_ SG_ 247 VFC_TS09_AddTS1Prob "Probability that the sign is a traffic sign";
CM_ SG_ 247 VFC_TS09_AddTS1Quality "A flag that determines the quality of the signal";
CM_ SG_ 247 VFC_TS09_AddTS1VMS "Variable-message sign: Determines whether the traffic sign is Variable or fixed";
CM_ SG_ 247 VFC_TS09_AddTS2Class "The type of additonal sign that has been detected by the vision system";
CM_ SG_ 247 VFC_TS09_AddTS2Prob "Probability that the sign is a traffic sign";
CM_ SG_ 247 VFC_TS09_AddTS2Quality "A flag that determines the quality of the signal";
CM_ SG_ 247 VFC_TS09_AddTS2VMS "Variable-message sign: Determines whether the traffic sign is Variable or fixed";
CM_ SG_ 247 VFC_TS09_AddTS3Class "The type of additonal sign that has been detected by the vision system";
CM_ SG_ 247 VFC_TS09_AddTS3Prob "Probability that the sign is a traffic sign";
CM_ SG_ 247 VFC_TS09_AddTS3Quality "A flag that determines the quality of the signal";
CM_ SG_ 247 VFC_TS09_AddTS3VMS "Variable-message sign: Determines whether the traffic sign is Variable or fixed";
CM_ SG_ 247 VFC_TS09_AddTS4Class "The type of additonal sign that has been detected by the vision system";
CM_ SG_ 247 VFC_TS09_AddTS4Prob "Probability that the sign is a traffic sign";
CM_ SG_ 247 VFC_TS09_AddTS4Quality "A flag that determines the quality of the signal";
CM_ SG_ 247 VFC_TS09_AddTS4VMS "Variable-message sign: Determines whether the traffic sign is Variable or fixed";
CM_ SG_ 247 VFC_TS09_AddTS5Class "The type of additonal sign that has been detected by the vision system";
CM_ SG_ 247 VFC_TS09_AddTS5Prob "Probability that the sign is a traffic sign";
CM_ SG_ 247 VFC_TS09_AddTS5Quality "A flag that determines the quality of the signal";
CM_ SG_ 247 VFC_TS09_AddTS5VMS "Variable-message sign: Determines whether the traffic sign is Variable or fixed";
CM_ SG_ 247 VFC_TS09_AddTS6Class "The type of additonal sign that has been detected by the vision system";
CM_ SG_ 247 VFC_TS09_AddTS6Prob "Probability that the sign is a traffic sign";
CM_ SG_ 247 VFC_TS09_AddTS6Quality "A flag that determines the quality of the signal";
CM_ SG_ 247 VFC_TS09_AddTS6VMS "Variable-message sign: Determines whether the traffic sign is Variable or fixed";
CM_ SG_ 248 VFC_TS10_CRC "CRC - Autosar E2E Profile 5";
CM_ SG_ 248 VFC_TS10_AliveCtr "Alive counter - Autosar E2E Profile 5";
CM_ SG_ 248 VFC_TS10_ProtBlockCtr "Protocol-Signal: Block-Counter";
CM_ SG_ 248 VFC_TS10_ProtOrderIndex "Protocol-Signal: Index to ensure same order in Tx and Rx (Ethernet only)";
CM_ SG_ 248 VFC_TS10_ID "Unique Traffic Sign ID";
CM_ SG_ 248 VFC_TS10_Class "The type of main sign that has been detected by the vision system";
CM_ SG_ 248 VFC_TS10_TSProb "Probability that the sign is a traffic sign";
CM_ SG_ 248 VFC_TS10_Dx "Traffic sign distance in longitudinal direction";
CM_ SG_ 248 VFC_TS10_Dy "Traffic sign distance in lateral direction";
CM_ SG_ 248 VFC_TS10_Dz "Traffic sign distance in vertical direction";
CM_ SG_ 248 VFC_TS10_DxStdDev "Standard deviation of Traffic sign distance in longitudinal direction";
CM_ SG_ 248 VFC_TS10_DyStdDev "Standard deviation of Traffic sign distance in lateral direction";
CM_ SG_ 248 VFC_TS10_DzStdDev "Standard deviation of Traffic sign distance in vertical direction";
CM_ SG_ 248 VFC_TS10_Width "Width of the sign";
CM_ SG_ 248 VFC_TS10_Height "Height of the sign";
CM_ SG_ 248 VFC_TS10_EmbedFlag "Determines whether the sign is embedded or not";
CM_ SG_ 248 VFC_TS10_Quality "A flag that determines the quality of the sign";
CM_ SG_ 248 VFC_TS10_VMS "Variable-message sign: Determines whether the traffic sign is Variable or fixed";
CM_ SG_ 248 VFC_TS10_Stable "Determines whether the object is stable";
CM_ SG_ 248 VFC_TS10_VehicleSticker "Flag which indicates whether the detected traffic sign is a invalid sign on a vehicle or not";
CM_ SG_ 248 VFC_TS10_InternalTrack "Flag which indicates if this sign is an internal track, i.e. an sign hypothesis of low quality";
CM_ SG_ 248 VFC_TS10_ValidLanes "Indicates on which lane the detected sign is valid. Bitfield:
Bit 0: valid on first right hand lane
Bit 1: valid on second right hand lane
Bit 2: valid on third right hand lane
Bit 3: valid on fourth right hand lane
Bit 4: valid on fifth right hand lane";
CM_ SG_ 248 VFC_TS10_ValidDay "The video sensor shall provide the week days for which the main traffic sign is valid. Bitfield:
Bit 0: MONDAY
Bit 1: TUESDAY
Bit 2: WEDNESDAY
Bit 3: THURSDAY
Bit 4: FRIDAY
Bit 5: SATURDAY
Bit 6: SUNDAY";
CM_ SG_ 248 VFC_TS10_ValidTimeRange1Start "Start time for the first time range in which the main traffic sign is valid. Minutes since midnight.";
CM_ SG_ 248 VFC_TS10_ValidTimeRange1End "End time for the first time range in which the main traffic sign is valid. Minutes since midnight.";
CM_ SG_ 248 VFC_TS10_ValidTimeRange2Start "Start time for the first time range in which the main traffic sign is valid. Minutes since midnight.";
CM_ SG_ 248 VFC_TS10_ValidTimeRange2End "End time for the first time range in which the main traffic sign is valid. Minutes since midnight.";
CM_ SG_ 248 VFC_TS10_ValidInDist "Indicates the longitudinal distance in which the validity of the main TSR starts";
CM_ SG_ 248 VFC_TS10_ValidDist "Indicates the longitudinal distance for which the main traffic sign is valid";
CM_ SG_ 248 VFC_TS10_AddTSCount "Number of additional signs attached to the main sign. This can be a minimum of 0 and a maximum of 6.";
CM_ SG_ 248 VFC_TS10_AddTS1Class "The type of additonal sign that has been detected by the vision system";
CM_ SG_ 248 VFC_TS10_AddTS1Prob "Probability that the sign is a traffic sign";
CM_ SG_ 248 VFC_TS10_AddTS1Quality "A flag that determines the quality of the signal";
CM_ SG_ 248 VFC_TS10_AddTS1VMS "Variable-message sign: Determines whether the traffic sign is Variable or fixed";
CM_ SG_ 248 VFC_TS10_AddTS2Class "The type of additonal sign that has been detected by the vision system";
CM_ SG_ 248 VFC_TS10_AddTS2Prob "Probability that the sign is a traffic sign";
CM_ SG_ 248 VFC_TS10_AddTS2Quality "A flag that determines the quality of the signal";
CM_ SG_ 248 VFC_TS10_AddTS2VMS "Variable-message sign: Determines whether the traffic sign is Variable or fixed";
CM_ SG_ 248 VFC_TS10_AddTS3Class "The type of additonal sign that has been detected by the vision system";
CM_ SG_ 248 VFC_TS10_AddTS3Prob "Probability that the sign is a traffic sign";
CM_ SG_ 248 VFC_TS10_AddTS3Quality "A flag that determines the quality of the signal";
CM_ SG_ 248 VFC_TS10_AddTS3VMS "Variable-message sign: Determines whether the traffic sign is Variable or fixed";
CM_ SG_ 248 VFC_TS10_AddTS4Class "The type of additonal sign that has been detected by the vision system";
CM_ SG_ 248 VFC_TS10_AddTS4Prob "Probability that the sign is a traffic sign";
CM_ SG_ 248 VFC_TS10_AddTS4Quality "A flag that determines the quality of the signal";
CM_ SG_ 248 VFC_TS10_AddTS4VMS "Variable-message sign: Determines whether the traffic sign is Variable or fixed";
CM_ SG_ 248 VFC_TS10_AddTS5Class "The type of additonal sign that has been detected by the vision system";
CM_ SG_ 248 VFC_TS10_AddTS5Prob "Probability that the sign is a traffic sign";
CM_ SG_ 248 VFC_TS10_AddTS5Quality "A flag that determines the quality of the signal";
CM_ SG_ 248 VFC_TS10_AddTS5VMS "Variable-message sign: Determines whether the traffic sign is Variable or fixed";
CM_ SG_ 248 VFC_TS10_AddTS6Class "The type of additonal sign that has been detected by the vision system";
CM_ SG_ 248 VFC_TS10_AddTS6Prob "Probability that the sign is a traffic sign";
CM_ SG_ 248 VFC_TS10_AddTS6Quality "A flag that determines the quality of the signal";
CM_ SG_ 248 VFC_TS10_AddTS6VMS "Variable-message sign: Determines whether the traffic sign is Variable or fixed";
CM_ SG_ 249 VFC_TS11_CRC "CRC - Autosar E2E Profile 5";
CM_ SG_ 249 VFC_TS11_AliveCtr "Alive counter - Autosar E2E Profile 5";
CM_ SG_ 249 VFC_TS11_ProtBlockCtr "Protocol-Signal: Block-Counter";
CM_ SG_ 249 VFC_TS11_ProtOrderIndex "Protocol-Signal: Index to ensure same order in Tx and Rx (Ethernet only)";
CM_ SG_ 249 VFC_TS11_ID "Unique Traffic Sign ID";
CM_ SG_ 249 VFC_TS11_Class "The type of main sign that has been detected by the vision system";
CM_ SG_ 249 VFC_TS11_TSProb "Probability that the sign is a traffic sign";
CM_ SG_ 249 VFC_TS11_Dx "Traffic sign distance in longitudinal direction";
CM_ SG_ 249 VFC_TS11_Dy "Traffic sign distance in lateral direction";
CM_ SG_ 249 VFC_TS11_Dz "Traffic sign distance in vertical direction";
CM_ SG_ 249 VFC_TS11_DxStdDev "Standard deviation of Traffic sign distance in longitudinal direction";
CM_ SG_ 249 VFC_TS11_DyStdDev "Standard deviation of Traffic sign distance in lateral direction";
CM_ SG_ 249 VFC_TS11_DzStdDev "Standard deviation of Traffic sign distance in vertical direction";
CM_ SG_ 249 VFC_TS11_Width "Width of the sign";
CM_ SG_ 249 VFC_TS11_Height "Height of the sign";
CM_ SG_ 249 VFC_TS11_EmbedFlag "Determines whether the sign is embedded or not";
CM_ SG_ 249 VFC_TS11_Quality "A flag that determines the quality of the sign";
CM_ SG_ 249 VFC_TS11_VMS "Variable-message sign: Determines whether the traffic sign is Variable or fixed";
CM_ SG_ 249 VFC_TS11_Stable "Determines whether the object is stable";
CM_ SG_ 249 VFC_TS11_VehicleSticker "Flag which indicates whether the detected traffic sign is a invalid sign on a vehicle or not";
CM_ SG_ 249 VFC_TS11_InternalTrack "Flag which indicates if this sign is an internal track, i.e. an sign hypothesis of low quality";
CM_ SG_ 249 VFC_TS11_ValidLanes "Indicates on which lane the detected sign is valid. Bitfield:
Bit 0: valid on first right hand lane
Bit 1: valid on second right hand lane
Bit 2: valid on third right hand lane
Bit 3: valid on fourth right hand lane
Bit 4: valid on fifth right hand lane";
CM_ SG_ 249 VFC_TS11_ValidDay "The video sensor shall provide the week days for which the main traffic sign is valid. Bitfield:
Bit 0: MONDAY
Bit 1: TUESDAY
Bit 2: WEDNESDAY
Bit 3: THURSDAY
Bit 4: FRIDAY
Bit 5: SATURDAY
Bit 6: SUNDAY";
CM_ SG_ 249 VFC_TS11_ValidTimeRange1Start "Start time for the first time range in which the main traffic sign is valid. Minutes since midnight.";
CM_ SG_ 249 VFC_TS11_ValidTimeRange1End "End time for the first time range in which the main traffic sign is valid. Minutes since midnight.";
CM_ SG_ 249 VFC_TS11_ValidTimeRange2Start "Start time for the first time range in which the main traffic sign is valid. Minutes since midnight.";
CM_ SG_ 249 VFC_TS11_ValidTimeRange2End "End time for the first time range in which the main traffic sign is valid. Minutes since midnight.";
CM_ SG_ 249 VFC_TS11_ValidInDist "Indicates the longitudinal distance in which the validity of the main TSR starts";
CM_ SG_ 249 VFC_TS11_ValidDist "Indicates the longitudinal distance for which the main traffic sign is valid";
CM_ SG_ 249 VFC_TS11_AddTSCount "Number of additional signs attached to the main sign. This can be a minimum of 0 and a maximum of 6.";
CM_ SG_ 249 VFC_TS11_AddTS1Class "The type of additonal sign that has been detected by the vision system";
CM_ SG_ 249 VFC_TS11_AddTS1Prob "Probability that the sign is a traffic sign";
CM_ SG_ 249 VFC_TS11_AddTS1Quality "A flag that determines the quality of the signal";
CM_ SG_ 249 VFC_TS11_AddTS1VMS "Variable-message sign: Determines whether the traffic sign is Variable or fixed";
CM_ SG_ 249 VFC_TS11_AddTS2Class "The type of additonal sign that has been detected by the vision system";
CM_ SG_ 249 VFC_TS11_AddTS2Prob "Probability that the sign is a traffic sign";
CM_ SG_ 249 VFC_TS11_AddTS2Quality "A flag that determines the quality of the signal";
CM_ SG_ 249 VFC_TS11_AddTS2VMS "Variable-message sign: Determines whether the traffic sign is Variable or fixed";
CM_ SG_ 249 VFC_TS11_AddTS3Class "The type of additonal sign that has been detected by the vision system";
CM_ SG_ 249 VFC_TS11_AddTS3Prob "Probability that the sign is a traffic sign";
CM_ SG_ 249 VFC_TS11_AddTS3Quality "A flag that determines the quality of the signal";
CM_ SG_ 249 VFC_TS11_AddTS3VMS "Variable-message sign: Determines whether the traffic sign is Variable or fixed";
CM_ SG_ 249 VFC_TS11_AddTS4Class "The type of additonal sign that has been detected by the vision system";
CM_ SG_ 249 VFC_TS11_AddTS4Prob "Probability that the sign is a traffic sign";
CM_ SG_ 249 VFC_TS11_AddTS4Quality "A flag that determines the quality of the signal";
CM_ SG_ 249 VFC_TS11_AddTS4VMS "Variable-message sign: Determines whether the traffic sign is Variable or fixed";
CM_ SG_ 249 VFC_TS11_AddTS5Class "The type of additonal sign that has been detected by the vision system";
CM_ SG_ 249 VFC_TS11_AddTS5Prob "Probability that the sign is a traffic sign";
CM_ SG_ 249 VFC_TS11_AddTS5Quality "A flag that determines the quality of the signal";
CM_ SG_ 249 VFC_TS11_AddTS5VMS "Variable-message sign: Determines whether the traffic sign is Variable or fixed";
CM_ SG_ 249 VFC_TS11_AddTS6Class "The type of additonal sign that has been detected by the vision system";
CM_ SG_ 249 VFC_TS11_AddTS6Prob "Probability that the sign is a traffic sign";
CM_ SG_ 249 VFC_TS11_AddTS6Quality "A flag that determines the quality of the signal";
CM_ SG_ 249 VFC_TS11_AddTS6VMS "Variable-message sign: Determines whether the traffic sign is Variable or fixed";
CM_ SG_ 250 VFC_TS12_CRC "CRC - Autosar E2E Profile 5";
CM_ SG_ 250 VFC_TS12_AliveCtr "Alive counter - Autosar E2E Profile 5";
CM_ SG_ 250 VFC_TS12_ProtBlockCtr "Protocol-Signal: Block-Counter";
CM_ SG_ 250 VFC_TS12_ProtOrderIndex "Protocol-Signal: Index to ensure same order in Tx and Rx (Ethernet only)";
CM_ SG_ 250 VFC_TS12_ID "Unique Traffic Sign ID";
CM_ SG_ 250 VFC_TS12_Class "The type of main sign that has been detected by the vision system";
CM_ SG_ 250 VFC_TS12_TSProb "Probability that the sign is a traffic sign";
CM_ SG_ 250 VFC_TS12_Dx "Traffic sign distance in longitudinal direction";
CM_ SG_ 250 VFC_TS12_Dy "Traffic sign distance in lateral direction";
CM_ SG_ 250 VFC_TS12_Dz "Traffic sign distance in vertical direction";
CM_ SG_ 250 VFC_TS12_DxStdDev "Standard deviation of Traffic sign distance in longitudinal direction";
CM_ SG_ 250 VFC_TS12_DyStdDev "Standard deviation of Traffic sign distance in lateral direction";
CM_ SG_ 250 VFC_TS12_DzStdDev "Standard deviation of Traffic sign distance in vertical direction";
CM_ SG_ 250 VFC_TS12_Width "Width of the sign";
CM_ SG_ 250 VFC_TS12_Height "Height of the sign";
CM_ SG_ 250 VFC_TS12_EmbedFlag "Determines whether the sign is embedded or not";
CM_ SG_ 250 VFC_TS12_Quality "A flag that determines the quality of the sign";
CM_ SG_ 250 VFC_TS12_VMS "Variable-message sign: Determines whether the traffic sign is Variable or fixed";
CM_ SG_ 250 VFC_TS12_Stable "Determines whether the object is stable";
CM_ SG_ 250 VFC_TS12_VehicleSticker "Flag which indicates whether the detected traffic sign is a invalid sign on a vehicle or not";
CM_ SG_ 250 VFC_TS12_InternalTrack "Flag which indicates if this sign is an internal track, i.e. an sign hypothesis of low quality";
CM_ SG_ 250 VFC_TS12_ValidLanes "Indicates on which lane the detected sign is valid. Bitfield:
Bit 0: valid on first right hand lane
Bit 1: valid on second right hand lane
Bit 2: valid on third right hand lane
Bit 3: valid on fourth right hand lane
Bit 4: valid on fifth right hand lane";
CM_ SG_ 250 VFC_TS12_ValidDay "The video sensor shall provide the week days for which the main traffic sign is valid. Bitfield:
Bit 0: MONDAY
Bit 1: TUESDAY
Bit 2: WEDNESDAY
Bit 3: THURSDAY
Bit 4: FRIDAY
Bit 5: SATURDAY
Bit 6: SUNDAY";
CM_ SG_ 250 VFC_TS12_ValidTimeRange1Start "Start time for the first time range in which the main traffic sign is valid. Minutes since midnight.";
CM_ SG_ 250 VFC_TS12_ValidTimeRange1End "End time for the first time range in which the main traffic sign is valid. Minutes since midnight.";
CM_ SG_ 250 VFC_TS12_ValidTimeRange2Start "Start time for the first time range in which the main traffic sign is valid. Minutes since midnight.";
CM_ SG_ 250 VFC_TS12_ValidTimeRange2End "End time for the first time range in which the main traffic sign is valid. Minutes since midnight.";
CM_ SG_ 250 VFC_TS12_ValidInDist "Indicates the longitudinal distance in which the validity of the main TSR starts";
CM_ SG_ 250 VFC_TS12_ValidDist "Indicates the longitudinal distance for which the main traffic sign is valid";
CM_ SG_ 250 VFC_TS12_AddTSCount "Number of additional signs attached to the main sign. This can be a minimum of 0 and a maximum of 6.";
CM_ SG_ 250 VFC_TS12_AddTS1Class "The type of additonal sign that has been detected by the vision system";
CM_ SG_ 250 VFC_TS12_AddTS1Prob "Probability that the sign is a traffic sign";
CM_ SG_ 250 VFC_TS12_AddTS1Quality "A flag that determines the quality of the signal";
CM_ SG_ 250 VFC_TS12_AddTS1VMS "Variable-message sign: Determines whether the traffic sign is Variable or fixed";
CM_ SG_ 250 VFC_TS12_AddTS2Class "The type of additonal sign that has been detected by the vision system";
CM_ SG_ 250 VFC_TS12_AddTS2Prob "Probability that the sign is a traffic sign";
CM_ SG_ 250 VFC_TS12_AddTS2Quality "A flag that determines the quality of the signal";
CM_ SG_ 250 VFC_TS12_AddTS2VMS "Variable-message sign: Determines whether the traffic sign is Variable or fixed";
CM_ SG_ 250 VFC_TS12_AddTS3Class "The type of additonal sign that has been detected by the vision system";
CM_ SG_ 250 VFC_TS12_AddTS3Prob "Probability that the sign is a traffic sign";
CM_ SG_ 250 VFC_TS12_AddTS3Quality "A flag that determines the quality of the signal";
CM_ SG_ 250 VFC_TS12_AddTS3VMS "Variable-message sign: Determines whether the traffic sign is Variable or fixed";
CM_ SG_ 250 VFC_TS12_AddTS4Class "The type of additonal sign that has been detected by the vision system";
CM_ SG_ 250 VFC_TS12_AddTS4Prob "Probability that the sign is a traffic sign";
CM_ SG_ 250 VFC_TS12_AddTS4Quality "A flag that determines the quality of the signal";
CM_ SG_ 250 VFC_TS12_AddTS4VMS "Variable-message sign: Determines whether the traffic sign is Variable or fixed";
CM_ SG_ 250 VFC_TS12_AddTS5Class "The type of additonal sign that has been detected by the vision system";
CM_ SG_ 250 VFC_TS12_AddTS5Prob "Probability that the sign is a traffic sign";
CM_ SG_ 250 VFC_TS12_AddTS5Quality "A flag that determines the quality of the signal";
CM_ SG_ 250 VFC_TS12_AddTS5VMS "Variable-message sign: Determines whether the traffic sign is Variable or fixed";
CM_ SG_ 250 VFC_TS12_AddTS6Class "The type of additonal sign that has been detected by the vision system";
CM_ SG_ 250 VFC_TS12_AddTS6Prob "Probability that the sign is a traffic sign";
CM_ SG_ 250 VFC_TS12_AddTS6Quality "A flag that determines the quality of the signal";
CM_ SG_ 250 VFC_TS12_AddTS6VMS "Variable-message sign: Determines whether the traffic sign is Variable or fixed";
CM_ SG_ 251 VFC_TS13_CRC "CRC - Autosar E2E Profile 5";
CM_ SG_ 251 VFC_TS13_AliveCtr "Alive counter - Autosar E2E Profile 5";
CM_ SG_ 251 VFC_TS13_ProtBlockCtr "Protocol-Signal: Block-Counter";
CM_ SG_ 251 VFC_TS13_ProtOrderIndex "Protocol-Signal: Index to ensure same order in Tx and Rx (Ethernet only)";
CM_ SG_ 251 VFC_TS13_ID "Unique Traffic Sign ID";
CM_ SG_ 251 VFC_TS13_Class "The type of main sign that has been detected by the vision system";
CM_ SG_ 251 VFC_TS13_TSProb "Probability that the sign is a traffic sign";
CM_ SG_ 251 VFC_TS13_Dx "Traffic sign distance in longitudinal direction";
CM_ SG_ 251 VFC_TS13_Dy "Traffic sign distance in lateral direction";
CM_ SG_ 251 VFC_TS13_Dz "Traffic sign distance in vertical direction";
CM_ SG_ 251 VFC_TS13_DxStdDev "Standard deviation of Traffic sign distance in longitudinal direction";
CM_ SG_ 251 VFC_TS13_DyStdDev "Standard deviation of Traffic sign distance in lateral direction";
CM_ SG_ 251 VFC_TS13_DzStdDev "Standard deviation of Traffic sign distance in vertical direction";
CM_ SG_ 251 VFC_TS13_Width "Width of the sign";
CM_ SG_ 251 VFC_TS13_Height "Height of the sign";
CM_ SG_ 251 VFC_TS13_EmbedFlag "Determines whether the sign is embedded or not";
CM_ SG_ 251 VFC_TS13_Quality "A flag that determines the quality of the sign";
CM_ SG_ 251 VFC_TS13_VMS "Variable-message sign: Determines whether the traffic sign is Variable or fixed";
CM_ SG_ 251 VFC_TS13_Stable "Determines whether the object is stable";
CM_ SG_ 251 VFC_TS13_VehicleSticker "Flag which indicates whether the detected traffic sign is a invalid sign on a vehicle or not";
CM_ SG_ 251 VFC_TS13_InternalTrack "Flag which indicates if this sign is an internal track, i.e. an sign hypothesis of low quality";
CM_ SG_ 251 VFC_TS13_ValidLanes "Indicates on which lane the detected sign is valid. Bitfield:
Bit 0: valid on first right hand lane
Bit 1: valid on second right hand lane
Bit 2: valid on third right hand lane
Bit 3: valid on fourth right hand lane
Bit 4: valid on fifth right hand lane";
CM_ SG_ 251 VFC_TS13_ValidDay "The video sensor shall provide the week days for which the main traffic sign is valid. Bitfield:
Bit 0: MONDAY
Bit 1: TUESDAY
Bit 2: WEDNESDAY
Bit 3: THURSDAY
Bit 4: FRIDAY
Bit 5: SATURDAY
Bit 6: SUNDAY";
CM_ SG_ 251 VFC_TS13_ValidTimeRange1Start "Start time for the first time range in which the main traffic sign is valid. Minutes since midnight.";
CM_ SG_ 251 VFC_TS13_ValidTimeRange1End "End time for the first time range in which the main traffic sign is valid. Minutes since midnight.";
CM_ SG_ 251 VFC_TS13_ValidTimeRange2Start "Start time for the first time range in which the main traffic sign is valid. Minutes since midnight.";
CM_ SG_ 251 VFC_TS13_ValidTimeRange2End "End time for the first time range in which the main traffic sign is valid. Minutes since midnight.";
CM_ SG_ 251 VFC_TS13_ValidInDist "Indicates the longitudinal distance in which the validity of the main TSR starts";
CM_ SG_ 251 VFC_TS13_ValidDist "Indicates the longitudinal distance for which the main traffic sign is valid";
CM_ SG_ 251 VFC_TS13_AddTSCount "Number of additional signs attached to the main sign. This can be a minimum of 0 and a maximum of 6.";
CM_ SG_ 251 VFC_TS13_AddTS1Class "The type of additonal sign that has been detected by the vision system";
CM_ SG_ 251 VFC_TS13_AddTS1Prob "Probability that the sign is a traffic sign";
CM_ SG_ 251 VFC_TS13_AddTS1Quality "A flag that determines the quality of the signal";
CM_ SG_ 251 VFC_TS13_AddTS1VMS "Variable-message sign: Determines whether the traffic sign is Variable or fixed";
CM_ SG_ 251 VFC_TS13_AddTS2Class "The type of additonal sign that has been detected by the vision system";
CM_ SG_ 251 VFC_TS13_AddTS2Prob "Probability that the sign is a traffic sign";
CM_ SG_ 251 VFC_TS13_AddTS2Quality "A flag that determines the quality of the signal";
CM_ SG_ 251 VFC_TS13_AddTS2VMS "Variable-message sign: Determines whether the traffic sign is Variable or fixed";
CM_ SG_ 251 VFC_TS13_AddTS3Class "The type of additonal sign that has been detected by the vision system";
CM_ SG_ 251 VFC_TS13_AddTS3Prob "Probability that the sign is a traffic sign";
CM_ SG_ 251 VFC_TS13_AddTS3Quality "A flag that determines the quality of the signal";
CM_ SG_ 251 VFC_TS13_AddTS3VMS "Variable-message sign: Determines whether the traffic sign is Variable or fixed";
CM_ SG_ 251 VFC_TS13_AddTS4Class "The type of additonal sign that has been detected by the vision system";
CM_ SG_ 251 VFC_TS13_AddTS4Prob "Probability that the sign is a traffic sign";
CM_ SG_ 251 VFC_TS13_AddTS4Quality "A flag that determines the quality of the signal";
CM_ SG_ 251 VFC_TS13_AddTS4VMS "Variable-message sign: Determines whether the traffic sign is Variable or fixed";
CM_ SG_ 251 VFC_TS13_AddTS5Class "The type of additonal sign that has been detected by the vision system";
CM_ SG_ 251 VFC_TS13_AddTS5Prob "Probability that the sign is a traffic sign";
CM_ SG_ 251 VFC_TS13_AddTS5Quality "A flag that determines the quality of the signal";
CM_ SG_ 251 VFC_TS13_AddTS5VMS "Variable-message sign: Determines whether the traffic sign is Variable or fixed";
CM_ SG_ 251 VFC_TS13_AddTS6Class "The type of additonal sign that has been detected by the vision system";
CM_ SG_ 251 VFC_TS13_AddTS6Prob "Probability that the sign is a traffic sign";
CM_ SG_ 251 VFC_TS13_AddTS6Quality "A flag that determines the quality of the signal";
CM_ SG_ 251 VFC_TS13_AddTS6VMS "Variable-message sign: Determines whether the traffic sign is Variable or fixed";
CM_ SG_ 252 VFC_TS14_CRC "CRC - Autosar E2E Profile 5";
CM_ SG_ 252 VFC_TS14_AliveCtr "Alive counter - Autosar E2E Profile 5";
CM_ SG_ 252 VFC_TS14_ProtBlockCtr "Protocol-Signal: Block-Counter";
CM_ SG_ 252 VFC_TS14_ProtOrderIndex "Protocol-Signal: Index to ensure same order in Tx and Rx (Ethernet only)";
CM_ SG_ 252 VFC_TS14_ID "Unique Traffic Sign ID";
CM_ SG_ 252 VFC_TS14_Class "The type of main sign that has been detected by the vision system";
CM_ SG_ 252 VFC_TS14_TSProb "Probability that the sign is a traffic sign";
CM_ SG_ 252 VFC_TS14_Dx "Traffic sign distance in longitudinal direction";
CM_ SG_ 252 VFC_TS14_Dy "Traffic sign distance in lateral direction";
CM_ SG_ 252 VFC_TS14_Dz "Traffic sign distance in vertical direction";
CM_ SG_ 252 VFC_TS14_DxStdDev "Standard deviation of Traffic sign distance in longitudinal direction";
CM_ SG_ 252 VFC_TS14_DyStdDev "Standard deviation of Traffic sign distance in lateral direction";
CM_ SG_ 252 VFC_TS14_DzStdDev "Standard deviation of Traffic sign distance in vertical direction";
CM_ SG_ 252 VFC_TS14_Width "Width of the sign";
CM_ SG_ 252 VFC_TS14_Height "Height of the sign";
CM_ SG_ 252 VFC_TS14_EmbedFlag "Determines whether the sign is embedded or not";
CM_ SG_ 252 VFC_TS14_Quality "A flag that determines the quality of the sign";
CM_ SG_ 252 VFC_TS14_VMS "Variable-message sign: Determines whether the traffic sign is Variable or fixed";
CM_ SG_ 252 VFC_TS14_Stable "Determines whether the object is stable";
CM_ SG_ 252 VFC_TS14_VehicleSticker "Flag which indicates whether the detected traffic sign is a invalid sign on a vehicle or not";
CM_ SG_ 252 VFC_TS14_InternalTrack "Flag which indicates if this sign is an internal track, i.e. an sign hypothesis of low quality";
CM_ SG_ 252 VFC_TS14_ValidLanes "Indicates on which lane the detected sign is valid. Bitfield:
Bit 0: valid on first right hand lane
Bit 1: valid on second right hand lane
Bit 2: valid on third right hand lane
Bit 3: valid on fourth right hand lane
Bit 4: valid on fifth right hand lane";
CM_ SG_ 252 VFC_TS14_ValidDay "The video sensor shall provide the week days for which the main traffic sign is valid. Bitfield:
Bit 0: MONDAY
Bit 1: TUESDAY
Bit 2: WEDNESDAY
Bit 3: THURSDAY
Bit 4: FRIDAY
Bit 5: SATURDAY
Bit 6: SUNDAY";
CM_ SG_ 252 VFC_TS14_ValidTimeRange1Start "Start time for the first time range in which the main traffic sign is valid. Minutes since midnight.";
CM_ SG_ 252 VFC_TS14_ValidTimeRange1End "End time for the first time range in which the main traffic sign is valid. Minutes since midnight.";
CM_ SG_ 252 VFC_TS14_ValidTimeRange2Start "Start time for the first time range in which the main traffic sign is valid. Minutes since midnight.";
CM_ SG_ 252 VFC_TS14_ValidTimeRange2End "End time for the first time range in which the main traffic sign is valid. Minutes since midnight.";
CM_ SG_ 252 VFC_TS14_ValidInDist "Indicates the longitudinal distance in which the validity of the main TSR starts";
CM_ SG_ 252 VFC_TS14_ValidDist "Indicates the longitudinal distance for which the main traffic sign is valid";
CM_ SG_ 252 VFC_TS14_AddTSCount "Number of additional signs attached to the main sign. This can be a minimum of 0 and a maximum of 6.";
CM_ SG_ 252 VFC_TS14_AddTS1Class "The type of additonal sign that has been detected by the vision system";
CM_ SG_ 252 VFC_TS14_AddTS1Prob "Probability that the sign is a traffic sign";
CM_ SG_ 252 VFC_TS14_AddTS1Quality "A flag that determines the quality of the signal";
CM_ SG_ 252 VFC_TS14_AddTS1VMS "Variable-message sign: Determines whether the traffic sign is Variable or fixed";
CM_ SG_ 252 VFC_TS14_AddTS2Class "The type of additonal sign that has been detected by the vision system";
CM_ SG_ 252 VFC_TS14_AddTS2Prob "Probability that the sign is a traffic sign";
CM_ SG_ 252 VFC_TS14_AddTS2Quality "A flag that determines the quality of the signal";
CM_ SG_ 252 VFC_TS14_AddTS2VMS "Variable-message sign: Determines whether the traffic sign is Variable or fixed";
CM_ SG_ 252 VFC_TS14_AddTS3Class "The type of additonal sign that has been detected by the vision system";
CM_ SG_ 252 VFC_TS14_AddTS3Prob "Probability that the sign is a traffic sign";
CM_ SG_ 252 VFC_TS14_AddTS3Quality "A flag that determines the quality of the signal";
CM_ SG_ 252 VFC_TS14_AddTS3VMS "Variable-message sign: Determines whether the traffic sign is Variable or fixed";
CM_ SG_ 252 VFC_TS14_AddTS4Class "The type of additonal sign that has been detected by the vision system";
CM_ SG_ 252 VFC_TS14_AddTS4Prob "Probability that the sign is a traffic sign";
CM_ SG_ 252 VFC_TS14_AddTS4Quality "A flag that determines the quality of the signal";
CM_ SG_ 252 VFC_TS14_AddTS4VMS "Variable-message sign: Determines whether the traffic sign is Variable or fixed";
CM_ SG_ 252 VFC_TS14_AddTS5Class "The type of additonal sign that has been detected by the vision system";
CM_ SG_ 252 VFC_TS14_AddTS5Prob "Probability that the sign is a traffic sign";
CM_ SG_ 252 VFC_TS14_AddTS5Quality "A flag that determines the quality of the signal";
CM_ SG_ 252 VFC_TS14_AddTS5VMS "Variable-message sign: Determines whether the traffic sign is Variable or fixed";
CM_ SG_ 252 VFC_TS14_AddTS6Class "The type of additonal sign that has been detected by the vision system";
CM_ SG_ 252 VFC_TS14_AddTS6Prob "Probability that the sign is a traffic sign";
CM_ SG_ 252 VFC_TS14_AddTS6Quality "A flag that determines the quality of the signal";
CM_ SG_ 252 VFC_TS14_AddTS6VMS "Variable-message sign: Determines whether the traffic sign is Variable or fixed";
CM_ SG_ 253 VFC_TS15_CRC "CRC - Autosar E2E Profile 5";
CM_ SG_ 253 VFC_TS15_AliveCtr "Alive counter - Autosar E2E Profile 5";
CM_ SG_ 253 VFC_TS15_ProtBlockCtr "Protocol-Signal: Block-Counter";
CM_ SG_ 253 VFC_TS15_ProtOrderIndex "Protocol-Signal: Index to ensure same order in Tx and Rx (Ethernet only)";
CM_ SG_ 253 VFC_TS15_ID "Unique Traffic Sign ID";
CM_ SG_ 253 VFC_TS15_Class "The type of main sign that has been detected by the vision system";
CM_ SG_ 253 VFC_TS15_TSProb "Probability that the sign is a traffic sign";
CM_ SG_ 253 VFC_TS15_Dx "Traffic sign distance in longitudinal direction";
CM_ SG_ 253 VFC_TS15_Dy "Traffic sign distance in lateral direction";
CM_ SG_ 253 VFC_TS15_Dz "Traffic sign distance in vertical direction";
CM_ SG_ 253 VFC_TS15_DxStdDev "Standard deviation of Traffic sign distance in longitudinal direction";
CM_ SG_ 253 VFC_TS15_DyStdDev "Standard deviation of Traffic sign distance in lateral direction";
CM_ SG_ 253 VFC_TS15_DzStdDev "Standard deviation of Traffic sign distance in vertical direction";
CM_ SG_ 253 VFC_TS15_Width "Width of the sign";
CM_ SG_ 253 VFC_TS15_Height "Height of the sign";
CM_ SG_ 253 VFC_TS15_EmbedFlag "Determines whether the sign is embedded or not";
CM_ SG_ 253 VFC_TS15_Quality "A flag that determines the quality of the sign";
CM_ SG_ 253 VFC_TS15_VMS "Variable-message sign: Determines whether the traffic sign is Variable or fixed";
CM_ SG_ 253 VFC_TS15_Stable "Determines whether the object is stable";
CM_ SG_ 253 VFC_TS15_VehicleSticker "Flag which indicates whether the detected traffic sign is a invalid sign on a vehicle or not";
CM_ SG_ 253 VFC_TS15_InternalTrack "Flag which indicates if this sign is an internal track, i.e. an sign hypothesis of low quality";
CM_ SG_ 253 VFC_TS15_ValidLanes "Indicates on which lane the detected sign is valid. Bitfield:
Bit 0: valid on first right hand lane
Bit 1: valid on second right hand lane
Bit 2: valid on third right hand lane
Bit 3: valid on fourth right hand lane
Bit 4: valid on fifth right hand lane";
CM_ SG_ 253 VFC_TS15_ValidDay "The video sensor shall provide the week days for which the main traffic sign is valid. Bitfield:
Bit 0: MONDAY
Bit 1: TUESDAY
Bit 2: WEDNESDAY
Bit 3: THURSDAY
Bit 4: FRIDAY
Bit 5: SATURDAY
Bit 6: SUNDAY";
CM_ SG_ 253 VFC_TS15_ValidTimeRange1Start "Start time for the first time range in which the main traffic sign is valid. Minutes since midnight.";
CM_ SG_ 253 VFC_TS15_ValidTimeRange1End "End time for the first time range in which the main traffic sign is valid. Minutes since midnight.";
CM_ SG_ 253 VFC_TS15_ValidTimeRange2Start "Start time for the first time range in which the main traffic sign is valid. Minutes since midnight.";
CM_ SG_ 253 VFC_TS15_ValidTimeRange2End "End time for the first time range in which the main traffic sign is valid. Minutes since midnight.";
CM_ SG_ 253 VFC_TS15_ValidInDist "Indicates the longitudinal distance in which the validity of the main TSR starts";
CM_ SG_ 253 VFC_TS15_ValidDist "Indicates the longitudinal distance for which the main traffic sign is valid";
CM_ SG_ 253 VFC_TS15_AddTSCount "Number of additional signs attached to the main sign. This can be a minimum of 0 and a maximum of 6.";
CM_ SG_ 253 VFC_TS15_AddTS1Class "The type of additonal sign that has been detected by the vision system";
CM_ SG_ 253 VFC_TS15_AddTS1Prob "Probability that the sign is a traffic sign";
CM_ SG_ 253 VFC_TS15_AddTS1Quality "A flag that determines the quality of the signal";
CM_ SG_ 253 VFC_TS15_AddTS1VMS "Variable-message sign: Determines whether the traffic sign is Variable or fixed";
CM_ SG_ 253 VFC_TS15_AddTS2Class "The type of additonal sign that has been detected by the vision system";
CM_ SG_ 253 VFC_TS15_AddTS2Prob "Probability that the sign is a traffic sign";
CM_ SG_ 253 VFC_TS15_AddTS2Quality "A flag that determines the quality of the signal";
CM_ SG_ 253 VFC_TS15_AddTS2VMS "Variable-message sign: Determines whether the traffic sign is Variable or fixed";
CM_ SG_ 253 VFC_TS15_AddTS3Class "The type of additonal sign that has been detected by the vision system";
CM_ SG_ 253 VFC_TS15_AddTS3Prob "Probability that the sign is a traffic sign";
CM_ SG_ 253 VFC_TS15_AddTS3Quality "A flag that determines the quality of the signal";
CM_ SG_ 253 VFC_TS15_AddTS3VMS "Variable-message sign: Determines whether the traffic sign is Variable or fixed";
CM_ SG_ 253 VFC_TS15_AddTS4Class "The type of additonal sign that has been detected by the vision system";
CM_ SG_ 253 VFC_TS15_AddTS4Prob "Probability that the sign is a traffic sign";
CM_ SG_ 253 VFC_TS15_AddTS4Quality "A flag that determines the quality of the signal";
CM_ SG_ 253 VFC_TS15_AddTS4VMS "Variable-message sign: Determines whether the traffic sign is Variable or fixed";
CM_ SG_ 253 VFC_TS15_AddTS5Class "The type of additonal sign that has been detected by the vision system";
CM_ SG_ 253 VFC_TS15_AddTS5Prob "Probability that the sign is a traffic sign";
CM_ SG_ 253 VFC_TS15_AddTS5Quality "A flag that determines the quality of the signal";
CM_ SG_ 253 VFC_TS15_AddTS5VMS "Variable-message sign: Determines whether the traffic sign is Variable or fixed";
CM_ SG_ 253 VFC_TS15_AddTS6Class "The type of additonal sign that has been detected by the vision system";
CM_ SG_ 253 VFC_TS15_AddTS6Prob "Probability that the sign is a traffic sign";
CM_ SG_ 253 VFC_TS15_AddTS6Quality "A flag that determines the quality of the signal";
CM_ SG_ 253 VFC_TS15_AddTS6VMS "Variable-message sign: Determines whether the traffic sign is Variable or fixed";
CM_ SG_ 517 RFL_ObjHdr_CRC "CRC - Autosar E2E Profile 5";
CM_ SG_ 517 RFL_ObjHdr_AliveCtr "Alive counter - Autosar E2E Profile 5";
CM_ SG_ 517 RFL_ObjHdr_ProtBlockCtr "Protocol-Signal: Block-Counter";
CM_ SG_ 517 RFL_ObjHdr_SensorState "The sensor shall provide its operation state.
In case of multiple errors the most severe state shall be sent.";
CM_ SG_ 517 RFL_ObjHdr_ProtocolVersion "Protocol version to be send: 0x0107 = V1.7";
CM_ SG_ 517 RFL_ObjHdr_ProtObjectCount "number of detected VALID Objects that have been sent to the bus";
CM_ SG_ 517 RFL_ObjHdr_ProtRSBSegmentCount "number of detected segments that have been sent to the bus (only available in RadarFrontCenter, must be set to 0)";
CM_ SG_ 517 RFL_ObjHdr_ProtRSBPointCount "number of detected points that have been sent to the bus (only available in RadarFrontCenter, must be set to 0)";
CM_ SG_ 517 RFL_ObjHdr_TimeStampStatus "Autosar StbM_TimeBaseStatusType bitfield with extension:
Bit 0: TIMEOUT
Bit 1: Reserved1
Bit 2: SYNC_TO_GATEWAY
Bit 3: GLOBAL_TIME_BASE
Bit 4: TIMELEAP_FUTURE
Bit 5: TIMELEAP_PAST
Bit 6: Reserved6
Bit 7: Extension: GENERAL_ERROR";
CM_ SG_ 517 RFL_ObjHdr_TimeStamp "Time Stamp";
CM_ SG_ 517 RFL_ObjHdr_MountPosY "mount offset of sensor in lateral direction relative to mid axis of vehicle";
CM_ SG_ 517 RFL_ObjHdr_MountPosX "mount offset of sensor in longitudinal direction relative to rear axis of vehicle";
CM_ SG_ 517 RFL_ObjHdr_MountPosZ "mount offset of sensor in elevation direction relative to GROUND";
CM_ SG_ 517 RFL_ObjHdr_ObjectDownSel "the detected number of objects exceeded the number of max. objects that can be transmitted";
CM_ SG_ 517 RFL_ObjHdr_YawMountAngle "angle between sensor mounting direction and vehicle longitudinal axis, Azimuth";
CM_ SG_ 517 RFL_ObjHdr_YawAngleLower "Lower angle of the fied of view Azimuth";
CM_ SG_ 517 RFL_ObjHdr_AziOutOfSpec "The sensor was detected to be out-of-spec due to misalignment in azimuth";
CM_ SG_ 517 RFL_ObjHdr_YawAngleUpper "Upper angle of the field of view Azimuth";
CM_ SG_ 517 RFL_ObjHdr_ElevOutOfSpec "The sensor was detected to be out-of-spec due to misalignment in elevation";
CM_ SG_ 517 RFL_ObjHdr_PitchMountAngle "angle between sensor mounting direction and vehicle longitudinal axis, Elevation";
CM_ SG_ 517 RFL_ObjHdr_PitchAngleLower "Lower angle of the fied of view Elevation";
CM_ SG_ 517 RFL_ObjHdr_PitchAngleUpper "Upper angle of the field of view Elevation";
CM_ SG_ 517 RFL_ObjHdr_RollMountAngle "Tilt of the mounting sensor";
CM_ SG_ 517 RFL_ObjHdr_DetectionRange "Estimated detection range of the sensor";
CM_ SG_ 517 RFL_ObjHdr_TimeStampLocal "Local Time Stamp";
CM_ SG_ 528 RFL_Obj00A_CRC "CRC - Autosar E2E Profile 5";
CM_ SG_ 528 RFL_Obj00A_AliveCtr "Alive counter - Autosar E2E Profile 5";
CM_ SG_ 528 RFL_Obj00A_ProtBlockCtr "Protocol-Signal: Block-Counter";
CM_ SG_ 528 RFL_Obj00A_ID "Unique Object ID";
CM_ SG_ 528 RFL_Obj00A_Measured "Object is measured or not";
CM_ SG_ 528 RFL_Obj00A_Dx "Object position in X direction";
CM_ SG_ 528 RFL_Obj00A_Dz "Object position in Z direction";
CM_ SG_ 528 RFL_Obj00A_Dy "Object position in Y direction";
CM_ SG_ 528 RFL_Obj00A_Valid "Object is valid or not";
CM_ SG_ 528 RFL_Obj00A_Vx "Object relative velocity in X direction";
CM_ SG_ 528 RFL_Obj00A_Vy "Object relative velocity in Y direction";
CM_ SG_ 528 RFL_Obj00A_Ax "Object relative acceleration in X direction";
CM_ SG_ 528 RFL_Obj00A_Ay "Object relative acceleration in Y direction";
CM_ SG_ 528 RFL_Obj00A_HeadingYawAngle "Object heading yaw angle";
CM_ SG_ 528 RFL_Obj00A_Length "Object Length";
CM_ SG_ 528 RFL_Obj00A_Width "Object Width";
CM_ SG_ 528 RFL_Obj00A_Height "Object Height";
CM_ SG_ 528 RFL_Obj00A_DxVnce "Variance of object position in X direction";
CM_ SG_ 528 RFL_Obj00A_DyVnce "Variance of object position in Y direction";
CM_ SG_ 528 RFL_Obj00A_DzVnce "Variance of object position in Z direction";
CM_ SG_ 528 RFL_Obj00A_VxVnce "Variance of object relative velocity in X direction";
CM_ SG_ 528 RFL_Obj00A_VyVnce "Variance of object relative velocity in Y direction";
CM_ SG_ 528 RFL_Obj00A_AxVnce "Variance of object relative acceleration in X direction";
CM_ SG_ 528 RFL_Obj00A_AyVnce "Variance of object relative acceleration in Y direction";
CM_ SG_ 528 RFL_Obj00A_RefPosIndex "Reference Position of the detected objects";
CM_ SG_ 528 RFL_Obj00A_DxDyCoVnce "Covariance of Dx and Dy";
CM_ SG_ 528 RFL_Obj00A_DxVxCoVnce "Covariance of Dx and Vx";
CM_ SG_ 528 RFL_Obj00A_DyVxCoVnce "Covariance of Dy and Ax";
CM_ SG_ 528 RFL_Obj00A_DxVyCoVnce "Covariance of Dx and Vy";
CM_ SG_ 528 RFL_Obj00A_DyVyCoVnce "Covariance of Dy and Vy";
CM_ SG_ 528 RFL_Obj00A_VxVyCoVnce "Covariance of Vx and Vy";
CM_ SG_ 528 RFL_Obj00A_DxAxCoVnce "Covariance of Dx and Ax";
CM_ SG_ 528 RFL_Obj00A_DyAxCoVnce "Covariance of Dy and Ax";
CM_ SG_ 528 RFL_Obj00A_VxAxCoVnce "Covariance of Vx and Ax";
CM_ SG_ 528 RFL_Obj00A_VyAxCoVnce "Covariance of Vy and Ax";
CM_ SG_ 528 RFL_Obj00A_DxAyCoVnce "Covariance of Dx and Ay";
CM_ SG_ 528 RFL_Obj00A_DyAyCoVnce "Covariance of Dy and Ay";
CM_ SG_ 528 RFL_Obj00A_VxAyCoVnce "Covariance of Vx and Ay";
CM_ SG_ 528 RFL_Obj00A_VyAyCoVnce "Covariance of Vy and Ay";
CM_ SG_ 528 RFL_Obj00A_AxAyCoVnce "Covariance of Ax and Ay";
CM_ SG_ 528 RFL_Obj00A_HeadingYawAngleVnce "Variance of object heading yaw angle";
CM_ SG_ 528 RFL_Obj00A_LengthVnce "Variance of object Length";
CM_ SG_ 528 RFL_Obj00A_WidthVnce "Variance of object Width";
CM_ SG_ 528 RFL_Obj00A_HeightVnce "Variance of object Height";
CM_ SG_ 528 RFL_Obj00A_ProbExist "Existence probability of object";
CM_ SG_ 528 RFL_Obj00A_ProbObstacle "Probability of the object being an Obstacle";
CM_ SG_ 528 RFL_Obj00A_ProbNonObstacle "Probability of the object being a Non-Obstacle";
CM_ SG_ 528 RFL_Obj00A_ProbMobileObst "Probability of the object being a mobile obstacle";
CM_ SG_ 529 RFL_Obj00B_CRC "CRC - Autosar E2E Profile 5";
CM_ SG_ 529 RFL_Obj00B_AliveCtr "Alive counter - Autosar E2E Profile 5";
CM_ SG_ 529 RFL_Obj00B_ProtBlockCtr "Protocol-Signal: Block-Counter";
CM_ SG_ 529 RFL_Obj00B_ProbMob4PlusWhl "Probability of a mobile object which has 4 or more wheels";
CM_ SG_ 529 RFL_Obj00B_ProbMob2Whl "Probability of a mobile object being 2-wheels vehicle";
CM_ SG_ 529 RFL_Obj00B_ProbMobPed "Probability of a mobile object being a pedestrian";
CM_ SG_ 529 RFL_Obj00B_Prob4PlusWhlCAR "Probability of a mobile object which has 4 or more wheels--passenger car";
CM_ SG_ 529 RFL_Obj00B_Prob4PlusWhlbHGV "Probability of a mobile object which has 4 or more wheels--commercial vehicle (Truck)";
CM_ SG_ 529 RFL_Obj00B_ProbGNDReflex "Probability of the object being a ground reflex";
CM_ SG_ 529 RFL_Obj00B_ProbStatBarrier "Probability of the object being a stationary road barrier";
CM_ SG_ 529 RFL_Obj00B_ProbStatObst "Probability of the object being a stationary obstacle";
CM_ SG_ 529 RFL_Obj00B_MovingProbability "Object has been observed moving over the ground";
CM_ SG_ 529 RFL_Obj00B_MovingObserved "Object has been observed moving over the ground since it was first detected";
CM_ SG_ 529 RFL_Obj00B_BehaviorType "Indicates that which behavior the object associated for";
CM_ SG_ 530 RFL_Obj01A_CRC "CRC - Autosar E2E Profile 5";
CM_ SG_ 530 RFL_Obj01A_AliveCtr "Alive counter - Autosar E2E Profile 5";
CM_ SG_ 530 RFL_Obj01A_ProtBlockCtr "Protocol-Signal: Block-Counter";
CM_ SG_ 530 RFL_Obj01A_ID "Unique Object ID";
CM_ SG_ 530 RFL_Obj01A_Measured "Object is measured or not";
CM_ SG_ 530 RFL_Obj01A_Dx "Object position in X direction";
CM_ SG_ 530 RFL_Obj01A_Dz "Object position in Z direction";
CM_ SG_ 530 RFL_Obj01A_Dy "Object position in Y direction";
CM_ SG_ 530 RFL_Obj01A_Valid "Object is valid or not";
CM_ SG_ 530 RFL_Obj01A_Vx "Object relative velocity in X direction";
CM_ SG_ 530 RFL_Obj01A_Vy "Object relative velocity in Y direction";
CM_ SG_ 530 RFL_Obj01A_Ax "Object relative acceleration in X direction";
CM_ SG_ 530 RFL_Obj01A_Ay "Object relative acceleration in Y direction";
CM_ SG_ 530 RFL_Obj01A_HeadingYawAngle "Object heading yaw angle";
CM_ SG_ 530 RFL_Obj01A_Length "Object Length";
CM_ SG_ 530 RFL_Obj01A_Width "Object Width";
CM_ SG_ 530 RFL_Obj01A_Height "Object Height";
CM_ SG_ 530 RFL_Obj01A_DxVnce "Variance of object position in X direction";
CM_ SG_ 530 RFL_Obj01A_DyVnce "Variance of object position in Y direction";
CM_ SG_ 530 RFL_Obj01A_DzVnce "Variance of object position in Z direction";
CM_ SG_ 530 RFL_Obj01A_VxVnce "Variance of object relative velocity in X direction";
CM_ SG_ 530 RFL_Obj01A_VyVnce "Variance of object relative velocity in Y direction";
CM_ SG_ 530 RFL_Obj01A_AxVnce "Variance of object relative acceleration in X direction";
CM_ SG_ 530 RFL_Obj01A_AyVnce "Variance of object relative acceleration in Y direction";
CM_ SG_ 530 RFL_Obj01A_RefPosIndex "Reference Position of the detected objects";
CM_ SG_ 530 RFL_Obj01A_DxDyCoVnce "Covariance of Dx and Dy";
CM_ SG_ 530 RFL_Obj01A_DxVxCoVnce "Covariance of Dx and Vx";
CM_ SG_ 530 RFL_Obj01A_DyVxCoVnce "Covariance of Dy and Ax";
CM_ SG_ 530 RFL_Obj01A_DxVyCoVnce "Covariance of Dx and Vy";
CM_ SG_ 530 RFL_Obj01A_DyVyCoVnce "Covariance of Dy and Vy";
CM_ SG_ 530 RFL_Obj01A_VxVyCoVnce "Covariance of Vx and Vy";
CM_ SG_ 530 RFL_Obj01A_DxAxCoVnce "Covariance of Dx and Ax";
CM_ SG_ 530 RFL_Obj01A_DyAxCoVnce "Covariance of Dy and Ax";
CM_ SG_ 530 RFL_Obj01A_VxAxCoVnce "Covariance of Vx and Ax";
CM_ SG_ 530 RFL_Obj01A_VyAxCoVnce "Covariance of Vy and Ax";
CM_ SG_ 530 RFL_Obj01A_DxAyCoVnce "Covariance of Dx and Ay";
CM_ SG_ 530 RFL_Obj01A_DyAyCoVnce "Covariance of Dy and Ay";
CM_ SG_ 530 RFL_Obj01A_VxAyCoVnce "Covariance of Vx and Ay";
CM_ SG_ 530 RFL_Obj01A_VyAyCoVnce "Covariance of Vy and Ay";
CM_ SG_ 530 RFL_Obj01A_AxAyCoVnce "Covariance of Ax and Ay";
CM_ SG_ 530 RFL_Obj01A_HeadingYawAngleVnce "Variance of object heading yaw angle";
CM_ SG_ 530 RFL_Obj01A_LengthVnce "Variance of object Length";
CM_ SG_ 530 RFL_Obj01A_WidthVnce "Variance of object Width";
CM_ SG_ 530 RFL_Obj01A_HeightVnce "Variance of object Height";
CM_ SG_ 530 RFL_Obj01A_ProbExist "Existence probability of object";
CM_ SG_ 530 RFL_Obj01A_ProbObstacle "Probability of the object being an Obstacle";
CM_ SG_ 530 RFL_Obj01A_ProbNonObstacle "Probability of the object being a Non-Obstacle";
CM_ SG_ 530 RFL_Obj01A_ProbMobileObst "Probability of the object being a mobile obstacle";
CM_ SG_ 531 RFL_Obj01B_CRC "CRC - Autosar E2E Profile 5";
CM_ SG_ 531 RFL_Obj01B_AliveCtr "Alive counter - Autosar E2E Profile 5";
CM_ SG_ 531 RFL_Obj01B_ProtBlockCtr "Protocol-Signal: Block-Counter";
CM_ SG_ 531 RFL_Obj01B_ProbMob4PlusWhl "Probability of a mobile object which has 4 or more wheels";
CM_ SG_ 531 RFL_Obj01B_ProbMob2Whl "Probability of a mobile object being 2-wheels vehicle";
CM_ SG_ 531 RFL_Obj01B_ProbMobPed "Probability of a mobile object being a pedestrian";
CM_ SG_ 531 RFL_Obj01B_Prob4PlusWhlCAR "Probability of a mobile object which has 4 or more wheels--passenger car";
CM_ SG_ 531 RFL_Obj01B_Prob4PlusWhlbHGV "Probability of a mobile object which has 4 or more wheels--commercial vehicle (Truck)";
CM_ SG_ 531 RFL_Obj01B_ProbGNDReflex "Probability of the object being a ground reflex";
CM_ SG_ 531 RFL_Obj01B_ProbStatBarrier "Probability of the object being a stationary road barrier";
CM_ SG_ 531 RFL_Obj01B_ProbStatObst "Probability of the object being a stationary obstacle";
CM_ SG_ 531 RFL_Obj01B_MovingProbability "Object has been observed moving over the ground";
CM_ SG_ 531 RFL_Obj01B_MovingObserved "Object has been observed moving over the ground since it was first detected";
CM_ SG_ 531 RFL_Obj01B_BehaviorType "Indicates that which behavior the object associated for";
CM_ SG_ 532 RFL_Obj02A_CRC "CRC - Autosar E2E Profile 5";
CM_ SG_ 532 RFL_Obj02A_AliveCtr "Alive counter - Autosar E2E Profile 5";
CM_ SG_ 532 RFL_Obj02A_ProtBlockCtr "Protocol-Signal: Block-Counter";
CM_ SG_ 532 RFL_Obj02A_ID "Unique Object ID";
CM_ SG_ 532 RFL_Obj02A_Measured "Object is measured or not";
CM_ SG_ 532 RFL_Obj02A_Dx "Object position in X direction";
CM_ SG_ 532 RFL_Obj02A_Dz "Object position in Z direction";
CM_ SG_ 532 RFL_Obj02A_Dy "Object position in Y direction";
CM_ SG_ 532 RFL_Obj02A_Valid "Object is valid or not";
CM_ SG_ 532 RFL_Obj02A_Vx "Object relative velocity in X direction";
CM_ SG_ 532 RFL_Obj02A_Vy "Object relative velocity in Y direction";
CM_ SG_ 532 RFL_Obj02A_Ax "Object relative acceleration in X direction";
CM_ SG_ 532 RFL_Obj02A_Ay "Object relative acceleration in Y direction";
CM_ SG_ 532 RFL_Obj02A_HeadingYawAngle "Object heading yaw angle";
CM_ SG_ 532 RFL_Obj02A_Length "Object Length";
CM_ SG_ 532 RFL_Obj02A_Width "Object Width";
CM_ SG_ 532 RFL_Obj02A_Height "Object Height";
CM_ SG_ 532 RFL_Obj02A_DxVnce "Variance of object position in X direction";
CM_ SG_ 532 RFL_Obj02A_DyVnce "Variance of object position in Y direction";
CM_ SG_ 532 RFL_Obj02A_DzVnce "Variance of object position in Z direction";
CM_ SG_ 532 RFL_Obj02A_VxVnce "Variance of object relative velocity in X direction";
CM_ SG_ 532 RFL_Obj02A_VyVnce "Variance of object relative velocity in Y direction";
CM_ SG_ 532 RFL_Obj02A_AxVnce "Variance of object relative acceleration in X direction";
CM_ SG_ 532 RFL_Obj02A_AyVnce "Variance of object relative acceleration in Y direction";
CM_ SG_ 532 RFL_Obj02A_RefPosIndex "Reference Position of the detected objects";
CM_ SG_ 532 RFL_Obj02A_DxDyCoVnce "Covariance of Dx and Dy";
CM_ SG_ 532 RFL_Obj02A_DxVxCoVnce "Covariance of Dx and Vx";
CM_ SG_ 532 RFL_Obj02A_DyVxCoVnce "Covariance of Dy and Ax";
CM_ SG_ 532 RFL_Obj02A_DxVyCoVnce "Covariance of Dx and Vy";
CM_ SG_ 532 RFL_Obj02A_DyVyCoVnce "Covariance of Dy and Vy";
CM_ SG_ 532 RFL_Obj02A_VxVyCoVnce "Covariance of Vx and Vy";
CM_ SG_ 532 RFL_Obj02A_DxAxCoVnce "Covariance of Dx and Ax";
CM_ SG_ 532 RFL_Obj02A_DyAxCoVnce "Covariance of Dy and Ax";
CM_ SG_ 532 RFL_Obj02A_VxAxCoVnce "Covariance of Vx and Ax";
CM_ SG_ 532 RFL_Obj02A_VyAxCoVnce "Covariance of Vy and Ax";
CM_ SG_ 532 RFL_Obj02A_DxAyCoVnce "Covariance of Dx and Ay";
CM_ SG_ 532 RFL_Obj02A_DyAyCoVnce "Covariance of Dy and Ay";
CM_ SG_ 532 RFL_Obj02A_VxAyCoVnce "Covariance of Vx and Ay";
CM_ SG_ 532 RFL_Obj02A_VyAyCoVnce "Covariance of Vy and Ay";
CM_ SG_ 532 RFL_Obj02A_AxAyCoVnce "Covariance of Ax and Ay";
CM_ SG_ 532 RFL_Obj02A_HeadingYawAngleVnce "Variance of object heading yaw angle";
CM_ SG_ 532 RFL_Obj02A_LengthVnce "Variance of object Length";
CM_ SG_ 532 RFL_Obj02A_WidthVnce "Variance of object Width";
CM_ SG_ 532 RFL_Obj02A_HeightVnce "Variance of object Height";
CM_ SG_ 532 RFL_Obj02A_ProbExist "Existence probability of object";
CM_ SG_ 532 RFL_Obj02A_ProbObstacle "Probability of the object being an Obstacle";
CM_ SG_ 532 RFL_Obj02A_ProbNonObstacle "Probability of the object being a Non-Obstacle";
CM_ SG_ 532 RFL_Obj02A_ProbMobileObst "Probability of the object being a mobile obstacle";
CM_ SG_ 533 RFL_Obj02B_CRC "CRC - Autosar E2E Profile 5";
CM_ SG_ 533 RFL_Obj02B_AliveCtr "Alive counter - Autosar E2E Profile 5";
CM_ SG_ 533 RFL_Obj02B_ProtBlockCtr "Protocol-Signal: Block-Counter";
CM_ SG_ 533 RFL_Obj02B_ProbMob4PlusWhl "Probability of a mobile object which has 4 or more wheels";
CM_ SG_ 533 RFL_Obj02B_ProbMob2Whl "Probability of a mobile object being 2-wheels vehicle";
CM_ SG_ 533 RFL_Obj02B_ProbMobPed "Probability of a mobile object being a pedestrian";
CM_ SG_ 533 RFL_Obj02B_Prob4PlusWhlCAR "Probability of a mobile object which has 4 or more wheels--passenger car";
CM_ SG_ 533 RFL_Obj02B_Prob4PlusWhlbHGV "Probability of a mobile object which has 4 or more wheels--commercial vehicle (Truck)";
CM_ SG_ 533 RFL_Obj02B_ProbGNDReflex "Probability of the object being a ground reflex";
CM_ SG_ 533 RFL_Obj02B_ProbStatBarrier "Probability of the object being a stationary road barrier";
CM_ SG_ 533 RFL_Obj02B_ProbStatObst "Probability of the object being a stationary obstacle";
CM_ SG_ 533 RFL_Obj02B_MovingProbability "Object has been observed moving over the ground";
CM_ SG_ 533 RFL_Obj02B_MovingObserved "Object has been observed moving over the ground since it was first detected";
CM_ SG_ 533 RFL_Obj02B_BehaviorType "Indicates that which behavior the object associated for";
CM_ SG_ 534 RFL_Obj03A_CRC "CRC - Autosar E2E Profile 5";
CM_ SG_ 534 RFL_Obj03A_AliveCtr "Alive counter - Autosar E2E Profile 5";
CM_ SG_ 534 RFL_Obj03A_ProtBlockCtr "Protocol-Signal: Block-Counter";
CM_ SG_ 534 RFL_Obj03A_ID "Unique Object ID";
CM_ SG_ 534 RFL_Obj03A_Measured "Object is measured or not";
CM_ SG_ 534 RFL_Obj03A_Dx "Object position in X direction";
CM_ SG_ 534 RFL_Obj03A_Dz "Object position in Z direction";
CM_ SG_ 534 RFL_Obj03A_Dy "Object position in Y direction";
CM_ SG_ 534 RFL_Obj03A_Valid "Object is valid or not";
CM_ SG_ 534 RFL_Obj03A_Vx "Object relative velocity in X direction";
CM_ SG_ 534 RFL_Obj03A_Vy "Object relative velocity in Y direction";
CM_ SG_ 534 RFL_Obj03A_Ax "Object relative acceleration in X direction";
CM_ SG_ 534 RFL_Obj03A_Ay "Object relative acceleration in Y direction";
CM_ SG_ 534 RFL_Obj03A_HeadingYawAngle "Object heading yaw angle";
CM_ SG_ 534 RFL_Obj03A_Length "Object Length";
CM_ SG_ 534 RFL_Obj03A_Width "Object Width";
CM_ SG_ 534 RFL_Obj03A_Height "Object Height";
CM_ SG_ 534 RFL_Obj03A_DxVnce "Variance of object position in X direction";
CM_ SG_ 534 RFL_Obj03A_DyVnce "Variance of object position in Y direction";
CM_ SG_ 534 RFL_Obj03A_DzVnce "Variance of object position in Z direction";
CM_ SG_ 534 RFL_Obj03A_VxVnce "Variance of object relative velocity in X direction";
CM_ SG_ 534 RFL_Obj03A_VyVnce "Variance of object relative velocity in Y direction";
CM_ SG_ 534 RFL_Obj03A_AxVnce "Variance of object relative acceleration in X direction";
CM_ SG_ 534 RFL_Obj03A_AyVnce "Variance of object relative acceleration in Y direction";
CM_ SG_ 534 RFL_Obj03A_RefPosIndex "Reference Position of the detected objects";
CM_ SG_ 534 RFL_Obj03A_DxDyCoVnce "Covariance of Dx and Dy";
CM_ SG_ 534 RFL_Obj03A_DxVxCoVnce "Covariance of Dx and Vx";
CM_ SG_ 534 RFL_Obj03A_DyVxCoVnce "Covariance of Dy and Ax";
CM_ SG_ 534 RFL_Obj03A_DxVyCoVnce "Covariance of Dx and Vy";
CM_ SG_ 534 RFL_Obj03A_DyVyCoVnce "Covariance of Dy and Vy";
CM_ SG_ 534 RFL_Obj03A_VxVyCoVnce "Covariance of Vx and Vy";
CM_ SG_ 534 RFL_Obj03A_DxAxCoVnce "Covariance of Dx and Ax";
CM_ SG_ 534 RFL_Obj03A_DyAxCoVnce "Covariance of Dy and Ax";
CM_ SG_ 534 RFL_Obj03A_VxAxCoVnce "Covariance of Vx and Ax";
CM_ SG_ 534 RFL_Obj03A_VyAxCoVnce "Covariance of Vy and Ax";
CM_ SG_ 534 RFL_Obj03A_DxAyCoVnce "Covariance of Dx and Ay";
CM_ SG_ 534 RFL_Obj03A_DyAyCoVnce "Covariance of Dy and Ay";
CM_ SG_ 534 RFL_Obj03A_VxAyCoVnce "Covariance of Vx and Ay";
CM_ SG_ 534 RFL_Obj03A_VyAyCoVnce "Covariance of Vy and Ay";
CM_ SG_ 534 RFL_Obj03A_AxAyCoVnce "Covariance of Ax and Ay";
CM_ SG_ 534 RFL_Obj03A_HeadingYawAngleVnce "Variance of object heading yaw angle";
CM_ SG_ 534 RFL_Obj03A_LengthVnce "Variance of object Length";
CM_ SG_ 534 RFL_Obj03A_WidthVnce "Variance of object Width";
CM_ SG_ 534 RFL_Obj03A_HeightVnce "Variance of object Height";
CM_ SG_ 534 RFL_Obj03A_ProbExist "Existence probability of object";
CM_ SG_ 534 RFL_Obj03A_ProbObstacle "Probability of the object being an Obstacle";
CM_ SG_ 534 RFL_Obj03A_ProbNonObstacle "Probability of the object being a Non-Obstacle";
CM_ SG_ 534 RFL_Obj03A_ProbMobileObst "Probability of the object being a mobile obstacle";
CM_ SG_ 535 RFL_Obj03B_CRC "CRC - Autosar E2E Profile 5";
CM_ SG_ 535 RFL_Obj03B_AliveCtr "Alive counter - Autosar E2E Profile 5";
CM_ SG_ 535 RFL_Obj03B_ProtBlockCtr "Protocol-Signal: Block-Counter";
CM_ SG_ 535 RFL_Obj03B_ProbMob4PlusWhl "Probability of a mobile object which has 4 or more wheels";
CM_ SG_ 535 RFL_Obj03B_ProbMob2Whl "Probability of a mobile object being 2-wheels vehicle";
CM_ SG_ 535 RFL_Obj03B_ProbMobPed "Probability of a mobile object being a pedestrian";
CM_ SG_ 535 RFL_Obj03B_Prob4PlusWhlCAR "Probability of a mobile object which has 4 or more wheels--passenger car";
CM_ SG_ 535 RFL_Obj03B_Prob4PlusWhlbHGV "Probability of a mobile object which has 4 or more wheels--commercial vehicle (Truck)";
CM_ SG_ 535 RFL_Obj03B_ProbGNDReflex "Probability of the object being a ground reflex";
CM_ SG_ 535 RFL_Obj03B_ProbStatBarrier "Probability of the object being a stationary road barrier";
CM_ SG_ 535 RFL_Obj03B_ProbStatObst "Probability of the object being a stationary obstacle";
CM_ SG_ 535 RFL_Obj03B_MovingProbability "Object has been observed moving over the ground";
CM_ SG_ 535 RFL_Obj03B_MovingObserved "Object has been observed moving over the ground since it was first detected";
CM_ SG_ 535 RFL_Obj03B_BehaviorType "Indicates that which behavior the object associated for";
BA_DEF_ SG_  "GenSigSendType" ENUM  "Cyclic","OnWrite","OnWriteWithRepetition","OnChange","OnChangeWithRepetition","IfActive","IfActiveWithRepetition";
BA_DEF_ BO_  "GenMsgCycleTimeFast" INT 2 50000;
BA_DEF_ BO_  "GenMsgILSupport" ENUM  "No","Yes";
BA_DEF_ BO_  "CANFD_BRS" ENUM  "0","1";
BA_DEF_ BO_  "GenMsgCycleTime" INT 0 65535;
BA_DEF_ BO_  "GenMsgSendType" ENUM  "Event","cyclic";
BA_DEF_ BO_  "VFrameFormat" ENUM  "StandardCAN","ExtendedCAN","reserved","reserved","reserved","reserved","reserved","reserved","reserved","reserved","reserved","reserved","reserved","reserved","StandardCAN_FD","ExtendedCAN_FD";
BA_DEF_ SG_  "GenSigStartValue" FLOAT 0 100000000000;
BA_DEF_DEF_  "GenSigSendType" "Cyclic";
BA_DEF_DEF_  "GenMsgCycleTimeFast" 100;
BA_DEF_DEF_  "GenMsgILSupport" "Yes";
BA_DEF_DEF_  "CANFD_BRS" "1";
BA_DEF_DEF_  "GenMsgCycleTime" 0;
BA_DEF_DEF_  "GenMsgSendType" "";
BA_DEF_DEF_  "VFrameFormat" "";
BA_DEF_DEF_  "GenSigStartValue" 0;
BA_ "GenMsgSendType" BO_ 247 0;
BA_ "VFrameFormat" BO_ 247 14;
BA_ "GenMsgSendType" BO_ 248 0;
BA_ "VFrameFormat" BO_ 248 14;
BA_ "GenMsgSendType" BO_ 249 0;
BA_ "VFrameFormat" BO_ 249 14;
BA_ "GenMsgSendType" BO_ 250 0;
BA_ "VFrameFormat" BO_ 250 14;
BA_ "GenMsgSendType" BO_ 251 0;
BA_ "VFrameFormat" BO_ 251 14;
BA_ "GenMsgSendType" BO_ 252 0;
BA_ "VFrameFormat" BO_ 252 14;
BA_ "GenMsgSendType" BO_ 253 0;
BA_ "VFrameFormat" BO_ 253 14;
BA_ "GenMsgSendType" BO_ 517 0;
BA_ "VFrameFormat" BO_ 517 14;
BA_ "GenMsgSendType" BO_ 528 0;
BA_ "VFrameFormat" BO_ 528 14;
BA_ "GenMsgSendType" BO_ 529 0;
BA_ "VFrameFormat" BO_ 529 14;
BA_ "GenMsgSendType" BO_ 530 0;
BA_ "VFrameFormat" BO_ 530 14;
BA_ "GenMsgSendType" BO_ 531 0;
BA_ "VFrameFormat" BO_ 531 14;
BA_ "GenMsgSendType" BO_ 532 0;
BA_ "VFrameFormat" BO_ 532 14;
BA_ "GenMsgSendType" BO_ 533 0;
BA_ "VFrameFormat" BO_ 533 14;
BA_ "GenMsgSendType" BO_ 534 0;
BA_ "VFrameFormat" BO_ 534 14;
BA_ "GenMsgSendType" BO_ 535 0;
BA_ "VFrameFormat" BO_ 535 14;
BA_ "GenSigStartValue" SG_ 247 VFC_TS09_Dy 128;
BA_ "GenSigStartValue" SG_ 248 VFC_TS10_Dy 128;
BA_ "GenSigStartValue" SG_ 249 VFC_TS11_Dy 128;
BA_ "GenSigStartValue" SG_ 250 VFC_TS12_Dy 128;
BA_ "GenSigStartValue" SG_ 251 VFC_TS13_Dy 128;
BA_ "GenSigStartValue" SG_ 252 VFC_TS14_Dy 128;
BA_ "GenSigStartValue" SG_ 253 VFC_TS15_Dy 128;
BA_ "GenSigStartValue" SG_ 517 RFL_ObjHdr_ProtocolVersion 263;
BA_ "GenSigStartValue" SG_ 517 RFL_ObjHdr_MountPosY 128;
BA_ "GenSigStartValue" SG_ 517 RFL_ObjHdr_MountPosX 256;
BA_ "GenSigStartValue" SG_ 517 RFL_ObjHdr_YawMountAngle 32768;
BA_ "GenSigStartValue" SG_ 517 RFL_ObjHdr_YawAngleLower 16384;
BA_ "GenSigStartValue" SG_ 517 RFL_ObjHdr_YawAngleUpper 16384;
BA_ "GenSigStartValue" SG_ 517 RFL_ObjHdr_PitchMountAngle 2048;
BA_ "GenSigStartValue" SG_ 517 RFL_ObjHdr_PitchAngleLower 2048;
BA_ "GenSigStartValue" SG_ 517 RFL_ObjHdr_PitchAngleUpper 2048;
BA_ "GenSigStartValue" SG_ 517 RFL_ObjHdr_RollMountAngle 2048;
BA_ "GenSigStartValue" SG_ 528 RFL_Obj00A_Dx 4096;
BA_ "GenSigStartValue" SG_ 528 RFL_Obj00A_Dz 20;
BA_ "GenSigStartValue" SG_ 528 RFL_Obj00A_Dy 1024;
BA_ "GenSigStartValue" SG_ 528 RFL_Obj00A_Vx 2048;
BA_ "GenSigStartValue" SG_ 528 RFL_Obj00A_Vy 512;
BA_ "GenSigStartValue" SG_ 528 RFL_Obj00A_Ax 512;
BA_ "GenSigStartValue" SG_ 528 RFL_Obj00A_Ay 256;
BA_ "GenSigStartValue" SG_ 528 RFL_Obj00A_HeadingYawAngle 256;
BA_ "GenSigStartValue" SG_ 530 RFL_Obj01A_Dx 4096;
BA_ "GenSigStartValue" SG_ 530 RFL_Obj01A_Dz 20;
BA_ "GenSigStartValue" SG_ 530 RFL_Obj01A_Dy 1024;
BA_ "GenSigStartValue" SG_ 530 RFL_Obj01A_Vx 2048;
BA_ "GenSigStartValue" SG_ 530 RFL_Obj01A_Vy 512;
BA_ "GenSigStartValue" SG_ 530 RFL_Obj01A_Ax 512;
BA_ "GenSigStartValue" SG_ 530 RFL_Obj01A_Ay 256;
BA_ "GenSigStartValue" SG_ 530 RFL_Obj01A_HeadingYawAngle 256;
BA_ "GenSigStartValue" SG_ 532 RFL_Obj02A_Dx 4096;
BA_ "GenSigStartValue" SG_ 532 RFL_Obj02A_Dz 20;
BA_ "GenSigStartValue" SG_ 532 RFL_Obj02A_Dy 1024;
BA_ "GenSigStartValue" SG_ 532 RFL_Obj02A_Vx 2048;
BA_ "GenSigStartValue" SG_ 532 RFL_Obj02A_Vy 512;
BA_ "GenSigStartValue" SG_ 532 RFL_Obj02A_Ax 512;
BA_ "GenSigStartValue" SG_ 532 RFL_Obj02A_Ay 256;
BA_ "GenSigStartValue" SG_ 532 RFL_Obj02A_HeadingYawAngle 256;
BA_ "GenSigStartValue" SG_ 534 RFL_Obj03A_Dx 4096;
BA_ "GenSigStartValue" SG_ 534 RFL_Obj03A_Dz 20;
BA_ "GenSigStartValue" SG_ 534 RFL_Obj03A_Dy 1024;
BA_ "GenSigStartValue" SG_ 534 RFL_Obj03A_Vx 2048;
BA_ "GenSigStartValue" SG_ 534 RFL_Obj03A_Vy 512;
BA_ "GenSigStartValue" SG_ 534 RFL_Obj03A_Ax 512;
BA_ "GenSigStartValue" SG_ 534 RFL_Obj03A_Ay 256;
BA_ "GenSigStartValue" SG_ 534 RFL_Obj03A_HeadingYawAngle 256;
VAL_ 247 VFC_TS09_ID 0 "INVALID" ;
VAL_ 247 VFC_TS09_Class 0 "UNKNOWN" 1 "SL5" 2 "SL10" 3 "SL15" 4 "SL20" 5 "SL25" 6 "SL30" 7 "SL35" 8 "SL40" 9 "SL45" 10 "SL50" 11 "SL55" 12 "SL60" 13 "SL65" 14 "SL70" 15 "SL75" 16 "SL80" 17 "SL85" 18 "SL90" 19 "SL95" 20 "SL100" 21 "SL105" 22 "SL110" 23 "SL115" 24 "SL120" 25 "SL125" 26 "SL130" 27 "SL135" 28 "SL140" 29 "SL145" 30 "SL150" 31 "SL155" 32 "SL160" 33 "ESL" 34 "EA" 35 "OP" 36 "EOP" 37 "OL" 38 "EOL" 39 "GIVEWAY" 40 "PRIOCROSS" 41 "PRIOCROSSYIELDTORIGHT" 42 "PRIOSTREET" 43 "EPRIOSTREET" 44 "STOP" 45 "AXLEWEIGHT" 46 "CARDIST" 47 "HEIGHT" 48 "LENGTH" 49 "LORRYDIST" 50 "NOALL" 51 "NOBIKE" 52 "NOBUS" 53 "NOCAR" 54 "NOCARBIKE" 55 "NOCARRIAGE" 56 "NOENTRY" 57 "NOHAZMAT" 58 "NOHAZWATER" 59 "NOLORRY" 60 "NOLORRYTRAILER" 61 "NOLTURN" 62 "NOPED" 63 "NORIDER" 64 "NORTURN" 65 "NOTRACTOR" 66 "NOTWOWAY" 67 "NOUTURN" 68 "UMWELT" 69 "EUMWELT" 70 "WEIGHT" 71 "WIDTH" 72 "WARNBIKE" 73 "WARNBUS" 74 "WARNCATTLE" 75 "WARNCONST" 76 "WARNCONSTL" 77 "WARNCONSTR" 78 "WARNCURVEL" 79 "WARNCURVER" 80 "WARNDANGER" 81 "WARNDCURVEL" 82 "WARNDCURVER" 83 "WARNDRAWBRIDGE" 84 "WARNFROG" 85 "WARNGRAVEL" 86 "WARNHUMP" 87 "WARNJAM" 88 "WARNKIDS" 89 "WARNLIGHTS" 90 "WARNLOWTREE" 91 "WARNPCROSS" 92 "WARNPED" 93 "WARNPIER" 94 "WARNPLANE" 95 "WARNRIDER" 96 "WARNROCK" 97 "WARNROUND" 98 "WARNRWORKS" 99 "WARNSKID" 100 "WARNSLOPED" 101 "WARNSLOPEU" 102 "WARNSNOW" 103 "WARNTRAIN" 104 "WARNTWOWAY" 105 "WARNWILDANIMAL" 106 "WARNWIND" 107 "ASL" 108 "EASL" 109 "CALM" 110 "ECALM" 111 "DEADEND" 112 "DOUANE" 113 "FWAY" 114 "EFWAY" 115 "HWAY" 116 "EHWAY" 117 "MSL" 118 "EMSL" 119 "NOPARK" 120 "NOSTOP" 121 "ONEWAYS" 122 "ONEWAYU" 123 "SLOWDOWN" 124 "SCHOOL" 125 "ESCHOOL" 126 "TWN" 127 "ETWN" 128 "WBBENTLEFT" 129 "WBBENTLEFTRIGHT" 130 "WBBENTRIGHT" 131 "WBDIAGL" 132 "WBDIAGLR" 133 "WBDIAGR" 134 "WBHAZWATER" 135 "WBLEFT" 136 "WBRIGHT" 137 "WBROUND" 138 "WBUP" 139 "WBUPLEFT" 140 "WBUPRIGHT" 141 "ZEBRA" 142 "HAZMAT" 143 "EMERGENCYBAY" 144 "ENDOFLANEL" 145 "ENDOFLANER" 146 "ENOPARK" 147 "EONEWAY" 148 "EPARK" 149 "ETOLL" 150 "NOPARKL" 151 "NOPARKLR" 152 "NOPARKR" 153 "NOSTOPL" 154 "NOSTOPLR" 155 "NOSTOPR" 156 "NOTURNONRED" 157 "ONEWAYL" 158 "ONEWAYR" 159 "PARK" 160 "PRIOCROSSL" 161 "PRIOCROSSR" 162 "TOLL" 163 "TUNNEL" 164 "TWOWAY" 165 "WARNCROSS" 166 "WARNCROSSL" 167 "WARNCROSSLR" 168 "WARNCROSSR" 169 "WARNCROSSRL" 170 "WARNCROSST" 171 "WARNGIVEWAYAHEAD" 172 "WARNSLAHEAD" 173 "WARNSTOPAHEAD" 174 "WBBUS" 175 "WRONGWAY" 176 "HAZWATER" 177 "GIVEWAYROUND" 178 "WARNWINDINGL" 179 "WARNWINDINGR" 180 "WARNHAIRPINL" 181 "WARNHAIRPINR" 182 "WARNPEDBIKE" 183 "WARNCROSSY" 184 "WARNBRANCHL" 185 "WARNBRANCHR" 186 "WARNAXLEWEIGHT" 187 "WARNWEIGHT" 188 "WARNHEIGHT" 189 "WARNLENGTH" 190 "WARNWIDTH" 191 "WARNBLACKSPOT" 192 "WARNMERGEL" 193 "WARNMERGER" 194 "WARNTUNNEL" 195 "WARNTRACTOR" 196 "WARNRWORKSVEHICLE" 197 "WARNNARROWBRIDGE" 198 "WARNFLAGGER" 199 "LANES" 200 "LANESHIFTL" 201 "LANESHIFTR" 202 "NEWLANEL" 203 "NEWLANER" 204 "RIGHTTURNONRED" 205 "BORDERLIMIT" 206 "EMBEDDEDRAIN" ;
VAL_ 247 VFC_TS09_EmbedFlag 0 "Unknown" 1 "Not Embedded" 2 "Border Limit" 3 "Multi Lane" 4 "Rain" 5 "Vehicle Type" 6 "Plate" 7 "Error Value" ;
VAL_ 247 VFC_TS09_Quality 0 "Poor Quality" 1 "Good Quality" ;
VAL_ 247 VFC_TS09_VMS 0 "Fixed" 1 "Variable" ;
VAL_ 247 VFC_TS09_Stable 0 "Object Is Not Stable" 1 "Object Is Stable" ;
VAL_ 247 VFC_TS09_VehicleSticker 0 "not_sticker_on_vehicle" 1 "Sign is a sticker on a vehicle" ;
VAL_ 247 VFC_TS09_InternalTrack 0 "Sign is not an internal track" 1 "Sign is an internal track" ;
VAL_ 247 VFC_TS09_AddTS1Class 0 "UNKNOWN" 1 "DETECTED" 2 "ACCIDENT" 3 "ADVICE" 4 "BEGINS" 5 "BUS" 6 "CAMPER" 7 "CAR" 8 "CARAVAN" 9 "CRASHRISK" 10 "DIRT" 11 "DISTANCE" 12 "DISTANCEBARS" 13 "END" 14 "EXITL" 15 "EXITR" 16 "FOG" 17 "GRAVEL" 18 "HAZMAT" 19 "HUMP" 20 "JAM" 21 "LORRY" 22 "EXCEPTLORRY" 23 "LOWTREE" 24 "MCYCLE" 25 "MINIMUM" 26 "NIGHT" 27 "NOSTOPSHOULDER" 28 "OILTRAIL" 29 "PRIOTURN" 30 "RADAR" 31 "RAIN" 32 "RAINSNOW" 33 "REMINDER" 34 "ROADDAMAGE" 35 "RUTS" 36 "RWORKSACCESS" 37 "RWORKSENTRY" 38 "RWORKSEXIT" 39 "SCHOOL" 40 "SECTION" 41 "SMOKE" 42 "SNOW" 43 "SOFTSHOULDERCAR" 44 "SHOFTSHOULDERLORRY" 45 "TEXT" 46 "TIME" 47 "TOWING" 48 "TRACTOR" 49 "TRACTOR_OVER" 50 "TRAILER" 51 "WEIGHT" 52 "WET" 53 "WITHIN" 54 "ZONE" 55 "EXIT" 56 "ACCESS" 57 "ALLWAY" 58 "EXCEPTBUS" 59 "EXCEPTDELIVERY" 60 "EXCEPTLOCAL" 61 "FROG" 62 "PRIOTURNL" 63 "PRIOTURNR" 64 "START" 65 "STOPIN" 66 "HAZWATER" 67 "DAY" 68 "SL" ;
VAL_ 247 VFC_TS09_AddTS1Quality 0 "Poor Quality" 1 "Good Quality" ;
VAL_ 247 VFC_TS09_AddTS1VMS 0 "Fixed" 1 "Variable" ;
VAL_ 247 VFC_TS09_AddTS2Class 0 "UNKNOWN" 1 "DETECTED" 2 "ACCIDENT" 3 "ADVICE" 4 "BEGINS" 5 "BUS" 6 "CAMPER" 7 "CAR" 8 "CARAVAN" 9 "CRASHRISK" 10 "DIRT" 11 "DISTANCE" 12 "DISTANCEBARS" 13 "END" 14 "EXITL" 15 "EXITR" 16 "FOG" 17 "GRAVEL" 18 "HAZMAT" 19 "HUMP" 20 "JAM" 21 "LORRY" 22 "EXCEPTLORRY" 23 "LOWTREE" 24 "MCYCLE" 25 "MINIMUM" 26 "NIGHT" 27 "NOSTOPSHOULDER" 28 "OILTRAIL" 29 "PRIOTURN" 30 "RADAR" 31 "RAIN" 32 "RAINSNOW" 33 "REMINDER" 34 "ROADDAMAGE" 35 "RUTS" 36 "RWORKSACCESS" 37 "RWORKSENTRY" 38 "RWORKSEXIT" 39 "SCHOOL" 40 "SECTION" 41 "SMOKE" 42 "SNOW" 43 "SOFTSHOULDERCAR" 44 "SHOFTSHOULDERLORRY" 45 "TEXT" 46 "TIME" 47 "TOWING" 48 "TRACTOR" 49 "TRACTOR_OVER" 50 "TRAILER" 51 "WEIGHT" 52 "WET" 53 "WITHIN" 54 "ZONE" 55 "EXIT" 56 "ACCESS" 57 "ALLWAY" 58 "EXCEPTBUS" 59 "EXCEPTDELIVERY" 60 "EXCEPTLOCAL" 61 "FROG" 62 "PRIOTURNL" 63 "PRIOTURNR" 64 "START" 65 "STOPIN" 66 "HAZWATER" 67 "DAY" 68 "SL" ;
VAL_ 247 VFC_TS09_AddTS2Quality 0 "Poor Quality" 1 "Good Quality" ;
VAL_ 247 VFC_TS09_AddTS2VMS 0 "Fixed" 1 "Variable" ;
VAL_ 247 VFC_TS09_AddTS3Class 0 "UNKNOWN" 1 "DETECTED" 2 "ACCIDENT" 3 "ADVICE" 4 "BEGINS" 5 "BUS" 6 "CAMPER" 7 "CAR" 8 "CARAVAN" 9 "CRASHRISK" 10 "DIRT" 11 "DISTANCE" 12 "DISTANCEBARS" 13 "END" 14 "EXITL" 15 "EXITR" 16 "FOG" 17 "GRAVEL" 18 "HAZMAT" 19 "HUMP" 20 "JAM" 21 "LORRY" 22 "EXCEPTLORRY" 23 "LOWTREE" 24 "MCYCLE" 25 "MINIMUM" 26 "NIGHT" 27 "NOSTOPSHOULDER" 28 "OILTRAIL" 29 "PRIOTURN" 30 "RADAR" 31 "RAIN" 32 "RAINSNOW" 33 "REMINDER" 34 "ROADDAMAGE" 35 "RUTS" 36 "RWORKSACCESS" 37 "RWORKSENTRY" 38 "RWORKSEXIT" 39 "SCHOOL" 40 "SECTION" 41 "SMOKE" 42 "SNOW" 43 "SOFTSHOULDERCAR" 44 "SHOFTSHOULDERLORRY" 45 "TEXT" 46 "TIME" 47 "TOWING" 48 "TRACTOR" 49 "TRACTOR_OVER" 50 "TRAILER" 51 "WEIGHT" 52 "WET" 53 "WITHIN" 54 "ZONE" 55 "EXIT" 56 "ACCESS" 57 "ALLWAY" 58 "EXCEPTBUS" 59 "EXCEPTDELIVERY" 60 "EXCEPTLOCAL" 61 "FROG" 62 "PRIOTURNL" 63 "PRIOTURNR" 64 "START" 65 "STOPIN" 66 "HAZWATER" 67 "DAY" 68 "SL" ;
VAL_ 247 VFC_TS09_AddTS3Quality 0 "Poor Quality" 1 "Good Quality" ;
VAL_ 247 VFC_TS09_AddTS3VMS 0 "Fixed" 1 "Variable" ;
VAL_ 247 VFC_TS09_AddTS4Class 0 "UNKNOWN" 1 "DETECTED" 2 "ACCIDENT" 3 "ADVICE" 4 "BEGINS" 5 "BUS" 6 "CAMPER" 7 "CAR" 8 "CARAVAN" 9 "CRASHRISK" 10 "DIRT" 11 "DISTANCE" 12 "DISTANCEBARS" 13 "END" 14 "EXITL" 15 "EXITR" 16 "FOG" 17 "GRAVEL" 18 "HAZMAT" 19 "HUMP" 20 "JAM" 21 "LORRY" 22 "EXCEPTLORRY" 23 "LOWTREE" 24 "MCYCLE" 25 "MINIMUM" 26 "NIGHT" 27 "NOSTOPSHOULDER" 28 "OILTRAIL" 29 "PRIOTURN" 30 "RADAR" 31 "RAIN" 32 "RAINSNOW" 33 "REMINDER" 34 "ROADDAMAGE" 35 "RUTS" 36 "RWORKSACCESS" 37 "RWORKSENTRY" 38 "RWORKSEXIT" 39 "SCHOOL" 40 "SECTION" 41 "SMOKE" 42 "SNOW" 43 "SOFTSHOULDERCAR" 44 "SHOFTSHOULDERLORRY" 45 "TEXT" 46 "TIME" 47 "TOWING" 48 "TRACTOR" 49 "TRACTOR_OVER" 50 "TRAILER" 51 "WEIGHT" 52 "WET" 53 "WITHIN" 54 "ZONE" 55 "EXIT" 56 "ACCESS" 57 "ALLWAY" 58 "EXCEPTBUS" 59 "EXCEPTDELIVERY" 60 "EXCEPTLOCAL" 61 "FROG" 62 "PRIOTURNL" 63 "PRIOTURNR" 64 "START" 65 "STOPIN" 66 "HAZWATER" 67 "DAY" 68 "SL" ;
VAL_ 247 VFC_TS09_AddTS4Quality 0 "Poor Quality" 1 "Good Quality" ;
VAL_ 247 VFC_TS09_AddTS4VMS 0 "Fixed" 1 "Variable" ;
VAL_ 247 VFC_TS09_AddTS5Class 0 "UNKNOWN" 1 "DETECTED" 2 "ACCIDENT" 3 "ADVICE" 4 "BEGINS" 5 "BUS" 6 "CAMPER" 7 "CAR" 8 "CARAVAN" 9 "CRASHRISK" 10 "DIRT" 11 "DISTANCE" 12 "DISTANCEBARS" 13 "END" 14 "EXITL" 15 "EXITR" 16 "FOG" 17 "GRAVEL" 18 "HAZMAT" 19 "HUMP" 20 "JAM" 21 "LORRY" 22 "EXCEPTLORRY" 23 "LOWTREE" 24 "MCYCLE" 25 "MINIMUM" 26 "NIGHT" 27 "NOSTOPSHOULDER" 28 "OILTRAIL" 29 "PRIOTURN" 30 "RADAR" 31 "RAIN" 32 "RAINSNOW" 33 "REMINDER" 34 "ROADDAMAGE" 35 "RUTS" 36 "RWORKSACCESS" 37 "RWORKSENTRY" 38 "RWORKSEXIT" 39 "SCHOOL" 40 "SECTION" 41 "SMOKE" 42 "SNOW" 43 "SOFTSHOULDERCAR" 44 "SHOFTSHOULDERLORRY" 45 "TEXT" 46 "TIME" 47 "TOWING" 48 "TRACTOR" 49 "TRACTOR_OVER" 50 "TRAILER" 51 "WEIGHT" 52 "WET" 53 "WITHIN" 54 "ZONE" 55 "EXIT" 56 "ACCESS" 57 "ALLWAY" 58 "EXCEPTBUS" 59 "EXCEPTDELIVERY" 60 "EXCEPTLOCAL" 61 "FROG" 62 "PRIOTURNL" 63 "PRIOTURNR" 64 "START" 65 "STOPIN" 66 "HAZWATER" 67 "DAY" 68 "SL" ;
VAL_ 247 VFC_TS09_AddTS5Quality 0 "Poor Quality" 1 "Good Quality" ;
VAL_ 247 VFC_TS09_AddTS5VMS 0 "Fixed" 1 "Variable" ;
VAL_ 247 VFC_TS09_AddTS6Class 0 "UNKNOWN" 1 "DETECTED" 2 "ACCIDENT" 3 "ADVICE" 4 "BEGINS" 5 "BUS" 6 "CAMPER" 7 "CAR" 8 "CARAVAN" 9 "CRASHRISK" 10 "DIRT" 11 "DISTANCE" 12 "DISTANCEBARS" 13 "END" 14 "EXITL" 15 "EXITR" 16 "FOG" 17 "GRAVEL" 18 "HAZMAT" 19 "HUMP" 20 "JAM" 21 "LORRY" 22 "EXCEPTLORRY" 23 "LOWTREE" 24 "MCYCLE" 25 "MINIMUM" 26 "NIGHT" 27 "NOSTOPSHOULDER" 28 "OILTRAIL" 29 "PRIOTURN" 30 "RADAR" 31 "RAIN" 32 "RAINSNOW" 33 "REMINDER" 34 "ROADDAMAGE" 35 "RUTS" 36 "RWORKSACCESS" 37 "RWORKSENTRY" 38 "RWORKSEXIT" 39 "SCHOOL" 40 "SECTION" 41 "SMOKE" 42 "SNOW" 43 "SOFTSHOULDERCAR" 44 "SHOFTSHOULDERLORRY" 45 "TEXT" 46 "TIME" 47 "TOWING" 48 "TRACTOR" 49 "TRACTOR_OVER" 50 "TRAILER" 51 "WEIGHT" 52 "WET" 53 "WITHIN" 54 "ZONE" 55 "EXIT" 56 "ACCESS" 57 "ALLWAY" 58 "EXCEPTBUS" 59 "EXCEPTDELIVERY" 60 "EXCEPTLOCAL" 61 "FROG" 62 "PRIOTURNL" 63 "PRIOTURNR" 64 "START" 65 "STOPIN" 66 "HAZWATER" 67 "DAY" 68 "SL" ;
VAL_ 247 VFC_TS09_AddTS6Quality 0 "Poor Quality" 1 "Good Quality" ;
VAL_ 247 VFC_TS09_AddTS6VMS 0 "Fixed" 1 "Variable" ;
VAL_ 248 VFC_TS10_ID 0 "INVALID" ;
VAL_ 248 VFC_TS10_Class 0 "UNKNOWN" 1 "SL5" 2 "SL10" 3 "SL15" 4 "SL20" 5 "SL25" 6 "SL30" 7 "SL35" 8 "SL40" 9 "SL45" 10 "SL50" 11 "SL55" 12 "SL60" 13 "SL65" 14 "SL70" 15 "SL75" 16 "SL80" 17 "SL85" 18 "SL90" 19 "SL95" 20 "SL100" 21 "SL105" 22 "SL110" 23 "SL115" 24 "SL120" 25 "SL125" 26 "SL130" 27 "SL135" 28 "SL140" 29 "SL145" 30 "SL150" 31 "SL155" 32 "SL160" 33 "ESL" 34 "EA" 35 "OP" 36 "EOP" 37 "OL" 38 "EOL" 39 "GIVEWAY" 40 "PRIOCROSS" 41 "PRIOCROSSYIELDTORIGHT" 42 "PRIOSTREET" 43 "EPRIOSTREET" 44 "STOP" 45 "AXLEWEIGHT" 46 "CARDIST" 47 "HEIGHT" 48 "LENGTH" 49 "LORRYDIST" 50 "NOALL" 51 "NOBIKE" 52 "NOBUS" 53 "NOCAR" 54 "NOCARBIKE" 55 "NOCARRIAGE" 56 "NOENTRY" 57 "NOHAZMAT" 58 "NOHAZWATER" 59 "NOLORRY" 60 "NOLORRYTRAILER" 61 "NOLTURN" 62 "NOPED" 63 "NORIDER" 64 "NORTURN" 65 "NOTRACTOR" 66 "NOTWOWAY" 67 "NOUTURN" 68 "UMWELT" 69 "EUMWELT" 70 "WEIGHT" 71 "WIDTH" 72 "WARNBIKE" 73 "WARNBUS" 74 "WARNCATTLE" 75 "WARNCONST" 76 "WARNCONSTL" 77 "WARNCONSTR" 78 "WARNCURVEL" 79 "WARNCURVER" 80 "WARNDANGER" 81 "WARNDCURVEL" 82 "WARNDCURVER" 83 "WARNDRAWBRIDGE" 84 "WARNFROG" 85 "WARNGRAVEL" 86 "WARNHUMP" 87 "WARNJAM" 88 "WARNKIDS" 89 "WARNLIGHTS" 90 "WARNLOWTREE" 91 "WARNPCROSS" 92 "WARNPED" 93 "WARNPIER" 94 "WARNPLANE" 95 "WARNRIDER" 96 "WARNROCK" 97 "WARNROUND" 98 "WARNRWORKS" 99 "WARNSKID" 100 "WARNSLOPED" 101 "WARNSLOPEU" 102 "WARNSNOW" 103 "WARNTRAIN" 104 "WARNTWOWAY" 105 "WARNWILDANIMAL" 106 "WARNWIND" 107 "ASL" 108 "EASL" 109 "CALM" 110 "ECALM" 111 "DEADEND" 112 "DOUANE" 113 "FWAY" 114 "EFWAY" 115 "HWAY" 116 "EHWAY" 117 "MSL" 118 "EMSL" 119 "NOPARK" 120 "NOSTOP" 121 "ONEWAYS" 122 "ONEWAYU" 123 "SLOWDOWN" 124 "SCHOOL" 125 "ESCHOOL" 126 "TWN" 127 "ETWN" 128 "WBBENTLEFT" 129 "WBBENTLEFTRIGHT" 130 "WBBENTRIGHT" 131 "WBDIAGL" 132 "WBDIAGLR" 133 "WBDIAGR" 134 "WBHAZWATER" 135 "WBLEFT" 136 "WBRIGHT" 137 "WBROUND" 138 "WBUP" 139 "WBUPLEFT" 140 "WBUPRIGHT" 141 "ZEBRA" 142 "HAZMAT" 143 "EMERGENCYBAY" 144 "ENDOFLANEL" 145 "ENDOFLANER" 146 "ENOPARK" 147 "EONEWAY" 148 "EPARK" 149 "ETOLL" 150 "NOPARKL" 151 "NOPARKLR" 152 "NOPARKR" 153 "NOSTOPL" 154 "NOSTOPLR" 155 "NOSTOPR" 156 "NOTURNONRED" 157 "ONEWAYL" 158 "ONEWAYR" 159 "PARK" 160 "PRIOCROSSL" 161 "PRIOCROSSR" 162 "TOLL" 163 "TUNNEL" 164 "TWOWAY" 165 "WARNCROSS" 166 "WARNCROSSL" 167 "WARNCROSSLR" 168 "WARNCROSSR" 169 "WARNCROSSRL" 170 "WARNCROSST" 171 "WARNGIVEWAYAHEAD" 172 "WARNSLAHEAD" 173 "WARNSTOPAHEAD" 174 "WBBUS" 175 "WRONGWAY" 176 "HAZWATER" 177 "GIVEWAYROUND" 178 "WARNWINDINGL" 179 "WARNWINDINGR" 180 "WARNHAIRPINL" 181 "WARNHAIRPINR" 182 "WARNPEDBIKE" 183 "WARNCROSSY" 184 "WARNBRANCHL" 185 "WARNBRANCHR" 186 "WARNAXLEWEIGHT" 187 "WARNWEIGHT" 188 "WARNHEIGHT" 189 "WARNLENGTH" 190 "WARNWIDTH" 191 "WARNBLACKSPOT" 192 "WARNMERGEL" 193 "WARNMERGER" 194 "WARNTUNNEL" 195 "WARNTRACTOR" 196 "WARNRWORKSVEHICLE" 197 "WARNNARROWBRIDGE" 198 "WARNFLAGGER" 199 "LANES" 200 "LANESHIFTL" 201 "LANESHIFTR" 202 "NEWLANEL" 203 "NEWLANER" 204 "RIGHTTURNONRED" 205 "BORDERLIMIT" 206 "EMBEDDEDRAIN" ;
VAL_ 248 VFC_TS10_EmbedFlag 0 "Unknown" 1 "Not Embedded" 2 "Border Limit" 3 "Multi Lane" 4 "Rain" 5 "Vehicle Type" 6 "Plate" 7 "Error Value" ;
VAL_ 248 VFC_TS10_Quality 0 "Poor Quality" 1 "Good Quality" ;
VAL_ 248 VFC_TS10_VMS 0 "Fixed" 1 "Variable" ;
VAL_ 248 VFC_TS10_Stable 0 "Object Is Not Stable" 1 "Object Is Stable" ;
VAL_ 248 VFC_TS10_VehicleSticker 0 "not_sticker_on_vehicle" 1 "Sign is a sticker on a vehicle" ;
VAL_ 248 VFC_TS10_InternalTrack 0 "Sign is not an internal track" 1 "Sign is an internal track" ;
VAL_ 248 VFC_TS10_AddTS1Class 0 "UNKNOWN" 1 "DETECTED" 2 "ACCIDENT" 3 "ADVICE" 4 "BEGINS" 5 "BUS" 6 "CAMPER" 7 "CAR" 8 "CARAVAN" 9 "CRASHRISK" 10 "DIRT" 11 "DISTANCE" 12 "DISTANCEBARS" 13 "END" 14 "EXITL" 15 "EXITR" 16 "FOG" 17 "GRAVEL" 18 "HAZMAT" 19 "HUMP" 20 "JAM" 21 "LORRY" 22 "EXCEPTLORRY" 23 "LOWTREE" 24 "MCYCLE" 25 "MINIMUM" 26 "NIGHT" 27 "NOSTOPSHOULDER" 28 "OILTRAIL" 29 "PRIOTURN" 30 "RADAR" 31 "RAIN" 32 "RAINSNOW" 33 "REMINDER" 34 "ROADDAMAGE" 35 "RUTS" 36 "RWORKSACCESS" 37 "RWORKSENTRY" 38 "RWORKSEXIT" 39 "SCHOOL" 40 "SECTION" 41 "SMOKE" 42 "SNOW" 43 "SOFTSHOULDERCAR" 44 "SHOFTSHOULDERLORRY" 45 "TEXT" 46 "TIME" 47 "TOWING" 48 "TRACTOR" 49 "TRACTOR_OVER" 50 "TRAILER" 51 "WEIGHT" 52 "WET" 53 "WITHIN" 54 "ZONE" 55 "EXIT" 56 "ACCESS" 57 "ALLWAY" 58 "EXCEPTBUS" 59 "EXCEPTDELIVERY" 60 "EXCEPTLOCAL" 61 "FROG" 62 "PRIOTURNL" 63 "PRIOTURNR" 64 "START" 65 "STOPIN" 66 "HAZWATER" 67 "DAY" 68 "SL" ;
VAL_ 248 VFC_TS10_AddTS1Quality 0 "Poor Quality" 1 "Good Quality" ;
VAL_ 248 VFC_TS10_AddTS1VMS 0 "Fixed" 1 "Variable" ;
VAL_ 248 VFC_TS10_AddTS2Class 0 "UNKNOWN" 1 "DETECTED" 2 "ACCIDENT" 3 "ADVICE" 4 "BEGINS" 5 "BUS" 6 "CAMPER" 7 "CAR" 8 "CARAVAN" 9 "CRASHRISK" 10 "DIRT" 11 "DISTANCE" 12 "DISTANCEBARS" 13 "END" 14 "EXITL" 15 "EXITR" 16 "FOG" 17 "GRAVEL" 18 "HAZMAT" 19 "HUMP" 20 "JAM" 21 "LORRY" 22 "EXCEPTLORRY" 23 "LOWTREE" 24 "MCYCLE" 25 "MINIMUM" 26 "NIGHT" 27 "NOSTOPSHOULDER" 28 "OILTRAIL" 29 "PRIOTURN" 30 "RADAR" 31 "RAIN" 32 "RAINSNOW" 33 "REMINDER" 34 "ROADDAMAGE" 35 "RUTS" 36 "RWORKSACCESS" 37 "RWORKSENTRY" 38 "RWORKSEXIT" 39 "SCHOOL" 40 "SECTION" 41 "SMOKE" 42 "SNOW" 43 "SOFTSHOULDERCAR" 44 "SHOFTSHOULDERLORRY" 45 "TEXT" 46 "TIME" 47 "TOWING" 48 "TRACTOR" 49 "TRACTOR_OVER" 50 "TRAILER" 51 "WEIGHT" 52 "WET" 53 "WITHIN" 54 "ZONE" 55 "EXIT" 56 "ACCESS" 57 "ALLWAY" 58 "EXCEPTBUS" 59 "EXCEPTDELIVERY" 60 "EXCEPTLOCAL" 61 "FROG" 62 "PRIOTURNL" 63 "PRIOTURNR" 64 "START" 65 "STOPIN" 66 "HAZWATER" 67 "DAY" 68 "SL" ;
VAL_ 248 VFC_TS10_AddTS2Quality 0 "Poor Quality" 1 "Good Quality" ;
VAL_ 248 VFC_TS10_AddTS2VMS 0 "Fixed" 1 "Variable" ;
VAL_ 248 VFC_TS10_AddTS3Class 0 "UNKNOWN" 1 "DETECTED" 2 "ACCIDENT" 3 "ADVICE" 4 "BEGINS" 5 "BUS" 6 "CAMPER" 7 "CAR" 8 "CARAVAN" 9 "CRASHRISK" 10 "DIRT" 11 "DISTANCE" 12 "DISTANCEBARS" 13 "END" 14 "EXITL" 15 "EXITR" 16 "FOG" 17 "GRAVEL" 18 "HAZMAT" 19 "HUMP" 20 "JAM" 21 "LORRY" 22 "EXCEPTLORRY" 23 "LOWTREE" 24 "MCYCLE" 25 "MINIMUM" 26 "NIGHT" 27 "NOSTOPSHOULDER" 28 "OILTRAIL" 29 "PRIOTURN" 30 "RADAR" 31 "RAIN" 32 "RAINSNOW" 33 "REMINDER" 34 "ROADDAMAGE" 35 "RUTS" 36 "RWORKSACCESS" 37 "RWORKSENTRY" 38 "RWORKSEXIT" 39 "SCHOOL" 40 "SECTION" 41 "SMOKE" 42 "SNOW" 43 "SOFTSHOULDERCAR" 44 "SHOFTSHOULDERLORRY" 45 "TEXT" 46 "TIME" 47 "TOWING" 48 "TRACTOR" 49 "TRACTOR_OVER" 50 "TRAILER" 51 "WEIGHT" 52 "WET" 53 "WITHIN" 54 "ZONE" 55 "EXIT" 56 "ACCESS" 57 "ALLWAY" 58 "EXCEPTBUS" 59 "EXCEPTDELIVERY" 60 "EXCEPTLOCAL" 61 "FROG" 62 "PRIOTURNL" 63 "PRIOTURNR" 64 "START" 65 "STOPIN" 66 "HAZWATER" 67 "DAY" 68 "SL" ;
VAL_ 248 VFC_TS10_AddTS3Quality 0 "Poor Quality" 1 "Good Quality" ;
VAL_ 248 VFC_TS10_AddTS3VMS 0 "Fixed" 1 "Variable" ;
VAL_ 248 VFC_TS10_AddTS4Class 0 "UNKNOWN" 1 "DETECTED" 2 "ACCIDENT" 3 "ADVICE" 4 "BEGINS" 5 "BUS" 6 "CAMPER" 7 "CAR" 8 "CARAVAN" 9 "CRASHRISK" 10 "DIRT" 11 "DISTANCE" 12 "DISTANCEBARS" 13 "END" 14 "EXITL" 15 "EXITR" 16 "FOG" 17 "GRAVEL" 18 "HAZMAT" 19 "HUMP" 20 "JAM" 21 "LORRY" 22 "EXCEPTLORRY" 23 "LOWTREE" 24 "MCYCLE" 25 "MINIMUM" 26 "NIGHT" 27 "NOSTOPSHOULDER" 28 "OILTRAIL" 29 "PRIOTURN" 30 "RADAR" 31 "RAIN" 32 "RAINSNOW" 33 "REMINDER" 34 "ROADDAMAGE" 35 "RUTS" 36 "RWORKSACCESS" 37 "RWORKSENTRY" 38 "RWORKSEXIT" 39 "SCHOOL" 40 "SECTION" 41 "SMOKE" 42 "SNOW" 43 "SOFTSHOULDERCAR" 44 "SHOFTSHOULDERLORRY" 45 "TEXT" 46 "TIME" 47 "TOWING" 48 "TRACTOR" 49 "TRACTOR_OVER" 50 "TRAILER" 51 "WEIGHT" 52 "WET" 53 "WITHIN" 54 "ZONE" 55 "EXIT" 56 "ACCESS" 57 "ALLWAY" 58 "EXCEPTBUS" 59 "EXCEPTDELIVERY" 60 "EXCEPTLOCAL" 61 "FROG" 62 "PRIOTURNL" 63 "PRIOTURNR" 64 "START" 65 "STOPIN" 66 "HAZWATER" 67 "DAY" 68 "SL" ;
VAL_ 248 VFC_TS10_AddTS4Quality 0 "Poor Quality" 1 "Good Quality" ;
VAL_ 248 VFC_TS10_AddTS4VMS 0 "Fixed" 1 "Variable" ;
VAL_ 248 VFC_TS10_AddTS5Class 0 "UNKNOWN" 1 "DETECTED" 2 "ACCIDENT" 3 "ADVICE" 4 "BEGINS" 5 "BUS" 6 "CAMPER" 7 "CAR" 8 "CARAVAN" 9 "CRASHRISK" 10 "DIRT" 11 "DISTANCE" 12 "DISTANCEBARS" 13 "END" 14 "EXITL" 15 "EXITR" 16 "FOG" 17 "GRAVEL" 18 "HAZMAT" 19 "HUMP" 20 "JAM" 21 "LORRY" 22 "EXCEPTLORRY" 23 "LOWTREE" 24 "MCYCLE" 25 "MINIMUM" 26 "NIGHT" 27 "NOSTOPSHOULDER" 28 "OILTRAIL" 29 "PRIOTURN" 30 "RADAR" 31 "RAIN" 32 "RAINSNOW" 33 "REMINDER" 34 "ROADDAMAGE" 35 "RUTS" 36 "RWORKSACCESS" 37 "RWORKSENTRY" 38 "RWORKSEXIT" 39 "SCHOOL" 40 "SECTION" 41 "SMOKE" 42 "SNOW" 43 "SOFTSHOULDERCAR" 44 "SHOFTSHOULDERLORRY" 45 "TEXT" 46 "TIME" 47 "TOWING" 48 "TRACTOR" 49 "TRACTOR_OVER" 50 "TRAILER" 51 "WEIGHT" 52 "WET" 53 "WITHIN" 54 "ZONE" 55 "EXIT" 56 "ACCESS" 57 "ALLWAY" 58 "EXCEPTBUS" 59 "EXCEPTDELIVERY" 60 "EXCEPTLOCAL" 61 "FROG" 62 "PRIOTURNL" 63 "PRIOTURNR" 64 "START" 65 "STOPIN" 66 "HAZWATER" 67 "DAY" 68 "SL" ;
VAL_ 248 VFC_TS10_AddTS5Quality 0 "Poor Quality" 1 "Good Quality" ;
VAL_ 248 VFC_TS10_AddTS5VMS 0 "Fixed" 1 "Variable" ;
VAL_ 248 VFC_TS10_AddTS6Class 0 "UNKNOWN" 1 "DETECTED" 2 "ACCIDENT" 3 "ADVICE" 4 "BEGINS" 5 "BUS" 6 "CAMPER" 7 "CAR" 8 "CARAVAN" 9 "CRASHRISK" 10 "DIRT" 11 "DISTANCE" 12 "DISTANCEBARS" 13 "END" 14 "EXITL" 15 "EXITR" 16 "FOG" 17 "GRAVEL" 18 "HAZMAT" 19 "HUMP" 20 "JAM" 21 "LORRY" 22 "EXCEPTLORRY" 23 "LOWTREE" 24 "MCYCLE" 25 "MINIMUM" 26 "NIGHT" 27 "NOSTOPSHOULDER" 28 "OILTRAIL" 29 "PRIOTURN" 30 "RADAR" 31 "RAIN" 32 "RAINSNOW" 33 "REMINDER" 34 "ROADDAMAGE" 35 "RUTS" 36 "RWORKSACCESS" 37 "RWORKSENTRY" 38 "RWORKSEXIT" 39 "SCHOOL" 40 "SECTION" 41 "SMOKE" 42 "SNOW" 43 "SOFTSHOULDERCAR" 44 "SHOFTSHOULDERLORRY" 45 "TEXT" 46 "TIME" 47 "TOWING" 48 "TRACTOR" 49 "TRACTOR_OVER" 50 "TRAILER" 51 "WEIGHT" 52 "WET" 53 "WITHIN" 54 "ZONE" 55 "EXIT" 56 "ACCESS" 57 "ALLWAY" 58 "EXCEPTBUS" 59 "EXCEPTDELIVERY" 60 "EXCEPTLOCAL" 61 "FROG" 62 "PRIOTURNL" 63 "PRIOTURNR" 64 "START" 65 "STOPIN" 66 "HAZWATER" 67 "DAY" 68 "SL" ;
VAL_ 248 VFC_TS10_AddTS6Quality 0 "Poor Quality" 1 "Good Quality" ;
VAL_ 248 VFC_TS10_AddTS6VMS 0 "Fixed" 1 "Variable" ;
VAL_ 249 VFC_TS11_ID 0 "INVALID" ;
VAL_ 249 VFC_TS11_Class 0 "UNKNOWN" 1 "SL5" 2 "SL10" 3 "SL15" 4 "SL20" 5 "SL25" 6 "SL30" 7 "SL35" 8 "SL40" 9 "SL45" 10 "SL50" 11 "SL55" 12 "SL60" 13 "SL65" 14 "SL70" 15 "SL75" 16 "SL80" 17 "SL85" 18 "SL90" 19 "SL95" 20 "SL100" 21 "SL105" 22 "SL110" 23 "SL115" 24 "SL120" 25 "SL125" 26 "SL130" 27 "SL135" 28 "SL140" 29 "SL145" 30 "SL150" 31 "SL155" 32 "SL160" 33 "ESL" 34 "EA" 35 "OP" 36 "EOP" 37 "OL" 38 "EOL" 39 "GIVEWAY" 40 "PRIOCROSS" 41 "PRIOCROSSYIELDTORIGHT" 42 "PRIOSTREET" 43 "EPRIOSTREET" 44 "STOP" 45 "AXLEWEIGHT" 46 "CARDIST" 47 "HEIGHT" 48 "LENGTH" 49 "LORRYDIST" 50 "NOALL" 51 "NOBIKE" 52 "NOBUS" 53 "NOCAR" 54 "NOCARBIKE" 55 "NOCARRIAGE" 56 "NOENTRY" 57 "NOHAZMAT" 58 "NOHAZWATER" 59 "NOLORRY" 60 "NOLORRYTRAILER" 61 "NOLTURN" 62 "NOPED" 63 "NORIDER" 64 "NORTURN" 65 "NOTRACTOR" 66 "NOTWOWAY" 67 "NOUTURN" 68 "UMWELT" 69 "EUMWELT" 70 "WEIGHT" 71 "WIDTH" 72 "WARNBIKE" 73 "WARNBUS" 74 "WARNCATTLE" 75 "WARNCONST" 76 "WARNCONSTL" 77 "WARNCONSTR" 78 "WARNCURVEL" 79 "WARNCURVER" 80 "WARNDANGER" 81 "WARNDCURVEL" 82 "WARNDCURVER" 83 "WARNDRAWBRIDGE" 84 "WARNFROG" 85 "WARNGRAVEL" 86 "WARNHUMP" 87 "WARNJAM" 88 "WARNKIDS" 89 "WARNLIGHTS" 90 "WARNLOWTREE" 91 "WARNPCROSS" 92 "WARNPED" 93 "WARNPIER" 94 "WARNPLANE" 95 "WARNRIDER" 96 "WARNROCK" 97 "WARNROUND" 98 "WARNRWORKS" 99 "WARNSKID" 100 "WARNSLOPED" 101 "WARNSLOPEU" 102 "WARNSNOW" 103 "WARNTRAIN" 104 "WARNTWOWAY" 105 "WARNWILDANIMAL" 106 "WARNWIND" 107 "ASL" 108 "EASL" 109 "CALM" 110 "ECALM" 111 "DEADEND" 112 "DOUANE" 113 "FWAY" 114 "EFWAY" 115 "HWAY" 116 "EHWAY" 117 "MSL" 118 "EMSL" 119 "NOPARK" 120 "NOSTOP" 121 "ONEWAYS" 122 "ONEWAYU" 123 "SLOWDOWN" 124 "SCHOOL" 125 "ESCHOOL" 126 "TWN" 127 "ETWN" 128 "WBBENTLEFT" 129 "WBBENTLEFTRIGHT" 130 "WBBENTRIGHT" 131 "WBDIAGL" 132 "WBDIAGLR" 133 "WBDIAGR" 134 "WBHAZWATER" 135 "WBLEFT" 136 "WBRIGHT" 137 "WBROUND" 138 "WBUP" 139 "WBUPLEFT" 140 "WBUPRIGHT" 141 "ZEBRA" 142 "HAZMAT" 143 "EMERGENCYBAY" 144 "ENDOFLANEL" 145 "ENDOFLANER" 146 "ENOPARK" 147 "EONEWAY" 148 "EPARK" 149 "ETOLL" 150 "NOPARKL" 151 "NOPARKLR" 152 "NOPARKR" 153 "NOSTOPL" 154 "NOSTOPLR" 155 "NOSTOPR" 156 "NOTURNONRED" 157 "ONEWAYL" 158 "ONEWAYR" 159 "PARK" 160 "PRIOCROSSL" 161 "PRIOCROSSR" 162 "TOLL" 163 "TUNNEL" 164 "TWOWAY" 165 "WARNCROSS" 166 "WARNCROSSL" 167 "WARNCROSSLR" 168 "WARNCROSSR" 169 "WARNCROSSRL" 170 "WARNCROSST" 171 "WARNGIVEWAYAHEAD" 172 "WARNSLAHEAD" 173 "WARNSTOPAHEAD" 174 "WBBUS" 175 "WRONGWAY" 176 "HAZWATER" 177 "GIVEWAYROUND" 178 "WARNWINDINGL" 179 "WARNWINDINGR" 180 "WARNHAIRPINL" 181 "WARNHAIRPINR" 182 "WARNPEDBIKE" 183 "WARNCROSSY" 184 "WARNBRANCHL" 185 "WARNBRANCHR" 186 "WARNAXLEWEIGHT" 187 "WARNWEIGHT" 188 "WARNHEIGHT" 189 "WARNLENGTH" 190 "WARNWIDTH" 191 "WARNBLACKSPOT" 192 "WARNMERGEL" 193 "WARNMERGER" 194 "WARNTUNNEL" 195 "WARNTRACTOR" 196 "WARNRWORKSVEHICLE" 197 "WARNNARROWBRIDGE" 198 "WARNFLAGGER" 199 "LANES" 200 "LANESHIFTL" 201 "LANESHIFTR" 202 "NEWLANEL" 203 "NEWLANER" 204 "RIGHTTURNONRED" 205 "BORDERLIMIT" 206 "EMBEDDEDRAIN" ;
VAL_ 249 VFC_TS11_EmbedFlag 0 "Unknown" 1 "Not Embedded" 2 "Border Limit" 3 "Multi Lane" 4 "Rain" 5 "Vehicle Type" 6 "Plate" 7 "Error Value" ;
VAL_ 249 VFC_TS11_Quality 0 "Poor Quality" 1 "Good Quality" ;
VAL_ 249 VFC_TS11_VMS 0 "Fixed" 1 "Variable" ;
VAL_ 249 VFC_TS11_Stable 0 "Object Is Not Stable" 1 "Object Is Stable" ;
VAL_ 249 VFC_TS11_VehicleSticker 0 "not_sticker_on_vehicle" 1 "Sign is a sticker on a vehicle" ;
VAL_ 249 VFC_TS11_InternalTrack 0 "Sign is not an internal track" 1 "Sign is an internal track" ;
VAL_ 249 VFC_TS11_AddTS1Class 0 "UNKNOWN" 1 "DETECTED" 2 "ACCIDENT" 3 "ADVICE" 4 "BEGINS" 5 "BUS" 6 "CAMPER" 7 "CAR" 8 "CARAVAN" 9 "CRASHRISK" 10 "DIRT" 11 "DISTANCE" 12 "DISTANCEBARS" 13 "END" 14 "EXITL" 15 "EXITR" 16 "FOG" 17 "GRAVEL" 18 "HAZMAT" 19 "HUMP" 20 "JAM" 21 "LORRY" 22 "EXCEPTLORRY" 23 "LOWTREE" 24 "MCYCLE" 25 "MINIMUM" 26 "NIGHT" 27 "NOSTOPSHOULDER" 28 "OILTRAIL" 29 "PRIOTURN" 30 "RADAR" 31 "RAIN" 32 "RAINSNOW" 33 "REMINDER" 34 "ROADDAMAGE" 35 "RUTS" 36 "RWORKSACCESS" 37 "RWORKSENTRY" 38 "RWORKSEXIT" 39 "SCHOOL" 40 "SECTION" 41 "SMOKE" 42 "SNOW" 43 "SOFTSHOULDERCAR" 44 "SHOFTSHOULDERLORRY" 45 "TEXT" 46 "TIME" 47 "TOWING" 48 "TRACTOR" 49 "TRACTOR_OVER" 50 "TRAILER" 51 "WEIGHT" 52 "WET" 53 "WITHIN" 54 "ZONE" 55 "EXIT" 56 "ACCESS" 57 "ALLWAY" 58 "EXCEPTBUS" 59 "EXCEPTDELIVERY" 60 "EXCEPTLOCAL" 61 "FROG" 62 "PRIOTURNL" 63 "PRIOTURNR" 64 "START" 65 "STOPIN" 66 "HAZWATER" 67 "DAY" 68 "SL" ;
VAL_ 249 VFC_TS11_AddTS1Quality 0 "Poor Quality" 1 "Good Quality" ;
VAL_ 249 VFC_TS11_AddTS1VMS 0 "Fixed" 1 "Variable" ;
VAL_ 249 VFC_TS11_AddTS2Class 0 "UNKNOWN" 1 "DETECTED" 2 "ACCIDENT" 3 "ADVICE" 4 "BEGINS" 5 "BUS" 6 "CAMPER" 7 "CAR" 8 "CARAVAN" 9 "CRASHRISK" 10 "DIRT" 11 "DISTANCE" 12 "DISTANCEBARS" 13 "END" 14 "EXITL" 15 "EXITR" 16 "FOG" 17 "GRAVEL" 18 "HAZMAT" 19 "HUMP" 20 "JAM" 21 "LORRY" 22 "EXCEPTLORRY" 23 "LOWTREE" 24 "MCYCLE" 25 "MINIMUM" 26 "NIGHT" 27 "NOSTOPSHOULDER" 28 "OILTRAIL" 29 "PRIOTURN" 30 "RADAR" 31 "RAIN" 32 "RAINSNOW" 33 "REMINDER" 34 "ROADDAMAGE" 35 "RUTS" 36 "RWORKSACCESS" 37 "RWORKSENTRY" 38 "RWORKSEXIT" 39 "SCHOOL" 40 "SECTION" 41 "SMOKE" 42 "SNOW" 43 "SOFTSHOULDERCAR" 44 "SHOFTSHOULDERLORRY" 45 "TEXT" 46 "TIME" 47 "TOWING" 48 "TRACTOR" 49 "TRACTOR_OVER" 50 "TRAILER" 51 "WEIGHT" 52 "WET" 53 "WITHIN" 54 "ZONE" 55 "EXIT" 56 "ACCESS" 57 "ALLWAY" 58 "EXCEPTBUS" 59 "EXCEPTDELIVERY" 60 "EXCEPTLOCAL" 61 "FROG" 62 "PRIOTURNL" 63 "PRIOTURNR" 64 "START" 65 "STOPIN" 66 "HAZWATER" 67 "DAY" 68 "SL" ;
VAL_ 249 VFC_TS11_AddTS2Quality 0 "Poor Quality" 1 "Good Quality" ;
VAL_ 249 VFC_TS11_AddTS2VMS 0 "Fixed" 1 "Variable" ;
VAL_ 249 VFC_TS11_AddTS3Class 0 "UNKNOWN" 1 "DETECTED" 2 "ACCIDENT" 3 "ADVICE" 4 "BEGINS" 5 "BUS" 6 "CAMPER" 7 "CAR" 8 "CARAVAN" 9 "CRASHRISK" 10 "DIRT" 11 "DISTANCE" 12 "DISTANCEBARS" 13 "END" 14 "EXITL" 15 "EXITR" 16 "FOG" 17 "GRAVEL" 18 "HAZMAT" 19 "HUMP" 20 "JAM" 21 "LORRY" 22 "EXCEPTLORRY" 23 "LOWTREE" 24 "MCYCLE" 25 "MINIMUM" 26 "NIGHT" 27 "NOSTOPSHOULDER" 28 "OILTRAIL" 29 "PRIOTURN" 30 "RADAR" 31 "RAIN" 32 "RAINSNOW" 33 "REMINDER" 34 "ROADDAMAGE" 35 "RUTS" 36 "RWORKSACCESS" 37 "RWORKSENTRY" 38 "RWORKSEXIT" 39 "SCHOOL" 40 "SECTION" 41 "SMOKE" 42 "SNOW" 43 "SOFTSHOULDERCAR" 44 "SHOFTSHOULDERLORRY" 45 "TEXT" 46 "TIME" 47 "TOWING" 48 "TRACTOR" 49 "TRACTOR_OVER" 50 "TRAILER" 51 "WEIGHT" 52 "WET" 53 "WITHIN" 54 "ZONE" 55 "EXIT" 56 "ACCESS" 57 "ALLWAY" 58 "EXCEPTBUS" 59 "EXCEPTDELIVERY" 60 "EXCEPTLOCAL" 61 "FROG" 62 "PRIOTURNL" 63 "PRIOTURNR" 64 "START" 65 "STOPIN" 66 "HAZWATER" 67 "DAY" 68 "SL" ;
VAL_ 249 VFC_TS11_AddTS3Quality 0 "Poor Quality" 1 "Good Quality" ;
VAL_ 249 VFC_TS11_AddTS3VMS 0 "Fixed" 1 "Variable" ;
VAL_ 249 VFC_TS11_AddTS4Class 0 "UNKNOWN" 1 "DETECTED" 2 "ACCIDENT" 3 "ADVICE" 4 "BEGINS" 5 "BUS" 6 "CAMPER" 7 "CAR" 8 "CARAVAN" 9 "CRASHRISK" 10 "DIRT" 11 "DISTANCE" 12 "DISTANCEBARS" 13 "END" 14 "EXITL" 15 "EXITR" 16 "FOG" 17 "GRAVEL" 18 "HAZMAT" 19 "HUMP" 20 "JAM" 21 "LORRY" 22 "EXCEPTLORRY" 23 "LOWTREE" 24 "MCYCLE" 25 "MINIMUM" 26 "NIGHT" 27 "NOSTOPSHOULDER" 28 "OILTRAIL" 29 "PRIOTURN" 30 "RADAR" 31 "RAIN" 32 "RAINSNOW" 33 "REMINDER" 34 "ROADDAMAGE" 35 "RUTS" 36 "RWORKSACCESS" 37 "RWORKSENTRY" 38 "RWORKSEXIT" 39 "SCHOOL" 40 "SECTION" 41 "SMOKE" 42 "SNOW" 43 "SOFTSHOULDERCAR" 44 "SHOFTSHOULDERLORRY" 45 "TEXT" 46 "TIME" 47 "TOWING" 48 "TRACTOR" 49 "TRACTOR_OVER" 50 "TRAILER" 51 "WEIGHT" 52 "WET" 53 "WITHIN" 54 "ZONE" 55 "EXIT" 56 "ACCESS" 57 "ALLWAY" 58 "EXCEPTBUS" 59 "EXCEPTDELIVERY" 60 "EXCEPTLOCAL" 61 "FROG" 62 "PRIOTURNL" 63 "PRIOTURNR" 64 "START" 65 "STOPIN" 66 "HAZWATER" 67 "DAY" 68 "SL" ;
VAL_ 249 VFC_TS11_AddTS4Quality 0 "Poor Quality" 1 "Good Quality" ;
VAL_ 249 VFC_TS11_AddTS4VMS 0 "Fixed" 1 "Variable" ;
VAL_ 249 VFC_TS11_AddTS5Class 0 "UNKNOWN" 1 "DETECTED" 2 "ACCIDENT" 3 "ADVICE" 4 "BEGINS" 5 "BUS" 6 "CAMPER" 7 "CAR" 8 "CARAVAN" 9 "CRASHRISK" 10 "DIRT" 11 "DISTANCE" 12 "DISTANCEBARS" 13 "END" 14 "EXITL" 15 "EXITR" 16 "FOG" 17 "GRAVEL" 18 "HAZMAT" 19 "HUMP" 20 "JAM" 21 "LORRY" 22 "EXCEPTLORRY" 23 "LOWTREE" 24 "MCYCLE" 25 "MINIMUM" 26 "NIGHT" 27 "NOSTOPSHOULDER" 28 "OILTRAIL" 29 "PRIOTURN" 30 "RADAR" 31 "RAIN" 32 "RAINSNOW" 33 "REMINDER" 34 "ROADDAMAGE" 35 "RUTS" 36 "RWORKSACCESS" 37 "RWORKSENTRY" 38 "RWORKSEXIT" 39 "SCHOOL" 40 "SECTION" 41 "SMOKE" 42 "SNOW" 43 "SOFTSHOULDERCAR" 44 "SHOFTSHOULDERLORRY" 45 "TEXT" 46 "TIME" 47 "TOWING" 48 "TRACTOR" 49 "TRACTOR_OVER" 50 "TRAILER" 51 "WEIGHT" 52 "WET" 53 "WITHIN" 54 "ZONE" 55 "EXIT" 56 "ACCESS" 57 "ALLWAY" 58 "EXCEPTBUS" 59 "EXCEPTDELIVERY" 60 "EXCEPTLOCAL" 61 "FROG" 62 "PRIOTURNL" 63 "PRIOTURNR" 64 "START" 65 "STOPIN" 66 "HAZWATER" 67 "DAY" 68 "SL" ;
VAL_ 249 VFC_TS11_AddTS5Quality 0 "Poor Quality" 1 "Good Quality" ;
VAL_ 249 VFC_TS11_AddTS5VMS 0 "Fixed" 1 "Variable" ;
VAL_ 249 VFC_TS11_AddTS6Class 0 "UNKNOWN" 1 "DETECTED" 2 "ACCIDENT" 3 "ADVICE" 4 "BEGINS" 5 "BUS" 6 "CAMPER" 7 "CAR" 8 "CARAVAN" 9 "CRASHRISK" 10 "DIRT" 11 "DISTANCE" 12 "DISTANCEBARS" 13 "END" 14 "EXITL" 15 "EXITR" 16 "FOG" 17 "GRAVEL" 18 "HAZMAT" 19 "HUMP" 20 "JAM" 21 "LORRY" 22 "EXCEPTLORRY" 23 "LOWTREE" 24 "MCYCLE" 25 "MINIMUM" 26 "NIGHT" 27 "NOSTOPSHOULDER" 28 "OILTRAIL" 29 "PRIOTURN" 30 "RADAR" 31 "RAIN" 32 "RAINSNOW" 33 "REMINDER" 34 "ROADDAMAGE" 35 "RUTS" 36 "RWORKSACCESS" 37 "RWORKSENTRY" 38 "RWORKSEXIT" 39 "SCHOOL" 40 "SECTION" 41 "SMOKE" 42 "SNOW" 43 "SOFTSHOULDERCAR" 44 "SHOFTSHOULDERLORRY" 45 "TEXT" 46 "TIME" 47 "TOWING" 48 "TRACTOR" 49 "TRACTOR_OVER" 50 "TRAILER" 51 "WEIGHT" 52 "WET" 53 "WITHIN" 54 "ZONE" 55 "EXIT" 56 "ACCESS" 57 "ALLWAY" 58 "EXCEPTBUS" 59 "EXCEPTDELIVERY" 60 "EXCEPTLOCAL" 61 "FROG" 62 "PRIOTURNL" 63 "PRIOTURNR" 64 "START" 65 "STOPIN" 66 "HAZWATER" 67 "DAY" 68 "SL" ;
VAL_ 249 VFC_TS11_AddTS6Quality 0 "Poor Quality" 1 "Good Quality" ;
VAL_ 249 VFC_TS11_AddTS6VMS 0 "Fixed" 1 "Variable" ;
VAL_ 250 VFC_TS12_ID 0 "INVALID" ;
VAL_ 250 VFC_TS12_Class 0 "UNKNOWN" 1 "SL5" 2 "SL10" 3 "SL15" 4 "SL20" 5 "SL25" 6 "SL30" 7 "SL35" 8 "SL40" 9 "SL45" 10 "SL50" 11 "SL55" 12 "SL60" 13 "SL65" 14 "SL70" 15 "SL75" 16 "SL80" 17 "SL85" 18 "SL90" 19 "SL95" 20 "SL100" 21 "SL105" 22 "SL110" 23 "SL115" 24 "SL120" 25 "SL125" 26 "SL130" 27 "SL135" 28 "SL140" 29 "SL145" 30 "SL150" 31 "SL155" 32 "SL160" 33 "ESL" 34 "EA" 35 "OP" 36 "EOP" 37 "OL" 38 "EOL" 39 "GIVEWAY" 40 "PRIOCROSS" 41 "PRIOCROSSYIELDTORIGHT" 42 "PRIOSTREET" 43 "EPRIOSTREET" 44 "STOP" 45 "AXLEWEIGHT" 46 "CARDIST" 47 "HEIGHT" 48 "LENGTH" 49 "LORRYDIST" 50 "NOALL" 51 "NOBIKE" 52 "NOBUS" 53 "NOCAR" 54 "NOCARBIKE" 55 "NOCARRIAGE" 56 "NOENTRY" 57 "NOHAZMAT" 58 "NOHAZWATER" 59 "NOLORRY" 60 "NOLORRYTRAILER" 61 "NOLTURN" 62 "NOPED" 63 "NORIDER" 64 "NORTURN" 65 "NOTRACTOR" 66 "NOTWOWAY" 67 "NOUTURN" 68 "UMWELT" 69 "EUMWELT" 70 "WEIGHT" 71 "WIDTH" 72 "WARNBIKE" 73 "WARNBUS" 74 "WARNCATTLE" 75 "WARNCONST" 76 "WARNCONSTL" 77 "WARNCONSTR" 78 "WARNCURVEL" 79 "WARNCURVER" 80 "WARNDANGER" 81 "WARNDCURVEL" 82 "WARNDCURVER" 83 "WARNDRAWBRIDGE" 84 "WARNFROG" 85 "WARNGRAVEL" 86 "WARNHUMP" 87 "WARNJAM" 88 "WARNKIDS" 89 "WARNLIGHTS" 90 "WARNLOWTREE" 91 "WARNPCROSS" 92 "WARNPED" 93 "WARNPIER" 94 "WARNPLANE" 95 "WARNRIDER" 96 "WARNROCK" 97 "WARNROUND" 98 "WARNRWORKS" 99 "WARNSKID" 100 "WARNSLOPED" 101 "WARNSLOPEU" 102 "WARNSNOW" 103 "WARNTRAIN" 104 "WARNTWOWAY" 105 "WARNWILDANIMAL" 106 "WARNWIND" 107 "ASL" 108 "EASL" 109 "CALM" 110 "ECALM" 111 "DEADEND" 112 "DOUANE" 113 "FWAY" 114 "EFWAY" 115 "HWAY" 116 "EHWAY" 117 "MSL" 118 "EMSL" 119 "NOPARK" 120 "NOSTOP" 121 "ONEWAYS" 122 "ONEWAYU" 123 "SLOWDOWN" 124 "SCHOOL" 125 "ESCHOOL" 126 "TWN" 127 "ETWN" 128 "WBBENTLEFT" 129 "WBBENTLEFTRIGHT" 130 "WBBENTRIGHT" 131 "WBDIAGL" 132 "WBDIAGLR" 133 "WBDIAGR" 134 "WBHAZWATER" 135 "WBLEFT" 136 "WBRIGHT" 137 "WBROUND" 138 "WBUP" 139 "WBUPLEFT" 140 "WBUPRIGHT" 141 "ZEBRA" 142 "HAZMAT" 143 "EMERGENCYBAY" 144 "ENDOFLANEL" 145 "ENDOFLANER" 146 "ENOPARK" 147 "EONEWAY" 148 "EPARK" 149 "ETOLL" 150 "NOPARKL" 151 "NOPARKLR" 152 "NOPARKR" 153 "NOSTOPL" 154 "NOSTOPLR" 155 "NOSTOPR" 156 "NOTURNONRED" 157 "ONEWAYL" 158 "ONEWAYR" 159 "PARK" 160 "PRIOCROSSL" 161 "PRIOCROSSR" 162 "TOLL" 163 "TUNNEL" 164 "TWOWAY" 165 "WARNCROSS" 166 "WARNCROSSL" 167 "WARNCROSSLR" 168 "WARNCROSSR" 169 "WARNCROSSRL" 170 "WARNCROSST" 171 "WARNGIVEWAYAHEAD" 172 "WARNSLAHEAD" 173 "WARNSTOPAHEAD" 174 "WBBUS" 175 "WRONGWAY" 176 "HAZWATER" 177 "GIVEWAYROUND" 178 "WARNWINDINGL" 179 "WARNWINDINGR" 180 "WARNHAIRPINL" 181 "WARNHAIRPINR" 182 "WARNPEDBIKE" 183 "WARNCROSSY" 184 "WARNBRANCHL" 185 "WARNBRANCHR" 186 "WARNAXLEWEIGHT" 187 "WARNWEIGHT" 188 "WARNHEIGHT" 189 "WARNLENGTH" 190 "WARNWIDTH" 191 "WARNBLACKSPOT" 192 "WARNMERGEL" 193 "WARNMERGER" 194 "WARNTUNNEL" 195 "WARNTRACTOR" 196 "WARNRWORKSVEHICLE" 197 "WARNNARROWBRIDGE" 198 "WARNFLAGGER" 199 "LANES" 200 "LANESHIFTL" 201 "LANESHIFTR" 202 "NEWLANEL" 203 "NEWLANER" 204 "RIGHTTURNONRED" 205 "BORDERLIMIT" 206 "EMBEDDEDRAIN" ;
VAL_ 250 VFC_TS12_EmbedFlag 0 "Unknown" 1 "Not Embedded" 2 "Border Limit" 3 "Multi Lane" 4 "Rain" 5 "Vehicle Type" 6 "Plate" 7 "Error Value" ;
VAL_ 250 VFC_TS12_Quality 0 "Poor Quality" 1 "Good Quality" ;
VAL_ 250 VFC_TS12_VMS 0 "Fixed" 1 "Variable" ;
VAL_ 250 VFC_TS12_Stable 0 "Object Is Not Stable" 1 "Object Is Stable" ;
VAL_ 250 VFC_TS12_VehicleSticker 0 "not_sticker_on_vehicle" 1 "Sign is a sticker on a vehicle" ;
VAL_ 250 VFC_TS12_InternalTrack 0 "Sign is not an internal track" 1 "Sign is an internal track" ;
VAL_ 250 VFC_TS12_AddTS1Class 0 "UNKNOWN" 1 "DETECTED" 2 "ACCIDENT" 3 "ADVICE" 4 "BEGINS" 5 "BUS" 6 "CAMPER" 7 "CAR" 8 "CARAVAN" 9 "CRASHRISK" 10 "DIRT" 11 "DISTANCE" 12 "DISTANCEBARS" 13 "END" 14 "EXITL" 15 "EXITR" 16 "FOG" 17 "GRAVEL" 18 "HAZMAT" 19 "HUMP" 20 "JAM" 21 "LORRY" 22 "EXCEPTLORRY" 23 "LOWTREE" 24 "MCYCLE" 25 "MINIMUM" 26 "NIGHT" 27 "NOSTOPSHOULDER" 28 "OILTRAIL" 29 "PRIOTURN" 30 "RADAR" 31 "RAIN" 32 "RAINSNOW" 33 "REMINDER" 34 "ROADDAMAGE" 35 "RUTS" 36 "RWORKSACCESS" 37 "RWORKSENTRY" 38 "RWORKSEXIT" 39 "SCHOOL" 40 "SECTION" 41 "SMOKE" 42 "SNOW" 43 "SOFTSHOULDERCAR" 44 "SHOFTSHOULDERLORRY" 45 "TEXT" 46 "TIME" 47 "TOWING" 48 "TRACTOR" 49 "TRACTOR_OVER" 50 "TRAILER" 51 "WEIGHT" 52 "WET" 53 "WITHIN" 54 "ZONE" 55 "EXIT" 56 "ACCESS" 57 "ALLWAY" 58 "EXCEPTBUS" 59 "EXCEPTDELIVERY" 60 "EXCEPTLOCAL" 61 "FROG" 62 "PRIOTURNL" 63 "PRIOTURNR" 64 "START" 65 "STOPIN" 66 "HAZWATER" 67 "DAY" 68 "SL" ;
VAL_ 250 VFC_TS12_AddTS1Quality 0 "Poor Quality" 1 "Good Quality" ;
VAL_ 250 VFC_TS12_AddTS1VMS 0 "Fixed" 1 "Variable" ;
VAL_ 250 VFC_TS12_AddTS2Class 0 "UNKNOWN" 1 "DETECTED" 2 "ACCIDENT" 3 "ADVICE" 4 "BEGINS" 5 "BUS" 6 "CAMPER" 7 "CAR" 8 "CARAVAN" 9 "CRASHRISK" 10 "DIRT" 11 "DISTANCE" 12 "DISTANCEBARS" 13 "END" 14 "EXITL" 15 "EXITR" 16 "FOG" 17 "GRAVEL" 18 "HAZMAT" 19 "HUMP" 20 "JAM" 21 "LORRY" 22 "EXCEPTLORRY" 23 "LOWTREE" 24 "MCYCLE" 25 "MINIMUM" 26 "NIGHT" 27 "NOSTOPSHOULDER" 28 "OILTRAIL" 29 "PRIOTURN" 30 "RADAR" 31 "RAIN" 32 "RAINSNOW" 33 "REMINDER" 34 "ROADDAMAGE" 35 "RUTS" 36 "RWORKSACCESS" 37 "RWORKSENTRY" 38 "RWORKSEXIT" 39 "SCHOOL" 40 "SECTION" 41 "SMOKE" 42 "SNOW" 43 "SOFTSHOULDERCAR" 44 "SHOFTSHOULDERLORRY" 45 "TEXT" 46 "TIME" 47 "TOWING" 48 "TRACTOR" 49 "TRACTOR_OVER" 50 "TRAILER" 51 "WEIGHT" 52 "WET" 53 "WITHIN" 54 "ZONE" 55 "EXIT" 56 "ACCESS" 57 "ALLWAY" 58 "EXCEPTBUS" 59 "EXCEPTDELIVERY" 60 "EXCEPTLOCAL" 61 "FROG" 62 "PRIOTURNL" 63 "PRIOTURNR" 64 "START" 65 "STOPIN" 66 "HAZWATER" 67 "DAY" 68 "SL" ;
VAL_ 250 VFC_TS12_AddTS2Quality 0 "Poor Quality" 1 "Good Quality" ;
VAL_ 250 VFC_TS12_AddTS2VMS 0 "Fixed" 1 "Variable" ;
VAL_ 250 VFC_TS12_AddTS3Class 0 "UNKNOWN" 1 "DETECTED" 2 "ACCIDENT" 3 "ADVICE" 4 "BEGINS" 5 "BUS" 6 "CAMPER" 7 "CAR" 8 "CARAVAN" 9 "CRASHRISK" 10 "DIRT" 11 "DISTANCE" 12 "DISTANCEBARS" 13 "END" 14 "EXITL" 15 "EXITR" 16 "FOG" 17 "GRAVEL" 18 "HAZMAT" 19 "HUMP" 20 "JAM" 21 "LORRY" 22 "EXCEPTLORRY" 23 "LOWTREE" 24 "MCYCLE" 25 "MINIMUM" 26 "NIGHT" 27 "NOSTOPSHOULDER" 28 "OILTRAIL" 29 "PRIOTURN" 30 "RADAR" 31 "RAIN" 32 "RAINSNOW" 33 "REMINDER" 34 "ROADDAMAGE" 35 "RUTS" 36 "RWORKSACCESS" 37 "RWORKSENTRY" 38 "RWORKSEXIT" 39 "SCHOOL" 40 "SECTION" 41 "SMOKE" 42 "SNOW" 43 "SOFTSHOULDERCAR" 44 "SHOFTSHOULDERLORRY" 45 "TEXT" 46 "TIME" 47 "TOWING" 48 "TRACTOR" 49 "TRACTOR_OVER" 50 "TRAILER" 51 "WEIGHT" 52 "WET" 53 "WITHIN" 54 "ZONE" 55 "EXIT" 56 "ACCESS" 57 "ALLWAY" 58 "EXCEPTBUS" 59 "EXCEPTDELIVERY" 60 "EXCEPTLOCAL" 61 "FROG" 62 "PRIOTURNL" 63 "PRIOTURNR" 64 "START" 65 "STOPIN" 66 "HAZWATER" 67 "DAY" 68 "SL" ;
VAL_ 250 VFC_TS12_AddTS3Quality 0 "Poor Quality" 1 "Good Quality" ;
VAL_ 250 VFC_TS12_AddTS3VMS 0 "Fixed" 1 "Variable" ;
VAL_ 250 VFC_TS12_AddTS4Class 0 "UNKNOWN" 1 "DETECTED" 2 "ACCIDENT" 3 "ADVICE" 4 "BEGINS" 5 "BUS" 6 "CAMPER" 7 "CAR" 8 "CARAVAN" 9 "CRASHRISK" 10 "DIRT" 11 "DISTANCE" 12 "DISTANCEBARS" 13 "END" 14 "EXITL" 15 "EXITR" 16 "FOG" 17 "GRAVEL" 18 "HAZMAT" 19 "HUMP" 20 "JAM" 21 "LORRY" 22 "EXCEPTLORRY" 23 "LOWTREE" 24 "MCYCLE" 25 "MINIMUM" 26 "NIGHT" 27 "NOSTOPSHOULDER" 28 "OILTRAIL" 29 "PRIOTURN" 30 "RADAR" 31 "RAIN" 32 "RAINSNOW" 33 "REMINDER" 34 "ROADDAMAGE" 35 "RUTS" 36 "RWORKSACCESS" 37 "RWORKSENTRY" 38 "RWORKSEXIT" 39 "SCHOOL" 40 "SECTION" 41 "SMOKE" 42 "SNOW" 43 "SOFTSHOULDERCAR" 44 "SHOFTSHOULDERLORRY" 45 "TEXT" 46 "TIME" 47 "TOWING" 48 "TRACTOR" 49 "TRACTOR_OVER" 50 "TRAILER" 51 "WEIGHT" 52 "WET" 53 "WITHIN" 54 "ZONE" 55 "EXIT" 56 "ACCESS" 57 "ALLWAY" 58 "EXCEPTBUS" 59 "EXCEPTDELIVERY" 60 "EXCEPTLOCAL" 61 "FROG" 62 "PRIOTURNL" 63 "PRIOTURNR" 64 "START" 65 "STOPIN" 66 "HAZWATER" 67 "DAY" 68 "SL" ;
VAL_ 250 VFC_TS12_AddTS4Quality 0 "Poor Quality" 1 "Good Quality" ;
VAL_ 250 VFC_TS12_AddTS4VMS 0 "Fixed" 1 "Variable" ;
VAL_ 250 VFC_TS12_AddTS5Class 0 "UNKNOWN" 1 "DETECTED" 2 "ACCIDENT" 3 "ADVICE" 4 "BEGINS" 5 "BUS" 6 "CAMPER" 7 "CAR" 8 "CARAVAN" 9 "CRASHRISK" 10 "DIRT" 11 "DISTANCE" 12 "DISTANCEBARS" 13 "END" 14 "EXITL" 15 "EXITR" 16 "FOG" 17 "GRAVEL" 18 "HAZMAT" 19 "HUMP" 20 "JAM" 21 "LORRY" 22 "EXCEPTLORRY" 23 "LOWTREE" 24 "MCYCLE" 25 "MINIMUM" 26 "NIGHT" 27 "NOSTOPSHOULDER" 28 "OILTRAIL" 29 "PRIOTURN" 30 "RADAR" 31 "RAIN" 32 "RAINSNOW" 33 "REMINDER" 34 "ROADDAMAGE" 35 "RUTS" 36 "RWORKSACCESS" 37 "RWORKSENTRY" 38 "RWORKSEXIT" 39 "SCHOOL" 40 "SECTION" 41 "SMOKE" 42 "SNOW" 43 "SOFTSHOULDERCAR" 44 "SHOFTSHOULDERLORRY" 45 "TEXT" 46 "TIME" 47 "TOWING" 48 "TRACTOR" 49 "TRACTOR_OVER" 50 "TRAILER" 51 "WEIGHT" 52 "WET" 53 "WITHIN" 54 "ZONE" 55 "EXIT" 56 "ACCESS" 57 "ALLWAY" 58 "EXCEPTBUS" 59 "EXCEPTDELIVERY" 60 "EXCEPTLOCAL" 61 "FROG" 62 "PRIOTURNL" 63 "PRIOTURNR" 64 "START" 65 "STOPIN" 66 "HAZWATER" 67 "DAY" 68 "SL" ;
VAL_ 250 VFC_TS12_AddTS5Quality 0 "Poor Quality" 1 "Good Quality" ;
VAL_ 250 VFC_TS12_AddTS5VMS 0 "Fixed" 1 "Variable" ;
VAL_ 250 VFC_TS12_AddTS6Class 0 "UNKNOWN" 1 "DETECTED" 2 "ACCIDENT" 3 "ADVICE" 4 "BEGINS" 5 "BUS" 6 "CAMPER" 7 "CAR" 8 "CARAVAN" 9 "CRASHRISK" 10 "DIRT" 11 "DISTANCE" 12 "DISTANCEBARS" 13 "END" 14 "EXITL" 15 "EXITR" 16 "FOG" 17 "GRAVEL" 18 "HAZMAT" 19 "HUMP" 20 "JAM" 21 "LORRY" 22 "EXCEPTLORRY" 23 "LOWTREE" 24 "MCYCLE" 25 "MINIMUM" 26 "NIGHT" 27 "NOSTOPSHOULDER" 28 "OILTRAIL" 29 "PRIOTURN" 30 "RADAR" 31 "RAIN" 32 "RAINSNOW" 33 "REMINDER" 34 "ROADDAMAGE" 35 "RUTS" 36 "RWORKSACCESS" 37 "RWORKSENTRY" 38 "RWORKSEXIT" 39 "SCHOOL" 40 "SECTION" 41 "SMOKE" 42 "SNOW" 43 "SOFTSHOULDERCAR" 44 "SHOFTSHOULDERLORRY" 45 "TEXT" 46 "TIME" 47 "TOWING" 48 "TRACTOR" 49 "TRACTOR_OVER" 50 "TRAILER" 51 "WEIGHT" 52 "WET" 53 "WITHIN" 54 "ZONE" 55 "EXIT" 56 "ACCESS" 57 "ALLWAY" 58 "EXCEPTBUS" 59 "EXCEPTDELIVERY" 60 "EXCEPTLOCAL" 61 "FROG" 62 "PRIOTURNL" 63 "PRIOTURNR" 64 "START" 65 "STOPIN" 66 "HAZWATER" 67 "DAY" 68 "SL" ;
VAL_ 250 VFC_TS12_AddTS6Quality 0 "Poor Quality" 1 "Good Quality" ;
VAL_ 250 VFC_TS12_AddTS6VMS 0 "Fixed" 1 "Variable" ;
VAL_ 251 VFC_TS13_ID 0 "INVALID" ;
VAL_ 251 VFC_TS13_Class 0 "UNKNOWN" 1 "SL5" 2 "SL10" 3 "SL15" 4 "SL20" 5 "SL25" 6 "SL30" 7 "SL35" 8 "SL40" 9 "SL45" 10 "SL50" 11 "SL55" 12 "SL60" 13 "SL65" 14 "SL70" 15 "SL75" 16 "SL80" 17 "SL85" 18 "SL90" 19 "SL95" 20 "SL100" 21 "SL105" 22 "SL110" 23 "SL115" 24 "SL120" 25 "SL125" 26 "SL130" 27 "SL135" 28 "SL140" 29 "SL145" 30 "SL150" 31 "SL155" 32 "SL160" 33 "ESL" 34 "EA" 35 "OP" 36 "EOP" 37 "OL" 38 "EOL" 39 "GIVEWAY" 40 "PRIOCROSS" 41 "PRIOCROSSYIELDTORIGHT" 42 "PRIOSTREET" 43 "EPRIOSTREET" 44 "STOP" 45 "AXLEWEIGHT" 46 "CARDIST" 47 "HEIGHT" 48 "LENGTH" 49 "LORRYDIST" 50 "NOALL" 51 "NOBIKE" 52 "NOBUS" 53 "NOCAR" 54 "NOCARBIKE" 55 "NOCARRIAGE" 56 "NOENTRY" 57 "NOHAZMAT" 58 "NOHAZWATER" 59 "NOLORRY" 60 "NOLORRYTRAILER" 61 "NOLTURN" 62 "NOPED" 63 "NORIDER" 64 "NORTURN" 65 "NOTRACTOR" 66 "NOTWOWAY" 67 "NOUTURN" 68 "UMWELT" 69 "EUMWELT" 70 "WEIGHT" 71 "WIDTH" 72 "WARNBIKE" 73 "WARNBUS" 74 "WARNCATTLE" 75 "WARNCONST" 76 "WARNCONSTL" 77 "WARNCONSTR" 78 "WARNCURVEL" 79 "WARNCURVER" 80 "WARNDANGER" 81 "WARNDCURVEL" 82 "WARNDCURVER" 83 "WARNDRAWBRIDGE" 84 "WARNFROG" 85 "WARNGRAVEL" 86 "WARNHUMP" 87 "WARNJAM" 88 "WARNKIDS" 89 "WARNLIGHTS" 90 "WARNLOWTREE" 91 "WARNPCROSS" 92 "WARNPED" 93 "WARNPIER" 94 "WARNPLANE" 95 "WARNRIDER" 96 "WARNROCK" 97 "WARNROUND" 98 "WARNRWORKS" 99 "WARNSKID" 100 "WARNSLOPED" 101 "WARNSLOPEU" 102 "WARNSNOW" 103 "WARNTRAIN" 104 "WARNTWOWAY" 105 "WARNWILDANIMAL" 106 "WARNWIND" 107 "ASL" 108 "EASL" 109 "CALM" 110 "ECALM" 111 "DEADEND" 112 "DOUANE" 113 "FWAY" 114 "EFWAY" 115 "HWAY" 116 "EHWAY" 117 "MSL" 118 "EMSL" 119 "NOPARK" 120 "NOSTOP" 121 "ONEWAYS" 122 "ONEWAYU" 123 "SLOWDOWN" 124 "SCHOOL" 125 "ESCHOOL" 126 "TWN" 127 "ETWN" 128 "WBBENTLEFT" 129 "WBBENTLEFTRIGHT" 130 "WBBENTRIGHT" 131 "WBDIAGL" 132 "WBDIAGLR" 133 "WBDIAGR" 134 "WBHAZWATER" 135 "WBLEFT" 136 "WBRIGHT" 137 "WBROUND" 138 "WBUP" 139 "WBUPLEFT" 140 "WBUPRIGHT" 141 "ZEBRA" 142 "HAZMAT" 143 "EMERGENCYBAY" 144 "ENDOFLANEL" 145 "ENDOFLANER" 146 "ENOPARK" 147 "EONEWAY" 148 "EPARK" 149 "ETOLL" 150 "NOPARKL" 151 "NOPARKLR" 152 "NOPARKR" 153 "NOSTOPL" 154 "NOSTOPLR" 155 "NOSTOPR" 156 "NOTURNONRED" 157 "ONEWAYL" 158 "ONEWAYR" 159 "PARK" 160 "PRIOCROSSL" 161 "PRIOCROSSR" 162 "TOLL" 163 "TUNNEL" 164 "TWOWAY" 165 "WARNCROSS" 166 "WARNCROSSL" 167 "WARNCROSSLR" 168 "WARNCROSSR" 169 "WARNCROSSRL" 170 "WARNCROSST" 171 "WARNGIVEWAYAHEAD" 172 "WARNSLAHEAD" 173 "WARNSTOPAHEAD" 174 "WBBUS" 175 "WRONGWAY" 176 "HAZWATER" 177 "GIVEWAYROUND" 178 "WARNWINDINGL" 179 "WARNWINDINGR" 180 "WARNHAIRPINL" 181 "WARNHAIRPINR" 182 "WARNPEDBIKE" 183 "WARNCROSSY" 184 "WARNBRANCHL" 185 "WARNBRANCHR" 186 "WARNAXLEWEIGHT" 187 "WARNWEIGHT" 188 "WARNHEIGHT" 189 "WARNLENGTH" 190 "WARNWIDTH" 191 "WARNBLACKSPOT" 192 "WARNMERGEL" 193 "WARNMERGER" 194 "WARNTUNNEL" 195 "WARNTRACTOR" 196 "WARNRWORKSVEHICLE" 197 "WARNNARROWBRIDGE" 198 "WARNFLAGGER" 199 "LANES" 200 "LANESHIFTL" 201 "LANESHIFTR" 202 "NEWLANEL" 203 "NEWLANER" 204 "RIGHTTURNONRED" 205 "BORDERLIMIT" 206 "EMBEDDEDRAIN" ;
VAL_ 251 VFC_TS13_EmbedFlag 0 "Unknown" 1 "Not Embedded" 2 "Border Limit" 3 "Multi Lane" 4 "Rain" 5 "Vehicle Type" 6 "Plate" 7 "Error Value" ;
VAL_ 251 VFC_TS13_Quality 0 "Poor Quality" 1 "Good Quality" ;
VAL_ 251 VFC_TS13_VMS 0 "Fixed" 1 "Variable" ;
VAL_ 251 VFC_TS13_Stable 0 "Object Is Not Stable" 1 "Object Is Stable" ;
VAL_ 251 VFC_TS13_VehicleSticker 0 "not_sticker_on_vehicle" 1 "Sign is a sticker on a vehicle" ;
VAL_ 251 VFC_TS13_InternalTrack 0 "Sign is not an internal track" 1 "Sign is an internal track" ;
VAL_ 251 VFC_TS13_AddTS1Class 0 "UNKNOWN" 1 "DETECTED" 2 "ACCIDENT" 3 "ADVICE" 4 "BEGINS" 5 "BUS" 6 "CAMPER" 7 "CAR" 8 "CARAVAN" 9 "CRASHRISK" 10 "DIRT" 11 "DISTANCE" 12 "DISTANCEBARS" 13 "END" 14 "EXITL" 15 "EXITR" 16 "FOG" 17 "GRAVEL" 18 "HAZMAT" 19 "HUMP" 20 "JAM" 21 "LORRY" 22 "EXCEPTLORRY" 23 "LOWTREE" 24 "MCYCLE" 25 "MINIMUM" 26 "NIGHT" 27 "NOSTOPSHOULDER" 28 "OILTRAIL" 29 "PRIOTURN" 30 "RADAR" 31 "RAIN" 32 "RAINSNOW" 33 "REMINDER" 34 "ROADDAMAGE" 35 "RUTS" 36 "RWORKSACCESS" 37 "RWORKSENTRY" 38 "RWORKSEXIT" 39 "SCHOOL" 40 "SECTION" 41 "SMOKE" 42 "SNOW" 43 "SOFTSHOULDERCAR" 44 "SHOFTSHOULDERLORRY" 45 "TEXT" 46 "TIME" 47 "TOWING" 48 "TRACTOR" 49 "TRACTOR_OVER" 50 "TRAILER" 51 "WEIGHT" 52 "WET" 53 "WITHIN" 54 "ZONE" 55 "EXIT" 56 "ACCESS" 57 "ALLWAY" 58 "EXCEPTBUS" 59 "EXCEPTDELIVERY" 60 "EXCEPTLOCAL" 61 "FROG" 62 "PRIOTURNL" 63 "PRIOTURNR" 64 "START" 65 "STOPIN" 66 "HAZWATER" 67 "DAY" 68 "SL" ;
VAL_ 251 VFC_TS13_AddTS1Quality 0 "Poor Quality" 1 "Good Quality" ;
VAL_ 251 VFC_TS13_AddTS1VMS 0 "Fixed" 1 "Variable" ;
VAL_ 251 VFC_TS13_AddTS2Class 0 "UNKNOWN" 1 "DETECTED" 2 "ACCIDENT" 3 "ADVICE" 4 "BEGINS" 5 "BUS" 6 "CAMPER" 7 "CAR" 8 "CARAVAN" 9 "CRASHRISK" 10 "DIRT" 11 "DISTANCE" 12 "DISTANCEBARS" 13 "END" 14 "EXITL" 15 "EXITR" 16 "FOG" 17 "GRAVEL" 18 "HAZMAT" 19 "HUMP" 20 "JAM" 21 "LORRY" 22 "EXCEPTLORRY" 23 "LOWTREE" 24 "MCYCLE" 25 "MINIMUM" 26 "NIGHT" 27 "NOSTOPSHOULDER" 28 "OILTRAIL" 29 "PRIOTURN" 30 "RADAR" 31 "RAIN" 32 "RAINSNOW" 33 "REMINDER" 34 "ROADDAMAGE" 35 "RUTS" 36 "RWORKSACCESS" 37 "RWORKSENTRY" 38 "RWORKSEXIT" 39 "SCHOOL" 40 "SECTION" 41 "SMOKE" 42 "SNOW" 43 "SOFTSHOULDERCAR" 44 "SHOFTSHOULDERLORRY" 45 "TEXT" 46 "TIME" 47 "TOWING" 48 "TRACTOR" 49 "TRACTOR_OVER" 50 "TRAILER" 51 "WEIGHT" 52 "WET" 53 "WITHIN" 54 "ZONE" 55 "EXIT" 56 "ACCESS" 57 "ALLWAY" 58 "EXCEPTBUS" 59 "EXCEPTDELIVERY" 60 "EXCEPTLOCAL" 61 "FROG" 62 "PRIOTURNL" 63 "PRIOTURNR" 64 "START" 65 "STOPIN" 66 "HAZWATER" 67 "DAY" 68 "SL" ;
VAL_ 251 VFC_TS13_AddTS2Quality 0 "Poor Quality" 1 "Good Quality" ;
VAL_ 251 VFC_TS13_AddTS2VMS 0 "Fixed" 1 "Variable" ;
VAL_ 251 VFC_TS13_AddTS3Class 0 "UNKNOWN" 1 "DETECTED" 2 "ACCIDENT" 3 "ADVICE" 4 "BEGINS" 5 "BUS" 6 "CAMPER" 7 "CAR" 8 "CARAVAN" 9 "CRASHRISK" 10 "DIRT" 11 "DISTANCE" 12 "DISTANCEBARS" 13 "END" 14 "EXITL" 15 "EXITR" 16 "FOG" 17 "GRAVEL" 18 "HAZMAT" 19 "HUMP" 20 "JAM" 21 "LORRY" 22 "EXCEPTLORRY" 23 "LOWTREE" 24 "MCYCLE" 25 "MINIMUM" 26 "NIGHT" 27 "NOSTOPSHOULDER" 28 "OILTRAIL" 29 "PRIOTURN" 30 "RADAR" 31 "RAIN" 32 "RAINSNOW" 33 "REMINDER" 34 "ROADDAMAGE" 35 "RUTS" 36 "RWORKSACCESS" 37 "RWORKSENTRY" 38 "RWORKSEXIT" 39 "SCHOOL" 40 "SECTION" 41 "SMOKE" 42 "SNOW" 43 "SOFTSHOULDERCAR" 44 "SHOFTSHOULDERLORRY" 45 "TEXT" 46 "TIME" 47 "TOWING" 48 "TRACTOR" 49 "TRACTOR_OVER" 50 "TRAILER" 51 "WEIGHT" 52 "WET" 53 "WITHIN" 54 "ZONE" 55 "EXIT" 56 "ACCESS" 57 "ALLWAY" 58 "EXCEPTBUS" 59 "EXCEPTDELIVERY" 60 "EXCEPTLOCAL" 61 "FROG" 62 "PRIOTURNL" 63 "PRIOTURNR" 64 "START" 65 "STOPIN" 66 "HAZWATER" 67 "DAY" 68 "SL" ;
VAL_ 251 VFC_TS13_AddTS3Quality 0 "Poor Quality" 1 "Good Quality" ;
VAL_ 251 VFC_TS13_AddTS3VMS 0 "Fixed" 1 "Variable" ;
VAL_ 251 VFC_TS13_AddTS4Class 0 "UNKNOWN" 1 "DETECTED" 2 "ACCIDENT" 3 "ADVICE" 4 "BEGINS" 5 "BUS" 6 "CAMPER" 7 "CAR" 8 "CARAVAN" 9 "CRASHRISK" 10 "DIRT" 11 "DISTANCE" 12 "DISTANCEBARS" 13 "END" 14 "EXITL" 15 "EXITR" 16 "FOG" 17 "GRAVEL" 18 "HAZMAT" 19 "HUMP" 20 "JAM" 21 "LORRY" 22 "EXCEPTLORRY" 23 "LOWTREE" 24 "MCYCLE" 25 "MINIMUM" 26 "NIGHT" 27 "NOSTOPSHOULDER" 28 "OILTRAIL" 29 "PRIOTURN" 30 "RADAR" 31 "RAIN" 32 "RAINSNOW" 33 "REMINDER" 34 "ROADDAMAGE" 35 "RUTS" 36 "RWORKSACCESS" 37 "RWORKSENTRY" 38 "RWORKSEXIT" 39 "SCHOOL" 40 "SECTION" 41 "SMOKE" 42 "SNOW" 43 "SOFTSHOULDERCAR" 44 "SHOFTSHOULDERLORRY" 45 "TEXT" 46 "TIME" 47 "TOWING" 48 "TRACTOR" 49 "TRACTOR_OVER" 50 "TRAILER" 51 "WEIGHT" 52 "WET" 53 "WITHIN" 54 "ZONE" 55 "EXIT" 56 "ACCESS" 57 "ALLWAY" 58 "EXCEPTBUS" 59 "EXCEPTDELIVERY" 60 "EXCEPTLOCAL" 61 "FROG" 62 "PRIOTURNL" 63 "PRIOTURNR" 64 "START" 65 "STOPIN" 66 "HAZWATER" 67 "DAY" 68 "SL" ;
VAL_ 251 VFC_TS13_AddTS4Quality 0 "Poor Quality" 1 "Good Quality" ;
VAL_ 251 VFC_TS13_AddTS4VMS 0 "Fixed" 1 "Variable" ;
VAL_ 251 VFC_TS13_AddTS5Class 0 "UNKNOWN" 1 "DETECTED" 2 "ACCIDENT" 3 "ADVICE" 4 "BEGINS" 5 "BUS" 6 "CAMPER" 7 "CAR" 8 "CARAVAN" 9 "CRASHRISK" 10 "DIRT" 11 "DISTANCE" 12 "DISTANCEBARS" 13 "END" 14 "EXITL" 15 "EXITR" 16 "FOG" 17 "GRAVEL" 18 "HAZMAT" 19 "HUMP" 20 "JAM" 21 "LORRY" 22 "EXCEPTLORRY" 23 "LOWTREE" 24 "MCYCLE" 25 "MINIMUM" 26 "NIGHT" 27 "NOSTOPSHOULDER" 28 "OILTRAIL" 29 "PRIOTURN" 30 "RADAR" 31 "RAIN" 32 "RAINSNOW" 33 "REMINDER" 34 "ROADDAMAGE" 35 "RUTS" 36 "RWORKSACCESS" 37 "RWORKSENTRY" 38 "RWORKSEXIT" 39 "SCHOOL" 40 "SECTION" 41 "SMOKE" 42 "SNOW" 43 "SOFTSHOULDERCAR" 44 "SHOFTSHOULDERLORRY" 45 "TEXT" 46 "TIME" 47 "TOWING" 48 "TRACTOR" 49 "TRACTOR_OVER" 50 "TRAILER" 51 "WEIGHT" 52 "WET" 53 "WITHIN" 54 "ZONE" 55 "EXIT" 56 "ACCESS" 57 "ALLWAY" 58 "EXCEPTBUS" 59 "EXCEPTDELIVERY" 60 "EXCEPTLOCAL" 61 "FROG" 62 "PRIOTURNL" 63 "PRIOTURNR" 64 "START" 65 "STOPIN" 66 "HAZWATER" 67 "DAY" 68 "SL" ;
VAL_ 251 VFC_TS13_AddTS5Quality 0 "Poor Quality" 1 "Good Quality" ;
VAL_ 251 VFC_TS13_AddTS5VMS 0 "Fixed" 1 "Variable" ;
VAL_ 251 VFC_TS13_AddTS6Class 0 "UNKNOWN" 1 "DETECTED" 2 "ACCIDENT" 3 "ADVICE" 4 "BEGINS" 5 "BUS" 6 "CAMPER" 7 "CAR" 8 "CARAVAN" 9 "CRASHRISK" 10 "DIRT" 11 "DISTANCE" 12 "DISTANCEBARS" 13 "END" 14 "EXITL" 15 "EXITR" 16 "FOG" 17 "GRAVEL" 18 "HAZMAT" 19 "HUMP" 20 "JAM" 21 "LORRY" 22 "EXCEPTLORRY" 23 "LOWTREE" 24 "MCYCLE" 25 "MINIMUM" 26 "NIGHT" 27 "NOSTOPSHOULDER" 28 "OILTRAIL" 29 "PRIOTURN" 30 "RADAR" 31 "RAIN" 32 "RAINSNOW" 33 "REMINDER" 34 "ROADDAMAGE" 35 "RUTS" 36 "RWORKSACCESS" 37 "RWORKSENTRY" 38 "RWORKSEXIT" 39 "SCHOOL" 40 "SECTION" 41 "SMOKE" 42 "SNOW" 43 "SOFTSHOULDERCAR" 44 "SHOFTSHOULDERLORRY" 45 "TEXT" 46 "TIME" 47 "TOWING" 48 "TRACTOR" 49 "TRACTOR_OVER" 50 "TRAILER" 51 "WEIGHT" 52 "WET" 53 "WITHIN" 54 "ZONE" 55 "EXIT" 56 "ACCESS" 57 "ALLWAY" 58 "EXCEPTBUS" 59 "EXCEPTDELIVERY" 60 "EXCEPTLOCAL" 61 "FROG" 62 "PRIOTURNL" 63 "PRIOTURNR" 64 "START" 65 "STOPIN" 66 "HAZWATER" 67 "DAY" 68 "SL" ;
VAL_ 251 VFC_TS13_AddTS6Quality 0 "Poor Quality" 1 "Good Quality" ;
VAL_ 251 VFC_TS13_AddTS6VMS 0 "Fixed" 1 "Variable" ;
VAL_ 252 VFC_TS14_ID 0 "INVALID" ;
VAL_ 252 VFC_TS14_Class 0 "UNKNOWN" 1 "SL5" 2 "SL10" 3 "SL15" 4 "SL20" 5 "SL25" 6 "SL30" 7 "SL35" 8 "SL40" 9 "SL45" 10 "SL50" 11 "SL55" 12 "SL60" 13 "SL65" 14 "SL70" 15 "SL75" 16 "SL80" 17 "SL85" 18 "SL90" 19 "SL95" 20 "SL100" 21 "SL105" 22 "SL110" 23 "SL115" 24 "SL120" 25 "SL125" 26 "SL130" 27 "SL135" 28 "SL140" 29 "SL145" 30 "SL150" 31 "SL155" 32 "SL160" 33 "ESL" 34 "EA" 35 "OP" 36 "EOP" 37 "OL" 38 "EOL" 39 "GIVEWAY" 40 "PRIOCROSS" 41 "PRIOCROSSYIELDTORIGHT" 42 "PRIOSTREET" 43 "EPRIOSTREET" 44 "STOP" 45 "AXLEWEIGHT" 46 "CARDIST" 47 "HEIGHT" 48 "LENGTH" 49 "LORRYDIST" 50 "NOALL" 51 "NOBIKE" 52 "NOBUS" 53 "NOCAR" 54 "NOCARBIKE" 55 "NOCARRIAGE" 56 "NOENTRY" 57 "NOHAZMAT" 58 "NOHAZWATER" 59 "NOLORRY" 60 "NOLORRYTRAILER" 61 "NOLTURN" 62 "NOPED" 63 "NORIDER" 64 "NORTURN" 65 "NOTRACTOR" 66 "NOTWOWAY" 67 "NOUTURN" 68 "UMWELT" 69 "EUMWELT" 70 "WEIGHT" 71 "WIDTH" 72 "WARNBIKE" 73 "WARNBUS" 74 "WARNCATTLE" 75 "WARNCONST" 76 "WARNCONSTL" 77 "WARNCONSTR" 78 "WARNCURVEL" 79 "WARNCURVER" 80 "WARNDANGER" 81 "WARNDCURVEL" 82 "WARNDCURVER" 83 "WARNDRAWBRIDGE" 84 "WARNFROG" 85 "WARNGRAVEL" 86 "WARNHUMP" 87 "WARNJAM" 88 "WARNKIDS" 89 "WARNLIGHTS" 90 "WARNLOWTREE" 91 "WARNPCROSS" 92 "WARNPED" 93 "WARNPIER" 94 "WARNPLANE" 95 "WARNRIDER" 96 "WARNROCK" 97 "WARNROUND" 98 "WARNRWORKS" 99 "WARNSKID" 100 "WARNSLOPED" 101 "WARNSLOPEU" 102 "WARNSNOW" 103 "WARNTRAIN" 104 "WARNTWOWAY" 105 "WARNWILDANIMAL" 106 "WARNWIND" 107 "ASL" 108 "EASL" 109 "CALM" 110 "ECALM" 111 "DEADEND" 112 "DOUANE" 113 "FWAY" 114 "EFWAY" 115 "HWAY" 116 "EHWAY" 117 "MSL" 118 "EMSL" 119 "NOPARK" 120 "NOSTOP" 121 "ONEWAYS" 122 "ONEWAYU" 123 "SLOWDOWN" 124 "SCHOOL" 125 "ESCHOOL" 126 "TWN" 127 "ETWN" 128 "WBBENTLEFT" 129 "WBBENTLEFTRIGHT" 130 "WBBENTRIGHT" 131 "WBDIAGL" 132 "WBDIAGLR" 133 "WBDIAGR" 134 "WBHAZWATER" 135 "WBLEFT" 136 "WBRIGHT" 137 "WBROUND" 138 "WBUP" 139 "WBUPLEFT" 140 "WBUPRIGHT" 141 "ZEBRA" 142 "HAZMAT" 143 "EMERGENCYBAY" 144 "ENDOFLANEL" 145 "ENDOFLANER" 146 "ENOPARK" 147 "EONEWAY" 148 "EPARK" 149 "ETOLL" 150 "NOPARKL" 151 "NOPARKLR" 152 "NOPARKR" 153 "NOSTOPL" 154 "NOSTOPLR" 155 "NOSTOPR" 156 "NOTURNONRED" 157 "ONEWAYL" 158 "ONEWAYR" 159 "PARK" 160 "PRIOCROSSL" 161 "PRIOCROSSR" 162 "TOLL" 163 "TUNNEL" 164 "TWOWAY" 165 "WARNCROSS" 166 "WARNCROSSL" 167 "WARNCROSSLR" 168 "WARNCROSSR" 169 "WARNCROSSRL" 170 "WARNCROSST" 171 "WARNGIVEWAYAHEAD" 172 "WARNSLAHEAD" 173 "WARNSTOPAHEAD" 174 "WBBUS" 175 "WRONGWAY" 176 "HAZWATER" 177 "GIVEWAYROUND" 178 "WARNWINDINGL" 179 "WARNWINDINGR" 180 "WARNHAIRPINL" 181 "WARNHAIRPINR" 182 "WARNPEDBIKE" 183 "WARNCROSSY" 184 "WARNBRANCHL" 185 "WARNBRANCHR" 186 "WARNAXLEWEIGHT" 187 "WARNWEIGHT" 188 "WARNHEIGHT" 189 "WARNLENGTH" 190 "WARNWIDTH" 191 "WARNBLACKSPOT" 192 "WARNMERGEL" 193 "WARNMERGER" 194 "WARNTUNNEL" 195 "WARNTRACTOR" 196 "WARNRWORKSVEHICLE" 197 "WARNNARROWBRIDGE" 198 "WARNFLAGGER" 199 "LANES" 200 "LANESHIFTL" 201 "LANESHIFTR" 202 "NEWLANEL" 203 "NEWLANER" 204 "RIGHTTURNONRED" 205 "BORDERLIMIT" 206 "EMBEDDEDRAIN" ;
VAL_ 252 VFC_TS14_EmbedFlag 0 "Unknown" 1 "Not Embedded" 2 "Border Limit" 3 "Multi Lane" 4 "Rain" 5 "Vehicle Type" 6 "Plate" 7 "Error Value" ;
VAL_ 252 VFC_TS14_Quality 0 "Poor Quality" 1 "Good Quality" ;
VAL_ 252 VFC_TS14_VMS 0 "Fixed" 1 "Variable" ;
VAL_ 252 VFC_TS14_Stable 0 "Object Is Not Stable" 1 "Object Is Stable" ;
VAL_ 252 VFC_TS14_VehicleSticker 0 "not_sticker_on_vehicle" 1 "Sign is a sticker on a vehicle" ;
VAL_ 252 VFC_TS14_InternalTrack 0 "Sign is not an internal track" 1 "Sign is an internal track" ;
VAL_ 252 VFC_TS14_AddTS1Class 0 "UNKNOWN" 1 "DETECTED" 2 "ACCIDENT" 3 "ADVICE" 4 "BEGINS" 5 "BUS" 6 "CAMPER" 7 "CAR" 8 "CARAVAN" 9 "CRASHRISK" 10 "DIRT" 11 "DISTANCE" 12 "DISTANCEBARS" 13 "END" 14 "EXITL" 15 "EXITR" 16 "FOG" 17 "GRAVEL" 18 "HAZMAT" 19 "HUMP" 20 "JAM" 21 "LORRY" 22 "EXCEPTLORRY" 23 "LOWTREE" 24 "MCYCLE" 25 "MINIMUM" 26 "NIGHT" 27 "NOSTOPSHOULDER" 28 "OILTRAIL" 29 "PRIOTURN" 30 "RADAR" 31 "RAIN" 32 "RAINSNOW" 33 "REMINDER" 34 "ROADDAMAGE" 35 "RUTS" 36 "RWORKSACCESS" 37 "RWORKSENTRY" 38 "RWORKSEXIT" 39 "SCHOOL" 40 "SECTION" 41 "SMOKE" 42 "SNOW" 43 "SOFTSHOULDERCAR" 44 "SHOFTSHOULDERLORRY" 45 "TEXT" 46 "TIME" 47 "TOWING" 48 "TRACTOR" 49 "TRACTOR_OVER" 50 "TRAILER" 51 "WEIGHT" 52 "WET" 53 "WITHIN" 54 "ZONE" 55 "EXIT" 56 "ACCESS" 57 "ALLWAY" 58 "EXCEPTBUS" 59 "EXCEPTDELIVERY" 60 "EXCEPTLOCAL" 61 "FROG" 62 "PRIOTURNL" 63 "PRIOTURNR" 64 "START" 65 "STOPIN" 66 "HAZWATER" 67 "DAY" 68 "SL" ;
VAL_ 252 VFC_TS14_AddTS1Quality 0 "Poor Quality" 1 "Good Quality" ;
VAL_ 252 VFC_TS14_AddTS1VMS 0 "Fixed" 1 "Variable" ;
VAL_ 252 VFC_TS14_AddTS2Class 0 "UNKNOWN" 1 "DETECTED" 2 "ACCIDENT" 3 "ADVICE" 4 "BEGINS" 5 "BUS" 6 "CAMPER" 7 "CAR" 8 "CARAVAN" 9 "CRASHRISK" 10 "DIRT" 11 "DISTANCE" 12 "DISTANCEBARS" 13 "END" 14 "EXITL" 15 "EXITR" 16 "FOG" 17 "GRAVEL" 18 "HAZMAT" 19 "HUMP" 20 "JAM" 21 "LORRY" 22 "EXCEPTLORRY" 23 "LOWTREE" 24 "MCYCLE" 25 "MINIMUM" 26 "NIGHT" 27 "NOSTOPSHOULDER" 28 "OILTRAIL" 29 "PRIOTURN" 30 "RADAR" 31 "RAIN" 32 "RAINSNOW" 33 "REMINDER" 34 "ROADDAMAGE" 35 "RUTS" 36 "RWORKSACCESS" 37 "RWORKSENTRY" 38 "RWORKSEXIT" 39 "SCHOOL" 40 "SECTION" 41 "SMOKE" 42 "SNOW" 43 "SOFTSHOULDERCAR" 44 "SHOFTSHOULDERLORRY" 45 "TEXT" 46 "TIME" 47 "TOWING" 48 "TRACTOR" 49 "TRACTOR_OVER" 50 "TRAILER" 51 "WEIGHT" 52 "WET" 53 "WITHIN" 54 "ZONE" 55 "EXIT" 56 "ACCESS" 57 "ALLWAY" 58 "EXCEPTBUS" 59 "EXCEPTDELIVERY" 60 "EXCEPTLOCAL" 61 "FROG" 62 "PRIOTURNL" 63 "PRIOTURNR" 64 "START" 65 "STOPIN" 66 "HAZWATER" 67 "DAY" 68 "SL" ;
VAL_ 252 VFC_TS14_AddTS2Quality 0 "Poor Quality" 1 "Good Quality" ;
VAL_ 252 VFC_TS14_AddTS2VMS 0 "Fixed" 1 "Variable" ;
VAL_ 252 VFC_TS14_AddTS3Class 0 "UNKNOWN" 1 "DETECTED" 2 "ACCIDENT" 3 "ADVICE" 4 "BEGINS" 5 "BUS" 6 "CAMPER" 7 "CAR" 8 "CARAVAN" 9 "CRASHRISK" 10 "DIRT" 11 "DISTANCE" 12 "DISTANCEBARS" 13 "END" 14 "EXITL" 15 "EXITR" 16 "FOG" 17 "GRAVEL" 18 "HAZMAT" 19 "HUMP" 20 "JAM" 21 "LORRY" 22 "EXCEPTLORRY" 23 "LOWTREE" 24 "MCYCLE" 25 "MINIMUM" 26 "NIGHT" 27 "NOSTOPSHOULDER" 28 "OILTRAIL" 29 "PRIOTURN" 30 "RADAR" 31 "RAIN" 32 "RAINSNOW" 33 "REMINDER" 34 "ROADDAMAGE" 35 "RUTS" 36 "RWORKSACCESS" 37 "RWORKSENTRY" 38 "RWORKSEXIT" 39 "SCHOOL" 40 "SECTION" 41 "SMOKE" 42 "SNOW" 43 "SOFTSHOULDERCAR" 44 "SHOFTSHOULDERLORRY" 45 "TEXT" 46 "TIME" 47 "TOWING" 48 "TRACTOR" 49 "TRACTOR_OVER" 50 "TRAILER" 51 "WEIGHT" 52 "WET" 53 "WITHIN" 54 "ZONE" 55 "EXIT" 56 "ACCESS" 57 "ALLWAY" 58 "EXCEPTBUS" 59 "EXCEPTDELIVERY" 60 "EXCEPTLOCAL" 61 "FROG" 62 "PRIOTURNL" 63 "PRIOTURNR" 64 "START" 65 "STOPIN" 66 "HAZWATER" 67 "DAY" 68 "SL" ;
VAL_ 252 VFC_TS14_AddTS3Quality 0 "Poor Quality" 1 "Good Quality" ;
VAL_ 252 VFC_TS14_AddTS3VMS 0 "Fixed" 1 "Variable" ;
VAL_ 252 VFC_TS14_AddTS4Class 0 "UNKNOWN" 1 "DETECTED" 2 "ACCIDENT" 3 "ADVICE" 4 "BEGINS" 5 "BUS" 6 "CAMPER" 7 "CAR" 8 "CARAVAN" 9 "CRASHRISK" 10 "DIRT" 11 "DISTANCE" 12 "DISTANCEBARS" 13 "END" 14 "EXITL" 15 "EXITR" 16 "FOG" 17 "GRAVEL" 18 "HAZMAT" 19 "HUMP" 20 "JAM" 21 "LORRY" 22 "EXCEPTLORRY" 23 "LOWTREE" 24 "MCYCLE" 25 "MINIMUM" 26 "NIGHT" 27 "NOSTOPSHOULDER" 28 "OILTRAIL" 29 "PRIOTURN" 30 "RADAR" 31 "RAIN" 32 "RAINSNOW" 33 "REMINDER" 34 "ROADDAMAGE" 35 "RUTS" 36 "RWORKSACCESS" 37 "RWORKSENTRY" 38 "RWORKSEXIT" 39 "SCHOOL" 40 "SECTION" 41 "SMOKE" 42 "SNOW" 43 "SOFTSHOULDERCAR" 44 "SHOFTSHOULDERLORRY" 45 "TEXT" 46 "TIME" 47 "TOWING" 48 "TRACTOR" 49 "TRACTOR_OVER" 50 "TRAILER" 51 "WEIGHT" 52 "WET" 53 "WITHIN" 54 "ZONE" 55 "EXIT" 56 "ACCESS" 57 "ALLWAY" 58 "EXCEPTBUS" 59 "EXCEPTDELIVERY" 60 "EXCEPTLOCAL" 61 "FROG" 62 "PRIOTURNL" 63 "PRIOTURNR" 64 "START" 65 "STOPIN" 66 "HAZWATER" 67 "DAY" 68 "SL" ;
VAL_ 252 VFC_TS14_AddTS4Quality 0 "Poor Quality" 1 "Good Quality" ;
VAL_ 252 VFC_TS14_AddTS4VMS 0 "Fixed" 1 "Variable" ;
VAL_ 252 VFC_TS14_AddTS5Class 0 "UNKNOWN" 1 "DETECTED" 2 "ACCIDENT" 3 "ADVICE" 4 "BEGINS" 5 "BUS" 6 "CAMPER" 7 "CAR" 8 "CARAVAN" 9 "CRASHRISK" 10 "DIRT" 11 "DISTANCE" 12 "DISTANCEBARS" 13 "END" 14 "EXITL" 15 "EXITR" 16 "FOG" 17 "GRAVEL" 18 "HAZMAT" 19 "HUMP" 20 "JAM" 21 "LORRY" 22 "EXCEPTLORRY" 23 "LOWTREE" 24 "MCYCLE" 25 "MINIMUM" 26 "NIGHT" 27 "NOSTOPSHOULDER" 28 "OILTRAIL" 29 "PRIOTURN" 30 "RADAR" 31 "RAIN" 32 "RAINSNOW" 33 "REMINDER" 34 "ROADDAMAGE" 35 "RUTS" 36 "RWORKSACCESS" 37 "RWORKSENTRY" 38 "RWORKSEXIT" 39 "SCHOOL" 40 "SECTION" 41 "SMOKE" 42 "SNOW" 43 "SOFTSHOULDERCAR" 44 "SHOFTSHOULDERLORRY" 45 "TEXT" 46 "TIME" 47 "TOWING" 48 "TRACTOR" 49 "TRACTOR_OVER" 50 "TRAILER" 51 "WEIGHT" 52 "WET" 53 "WITHIN" 54 "ZONE" 55 "EXIT" 56 "ACCESS" 57 "ALLWAY" 58 "EXCEPTBUS" 59 "EXCEPTDELIVERY" 60 "EXCEPTLOCAL" 61 "FROG" 62 "PRIOTURNL" 63 "PRIOTURNR" 64 "START" 65 "STOPIN" 66 "HAZWATER" 67 "DAY" 68 "SL" ;
VAL_ 252 VFC_TS14_AddTS5Quality 0 "Poor Quality" 1 "Good Quality" ;
VAL_ 252 VFC_TS14_AddTS5VMS 0 "Fixed" 1 "Variable" ;
VAL_ 252 VFC_TS14_AddTS6Class 0 "UNKNOWN" 1 "DETECTED" 2 "ACCIDENT" 3 "ADVICE" 4 "BEGINS" 5 "BUS" 6 "CAMPER" 7 "CAR" 8 "CARAVAN" 9 "CRASHRISK" 10 "DIRT" 11 "DISTANCE" 12 "DISTANCEBARS" 13 "END" 14 "EXITL" 15 "EXITR" 16 "FOG" 17 "GRAVEL" 18 "HAZMAT" 19 "HUMP" 20 "JAM" 21 "LORRY" 22 "EXCEPTLORRY" 23 "LOWTREE" 24 "MCYCLE" 25 "MINIMUM" 26 "NIGHT" 27 "NOSTOPSHOULDER" 28 "OILTRAIL" 29 "PRIOTURN" 30 "RADAR" 31 "RAIN" 32 "RAINSNOW" 33 "REMINDER" 34 "ROADDAMAGE" 35 "RUTS" 36 "RWORKSACCESS" 37 "RWORKSENTRY" 38 "RWORKSEXIT" 39 "SCHOOL" 40 "SECTION" 41 "SMOKE" 42 "SNOW" 43 "SOFTSHOULDERCAR" 44 "SHOFTSHOULDERLORRY" 45 "TEXT" 46 "TIME" 47 "TOWING" 48 "TRACTOR" 49 "TRACTOR_OVER" 50 "TRAILER" 51 "WEIGHT" 52 "WET" 53 "WITHIN" 54 "ZONE" 55 "EXIT" 56 "ACCESS" 57 "ALLWAY" 58 "EXCEPTBUS" 59 "EXCEPTDELIVERY" 60 "EXCEPTLOCAL" 61 "FROG" 62 "PRIOTURNL" 63 "PRIOTURNR" 64 "START" 65 "STOPIN" 66 "HAZWATER" 67 "DAY" 68 "SL" ;
VAL_ 252 VFC_TS14_AddTS6Quality 0 "Poor Quality" 1 "Good Quality" ;
VAL_ 252 VFC_TS14_AddTS6VMS 0 "Fixed" 1 "Variable" ;
VAL_ 253 VFC_TS15_ID 0 "INVALID" ;
VAL_ 253 VFC_TS15_Class 0 "UNKNOWN" 1 "SL5" 2 "SL10" 3 "SL15" 4 "SL20" 5 "SL25" 6 "SL30" 7 "SL35" 8 "SL40" 9 "SL45" 10 "SL50" 11 "SL55" 12 "SL60" 13 "SL65" 14 "SL70" 15 "SL75" 16 "SL80" 17 "SL85" 18 "SL90" 19 "SL95" 20 "SL100" 21 "SL105" 22 "SL110" 23 "SL115" 24 "SL120" 25 "SL125" 26 "SL130" 27 "SL135" 28 "SL140" 29 "SL145" 30 "SL150" 31 "SL155" 32 "SL160" 33 "ESL" 34 "EA" 35 "OP" 36 "EOP" 37 "OL" 38 "EOL" 39 "GIVEWAY" 40 "PRIOCROSS" 41 "PRIOCROSSYIELDTORIGHT" 42 "PRIOSTREET" 43 "EPRIOSTREET" 44 "STOP" 45 "AXLEWEIGHT" 46 "CARDIST" 47 "HEIGHT" 48 "LENGTH" 49 "LORRYDIST" 50 "NOALL" 51 "NOBIKE" 52 "NOBUS" 53 "NOCAR" 54 "NOCARBIKE" 55 "NOCARRIAGE" 56 "NOENTRY" 57 "NOHAZMAT" 58 "NOHAZWATER" 59 "NOLORRY" 60 "NOLORRYTRAILER" 61 "NOLTURN" 62 "NOPED" 63 "NORIDER" 64 "NORTURN" 65 "NOTRACTOR" 66 "NOTWOWAY" 67 "NOUTURN" 68 "UMWELT" 69 "EUMWELT" 70 "WEIGHT" 71 "WIDTH" 72 "WARNBIKE" 73 "WARNBUS" 74 "WARNCATTLE" 75 "WARNCONST" 76 "WARNCONSTL" 77 "WARNCONSTR" 78 "WARNCURVEL" 79 "WARNCURVER" 80 "WARNDANGER" 81 "WARNDCURVEL" 82 "WARNDCURVER" 83 "WARNDRAWBRIDGE" 84 "WARNFROG" 85 "WARNGRAVEL" 86 "WARNHUMP" 87 "WARNJAM" 88 "WARNKIDS" 89 "WARNLIGHTS" 90 "WARNLOWTREE" 91 "WARNPCROSS" 92 "WARNPED" 93 "WARNPIER" 94 "WARNPLANE" 95 "WARNRIDER" 96 "WARNROCK" 97 "WARNROUND" 98 "WARNRWORKS" 99 "WARNSKID" 100 "WARNSLOPED" 101 "WARNSLOPEU" 102 "WARNSNOW" 103 "WARNTRAIN" 104 "WARNTWOWAY" 105 "WARNWILDANIMAL" 106 "WARNWIND" 107 "ASL" 108 "EASL" 109 "CALM" 110 "ECALM" 111 "DEADEND" 112 "DOUANE" 113 "FWAY" 114 "EFWAY" 115 "HWAY" 116 "EHWAY" 117 "MSL" 118 "EMSL" 119 "NOPARK" 120 "NOSTOP" 121 "ONEWAYS" 122 "ONEWAYU" 123 "SLOWDOWN" 124 "SCHOOL" 125 "ESCHOOL" 126 "TWN" 127 "ETWN" 128 "WBBENTLEFT" 129 "WBBENTLEFTRIGHT" 130 "WBBENTRIGHT" 131 "WBDIAGL" 132 "WBDIAGLR" 133 "WBDIAGR" 134 "WBHAZWATER" 135 "WBLEFT" 136 "WBRIGHT" 137 "WBROUND" 138 "WBUP" 139 "WBUPLEFT" 140 "WBUPRIGHT" 141 "ZEBRA" 142 "HAZMAT" 143 "EMERGENCYBAY" 144 "ENDOFLANEL" 145 "ENDOFLANER" 146 "ENOPARK" 147 "EONEWAY" 148 "EPARK" 149 "ETOLL" 150 "NOPARKL" 151 "NOPARKLR" 152 "NOPARKR" 153 "NOSTOPL" 154 "NOSTOPLR" 155 "NOSTOPR" 156 "NOTURNONRED" 157 "ONEWAYL" 158 "ONEWAYR" 159 "PARK" 160 "PRIOCROSSL" 161 "PRIOCROSSR" 162 "TOLL" 163 "TUNNEL" 164 "TWOWAY" 165 "WARNCROSS" 166 "WARNCROSSL" 167 "WARNCROSSLR" 168 "WARNCROSSR" 169 "WARNCROSSRL" 170 "WARNCROSST" 171 "WARNGIVEWAYAHEAD" 172 "WARNSLAHEAD" 173 "WARNSTOPAHEAD" 174 "WBBUS" 175 "WRONGWAY" 176 "HAZWATER" 177 "GIVEWAYROUND" 178 "WARNWINDINGL" 179 "WARNWINDINGR" 180 "WARNHAIRPINL" 181 "WARNHAIRPINR" 182 "WARNPEDBIKE" 183 "WARNCROSSY" 184 "WARNBRANCHL" 185 "WARNBRANCHR" 186 "WARNAXLEWEIGHT" 187 "WARNWEIGHT" 188 "WARNHEIGHT" 189 "WARNLENGTH" 190 "WARNWIDTH" 191 "WARNBLACKSPOT" 192 "WARNMERGEL" 193 "WARNMERGER" 194 "WARNTUNNEL" 195 "WARNTRACTOR" 196 "WARNRWORKSVEHICLE" 197 "WARNNARROWBRIDGE" 198 "WARNFLAGGER" 199 "LANES" 200 "LANESHIFTL" 201 "LANESHIFTR" 202 "NEWLANEL" 203 "NEWLANER" 204 "RIGHTTURNONRED" 205 "BORDERLIMIT" 206 "EMBEDDEDRAIN" ;
VAL_ 253 VFC_TS15_EmbedFlag 0 "Unknown" 1 "Not Embedded" 2 "Border Limit" 3 "Multi Lane" 4 "Rain" 5 "Vehicle Type" 6 "Plate" 7 "Error Value" ;
VAL_ 253 VFC_TS15_Quality 0 "Poor Quality" 1 "Good Quality" ;
VAL_ 253 VFC_TS15_VMS 0 "Fixed" 1 "Variable" ;
VAL_ 253 VFC_TS15_Stable 0 "Object Is Not Stable" 1 "Object Is Stable" ;
VAL_ 253 VFC_TS15_VehicleSticker 0 "not_sticker_on_vehicle" 1 "Sign is a sticker on a vehicle" ;
VAL_ 253 VFC_TS15_InternalTrack 0 "Sign is not an internal track" 1 "Sign is an internal track" ;
VAL_ 253 VFC_TS15_AddTS1Class 0 "UNKNOWN" 1 "DETECTED" 2 "ACCIDENT" 3 "ADVICE" 4 "BEGINS" 5 "BUS" 6 "CAMPER" 7 "CAR" 8 "CARAVAN" 9 "CRASHRISK" 10 "DIRT" 11 "DISTANCE" 12 "DISTANCEBARS" 13 "END" 14 "EXITL" 15 "EXITR" 16 "FOG" 17 "GRAVEL" 18 "HAZMAT" 19 "HUMP" 20 "JAM" 21 "LORRY" 22 "EXCEPTLORRY" 23 "LOWTREE" 24 "MCYCLE" 25 "MINIMUM" 26 "NIGHT" 27 "NOSTOPSHOULDER" 28 "OILTRAIL" 29 "PRIOTURN" 30 "RADAR" 31 "RAIN" 32 "RAINSNOW" 33 "REMINDER" 34 "ROADDAMAGE" 35 "RUTS" 36 "RWORKSACCESS" 37 "RWORKSENTRY" 38 "RWORKSEXIT" 39 "SCHOOL" 40 "SECTION" 41 "SMOKE" 42 "SNOW" 43 "SOFTSHOULDERCAR" 44 "SHOFTSHOULDERLORRY" 45 "TEXT" 46 "TIME" 47 "TOWING" 48 "TRACTOR" 49 "TRACTOR_OVER" 50 "TRAILER" 51 "WEIGHT" 52 "WET" 53 "WITHIN" 54 "ZONE" 55 "EXIT" 56 "ACCESS" 57 "ALLWAY" 58 "EXCEPTBUS" 59 "EXCEPTDELIVERY" 60 "EXCEPTLOCAL" 61 "FROG" 62 "PRIOTURNL" 63 "PRIOTURNR" 64 "START" 65 "STOPIN" 66 "HAZWATER" 67 "DAY" 68 "SL" ;
VAL_ 253 VFC_TS15_AddTS1Quality 0 "Poor Quality" 1 "Good Quality" ;
VAL_ 253 VFC_TS15_AddTS1VMS 0 "Fixed" 1 "Variable" ;
VAL_ 253 VFC_TS15_AddTS2Class 0 "UNKNOWN" 1 "DETECTED" 2 "ACCIDENT" 3 "ADVICE" 4 "BEGINS" 5 "BUS" 6 "CAMPER" 7 "CAR" 8 "CARAVAN" 9 "CRASHRISK" 10 "DIRT" 11 "DISTANCE" 12 "DISTANCEBARS" 13 "END" 14 "EXITL" 15 "EXITR" 16 "FOG" 17 "GRAVEL" 18 "HAZMAT" 19 "HUMP" 20 "JAM" 21 "LORRY" 22 "EXCEPTLORRY" 23 "LOWTREE" 24 "MCYCLE" 25 "MINIMUM" 26 "NIGHT" 27 "NOSTOPSHOULDER" 28 "OILTRAIL" 29 "PRIOTURN" 30 "RADAR" 31 "RAIN" 32 "RAINSNOW" 33 "REMINDER" 34 "ROADDAMAGE" 35 "RUTS" 36 "RWORKSACCESS" 37 "RWORKSENTRY" 38 "RWORKSEXIT" 39 "SCHOOL" 40 "SECTION" 41 "SMOKE" 42 "SNOW" 43 "SOFTSHOULDERCAR" 44 "SHOFTSHOULDERLORRY" 45 "TEXT" 46 "TIME" 47 "TOWING" 48 "TRACTOR" 49 "TRACTOR_OVER" 50 "TRAILER" 51 "WEIGHT" 52 "WET" 53 "WITHIN" 54 "ZONE" 55 "EXIT" 56 "ACCESS" 57 "ALLWAY" 58 "EXCEPTBUS" 59 "EXCEPTDELIVERY" 60 "EXCEPTLOCAL" 61 "FROG" 62 "PRIOTURNL" 63 "PRIOTURNR" 64 "START" 65 "STOPIN" 66 "HAZWATER" 67 "DAY" 68 "SL" ;
VAL_ 253 VFC_TS15_AddTS2Quality 0 "Poor Quality" 1 "Good Quality" ;
VAL_ 253 VFC_TS15_AddTS2VMS 0 "Fixed" 1 "Variable" ;
VAL_ 253 VFC_TS15_AddTS3Class 0 "UNKNOWN" 1 "DETECTED" 2 "ACCIDENT" 3 "ADVICE" 4 "BEGINS" 5 "BUS" 6 "CAMPER" 7 "CAR" 8 "CARAVAN" 9 "CRASHRISK" 10 "DIRT" 11 "DISTANCE" 12 "DISTANCEBARS" 13 "END" 14 "EXITL" 15 "EXITR" 16 "FOG" 17 "GRAVEL" 18 "HAZMAT" 19 "HUMP" 20 "JAM" 21 "LORRY" 22 "EXCEPTLORRY" 23 "LOWTREE" 24 "MCYCLE" 25 "MINIMUM" 26 "NIGHT" 27 "NOSTOPSHOULDER" 28 "OILTRAIL" 29 "PRIOTURN" 30 "RADAR" 31 "RAIN" 32 "RAINSNOW" 33 "REMINDER" 34 "ROADDAMAGE" 35 "RUTS" 36 "RWORKSACCESS" 37 "RWORKSENTRY" 38 "RWORKSEXIT" 39 "SCHOOL" 40 "SECTION" 41 "SMOKE" 42 "SNOW" 43 "SOFTSHOULDERCAR" 44 "SHOFTSHOULDERLORRY" 45 "TEXT" 46 "TIME" 47 "TOWING" 48 "TRACTOR" 49 "TRACTOR_OVER" 50 "TRAILER" 51 "WEIGHT" 52 "WET" 53 "WITHIN" 54 "ZONE" 55 "EXIT" 56 "ACCESS" 57 "ALLWAY" 58 "EXCEPTBUS" 59 "EXCEPTDELIVERY" 60 "EXCEPTLOCAL" 61 "FROG" 62 "PRIOTURNL" 63 "PRIOTURNR" 64 "START" 65 "STOPIN" 66 "HAZWATER" 67 "DAY" 68 "SL" ;
VAL_ 253 VFC_TS15_AddTS3Quality 0 "Poor Quality" 1 "Good Quality" ;
VAL_ 253 VFC_TS15_AddTS3VMS 0 "Fixed" 1 "Variable" ;
VAL_ 253 VFC_TS15_AddTS4Class 0 "UNKNOWN" 1 "DETECTED" 2 "ACCIDENT" 3 "ADVICE" 4 "BEGINS" 5 "BUS" 6 "CAMPER" 7 "CAR" 8 "CARAVAN" 9 "CRASHRISK" 10 "DIRT" 11 "DISTANCE" 12 "DISTANCEBARS" 13 "END" 14 "EXITL" 15 "EXITR" 16 "FOG" 17 "GRAVEL" 18 "HAZMAT" 19 "HUMP" 20 "JAM" 21 "LORRY" 22 "EXCEPTLORRY" 23 "LOWTREE" 24 "MCYCLE" 25 "MINIMUM" 26 "NIGHT" 27 "NOSTOPSHOULDER" 28 "OILTRAIL" 29 "PRIOTURN" 30 "RADAR" 31 "RAIN" 32 "RAINSNOW" 33 "REMINDER" 34 "ROADDAMAGE" 35 "RUTS" 36 "RWORKSACCESS" 37 "RWORKSENTRY" 38 "RWORKSEXIT" 39 "SCHOOL" 40 "SECTION" 41 "SMOKE" 42 "SNOW" 43 "SOFTSHOULDERCAR" 44 "SHOFTSHOULDERLORRY" 45 "TEXT" 46 "TIME" 47 "TOWING" 48 "TRACTOR" 49 "TRACTOR_OVER" 50 "TRAILER" 51 "WEIGHT" 52 "WET" 53 "WITHIN" 54 "ZONE" 55 "EXIT" 56 "ACCESS" 57 "ALLWAY" 58 "EXCEPTBUS" 59 "EXCEPTDELIVERY" 60 "EXCEPTLOCAL" 61 "FROG" 62 "PRIOTURNL" 63 "PRIOTURNR" 64 "START" 65 "STOPIN" 66 "HAZWATER" 67 "DAY" 68 "SL" ;
VAL_ 253 VFC_TS15_AddTS4Quality 0 "Poor Quality" 1 "Good Quality" ;
VAL_ 253 VFC_TS15_AddTS4VMS 0 "Fixed" 1 "Variable" ;
VAL_ 253 VFC_TS15_AddTS5Class 0 "UNKNOWN" 1 "DETECTED" 2 "ACCIDENT" 3 "ADVICE" 4 "BEGINS" 5 "BUS" 6 "CAMPER" 7 "CAR" 8 "CARAVAN" 9 "CRASHRISK" 10 "DIRT" 11 "DISTANCE" 12 "DISTANCEBARS" 13 "END" 14 "EXITL" 15 "EXITR" 16 "FOG" 17 "GRAVEL" 18 "HAZMAT" 19 "HUMP" 20 "JAM" 21 "LORRY" 22 "EXCEPTLORRY" 23 "LOWTREE" 24 "MCYCLE" 25 "MINIMUM" 26 "NIGHT" 27 "NOSTOPSHOULDER" 28 "OILTRAIL" 29 "PRIOTURN" 30 "RADAR" 31 "RAIN" 32 "RAINSNOW" 33 "REMINDER" 34 "ROADDAMAGE" 35 "RUTS" 36 "RWORKSACCESS" 37 "RWORKSENTRY" 38 "RWORKSEXIT" 39 "SCHOOL" 40 "SECTION" 41 "SMOKE" 42 "SNOW" 43 "SOFTSHOULDERCAR" 44 "SHOFTSHOULDERLORRY" 45 "TEXT" 46 "TIME" 47 "TOWING" 48 "TRACTOR" 49 "TRACTOR_OVER" 50 "TRAILER" 51 "WEIGHT" 52 "WET" 53 "WITHIN" 54 "ZONE" 55 "EXIT" 56 "ACCESS" 57 "ALLWAY" 58 "EXCEPTBUS" 59 "EXCEPTDELIVERY" 60 "EXCEPTLOCAL" 61 "FROG" 62 "PRIOTURNL" 63 "PRIOTURNR" 64 "START" 65 "STOPIN" 66 "HAZWATER" 67 "DAY" 68 "SL" ;
VAL_ 253 VFC_TS15_AddTS5Quality 0 "Poor Quality" 1 "Good Quality" ;
VAL_ 253 VFC_TS15_AddTS5VMS 0 "Fixed" 1 "Variable" ;
VAL_ 253 VFC_TS15_AddTS6Class 0 "UNKNOWN" 1 "DETECTED" 2 "ACCIDENT" 3 "ADVICE" 4 "BEGINS" 5 "BUS" 6 "CAMPER" 7 "CAR" 8 "CARAVAN" 9 "CRASHRISK" 10 "DIRT" 11 "DISTANCE" 12 "DISTANCEBARS" 13 "END" 14 "EXITL" 15 "EXITR" 16 "FOG" 17 "GRAVEL" 18 "HAZMAT" 19 "HUMP" 20 "JAM" 21 "LORRY" 22 "EXCEPTLORRY" 23 "LOWTREE" 24 "MCYCLE" 25 "MINIMUM" 26 "NIGHT" 27 "NOSTOPSHOULDER" 28 "OILTRAIL" 29 "PRIOTURN" 30 "RADAR" 31 "RAIN" 32 "RAINSNOW" 33 "REMINDER" 34 "ROADDAMAGE" 35 "RUTS" 36 "RWORKSACCESS" 37 "RWORKSENTRY" 38 "RWORKSEXIT" 39 "SCHOOL" 40 "SECTION" 41 "SMOKE" 42 "SNOW" 43 "SOFTSHOULDERCAR" 44 "SHOFTSHOULDERLORRY" 45 "TEXT" 46 "TIME" 47 "TOWING" 48 "TRACTOR" 49 "TRACTOR_OVER" 50 "TRAILER" 51 "WEIGHT" 52 "WET" 53 "WITHIN" 54 "ZONE" 55 "EXIT" 56 "ACCESS" 57 "ALLWAY" 58 "EXCEPTBUS" 59 "EXCEPTDELIVERY" 60 "EXCEPTLOCAL" 61 "FROG" 62 "PRIOTURNL" 63 "PRIOTURNR" 64 "START" 65 "STOPIN" 66 "HAZWATER" 67 "DAY" 68 "SL" ;
VAL_ 253 VFC_TS15_AddTS6Quality 0 "Poor Quality" 1 "Good Quality" ;
VAL_ 253 VFC_TS15_AddTS6VMS 0 "Fixed" 1 "Variable" ;
VAL_ 517 RFL_ObjHdr_SensorState 0 "SENSOR FULLY OPERATIONAL" 1 "HW MALFUNCTION" 2 "DSP ISSUES" 3 "COMMUNICATION ERRORS" 4 "MISALIGNMENT (OUT OF SPEC)" 5 "SENSOR BLIDNESS DETECTED" 6 "SENSOR DISTUBED" 7 "OTHER ISSUES" 8 "DEGRADED BY REQUEST" 9 "RESERVED1" 10 "RESERVED2" 11 "RESERVED3" 12 "RESERVED4" 13 "RESERVED5" 14 "RESERVED6" 15 "INVALID" ;
VAL_ 517 RFL_ObjHdr_ObjectDownSel 0 "no downselection" 1 "downselected" ;
VAL_ 517 RFL_ObjHdr_AziOutOfSpec 0 "In spec Azimuth Alignemdn" 1 "Out of spec Azimuth Alignement" ;
VAL_ 517 RFL_ObjHdr_ElevOutOfSpec 0 "In Spec Elevation Alignment" 1 "Out of spec Elevation Alignement" ;
VAL_ 528 RFL_Obj00A_Measured 0 "not measured" 1 "measured" ;
VAL_ 528 RFL_Obj00A_Valid 0 "not valid" 1 "valid" ;
VAL_ 528 RFL_Obj00A_RefPosIndex 0 "Front corner left" 1 "Front center" 2 "Front corner right" 3 "Front wheelcase left" 4 "Front wheelcase right" 5 "Side middle left" 6 "Side middle right" 7 "Rear wheelcase left" 8 "Rear wheelcase right" 9 "Rear corner left" 10 "Rear center" 11 "Rear corner right" 12 "Object center" 13 "Rear wheelcase center" 14 "Front wheelcase center" 15 "Invalid" ;
VAL_ 529 RFL_Obj00B_BehaviorType 0 "No_Target" 1 "FCTA" 2 "RCTA" 3 "BSD" 4 "LCA" 5 "HWA" 6 "Reserved1" 7 "Reserved2" ;
VAL_ 530 RFL_Obj01A_Measured 0 "not measured" 1 "measured" ;
VAL_ 530 RFL_Obj01A_Valid 0 "not valid" 1 "valid" ;
VAL_ 530 RFL_Obj01A_RefPosIndex 0 "Front corner left" 1 "Front center" 2 "Front corner right" 3 "Front wheelcase left" 4 "Front wheelcase right" 5 "Side middle left" 6 "Side middle right" 7 "Rear wheelcase left" 8 "Rear wheelcase right" 9 "Rear corner left" 10 "Rear center" 11 "Rear corner right" 12 "Object center" 13 "Rear wheelcase center" 14 "Front wheelcase center" 15 "Invalid" ;
VAL_ 531 RFL_Obj01B_BehaviorType 0 "No_Target" 1 "FCTA" 2 "RCTA" 3 "BSD" 4 "LCA" 5 "HWA" 6 "Reserved1" 7 "Reserved2" ;
VAL_ 532 RFL_Obj02A_Measured 0 "not measured" 1 "measured" ;
VAL_ 532 RFL_Obj02A_Valid 0 "not valid" 1 "valid" ;
VAL_ 532 RFL_Obj02A_RefPosIndex 0 "Front corner left" 1 "Front center" 2 "Front corner right" 3 "Front wheelcase left" 4 "Front wheelcase right" 5 "Side middle left" 6 "Side middle right" 7 "Rear wheelcase left" 8 "Rear wheelcase right" 9 "Rear corner left" 10 "Rear center" 11 "Rear corner right" 12 "Object center" 13 "Rear wheelcase center" 14 "Front wheelcase center" 15 "Invalid" ;
VAL_ 533 RFL_Obj02B_BehaviorType 0 "No_Target" 1 "FCTA" 2 "RCTA" 3 "BSD" 4 "LCA" 5 "HWA" 6 "Reserved1" 7 "Reserved2" ;
VAL_ 534 RFL_Obj03A_Measured 0 "not measured" 1 "measured" ;
VAL_ 534 RFL_Obj03A_Valid 0 "not valid" 1 "valid" ;
VAL_ 534 RFL_Obj03A_RefPosIndex 0 "Front corner left" 1 "Front center" 2 "Front corner right" 3 "Front wheelcase left" 4 "Front wheelcase right" 5 "Side middle left" 6 "Side middle right" 7 "Rear wheelcase left" 8 "Rear wheelcase right" 9 "Rear corner left" 10 "Rear center" 11 "Rear corner right" 12 "Object center" 13 "Rear wheelcase center" 14 "Front wheelcase center" 15 "Invalid" ;
VAL_ 535 RFL_Obj03B_BehaviorType 0 "No_Target" 1 "FCTA" 2 "RCTA" 3 "BSD" 4 "LCA" 5 "HWA" 6 "Reserved1" 7 "Reserved2" ;
SIG_GROUP_ 247 SG_VFC_TrafficSign09 1 : VFC_TS09_CRC VFC_TS09_AliveCtr VFC_TS09_ProtBlockCtr VFC_TS09_ProtOrderIndex VFC_TS09_ID VFC_TS09_Class VFC_TS09_TSProb VFC_TS09_Dx VFC_TS09_Dy VFC_TS09_Dz VFC_TS09_DxStdDev VFC_TS09_DyStdDev VFC_TS09_DzStdDev VFC_TS09_Width VFC_TS09_Height VFC_TS09_EmbedFlag VFC_TS09_Quality VFC_TS09_VMS VFC_TS09_Stable VFC_TS09_VehicleSticker VFC_TS09_InternalTrack VFC_TS09_ValidLanes VFC_TS09_ValidDay VFC_TS09_ValidTimeRange1Start VFC_TS09_ValidTimeRange1End VFC_TS09_ValidTimeRange2Start VFC_TS09_ValidTimeRange2End VFC_TS09_ValidInDist VFC_TS09_ValidDist VFC_TS09_AddTSCount VFC_TS09_AddTS1Class VFC_TS09_AddTS1Prob VFC_TS09_AddTS1Quality VFC_TS09_AddTS1VMS VFC_TS09_AddTS2Class VFC_TS09_AddTS2Prob VFC_TS09_AddTS2Quality VFC_TS09_AddTS2VMS VFC_TS09_AddTS3Class VFC_TS09_AddTS3Prob VFC_TS09_AddTS3Quality VFC_TS09_AddTS3VMS VFC_TS09_AddTS4Class VFC_TS09_AddTS4Prob VFC_TS09_AddTS4Quality VFC_TS09_AddTS4VMS VFC_TS09_AddTS5Class VFC_TS09_AddTS5Prob VFC_TS09_AddTS5Quality VFC_TS09_AddTS5VMS VFC_TS09_AddTS6Class VFC_TS09_AddTS6Prob VFC_TS09_AddTS6Quality VFC_TS09_AddTS6VMS;
SIG_GROUP_ 248 SG_VFC_TrafficSign10 1 : VFC_TS10_CRC VFC_TS10_AliveCtr VFC_TS10_ProtBlockCtr VFC_TS10_ProtOrderIndex VFC_TS10_ID VFC_TS10_Class VFC_TS10_TSProb VFC_TS10_Dx VFC_TS10_Dy VFC_TS10_Dz VFC_TS10_DxStdDev VFC_TS10_DyStdDev VFC_TS10_DzStdDev VFC_TS10_Width VFC_TS10_Height VFC_TS10_EmbedFlag VFC_TS10_Quality VFC_TS10_VMS VFC_TS10_Stable VFC_TS10_VehicleSticker VFC_TS10_InternalTrack VFC_TS10_ValidLanes VFC_TS10_ValidDay VFC_TS10_ValidTimeRange1Start VFC_TS10_ValidTimeRange1End VFC_TS10_ValidTimeRange2Start VFC_TS10_ValidTimeRange2End VFC_TS10_ValidInDist VFC_TS10_ValidDist VFC_TS10_AddTSCount VFC_TS10_AddTS1Class VFC_TS10_AddTS1Prob VFC_TS10_AddTS1Quality VFC_TS10_AddTS1VMS VFC_TS10_AddTS2Class VFC_TS10_AddTS2Prob VFC_TS10_AddTS2Quality VFC_TS10_AddTS2VMS VFC_TS10_AddTS3Class VFC_TS10_AddTS3Prob VFC_TS10_AddTS3Quality VFC_TS10_AddTS3VMS VFC_TS10_AddTS4Class VFC_TS10_AddTS4Prob VFC_TS10_AddTS4Quality VFC_TS10_AddTS4VMS VFC_TS10_AddTS5Class VFC_TS10_AddTS5Prob VFC_TS10_AddTS5Quality VFC_TS10_AddTS5VMS VFC_TS10_AddTS6Class VFC_TS10_AddTS6Prob VFC_TS10_AddTS6Quality VFC_TS10_AddTS6VMS;
SIG_GROUP_ 249 SG_VFC_TrafficSign11 1 : VFC_TS11_CRC VFC_TS11_AliveCtr VFC_TS11_ProtBlockCtr VFC_TS11_ProtOrderIndex VFC_TS11_ID VFC_TS11_Class VFC_TS11_TSProb VFC_TS11_Dx VFC_TS11_Dy VFC_TS11_Dz VFC_TS11_DxStdDev VFC_TS11_DyStdDev VFC_TS11_DzStdDev VFC_TS11_Width VFC_TS11_Height VFC_TS11_EmbedFlag VFC_TS11_Quality VFC_TS11_VMS VFC_TS11_Stable VFC_TS11_VehicleSticker VFC_TS11_InternalTrack VFC_TS11_ValidLanes VFC_TS11_ValidDay VFC_TS11_ValidTimeRange1Start VFC_TS11_ValidTimeRange1End VFC_TS11_ValidTimeRange2Start VFC_TS11_ValidTimeRange2End VFC_TS11_ValidInDist VFC_TS11_ValidDist VFC_TS11_AddTSCount VFC_TS11_AddTS1Class VFC_TS11_AddTS1Prob VFC_TS11_AddTS1Quality VFC_TS11_AddTS1VMS VFC_TS11_AddTS2Class VFC_TS11_AddTS2Prob VFC_TS11_AddTS2Quality VFC_TS11_AddTS2VMS VFC_TS11_AddTS3Class VFC_TS11_AddTS3Prob VFC_TS11_AddTS3Quality VFC_TS11_AddTS3VMS VFC_TS11_AddTS4Class VFC_TS11_AddTS4Prob VFC_TS11_AddTS4Quality VFC_TS11_AddTS4VMS VFC_TS11_AddTS5Class VFC_TS11_AddTS5Prob VFC_TS11_AddTS5Quality VFC_TS11_AddTS5VMS VFC_TS11_AddTS6Class VFC_TS11_AddTS6Prob VFC_TS11_AddTS6Quality VFC_TS11_AddTS6VMS;
SIG_GROUP_ 250 SG_VFC_TrafficSign12 1 : VFC_TS12_CRC VFC_TS12_AliveCtr VFC_TS12_ProtBlockCtr VFC_TS12_ProtOrderIndex VFC_TS12_ID VFC_TS12_Class VFC_TS12_TSProb VFC_TS12_Dx VFC_TS12_Dy VFC_TS12_Dz VFC_TS12_DxStdDev VFC_TS12_DyStdDev VFC_TS12_DzStdDev VFC_TS12_Width VFC_TS12_Height VFC_TS12_EmbedFlag VFC_TS12_Quality VFC_TS12_VMS VFC_TS12_Stable VFC_TS12_VehicleSticker VFC_TS12_InternalTrack VFC_TS12_ValidLanes VFC_TS12_ValidDay VFC_TS12_ValidTimeRange1Start VFC_TS12_ValidTimeRange1End VFC_TS12_ValidTimeRange2Start VFC_TS12_ValidTimeRange2End VFC_TS12_ValidInDist VFC_TS12_ValidDist VFC_TS12_AddTSCount VFC_TS12_AddTS1Class VFC_TS12_AddTS1Prob VFC_TS12_AddTS1Quality VFC_TS12_AddTS1VMS VFC_TS12_AddTS2Class VFC_TS12_AddTS2Prob VFC_TS12_AddTS2Quality VFC_TS12_AddTS2VMS VFC_TS12_AddTS3Class VFC_TS12_AddTS3Prob VFC_TS12_AddTS3Quality VFC_TS12_AddTS3VMS VFC_TS12_AddTS4Class VFC_TS12_AddTS4Prob VFC_TS12_AddTS4Quality VFC_TS12_AddTS4VMS VFC_TS12_AddTS5Class VFC_TS12_AddTS5Prob VFC_TS12_AddTS5Quality VFC_TS12_AddTS5VMS VFC_TS12_AddTS6Class VFC_TS12_AddTS6Prob VFC_TS12_AddTS6Quality VFC_TS12_AddTS6VMS;
SIG_GROUP_ 251 SG_VFC_TrafficSign13 1 : VFC_TS13_CRC VFC_TS13_AliveCtr VFC_TS13_ProtBlockCtr VFC_TS13_ProtOrderIndex VFC_TS13_ID VFC_TS13_Class VFC_TS13_TSProb VFC_TS13_Dx VFC_TS13_Dy VFC_TS13_Dz VFC_TS13_DxStdDev VFC_TS13_DyStdDev VFC_TS13_DzStdDev VFC_TS13_Width VFC_TS13_Height VFC_TS13_EmbedFlag VFC_TS13_Quality VFC_TS13_VMS VFC_TS13_Stable VFC_TS13_VehicleSticker VFC_TS13_InternalTrack VFC_TS13_ValidLanes VFC_TS13_ValidDay VFC_TS13_ValidTimeRange1Start VFC_TS13_ValidTimeRange1End VFC_TS13_ValidTimeRange2Start VFC_TS13_ValidTimeRange2End VFC_TS13_ValidInDist VFC_TS13_ValidDist VFC_TS13_AddTSCount VFC_TS13_AddTS1Class VFC_TS13_AddTS1Prob VFC_TS13_AddTS1Quality VFC_TS13_AddTS1VMS VFC_TS13_AddTS2Class VFC_TS13_AddTS2Prob VFC_TS13_AddTS2Quality VFC_TS13_AddTS2VMS VFC_TS13_AddTS3Class VFC_TS13_AddTS3Prob VFC_TS13_AddTS3Quality VFC_TS13_AddTS3VMS VFC_TS13_AddTS4Class VFC_TS13_AddTS4Prob VFC_TS13_AddTS4Quality VFC_TS13_AddTS4VMS VFC_TS13_AddTS5Class VFC_TS13_AddTS5Prob VFC_TS13_AddTS5Quality VFC_TS13_AddTS5VMS VFC_TS13_AddTS6Class VFC_TS13_AddTS6Prob VFC_TS13_AddTS6Quality VFC_TS13_AddTS6VMS;
SIG_GROUP_ 252 SG_VFC_TrafficSign14 1 : VFC_TS14_CRC VFC_TS14_AliveCtr VFC_TS14_ProtBlockCtr VFC_TS14_ProtOrderIndex VFC_TS14_ID VFC_TS14_Class VFC_TS14_TSProb VFC_TS14_Dx VFC_TS14_Dy VFC_TS14_Dz VFC_TS14_DxStdDev VFC_TS14_DyStdDev VFC_TS14_DzStdDev VFC_TS14_Width VFC_TS14_Height VFC_TS14_EmbedFlag VFC_TS14_Quality VFC_TS14_VMS VFC_TS14_Stable VFC_TS14_VehicleSticker VFC_TS14_InternalTrack VFC_TS14_ValidLanes VFC_TS14_ValidDay VFC_TS14_ValidTimeRange1Start VFC_TS14_ValidTimeRange1End VFC_TS14_ValidTimeRange2Start VFC_TS14_ValidTimeRange2End VFC_TS14_ValidInDist VFC_TS14_ValidDist VFC_TS14_AddTSCount VFC_TS14_AddTS1Class VFC_TS14_AddTS1Prob VFC_TS14_AddTS1Quality VFC_TS14_AddTS1VMS VFC_TS14_AddTS2Class VFC_TS14_AddTS2Prob VFC_TS14_AddTS2Quality VFC_TS14_AddTS2VMS VFC_TS14_AddTS3Class VFC_TS14_AddTS3Prob VFC_TS14_AddTS3Quality VFC_TS14_AddTS3VMS VFC_TS14_AddTS4Class VFC_TS14_AddTS4Prob VFC_TS14_AddTS4Quality VFC_TS14_AddTS4VMS VFC_TS14_AddTS5Class VFC_TS14_AddTS5Prob VFC_TS14_AddTS5Quality VFC_TS14_AddTS5VMS VFC_TS14_AddTS6Class VFC_TS14_AddTS6Prob VFC_TS14_AddTS6Quality VFC_TS14_AddTS6VMS;
SIG_GROUP_ 253 SG_VFC_TrafficSign15 1 : VFC_TS15_CRC VFC_TS15_AliveCtr VFC_TS15_ProtBlockCtr VFC_TS15_ProtOrderIndex VFC_TS15_ID VFC_TS15_Class VFC_TS15_TSProb VFC_TS15_Dx VFC_TS15_Dy VFC_TS15_Dz VFC_TS15_DxStdDev VFC_TS15_DyStdDev VFC_TS15_DzStdDev VFC_TS15_Width VFC_TS15_Height VFC_TS15_EmbedFlag VFC_TS15_Quality VFC_TS15_VMS VFC_TS15_Stable VFC_TS15_VehicleSticker VFC_TS15_InternalTrack VFC_TS15_ValidLanes VFC_TS15_ValidDay VFC_TS15_ValidTimeRange1Start VFC_TS15_ValidTimeRange1End VFC_TS15_ValidTimeRange2Start VFC_TS15_ValidTimeRange2End VFC_TS15_ValidInDist VFC_TS15_ValidDist VFC_TS15_AddTSCount VFC_TS15_AddTS1Class VFC_TS15_AddTS1Prob VFC_TS15_AddTS1Quality VFC_TS15_AddTS1VMS VFC_TS15_AddTS2Class VFC_TS15_AddTS2Prob VFC_TS15_AddTS2Quality VFC_TS15_AddTS2VMS VFC_TS15_AddTS3Class VFC_TS15_AddTS3Prob VFC_TS15_AddTS3Quality VFC_TS15_AddTS3VMS VFC_TS15_AddTS4Class VFC_TS15_AddTS4Prob VFC_TS15_AddTS4Quality VFC_TS15_AddTS4VMS VFC_TS15_AddTS5Class VFC_TS15_AddTS5Prob VFC_TS15_AddTS5Quality VFC_TS15_AddTS5VMS VFC_TS15_AddTS6Class VFC_TS15_AddTS6Prob VFC_TS15_AddTS6Quality VFC_TS15_AddTS6VMS;
