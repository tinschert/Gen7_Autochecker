VERSION "created by canmatrix"

NS_ :

BS_:

BU_: RadarFrontCenter VideoFrontCenter RadarFrontLeft RadarFrontRight ReceiveECU

BO_ 133 VFC_RoadClothoid_09_11: 64 VideoFrontCenter
 SG_ VFC_Cloth_09_11_CRC : 0|16@1+ (1,0) [0|65535] ""  RadarFrontCenter
 SG_ VFC_Cloth_09_11_AliveCtr : 16|8@1+ (1,0) [0|255] ""  RadarFrontCenter
 SG_ VFC_Cloth_09_11_ProtBlockCtr : 24|4@1+ (1,0) [0|15] ""  RadarFrontCenter
 SG_ VFC_Cloth09_LaneAssociation : 32|4@1+ (1,0) [0|15] ""  RadarFrontCenter
 SG_ VFC_Cloth09_Colour : 37|3@1+ (1,0) [0|7] ""  RadarFrontCenter
 SG_ VFC_Cloth09_RangeXBegin : 40|9@1+ (0.25,0) [0|127.75] "m"  RadarFrontCenter
 SG_ VFC_Cloth09_RangeXEnd : 49|9@1+ (0.5,0) [0|255.5] "m"  RadarFrontCenter
 SG_ VFC_Cloth09_ExistProb : 58|6@1+ (2,0) [0|100] "%"  RadarFrontCenter
 SG_ VFC_Cloth09_CurvChange : 64|24@1+ (1.86264514923096E-009,-0.015625) [-0.015625|0.0156249981373548] "1/m^2"  RadarFrontCenter
 SG_ VFC_Cloth09_Curv : 88|15@1+ (3.814697265625E-006,-0.0625) [-0.0625|0.0624961853027344] "1/m"  RadarFrontCenter
 SG_ VFC_Cloth09_PyStdDev : 103|9@1+ (0.0078125,0) [0|3.9921875] "m"  RadarFrontCenter
 SG_ VFC_Cloth09_Py : 112|12@1+ (0.0078125,-16) [-16|15.9921875] "m"  RadarFrontCenter
 SG_ VFC_Cloth09_OrientationYaw : 124|12@1+ (0.00048828125,-1) [-1|0.99951171875] "rad"  RadarFrontCenter
 SG_ VFC_Cloth09_Width : 136|8@1+ (0.01,0) [0|2.55] "m"  RadarFrontCenter
 SG_ VFC_Cloth09_Type : 144|4@1+ (1,0) [0|15] ""  RadarFrontCenter
 SG_ VFC_Cloth10_LaneAssociation : 192|4@1+ (1,0) [0|15] ""  RadarFrontCenter
 SG_ VFC_Cloth10_Colour : 197|3@1+ (1,0) [0|7] ""  RadarFrontCenter
 SG_ VFC_Cloth10_RangeXBegin : 200|9@1+ (0.25,0) [0|127.75] "m"  RadarFrontCenter
 SG_ VFC_Cloth10_RangeXEnd : 209|9@1+ (0.5,0) [0|255.5] "m"  RadarFrontCenter
 SG_ VFC_Cloth10_ExistProb : 218|6@1+ (2,0) [0|100] "%"  RadarFrontCenter
 SG_ VFC_Cloth10_CurvChange : 224|24@1+ (1.86264514923096E-009,-0.015625) [-0.015625|0.0156249981373548] "1/m^2"  RadarFrontCenter
 SG_ VFC_Cloth10_Curv : 248|15@1+ (3.814697265625E-006,-0.0625) [-0.0625|0.0624961853027344] "1/m"  RadarFrontCenter
 SG_ VFC_Cloth10_PyStdDev : 263|9@1+ (0.0078125,0) [0|3.9921875] "m"  RadarFrontCenter
 SG_ VFC_Cloth10_Py : 272|12@1+ (0.0078125,-16) [-16|15.9921875] "m"  RadarFrontCenter
 SG_ VFC_Cloth10_OrientationYaw : 284|12@1+ (0.00048828125,-1) [-1|0.99951171875] "rad"  RadarFrontCenter
 SG_ VFC_Cloth10_Width : 296|8@1+ (0.01,0) [0|2.55] "m"  RadarFrontCenter
 SG_ VFC_Cloth10_Type : 304|4@1+ (1,0) [0|15] ""  RadarFrontCenter
 SG_ VFC_Cloth11_LaneAssociation : 352|4@1+ (1,0) [0|15] ""  RadarFrontCenter
 SG_ VFC_Cloth11_Colour : 357|3@1+ (1,0) [0|7] ""  RadarFrontCenter
 SG_ VFC_Cloth11_RangeXBegin : 360|9@1+ (0.25,0) [0|127.75] "m"  RadarFrontCenter
 SG_ VFC_Cloth11_RangeXEnd : 369|9@1+ (0.5,0) [0|255.5] "m"  RadarFrontCenter
 SG_ VFC_Cloth11_ExistProb : 378|6@1+ (2,0) [0|100] "%"  RadarFrontCenter
 SG_ VFC_Cloth11_CurvChange : 384|24@1+ (1.86264514923096E-009,-0.015625) [-0.015625|0.0156249981373548] "1/m^2"  RadarFrontCenter
 SG_ VFC_Cloth11_Curv : 408|15@1+ (3.814697265625E-006,-0.0625) [-0.0625|0.0624961853027344] "1/m"  RadarFrontCenter
 SG_ VFC_Cloth11_PyStdDev : 423|9@1+ (0.0078125,0) [0|3.9921875] "m"  RadarFrontCenter
 SG_ VFC_Cloth11_Py : 432|12@1+ (0.0078125,-16) [-16|15.9921875] "m"  RadarFrontCenter
 SG_ VFC_Cloth11_OrientationYaw : 444|12@1+ (0.00048828125,-1) [-1|0.99951171875] "rad"  RadarFrontCenter
 SG_ VFC_Cloth11_Width : 456|8@1+ (0.01,0) [0|2.55] "m"  RadarFrontCenter
 SG_ VFC_Cloth11_Type : 464|4@1+ (1,0) [0|15] ""  RadarFrontCenter

BO_ 146 VFC_RoadPolynomial_00_02: 64 VideoFrontCenter
 SG_ VFC_Poly_00_02_CRC : 0|16@1+ (1,0) [0|65535] ""  RadarFrontCenter
 SG_ VFC_Poly_00_02_AliveCtr : 16|8@1+ (1,0) [0|255] ""  RadarFrontCenter
 SG_ VFC_Poly_00_02_ProtBlockCtr : 24|4@1+ (1,0) [0|15] ""  RadarFrontCenter
 SG_ VFC_Poly00_LaneAssociation : 32|4@1+ (1,0) [0|15] ""  RadarFrontCenter
 SG_ VFC_Poly00_Type : 36|4@1+ (1,0) [0|15] ""  RadarFrontCenter
 SG_ VFC_Poly00_ExistProb : 40|6@1+ (2,0) [0|100] "%"  RadarFrontCenter
 SG_ VFC_Poly00_CoefficientYc3 : 46|18@1+ (1.49011611938476E-008,-0.001953125) [-0.001953125|0.00195311009883879] "1/m^2"  RadarFrontCenter
 SG_ VFC_Poly00_Colour : 64|3@1+ (1,0) [0|7] ""  RadarFrontCenter
 SG_ VFC_Poly00_CoefficientYc2 : 67|17@1+ (9.5367431640625E-007,-0.0625) [-0.0625|0.0624990463256836] "1/m"  RadarFrontCenter
 SG_ VFC_Poly00_CoefficientYc0 : 84|12@1+ (0.0078125,-16) [-16|15.9921875] "m"  RadarFrontCenter
 SG_ VFC_Poly00_CoefficientYc1 : 96|15@1+ (6.103515625E-005,-1) [-1|0.99993896484375] "1"  RadarFrontCenter
 SG_ VFC_Poly00_CoefficientYc2Corr : 111|17@1+ (9.5367431640625E-007,-0.0625) [-0.0625|0.0624990463256836] "1/m"  RadarFrontCenter
 SG_ VFC_Poly00_CoefficientYc3Corr : 128|18@1+ (1.49011611938476E-008,-0.001953125) [-0.001953125|0.00195311009883879] "1/m^2"  RadarFrontCenter
 SG_ VFC_Poly00_Width : 146|6@1+ (0.01,0) [0|0.63] "m"  RadarFrontCenter
 SG_ VFC_Poly00_RangeXCorrectionPoint : 152|8@1+ (1,0) [0|255] "m"  RadarFrontCenter
 SG_ VFC_Poly00_RangeXBegin : 160|9@1+ (0.25,0) [0|127.75] "m"  RadarFrontCenter
 SG_ VFC_Poly00_Reserved0 : 169|7@1+ (1,0) [0|127] "unitless"  RadarFrontCenter
 SG_ VFC_Poly00_RangeXEnd : 176|9@1+ (0.5,0) [0|255.5] "m"  RadarFrontCenter
 SG_ VFC_Poly00_Reserved1 : 185|7@1+ (1,0) [0|127] "unitless"  RadarFrontCenter
 SG_ VFC_Poly01_LaneAssociation : 192|4@1+ (1,0) [0|15] ""  RadarFrontCenter
 SG_ VFC_Poly01_Type : 196|4@1+ (1,0) [0|15] ""  RadarFrontCenter
 SG_ VFC_Poly01_ExistProb : 200|6@1+ (2,0) [0|100] "%"  RadarFrontCenter
 SG_ VFC_Poly01_CoefficientYc3 : 206|18@1+ (1.49011611938476E-008,-0.001953125) [-0.001953125|0.00195311009883879] "1/m^2"  RadarFrontCenter
 SG_ VFC_Poly01_Colour : 224|3@1+ (1,0) [0|7] ""  RadarFrontCenter
 SG_ VFC_Poly01_CoefficientYc2 : 227|17@1+ (9.5367431640625E-007,-0.0625) [-0.0625|0.0624990463256836] "1/m"  RadarFrontCenter
 SG_ VFC_Poly01_CoefficientYc0 : 244|12@1+ (0.0078125,-16) [-16|15.9921875] "m"  RadarFrontCenter
 SG_ VFC_Poly01_CoefficientYc1 : 256|15@1+ (6.103515625E-005,-1) [-1|0.99993896484375] "1"  RadarFrontCenter
 SG_ VFC_Poly01_CoefficientYc2Corr : 271|17@1+ (9.5367431640625E-007,-0.0625) [-0.0625|0.0624990463256836] "1/m"  RadarFrontCenter
 SG_ VFC_Poly01_CoefficientYc3Corr : 288|18@1+ (1.49011611938476E-008,-0.001953125) [-0.001953125|0.00195311009883879] "1/m^2"  RadarFrontCenter
 SG_ VFC_Poly01_Width : 306|6@1+ (0.01,0) [0|0.63] "m"  RadarFrontCenter
 SG_ VFC_Poly01_RangeXCorrectionPoint : 312|8@1+ (1,0) [0|255] "m"  RadarFrontCenter
 SG_ VFC_Poly01_RangeXBegin : 320|9@1+ (0.25,0) [0|127.75] "m"  RadarFrontCenter
 SG_ VFC_Poly01_Reserved0 : 329|7@1+ (1,0) [0|127] "unitless"  RadarFrontCenter
 SG_ VFC_Poly01_RangeXEnd : 336|9@1+ (0.5,0) [0|255.5] "m"  RadarFrontCenter
 SG_ VFC_Poly01_Reserved1 : 345|7@1+ (1,0) [0|127] "unitless"  RadarFrontCenter
 SG_ VFC_Poly02_LaneAssociation : 352|4@1+ (1,0) [0|15] ""  RadarFrontCenter
 SG_ VFC_Poly02_Type : 356|4@1+ (1,0) [0|15] ""  RadarFrontCenter
 SG_ VFC_Poly02_ExistProb : 360|6@1+ (2,0) [0|100] "%"  RadarFrontCenter
 SG_ VFC_Poly02_CoefficientYc3 : 366|18@1+ (1.49011611938476E-008,-0.001953125) [-0.001953125|0.00195311009883879] "1/m^2"  RadarFrontCenter
 SG_ VFC_Poly02_Colour : 384|3@1+ (1,0) [0|7] ""  RadarFrontCenter
 SG_ VFC_Poly02_CoefficientYc2 : 387|17@1+ (9.5367431640625E-007,-0.0625) [-0.0625|0.0624990463256836] "1/m"  RadarFrontCenter
 SG_ VFC_Poly02_CoefficientYc0 : 404|12@1+ (0.0078125,-16) [-16|15.9921875] "m"  RadarFrontCenter
 SG_ VFC_Poly02_CoefficientYc1 : 416|15@1+ (6.103515625E-005,-1) [-1|0.99993896484375] "1"  RadarFrontCenter
 SG_ VFC_Poly02_CoefficientYc2Corr : 431|17@1+ (9.5367431640625E-007,-0.0625) [-0.0625|0.0624990463256836] "1/m"  RadarFrontCenter
 SG_ VFC_Poly02_CoefficientYc3Corr : 448|18@1+ (1.49011611938476E-008,-0.001953125) [-0.001953125|0.00195311009883879] "1/m^2"  RadarFrontCenter
 SG_ VFC_Poly02_Width : 466|6@1+ (0.01,0) [0|0.63] "m"  RadarFrontCenter
 SG_ VFC_Poly02_RangeXCorrectionPoint : 472|8@1+ (1,0) [0|255] "m"  RadarFrontCenter
 SG_ VFC_Poly02_RangeXBegin : 480|9@1+ (0.25,0) [0|127.75] "m"  RadarFrontCenter
 SG_ VFC_Poly02_Reserved0 : 489|7@1+ (1,0) [0|127] "unitless"  RadarFrontCenter
 SG_ VFC_Poly02_RangeXEnd : 496|9@1+ (0.5,0) [0|255.5] "m"  RadarFrontCenter
 SG_ VFC_Poly02_Reserved1 : 505|7@1+ (1,0) [0|127] "unitless"  RadarFrontCenter

BO_ 147 VFC_RoadPolynomial_03_05: 64 VideoFrontCenter
 SG_ VFC_Poly_03_05_CRC : 0|16@1+ (1,0) [0|65535] ""  RadarFrontCenter
 SG_ VFC_Poly_03_05_AliveCtr : 16|8@1+ (1,0) [0|255] ""  RadarFrontCenter
 SG_ VFC_Poly_03_05_ProtBlockCtr : 24|4@1+ (1,0) [0|15] ""  RadarFrontCenter
 SG_ VFC_Poly03_LaneAssociation : 32|4@1+ (1,0) [0|15] ""  RadarFrontCenter
 SG_ VFC_Poly03_Type : 36|4@1+ (1,0) [0|15] ""  RadarFrontCenter
 SG_ VFC_Poly03_ExistProb : 40|6@1+ (2,0) [0|100] "%"  RadarFrontCenter
 SG_ VFC_Poly03_CoefficientYc3 : 46|18@1+ (1.49011611938476E-008,-0.001953125) [-0.001953125|0.00195311009883879] "1/m^2"  RadarFrontCenter
 SG_ VFC_Poly03_Colour : 64|3@1+ (1,0) [0|7] ""  RadarFrontCenter
 SG_ VFC_Poly03_CoefficientYc2 : 67|17@1+ (9.5367431640625E-007,-0.0625) [-0.0625|0.0624990463256836] "1/m"  RadarFrontCenter
 SG_ VFC_Poly03_CoefficientYc0 : 84|12@1+ (0.0078125,-16) [-16|15.9921875] "m"  RadarFrontCenter
 SG_ VFC_Poly03_CoefficientYc1 : 96|15@1+ (6.103515625E-005,-1) [-1|0.99993896484375] "1"  RadarFrontCenter
 SG_ VFC_Poly03_CoefficientYc2Corr : 111|17@1+ (9.5367431640625E-007,-0.0625) [-0.0625|0.0624990463256836] "1/m"  RadarFrontCenter
 SG_ VFC_Poly03_CoefficientYc3Corr : 128|18@1+ (1.49011611938476E-008,-0.001953125) [-0.001953125|0.00195311009883879] "1/m^2"  RadarFrontCenter
 SG_ VFC_Poly03_Width : 146|6@1+ (0.01,0) [0|0.63] "m"  RadarFrontCenter
 SG_ VFC_Poly03_RangeXCorrectionPoint : 152|8@1+ (1,0) [0|255] "m"  RadarFrontCenter
 SG_ VFC_Poly03_RangeXBegin : 160|9@1+ (0.25,0) [0|127.75] "m"  RadarFrontCenter
 SG_ VFC_Poly03_Reserved0 : 169|7@1+ (1,0) [0|127] "unitless"  RadarFrontCenter
 SG_ VFC_Poly03_RangeXEnd : 176|9@1+ (0.5,0) [0|255.5] "m"  RadarFrontCenter
 SG_ VFC_Poly03_Reserved1 : 185|7@1+ (1,0) [0|127] "unitless"  RadarFrontCenter
 SG_ VFC_Poly04_LaneAssociation : 192|4@1+ (1,0) [0|15] ""  RadarFrontCenter
 SG_ VFC_Poly04_Type : 196|4@1+ (1,0) [0|15] ""  RadarFrontCenter
 SG_ VFC_Poly04_ExistProb : 200|6@1+ (2,0) [0|100] "%"  RadarFrontCenter
 SG_ VFC_Poly04_CoefficientYc3 : 206|18@1+ (1.49011611938476E-008,-0.001953125) [-0.001953125|0.00195311009883879] "1/m^2"  RadarFrontCenter
 SG_ VFC_Poly04_Colour : 224|3@1+ (1,0) [0|7] ""  RadarFrontCenter
 SG_ VFC_Poly04_CoefficientYc2 : 227|17@1+ (9.5367431640625E-007,-0.0625) [-0.0625|0.0624990463256836] "1/m"  RadarFrontCenter
 SG_ VFC_Poly04_CoefficientYc0 : 244|12@1+ (0.0078125,-16) [-16|15.9921875] "m"  RadarFrontCenter
 SG_ VFC_Poly04_CoefficientYc1 : 256|15@1+ (6.103515625E-005,-1) [-1|0.99993896484375] "1"  RadarFrontCenter
 SG_ VFC_Poly04_CoefficientYc2Corr : 271|17@1+ (9.5367431640625E-007,-0.0625) [-0.0625|0.0624990463256836] "1/m"  RadarFrontCenter
 SG_ VFC_Poly04_CoefficientYc3Corr : 288|18@1+ (1.49011611938476E-008,-0.001953125) [-0.001953125|0.00195311009883879] "1/m^2"  RadarFrontCenter
 SG_ VFC_Poly04_Width : 306|6@1+ (0.01,0) [0|0.63] "m"  RadarFrontCenter
 SG_ VFC_Poly04_RangeXCorrectionPoint : 312|8@1+ (1,0) [0|255] "m"  RadarFrontCenter
 SG_ VFC_Poly04_RangeXBegin : 320|9@1+ (0.25,0) [0|127.75] "m"  RadarFrontCenter
 SG_ VFC_Poly04_Reserved0 : 329|7@1+ (1,0) [0|127] "unitless"  RadarFrontCenter
 SG_ VFC_Poly04_RangeXEnd : 336|9@1+ (0.5,0) [0|255.5] "m"  RadarFrontCenter
 SG_ VFC_Poly04_Reserved1 : 345|7@1+ (1,0) [0|127] "unitless"  RadarFrontCenter
 SG_ VFC_Poly05_LaneAssociation : 352|4@1+ (1,0) [0|15] ""  RadarFrontCenter
 SG_ VFC_Poly05_Type : 356|4@1+ (1,0) [0|15] ""  RadarFrontCenter
 SG_ VFC_Poly05_ExistProb : 360|6@1+ (2,0) [0|100] "%"  RadarFrontCenter
 SG_ VFC_Poly05_CoefficientYc3 : 366|18@1+ (1.49011611938476E-008,-0.001953125) [-0.001953125|0.00195311009883879] "1/m^2"  RadarFrontCenter
 SG_ VFC_Poly05_Colour : 384|3@1+ (1,0) [0|7] ""  RadarFrontCenter
 SG_ VFC_Poly05_CoefficientYc2 : 387|17@1+ (9.5367431640625E-007,-0.0625) [-0.0625|0.0624990463256836] "1/m"  RadarFrontCenter
 SG_ VFC_Poly05_CoefficientYc0 : 404|12@1+ (0.0078125,-16) [-16|15.9921875] "m"  RadarFrontCenter
 SG_ VFC_Poly05_CoefficientYc1 : 416|15@1+ (6.103515625E-005,-1) [-1|0.99993896484375] "1"  RadarFrontCenter
 SG_ VFC_Poly05_CoefficientYc2Corr : 431|17@1+ (9.5367431640625E-007,-0.0625) [-0.0625|0.0624990463256836] "1/m"  RadarFrontCenter
 SG_ VFC_Poly05_CoefficientYc3Corr : 448|18@1+ (1.49011611938476E-008,-0.001953125) [-0.001953125|0.00195311009883879] "1/m^2"  RadarFrontCenter
 SG_ VFC_Poly05_Width : 466|6@1+ (0.01,0) [0|0.63] "m"  RadarFrontCenter
 SG_ VFC_Poly05_RangeXCorrectionPoint : 472|8@1+ (1,0) [0|255] "m"  RadarFrontCenter
 SG_ VFC_Poly05_RangeXBegin : 480|9@1+ (0.25,0) [0|127.75] "m"  RadarFrontCenter
 SG_ VFC_Poly05_Reserved0 : 489|7@1+ (1,0) [0|127] "unitless"  RadarFrontCenter
 SG_ VFC_Poly05_RangeXEnd : 496|9@1+ (0.5,0) [0|255.5] "m"  RadarFrontCenter
 SG_ VFC_Poly05_Reserved1 : 505|7@1+ (1,0) [0|127] "unitless"  RadarFrontCenter

BO_ 148 VFC_RoadPolynomial_06_08: 64 VideoFrontCenter
 SG_ VFC_Poly_06_08_CRC : 0|16@1+ (1,0) [0|65535] ""  RadarFrontCenter
 SG_ VFC_Poly_06_08_AliveCtr : 16|8@1+ (1,0) [0|255] ""  RadarFrontCenter
 SG_ VFC_Poly_06_08_ProtBlockCtr : 24|4@1+ (1,0) [0|15] ""  RadarFrontCenter
 SG_ VFC_Poly06_LaneAssociation : 32|4@1+ (1,0) [0|15] ""  RadarFrontCenter
 SG_ VFC_Poly06_Type : 36|4@1+ (1,0) [0|15] ""  RadarFrontCenter
 SG_ VFC_Poly06_ExistProb : 40|6@1+ (2,0) [0|100] "%"  RadarFrontCenter
 SG_ VFC_Poly06_CoefficientYc3 : 46|18@1+ (1.49011611938476E-008,-0.001953125) [-0.001953125|0.00195311009883879] "1/m^2"  RadarFrontCenter
 SG_ VFC_Poly06_Colour : 64|3@1+ (1,0) [0|7] ""  RadarFrontCenter
 SG_ VFC_Poly06_CoefficientYc2 : 67|17@1+ (9.5367431640625E-007,-0.0625) [-0.0625|0.0624990463256836] "1/m"  RadarFrontCenter
 SG_ VFC_Poly06_CoefficientYc0 : 84|12@1+ (0.0078125,-16) [-16|15.9921875] "m"  RadarFrontCenter
 SG_ VFC_Poly06_CoefficientYc1 : 96|15@1+ (6.103515625E-005,-1) [-1|0.99993896484375] "1"  RadarFrontCenter
 SG_ VFC_Poly06_CoefficientYc2Corr : 111|17@1+ (9.5367431640625E-007,-0.0625) [-0.0625|0.0624990463256836] "1/m"  RadarFrontCenter
 SG_ VFC_Poly06_CoefficientYc3Corr : 128|18@1+ (1.49011611938476E-008,-0.001953125) [-0.001953125|0.00195311009883879] "1/m^2"  RadarFrontCenter
 SG_ VFC_Poly06_Width : 146|6@1+ (0.01,0) [0|0.63] "m"  RadarFrontCenter
 SG_ VFC_Poly06_RangeXCorrectionPoint : 152|8@1+ (1,0) [0|255] "m"  RadarFrontCenter
 SG_ VFC_Poly06_RangeXBegin : 160|9@1+ (0.25,0) [0|127.75] "m"  RadarFrontCenter
 SG_ VFC_Poly06_Reserved0 : 169|7@1+ (1,0) [0|127] "unitless"  RadarFrontCenter
 SG_ VFC_Poly06_RangeXEnd : 176|9@1+ (0.5,0) [0|255.5] "m"  RadarFrontCenter
 SG_ VFC_Poly06_Reserved1 : 185|7@1+ (1,0) [0|127] "unitless"  RadarFrontCenter
 SG_ VFC_Poly07_LaneAssociation : 192|4@1+ (1,0) [0|15] ""  RadarFrontCenter
 SG_ VFC_Poly07_Type : 196|4@1+ (1,0) [0|15] ""  RadarFrontCenter
 SG_ VFC_Poly07_ExistProb : 200|6@1+ (2,0) [0|100] "%"  RadarFrontCenter
 SG_ VFC_Poly07_CoefficientYc3 : 206|18@1+ (1.49011611938476E-008,-0.001953125) [-0.001953125|0.00195311009883879] "1/m^2"  RadarFrontCenter
 SG_ VFC_Poly07_Colour : 224|3@1+ (1,0) [0|7] ""  RadarFrontCenter
 SG_ VFC_Poly07_CoefficientYc2 : 227|17@1+ (9.5367431640625E-007,-0.0625) [-0.0625|0.0624990463256836] "1/m"  RadarFrontCenter
 SG_ VFC_Poly07_CoefficientYc0 : 244|12@1+ (0.0078125,-16) [-16|15.9921875] "m"  RadarFrontCenter
 SG_ VFC_Poly07_CoefficientYc1 : 256|15@1+ (6.103515625E-005,-1) [-1|0.99993896484375] "1"  RadarFrontCenter
 SG_ VFC_Poly07_CoefficientYc2Corr : 271|17@1+ (9.5367431640625E-007,-0.0625) [-0.0625|0.0624990463256836] "1/m"  RadarFrontCenter
 SG_ VFC_Poly07_CoefficientYc3Corr : 288|18@1+ (1.49011611938476E-008,-0.001953125) [-0.001953125|0.00195311009883879] "1/m^2"  RadarFrontCenter
 SG_ VFC_Poly07_Width : 306|6@1+ (0.01,0) [0|0.63] "m"  RadarFrontCenter
 SG_ VFC_Poly07_RangeXCorrectionPoint : 312|8@1+ (1,0) [0|255] "m"  RadarFrontCenter
 SG_ VFC_Poly07_RangeXBegin : 320|9@1+ (0.25,0) [0|127.75] "m"  RadarFrontCenter
 SG_ VFC_Poly07_Reserved0 : 329|7@1+ (1,0) [0|127] "unitless"  RadarFrontCenter
 SG_ VFC_Poly07_RangeXEnd : 336|9@1+ (0.5,0) [0|255.5] "m"  RadarFrontCenter
 SG_ VFC_Poly07_Reserved1 : 345|7@1+ (1,0) [0|127] "unitless"  RadarFrontCenter
 SG_ VFC_Poly08_LaneAssociation : 352|4@1+ (1,0) [0|15] ""  RadarFrontCenter
 SG_ VFC_Poly08_Type : 356|4@1+ (1,0) [0|15] ""  RadarFrontCenter
 SG_ VFC_Poly08_ExistProb : 360|6@1+ (2,0) [0|100] "%"  RadarFrontCenter
 SG_ VFC_Poly08_CoefficientYc3 : 366|18@1+ (1.49011611938476E-008,-0.001953125) [-0.001953125|0.00195311009883879] "1/m^2"  RadarFrontCenter
 SG_ VFC_Poly08_Colour : 384|3@1+ (1,0) [0|7] ""  RadarFrontCenter
 SG_ VFC_Poly08_CoefficientYc2 : 387|17@1+ (9.5367431640625E-007,-0.0625) [-0.0625|0.0624990463256836] "1/m"  RadarFrontCenter
 SG_ VFC_Poly08_CoefficientYc0 : 404|12@1+ (0.0078125,-16) [-16|15.9921875] "m"  RadarFrontCenter
 SG_ VFC_Poly08_CoefficientYc1 : 416|15@1+ (6.103515625E-005,-1) [-1|0.99993896484375] "1"  RadarFrontCenter
 SG_ VFC_Poly08_CoefficientYc2Corr : 431|17@1+ (9.5367431640625E-007,-0.0625) [-0.0625|0.0624990463256836] "1/m"  RadarFrontCenter
 SG_ VFC_Poly08_CoefficientYc3Corr : 448|18@1+ (1.49011611938476E-008,-0.001953125) [-0.001953125|0.00195311009883879] "1/m^2"  RadarFrontCenter
 SG_ VFC_Poly08_Width : 466|6@1+ (0.01,0) [0|0.63] "m"  RadarFrontCenter
 SG_ VFC_Poly08_RangeXCorrectionPoint : 472|8@1+ (1,0) [0|255] "m"  RadarFrontCenter
 SG_ VFC_Poly08_RangeXBegin : 480|9@1+ (0.25,0) [0|127.75] "m"  RadarFrontCenter
 SG_ VFC_Poly08_Reserved0 : 489|7@1+ (1,0) [0|127] "unitless"  RadarFrontCenter
 SG_ VFC_Poly08_RangeXEnd : 496|9@1+ (0.5,0) [0|255.5] "m"  RadarFrontCenter
 SG_ VFC_Poly08_Reserved1 : 505|7@1+ (1,0) [0|127] "unitless"  RadarFrontCenter

BO_ 149 VFC_RoadPolynomial_09_11: 64 VideoFrontCenter
 SG_ VFC_Poly_09_11_CRC : 0|16@1+ (1,0) [0|65535] ""  RadarFrontCenter
 SG_ VFC_Poly_09_11_AliveCtr : 16|8@1+ (1,0) [0|255] ""  RadarFrontCenter
 SG_ VFC_Poly_09_11_ProtBlockCtr : 24|4@1+ (1,0) [0|15] ""  RadarFrontCenter
 SG_ VFC_Poly09_LaneAssociation : 32|4@1+ (1,0) [0|15] ""  RadarFrontCenter
 SG_ VFC_Poly09_Type : 36|4@1+ (1,0) [0|15] ""  RadarFrontCenter
 SG_ VFC_Poly09_ExistProb : 40|6@1+ (2,0) [0|100] "%"  RadarFrontCenter
 SG_ VFC_Poly09_CoefficientYc3 : 46|18@1+ (1.49011611938476E-008,-0.001953125) [-0.001953125|0.00195311009883879] "1/m^2"  RadarFrontCenter
 SG_ VFC_Poly09_Colour : 64|3@1+ (1,0) [0|7] ""  RadarFrontCenter
 SG_ VFC_Poly09_CoefficientYc2 : 67|17@1+ (9.5367431640625E-007,-0.0625) [-0.0625|0.0624990463256836] "1/m"  RadarFrontCenter
 SG_ VFC_Poly09_CoefficientYc0 : 84|12@1+ (0.0078125,-16) [-16|15.9921875] "m"  RadarFrontCenter
 SG_ VFC_Poly09_CoefficientYc1 : 96|15@1+ (6.103515625E-005,-1) [-1|0.99993896484375] "1"  RadarFrontCenter
 SG_ VFC_Poly09_CoefficientYc2Corr : 111|17@1+ (9.5367431640625E-007,-0.0625) [-0.0625|0.0624990463256836] "1/m"  RadarFrontCenter
 SG_ VFC_Poly09_CoefficientYc3Corr : 128|18@1+ (1.49011611938476E-008,-0.001953125) [-0.001953125|0.00195311009883879] "1/m^2"  RadarFrontCenter
 SG_ VFC_Poly09_Width : 146|6@1+ (0.01,0) [0|0.63] "m"  RadarFrontCenter
 SG_ VFC_Poly09_RangeXCorrectionPoint : 152|8@1+ (1,0) [0|255] "m"  RadarFrontCenter
 SG_ VFC_Poly09_RangeXBegin : 160|9@1+ (0.25,0) [0|127.75] "m"  RadarFrontCenter
 SG_ VFC_Poly09_Reserved0 : 169|7@1+ (1,0) [0|127] "unitless"  RadarFrontCenter
 SG_ VFC_Poly09_RangeXEnd : 176|9@1+ (0.5,0) [0|255.5] "m"  RadarFrontCenter
 SG_ VFC_Poly09_Reserved1 : 185|7@1+ (1,0) [0|127] "unitless"  RadarFrontCenter
 SG_ VFC_Poly10_LaneAssociation : 192|4@1+ (1,0) [0|15] ""  RadarFrontCenter
 SG_ VFC_Poly10_Type : 196|4@1+ (1,0) [0|15] ""  RadarFrontCenter
 SG_ VFC_Poly10_ExistProb : 200|6@1+ (2,0) [0|100] "%"  RadarFrontCenter
 SG_ VFC_Poly10_CoefficientYc3 : 206|18@1+ (1.49011611938476E-008,-0.001953125) [-0.001953125|0.00195311009883879] "1/m^2"  RadarFrontCenter
 SG_ VFC_Poly10_Colour : 224|3@1+ (1,0) [0|7] ""  RadarFrontCenter
 SG_ VFC_Poly10_CoefficientYc2 : 227|17@1+ (9.5367431640625E-007,-0.0625) [-0.0625|0.0624990463256836] "1/m"  RadarFrontCenter
 SG_ VFC_Poly10_CoefficientYc0 : 244|12@1+ (0.0078125,-16) [-16|15.9921875] "m"  RadarFrontCenter
 SG_ VFC_Poly10_CoefficientYc1 : 256|15@1+ (6.103515625E-005,-1) [-1|0.99993896484375] "1"  RadarFrontCenter
 SG_ VFC_Poly10_CoefficientYc2Corr : 271|17@1+ (9.5367431640625E-007,-0.0625) [-0.0625|0.0624990463256836] "1/m"  RadarFrontCenter
 SG_ VFC_Poly10_CoefficientYc3Corr : 288|18@1+ (1.49011611938476E-008,-0.001953125) [-0.001953125|0.00195311009883879] "1/m^2"  RadarFrontCenter
 SG_ VFC_Poly10_Width : 306|6@1+ (0.01,0) [0|0.63] "m"  RadarFrontCenter
 SG_ VFC_Poly10_RangeXCorrectionPoint : 312|8@1+ (1,0) [0|255] "m"  RadarFrontCenter
 SG_ VFC_Poly10_RangeXBegin : 320|9@1+ (0.25,0) [0|127.75] "m"  RadarFrontCenter
 SG_ VFC_Poly10_Reserved0 : 329|7@1+ (1,0) [0|127] "unitless"  RadarFrontCenter
 SG_ VFC_Poly10_RangeXEnd : 336|9@1+ (0.5,0) [0|255.5] "m"  RadarFrontCenter
 SG_ VFC_Poly10_Reserved1 : 345|7@1+ (1,0) [0|127] "unitless"  RadarFrontCenter
 SG_ VFC_Poly11_LaneAssociation : 352|4@1+ (1,0) [0|15] ""  RadarFrontCenter
 SG_ VFC_Poly11_Type : 356|4@1+ (1,0) [0|15] ""  RadarFrontCenter
 SG_ VFC_Poly11_ExistProb : 360|6@1+ (2,0) [0|100] "%"  RadarFrontCenter
 SG_ VFC_Poly11_CoefficientYc3 : 366|18@1+ (1.49011611938476E-008,-0.001953125) [-0.001953125|0.00195311009883879] "1/m^2"  RadarFrontCenter
 SG_ VFC_Poly11_Colour : 384|3@1+ (1,0) [0|7] ""  RadarFrontCenter
 SG_ VFC_Poly11_CoefficientYc2 : 387|17@1+ (9.5367431640625E-007,-0.0625) [-0.0625|0.0624990463256836] "1/m"  RadarFrontCenter
 SG_ VFC_Poly11_CoefficientYc0 : 404|12@1+ (0.0078125,-16) [-16|15.9921875] "m"  RadarFrontCenter
 SG_ VFC_Poly11_CoefficientYc1 : 416|15@1+ (6.103515625E-005,-1) [-1|0.99993896484375] "1"  RadarFrontCenter
 SG_ VFC_Poly11_CoefficientYc2Corr : 431|17@1+ (9.5367431640625E-007,-0.0625) [-0.0625|0.0624990463256836] "1/m"  RadarFrontCenter
 SG_ VFC_Poly11_CoefficientYc3Corr : 448|18@1+ (1.49011611938476E-008,-0.001953125) [-0.001953125|0.00195311009883879] "1/m^2"  RadarFrontCenter
 SG_ VFC_Poly11_Width : 466|6@1+ (0.01,0) [0|0.63] "m"  RadarFrontCenter
 SG_ VFC_Poly11_RangeXCorrectionPoint : 472|8@1+ (1,0) [0|255] "m"  RadarFrontCenter
 SG_ VFC_Poly11_RangeXBegin : 480|9@1+ (0.25,0) [0|127.75] "m"  RadarFrontCenter
 SG_ VFC_Poly11_Reserved0 : 489|7@1+ (1,0) [0|127] "unitless"  RadarFrontCenter
 SG_ VFC_Poly11_RangeXEnd : 496|9@1+ (0.5,0) [0|255.5] "m"  RadarFrontCenter
 SG_ VFC_Poly11_Reserved1 : 505|7@1+ (1,0) [0|127] "unitless"  RadarFrontCenter

BO_ 162 VFC_Road2DPolynomial_00_02: 64 VideoFrontCenter
 SG_ VFC_2DPoly_00_02_CRC : 0|16@1+ (1,0) [0|65535] ""  RadarFrontCenter
 SG_ VFC_2DPoly_00_02_AliveCtr : 16|8@1+ (1,0) [0|255] ""  RadarFrontCenter
 SG_ VFC_2DPoly_00_02_ProtBlockCtr : 24|4@1+ (1,0) [0|15] ""  RadarFrontCenter
 SG_ VFC_2DPoly00_LaneAssociation : 32|4@1+ (1,0) [0|15] ""  RadarFrontCenter
 SG_ VFC_2DPoly00_ExistProb : 38|6@1+ (2,0) [0|100] "%"  RadarFrontCenter
 SG_ VFC_2DPoly00_Type : 44|4@1+ (1,0) [0|15] ""  RadarFrontCenter
 SG_ VFC_2DPoly00_CoefficientUc0 : 48|16@1+ (0.25,-8192) [-8192|8191.75] "pixel"  RadarFrontCenter
 SG_ VFC_2DPoly00_CoefficientUc1 : 64|16@1+ (0.25,-8192) [-8192|8191.75] "pixel"  RadarFrontCenter
 SG_ VFC_2DPoly00_CoefficientUc2 : 80|16@1+ (0.25,-8192) [-8192|8191.75] "pixel"  RadarFrontCenter
 SG_ VFC_2DPoly00_CoefficientUc3 : 96|16@1+ (0.25,-8192) [-8192|8191.75] "pixel"  RadarFrontCenter
 SG_ VFC_2DPoly00_CoefficientUc4 : 112|16@1+ (0.25,-8192) [-8192|8191.75] "pixel"  RadarFrontCenter
 SG_ VFC_2DPoly00_CoefficientUc5 : 128|16@1+ (0.25,-8192) [-8192|8191.75] "pixel"  RadarFrontCenter
 SG_ VFC_2DPoly00_RangeVBegin : 144|12@1+ (1,0) [0|4095] "pixel"  RadarFrontCenter
 SG_ VFC_2DPoly00_RangeVEnd : 156|12@1+ (1,0) [0|4095] "pixel"  RadarFrontCenter
 SG_ VFC_2DPoly01_LaneAssociation : 192|4@1+ (1,0) [0|15] ""  RadarFrontCenter
 SG_ VFC_2DPoly01_ExistProb : 198|6@1+ (2,0) [0|100] "%"  RadarFrontCenter
 SG_ VFC_2DPoly01_Type : 204|4@1+ (1,0) [0|15] ""  RadarFrontCenter
 SG_ VFC_2DPoly01_CoefficientUc0 : 208|16@1+ (0.25,-8192) [-8192|8191.75] "pixel"  RadarFrontCenter
 SG_ VFC_2DPoly01_CoefficientUc1 : 224|16@1+ (0.25,-8192) [-8192|8191.75] "pixel"  RadarFrontCenter
 SG_ VFC_2DPoly01_CoefficientUc2 : 240|16@1+ (0.25,-8192) [-8192|8191.75] "pixel"  RadarFrontCenter
 SG_ VFC_2DPoly01_CoefficientUc3 : 256|16@1+ (0.25,-8192) [-8192|8191.75] "pixel"  RadarFrontCenter
 SG_ VFC_2DPoly01_CoefficientUc4 : 272|16@1+ (0.25,-8192) [-8192|8191.75] "pixel"  RadarFrontCenter
 SG_ VFC_2DPoly01_CoefficientUc5 : 288|16@1+ (0.25,-8192) [-8192|8191.75] "pixel"  RadarFrontCenter
 SG_ VFC_2DPoly01_RangeVBegin : 304|12@1+ (1,0) [0|4095] "pixel"  RadarFrontCenter
 SG_ VFC_2DPoly01_RangeVEnd : 316|12@1+ (1,0) [0|4095] "pixel"  RadarFrontCenter
 SG_ VFC_2DPoly02_LaneAssociation : 352|4@1+ (1,0) [0|15] ""  RadarFrontCenter
 SG_ VFC_2DPoly02_ExistProb : 358|6@1+ (2,0) [0|100] "%"  RadarFrontCenter
 SG_ VFC_2DPoly02_Type : 364|4@1+ (1,0) [0|15] ""  RadarFrontCenter
 SG_ VFC_2DPoly02_CoefficientUc0 : 368|16@1+ (0.25,-8192) [-8192|8191.75] "pixel"  RadarFrontCenter
 SG_ VFC_2DPoly02_CoefficientUc1 : 384|16@1+ (0.25,-8192) [-8192|8191.75] "pixel"  RadarFrontCenter
 SG_ VFC_2DPoly02_CoefficientUc2 : 400|16@1+ (0.25,-8192) [-8192|8191.75] "pixel"  RadarFrontCenter
 SG_ VFC_2DPoly02_CoefficientUc3 : 416|16@1+ (0.25,-8192) [-8192|8191.75] "pixel"  RadarFrontCenter
 SG_ VFC_2DPoly02_CoefficientUc4 : 432|16@1+ (0.25,-8192) [-8192|8191.75] "pixel"  RadarFrontCenter
 SG_ VFC_2DPoly02_CoefficientUc5 : 448|16@1+ (0.25,-8192) [-8192|8191.75] "pixel"  RadarFrontCenter
 SG_ VFC_2DPoly02_RangeVBegin : 464|12@1+ (1,0) [0|4095] "pixel"  RadarFrontCenter
 SG_ VFC_2DPoly02_RangeVEnd : 476|12@1+ (1,0) [0|4095] "pixel"  RadarFrontCenter

BO_ 163 VFC_Road2DPolynomial_03_05: 64 VideoFrontCenter
 SG_ VFC_2DPoly_03_05_CRC : 0|16@1+ (1,0) [0|65535] ""  RadarFrontCenter
 SG_ VFC_2DPoly_03_05_AliveCtr : 16|8@1+ (1,0) [0|255] ""  RadarFrontCenter
 SG_ VFC_2DPoly_03_05_ProtBlockCtr : 24|4@1+ (1,0) [0|15] ""  RadarFrontCenter
 SG_ VFC_2DPoly03_LaneAssociation : 32|4@1+ (1,0) [0|15] ""  RadarFrontCenter
 SG_ VFC_2DPoly03_ExistProb : 38|6@1+ (2,0) [0|100] "%"  RadarFrontCenter
 SG_ VFC_2DPoly03_Type : 44|4@1+ (1,0) [0|15] ""  RadarFrontCenter
 SG_ VFC_2DPoly03_CoefficientUc0 : 48|16@1+ (0.25,-8192) [-8192|8191.75] "pixel"  RadarFrontCenter
 SG_ VFC_2DPoly03_CoefficientUc1 : 64|16@1+ (0.25,-8192) [-8192|8191.75] "pixel"  RadarFrontCenter
 SG_ VFC_2DPoly03_CoefficientUc2 : 80|16@1+ (0.25,-8192) [-8192|8191.75] "pixel"  RadarFrontCenter
 SG_ VFC_2DPoly03_CoefficientUc3 : 96|16@1+ (0.25,-8192) [-8192|8191.75] "pixel"  RadarFrontCenter
 SG_ VFC_2DPoly03_CoefficientUc4 : 112|16@1+ (0.25,-8192) [-8192|8191.75] "pixel"  RadarFrontCenter
 SG_ VFC_2DPoly03_CoefficientUc5 : 128|16@1+ (0.25,-8192) [-8192|8191.75] "pixel"  RadarFrontCenter
 SG_ VFC_2DPoly03_RangeVBegin : 144|12@1+ (1,0) [0|4095] "pixel"  RadarFrontCenter
 SG_ VFC_2DPoly03_RangeVEnd : 156|12@1+ (1,0) [0|4095] "pixel"  RadarFrontCenter
 SG_ VFC_2DPoly04_LaneAssociation : 192|4@1+ (1,0) [0|15] ""  RadarFrontCenter
 SG_ VFC_2DPoly04_ExistProb : 198|6@1+ (2,0) [0|100] "%"  RadarFrontCenter
 SG_ VFC_2DPoly04_Type : 204|4@1+ (1,0) [0|15] ""  RadarFrontCenter
 SG_ VFC_2DPoly04_CoefficientUc0 : 208|16@1+ (0.25,-8192) [-8192|8191.75] "pixel"  RadarFrontCenter
 SG_ VFC_2DPoly04_CoefficientUc1 : 224|16@1+ (0.25,-8192) [-8192|8191.75] "pixel"  RadarFrontCenter
 SG_ VFC_2DPoly04_CoefficientUc2 : 240|16@1+ (0.25,-8192) [-8192|8191.75] "pixel"  RadarFrontCenter
 SG_ VFC_2DPoly04_CoefficientUc3 : 256|16@1+ (0.25,-8192) [-8192|8191.75] "pixel"  RadarFrontCenter
 SG_ VFC_2DPoly04_CoefficientUc4 : 272|16@1+ (0.25,-8192) [-8192|8191.75] "pixel"  RadarFrontCenter
 SG_ VFC_2DPoly04_CoefficientUc5 : 288|16@1+ (0.25,-8192) [-8192|8191.75] "pixel"  RadarFrontCenter
 SG_ VFC_2DPoly04_RangeVBegin : 304|12@1+ (1,0) [0|4095] "pixel"  RadarFrontCenter
 SG_ VFC_2DPoly04_RangeVEnd : 316|12@1+ (1,0) [0|4095] "pixel"  RadarFrontCenter
 SG_ VFC_2DPoly05_LaneAssociation : 352|4@1+ (1,0) [0|15] ""  RadarFrontCenter
 SG_ VFC_2DPoly05_ExistProb : 358|6@1+ (2,0) [0|100] "%"  RadarFrontCenter
 SG_ VFC_2DPoly05_Type : 364|4@1+ (1,0) [0|15] ""  RadarFrontCenter
 SG_ VFC_2DPoly05_CoefficientUc0 : 368|16@1+ (0.25,-8192) [-8192|8191.75] "pixel"  RadarFrontCenter
 SG_ VFC_2DPoly05_CoefficientUc1 : 384|16@1+ (0.25,-8192) [-8192|8191.75] "pixel"  RadarFrontCenter
 SG_ VFC_2DPoly05_CoefficientUc2 : 400|16@1+ (0.25,-8192) [-8192|8191.75] "pixel"  RadarFrontCenter
 SG_ VFC_2DPoly05_CoefficientUc3 : 416|16@1+ (0.25,-8192) [-8192|8191.75] "pixel"  RadarFrontCenter
 SG_ VFC_2DPoly05_CoefficientUc4 : 432|16@1+ (0.25,-8192) [-8192|8191.75] "pixel"  RadarFrontCenter
 SG_ VFC_2DPoly05_CoefficientUc5 : 448|16@1+ (0.25,-8192) [-8192|8191.75] "pixel"  RadarFrontCenter
 SG_ VFC_2DPoly05_RangeVBegin : 464|12@1+ (1,0) [0|4095] "pixel"  RadarFrontCenter
 SG_ VFC_2DPoly05_RangeVEnd : 476|12@1+ (1,0) [0|4095] "pixel"  RadarFrontCenter

BO_ 164 VFC_Road2DPolynomial_06_08: 64 VideoFrontCenter
 SG_ VFC_2DPoly_06_08_CRC : 0|16@1+ (1,0) [0|65535] ""  RadarFrontCenter
 SG_ VFC_2DPoly_06_08_AliveCtr : 16|8@1+ (1,0) [0|255] ""  RadarFrontCenter
 SG_ VFC_2DPoly_06_08_ProtBlockCtr : 24|4@1+ (1,0) [0|15] ""  RadarFrontCenter
 SG_ VFC_2DPoly06_LaneAssociation : 32|4@1+ (1,0) [0|15] ""  RadarFrontCenter
 SG_ VFC_2DPoly06_ExistProb : 38|6@1+ (2,0) [0|100] "%"  RadarFrontCenter
 SG_ VFC_2DPoly06_Type : 44|4@1+ (1,0) [0|15] ""  RadarFrontCenter
 SG_ VFC_2DPoly06_CoefficientUc0 : 48|16@1+ (0.25,-8192) [-8192|8191.75] "pixel"  RadarFrontCenter
 SG_ VFC_2DPoly06_CoefficientUc1 : 64|16@1+ (0.25,-8192) [-8192|8191.75] "pixel"  RadarFrontCenter
 SG_ VFC_2DPoly06_CoefficientUc2 : 80|16@1+ (0.25,-8192) [-8192|8191.75] "pixel"  RadarFrontCenter
 SG_ VFC_2DPoly06_CoefficientUc3 : 96|16@1+ (0.25,-8192) [-8192|8191.75] "pixel"  RadarFrontCenter
 SG_ VFC_2DPoly06_CoefficientUc4 : 112|16@1+ (0.25,-8192) [-8192|8191.75] "pixel"  RadarFrontCenter
 SG_ VFC_2DPoly06_CoefficientUc5 : 128|16@1+ (0.25,-8192) [-8192|8191.75] "pixel"  RadarFrontCenter
 SG_ VFC_2DPoly06_RangeVBegin : 144|12@1+ (1,0) [0|4095] "pixel"  RadarFrontCenter
 SG_ VFC_2DPoly06_RangeVEnd : 156|12@1+ (1,0) [0|4095] "pixel"  RadarFrontCenter
 SG_ VFC_2DPoly07_LaneAssociation : 192|4@1+ (1,0) [0|15] ""  RadarFrontCenter
 SG_ VFC_2DPoly07_ExistProb : 198|6@1+ (2,0) [0|100] "%"  RadarFrontCenter
 SG_ VFC_2DPoly07_Type : 204|4@1+ (1,0) [0|15] ""  RadarFrontCenter
 SG_ VFC_2DPoly07_CoefficientUc0 : 208|16@1+ (0.25,-8192) [-8192|8191.75] "pixel"  RadarFrontCenter
 SG_ VFC_2DPoly07_CoefficientUc1 : 224|16@1+ (0.25,-8192) [-8192|8191.75] "pixel"  RadarFrontCenter
 SG_ VFC_2DPoly07_CoefficientUc2 : 240|16@1+ (0.25,-8192) [-8192|8191.75] "pixel"  RadarFrontCenter
 SG_ VFC_2DPoly07_CoefficientUc3 : 256|16@1+ (0.25,-8192) [-8192|8191.75] "pixel"  RadarFrontCenter
 SG_ VFC_2DPoly07_CoefficientUc4 : 272|16@1+ (0.25,-8192) [-8192|8191.75] "pixel"  RadarFrontCenter
 SG_ VFC_2DPoly07_CoefficientUc5 : 288|16@1+ (0.25,-8192) [-8192|8191.75] "pixel"  RadarFrontCenter
 SG_ VFC_2DPoly07_RangeVBegin : 304|12@1+ (1,0) [0|4095] "pixel"  RadarFrontCenter
 SG_ VFC_2DPoly07_RangeVEnd : 316|12@1+ (1,0) [0|4095] "pixel"  RadarFrontCenter
 SG_ VFC_2DPoly08_LaneAssociation : 352|4@1+ (1,0) [0|15] ""  RadarFrontCenter
 SG_ VFC_2DPoly08_ExistProb : 358|6@1+ (2,0) [0|100] "%"  RadarFrontCenter
 SG_ VFC_2DPoly08_Type : 364|4@1+ (1,0) [0|15] ""  RadarFrontCenter
 SG_ VFC_2DPoly08_CoefficientUc0 : 368|16@1+ (0.25,-8192) [-8192|8191.75] "pixel"  RadarFrontCenter
 SG_ VFC_2DPoly08_CoefficientUc1 : 384|16@1+ (0.25,-8192) [-8192|8191.75] "pixel"  RadarFrontCenter
 SG_ VFC_2DPoly08_CoefficientUc2 : 400|16@1+ (0.25,-8192) [-8192|8191.75] "pixel"  RadarFrontCenter
 SG_ VFC_2DPoly08_CoefficientUc3 : 416|16@1+ (0.25,-8192) [-8192|8191.75] "pixel"  RadarFrontCenter
 SG_ VFC_2DPoly08_CoefficientUc4 : 432|16@1+ (0.25,-8192) [-8192|8191.75] "pixel"  RadarFrontCenter
 SG_ VFC_2DPoly08_CoefficientUc5 : 448|16@1+ (0.25,-8192) [-8192|8191.75] "pixel"  RadarFrontCenter
 SG_ VFC_2DPoly08_RangeVBegin : 464|12@1+ (1,0) [0|4095] "pixel"  RadarFrontCenter
 SG_ VFC_2DPoly08_RangeVEnd : 476|12@1+ (1,0) [0|4095] "pixel"  RadarFrontCenter

BO_ 165 VFC_Road2DPolynomial_09_11: 64 VideoFrontCenter
 SG_ VFC_2DPoly_09_11_CRC : 0|16@1+ (1,0) [0|65535] ""  RadarFrontCenter
 SG_ VFC_2DPoly_09_11_AliveCtr : 16|8@1+ (1,0) [0|255] ""  RadarFrontCenter
 SG_ VFC_2DPoly_09_11_ProtBlockCtr : 24|4@1+ (1,0) [0|15] ""  RadarFrontCenter
 SG_ VFC_2DPoly09_LaneAssociation : 32|4@1+ (1,0) [0|15] ""  RadarFrontCenter
 SG_ VFC_2DPoly09_ExistProb : 38|6@1+ (2,0) [0|100] "%"  RadarFrontCenter
 SG_ VFC_2DPoly09_Type : 44|4@1+ (1,0) [0|15] ""  RadarFrontCenter
 SG_ VFC_2DPoly09_CoefficientUc0 : 48|16@1+ (0.25,-8192) [-8192|8191.75] "pixel"  RadarFrontCenter
 SG_ VFC_2DPoly09_CoefficientUc1 : 64|16@1+ (0.25,-8192) [-8192|8191.75] "pixel"  RadarFrontCenter
 SG_ VFC_2DPoly09_CoefficientUc2 : 80|16@1+ (0.25,-8192) [-8192|8191.75] "pixel"  RadarFrontCenter
 SG_ VFC_2DPoly09_CoefficientUc3 : 96|16@1+ (0.25,-8192) [-8192|8191.75] "pixel"  RadarFrontCenter
 SG_ VFC_2DPoly09_CoefficientUc4 : 112|16@1+ (0.25,-8192) [-8192|8191.75] "pixel"  RadarFrontCenter
 SG_ VFC_2DPoly09_CoefficientUc5 : 128|16@1+ (0.25,-8192) [-8192|8191.75] "pixel"  RadarFrontCenter
 SG_ VFC_2DPoly09_RangeVBegin : 144|12@1+ (1,0) [0|4095] "pixel"  RadarFrontCenter
 SG_ VFC_2DPoly09_RangeVEnd : 156|12@1+ (1,0) [0|4095] "pixel"  RadarFrontCenter
 SG_ VFC_2DPoly10_LaneAssociation : 192|4@1+ (1,0) [0|15] ""  RadarFrontCenter
 SG_ VFC_2DPoly10_ExistProb : 198|6@1+ (2,0) [0|100] "%"  RadarFrontCenter
 SG_ VFC_2DPoly10_Type : 204|4@1+ (1,0) [0|15] ""  RadarFrontCenter
 SG_ VFC_2DPoly10_CoefficientUc0 : 208|16@1+ (0.25,-8192) [-8192|8191.75] "pixel"  RadarFrontCenter
 SG_ VFC_2DPoly10_CoefficientUc1 : 224|16@1+ (0.25,-8192) [-8192|8191.75] "pixel"  RadarFrontCenter
 SG_ VFC_2DPoly10_CoefficientUc2 : 240|16@1+ (0.25,-8192) [-8192|8191.75] "pixel"  RadarFrontCenter
 SG_ VFC_2DPoly10_CoefficientUc3 : 256|16@1+ (0.25,-8192) [-8192|8191.75] "pixel"  RadarFrontCenter
 SG_ VFC_2DPoly10_CoefficientUc4 : 272|16@1+ (0.25,-8192) [-8192|8191.75] "pixel"  RadarFrontCenter
 SG_ VFC_2DPoly10_CoefficientUc5 : 288|16@1+ (0.25,-8192) [-8192|8191.75] "pixel"  RadarFrontCenter
 SG_ VFC_2DPoly10_RangeVBegin : 304|12@1+ (1,0) [0|4095] "pixel"  RadarFrontCenter
 SG_ VFC_2DPoly10_RangeVEnd : 316|12@1+ (1,0) [0|4095] "pixel"  RadarFrontCenter
 SG_ VFC_2DPoly11_LaneAssociation : 352|4@1+ (1,0) [0|15] ""  RadarFrontCenter
 SG_ VFC_2DPoly11_ExistProb : 358|6@1+ (2,0) [0|100] "%"  RadarFrontCenter
 SG_ VFC_2DPoly11_Type : 364|4@1+ (1,0) [0|15] ""  RadarFrontCenter
 SG_ VFC_2DPoly11_CoefficientUc0 : 368|16@1+ (0.25,-8192) [-8192|8191.75] "pixel"  RadarFrontCenter
 SG_ VFC_2DPoly11_CoefficientUc1 : 384|16@1+ (0.25,-8192) [-8192|8191.75] "pixel"  RadarFrontCenter
 SG_ VFC_2DPoly11_CoefficientUc2 : 400|16@1+ (0.25,-8192) [-8192|8191.75] "pixel"  RadarFrontCenter
 SG_ VFC_2DPoly11_CoefficientUc3 : 416|16@1+ (0.25,-8192) [-8192|8191.75] "pixel"  RadarFrontCenter
 SG_ VFC_2DPoly11_CoefficientUc4 : 432|16@1+ (0.25,-8192) [-8192|8191.75] "pixel"  RadarFrontCenter
 SG_ VFC_2DPoly11_CoefficientUc5 : 448|16@1+ (0.25,-8192) [-8192|8191.75] "pixel"  RadarFrontCenter
 SG_ VFC_2DPoly11_RangeVBegin : 464|12@1+ (1,0) [0|4095] "pixel"  RadarFrontCenter
 SG_ VFC_2DPoly11_RangeVEnd : 476|12@1+ (1,0) [0|4095] "pixel"  RadarFrontCenter

BO_ 178 VFC_RoadMarking_00_06: 64 VideoFrontCenter
 SG_ VFC_RM_00_06_CRC : 0|16@1+ (1,0) [0|65535] ""  RadarFrontCenter
 SG_ VFC_RM_00_06_AliveCtr : 16|8@1+ (1,0) [0|255] ""  RadarFrontCenter
 SG_ VFC_RM_00_06_ProtBlockCtr : 24|4@1+ (1,0) [0|15] ""  RadarFrontCenter
 SG_ VFC_RM00_ExistProb : 32|6@1+ (2,0) [0|100] "%"  RadarFrontCenter
 SG_ VFC_RM00_Type : 38|5@1+ (1,0) [0|31] ""  RadarFrontCenter
 SG_ VFC_RM00_VertexPoint00x : 43|11@1+ (0.1,0) [0|204.7] "m"  RadarFrontCenter
 SG_ VFC_RM00_VertexPoint00y : 54|9@1+ (0.1,-25.6) [-25.6|25.5] "m"  RadarFrontCenter
 SG_ VFC_RM00_VertexPoint01x : 63|11@1+ (0.1,0) [0|204.7] "m"  RadarFrontCenter
 SG_ VFC_RM00_VertexPoint01y : 74|9@1+ (0.1,-25.6) [-25.6|25.5] "m"  RadarFrontCenter
 SG_ VFC_RM01_ExistProb : 96|6@1+ (2,0) [0|100] "%"  RadarFrontCenter
 SG_ VFC_RM01_Type : 102|5@1+ (1,0) [0|31] ""  RadarFrontCenter
 SG_ VFC_RM01_VertexPoint00x : 107|11@1+ (0.1,0) [0|204.7] "m"  RadarFrontCenter
 SG_ VFC_RM01_VertexPoint00y : 118|9@1+ (0.1,-25.6) [-25.6|25.5] "m"  RadarFrontCenter
 SG_ VFC_RM01_VertexPoint01x : 127|11@1+ (0.1,0) [0|204.7] "m"  RadarFrontCenter
 SG_ VFC_RM01_VertexPoint01y : 138|9@1+ (0.1,-25.6) [-25.6|25.5] "m"  RadarFrontCenter
 SG_ VFC_RM02_ExistProb : 160|6@1+ (2,0) [0|100] "%"  RadarFrontCenter
 SG_ VFC_RM02_Type : 166|5@1+ (1,0) [0|31] ""  RadarFrontCenter
 SG_ VFC_RM02_VertexPoint00x : 171|11@1+ (0.1,0) [0|204.7] "m"  RadarFrontCenter
 SG_ VFC_RM02_VertexPoint00y : 182|9@1+ (0.1,-25.6) [-25.6|25.5] "m"  RadarFrontCenter
 SG_ VFC_RM02_VertexPoint01x : 191|11@1+ (0.1,0) [0|204.7] "m"  RadarFrontCenter
 SG_ VFC_RM02_VertexPoint01y : 202|9@1+ (0.1,-25.6) [-25.6|25.5] "m"  RadarFrontCenter
 SG_ VFC_RM03_ExistProb : 224|6@1+ (2,0) [0|100] "%"  RadarFrontCenter
 SG_ VFC_RM03_Type : 230|5@1+ (1,0) [0|31] ""  RadarFrontCenter
 SG_ VFC_RM03_VertexPoint00x : 235|11@1+ (0.1,0) [0|204.7] "m"  RadarFrontCenter
 SG_ VFC_RM03_VertexPoint00y : 246|9@1+ (0.1,-25.6) [-25.6|25.5] "m"  RadarFrontCenter
 SG_ VFC_RM03_VertexPoint01x : 255|11@1+ (0.1,0) [0|204.7] "m"  RadarFrontCenter
 SG_ VFC_RM03_VertexPoint01y : 266|9@1+ (0.1,-25.6) [-25.6|25.5] "m"  RadarFrontCenter
 SG_ VFC_RM04_ExistProb : 288|6@1+ (2,0) [0|100] "%"  RadarFrontCenter
 SG_ VFC_RM04_Type : 294|5@1+ (1,0) [0|31] ""  RadarFrontCenter
 SG_ VFC_RM04_VertexPoint00x : 299|11@1+ (0.1,0) [0|204.7] "m"  RadarFrontCenter
 SG_ VFC_RM04_VertexPoint00y : 310|9@1+ (0.1,-25.6) [-25.6|25.5] "m"  RadarFrontCenter
 SG_ VFC_RM04_VertexPoint01x : 319|11@1+ (0.1,0) [0|204.7] "m"  RadarFrontCenter
 SG_ VFC_RM04_VertexPoint01y : 330|9@1+ (0.1,-25.6) [-25.6|25.5] "m"  RadarFrontCenter
 SG_ VFC_RM05_ExistProb : 352|6@1+ (2,0) [0|100] "%"  RadarFrontCenter
 SG_ VFC_RM05_Type : 358|5@1+ (1,0) [0|31] ""  RadarFrontCenter
 SG_ VFC_RM05_VertexPoint00x : 363|11@1+ (0.1,0) [0|204.7] "m"  RadarFrontCenter
 SG_ VFC_RM05_VertexPoint00y : 374|9@1+ (0.1,-25.6) [-25.6|25.5] "m"  RadarFrontCenter
 SG_ VFC_RM05_VertexPoint01x : 383|11@1+ (0.1,0) [0|204.7] "m"  RadarFrontCenter
 SG_ VFC_RM05_VertexPoint01y : 394|9@1+ (0.1,-25.6) [-25.6|25.5] "m"  RadarFrontCenter
 SG_ VFC_RM06_ExistProb : 416|6@1+ (2,0) [0|100] "%"  RadarFrontCenter
 SG_ VFC_RM06_Type : 422|5@1+ (1,0) [0|31] ""  RadarFrontCenter
 SG_ VFC_RM06_VertexPoint00x : 427|11@1+ (0.1,0) [0|204.7] "m"  RadarFrontCenter
 SG_ VFC_RM06_VertexPoint00y : 438|9@1+ (0.1,-25.6) [-25.6|25.5] "m"  RadarFrontCenter
 SG_ VFC_RM06_VertexPoint01x : 447|11@1+ (0.1,0) [0|204.7] "m"  RadarFrontCenter
 SG_ VFC_RM06_VertexPoint01y : 458|9@1+ (0.1,-25.6) [-25.6|25.5] "m"  RadarFrontCenter

BO_ 224 VFC_TrafficLightHdr: 20 VideoFrontCenter
 SG_ VFC_TLHdr_CRC : 0|16@1+ (1,0) [0|65535] ""  RadarFrontCenter
 SG_ VFC_TLHdr_AliveCtr : 16|8@1+ (1,0) [0|255] ""  RadarFrontCenter
 SG_ VFC_TLHdr_ProtBlockCtr : 24|4@1+ (1,0) [0|15] ""  RadarFrontCenter
 SG_ VFC_TLHdr_IfVersionIdMajor : 32|8@1+ (1,0) [0|255] ""  RadarFrontCenter
 SG_ VFC_TLHdr_IfVersionIdMinor : 40|8@1+ (1,0) [0|255] ""  RadarFrontCenter
 SG_ VFC_TLHdr_NumTrafficLights : 48|5@1+ (1,0) [0|31] ""  RadarFrontCenter
 SG_ VFC_TLHdr_TimeStampStatus : 56|8@1+ (1,0) [0|255] ""  RadarFrontCenter
 SG_ VFC_TLHdr_TimeStamp : 64|26@1+ (1,0) [0|67108863] "ms"  RadarFrontCenter
 SG_ VFC_TLHdr_State : 96|3@1+ (1,0) [0|7] ""  RadarFrontCenter
 SG_ VFC_TLHdr_MostRelevantTLId : 104|5@1+ (1,0) [0|31] ""  RadarFrontCenter
 SG_ VFC_TLHdr_Reserved0 : 112|8@1+ (1,0) [0|255] ""  RadarFrontCenter
 SG_ VFC_TLHdr_Reserved1 : 120|8@1+ (1,0) [0|255] ""  RadarFrontCenter

BO_ 226 VFC_TrafficLight_00_04: 64 VideoFrontCenter
 SG_ VFC_TL00_04_CRC : 0|16@1+ (1,0) [0|65535] ""  RadarFrontCenter
 SG_ VFC_TL00_04_AliveCtr : 16|8@1+ (1,0) [0|255] ""  RadarFrontCenter
 SG_ VFC_TL00_04_ProtBlockCtr : 24|4@1+ (1,0) [0|15] ""  RadarFrontCenter
 SG_ VFC_TL00_Colour : 32|2@1+ (1,0) [0|3] ""  RadarFrontCenter
 SG_ VFC_TL00_LightShapeType : 34|4@1+ (1,0) [0|15] ""  RadarFrontCenter
 SG_ VFC_TL00_LightModeType : 38|2@1+ (1,0) [0|3] ""  RadarFrontCenter
 SG_ VFC_TL00_Py : 40|10@1+ (0.1,-51.2) [-51.2|51.1] "m"  RadarFrontCenter
 SG_ VFC_TL00_ExistProb : 50|6@1+ (2,0) [0|100] "%"  RadarFrontCenter
 SG_ VFC_TL00_Pz : 56|8@1+ (0.1,0) [0|25.5] "m"  RadarFrontCenter
 SG_ VFC_TL00_2DWidth : 64|8@1+ (0.03,0) [0|7.65] "degree"  RadarFrontCenter
 SG_ VFC_TL00_2DHeight : 72|8@1+ (0.03,0) [0|7.65] "degree"  RadarFrontCenter
 SG_ VFC_TL00_2DLeftEdge : 80|12@1+ (0.03,-61.44) [-61.44|61.41] "degree"  RadarFrontCenter
 SG_ VFC_TL00_2DTopEdge : 92|11@1+ (0.03,-30.72) [-30.72|30.69] "degree"  RadarFrontCenter
 SG_ VFC_TL00_Px : 104|11@1+ (0.1,0) [0|204.7] "m"  RadarFrontCenter
 SG_ VFC_TL01_Colour : 120|2@1+ (1,0) [0|3] ""  RadarFrontCenter
 SG_ VFC_TL01_LightShapeType : 122|4@1+ (1,0) [0|15] ""  RadarFrontCenter
 SG_ VFC_TL01_LightModeType : 126|2@1+ (1,0) [0|3] ""  RadarFrontCenter
 SG_ VFC_TL01_Py : 128|10@1+ (0.1,-51.2) [-51.2|51.1] "m"  RadarFrontCenter
 SG_ VFC_TL01_ExistProb : 138|6@1+ (2,0) [0|100] "%"  RadarFrontCenter
 SG_ VFC_TL01_Pz : 144|8@1+ (0.1,0) [0|25.5] "m"  RadarFrontCenter
 SG_ VFC_TL01_2DWidth : 152|8@1+ (0.03,0) [0|7.65] "degree"  RadarFrontCenter
 SG_ VFC_TL01_2DHeight : 160|8@1+ (0.03,0) [0|7.65] "degree"  RadarFrontCenter
 SG_ VFC_TL01_2DLeftEdge : 168|12@1+ (0.03,-61.44) [-61.44|61.41] "degree"  RadarFrontCenter
 SG_ VFC_TL01_2DTopEdge : 180|11@1+ (0.03,-30.72) [-30.72|30.69] "degree"  RadarFrontCenter
 SG_ VFC_TL01_Px : 192|11@1+ (0.1,0) [0|204.7] "m"  RadarFrontCenter
 SG_ VFC_TL02_Colour : 208|2@1+ (1,0) [0|3] ""  RadarFrontCenter
 SG_ VFC_TL02_LightShapeType : 210|4@1+ (1,0) [0|15] ""  RadarFrontCenter
 SG_ VFC_TL02_LightModeType : 214|2@1+ (1,0) [0|3] ""  RadarFrontCenter
 SG_ VFC_TL02_Py : 216|10@1+ (0.1,-51.2) [-51.2|51.1] "m"  RadarFrontCenter
 SG_ VFC_TL02_ExistProb : 226|6@1+ (2,0) [0|100] "%"  RadarFrontCenter
 SG_ VFC_TL02_Pz : 232|8@1+ (0.1,0) [0|25.5] "m"  RadarFrontCenter
 SG_ VFC_TL02_2DWidth : 240|8@1+ (0.03,0) [0|7.65] "degree"  RadarFrontCenter
 SG_ VFC_TL02_2DHeight : 248|8@1+ (0.03,0) [0|7.65] "degree"  RadarFrontCenter
 SG_ VFC_TL02_2DLeftEdge : 256|12@1+ (0.03,-61.44) [-61.44|61.41] "degree"  RadarFrontCenter
 SG_ VFC_TL02_2DTopEdge : 268|11@1+ (0.03,-30.72) [-30.72|30.69] "degree"  RadarFrontCenter
 SG_ VFC_TL02_Px : 280|11@1+ (0.1,0) [0|204.7] "m"  RadarFrontCenter
 SG_ VFC_TL03_Colour : 296|2@1+ (1,0) [0|3] ""  RadarFrontCenter
 SG_ VFC_TL03_LightShapeType : 298|4@1+ (1,0) [0|15] ""  RadarFrontCenter
 SG_ VFC_TL03_LightModeType : 302|2@1+ (1,0) [0|3] ""  RadarFrontCenter
 SG_ VFC_TL03_Py : 304|10@1+ (0.1,-51.2) [-51.2|51.1] "m"  RadarFrontCenter
 SG_ VFC_TL03_ExistProb : 314|6@1+ (2,0) [0|100] "%"  RadarFrontCenter
 SG_ VFC_TL03_Pz : 320|8@1+ (0.1,0) [0|25.5] "m"  RadarFrontCenter
 SG_ VFC_TL03_2DWidth : 328|8@1+ (0.03,0) [0|7.65] "degree"  RadarFrontCenter
 SG_ VFC_TL03_2DHeight : 336|8@1+ (0.03,0) [0|7.65] "degree"  RadarFrontCenter
 SG_ VFC_TL03_2DLeftEdge : 344|12@1+ (0.03,-61.44) [-61.44|61.41] "degree"  RadarFrontCenter
 SG_ VFC_TL03_2DTopEdge : 356|11@1+ (0.03,-30.72) [-30.72|30.69] "degree"  RadarFrontCenter
 SG_ VFC_TL03_Px : 368|11@1+ (0.1,0) [0|204.7] "m"  RadarFrontCenter
 SG_ VFC_TL04_Colour : 384|2@1+ (1,0) [0|3] ""  RadarFrontCenter
 SG_ VFC_TL04_LightShapeType : 386|4@1+ (1,0) [0|15] ""  RadarFrontCenter
 SG_ VFC_TL04_LightModeType : 390|2@1+ (1,0) [0|3] ""  RadarFrontCenter
 SG_ VFC_TL04_Py : 392|10@1+ (0.1,-51.2) [-51.2|51.1] "m"  RadarFrontCenter
 SG_ VFC_TL04_ExistProb : 402|6@1+ (2,0) [0|100] "%"  RadarFrontCenter
 SG_ VFC_TL04_Pz : 408|8@1+ (0.1,0) [0|25.5] "m"  RadarFrontCenter
 SG_ VFC_TL04_2DWidth : 416|8@1+ (0.03,0) [0|7.65] "degree"  RadarFrontCenter
 SG_ VFC_TL04_2DHeight : 424|8@1+ (0.03,0) [0|7.65] "degree"  RadarFrontCenter
 SG_ VFC_TL04_2DLeftEdge : 432|12@1+ (0.03,-61.44) [-61.44|61.41] "degree"  RadarFrontCenter
 SG_ VFC_TL04_2DTopEdge : 444|11@1+ (0.03,-30.72) [-30.72|30.69] "degree"  RadarFrontCenter
 SG_ VFC_TL04_Px : 456|11@1+ (0.1,0) [0|204.7] "m"  RadarFrontCenter

BO_ 227 VFC_TrafficLight_05_09: 64 VideoFrontCenter
 SG_ VFC_TL05_09_CRC : 0|16@1+ (1,0) [0|65535] ""  RadarFrontCenter
 SG_ VFC_TL05_09_AliveCtr : 16|8@1+ (1,0) [0|255] ""  RadarFrontCenter
 SG_ VFC_TL05_09_ProtBlockCtr : 24|4@1+ (1,0) [0|15] ""  RadarFrontCenter
 SG_ VFC_TL05_Colour : 32|2@1+ (1,0) [0|3] ""  RadarFrontCenter
 SG_ VFC_TL05_LightShapeType : 34|4@1+ (1,0) [0|15] ""  RadarFrontCenter
 SG_ VFC_TL05_LightModeType : 38|2@1+ (1,0) [0|3] ""  RadarFrontCenter
 SG_ VFC_TL05_Py : 40|10@1+ (0.1,-51.2) [-51.2|51.1] "m"  RadarFrontCenter
 SG_ VFC_TL05_ExistProb : 50|6@1+ (2,0) [0|100] "%"  RadarFrontCenter
 SG_ VFC_TL05_Pz : 56|8@1+ (0.1,0) [0|25.5] "m"  RadarFrontCenter
 SG_ VFC_TL05_2DWidth : 64|8@1+ (0.03,0) [0|7.65] "degree"  RadarFrontCenter
 SG_ VFC_TL05_2DHeight : 72|8@1+ (0.03,0) [0|7.65] "degree"  RadarFrontCenter
 SG_ VFC_TL05_2DLeftEdge : 80|12@1+ (0.03,-61.44) [-61.44|61.41] "degree"  RadarFrontCenter
 SG_ VFC_TL05_2DTopEdge : 92|11@1+ (0.03,-30.72) [-30.72|30.69] "degree"  RadarFrontCenter
 SG_ VFC_TL05_Px : 104|11@1+ (0.1,0) [0|204.7] "m"  RadarFrontCenter
 SG_ VFC_TL06_Colour : 120|2@1+ (1,0) [0|3] ""  RadarFrontCenter
 SG_ VFC_TL06_LightShapeType : 122|4@1+ (1,0) [0|15] ""  RadarFrontCenter
 SG_ VFC_TL06_LightModeType : 126|2@1+ (1,0) [0|3] ""  RadarFrontCenter
 SG_ VFC_TL06_Py : 128|10@1+ (0.1,-51.2) [-51.2|51.1] "m"  RadarFrontCenter
 SG_ VFC_TL06_ExistProb : 138|6@1+ (2,0) [0|100] "%"  RadarFrontCenter
 SG_ VFC_TL06_Pz : 144|8@1+ (0.1,0) [0|25.5] "m"  RadarFrontCenter
 SG_ VFC_TL06_2DWidth : 152|8@1+ (0.03,0) [0|7.65] "degree"  RadarFrontCenter
 SG_ VFC_TL06_2DHeight : 160|8@1+ (0.03,0) [0|7.65] "degree"  RadarFrontCenter
 SG_ VFC_TL06_2DLeftEdge : 168|12@1+ (0.03,-61.44) [-61.44|61.41] "degree"  RadarFrontCenter
 SG_ VFC_TL06_2DTopEdge : 180|11@1+ (0.03,-30.72) [-30.72|30.69] "degree"  RadarFrontCenter
 SG_ VFC_TL06_Px : 192|11@1+ (0.1,0) [0|204.7] "m"  RadarFrontCenter
 SG_ VFC_TL07_Colour : 208|2@1+ (1,0) [0|3] ""  RadarFrontCenter
 SG_ VFC_TL07_LightShapeType : 210|4@1+ (1,0) [0|15] ""  RadarFrontCenter
 SG_ VFC_TL07_LightModeType : 214|2@1+ (1,0) [0|3] ""  RadarFrontCenter
 SG_ VFC_TL07_Py : 216|10@1+ (0.1,-51.2) [-51.2|51.1] "m"  RadarFrontCenter
 SG_ VFC_TL07_ExistProb : 226|6@1+ (2,0) [0|100] "%"  RadarFrontCenter
 SG_ VFC_TL07_Pz : 232|8@1+ (0.1,0) [0|25.5] "m"  RadarFrontCenter
 SG_ VFC_TL07_2DWidth : 240|8@1+ (0.03,0) [0|7.65] "degree"  RadarFrontCenter
 SG_ VFC_TL07_2DHeight : 248|8@1+ (0.03,0) [0|7.65] "degree"  RadarFrontCenter
 SG_ VFC_TL07_2DLeftEdge : 256|12@1+ (0.03,-61.44) [-61.44|61.41] "degree"  RadarFrontCenter
 SG_ VFC_TL07_2DTopEdge : 268|11@1+ (0.03,-30.72) [-30.72|30.69] "degree"  RadarFrontCenter
 SG_ VFC_TL07_Px : 280|11@1+ (0.1,0) [0|204.7] "m"  RadarFrontCenter
 SG_ VFC_TL08_Colour : 296|2@1+ (1,0) [0|3] ""  RadarFrontCenter
 SG_ VFC_TL08_LightShapeType : 298|4@1+ (1,0) [0|15] ""  RadarFrontCenter
 SG_ VFC_TL08_LightModeType : 302|2@1+ (1,0) [0|3] ""  RadarFrontCenter
 SG_ VFC_TL08_Py : 304|10@1+ (0.1,-51.2) [-51.2|51.1] "m"  RadarFrontCenter
 SG_ VFC_TL08_ExistProb : 314|6@1+ (2,0) [0|100] "%"  RadarFrontCenter
 SG_ VFC_TL08_Pz : 320|8@1+ (0.1,0) [0|25.5] "m"  RadarFrontCenter
 SG_ VFC_TL08_2DWidth : 328|8@1+ (0.03,0) [0|7.65] "degree"  RadarFrontCenter
 SG_ VFC_TL08_2DHeight : 336|8@1+ (0.03,0) [0|7.65] "degree"  RadarFrontCenter
 SG_ VFC_TL08_2DLeftEdge : 344|12@1+ (0.03,-61.44) [-61.44|61.41] "degree"  RadarFrontCenter
 SG_ VFC_TL08_2DTopEdge : 356|11@1+ (0.03,-30.72) [-30.72|30.69] "degree"  RadarFrontCenter
 SG_ VFC_TL08_Px : 368|11@1+ (0.1,0) [0|204.7] "m"  RadarFrontCenter
 SG_ VFC_TL09_Colour : 384|2@1+ (1,0) [0|3] ""  RadarFrontCenter
 SG_ VFC_TL09_LightShapeType : 386|4@1+ (1,0) [0|15] ""  RadarFrontCenter
 SG_ VFC_TL09_LightModeType : 390|2@1+ (1,0) [0|3] ""  RadarFrontCenter
 SG_ VFC_TL09_Py : 392|10@1+ (0.1,-51.2) [-51.2|51.1] "m"  RadarFrontCenter
 SG_ VFC_TL09_ExistProb : 402|6@1+ (2,0) [0|100] "%"  RadarFrontCenter
 SG_ VFC_TL09_Pz : 408|8@1+ (0.1,0) [0|25.5] "m"  RadarFrontCenter
 SG_ VFC_TL09_2DWidth : 416|8@1+ (0.03,0) [0|7.65] "degree"  RadarFrontCenter
 SG_ VFC_TL09_2DHeight : 424|8@1+ (0.03,0) [0|7.65] "degree"  RadarFrontCenter
 SG_ VFC_TL09_2DLeftEdge : 432|12@1+ (0.03,-61.44) [-61.44|61.41] "degree"  RadarFrontCenter
 SG_ VFC_TL09_2DTopEdge : 444|11@1+ (0.03,-30.72) [-30.72|30.69] "degree"  RadarFrontCenter
 SG_ VFC_TL09_Px : 456|11@1+ (0.1,0) [0|204.7] "m"  RadarFrontCenter

BO_ 236 VFC_TrafficSignHdr: 16 VideoFrontCenter
 SG_ VFC_TSHdr_CRC : 0|16@1+ (1,0) [0|65535] ""  RadarFrontCenter
 SG_ VFC_TSHdr_AliveCtr : 16|8@1+ (1,0) [0|255] ""  RadarFrontCenter
 SG_ VFC_TSHdr_ProtBlockCtr : 24|4@1+ (1,0) [0|15] ""  RadarFrontCenter
 SG_ VFC_TSHdr_ProtTrafficSignCount : 32|5@1+ (1,0) [0|16] ""  RadarFrontCenter
 SG_ VFC_TSHdr_State : 40|3@1+ (1,0) [0|7] ""  RadarFrontCenter
 SG_ VFC_TSHdr_Brightness : 43|3@1+ (1,0) [0|7] ""  RadarFrontCenter
 SG_ VFC_TSHdr_Country : 46|10@1+ (1,0) [0|894] ""  RadarFrontCenter
 SG_ VFC_TSHdr_TimeStampStatus : 56|8@1+ (1,0) [0|255] ""  RadarFrontCenter
 SG_ VFC_TSHdr_TimeStamp : 64|26@1+ (1,0) [0|67108863] "ms"  RadarFrontCenter
 SG_ VFC_TSHdr_CountryMode : 93|3@1+ (1,0) [0|7] ""  RadarFrontCenter

CM_ SG_ 133 VFC_Cloth_09_11_CRC "CRC - Autosar E2E Profile 5";
CM_ SG_ 133 VFC_Cloth_09_11_AliveCtr "Alive counter - Autosar E2E Profile 5";
CM_ SG_ 133 VFC_Cloth_09_11_ProtBlockCtr "Protocol-Signal: Block-Counter";
CM_ SG_ 133 VFC_Cloth09_LaneAssociation "Position relative to the ego lane. ISO 23150:2022(E): Road object lane association (A.2.93)";
CM_ SG_ 133 VFC_Cloth09_Colour "The color of the line. Similar to ISO 23150:2022(E): Colour value - object level (A.2.107)";
CM_ SG_ 133 VFC_Cloth09_RangeXBegin "Longitudinal begin of the clothoid. ISO 23150:2022(E): Polynomial range x {begin, end} (A.2.120)";
CM_ SG_ 133 VFC_Cloth09_RangeXEnd "Longitudinal end of the clothoid. ISO 23150:2022(E): Polynomial range x {begin, end} (A.2.120)";
CM_ SG_ 133 VFC_Cloth09_ExistProb "Confidence for this clothoid, probability that it describes the true lane boundary. ISO 23150:2022(E): Existence probability - object level (A.2.1)";
CM_ SG_ 133 VFC_Cloth09_CurvChange "Curvature change or alteration of the clothoid, also called kappaDt (resolution = 2^-29)";
CM_ SG_ 133 VFC_Cloth09_Curv "Curvature of the clothoid, also called kappa (resolution = 2^-18)";
CM_ SG_ 133 VFC_Cloth09_PyStdDev "Standard deviation at x=0 of the lateral offset (resolution = 2^-7)";
CM_ SG_ 133 VFC_Cloth09_Py "Lateral offset at x=0, also called LatDeviation (resolution = 2^-7)";
CM_ SG_ 133 VFC_Cloth09_OrientationYaw "Heading angle, difference in yaw angle between vehicle heading and clothoid (resolution = 2^-11). ISO 23150:2022(E): Orientation {yaw, pitch, roll} (A.2.17)";
CM_ SG_ 133 VFC_Cloth09_Width "Width of the line. ISO 23150:2022(E): Extent {width} - polynomial (A.2.121)";
CM_ SG_ 133 VFC_Cloth09_Type "Type of the Line. ISO 23150:2022(E): Road marking type (A.2.91)";
CM_ SG_ 133 VFC_Cloth10_LaneAssociation "Position relative to the ego lane. ISO 23150:2022(E): Road object lane association (A.2.93)";
CM_ SG_ 133 VFC_Cloth10_Colour "The color of the line. Similar to ISO 23150:2022(E): Colour value - object level (A.2.107)";
CM_ SG_ 133 VFC_Cloth10_RangeXBegin "Longitudinal begin of the clothoid. ISO 23150:2022(E): Polynomial range x {begin, end} (A.2.120)";
CM_ SG_ 133 VFC_Cloth10_RangeXEnd "Longitudinal end of the clothoid. ISO 23150:2022(E): Polynomial range x {begin, end} (A.2.120)";
CM_ SG_ 133 VFC_Cloth10_ExistProb "Confidence for this clothoid, probability that it describes the true lane boundary. ISO 23150:2022(E): Existence probability - object level (A.2.1)";
CM_ SG_ 133 VFC_Cloth10_CurvChange "Curvature change or alteration of the clothoid, also called kappaDt (resolution = 2^-29)";
CM_ SG_ 133 VFC_Cloth10_Curv "Curvature of the clothoid, also called kappa (resolution = 2^-18)";
CM_ SG_ 133 VFC_Cloth10_PyStdDev "Standard deviation at x=0 of the lateral offset (resolution = 2^-7)";
CM_ SG_ 133 VFC_Cloth10_Py "Lateral offset at x=0, also called LatDeviation (resolution = 2^-7)";
CM_ SG_ 133 VFC_Cloth10_OrientationYaw "Heading angle, difference in yaw angle between vehicle heading and clothoid (resolution = 2^-11). ISO 23150:2022(E): Orientation {yaw, pitch, roll} (A.2.17)";
CM_ SG_ 133 VFC_Cloth10_Width "Width of the line. ISO 23150:2022(E): Extent {width} - polynomial (A.2.121)";
CM_ SG_ 133 VFC_Cloth10_Type "Type of the Line. ISO 23150:2022(E): Road marking type (A.2.91)";
CM_ SG_ 133 VFC_Cloth11_LaneAssociation "Position relative to the ego lane. ISO 23150:2022(E): Road object lane association (A.2.93)";
CM_ SG_ 133 VFC_Cloth11_Colour "The color of the line. Similar to ISO 23150:2022(E): Colour value - object level (A.2.107)";
CM_ SG_ 133 VFC_Cloth11_RangeXBegin "Longitudinal begin of the clothoid. ISO 23150:2022(E): Polynomial range x {begin, end} (A.2.120)";
CM_ SG_ 133 VFC_Cloth11_RangeXEnd "Longitudinal end of the clothoid. ISO 23150:2022(E): Polynomial range x {begin, end} (A.2.120)";
CM_ SG_ 133 VFC_Cloth11_ExistProb "Confidence for this clothoid, probability that it describes the true lane boundary. ISO 23150:2022(E): Existence probability - object level (A.2.1)";
CM_ SG_ 133 VFC_Cloth11_CurvChange "Curvature change or alteration of the clothoid, also called kappaDt (resolution = 2^-29)";
CM_ SG_ 133 VFC_Cloth11_Curv "Curvature of the clothoid, also called kappa (resolution = 2^-18)";
CM_ SG_ 133 VFC_Cloth11_PyStdDev "Standard deviation at x=0 of the lateral offset (resolution = 2^-7)";
CM_ SG_ 133 VFC_Cloth11_Py "Lateral offset at x=0, also called LatDeviation (resolution = 2^-7)";
CM_ SG_ 133 VFC_Cloth11_OrientationYaw "Heading angle, difference in yaw angle between vehicle heading and clothoid (resolution = 2^-11). ISO 23150:2022(E): Orientation {yaw, pitch, roll} (A.2.17)";
CM_ SG_ 133 VFC_Cloth11_Width "Width of the line. ISO 23150:2022(E): Extent {width} - polynomial (A.2.121)";
CM_ SG_ 133 VFC_Cloth11_Type "Type of the Line. ISO 23150:2022(E): Road marking type (A.2.91)";
CM_ SG_ 146 VFC_Poly_00_02_CRC "CRC - Autosar E2E Profile 5";
CM_ SG_ 146 VFC_Poly_00_02_AliveCtr "Alive counter - Autosar E2E Profile 5";
CM_ SG_ 146 VFC_Poly_00_02_ProtBlockCtr "Protocol-Signal: Block-Counter";
CM_ SG_ 146 VFC_Poly00_LaneAssociation "Position relative to the ego lane. ISO 23150:2022(E): Road object lane association (A.2.93)";
CM_ SG_ 146 VFC_Poly00_Type "Type of the Line. ISO 23150:2022(E): Road marking type (A.2.91)";
CM_ SG_ 146 VFC_Poly00_ExistProb "Confidence for this line, probability that it describes the true lane boundary. ISO 23150:2022(E): Existence probability - object level (A.2.1)";
CM_ SG_ 146 VFC_Poly00_CoefficientYc3 "c3 coefficient of the  lateral polynomial.(resolution = 2^-26)  ISO 23150:2022(E): Polynomial coefficient y {c0,c1,c2,c3} (A.2.116)";
CM_ SG_ 146 VFC_Poly00_Colour "The color of the line. Similar to ISO 23150:2022(E): Colour value - object level (A.2.107)";
CM_ SG_ 146 VFC_Poly00_CoefficientYc2 "c2 coefficient of  the  lateral polynomial.(resolution = 2^-20) ISO 23150:2022(E): Polynomial coefficient y {c0,c1,c2,c3} (A.2.116)";
CM_ SG_ 146 VFC_Poly00_CoefficientYc0 "c0 coefficient of the lateral polynomial. (resolution = 2^-7) ISO 23150:2022(E): Polynomial coefficient y {c0,c1,c2,c3} (A.2.116)";
CM_ SG_ 146 VFC_Poly00_CoefficientYc1 "c1 coefficient of  the lateral polynomial. (resolution = 2^-14) ISO 23150:2022(E): Polynomial coefficient y {c0,c1,c2,c3} (A.2.116)";
CM_ SG_ 146 VFC_Poly00_CoefficientYc2Corr "c2 correction coefficient for lateral polynomial. (resolution = 2^-20) If X > XCorrectionPoint then Yc2Corr*(X-XCorrectionPoint)^2 shall be added to Y value. Deviation form ISO 23150:2022(E) polynomial representation";
CM_ SG_ 146 VFC_Poly00_CoefficientYc3Corr "c3 correction coefficient for lateral polynomial. (resolution = 2^-26) If X > XCorrectionPoint then Yc3Corr*(X-XCorrectionPoint)^3 shall be added to Y value. Deviation form 23150:2022(E) polynomial representation";
CM_ SG_ 146 VFC_Poly00_Width "Width of the line. ISO 23150:2022(E): Extent {width} - polynomial (A.2.121)";
CM_ SG_ 146 VFC_Poly00_RangeXCorrectionPoint "Transition point along the X axis the correction parameters shall be applied on the polynomial.  ISO 23150:2022(E): Polynomial range x {begin, end} (A.2.120)";
CM_ SG_ 146 VFC_Poly00_RangeXBegin "Longitudinal begin of the polynomial. ISO 23150:2022(E): Polynomial range x {begin, end} (A.2.120)";
CM_ SG_ 146 VFC_Poly00_Reserved0 "Reserved for future use";
CM_ SG_ 146 VFC_Poly00_RangeXEnd "Longitudinal end of the polynomial. ISO 23150:2022(E): Polynomial range x {begin, end} (A.2.120)";
CM_ SG_ 146 VFC_Poly00_Reserved1 "Reserved for future use";
CM_ SG_ 146 VFC_Poly01_LaneAssociation "Position relative to the ego lane. ISO 23150:2022(E): Road object lane association (A.2.93)";
CM_ SG_ 146 VFC_Poly01_Type "Type of the Line. ISO 23150:2022(E): Road marking type (A.2.91)";
CM_ SG_ 146 VFC_Poly01_ExistProb "Confidence for this line, probability that it describes the true lane boundary. ISO 23150:2022(E): Existence probability - object level (A.2.1)";
CM_ SG_ 146 VFC_Poly01_CoefficientYc3 "c3 coefficient of the  lateral polynomial.(resolution = 2^-26)  ISO 23150:2022(E): Polynomial coefficient y {c0,c1,c2,c3} (A.2.116)";
CM_ SG_ 146 VFC_Poly01_Colour "The color of the line. Similar to ISO 23150:2022(E): Colour value - object level (A.2.107)";
CM_ SG_ 146 VFC_Poly01_CoefficientYc2 "c2 coefficient of  the  lateral polynomial.(resolution = 2^-20) ISO 23150:2022(E): Polynomial coefficient y {c0,c1,c2,c3} (A.2.116)";
CM_ SG_ 146 VFC_Poly01_CoefficientYc0 "c0 coefficient of the lateral polynomial. (resolution = 2^-7) ISO 23150:2022(E): Polynomial coefficient y {c0,c1,c2,c3} (A.2.116)";
CM_ SG_ 146 VFC_Poly01_CoefficientYc1 "c1 coefficient of  the lateral polynomial. (resolution = 2^-14) ISO 23150:2022(E): Polynomial coefficient y {c0,c1,c2,c3} (A.2.116)";
CM_ SG_ 146 VFC_Poly01_CoefficientYc2Corr "c2 correction coefficient for lateral polynomial. (resolution = 2^-20) If X > XCorrectionPoint then Yc2Corr*(X-XCorrectionPoint)^2 shall be added to Y value. Deviation form ISO 23150:2022(E) polynomial representation";
CM_ SG_ 146 VFC_Poly01_CoefficientYc3Corr "c3 correction coefficient for lateral polynomial. (resolution = 2^-26) If X > XCorrectionPoint then Yc3Corr*(X-XCorrectionPoint)^3 shall be added to Y value. Deviation form 23150:2022(E) polynomial representation";
CM_ SG_ 146 VFC_Poly01_Width "Width of the line. ISO 23150:2022(E): Extent {width} - polynomial (A.2.121)";
CM_ SG_ 146 VFC_Poly01_RangeXCorrectionPoint "Transition point along the X axis the correction parameters shall be applied on the polynomial.  ISO 23150:2022(E): Polynomial range x {begin, end} (A.2.120)";
CM_ SG_ 146 VFC_Poly01_RangeXBegin "Longitudinal begin of the polynomial. ISO 23150:2022(E): Polynomial range x {begin, end} (A.2.120)";
CM_ SG_ 146 VFC_Poly01_Reserved0 "Reserved for future use";
CM_ SG_ 146 VFC_Poly01_RangeXEnd "Longitudinal end of the polynomial. ISO 23150:2022(E): Polynomial range x {begin, end} (A.2.120)";
CM_ SG_ 146 VFC_Poly01_Reserved1 "Reserved for future use";
CM_ SG_ 146 VFC_Poly02_LaneAssociation "Position relative to the ego lane. ISO 23150:2022(E): Road object lane association (A.2.93)";
CM_ SG_ 146 VFC_Poly02_Type "Type of the Line. ISO 23150:2022(E): Road marking type (A.2.91)";
CM_ SG_ 146 VFC_Poly02_ExistProb "Confidence for this line, probability that it describes the true lane boundary. ISO 23150:2022(E): Existence probability - object level (A.2.1)";
CM_ SG_ 146 VFC_Poly02_CoefficientYc3 "c3 coefficient of the  lateral polynomial.(resolution = 2^-26)  ISO 23150:2022(E): Polynomial coefficient y {c0,c1,c2,c3} (A.2.116)";
CM_ SG_ 146 VFC_Poly02_Colour "The color of the line. Similar to ISO 23150:2022(E): Colour value - object level (A.2.107)";
CM_ SG_ 146 VFC_Poly02_CoefficientYc2 "c2 coefficient of  the  lateral polynomial.(resolution = 2^-20) ISO 23150:2022(E): Polynomial coefficient y {c0,c1,c2,c3} (A.2.116)";
CM_ SG_ 146 VFC_Poly02_CoefficientYc0 "c0 coefficient of the lateral polynomial. (resolution = 2^-7) ISO 23150:2022(E): Polynomial coefficient y {c0,c1,c2,c3} (A.2.116)";
CM_ SG_ 146 VFC_Poly02_CoefficientYc1 "c1 coefficient of  the lateral polynomial. (resolution = 2^-14) ISO 23150:2022(E): Polynomial coefficient y {c0,c1,c2,c3} (A.2.116)";
CM_ SG_ 146 VFC_Poly02_CoefficientYc2Corr "c2 correction coefficient for lateral polynomial. (resolution = 2^-20) If X > XCorrectionPoint then Yc2Corr*(X-XCorrectionPoint)^2 shall be added to Y value. Deviation form ISO 23150:2022(E) polynomial representation";
CM_ SG_ 146 VFC_Poly02_CoefficientYc3Corr "c3 correction coefficient for lateral polynomial. (resolution = 2^-26) If X > XCorrectionPoint then Yc3Corr*(X-XCorrectionPoint)^3 shall be added to Y value. Deviation form 23150:2022(E) polynomial representation";
CM_ SG_ 146 VFC_Poly02_Width "Width of the line. ISO 23150:2022(E): Extent {width} - polynomial (A.2.121)";
CM_ SG_ 146 VFC_Poly02_RangeXCorrectionPoint "Transition point along the X axis the correction parameters shall be applied on the polynomial.  ISO 23150:2022(E): Polynomial range x {begin, end} (A.2.120)";
CM_ SG_ 146 VFC_Poly02_RangeXBegin "Longitudinal begin of the polynomial. ISO 23150:2022(E): Polynomial range x {begin, end} (A.2.120)";
CM_ SG_ 146 VFC_Poly02_Reserved0 "Reserved for future use";
CM_ SG_ 146 VFC_Poly02_RangeXEnd "Longitudinal end of the polynomial. ISO 23150:2022(E): Polynomial range x {begin, end} (A.2.120)";
CM_ SG_ 146 VFC_Poly02_Reserved1 "Reserved for future use";
CM_ SG_ 147 VFC_Poly_03_05_CRC "CRC - Autosar E2E Profile 5";
CM_ SG_ 147 VFC_Poly_03_05_AliveCtr "Alive counter - Autosar E2E Profile 5";
CM_ SG_ 147 VFC_Poly_03_05_ProtBlockCtr "Protocol-Signal: Block-Counter";
CM_ SG_ 147 VFC_Poly03_LaneAssociation "Position relative to the ego lane. ISO 23150:2022(E): Road object lane association (A.2.93)";
CM_ SG_ 147 VFC_Poly03_Type "Type of the Line. ISO 23150:2022(E): Road marking type (A.2.91)";
CM_ SG_ 147 VFC_Poly03_ExistProb "Confidence for this line, probability that it describes the true lane boundary. ISO 23150:2022(E): Existence probability - object level (A.2.1)";
CM_ SG_ 147 VFC_Poly03_CoefficientYc3 "c3 coefficient of the  lateral polynomial.(resolution = 2^-26)  ISO 23150:2022(E): Polynomial coefficient y {c0,c1,c2,c3} (A.2.116)";
CM_ SG_ 147 VFC_Poly03_Colour "The color of the line. Similar to ISO 23150:2022(E): Colour value - object level (A.2.107)";
CM_ SG_ 147 VFC_Poly03_CoefficientYc2 "c2 coefficient of  the  lateral polynomial.(resolution = 2^-20) ISO 23150:2022(E): Polynomial coefficient y {c0,c1,c2,c3} (A.2.116)";
CM_ SG_ 147 VFC_Poly03_CoefficientYc0 "c0 coefficient of the lateral polynomial. (resolution = 2^-7) ISO 23150:2022(E): Polynomial coefficient y {c0,c1,c2,c3} (A.2.116)";
CM_ SG_ 147 VFC_Poly03_CoefficientYc1 "c1 coefficient of  the lateral polynomial. (resolution = 2^-14) ISO 23150:2022(E): Polynomial coefficient y {c0,c1,c2,c3} (A.2.116)";
CM_ SG_ 147 VFC_Poly03_CoefficientYc2Corr "c2 correction coefficient for lateral polynomial. (resolution = 2^-20) If X > XCorrectionPoint then Yc2Corr*(X-XCorrectionPoint)^2 shall be added to Y value. Deviation form ISO 23150:2022(E) polynomial representation";
CM_ SG_ 147 VFC_Poly03_CoefficientYc3Corr "c3 correction coefficient for lateral polynomial. (resolution = 2^-26) If X > XCorrectionPoint then Yc3Corr*(X-XCorrectionPoint)^3 shall be added to Y value. Deviation form 23150:2022(E) polynomial representation";
CM_ SG_ 147 VFC_Poly03_Width "Width of the line. ISO 23150:2022(E): Extent {width} - polynomial (A.2.121)";
CM_ SG_ 147 VFC_Poly03_RangeXCorrectionPoint "Transition point along the X axis the correction parameters shall be applied on the polynomial.  ISO 23150:2022(E): Polynomial range x {begin, end} (A.2.120)";
CM_ SG_ 147 VFC_Poly03_RangeXBegin "Longitudinal begin of the polynomial. ISO 23150:2022(E): Polynomial range x {begin, end} (A.2.120)";
CM_ SG_ 147 VFC_Poly03_Reserved0 "Reserved for future use";
CM_ SG_ 147 VFC_Poly03_RangeXEnd "Longitudinal end of the polynomial. ISO 23150:2022(E): Polynomial range x {begin, end} (A.2.120)";
CM_ SG_ 147 VFC_Poly03_Reserved1 "Reserved for future use";
CM_ SG_ 147 VFC_Poly04_LaneAssociation "Position relative to the ego lane. ISO 23150:2022(E): Road object lane association (A.2.93)";
CM_ SG_ 147 VFC_Poly04_Type "Type of the Line. ISO 23150:2022(E): Road marking type (A.2.91)";
CM_ SG_ 147 VFC_Poly04_ExistProb "Confidence for this line, probability that it describes the true lane boundary. ISO 23150:2022(E): Existence probability - object level (A.2.1)";
CM_ SG_ 147 VFC_Poly04_CoefficientYc3 "c3 coefficient of the  lateral polynomial.(resolution = 2^-26)  ISO 23150:2022(E): Polynomial coefficient y {c0,c1,c2,c3} (A.2.116)";
CM_ SG_ 147 VFC_Poly04_Colour "The color of the line. Similar to ISO 23150:2022(E): Colour value - object level (A.2.107)";
CM_ SG_ 147 VFC_Poly04_CoefficientYc2 "c2 coefficient of  the  lateral polynomial.(resolution = 2^-20) ISO 23150:2022(E): Polynomial coefficient y {c0,c1,c2,c3} (A.2.116)";
CM_ SG_ 147 VFC_Poly04_CoefficientYc0 "c0 coefficient of the lateral polynomial. (resolution = 2^-7) ISO 23150:2022(E): Polynomial coefficient y {c0,c1,c2,c3} (A.2.116)";
CM_ SG_ 147 VFC_Poly04_CoefficientYc1 "c1 coefficient of  the lateral polynomial. (resolution = 2^-14) ISO 23150:2022(E): Polynomial coefficient y {c0,c1,c2,c3} (A.2.116)";
CM_ SG_ 147 VFC_Poly04_CoefficientYc2Corr "c2 correction coefficient for lateral polynomial. (resolution = 2^-20) If X > XCorrectionPoint then Yc2Corr*(X-XCorrectionPoint)^2 shall be added to Y value. Deviation form ISO 23150:2022(E) polynomial representation";
CM_ SG_ 147 VFC_Poly04_CoefficientYc3Corr "c3 correction coefficient for lateral polynomial. (resolution = 2^-26) If X > XCorrectionPoint then Yc3Corr*(X-XCorrectionPoint)^3 shall be added to Y value. Deviation form 23150:2022(E) polynomial representation";
CM_ SG_ 147 VFC_Poly04_Width "Width of the line. ISO 23150:2022(E): Extent {width} - polynomial (A.2.121)";
CM_ SG_ 147 VFC_Poly04_RangeXCorrectionPoint "Transition point along the X axis the correction parameters shall be applied on the polynomial.  ISO 23150:2022(E): Polynomial range x {begin, end} (A.2.120)";
CM_ SG_ 147 VFC_Poly04_RangeXBegin "Longitudinal begin of the polynomial. ISO 23150:2022(E): Polynomial range x {begin, end} (A.2.120)";
CM_ SG_ 147 VFC_Poly04_Reserved0 "Reserved for future use";
CM_ SG_ 147 VFC_Poly04_RangeXEnd "Longitudinal end of the polynomial. ISO 23150:2022(E): Polynomial range x {begin, end} (A.2.120)";
CM_ SG_ 147 VFC_Poly04_Reserved1 "Reserved for future use";
CM_ SG_ 147 VFC_Poly05_LaneAssociation "Position relative to the ego lane. ISO 23150:2022(E): Road object lane association (A.2.93)";
CM_ SG_ 147 VFC_Poly05_Type "Type of the Line. ISO 23150:2022(E): Road marking type (A.2.91)";
CM_ SG_ 147 VFC_Poly05_ExistProb "Confidence for this line, probability that it describes the true lane boundary. ISO 23150:2022(E): Existence probability - object level (A.2.1)";
CM_ SG_ 147 VFC_Poly05_CoefficientYc3 "c3 coefficient of the  lateral polynomial.(resolution = 2^-26)  ISO 23150:2022(E): Polynomial coefficient y {c0,c1,c2,c3} (A.2.116)";
CM_ SG_ 147 VFC_Poly05_Colour "The color of the line. Similar to ISO 23150:2022(E): Colour value - object level (A.2.107)";
CM_ SG_ 147 VFC_Poly05_CoefficientYc2 "c2 coefficient of  the  lateral polynomial.(resolution = 2^-20) ISO 23150:2022(E): Polynomial coefficient y {c0,c1,c2,c3} (A.2.116)";
CM_ SG_ 147 VFC_Poly05_CoefficientYc0 "c0 coefficient of the lateral polynomial. (resolution = 2^-7) ISO 23150:2022(E): Polynomial coefficient y {c0,c1,c2,c3} (A.2.116)";
CM_ SG_ 147 VFC_Poly05_CoefficientYc1 "c1 coefficient of  the lateral polynomial. (resolution = 2^-14) ISO 23150:2022(E): Polynomial coefficient y {c0,c1,c2,c3} (A.2.116)";
CM_ SG_ 147 VFC_Poly05_CoefficientYc2Corr "c2 correction coefficient for lateral polynomial. (resolution = 2^-20) If X > XCorrectionPoint then Yc2Corr*(X-XCorrectionPoint)^2 shall be added to Y value. Deviation form ISO 23150:2022(E) polynomial representation";
CM_ SG_ 147 VFC_Poly05_CoefficientYc3Corr "c3 correction coefficient for lateral polynomial. (resolution = 2^-26) If X > XCorrectionPoint then Yc3Corr*(X-XCorrectionPoint)^3 shall be added to Y value. Deviation form 23150:2022(E) polynomial representation";
CM_ SG_ 147 VFC_Poly05_Width "Width of the line. ISO 23150:2022(E): Extent {width} - polynomial (A.2.121)";
CM_ SG_ 147 VFC_Poly05_RangeXCorrectionPoint "Transition point along the X axis the correction parameters shall be applied on the polynomial.  ISO 23150:2022(E): Polynomial range x {begin, end} (A.2.120)";
CM_ SG_ 147 VFC_Poly05_RangeXBegin "Longitudinal begin of the polynomial. ISO 23150:2022(E): Polynomial range x {begin, end} (A.2.120)";
CM_ SG_ 147 VFC_Poly05_Reserved0 "Reserved for future use";
CM_ SG_ 147 VFC_Poly05_RangeXEnd "Longitudinal end of the polynomial. ISO 23150:2022(E): Polynomial range x {begin, end} (A.2.120)";
CM_ SG_ 147 VFC_Poly05_Reserved1 "Reserved for future use";
CM_ SG_ 148 VFC_Poly_06_08_CRC "CRC - Autosar E2E Profile 5";
CM_ SG_ 148 VFC_Poly_06_08_AliveCtr "Alive counter - Autosar E2E Profile 5";
CM_ SG_ 148 VFC_Poly_06_08_ProtBlockCtr "Protocol-Signal: Block-Counter";
CM_ SG_ 148 VFC_Poly06_LaneAssociation "Position relative to the ego lane. ISO 23150:2022(E): Road object lane association (A.2.93)";
CM_ SG_ 148 VFC_Poly06_Type "Type of the Line. ISO 23150:2022(E): Road marking type (A.2.91)";
CM_ SG_ 148 VFC_Poly06_ExistProb "Confidence for this line, probability that it describes the true lane boundary. ISO 23150:2022(E): Existence probability - object level (A.2.1)";
CM_ SG_ 148 VFC_Poly06_CoefficientYc3 "c3 coefficient of the  lateral polynomial.(resolution = 2^-26)  ISO 23150:2022(E): Polynomial coefficient y {c0,c1,c2,c3} (A.2.116)";
CM_ SG_ 148 VFC_Poly06_Colour "The color of the line. Similar to ISO 23150:2022(E): Colour value - object level (A.2.107)";
CM_ SG_ 148 VFC_Poly06_CoefficientYc2 "c2 coefficient of  the  lateral polynomial.(resolution = 2^-20) ISO 23150:2022(E): Polynomial coefficient y {c0,c1,c2,c3} (A.2.116)";
CM_ SG_ 148 VFC_Poly06_CoefficientYc0 "c0 coefficient of the lateral polynomial. (resolution = 2^-7) ISO 23150:2022(E): Polynomial coefficient y {c0,c1,c2,c3} (A.2.116)";
CM_ SG_ 148 VFC_Poly06_CoefficientYc1 "c1 coefficient of  the lateral polynomial. (resolution = 2^-14) ISO 23150:2022(E): Polynomial coefficient y {c0,c1,c2,c3} (A.2.116)";
CM_ SG_ 148 VFC_Poly06_CoefficientYc2Corr "c2 correction coefficient for lateral polynomial. (resolution = 2^-20) If X > XCorrectionPoint then Yc2Corr*(X-XCorrectionPoint)^2 shall be added to Y value. Deviation form ISO 23150:2022(E) polynomial representation";
CM_ SG_ 148 VFC_Poly06_CoefficientYc3Corr "c3 correction coefficient for lateral polynomial. (resolution = 2^-26) If X > XCorrectionPoint then Yc3Corr*(X-XCorrectionPoint)^3 shall be added to Y value. Deviation form 23150:2022(E) polynomial representation";
CM_ SG_ 148 VFC_Poly06_Width "Width of the line. ISO 23150:2022(E): Extent {width} - polynomial (A.2.121)";
CM_ SG_ 148 VFC_Poly06_RangeXCorrectionPoint "Transition point along the X axis the correction parameters shall be applied on the polynomial.  ISO 23150:2022(E): Polynomial range x {begin, end} (A.2.120)";
CM_ SG_ 148 VFC_Poly06_RangeXBegin "Longitudinal begin of the polynomial. ISO 23150:2022(E): Polynomial range x {begin, end} (A.2.120)";
CM_ SG_ 148 VFC_Poly06_Reserved0 "Reserved for future use";
CM_ SG_ 148 VFC_Poly06_RangeXEnd "Longitudinal end of the polynomial. ISO 23150:2022(E): Polynomial range x {begin, end} (A.2.120)";
CM_ SG_ 148 VFC_Poly06_Reserved1 "Reserved for future use";
CM_ SG_ 148 VFC_Poly07_LaneAssociation "Position relative to the ego lane. ISO 23150:2022(E): Road object lane association (A.2.93)";
CM_ SG_ 148 VFC_Poly07_Type "Type of the Line. ISO 23150:2022(E): Road marking type (A.2.91)";
CM_ SG_ 148 VFC_Poly07_ExistProb "Confidence for this line, probability that it describes the true lane boundary. ISO 23150:2022(E): Existence probability - object level (A.2.1)";
CM_ SG_ 148 VFC_Poly07_CoefficientYc3 "c3 coefficient of the  lateral polynomial.(resolution = 2^-26)  ISO 23150:2022(E): Polynomial coefficient y {c0,c1,c2,c3} (A.2.116)";
CM_ SG_ 148 VFC_Poly07_Colour "The color of the line. Similar to ISO 23150:2022(E): Colour value - object level (A.2.107)";
CM_ SG_ 148 VFC_Poly07_CoefficientYc2 "c2 coefficient of  the  lateral polynomial.(resolution = 2^-20) ISO 23150:2022(E): Polynomial coefficient y {c0,c1,c2,c3} (A.2.116)";
CM_ SG_ 148 VFC_Poly07_CoefficientYc0 "c0 coefficient of the lateral polynomial. (resolution = 2^-7) ISO 23150:2022(E): Polynomial coefficient y {c0,c1,c2,c3} (A.2.116)";
CM_ SG_ 148 VFC_Poly07_CoefficientYc1 "c1 coefficient of  the lateral polynomial. (resolution = 2^-14) ISO 23150:2022(E): Polynomial coefficient y {c0,c1,c2,c3} (A.2.116)";
CM_ SG_ 148 VFC_Poly07_CoefficientYc2Corr "c2 correction coefficient for lateral polynomial. (resolution = 2^-20) If X > XCorrectionPoint then Yc2Corr*(X-XCorrectionPoint)^2 shall be added to Y value. Deviation form ISO 23150:2022(E) polynomial representation";
CM_ SG_ 148 VFC_Poly07_CoefficientYc3Corr "c3 correction coefficient for lateral polynomial. (resolution = 2^-26) If X > XCorrectionPoint then Yc3Corr*(X-XCorrectionPoint)^3 shall be added to Y value. Deviation form 23150:2022(E) polynomial representation";
CM_ SG_ 148 VFC_Poly07_Width "Width of the line. ISO 23150:2022(E): Extent {width} - polynomial (A.2.121)";
CM_ SG_ 148 VFC_Poly07_RangeXCorrectionPoint "Transition point along the X axis the correction parameters shall be applied on the polynomial.  ISO 23150:2022(E): Polynomial range x {begin, end} (A.2.120)";
CM_ SG_ 148 VFC_Poly07_RangeXBegin "Longitudinal begin of the polynomial. ISO 23150:2022(E): Polynomial range x {begin, end} (A.2.120)";
CM_ SG_ 148 VFC_Poly07_Reserved0 "Reserved for future use";
CM_ SG_ 148 VFC_Poly07_RangeXEnd "Longitudinal end of the polynomial. ISO 23150:2022(E): Polynomial range x {begin, end} (A.2.120)";
CM_ SG_ 148 VFC_Poly07_Reserved1 "Reserved for future use";
CM_ SG_ 148 VFC_Poly08_LaneAssociation "Position relative to the ego lane. ISO 23150:2022(E): Road object lane association (A.2.93)";
CM_ SG_ 148 VFC_Poly08_Type "Type of the Line. ISO 23150:2022(E): Road marking type (A.2.91)";
CM_ SG_ 148 VFC_Poly08_ExistProb "Confidence for this line, probability that it describes the true lane boundary. ISO 23150:2022(E): Existence probability - object level (A.2.1)";
CM_ SG_ 148 VFC_Poly08_CoefficientYc3 "c3 coefficient of the  lateral polynomial.(resolution = 2^-26)  ISO 23150:2022(E): Polynomial coefficient y {c0,c1,c2,c3} (A.2.116)";
CM_ SG_ 148 VFC_Poly08_Colour "The color of the line. Similar to ISO 23150:2022(E): Colour value - object level (A.2.107)";
CM_ SG_ 148 VFC_Poly08_CoefficientYc2 "c2 coefficient of  the  lateral polynomial.(resolution = 2^-20) ISO 23150:2022(E): Polynomial coefficient y {c0,c1,c2,c3} (A.2.116)";
CM_ SG_ 148 VFC_Poly08_CoefficientYc0 "c0 coefficient of the lateral polynomial. (resolution = 2^-7) ISO 23150:2022(E): Polynomial coefficient y {c0,c1,c2,c3} (A.2.116)";
CM_ SG_ 148 VFC_Poly08_CoefficientYc1 "c1 coefficient of  the lateral polynomial. (resolution = 2^-14) ISO 23150:2022(E): Polynomial coefficient y {c0,c1,c2,c3} (A.2.116)";
CM_ SG_ 148 VFC_Poly08_CoefficientYc2Corr "c2 correction coefficient for lateral polynomial. (resolution = 2^-20) If X > XCorrectionPoint then Yc2Corr*(X-XCorrectionPoint)^2 shall be added to Y value. Deviation form ISO 23150:2022(E) polynomial representation";
CM_ SG_ 148 VFC_Poly08_CoefficientYc3Corr "c3 correction coefficient for lateral polynomial. (resolution = 2^-26) If X > XCorrectionPoint then Yc3Corr*(X-XCorrectionPoint)^3 shall be added to Y value. Deviation form 23150:2022(E) polynomial representation";
CM_ SG_ 148 VFC_Poly08_Width "Width of the line. ISO 23150:2022(E): Extent {width} - polynomial (A.2.121)";
CM_ SG_ 148 VFC_Poly08_RangeXCorrectionPoint "Transition point along the X axis the correction parameters shall be applied on the polynomial.  ISO 23150:2022(E): Polynomial range x {begin, end} (A.2.120)";
CM_ SG_ 148 VFC_Poly08_RangeXBegin "Longitudinal begin of the polynomial. ISO 23150:2022(E): Polynomial range x {begin, end} (A.2.120)";
CM_ SG_ 148 VFC_Poly08_Reserved0 "Reserved for future use";
CM_ SG_ 148 VFC_Poly08_RangeXEnd "Longitudinal end of the polynomial. ISO 23150:2022(E): Polynomial range x {begin, end} (A.2.120)";
CM_ SG_ 148 VFC_Poly08_Reserved1 "Reserved for future use";
CM_ SG_ 149 VFC_Poly_09_11_CRC "CRC - Autosar E2E Profile 5";
CM_ SG_ 149 VFC_Poly_09_11_AliveCtr "Alive counter - Autosar E2E Profile 5";
CM_ SG_ 149 VFC_Poly_09_11_ProtBlockCtr "Protocol-Signal: Block-Counter";
CM_ SG_ 149 VFC_Poly09_LaneAssociation "Position relative to the ego lane. ISO 23150:2022(E): Road object lane association (A.2.93)";
CM_ SG_ 149 VFC_Poly09_Type "Type of the Line. ISO 23150:2022(E): Road marking type (A.2.91)";
CM_ SG_ 149 VFC_Poly09_ExistProb "Confidence for this line, probability that it describes the true lane boundary. ISO 23150:2022(E): Existence probability - object level (A.2.1)";
CM_ SG_ 149 VFC_Poly09_CoefficientYc3 "c3 coefficient of the  lateral polynomial.(resolution = 2^-26)  ISO 23150:2022(E): Polynomial coefficient y {c0,c1,c2,c3} (A.2.116)";
CM_ SG_ 149 VFC_Poly09_Colour "The color of the line. Similar to ISO 23150:2022(E): Colour value - object level (A.2.107)";
CM_ SG_ 149 VFC_Poly09_CoefficientYc2 "c2 coefficient of  the  lateral polynomial.(resolution = 2^-20) ISO 23150:2022(E): Polynomial coefficient y {c0,c1,c2,c3} (A.2.116)";
CM_ SG_ 149 VFC_Poly09_CoefficientYc0 "c0 coefficient of the lateral polynomial. (resolution = 2^-7) ISO 23150:2022(E): Polynomial coefficient y {c0,c1,c2,c3} (A.2.116)";
CM_ SG_ 149 VFC_Poly09_CoefficientYc1 "c1 coefficient of  the lateral polynomial. (resolution = 2^-14) ISO 23150:2022(E): Polynomial coefficient y {c0,c1,c2,c3} (A.2.116)";
CM_ SG_ 149 VFC_Poly09_CoefficientYc2Corr "c2 correction coefficient for lateral polynomial. (resolution = 2^-20) If X > XCorrectionPoint then Yc2Corr*(X-XCorrectionPoint)^2 shall be added to Y value. Deviation form ISO 23150:2022(E) polynomial representation";
CM_ SG_ 149 VFC_Poly09_CoefficientYc3Corr "c3 correction coefficient for lateral polynomial. (resolution = 2^-26) If X > XCorrectionPoint then Yc3Corr*(X-XCorrectionPoint)^3 shall be added to Y value. Deviation form 23150:2022(E) polynomial representation";
CM_ SG_ 149 VFC_Poly09_Width "Width of the line. ISO 23150:2022(E): Extent {width} - polynomial (A.2.121)";
CM_ SG_ 149 VFC_Poly09_RangeXCorrectionPoint "Transition point along the X axis the correction parameters shall be applied on the polynomial.  ISO 23150:2022(E): Polynomial range x {begin, end} (A.2.120)";
CM_ SG_ 149 VFC_Poly09_RangeXBegin "Longitudinal begin of the polynomial. ISO 23150:2022(E): Polynomial range x {begin, end} (A.2.120)";
CM_ SG_ 149 VFC_Poly09_Reserved0 "Reserved for future use";
CM_ SG_ 149 VFC_Poly09_RangeXEnd "Longitudinal end of the polynomial. ISO 23150:2022(E): Polynomial range x {begin, end} (A.2.120)";
CM_ SG_ 149 VFC_Poly09_Reserved1 "Reserved for future use";
CM_ SG_ 149 VFC_Poly10_LaneAssociation "Position relative to the ego lane. ISO 23150:2022(E): Road object lane association (A.2.93)";
CM_ SG_ 149 VFC_Poly10_Type "Type of the Line. ISO 23150:2022(E): Road marking type (A.2.91)";
CM_ SG_ 149 VFC_Poly10_ExistProb "Confidence for this line, probability that it describes the true lane boundary. ISO 23150:2022(E): Existence probability - object level (A.2.1)";
CM_ SG_ 149 VFC_Poly10_CoefficientYc3 "c3 coefficient of the  lateral polynomial.(resolution = 2^-26)  ISO 23150:2022(E): Polynomial coefficient y {c0,c1,c2,c3} (A.2.116)";
CM_ SG_ 149 VFC_Poly10_Colour "The color of the line. Similar to ISO 23150:2022(E): Colour value - object level (A.2.107)";
CM_ SG_ 149 VFC_Poly10_CoefficientYc2 "c2 coefficient of  the  lateral polynomial.(resolution = 2^-20) ISO 23150:2022(E): Polynomial coefficient y {c0,c1,c2,c3} (A.2.116)";
CM_ SG_ 149 VFC_Poly10_CoefficientYc0 "c0 coefficient of the lateral polynomial. (resolution = 2^-7) ISO 23150:2022(E): Polynomial coefficient y {c0,c1,c2,c3} (A.2.116)";
CM_ SG_ 149 VFC_Poly10_CoefficientYc1 "c1 coefficient of  the lateral polynomial. (resolution = 2^-14) ISO 23150:2022(E): Polynomial coefficient y {c0,c1,c2,c3} (A.2.116)";
CM_ SG_ 149 VFC_Poly10_CoefficientYc2Corr "c2 correction coefficient for lateral polynomial. (resolution = 2^-20) If X > XCorrectionPoint then Yc2Corr*(X-XCorrectionPoint)^2 shall be added to Y value. Deviation form ISO 23150:2022(E) polynomial representation";
CM_ SG_ 149 VFC_Poly10_CoefficientYc3Corr "c3 correction coefficient for lateral polynomial. (resolution = 2^-26) If X > XCorrectionPoint then Yc3Corr*(X-XCorrectionPoint)^3 shall be added to Y value. Deviation form 23150:2022(E) polynomial representation";
CM_ SG_ 149 VFC_Poly10_Width "Width of the line. ISO 23150:2022(E): Extent {width} - polynomial (A.2.121)";
CM_ SG_ 149 VFC_Poly10_RangeXCorrectionPoint "Transition point along the X axis the correction parameters shall be applied on the polynomial.  ISO 23150:2022(E): Polynomial range x {begin, end} (A.2.120)";
CM_ SG_ 149 VFC_Poly10_RangeXBegin "Longitudinal begin of the polynomial. ISO 23150:2022(E): Polynomial range x {begin, end} (A.2.120)";
CM_ SG_ 149 VFC_Poly10_Reserved0 "Reserved for future use";
CM_ SG_ 149 VFC_Poly10_RangeXEnd "Longitudinal end of the polynomial. ISO 23150:2022(E): Polynomial range x {begin, end} (A.2.120)";
CM_ SG_ 149 VFC_Poly10_Reserved1 "Reserved for future use";
CM_ SG_ 149 VFC_Poly11_LaneAssociation "Position relative to the ego lane. ISO 23150:2022(E): Road object lane association (A.2.93)";
CM_ SG_ 149 VFC_Poly11_Type "Type of the Line. ISO 23150:2022(E): Road marking type (A.2.91)";
CM_ SG_ 149 VFC_Poly11_ExistProb "Confidence for this line, probability that it describes the true lane boundary. ISO 23150:2022(E): Existence probability - object level (A.2.1)";
CM_ SG_ 149 VFC_Poly11_CoefficientYc3 "c3 coefficient of the  lateral polynomial.(resolution = 2^-26)  ISO 23150:2022(E): Polynomial coefficient y {c0,c1,c2,c3} (A.2.116)";
CM_ SG_ 149 VFC_Poly11_Colour "The color of the line. Similar to ISO 23150:2022(E): Colour value - object level (A.2.107)";
CM_ SG_ 149 VFC_Poly11_CoefficientYc2 "c2 coefficient of  the  lateral polynomial.(resolution = 2^-20) ISO 23150:2022(E): Polynomial coefficient y {c0,c1,c2,c3} (A.2.116)";
CM_ SG_ 149 VFC_Poly11_CoefficientYc0 "c0 coefficient of the lateral polynomial. (resolution = 2^-7) ISO 23150:2022(E): Polynomial coefficient y {c0,c1,c2,c3} (A.2.116)";
CM_ SG_ 149 VFC_Poly11_CoefficientYc1 "c1 coefficient of  the lateral polynomial. (resolution = 2^-14) ISO 23150:2022(E): Polynomial coefficient y {c0,c1,c2,c3} (A.2.116)";
CM_ SG_ 149 VFC_Poly11_CoefficientYc2Corr "c2 correction coefficient for lateral polynomial. (resolution = 2^-20) If X > XCorrectionPoint then Yc2Corr*(X-XCorrectionPoint)^2 shall be added to Y value. Deviation form ISO 23150:2022(E) polynomial representation";
CM_ SG_ 149 VFC_Poly11_CoefficientYc3Corr "c3 correction coefficient for lateral polynomial. (resolution = 2^-26) If X > XCorrectionPoint then Yc3Corr*(X-XCorrectionPoint)^3 shall be added to Y value. Deviation form 23150:2022(E) polynomial representation";
CM_ SG_ 149 VFC_Poly11_Width "Width of the line. ISO 23150:2022(E): Extent {width} - polynomial (A.2.121)";
CM_ SG_ 149 VFC_Poly11_RangeXCorrectionPoint "Transition point along the X axis the correction parameters shall be applied on the polynomial.  ISO 23150:2022(E): Polynomial range x {begin, end} (A.2.120)";
CM_ SG_ 149 VFC_Poly11_RangeXBegin "Longitudinal begin of the polynomial. ISO 23150:2022(E): Polynomial range x {begin, end} (A.2.120)";
CM_ SG_ 149 VFC_Poly11_Reserved0 "Reserved for future use";
CM_ SG_ 149 VFC_Poly11_RangeXEnd "Longitudinal end of the polynomial. ISO 23150:2022(E): Polynomial range x {begin, end} (A.2.120)";
CM_ SG_ 149 VFC_Poly11_Reserved1 "Reserved for future use";
CM_ SG_ 162 VFC_2DPoly_00_02_CRC "CRC - Autosar E2E Profile 5";
CM_ SG_ 162 VFC_2DPoly_00_02_AliveCtr "Alive counter - Autosar E2E Profile 5";
CM_ SG_ 162 VFC_2DPoly_00_02_ProtBlockCtr "Protocol-Signal: Block-Counter";
CM_ SG_ 162 VFC_2DPoly00_LaneAssociation "Position relative to the ego lane. ISO 23150:2022(E): Road object lane association (A.2.93)";
CM_ SG_ 162 VFC_2DPoly00_ExistProb "ISO 23150:2022(E): Existence probability - object level (A.2.1)";
CM_ SG_ 162 VFC_2DPoly00_Type "Type of the Line. ISO 23150:2022(E): Road marking type (A.2.91)";
CM_ SG_ 162 VFC_2DPoly00_CoefficientUc0 "Polynomial coefficient for the u-axis value (in CV coordinates, origin top left). Similar to ISO 23150:2022(E): Polynomial coefficient y {c0,c1,c2,c3} (A.2.116)";
CM_ SG_ 162 VFC_2DPoly00_CoefficientUc1 "Polynomial coefficient for the u-axis value (in CV coordinates, origin top left). Similar to ISO 23150:2022(E): Polynomial coefficient y {c0,c1,c2,c3} (A.2.116)";
CM_ SG_ 162 VFC_2DPoly00_CoefficientUc2 "Polynomial coefficient for the u-axis value (in CV coordinates, origin top left). Similar to ISO 23150:2022(E): Polynomial coefficient y {c0,c1,c2,c3} (A.2.116)";
CM_ SG_ 162 VFC_2DPoly00_CoefficientUc3 "Polynomial coefficient for the u-axis value (in CV coordinates, origin top left). Similar to ISO 23150:2022(E): Polynomial coefficient y {c0,c1,c2,c3} (A.2.116)";
CM_ SG_ 162 VFC_2DPoly00_CoefficientUc4 "Polynomial coefficient for the u-axis value (in CV coordinates, origin top left). Similar to ISO 23150:2022(E): Polynomial coefficient y {c0,c1,c2,c3} (A.2.116)";
CM_ SG_ 162 VFC_2DPoly00_CoefficientUc5 "Polynomial coefficient for the u-axis value (in CV coordinates, origin top left). Similar to ISO 23150:2022(E): Polynomial coefficient y {c0,c1,c2,c3} (A.2.116)";
CM_ SG_ 162 VFC_2DPoly00_RangeVBegin "Longitudinal begin of the polynomial (big v value) (in CV coordinates, origin top left). Similar to ISO 23150:2022(E): Polynomial range x {begin, end} (A.2.120)";
CM_ SG_ 162 VFC_2DPoly00_RangeVEnd "Longitudinal end of the polynomial (small v value) (in CV coordinates, origin top left). Similar to ISO 23150:2022(E): Polynomial range x {begin, end} (A.2.120)";
CM_ SG_ 162 VFC_2DPoly01_LaneAssociation "Position relative to the ego lane. ISO 23150:2022(E): Road object lane association (A.2.93)";
CM_ SG_ 162 VFC_2DPoly01_ExistProb "ISO 23150:2022(E): Existence probability - object level (A.2.1)";
CM_ SG_ 162 VFC_2DPoly01_Type "Type of the Line. ISO 23150:2022(E): Road marking type (A.2.91)";
CM_ SG_ 162 VFC_2DPoly01_CoefficientUc0 "Polynomial coefficient for the u-axis value (in CV coordinates, origin top left). Similar to ISO 23150:2022(E): Polynomial coefficient y {c0,c1,c2,c3} (A.2.116)";
CM_ SG_ 162 VFC_2DPoly01_CoefficientUc1 "Polynomial coefficient for the u-axis value (in CV coordinates, origin top left). Similar to ISO 23150:2022(E): Polynomial coefficient y {c0,c1,c2,c3} (A.2.116)";
CM_ SG_ 162 VFC_2DPoly01_CoefficientUc2 "Polynomial coefficient for the u-axis value (in CV coordinates, origin top left). Similar to ISO 23150:2022(E): Polynomial coefficient y {c0,c1,c2,c3} (A.2.116)";
CM_ SG_ 162 VFC_2DPoly01_CoefficientUc3 "Polynomial coefficient for the u-axis value (in CV coordinates, origin top left). Similar to ISO 23150:2022(E): Polynomial coefficient y {c0,c1,c2,c3} (A.2.116)";
CM_ SG_ 162 VFC_2DPoly01_CoefficientUc4 "Polynomial coefficient for the u-axis value (in CV coordinates, origin top left). Similar to ISO 23150:2022(E): Polynomial coefficient y {c0,c1,c2,c3} (A.2.116)";
CM_ SG_ 162 VFC_2DPoly01_CoefficientUc5 "Polynomial coefficient for the u-axis value (in CV coordinates, origin top left). Similar to ISO 23150:2022(E): Polynomial coefficient y {c0,c1,c2,c3} (A.2.116)";
CM_ SG_ 162 VFC_2DPoly01_RangeVBegin "Longitudinal begin of the polynomial (big v value) (in CV coordinates, origin top left). Similar to ISO 23150:2022(E): Polynomial range x {begin, end} (A.2.120)";
CM_ SG_ 162 VFC_2DPoly01_RangeVEnd "Longitudinal end of the polynomial (small v value) (in CV coordinates, origin top left). Similar to ISO 23150:2022(E): Polynomial range x {begin, end} (A.2.120)";
CM_ SG_ 162 VFC_2DPoly02_LaneAssociation "Position relative to the ego lane. ISO 23150:2022(E): Road object lane association (A.2.93)";
CM_ SG_ 162 VFC_2DPoly02_ExistProb "ISO 23150:2022(E): Existence probability - object level (A.2.1)";
CM_ SG_ 162 VFC_2DPoly02_Type "Type of the Line. ISO 23150:2022(E): Road marking type (A.2.91)";
CM_ SG_ 162 VFC_2DPoly02_CoefficientUc0 "Polynomial coefficient for the u-axis value (in CV coordinates, origin top left). Similar to ISO 23150:2022(E): Polynomial coefficient y {c0,c1,c2,c3} (A.2.116)";
CM_ SG_ 162 VFC_2DPoly02_CoefficientUc1 "Polynomial coefficient for the u-axis value (in CV coordinates, origin top left). Similar to ISO 23150:2022(E): Polynomial coefficient y {c0,c1,c2,c3} (A.2.116)";
CM_ SG_ 162 VFC_2DPoly02_CoefficientUc2 "Polynomial coefficient for the u-axis value (in CV coordinates, origin top left). Similar to ISO 23150:2022(E): Polynomial coefficient y {c0,c1,c2,c3} (A.2.116)";
CM_ SG_ 162 VFC_2DPoly02_CoefficientUc3 "Polynomial coefficient for the u-axis value (in CV coordinates, origin top left). Similar to ISO 23150:2022(E): Polynomial coefficient y {c0,c1,c2,c3} (A.2.116)";
CM_ SG_ 162 VFC_2DPoly02_CoefficientUc4 "Polynomial coefficient for the u-axis value (in CV coordinates, origin top left). Similar to ISO 23150:2022(E): Polynomial coefficient y {c0,c1,c2,c3} (A.2.116)";
CM_ SG_ 162 VFC_2DPoly02_CoefficientUc5 "Polynomial coefficient for the u-axis value (in CV coordinates, origin top left). Similar to ISO 23150:2022(E): Polynomial coefficient y {c0,c1,c2,c3} (A.2.116)";
CM_ SG_ 162 VFC_2DPoly02_RangeVBegin "Longitudinal begin of the polynomial (big v value) (in CV coordinates, origin top left). Similar to ISO 23150:2022(E): Polynomial range x {begin, end} (A.2.120)";
CM_ SG_ 162 VFC_2DPoly02_RangeVEnd "Longitudinal end of the polynomial (small v value) (in CV coordinates, origin top left). Similar to ISO 23150:2022(E): Polynomial range x {begin, end} (A.2.120)";
CM_ SG_ 163 VFC_2DPoly_03_05_CRC "CRC - Autosar E2E Profile 5";
CM_ SG_ 163 VFC_2DPoly_03_05_AliveCtr "Alive counter - Autosar E2E Profile 5";
CM_ SG_ 163 VFC_2DPoly_03_05_ProtBlockCtr "Protocol-Signal: Block-Counter";
CM_ SG_ 163 VFC_2DPoly03_LaneAssociation "Position relative to the ego lane. ISO 23150:2022(E): Road object lane association (A.2.93)";
CM_ SG_ 163 VFC_2DPoly03_ExistProb "ISO 23150:2022(E): Existence probability - object level (A.2.1)";
CM_ SG_ 163 VFC_2DPoly03_Type "Type of the Line. ISO 23150:2022(E): Road marking type (A.2.91)";
CM_ SG_ 163 VFC_2DPoly03_CoefficientUc0 "Polynomial coefficient for the u-axis value (in CV coordinates, origin top left). Similar to ISO 23150:2022(E): Polynomial coefficient y {c0,c1,c2,c3} (A.2.116)";
CM_ SG_ 163 VFC_2DPoly03_CoefficientUc1 "Polynomial coefficient for the u-axis value (in CV coordinates, origin top left). Similar to ISO 23150:2022(E): Polynomial coefficient y {c0,c1,c2,c3} (A.2.116)";
CM_ SG_ 163 VFC_2DPoly03_CoefficientUc2 "Polynomial coefficient for the u-axis value (in CV coordinates, origin top left). Similar to ISO 23150:2022(E): Polynomial coefficient y {c0,c1,c2,c3} (A.2.116)";
CM_ SG_ 163 VFC_2DPoly03_CoefficientUc3 "Polynomial coefficient for the u-axis value (in CV coordinates, origin top left). Similar to ISO 23150:2022(E): Polynomial coefficient y {c0,c1,c2,c3} (A.2.116)";
CM_ SG_ 163 VFC_2DPoly03_CoefficientUc4 "Polynomial coefficient for the u-axis value (in CV coordinates, origin top left). Similar to ISO 23150:2022(E): Polynomial coefficient y {c0,c1,c2,c3} (A.2.116)";
CM_ SG_ 163 VFC_2DPoly03_CoefficientUc5 "Polynomial coefficient for the u-axis value (in CV coordinates, origin top left). Similar to ISO 23150:2022(E): Polynomial coefficient y {c0,c1,c2,c3} (A.2.116)";
CM_ SG_ 163 VFC_2DPoly03_RangeVBegin "Longitudinal begin of the polynomial (big v value) (in CV coordinates, origin top left). Similar to ISO 23150:2022(E): Polynomial range x {begin, end} (A.2.120)";
CM_ SG_ 163 VFC_2DPoly03_RangeVEnd "Longitudinal end of the polynomial (small v value) (in CV coordinates, origin top left). Similar to ISO 23150:2022(E): Polynomial range x {begin, end} (A.2.120)";
CM_ SG_ 163 VFC_2DPoly04_LaneAssociation "Position relative to the ego lane. ISO 23150:2022(E): Road object lane association (A.2.93)";
CM_ SG_ 163 VFC_2DPoly04_ExistProb "ISO 23150:2022(E): Existence probability - object level (A.2.1)";
CM_ SG_ 163 VFC_2DPoly04_Type "Type of the Line. ISO 23150:2022(E): Road marking type (A.2.91)";
CM_ SG_ 163 VFC_2DPoly04_CoefficientUc0 "Polynomial coefficient for the u-axis value (in CV coordinates, origin top left). Similar to ISO 23150:2022(E): Polynomial coefficient y {c0,c1,c2,c3} (A.2.116)";
CM_ SG_ 163 VFC_2DPoly04_CoefficientUc1 "Polynomial coefficient for the u-axis value (in CV coordinates, origin top left). Similar to ISO 23150:2022(E): Polynomial coefficient y {c0,c1,c2,c3} (A.2.116)";
CM_ SG_ 163 VFC_2DPoly04_CoefficientUc2 "Polynomial coefficient for the u-axis value (in CV coordinates, origin top left). Similar to ISO 23150:2022(E): Polynomial coefficient y {c0,c1,c2,c3} (A.2.116)";
CM_ SG_ 163 VFC_2DPoly04_CoefficientUc3 "Polynomial coefficient for the u-axis value (in CV coordinates, origin top left). Similar to ISO 23150:2022(E): Polynomial coefficient y {c0,c1,c2,c3} (A.2.116)";
CM_ SG_ 163 VFC_2DPoly04_CoefficientUc4 "Polynomial coefficient for the u-axis value (in CV coordinates, origin top left). Similar to ISO 23150:2022(E): Polynomial coefficient y {c0,c1,c2,c3} (A.2.116)";
CM_ SG_ 163 VFC_2DPoly04_CoefficientUc5 "Polynomial coefficient for the u-axis value (in CV coordinates, origin top left). Similar to ISO 23150:2022(E): Polynomial coefficient y {c0,c1,c2,c3} (A.2.116)";
CM_ SG_ 163 VFC_2DPoly04_RangeVBegin "Longitudinal begin of the polynomial (big v value) (in CV coordinates, origin top left). Similar to ISO 23150:2022(E): Polynomial range x {begin, end} (A.2.120)";
CM_ SG_ 163 VFC_2DPoly04_RangeVEnd "Longitudinal end of the polynomial (small v value) (in CV coordinates, origin top left). Similar to ISO 23150:2022(E): Polynomial range x {begin, end} (A.2.120)";
CM_ SG_ 163 VFC_2DPoly05_LaneAssociation "Position relative to the ego lane. ISO 23150:2022(E): Road object lane association (A.2.93)";
CM_ SG_ 163 VFC_2DPoly05_ExistProb "ISO 23150:2022(E): Existence probability - object level (A.2.1)";
CM_ SG_ 163 VFC_2DPoly05_Type "Type of the Line. ISO 23150:2022(E): Road marking type (A.2.91)";
CM_ SG_ 163 VFC_2DPoly05_CoefficientUc0 "Polynomial coefficient for the u-axis value (in CV coordinates, origin top left). Similar to ISO 23150:2022(E): Polynomial coefficient y {c0,c1,c2,c3} (A.2.116)";
CM_ SG_ 163 VFC_2DPoly05_CoefficientUc1 "Polynomial coefficient for the u-axis value (in CV coordinates, origin top left). Similar to ISO 23150:2022(E): Polynomial coefficient y {c0,c1,c2,c3} (A.2.116)";
CM_ SG_ 163 VFC_2DPoly05_CoefficientUc2 "Polynomial coefficient for the u-axis value (in CV coordinates, origin top left). Similar to ISO 23150:2022(E): Polynomial coefficient y {c0,c1,c2,c3} (A.2.116)";
CM_ SG_ 163 VFC_2DPoly05_CoefficientUc3 "Polynomial coefficient for the u-axis value (in CV coordinates, origin top left). Similar to ISO 23150:2022(E): Polynomial coefficient y {c0,c1,c2,c3} (A.2.116)";
CM_ SG_ 163 VFC_2DPoly05_CoefficientUc4 "Polynomial coefficient for the u-axis value (in CV coordinates, origin top left). Similar to ISO 23150:2022(E): Polynomial coefficient y {c0,c1,c2,c3} (A.2.116)";
CM_ SG_ 163 VFC_2DPoly05_CoefficientUc5 "Polynomial coefficient for the u-axis value (in CV coordinates, origin top left). Similar to ISO 23150:2022(E): Polynomial coefficient y {c0,c1,c2,c3} (A.2.116)";
CM_ SG_ 163 VFC_2DPoly05_RangeVBegin "Longitudinal begin of the polynomial (big v value) (in CV coordinates, origin top left). Similar to ISO 23150:2022(E): Polynomial range x {begin, end} (A.2.120)";
CM_ SG_ 163 VFC_2DPoly05_RangeVEnd "Longitudinal end of the polynomial (small v value) (in CV coordinates, origin top left). Similar to ISO 23150:2022(E): Polynomial range x {begin, end} (A.2.120)";
CM_ SG_ 164 VFC_2DPoly_06_08_CRC "CRC - Autosar E2E Profile 5";
CM_ SG_ 164 VFC_2DPoly_06_08_AliveCtr "Alive counter - Autosar E2E Profile 5";
CM_ SG_ 164 VFC_2DPoly_06_08_ProtBlockCtr "Protocol-Signal: Block-Counter";
CM_ SG_ 164 VFC_2DPoly06_LaneAssociation "Position relative to the ego lane. ISO 23150:2022(E): Road object lane association (A.2.93)";
CM_ SG_ 164 VFC_2DPoly06_ExistProb "ISO 23150:2022(E): Existence probability - object level (A.2.1)";
CM_ SG_ 164 VFC_2DPoly06_Type "Type of the Line. ISO 23150:2022(E): Road marking type (A.2.91)";
CM_ SG_ 164 VFC_2DPoly06_CoefficientUc0 "Polynomial coefficient for the u-axis value (in CV coordinates, origin top left). Similar to ISO 23150:2022(E): Polynomial coefficient y {c0,c1,c2,c3} (A.2.116)";
CM_ SG_ 164 VFC_2DPoly06_CoefficientUc1 "Polynomial coefficient for the u-axis value (in CV coordinates, origin top left). Similar to ISO 23150:2022(E): Polynomial coefficient y {c0,c1,c2,c3} (A.2.116)";
CM_ SG_ 164 VFC_2DPoly06_CoefficientUc2 "Polynomial coefficient for the u-axis value (in CV coordinates, origin top left). Similar to ISO 23150:2022(E): Polynomial coefficient y {c0,c1,c2,c3} (A.2.116)";
CM_ SG_ 164 VFC_2DPoly06_CoefficientUc3 "Polynomial coefficient for the u-axis value (in CV coordinates, origin top left). Similar to ISO 23150:2022(E): Polynomial coefficient y {c0,c1,c2,c3} (A.2.116)";
CM_ SG_ 164 VFC_2DPoly06_CoefficientUc4 "Polynomial coefficient for the u-axis value (in CV coordinates, origin top left). Similar to ISO 23150:2022(E): Polynomial coefficient y {c0,c1,c2,c3} (A.2.116)";
CM_ SG_ 164 VFC_2DPoly06_CoefficientUc5 "Polynomial coefficient for the u-axis value (in CV coordinates, origin top left). Similar to ISO 23150:2022(E): Polynomial coefficient y {c0,c1,c2,c3} (A.2.116)";
CM_ SG_ 164 VFC_2DPoly06_RangeVBegin "Longitudinal begin of the polynomial (big v value) (in CV coordinates, origin top left). Similar to ISO 23150:2022(E): Polynomial range x {begin, end} (A.2.120)";
CM_ SG_ 164 VFC_2DPoly06_RangeVEnd "Longitudinal end of the polynomial (small v value) (in CV coordinates, origin top left). Similar to ISO 23150:2022(E): Polynomial range x {begin, end} (A.2.120)";
CM_ SG_ 164 VFC_2DPoly07_LaneAssociation "Position relative to the ego lane. ISO 23150:2022(E): Road object lane association (A.2.93)";
CM_ SG_ 164 VFC_2DPoly07_ExistProb "ISO 23150:2022(E): Existence probability - object level (A.2.1)";
CM_ SG_ 164 VFC_2DPoly07_Type "Type of the Line. ISO 23150:2022(E): Road marking type (A.2.91)";
CM_ SG_ 164 VFC_2DPoly07_CoefficientUc0 "Polynomial coefficient for the u-axis value (in CV coordinates, origin top left). Similar to ISO 23150:2022(E): Polynomial coefficient y {c0,c1,c2,c3} (A.2.116)";
CM_ SG_ 164 VFC_2DPoly07_CoefficientUc1 "Polynomial coefficient for the u-axis value (in CV coordinates, origin top left). Similar to ISO 23150:2022(E): Polynomial coefficient y {c0,c1,c2,c3} (A.2.116)";
CM_ SG_ 164 VFC_2DPoly07_CoefficientUc2 "Polynomial coefficient for the u-axis value (in CV coordinates, origin top left). Similar to ISO 23150:2022(E): Polynomial coefficient y {c0,c1,c2,c3} (A.2.116)";
CM_ SG_ 164 VFC_2DPoly07_CoefficientUc3 "Polynomial coefficient for the u-axis value (in CV coordinates, origin top left). Similar to ISO 23150:2022(E): Polynomial coefficient y {c0,c1,c2,c3} (A.2.116)";
CM_ SG_ 164 VFC_2DPoly07_CoefficientUc4 "Polynomial coefficient for the u-axis value (in CV coordinates, origin top left). Similar to ISO 23150:2022(E): Polynomial coefficient y {c0,c1,c2,c3} (A.2.116)";
CM_ SG_ 164 VFC_2DPoly07_CoefficientUc5 "Polynomial coefficient for the u-axis value (in CV coordinates, origin top left). Similar to ISO 23150:2022(E): Polynomial coefficient y {c0,c1,c2,c3} (A.2.116)";
CM_ SG_ 164 VFC_2DPoly07_RangeVBegin "Longitudinal begin of the polynomial (big v value) (in CV coordinates, origin top left). Similar to ISO 23150:2022(E): Polynomial range x {begin, end} (A.2.120)";
CM_ SG_ 164 VFC_2DPoly07_RangeVEnd "Longitudinal end of the polynomial (small v value) (in CV coordinates, origin top left). Similar to ISO 23150:2022(E): Polynomial range x {begin, end} (A.2.120)";
CM_ SG_ 164 VFC_2DPoly08_LaneAssociation "Position relative to the ego lane. ISO 23150:2022(E): Road object lane association (A.2.93)";
CM_ SG_ 164 VFC_2DPoly08_ExistProb "ISO 23150:2022(E): Existence probability - object level (A.2.1)";
CM_ SG_ 164 VFC_2DPoly08_Type "Type of the Line. ISO 23150:2022(E): Road marking type (A.2.91)";
CM_ SG_ 164 VFC_2DPoly08_CoefficientUc0 "Polynomial coefficient for the u-axis value (in CV coordinates, origin top left). Similar to ISO 23150:2022(E): Polynomial coefficient y {c0,c1,c2,c3} (A.2.116)";
CM_ SG_ 164 VFC_2DPoly08_CoefficientUc1 "Polynomial coefficient for the u-axis value (in CV coordinates, origin top left). Similar to ISO 23150:2022(E): Polynomial coefficient y {c0,c1,c2,c3} (A.2.116)";
CM_ SG_ 164 VFC_2DPoly08_CoefficientUc2 "Polynomial coefficient for the u-axis value (in CV coordinates, origin top left). Similar to ISO 23150:2022(E): Polynomial coefficient y {c0,c1,c2,c3} (A.2.116)";
CM_ SG_ 164 VFC_2DPoly08_CoefficientUc3 "Polynomial coefficient for the u-axis value (in CV coordinates, origin top left). Similar to ISO 23150:2022(E): Polynomial coefficient y {c0,c1,c2,c3} (A.2.116)";
CM_ SG_ 164 VFC_2DPoly08_CoefficientUc4 "Polynomial coefficient for the u-axis value (in CV coordinates, origin top left). Similar to ISO 23150:2022(E): Polynomial coefficient y {c0,c1,c2,c3} (A.2.116)";
CM_ SG_ 164 VFC_2DPoly08_CoefficientUc5 "Polynomial coefficient for the u-axis value (in CV coordinates, origin top left). Similar to ISO 23150:2022(E): Polynomial coefficient y {c0,c1,c2,c3} (A.2.116)";
CM_ SG_ 164 VFC_2DPoly08_RangeVBegin "Longitudinal begin of the polynomial (big v value) (in CV coordinates, origin top left). Similar to ISO 23150:2022(E): Polynomial range x {begin, end} (A.2.120)";
CM_ SG_ 164 VFC_2DPoly08_RangeVEnd "Longitudinal end of the polynomial (small v value) (in CV coordinates, origin top left). Similar to ISO 23150:2022(E): Polynomial range x {begin, end} (A.2.120)";
CM_ SG_ 165 VFC_2DPoly_09_11_CRC "CRC - Autosar E2E Profile 5";
CM_ SG_ 165 VFC_2DPoly_09_11_AliveCtr "Alive counter - Autosar E2E Profile 5";
CM_ SG_ 165 VFC_2DPoly_09_11_ProtBlockCtr "Protocol-Signal: Block-Counter";
CM_ SG_ 165 VFC_2DPoly09_LaneAssociation "Position relative to the ego lane. ISO 23150:2022(E): Road object lane association (A.2.93)";
CM_ SG_ 165 VFC_2DPoly09_ExistProb "ISO 23150:2022(E): Existence probability - object level (A.2.1)";
CM_ SG_ 165 VFC_2DPoly09_Type "Type of the Line. ISO 23150:2022(E): Road marking type (A.2.91)";
CM_ SG_ 165 VFC_2DPoly09_CoefficientUc0 "Polynomial coefficient for the u-axis value (in CV coordinates, origin top left). Similar to ISO 23150:2022(E): Polynomial coefficient y {c0,c1,c2,c3} (A.2.116)";
CM_ SG_ 165 VFC_2DPoly09_CoefficientUc1 "Polynomial coefficient for the u-axis value (in CV coordinates, origin top left). Similar to ISO 23150:2022(E): Polynomial coefficient y {c0,c1,c2,c3} (A.2.116)";
CM_ SG_ 165 VFC_2DPoly09_CoefficientUc2 "Polynomial coefficient for the u-axis value (in CV coordinates, origin top left). Similar to ISO 23150:2022(E): Polynomial coefficient y {c0,c1,c2,c3} (A.2.116)";
CM_ SG_ 165 VFC_2DPoly09_CoefficientUc3 "Polynomial coefficient for the u-axis value (in CV coordinates, origin top left). Similar to ISO 23150:2022(E): Polynomial coefficient y {c0,c1,c2,c3} (A.2.116)";
CM_ SG_ 165 VFC_2DPoly09_CoefficientUc4 "Polynomial coefficient for the u-axis value (in CV coordinates, origin top left). Similar to ISO 23150:2022(E): Polynomial coefficient y {c0,c1,c2,c3} (A.2.116)";
CM_ SG_ 165 VFC_2DPoly09_CoefficientUc5 "Polynomial coefficient for the u-axis value (in CV coordinates, origin top left). Similar to ISO 23150:2022(E): Polynomial coefficient y {c0,c1,c2,c3} (A.2.116)";
CM_ SG_ 165 VFC_2DPoly09_RangeVBegin "Longitudinal begin of the polynomial (big v value) (in CV coordinates, origin top left). Similar to ISO 23150:2022(E): Polynomial range x {begin, end} (A.2.120)";
CM_ SG_ 165 VFC_2DPoly09_RangeVEnd "Longitudinal end of the polynomial (small v value) (in CV coordinates, origin top left). Similar to ISO 23150:2022(E): Polynomial range x {begin, end} (A.2.120)";
CM_ SG_ 165 VFC_2DPoly10_LaneAssociation "Position relative to the ego lane. ISO 23150:2022(E): Road object lane association (A.2.93)";
CM_ SG_ 165 VFC_2DPoly10_ExistProb "ISO 23150:2022(E): Existence probability - object level (A.2.1)";
CM_ SG_ 165 VFC_2DPoly10_Type "Type of the Line. ISO 23150:2022(E): Road marking type (A.2.91)";
CM_ SG_ 165 VFC_2DPoly10_CoefficientUc0 "Polynomial coefficient for the u-axis value (in CV coordinates, origin top left). Similar to ISO 23150:2022(E): Polynomial coefficient y {c0,c1,c2,c3} (A.2.116)";
CM_ SG_ 165 VFC_2DPoly10_CoefficientUc1 "Polynomial coefficient for the u-axis value (in CV coordinates, origin top left). Similar to ISO 23150:2022(E): Polynomial coefficient y {c0,c1,c2,c3} (A.2.116)";
CM_ SG_ 165 VFC_2DPoly10_CoefficientUc2 "Polynomial coefficient for the u-axis value (in CV coordinates, origin top left). Similar to ISO 23150:2022(E): Polynomial coefficient y {c0,c1,c2,c3} (A.2.116)";
CM_ SG_ 165 VFC_2DPoly10_CoefficientUc3 "Polynomial coefficient for the u-axis value (in CV coordinates, origin top left). Similar to ISO 23150:2022(E): Polynomial coefficient y {c0,c1,c2,c3} (A.2.116)";
CM_ SG_ 165 VFC_2DPoly10_CoefficientUc4 "Polynomial coefficient for the u-axis value (in CV coordinates, origin top left). Similar to ISO 23150:2022(E): Polynomial coefficient y {c0,c1,c2,c3} (A.2.116)";
CM_ SG_ 165 VFC_2DPoly10_CoefficientUc5 "Polynomial coefficient for the u-axis value (in CV coordinates, origin top left). Similar to ISO 23150:2022(E): Polynomial coefficient y {c0,c1,c2,c3} (A.2.116)";
CM_ SG_ 165 VFC_2DPoly10_RangeVBegin "Longitudinal begin of the polynomial (big v value) (in CV coordinates, origin top left). Similar to ISO 23150:2022(E): Polynomial range x {begin, end} (A.2.120)";
CM_ SG_ 165 VFC_2DPoly10_RangeVEnd "Longitudinal end of the polynomial (small v value) (in CV coordinates, origin top left). Similar to ISO 23150:2022(E): Polynomial range x {begin, end} (A.2.120)";
CM_ SG_ 165 VFC_2DPoly11_LaneAssociation "Position relative to the ego lane. ISO 23150:2022(E): Road object lane association (A.2.93)";
CM_ SG_ 165 VFC_2DPoly11_ExistProb "ISO 23150:2022(E): Existence probability - object level (A.2.1)";
CM_ SG_ 165 VFC_2DPoly11_Type "Type of the Line. ISO 23150:2022(E): Road marking type (A.2.91)";
CM_ SG_ 165 VFC_2DPoly11_CoefficientUc0 "Polynomial coefficient for the u-axis value (in CV coordinates, origin top left). Similar to ISO 23150:2022(E): Polynomial coefficient y {c0,c1,c2,c3} (A.2.116)";
CM_ SG_ 165 VFC_2DPoly11_CoefficientUc1 "Polynomial coefficient for the u-axis value (in CV coordinates, origin top left). Similar to ISO 23150:2022(E): Polynomial coefficient y {c0,c1,c2,c3} (A.2.116)";
CM_ SG_ 165 VFC_2DPoly11_CoefficientUc2 "Polynomial coefficient for the u-axis value (in CV coordinates, origin top left). Similar to ISO 23150:2022(E): Polynomial coefficient y {c0,c1,c2,c3} (A.2.116)";
CM_ SG_ 165 VFC_2DPoly11_CoefficientUc3 "Polynomial coefficient for the u-axis value (in CV coordinates, origin top left). Similar to ISO 23150:2022(E): Polynomial coefficient y {c0,c1,c2,c3} (A.2.116)";
CM_ SG_ 165 VFC_2DPoly11_CoefficientUc4 "Polynomial coefficient for the u-axis value (in CV coordinates, origin top left). Similar to ISO 23150:2022(E): Polynomial coefficient y {c0,c1,c2,c3} (A.2.116)";
CM_ SG_ 165 VFC_2DPoly11_CoefficientUc5 "Polynomial coefficient for the u-axis value (in CV coordinates, origin top left). Similar to ISO 23150:2022(E): Polynomial coefficient y {c0,c1,c2,c3} (A.2.116)";
CM_ SG_ 165 VFC_2DPoly11_RangeVBegin "Longitudinal begin of the polynomial (big v value) (in CV coordinates, origin top left). Similar to ISO 23150:2022(E): Polynomial range x {begin, end} (A.2.120)";
CM_ SG_ 165 VFC_2DPoly11_RangeVEnd "Longitudinal end of the polynomial (small v value) (in CV coordinates, origin top left). Similar to ISO 23150:2022(E): Polynomial range x {begin, end} (A.2.120)";
CM_ SG_ 178 VFC_RM_00_06_CRC "CRC - Autosar E2E Profile 5";
CM_ SG_ 178 VFC_RM_00_06_AliveCtr "Alive counter - Autosar E2E Profile 5";
CM_ SG_ 178 VFC_RM_00_06_ProtBlockCtr "Protocol-Signal: Block-Counter";
CM_ SG_ 178 VFC_RM00_ExistProb "ISO 23150:2022(E): Existence probability - object level (A.2.1)";
CM_ SG_ 178 VFC_RM00_Type "ISO 23150:2022(E): Road marking type (A.2.91)";
CM_ SG_ 178 VFC_RM00_VertexPoint00x "Point00 connected to Point01 results in straight line. ISO 23150:2022(E): Vertex point {x, y, z} (A.2.112)";
CM_ SG_ 178 VFC_RM00_VertexPoint00y "Point00 connected to Point01 results in straight line. ISO 23150:2022(E): Vertex point {x, y, z} (A.2.112)";
CM_ SG_ 178 VFC_RM00_VertexPoint01x "Point00 connected to Point01 results in straight line. ISO 23150:2022(E): Vertex point {x, y, z} (A.2.112)";
CM_ SG_ 178 VFC_RM00_VertexPoint01y "Point00 connected to Point01 results in straight line. ISO 23150:2022(E): Vertex point {x, y, z} (A.2.112)";
CM_ SG_ 178 VFC_RM01_ExistProb "ISO 23150:2022(E): Existence probability - object level (A.2.1)";
CM_ SG_ 178 VFC_RM01_Type "ISO 23150:2022(E): Road marking type (A.2.91)";
CM_ SG_ 178 VFC_RM01_VertexPoint00x "Point00 connected to Point01 results in straight line. ISO 23150:2022(E): Vertex point {x, y, z} (A.2.112)";
CM_ SG_ 178 VFC_RM01_VertexPoint00y "Point00 connected to Point01 results in straight line. ISO 23150:2022(E): Vertex point {x, y, z} (A.2.112)";
CM_ SG_ 178 VFC_RM01_VertexPoint01x "Point00 connected to Point01 results in straight line. ISO 23150:2022(E): Vertex point {x, y, z} (A.2.112)";
CM_ SG_ 178 VFC_RM01_VertexPoint01y "Point00 connected to Point01 results in straight line. ISO 23150:2022(E): Vertex point {x, y, z} (A.2.112)";
CM_ SG_ 178 VFC_RM02_ExistProb "ISO 23150:2022(E): Existence probability - object level (A.2.1)";
CM_ SG_ 178 VFC_RM02_Type "ISO 23150:2022(E): Road marking type (A.2.91)";
CM_ SG_ 178 VFC_RM02_VertexPoint00x "Point00 connected to Point01 results in straight line. ISO 23150:2022(E): Vertex point {x, y, z} (A.2.112)";
CM_ SG_ 178 VFC_RM02_VertexPoint00y "Point00 connected to Point01 results in straight line. ISO 23150:2022(E): Vertex point {x, y, z} (A.2.112)";
CM_ SG_ 178 VFC_RM02_VertexPoint01x "Point00 connected to Point01 results in straight line. ISO 23150:2022(E): Vertex point {x, y, z} (A.2.112)";
CM_ SG_ 178 VFC_RM02_VertexPoint01y "Point00 connected to Point01 results in straight line. ISO 23150:2022(E): Vertex point {x, y, z} (A.2.112)";
CM_ SG_ 178 VFC_RM03_ExistProb "ISO 23150:2022(E): Existence probability - object level (A.2.1)";
CM_ SG_ 178 VFC_RM03_Type "ISO 23150:2022(E): Road marking type (A.2.91)";
CM_ SG_ 178 VFC_RM03_VertexPoint00x "Point00 connected to Point01 results in straight line. ISO 23150:2022(E): Vertex point {x, y, z} (A.2.112)";
CM_ SG_ 178 VFC_RM03_VertexPoint00y "Point00 connected to Point01 results in straight line. ISO 23150:2022(E): Vertex point {x, y, z} (A.2.112)";
CM_ SG_ 178 VFC_RM03_VertexPoint01x "Point00 connected to Point01 results in straight line. ISO 23150:2022(E): Vertex point {x, y, z} (A.2.112)";
CM_ SG_ 178 VFC_RM03_VertexPoint01y "Point00 connected to Point01 results in straight line. ISO 23150:2022(E): Vertex point {x, y, z} (A.2.112)";
CM_ SG_ 178 VFC_RM04_ExistProb "ISO 23150:2022(E): Existence probability - object level (A.2.1)";
CM_ SG_ 178 VFC_RM04_Type "ISO 23150:2022(E): Road marking type (A.2.91)";
CM_ SG_ 178 VFC_RM04_VertexPoint00x "Point00 connected to Point01 results in straight line. ISO 23150:2022(E): Vertex point {x, y, z} (A.2.112)";
CM_ SG_ 178 VFC_RM04_VertexPoint00y "Point00 connected to Point01 results in straight line. ISO 23150:2022(E): Vertex point {x, y, z} (A.2.112)";
CM_ SG_ 178 VFC_RM04_VertexPoint01x "Point00 connected to Point01 results in straight line. ISO 23150:2022(E): Vertex point {x, y, z} (A.2.112)";
CM_ SG_ 178 VFC_RM04_VertexPoint01y "Point00 connected to Point01 results in straight line. ISO 23150:2022(E): Vertex point {x, y, z} (A.2.112)";
CM_ SG_ 178 VFC_RM05_ExistProb "ISO 23150:2022(E): Existence probability - object level (A.2.1)";
CM_ SG_ 178 VFC_RM05_Type "ISO 23150:2022(E): Road marking type (A.2.91)";
CM_ SG_ 178 VFC_RM05_VertexPoint00x "Point00 connected to Point01 results in straight line. ISO 23150:2022(E): Vertex point {x, y, z} (A.2.112)";
CM_ SG_ 178 VFC_RM05_VertexPoint00y "Point00 connected to Point01 results in straight line. ISO 23150:2022(E): Vertex point {x, y, z} (A.2.112)";
CM_ SG_ 178 VFC_RM05_VertexPoint01x "Point00 connected to Point01 results in straight line. ISO 23150:2022(E): Vertex point {x, y, z} (A.2.112)";
CM_ SG_ 178 VFC_RM05_VertexPoint01y "Point00 connected to Point01 results in straight line. ISO 23150:2022(E): Vertex point {x, y, z} (A.2.112)";
CM_ SG_ 178 VFC_RM06_ExistProb "ISO 23150:2022(E): Existence probability - object level (A.2.1)";
CM_ SG_ 178 VFC_RM06_Type "ISO 23150:2022(E): Road marking type (A.2.91)";
CM_ SG_ 178 VFC_RM06_VertexPoint00x "Point00 connected to Point01 results in straight line. ISO 23150:2022(E): Vertex point {x, y, z} (A.2.112)";
CM_ SG_ 178 VFC_RM06_VertexPoint00y "Point00 connected to Point01 results in straight line. ISO 23150:2022(E): Vertex point {x, y, z} (A.2.112)";
CM_ SG_ 178 VFC_RM06_VertexPoint01x "Point00 connected to Point01 results in straight line. ISO 23150:2022(E): Vertex point {x, y, z} (A.2.112)";
CM_ SG_ 178 VFC_RM06_VertexPoint01y "Point00 connected to Point01 results in straight line. ISO 23150:2022(E): Vertex point {x, y, z} (A.2.112)";
CM_ SG_ 224 VFC_TLHdr_CRC "CRC - Autosar E2E Profile 5";
CM_ SG_ 224 VFC_TLHdr_AliveCtr "Alive counter - Autosar E2E Profile 5";
CM_ SG_ 224 VFC_TLHdr_ProtBlockCtr "Protocol-Signal: Block-Counter";
CM_ SG_ 224 VFC_TLHdr_IfVersionIdMajor "Version information of the interface. e. g. version 1.0: Major = 1. ISO 23150:2022(E): Interface version ID {major, minor, patch} (A.1.1)";
CM_ SG_ 224 VFC_TLHdr_IfVersionIdMinor "Version information of the interface. e. g. version 1.0: Minor = 0. ISO 23150:2022(E): Interface version ID {major, minor, patch} (A.1.1)";
CM_ SG_ 224 VFC_TLHdr_NumTrafficLights "Protocol-Signal: count of all traffic lights ISO 23150:2022(E): Number of valid traffic lights (A.1.12.7)";
CM_ SG_ 224 VFC_TLHdr_TimeStampStatus "Autosar StbM_TimeBaseStatusType bitfield with extension:
Bit 0: TIMEOUT
Bit 1: Reserved1
Bit 2: SYNC_TO_GATEWAY
Bit 3: GLOBAL_TIME_BASE
Bit 4: TIMELEAP_FUTURE
Bit 5: TIMELEAP_PAST
Bit 6: Reserved6
Bit 7: Extension: GENERAL_ERROR";
CM_ SG_ 224 VFC_TLHdr_TimeStamp "TimeStamp of Objects ISO 23150:2022(E) Time stamp �prediction (A.1.5.1)";
CM_ SG_ 224 VFC_TLHdr_State "Traffic light function and degradation state";
CM_ SG_ 224 VFC_TLHdr_MostRelevantTLId "Index of traffic light object which is most relevant";
CM_ SG_ 224 VFC_TLHdr_Reserved0 "Reserved for future usage";
CM_ SG_ 224 VFC_TLHdr_Reserved1 "Reserved for future usage";
CM_ SG_ 226 VFC_TL00_04_CRC "CRC - Autosar E2E Profile 5";
CM_ SG_ 226 VFC_TL00_04_AliveCtr "Alive counter - Autosar E2E Profile 5";
CM_ SG_ 226 VFC_TL00_04_ProtBlockCtr "Protocol-Signal: Block-Counter";
CM_ SG_ 226 VFC_TL00_Colour "Colour of the traffic light spot - defined in ISO 23150:2022(E) A.2.209";
CM_ SG_ 226 VFC_TL00_LightShapeType "Type of traffic light, which indicates the direction of the traffic light (e.g. left/right turn) �- defined in ISO 23150:2022(E) A.2.205";
CM_ SG_ 226 VFC_TL00_LightModeType "Behavior mode of the traffic light spot �- defined in ISO 23150:2022(E) A.2.212";
CM_ SG_ 226 VFC_TL00_Py "Lateral position of traffic light �- defined in ISO 23150:2022(E) A.2.15";
CM_ SG_ 226 VFC_TL00_ExistProb "Existence probability - defined in ISO 23150:2022(E): Existence probability - object level (A.2.1)";
CM_ SG_ 226 VFC_TL00_Pz "Vertical position of traffic light �- defined in ISO 23150:2022(E) A.2.15";
CM_ SG_ 226 VFC_TL00_2DWidth "Width of traffic light in angle of view - additional information over ISO 23150:2022(E)";
CM_ SG_ 226 VFC_TL00_2DHeight "Height of traffic light in angle of view - additional information over ISO 23150:2022(E)";
CM_ SG_ 226 VFC_TL00_2DLeftEdge "Angle of view of the left border of traffic light spot bounding box - additional information over ISO 23150:2022(E)";
CM_ SG_ 226 VFC_TL00_2DTopEdge "Angle of view of the top border of traffic light spot bounding box - additional information over ISO 23150:2022(E)";
CM_ SG_ 226 VFC_TL00_Px "Longitudinal position of traffic light - defined in ISO 23150:2022(E) A.2.15";
CM_ SG_ 226 VFC_TL01_Colour "Colour of the traffic light spot - defined in ISO 23150:2022(E) A.2.209";
CM_ SG_ 226 VFC_TL01_LightShapeType "Type of traffic light, which indicates the direction of the traffic light (e.g. left/right turn) �- defined in ISO 23150:2022(E) A.2.205";
CM_ SG_ 226 VFC_TL01_LightModeType "Behavior mode of the traffic light spot �- defined in ISO 23150:2022(E) A.2.212";
CM_ SG_ 226 VFC_TL01_Py "Lateral position of traffic light �- defined in ISO 23150:2022(E) A.2.15";
CM_ SG_ 226 VFC_TL01_ExistProb "Existence probability - defined in ISO 23150:2022(E): Existence probability - object level (A.2.1)";
CM_ SG_ 226 VFC_TL01_Pz "Vertical position of traffic light �- defined in ISO 23150:2022(E) A.2.15";
CM_ SG_ 226 VFC_TL01_2DWidth "Width of traffic light in angle of view - additional information over ISO 23150:2022(E)";
CM_ SG_ 226 VFC_TL01_2DHeight "Height of traffic light in angle of view - additional information over ISO 23150:2022(E)";
CM_ SG_ 226 VFC_TL01_2DLeftEdge "Angle of view of the left border of traffic light spot bounding box - additional information over ISO 23150:2022(E)";
CM_ SG_ 226 VFC_TL01_2DTopEdge "Angle of view of the top border of traffic light spot bounding box - additional information over ISO 23150:2022(E)";
CM_ SG_ 226 VFC_TL01_Px "Longitudinal position of traffic light - defined in ISO 23150:2022(E) A.2.15";
CM_ SG_ 226 VFC_TL02_Colour "Colour of the traffic light spot - defined in ISO 23150:2022(E) A.2.209";
CM_ SG_ 226 VFC_TL02_LightShapeType "Type of traffic light, which indicates the direction of the traffic light (e.g. left/right turn) �- defined in ISO 23150:2022(E) A.2.205";
CM_ SG_ 226 VFC_TL02_LightModeType "Behavior mode of the traffic light spot �- defined in ISO 23150:2022(E) A.2.212";
CM_ SG_ 226 VFC_TL02_Py "Lateral position of traffic light �- defined in ISO 23150:2022(E) A.2.15";
CM_ SG_ 226 VFC_TL02_ExistProb "Existence probability - defined in ISO 23150:2022(E): Existence probability - object level (A.2.1)";
CM_ SG_ 226 VFC_TL02_Pz "Vertical position of traffic light �- defined in ISO 23150:2022(E) A.2.15";
CM_ SG_ 226 VFC_TL02_2DWidth "Width of traffic light in angle of view - additional information over ISO 23150:2022(E)";
CM_ SG_ 226 VFC_TL02_2DHeight "Height of traffic light in angle of view - additional information over ISO 23150:2022(E)";
CM_ SG_ 226 VFC_TL02_2DLeftEdge "Angle of view of the left border of traffic light spot bounding box - additional information over ISO 23150:2022(E)";
CM_ SG_ 226 VFC_TL02_2DTopEdge "Angle of view of the top border of traffic light spot bounding box - additional information over ISO 23150:2022(E)";
CM_ SG_ 226 VFC_TL02_Px "Longitudinal position of traffic light - defined in ISO 23150:2022(E) A.2.15";
CM_ SG_ 226 VFC_TL03_Colour "Colour of the traffic light spot - defined in ISO 23150:2022(E) A.2.209";
CM_ SG_ 226 VFC_TL03_LightShapeType "Type of traffic light, which indicates the direction of the traffic light (e.g. left/right turn) �- defined in ISO 23150:2022(E) A.2.205";
CM_ SG_ 226 VFC_TL03_LightModeType "Behavior mode of the traffic light spot �- defined in ISO 23150:2022(E) A.2.212";
CM_ SG_ 226 VFC_TL03_Py "Lateral position of traffic light �- defined in ISO 23150:2022(E) A.2.15";
CM_ SG_ 226 VFC_TL03_ExistProb "Existence probability - defined in ISO 23150:2022(E): Existence probability - object level (A.2.1)";
CM_ SG_ 226 VFC_TL03_Pz "Vertical position of traffic light �- defined in ISO 23150:2022(E) A.2.15";
CM_ SG_ 226 VFC_TL03_2DWidth "Width of traffic light in angle of view - additional information over ISO 23150:2022(E)";
CM_ SG_ 226 VFC_TL03_2DHeight "Height of traffic light in angle of view - additional information over ISO 23150:2022(E)";
CM_ SG_ 226 VFC_TL03_2DLeftEdge "Angle of view of the left border of traffic light spot bounding box - additional information over ISO 23150:2022(E)";
CM_ SG_ 226 VFC_TL03_2DTopEdge "Angle of view of the top border of traffic light spot bounding box - additional information over ISO 23150:2022(E)";
CM_ SG_ 226 VFC_TL03_Px "Longitudinal position of traffic light - defined in ISO 23150:2022(E) A.2.15";
CM_ SG_ 226 VFC_TL04_Colour "Colour of the traffic light spot - defined in ISO 23150:2022(E) A.2.209";
CM_ SG_ 226 VFC_TL04_LightShapeType "Type of traffic light, which indicates the direction of the traffic light (e.g. left/right turn) �- defined in ISO 23150:2022(E) A.2.205";
CM_ SG_ 226 VFC_TL04_LightModeType "Behavior mode of the traffic light spot �- defined in ISO 23150:2022(E) A.2.212";
CM_ SG_ 226 VFC_TL04_Py "Lateral position of traffic light �- defined in ISO 23150:2022(E) A.2.15";
CM_ SG_ 226 VFC_TL04_ExistProb "Existence probability - defined in ISO 23150:2022(E): Existence probability - object level (A.2.1)";
CM_ SG_ 226 VFC_TL04_Pz "Vertical position of traffic light �- defined in ISO 23150:2022(E) A.2.15";
CM_ SG_ 226 VFC_TL04_2DWidth "Width of traffic light in angle of view - additional information over ISO 23150:2022(E)";
CM_ SG_ 226 VFC_TL04_2DHeight "Height of traffic light in angle of view - additional information over ISO 23150:2022(E)";
CM_ SG_ 226 VFC_TL04_2DLeftEdge "Angle of view of the left border of traffic light spot bounding box - additional information over ISO 23150:2022(E)";
CM_ SG_ 226 VFC_TL04_2DTopEdge "Angle of view of the top border of traffic light spot bounding box - additional information over ISO 23150:2022(E)";
CM_ SG_ 226 VFC_TL04_Px "Longitudinal position of traffic light - defined in ISO 23150:2022(E) A.2.15";
CM_ SG_ 227 VFC_TL05_09_CRC "CRC - Autosar E2E Profile 5";
CM_ SG_ 227 VFC_TL05_09_AliveCtr "Alive counter - Autosar E2E Profile 5";
CM_ SG_ 227 VFC_TL05_09_ProtBlockCtr "Protocol-Signal: Block-Counter";
CM_ SG_ 227 VFC_TL05_Colour "Colour of the traffic light spot - defined in ISO 23150:2022(E) A.2.209";
CM_ SG_ 227 VFC_TL05_LightShapeType "Type of traffic light, which indicates the direction of the traffic light (e.g. left/right turn) �- defined in ISO 23150:2022(E) A.2.205";
CM_ SG_ 227 VFC_TL05_LightModeType "Behavior mode of the traffic light spot �- defined in ISO 23150:2022(E) A.2.212";
CM_ SG_ 227 VFC_TL05_Py "Lateral position of traffic light �- defined in ISO 23150:2022(E) A.2.15";
CM_ SG_ 227 VFC_TL05_ExistProb "Existence probability - defined in ISO 23150:2022(E): Existence probability - object level (A.2.1)";
CM_ SG_ 227 VFC_TL05_Pz "Vertical position of traffic light �- defined in ISO 23150:2022(E) A.2.15";
CM_ SG_ 227 VFC_TL05_2DWidth "Width of traffic light in angle of view - additional information over ISO 23150:2022(E)";
CM_ SG_ 227 VFC_TL05_2DHeight "Height of traffic light in angle of view - additional information over ISO 23150:2022(E)";
CM_ SG_ 227 VFC_TL05_2DLeftEdge "Angle of view of the left border of traffic light spot bounding box - additional information over ISO 23150:2022(E)";
CM_ SG_ 227 VFC_TL05_2DTopEdge "Angle of view of the top border of traffic light spot bounding box - additional information over ISO 23150:2022(E)";
CM_ SG_ 227 VFC_TL05_Px "Longitudinal position of traffic light - defined in ISO 23150:2022(E) A.2.15";
CM_ SG_ 227 VFC_TL06_Colour "Colour of the traffic light spot - defined in ISO 23150:2022(E) A.2.209";
CM_ SG_ 227 VFC_TL06_LightShapeType "Type of traffic light, which indicates the direction of the traffic light (e.g. left/right turn) �- defined in ISO 23150:2022(E) A.2.205";
CM_ SG_ 227 VFC_TL06_LightModeType "Behavior mode of the traffic light spot �- defined in ISO 23150:2022(E) A.2.212";
CM_ SG_ 227 VFC_TL06_Py "Lateral position of traffic light �- defined in ISO 23150:2022(E) A.2.15";
CM_ SG_ 227 VFC_TL06_ExistProb "Existence probability - defined in ISO 23150:2022(E): Existence probability - object level (A.2.1)";
CM_ SG_ 227 VFC_TL06_Pz "Vertical position of traffic light �- defined in ISO 23150:2022(E) A.2.15";
CM_ SG_ 227 VFC_TL06_2DWidth "Width of traffic light in angle of view - additional information over ISO 23150:2022(E)";
CM_ SG_ 227 VFC_TL06_2DHeight "Height of traffic light in angle of view - additional information over ISO 23150:2022(E)";
CM_ SG_ 227 VFC_TL06_2DLeftEdge "Angle of view of the left border of traffic light spot bounding box - additional information over ISO 23150:2022(E)";
CM_ SG_ 227 VFC_TL06_2DTopEdge "Angle of view of the top border of traffic light spot bounding box - additional information over ISO 23150:2022(E)";
CM_ SG_ 227 VFC_TL06_Px "Longitudinal position of traffic light - defined in ISO 23150:2022(E) A.2.15";
CM_ SG_ 227 VFC_TL07_Colour "Colour of the traffic light spot - defined in ISO 23150:2022(E) A.2.209";
CM_ SG_ 227 VFC_TL07_LightShapeType "Type of traffic light, which indicates the direction of the traffic light (e.g. left/right turn) �- defined in ISO 23150:2022(E) A.2.205";
CM_ SG_ 227 VFC_TL07_LightModeType "Behavior mode of the traffic light spot �- defined in ISO 23150:2022(E) A.2.212";
CM_ SG_ 227 VFC_TL07_Py "Lateral position of traffic light �- defined in ISO 23150:2022(E) A.2.15";
CM_ SG_ 227 VFC_TL07_ExistProb "Existence probability - defined in ISO 23150:2022(E): Existence probability - object level (A.2.1)";
CM_ SG_ 227 VFC_TL07_Pz "Vertical position of traffic light �- defined in ISO 23150:2022(E) A.2.15";
CM_ SG_ 227 VFC_TL07_2DWidth "Width of traffic light in angle of view - additional information over ISO 23150:2022(E)";
CM_ SG_ 227 VFC_TL07_2DHeight "Height of traffic light in angle of view - additional information over ISO 23150:2022(E)";
CM_ SG_ 227 VFC_TL07_2DLeftEdge "Angle of view of the left border of traffic light spot bounding box - additional information over ISO 23150:2022(E)";
CM_ SG_ 227 VFC_TL07_2DTopEdge "Angle of view of the top border of traffic light spot bounding box - additional information over ISO 23150:2022(E)";
CM_ SG_ 227 VFC_TL07_Px "Longitudinal position of traffic light - defined in ISO 23150:2022(E) A.2.15";
CM_ SG_ 227 VFC_TL08_Colour "Colour of the traffic light spot - defined in ISO 23150:2022(E) A.2.209";
CM_ SG_ 227 VFC_TL08_LightShapeType "Type of traffic light, which indicates the direction of the traffic light (e.g. left/right turn) �- defined in ISO 23150:2022(E) A.2.205";
CM_ SG_ 227 VFC_TL08_LightModeType "Behavior mode of the traffic light spot �- defined in ISO 23150:2022(E) A.2.212";
CM_ SG_ 227 VFC_TL08_Py "Lateral position of traffic light �- defined in ISO 23150:2022(E) A.2.15";
CM_ SG_ 227 VFC_TL08_ExistProb "Existence probability - defined in ISO 23150:2022(E): Existence probability - object level (A.2.1)";
CM_ SG_ 227 VFC_TL08_Pz "Vertical position of traffic light �- defined in ISO 23150:2022(E) A.2.15";
CM_ SG_ 227 VFC_TL08_2DWidth "Width of traffic light in angle of view - additional information over ISO 23150:2022(E)";
CM_ SG_ 227 VFC_TL08_2DHeight "Height of traffic light in angle of view - additional information over ISO 23150:2022(E)";
CM_ SG_ 227 VFC_TL08_2DLeftEdge "Angle of view of the left border of traffic light spot bounding box - additional information over ISO 23150:2022(E)";
CM_ SG_ 227 VFC_TL08_2DTopEdge "Angle of view of the top border of traffic light spot bounding box - additional information over ISO 23150:2022(E)";
CM_ SG_ 227 VFC_TL08_Px "Longitudinal position of traffic light - defined in ISO 23150:2022(E) A.2.15";
CM_ SG_ 227 VFC_TL09_Colour "Colour of the traffic light spot - defined in ISO 23150:2022(E) A.2.209";
CM_ SG_ 227 VFC_TL09_LightShapeType "Type of traffic light, which indicates the direction of the traffic light (e.g. left/right turn) �- defined in ISO 23150:2022(E) A.2.205";
CM_ SG_ 227 VFC_TL09_LightModeType "Behavior mode of the traffic light spot �- defined in ISO 23150:2022(E) A.2.212";
CM_ SG_ 227 VFC_TL09_Py "Lateral position of traffic light �- defined in ISO 23150:2022(E) A.2.15";
CM_ SG_ 227 VFC_TL09_ExistProb "Existence probability - defined in ISO 23150:2022(E): Existence probability - object level (A.2.1)";
CM_ SG_ 227 VFC_TL09_Pz "Vertical position of traffic light �- defined in ISO 23150:2022(E) A.2.15";
CM_ SG_ 227 VFC_TL09_2DWidth "Width of traffic light in angle of view - additional information over ISO 23150:2022(E)";
CM_ SG_ 227 VFC_TL09_2DHeight "Height of traffic light in angle of view - additional information over ISO 23150:2022(E)";
CM_ SG_ 227 VFC_TL09_2DLeftEdge "Angle of view of the left border of traffic light spot bounding box - additional information over ISO 23150:2022(E)";
CM_ SG_ 227 VFC_TL09_2DTopEdge "Angle of view of the top border of traffic light spot bounding box - additional information over ISO 23150:2022(E)";
CM_ SG_ 227 VFC_TL09_Px "Longitudinal position of traffic light - defined in ISO 23150:2022(E) A.2.15";
CM_ SG_ 236 VFC_TSHdr_CRC "CRC - Autosar E2E Profile 5";
CM_ SG_ 236 VFC_TSHdr_AliveCtr "Alive counter - Autosar E2E Profile 5";
CM_ SG_ 236 VFC_TSHdr_ProtBlockCtr "Protocol-Signal: Block-Counter";
CM_ SG_ 236 VFC_TSHdr_ProtTrafficSignCount "Protocol-Signal: count of all traffic signs";
CM_ SG_ 236 VFC_TSHdr_State "Informs the system of the current state of the traffic sign detection system";
CM_ SG_ 236 VFC_TSHdr_Brightness "The ambient light conditions detected by the camera";
CM_ SG_ 236 VFC_TSHdr_Country "The current country that the vision system is using as ISO 3166 Code";
CM_ SG_ 236 VFC_TSHdr_TimeStampStatus "Autosar StbM_TimeBaseStatusType bitfield with extension:
Bit 0: TIMEOUT
Bit 1: Reserved1
Bit 2: SYNC_TO_GATEWAY
Bit 3: GLOBAL_TIME_BASE
Bit 4: TIMELEAP_FUTURE
Bit 5: TIMELEAP_PAST
Bit 6: Reserved6
Bit 7: Extension: GENERAL_ERROR";
CM_ SG_ 236 VFC_TSHdr_TimeStamp "TimeStamp of Traffic Signs";
CM_ SG_ 236 VFC_TSHdr_CountryMode "Tells the system the current country mode that the system is operating in";
BA_DEF_ SG_  "GenSigSendType" ENUM  "Cyclic","OnWrite","OnWriteWithRepetition","OnChange","OnChangeWithRepetition","IfActive","IfActiveWithRepetition";
BA_DEF_ BO_  "GenMsgCycleTimeFast" INT 2 50000;
BA_DEF_ BO_  "GenMsgILSupport" ENUM  "No","Yes";
BA_DEF_ BO_  "CANFD_BRS" ENUM  "0","1";
BA_DEF_ BO_  "GenMsgCycleTime" INT 0 65535;
BA_DEF_ BO_  "GenMsgSendType" ENUM  "Event","cyclic";
BA_DEF_ BO_  "VFrameFormat" ENUM  "StandardCAN","ExtendedCAN","reserved","reserved","reserved","reserved","reserved","reserved","reserved","reserved","reserved","reserved","reserved","reserved","StandardCAN_FD","ExtendedCAN_FD";
BA_DEF_ SG_  "GenSigStartValue" FLOAT 0 100000000000;
BA_DEF_DEF_  "GenSigSendType" "Cyclic";
BA_DEF_DEF_  "GenMsgCycleTimeFast" 100;
BA_DEF_DEF_  "GenMsgILSupport" "Yes";
BA_DEF_DEF_  "CANFD_BRS" "1";
BA_DEF_DEF_  "GenMsgCycleTime" 0;
BA_DEF_DEF_  "GenMsgSendType" "";
BA_DEF_DEF_  "VFrameFormat" "";
BA_DEF_DEF_  "GenSigStartValue" 0;
BA_ "GenMsgSendType" BO_ 133 0;
BA_ "VFrameFormat" BO_ 133 14;
BA_ "GenMsgSendType" BO_ 146 0;
BA_ "VFrameFormat" BO_ 146 14;
BA_ "GenMsgSendType" BO_ 147 0;
BA_ "VFrameFormat" BO_ 147 14;
BA_ "GenMsgSendType" BO_ 148 0;
BA_ "VFrameFormat" BO_ 148 14;
BA_ "GenMsgSendType" BO_ 149 0;
BA_ "VFrameFormat" BO_ 149 14;
BA_ "GenMsgSendType" BO_ 162 0;
BA_ "VFrameFormat" BO_ 162 14;
BA_ "GenMsgSendType" BO_ 163 0;
BA_ "VFrameFormat" BO_ 163 14;
BA_ "GenMsgSendType" BO_ 164 0;
BA_ "VFrameFormat" BO_ 164 14;
BA_ "GenMsgSendType" BO_ 165 0;
BA_ "VFrameFormat" BO_ 165 14;
BA_ "GenMsgSendType" BO_ 178 0;
BA_ "VFrameFormat" BO_ 178 14;
BA_ "GenMsgSendType" BO_ 224 0;
BA_ "VFrameFormat" BO_ 224 14;
BA_ "GenMsgSendType" BO_ 226 0;
BA_ "VFrameFormat" BO_ 226 14;
BA_ "GenMsgSendType" BO_ 227 0;
BA_ "VFrameFormat" BO_ 227 14;
BA_ "GenMsgSendType" BO_ 236 0;
BA_ "VFrameFormat" BO_ 236 14;
BA_ "GenSigStartValue" SG_ 133 VFC_Cloth09_CurvChange 8388607;
BA_ "GenSigStartValue" SG_ 133 VFC_Cloth09_Curv 2048;
BA_ "GenSigStartValue" SG_ 133 VFC_Cloth09_Py 2048;
BA_ "GenSigStartValue" SG_ 133 VFC_Cloth09_OrientationYaw 2048;
BA_ "GenSigStartValue" SG_ 133 VFC_Cloth10_CurvChange 8388607;
BA_ "GenSigStartValue" SG_ 133 VFC_Cloth10_Curv 2048;
BA_ "GenSigStartValue" SG_ 133 VFC_Cloth10_Py 2048;
BA_ "GenSigStartValue" SG_ 133 VFC_Cloth10_OrientationYaw 2048;
BA_ "GenSigStartValue" SG_ 133 VFC_Cloth11_CurvChange 8388607;
BA_ "GenSigStartValue" SG_ 133 VFC_Cloth11_Curv 2048;
BA_ "GenSigStartValue" SG_ 133 VFC_Cloth11_Py 2048;
BA_ "GenSigStartValue" SG_ 133 VFC_Cloth11_OrientationYaw 2048;
BA_ "GenSigStartValue" SG_ 146 VFC_Poly00_CoefficientYc3 131072;
BA_ "GenSigStartValue" SG_ 146 VFC_Poly00_CoefficientYc2 65536;
BA_ "GenSigStartValue" SG_ 146 VFC_Poly00_CoefficientYc0 2048;
BA_ "GenSigStartValue" SG_ 146 VFC_Poly00_CoefficientYc1 16384;
BA_ "GenSigStartValue" SG_ 146 VFC_Poly00_CoefficientYc2Corr 65536;
BA_ "GenSigStartValue" SG_ 146 VFC_Poly00_CoefficientYc3Corr 131072;
BA_ "GenSigStartValue" SG_ 146 VFC_Poly01_CoefficientYc3 131072;
BA_ "GenSigStartValue" SG_ 146 VFC_Poly01_CoefficientYc2 65536;
BA_ "GenSigStartValue" SG_ 146 VFC_Poly01_CoefficientYc0 2048;
BA_ "GenSigStartValue" SG_ 146 VFC_Poly01_CoefficientYc1 16384;
BA_ "GenSigStartValue" SG_ 146 VFC_Poly01_CoefficientYc2Corr 65536;
BA_ "GenSigStartValue" SG_ 146 VFC_Poly01_CoefficientYc3Corr 131072;
BA_ "GenSigStartValue" SG_ 146 VFC_Poly02_CoefficientYc3 131072;
BA_ "GenSigStartValue" SG_ 146 VFC_Poly02_CoefficientYc2 65536;
BA_ "GenSigStartValue" SG_ 146 VFC_Poly02_CoefficientYc0 2048;
BA_ "GenSigStartValue" SG_ 146 VFC_Poly02_CoefficientYc1 16384;
BA_ "GenSigStartValue" SG_ 146 VFC_Poly02_CoefficientYc2Corr 65536;
BA_ "GenSigStartValue" SG_ 146 VFC_Poly02_CoefficientYc3Corr 131072;
BA_ "GenSigStartValue" SG_ 147 VFC_Poly03_CoefficientYc3 131072;
BA_ "GenSigStartValue" SG_ 147 VFC_Poly03_CoefficientYc2 65536;
BA_ "GenSigStartValue" SG_ 147 VFC_Poly03_CoefficientYc0 2048;
BA_ "GenSigStartValue" SG_ 147 VFC_Poly03_CoefficientYc1 16384;
BA_ "GenSigStartValue" SG_ 147 VFC_Poly03_CoefficientYc2Corr 65536;
BA_ "GenSigStartValue" SG_ 147 VFC_Poly03_CoefficientYc3Corr 131072;
BA_ "GenSigStartValue" SG_ 147 VFC_Poly04_CoefficientYc3 131072;
BA_ "GenSigStartValue" SG_ 147 VFC_Poly04_CoefficientYc2 65536;
BA_ "GenSigStartValue" SG_ 147 VFC_Poly04_CoefficientYc0 2048;
BA_ "GenSigStartValue" SG_ 147 VFC_Poly04_CoefficientYc1 16384;
BA_ "GenSigStartValue" SG_ 147 VFC_Poly04_CoefficientYc2Corr 65536;
BA_ "GenSigStartValue" SG_ 147 VFC_Poly04_CoefficientYc3Corr 131072;
BA_ "GenSigStartValue" SG_ 147 VFC_Poly05_CoefficientYc3 131072;
BA_ "GenSigStartValue" SG_ 147 VFC_Poly05_CoefficientYc2 65536;
BA_ "GenSigStartValue" SG_ 147 VFC_Poly05_CoefficientYc0 2048;
BA_ "GenSigStartValue" SG_ 147 VFC_Poly05_CoefficientYc1 16384;
BA_ "GenSigStartValue" SG_ 147 VFC_Poly05_CoefficientYc2Corr 65536;
BA_ "GenSigStartValue" SG_ 147 VFC_Poly05_CoefficientYc3Corr 131072;
BA_ "GenSigStartValue" SG_ 148 VFC_Poly06_CoefficientYc3 131072;
BA_ "GenSigStartValue" SG_ 148 VFC_Poly06_CoefficientYc2 65536;
BA_ "GenSigStartValue" SG_ 148 VFC_Poly06_CoefficientYc0 2048;
BA_ "GenSigStartValue" SG_ 148 VFC_Poly06_CoefficientYc1 16384;
BA_ "GenSigStartValue" SG_ 148 VFC_Poly06_CoefficientYc2Corr 65536;
BA_ "GenSigStartValue" SG_ 148 VFC_Poly06_CoefficientYc3Corr 131072;
BA_ "GenSigStartValue" SG_ 148 VFC_Poly07_CoefficientYc3 131072;
BA_ "GenSigStartValue" SG_ 148 VFC_Poly07_CoefficientYc2 65536;
BA_ "GenSigStartValue" SG_ 148 VFC_Poly07_CoefficientYc0 2048;
BA_ "GenSigStartValue" SG_ 148 VFC_Poly07_CoefficientYc1 16384;
BA_ "GenSigStartValue" SG_ 148 VFC_Poly07_CoefficientYc2Corr 65536;
BA_ "GenSigStartValue" SG_ 148 VFC_Poly07_CoefficientYc3Corr 131072;
BA_ "GenSigStartValue" SG_ 148 VFC_Poly08_CoefficientYc3 131072;
BA_ "GenSigStartValue" SG_ 148 VFC_Poly08_CoefficientYc2 65536;
BA_ "GenSigStartValue" SG_ 148 VFC_Poly08_CoefficientYc0 2048;
BA_ "GenSigStartValue" SG_ 148 VFC_Poly08_CoefficientYc1 16384;
BA_ "GenSigStartValue" SG_ 148 VFC_Poly08_CoefficientYc2Corr 65536;
BA_ "GenSigStartValue" SG_ 148 VFC_Poly08_CoefficientYc3Corr 131072;
BA_ "GenSigStartValue" SG_ 149 VFC_Poly09_CoefficientYc3 131072;
BA_ "GenSigStartValue" SG_ 149 VFC_Poly09_CoefficientYc2 65536;
BA_ "GenSigStartValue" SG_ 149 VFC_Poly09_CoefficientYc0 2048;
BA_ "GenSigStartValue" SG_ 149 VFC_Poly09_CoefficientYc1 16384;
BA_ "GenSigStartValue" SG_ 149 VFC_Poly09_CoefficientYc2Corr 65536;
BA_ "GenSigStartValue" SG_ 149 VFC_Poly09_CoefficientYc3Corr 131072;
BA_ "GenSigStartValue" SG_ 149 VFC_Poly10_CoefficientYc3 131072;
BA_ "GenSigStartValue" SG_ 149 VFC_Poly10_CoefficientYc2 65536;
BA_ "GenSigStartValue" SG_ 149 VFC_Poly10_CoefficientYc0 2048;
BA_ "GenSigStartValue" SG_ 149 VFC_Poly10_CoefficientYc1 16384;
BA_ "GenSigStartValue" SG_ 149 VFC_Poly10_CoefficientYc2Corr 65536;
BA_ "GenSigStartValue" SG_ 149 VFC_Poly10_CoefficientYc3Corr 131072;
BA_ "GenSigStartValue" SG_ 149 VFC_Poly11_CoefficientYc3 131072;
BA_ "GenSigStartValue" SG_ 149 VFC_Poly11_CoefficientYc2 65536;
BA_ "GenSigStartValue" SG_ 149 VFC_Poly11_CoefficientYc0 2048;
BA_ "GenSigStartValue" SG_ 149 VFC_Poly11_CoefficientYc1 16384;
BA_ "GenSigStartValue" SG_ 149 VFC_Poly11_CoefficientYc2Corr 65536;
BA_ "GenSigStartValue" SG_ 149 VFC_Poly11_CoefficientYc3Corr 131072;
BA_ "GenSigStartValue" SG_ 162 VFC_2DPoly00_CoefficientUc0 32768;
BA_ "GenSigStartValue" SG_ 162 VFC_2DPoly00_CoefficientUc1 32768;
BA_ "GenSigStartValue" SG_ 162 VFC_2DPoly00_CoefficientUc2 32768;
BA_ "GenSigStartValue" SG_ 162 VFC_2DPoly00_CoefficientUc3 32768;
BA_ "GenSigStartValue" SG_ 162 VFC_2DPoly00_CoefficientUc4 32768;
BA_ "GenSigStartValue" SG_ 162 VFC_2DPoly00_CoefficientUc5 32768;
BA_ "GenSigStartValue" SG_ 162 VFC_2DPoly01_CoefficientUc0 32768;
BA_ "GenSigStartValue" SG_ 162 VFC_2DPoly01_CoefficientUc1 32768;
BA_ "GenSigStartValue" SG_ 162 VFC_2DPoly01_CoefficientUc2 32768;
BA_ "GenSigStartValue" SG_ 162 VFC_2DPoly01_CoefficientUc3 32768;
BA_ "GenSigStartValue" SG_ 162 VFC_2DPoly01_CoefficientUc4 32768;
BA_ "GenSigStartValue" SG_ 162 VFC_2DPoly01_CoefficientUc5 32768;
BA_ "GenSigStartValue" SG_ 162 VFC_2DPoly02_CoefficientUc0 32768;
BA_ "GenSigStartValue" SG_ 162 VFC_2DPoly02_CoefficientUc1 32768;
BA_ "GenSigStartValue" SG_ 162 VFC_2DPoly02_CoefficientUc2 32768;
BA_ "GenSigStartValue" SG_ 162 VFC_2DPoly02_CoefficientUc3 32768;
BA_ "GenSigStartValue" SG_ 162 VFC_2DPoly02_CoefficientUc4 32768;
BA_ "GenSigStartValue" SG_ 162 VFC_2DPoly02_CoefficientUc5 32768;
BA_ "GenSigStartValue" SG_ 163 VFC_2DPoly03_CoefficientUc0 32768;
BA_ "GenSigStartValue" SG_ 163 VFC_2DPoly03_CoefficientUc1 32768;
BA_ "GenSigStartValue" SG_ 163 VFC_2DPoly03_CoefficientUc2 32768;
BA_ "GenSigStartValue" SG_ 163 VFC_2DPoly03_CoefficientUc3 32768;
BA_ "GenSigStartValue" SG_ 163 VFC_2DPoly03_CoefficientUc4 32768;
BA_ "GenSigStartValue" SG_ 163 VFC_2DPoly03_CoefficientUc5 32768;
BA_ "GenSigStartValue" SG_ 163 VFC_2DPoly04_CoefficientUc0 32768;
BA_ "GenSigStartValue" SG_ 163 VFC_2DPoly04_CoefficientUc1 32768;
BA_ "GenSigStartValue" SG_ 163 VFC_2DPoly04_CoefficientUc2 32768;
BA_ "GenSigStartValue" SG_ 163 VFC_2DPoly04_CoefficientUc3 32768;
BA_ "GenSigStartValue" SG_ 163 VFC_2DPoly04_CoefficientUc4 32768;
BA_ "GenSigStartValue" SG_ 163 VFC_2DPoly04_CoefficientUc5 32768;
BA_ "GenSigStartValue" SG_ 163 VFC_2DPoly05_CoefficientUc0 32768;
BA_ "GenSigStartValue" SG_ 163 VFC_2DPoly05_CoefficientUc1 32768;
BA_ "GenSigStartValue" SG_ 163 VFC_2DPoly05_CoefficientUc2 32768;
BA_ "GenSigStartValue" SG_ 163 VFC_2DPoly05_CoefficientUc3 32768;
BA_ "GenSigStartValue" SG_ 163 VFC_2DPoly05_CoefficientUc4 32768;
BA_ "GenSigStartValue" SG_ 163 VFC_2DPoly05_CoefficientUc5 32768;
BA_ "GenSigStartValue" SG_ 164 VFC_2DPoly06_CoefficientUc0 32768;
BA_ "GenSigStartValue" SG_ 164 VFC_2DPoly06_CoefficientUc1 32768;
BA_ "GenSigStartValue" SG_ 164 VFC_2DPoly06_CoefficientUc2 32768;
BA_ "GenSigStartValue" SG_ 164 VFC_2DPoly06_CoefficientUc3 32768;
BA_ "GenSigStartValue" SG_ 164 VFC_2DPoly06_CoefficientUc4 32768;
BA_ "GenSigStartValue" SG_ 164 VFC_2DPoly06_CoefficientUc5 32768;
BA_ "GenSigStartValue" SG_ 164 VFC_2DPoly07_CoefficientUc0 32768;
BA_ "GenSigStartValue" SG_ 164 VFC_2DPoly07_CoefficientUc1 32768;
BA_ "GenSigStartValue" SG_ 164 VFC_2DPoly07_CoefficientUc2 32768;
BA_ "GenSigStartValue" SG_ 164 VFC_2DPoly07_CoefficientUc3 32768;
BA_ "GenSigStartValue" SG_ 164 VFC_2DPoly07_CoefficientUc4 32768;
BA_ "GenSigStartValue" SG_ 164 VFC_2DPoly07_CoefficientUc5 32768;
BA_ "GenSigStartValue" SG_ 164 VFC_2DPoly08_CoefficientUc0 32768;
BA_ "GenSigStartValue" SG_ 164 VFC_2DPoly08_CoefficientUc1 32768;
BA_ "GenSigStartValue" SG_ 164 VFC_2DPoly08_CoefficientUc2 32768;
BA_ "GenSigStartValue" SG_ 164 VFC_2DPoly08_CoefficientUc3 32768;
BA_ "GenSigStartValue" SG_ 164 VFC_2DPoly08_CoefficientUc4 32768;
BA_ "GenSigStartValue" SG_ 164 VFC_2DPoly08_CoefficientUc5 32768;
BA_ "GenSigStartValue" SG_ 165 VFC_2DPoly09_CoefficientUc0 32768;
BA_ "GenSigStartValue" SG_ 165 VFC_2DPoly09_CoefficientUc1 32768;
BA_ "GenSigStartValue" SG_ 165 VFC_2DPoly09_CoefficientUc2 32768;
BA_ "GenSigStartValue" SG_ 165 VFC_2DPoly09_CoefficientUc3 32768;
BA_ "GenSigStartValue" SG_ 165 VFC_2DPoly09_CoefficientUc4 32768;
BA_ "GenSigStartValue" SG_ 165 VFC_2DPoly09_CoefficientUc5 32768;
BA_ "GenSigStartValue" SG_ 165 VFC_2DPoly10_CoefficientUc0 32768;
BA_ "GenSigStartValue" SG_ 165 VFC_2DPoly10_CoefficientUc1 32768;
BA_ "GenSigStartValue" SG_ 165 VFC_2DPoly10_CoefficientUc2 32768;
BA_ "GenSigStartValue" SG_ 165 VFC_2DPoly10_CoefficientUc3 32768;
BA_ "GenSigStartValue" SG_ 165 VFC_2DPoly10_CoefficientUc4 32768;
BA_ "GenSigStartValue" SG_ 165 VFC_2DPoly10_CoefficientUc5 32768;
BA_ "GenSigStartValue" SG_ 165 VFC_2DPoly11_CoefficientUc0 32768;
BA_ "GenSigStartValue" SG_ 165 VFC_2DPoly11_CoefficientUc1 32768;
BA_ "GenSigStartValue" SG_ 165 VFC_2DPoly11_CoefficientUc2 32768;
BA_ "GenSigStartValue" SG_ 165 VFC_2DPoly11_CoefficientUc3 32768;
BA_ "GenSigStartValue" SG_ 165 VFC_2DPoly11_CoefficientUc4 32768;
BA_ "GenSigStartValue" SG_ 165 VFC_2DPoly11_CoefficientUc5 32768;
BA_ "GenSigStartValue" SG_ 178 VFC_RM00_VertexPoint00y 256;
BA_ "GenSigStartValue" SG_ 178 VFC_RM00_VertexPoint01y 256;
BA_ "GenSigStartValue" SG_ 178 VFC_RM01_VertexPoint00y 256;
BA_ "GenSigStartValue" SG_ 178 VFC_RM01_VertexPoint01y 256;
BA_ "GenSigStartValue" SG_ 178 VFC_RM02_VertexPoint00y 256;
BA_ "GenSigStartValue" SG_ 178 VFC_RM02_VertexPoint01y 256;
BA_ "GenSigStartValue" SG_ 178 VFC_RM03_VertexPoint00y 256;
BA_ "GenSigStartValue" SG_ 178 VFC_RM03_VertexPoint01y 256;
BA_ "GenSigStartValue" SG_ 178 VFC_RM04_VertexPoint00y 256;
BA_ "GenSigStartValue" SG_ 178 VFC_RM04_VertexPoint01y 256;
BA_ "GenSigStartValue" SG_ 178 VFC_RM05_VertexPoint00y 256;
BA_ "GenSigStartValue" SG_ 178 VFC_RM05_VertexPoint01y 256;
BA_ "GenSigStartValue" SG_ 178 VFC_RM06_VertexPoint00y 256;
BA_ "GenSigStartValue" SG_ 178 VFC_RM06_VertexPoint01y 256;
BA_ "GenSigStartValue" SG_ 226 VFC_TL00_Py 512;
BA_ "GenSigStartValue" SG_ 226 VFC_TL00_2DLeftEdge 2048;
BA_ "GenSigStartValue" SG_ 226 VFC_TL00_2DTopEdge 1024;
BA_ "GenSigStartValue" SG_ 226 VFC_TL01_Py 512;
BA_ "GenSigStartValue" SG_ 226 VFC_TL01_2DLeftEdge 2048;
BA_ "GenSigStartValue" SG_ 226 VFC_TL01_2DTopEdge 1024;
BA_ "GenSigStartValue" SG_ 226 VFC_TL02_Py 512;
BA_ "GenSigStartValue" SG_ 226 VFC_TL02_2DLeftEdge 2048;
BA_ "GenSigStartValue" SG_ 226 VFC_TL02_2DTopEdge 1024;
BA_ "GenSigStartValue" SG_ 226 VFC_TL03_Py 512;
BA_ "GenSigStartValue" SG_ 226 VFC_TL03_2DLeftEdge 2048;
BA_ "GenSigStartValue" SG_ 226 VFC_TL03_2DTopEdge 1024;
BA_ "GenSigStartValue" SG_ 226 VFC_TL04_Py 512;
BA_ "GenSigStartValue" SG_ 226 VFC_TL04_2DLeftEdge 2048;
BA_ "GenSigStartValue" SG_ 226 VFC_TL04_2DTopEdge 1024;
BA_ "GenSigStartValue" SG_ 227 VFC_TL05_Py 512;
BA_ "GenSigStartValue" SG_ 227 VFC_TL05_2DLeftEdge 2048;
BA_ "GenSigStartValue" SG_ 227 VFC_TL05_2DTopEdge 1024;
BA_ "GenSigStartValue" SG_ 227 VFC_TL06_Py 512;
BA_ "GenSigStartValue" SG_ 227 VFC_TL06_2DLeftEdge 2048;
BA_ "GenSigStartValue" SG_ 227 VFC_TL06_2DTopEdge 1024;
BA_ "GenSigStartValue" SG_ 227 VFC_TL07_Py 512;
BA_ "GenSigStartValue" SG_ 227 VFC_TL07_2DLeftEdge 2048;
BA_ "GenSigStartValue" SG_ 227 VFC_TL07_2DTopEdge 1024;
BA_ "GenSigStartValue" SG_ 227 VFC_TL08_Py 512;
BA_ "GenSigStartValue" SG_ 227 VFC_TL08_2DLeftEdge 2048;
BA_ "GenSigStartValue" SG_ 227 VFC_TL08_2DTopEdge 1024;
BA_ "GenSigStartValue" SG_ 227 VFC_TL09_Py 512;
BA_ "GenSigStartValue" SG_ 227 VFC_TL09_2DLeftEdge 2048;
BA_ "GenSigStartValue" SG_ 227 VFC_TL09_2DTopEdge 1024;
VAL_ 133 VFC_Cloth09_LaneAssociation 0 "LEFT_EGO_LINE" 1 "RIGHT_EGO_LINE" 2 "LEFT_LEFT_LINE" 3 "RIGHT_RIGHT_LINE" 4 "ROAD_EDGE_LEFT" 5 "ROAD_EDGE_RIGHT" 6 "RAISED_LEFT" 7 "RAISED_RIGHT" 8 "NOT_SELECTED_CANDIDATE" 9 "EGO_TRACK_LEFT" 10 "EGO_TRACK_RIGHT" 11 "Reserved11" 12 "Reserved12" 13 "Reserved13" 14 "Reserved14" 15 "Reserved15" ;
VAL_ 133 VFC_Cloth09_Colour 0 "COLOR_WHITE" 1 "COLOR_YELLOW" 2 "COLOR_RED" 3 "COLOR_BLUE" 4 "COLOR_GREEN" 5 "RESERVED5" 6 "RESERVED6" 7 "COLOR_UNKNOWN" ;
VAL_ 133 VFC_Cloth09_Type 0 "TYPE_SOLID_LINE" 1 "TYPE_DASHED_LINE" 2 "TYPE_DOUBLE_DASHED_DASHED" 3 "TYPE_DOUBLE_DASHED_SOLID" 4 "TYPE_DOUBLE_SOLID_DASHED" 5 "TYPE_DOUBLE_SOLID_SOLID" 6 "TYPE_MULTIPLE" 7 "TYPE_MULTIPLE_WARNING" 8 "TYPE_BOTTS_DOTS" 9 "TYPE_ROAD_EDGE" 10 "TYPE_ROAD_FURNITURE" 11 "TYPE_CURBSTONE" 12 "TYPE_TRAFFIC_STATIC" 13 "TYPE_UNKNOWN_RAISED" 14 "TYPE_UNKNOWN" 15 "Reserved15" ;
VAL_ 133 VFC_Cloth10_LaneAssociation 0 "LEFT_EGO_LINE" 1 "RIGHT_EGO_LINE" 2 "LEFT_LEFT_LINE" 3 "RIGHT_RIGHT_LINE" 4 "ROAD_EDGE_LEFT" 5 "ROAD_EDGE_RIGHT" 6 "RAISED_LEFT" 7 "RAISED_RIGHT" 8 "NOT_SELECTED_CANDIDATE" 9 "EGO_TRACK_LEFT" 10 "EGO_TRACK_RIGHT" 11 "Reserved11" 12 "Reserved12" 13 "Reserved13" 14 "Reserved14" 15 "Reserved15" ;
VAL_ 133 VFC_Cloth10_Colour 0 "COLOR_WHITE" 1 "COLOR_YELLOW" 2 "COLOR_RED" 3 "COLOR_BLUE" 4 "COLOR_GREEN" 5 "RESERVED5" 6 "RESERVED6" 7 "COLOR_UNKNOWN" ;
VAL_ 133 VFC_Cloth10_Type 0 "TYPE_SOLID_LINE" 1 "TYPE_DASHED_LINE" 2 "TYPE_DOUBLE_DASHED_DASHED" 3 "TYPE_DOUBLE_DASHED_SOLID" 4 "TYPE_DOUBLE_SOLID_DASHED" 5 "TYPE_DOUBLE_SOLID_SOLID" 6 "TYPE_MULTIPLE" 7 "TYPE_MULTIPLE_WARNING" 8 "TYPE_BOTTS_DOTS" 9 "TYPE_ROAD_EDGE" 10 "TYPE_ROAD_FURNITURE" 11 "TYPE_CURBSTONE" 12 "TYPE_TRAFFIC_STATIC" 13 "TYPE_UNKNOWN_RAISED" 14 "TYPE_UNKNOWN" 15 "Reserved15" ;
VAL_ 133 VFC_Cloth11_LaneAssociation 0 "LEFT_EGO_LINE" 1 "RIGHT_EGO_LINE" 2 "LEFT_LEFT_LINE" 3 "RIGHT_RIGHT_LINE" 4 "ROAD_EDGE_LEFT" 5 "ROAD_EDGE_RIGHT" 6 "RAISED_LEFT" 7 "RAISED_RIGHT" 8 "NOT_SELECTED_CANDIDATE" 9 "EGO_TRACK_LEFT" 10 "EGO_TRACK_RIGHT" 11 "Reserved11" 12 "Reserved12" 13 "Reserved13" 14 "Reserved14" 15 "Reserved15" ;
VAL_ 133 VFC_Cloth11_Colour 0 "COLOR_WHITE" 1 "COLOR_YELLOW" 2 "COLOR_RED" 3 "COLOR_BLUE" 4 "COLOR_GREEN" 5 "RESERVED5" 6 "RESERVED6" 7 "COLOR_UNKNOWN" ;
VAL_ 133 VFC_Cloth11_Type 0 "TYPE_SOLID_LINE" 1 "TYPE_DASHED_LINE" 2 "TYPE_DOUBLE_DASHED_DASHED" 3 "TYPE_DOUBLE_DASHED_SOLID" 4 "TYPE_DOUBLE_SOLID_DASHED" 5 "TYPE_DOUBLE_SOLID_SOLID" 6 "TYPE_MULTIPLE" 7 "TYPE_MULTIPLE_WARNING" 8 "TYPE_BOTTS_DOTS" 9 "TYPE_ROAD_EDGE" 10 "TYPE_ROAD_FURNITURE" 11 "TYPE_CURBSTONE" 12 "TYPE_TRAFFIC_STATIC" 13 "TYPE_UNKNOWN_RAISED" 14 "TYPE_UNKNOWN" 15 "Reserved15" ;
VAL_ 146 VFC_Poly00_LaneAssociation 0 "LEFT_EGO_LINE" 1 "RIGHT_EGO_LINE" 2 "LEFT_LEFT_LINE" 3 "RIGHT_RIGHT_LINE" 4 "ROAD_EDGE_LEFT" 5 "ROAD_EDGE_RIGHT" 6 "RAISED_LEFT" 7 "RAISED_RIGHT" 8 "NOT_SELECTED_CANDIDATE" 9 "EGO_TRACK_LEFT" 10 "EGO_TRACK_RIGHT" 11 "Reserved11" 12 "Reserved12" 13 "Reserved13" 14 "Reserved14" 15 "Reserved15" ;
VAL_ 146 VFC_Poly00_Type 0 "TYPE_SOLID_LINE" 1 "TYPE_DASHED_LINE" 2 "TYPE_DOUBLE_DASHED_DASHED" 3 "TYPE_DOUBLE_DASHED_SOLID" 4 "TYPE_DOUBLE_SOLID_DASHED" 5 "TYPE_DOUBLE_SOLID_SOLID" 6 "TYPE_MULTIPLE" 7 "TYPE_MULTIPLE_WARNING" 8 "TYPE_BOTTS_DOTS" 9 "TYPE_ROAD_EDGE" 10 "TYPE_ROAD_FURNITURE" 11 "TYPE_CURBSTONE" 12 "TYPE_TRAFFIC_STATIC" 13 "TYPE_UNKNOWN_RAISED" 14 "TYPE_UNKNOWN" 15 "Reserved15" ;
VAL_ 146 VFC_Poly00_Colour 0 "COLOR_WHITE" 1 "COLOR_YELLOW" 2 "COLOR_RED" 3 "COLOR_BLUE" 4 "COLOR_GREEN" 5 "RESERVED5" 6 "RESERVED6" 7 "COLOR_UNKNOWN" ;
VAL_ 146 VFC_Poly01_LaneAssociation 0 "LEFT_EGO_LINE" 1 "RIGHT_EGO_LINE" 2 "LEFT_LEFT_LINE" 3 "RIGHT_RIGHT_LINE" 4 "ROAD_EDGE_LEFT" 5 "ROAD_EDGE_RIGHT" 6 "RAISED_LEFT" 7 "RAISED_RIGHT" 8 "NOT_SELECTED_CANDIDATE" 9 "EGO_TRACK_LEFT" 10 "EGO_TRACK_RIGHT" 11 "Reserved11" 12 "Reserved12" 13 "Reserved13" 14 "Reserved14" 15 "Reserved15" ;
VAL_ 146 VFC_Poly01_Type 0 "TYPE_SOLID_LINE" 1 "TYPE_DASHED_LINE" 2 "TYPE_DOUBLE_DASHED_DASHED" 3 "TYPE_DOUBLE_DASHED_SOLID" 4 "TYPE_DOUBLE_SOLID_DASHED" 5 "TYPE_DOUBLE_SOLID_SOLID" 6 "TYPE_MULTIPLE" 7 "TYPE_MULTIPLE_WARNING" 8 "TYPE_BOTTS_DOTS" 9 "TYPE_ROAD_EDGE" 10 "TYPE_ROAD_FURNITURE" 11 "TYPE_CURBSTONE" 12 "TYPE_TRAFFIC_STATIC" 13 "TYPE_UNKNOWN_RAISED" 14 "TYPE_UNKNOWN" 15 "Reserved15" ;
VAL_ 146 VFC_Poly01_Colour 0 "COLOR_WHITE" 1 "COLOR_YELLOW" 2 "COLOR_RED" 3 "COLOR_BLUE" 4 "COLOR_GREEN" 5 "RESERVED5" 6 "RESERVED6" 7 "COLOR_UNKNOWN" ;
VAL_ 146 VFC_Poly02_LaneAssociation 0 "LEFT_EGO_LINE" 1 "RIGHT_EGO_LINE" 2 "LEFT_LEFT_LINE" 3 "RIGHT_RIGHT_LINE" 4 "ROAD_EDGE_LEFT" 5 "ROAD_EDGE_RIGHT" 6 "RAISED_LEFT" 7 "RAISED_RIGHT" 8 "NOT_SELECTED_CANDIDATE" 9 "EGO_TRACK_LEFT" 10 "EGO_TRACK_RIGHT" 11 "Reserved11" 12 "Reserved12" 13 "Reserved13" 14 "Reserved14" 15 "Reserved15" ;
VAL_ 146 VFC_Poly02_Type 0 "TYPE_SOLID_LINE" 1 "TYPE_DASHED_LINE" 2 "TYPE_DOUBLE_DASHED_DASHED" 3 "TYPE_DOUBLE_DASHED_SOLID" 4 "TYPE_DOUBLE_SOLID_DASHED" 5 "TYPE_DOUBLE_SOLID_SOLID" 6 "TYPE_MULTIPLE" 7 "TYPE_MULTIPLE_WARNING" 8 "TYPE_BOTTS_DOTS" 9 "TYPE_ROAD_EDGE" 10 "TYPE_ROAD_FURNITURE" 11 "TYPE_CURBSTONE" 12 "TYPE_TRAFFIC_STATIC" 13 "TYPE_UNKNOWN_RAISED" 14 "TYPE_UNKNOWN" 15 "Reserved15" ;
VAL_ 146 VFC_Poly02_Colour 0 "COLOR_WHITE" 1 "COLOR_YELLOW" 2 "COLOR_RED" 3 "COLOR_BLUE" 4 "COLOR_GREEN" 5 "RESERVED5" 6 "RESERVED6" 7 "COLOR_UNKNOWN" ;
VAL_ 147 VFC_Poly03_LaneAssociation 0 "LEFT_EGO_LINE" 1 "RIGHT_EGO_LINE" 2 "LEFT_LEFT_LINE" 3 "RIGHT_RIGHT_LINE" 4 "ROAD_EDGE_LEFT" 5 "ROAD_EDGE_RIGHT" 6 "RAISED_LEFT" 7 "RAISED_RIGHT" 8 "NOT_SELECTED_CANDIDATE" 9 "EGO_TRACK_LEFT" 10 "EGO_TRACK_RIGHT" 11 "Reserved11" 12 "Reserved12" 13 "Reserved13" 14 "Reserved14" 15 "Reserved15" ;
VAL_ 147 VFC_Poly03_Type 0 "TYPE_SOLID_LINE" 1 "TYPE_DASHED_LINE" 2 "TYPE_DOUBLE_DASHED_DASHED" 3 "TYPE_DOUBLE_DASHED_SOLID" 4 "TYPE_DOUBLE_SOLID_DASHED" 5 "TYPE_DOUBLE_SOLID_SOLID" 6 "TYPE_MULTIPLE" 7 "TYPE_MULTIPLE_WARNING" 8 "TYPE_BOTTS_DOTS" 9 "TYPE_ROAD_EDGE" 10 "TYPE_ROAD_FURNITURE" 11 "TYPE_CURBSTONE" 12 "TYPE_TRAFFIC_STATIC" 13 "TYPE_UNKNOWN_RAISED" 14 "TYPE_UNKNOWN" 15 "Reserved15" ;
VAL_ 147 VFC_Poly03_Colour 0 "COLOR_WHITE" 1 "COLOR_YELLOW" 2 "COLOR_RED" 3 "COLOR_BLUE" 4 "COLOR_GREEN" 5 "RESERVED5" 6 "RESERVED6" 7 "COLOR_UNKNOWN" ;
VAL_ 147 VFC_Poly04_LaneAssociation 0 "LEFT_EGO_LINE" 1 "RIGHT_EGO_LINE" 2 "LEFT_LEFT_LINE" 3 "RIGHT_RIGHT_LINE" 4 "ROAD_EDGE_LEFT" 5 "ROAD_EDGE_RIGHT" 6 "RAISED_LEFT" 7 "RAISED_RIGHT" 8 "NOT_SELECTED_CANDIDATE" 9 "EGO_TRACK_LEFT" 10 "EGO_TRACK_RIGHT" 11 "Reserved11" 12 "Reserved12" 13 "Reserved13" 14 "Reserved14" 15 "Reserved15" ;
VAL_ 147 VFC_Poly04_Type 0 "TYPE_SOLID_LINE" 1 "TYPE_DASHED_LINE" 2 "TYPE_DOUBLE_DASHED_DASHED" 3 "TYPE_DOUBLE_DASHED_SOLID" 4 "TYPE_DOUBLE_SOLID_DASHED" 5 "TYPE_DOUBLE_SOLID_SOLID" 6 "TYPE_MULTIPLE" 7 "TYPE_MULTIPLE_WARNING" 8 "TYPE_BOTTS_DOTS" 9 "TYPE_ROAD_EDGE" 10 "TYPE_ROAD_FURNITURE" 11 "TYPE_CURBSTONE" 12 "TYPE_TRAFFIC_STATIC" 13 "TYPE_UNKNOWN_RAISED" 14 "TYPE_UNKNOWN" 15 "Reserved15" ;
VAL_ 147 VFC_Poly04_Colour 0 "COLOR_WHITE" 1 "COLOR_YELLOW" 2 "COLOR_RED" 3 "COLOR_BLUE" 4 "COLOR_GREEN" 5 "RESERVED5" 6 "RESERVED6" 7 "COLOR_UNKNOWN" ;
VAL_ 147 VFC_Poly05_LaneAssociation 0 "LEFT_EGO_LINE" 1 "RIGHT_EGO_LINE" 2 "LEFT_LEFT_LINE" 3 "RIGHT_RIGHT_LINE" 4 "ROAD_EDGE_LEFT" 5 "ROAD_EDGE_RIGHT" 6 "RAISED_LEFT" 7 "RAISED_RIGHT" 8 "NOT_SELECTED_CANDIDATE" 9 "EGO_TRACK_LEFT" 10 "EGO_TRACK_RIGHT" 11 "Reserved11" 12 "Reserved12" 13 "Reserved13" 14 "Reserved14" 15 "Reserved15" ;
VAL_ 147 VFC_Poly05_Type 0 "TYPE_SOLID_LINE" 1 "TYPE_DASHED_LINE" 2 "TYPE_DOUBLE_DASHED_DASHED" 3 "TYPE_DOUBLE_DASHED_SOLID" 4 "TYPE_DOUBLE_SOLID_DASHED" 5 "TYPE_DOUBLE_SOLID_SOLID" 6 "TYPE_MULTIPLE" 7 "TYPE_MULTIPLE_WARNING" 8 "TYPE_BOTTS_DOTS" 9 "TYPE_ROAD_EDGE" 10 "TYPE_ROAD_FURNITURE" 11 "TYPE_CURBSTONE" 12 "TYPE_TRAFFIC_STATIC" 13 "TYPE_UNKNOWN_RAISED" 14 "TYPE_UNKNOWN" 15 "Reserved15" ;
VAL_ 147 VFC_Poly05_Colour 0 "COLOR_WHITE" 1 "COLOR_YELLOW" 2 "COLOR_RED" 3 "COLOR_BLUE" 4 "COLOR_GREEN" 5 "RESERVED5" 6 "RESERVED6" 7 "COLOR_UNKNOWN" ;
VAL_ 148 VFC_Poly06_LaneAssociation 0 "LEFT_EGO_LINE" 1 "RIGHT_EGO_LINE" 2 "LEFT_LEFT_LINE" 3 "RIGHT_RIGHT_LINE" 4 "ROAD_EDGE_LEFT" 5 "ROAD_EDGE_RIGHT" 6 "RAISED_LEFT" 7 "RAISED_RIGHT" 8 "NOT_SELECTED_CANDIDATE" 9 "EGO_TRACK_LEFT" 10 "EGO_TRACK_RIGHT" 11 "Reserved11" 12 "Reserved12" 13 "Reserved13" 14 "Reserved14" 15 "Reserved15" ;
VAL_ 148 VFC_Poly06_Type 0 "TYPE_SOLID_LINE" 1 "TYPE_DASHED_LINE" 2 "TYPE_DOUBLE_DASHED_DASHED" 3 "TYPE_DOUBLE_DASHED_SOLID" 4 "TYPE_DOUBLE_SOLID_DASHED" 5 "TYPE_DOUBLE_SOLID_SOLID" 6 "TYPE_MULTIPLE" 7 "TYPE_MULTIPLE_WARNING" 8 "TYPE_BOTTS_DOTS" 9 "TYPE_ROAD_EDGE" 10 "TYPE_ROAD_FURNITURE" 11 "TYPE_CURBSTONE" 12 "TYPE_TRAFFIC_STATIC" 13 "TYPE_UNKNOWN_RAISED" 14 "TYPE_UNKNOWN" 15 "Reserved15" ;
VAL_ 148 VFC_Poly06_Colour 0 "COLOR_WHITE" 1 "COLOR_YELLOW" 2 "COLOR_RED" 3 "COLOR_BLUE" 4 "COLOR_GREEN" 5 "RESERVED5" 6 "RESERVED6" 7 "COLOR_UNKNOWN" ;
VAL_ 148 VFC_Poly07_LaneAssociation 0 "LEFT_EGO_LINE" 1 "RIGHT_EGO_LINE" 2 "LEFT_LEFT_LINE" 3 "RIGHT_RIGHT_LINE" 4 "ROAD_EDGE_LEFT" 5 "ROAD_EDGE_RIGHT" 6 "RAISED_LEFT" 7 "RAISED_RIGHT" 8 "NOT_SELECTED_CANDIDATE" 9 "EGO_TRACK_LEFT" 10 "EGO_TRACK_RIGHT" 11 "Reserved11" 12 "Reserved12" 13 "Reserved13" 14 "Reserved14" 15 "Reserved15" ;
VAL_ 148 VFC_Poly07_Type 0 "TYPE_SOLID_LINE" 1 "TYPE_DASHED_LINE" 2 "TYPE_DOUBLE_DASHED_DASHED" 3 "TYPE_DOUBLE_DASHED_SOLID" 4 "TYPE_DOUBLE_SOLID_DASHED" 5 "TYPE_DOUBLE_SOLID_SOLID" 6 "TYPE_MULTIPLE" 7 "TYPE_MULTIPLE_WARNING" 8 "TYPE_BOTTS_DOTS" 9 "TYPE_ROAD_EDGE" 10 "TYPE_ROAD_FURNITURE" 11 "TYPE_CURBSTONE" 12 "TYPE_TRAFFIC_STATIC" 13 "TYPE_UNKNOWN_RAISED" 14 "TYPE_UNKNOWN" 15 "Reserved15" ;
VAL_ 148 VFC_Poly07_Colour 0 "COLOR_WHITE" 1 "COLOR_YELLOW" 2 "COLOR_RED" 3 "COLOR_BLUE" 4 "COLOR_GREEN" 5 "RESERVED5" 6 "RESERVED6" 7 "COLOR_UNKNOWN" ;
VAL_ 148 VFC_Poly08_LaneAssociation 0 "LEFT_EGO_LINE" 1 "RIGHT_EGO_LINE" 2 "LEFT_LEFT_LINE" 3 "RIGHT_RIGHT_LINE" 4 "ROAD_EDGE_LEFT" 5 "ROAD_EDGE_RIGHT" 6 "RAISED_LEFT" 7 "RAISED_RIGHT" 8 "NOT_SELECTED_CANDIDATE" 9 "EGO_TRACK_LEFT" 10 "EGO_TRACK_RIGHT" 11 "Reserved11" 12 "Reserved12" 13 "Reserved13" 14 "Reserved14" 15 "Reserved15" ;
VAL_ 148 VFC_Poly08_Type 0 "TYPE_SOLID_LINE" 1 "TYPE_DASHED_LINE" 2 "TYPE_DOUBLE_DASHED_DASHED" 3 "TYPE_DOUBLE_DASHED_SOLID" 4 "TYPE_DOUBLE_SOLID_DASHED" 5 "TYPE_DOUBLE_SOLID_SOLID" 6 "TYPE_MULTIPLE" 7 "TYPE_MULTIPLE_WARNING" 8 "TYPE_BOTTS_DOTS" 9 "TYPE_ROAD_EDGE" 10 "TYPE_ROAD_FURNITURE" 11 "TYPE_CURBSTONE" 12 "TYPE_TRAFFIC_STATIC" 13 "TYPE_UNKNOWN_RAISED" 14 "TYPE_UNKNOWN" 15 "Reserved15" ;
VAL_ 148 VFC_Poly08_Colour 0 "COLOR_WHITE" 1 "COLOR_YELLOW" 2 "COLOR_RED" 3 "COLOR_BLUE" 4 "COLOR_GREEN" 5 "RESERVED5" 6 "RESERVED6" 7 "COLOR_UNKNOWN" ;
VAL_ 149 VFC_Poly09_LaneAssociation 0 "LEFT_EGO_LINE" 1 "RIGHT_EGO_LINE" 2 "LEFT_LEFT_LINE" 3 "RIGHT_RIGHT_LINE" 4 "ROAD_EDGE_LEFT" 5 "ROAD_EDGE_RIGHT" 6 "RAISED_LEFT" 7 "RAISED_RIGHT" 8 "NOT_SELECTED_CANDIDATE" 9 "EGO_TRACK_LEFT" 10 "EGO_TRACK_RIGHT" 11 "Reserved11" 12 "Reserved12" 13 "Reserved13" 14 "Reserved14" 15 "Reserved15" ;
VAL_ 149 VFC_Poly09_Type 0 "TYPE_SOLID_LINE" 1 "TYPE_DASHED_LINE" 2 "TYPE_DOUBLE_DASHED_DASHED" 3 "TYPE_DOUBLE_DASHED_SOLID" 4 "TYPE_DOUBLE_SOLID_DASHED" 5 "TYPE_DOUBLE_SOLID_SOLID" 6 "TYPE_MULTIPLE" 7 "TYPE_MULTIPLE_WARNING" 8 "TYPE_BOTTS_DOTS" 9 "TYPE_ROAD_EDGE" 10 "TYPE_ROAD_FURNITURE" 11 "TYPE_CURBSTONE" 12 "TYPE_TRAFFIC_STATIC" 13 "TYPE_UNKNOWN_RAISED" 14 "TYPE_UNKNOWN" 15 "Reserved15" ;
VAL_ 149 VFC_Poly09_Colour 0 "COLOR_WHITE" 1 "COLOR_YELLOW" 2 "COLOR_RED" 3 "COLOR_BLUE" 4 "COLOR_GREEN" 5 "RESERVED5" 6 "RESERVED6" 7 "COLOR_UNKNOWN" ;
VAL_ 149 VFC_Poly10_LaneAssociation 0 "LEFT_EGO_LINE" 1 "RIGHT_EGO_LINE" 2 "LEFT_LEFT_LINE" 3 "RIGHT_RIGHT_LINE" 4 "ROAD_EDGE_LEFT" 5 "ROAD_EDGE_RIGHT" 6 "RAISED_LEFT" 7 "RAISED_RIGHT" 8 "NOT_SELECTED_CANDIDATE" 9 "EGO_TRACK_LEFT" 10 "EGO_TRACK_RIGHT" 11 "Reserved11" 12 "Reserved12" 13 "Reserved13" 14 "Reserved14" 15 "Reserved15" ;
VAL_ 149 VFC_Poly10_Type 0 "TYPE_SOLID_LINE" 1 "TYPE_DASHED_LINE" 2 "TYPE_DOUBLE_DASHED_DASHED" 3 "TYPE_DOUBLE_DASHED_SOLID" 4 "TYPE_DOUBLE_SOLID_DASHED" 5 "TYPE_DOUBLE_SOLID_SOLID" 6 "TYPE_MULTIPLE" 7 "TYPE_MULTIPLE_WARNING" 8 "TYPE_BOTTS_DOTS" 9 "TYPE_ROAD_EDGE" 10 "TYPE_ROAD_FURNITURE" 11 "TYPE_CURBSTONE" 12 "TYPE_TRAFFIC_STATIC" 13 "TYPE_UNKNOWN_RAISED" 14 "TYPE_UNKNOWN" 15 "Reserved15" ;
VAL_ 149 VFC_Poly10_Colour 0 "COLOR_WHITE" 1 "COLOR_YELLOW" 2 "COLOR_RED" 3 "COLOR_BLUE" 4 "COLOR_GREEN" 5 "RESERVED5" 6 "RESERVED6" 7 "COLOR_UNKNOWN" ;
VAL_ 149 VFC_Poly11_LaneAssociation 0 "LEFT_EGO_LINE" 1 "RIGHT_EGO_LINE" 2 "LEFT_LEFT_LINE" 3 "RIGHT_RIGHT_LINE" 4 "ROAD_EDGE_LEFT" 5 "ROAD_EDGE_RIGHT" 6 "RAISED_LEFT" 7 "RAISED_RIGHT" 8 "NOT_SELECTED_CANDIDATE" 9 "EGO_TRACK_LEFT" 10 "EGO_TRACK_RIGHT" 11 "Reserved11" 12 "Reserved12" 13 "Reserved13" 14 "Reserved14" 15 "Reserved15" ;
VAL_ 149 VFC_Poly11_Type 0 "TYPE_SOLID_LINE" 1 "TYPE_DASHED_LINE" 2 "TYPE_DOUBLE_DASHED_DASHED" 3 "TYPE_DOUBLE_DASHED_SOLID" 4 "TYPE_DOUBLE_SOLID_DASHED" 5 "TYPE_DOUBLE_SOLID_SOLID" 6 "TYPE_MULTIPLE" 7 "TYPE_MULTIPLE_WARNING" 8 "TYPE_BOTTS_DOTS" 9 "TYPE_ROAD_EDGE" 10 "TYPE_ROAD_FURNITURE" 11 "TYPE_CURBSTONE" 12 "TYPE_TRAFFIC_STATIC" 13 "TYPE_UNKNOWN_RAISED" 14 "TYPE_UNKNOWN" 15 "Reserved15" ;
VAL_ 149 VFC_Poly11_Colour 0 "COLOR_WHITE" 1 "COLOR_YELLOW" 2 "COLOR_RED" 3 "COLOR_BLUE" 4 "COLOR_GREEN" 5 "RESERVED5" 6 "RESERVED6" 7 "COLOR_UNKNOWN" ;
VAL_ 162 VFC_2DPoly00_LaneAssociation 0 "LEFT_EGO_LINE" 1 "RIGHT_EGO_LINE" 2 "LEFT_LEFT_LINE" 3 "RIGHT_RIGHT_LINE" 4 "ROAD_EDGE_LEFT" 5 "ROAD_EDGE_RIGHT" 6 "RAISED_LEFT" 7 "RAISED_RIGHT" 8 "NOT_SELECTED_CANDIDATE" 9 "EGO_TRACK_LEFT" 10 "EGO_TRACK_RIGHT" 11 "Reserved11" 12 "Reserved12" 13 "Reserved13" 14 "Reserved14" 15 "Reserved15" ;
VAL_ 162 VFC_2DPoly00_Type 0 "TYPE_SOLID_LINE" 1 "TYPE_DASHED_LINE" 2 "TYPE_DOUBLE_DASHED_DASHED" 3 "TYPE_DOUBLE_DASHED_SOLID" 4 "TYPE_DOUBLE_SOLID_DASHED" 5 "TYPE_DOUBLE_SOLID_SOLID" 6 "TYPE_MULTIPLE" 7 "TYPE_MULTIPLE_WARNING" 8 "TYPE_BOTTS_DOTS" 9 "TYPE_ROAD_EDGE" 10 "TYPE_ROAD_FURNITURE" 11 "TYPE_CURBSTONE" 12 "TYPE_TRAFFIC_STATIC" 13 "TYPE_UNKNOWN_RAISED" 14 "TYPE_UNKNOWN" 15 "Reserved15" ;
VAL_ 162 VFC_2DPoly01_LaneAssociation 0 "LEFT_EGO_LINE" 1 "RIGHT_EGO_LINE" 2 "LEFT_LEFT_LINE" 3 "RIGHT_RIGHT_LINE" 4 "ROAD_EDGE_LEFT" 5 "ROAD_EDGE_RIGHT" 6 "RAISED_LEFT" 7 "RAISED_RIGHT" 8 "NOT_SELECTED_CANDIDATE" 9 "EGO_TRACK_LEFT" 10 "EGO_TRACK_RIGHT" 11 "Reserved11" 12 "Reserved12" 13 "Reserved13" 14 "Reserved14" 15 "Reserved15" ;
VAL_ 162 VFC_2DPoly01_Type 0 "TYPE_SOLID_LINE" 1 "TYPE_DASHED_LINE" 2 "TYPE_DOUBLE_DASHED_DASHED" 3 "TYPE_DOUBLE_DASHED_SOLID" 4 "TYPE_DOUBLE_SOLID_DASHED" 5 "TYPE_DOUBLE_SOLID_SOLID" 6 "TYPE_MULTIPLE" 7 "TYPE_MULTIPLE_WARNING" 8 "TYPE_BOTTS_DOTS" 9 "TYPE_ROAD_EDGE" 10 "TYPE_ROAD_FURNITURE" 11 "TYPE_CURBSTONE" 12 "TYPE_TRAFFIC_STATIC" 13 "TYPE_UNKNOWN_RAISED" 14 "TYPE_UNKNOWN" 15 "Reserved15" ;
VAL_ 162 VFC_2DPoly02_LaneAssociation 0 "LEFT_EGO_LINE" 1 "RIGHT_EGO_LINE" 2 "LEFT_LEFT_LINE" 3 "RIGHT_RIGHT_LINE" 4 "ROAD_EDGE_LEFT" 5 "ROAD_EDGE_RIGHT" 6 "RAISED_LEFT" 7 "RAISED_RIGHT" 8 "NOT_SELECTED_CANDIDATE" 9 "EGO_TRACK_LEFT" 10 "EGO_TRACK_RIGHT" 11 "Reserved11" 12 "Reserved12" 13 "Reserved13" 14 "Reserved14" 15 "Reserved15" ;
VAL_ 162 VFC_2DPoly02_Type 0 "TYPE_SOLID_LINE" 1 "TYPE_DASHED_LINE" 2 "TYPE_DOUBLE_DASHED_DASHED" 3 "TYPE_DOUBLE_DASHED_SOLID" 4 "TYPE_DOUBLE_SOLID_DASHED" 5 "TYPE_DOUBLE_SOLID_SOLID" 6 "TYPE_MULTIPLE" 7 "TYPE_MULTIPLE_WARNING" 8 "TYPE_BOTTS_DOTS" 9 "TYPE_ROAD_EDGE" 10 "TYPE_ROAD_FURNITURE" 11 "TYPE_CURBSTONE" 12 "TYPE_TRAFFIC_STATIC" 13 "TYPE_UNKNOWN_RAISED" 14 "TYPE_UNKNOWN" 15 "Reserved15" ;
VAL_ 163 VFC_2DPoly03_LaneAssociation 0 "LEFT_EGO_LINE" 1 "RIGHT_EGO_LINE" 2 "LEFT_LEFT_LINE" 3 "RIGHT_RIGHT_LINE" 4 "ROAD_EDGE_LEFT" 5 "ROAD_EDGE_RIGHT" 6 "RAISED_LEFT" 7 "RAISED_RIGHT" 8 "NOT_SELECTED_CANDIDATE" 9 "EGO_TRACK_LEFT" 10 "EGO_TRACK_RIGHT" 11 "Reserved11" 12 "Reserved12" 13 "Reserved13" 14 "Reserved14" 15 "Reserved15" ;
VAL_ 163 VFC_2DPoly03_Type 0 "TYPE_SOLID_LINE" 1 "TYPE_DASHED_LINE" 2 "TYPE_DOUBLE_DASHED_DASHED" 3 "TYPE_DOUBLE_DASHED_SOLID" 4 "TYPE_DOUBLE_SOLID_DASHED" 5 "TYPE_DOUBLE_SOLID_SOLID" 6 "TYPE_MULTIPLE" 7 "TYPE_MULTIPLE_WARNING" 8 "TYPE_BOTTS_DOTS" 9 "TYPE_ROAD_EDGE" 10 "TYPE_ROAD_FURNITURE" 11 "TYPE_CURBSTONE" 12 "TYPE_TRAFFIC_STATIC" 13 "TYPE_UNKNOWN_RAISED" 14 "TYPE_UNKNOWN" 15 "Reserved15" ;
VAL_ 163 VFC_2DPoly04_LaneAssociation 0 "LEFT_EGO_LINE" 1 "RIGHT_EGO_LINE" 2 "LEFT_LEFT_LINE" 3 "RIGHT_RIGHT_LINE" 4 "ROAD_EDGE_LEFT" 5 "ROAD_EDGE_RIGHT" 6 "RAISED_LEFT" 7 "RAISED_RIGHT" 8 "NOT_SELECTED_CANDIDATE" 9 "EGO_TRACK_LEFT" 10 "EGO_TRACK_RIGHT" 11 "Reserved11" 12 "Reserved12" 13 "Reserved13" 14 "Reserved14" 15 "Reserved15" ;
VAL_ 163 VFC_2DPoly04_Type 0 "TYPE_SOLID_LINE" 1 "TYPE_DASHED_LINE" 2 "TYPE_DOUBLE_DASHED_DASHED" 3 "TYPE_DOUBLE_DASHED_SOLID" 4 "TYPE_DOUBLE_SOLID_DASHED" 5 "TYPE_DOUBLE_SOLID_SOLID" 6 "TYPE_MULTIPLE" 7 "TYPE_MULTIPLE_WARNING" 8 "TYPE_BOTTS_DOTS" 9 "TYPE_ROAD_EDGE" 10 "TYPE_ROAD_FURNITURE" 11 "TYPE_CURBSTONE" 12 "TYPE_TRAFFIC_STATIC" 13 "TYPE_UNKNOWN_RAISED" 14 "TYPE_UNKNOWN" 15 "Reserved15" ;
VAL_ 163 VFC_2DPoly05_LaneAssociation 0 "LEFT_EGO_LINE" 1 "RIGHT_EGO_LINE" 2 "LEFT_LEFT_LINE" 3 "RIGHT_RIGHT_LINE" 4 "ROAD_EDGE_LEFT" 5 "ROAD_EDGE_RIGHT" 6 "RAISED_LEFT" 7 "RAISED_RIGHT" 8 "NOT_SELECTED_CANDIDATE" 9 "EGO_TRACK_LEFT" 10 "EGO_TRACK_RIGHT" 11 "Reserved11" 12 "Reserved12" 13 "Reserved13" 14 "Reserved14" 15 "Reserved15" ;
VAL_ 163 VFC_2DPoly05_Type 0 "TYPE_SOLID_LINE" 1 "TYPE_DASHED_LINE" 2 "TYPE_DOUBLE_DASHED_DASHED" 3 "TYPE_DOUBLE_DASHED_SOLID" 4 "TYPE_DOUBLE_SOLID_DASHED" 5 "TYPE_DOUBLE_SOLID_SOLID" 6 "TYPE_MULTIPLE" 7 "TYPE_MULTIPLE_WARNING" 8 "TYPE_BOTTS_DOTS" 9 "TYPE_ROAD_EDGE" 10 "TYPE_ROAD_FURNITURE" 11 "TYPE_CURBSTONE" 12 "TYPE_TRAFFIC_STATIC" 13 "TYPE_UNKNOWN_RAISED" 14 "TYPE_UNKNOWN" 15 "Reserved15" ;
VAL_ 164 VFC_2DPoly06_LaneAssociation 0 "LEFT_EGO_LINE" 1 "RIGHT_EGO_LINE" 2 "LEFT_LEFT_LINE" 3 "RIGHT_RIGHT_LINE" 4 "ROAD_EDGE_LEFT" 5 "ROAD_EDGE_RIGHT" 6 "RAISED_LEFT" 7 "RAISED_RIGHT" 8 "NOT_SELECTED_CANDIDATE" 9 "EGO_TRACK_LEFT" 10 "EGO_TRACK_RIGHT" 11 "Reserved11" 12 "Reserved12" 13 "Reserved13" 14 "Reserved14" 15 "Reserved15" ;
VAL_ 164 VFC_2DPoly06_Type 0 "TYPE_SOLID_LINE" 1 "TYPE_DASHED_LINE" 2 "TYPE_DOUBLE_DASHED_DASHED" 3 "TYPE_DOUBLE_DASHED_SOLID" 4 "TYPE_DOUBLE_SOLID_DASHED" 5 "TYPE_DOUBLE_SOLID_SOLID" 6 "TYPE_MULTIPLE" 7 "TYPE_MULTIPLE_WARNING" 8 "TYPE_BOTTS_DOTS" 9 "TYPE_ROAD_EDGE" 10 "TYPE_ROAD_FURNITURE" 11 "TYPE_CURBSTONE" 12 "TYPE_TRAFFIC_STATIC" 13 "TYPE_UNKNOWN_RAISED" 14 "TYPE_UNKNOWN" 15 "Reserved15" ;
VAL_ 164 VFC_2DPoly07_LaneAssociation 0 "LEFT_EGO_LINE" 1 "RIGHT_EGO_LINE" 2 "LEFT_LEFT_LINE" 3 "RIGHT_RIGHT_LINE" 4 "ROAD_EDGE_LEFT" 5 "ROAD_EDGE_RIGHT" 6 "RAISED_LEFT" 7 "RAISED_RIGHT" 8 "NOT_SELECTED_CANDIDATE" 9 "EGO_TRACK_LEFT" 10 "EGO_TRACK_RIGHT" 11 "Reserved11" 12 "Reserved12" 13 "Reserved13" 14 "Reserved14" 15 "Reserved15" ;
VAL_ 164 VFC_2DPoly07_Type 0 "TYPE_SOLID_LINE" 1 "TYPE_DASHED_LINE" 2 "TYPE_DOUBLE_DASHED_DASHED" 3 "TYPE_DOUBLE_DASHED_SOLID" 4 "TYPE_DOUBLE_SOLID_DASHED" 5 "TYPE_DOUBLE_SOLID_SOLID" 6 "TYPE_MULTIPLE" 7 "TYPE_MULTIPLE_WARNING" 8 "TYPE_BOTTS_DOTS" 9 "TYPE_ROAD_EDGE" 10 "TYPE_ROAD_FURNITURE" 11 "TYPE_CURBSTONE" 12 "TYPE_TRAFFIC_STATIC" 13 "TYPE_UNKNOWN_RAISED" 14 "TYPE_UNKNOWN" 15 "Reserved15" ;
VAL_ 164 VFC_2DPoly08_LaneAssociation 0 "LEFT_EGO_LINE" 1 "RIGHT_EGO_LINE" 2 "LEFT_LEFT_LINE" 3 "RIGHT_RIGHT_LINE" 4 "ROAD_EDGE_LEFT" 5 "ROAD_EDGE_RIGHT" 6 "RAISED_LEFT" 7 "RAISED_RIGHT" 8 "NOT_SELECTED_CANDIDATE" 9 "EGO_TRACK_LEFT" 10 "EGO_TRACK_RIGHT" 11 "Reserved11" 12 "Reserved12" 13 "Reserved13" 14 "Reserved14" 15 "Reserved15" ;
VAL_ 164 VFC_2DPoly08_Type 0 "TYPE_SOLID_LINE" 1 "TYPE_DASHED_LINE" 2 "TYPE_DOUBLE_DASHED_DASHED" 3 "TYPE_DOUBLE_DASHED_SOLID" 4 "TYPE_DOUBLE_SOLID_DASHED" 5 "TYPE_DOUBLE_SOLID_SOLID" 6 "TYPE_MULTIPLE" 7 "TYPE_MULTIPLE_WARNING" 8 "TYPE_BOTTS_DOTS" 9 "TYPE_ROAD_EDGE" 10 "TYPE_ROAD_FURNITURE" 11 "TYPE_CURBSTONE" 12 "TYPE_TRAFFIC_STATIC" 13 "TYPE_UNKNOWN_RAISED" 14 "TYPE_UNKNOWN" 15 "Reserved15" ;
VAL_ 165 VFC_2DPoly09_LaneAssociation 0 "LEFT_EGO_LINE" 1 "RIGHT_EGO_LINE" 2 "LEFT_LEFT_LINE" 3 "RIGHT_RIGHT_LINE" 4 "ROAD_EDGE_LEFT" 5 "ROAD_EDGE_RIGHT" 6 "RAISED_LEFT" 7 "RAISED_RIGHT" 8 "NOT_SELECTED_CANDIDATE" 9 "EGO_TRACK_LEFT" 10 "EGO_TRACK_RIGHT" 11 "Reserved11" 12 "Reserved12" 13 "Reserved13" 14 "Reserved14" 15 "Reserved15" ;
VAL_ 165 VFC_2DPoly09_Type 0 "TYPE_SOLID_LINE" 1 "TYPE_DASHED_LINE" 2 "TYPE_DOUBLE_DASHED_DASHED" 3 "TYPE_DOUBLE_DASHED_SOLID" 4 "TYPE_DOUBLE_SOLID_DASHED" 5 "TYPE_DOUBLE_SOLID_SOLID" 6 "TYPE_MULTIPLE" 7 "TYPE_MULTIPLE_WARNING" 8 "TYPE_BOTTS_DOTS" 9 "TYPE_ROAD_EDGE" 10 "TYPE_ROAD_FURNITURE" 11 "TYPE_CURBSTONE" 12 "TYPE_TRAFFIC_STATIC" 13 "TYPE_UNKNOWN_RAISED" 14 "TYPE_UNKNOWN" 15 "Reserved15" ;
VAL_ 165 VFC_2DPoly10_LaneAssociation 0 "LEFT_EGO_LINE" 1 "RIGHT_EGO_LINE" 2 "LEFT_LEFT_LINE" 3 "RIGHT_RIGHT_LINE" 4 "ROAD_EDGE_LEFT" 5 "ROAD_EDGE_RIGHT" 6 "RAISED_LEFT" 7 "RAISED_RIGHT" 8 "NOT_SELECTED_CANDIDATE" 9 "EGO_TRACK_LEFT" 10 "EGO_TRACK_RIGHT" 11 "Reserved11" 12 "Reserved12" 13 "Reserved13" 14 "Reserved14" 15 "Reserved15" ;
VAL_ 165 VFC_2DPoly10_Type 0 "TYPE_SOLID_LINE" 1 "TYPE_DASHED_LINE" 2 "TYPE_DOUBLE_DASHED_DASHED" 3 "TYPE_DOUBLE_DASHED_SOLID" 4 "TYPE_DOUBLE_SOLID_DASHED" 5 "TYPE_DOUBLE_SOLID_SOLID" 6 "TYPE_MULTIPLE" 7 "TYPE_MULTIPLE_WARNING" 8 "TYPE_BOTTS_DOTS" 9 "TYPE_ROAD_EDGE" 10 "TYPE_ROAD_FURNITURE" 11 "TYPE_CURBSTONE" 12 "TYPE_TRAFFIC_STATIC" 13 "TYPE_UNKNOWN_RAISED" 14 "TYPE_UNKNOWN" 15 "Reserved15" ;
VAL_ 165 VFC_2DPoly11_LaneAssociation 0 "LEFT_EGO_LINE" 1 "RIGHT_EGO_LINE" 2 "LEFT_LEFT_LINE" 3 "RIGHT_RIGHT_LINE" 4 "ROAD_EDGE_LEFT" 5 "ROAD_EDGE_RIGHT" 6 "RAISED_LEFT" 7 "RAISED_RIGHT" 8 "NOT_SELECTED_CANDIDATE" 9 "EGO_TRACK_LEFT" 10 "EGO_TRACK_RIGHT" 11 "Reserved11" 12 "Reserved12" 13 "Reserved13" 14 "Reserved14" 15 "Reserved15" ;
VAL_ 165 VFC_2DPoly11_Type 0 "TYPE_SOLID_LINE" 1 "TYPE_DASHED_LINE" 2 "TYPE_DOUBLE_DASHED_DASHED" 3 "TYPE_DOUBLE_DASHED_SOLID" 4 "TYPE_DOUBLE_SOLID_DASHED" 5 "TYPE_DOUBLE_SOLID_SOLID" 6 "TYPE_MULTIPLE" 7 "TYPE_MULTIPLE_WARNING" 8 "TYPE_BOTTS_DOTS" 9 "TYPE_ROAD_EDGE" 10 "TYPE_ROAD_FURNITURE" 11 "TYPE_CURBSTONE" 12 "TYPE_TRAFFIC_STATIC" 13 "TYPE_UNKNOWN_RAISED" 14 "TYPE_UNKNOWN" 15 "Reserved15" ;
VAL_ 178 VFC_RM00_Type 0 "Stop_Line" 1 "Zebra_Crossing_Start" 2 "Zebra_Crossing_End" 3 "Arrow_Forward" 4 "Arrow_Left" 5 "Arrow_Right" 6 "Arrow_Straight_Left" 7 "Arrow_Straight_Right" 8 "Arrow_Turning_Point_Left" 9 "Arrow_Turning_Point_Right" 10 "Arrow_45_Deg_Left" 11 "Arrow_45_Deg_Right" 12 "Virtual_Stop_Area_Begin" 13 "Virtual_Stop_Area_End" 14 "Virtual_Braking_Area_Begin" 15 "Virtual_Braking_Area_End" 16 "Reserved16" 17 "Reserved17" 18 "Reserved18" 19 "Reserved19" 20 "Reserved20" 21 "Reserved21" 22 "Reserved22" 23 "Reserved23" 24 "Reserved24" 25 "Reserved25" 26 "Reserved26" 27 "Reserved27" 28 "Reserved28" 29 "Reserved29" 30 "Reserved30" 31 "Reserved31" ;
VAL_ 178 VFC_RM01_Type 0 "Stop_Line" 1 "Zebra_Crossing_Start" 2 "Zebra_Crossing_End" 3 "Arrow_Forward" 4 "Arrow_Left" 5 "Arrow_Right" 6 "Arrow_Straight_Left" 7 "Arrow_Straight_Right" 8 "Arrow_Turning_Point_Left" 9 "Arrow_Turning_Point_Right" 10 "Arrow_45_Deg_Left" 11 "Arrow_45_Deg_Right" 12 "Virtual_Stop_Area_Begin" 13 "Virtual_Stop_Area_End" 14 "Virtual_Braking_Area_Begin" 15 "Virtual_Braking_Area_End" 16 "Reserved16" 17 "Reserved17" 18 "Reserved18" 19 "Reserved19" 20 "Reserved20" 21 "Reserved21" 22 "Reserved22" 23 "Reserved23" 24 "Reserved24" 25 "Reserved25" 26 "Reserved26" 27 "Reserved27" 28 "Reserved28" 29 "Reserved29" 30 "Reserved30" 31 "Reserved31" ;
VAL_ 178 VFC_RM02_Type 0 "Stop_Line" 1 "Zebra_Crossing_Start" 2 "Zebra_Crossing_End" 3 "Arrow_Forward" 4 "Arrow_Left" 5 "Arrow_Right" 6 "Arrow_Straight_Left" 7 "Arrow_Straight_Right" 8 "Arrow_Turning_Point_Left" 9 "Arrow_Turning_Point_Right" 10 "Arrow_45_Deg_Left" 11 "Arrow_45_Deg_Right" 12 "Virtual_Stop_Area_Begin" 13 "Virtual_Stop_Area_End" 14 "Virtual_Braking_Area_Begin" 15 "Virtual_Braking_Area_End" 16 "Reserved16" 17 "Reserved17" 18 "Reserved18" 19 "Reserved19" 20 "Reserved20" 21 "Reserved21" 22 "Reserved22" 23 "Reserved23" 24 "Reserved24" 25 "Reserved25" 26 "Reserved26" 27 "Reserved27" 28 "Reserved28" 29 "Reserved29" 30 "Reserved30" 31 "Reserved31" ;
VAL_ 178 VFC_RM03_Type 0 "Stop_Line" 1 "Zebra_Crossing_Start" 2 "Zebra_Crossing_End" 3 "Arrow_Forward" 4 "Arrow_Left" 5 "Arrow_Right" 6 "Arrow_Straight_Left" 7 "Arrow_Straight_Right" 8 "Arrow_Turning_Point_Left" 9 "Arrow_Turning_Point_Right" 10 "Arrow_45_Deg_Left" 11 "Arrow_45_Deg_Right" 12 "Virtual_Stop_Area_Begin" 13 "Virtual_Stop_Area_End" 14 "Virtual_Braking_Area_Begin" 15 "Virtual_Braking_Area_End" 16 "Reserved16" 17 "Reserved17" 18 "Reserved18" 19 "Reserved19" 20 "Reserved20" 21 "Reserved21" 22 "Reserved22" 23 "Reserved23" 24 "Reserved24" 25 "Reserved25" 26 "Reserved26" 27 "Reserved27" 28 "Reserved28" 29 "Reserved29" 30 "Reserved30" 31 "Reserved31" ;
VAL_ 178 VFC_RM04_Type 0 "Stop_Line" 1 "Zebra_Crossing_Start" 2 "Zebra_Crossing_End" 3 "Arrow_Forward" 4 "Arrow_Left" 5 "Arrow_Right" 6 "Arrow_Straight_Left" 7 "Arrow_Straight_Right" 8 "Arrow_Turning_Point_Left" 9 "Arrow_Turning_Point_Right" 10 "Arrow_45_Deg_Left" 11 "Arrow_45_Deg_Right" 12 "Virtual_Stop_Area_Begin" 13 "Virtual_Stop_Area_End" 14 "Virtual_Braking_Area_Begin" 15 "Virtual_Braking_Area_End" 16 "Reserved16" 17 "Reserved17" 18 "Reserved18" 19 "Reserved19" 20 "Reserved20" 21 "Reserved21" 22 "Reserved22" 23 "Reserved23" 24 "Reserved24" 25 "Reserved25" 26 "Reserved26" 27 "Reserved27" 28 "Reserved28" 29 "Reserved29" 30 "Reserved30" 31 "Reserved31" ;
VAL_ 178 VFC_RM05_Type 0 "Stop_Line" 1 "Zebra_Crossing_Start" 2 "Zebra_Crossing_End" 3 "Arrow_Forward" 4 "Arrow_Left" 5 "Arrow_Right" 6 "Arrow_Straight_Left" 7 "Arrow_Straight_Right" 8 "Arrow_Turning_Point_Left" 9 "Arrow_Turning_Point_Right" 10 "Arrow_45_Deg_Left" 11 "Arrow_45_Deg_Right" 12 "Virtual_Stop_Area_Begin" 13 "Virtual_Stop_Area_End" 14 "Virtual_Braking_Area_Begin" 15 "Virtual_Braking_Area_End" 16 "Reserved16" 17 "Reserved17" 18 "Reserved18" 19 "Reserved19" 20 "Reserved20" 21 "Reserved21" 22 "Reserved22" 23 "Reserved23" 24 "Reserved24" 25 "Reserved25" 26 "Reserved26" 27 "Reserved27" 28 "Reserved28" 29 "Reserved29" 30 "Reserved30" 31 "Reserved31" ;
VAL_ 178 VFC_RM06_Type 0 "Stop_Line" 1 "Zebra_Crossing_Start" 2 "Zebra_Crossing_End" 3 "Arrow_Forward" 4 "Arrow_Left" 5 "Arrow_Right" 6 "Arrow_Straight_Left" 7 "Arrow_Straight_Right" 8 "Arrow_Turning_Point_Left" 9 "Arrow_Turning_Point_Right" 10 "Arrow_45_Deg_Left" 11 "Arrow_45_Deg_Right" 12 "Virtual_Stop_Area_Begin" 13 "Virtual_Stop_Area_End" 14 "Virtual_Braking_Area_Begin" 15 "Virtual_Braking_Area_End" 16 "Reserved16" 17 "Reserved17" 18 "Reserved18" 19 "Reserved19" 20 "Reserved20" 21 "Reserved21" 22 "Reserved22" 23 "Reserved23" 24 "Reserved24" 25 "Reserved25" 26 "Reserved26" 27 "Reserved27" 28 "Reserved28" 29 "Reserved29" 30 "Reserved30" 31 "Reserved31" ;
VAL_ 224 VFC_TLHdr_State 0 "Off" 1 "On" 2 "Error" 3 "Reduced sight" 4 "Reserved4" 5 "Reserved5" 6 "Reserved6" 7 "Reserved7" ;
VAL_ 226 VFC_TL00_Colour 0 "unknown" 1 "red" 2 "green" 3 "yellow" ;
VAL_ 226 VFC_TL00_LightShapeType 0 "unknown" 1 "round" 2 "straightArrow" 3 "straightLeftArrow" 4 "straightRightArrow" 5 "leftArrow" 6 "rightArrow" 7 "downArrow" 8 "Counter" 9 "Reserved9" 10 "Reserved10" 11 "Reserved11" 12 "Reserved12" 13 "Reserved13" 14 "Reserved14" 15 "Reserved15" ;
VAL_ 226 VFC_TL00_LightModeType 0 "Continous" 1 "Blinking" 2 "Counting" 3 "Reserved" ;
VAL_ 226 VFC_TL01_Colour 0 "unknown" 1 "red" 2 "green" 3 "yellow" ;
VAL_ 226 VFC_TL01_LightShapeType 0 "unknown" 1 "round" 2 "straightArrow" 3 "straightLeftArrow" 4 "straightRightArrow" 5 "leftArrow" 6 "rightArrow" 7 "downArrow" 8 "Counter" 9 "Reserved9" 10 "Reserved10" 11 "Reserved11" 12 "Reserved12" 13 "Reserved13" 14 "Reserved14" 15 "Reserved15" ;
VAL_ 226 VFC_TL01_LightModeType 0 "Continous" 1 "Blinking" 2 "Counting" 3 "Reserved" ;
VAL_ 226 VFC_TL02_Colour 0 "unknown" 1 "red" 2 "green" 3 "yellow" ;
VAL_ 226 VFC_TL02_LightShapeType 0 "unknown" 1 "round" 2 "straightArrow" 3 "straightLeftArrow" 4 "straightRightArrow" 5 "leftArrow" 6 "rightArrow" 7 "downArrow" 8 "Counter" 9 "Reserved9" 10 "Reserved10" 11 "Reserved11" 12 "Reserved12" 13 "Reserved13" 14 "Reserved14" 15 "Reserved15" ;
VAL_ 226 VFC_TL02_LightModeType 0 "Continous" 1 "Blinking" 2 "Counting" 3 "Reserved" ;
VAL_ 226 VFC_TL03_Colour 0 "unknown" 1 "red" 2 "green" 3 "yellow" ;
VAL_ 226 VFC_TL03_LightShapeType 0 "unknown" 1 "round" 2 "straightArrow" 3 "straightLeftArrow" 4 "straightRightArrow" 5 "leftArrow" 6 "rightArrow" 7 "downArrow" 8 "Counter" 9 "Reserved9" 10 "Reserved10" 11 "Reserved11" 12 "Reserved12" 13 "Reserved13" 14 "Reserved14" 15 "Reserved15" ;
VAL_ 226 VFC_TL03_LightModeType 0 "Continous" 1 "Blinking" 2 "Counting" 3 "Reserved" ;
VAL_ 226 VFC_TL04_Colour 0 "unknown" 1 "red" 2 "green" 3 "yellow" ;
VAL_ 226 VFC_TL04_LightShapeType 0 "unknown" 1 "round" 2 "straightArrow" 3 "straightLeftArrow" 4 "straightRightArrow" 5 "leftArrow" 6 "rightArrow" 7 "downArrow" 8 "Counter" 9 "Reserved9" 10 "Reserved10" 11 "Reserved11" 12 "Reserved12" 13 "Reserved13" 14 "Reserved14" 15 "Reserved15" ;
VAL_ 226 VFC_TL04_LightModeType 0 "Continous" 1 "Blinking" 2 "Counting" 3 "Reserved" ;
VAL_ 227 VFC_TL05_Colour 0 "unknown" 1 "red" 2 "green" 3 "yellow" ;
VAL_ 227 VFC_TL05_LightShapeType 0 "unknown" 1 "round" 2 "straightArrow" 3 "straightLeftArrow" 4 "straightRightArrow" 5 "leftArrow" 6 "rightArrow" 7 "downArrow" 8 "Counter" 9 "Reserved9" 10 "Reserved10" 11 "Reserved11" 12 "Reserved12" 13 "Reserved13" 14 "Reserved14" 15 "Reserved15" ;
VAL_ 227 VFC_TL05_LightModeType 0 "Continous" 1 "Blinking" 2 "Counting" 3 "Reserved" ;
VAL_ 227 VFC_TL06_Colour 0 "unknown" 1 "red" 2 "green" 3 "yellow" ;
VAL_ 227 VFC_TL06_LightShapeType 0 "unknown" 1 "round" 2 "straightArrow" 3 "straightLeftArrow" 4 "straightRightArrow" 5 "leftArrow" 6 "rightArrow" 7 "downArrow" 8 "Counter" 9 "Reserved9" 10 "Reserved10" 11 "Reserved11" 12 "Reserved12" 13 "Reserved13" 14 "Reserved14" 15 "Reserved15" ;
VAL_ 227 VFC_TL06_LightModeType 0 "Continous" 1 "Blinking" 2 "Counting" 3 "Reserved" ;
VAL_ 227 VFC_TL07_Colour 0 "unknown" 1 "red" 2 "green" 3 "yellow" ;
VAL_ 227 VFC_TL07_LightShapeType 0 "unknown" 1 "round" 2 "straightArrow" 3 "straightLeftArrow" 4 "straightRightArrow" 5 "leftArrow" 6 "rightArrow" 7 "downArrow" 8 "Counter" 9 "Reserved9" 10 "Reserved10" 11 "Reserved11" 12 "Reserved12" 13 "Reserved13" 14 "Reserved14" 15 "Reserved15" ;
VAL_ 227 VFC_TL07_LightModeType 0 "Continous" 1 "Blinking" 2 "Counting" 3 "Reserved" ;
VAL_ 227 VFC_TL08_Colour 0 "unknown" 1 "red" 2 "green" 3 "yellow" ;
VAL_ 227 VFC_TL08_LightShapeType 0 "unknown" 1 "round" 2 "straightArrow" 3 "straightLeftArrow" 4 "straightRightArrow" 5 "leftArrow" 6 "rightArrow" 7 "downArrow" 8 "Counter" 9 "Reserved9" 10 "Reserved10" 11 "Reserved11" 12 "Reserved12" 13 "Reserved13" 14 "Reserved14" 15 "Reserved15" ;
VAL_ 227 VFC_TL08_LightModeType 0 "Continous" 1 "Blinking" 2 "Counting" 3 "Reserved" ;
VAL_ 227 VFC_TL09_Colour 0 "unknown" 1 "red" 2 "green" 3 "yellow" ;
VAL_ 227 VFC_TL09_LightShapeType 0 "unknown" 1 "round" 2 "straightArrow" 3 "straightLeftArrow" 4 "straightRightArrow" 5 "leftArrow" 6 "rightArrow" 7 "downArrow" 8 "Counter" 9 "Reserved9" 10 "Reserved10" 11 "Reserved11" 12 "Reserved12" 13 "Reserved13" 14 "Reserved14" 15 "Reserved15" ;
VAL_ 227 VFC_TL09_LightModeType 0 "Continous" 1 "Blinking" 2 "Counting" 3 "Reserved" ;
VAL_ 236 VFC_TSHdr_State 0 "Off" 1 "On" 2 "Reduced" 3 "HW_Error" 4 "SW_Error" 5 "FID_Active" 6 "Reserved6" 7 "Reserved7" ;
VAL_ 236 VFC_TSHdr_Brightness 0 "Daylight" 1 "Night" 2 "Reserved2" 3 "Reserved3" 4 "Reserved4" 5 "Reserved5" 6 "Reserved6" 7 "Reserved7" ;
VAL_ 236 VFC_TSHdr_Country 0 "0 Unknown" 4 "Afghanistan" 8 "Albania" 10 "Antarctica" 12 "Algeria" 16 "American Samoa" 20 "Andorra" 24 "Angola" 28 "Antigua and Barbuda" 31 "Azerbaijan" 32 "Argentina" 36 "Australia" 40 "Austria" 44 "Bahamas (the)" 48 "Bahrain" 50 "Bangladesh" 51 "Armenia" 52 "Barbados" 56 "Belgium" 60 "Bermuda" 64 "Bhutan" 68 "Bolivia (Plurinational State of)" 70 "Bosnia and Herzegovina" 72 "Botswana" 74 "Bouvet Island" 76 "Brazil" 84 "Belize" 86 "British Indian Ocean Territory (the)" 90 "Solomon Islands" 92 "Virgin Islands (British)" 96 "Brunei Darussalam" 100 "Bulgaria" 104 "Myanmar" 108 "Burundi" 112 "Belarus" 116 "Cambodia" 120 "Cameroon" 124 "Canada" 132 "Cabo Verde" 136 "Cayman Islands (the)" 140 "Central African Republic (the)" 144 "Sri Lanka" 148 "Chad" 152 "Chile" 156 "China" 158 "Taiwan (Province of China)" 162 "Christmas Island" 166 "Cocos (Keeling) Islands (the)" 170 "Colombia" 174 "Comoros (the)" 175 "Mayotte" 178 "Congo (the)" 180 "Congo (the Democratic Republic of the)" 184 "Cook Islands (the)" 188 "Costa Rica" 191 "Croatia" 192 "Cuba" 196 "Cyprus" 203 "Czechia" 204 "Benin" 208 "Denmark" 212 "Dominica" 214 "Dominican Republic (the)" 218 "Ecuador" 222 "El Salvador" 226 "Equatorial Guinea" 231 "Ethiopia" 232 "Eritrea" 233 "Estonia" 234 "Faroe Islands (the)" 238 "Falkland Islands (the) [Malvinas]" 239 "South Georgia and the South Sandwich Islands" 242 "Fiji" 246 "Finland" 248 "Aland Islands" 250 "France" 254 "French Guiana" 258 "French Polynesia" 260 "French Southern Territories (the)" 262 "Djibouti" 266 "Gabon" 268 "Georgia" 270 "Gambia (the)" 275 "Palestine, State of" 276 "Germany" 288 "Ghana" 292 "Gibraltar" 296 "Kiribati" 300 "Greece" 304 "Greenland" 308 "Grenada" 312 "Guadeloupe" 316 "Guam" 320 "Guatemala" 324 "Guinea" 328 "Guyana" 332 "Haiti" 334 "Heard Island and McDonald Islands" 336 "Holy See (the)" 340 "Honduras" 344 "Hong Kong" 348 "Hungary" 352 "Iceland" 356 "India" 360 "Indonesia" 364 "Iran (Islamic Republic of)" 368 "Iraq" 372 "Ireland" 376 "Israel" 380 "Italy" 384 "Cote d'Ivoire" 388 "Jamaica" 392 "Japan" 398 "Kazakhstan" 400 "Jordan" 404 "Kenya" 408 "Korea (the Democratic People's Republic of)" 410 "Korea (the Republic of)" 414 "Kuwait" 417 "Kyrgyzstan" 418 "Lao People's Democratic Republic (the)" 422 "Lebanon" 426 "Lesotho" 428 "Latvia" 430 "Liberia" 434 "Libya" 438 "Liechtenstein" 440 "Lithuania" 442 "Luxembourg" 446 "Macao" 450 "Madagascar" 454 "Malawi" 458 "Malaysia" 462 "Maldives" 466 "Mali" 470 "Malta" 474 "Martinique" 478 "Mauritania" 480 "Mauritius" 484 "Mexico" 492 "Monaco" 496 "Mongolia" 498 "Moldova (the Republic of)" 499 "Montenegro" 500 "Montserrat" 504 "Morocco" 508 "Mozambique" 512 "Oman" 516 "Namibia" 520 "Nauru" 524 "Nepal" 528 "Netherlands (the)" 531 "Curacao" 533 "Aruba" 534 "Sint Maarten (Dutch part)" 535 "Bonaire, Sint Eustatius and Saba" 540 "New Caledonia" 548 "Vanuatu" 554 "New Zealand" 558 "Nicaragua" 562 "Niger (the)" 566 "Nigeria" 570 "Niue" 574 "Norfolk Island" 578 "Norway" 580 "Northern Mariana Islands (the)" 581 "United States Minor Outlying Islands (the)" 583 "Micronesia (Federated States of)" 584 "Marshall Islands (the)" 585 "Palau" 586 "Pakistan" 591 "Panama" 598 "Papua New Guinea" 600 "Paraguay" 604 "Peru" 608 "Philippines (the)" 612 "Pitcairn" 616 "Poland" 620 "Portugal" 624 "Guinea-Bissau" 626 "Timor-Leste" 630 "Puerto Rico" 634 "Qatar" 638 "Reunion" 642 "Romania" 643 "Russian Federation (the)" 646 "Rwanda" 652 "Saint Barthelemy" 654 "Saint Helena, Ascension and Tristan da Cunha" 659 "Saint Kitts and Nevis" 660 "Anguilla" 662 "Saint Lucia" 663 "Saint Martin (French part)" 666 "Saint Pierre and Miquelon" 670 "Saint Vincent and the Grenadines" 674 "San Marino" 678 "Sao Tome and Principe" 682 "Saudi Arabia" 686 "Senegal" 688 "Serbia" 690 "Seychelles" 694 "Sierra Leone" 702 "Singapore" 703 "Slovakia" 704 "Viet Nam" 705 "Slovenia" 706 "Somalia" 710 "South Africa" 716 "Zimbabwe" 724 "Spain" 728 "South Sudan" 729 "Sudan (the)" 732 "Western Sahara*" 740 "Suriname" 744 "Svalbard and Jan Mayen" 748 "Eswatini" 752 "Sweden" 756 "Switzerland" 760 "Syrian Arab Republic" 762 "Tajikistan" 764 "Thailand" 768 "Togo" 772 "Tokelau" 776 "Tonga" 780 "Trinidad and Tobago" 784 "United Arab Emirates (the)" 788 "Tunisia" 792 "Turkey" 795 "Turkmenistan" 796 "Turks and Caicos Islands (the)" 798 "Tuvalu" 800 "Uganda" 804 "Ukraine" 807 "Macedonia (the former Yugoslav Republic of)" 818 "Egypt" 826 "United Kingdom of Great Britain and Northern Ireland (the)" 831 "Guernsey" 832 "Jersey" 833 "Isle of Man" 834 "Tanzania, United Republic of" 840 "United States of America (the)" 850 "Virgin Islands (U.S.)" 854 "Burkina Faso" 858 "Uruguay" 860 "Uzbekistan" 862 "Venezuela(Bolivarian Republic of)" 876 "Wallis and Futuna" 882 "Samoa" 887 "Yemen" 894 "Zambia" ;
VAL_ 236 VFC_TSHdr_CountryMode 0 "Unknown" 1 "EHR_CAN" 2 "EHR_Default_Country" 3 "EHR_Adaptation_Value" 4 "EHR_Variant_Coding" 5 "RSR_Dataset" 6 "RSR_CCD" 7 "Reserved" ;
SIG_GROUP_ 133 SG_VFC_RoadClothoid_09_11 1 : VFC_Cloth_09_11_CRC VFC_Cloth_09_11_AliveCtr VFC_Cloth_09_11_ProtBlockCtr VFC_Cloth09_LaneAssociation VFC_Cloth09_Colour VFC_Cloth09_RangeXBegin VFC_Cloth09_RangeXEnd VFC_Cloth09_ExistProb VFC_Cloth09_CurvChange VFC_Cloth09_Curv VFC_Cloth09_PyStdDev VFC_Cloth09_Py VFC_Cloth09_OrientationYaw VFC_Cloth09_Width VFC_Cloth09_Type VFC_Cloth10_LaneAssociation VFC_Cloth10_Colour VFC_Cloth10_RangeXBegin VFC_Cloth10_RangeXEnd VFC_Cloth10_ExistProb VFC_Cloth10_CurvChange VFC_Cloth10_Curv VFC_Cloth10_PyStdDev VFC_Cloth10_Py VFC_Cloth10_OrientationYaw VFC_Cloth10_Width VFC_Cloth10_Type VFC_Cloth11_LaneAssociation VFC_Cloth11_Colour VFC_Cloth11_RangeXBegin VFC_Cloth11_RangeXEnd VFC_Cloth11_ExistProb VFC_Cloth11_CurvChange VFC_Cloth11_Curv VFC_Cloth11_PyStdDev VFC_Cloth11_Py VFC_Cloth11_OrientationYaw VFC_Cloth11_Width VFC_Cloth11_Type;
SIG_GROUP_ 146 SG_VFC_RoadPolynomial_00_02 1 : VFC_Poly_00_02_CRC VFC_Poly_00_02_AliveCtr VFC_Poly_00_02_ProtBlockCtr VFC_Poly00_LaneAssociation VFC_Poly00_Type VFC_Poly00_ExistProb VFC_Poly00_CoefficientYc3 VFC_Poly00_Colour VFC_Poly00_CoefficientYc2 VFC_Poly00_CoefficientYc0 VFC_Poly00_CoefficientYc1 VFC_Poly00_CoefficientYc2Corr VFC_Poly00_CoefficientYc3Corr VFC_Poly00_Width VFC_Poly00_RangeXCorrectionPoint VFC_Poly00_RangeXBegin VFC_Poly00_Reserved0 VFC_Poly00_RangeXEnd VFC_Poly00_Reserved1 VFC_Poly01_LaneAssociation VFC_Poly01_Type VFC_Poly01_ExistProb VFC_Poly01_CoefficientYc3 VFC_Poly01_Colour VFC_Poly01_CoefficientYc2 VFC_Poly01_CoefficientYc0 VFC_Poly01_CoefficientYc1 VFC_Poly01_CoefficientYc2Corr VFC_Poly01_CoefficientYc3Corr VFC_Poly01_Width VFC_Poly01_RangeXCorrectionPoint VFC_Poly01_RangeXBegin VFC_Poly01_Reserved0 VFC_Poly01_RangeXEnd VFC_Poly01_Reserved1 VFC_Poly02_LaneAssociation VFC_Poly02_Type VFC_Poly02_ExistProb VFC_Poly02_CoefficientYc3 VFC_Poly02_Colour VFC_Poly02_CoefficientYc2 VFC_Poly02_CoefficientYc0 VFC_Poly02_CoefficientYc1 VFC_Poly02_CoefficientYc2Corr VFC_Poly02_CoefficientYc3Corr VFC_Poly02_Width VFC_Poly02_RangeXCorrectionPoint VFC_Poly02_RangeXBegin VFC_Poly02_Reserved0 VFC_Poly02_RangeXEnd VFC_Poly02_Reserved1;
SIG_GROUP_ 147 SG_VFC_RoadPolynomial_03_05 1 : VFC_Poly_03_05_CRC VFC_Poly_03_05_AliveCtr VFC_Poly_03_05_ProtBlockCtr VFC_Poly03_LaneAssociation VFC_Poly03_Type VFC_Poly03_ExistProb VFC_Poly03_CoefficientYc3 VFC_Poly03_Colour VFC_Poly03_CoefficientYc2 VFC_Poly03_CoefficientYc0 VFC_Poly03_CoefficientYc1 VFC_Poly03_CoefficientYc2Corr VFC_Poly03_CoefficientYc3Corr VFC_Poly03_Width VFC_Poly03_RangeXCorrectionPoint VFC_Poly03_RangeXBegin VFC_Poly03_Reserved0 VFC_Poly03_RangeXEnd VFC_Poly03_Reserved1 VFC_Poly04_LaneAssociation VFC_Poly04_Type VFC_Poly04_ExistProb VFC_Poly04_CoefficientYc3 VFC_Poly04_Colour VFC_Poly04_CoefficientYc2 VFC_Poly04_CoefficientYc0 VFC_Poly04_CoefficientYc1 VFC_Poly04_CoefficientYc2Corr VFC_Poly04_CoefficientYc3Corr VFC_Poly04_Width VFC_Poly04_RangeXCorrectionPoint VFC_Poly04_RangeXBegin VFC_Poly04_Reserved0 VFC_Poly04_RangeXEnd VFC_Poly04_Reserved1 VFC_Poly05_LaneAssociation VFC_Poly05_Type VFC_Poly05_ExistProb VFC_Poly05_CoefficientYc3 VFC_Poly05_Colour VFC_Poly05_CoefficientYc2 VFC_Poly05_CoefficientYc0 VFC_Poly05_CoefficientYc1 VFC_Poly05_CoefficientYc2Corr VFC_Poly05_CoefficientYc3Corr VFC_Poly05_Width VFC_Poly05_RangeXCorrectionPoint VFC_Poly05_RangeXBegin VFC_Poly05_Reserved0 VFC_Poly05_RangeXEnd VFC_Poly05_Reserved1;
SIG_GROUP_ 148 SG_VFC_RoadPolynomial_06_08 1 : VFC_Poly_06_08_CRC VFC_Poly_06_08_AliveCtr VFC_Poly_06_08_ProtBlockCtr VFC_Poly06_LaneAssociation VFC_Poly06_Type VFC_Poly06_ExistProb VFC_Poly06_CoefficientYc3 VFC_Poly06_Colour VFC_Poly06_CoefficientYc2 VFC_Poly06_CoefficientYc0 VFC_Poly06_CoefficientYc1 VFC_Poly06_CoefficientYc2Corr VFC_Poly06_CoefficientYc3Corr VFC_Poly06_Width VFC_Poly06_RangeXCorrectionPoint VFC_Poly06_RangeXBegin VFC_Poly06_Reserved0 VFC_Poly06_RangeXEnd VFC_Poly06_Reserved1 VFC_Poly07_LaneAssociation VFC_Poly07_Type VFC_Poly07_ExistProb VFC_Poly07_CoefficientYc3 VFC_Poly07_Colour VFC_Poly07_CoefficientYc2 VFC_Poly07_CoefficientYc0 VFC_Poly07_CoefficientYc1 VFC_Poly07_CoefficientYc2Corr VFC_Poly07_CoefficientYc3Corr VFC_Poly07_Width VFC_Poly07_RangeXCorrectionPoint VFC_Poly07_RangeXBegin VFC_Poly07_Reserved0 VFC_Poly07_RangeXEnd VFC_Poly07_Reserved1 VFC_Poly08_LaneAssociation VFC_Poly08_Type VFC_Poly08_ExistProb VFC_Poly08_CoefficientYc3 VFC_Poly08_Colour VFC_Poly08_CoefficientYc2 VFC_Poly08_CoefficientYc0 VFC_Poly08_CoefficientYc1 VFC_Poly08_CoefficientYc2Corr VFC_Poly08_CoefficientYc3Corr VFC_Poly08_Width VFC_Poly08_RangeXCorrectionPoint VFC_Poly08_RangeXBegin VFC_Poly08_Reserved0 VFC_Poly08_RangeXEnd VFC_Poly08_Reserved1;
SIG_GROUP_ 149 SG_VFC_RoadPolynomial_09_11 1 : VFC_Poly_09_11_CRC VFC_Poly_09_11_AliveCtr VFC_Poly_09_11_ProtBlockCtr VFC_Poly09_LaneAssociation VFC_Poly09_Type VFC_Poly09_ExistProb VFC_Poly09_CoefficientYc3 VFC_Poly09_Colour VFC_Poly09_CoefficientYc2 VFC_Poly09_CoefficientYc0 VFC_Poly09_CoefficientYc1 VFC_Poly09_CoefficientYc2Corr VFC_Poly09_CoefficientYc3Corr VFC_Poly09_Width VFC_Poly09_RangeXCorrectionPoint VFC_Poly09_RangeXBegin VFC_Poly09_Reserved0 VFC_Poly09_RangeXEnd VFC_Poly09_Reserved1 VFC_Poly10_LaneAssociation VFC_Poly10_Type VFC_Poly10_ExistProb VFC_Poly10_CoefficientYc3 VFC_Poly10_Colour VFC_Poly10_CoefficientYc2 VFC_Poly10_CoefficientYc0 VFC_Poly10_CoefficientYc1 VFC_Poly10_CoefficientYc2Corr VFC_Poly10_CoefficientYc3Corr VFC_Poly10_Width VFC_Poly10_RangeXCorrectionPoint VFC_Poly10_RangeXBegin VFC_Poly10_Reserved0 VFC_Poly10_RangeXEnd VFC_Poly10_Reserved1 VFC_Poly11_LaneAssociation VFC_Poly11_Type VFC_Poly11_ExistProb VFC_Poly11_CoefficientYc3 VFC_Poly11_Colour VFC_Poly11_CoefficientYc2 VFC_Poly11_CoefficientYc0 VFC_Poly11_CoefficientYc1 VFC_Poly11_CoefficientYc2Corr VFC_Poly11_CoefficientYc3Corr VFC_Poly11_Width VFC_Poly11_RangeXCorrectionPoint VFC_Poly11_RangeXBegin VFC_Poly11_Reserved0 VFC_Poly11_RangeXEnd VFC_Poly11_Reserved1;
SIG_GROUP_ 162 SG_VFC_Road2DPolynomial_00_02 1 : VFC_2DPoly_00_02_CRC VFC_2DPoly_00_02_AliveCtr VFC_2DPoly_00_02_ProtBlockCtr VFC_2DPoly00_LaneAssociation VFC_2DPoly00_ExistProb VFC_2DPoly00_Type VFC_2DPoly00_CoefficientUc0 VFC_2DPoly00_CoefficientUc1 VFC_2DPoly00_CoefficientUc2 VFC_2DPoly00_CoefficientUc3 VFC_2DPoly00_CoefficientUc4 VFC_2DPoly00_CoefficientUc5 VFC_2DPoly00_RangeVBegin VFC_2DPoly00_RangeVEnd VFC_2DPoly01_LaneAssociation VFC_2DPoly01_ExistProb VFC_2DPoly01_Type VFC_2DPoly01_CoefficientUc0 VFC_2DPoly01_CoefficientUc1 VFC_2DPoly01_CoefficientUc2 VFC_2DPoly01_CoefficientUc3 VFC_2DPoly01_CoefficientUc4 VFC_2DPoly01_CoefficientUc5 VFC_2DPoly01_RangeVBegin VFC_2DPoly01_RangeVEnd VFC_2DPoly02_LaneAssociation VFC_2DPoly02_ExistProb VFC_2DPoly02_Type VFC_2DPoly02_CoefficientUc0 VFC_2DPoly02_CoefficientUc1 VFC_2DPoly02_CoefficientUc2 VFC_2DPoly02_CoefficientUc3 VFC_2DPoly02_CoefficientUc4 VFC_2DPoly02_CoefficientUc5 VFC_2DPoly02_RangeVBegin VFC_2DPoly02_RangeVEnd;
SIG_GROUP_ 163 SG_VFC_Road2DPolynomial_03_05 1 : VFC_2DPoly_03_05_CRC VFC_2DPoly_03_05_AliveCtr VFC_2DPoly_03_05_ProtBlockCtr VFC_2DPoly03_LaneAssociation VFC_2DPoly03_ExistProb VFC_2DPoly03_Type VFC_2DPoly03_CoefficientUc0 VFC_2DPoly03_CoefficientUc1 VFC_2DPoly03_CoefficientUc2 VFC_2DPoly03_CoefficientUc3 VFC_2DPoly03_CoefficientUc4 VFC_2DPoly03_CoefficientUc5 VFC_2DPoly03_RangeVBegin VFC_2DPoly03_RangeVEnd VFC_2DPoly04_LaneAssociation VFC_2DPoly04_ExistProb VFC_2DPoly04_Type VFC_2DPoly04_CoefficientUc0 VFC_2DPoly04_CoefficientUc1 VFC_2DPoly04_CoefficientUc2 VFC_2DPoly04_CoefficientUc3 VFC_2DPoly04_CoefficientUc4 VFC_2DPoly04_CoefficientUc5 VFC_2DPoly04_RangeVBegin VFC_2DPoly04_RangeVEnd VFC_2DPoly05_LaneAssociation VFC_2DPoly05_ExistProb VFC_2DPoly05_Type VFC_2DPoly05_CoefficientUc0 VFC_2DPoly05_CoefficientUc1 VFC_2DPoly05_CoefficientUc2 VFC_2DPoly05_CoefficientUc3 VFC_2DPoly05_CoefficientUc4 VFC_2DPoly05_CoefficientUc5 VFC_2DPoly05_RangeVBegin VFC_2DPoly05_RangeVEnd;
SIG_GROUP_ 164 SG_VFC_Road2DPolynomial_06_08 1 : VFC_2DPoly_06_08_CRC VFC_2DPoly_06_08_AliveCtr VFC_2DPoly_06_08_ProtBlockCtr VFC_2DPoly06_LaneAssociation VFC_2DPoly06_ExistProb VFC_2DPoly06_Type VFC_2DPoly06_CoefficientUc0 VFC_2DPoly06_CoefficientUc1 VFC_2DPoly06_CoefficientUc2 VFC_2DPoly06_CoefficientUc3 VFC_2DPoly06_CoefficientUc4 VFC_2DPoly06_CoefficientUc5 VFC_2DPoly06_RangeVBegin VFC_2DPoly06_RangeVEnd VFC_2DPoly07_LaneAssociation VFC_2DPoly07_ExistProb VFC_2DPoly07_Type VFC_2DPoly07_CoefficientUc0 VFC_2DPoly07_CoefficientUc1 VFC_2DPoly07_CoefficientUc2 VFC_2DPoly07_CoefficientUc3 VFC_2DPoly07_CoefficientUc4 VFC_2DPoly07_CoefficientUc5 VFC_2DPoly07_RangeVBegin VFC_2DPoly07_RangeVEnd VFC_2DPoly08_LaneAssociation VFC_2DPoly08_ExistProb VFC_2DPoly08_Type VFC_2DPoly08_CoefficientUc0 VFC_2DPoly08_CoefficientUc1 VFC_2DPoly08_CoefficientUc2 VFC_2DPoly08_CoefficientUc3 VFC_2DPoly08_CoefficientUc4 VFC_2DPoly08_CoefficientUc5 VFC_2DPoly08_RangeVBegin VFC_2DPoly08_RangeVEnd;
SIG_GROUP_ 165 SG_VFC_Road2DPolynomial_09_11 1 : VFC_2DPoly_09_11_CRC VFC_2DPoly_09_11_AliveCtr VFC_2DPoly_09_11_ProtBlockCtr VFC_2DPoly09_LaneAssociation VFC_2DPoly09_ExistProb VFC_2DPoly09_Type VFC_2DPoly09_CoefficientUc0 VFC_2DPoly09_CoefficientUc1 VFC_2DPoly09_CoefficientUc2 VFC_2DPoly09_CoefficientUc3 VFC_2DPoly09_CoefficientUc4 VFC_2DPoly09_CoefficientUc5 VFC_2DPoly09_RangeVBegin VFC_2DPoly09_RangeVEnd VFC_2DPoly10_LaneAssociation VFC_2DPoly10_ExistProb VFC_2DPoly10_Type VFC_2DPoly10_CoefficientUc0 VFC_2DPoly10_CoefficientUc1 VFC_2DPoly10_CoefficientUc2 VFC_2DPoly10_CoefficientUc3 VFC_2DPoly10_CoefficientUc4 VFC_2DPoly10_CoefficientUc5 VFC_2DPoly10_RangeVBegin VFC_2DPoly10_RangeVEnd VFC_2DPoly11_LaneAssociation VFC_2DPoly11_ExistProb VFC_2DPoly11_Type VFC_2DPoly11_CoefficientUc0 VFC_2DPoly11_CoefficientUc1 VFC_2DPoly11_CoefficientUc2 VFC_2DPoly11_CoefficientUc3 VFC_2DPoly11_CoefficientUc4 VFC_2DPoly11_CoefficientUc5 VFC_2DPoly11_RangeVBegin VFC_2DPoly11_RangeVEnd;
SIG_GROUP_ 178 SG_VFC_RoadMarking_00_06 1 : VFC_RM_00_06_CRC VFC_RM_00_06_AliveCtr VFC_RM_00_06_ProtBlockCtr VFC_RM00_ExistProb VFC_RM00_Type VFC_RM00_VertexPoint00x VFC_RM00_VertexPoint00y VFC_RM00_VertexPoint01x VFC_RM00_VertexPoint01y VFC_RM01_ExistProb VFC_RM01_Type VFC_RM01_VertexPoint00x VFC_RM01_VertexPoint00y VFC_RM01_VertexPoint01x VFC_RM01_VertexPoint01y VFC_RM02_ExistProb VFC_RM02_Type VFC_RM02_VertexPoint00x VFC_RM02_VertexPoint00y VFC_RM02_VertexPoint01x VFC_RM02_VertexPoint01y VFC_RM03_ExistProb VFC_RM03_Type VFC_RM03_VertexPoint00x VFC_RM03_VertexPoint00y VFC_RM03_VertexPoint01x VFC_RM03_VertexPoint01y VFC_RM04_ExistProb VFC_RM04_Type VFC_RM04_VertexPoint00x VFC_RM04_VertexPoint00y VFC_RM04_VertexPoint01x VFC_RM04_VertexPoint01y VFC_RM05_ExistProb VFC_RM05_Type VFC_RM05_VertexPoint00x VFC_RM05_VertexPoint00y VFC_RM05_VertexPoint01x VFC_RM05_VertexPoint01y VFC_RM06_ExistProb VFC_RM06_Type VFC_RM06_VertexPoint00x VFC_RM06_VertexPoint00y VFC_RM06_VertexPoint01x VFC_RM06_VertexPoint01y;
SIG_GROUP_ 224 SG_VFC_TrafficLightHdr 1 : VFC_TLHdr_CRC VFC_TLHdr_AliveCtr VFC_TLHdr_ProtBlockCtr VFC_TLHdr_IfVersionIdMajor VFC_TLHdr_IfVersionIdMinor VFC_TLHdr_NumTrafficLights VFC_TLHdr_TimeStampStatus VFC_TLHdr_TimeStamp VFC_TLHdr_State VFC_TLHdr_MostRelevantTLId VFC_TLHdr_Reserved0 VFC_TLHdr_Reserved1;
SIG_GROUP_ 226 SG_VFC_TrafficLight_00_04 1 : VFC_TL00_04_CRC VFC_TL00_04_AliveCtr VFC_TL00_04_ProtBlockCtr VFC_TL00_Colour VFC_TL00_LightShapeType VFC_TL00_LightModeType VFC_TL00_Py VFC_TL00_ExistProb VFC_TL00_Pz VFC_TL00_2DWidth VFC_TL00_2DHeight VFC_TL00_2DLeftEdge VFC_TL00_2DTopEdge VFC_TL00_Px VFC_TL01_Colour VFC_TL01_LightShapeType VFC_TL01_LightModeType VFC_TL01_Py VFC_TL01_ExistProb VFC_TL01_Pz VFC_TL01_2DWidth VFC_TL01_2DHeight VFC_TL01_2DLeftEdge VFC_TL01_2DTopEdge VFC_TL01_Px VFC_TL02_Colour VFC_TL02_LightShapeType VFC_TL02_LightModeType VFC_TL02_Py VFC_TL02_ExistProb VFC_TL02_Pz VFC_TL02_2DWidth VFC_TL02_2DHeight VFC_TL02_2DLeftEdge VFC_TL02_2DTopEdge VFC_TL02_Px VFC_TL03_Colour VFC_TL03_LightShapeType VFC_TL03_LightModeType VFC_TL03_Py VFC_TL03_ExistProb VFC_TL03_Pz VFC_TL03_2DWidth VFC_TL03_2DHeight VFC_TL03_2DLeftEdge VFC_TL03_2DTopEdge VFC_TL03_Px VFC_TL04_Colour VFC_TL04_LightShapeType VFC_TL04_LightModeType VFC_TL04_Py VFC_TL04_ExistProb VFC_TL04_Pz VFC_TL04_2DWidth VFC_TL04_2DHeight VFC_TL04_2DLeftEdge VFC_TL04_2DTopEdge VFC_TL04_Px;
SIG_GROUP_ 227 SG_VFC_TrafficLight_05_09 1 : VFC_TL05_09_CRC VFC_TL05_09_AliveCtr VFC_TL05_09_ProtBlockCtr VFC_TL05_Colour VFC_TL05_LightShapeType VFC_TL05_LightModeType VFC_TL05_Py VFC_TL05_ExistProb VFC_TL05_Pz VFC_TL05_2DWidth VFC_TL05_2DHeight VFC_TL05_2DLeftEdge VFC_TL05_2DTopEdge VFC_TL05_Px VFC_TL06_Colour VFC_TL06_LightShapeType VFC_TL06_LightModeType VFC_TL06_Py VFC_TL06_ExistProb VFC_TL06_Pz VFC_TL06_2DWidth VFC_TL06_2DHeight VFC_TL06_2DLeftEdge VFC_TL06_2DTopEdge VFC_TL06_Px VFC_TL07_Colour VFC_TL07_LightShapeType VFC_TL07_LightModeType VFC_TL07_Py VFC_TL07_ExistProb VFC_TL07_Pz VFC_TL07_2DWidth VFC_TL07_2DHeight VFC_TL07_2DLeftEdge VFC_TL07_2DTopEdge VFC_TL07_Px VFC_TL08_Colour VFC_TL08_LightShapeType VFC_TL08_LightModeType VFC_TL08_Py VFC_TL08_ExistProb VFC_TL08_Pz VFC_TL08_2DWidth VFC_TL08_2DHeight VFC_TL08_2DLeftEdge VFC_TL08_2DTopEdge VFC_TL08_Px VFC_TL09_Colour VFC_TL09_LightShapeType VFC_TL09_LightModeType VFC_TL09_Py VFC_TL09_ExistProb VFC_TL09_Pz VFC_TL09_2DWidth VFC_TL09_2DHeight VFC_TL09_2DLeftEdge VFC_TL09_2DTopEdge VFC_TL09_Px;
SIG_GROUP_ 236 SG_VFC_TrafficSignHdr 1 : VFC_TSHdr_CRC VFC_TSHdr_AliveCtr VFC_TSHdr_ProtBlockCtr VFC_TSHdr_ProtTrafficSignCount VFC_TSHdr_State VFC_TSHdr_Brightness VFC_TSHdr_Country VFC_TSHdr_TimeStampStatus VFC_TSHdr_TimeStamp VFC_TSHdr_CountryMode;
