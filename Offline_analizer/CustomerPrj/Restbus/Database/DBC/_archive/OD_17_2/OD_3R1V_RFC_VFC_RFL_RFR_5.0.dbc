VERSION "created by canmatrix"

NS_ :

BS_:

BU_: RadarFrontCenter VideoFrontCenter RadarFrontLeft RadarFrontRight ReceiveECU

BO_ 67 VFC_Object13A: 64 VideoFrontCenter
 SG_ VFC_Obj13A_CRC : 0|16@1+ (1,0) [0|65535] ""  RadarFrontCenter
 SG_ VFC_Obj13A_AliveCtr : 16|8@1+ (1,0) [0|255] ""  RadarFrontCenter
 SG_ VFC_Obj13A_ProtBlockCtr : 24|4@1+ (1,0) [0|15] ""  RadarFrontCenter
 SG_ VFC_Obj13A_ID : 32|8@1+ (1,0) [1|255] ""  RadarFrontCenter
 SG_ VFC_Obj13A_AxStdDev : 40|8@1+ (0.1,0) [0|25.5] "m/s^2"  RadarFrontCenter
 SG_ VFC_Obj13A_Dx : 48|12@1+ (0.05,0) [0|204.75] "m"  RadarFrontCenter
 SG_ VFC_Obj13A_Type : 60|4@1+ (1,0) [0|15] ""  RadarFrontCenter
 SG_ VFC_Obj13A_Dy : 64|14@1+ (0.01,-80) [-80|80] "m"  RadarFrontCenter
 SG_ VFC_Obj13A_Measured : 78|2@1+ (1,0) [0|3] ""  RadarFrontCenter
 SG_ VFC_Obj13A_Vx : 80|11@1+ (0.1,-154) [-154|50] "m/s"  RadarFrontCenter
 SG_ VFC_Obj13A_MeasSource : 91|5@1+ (1,0) [0|31] ""  RadarFrontCenter
 SG_ VFC_Obj13A_Vy : 96|10@1+ (0.1,-50) [-50|50] "m/s"  RadarFrontCenter
 SG_ VFC_Obj13A_DirIndicator : 106|3@1+ (1,0) [0|4] ""  RadarFrontCenter
 SG_ VFC_Obj13A_BrakeLight : 109|3@1+ (1,0) [0|7] ""  RadarFrontCenter
 SG_ VFC_Obj13A_Ax : 112|9@1+ (0.1,-16) [-16|16] "m/s^2"  RadarFrontCenter
 SG_ VFC_Obj13A_CompletelyInImg : 121|1@1+ (1,0) [0|1] ""  RadarFrontCenter
 SG_ VFC_Obj13A_ProbExist : 122|6@1+ (2,0) [0|100] "%"  RadarFrontCenter
 SG_ VFC_Obj13A_Ay : 128|8@1+ (0.1,-12) [-12|12] "m/s^2"  RadarFrontCenter
 SG_ VFC_Obj13A_AyStdDev : 136|8@1+ (0.1,0) [0|25.5] "m/s^2"  RadarFrontCenter
 SG_ VFC_Obj13A_DxStdDev : 144|10@1+ (0.05,0) [0|51.15] "m"  RadarFrontCenter
 SG_ VFC_Obj13A_ProbMovingLat : 154|6@1+ (2,0) [0|100] "%"  RadarFrontCenter
 SG_ VFC_Obj13A_DyStdDev : 160|10@1+ (0.02,0) [0|20.46] "m"  RadarFrontCenter
 SG_ VFC_Obj13A_ProbMovingLong : 170|6@1+ (2,0) [0|100] "%"  RadarFrontCenter
 SG_ VFC_Obj13A_VxStdDev : 176|10@1+ (0.1,0) [0|102.3] "m/s"  RadarFrontCenter
 SG_ VFC_Obj13A_HeadingAngleStdDev : 186|6@1+ (0.01,0) [0|0.5] "rad"  RadarFrontCenter
 SG_ VFC_Obj13A_VyStdDev : 192|9@1+ (0.1,0) [0|51.1] "m/s"  RadarFrontCenter
 SG_ VFC_Obj13A_HeightStdDev : 201|7@1+ (0.01,0) [0|1] "m"  RadarFrontCenter
 SG_ VFC_Obj13A_Height : 208|9@1+ (0.01,0) [0|5.11] "m"  RadarFrontCenter
 SG_ VFC_Obj13A_Length : 217|9@1+ (0.05,0) [0|25.55] "m"  RadarFrontCenter
 SG_ VFC_Obj13A_HeadingAngle : 226|9@1+ (0.01,-1.57) [-1.57|1.57] "rad"  RadarFrontCenter
 SG_ VFC_Obj13A_NormAx : 235|13@1+ (0.002,-10) [-10|6] "1/s^2"  RadarFrontCenter
 SG_ VFC_Obj13A_NormVyEdgeLeftStdDev : 248|8@1+ (0.001,0) [0|0.255] "1/s"  RadarFrontCenter
 SG_ VFC_Obj13A_NormVyEdgeLeft : 256|13@1+ (0.001,-4) [-4|4] "1/s"  RadarFrontCenter
 SG_ VFC_Obj13A_EdgeBottom : 269|12@1+ (0.00025,-0.5) [-0.5|0.5] "unitless"  RadarFrontCenter
 SG_ VFC_Obj13A_NormVyEdgeRight : 281|13@1+ (0.001,-4) [-4|4] "1/s"  RadarFrontCenter
 SG_ VFC_Obj13A_Width : 294|10@1+ (0.01,0) [0|10.23] "m"  RadarFrontCenter
 SG_ VFC_Obj13A_NormVx : 304|16@1+ (0.001,-40) [-40|25] "1/s"  RadarFrontCenter
 SG_ VFC_Obj13A_NormVyEdgeRightStdDev : 320|8@1+ (0.001,0) [0|0.255] "1/s"  RadarFrontCenter
 SG_ VFC_Obj13A_NormAxStdDev : 328|10@1+ (0.0025,0) [0|2.5575] "1/s^2"  RadarFrontCenter
 SG_ VFC_Obj13A_ScaleChange : 338|14@1+ (0.0001,0.5) [0.5|2.1383] "unitless"  RadarFrontCenter
 SG_ VFC_Obj13A_ScaleChngStdDev : 352|10@1+ (0.0001,0) [0|0.1023] "unitless"  RadarFrontCenter
 SG_ VFC_Obj13A_Reliability : 362|6@1+ (1,0) [0|63] ""  RadarFrontCenter
 SG_ VFC_Obj13A_NormVxStdDev : 368|10@1+ (0.001,0) [0|1.023] "1/s"  RadarFrontCenter
 SG_ VFC_Obj13A_TypeProb : 378|6@1+ (2,0) [0|100] "%"  RadarFrontCenter
 SG_ VFC_Obj13A_LengthStdDev : 384|7@1+ (0.05,0) [0|5] "m"  RadarFrontCenter
 SG_ VFC_Obj13A_WidthStdDev : 391|7@1+ (0.01,0) [0|1] "m"  RadarFrontCenter
 SG_ VFC_Obj13A_EdgeMid : 398|13@1+ (0.00025,-1) [-1|1] "unitless"  RadarFrontCenter
 SG_ VFC_Obj13A_EdgeLeft : 411|13@1+ (0.00025,-1) [-1|1] "unitless"  RadarFrontCenter
 SG_ VFC_Obj13A_EdgeRight : 424|13@1+ (0.00025,-1) [-1|1] "unitless"  RadarFrontCenter
 SG_ VFC_Obj13A_VisibleView : 437|3@1+ (1,0) [0|4] ""  RadarFrontCenter
 SG_ VFC_Obj13A_EdgeLeftStdDev : 440|8@1+ (0.0002,0) [0|0.051] "unitless"  RadarFrontCenter
 SG_ VFC_Obj13A_EdgeTop : 448|12@1+ (0.00025,-0.5) [-0.5|0.5] "unitless"  RadarFrontCenter
 SG_ VFC_Obj13A_HeadOrientation : 460|4@1+ (1,0) [0|15] ""  RadarFrontCenter
 SG_ VFC_Obj13A_EdgeMidStdDev : 464|8@1+ (0.0002,0) [0|0.051] "unitless"  RadarFrontCenter
 SG_ VFC_Obj13A_EdgeRightStdDev : 472|8@1+ (0.0002,0) [0|0.051] "unitless"  RadarFrontCenter
 SG_ VFC_Obj13A_EdgeTopStdDev : 480|8@1+ (0.0002,0) [0|0.051] "unitless"  RadarFrontCenter
 SG_ VFC_Obj13A_EdgeBottomStdDev : 488|8@1+ (0.0002,0) [0|0.051] "unitless"  RadarFrontCenter
 SG_ VFC_Obj13A_ClassifiedView : 496|3@1+ (1,0) [0|4] ""  RadarFrontCenter

BO_ 68 VFC_Object14A: 64 VideoFrontCenter
 SG_ VFC_Obj14A_CRC : 0|16@1+ (1,0) [0|65535] ""  RadarFrontCenter
 SG_ VFC_Obj14A_AliveCtr : 16|8@1+ (1,0) [0|255] ""  RadarFrontCenter
 SG_ VFC_Obj14A_ProtBlockCtr : 24|4@1+ (1,0) [0|15] ""  RadarFrontCenter
 SG_ VFC_Obj14A_ID : 32|8@1+ (1,0) [1|255] ""  RadarFrontCenter
 SG_ VFC_Obj14A_AxStdDev : 40|8@1+ (0.1,0) [0|25.5] "m/s^2"  RadarFrontCenter
 SG_ VFC_Obj14A_Dx : 48|12@1+ (0.05,0) [0|204.75] "m"  RadarFrontCenter
 SG_ VFC_Obj14A_Type : 60|4@1+ (1,0) [0|15] ""  RadarFrontCenter
 SG_ VFC_Obj14A_Dy : 64|14@1+ (0.01,-80) [-80|80] "m"  RadarFrontCenter
 SG_ VFC_Obj14A_Measured : 78|2@1+ (1,0) [0|3] ""  RadarFrontCenter
 SG_ VFC_Obj14A_Vx : 80|11@1+ (0.1,-154) [-154|50] "m/s"  RadarFrontCenter
 SG_ VFC_Obj14A_MeasSource : 91|5@1+ (1,0) [0|31] ""  RadarFrontCenter
 SG_ VFC_Obj14A_Vy : 96|10@1+ (0.1,-50) [-50|50] "m/s"  RadarFrontCenter
 SG_ VFC_Obj14A_DirIndicator : 106|3@1+ (1,0) [0|4] ""  RadarFrontCenter
 SG_ VFC_Obj14A_BrakeLight : 109|3@1+ (1,0) [0|7] ""  RadarFrontCenter
 SG_ VFC_Obj14A_Ax : 112|9@1+ (0.1,-16) [-16|16] "m/s^2"  RadarFrontCenter
 SG_ VFC_Obj14A_CompletelyInImg : 121|1@1+ (1,0) [0|1] ""  RadarFrontCenter
 SG_ VFC_Obj14A_ProbExist : 122|6@1+ (2,0) [0|100] "%"  RadarFrontCenter
 SG_ VFC_Obj14A_Ay : 128|8@1+ (0.1,-12) [-12|12] "m/s^2"  RadarFrontCenter
 SG_ VFC_Obj14A_AyStdDev : 136|8@1+ (0.1,0) [0|25.5] "m/s^2"  RadarFrontCenter
 SG_ VFC_Obj14A_DxStdDev : 144|10@1+ (0.05,0) [0|51.15] "m"  RadarFrontCenter
 SG_ VFC_Obj14A_ProbMovingLat : 154|6@1+ (2,0) [0|100] "%"  RadarFrontCenter
 SG_ VFC_Obj14A_DyStdDev : 160|10@1+ (0.02,0) [0|20.46] "m"  RadarFrontCenter
 SG_ VFC_Obj14A_ProbMovingLong : 170|6@1+ (2,0) [0|100] "%"  RadarFrontCenter
 SG_ VFC_Obj14A_VxStdDev : 176|10@1+ (0.1,0) [0|102.3] "m/s"  RadarFrontCenter
 SG_ VFC_Obj14A_HeadingAngleStdDev : 186|6@1+ (0.01,0) [0|0.5] "rad"  RadarFrontCenter
 SG_ VFC_Obj14A_VyStdDev : 192|9@1+ (0.1,0) [0|51.1] "m/s"  RadarFrontCenter
 SG_ VFC_Obj14A_HeightStdDev : 201|7@1+ (0.01,0) [0|1] "m"  RadarFrontCenter
 SG_ VFC_Obj14A_Height : 208|9@1+ (0.01,0) [0|5.11] "m"  RadarFrontCenter
 SG_ VFC_Obj14A_Length : 217|9@1+ (0.05,0) [0|25.55] "m"  RadarFrontCenter
 SG_ VFC_Obj14A_HeadingAngle : 226|9@1+ (0.01,-1.57) [-1.57|1.57] "rad"  RadarFrontCenter
 SG_ VFC_Obj14A_NormAx : 235|13@1+ (0.002,-10) [-10|6] "1/s^2"  RadarFrontCenter
 SG_ VFC_Obj14A_NormVyEdgeLeftStdDev : 248|8@1+ (0.001,0) [0|0.255] "1/s"  RadarFrontCenter
 SG_ VFC_Obj14A_NormVyEdgeLeft : 256|13@1+ (0.001,-4) [-4|4] "1/s"  RadarFrontCenter
 SG_ VFC_Obj14A_EdgeBottom : 269|12@1+ (0.00025,-0.5) [-0.5|0.5] "unitless"  RadarFrontCenter
 SG_ VFC_Obj14A_NormVyEdgeRight : 281|13@1+ (0.001,-4) [-4|4] "1/s"  RadarFrontCenter
 SG_ VFC_Obj14A_Width : 294|10@1+ (0.01,0) [0|10.23] "m"  RadarFrontCenter
 SG_ VFC_Obj14A_NormVx : 304|16@1+ (0.001,-40) [-40|25] "1/s"  RadarFrontCenter
 SG_ VFC_Obj14A_NormVyEdgeRightStdDev : 320|8@1+ (0.001,0) [0|0.255] "1/s"  RadarFrontCenter
 SG_ VFC_Obj14A_NormAxStdDev : 328|10@1+ (0.0025,0) [0|2.5575] "1/s^2"  RadarFrontCenter
 SG_ VFC_Obj14A_ScaleChange : 338|14@1+ (0.0001,0.5) [0.5|2.1383] "unitless"  RadarFrontCenter
 SG_ VFC_Obj14A_ScaleChngStdDev : 352|10@1+ (0.0001,0) [0|0.1023] "unitless"  RadarFrontCenter
 SG_ VFC_Obj14A_Reliability : 362|6@1+ (1,0) [0|63] ""  RadarFrontCenter
 SG_ VFC_Obj14A_NormVxStdDev : 368|10@1+ (0.001,0) [0|1.023] "1/s"  RadarFrontCenter
 SG_ VFC_Obj14A_TypeProb : 378|6@1+ (2,0) [0|100] "%"  RadarFrontCenter
 SG_ VFC_Obj14A_LengthStdDev : 384|7@1+ (0.05,0) [0|5] "m"  RadarFrontCenter
 SG_ VFC_Obj14A_WidthStdDev : 391|7@1+ (0.01,0) [0|1] "m"  RadarFrontCenter
 SG_ VFC_Obj14A_EdgeMid : 398|13@1+ (0.00025,-1) [-1|1] "unitless"  RadarFrontCenter
 SG_ VFC_Obj14A_EdgeLeft : 411|13@1+ (0.00025,-1) [-1|1] "unitless"  RadarFrontCenter
 SG_ VFC_Obj14A_EdgeRight : 424|13@1+ (0.00025,-1) [-1|1] "unitless"  RadarFrontCenter
 SG_ VFC_Obj14A_VisibleView : 437|3@1+ (1,0) [0|4] ""  RadarFrontCenter
 SG_ VFC_Obj14A_EdgeLeftStdDev : 440|8@1+ (0.0002,0) [0|0.051] "unitless"  RadarFrontCenter
 SG_ VFC_Obj14A_EdgeTop : 448|12@1+ (0.00025,-0.5) [-0.5|0.5] "unitless"  RadarFrontCenter
 SG_ VFC_Obj14A_HeadOrientation : 460|4@1+ (1,0) [0|15] ""  RadarFrontCenter
 SG_ VFC_Obj14A_EdgeMidStdDev : 464|8@1+ (0.0002,0) [0|0.051] "unitless"  RadarFrontCenter
 SG_ VFC_Obj14A_EdgeRightStdDev : 472|8@1+ (0.0002,0) [0|0.051] "unitless"  RadarFrontCenter
 SG_ VFC_Obj14A_EdgeTopStdDev : 480|8@1+ (0.0002,0) [0|0.051] "unitless"  RadarFrontCenter
 SG_ VFC_Obj14A_EdgeBottomStdDev : 488|8@1+ (0.0002,0) [0|0.051] "unitless"  RadarFrontCenter
 SG_ VFC_Obj14A_ClassifiedView : 496|3@1+ (1,0) [0|4] ""  RadarFrontCenter

BO_ 69 VFC_Object15A: 64 VideoFrontCenter
 SG_ VFC_Obj15A_CRC : 0|16@1+ (1,0) [0|65535] ""  RadarFrontCenter
 SG_ VFC_Obj15A_AliveCtr : 16|8@1+ (1,0) [0|255] ""  RadarFrontCenter
 SG_ VFC_Obj15A_ProtBlockCtr : 24|4@1+ (1,0) [0|15] ""  RadarFrontCenter
 SG_ VFC_Obj15A_ID : 32|8@1+ (1,0) [1|255] ""  RadarFrontCenter
 SG_ VFC_Obj15A_AxStdDev : 40|8@1+ (0.1,0) [0|25.5] "m/s^2"  RadarFrontCenter
 SG_ VFC_Obj15A_Dx : 48|12@1+ (0.05,0) [0|204.75] "m"  RadarFrontCenter
 SG_ VFC_Obj15A_Type : 60|4@1+ (1,0) [0|15] ""  RadarFrontCenter
 SG_ VFC_Obj15A_Dy : 64|14@1+ (0.01,-80) [-80|80] "m"  RadarFrontCenter
 SG_ VFC_Obj15A_Measured : 78|2@1+ (1,0) [0|3] ""  RadarFrontCenter
 SG_ VFC_Obj15A_Vx : 80|11@1+ (0.1,-154) [-154|50] "m/s"  RadarFrontCenter
 SG_ VFC_Obj15A_MeasSource : 91|5@1+ (1,0) [0|31] ""  RadarFrontCenter
 SG_ VFC_Obj15A_Vy : 96|10@1+ (0.1,-50) [-50|50] "m/s"  RadarFrontCenter
 SG_ VFC_Obj15A_DirIndicator : 106|3@1+ (1,0) [0|4] ""  RadarFrontCenter
 SG_ VFC_Obj15A_BrakeLight : 109|3@1+ (1,0) [0|7] ""  RadarFrontCenter
 SG_ VFC_Obj15A_Ax : 112|9@1+ (0.1,-16) [-16|16] "m/s^2"  RadarFrontCenter
 SG_ VFC_Obj15A_CompletelyInImg : 121|1@1+ (1,0) [0|1] ""  RadarFrontCenter
 SG_ VFC_Obj15A_ProbExist : 122|6@1+ (2,0) [0|100] "%"  RadarFrontCenter
 SG_ VFC_Obj15A_Ay : 128|8@1+ (0.1,-12) [-12|12] "m/s^2"  RadarFrontCenter
 SG_ VFC_Obj15A_AyStdDev : 136|8@1+ (0.1,0) [0|25.5] "m/s^2"  RadarFrontCenter
 SG_ VFC_Obj15A_DxStdDev : 144|10@1+ (0.05,0) [0|51.15] "m"  RadarFrontCenter
 SG_ VFC_Obj15A_ProbMovingLat : 154|6@1+ (2,0) [0|100] "%"  RadarFrontCenter
 SG_ VFC_Obj15A_DyStdDev : 160|10@1+ (0.02,0) [0|20.46] "m"  RadarFrontCenter
 SG_ VFC_Obj15A_ProbMovingLong : 170|6@1+ (2,0) [0|100] "%"  RadarFrontCenter
 SG_ VFC_Obj15A_VxStdDev : 176|10@1+ (0.1,0) [0|102.3] "m/s"  RadarFrontCenter
 SG_ VFC_Obj15A_HeadingAngleStdDev : 186|6@1+ (0.01,0) [0|0.5] "rad"  RadarFrontCenter
 SG_ VFC_Obj15A_VyStdDev : 192|9@1+ (0.1,0) [0|51.1] "m/s"  RadarFrontCenter
 SG_ VFC_Obj15A_HeightStdDev : 201|7@1+ (0.01,0) [0|1] "m"  RadarFrontCenter
 SG_ VFC_Obj15A_Height : 208|9@1+ (0.01,0) [0|5.11] "m"  RadarFrontCenter
 SG_ VFC_Obj15A_Length : 217|9@1+ (0.05,0) [0|25.55] "m"  RadarFrontCenter
 SG_ VFC_Obj15A_HeadingAngle : 226|9@1+ (0.01,-1.57) [-1.57|1.57] "rad"  RadarFrontCenter
 SG_ VFC_Obj15A_NormAx : 235|13@1+ (0.002,-10) [-10|6] "1/s^2"  RadarFrontCenter
 SG_ VFC_Obj15A_NormVyEdgeLeftStdDev : 248|8@1+ (0.001,0) [0|0.255] "1/s"  RadarFrontCenter
 SG_ VFC_Obj15A_NormVyEdgeLeft : 256|13@1+ (0.001,-4) [-4|4] "1/s"  RadarFrontCenter
 SG_ VFC_Obj15A_EdgeBottom : 269|12@1+ (0.00025,-0.5) [-0.5|0.5] "unitless"  RadarFrontCenter
 SG_ VFC_Obj15A_NormVyEdgeRight : 281|13@1+ (0.001,-4) [-4|4] "1/s"  RadarFrontCenter
 SG_ VFC_Obj15A_Width : 294|10@1+ (0.01,0) [0|10.23] "m"  RadarFrontCenter
 SG_ VFC_Obj15A_NormVx : 304|16@1+ (0.001,-40) [-40|25] "1/s"  RadarFrontCenter
 SG_ VFC_Obj15A_NormVyEdgeRightStdDev : 320|8@1+ (0.001,0) [0|0.255] "1/s"  RadarFrontCenter
 SG_ VFC_Obj15A_NormAxStdDev : 328|10@1+ (0.0025,0) [0|2.5575] "1/s^2"  RadarFrontCenter
 SG_ VFC_Obj15A_ScaleChange : 338|14@1+ (0.0001,0.5) [0.5|2.1383] "unitless"  RadarFrontCenter
 SG_ VFC_Obj15A_ScaleChngStdDev : 352|10@1+ (0.0001,0) [0|0.1023] "unitless"  RadarFrontCenter
 SG_ VFC_Obj15A_Reliability : 362|6@1+ (1,0) [0|63] ""  RadarFrontCenter
 SG_ VFC_Obj15A_NormVxStdDev : 368|10@1+ (0.001,0) [0|1.023] "1/s"  RadarFrontCenter
 SG_ VFC_Obj15A_TypeProb : 378|6@1+ (2,0) [0|100] "%"  RadarFrontCenter
 SG_ VFC_Obj15A_LengthStdDev : 384|7@1+ (0.05,0) [0|5] "m"  RadarFrontCenter
 SG_ VFC_Obj15A_WidthStdDev : 391|7@1+ (0.01,0) [0|1] "m"  RadarFrontCenter
 SG_ VFC_Obj15A_EdgeMid : 398|13@1+ (0.00025,-1) [-1|1] "unitless"  RadarFrontCenter
 SG_ VFC_Obj15A_EdgeLeft : 411|13@1+ (0.00025,-1) [-1|1] "unitless"  RadarFrontCenter
 SG_ VFC_Obj15A_EdgeRight : 424|13@1+ (0.00025,-1) [-1|1] "unitless"  RadarFrontCenter
 SG_ VFC_Obj15A_VisibleView : 437|3@1+ (1,0) [0|4] ""  RadarFrontCenter
 SG_ VFC_Obj15A_EdgeLeftStdDev : 440|8@1+ (0.0002,0) [0|0.051] "unitless"  RadarFrontCenter
 SG_ VFC_Obj15A_EdgeTop : 448|12@1+ (0.00025,-0.5) [-0.5|0.5] "unitless"  RadarFrontCenter
 SG_ VFC_Obj15A_HeadOrientation : 460|4@1+ (1,0) [0|15] ""  RadarFrontCenter
 SG_ VFC_Obj15A_EdgeMidStdDev : 464|8@1+ (0.0002,0) [0|0.051] "unitless"  RadarFrontCenter
 SG_ VFC_Obj15A_EdgeRightStdDev : 472|8@1+ (0.0002,0) [0|0.051] "unitless"  RadarFrontCenter
 SG_ VFC_Obj15A_EdgeTopStdDev : 480|8@1+ (0.0002,0) [0|0.051] "unitless"  RadarFrontCenter
 SG_ VFC_Obj15A_EdgeBottomStdDev : 488|8@1+ (0.0002,0) [0|0.051] "unitless"  RadarFrontCenter
 SG_ VFC_Obj15A_ClassifiedView : 496|3@1+ (1,0) [0|4] ""  RadarFrontCenter

BO_ 70 VFC_Object16A: 64 VideoFrontCenter
 SG_ VFC_Obj16A_CRC : 0|16@1+ (1,0) [0|65535] ""  RadarFrontCenter
 SG_ VFC_Obj16A_AliveCtr : 16|8@1+ (1,0) [0|255] ""  RadarFrontCenter
 SG_ VFC_Obj16A_ProtBlockCtr : 24|4@1+ (1,0) [0|15] ""  RadarFrontCenter
 SG_ VFC_Obj16A_ID : 32|8@1+ (1,0) [1|255] ""  RadarFrontCenter
 SG_ VFC_Obj16A_AxStdDev : 40|8@1+ (0.1,0) [0|25.5] "m/s^2"  RadarFrontCenter
 SG_ VFC_Obj16A_Dx : 48|12@1+ (0.05,0) [0|204.75] "m"  RadarFrontCenter
 SG_ VFC_Obj16A_Type : 60|4@1+ (1,0) [0|15] ""  RadarFrontCenter
 SG_ VFC_Obj16A_Dy : 64|14@1+ (0.01,-80) [-80|80] "m"  RadarFrontCenter
 SG_ VFC_Obj16A_Measured : 78|2@1+ (1,0) [0|3] ""  RadarFrontCenter
 SG_ VFC_Obj16A_Vx : 80|11@1+ (0.1,-154) [-154|50] "m/s"  RadarFrontCenter
 SG_ VFC_Obj16A_MeasSource : 91|5@1+ (1,0) [0|31] ""  RadarFrontCenter
 SG_ VFC_Obj16A_Vy : 96|10@1+ (0.1,-50) [-50|50] "m/s"  RadarFrontCenter
 SG_ VFC_Obj16A_DirIndicator : 106|3@1+ (1,0) [0|4] ""  RadarFrontCenter
 SG_ VFC_Obj16A_BrakeLight : 109|3@1+ (1,0) [0|7] ""  RadarFrontCenter
 SG_ VFC_Obj16A_Ax : 112|9@1+ (0.1,-16) [-16|16] "m/s^2"  RadarFrontCenter
 SG_ VFC_Obj16A_CompletelyInImg : 121|1@1+ (1,0) [0|1] ""  RadarFrontCenter
 SG_ VFC_Obj16A_ProbExist : 122|6@1+ (2,0) [0|100] "%"  RadarFrontCenter
 SG_ VFC_Obj16A_Ay : 128|8@1+ (0.1,-12) [-12|12] "m/s^2"  RadarFrontCenter
 SG_ VFC_Obj16A_AyStdDev : 136|8@1+ (0.1,0) [0|25.5] "m/s^2"  RadarFrontCenter
 SG_ VFC_Obj16A_DxStdDev : 144|10@1+ (0.05,0) [0|51.15] "m"  RadarFrontCenter
 SG_ VFC_Obj16A_ProbMovingLat : 154|6@1+ (2,0) [0|100] "%"  RadarFrontCenter
 SG_ VFC_Obj16A_DyStdDev : 160|10@1+ (0.02,0) [0|20.46] "m"  RadarFrontCenter
 SG_ VFC_Obj16A_ProbMovingLong : 170|6@1+ (2,0) [0|100] "%"  RadarFrontCenter
 SG_ VFC_Obj16A_VxStdDev : 176|10@1+ (0.1,0) [0|102.3] "m/s"  RadarFrontCenter
 SG_ VFC_Obj16A_HeadingAngleStdDev : 186|6@1+ (0.01,0) [0|0.5] "rad"  RadarFrontCenter
 SG_ VFC_Obj16A_VyStdDev : 192|9@1+ (0.1,0) [0|51.1] "m/s"  RadarFrontCenter
 SG_ VFC_Obj16A_HeightStdDev : 201|7@1+ (0.01,0) [0|1] "m"  RadarFrontCenter
 SG_ VFC_Obj16A_Height : 208|9@1+ (0.01,0) [0|5.11] "m"  RadarFrontCenter
 SG_ VFC_Obj16A_Length : 217|9@1+ (0.05,0) [0|25.55] "m"  RadarFrontCenter
 SG_ VFC_Obj16A_HeadingAngle : 226|9@1+ (0.01,-1.57) [-1.57|1.57] "rad"  RadarFrontCenter
 SG_ VFC_Obj16A_NormAx : 235|13@1+ (0.002,-10) [-10|6] "1/s^2"  RadarFrontCenter
 SG_ VFC_Obj16A_NormVyEdgeLeftStdDev : 248|8@1+ (0.001,0) [0|0.255] "1/s"  RadarFrontCenter
 SG_ VFC_Obj16A_NormVyEdgeLeft : 256|13@1+ (0.001,-4) [-4|4] "1/s"  RadarFrontCenter
 SG_ VFC_Obj16A_EdgeBottom : 269|12@1+ (0.00025,-0.5) [-0.5|0.5] "unitless"  RadarFrontCenter
 SG_ VFC_Obj16A_NormVyEdgeRight : 281|13@1+ (0.001,-4) [-4|4] "1/s"  RadarFrontCenter
 SG_ VFC_Obj16A_Width : 294|10@1+ (0.01,0) [0|10.23] "m"  RadarFrontCenter
 SG_ VFC_Obj16A_NormVx : 304|16@1+ (0.001,-40) [-40|25] "1/s"  RadarFrontCenter
 SG_ VFC_Obj16A_NormVyEdgeRightStdDev : 320|8@1+ (0.001,0) [0|0.255] "1/s"  RadarFrontCenter
 SG_ VFC_Obj16A_NormAxStdDev : 328|10@1+ (0.0025,0) [0|2.5575] "1/s^2"  RadarFrontCenter
 SG_ VFC_Obj16A_ScaleChange : 338|14@1+ (0.0001,0.5) [0.5|2.1383] "unitless"  RadarFrontCenter
 SG_ VFC_Obj16A_ScaleChngStdDev : 352|10@1+ (0.0001,0) [0|0.1023] "unitless"  RadarFrontCenter
 SG_ VFC_Obj16A_Reliability : 362|6@1+ (1,0) [0|63] ""  RadarFrontCenter
 SG_ VFC_Obj16A_NormVxStdDev : 368|10@1+ (0.001,0) [0|1.023] "1/s"  RadarFrontCenter
 SG_ VFC_Obj16A_TypeProb : 378|6@1+ (2,0) [0|100] "%"  RadarFrontCenter
 SG_ VFC_Obj16A_LengthStdDev : 384|7@1+ (0.05,0) [0|5] "m"  RadarFrontCenter
 SG_ VFC_Obj16A_WidthStdDev : 391|7@1+ (0.01,0) [0|1] "m"  RadarFrontCenter
 SG_ VFC_Obj16A_EdgeMid : 398|13@1+ (0.00025,-1) [-1|1] "unitless"  RadarFrontCenter
 SG_ VFC_Obj16A_EdgeLeft : 411|13@1+ (0.00025,-1) [-1|1] "unitless"  RadarFrontCenter
 SG_ VFC_Obj16A_EdgeRight : 424|13@1+ (0.00025,-1) [-1|1] "unitless"  RadarFrontCenter
 SG_ VFC_Obj16A_VisibleView : 437|3@1+ (1,0) [0|4] ""  RadarFrontCenter
 SG_ VFC_Obj16A_EdgeLeftStdDev : 440|8@1+ (0.0002,0) [0|0.051] "unitless"  RadarFrontCenter
 SG_ VFC_Obj16A_EdgeTop : 448|12@1+ (0.00025,-0.5) [-0.5|0.5] "unitless"  RadarFrontCenter
 SG_ VFC_Obj16A_HeadOrientation : 460|4@1+ (1,0) [0|15] ""  RadarFrontCenter
 SG_ VFC_Obj16A_EdgeMidStdDev : 464|8@1+ (0.0002,0) [0|0.051] "unitless"  RadarFrontCenter
 SG_ VFC_Obj16A_EdgeRightStdDev : 472|8@1+ (0.0002,0) [0|0.051] "unitless"  RadarFrontCenter
 SG_ VFC_Obj16A_EdgeTopStdDev : 480|8@1+ (0.0002,0) [0|0.051] "unitless"  RadarFrontCenter
 SG_ VFC_Obj16A_EdgeBottomStdDev : 488|8@1+ (0.0002,0) [0|0.051] "unitless"  RadarFrontCenter
 SG_ VFC_Obj16A_ClassifiedView : 496|3@1+ (1,0) [0|4] ""  RadarFrontCenter

BO_ 71 VFC_Object17A: 64 VideoFrontCenter
 SG_ VFC_Obj17A_CRC : 0|16@1+ (1,0) [0|65535] ""  RadarFrontCenter
 SG_ VFC_Obj17A_AliveCtr : 16|8@1+ (1,0) [0|255] ""  RadarFrontCenter
 SG_ VFC_Obj17A_ProtBlockCtr : 24|4@1+ (1,0) [0|15] ""  RadarFrontCenter
 SG_ VFC_Obj17A_ID : 32|8@1+ (1,0) [1|255] ""  RadarFrontCenter
 SG_ VFC_Obj17A_AxStdDev : 40|8@1+ (0.1,0) [0|25.5] "m/s^2"  RadarFrontCenter
 SG_ VFC_Obj17A_Dx : 48|12@1+ (0.05,0) [0|204.75] "m"  RadarFrontCenter
 SG_ VFC_Obj17A_Type : 60|4@1+ (1,0) [0|15] ""  RadarFrontCenter
 SG_ VFC_Obj17A_Dy : 64|14@1+ (0.01,-80) [-80|80] "m"  RadarFrontCenter
 SG_ VFC_Obj17A_Measured : 78|2@1+ (1,0) [0|3] ""  RadarFrontCenter
 SG_ VFC_Obj17A_Vx : 80|11@1+ (0.1,-154) [-154|50] "m/s"  RadarFrontCenter
 SG_ VFC_Obj17A_MeasSource : 91|5@1+ (1,0) [0|31] ""  RadarFrontCenter
 SG_ VFC_Obj17A_Vy : 96|10@1+ (0.1,-50) [-50|50] "m/s"  RadarFrontCenter
 SG_ VFC_Obj17A_DirIndicator : 106|3@1+ (1,0) [0|4] ""  RadarFrontCenter
 SG_ VFC_Obj17A_BrakeLight : 109|3@1+ (1,0) [0|7] ""  RadarFrontCenter
 SG_ VFC_Obj17A_Ax : 112|9@1+ (0.1,-16) [-16|16] "m/s^2"  RadarFrontCenter
 SG_ VFC_Obj17A_CompletelyInImg : 121|1@1+ (1,0) [0|1] ""  RadarFrontCenter
 SG_ VFC_Obj17A_ProbExist : 122|6@1+ (2,0) [0|100] "%"  RadarFrontCenter
 SG_ VFC_Obj17A_Ay : 128|8@1+ (0.1,-12) [-12|12] "m/s^2"  RadarFrontCenter
 SG_ VFC_Obj17A_AyStdDev : 136|8@1+ (0.1,0) [0|25.5] "m/s^2"  RadarFrontCenter
 SG_ VFC_Obj17A_DxStdDev : 144|10@1+ (0.05,0) [0|51.15] "m"  RadarFrontCenter
 SG_ VFC_Obj17A_ProbMovingLat : 154|6@1+ (2,0) [0|100] "%"  RadarFrontCenter
 SG_ VFC_Obj17A_DyStdDev : 160|10@1+ (0.02,0) [0|20.46] "m"  RadarFrontCenter
 SG_ VFC_Obj17A_ProbMovingLong : 170|6@1+ (2,0) [0|100] "%"  RadarFrontCenter
 SG_ VFC_Obj17A_VxStdDev : 176|10@1+ (0.1,0) [0|102.3] "m/s"  RadarFrontCenter
 SG_ VFC_Obj17A_HeadingAngleStdDev : 186|6@1+ (0.01,0) [0|0.5] "rad"  RadarFrontCenter
 SG_ VFC_Obj17A_VyStdDev : 192|9@1+ (0.1,0) [0|51.1] "m/s"  RadarFrontCenter
 SG_ VFC_Obj17A_HeightStdDev : 201|7@1+ (0.01,0) [0|1] "m"  RadarFrontCenter
 SG_ VFC_Obj17A_Height : 208|9@1+ (0.01,0) [0|5.11] "m"  RadarFrontCenter
 SG_ VFC_Obj17A_Length : 217|9@1+ (0.05,0) [0|25.55] "m"  RadarFrontCenter
 SG_ VFC_Obj17A_HeadingAngle : 226|9@1+ (0.01,-1.57) [-1.57|1.57] "rad"  RadarFrontCenter
 SG_ VFC_Obj17A_NormAx : 235|13@1+ (0.002,-10) [-10|6] "1/s^2"  RadarFrontCenter
 SG_ VFC_Obj17A_NormVyEdgeLeftStdDev : 248|8@1+ (0.001,0) [0|0.255] "1/s"  RadarFrontCenter
 SG_ VFC_Obj17A_NormVyEdgeLeft : 256|13@1+ (0.001,-4) [-4|4] "1/s"  RadarFrontCenter
 SG_ VFC_Obj17A_EdgeBottom : 269|12@1+ (0.00025,-0.5) [-0.5|0.5] "unitless"  RadarFrontCenter
 SG_ VFC_Obj17A_NormVyEdgeRight : 281|13@1+ (0.001,-4) [-4|4] "1/s"  RadarFrontCenter
 SG_ VFC_Obj17A_Width : 294|10@1+ (0.01,0) [0|10.23] "m"  RadarFrontCenter
 SG_ VFC_Obj17A_NormVx : 304|16@1+ (0.001,-40) [-40|25] "1/s"  RadarFrontCenter
 SG_ VFC_Obj17A_NormVyEdgeRightStdDev : 320|8@1+ (0.001,0) [0|0.255] "1/s"  RadarFrontCenter
 SG_ VFC_Obj17A_NormAxStdDev : 328|10@1+ (0.0025,0) [0|2.5575] "1/s^2"  RadarFrontCenter
 SG_ VFC_Obj17A_ScaleChange : 338|14@1+ (0.0001,0.5) [0.5|2.1383] "unitless"  RadarFrontCenter
 SG_ VFC_Obj17A_ScaleChngStdDev : 352|10@1+ (0.0001,0) [0|0.1023] "unitless"  RadarFrontCenter
 SG_ VFC_Obj17A_Reliability : 362|6@1+ (1,0) [0|63] ""  RadarFrontCenter
 SG_ VFC_Obj17A_NormVxStdDev : 368|10@1+ (0.001,0) [0|1.023] "1/s"  RadarFrontCenter
 SG_ VFC_Obj17A_TypeProb : 378|6@1+ (2,0) [0|100] "%"  RadarFrontCenter
 SG_ VFC_Obj17A_LengthStdDev : 384|7@1+ (0.05,0) [0|5] "m"  RadarFrontCenter
 SG_ VFC_Obj17A_WidthStdDev : 391|7@1+ (0.01,0) [0|1] "m"  RadarFrontCenter
 SG_ VFC_Obj17A_EdgeMid : 398|13@1+ (0.00025,-1) [-1|1] "unitless"  RadarFrontCenter
 SG_ VFC_Obj17A_EdgeLeft : 411|13@1+ (0.00025,-1) [-1|1] "unitless"  RadarFrontCenter
 SG_ VFC_Obj17A_EdgeRight : 424|13@1+ (0.00025,-1) [-1|1] "unitless"  RadarFrontCenter
 SG_ VFC_Obj17A_VisibleView : 437|3@1+ (1,0) [0|4] ""  RadarFrontCenter
 SG_ VFC_Obj17A_EdgeLeftStdDev : 440|8@1+ (0.0002,0) [0|0.051] "unitless"  RadarFrontCenter
 SG_ VFC_Obj17A_EdgeTop : 448|12@1+ (0.00025,-0.5) [-0.5|0.5] "unitless"  RadarFrontCenter
 SG_ VFC_Obj17A_HeadOrientation : 460|4@1+ (1,0) [0|15] ""  RadarFrontCenter
 SG_ VFC_Obj17A_EdgeMidStdDev : 464|8@1+ (0.0002,0) [0|0.051] "unitless"  RadarFrontCenter
 SG_ VFC_Obj17A_EdgeRightStdDev : 472|8@1+ (0.0002,0) [0|0.051] "unitless"  RadarFrontCenter
 SG_ VFC_Obj17A_EdgeTopStdDev : 480|8@1+ (0.0002,0) [0|0.051] "unitless"  RadarFrontCenter
 SG_ VFC_Obj17A_EdgeBottomStdDev : 488|8@1+ (0.0002,0) [0|0.051] "unitless"  RadarFrontCenter
 SG_ VFC_Obj17A_ClassifiedView : 496|3@1+ (1,0) [0|4] ""  RadarFrontCenter

BO_ 72 VFC_Object18A: 64 VideoFrontCenter
 SG_ VFC_Obj18A_CRC : 0|16@1+ (1,0) [0|65535] ""  RadarFrontCenter
 SG_ VFC_Obj18A_AliveCtr : 16|8@1+ (1,0) [0|255] ""  RadarFrontCenter
 SG_ VFC_Obj18A_ProtBlockCtr : 24|4@1+ (1,0) [0|15] ""  RadarFrontCenter
 SG_ VFC_Obj18A_ID : 32|8@1+ (1,0) [1|255] ""  RadarFrontCenter
 SG_ VFC_Obj18A_AxStdDev : 40|8@1+ (0.1,0) [0|25.5] "m/s^2"  RadarFrontCenter
 SG_ VFC_Obj18A_Dx : 48|12@1+ (0.05,0) [0|204.75] "m"  RadarFrontCenter
 SG_ VFC_Obj18A_Type : 60|4@1+ (1,0) [0|15] ""  RadarFrontCenter
 SG_ VFC_Obj18A_Dy : 64|14@1+ (0.01,-80) [-80|80] "m"  RadarFrontCenter
 SG_ VFC_Obj18A_Measured : 78|2@1+ (1,0) [0|3] ""  RadarFrontCenter
 SG_ VFC_Obj18A_Vx : 80|11@1+ (0.1,-154) [-154|50] "m/s"  RadarFrontCenter
 SG_ VFC_Obj18A_MeasSource : 91|5@1+ (1,0) [0|31] ""  RadarFrontCenter
 SG_ VFC_Obj18A_Vy : 96|10@1+ (0.1,-50) [-50|50] "m/s"  RadarFrontCenter
 SG_ VFC_Obj18A_DirIndicator : 106|3@1+ (1,0) [0|4] ""  RadarFrontCenter
 SG_ VFC_Obj18A_BrakeLight : 109|3@1+ (1,0) [0|7] ""  RadarFrontCenter
 SG_ VFC_Obj18A_Ax : 112|9@1+ (0.1,-16) [-16|16] "m/s^2"  RadarFrontCenter
 SG_ VFC_Obj18A_CompletelyInImg : 121|1@1+ (1,0) [0|1] ""  RadarFrontCenter
 SG_ VFC_Obj18A_ProbExist : 122|6@1+ (2,0) [0|100] "%"  RadarFrontCenter
 SG_ VFC_Obj18A_Ay : 128|8@1+ (0.1,-12) [-12|12] "m/s^2"  RadarFrontCenter
 SG_ VFC_Obj18A_AyStdDev : 136|8@1+ (0.1,0) [0|25.5] "m/s^2"  RadarFrontCenter
 SG_ VFC_Obj18A_DxStdDev : 144|10@1+ (0.05,0) [0|51.15] "m"  RadarFrontCenter
 SG_ VFC_Obj18A_ProbMovingLat : 154|6@1+ (2,0) [0|100] "%"  RadarFrontCenter
 SG_ VFC_Obj18A_DyStdDev : 160|10@1+ (0.02,0) [0|20.46] "m"  RadarFrontCenter
 SG_ VFC_Obj18A_ProbMovingLong : 170|6@1+ (2,0) [0|100] "%"  RadarFrontCenter
 SG_ VFC_Obj18A_VxStdDev : 176|10@1+ (0.1,0) [0|102.3] "m/s"  RadarFrontCenter
 SG_ VFC_Obj18A_HeadingAngleStdDev : 186|6@1+ (0.01,0) [0|0.5] "rad"  RadarFrontCenter
 SG_ VFC_Obj18A_VyStdDev : 192|9@1+ (0.1,0) [0|51.1] "m/s"  RadarFrontCenter
 SG_ VFC_Obj18A_HeightStdDev : 201|7@1+ (0.01,0) [0|1] "m"  RadarFrontCenter
 SG_ VFC_Obj18A_Height : 208|9@1+ (0.01,0) [0|5.11] "m"  RadarFrontCenter
 SG_ VFC_Obj18A_Length : 217|9@1+ (0.05,0) [0|25.55] "m"  RadarFrontCenter
 SG_ VFC_Obj18A_HeadingAngle : 226|9@1+ (0.01,-1.57) [-1.57|1.57] "rad"  RadarFrontCenter
 SG_ VFC_Obj18A_NormAx : 235|13@1+ (0.002,-10) [-10|6] "1/s^2"  RadarFrontCenter
 SG_ VFC_Obj18A_NormVyEdgeLeftStdDev : 248|8@1+ (0.001,0) [0|0.255] "1/s"  RadarFrontCenter
 SG_ VFC_Obj18A_NormVyEdgeLeft : 256|13@1+ (0.001,-4) [-4|4] "1/s"  RadarFrontCenter
 SG_ VFC_Obj18A_EdgeBottom : 269|12@1+ (0.00025,-0.5) [-0.5|0.5] "unitless"  RadarFrontCenter
 SG_ VFC_Obj18A_NormVyEdgeRight : 281|13@1+ (0.001,-4) [-4|4] "1/s"  RadarFrontCenter
 SG_ VFC_Obj18A_Width : 294|10@1+ (0.01,0) [0|10.23] "m"  RadarFrontCenter
 SG_ VFC_Obj18A_NormVx : 304|16@1+ (0.001,-40) [-40|25] "1/s"  RadarFrontCenter
 SG_ VFC_Obj18A_NormVyEdgeRightStdDev : 320|8@1+ (0.001,0) [0|0.255] "1/s"  RadarFrontCenter
 SG_ VFC_Obj18A_NormAxStdDev : 328|10@1+ (0.0025,0) [0|2.5575] "1/s^2"  RadarFrontCenter
 SG_ VFC_Obj18A_ScaleChange : 338|14@1+ (0.0001,0.5) [0.5|2.1383] "unitless"  RadarFrontCenter
 SG_ VFC_Obj18A_ScaleChngStdDev : 352|10@1+ (0.0001,0) [0|0.1023] "unitless"  RadarFrontCenter
 SG_ VFC_Obj18A_Reliability : 362|6@1+ (1,0) [0|63] ""  RadarFrontCenter
 SG_ VFC_Obj18A_NormVxStdDev : 368|10@1+ (0.001,0) [0|1.023] "1/s"  RadarFrontCenter
 SG_ VFC_Obj18A_TypeProb : 378|6@1+ (2,0) [0|100] "%"  RadarFrontCenter
 SG_ VFC_Obj18A_LengthStdDev : 384|7@1+ (0.05,0) [0|5] "m"  RadarFrontCenter
 SG_ VFC_Obj18A_WidthStdDev : 391|7@1+ (0.01,0) [0|1] "m"  RadarFrontCenter
 SG_ VFC_Obj18A_EdgeMid : 398|13@1+ (0.00025,-1) [-1|1] "unitless"  RadarFrontCenter
 SG_ VFC_Obj18A_EdgeLeft : 411|13@1+ (0.00025,-1) [-1|1] "unitless"  RadarFrontCenter
 SG_ VFC_Obj18A_EdgeRight : 424|13@1+ (0.00025,-1) [-1|1] "unitless"  RadarFrontCenter
 SG_ VFC_Obj18A_VisibleView : 437|3@1+ (1,0) [0|4] ""  RadarFrontCenter
 SG_ VFC_Obj18A_EdgeLeftStdDev : 440|8@1+ (0.0002,0) [0|0.051] "unitless"  RadarFrontCenter
 SG_ VFC_Obj18A_EdgeTop : 448|12@1+ (0.00025,-0.5) [-0.5|0.5] "unitless"  RadarFrontCenter
 SG_ VFC_Obj18A_HeadOrientation : 460|4@1+ (1,0) [0|15] ""  RadarFrontCenter
 SG_ VFC_Obj18A_EdgeMidStdDev : 464|8@1+ (0.0002,0) [0|0.051] "unitless"  RadarFrontCenter
 SG_ VFC_Obj18A_EdgeRightStdDev : 472|8@1+ (0.0002,0) [0|0.051] "unitless"  RadarFrontCenter
 SG_ VFC_Obj18A_EdgeTopStdDev : 480|8@1+ (0.0002,0) [0|0.051] "unitless"  RadarFrontCenter
 SG_ VFC_Obj18A_EdgeBottomStdDev : 488|8@1+ (0.0002,0) [0|0.051] "unitless"  RadarFrontCenter
 SG_ VFC_Obj18A_ClassifiedView : 496|3@1+ (1,0) [0|4] ""  RadarFrontCenter

BO_ 73 VFC_Object19A: 64 VideoFrontCenter
 SG_ VFC_Obj19A_CRC : 0|16@1+ (1,0) [0|65535] ""  RadarFrontCenter
 SG_ VFC_Obj19A_AliveCtr : 16|8@1+ (1,0) [0|255] ""  RadarFrontCenter
 SG_ VFC_Obj19A_ProtBlockCtr : 24|4@1+ (1,0) [0|15] ""  RadarFrontCenter
 SG_ VFC_Obj19A_ID : 32|8@1+ (1,0) [1|255] ""  RadarFrontCenter
 SG_ VFC_Obj19A_AxStdDev : 40|8@1+ (0.1,0) [0|25.5] "m/s^2"  RadarFrontCenter
 SG_ VFC_Obj19A_Dx : 48|12@1+ (0.05,0) [0|204.75] "m"  RadarFrontCenter
 SG_ VFC_Obj19A_Type : 60|4@1+ (1,0) [0|15] ""  RadarFrontCenter
 SG_ VFC_Obj19A_Dy : 64|14@1+ (0.01,-80) [-80|80] "m"  RadarFrontCenter
 SG_ VFC_Obj19A_Measured : 78|2@1+ (1,0) [0|3] ""  RadarFrontCenter
 SG_ VFC_Obj19A_Vx : 80|11@1+ (0.1,-154) [-154|50] "m/s"  RadarFrontCenter
 SG_ VFC_Obj19A_MeasSource : 91|5@1+ (1,0) [0|31] ""  RadarFrontCenter
 SG_ VFC_Obj19A_Vy : 96|10@1+ (0.1,-50) [-50|50] "m/s"  RadarFrontCenter
 SG_ VFC_Obj19A_DirIndicator : 106|3@1+ (1,0) [0|4] ""  RadarFrontCenter
 SG_ VFC_Obj19A_BrakeLight : 109|3@1+ (1,0) [0|7] ""  RadarFrontCenter
 SG_ VFC_Obj19A_Ax : 112|9@1+ (0.1,-16) [-16|16] "m/s^2"  RadarFrontCenter
 SG_ VFC_Obj19A_CompletelyInImg : 121|1@1+ (1,0) [0|1] ""  RadarFrontCenter
 SG_ VFC_Obj19A_ProbExist : 122|6@1+ (2,0) [0|100] "%"  RadarFrontCenter
 SG_ VFC_Obj19A_Ay : 128|8@1+ (0.1,-12) [-12|12] "m/s^2"  RadarFrontCenter
 SG_ VFC_Obj19A_AyStdDev : 136|8@1+ (0.1,0) [0|25.5] "m/s^2"  RadarFrontCenter
 SG_ VFC_Obj19A_DxStdDev : 144|10@1+ (0.05,0) [0|51.15] "m"  RadarFrontCenter
 SG_ VFC_Obj19A_ProbMovingLat : 154|6@1+ (2,0) [0|100] "%"  RadarFrontCenter
 SG_ VFC_Obj19A_DyStdDev : 160|10@1+ (0.02,0) [0|20.46] "m"  RadarFrontCenter
 SG_ VFC_Obj19A_ProbMovingLong : 170|6@1+ (2,0) [0|100] "%"  RadarFrontCenter
 SG_ VFC_Obj19A_VxStdDev : 176|10@1+ (0.1,0) [0|102.3] "m/s"  RadarFrontCenter
 SG_ VFC_Obj19A_HeadingAngleStdDev : 186|6@1+ (0.01,0) [0|0.5] "rad"  RadarFrontCenter
 SG_ VFC_Obj19A_VyStdDev : 192|9@1+ (0.1,0) [0|51.1] "m/s"  RadarFrontCenter
 SG_ VFC_Obj19A_HeightStdDev : 201|7@1+ (0.01,0) [0|1] "m"  RadarFrontCenter
 SG_ VFC_Obj19A_Height : 208|9@1+ (0.01,0) [0|5.11] "m"  RadarFrontCenter
 SG_ VFC_Obj19A_Length : 217|9@1+ (0.05,0) [0|25.55] "m"  RadarFrontCenter
 SG_ VFC_Obj19A_HeadingAngle : 226|9@1+ (0.01,-1.57) [-1.57|1.57] "rad"  RadarFrontCenter
 SG_ VFC_Obj19A_NormAx : 235|13@1+ (0.002,-10) [-10|6] "1/s^2"  RadarFrontCenter
 SG_ VFC_Obj19A_NormVyEdgeLeftStdDev : 248|8@1+ (0.001,0) [0|0.255] "1/s"  RadarFrontCenter
 SG_ VFC_Obj19A_NormVyEdgeLeft : 256|13@1+ (0.001,-4) [-4|4] "1/s"  RadarFrontCenter
 SG_ VFC_Obj19A_EdgeBottom : 269|12@1+ (0.00025,-0.5) [-0.5|0.5] "unitless"  RadarFrontCenter
 SG_ VFC_Obj19A_NormVyEdgeRight : 281|13@1+ (0.001,-4) [-4|4] "1/s"  RadarFrontCenter
 SG_ VFC_Obj19A_Width : 294|10@1+ (0.01,0) [0|10.23] "m"  RadarFrontCenter
 SG_ VFC_Obj19A_NormVx : 304|16@1+ (0.001,-40) [-40|25] "1/s"  RadarFrontCenter
 SG_ VFC_Obj19A_NormVyEdgeRightStdDev : 320|8@1+ (0.001,0) [0|0.255] "1/s"  RadarFrontCenter
 SG_ VFC_Obj19A_NormAxStdDev : 328|10@1+ (0.0025,0) [0|2.5575] "1/s^2"  RadarFrontCenter
 SG_ VFC_Obj19A_ScaleChange : 338|14@1+ (0.0001,0.5) [0.5|2.1383] "unitless"  RadarFrontCenter
 SG_ VFC_Obj19A_ScaleChngStdDev : 352|10@1+ (0.0001,0) [0|0.1023] "unitless"  RadarFrontCenter
 SG_ VFC_Obj19A_Reliability : 362|6@1+ (1,0) [0|63] ""  RadarFrontCenter
 SG_ VFC_Obj19A_NormVxStdDev : 368|10@1+ (0.001,0) [0|1.023] "1/s"  RadarFrontCenter
 SG_ VFC_Obj19A_TypeProb : 378|6@1+ (2,0) [0|100] "%"  RadarFrontCenter
 SG_ VFC_Obj19A_LengthStdDev : 384|7@1+ (0.05,0) [0|5] "m"  RadarFrontCenter
 SG_ VFC_Obj19A_WidthStdDev : 391|7@1+ (0.01,0) [0|1] "m"  RadarFrontCenter
 SG_ VFC_Obj19A_EdgeMid : 398|13@1+ (0.00025,-1) [-1|1] "unitless"  RadarFrontCenter
 SG_ VFC_Obj19A_EdgeLeft : 411|13@1+ (0.00025,-1) [-1|1] "unitless"  RadarFrontCenter
 SG_ VFC_Obj19A_EdgeRight : 424|13@1+ (0.00025,-1) [-1|1] "unitless"  RadarFrontCenter
 SG_ VFC_Obj19A_VisibleView : 437|3@1+ (1,0) [0|4] ""  RadarFrontCenter
 SG_ VFC_Obj19A_EdgeLeftStdDev : 440|8@1+ (0.0002,0) [0|0.051] "unitless"  RadarFrontCenter
 SG_ VFC_Obj19A_EdgeTop : 448|12@1+ (0.00025,-0.5) [-0.5|0.5] "unitless"  RadarFrontCenter
 SG_ VFC_Obj19A_HeadOrientation : 460|4@1+ (1,0) [0|15] ""  RadarFrontCenter
 SG_ VFC_Obj19A_EdgeMidStdDev : 464|8@1+ (0.0002,0) [0|0.051] "unitless"  RadarFrontCenter
 SG_ VFC_Obj19A_EdgeRightStdDev : 472|8@1+ (0.0002,0) [0|0.051] "unitless"  RadarFrontCenter
 SG_ VFC_Obj19A_EdgeTopStdDev : 480|8@1+ (0.0002,0) [0|0.051] "unitless"  RadarFrontCenter
 SG_ VFC_Obj19A_EdgeBottomStdDev : 488|8@1+ (0.0002,0) [0|0.051] "unitless"  RadarFrontCenter
 SG_ VFC_Obj19A_ClassifiedView : 496|3@1+ (1,0) [0|4] ""  RadarFrontCenter

BO_ 74 VFC_Object20A: 64 VideoFrontCenter
 SG_ VFC_Obj20A_CRC : 0|16@1+ (1,0) [0|65535] ""  RadarFrontCenter
 SG_ VFC_Obj20A_AliveCtr : 16|8@1+ (1,0) [0|255] ""  RadarFrontCenter
 SG_ VFC_Obj20A_ProtBlockCtr : 24|4@1+ (1,0) [0|15] ""  RadarFrontCenter
 SG_ VFC_Obj20A_ID : 32|8@1+ (1,0) [1|255] ""  RadarFrontCenter
 SG_ VFC_Obj20A_AxStdDev : 40|8@1+ (0.1,0) [0|25.5] "m/s^2"  RadarFrontCenter
 SG_ VFC_Obj20A_Dx : 48|12@1+ (0.05,0) [0|204.75] "m"  RadarFrontCenter
 SG_ VFC_Obj20A_Type : 60|4@1+ (1,0) [0|15] ""  RadarFrontCenter
 SG_ VFC_Obj20A_Dy : 64|14@1+ (0.01,-80) [-80|80] "m"  RadarFrontCenter
 SG_ VFC_Obj20A_Measured : 78|2@1+ (1,0) [0|3] ""  RadarFrontCenter
 SG_ VFC_Obj20A_Vx : 80|11@1+ (0.1,-154) [-154|50] "m/s"  RadarFrontCenter
 SG_ VFC_Obj20A_MeasSource : 91|5@1+ (1,0) [0|31] ""  RadarFrontCenter
 SG_ VFC_Obj20A_Vy : 96|10@1+ (0.1,-50) [-50|50] "m/s"  RadarFrontCenter
 SG_ VFC_Obj20A_DirIndicator : 106|3@1+ (1,0) [0|4] ""  RadarFrontCenter
 SG_ VFC_Obj20A_BrakeLight : 109|3@1+ (1,0) [0|7] ""  RadarFrontCenter
 SG_ VFC_Obj20A_Ax : 112|9@1+ (0.1,-16) [-16|16] "m/s^2"  RadarFrontCenter
 SG_ VFC_Obj20A_CompletelyInImg : 121|1@1+ (1,0) [0|1] ""  RadarFrontCenter
 SG_ VFC_Obj20A_ProbExist : 122|6@1+ (2,0) [0|100] "%"  RadarFrontCenter
 SG_ VFC_Obj20A_Ay : 128|8@1+ (0.1,-12) [-12|12] "m/s^2"  RadarFrontCenter
 SG_ VFC_Obj20A_AyStdDev : 136|8@1+ (0.1,0) [0|25.5] "m/s^2"  RadarFrontCenter
 SG_ VFC_Obj20A_DxStdDev : 144|10@1+ (0.05,0) [0|51.15] "m"  RadarFrontCenter
 SG_ VFC_Obj20A_ProbMovingLat : 154|6@1+ (2,0) [0|100] "%"  RadarFrontCenter
 SG_ VFC_Obj20A_DyStdDev : 160|10@1+ (0.02,0) [0|20.46] "m"  RadarFrontCenter
 SG_ VFC_Obj20A_ProbMovingLong : 170|6@1+ (2,0) [0|100] "%"  RadarFrontCenter
 SG_ VFC_Obj20A_VxStdDev : 176|10@1+ (0.1,0) [0|102.3] "m/s"  RadarFrontCenter
 SG_ VFC_Obj20A_HeadingAngleStdDev : 186|6@1+ (0.01,0) [0|0.5] "rad"  RadarFrontCenter
 SG_ VFC_Obj20A_VyStdDev : 192|9@1+ (0.1,0) [0|51.1] "m/s"  RadarFrontCenter
 SG_ VFC_Obj20A_HeightStdDev : 201|7@1+ (0.01,0) [0|1] "m"  RadarFrontCenter
 SG_ VFC_Obj20A_Height : 208|9@1+ (0.01,0) [0|5.11] "m"  RadarFrontCenter
 SG_ VFC_Obj20A_Length : 217|9@1+ (0.05,0) [0|25.55] "m"  RadarFrontCenter
 SG_ VFC_Obj20A_HeadingAngle : 226|9@1+ (0.01,-1.57) [-1.57|1.57] "rad"  RadarFrontCenter
 SG_ VFC_Obj20A_NormAx : 235|13@1+ (0.002,-10) [-10|6] "1/s^2"  RadarFrontCenter
 SG_ VFC_Obj20A_NormVyEdgeLeftStdDev : 248|8@1+ (0.001,0) [0|0.255] "1/s"  RadarFrontCenter
 SG_ VFC_Obj20A_NormVyEdgeLeft : 256|13@1+ (0.001,-4) [-4|4] "1/s"  RadarFrontCenter
 SG_ VFC_Obj20A_EdgeBottom : 269|12@1+ (0.00025,-0.5) [-0.5|0.5] "unitless"  RadarFrontCenter
 SG_ VFC_Obj20A_NormVyEdgeRight : 281|13@1+ (0.001,-4) [-4|4] "1/s"  RadarFrontCenter
 SG_ VFC_Obj20A_Width : 294|10@1+ (0.01,0) [0|10.23] "m"  RadarFrontCenter
 SG_ VFC_Obj20A_NormVx : 304|16@1+ (0.001,-40) [-40|25] "1/s"  RadarFrontCenter
 SG_ VFC_Obj20A_NormVyEdgeRightStdDev : 320|8@1+ (0.001,0) [0|0.255] "1/s"  RadarFrontCenter
 SG_ VFC_Obj20A_NormAxStdDev : 328|10@1+ (0.0025,0) [0|2.5575] "1/s^2"  RadarFrontCenter
 SG_ VFC_Obj20A_ScaleChange : 338|14@1+ (0.0001,0.5) [0.5|2.1383] "unitless"  RadarFrontCenter
 SG_ VFC_Obj20A_ScaleChngStdDev : 352|10@1+ (0.0001,0) [0|0.1023] "unitless"  RadarFrontCenter
 SG_ VFC_Obj20A_Reliability : 362|6@1+ (1,0) [0|63] ""  RadarFrontCenter
 SG_ VFC_Obj20A_NormVxStdDev : 368|10@1+ (0.001,0) [0|1.023] "1/s"  RadarFrontCenter
 SG_ VFC_Obj20A_TypeProb : 378|6@1+ (2,0) [0|100] "%"  RadarFrontCenter
 SG_ VFC_Obj20A_LengthStdDev : 384|7@1+ (0.05,0) [0|5] "m"  RadarFrontCenter
 SG_ VFC_Obj20A_WidthStdDev : 391|7@1+ (0.01,0) [0|1] "m"  RadarFrontCenter
 SG_ VFC_Obj20A_EdgeMid : 398|13@1+ (0.00025,-1) [-1|1] "unitless"  RadarFrontCenter
 SG_ VFC_Obj20A_EdgeLeft : 411|13@1+ (0.00025,-1) [-1|1] "unitless"  RadarFrontCenter
 SG_ VFC_Obj20A_EdgeRight : 424|13@1+ (0.00025,-1) [-1|1] "unitless"  RadarFrontCenter
 SG_ VFC_Obj20A_VisibleView : 437|3@1+ (1,0) [0|4] ""  RadarFrontCenter
 SG_ VFC_Obj20A_EdgeLeftStdDev : 440|8@1+ (0.0002,0) [0|0.051] "unitless"  RadarFrontCenter
 SG_ VFC_Obj20A_EdgeTop : 448|12@1+ (0.00025,-0.5) [-0.5|0.5] "unitless"  RadarFrontCenter
 SG_ VFC_Obj20A_HeadOrientation : 460|4@1+ (1,0) [0|15] ""  RadarFrontCenter
 SG_ VFC_Obj20A_EdgeMidStdDev : 464|8@1+ (0.0002,0) [0|0.051] "unitless"  RadarFrontCenter
 SG_ VFC_Obj20A_EdgeRightStdDev : 472|8@1+ (0.0002,0) [0|0.051] "unitless"  RadarFrontCenter
 SG_ VFC_Obj20A_EdgeTopStdDev : 480|8@1+ (0.0002,0) [0|0.051] "unitless"  RadarFrontCenter
 SG_ VFC_Obj20A_EdgeBottomStdDev : 488|8@1+ (0.0002,0) [0|0.051] "unitless"  RadarFrontCenter
 SG_ VFC_Obj20A_ClassifiedView : 496|3@1+ (1,0) [0|4] ""  RadarFrontCenter

BO_ 75 VFC_Object21A: 64 VideoFrontCenter
 SG_ VFC_Obj21A_CRC : 0|16@1+ (1,0) [0|65535] ""  RadarFrontCenter
 SG_ VFC_Obj21A_AliveCtr : 16|8@1+ (1,0) [0|255] ""  RadarFrontCenter
 SG_ VFC_Obj21A_ProtBlockCtr : 24|4@1+ (1,0) [0|15] ""  RadarFrontCenter
 SG_ VFC_Obj21A_ID : 32|8@1+ (1,0) [1|255] ""  RadarFrontCenter
 SG_ VFC_Obj21A_AxStdDev : 40|8@1+ (0.1,0) [0|25.5] "m/s^2"  RadarFrontCenter
 SG_ VFC_Obj21A_Dx : 48|12@1+ (0.05,0) [0|204.75] "m"  RadarFrontCenter
 SG_ VFC_Obj21A_Type : 60|4@1+ (1,0) [0|15] ""  RadarFrontCenter
 SG_ VFC_Obj21A_Dy : 64|14@1+ (0.01,-80) [-80|80] "m"  RadarFrontCenter
 SG_ VFC_Obj21A_Measured : 78|2@1+ (1,0) [0|3] ""  RadarFrontCenter
 SG_ VFC_Obj21A_Vx : 80|11@1+ (0.1,-154) [-154|50] "m/s"  RadarFrontCenter
 SG_ VFC_Obj21A_MeasSource : 91|5@1+ (1,0) [0|31] ""  RadarFrontCenter
 SG_ VFC_Obj21A_Vy : 96|10@1+ (0.1,-50) [-50|50] "m/s"  RadarFrontCenter
 SG_ VFC_Obj21A_DirIndicator : 106|3@1+ (1,0) [0|4] ""  RadarFrontCenter
 SG_ VFC_Obj21A_BrakeLight : 109|3@1+ (1,0) [0|7] ""  RadarFrontCenter
 SG_ VFC_Obj21A_Ax : 112|9@1+ (0.1,-16) [-16|16] "m/s^2"  RadarFrontCenter
 SG_ VFC_Obj21A_CompletelyInImg : 121|1@1+ (1,0) [0|1] ""  RadarFrontCenter
 SG_ VFC_Obj21A_ProbExist : 122|6@1+ (2,0) [0|100] "%"  RadarFrontCenter
 SG_ VFC_Obj21A_Ay : 128|8@1+ (0.1,-12) [-12|12] "m/s^2"  RadarFrontCenter
 SG_ VFC_Obj21A_AyStdDev : 136|8@1+ (0.1,0) [0|25.5] "m/s^2"  RadarFrontCenter
 SG_ VFC_Obj21A_DxStdDev : 144|10@1+ (0.05,0) [0|51.15] "m"  RadarFrontCenter
 SG_ VFC_Obj21A_ProbMovingLat : 154|6@1+ (2,0) [0|100] "%"  RadarFrontCenter
 SG_ VFC_Obj21A_DyStdDev : 160|10@1+ (0.02,0) [0|20.46] "m"  RadarFrontCenter
 SG_ VFC_Obj21A_ProbMovingLong : 170|6@1+ (2,0) [0|100] "%"  RadarFrontCenter
 SG_ VFC_Obj21A_VxStdDev : 176|10@1+ (0.1,0) [0|102.3] "m/s"  RadarFrontCenter
 SG_ VFC_Obj21A_HeadingAngleStdDev : 186|6@1+ (0.01,0) [0|0.5] "rad"  RadarFrontCenter
 SG_ VFC_Obj21A_VyStdDev : 192|9@1+ (0.1,0) [0|51.1] "m/s"  RadarFrontCenter
 SG_ VFC_Obj21A_HeightStdDev : 201|7@1+ (0.01,0) [0|1] "m"  RadarFrontCenter
 SG_ VFC_Obj21A_Height : 208|9@1+ (0.01,0) [0|5.11] "m"  RadarFrontCenter
 SG_ VFC_Obj21A_Length : 217|9@1+ (0.05,0) [0|25.55] "m"  RadarFrontCenter
 SG_ VFC_Obj21A_HeadingAngle : 226|9@1+ (0.01,-1.57) [-1.57|1.57] "rad"  RadarFrontCenter
 SG_ VFC_Obj21A_NormAx : 235|13@1+ (0.002,-10) [-10|6] "1/s^2"  RadarFrontCenter
 SG_ VFC_Obj21A_NormVyEdgeLeftStdDev : 248|8@1+ (0.001,0) [0|0.255] "1/s"  RadarFrontCenter
 SG_ VFC_Obj21A_NormVyEdgeLeft : 256|13@1+ (0.001,-4) [-4|4] "1/s"  RadarFrontCenter
 SG_ VFC_Obj21A_EdgeBottom : 269|12@1+ (0.00025,-0.5) [-0.5|0.5] "unitless"  RadarFrontCenter
 SG_ VFC_Obj21A_NormVyEdgeRight : 281|13@1+ (0.001,-4) [-4|4] "1/s"  RadarFrontCenter
 SG_ VFC_Obj21A_Width : 294|10@1+ (0.01,0) [0|10.23] "m"  RadarFrontCenter
 SG_ VFC_Obj21A_NormVx : 304|16@1+ (0.001,-40) [-40|25] "1/s"  RadarFrontCenter
 SG_ VFC_Obj21A_NormVyEdgeRightStdDev : 320|8@1+ (0.001,0) [0|0.255] "1/s"  RadarFrontCenter
 SG_ VFC_Obj21A_NormAxStdDev : 328|10@1+ (0.0025,0) [0|2.5575] "1/s^2"  RadarFrontCenter
 SG_ VFC_Obj21A_ScaleChange : 338|14@1+ (0.0001,0.5) [0.5|2.1383] "unitless"  RadarFrontCenter
 SG_ VFC_Obj21A_ScaleChngStdDev : 352|10@1+ (0.0001,0) [0|0.1023] "unitless"  RadarFrontCenter
 SG_ VFC_Obj21A_Reliability : 362|6@1+ (1,0) [0|63] ""  RadarFrontCenter
 SG_ VFC_Obj21A_NormVxStdDev : 368|10@1+ (0.001,0) [0|1.023] "1/s"  RadarFrontCenter
 SG_ VFC_Obj21A_TypeProb : 378|6@1+ (2,0) [0|100] "%"  RadarFrontCenter
 SG_ VFC_Obj21A_LengthStdDev : 384|7@1+ (0.05,0) [0|5] "m"  RadarFrontCenter
 SG_ VFC_Obj21A_WidthStdDev : 391|7@1+ (0.01,0) [0|1] "m"  RadarFrontCenter
 SG_ VFC_Obj21A_EdgeMid : 398|13@1+ (0.00025,-1) [-1|1] "unitless"  RadarFrontCenter
 SG_ VFC_Obj21A_EdgeLeft : 411|13@1+ (0.00025,-1) [-1|1] "unitless"  RadarFrontCenter
 SG_ VFC_Obj21A_EdgeRight : 424|13@1+ (0.00025,-1) [-1|1] "unitless"  RadarFrontCenter
 SG_ VFC_Obj21A_VisibleView : 437|3@1+ (1,0) [0|4] ""  RadarFrontCenter
 SG_ VFC_Obj21A_EdgeLeftStdDev : 440|8@1+ (0.0002,0) [0|0.051] "unitless"  RadarFrontCenter
 SG_ VFC_Obj21A_EdgeTop : 448|12@1+ (0.00025,-0.5) [-0.5|0.5] "unitless"  RadarFrontCenter
 SG_ VFC_Obj21A_HeadOrientation : 460|4@1+ (1,0) [0|15] ""  RadarFrontCenter
 SG_ VFC_Obj21A_EdgeMidStdDev : 464|8@1+ (0.0002,0) [0|0.051] "unitless"  RadarFrontCenter
 SG_ VFC_Obj21A_EdgeRightStdDev : 472|8@1+ (0.0002,0) [0|0.051] "unitless"  RadarFrontCenter
 SG_ VFC_Obj21A_EdgeTopStdDev : 480|8@1+ (0.0002,0) [0|0.051] "unitless"  RadarFrontCenter
 SG_ VFC_Obj21A_EdgeBottomStdDev : 488|8@1+ (0.0002,0) [0|0.051] "unitless"  RadarFrontCenter
 SG_ VFC_Obj21A_ClassifiedView : 496|3@1+ (1,0) [0|4] ""  RadarFrontCenter

BO_ 76 VFC_Object22A: 64 VideoFrontCenter
 SG_ VFC_Obj22A_CRC : 0|16@1+ (1,0) [0|65535] ""  RadarFrontCenter
 SG_ VFC_Obj22A_AliveCtr : 16|8@1+ (1,0) [0|255] ""  RadarFrontCenter
 SG_ VFC_Obj22A_ProtBlockCtr : 24|4@1+ (1,0) [0|15] ""  RadarFrontCenter
 SG_ VFC_Obj22A_ID : 32|8@1+ (1,0) [1|255] ""  RadarFrontCenter
 SG_ VFC_Obj22A_AxStdDev : 40|8@1+ (0.1,0) [0|25.5] "m/s^2"  RadarFrontCenter
 SG_ VFC_Obj22A_Dx : 48|12@1+ (0.05,0) [0|204.75] "m"  RadarFrontCenter
 SG_ VFC_Obj22A_Type : 60|4@1+ (1,0) [0|15] ""  RadarFrontCenter
 SG_ VFC_Obj22A_Dy : 64|14@1+ (0.01,-80) [-80|80] "m"  RadarFrontCenter
 SG_ VFC_Obj22A_Measured : 78|2@1+ (1,0) [0|3] ""  RadarFrontCenter
 SG_ VFC_Obj22A_Vx : 80|11@1+ (0.1,-154) [-154|50] "m/s"  RadarFrontCenter
 SG_ VFC_Obj22A_MeasSource : 91|5@1+ (1,0) [0|31] ""  RadarFrontCenter
 SG_ VFC_Obj22A_Vy : 96|10@1+ (0.1,-50) [-50|50] "m/s"  RadarFrontCenter
 SG_ VFC_Obj22A_DirIndicator : 106|3@1+ (1,0) [0|4] ""  RadarFrontCenter
 SG_ VFC_Obj22A_BrakeLight : 109|3@1+ (1,0) [0|7] ""  RadarFrontCenter
 SG_ VFC_Obj22A_Ax : 112|9@1+ (0.1,-16) [-16|16] "m/s^2"  RadarFrontCenter
 SG_ VFC_Obj22A_CompletelyInImg : 121|1@1+ (1,0) [0|1] ""  RadarFrontCenter
 SG_ VFC_Obj22A_ProbExist : 122|6@1+ (2,0) [0|100] "%"  RadarFrontCenter
 SG_ VFC_Obj22A_Ay : 128|8@1+ (0.1,-12) [-12|12] "m/s^2"  RadarFrontCenter
 SG_ VFC_Obj22A_AyStdDev : 136|8@1+ (0.1,0) [0|25.5] "m/s^2"  RadarFrontCenter
 SG_ VFC_Obj22A_DxStdDev : 144|10@1+ (0.05,0) [0|51.15] "m"  RadarFrontCenter
 SG_ VFC_Obj22A_ProbMovingLat : 154|6@1+ (2,0) [0|100] "%"  RadarFrontCenter
 SG_ VFC_Obj22A_DyStdDev : 160|10@1+ (0.02,0) [0|20.46] "m"  RadarFrontCenter
 SG_ VFC_Obj22A_ProbMovingLong : 170|6@1+ (2,0) [0|100] "%"  RadarFrontCenter
 SG_ VFC_Obj22A_VxStdDev : 176|10@1+ (0.1,0) [0|102.3] "m/s"  RadarFrontCenter
 SG_ VFC_Obj22A_HeadingAngleStdDev : 186|6@1+ (0.01,0) [0|0.5] "rad"  RadarFrontCenter
 SG_ VFC_Obj22A_VyStdDev : 192|9@1+ (0.1,0) [0|51.1] "m/s"  RadarFrontCenter
 SG_ VFC_Obj22A_HeightStdDev : 201|7@1+ (0.01,0) [0|1] "m"  RadarFrontCenter
 SG_ VFC_Obj22A_Height : 208|9@1+ (0.01,0) [0|5.11] "m"  RadarFrontCenter
 SG_ VFC_Obj22A_Length : 217|9@1+ (0.05,0) [0|25.55] "m"  RadarFrontCenter
 SG_ VFC_Obj22A_HeadingAngle : 226|9@1+ (0.01,-1.57) [-1.57|1.57] "rad"  RadarFrontCenter
 SG_ VFC_Obj22A_NormAx : 235|13@1+ (0.002,-10) [-10|6] "1/s^2"  RadarFrontCenter
 SG_ VFC_Obj22A_NormVyEdgeLeftStdDev : 248|8@1+ (0.001,0) [0|0.255] "1/s"  RadarFrontCenter
 SG_ VFC_Obj22A_NormVyEdgeLeft : 256|13@1+ (0.001,-4) [-4|4] "1/s"  RadarFrontCenter
 SG_ VFC_Obj22A_EdgeBottom : 269|12@1+ (0.00025,-0.5) [-0.5|0.5] "unitless"  RadarFrontCenter
 SG_ VFC_Obj22A_NormVyEdgeRight : 281|13@1+ (0.001,-4) [-4|4] "1/s"  RadarFrontCenter
 SG_ VFC_Obj22A_Width : 294|10@1+ (0.01,0) [0|10.23] "m"  RadarFrontCenter
 SG_ VFC_Obj22A_NormVx : 304|16@1+ (0.001,-40) [-40|25] "1/s"  RadarFrontCenter
 SG_ VFC_Obj22A_NormVyEdgeRightStdDev : 320|8@1+ (0.001,0) [0|0.255] "1/s"  RadarFrontCenter
 SG_ VFC_Obj22A_NormAxStdDev : 328|10@1+ (0.0025,0) [0|2.5575] "1/s^2"  RadarFrontCenter
 SG_ VFC_Obj22A_ScaleChange : 338|14@1+ (0.0001,0.5) [0.5|2.1383] "unitless"  RadarFrontCenter
 SG_ VFC_Obj22A_ScaleChngStdDev : 352|10@1+ (0.0001,0) [0|0.1023] "unitless"  RadarFrontCenter
 SG_ VFC_Obj22A_Reliability : 362|6@1+ (1,0) [0|63] ""  RadarFrontCenter
 SG_ VFC_Obj22A_NormVxStdDev : 368|10@1+ (0.001,0) [0|1.023] "1/s"  RadarFrontCenter
 SG_ VFC_Obj22A_TypeProb : 378|6@1+ (2,0) [0|100] "%"  RadarFrontCenter
 SG_ VFC_Obj22A_LengthStdDev : 384|7@1+ (0.05,0) [0|5] "m"  RadarFrontCenter
 SG_ VFC_Obj22A_WidthStdDev : 391|7@1+ (0.01,0) [0|1] "m"  RadarFrontCenter
 SG_ VFC_Obj22A_EdgeMid : 398|13@1+ (0.00025,-1) [-1|1] "unitless"  RadarFrontCenter
 SG_ VFC_Obj22A_EdgeLeft : 411|13@1+ (0.00025,-1) [-1|1] "unitless"  RadarFrontCenter
 SG_ VFC_Obj22A_EdgeRight : 424|13@1+ (0.00025,-1) [-1|1] "unitless"  RadarFrontCenter
 SG_ VFC_Obj22A_VisibleView : 437|3@1+ (1,0) [0|4] ""  RadarFrontCenter
 SG_ VFC_Obj22A_EdgeLeftStdDev : 440|8@1+ (0.0002,0) [0|0.051] "unitless"  RadarFrontCenter
 SG_ VFC_Obj22A_EdgeTop : 448|12@1+ (0.00025,-0.5) [-0.5|0.5] "unitless"  RadarFrontCenter
 SG_ VFC_Obj22A_HeadOrientation : 460|4@1+ (1,0) [0|15] ""  RadarFrontCenter
 SG_ VFC_Obj22A_EdgeMidStdDev : 464|8@1+ (0.0002,0) [0|0.051] "unitless"  RadarFrontCenter
 SG_ VFC_Obj22A_EdgeRightStdDev : 472|8@1+ (0.0002,0) [0|0.051] "unitless"  RadarFrontCenter
 SG_ VFC_Obj22A_EdgeTopStdDev : 480|8@1+ (0.0002,0) [0|0.051] "unitless"  RadarFrontCenter
 SG_ VFC_Obj22A_EdgeBottomStdDev : 488|8@1+ (0.0002,0) [0|0.051] "unitless"  RadarFrontCenter
 SG_ VFC_Obj22A_ClassifiedView : 496|3@1+ (1,0) [0|4] ""  RadarFrontCenter

BO_ 77 VFC_Object23A: 64 VideoFrontCenter
 SG_ VFC_Obj23A_CRC : 0|16@1+ (1,0) [0|65535] ""  RadarFrontCenter
 SG_ VFC_Obj23A_AliveCtr : 16|8@1+ (1,0) [0|255] ""  RadarFrontCenter
 SG_ VFC_Obj23A_ProtBlockCtr : 24|4@1+ (1,0) [0|15] ""  RadarFrontCenter
 SG_ VFC_Obj23A_ID : 32|8@1+ (1,0) [1|255] ""  RadarFrontCenter
 SG_ VFC_Obj23A_AxStdDev : 40|8@1+ (0.1,0) [0|25.5] "m/s^2"  RadarFrontCenter
 SG_ VFC_Obj23A_Dx : 48|12@1+ (0.05,0) [0|204.75] "m"  RadarFrontCenter
 SG_ VFC_Obj23A_Type : 60|4@1+ (1,0) [0|15] ""  RadarFrontCenter
 SG_ VFC_Obj23A_Dy : 64|14@1+ (0.01,-80) [-80|80] "m"  RadarFrontCenter
 SG_ VFC_Obj23A_Measured : 78|2@1+ (1,0) [0|3] ""  RadarFrontCenter
 SG_ VFC_Obj23A_Vx : 80|11@1+ (0.1,-154) [-154|50] "m/s"  RadarFrontCenter
 SG_ VFC_Obj23A_MeasSource : 91|5@1+ (1,0) [0|31] ""  RadarFrontCenter
 SG_ VFC_Obj23A_Vy : 96|10@1+ (0.1,-50) [-50|50] "m/s"  RadarFrontCenter
 SG_ VFC_Obj23A_DirIndicator : 106|3@1+ (1,0) [0|4] ""  RadarFrontCenter
 SG_ VFC_Obj23A_BrakeLight : 109|3@1+ (1,0) [0|7] ""  RadarFrontCenter
 SG_ VFC_Obj23A_Ax : 112|9@1+ (0.1,-16) [-16|16] "m/s^2"  RadarFrontCenter
 SG_ VFC_Obj23A_CompletelyInImg : 121|1@1+ (1,0) [0|1] ""  RadarFrontCenter
 SG_ VFC_Obj23A_ProbExist : 122|6@1+ (2,0) [0|100] "%"  RadarFrontCenter
 SG_ VFC_Obj23A_Ay : 128|8@1+ (0.1,-12) [-12|12] "m/s^2"  RadarFrontCenter
 SG_ VFC_Obj23A_AyStdDev : 136|8@1+ (0.1,0) [0|25.5] "m/s^2"  RadarFrontCenter
 SG_ VFC_Obj23A_DxStdDev : 144|10@1+ (0.05,0) [0|51.15] "m"  RadarFrontCenter
 SG_ VFC_Obj23A_ProbMovingLat : 154|6@1+ (2,0) [0|100] "%"  RadarFrontCenter
 SG_ VFC_Obj23A_DyStdDev : 160|10@1+ (0.02,0) [0|20.46] "m"  RadarFrontCenter
 SG_ VFC_Obj23A_ProbMovingLong : 170|6@1+ (2,0) [0|100] "%"  RadarFrontCenter
 SG_ VFC_Obj23A_VxStdDev : 176|10@1+ (0.1,0) [0|102.3] "m/s"  RadarFrontCenter
 SG_ VFC_Obj23A_HeadingAngleStdDev : 186|6@1+ (0.01,0) [0|0.5] "rad"  RadarFrontCenter
 SG_ VFC_Obj23A_VyStdDev : 192|9@1+ (0.1,0) [0|51.1] "m/s"  RadarFrontCenter
 SG_ VFC_Obj23A_HeightStdDev : 201|7@1+ (0.01,0) [0|1] "m"  RadarFrontCenter
 SG_ VFC_Obj23A_Height : 208|9@1+ (0.01,0) [0|5.11] "m"  RadarFrontCenter
 SG_ VFC_Obj23A_Length : 217|9@1+ (0.05,0) [0|25.55] "m"  RadarFrontCenter
 SG_ VFC_Obj23A_HeadingAngle : 226|9@1+ (0.01,-1.57) [-1.57|1.57] "rad"  RadarFrontCenter
 SG_ VFC_Obj23A_NormAx : 235|13@1+ (0.002,-10) [-10|6] "1/s^2"  RadarFrontCenter
 SG_ VFC_Obj23A_NormVyEdgeLeftStdDev : 248|8@1+ (0.001,0) [0|0.255] "1/s"  RadarFrontCenter
 SG_ VFC_Obj23A_NormVyEdgeLeft : 256|13@1+ (0.001,-4) [-4|4] "1/s"  RadarFrontCenter
 SG_ VFC_Obj23A_EdgeBottom : 269|12@1+ (0.00025,-0.5) [-0.5|0.5] "unitless"  RadarFrontCenter
 SG_ VFC_Obj23A_NormVyEdgeRight : 281|13@1+ (0.001,-4) [-4|4] "1/s"  RadarFrontCenter
 SG_ VFC_Obj23A_Width : 294|10@1+ (0.01,0) [0|10.23] "m"  RadarFrontCenter
 SG_ VFC_Obj23A_NormVx : 304|16@1+ (0.001,-40) [-40|25] "1/s"  RadarFrontCenter
 SG_ VFC_Obj23A_NormVyEdgeRightStdDev : 320|8@1+ (0.001,0) [0|0.255] "1/s"  RadarFrontCenter
 SG_ VFC_Obj23A_NormAxStdDev : 328|10@1+ (0.0025,0) [0|2.5575] "1/s^2"  RadarFrontCenter
 SG_ VFC_Obj23A_ScaleChange : 338|14@1+ (0.0001,0.5) [0.5|2.1383] "unitless"  RadarFrontCenter
 SG_ VFC_Obj23A_ScaleChngStdDev : 352|10@1+ (0.0001,0) [0|0.1023] "unitless"  RadarFrontCenter
 SG_ VFC_Obj23A_Reliability : 362|6@1+ (1,0) [0|63] ""  RadarFrontCenter
 SG_ VFC_Obj23A_NormVxStdDev : 368|10@1+ (0.001,0) [0|1.023] "1/s"  RadarFrontCenter
 SG_ VFC_Obj23A_TypeProb : 378|6@1+ (2,0) [0|100] "%"  RadarFrontCenter
 SG_ VFC_Obj23A_LengthStdDev : 384|7@1+ (0.05,0) [0|5] "m"  RadarFrontCenter
 SG_ VFC_Obj23A_WidthStdDev : 391|7@1+ (0.01,0) [0|1] "m"  RadarFrontCenter
 SG_ VFC_Obj23A_EdgeMid : 398|13@1+ (0.00025,-1) [-1|1] "unitless"  RadarFrontCenter
 SG_ VFC_Obj23A_EdgeLeft : 411|13@1+ (0.00025,-1) [-1|1] "unitless"  RadarFrontCenter
 SG_ VFC_Obj23A_EdgeRight : 424|13@1+ (0.00025,-1) [-1|1] "unitless"  RadarFrontCenter
 SG_ VFC_Obj23A_VisibleView : 437|3@1+ (1,0) [0|4] ""  RadarFrontCenter
 SG_ VFC_Obj23A_EdgeLeftStdDev : 440|8@1+ (0.0002,0) [0|0.051] "unitless"  RadarFrontCenter
 SG_ VFC_Obj23A_EdgeTop : 448|12@1+ (0.00025,-0.5) [-0.5|0.5] "unitless"  RadarFrontCenter
 SG_ VFC_Obj23A_HeadOrientation : 460|4@1+ (1,0) [0|15] ""  RadarFrontCenter
 SG_ VFC_Obj23A_EdgeMidStdDev : 464|8@1+ (0.0002,0) [0|0.051] "unitless"  RadarFrontCenter
 SG_ VFC_Obj23A_EdgeRightStdDev : 472|8@1+ (0.0002,0) [0|0.051] "unitless"  RadarFrontCenter
 SG_ VFC_Obj23A_EdgeTopStdDev : 480|8@1+ (0.0002,0) [0|0.051] "unitless"  RadarFrontCenter
 SG_ VFC_Obj23A_EdgeBottomStdDev : 488|8@1+ (0.0002,0) [0|0.051] "unitless"  RadarFrontCenter
 SG_ VFC_Obj23A_ClassifiedView : 496|3@1+ (1,0) [0|4] ""  RadarFrontCenter

BO_ 128 VFC_RoadHdr: 24 VideoFrontCenter
 SG_ VFC_RoadHdr_CRC : 0|16@1+ (1,0) [0|65535] ""  RadarFrontCenter
 SG_ VFC_RoadHdr_AliveCtr : 16|8@1+ (1,0) [0|255] ""  RadarFrontCenter
 SG_ VFC_RoadHdr_ProtBlockCtr : 24|4@1+ (1,0) [0|15] ""  RadarFrontCenter
 SG_ VFC_RoadHdr_IfVersionIdMajor : 32|8@1+ (1,0) [0|255] ""  RadarFrontCenter
 SG_ VFC_RoadHdr_IfVersionIdMinor : 40|8@1+ (1,0) [0|255] ""  RadarFrontCenter
 SG_ VFC_RoadHdr_NumValidPolynomials : 48|5@1+ (1,0) [0|31] ""  RadarFrontCenter
 SG_ VFC_RoadHdr_RoadType : 54|2@1+ (1,0) [0|3] ""  RadarFrontCenter
 SG_ VFC_RoadHdr_TimeStampStatus : 56|8@1+ (1,0) [0|255] ""  RadarFrontCenter
 SG_ VFC_RoadHdr_TimeStamp : 64|26@1+ (1,0) [0|67108863] "ms"  RadarFrontCenter
 SG_ VFC_RoadHdr_SensorStatus : 96|3@1+ (1,0) [0|7] ""  RadarFrontCenter
 SG_ VFC_RoadHdr_NumValid2DPolynomial : 112|5@1+ (1,0) [0|31] ""  RadarFrontCenter
 SG_ VFC_RoadHdr_RoadSurfCondType : 118|2@1+ (1,0) [0|3] ""  RadarFrontCenter
 SG_ VFC_RoadHdr_NumValidRoadMarkings : 120|5@1+ (1,0) [0|31] ""  RadarFrontCenter
 SG_ VFC_RoadHdr_RoadTypeConf : 126|1@1+ (100,0) [0|100] "%"  RadarFrontCenter
 SG_ VFC_RoadHdr_RoadSurCondTypeConf : 127|1@1+ (100,0) [0|100] "%"  RadarFrontCenter
 SG_ VFC_RoadHdr_2DNormVMean : 128|12@1+ (1,0) [0|4095] "pixel"  RadarFrontCenter
 SG_ VFC_RoadHdr_2DNormVMeanStdDev : 140|11@1+ (1,0) [0|2047] "pixel"  RadarFrontCenter
 SG_ VFC_RoadHdr_NumValidClothoids : 151|5@1+ (1,0) [0|31] ""  RadarFrontCenter

BO_ 130 VFC_RoadClothoid_00_02: 64 VideoFrontCenter
 SG_ VFC_Cloth_00_02_CRC : 0|16@1+ (1,0) [0|65535] ""  RadarFrontCenter
 SG_ VFC_Cloth_00_02_AliveCtr : 16|8@1+ (1,0) [0|255] ""  RadarFrontCenter
 SG_ VFC_Cloth_00_02_ProtBlockCtr : 24|4@1+ (1,0) [0|15] ""  RadarFrontCenter
 SG_ VFC_Cloth00_LaneAssociation : 32|4@1+ (1,0) [0|15] ""  RadarFrontCenter
 SG_ VFC_Cloth00_Colour : 37|3@1+ (1,0) [0|7] ""  RadarFrontCenter
 SG_ VFC_Cloth00_RangeXBegin : 40|9@1+ (0.25,0) [0|127.75] "m"  RadarFrontCenter
 SG_ VFC_Cloth00_RangeXEnd : 49|9@1+ (0.5,0) [0|255.5] "m"  RadarFrontCenter
 SG_ VFC_Cloth00_ExistProb : 58|6@1+ (2,0) [0|100] "%"  RadarFrontCenter
 SG_ VFC_Cloth00_CurvChange : 64|24@1+ (1.86264514923096E-009,-0.015625) [-0.015625|0.0156249981373548] "1/m^2"  RadarFrontCenter
 SG_ VFC_Cloth00_Curv : 88|15@1+ (3.814697265625E-006,-0.0625) [-0.0625|0.0624961853027344] "1/m"  RadarFrontCenter
 SG_ VFC_Cloth00_PyStdDev : 103|9@1+ (0.0078125,0) [0|3.9921875] "m"  RadarFrontCenter
 SG_ VFC_Cloth00_Py : 112|12@1+ (0.0078125,-16) [-16|15.9921875] "m"  RadarFrontCenter
 SG_ VFC_Cloth00_OrientationYaw : 124|12@1+ (0.00048828125,-1) [-1|0.99951171875] "rad"  RadarFrontCenter
 SG_ VFC_Cloth00_Width : 136|8@1+ (0.01,0) [0|2.55] "m"  RadarFrontCenter
 SG_ VFC_Cloth00_Type : 144|4@1+ (1,0) [0|15] ""  RadarFrontCenter
 SG_ VFC_Cloth01_LaneAssociation : 192|4@1+ (1,0) [0|15] ""  RadarFrontCenter
 SG_ VFC_Cloth01_Colour : 197|3@1+ (1,0) [0|7] ""  RadarFrontCenter
 SG_ VFC_Cloth01_RangeXBegin : 200|9@1+ (0.25,0) [0|127.75] "m"  RadarFrontCenter
 SG_ VFC_Cloth01_RangeXEnd : 209|9@1+ (0.5,0) [0|255.5] "m"  RadarFrontCenter
 SG_ VFC_Cloth01_ExistProb : 218|6@1+ (2,0) [0|100] "%"  RadarFrontCenter
 SG_ VFC_Cloth01_CurvChange : 224|24@1+ (1.86264514923096E-009,-0.015625) [-0.015625|0.0156249981373548] "1/m^2"  RadarFrontCenter
 SG_ VFC_Cloth01_Curv : 248|15@1+ (3.814697265625E-006,-0.0625) [-0.0625|0.0624961853027344] "1/m"  RadarFrontCenter
 SG_ VFC_Cloth01_PyStdDev : 263|9@1+ (0.0078125,0) [0|3.9921875] "m"  RadarFrontCenter
 SG_ VFC_Cloth01_Py : 272|12@1+ (0.0078125,-16) [-16|15.9921875] "m"  RadarFrontCenter
 SG_ VFC_Cloth01_OrientationYaw : 284|12@1+ (0.00048828125,-1) [-1|0.99951171875] "rad"  RadarFrontCenter
 SG_ VFC_Cloth01_Width : 296|8@1+ (0.01,0) [0|2.55] "m"  RadarFrontCenter
 SG_ VFC_Cloth01_Type : 304|4@1+ (1,0) [0|15] ""  RadarFrontCenter
 SG_ VFC_Cloth02_LaneAssociation : 352|4@1+ (1,0) [0|15] ""  RadarFrontCenter
 SG_ VFC_Cloth02_Colour : 357|3@1+ (1,0) [0|7] ""  RadarFrontCenter
 SG_ VFC_Cloth02_RangeXBegin : 360|9@1+ (0.25,0) [0|127.75] "m"  RadarFrontCenter
 SG_ VFC_Cloth02_RangeXEnd : 369|9@1+ (0.5,0) [0|255.5] "m"  RadarFrontCenter
 SG_ VFC_Cloth02_ExistProb : 378|6@1+ (2,0) [0|100] "%"  RadarFrontCenter
 SG_ VFC_Cloth02_CurvChange : 384|24@1+ (1.86264514923096E-009,-0.015625) [-0.015625|0.0156249981373548] "1/m^2"  RadarFrontCenter
 SG_ VFC_Cloth02_Curv : 408|15@1+ (3.814697265625E-006,-0.0625) [-0.0625|0.0624961853027344] "1/m"  RadarFrontCenter
 SG_ VFC_Cloth02_PyStdDev : 423|9@1+ (0.0078125,0) [0|3.9921875] "m"  RadarFrontCenter
 SG_ VFC_Cloth02_Py : 432|12@1+ (0.0078125,-16) [-16|15.9921875] "m"  RadarFrontCenter
 SG_ VFC_Cloth02_OrientationYaw : 444|12@1+ (0.00048828125,-1) [-1|0.99951171875] "rad"  RadarFrontCenter
 SG_ VFC_Cloth02_Width : 456|8@1+ (0.01,0) [0|2.55] "m"  RadarFrontCenter
 SG_ VFC_Cloth02_Type : 464|4@1+ (1,0) [0|15] ""  RadarFrontCenter

BO_ 131 VFC_RoadClothoid_03_05: 64 VideoFrontCenter
 SG_ VFC_Cloth_03_05_CRC : 0|16@1+ (1,0) [0|65535] ""  RadarFrontCenter
 SG_ VFC_Cloth_03_05_AliveCtr : 16|8@1+ (1,0) [0|255] ""  RadarFrontCenter
 SG_ VFC_Cloth_03_05_ProtBlockCtr : 24|4@1+ (1,0) [0|15] ""  RadarFrontCenter
 SG_ VFC_Cloth03_LaneAssociation : 32|4@1+ (1,0) [0|15] ""  RadarFrontCenter
 SG_ VFC_Cloth03_Colour : 37|3@1+ (1,0) [0|7] ""  RadarFrontCenter
 SG_ VFC_Cloth03_RangeXBegin : 40|9@1+ (0.25,0) [0|127.75] "m"  RadarFrontCenter
 SG_ VFC_Cloth03_RangeXEnd : 49|9@1+ (0.5,0) [0|255.5] "m"  RadarFrontCenter
 SG_ VFC_Cloth03_ExistProb : 58|6@1+ (2,0) [0|100] "%"  RadarFrontCenter
 SG_ VFC_Cloth03_CurvChange : 64|24@1+ (1.86264514923096E-009,-0.015625) [-0.015625|0.0156249981373548] "1/m^2"  RadarFrontCenter
 SG_ VFC_Cloth03_Curv : 88|15@1+ (3.814697265625E-006,-0.0625) [-0.0625|0.0624961853027344] "1/m"  RadarFrontCenter
 SG_ VFC_Cloth03_PyStdDev : 103|9@1+ (0.0078125,0) [0|3.9921875] "m"  RadarFrontCenter
 SG_ VFC_Cloth03_Py : 112|12@1+ (0.0078125,-16) [-16|15.9921875] "m"  RadarFrontCenter
 SG_ VFC_Cloth03_OrientationYaw : 124|12@1+ (0.00048828125,-1) [-1|0.99951171875] "rad"  RadarFrontCenter
 SG_ VFC_Cloth03_Width : 136|8@1+ (0.01,0) [0|2.55] "m"  RadarFrontCenter
 SG_ VFC_Cloth03_Type : 144|4@1+ (1,0) [0|15] ""  RadarFrontCenter
 SG_ VFC_Cloth04_LaneAssociation : 192|4@1+ (1,0) [0|15] ""  RadarFrontCenter
 SG_ VFC_Cloth04_Colour : 197|3@1+ (1,0) [0|7] ""  RadarFrontCenter
 SG_ VFC_Cloth04_RangeXBegin : 200|9@1+ (0.25,0) [0|127.75] "m"  RadarFrontCenter
 SG_ VFC_Cloth04_RangeXEnd : 209|9@1+ (0.5,0) [0|255.5] "m"  RadarFrontCenter
 SG_ VFC_Cloth04_ExistProb : 218|6@1+ (2,0) [0|100] "%"  RadarFrontCenter
 SG_ VFC_Cloth04_CurvChange : 224|24@1+ (1.86264514923096E-009,-0.015625) [-0.015625|0.0156249981373548] "1/m^2"  RadarFrontCenter
 SG_ VFC_Cloth04_Curv : 248|15@1+ (3.814697265625E-006,-0.0625) [-0.0625|0.0624961853027344] "1/m"  RadarFrontCenter
 SG_ VFC_Cloth04_PyStdDev : 263|9@1+ (0.0078125,0) [0|3.9921875] "m"  RadarFrontCenter
 SG_ VFC_Cloth04_Py : 272|12@1+ (0.0078125,-16) [-16|15.9921875] "m"  RadarFrontCenter
 SG_ VFC_Cloth04_OrientationYaw : 284|12@1+ (0.00048828125,-1) [-1|0.99951171875] "rad"  RadarFrontCenter
 SG_ VFC_Cloth04_Width : 296|8@1+ (0.01,0) [0|2.55] "m"  RadarFrontCenter
 SG_ VFC_Cloth04_Type : 304|4@1+ (1,0) [0|15] ""  RadarFrontCenter
 SG_ VFC_Cloth05_LaneAssociation : 352|4@1+ (1,0) [0|15] ""  RadarFrontCenter
 SG_ VFC_Cloth05_Colour : 357|3@1+ (1,0) [0|7] ""  RadarFrontCenter
 SG_ VFC_Cloth05_RangeXBegin : 360|9@1+ (0.25,0) [0|127.75] "m"  RadarFrontCenter
 SG_ VFC_Cloth05_RangeXEnd : 369|9@1+ (0.5,0) [0|255.5] "m"  RadarFrontCenter
 SG_ VFC_Cloth05_ExistProb : 378|6@1+ (2,0) [0|100] "%"  RadarFrontCenter
 SG_ VFC_Cloth05_CurvChange : 384|24@1+ (1.86264514923096E-009,-0.015625) [-0.015625|0.0156249981373548] "1/m^2"  RadarFrontCenter
 SG_ VFC_Cloth05_Curv : 408|15@1+ (3.814697265625E-006,-0.0625) [-0.0625|0.0624961853027344] "1/m"  RadarFrontCenter
 SG_ VFC_Cloth05_PyStdDev : 423|9@1+ (0.0078125,0) [0|3.9921875] "m"  RadarFrontCenter
 SG_ VFC_Cloth05_Py : 432|12@1+ (0.0078125,-16) [-16|15.9921875] "m"  RadarFrontCenter
 SG_ VFC_Cloth05_OrientationYaw : 444|12@1+ (0.00048828125,-1) [-1|0.99951171875] "rad"  RadarFrontCenter
 SG_ VFC_Cloth05_Width : 456|8@1+ (0.01,0) [0|2.55] "m"  RadarFrontCenter
 SG_ VFC_Cloth05_Type : 464|4@1+ (1,0) [0|15] ""  RadarFrontCenter

BO_ 132 VFC_RoadClothoid_06_08: 64 VideoFrontCenter
 SG_ VFC_Cloth_06_08_CRC : 0|16@1+ (1,0) [0|65535] ""  RadarFrontCenter
 SG_ VFC_Cloth_06_08_AliveCtr : 16|8@1+ (1,0) [0|255] ""  RadarFrontCenter
 SG_ VFC_Cloth_06_08_ProtBlockCtr : 24|4@1+ (1,0) [0|15] ""  RadarFrontCenter
 SG_ VFC_Cloth06_LaneAssociation : 32|4@1+ (1,0) [0|15] ""  RadarFrontCenter
 SG_ VFC_Cloth06_Colour : 37|3@1+ (1,0) [0|7] ""  RadarFrontCenter
 SG_ VFC_Cloth06_RangeXBegin : 40|9@1+ (0.25,0) [0|127.75] "m"  RadarFrontCenter
 SG_ VFC_Cloth06_RangeXEnd : 49|9@1+ (0.5,0) [0|255.5] "m"  RadarFrontCenter
 SG_ VFC_Cloth06_ExistProb : 58|6@1+ (2,0) [0|100] "%"  RadarFrontCenter
 SG_ VFC_Cloth06_CurvChange : 64|24@1+ (1.86264514923096E-009,-0.015625) [-0.015625|0.0156249981373548] "1/m^2"  RadarFrontCenter
 SG_ VFC_Cloth06_Curv : 88|15@1+ (3.814697265625E-006,-0.0625) [-0.0625|0.0624961853027344] "1/m"  RadarFrontCenter
 SG_ VFC_Cloth06_PyStdDev : 103|9@1+ (0.0078125,0) [0|3.9921875] "m"  RadarFrontCenter
 SG_ VFC_Cloth06_Py : 112|12@1+ (0.0078125,-16) [-16|15.9921875] "m"  RadarFrontCenter
 SG_ VFC_Cloth06_OrientationYaw : 124|12@1+ (0.00048828125,-1) [-1|0.99951171875] "rad"  RadarFrontCenter
 SG_ VFC_Cloth06_Width : 136|8@1+ (0.01,0) [0|2.55] "m"  RadarFrontCenter
 SG_ VFC_Cloth06_Type : 144|4@1+ (1,0) [0|15] ""  RadarFrontCenter
 SG_ VFC_Cloth07_LaneAssociation : 192|4@1+ (1,0) [0|15] ""  RadarFrontCenter
 SG_ VFC_Cloth07_Colour : 197|3@1+ (1,0) [0|7] ""  RadarFrontCenter
 SG_ VFC_Cloth07_RangeXBegin : 200|9@1+ (0.25,0) [0|127.75] "m"  RadarFrontCenter
 SG_ VFC_Cloth07_RangeXEnd : 209|9@1+ (0.5,0) [0|255.5] "m"  RadarFrontCenter
 SG_ VFC_Cloth07_ExistProb : 218|6@1+ (2,0) [0|100] "%"  RadarFrontCenter
 SG_ VFC_Cloth07_CurvChange : 224|24@1+ (1.86264514923096E-009,-0.015625) [-0.015625|0.0156249981373548] "1/m^2"  RadarFrontCenter
 SG_ VFC_Cloth07_Curv : 248|15@1+ (3.814697265625E-006,-0.0625) [-0.0625|0.0624961853027344] "1/m"  RadarFrontCenter
 SG_ VFC_Cloth07_PyStdDev : 263|9@1+ (0.0078125,0) [0|3.9921875] "m"  RadarFrontCenter
 SG_ VFC_Cloth07_Py : 272|12@1+ (0.0078125,-16) [-16|15.9921875] "m"  RadarFrontCenter
 SG_ VFC_Cloth07_OrientationYaw : 284|12@1+ (0.00048828125,-1) [-1|0.99951171875] "rad"  RadarFrontCenter
 SG_ VFC_Cloth07_Width : 296|8@1+ (0.01,0) [0|2.55] "m"  RadarFrontCenter
 SG_ VFC_Cloth07_Type : 304|4@1+ (1,0) [0|15] ""  RadarFrontCenter
 SG_ VFC_Cloth08_LaneAssociation : 352|4@1+ (1,0) [0|15] ""  RadarFrontCenter
 SG_ VFC_Cloth08_Colour : 357|3@1+ (1,0) [0|7] ""  RadarFrontCenter
 SG_ VFC_Cloth08_RangeXBegin : 360|9@1+ (0.25,0) [0|127.75] "m"  RadarFrontCenter
 SG_ VFC_Cloth08_RangeXEnd : 369|9@1+ (0.5,0) [0|255.5] "m"  RadarFrontCenter
 SG_ VFC_Cloth08_ExistProb : 378|6@1+ (2,0) [0|100] "%"  RadarFrontCenter
 SG_ VFC_Cloth08_CurvChange : 384|24@1+ (1.86264514923096E-009,-0.015625) [-0.015625|0.0156249981373548] "1/m^2"  RadarFrontCenter
 SG_ VFC_Cloth08_Curv : 408|15@1+ (3.814697265625E-006,-0.0625) [-0.0625|0.0624961853027344] "1/m"  RadarFrontCenter
 SG_ VFC_Cloth08_PyStdDev : 423|9@1+ (0.0078125,0) [0|3.9921875] "m"  RadarFrontCenter
 SG_ VFC_Cloth08_Py : 432|12@1+ (0.0078125,-16) [-16|15.9921875] "m"  RadarFrontCenter
 SG_ VFC_Cloth08_OrientationYaw : 444|12@1+ (0.00048828125,-1) [-1|0.99951171875] "rad"  RadarFrontCenter
 SG_ VFC_Cloth08_Width : 456|8@1+ (0.01,0) [0|2.55] "m"  RadarFrontCenter
 SG_ VFC_Cloth08_Type : 464|4@1+ (1,0) [0|15] ""  RadarFrontCenter

CM_ SG_ 67 VFC_Obj13A_CRC "CRC - Autosar E2E Profile 5";
CM_ SG_ 67 VFC_Obj13A_AliveCtr "Alive counter - Autosar E2E Profile 5";
CM_ SG_ 67 VFC_Obj13A_ProtBlockCtr "Protocol-Signal: Block-Counter";
CM_ SG_ 67 VFC_Obj13A_ID "Unique Object ID";
CM_ SG_ 67 VFC_Obj13A_AxStdDev "Standard deviation of Object acceleration in longitudinal direction";
CM_ SG_ 67 VFC_Obj13A_Dx "Object distance in longitudinal direction";
CM_ SG_ 67 VFC_Obj13A_Type "Classification of the object";
CM_ SG_ 67 VFC_Obj13A_Dy "Object distance in lateral direction";
CM_ SG_ 67 VFC_Obj13A_Measured "Indicator if the object detected is measured or predicted";
CM_ SG_ 67 VFC_Obj13A_Vx "Object velocity in longitudinal direction";
CM_ SG_ 67 VFC_Obj13A_MeasSource "Bitfield for the measurement programs from which this object originates
Bit 0: MOD
Bit 1: PDET
Bit 2: OFT
Bit 3: OLS
Bit 4: RESERVED";
CM_ SG_ 67 VFC_Obj13A_Vy "Object velocity in lateral direction";
CM_ SG_ 67 VFC_Obj13A_DirIndicator "The detected direction indicator lights";
CM_ SG_ 67 VFC_Obj13A_BrakeLight "The number of detected lights. More confident if more lights are detected.";
CM_ SG_ 67 VFC_Obj13A_Ax "Object acceleration in longitudinal direction";
CM_ SG_ 67 VFC_Obj13A_CompletelyInImg "indicator if the object is completely measured in the image";
CM_ SG_ 67 VFC_Obj13A_ProbExist "Object existence probability";
CM_ SG_ 67 VFC_Obj13A_Ay "Object acceleration in lateral direction";
CM_ SG_ 67 VFC_Obj13A_AyStdDev "Standard deviation of Object acceleration in lateral direction";
CM_ SG_ 67 VFC_Obj13A_DxStdDev "Standard deviation of Object distance in longitudinal direction";
CM_ SG_ 67 VFC_Obj13A_ProbMovingLat "Probability of object moving laterally";
CM_ SG_ 67 VFC_Obj13A_DyStdDev "Standard deviation of Object distance in lateral direction";
CM_ SG_ 67 VFC_Obj13A_ProbMovingLong "Probability of object moving longitudinally";
CM_ SG_ 67 VFC_Obj13A_VxStdDev "Standard deviation of Object velocity in longitudinal direction";
CM_ SG_ 67 VFC_Obj13A_HeadingAngleStdDev "Standard deviation of object Heading angle";
CM_ SG_ 67 VFC_Obj13A_VyStdDev "Standard deviation of Object velocity in lateral direction";
CM_ SG_ 67 VFC_Obj13A_HeightStdDev "Standard deviation of object height";
CM_ SG_ 67 VFC_Obj13A_Height "Height of the object";
CM_ SG_ 67 VFC_Obj13A_Length "Length of the object";
CM_ SG_ 67 VFC_Obj13A_HeadingAngle "Heading angle of the object";
CM_ SG_ 67 VFC_Obj13A_NormAx "Normalised Object acceleration in longitudinal direction";
CM_ SG_ 67 VFC_Obj13A_NormVyEdgeLeftStdDev "Standard deviation of Normalised velocity of the ACCS left object edge in lateral direction";
CM_ SG_ 67 VFC_Obj13A_NormVyEdgeLeft "Normalised velocity of the ACCS left object edge in lateral direction";
CM_ SG_ 67 VFC_Obj13A_EdgeBottom "In ACCS coordinates; corresponds to tan(viewing angle of bottom object edge)";
CM_ SG_ 67 VFC_Obj13A_NormVyEdgeRight "Normalised velocity of the ACCS right object edge in lateral direction";
CM_ SG_ 67 VFC_Obj13A_Width "Width of the object";
CM_ SG_ 67 VFC_Obj13A_NormVx "Normalised Object velocity in longitudinal direction";
CM_ SG_ 67 VFC_Obj13A_NormVyEdgeRightStdDev "Standard deviation of Normalised velocity of the ACCS right object edge in lateral direction";
CM_ SG_ 67 VFC_Obj13A_NormAxStdDev "Standard deviation of Normalised Object acceleration in longitudinal direction";
CM_ SG_ 67 VFC_Obj13A_ScaleChange "A scale change of of the detected object";
CM_ SG_ 67 VFC_Obj13A_ScaleChngStdDev "Standard deviation of object scale change";
CM_ SG_ 67 VFC_Obj13A_Reliability "The bitfield shows if the signal quality is assumed to be sufficient for functions with safety target -no false positives-
Bit 0: DYNAMIC
Bit 1: SEMSEG_SURFACE
Bit 2: WDD_CRITICAL
Bit 3: GOD_CONFIRMED
Bit 4: RESTRICTED
Bit 5: ISO26262_SAFE";
CM_ SG_ 67 VFC_Obj13A_NormVxStdDev "Standard deviation of Normalised Object velocity in longitudinal direction";
CM_ SG_ 67 VFC_Obj13A_TypeProb "Probability of the classified object type";
CM_ SG_ 67 VFC_Obj13A_LengthStdDev "Standard deviation of object length";
CM_ SG_ 67 VFC_Obj13A_WidthStdDev "Standard deviation of object width";
CM_ SG_ 67 VFC_Obj13A_EdgeMid "In ACCS coordinates; corresponds to tan(viewing angle of middle object edge)";
CM_ SG_ 67 VFC_Obj13A_EdgeLeft "In ACCS coordinates; corresponds to tan(viewing angle of left object edge)";
CM_ SG_ 67 VFC_Obj13A_EdgeRight "In ACCS coordinates; corresponds to tan(viewing angle of right object edge)";
CM_ SG_ 67 VFC_Obj13A_VisibleView "The visible view of the detected object";
CM_ SG_ 67 VFC_Obj13A_EdgeLeftStdDev "Standard deviation of the ACCS left object edge";
CM_ SG_ 67 VFC_Obj13A_EdgeTop "In ACCS coordinates; corresponds to tan(viewing angle of top object edge)";
CM_ SG_ 67 VFC_Obj13A_HeadOrientation "The orientation of the head of cyclists or pedestrians that are detected";
CM_ SG_ 67 VFC_Obj13A_EdgeMidStdDev "Standard deviation of the ACCS middle object edge";
CM_ SG_ 67 VFC_Obj13A_EdgeRightStdDev "Standard deviation of the ACCS right object edge";
CM_ SG_ 67 VFC_Obj13A_EdgeTopStdDev "Standard deviation of the ACCS top object edge";
CM_ SG_ 67 VFC_Obj13A_EdgeBottomStdDev "Standard deviation of the ACCS bottom object edge";
CM_ SG_ 67 VFC_Obj13A_ClassifiedView "The classified view of object to be used in connection with Heading angle";
CM_ SG_ 68 VFC_Obj14A_CRC "CRC - Autosar E2E Profile 5";
CM_ SG_ 68 VFC_Obj14A_AliveCtr "Alive counter - Autosar E2E Profile 5";
CM_ SG_ 68 VFC_Obj14A_ProtBlockCtr "Protocol-Signal: Block-Counter";
CM_ SG_ 68 VFC_Obj14A_ID "Unique Object ID";
CM_ SG_ 68 VFC_Obj14A_AxStdDev "Standard deviation of Object acceleration in longitudinal direction";
CM_ SG_ 68 VFC_Obj14A_Dx "Object distance in longitudinal direction";
CM_ SG_ 68 VFC_Obj14A_Type "Classification of the object";
CM_ SG_ 68 VFC_Obj14A_Dy "Object distance in lateral direction";
CM_ SG_ 68 VFC_Obj14A_Measured "Indicator if the object detected is measured or predicted";
CM_ SG_ 68 VFC_Obj14A_Vx "Object velocity in longitudinal direction";
CM_ SG_ 68 VFC_Obj14A_MeasSource "Bitfield for the measurement programs from which this object originates
Bit 0: MOD
Bit 1: PDET
Bit 2: OFT
Bit 3: OLS
Bit 4: RESERVED";
CM_ SG_ 68 VFC_Obj14A_Vy "Object velocity in lateral direction";
CM_ SG_ 68 VFC_Obj14A_DirIndicator "The detected direction indicator lights";
CM_ SG_ 68 VFC_Obj14A_BrakeLight "The number of detected lights. More confident if more lights are detected.";
CM_ SG_ 68 VFC_Obj14A_Ax "Object acceleration in longitudinal direction";
CM_ SG_ 68 VFC_Obj14A_CompletelyInImg "indicator if the object is completely measured in the image";
CM_ SG_ 68 VFC_Obj14A_ProbExist "Object existence probability";
CM_ SG_ 68 VFC_Obj14A_Ay "Object acceleration in lateral direction";
CM_ SG_ 68 VFC_Obj14A_AyStdDev "Standard deviation of Object acceleration in lateral direction";
CM_ SG_ 68 VFC_Obj14A_DxStdDev "Standard deviation of Object distance in longitudinal direction";
CM_ SG_ 68 VFC_Obj14A_ProbMovingLat "Probability of object moving laterally";
CM_ SG_ 68 VFC_Obj14A_DyStdDev "Standard deviation of Object distance in lateral direction";
CM_ SG_ 68 VFC_Obj14A_ProbMovingLong "Probability of object moving longitudinally";
CM_ SG_ 68 VFC_Obj14A_VxStdDev "Standard deviation of Object velocity in longitudinal direction";
CM_ SG_ 68 VFC_Obj14A_HeadingAngleStdDev "Standard deviation of object Heading angle";
CM_ SG_ 68 VFC_Obj14A_VyStdDev "Standard deviation of Object velocity in lateral direction";
CM_ SG_ 68 VFC_Obj14A_HeightStdDev "Standard deviation of object height";
CM_ SG_ 68 VFC_Obj14A_Height "Height of the object";
CM_ SG_ 68 VFC_Obj14A_Length "Length of the object";
CM_ SG_ 68 VFC_Obj14A_HeadingAngle "Heading angle of the object";
CM_ SG_ 68 VFC_Obj14A_NormAx "Normalised Object acceleration in longitudinal direction";
CM_ SG_ 68 VFC_Obj14A_NormVyEdgeLeftStdDev "Standard deviation of Normalised velocity of the ACCS left object edge in lateral direction";
CM_ SG_ 68 VFC_Obj14A_NormVyEdgeLeft "Normalised velocity of the ACCS left object edge in lateral direction";
CM_ SG_ 68 VFC_Obj14A_EdgeBottom "In ACCS coordinates; corresponds to tan(viewing angle of bottom object edge)";
CM_ SG_ 68 VFC_Obj14A_NormVyEdgeRight "Normalised velocity of the ACCS right object edge in lateral direction";
CM_ SG_ 68 VFC_Obj14A_Width "Width of the object";
CM_ SG_ 68 VFC_Obj14A_NormVx "Normalised Object velocity in longitudinal direction";
CM_ SG_ 68 VFC_Obj14A_NormVyEdgeRightStdDev "Standard deviation of Normalised velocity of the ACCS right object edge in lateral direction";
CM_ SG_ 68 VFC_Obj14A_NormAxStdDev "Standard deviation of Normalised Object acceleration in longitudinal direction";
CM_ SG_ 68 VFC_Obj14A_ScaleChange "A scale change of of the detected object";
CM_ SG_ 68 VFC_Obj14A_ScaleChngStdDev "Standard deviation of object scale change";
CM_ SG_ 68 VFC_Obj14A_Reliability "The bitfield shows if the signal quality is assumed to be sufficient for functions with safety target -no false positives-
Bit 0: DYNAMIC
Bit 1: SEMSEG_SURFACE
Bit 2: WDD_CRITICAL
Bit 3: GOD_CONFIRMED
Bit 4: RESTRICTED
Bit 5: ISO26262_SAFE";
CM_ SG_ 68 VFC_Obj14A_NormVxStdDev "Standard deviation of Normalised Object velocity in longitudinal direction";
CM_ SG_ 68 VFC_Obj14A_TypeProb "Probability of the classified object type";
CM_ SG_ 68 VFC_Obj14A_LengthStdDev "Standard deviation of object length";
CM_ SG_ 68 VFC_Obj14A_WidthStdDev "Standard deviation of object width";
CM_ SG_ 68 VFC_Obj14A_EdgeMid "In ACCS coordinates; corresponds to tan(viewing angle of middle object edge)";
CM_ SG_ 68 VFC_Obj14A_EdgeLeft "In ACCS coordinates; corresponds to tan(viewing angle of left object edge)";
CM_ SG_ 68 VFC_Obj14A_EdgeRight "In ACCS coordinates; corresponds to tan(viewing angle of right object edge)";
CM_ SG_ 68 VFC_Obj14A_VisibleView "The visible view of the detected object";
CM_ SG_ 68 VFC_Obj14A_EdgeLeftStdDev "Standard deviation of the ACCS left object edge";
CM_ SG_ 68 VFC_Obj14A_EdgeTop "In ACCS coordinates; corresponds to tan(viewing angle of top object edge)";
CM_ SG_ 68 VFC_Obj14A_HeadOrientation "The orientation of the head of cyclists or pedestrians that are detected";
CM_ SG_ 68 VFC_Obj14A_EdgeMidStdDev "Standard deviation of the ACCS middle object edge";
CM_ SG_ 68 VFC_Obj14A_EdgeRightStdDev "Standard deviation of the ACCS right object edge";
CM_ SG_ 68 VFC_Obj14A_EdgeTopStdDev "Standard deviation of the ACCS top object edge";
CM_ SG_ 68 VFC_Obj14A_EdgeBottomStdDev "Standard deviation of the ACCS bottom object edge";
CM_ SG_ 68 VFC_Obj14A_ClassifiedView "The classified view of object to be used in connection with Heading angle";
CM_ SG_ 69 VFC_Obj15A_CRC "CRC - Autosar E2E Profile 5";
CM_ SG_ 69 VFC_Obj15A_AliveCtr "Alive counter - Autosar E2E Profile 5";
CM_ SG_ 69 VFC_Obj15A_ProtBlockCtr "Protocol-Signal: Block-Counter";
CM_ SG_ 69 VFC_Obj15A_ID "Unique Object ID";
CM_ SG_ 69 VFC_Obj15A_AxStdDev "Standard deviation of Object acceleration in longitudinal direction";
CM_ SG_ 69 VFC_Obj15A_Dx "Object distance in longitudinal direction";
CM_ SG_ 69 VFC_Obj15A_Type "Classification of the object";
CM_ SG_ 69 VFC_Obj15A_Dy "Object distance in lateral direction";
CM_ SG_ 69 VFC_Obj15A_Measured "Indicator if the object detected is measured or predicted";
CM_ SG_ 69 VFC_Obj15A_Vx "Object velocity in longitudinal direction";
CM_ SG_ 69 VFC_Obj15A_MeasSource "Bitfield for the measurement programs from which this object originates
Bit 0: MOD
Bit 1: PDET
Bit 2: OFT
Bit 3: OLS
Bit 4: RESERVED";
CM_ SG_ 69 VFC_Obj15A_Vy "Object velocity in lateral direction";
CM_ SG_ 69 VFC_Obj15A_DirIndicator "The detected direction indicator lights";
CM_ SG_ 69 VFC_Obj15A_BrakeLight "The number of detected lights. More confident if more lights are detected.";
CM_ SG_ 69 VFC_Obj15A_Ax "Object acceleration in longitudinal direction";
CM_ SG_ 69 VFC_Obj15A_CompletelyInImg "indicator if the object is completely measured in the image";
CM_ SG_ 69 VFC_Obj15A_ProbExist "Object existence probability";
CM_ SG_ 69 VFC_Obj15A_Ay "Object acceleration in lateral direction";
CM_ SG_ 69 VFC_Obj15A_AyStdDev "Standard deviation of Object acceleration in lateral direction";
CM_ SG_ 69 VFC_Obj15A_DxStdDev "Standard deviation of Object distance in longitudinal direction";
CM_ SG_ 69 VFC_Obj15A_ProbMovingLat "Probability of object moving laterally";
CM_ SG_ 69 VFC_Obj15A_DyStdDev "Standard deviation of Object distance in lateral direction";
CM_ SG_ 69 VFC_Obj15A_ProbMovingLong "Probability of object moving longitudinally";
CM_ SG_ 69 VFC_Obj15A_VxStdDev "Standard deviation of Object velocity in longitudinal direction";
CM_ SG_ 69 VFC_Obj15A_HeadingAngleStdDev "Standard deviation of object Heading angle";
CM_ SG_ 69 VFC_Obj15A_VyStdDev "Standard deviation of Object velocity in lateral direction";
CM_ SG_ 69 VFC_Obj15A_HeightStdDev "Standard deviation of object height";
CM_ SG_ 69 VFC_Obj15A_Height "Height of the object";
CM_ SG_ 69 VFC_Obj15A_Length "Length of the object";
CM_ SG_ 69 VFC_Obj15A_HeadingAngle "Heading angle of the object";
CM_ SG_ 69 VFC_Obj15A_NormAx "Normalised Object acceleration in longitudinal direction";
CM_ SG_ 69 VFC_Obj15A_NormVyEdgeLeftStdDev "Standard deviation of Normalised velocity of the ACCS left object edge in lateral direction";
CM_ SG_ 69 VFC_Obj15A_NormVyEdgeLeft "Normalised velocity of the ACCS left object edge in lateral direction";
CM_ SG_ 69 VFC_Obj15A_EdgeBottom "In ACCS coordinates; corresponds to tan(viewing angle of bottom object edge)";
CM_ SG_ 69 VFC_Obj15A_NormVyEdgeRight "Normalised velocity of the ACCS right object edge in lateral direction";
CM_ SG_ 69 VFC_Obj15A_Width "Width of the object";
CM_ SG_ 69 VFC_Obj15A_NormVx "Normalised Object velocity in longitudinal direction";
CM_ SG_ 69 VFC_Obj15A_NormVyEdgeRightStdDev "Standard deviation of Normalised velocity of the ACCS right object edge in lateral direction";
CM_ SG_ 69 VFC_Obj15A_NormAxStdDev "Standard deviation of Normalised Object acceleration in longitudinal direction";
CM_ SG_ 69 VFC_Obj15A_ScaleChange "A scale change of of the detected object";
CM_ SG_ 69 VFC_Obj15A_ScaleChngStdDev "Standard deviation of object scale change";
CM_ SG_ 69 VFC_Obj15A_Reliability "The bitfield shows if the signal quality is assumed to be sufficient for functions with safety target -no false positives-
Bit 0: DYNAMIC
Bit 1: SEMSEG_SURFACE
Bit 2: WDD_CRITICAL
Bit 3: GOD_CONFIRMED
Bit 4: RESTRICTED
Bit 5: ISO26262_SAFE";
CM_ SG_ 69 VFC_Obj15A_NormVxStdDev "Standard deviation of Normalised Object velocity in longitudinal direction";
CM_ SG_ 69 VFC_Obj15A_TypeProb "Probability of the classified object type";
CM_ SG_ 69 VFC_Obj15A_LengthStdDev "Standard deviation of object length";
CM_ SG_ 69 VFC_Obj15A_WidthStdDev "Standard deviation of object width";
CM_ SG_ 69 VFC_Obj15A_EdgeMid "In ACCS coordinates; corresponds to tan(viewing angle of middle object edge)";
CM_ SG_ 69 VFC_Obj15A_EdgeLeft "In ACCS coordinates; corresponds to tan(viewing angle of left object edge)";
CM_ SG_ 69 VFC_Obj15A_EdgeRight "In ACCS coordinates; corresponds to tan(viewing angle of right object edge)";
CM_ SG_ 69 VFC_Obj15A_VisibleView "The visible view of the detected object";
CM_ SG_ 69 VFC_Obj15A_EdgeLeftStdDev "Standard deviation of the ACCS left object edge";
CM_ SG_ 69 VFC_Obj15A_EdgeTop "In ACCS coordinates; corresponds to tan(viewing angle of top object edge)";
CM_ SG_ 69 VFC_Obj15A_HeadOrientation "The orientation of the head of cyclists or pedestrians that are detected";
CM_ SG_ 69 VFC_Obj15A_EdgeMidStdDev "Standard deviation of the ACCS middle object edge";
CM_ SG_ 69 VFC_Obj15A_EdgeRightStdDev "Standard deviation of the ACCS right object edge";
CM_ SG_ 69 VFC_Obj15A_EdgeTopStdDev "Standard deviation of the ACCS top object edge";
CM_ SG_ 69 VFC_Obj15A_EdgeBottomStdDev "Standard deviation of the ACCS bottom object edge";
CM_ SG_ 69 VFC_Obj15A_ClassifiedView "The classified view of object to be used in connection with Heading angle";
CM_ SG_ 70 VFC_Obj16A_CRC "CRC - Autosar E2E Profile 5";
CM_ SG_ 70 VFC_Obj16A_AliveCtr "Alive counter - Autosar E2E Profile 5";
CM_ SG_ 70 VFC_Obj16A_ProtBlockCtr "Protocol-Signal: Block-Counter";
CM_ SG_ 70 VFC_Obj16A_ID "Unique Object ID";
CM_ SG_ 70 VFC_Obj16A_AxStdDev "Standard deviation of Object acceleration in longitudinal direction";
CM_ SG_ 70 VFC_Obj16A_Dx "Object distance in longitudinal direction";
CM_ SG_ 70 VFC_Obj16A_Type "Classification of the object";
CM_ SG_ 70 VFC_Obj16A_Dy "Object distance in lateral direction";
CM_ SG_ 70 VFC_Obj16A_Measured "Indicator if the object detected is measured or predicted";
CM_ SG_ 70 VFC_Obj16A_Vx "Object velocity in longitudinal direction";
CM_ SG_ 70 VFC_Obj16A_MeasSource "Bitfield for the measurement programs from which this object originates
Bit 0: MOD
Bit 1: PDET
Bit 2: OFT
Bit 3: OLS
Bit 4: RESERVED";
CM_ SG_ 70 VFC_Obj16A_Vy "Object velocity in lateral direction";
CM_ SG_ 70 VFC_Obj16A_DirIndicator "The detected direction indicator lights";
CM_ SG_ 70 VFC_Obj16A_BrakeLight "The number of detected lights. More confident if more lights are detected.";
CM_ SG_ 70 VFC_Obj16A_Ax "Object acceleration in longitudinal direction";
CM_ SG_ 70 VFC_Obj16A_CompletelyInImg "indicator if the object is completely measured in the image";
CM_ SG_ 70 VFC_Obj16A_ProbExist "Object existence probability";
CM_ SG_ 70 VFC_Obj16A_Ay "Object acceleration in lateral direction";
CM_ SG_ 70 VFC_Obj16A_AyStdDev "Standard deviation of Object acceleration in lateral direction";
CM_ SG_ 70 VFC_Obj16A_DxStdDev "Standard deviation of Object distance in longitudinal direction";
CM_ SG_ 70 VFC_Obj16A_ProbMovingLat "Probability of object moving laterally";
CM_ SG_ 70 VFC_Obj16A_DyStdDev "Standard deviation of Object distance in lateral direction";
CM_ SG_ 70 VFC_Obj16A_ProbMovingLong "Probability of object moving longitudinally";
CM_ SG_ 70 VFC_Obj16A_VxStdDev "Standard deviation of Object velocity in longitudinal direction";
CM_ SG_ 70 VFC_Obj16A_HeadingAngleStdDev "Standard deviation of object Heading angle";
CM_ SG_ 70 VFC_Obj16A_VyStdDev "Standard deviation of Object velocity in lateral direction";
CM_ SG_ 70 VFC_Obj16A_HeightStdDev "Standard deviation of object height";
CM_ SG_ 70 VFC_Obj16A_Height "Height of the object";
CM_ SG_ 70 VFC_Obj16A_Length "Length of the object";
CM_ SG_ 70 VFC_Obj16A_HeadingAngle "Heading angle of the object";
CM_ SG_ 70 VFC_Obj16A_NormAx "Normalised Object acceleration in longitudinal direction";
CM_ SG_ 70 VFC_Obj16A_NormVyEdgeLeftStdDev "Standard deviation of Normalised velocity of the ACCS left object edge in lateral direction";
CM_ SG_ 70 VFC_Obj16A_NormVyEdgeLeft "Normalised velocity of the ACCS left object edge in lateral direction";
CM_ SG_ 70 VFC_Obj16A_EdgeBottom "In ACCS coordinates; corresponds to tan(viewing angle of bottom object edge)";
CM_ SG_ 70 VFC_Obj16A_NormVyEdgeRight "Normalised velocity of the ACCS right object edge in lateral direction";
CM_ SG_ 70 VFC_Obj16A_Width "Width of the object";
CM_ SG_ 70 VFC_Obj16A_NormVx "Normalised Object velocity in longitudinal direction";
CM_ SG_ 70 VFC_Obj16A_NormVyEdgeRightStdDev "Standard deviation of Normalised velocity of the ACCS right object edge in lateral direction";
CM_ SG_ 70 VFC_Obj16A_NormAxStdDev "Standard deviation of Normalised Object acceleration in longitudinal direction";
CM_ SG_ 70 VFC_Obj16A_ScaleChange "A scale change of of the detected object";
CM_ SG_ 70 VFC_Obj16A_ScaleChngStdDev "Standard deviation of object scale change";
CM_ SG_ 70 VFC_Obj16A_Reliability "The bitfield shows if the signal quality is assumed to be sufficient for functions with safety target -no false positives-
Bit 0: DYNAMIC
Bit 1: SEMSEG_SURFACE
Bit 2: WDD_CRITICAL
Bit 3: GOD_CONFIRMED
Bit 4: RESTRICTED
Bit 5: ISO26262_SAFE";
CM_ SG_ 70 VFC_Obj16A_NormVxStdDev "Standard deviation of Normalised Object velocity in longitudinal direction";
CM_ SG_ 70 VFC_Obj16A_TypeProb "Probability of the classified object type";
CM_ SG_ 70 VFC_Obj16A_LengthStdDev "Standard deviation of object length";
CM_ SG_ 70 VFC_Obj16A_WidthStdDev "Standard deviation of object width";
CM_ SG_ 70 VFC_Obj16A_EdgeMid "In ACCS coordinates; corresponds to tan(viewing angle of middle object edge)";
CM_ SG_ 70 VFC_Obj16A_EdgeLeft "In ACCS coordinates; corresponds to tan(viewing angle of left object edge)";
CM_ SG_ 70 VFC_Obj16A_EdgeRight "In ACCS coordinates; corresponds to tan(viewing angle of right object edge)";
CM_ SG_ 70 VFC_Obj16A_VisibleView "The visible view of the detected object";
CM_ SG_ 70 VFC_Obj16A_EdgeLeftStdDev "Standard deviation of the ACCS left object edge";
CM_ SG_ 70 VFC_Obj16A_EdgeTop "In ACCS coordinates; corresponds to tan(viewing angle of top object edge)";
CM_ SG_ 70 VFC_Obj16A_HeadOrientation "The orientation of the head of cyclists or pedestrians that are detected";
CM_ SG_ 70 VFC_Obj16A_EdgeMidStdDev "Standard deviation of the ACCS middle object edge";
CM_ SG_ 70 VFC_Obj16A_EdgeRightStdDev "Standard deviation of the ACCS right object edge";
CM_ SG_ 70 VFC_Obj16A_EdgeTopStdDev "Standard deviation of the ACCS top object edge";
CM_ SG_ 70 VFC_Obj16A_EdgeBottomStdDev "Standard deviation of the ACCS bottom object edge";
CM_ SG_ 70 VFC_Obj16A_ClassifiedView "The classified view of object to be used in connection with Heading angle";
CM_ SG_ 71 VFC_Obj17A_CRC "CRC - Autosar E2E Profile 5";
CM_ SG_ 71 VFC_Obj17A_AliveCtr "Alive counter - Autosar E2E Profile 5";
CM_ SG_ 71 VFC_Obj17A_ProtBlockCtr "Protocol-Signal: Block-Counter";
CM_ SG_ 71 VFC_Obj17A_ID "Unique Object ID";
CM_ SG_ 71 VFC_Obj17A_AxStdDev "Standard deviation of Object acceleration in longitudinal direction";
CM_ SG_ 71 VFC_Obj17A_Dx "Object distance in longitudinal direction";
CM_ SG_ 71 VFC_Obj17A_Type "Classification of the object";
CM_ SG_ 71 VFC_Obj17A_Dy "Object distance in lateral direction";
CM_ SG_ 71 VFC_Obj17A_Measured "Indicator if the object detected is measured or predicted";
CM_ SG_ 71 VFC_Obj17A_Vx "Object velocity in longitudinal direction";
CM_ SG_ 71 VFC_Obj17A_MeasSource "Bitfield for the measurement programs from which this object originates
Bit 0: MOD
Bit 1: PDET
Bit 2: OFT
Bit 3: OLS
Bit 4: RESERVED";
CM_ SG_ 71 VFC_Obj17A_Vy "Object velocity in lateral direction";
CM_ SG_ 71 VFC_Obj17A_DirIndicator "The detected direction indicator lights";
CM_ SG_ 71 VFC_Obj17A_BrakeLight "The number of detected lights. More confident if more lights are detected.";
CM_ SG_ 71 VFC_Obj17A_Ax "Object acceleration in longitudinal direction";
CM_ SG_ 71 VFC_Obj17A_CompletelyInImg "indicator if the object is completely measured in the image";
CM_ SG_ 71 VFC_Obj17A_ProbExist "Object existence probability";
CM_ SG_ 71 VFC_Obj17A_Ay "Object acceleration in lateral direction";
CM_ SG_ 71 VFC_Obj17A_AyStdDev "Standard deviation of Object acceleration in lateral direction";
CM_ SG_ 71 VFC_Obj17A_DxStdDev "Standard deviation of Object distance in longitudinal direction";
CM_ SG_ 71 VFC_Obj17A_ProbMovingLat "Probability of object moving laterally";
CM_ SG_ 71 VFC_Obj17A_DyStdDev "Standard deviation of Object distance in lateral direction";
CM_ SG_ 71 VFC_Obj17A_ProbMovingLong "Probability of object moving longitudinally";
CM_ SG_ 71 VFC_Obj17A_VxStdDev "Standard deviation of Object velocity in longitudinal direction";
CM_ SG_ 71 VFC_Obj17A_HeadingAngleStdDev "Standard deviation of object Heading angle";
CM_ SG_ 71 VFC_Obj17A_VyStdDev "Standard deviation of Object velocity in lateral direction";
CM_ SG_ 71 VFC_Obj17A_HeightStdDev "Standard deviation of object height";
CM_ SG_ 71 VFC_Obj17A_Height "Height of the object";
CM_ SG_ 71 VFC_Obj17A_Length "Length of the object";
CM_ SG_ 71 VFC_Obj17A_HeadingAngle "Heading angle of the object";
CM_ SG_ 71 VFC_Obj17A_NormAx "Normalised Object acceleration in longitudinal direction";
CM_ SG_ 71 VFC_Obj17A_NormVyEdgeLeftStdDev "Standard deviation of Normalised velocity of the ACCS left object edge in lateral direction";
CM_ SG_ 71 VFC_Obj17A_NormVyEdgeLeft "Normalised velocity of the ACCS left object edge in lateral direction";
CM_ SG_ 71 VFC_Obj17A_EdgeBottom "In ACCS coordinates; corresponds to tan(viewing angle of bottom object edge)";
CM_ SG_ 71 VFC_Obj17A_NormVyEdgeRight "Normalised velocity of the ACCS right object edge in lateral direction";
CM_ SG_ 71 VFC_Obj17A_Width "Width of the object";
CM_ SG_ 71 VFC_Obj17A_NormVx "Normalised Object velocity in longitudinal direction";
CM_ SG_ 71 VFC_Obj17A_NormVyEdgeRightStdDev "Standard deviation of Normalised velocity of the ACCS right object edge in lateral direction";
CM_ SG_ 71 VFC_Obj17A_NormAxStdDev "Standard deviation of Normalised Object acceleration in longitudinal direction";
CM_ SG_ 71 VFC_Obj17A_ScaleChange "A scale change of of the detected object";
CM_ SG_ 71 VFC_Obj17A_ScaleChngStdDev "Standard deviation of object scale change";
CM_ SG_ 71 VFC_Obj17A_Reliability "The bitfield shows if the signal quality is assumed to be sufficient for functions with safety target -no false positives-
Bit 0: DYNAMIC
Bit 1: SEMSEG_SURFACE
Bit 2: WDD_CRITICAL
Bit 3: GOD_CONFIRMED
Bit 4: RESTRICTED
Bit 5: ISO26262_SAFE";
CM_ SG_ 71 VFC_Obj17A_NormVxStdDev "Standard deviation of Normalised Object velocity in longitudinal direction";
CM_ SG_ 71 VFC_Obj17A_TypeProb "Probability of the classified object type";
CM_ SG_ 71 VFC_Obj17A_LengthStdDev "Standard deviation of object length";
CM_ SG_ 71 VFC_Obj17A_WidthStdDev "Standard deviation of object width";
CM_ SG_ 71 VFC_Obj17A_EdgeMid "In ACCS coordinates; corresponds to tan(viewing angle of middle object edge)";
CM_ SG_ 71 VFC_Obj17A_EdgeLeft "In ACCS coordinates; corresponds to tan(viewing angle of left object edge)";
CM_ SG_ 71 VFC_Obj17A_EdgeRight "In ACCS coordinates; corresponds to tan(viewing angle of right object edge)";
CM_ SG_ 71 VFC_Obj17A_VisibleView "The visible view of the detected object";
CM_ SG_ 71 VFC_Obj17A_EdgeLeftStdDev "Standard deviation of the ACCS left object edge";
CM_ SG_ 71 VFC_Obj17A_EdgeTop "In ACCS coordinates; corresponds to tan(viewing angle of top object edge)";
CM_ SG_ 71 VFC_Obj17A_HeadOrientation "The orientation of the head of cyclists or pedestrians that are detected";
CM_ SG_ 71 VFC_Obj17A_EdgeMidStdDev "Standard deviation of the ACCS middle object edge";
CM_ SG_ 71 VFC_Obj17A_EdgeRightStdDev "Standard deviation of the ACCS right object edge";
CM_ SG_ 71 VFC_Obj17A_EdgeTopStdDev "Standard deviation of the ACCS top object edge";
CM_ SG_ 71 VFC_Obj17A_EdgeBottomStdDev "Standard deviation of the ACCS bottom object edge";
CM_ SG_ 71 VFC_Obj17A_ClassifiedView "The classified view of object to be used in connection with Heading angle";
CM_ SG_ 72 VFC_Obj18A_CRC "CRC - Autosar E2E Profile 5";
CM_ SG_ 72 VFC_Obj18A_AliveCtr "Alive counter - Autosar E2E Profile 5";
CM_ SG_ 72 VFC_Obj18A_ProtBlockCtr "Protocol-Signal: Block-Counter";
CM_ SG_ 72 VFC_Obj18A_ID "Unique Object ID";
CM_ SG_ 72 VFC_Obj18A_AxStdDev "Standard deviation of Object acceleration in longitudinal direction";
CM_ SG_ 72 VFC_Obj18A_Dx "Object distance in longitudinal direction";
CM_ SG_ 72 VFC_Obj18A_Type "Classification of the object";
CM_ SG_ 72 VFC_Obj18A_Dy "Object distance in lateral direction";
CM_ SG_ 72 VFC_Obj18A_Measured "Indicator if the object detected is measured or predicted";
CM_ SG_ 72 VFC_Obj18A_Vx "Object velocity in longitudinal direction";
CM_ SG_ 72 VFC_Obj18A_MeasSource "Bitfield for the measurement programs from which this object originates
Bit 0: MOD
Bit 1: PDET
Bit 2: OFT
Bit 3: OLS
Bit 4: RESERVED";
CM_ SG_ 72 VFC_Obj18A_Vy "Object velocity in lateral direction";
CM_ SG_ 72 VFC_Obj18A_DirIndicator "The detected direction indicator lights";
CM_ SG_ 72 VFC_Obj18A_BrakeLight "The number of detected lights. More confident if more lights are detected.";
CM_ SG_ 72 VFC_Obj18A_Ax "Object acceleration in longitudinal direction";
CM_ SG_ 72 VFC_Obj18A_CompletelyInImg "indicator if the object is completely measured in the image";
CM_ SG_ 72 VFC_Obj18A_ProbExist "Object existence probability";
CM_ SG_ 72 VFC_Obj18A_Ay "Object acceleration in lateral direction";
CM_ SG_ 72 VFC_Obj18A_AyStdDev "Standard deviation of Object acceleration in lateral direction";
CM_ SG_ 72 VFC_Obj18A_DxStdDev "Standard deviation of Object distance in longitudinal direction";
CM_ SG_ 72 VFC_Obj18A_ProbMovingLat "Probability of object moving laterally";
CM_ SG_ 72 VFC_Obj18A_DyStdDev "Standard deviation of Object distance in lateral direction";
CM_ SG_ 72 VFC_Obj18A_ProbMovingLong "Probability of object moving longitudinally";
CM_ SG_ 72 VFC_Obj18A_VxStdDev "Standard deviation of Object velocity in longitudinal direction";
CM_ SG_ 72 VFC_Obj18A_HeadingAngleStdDev "Standard deviation of object Heading angle";
CM_ SG_ 72 VFC_Obj18A_VyStdDev "Standard deviation of Object velocity in lateral direction";
CM_ SG_ 72 VFC_Obj18A_HeightStdDev "Standard deviation of object height";
CM_ SG_ 72 VFC_Obj18A_Height "Height of the object";
CM_ SG_ 72 VFC_Obj18A_Length "Length of the object";
CM_ SG_ 72 VFC_Obj18A_HeadingAngle "Heading angle of the object";
CM_ SG_ 72 VFC_Obj18A_NormAx "Normalised Object acceleration in longitudinal direction";
CM_ SG_ 72 VFC_Obj18A_NormVyEdgeLeftStdDev "Standard deviation of Normalised velocity of the ACCS left object edge in lateral direction";
CM_ SG_ 72 VFC_Obj18A_NormVyEdgeLeft "Normalised velocity of the ACCS left object edge in lateral direction";
CM_ SG_ 72 VFC_Obj18A_EdgeBottom "In ACCS coordinates; corresponds to tan(viewing angle of bottom object edge)";
CM_ SG_ 72 VFC_Obj18A_NormVyEdgeRight "Normalised velocity of the ACCS right object edge in lateral direction";
CM_ SG_ 72 VFC_Obj18A_Width "Width of the object";
CM_ SG_ 72 VFC_Obj18A_NormVx "Normalised Object velocity in longitudinal direction";
CM_ SG_ 72 VFC_Obj18A_NormVyEdgeRightStdDev "Standard deviation of Normalised velocity of the ACCS right object edge in lateral direction";
CM_ SG_ 72 VFC_Obj18A_NormAxStdDev "Standard deviation of Normalised Object acceleration in longitudinal direction";
CM_ SG_ 72 VFC_Obj18A_ScaleChange "A scale change of of the detected object";
CM_ SG_ 72 VFC_Obj18A_ScaleChngStdDev "Standard deviation of object scale change";
CM_ SG_ 72 VFC_Obj18A_Reliability "The bitfield shows if the signal quality is assumed to be sufficient for functions with safety target -no false positives-
Bit 0: DYNAMIC
Bit 1: SEMSEG_SURFACE
Bit 2: WDD_CRITICAL
Bit 3: GOD_CONFIRMED
Bit 4: RESTRICTED
Bit 5: ISO26262_SAFE";
CM_ SG_ 72 VFC_Obj18A_NormVxStdDev "Standard deviation of Normalised Object velocity in longitudinal direction";
CM_ SG_ 72 VFC_Obj18A_TypeProb "Probability of the classified object type";
CM_ SG_ 72 VFC_Obj18A_LengthStdDev "Standard deviation of object length";
CM_ SG_ 72 VFC_Obj18A_WidthStdDev "Standard deviation of object width";
CM_ SG_ 72 VFC_Obj18A_EdgeMid "In ACCS coordinates; corresponds to tan(viewing angle of middle object edge)";
CM_ SG_ 72 VFC_Obj18A_EdgeLeft "In ACCS coordinates; corresponds to tan(viewing angle of left object edge)";
CM_ SG_ 72 VFC_Obj18A_EdgeRight "In ACCS coordinates; corresponds to tan(viewing angle of right object edge)";
CM_ SG_ 72 VFC_Obj18A_VisibleView "The visible view of the detected object";
CM_ SG_ 72 VFC_Obj18A_EdgeLeftStdDev "Standard deviation of the ACCS left object edge";
CM_ SG_ 72 VFC_Obj18A_EdgeTop "In ACCS coordinates; corresponds to tan(viewing angle of top object edge)";
CM_ SG_ 72 VFC_Obj18A_HeadOrientation "The orientation of the head of cyclists or pedestrians that are detected";
CM_ SG_ 72 VFC_Obj18A_EdgeMidStdDev "Standard deviation of the ACCS middle object edge";
CM_ SG_ 72 VFC_Obj18A_EdgeRightStdDev "Standard deviation of the ACCS right object edge";
CM_ SG_ 72 VFC_Obj18A_EdgeTopStdDev "Standard deviation of the ACCS top object edge";
CM_ SG_ 72 VFC_Obj18A_EdgeBottomStdDev "Standard deviation of the ACCS bottom object edge";
CM_ SG_ 72 VFC_Obj18A_ClassifiedView "The classified view of object to be used in connection with Heading angle";
CM_ SG_ 73 VFC_Obj19A_CRC "CRC - Autosar E2E Profile 5";
CM_ SG_ 73 VFC_Obj19A_AliveCtr "Alive counter - Autosar E2E Profile 5";
CM_ SG_ 73 VFC_Obj19A_ProtBlockCtr "Protocol-Signal: Block-Counter";
CM_ SG_ 73 VFC_Obj19A_ID "Unique Object ID";
CM_ SG_ 73 VFC_Obj19A_AxStdDev "Standard deviation of Object acceleration in longitudinal direction";
CM_ SG_ 73 VFC_Obj19A_Dx "Object distance in longitudinal direction";
CM_ SG_ 73 VFC_Obj19A_Type "Classification of the object";
CM_ SG_ 73 VFC_Obj19A_Dy "Object distance in lateral direction";
CM_ SG_ 73 VFC_Obj19A_Measured "Indicator if the object detected is measured or predicted";
CM_ SG_ 73 VFC_Obj19A_Vx "Object velocity in longitudinal direction";
CM_ SG_ 73 VFC_Obj19A_MeasSource "Bitfield for the measurement programs from which this object originates
Bit 0: MOD
Bit 1: PDET
Bit 2: OFT
Bit 3: OLS
Bit 4: RESERVED";
CM_ SG_ 73 VFC_Obj19A_Vy "Object velocity in lateral direction";
CM_ SG_ 73 VFC_Obj19A_DirIndicator "The detected direction indicator lights";
CM_ SG_ 73 VFC_Obj19A_BrakeLight "The number of detected lights. More confident if more lights are detected.";
CM_ SG_ 73 VFC_Obj19A_Ax "Object acceleration in longitudinal direction";
CM_ SG_ 73 VFC_Obj19A_CompletelyInImg "indicator if the object is completely measured in the image";
CM_ SG_ 73 VFC_Obj19A_ProbExist "Object existence probability";
CM_ SG_ 73 VFC_Obj19A_Ay "Object acceleration in lateral direction";
CM_ SG_ 73 VFC_Obj19A_AyStdDev "Standard deviation of Object acceleration in lateral direction";
CM_ SG_ 73 VFC_Obj19A_DxStdDev "Standard deviation of Object distance in longitudinal direction";
CM_ SG_ 73 VFC_Obj19A_ProbMovingLat "Probability of object moving laterally";
CM_ SG_ 73 VFC_Obj19A_DyStdDev "Standard deviation of Object distance in lateral direction";
CM_ SG_ 73 VFC_Obj19A_ProbMovingLong "Probability of object moving longitudinally";
CM_ SG_ 73 VFC_Obj19A_VxStdDev "Standard deviation of Object velocity in longitudinal direction";
CM_ SG_ 73 VFC_Obj19A_HeadingAngleStdDev "Standard deviation of object Heading angle";
CM_ SG_ 73 VFC_Obj19A_VyStdDev "Standard deviation of Object velocity in lateral direction";
CM_ SG_ 73 VFC_Obj19A_HeightStdDev "Standard deviation of object height";
CM_ SG_ 73 VFC_Obj19A_Height "Height of the object";
CM_ SG_ 73 VFC_Obj19A_Length "Length of the object";
CM_ SG_ 73 VFC_Obj19A_HeadingAngle "Heading angle of the object";
CM_ SG_ 73 VFC_Obj19A_NormAx "Normalised Object acceleration in longitudinal direction";
CM_ SG_ 73 VFC_Obj19A_NormVyEdgeLeftStdDev "Standard deviation of Normalised velocity of the ACCS left object edge in lateral direction";
CM_ SG_ 73 VFC_Obj19A_NormVyEdgeLeft "Normalised velocity of the ACCS left object edge in lateral direction";
CM_ SG_ 73 VFC_Obj19A_EdgeBottom "In ACCS coordinates; corresponds to tan(viewing angle of bottom object edge)";
CM_ SG_ 73 VFC_Obj19A_NormVyEdgeRight "Normalised velocity of the ACCS right object edge in lateral direction";
CM_ SG_ 73 VFC_Obj19A_Width "Width of the object";
CM_ SG_ 73 VFC_Obj19A_NormVx "Normalised Object velocity in longitudinal direction";
CM_ SG_ 73 VFC_Obj19A_NormVyEdgeRightStdDev "Standard deviation of Normalised velocity of the ACCS right object edge in lateral direction";
CM_ SG_ 73 VFC_Obj19A_NormAxStdDev "Standard deviation of Normalised Object acceleration in longitudinal direction";
CM_ SG_ 73 VFC_Obj19A_ScaleChange "A scale change of of the detected object";
CM_ SG_ 73 VFC_Obj19A_ScaleChngStdDev "Standard deviation of object scale change";
CM_ SG_ 73 VFC_Obj19A_Reliability "The bitfield shows if the signal quality is assumed to be sufficient for functions with safety target -no false positives-
Bit 0: DYNAMIC
Bit 1: SEMSEG_SURFACE
Bit 2: WDD_CRITICAL
Bit 3: GOD_CONFIRMED
Bit 4: RESTRICTED
Bit 5: ISO26262_SAFE";
CM_ SG_ 73 VFC_Obj19A_NormVxStdDev "Standard deviation of Normalised Object velocity in longitudinal direction";
CM_ SG_ 73 VFC_Obj19A_TypeProb "Probability of the classified object type";
CM_ SG_ 73 VFC_Obj19A_LengthStdDev "Standard deviation of object length";
CM_ SG_ 73 VFC_Obj19A_WidthStdDev "Standard deviation of object width";
CM_ SG_ 73 VFC_Obj19A_EdgeMid "In ACCS coordinates; corresponds to tan(viewing angle of middle object edge)";
CM_ SG_ 73 VFC_Obj19A_EdgeLeft "In ACCS coordinates; corresponds to tan(viewing angle of left object edge)";
CM_ SG_ 73 VFC_Obj19A_EdgeRight "In ACCS coordinates; corresponds to tan(viewing angle of right object edge)";
CM_ SG_ 73 VFC_Obj19A_VisibleView "The visible view of the detected object";
CM_ SG_ 73 VFC_Obj19A_EdgeLeftStdDev "Standard deviation of the ACCS left object edge";
CM_ SG_ 73 VFC_Obj19A_EdgeTop "In ACCS coordinates; corresponds to tan(viewing angle of top object edge)";
CM_ SG_ 73 VFC_Obj19A_HeadOrientation "The orientation of the head of cyclists or pedestrians that are detected";
CM_ SG_ 73 VFC_Obj19A_EdgeMidStdDev "Standard deviation of the ACCS middle object edge";
CM_ SG_ 73 VFC_Obj19A_EdgeRightStdDev "Standard deviation of the ACCS right object edge";
CM_ SG_ 73 VFC_Obj19A_EdgeTopStdDev "Standard deviation of the ACCS top object edge";
CM_ SG_ 73 VFC_Obj19A_EdgeBottomStdDev "Standard deviation of the ACCS bottom object edge";
CM_ SG_ 73 VFC_Obj19A_ClassifiedView "The classified view of object to be used in connection with Heading angle";
CM_ SG_ 74 VFC_Obj20A_CRC "CRC - Autosar E2E Profile 5";
CM_ SG_ 74 VFC_Obj20A_AliveCtr "Alive counter - Autosar E2E Profile 5";
CM_ SG_ 74 VFC_Obj20A_ProtBlockCtr "Protocol-Signal: Block-Counter";
CM_ SG_ 74 VFC_Obj20A_ID "Unique Object ID";
CM_ SG_ 74 VFC_Obj20A_AxStdDev "Standard deviation of Object acceleration in longitudinal direction";
CM_ SG_ 74 VFC_Obj20A_Dx "Object distance in longitudinal direction";
CM_ SG_ 74 VFC_Obj20A_Type "Classification of the object";
CM_ SG_ 74 VFC_Obj20A_Dy "Object distance in lateral direction";
CM_ SG_ 74 VFC_Obj20A_Measured "Indicator if the object detected is measured or predicted";
CM_ SG_ 74 VFC_Obj20A_Vx "Object velocity in longitudinal direction";
CM_ SG_ 74 VFC_Obj20A_MeasSource "Bitfield for the measurement programs from which this object originates
Bit 0: MOD
Bit 1: PDET
Bit 2: OFT
Bit 3: OLS
Bit 4: RESERVED";
CM_ SG_ 74 VFC_Obj20A_Vy "Object velocity in lateral direction";
CM_ SG_ 74 VFC_Obj20A_DirIndicator "The detected direction indicator lights";
CM_ SG_ 74 VFC_Obj20A_BrakeLight "The number of detected lights. More confident if more lights are detected.";
CM_ SG_ 74 VFC_Obj20A_Ax "Object acceleration in longitudinal direction";
CM_ SG_ 74 VFC_Obj20A_CompletelyInImg "indicator if the object is completely measured in the image";
CM_ SG_ 74 VFC_Obj20A_ProbExist "Object existence probability";
CM_ SG_ 74 VFC_Obj20A_Ay "Object acceleration in lateral direction";
CM_ SG_ 74 VFC_Obj20A_AyStdDev "Standard deviation of Object acceleration in lateral direction";
CM_ SG_ 74 VFC_Obj20A_DxStdDev "Standard deviation of Object distance in longitudinal direction";
CM_ SG_ 74 VFC_Obj20A_ProbMovingLat "Probability of object moving laterally";
CM_ SG_ 74 VFC_Obj20A_DyStdDev "Standard deviation of Object distance in lateral direction";
CM_ SG_ 74 VFC_Obj20A_ProbMovingLong "Probability of object moving longitudinally";
CM_ SG_ 74 VFC_Obj20A_VxStdDev "Standard deviation of Object velocity in longitudinal direction";
CM_ SG_ 74 VFC_Obj20A_HeadingAngleStdDev "Standard deviation of object Heading angle";
CM_ SG_ 74 VFC_Obj20A_VyStdDev "Standard deviation of Object velocity in lateral direction";
CM_ SG_ 74 VFC_Obj20A_HeightStdDev "Standard deviation of object height";
CM_ SG_ 74 VFC_Obj20A_Height "Height of the object";
CM_ SG_ 74 VFC_Obj20A_Length "Length of the object";
CM_ SG_ 74 VFC_Obj20A_HeadingAngle "Heading angle of the object";
CM_ SG_ 74 VFC_Obj20A_NormAx "Normalised Object acceleration in longitudinal direction";
CM_ SG_ 74 VFC_Obj20A_NormVyEdgeLeftStdDev "Standard deviation of Normalised velocity of the ACCS left object edge in lateral direction";
CM_ SG_ 74 VFC_Obj20A_NormVyEdgeLeft "Normalised velocity of the ACCS left object edge in lateral direction";
CM_ SG_ 74 VFC_Obj20A_EdgeBottom "In ACCS coordinates; corresponds to tan(viewing angle of bottom object edge)";
CM_ SG_ 74 VFC_Obj20A_NormVyEdgeRight "Normalised velocity of the ACCS right object edge in lateral direction";
CM_ SG_ 74 VFC_Obj20A_Width "Width of the object";
CM_ SG_ 74 VFC_Obj20A_NormVx "Normalised Object velocity in longitudinal direction";
CM_ SG_ 74 VFC_Obj20A_NormVyEdgeRightStdDev "Standard deviation of Normalised velocity of the ACCS right object edge in lateral direction";
CM_ SG_ 74 VFC_Obj20A_NormAxStdDev "Standard deviation of Normalised Object acceleration in longitudinal direction";
CM_ SG_ 74 VFC_Obj20A_ScaleChange "A scale change of of the detected object";
CM_ SG_ 74 VFC_Obj20A_ScaleChngStdDev "Standard deviation of object scale change";
CM_ SG_ 74 VFC_Obj20A_Reliability "The bitfield shows if the signal quality is assumed to be sufficient for functions with safety target -no false positives-
Bit 0: DYNAMIC
Bit 1: SEMSEG_SURFACE
Bit 2: WDD_CRITICAL
Bit 3: GOD_CONFIRMED
Bit 4: RESTRICTED
Bit 5: ISO26262_SAFE";
CM_ SG_ 74 VFC_Obj20A_NormVxStdDev "Standard deviation of Normalised Object velocity in longitudinal direction";
CM_ SG_ 74 VFC_Obj20A_TypeProb "Probability of the classified object type";
CM_ SG_ 74 VFC_Obj20A_LengthStdDev "Standard deviation of object length";
CM_ SG_ 74 VFC_Obj20A_WidthStdDev "Standard deviation of object width";
CM_ SG_ 74 VFC_Obj20A_EdgeMid "In ACCS coordinates; corresponds to tan(viewing angle of middle object edge)";
CM_ SG_ 74 VFC_Obj20A_EdgeLeft "In ACCS coordinates; corresponds to tan(viewing angle of left object edge)";
CM_ SG_ 74 VFC_Obj20A_EdgeRight "In ACCS coordinates; corresponds to tan(viewing angle of right object edge)";
CM_ SG_ 74 VFC_Obj20A_VisibleView "The visible view of the detected object";
CM_ SG_ 74 VFC_Obj20A_EdgeLeftStdDev "Standard deviation of the ACCS left object edge";
CM_ SG_ 74 VFC_Obj20A_EdgeTop "In ACCS coordinates; corresponds to tan(viewing angle of top object edge)";
CM_ SG_ 74 VFC_Obj20A_HeadOrientation "The orientation of the head of cyclists or pedestrians that are detected";
CM_ SG_ 74 VFC_Obj20A_EdgeMidStdDev "Standard deviation of the ACCS middle object edge";
CM_ SG_ 74 VFC_Obj20A_EdgeRightStdDev "Standard deviation of the ACCS right object edge";
CM_ SG_ 74 VFC_Obj20A_EdgeTopStdDev "Standard deviation of the ACCS top object edge";
CM_ SG_ 74 VFC_Obj20A_EdgeBottomStdDev "Standard deviation of the ACCS bottom object edge";
CM_ SG_ 74 VFC_Obj20A_ClassifiedView "The classified view of object to be used in connection with Heading angle";
CM_ SG_ 75 VFC_Obj21A_CRC "CRC - Autosar E2E Profile 5";
CM_ SG_ 75 VFC_Obj21A_AliveCtr "Alive counter - Autosar E2E Profile 5";
CM_ SG_ 75 VFC_Obj21A_ProtBlockCtr "Protocol-Signal: Block-Counter";
CM_ SG_ 75 VFC_Obj21A_ID "Unique Object ID";
CM_ SG_ 75 VFC_Obj21A_AxStdDev "Standard deviation of Object acceleration in longitudinal direction";
CM_ SG_ 75 VFC_Obj21A_Dx "Object distance in longitudinal direction";
CM_ SG_ 75 VFC_Obj21A_Type "Classification of the object";
CM_ SG_ 75 VFC_Obj21A_Dy "Object distance in lateral direction";
CM_ SG_ 75 VFC_Obj21A_Measured "Indicator if the object detected is measured or predicted";
CM_ SG_ 75 VFC_Obj21A_Vx "Object velocity in longitudinal direction";
CM_ SG_ 75 VFC_Obj21A_MeasSource "Bitfield for the measurement programs from which this object originates
Bit 0: MOD
Bit 1: PDET
Bit 2: OFT
Bit 3: OLS
Bit 4: RESERVED";
CM_ SG_ 75 VFC_Obj21A_Vy "Object velocity in lateral direction";
CM_ SG_ 75 VFC_Obj21A_DirIndicator "The detected direction indicator lights";
CM_ SG_ 75 VFC_Obj21A_BrakeLight "The number of detected lights. More confident if more lights are detected.";
CM_ SG_ 75 VFC_Obj21A_Ax "Object acceleration in longitudinal direction";
CM_ SG_ 75 VFC_Obj21A_CompletelyInImg "indicator if the object is completely measured in the image";
CM_ SG_ 75 VFC_Obj21A_ProbExist "Object existence probability";
CM_ SG_ 75 VFC_Obj21A_Ay "Object acceleration in lateral direction";
CM_ SG_ 75 VFC_Obj21A_AyStdDev "Standard deviation of Object acceleration in lateral direction";
CM_ SG_ 75 VFC_Obj21A_DxStdDev "Standard deviation of Object distance in longitudinal direction";
CM_ SG_ 75 VFC_Obj21A_ProbMovingLat "Probability of object moving laterally";
CM_ SG_ 75 VFC_Obj21A_DyStdDev "Standard deviation of Object distance in lateral direction";
CM_ SG_ 75 VFC_Obj21A_ProbMovingLong "Probability of object moving longitudinally";
CM_ SG_ 75 VFC_Obj21A_VxStdDev "Standard deviation of Object velocity in longitudinal direction";
CM_ SG_ 75 VFC_Obj21A_HeadingAngleStdDev "Standard deviation of object Heading angle";
CM_ SG_ 75 VFC_Obj21A_VyStdDev "Standard deviation of Object velocity in lateral direction";
CM_ SG_ 75 VFC_Obj21A_HeightStdDev "Standard deviation of object height";
CM_ SG_ 75 VFC_Obj21A_Height "Height of the object";
CM_ SG_ 75 VFC_Obj21A_Length "Length of the object";
CM_ SG_ 75 VFC_Obj21A_HeadingAngle "Heading angle of the object";
CM_ SG_ 75 VFC_Obj21A_NormAx "Normalised Object acceleration in longitudinal direction";
CM_ SG_ 75 VFC_Obj21A_NormVyEdgeLeftStdDev "Standard deviation of Normalised velocity of the ACCS left object edge in lateral direction";
CM_ SG_ 75 VFC_Obj21A_NormVyEdgeLeft "Normalised velocity of the ACCS left object edge in lateral direction";
CM_ SG_ 75 VFC_Obj21A_EdgeBottom "In ACCS coordinates; corresponds to tan(viewing angle of bottom object edge)";
CM_ SG_ 75 VFC_Obj21A_NormVyEdgeRight "Normalised velocity of the ACCS right object edge in lateral direction";
CM_ SG_ 75 VFC_Obj21A_Width "Width of the object";
CM_ SG_ 75 VFC_Obj21A_NormVx "Normalised Object velocity in longitudinal direction";
CM_ SG_ 75 VFC_Obj21A_NormVyEdgeRightStdDev "Standard deviation of Normalised velocity of the ACCS right object edge in lateral direction";
CM_ SG_ 75 VFC_Obj21A_NormAxStdDev "Standard deviation of Normalised Object acceleration in longitudinal direction";
CM_ SG_ 75 VFC_Obj21A_ScaleChange "A scale change of of the detected object";
CM_ SG_ 75 VFC_Obj21A_ScaleChngStdDev "Standard deviation of object scale change";
CM_ SG_ 75 VFC_Obj21A_Reliability "The bitfield shows if the signal quality is assumed to be sufficient for functions with safety target -no false positives-
Bit 0: DYNAMIC
Bit 1: SEMSEG_SURFACE
Bit 2: WDD_CRITICAL
Bit 3: GOD_CONFIRMED
Bit 4: RESTRICTED
Bit 5: ISO26262_SAFE";
CM_ SG_ 75 VFC_Obj21A_NormVxStdDev "Standard deviation of Normalised Object velocity in longitudinal direction";
CM_ SG_ 75 VFC_Obj21A_TypeProb "Probability of the classified object type";
CM_ SG_ 75 VFC_Obj21A_LengthStdDev "Standard deviation of object length";
CM_ SG_ 75 VFC_Obj21A_WidthStdDev "Standard deviation of object width";
CM_ SG_ 75 VFC_Obj21A_EdgeMid "In ACCS coordinates; corresponds to tan(viewing angle of middle object edge)";
CM_ SG_ 75 VFC_Obj21A_EdgeLeft "In ACCS coordinates; corresponds to tan(viewing angle of left object edge)";
CM_ SG_ 75 VFC_Obj21A_EdgeRight "In ACCS coordinates; corresponds to tan(viewing angle of right object edge)";
CM_ SG_ 75 VFC_Obj21A_VisibleView "The visible view of the detected object";
CM_ SG_ 75 VFC_Obj21A_EdgeLeftStdDev "Standard deviation of the ACCS left object edge";
CM_ SG_ 75 VFC_Obj21A_EdgeTop "In ACCS coordinates; corresponds to tan(viewing angle of top object edge)";
CM_ SG_ 75 VFC_Obj21A_HeadOrientation "The orientation of the head of cyclists or pedestrians that are detected";
CM_ SG_ 75 VFC_Obj21A_EdgeMidStdDev "Standard deviation of the ACCS middle object edge";
CM_ SG_ 75 VFC_Obj21A_EdgeRightStdDev "Standard deviation of the ACCS right object edge";
CM_ SG_ 75 VFC_Obj21A_EdgeTopStdDev "Standard deviation of the ACCS top object edge";
CM_ SG_ 75 VFC_Obj21A_EdgeBottomStdDev "Standard deviation of the ACCS bottom object edge";
CM_ SG_ 75 VFC_Obj21A_ClassifiedView "The classified view of object to be used in connection with Heading angle";
CM_ SG_ 76 VFC_Obj22A_CRC "CRC - Autosar E2E Profile 5";
CM_ SG_ 76 VFC_Obj22A_AliveCtr "Alive counter - Autosar E2E Profile 5";
CM_ SG_ 76 VFC_Obj22A_ProtBlockCtr "Protocol-Signal: Block-Counter";
CM_ SG_ 76 VFC_Obj22A_ID "Unique Object ID";
CM_ SG_ 76 VFC_Obj22A_AxStdDev "Standard deviation of Object acceleration in longitudinal direction";
CM_ SG_ 76 VFC_Obj22A_Dx "Object distance in longitudinal direction";
CM_ SG_ 76 VFC_Obj22A_Type "Classification of the object";
CM_ SG_ 76 VFC_Obj22A_Dy "Object distance in lateral direction";
CM_ SG_ 76 VFC_Obj22A_Measured "Indicator if the object detected is measured or predicted";
CM_ SG_ 76 VFC_Obj22A_Vx "Object velocity in longitudinal direction";
CM_ SG_ 76 VFC_Obj22A_MeasSource "Bitfield for the measurement programs from which this object originates
Bit 0: MOD
Bit 1: PDET
Bit 2: OFT
Bit 3: OLS
Bit 4: RESERVED";
CM_ SG_ 76 VFC_Obj22A_Vy "Object velocity in lateral direction";
CM_ SG_ 76 VFC_Obj22A_DirIndicator "The detected direction indicator lights";
CM_ SG_ 76 VFC_Obj22A_BrakeLight "The number of detected lights. More confident if more lights are detected.";
CM_ SG_ 76 VFC_Obj22A_Ax "Object acceleration in longitudinal direction";
CM_ SG_ 76 VFC_Obj22A_CompletelyInImg "indicator if the object is completely measured in the image";
CM_ SG_ 76 VFC_Obj22A_ProbExist "Object existence probability";
CM_ SG_ 76 VFC_Obj22A_Ay "Object acceleration in lateral direction";
CM_ SG_ 76 VFC_Obj22A_AyStdDev "Standard deviation of Object acceleration in lateral direction";
CM_ SG_ 76 VFC_Obj22A_DxStdDev "Standard deviation of Object distance in longitudinal direction";
CM_ SG_ 76 VFC_Obj22A_ProbMovingLat "Probability of object moving laterally";
CM_ SG_ 76 VFC_Obj22A_DyStdDev "Standard deviation of Object distance in lateral direction";
CM_ SG_ 76 VFC_Obj22A_ProbMovingLong "Probability of object moving longitudinally";
CM_ SG_ 76 VFC_Obj22A_VxStdDev "Standard deviation of Object velocity in longitudinal direction";
CM_ SG_ 76 VFC_Obj22A_HeadingAngleStdDev "Standard deviation of object Heading angle";
CM_ SG_ 76 VFC_Obj22A_VyStdDev "Standard deviation of Object velocity in lateral direction";
CM_ SG_ 76 VFC_Obj22A_HeightStdDev "Standard deviation of object height";
CM_ SG_ 76 VFC_Obj22A_Height "Height of the object";
CM_ SG_ 76 VFC_Obj22A_Length "Length of the object";
CM_ SG_ 76 VFC_Obj22A_HeadingAngle "Heading angle of the object";
CM_ SG_ 76 VFC_Obj22A_NormAx "Normalised Object acceleration in longitudinal direction";
CM_ SG_ 76 VFC_Obj22A_NormVyEdgeLeftStdDev "Standard deviation of Normalised velocity of the ACCS left object edge in lateral direction";
CM_ SG_ 76 VFC_Obj22A_NormVyEdgeLeft "Normalised velocity of the ACCS left object edge in lateral direction";
CM_ SG_ 76 VFC_Obj22A_EdgeBottom "In ACCS coordinates; corresponds to tan(viewing angle of bottom object edge)";
CM_ SG_ 76 VFC_Obj22A_NormVyEdgeRight "Normalised velocity of the ACCS right object edge in lateral direction";
CM_ SG_ 76 VFC_Obj22A_Width "Width of the object";
CM_ SG_ 76 VFC_Obj22A_NormVx "Normalised Object velocity in longitudinal direction";
CM_ SG_ 76 VFC_Obj22A_NormVyEdgeRightStdDev "Standard deviation of Normalised velocity of the ACCS right object edge in lateral direction";
CM_ SG_ 76 VFC_Obj22A_NormAxStdDev "Standard deviation of Normalised Object acceleration in longitudinal direction";
CM_ SG_ 76 VFC_Obj22A_ScaleChange "A scale change of of the detected object";
CM_ SG_ 76 VFC_Obj22A_ScaleChngStdDev "Standard deviation of object scale change";
CM_ SG_ 76 VFC_Obj22A_Reliability "The bitfield shows if the signal quality is assumed to be sufficient for functions with safety target -no false positives-
Bit 0: DYNAMIC
Bit 1: SEMSEG_SURFACE
Bit 2: WDD_CRITICAL
Bit 3: GOD_CONFIRMED
Bit 4: RESTRICTED
Bit 5: ISO26262_SAFE";
CM_ SG_ 76 VFC_Obj22A_NormVxStdDev "Standard deviation of Normalised Object velocity in longitudinal direction";
CM_ SG_ 76 VFC_Obj22A_TypeProb "Probability of the classified object type";
CM_ SG_ 76 VFC_Obj22A_LengthStdDev "Standard deviation of object length";
CM_ SG_ 76 VFC_Obj22A_WidthStdDev "Standard deviation of object width";
CM_ SG_ 76 VFC_Obj22A_EdgeMid "In ACCS coordinates; corresponds to tan(viewing angle of middle object edge)";
CM_ SG_ 76 VFC_Obj22A_EdgeLeft "In ACCS coordinates; corresponds to tan(viewing angle of left object edge)";
CM_ SG_ 76 VFC_Obj22A_EdgeRight "In ACCS coordinates; corresponds to tan(viewing angle of right object edge)";
CM_ SG_ 76 VFC_Obj22A_VisibleView "The visible view of the detected object";
CM_ SG_ 76 VFC_Obj22A_EdgeLeftStdDev "Standard deviation of the ACCS left object edge";
CM_ SG_ 76 VFC_Obj22A_EdgeTop "In ACCS coordinates; corresponds to tan(viewing angle of top object edge)";
CM_ SG_ 76 VFC_Obj22A_HeadOrientation "The orientation of the head of cyclists or pedestrians that are detected";
CM_ SG_ 76 VFC_Obj22A_EdgeMidStdDev "Standard deviation of the ACCS middle object edge";
CM_ SG_ 76 VFC_Obj22A_EdgeRightStdDev "Standard deviation of the ACCS right object edge";
CM_ SG_ 76 VFC_Obj22A_EdgeTopStdDev "Standard deviation of the ACCS top object edge";
CM_ SG_ 76 VFC_Obj22A_EdgeBottomStdDev "Standard deviation of the ACCS bottom object edge";
CM_ SG_ 76 VFC_Obj22A_ClassifiedView "The classified view of object to be used in connection with Heading angle";
CM_ SG_ 77 VFC_Obj23A_CRC "CRC - Autosar E2E Profile 5";
CM_ SG_ 77 VFC_Obj23A_AliveCtr "Alive counter - Autosar E2E Profile 5";
CM_ SG_ 77 VFC_Obj23A_ProtBlockCtr "Protocol-Signal: Block-Counter";
CM_ SG_ 77 VFC_Obj23A_ID "Unique Object ID";
CM_ SG_ 77 VFC_Obj23A_AxStdDev "Standard deviation of Object acceleration in longitudinal direction";
CM_ SG_ 77 VFC_Obj23A_Dx "Object distance in longitudinal direction";
CM_ SG_ 77 VFC_Obj23A_Type "Classification of the object";
CM_ SG_ 77 VFC_Obj23A_Dy "Object distance in lateral direction";
CM_ SG_ 77 VFC_Obj23A_Measured "Indicator if the object detected is measured or predicted";
CM_ SG_ 77 VFC_Obj23A_Vx "Object velocity in longitudinal direction";
CM_ SG_ 77 VFC_Obj23A_MeasSource "Bitfield for the measurement programs from which this object originates
Bit 0: MOD
Bit 1: PDET
Bit 2: OFT
Bit 3: OLS
Bit 4: RESERVED";
CM_ SG_ 77 VFC_Obj23A_Vy "Object velocity in lateral direction";
CM_ SG_ 77 VFC_Obj23A_DirIndicator "The detected direction indicator lights";
CM_ SG_ 77 VFC_Obj23A_BrakeLight "The number of detected lights. More confident if more lights are detected.";
CM_ SG_ 77 VFC_Obj23A_Ax "Object acceleration in longitudinal direction";
CM_ SG_ 77 VFC_Obj23A_CompletelyInImg "indicator if the object is completely measured in the image";
CM_ SG_ 77 VFC_Obj23A_ProbExist "Object existence probability";
CM_ SG_ 77 VFC_Obj23A_Ay "Object acceleration in lateral direction";
CM_ SG_ 77 VFC_Obj23A_AyStdDev "Standard deviation of Object acceleration in lateral direction";
CM_ SG_ 77 VFC_Obj23A_DxStdDev "Standard deviation of Object distance in longitudinal direction";
CM_ SG_ 77 VFC_Obj23A_ProbMovingLat "Probability of object moving laterally";
CM_ SG_ 77 VFC_Obj23A_DyStdDev "Standard deviation of Object distance in lateral direction";
CM_ SG_ 77 VFC_Obj23A_ProbMovingLong "Probability of object moving longitudinally";
CM_ SG_ 77 VFC_Obj23A_VxStdDev "Standard deviation of Object velocity in longitudinal direction";
CM_ SG_ 77 VFC_Obj23A_HeadingAngleStdDev "Standard deviation of object Heading angle";
CM_ SG_ 77 VFC_Obj23A_VyStdDev "Standard deviation of Object velocity in lateral direction";
CM_ SG_ 77 VFC_Obj23A_HeightStdDev "Standard deviation of object height";
CM_ SG_ 77 VFC_Obj23A_Height "Height of the object";
CM_ SG_ 77 VFC_Obj23A_Length "Length of the object";
CM_ SG_ 77 VFC_Obj23A_HeadingAngle "Heading angle of the object";
CM_ SG_ 77 VFC_Obj23A_NormAx "Normalised Object acceleration in longitudinal direction";
CM_ SG_ 77 VFC_Obj23A_NormVyEdgeLeftStdDev "Standard deviation of Normalised velocity of the ACCS left object edge in lateral direction";
CM_ SG_ 77 VFC_Obj23A_NormVyEdgeLeft "Normalised velocity of the ACCS left object edge in lateral direction";
CM_ SG_ 77 VFC_Obj23A_EdgeBottom "In ACCS coordinates; corresponds to tan(viewing angle of bottom object edge)";
CM_ SG_ 77 VFC_Obj23A_NormVyEdgeRight "Normalised velocity of the ACCS right object edge in lateral direction";
CM_ SG_ 77 VFC_Obj23A_Width "Width of the object";
CM_ SG_ 77 VFC_Obj23A_NormVx "Normalised Object velocity in longitudinal direction";
CM_ SG_ 77 VFC_Obj23A_NormVyEdgeRightStdDev "Standard deviation of Normalised velocity of the ACCS right object edge in lateral direction";
CM_ SG_ 77 VFC_Obj23A_NormAxStdDev "Standard deviation of Normalised Object acceleration in longitudinal direction";
CM_ SG_ 77 VFC_Obj23A_ScaleChange "A scale change of of the detected object";
CM_ SG_ 77 VFC_Obj23A_ScaleChngStdDev "Standard deviation of object scale change";
CM_ SG_ 77 VFC_Obj23A_Reliability "The bitfield shows if the signal quality is assumed to be sufficient for functions with safety target -no false positives-
Bit 0: DYNAMIC
Bit 1: SEMSEG_SURFACE
Bit 2: WDD_CRITICAL
Bit 3: GOD_CONFIRMED
Bit 4: RESTRICTED
Bit 5: ISO26262_SAFE";
CM_ SG_ 77 VFC_Obj23A_NormVxStdDev "Standard deviation of Normalised Object velocity in longitudinal direction";
CM_ SG_ 77 VFC_Obj23A_TypeProb "Probability of the classified object type";
CM_ SG_ 77 VFC_Obj23A_LengthStdDev "Standard deviation of object length";
CM_ SG_ 77 VFC_Obj23A_WidthStdDev "Standard deviation of object width";
CM_ SG_ 77 VFC_Obj23A_EdgeMid "In ACCS coordinates; corresponds to tan(viewing angle of middle object edge)";
CM_ SG_ 77 VFC_Obj23A_EdgeLeft "In ACCS coordinates; corresponds to tan(viewing angle of left object edge)";
CM_ SG_ 77 VFC_Obj23A_EdgeRight "In ACCS coordinates; corresponds to tan(viewing angle of right object edge)";
CM_ SG_ 77 VFC_Obj23A_VisibleView "The visible view of the detected object";
CM_ SG_ 77 VFC_Obj23A_EdgeLeftStdDev "Standard deviation of the ACCS left object edge";
CM_ SG_ 77 VFC_Obj23A_EdgeTop "In ACCS coordinates; corresponds to tan(viewing angle of top object edge)";
CM_ SG_ 77 VFC_Obj23A_HeadOrientation "The orientation of the head of cyclists or pedestrians that are detected";
CM_ SG_ 77 VFC_Obj23A_EdgeMidStdDev "Standard deviation of the ACCS middle object edge";
CM_ SG_ 77 VFC_Obj23A_EdgeRightStdDev "Standard deviation of the ACCS right object edge";
CM_ SG_ 77 VFC_Obj23A_EdgeTopStdDev "Standard deviation of the ACCS top object edge";
CM_ SG_ 77 VFC_Obj23A_EdgeBottomStdDev "Standard deviation of the ACCS bottom object edge";
CM_ SG_ 77 VFC_Obj23A_ClassifiedView "The classified view of object to be used in connection with Heading angle";
CM_ SG_ 128 VFC_RoadHdr_CRC "CRC - Autosar E2E Profile 5";
CM_ SG_ 128 VFC_RoadHdr_AliveCtr "Alive counter - Autosar E2E Profile 5";
CM_ SG_ 128 VFC_RoadHdr_ProtBlockCtr "Protocol-Signal: Block-Counter";
CM_ SG_ 128 VFC_RoadHdr_IfVersionIdMajor "Version information of the interface. e. g. version 1.0: Major = 1. ISO 23150:2022(E): Interface version ID {major, minor, patch} (A.1.1)";
CM_ SG_ 128 VFC_RoadHdr_IfVersionIdMinor "Version information of the interface. e. g. version 1.0: Minor = 0. ISO 23150:2022(E): Interface version ID {major, minor, patch} (A.1.1)";
CM_ SG_ 128 VFC_RoadHdr_NumValidPolynomials "Number of valid polynomials. ISO 23150:2022(E): Number of valid road markings (A.1.12.2)";
CM_ SG_ 128 VFC_RoadHdr_RoadType "ISO 23150:2022(E): Road type (A.2.81)";
CM_ SG_ 128 VFC_RoadHdr_TimeStampStatus "Autosar StbM_TimeBaseStatusType bitfield with extension:
Bit 0: TIMEOUT
Bit 1: Reserved1
Bit 2: SYNC_TO_GATEWAY
Bit 3: GLOBAL_TIME_BASE
Bit 4: TIMELEAP_FUTURE
Bit 5: TIMELEAP_PAST
Bit 6: Reserved6
Bit 7: Extension: GENERAL_ERROR";
CM_ SG_ 128 VFC_RoadHdr_TimeStamp "ISO 23150:2022(E): Time stamp - prediction (A.1.5.1)";
CM_ SG_ 128 VFC_RoadHdr_SensorStatus "Informs the system of the current status of the road detection system";
CM_ SG_ 128 VFC_RoadHdr_NumValid2DPolynomial "Number of valid 2D polynomials. ISO 23150:2022(E): Number of valid road markings (A.1.12.2)";
CM_ SG_ 128 VFC_RoadHdr_RoadSurfCondType "ISO 23150:2022(E): Road surface condition classification type (A.2.88)";
CM_ SG_ 128 VFC_RoadHdr_NumValidRoadMarkings "Number of valid road markings. ISO 23150:2022(E): Number of valid road markings (A.1.12.2)";
CM_ SG_ 128 VFC_RoadHdr_RoadTypeConf "ISO 23150:2022(E): Road type - confidence (A.2.82)";
CM_ SG_ 128 VFC_RoadHdr_RoadSurCondTypeConf "ISO 23150:2022(E): Road surface condition classification type - confidence (A.2.89)";
CM_ SG_ 128 VFC_RoadHdr_2DNormVMean "V-coordinate normalization mean value (in CV coordinates, origin top left)";
CM_ SG_ 128 VFC_RoadHdr_2DNormVMeanStdDev "Standard deviation of v-coordinate normalization mean value (in CV coordinates, origin top left)";
CM_ SG_ 128 VFC_RoadHdr_NumValidClothoids "Number of valid clothoids. ISO 23150:2022(E): Number of valid road markings (A.1.12.2)";
CM_ SG_ 130 VFC_Cloth_00_02_CRC "CRC - Autosar E2E Profile 5";
CM_ SG_ 130 VFC_Cloth_00_02_AliveCtr "Alive counter - Autosar E2E Profile 5";
CM_ SG_ 130 VFC_Cloth_00_02_ProtBlockCtr "Protocol-Signal: Block-Counter";
CM_ SG_ 130 VFC_Cloth00_LaneAssociation "Position relative to the ego lane. ISO 23150:2022(E): Road object lane association (A.2.93)";
CM_ SG_ 130 VFC_Cloth00_Colour "The color of the line. Similar to ISO 23150:2022(E): Colour value - object level (A.2.107)";
CM_ SG_ 130 VFC_Cloth00_RangeXBegin "Longitudinal begin of the clothoid. ISO 23150:2022(E): Polynomial range x {begin, end} (A.2.120)";
CM_ SG_ 130 VFC_Cloth00_RangeXEnd "Longitudinal end of the clothoid. ISO 23150:2022(E): Polynomial range x {begin, end} (A.2.120)";
CM_ SG_ 130 VFC_Cloth00_ExistProb "Confidence for this clothoid, probability that it describes the true lane boundary. ISO 23150:2022(E): Existence probability - object level (A.2.1)";
CM_ SG_ 130 VFC_Cloth00_CurvChange "Curvature change or alteration of the clothoid, also called kappaDt (resolution = 2^-29)";
CM_ SG_ 130 VFC_Cloth00_Curv "Curvature of the clothoid, also called kappa (resolution = 2^-18)";
CM_ SG_ 130 VFC_Cloth00_PyStdDev "Standard deviation at x=0 of the lateral offset (resolution = 2^-7)";
CM_ SG_ 130 VFC_Cloth00_Py "Lateral offset at x=0, also called LatDeviation (resolution = 2^-7)";
CM_ SG_ 130 VFC_Cloth00_OrientationYaw "Heading angle, difference in yaw angle between vehicle heading and clothoid (resolution = 2^-11). ISO 23150:2022(E): Orientation {yaw, pitch, roll} (A.2.17)";
CM_ SG_ 130 VFC_Cloth00_Width "Width of the line. ISO 23150:2022(E): Extent {width} - polynomial (A.2.121)";
CM_ SG_ 130 VFC_Cloth00_Type "Type of the Line. ISO 23150:2022(E): Road marking type (A.2.91)";
CM_ SG_ 130 VFC_Cloth01_LaneAssociation "Position relative to the ego lane. ISO 23150:2022(E): Road object lane association (A.2.93)";
CM_ SG_ 130 VFC_Cloth01_Colour "The color of the line. Similar to ISO 23150:2022(E): Colour value - object level (A.2.107)";
CM_ SG_ 130 VFC_Cloth01_RangeXBegin "Longitudinal begin of the clothoid. ISO 23150:2022(E): Polynomial range x {begin, end} (A.2.120)";
CM_ SG_ 130 VFC_Cloth01_RangeXEnd "Longitudinal end of the clothoid. ISO 23150:2022(E): Polynomial range x {begin, end} (A.2.120)";
CM_ SG_ 130 VFC_Cloth01_ExistProb "Confidence for this clothoid, probability that it describes the true lane boundary. ISO 23150:2022(E): Existence probability - object level (A.2.1)";
CM_ SG_ 130 VFC_Cloth01_CurvChange "Curvature change or alteration of the clothoid, also called kappaDt (resolution = 2^-29)";
CM_ SG_ 130 VFC_Cloth01_Curv "Curvature of the clothoid, also called kappa (resolution = 2^-18)";
CM_ SG_ 130 VFC_Cloth01_PyStdDev "Standard deviation at x=0 of the lateral offset (resolution = 2^-7)";
CM_ SG_ 130 VFC_Cloth01_Py "Lateral offset at x=0, also called LatDeviation (resolution = 2^-7)";
CM_ SG_ 130 VFC_Cloth01_OrientationYaw "Heading angle, difference in yaw angle between vehicle heading and clothoid (resolution = 2^-11). ISO 23150:2022(E): Orientation {yaw, pitch, roll} (A.2.17)";
CM_ SG_ 130 VFC_Cloth01_Width "Width of the line. ISO 23150:2022(E): Extent {width} - polynomial (A.2.121)";
CM_ SG_ 130 VFC_Cloth01_Type "Type of the Line. ISO 23150:2022(E): Road marking type (A.2.91)";
CM_ SG_ 130 VFC_Cloth02_LaneAssociation "Position relative to the ego lane. ISO 23150:2022(E): Road object lane association (A.2.93)";
CM_ SG_ 130 VFC_Cloth02_Colour "The color of the line. Similar to ISO 23150:2022(E): Colour value - object level (A.2.107)";
CM_ SG_ 130 VFC_Cloth02_RangeXBegin "Longitudinal begin of the clothoid. ISO 23150:2022(E): Polynomial range x {begin, end} (A.2.120)";
CM_ SG_ 130 VFC_Cloth02_RangeXEnd "Longitudinal end of the clothoid. ISO 23150:2022(E): Polynomial range x {begin, end} (A.2.120)";
CM_ SG_ 130 VFC_Cloth02_ExistProb "Confidence for this clothoid, probability that it describes the true lane boundary. ISO 23150:2022(E): Existence probability - object level (A.2.1)";
CM_ SG_ 130 VFC_Cloth02_CurvChange "Curvature change or alteration of the clothoid, also called kappaDt (resolution = 2^-29)";
CM_ SG_ 130 VFC_Cloth02_Curv "Curvature of the clothoid, also called kappa (resolution = 2^-18)";
CM_ SG_ 130 VFC_Cloth02_PyStdDev "Standard deviation at x=0 of the lateral offset (resolution = 2^-7)";
CM_ SG_ 130 VFC_Cloth02_Py "Lateral offset at x=0, also called LatDeviation (resolution = 2^-7)";
CM_ SG_ 130 VFC_Cloth02_OrientationYaw "Heading angle, difference in yaw angle between vehicle heading and clothoid (resolution = 2^-11). ISO 23150:2022(E): Orientation {yaw, pitch, roll} (A.2.17)";
CM_ SG_ 130 VFC_Cloth02_Width "Width of the line. ISO 23150:2022(E): Extent {width} - polynomial (A.2.121)";
CM_ SG_ 130 VFC_Cloth02_Type "Type of the Line. ISO 23150:2022(E): Road marking type (A.2.91)";
CM_ SG_ 131 VFC_Cloth_03_05_CRC "CRC - Autosar E2E Profile 5";
CM_ SG_ 131 VFC_Cloth_03_05_AliveCtr "Alive counter - Autosar E2E Profile 5";
CM_ SG_ 131 VFC_Cloth_03_05_ProtBlockCtr "Protocol-Signal: Block-Counter";
CM_ SG_ 131 VFC_Cloth03_LaneAssociation "Position relative to the ego lane. ISO 23150:2022(E): Road object lane association (A.2.93)";
CM_ SG_ 131 VFC_Cloth03_Colour "The color of the line. Similar to ISO 23150:2022(E): Colour value - object level (A.2.107)";
CM_ SG_ 131 VFC_Cloth03_RangeXBegin "Longitudinal begin of the clothoid. ISO 23150:2022(E): Polynomial range x {begin, end} (A.2.120)";
CM_ SG_ 131 VFC_Cloth03_RangeXEnd "Longitudinal end of the clothoid. ISO 23150:2022(E): Polynomial range x {begin, end} (A.2.120)";
CM_ SG_ 131 VFC_Cloth03_ExistProb "Confidence for this clothoid, probability that it describes the true lane boundary. ISO 23150:2022(E): Existence probability - object level (A.2.1)";
CM_ SG_ 131 VFC_Cloth03_CurvChange "Curvature change or alteration of the clothoid, also called kappaDt (resolution = 2^-29)";
CM_ SG_ 131 VFC_Cloth03_Curv "Curvature of the clothoid, also called kappa (resolution = 2^-18)";
CM_ SG_ 131 VFC_Cloth03_PyStdDev "Standard deviation at x=0 of the lateral offset (resolution = 2^-7)";
CM_ SG_ 131 VFC_Cloth03_Py "Lateral offset at x=0, also called LatDeviation (resolution = 2^-7)";
CM_ SG_ 131 VFC_Cloth03_OrientationYaw "Heading angle, difference in yaw angle between vehicle heading and clothoid (resolution = 2^-11). ISO 23150:2022(E): Orientation {yaw, pitch, roll} (A.2.17)";
CM_ SG_ 131 VFC_Cloth03_Width "Width of the line. ISO 23150:2022(E): Extent {width} - polynomial (A.2.121)";
CM_ SG_ 131 VFC_Cloth03_Type "Type of the Line. ISO 23150:2022(E): Road marking type (A.2.91)";
CM_ SG_ 131 VFC_Cloth04_LaneAssociation "Position relative to the ego lane. ISO 23150:2022(E): Road object lane association (A.2.93)";
CM_ SG_ 131 VFC_Cloth04_Colour "The color of the line. Similar to ISO 23150:2022(E): Colour value - object level (A.2.107)";
CM_ SG_ 131 VFC_Cloth04_RangeXBegin "Longitudinal begin of the clothoid. ISO 23150:2022(E): Polynomial range x {begin, end} (A.2.120)";
CM_ SG_ 131 VFC_Cloth04_RangeXEnd "Longitudinal end of the clothoid. ISO 23150:2022(E): Polynomial range x {begin, end} (A.2.120)";
CM_ SG_ 131 VFC_Cloth04_ExistProb "Confidence for this clothoid, probability that it describes the true lane boundary. ISO 23150:2022(E): Existence probability - object level (A.2.1)";
CM_ SG_ 131 VFC_Cloth04_CurvChange "Curvature change or alteration of the clothoid, also called kappaDt (resolution = 2^-29)";
CM_ SG_ 131 VFC_Cloth04_Curv "Curvature of the clothoid, also called kappa (resolution = 2^-18)";
CM_ SG_ 131 VFC_Cloth04_PyStdDev "Standard deviation at x=0 of the lateral offset (resolution = 2^-7)";
CM_ SG_ 131 VFC_Cloth04_Py "Lateral offset at x=0, also called LatDeviation (resolution = 2^-7)";
CM_ SG_ 131 VFC_Cloth04_OrientationYaw "Heading angle, difference in yaw angle between vehicle heading and clothoid (resolution = 2^-11). ISO 23150:2022(E): Orientation {yaw, pitch, roll} (A.2.17)";
CM_ SG_ 131 VFC_Cloth04_Width "Width of the line. ISO 23150:2022(E): Extent {width} - polynomial (A.2.121)";
CM_ SG_ 131 VFC_Cloth04_Type "Type of the Line. ISO 23150:2022(E): Road marking type (A.2.91)";
CM_ SG_ 131 VFC_Cloth05_LaneAssociation "Position relative to the ego lane. ISO 23150:2022(E): Road object lane association (A.2.93)";
CM_ SG_ 131 VFC_Cloth05_Colour "The color of the line. Similar to ISO 23150:2022(E): Colour value - object level (A.2.107)";
CM_ SG_ 131 VFC_Cloth05_RangeXBegin "Longitudinal begin of the clothoid. ISO 23150:2022(E): Polynomial range x {begin, end} (A.2.120)";
CM_ SG_ 131 VFC_Cloth05_RangeXEnd "Longitudinal end of the clothoid. ISO 23150:2022(E): Polynomial range x {begin, end} (A.2.120)";
CM_ SG_ 131 VFC_Cloth05_ExistProb "Confidence for this clothoid, probability that it describes the true lane boundary. ISO 23150:2022(E): Existence probability - object level (A.2.1)";
CM_ SG_ 131 VFC_Cloth05_CurvChange "Curvature change or alteration of the clothoid, also called kappaDt (resolution = 2^-29)";
CM_ SG_ 131 VFC_Cloth05_Curv "Curvature of the clothoid, also called kappa (resolution = 2^-18)";
CM_ SG_ 131 VFC_Cloth05_PyStdDev "Standard deviation at x=0 of the lateral offset (resolution = 2^-7)";
CM_ SG_ 131 VFC_Cloth05_Py "Lateral offset at x=0, also called LatDeviation (resolution = 2^-7)";
CM_ SG_ 131 VFC_Cloth05_OrientationYaw "Heading angle, difference in yaw angle between vehicle heading and clothoid (resolution = 2^-11). ISO 23150:2022(E): Orientation {yaw, pitch, roll} (A.2.17)";
CM_ SG_ 131 VFC_Cloth05_Width "Width of the line. ISO 23150:2022(E): Extent {width} - polynomial (A.2.121)";
CM_ SG_ 131 VFC_Cloth05_Type "Type of the Line. ISO 23150:2022(E): Road marking type (A.2.91)";
CM_ SG_ 132 VFC_Cloth_06_08_CRC "CRC - Autosar E2E Profile 5";
CM_ SG_ 132 VFC_Cloth_06_08_AliveCtr "Alive counter - Autosar E2E Profile 5";
CM_ SG_ 132 VFC_Cloth_06_08_ProtBlockCtr "Protocol-Signal: Block-Counter";
CM_ SG_ 132 VFC_Cloth06_LaneAssociation "Position relative to the ego lane. ISO 23150:2022(E): Road object lane association (A.2.93)";
CM_ SG_ 132 VFC_Cloth06_Colour "The color of the line. Similar to ISO 23150:2022(E): Colour value - object level (A.2.107)";
CM_ SG_ 132 VFC_Cloth06_RangeXBegin "Longitudinal begin of the clothoid. ISO 23150:2022(E): Polynomial range x {begin, end} (A.2.120)";
CM_ SG_ 132 VFC_Cloth06_RangeXEnd "Longitudinal end of the clothoid. ISO 23150:2022(E): Polynomial range x {begin, end} (A.2.120)";
CM_ SG_ 132 VFC_Cloth06_ExistProb "Confidence for this clothoid, probability that it describes the true lane boundary. ISO 23150:2022(E): Existence probability - object level (A.2.1)";
CM_ SG_ 132 VFC_Cloth06_CurvChange "Curvature change or alteration of the clothoid, also called kappaDt (resolution = 2^-29)";
CM_ SG_ 132 VFC_Cloth06_Curv "Curvature of the clothoid, also called kappa (resolution = 2^-18)";
CM_ SG_ 132 VFC_Cloth06_PyStdDev "Standard deviation at x=0 of the lateral offset (resolution = 2^-7)";
CM_ SG_ 132 VFC_Cloth06_Py "Lateral offset at x=0, also called LatDeviation (resolution = 2^-7)";
CM_ SG_ 132 VFC_Cloth06_OrientationYaw "Heading angle, difference in yaw angle between vehicle heading and clothoid (resolution = 2^-11). ISO 23150:2022(E): Orientation {yaw, pitch, roll} (A.2.17)";
CM_ SG_ 132 VFC_Cloth06_Width "Width of the line. ISO 23150:2022(E): Extent {width} - polynomial (A.2.121)";
CM_ SG_ 132 VFC_Cloth06_Type "Type of the Line. ISO 23150:2022(E): Road marking type (A.2.91)";
CM_ SG_ 132 VFC_Cloth07_LaneAssociation "Position relative to the ego lane. ISO 23150:2022(E): Road object lane association (A.2.93)";
CM_ SG_ 132 VFC_Cloth07_Colour "The color of the line. Similar to ISO 23150:2022(E): Colour value - object level (A.2.107)";
CM_ SG_ 132 VFC_Cloth07_RangeXBegin "Longitudinal begin of the clothoid. ISO 23150:2022(E): Polynomial range x {begin, end} (A.2.120)";
CM_ SG_ 132 VFC_Cloth07_RangeXEnd "Longitudinal end of the clothoid. ISO 23150:2022(E): Polynomial range x {begin, end} (A.2.120)";
CM_ SG_ 132 VFC_Cloth07_ExistProb "Confidence for this clothoid, probability that it describes the true lane boundary. ISO 23150:2022(E): Existence probability - object level (A.2.1)";
CM_ SG_ 132 VFC_Cloth07_CurvChange "Curvature change or alteration of the clothoid, also called kappaDt (resolution = 2^-29)";
CM_ SG_ 132 VFC_Cloth07_Curv "Curvature of the clothoid, also called kappa (resolution = 2^-18)";
CM_ SG_ 132 VFC_Cloth07_PyStdDev "Standard deviation at x=0 of the lateral offset (resolution = 2^-7)";
CM_ SG_ 132 VFC_Cloth07_Py "Lateral offset at x=0, also called LatDeviation (resolution = 2^-7)";
CM_ SG_ 132 VFC_Cloth07_OrientationYaw "Heading angle, difference in yaw angle between vehicle heading and clothoid (resolution = 2^-11). ISO 23150:2022(E): Orientation {yaw, pitch, roll} (A.2.17)";
CM_ SG_ 132 VFC_Cloth07_Width "Width of the line. ISO 23150:2022(E): Extent {width} - polynomial (A.2.121)";
CM_ SG_ 132 VFC_Cloth07_Type "Type of the Line. ISO 23150:2022(E): Road marking type (A.2.91)";
CM_ SG_ 132 VFC_Cloth08_LaneAssociation "Position relative to the ego lane. ISO 23150:2022(E): Road object lane association (A.2.93)";
CM_ SG_ 132 VFC_Cloth08_Colour "The color of the line. Similar to ISO 23150:2022(E): Colour value - object level (A.2.107)";
CM_ SG_ 132 VFC_Cloth08_RangeXBegin "Longitudinal begin of the clothoid. ISO 23150:2022(E): Polynomial range x {begin, end} (A.2.120)";
CM_ SG_ 132 VFC_Cloth08_RangeXEnd "Longitudinal end of the clothoid. ISO 23150:2022(E): Polynomial range x {begin, end} (A.2.120)";
CM_ SG_ 132 VFC_Cloth08_ExistProb "Confidence for this clothoid, probability that it describes the true lane boundary. ISO 23150:2022(E): Existence probability - object level (A.2.1)";
CM_ SG_ 132 VFC_Cloth08_CurvChange "Curvature change or alteration of the clothoid, also called kappaDt (resolution = 2^-29)";
CM_ SG_ 132 VFC_Cloth08_Curv "Curvature of the clothoid, also called kappa (resolution = 2^-18)";
CM_ SG_ 132 VFC_Cloth08_PyStdDev "Standard deviation at x=0 of the lateral offset (resolution = 2^-7)";
CM_ SG_ 132 VFC_Cloth08_Py "Lateral offset at x=0, also called LatDeviation (resolution = 2^-7)";
CM_ SG_ 132 VFC_Cloth08_OrientationYaw "Heading angle, difference in yaw angle between vehicle heading and clothoid (resolution = 2^-11). ISO 23150:2022(E): Orientation {yaw, pitch, roll} (A.2.17)";
CM_ SG_ 132 VFC_Cloth08_Width "Width of the line. ISO 23150:2022(E): Extent {width} - polynomial (A.2.121)";
CM_ SG_ 132 VFC_Cloth08_Type "Type of the Line. ISO 23150:2022(E): Road marking type (A.2.91)";
BA_DEF_ SG_  "GenSigSendType" ENUM  "Cyclic","OnWrite","OnWriteWithRepetition","OnChange","OnChangeWithRepetition","IfActive","IfActiveWithRepetition";
BA_DEF_ BO_  "GenMsgCycleTimeFast" INT 2 50000;
BA_DEF_ BO_  "GenMsgILSupport" ENUM  "No","Yes";
BA_DEF_ BO_  "CANFD_BRS" ENUM  "0","1";
BA_DEF_ BO_  "GenMsgCycleTime" INT 0 65535;
BA_DEF_ BO_  "GenMsgSendType" ENUM  "Event","cyclic";
BA_DEF_ BO_  "VFrameFormat" ENUM  "StandardCAN","ExtendedCAN","reserved","reserved","reserved","reserved","reserved","reserved","reserved","reserved","reserved","reserved","reserved","reserved","StandardCAN_FD","ExtendedCAN_FD";
BA_DEF_ SG_  "GenSigStartValue" FLOAT 0 100000000000;
BA_DEF_DEF_  "GenSigSendType" "Cyclic";
BA_DEF_DEF_  "GenMsgCycleTimeFast" 100;
BA_DEF_DEF_  "GenMsgILSupport" "Yes";
BA_DEF_DEF_  "CANFD_BRS" "1";
BA_DEF_DEF_  "GenMsgCycleTime" 0;
BA_DEF_DEF_  "GenMsgSendType" "";
BA_DEF_DEF_  "VFrameFormat" "";
BA_DEF_DEF_  "GenSigStartValue" 0;
BA_ "GenMsgSendType" BO_ 67 0;
BA_ "VFrameFormat" BO_ 67 14;
BA_ "GenMsgSendType" BO_ 68 0;
BA_ "VFrameFormat" BO_ 68 14;
BA_ "GenMsgSendType" BO_ 69 0;
BA_ "VFrameFormat" BO_ 69 14;
BA_ "GenMsgSendType" BO_ 70 0;
BA_ "VFrameFormat" BO_ 70 14;
BA_ "GenMsgSendType" BO_ 71 0;
BA_ "VFrameFormat" BO_ 71 14;
BA_ "GenMsgSendType" BO_ 72 0;
BA_ "VFrameFormat" BO_ 72 14;
BA_ "GenMsgSendType" BO_ 73 0;
BA_ "VFrameFormat" BO_ 73 14;
BA_ "GenMsgSendType" BO_ 74 0;
BA_ "VFrameFormat" BO_ 74 14;
BA_ "GenMsgSendType" BO_ 75 0;
BA_ "VFrameFormat" BO_ 75 14;
BA_ "GenMsgSendType" BO_ 76 0;
BA_ "VFrameFormat" BO_ 76 14;
BA_ "GenMsgSendType" BO_ 77 0;
BA_ "VFrameFormat" BO_ 77 14;
BA_ "GenMsgSendType" BO_ 128 0;
BA_ "VFrameFormat" BO_ 128 14;
BA_ "GenMsgSendType" BO_ 130 0;
BA_ "VFrameFormat" BO_ 130 14;
BA_ "GenMsgSendType" BO_ 131 0;
BA_ "VFrameFormat" BO_ 131 14;
BA_ "GenMsgSendType" BO_ 132 0;
BA_ "VFrameFormat" BO_ 132 14;
BA_ "GenSigStartValue" SG_ 67 VFC_Obj13A_Dy 8000;
BA_ "GenSigStartValue" SG_ 67 VFC_Obj13A_Vx 1540;
BA_ "GenSigStartValue" SG_ 67 VFC_Obj13A_Vy 500;
BA_ "GenSigStartValue" SG_ 67 VFC_Obj13A_Ax 160;
BA_ "GenSigStartValue" SG_ 67 VFC_Obj13A_Ay 120;
BA_ "GenSigStartValue" SG_ 67 VFC_Obj13A_HeadingAngle 157;
BA_ "GenSigStartValue" SG_ 67 VFC_Obj13A_NormAx 5000;
BA_ "GenSigStartValue" SG_ 67 VFC_Obj13A_NormVyEdgeLeft 4000;
BA_ "GenSigStartValue" SG_ 67 VFC_Obj13A_EdgeBottom 2000;
BA_ "GenSigStartValue" SG_ 67 VFC_Obj13A_NormVyEdgeRight 4000;
BA_ "GenSigStartValue" SG_ 67 VFC_Obj13A_NormVx 40000;
BA_ "GenSigStartValue" SG_ 67 VFC_Obj13A_EdgeMid 4000;
BA_ "GenSigStartValue" SG_ 67 VFC_Obj13A_EdgeLeft 4000;
BA_ "GenSigStartValue" SG_ 67 VFC_Obj13A_EdgeRight 4000;
BA_ "GenSigStartValue" SG_ 67 VFC_Obj13A_EdgeTop 2000;
BA_ "GenSigStartValue" SG_ 68 VFC_Obj14A_Dy 8000;
BA_ "GenSigStartValue" SG_ 68 VFC_Obj14A_Vx 1540;
BA_ "GenSigStartValue" SG_ 68 VFC_Obj14A_Vy 500;
BA_ "GenSigStartValue" SG_ 68 VFC_Obj14A_Ax 160;
BA_ "GenSigStartValue" SG_ 68 VFC_Obj14A_Ay 120;
BA_ "GenSigStartValue" SG_ 68 VFC_Obj14A_HeadingAngle 157;
BA_ "GenSigStartValue" SG_ 68 VFC_Obj14A_NormAx 5000;
BA_ "GenSigStartValue" SG_ 68 VFC_Obj14A_NormVyEdgeLeft 4000;
BA_ "GenSigStartValue" SG_ 68 VFC_Obj14A_EdgeBottom 2000;
BA_ "GenSigStartValue" SG_ 68 VFC_Obj14A_NormVyEdgeRight 4000;
BA_ "GenSigStartValue" SG_ 68 VFC_Obj14A_NormVx 40000;
BA_ "GenSigStartValue" SG_ 68 VFC_Obj14A_EdgeMid 4000;
BA_ "GenSigStartValue" SG_ 68 VFC_Obj14A_EdgeLeft 4000;
BA_ "GenSigStartValue" SG_ 68 VFC_Obj14A_EdgeRight 4000;
BA_ "GenSigStartValue" SG_ 68 VFC_Obj14A_EdgeTop 2000;
BA_ "GenSigStartValue" SG_ 69 VFC_Obj15A_Dy 8000;
BA_ "GenSigStartValue" SG_ 69 VFC_Obj15A_Vx 1540;
BA_ "GenSigStartValue" SG_ 69 VFC_Obj15A_Vy 500;
BA_ "GenSigStartValue" SG_ 69 VFC_Obj15A_Ax 160;
BA_ "GenSigStartValue" SG_ 69 VFC_Obj15A_Ay 120;
BA_ "GenSigStartValue" SG_ 69 VFC_Obj15A_HeadingAngle 157;
BA_ "GenSigStartValue" SG_ 69 VFC_Obj15A_NormAx 5000;
BA_ "GenSigStartValue" SG_ 69 VFC_Obj15A_NormVyEdgeLeft 4000;
BA_ "GenSigStartValue" SG_ 69 VFC_Obj15A_EdgeBottom 2000;
BA_ "GenSigStartValue" SG_ 69 VFC_Obj15A_NormVyEdgeRight 4000;
BA_ "GenSigStartValue" SG_ 69 VFC_Obj15A_NormVx 40000;
BA_ "GenSigStartValue" SG_ 69 VFC_Obj15A_EdgeMid 4000;
BA_ "GenSigStartValue" SG_ 69 VFC_Obj15A_EdgeLeft 4000;
BA_ "GenSigStartValue" SG_ 69 VFC_Obj15A_EdgeRight 4000;
BA_ "GenSigStartValue" SG_ 69 VFC_Obj15A_EdgeTop 2000;
BA_ "GenSigStartValue" SG_ 70 VFC_Obj16A_Dy 8000;
BA_ "GenSigStartValue" SG_ 70 VFC_Obj16A_Vx 1540;
BA_ "GenSigStartValue" SG_ 70 VFC_Obj16A_Vy 500;
BA_ "GenSigStartValue" SG_ 70 VFC_Obj16A_Ax 160;
BA_ "GenSigStartValue" SG_ 70 VFC_Obj16A_Ay 120;
BA_ "GenSigStartValue" SG_ 70 VFC_Obj16A_HeadingAngle 157;
BA_ "GenSigStartValue" SG_ 70 VFC_Obj16A_NormAx 5000;
BA_ "GenSigStartValue" SG_ 70 VFC_Obj16A_NormVyEdgeLeft 4000;
BA_ "GenSigStartValue" SG_ 70 VFC_Obj16A_EdgeBottom 2000;
BA_ "GenSigStartValue" SG_ 70 VFC_Obj16A_NormVyEdgeRight 4000;
BA_ "GenSigStartValue" SG_ 70 VFC_Obj16A_NormVx 40000;
BA_ "GenSigStartValue" SG_ 70 VFC_Obj16A_EdgeMid 4000;
BA_ "GenSigStartValue" SG_ 70 VFC_Obj16A_EdgeLeft 4000;
BA_ "GenSigStartValue" SG_ 70 VFC_Obj16A_EdgeRight 4000;
BA_ "GenSigStartValue" SG_ 70 VFC_Obj16A_EdgeTop 2000;
BA_ "GenSigStartValue" SG_ 71 VFC_Obj17A_Dy 8000;
BA_ "GenSigStartValue" SG_ 71 VFC_Obj17A_Vx 1540;
BA_ "GenSigStartValue" SG_ 71 VFC_Obj17A_Vy 500;
BA_ "GenSigStartValue" SG_ 71 VFC_Obj17A_Ax 160;
BA_ "GenSigStartValue" SG_ 71 VFC_Obj17A_Ay 120;
BA_ "GenSigStartValue" SG_ 71 VFC_Obj17A_HeadingAngle 157;
BA_ "GenSigStartValue" SG_ 71 VFC_Obj17A_NormAx 5000;
BA_ "GenSigStartValue" SG_ 71 VFC_Obj17A_NormVyEdgeLeft 4000;
BA_ "GenSigStartValue" SG_ 71 VFC_Obj17A_EdgeBottom 2000;
BA_ "GenSigStartValue" SG_ 71 VFC_Obj17A_NormVyEdgeRight 4000;
BA_ "GenSigStartValue" SG_ 71 VFC_Obj17A_NormVx 40000;
BA_ "GenSigStartValue" SG_ 71 VFC_Obj17A_EdgeMid 4000;
BA_ "GenSigStartValue" SG_ 71 VFC_Obj17A_EdgeLeft 4000;
BA_ "GenSigStartValue" SG_ 71 VFC_Obj17A_EdgeRight 4000;
BA_ "GenSigStartValue" SG_ 71 VFC_Obj17A_EdgeTop 2000;
BA_ "GenSigStartValue" SG_ 72 VFC_Obj18A_Dy 8000;
BA_ "GenSigStartValue" SG_ 72 VFC_Obj18A_Vx 1540;
BA_ "GenSigStartValue" SG_ 72 VFC_Obj18A_Vy 500;
BA_ "GenSigStartValue" SG_ 72 VFC_Obj18A_Ax 160;
BA_ "GenSigStartValue" SG_ 72 VFC_Obj18A_Ay 120;
BA_ "GenSigStartValue" SG_ 72 VFC_Obj18A_HeadingAngle 157;
BA_ "GenSigStartValue" SG_ 72 VFC_Obj18A_NormAx 5000;
BA_ "GenSigStartValue" SG_ 72 VFC_Obj18A_NormVyEdgeLeft 4000;
BA_ "GenSigStartValue" SG_ 72 VFC_Obj18A_EdgeBottom 2000;
BA_ "GenSigStartValue" SG_ 72 VFC_Obj18A_NormVyEdgeRight 4000;
BA_ "GenSigStartValue" SG_ 72 VFC_Obj18A_NormVx 40000;
BA_ "GenSigStartValue" SG_ 72 VFC_Obj18A_EdgeMid 4000;
BA_ "GenSigStartValue" SG_ 72 VFC_Obj18A_EdgeLeft 4000;
BA_ "GenSigStartValue" SG_ 72 VFC_Obj18A_EdgeRight 4000;
BA_ "GenSigStartValue" SG_ 72 VFC_Obj18A_EdgeTop 2000;
BA_ "GenSigStartValue" SG_ 73 VFC_Obj19A_Dy 8000;
BA_ "GenSigStartValue" SG_ 73 VFC_Obj19A_Vx 1540;
BA_ "GenSigStartValue" SG_ 73 VFC_Obj19A_Vy 500;
BA_ "GenSigStartValue" SG_ 73 VFC_Obj19A_Ax 160;
BA_ "GenSigStartValue" SG_ 73 VFC_Obj19A_Ay 120;
BA_ "GenSigStartValue" SG_ 73 VFC_Obj19A_HeadingAngle 157;
BA_ "GenSigStartValue" SG_ 73 VFC_Obj19A_NormAx 5000;
BA_ "GenSigStartValue" SG_ 73 VFC_Obj19A_NormVyEdgeLeft 4000;
BA_ "GenSigStartValue" SG_ 73 VFC_Obj19A_EdgeBottom 2000;
BA_ "GenSigStartValue" SG_ 73 VFC_Obj19A_NormVyEdgeRight 4000;
BA_ "GenSigStartValue" SG_ 73 VFC_Obj19A_NormVx 40000;
BA_ "GenSigStartValue" SG_ 73 VFC_Obj19A_EdgeMid 4000;
BA_ "GenSigStartValue" SG_ 73 VFC_Obj19A_EdgeLeft 4000;
BA_ "GenSigStartValue" SG_ 73 VFC_Obj19A_EdgeRight 4000;
BA_ "GenSigStartValue" SG_ 73 VFC_Obj19A_EdgeTop 2000;
BA_ "GenSigStartValue" SG_ 74 VFC_Obj20A_Dy 8000;
BA_ "GenSigStartValue" SG_ 74 VFC_Obj20A_Vx 1540;
BA_ "GenSigStartValue" SG_ 74 VFC_Obj20A_Vy 500;
BA_ "GenSigStartValue" SG_ 74 VFC_Obj20A_Ax 160;
BA_ "GenSigStartValue" SG_ 74 VFC_Obj20A_Ay 120;
BA_ "GenSigStartValue" SG_ 74 VFC_Obj20A_HeadingAngle 157;
BA_ "GenSigStartValue" SG_ 74 VFC_Obj20A_NormAx 5000;
BA_ "GenSigStartValue" SG_ 74 VFC_Obj20A_NormVyEdgeLeft 4000;
BA_ "GenSigStartValue" SG_ 74 VFC_Obj20A_EdgeBottom 2000;
BA_ "GenSigStartValue" SG_ 74 VFC_Obj20A_NormVyEdgeRight 4000;
BA_ "GenSigStartValue" SG_ 74 VFC_Obj20A_NormVx 40000;
BA_ "GenSigStartValue" SG_ 74 VFC_Obj20A_EdgeMid 4000;
BA_ "GenSigStartValue" SG_ 74 VFC_Obj20A_EdgeLeft 4000;
BA_ "GenSigStartValue" SG_ 74 VFC_Obj20A_EdgeRight 4000;
BA_ "GenSigStartValue" SG_ 74 VFC_Obj20A_EdgeTop 2000;
BA_ "GenSigStartValue" SG_ 75 VFC_Obj21A_Dy 8000;
BA_ "GenSigStartValue" SG_ 75 VFC_Obj21A_Vx 1540;
BA_ "GenSigStartValue" SG_ 75 VFC_Obj21A_Vy 500;
BA_ "GenSigStartValue" SG_ 75 VFC_Obj21A_Ax 160;
BA_ "GenSigStartValue" SG_ 75 VFC_Obj21A_Ay 120;
BA_ "GenSigStartValue" SG_ 75 VFC_Obj21A_HeadingAngle 157;
BA_ "GenSigStartValue" SG_ 75 VFC_Obj21A_NormAx 5000;
BA_ "GenSigStartValue" SG_ 75 VFC_Obj21A_NormVyEdgeLeft 4000;
BA_ "GenSigStartValue" SG_ 75 VFC_Obj21A_EdgeBottom 2000;
BA_ "GenSigStartValue" SG_ 75 VFC_Obj21A_NormVyEdgeRight 4000;
BA_ "GenSigStartValue" SG_ 75 VFC_Obj21A_NormVx 40000;
BA_ "GenSigStartValue" SG_ 75 VFC_Obj21A_EdgeMid 4000;
BA_ "GenSigStartValue" SG_ 75 VFC_Obj21A_EdgeLeft 4000;
BA_ "GenSigStartValue" SG_ 75 VFC_Obj21A_EdgeRight 4000;
BA_ "GenSigStartValue" SG_ 75 VFC_Obj21A_EdgeTop 2000;
BA_ "GenSigStartValue" SG_ 76 VFC_Obj22A_Dy 8000;
BA_ "GenSigStartValue" SG_ 76 VFC_Obj22A_Vx 1540;
BA_ "GenSigStartValue" SG_ 76 VFC_Obj22A_Vy 500;
BA_ "GenSigStartValue" SG_ 76 VFC_Obj22A_Ax 160;
BA_ "GenSigStartValue" SG_ 76 VFC_Obj22A_Ay 120;
BA_ "GenSigStartValue" SG_ 76 VFC_Obj22A_HeadingAngle 157;
BA_ "GenSigStartValue" SG_ 76 VFC_Obj22A_NormAx 5000;
BA_ "GenSigStartValue" SG_ 76 VFC_Obj22A_NormVyEdgeLeft 4000;
BA_ "GenSigStartValue" SG_ 76 VFC_Obj22A_EdgeBottom 2000;
BA_ "GenSigStartValue" SG_ 76 VFC_Obj22A_NormVyEdgeRight 4000;
BA_ "GenSigStartValue" SG_ 76 VFC_Obj22A_NormVx 40000;
BA_ "GenSigStartValue" SG_ 76 VFC_Obj22A_EdgeMid 4000;
BA_ "GenSigStartValue" SG_ 76 VFC_Obj22A_EdgeLeft 4000;
BA_ "GenSigStartValue" SG_ 76 VFC_Obj22A_EdgeRight 4000;
BA_ "GenSigStartValue" SG_ 76 VFC_Obj22A_EdgeTop 2000;
BA_ "GenSigStartValue" SG_ 77 VFC_Obj23A_Dy 8000;
BA_ "GenSigStartValue" SG_ 77 VFC_Obj23A_Vx 1540;
BA_ "GenSigStartValue" SG_ 77 VFC_Obj23A_Vy 500;
BA_ "GenSigStartValue" SG_ 77 VFC_Obj23A_Ax 160;
BA_ "GenSigStartValue" SG_ 77 VFC_Obj23A_Ay 120;
BA_ "GenSigStartValue" SG_ 77 VFC_Obj23A_HeadingAngle 157;
BA_ "GenSigStartValue" SG_ 77 VFC_Obj23A_NormAx 5000;
BA_ "GenSigStartValue" SG_ 77 VFC_Obj23A_NormVyEdgeLeft 4000;
BA_ "GenSigStartValue" SG_ 77 VFC_Obj23A_EdgeBottom 2000;
BA_ "GenSigStartValue" SG_ 77 VFC_Obj23A_NormVyEdgeRight 4000;
BA_ "GenSigStartValue" SG_ 77 VFC_Obj23A_NormVx 40000;
BA_ "GenSigStartValue" SG_ 77 VFC_Obj23A_EdgeMid 4000;
BA_ "GenSigStartValue" SG_ 77 VFC_Obj23A_EdgeLeft 4000;
BA_ "GenSigStartValue" SG_ 77 VFC_Obj23A_EdgeRight 4000;
BA_ "GenSigStartValue" SG_ 77 VFC_Obj23A_EdgeTop 2000;
BA_ "GenSigStartValue" SG_ 130 VFC_Cloth00_CurvChange 8388607;
BA_ "GenSigStartValue" SG_ 130 VFC_Cloth00_Curv 2048;
BA_ "GenSigStartValue" SG_ 130 VFC_Cloth00_Py 2048;
BA_ "GenSigStartValue" SG_ 130 VFC_Cloth00_OrientationYaw 2048;
BA_ "GenSigStartValue" SG_ 130 VFC_Cloth01_CurvChange 8388607;
BA_ "GenSigStartValue" SG_ 130 VFC_Cloth01_Curv 2048;
BA_ "GenSigStartValue" SG_ 130 VFC_Cloth01_Py 2048;
BA_ "GenSigStartValue" SG_ 130 VFC_Cloth01_OrientationYaw 2048;
BA_ "GenSigStartValue" SG_ 130 VFC_Cloth02_CurvChange 8388607;
BA_ "GenSigStartValue" SG_ 130 VFC_Cloth02_Curv 2048;
BA_ "GenSigStartValue" SG_ 130 VFC_Cloth02_Py 2048;
BA_ "GenSigStartValue" SG_ 130 VFC_Cloth02_OrientationYaw 2048;
BA_ "GenSigStartValue" SG_ 131 VFC_Cloth03_CurvChange 8388607;
BA_ "GenSigStartValue" SG_ 131 VFC_Cloth03_Curv 2048;
BA_ "GenSigStartValue" SG_ 131 VFC_Cloth03_Py 2048;
BA_ "GenSigStartValue" SG_ 131 VFC_Cloth03_OrientationYaw 2048;
BA_ "GenSigStartValue" SG_ 131 VFC_Cloth04_CurvChange 8388607;
BA_ "GenSigStartValue" SG_ 131 VFC_Cloth04_Curv 2048;
BA_ "GenSigStartValue" SG_ 131 VFC_Cloth04_Py 2048;
BA_ "GenSigStartValue" SG_ 131 VFC_Cloth04_OrientationYaw 2048;
BA_ "GenSigStartValue" SG_ 131 VFC_Cloth05_CurvChange 8388607;
BA_ "GenSigStartValue" SG_ 131 VFC_Cloth05_Curv 2048;
BA_ "GenSigStartValue" SG_ 131 VFC_Cloth05_Py 2048;
BA_ "GenSigStartValue" SG_ 131 VFC_Cloth05_OrientationYaw 2048;
BA_ "GenSigStartValue" SG_ 132 VFC_Cloth06_CurvChange 8388607;
BA_ "GenSigStartValue" SG_ 132 VFC_Cloth06_Curv 2048;
BA_ "GenSigStartValue" SG_ 132 VFC_Cloth06_Py 2048;
BA_ "GenSigStartValue" SG_ 132 VFC_Cloth06_OrientationYaw 2048;
BA_ "GenSigStartValue" SG_ 132 VFC_Cloth07_CurvChange 8388607;
BA_ "GenSigStartValue" SG_ 132 VFC_Cloth07_Curv 2048;
BA_ "GenSigStartValue" SG_ 132 VFC_Cloth07_Py 2048;
BA_ "GenSigStartValue" SG_ 132 VFC_Cloth07_OrientationYaw 2048;
BA_ "GenSigStartValue" SG_ 132 VFC_Cloth08_CurvChange 8388607;
BA_ "GenSigStartValue" SG_ 132 VFC_Cloth08_Curv 2048;
BA_ "GenSigStartValue" SG_ 132 VFC_Cloth08_Py 2048;
BA_ "GenSigStartValue" SG_ 132 VFC_Cloth08_OrientationYaw 2048;
VAL_ 67 VFC_Obj13A_ID 0 "INVALID" ;
VAL_ 67 VFC_Obj13A_Type 0 "NOTYPE" 1 "CAR" 2 "RESERVED02" 3 "TRUCK" 4 "RESERVED04" 5 "RESERVED05" 6 "MOTORCYCLIST" 7 "PEDESTRIAN" 8 "CYCLIST" 9 "BOLLARD" 10 "ROADPOST" 11 "ARROWPOST" 12 "RESERVED12" 13 "RESERVED13" 14 "RESERVED14" 15 "RESERVED15" ;
VAL_ 67 VFC_Obj13A_Measured 0 "Invalid" 1 "Measured" 2 "Predicted" 3 "Reserved3" ;
VAL_ 67 VFC_Obj13A_DirIndicator 0 "Unknown" 1 "No direction indicator" 2 "Left indicator" 3 "Right indicator" 4 "Warning Lights" ;
VAL_ 67 VFC_Obj13A_BrakeLight 0 "Unknown" 1 "No light detected" 2 "One light detected" 3 "Two lights detected" 4 "Three lights detected" 5 "Reserved5" 6 "Reserved6" 7 "Reserved7" ;
VAL_ 67 VFC_Obj13A_CompletelyInImg 0 "not completely measured" 1 "completely measured" ;
VAL_ 67 VFC_Obj13A_VisibleView 0 "UNKNOWN" 1 "CLASSIC" 2 "SIDE" 3 "CLASSIC_SIDE" 4 "SIDE_CLASSIC" ;
VAL_ 67 VFC_Obj13A_HeadOrientation 0 "N/A" 1 "Head front" 2 "Head left front" 3 "Head left" 4 "Head left back" 5 "Head back" 6 "Head right back" 7 "Head right" 8 "Head right front" 9 "Reserved09" 10 "Reserved10" 11 "Reserved11" 12 "Reserved12" 13 "Reserved13" 14 "Reserved14" 15 "Unknown" ;
VAL_ 67 VFC_Obj13A_ClassifiedView 0 "Unknown" 1 "Front" 2 "Rear" 3 "Left" 4 "Right" ;
VAL_ 68 VFC_Obj14A_ID 0 "INVALID" ;
VAL_ 68 VFC_Obj14A_Type 0 "NOTYPE" 1 "CAR" 2 "RESERVED02" 3 "TRUCK" 4 "RESERVED04" 5 "RESERVED05" 6 "MOTORCYCLIST" 7 "PEDESTRIAN" 8 "CYCLIST" 9 "BOLLARD" 10 "ROADPOST" 11 "ARROWPOST" 12 "RESERVED12" 13 "RESERVED13" 14 "RESERVED14" 15 "RESERVED15" ;
VAL_ 68 VFC_Obj14A_Measured 0 "Invalid" 1 "Measured" 2 "Predicted" 3 "Reserved3" ;
VAL_ 68 VFC_Obj14A_DirIndicator 0 "Unknown" 1 "No direction indicator" 2 "Left indicator" 3 "Right indicator" 4 "Warning Lights" ;
VAL_ 68 VFC_Obj14A_BrakeLight 0 "Unknown" 1 "No light detected" 2 "One light detected" 3 "Two lights detected" 4 "Three lights detected" 5 "Reserved5" 6 "Reserved6" 7 "Reserved7" ;
VAL_ 68 VFC_Obj14A_CompletelyInImg 0 "not completely measured" 1 "completely measured" ;
VAL_ 68 VFC_Obj14A_VisibleView 0 "UNKNOWN" 1 "CLASSIC" 2 "SIDE" 3 "CLASSIC_SIDE" 4 "SIDE_CLASSIC" ;
VAL_ 68 VFC_Obj14A_HeadOrientation 0 "N/A" 1 "Head front" 2 "Head left front" 3 "Head left" 4 "Head left back" 5 "Head back" 6 "Head right back" 7 "Head right" 8 "Head right front" 9 "Reserved09" 10 "Reserved10" 11 "Reserved11" 12 "Reserved12" 13 "Reserved13" 14 "Reserved14" 15 "Unknown" ;
VAL_ 68 VFC_Obj14A_ClassifiedView 0 "Unknown" 1 "Front" 2 "Rear" 3 "Left" 4 "Right" ;
VAL_ 69 VFC_Obj15A_ID 0 "INVALID" ;
VAL_ 69 VFC_Obj15A_Type 0 "NOTYPE" 1 "CAR" 2 "RESERVED02" 3 "TRUCK" 4 "RESERVED04" 5 "RESERVED05" 6 "MOTORCYCLIST" 7 "PEDESTRIAN" 8 "CYCLIST" 9 "BOLLARD" 10 "ROADPOST" 11 "ARROWPOST" 12 "RESERVED12" 13 "RESERVED13" 14 "RESERVED14" 15 "RESERVED15" ;
VAL_ 69 VFC_Obj15A_Measured 0 "Invalid" 1 "Measured" 2 "Predicted" 3 "Reserved3" ;
VAL_ 69 VFC_Obj15A_DirIndicator 0 "Unknown" 1 "No direction indicator" 2 "Left indicator" 3 "Right indicator" 4 "Warning Lights" ;
VAL_ 69 VFC_Obj15A_BrakeLight 0 "Unknown" 1 "No light detected" 2 "One light detected" 3 "Two lights detected" 4 "Three lights detected" 5 "Reserved5" 6 "Reserved6" 7 "Reserved7" ;
VAL_ 69 VFC_Obj15A_CompletelyInImg 0 "not completely measured" 1 "completely measured" ;
VAL_ 69 VFC_Obj15A_VisibleView 0 "UNKNOWN" 1 "CLASSIC" 2 "SIDE" 3 "CLASSIC_SIDE" 4 "SIDE_CLASSIC" ;
VAL_ 69 VFC_Obj15A_HeadOrientation 0 "N/A" 1 "Head front" 2 "Head left front" 3 "Head left" 4 "Head left back" 5 "Head back" 6 "Head right back" 7 "Head right" 8 "Head right front" 9 "Reserved09" 10 "Reserved10" 11 "Reserved11" 12 "Reserved12" 13 "Reserved13" 14 "Reserved14" 15 "Unknown" ;
VAL_ 69 VFC_Obj15A_ClassifiedView 0 "Unknown" 1 "Front" 2 "Rear" 3 "Left" 4 "Right" ;
VAL_ 70 VFC_Obj16A_ID 0 "INVALID" ;
VAL_ 70 VFC_Obj16A_Type 0 "NOTYPE" 1 "CAR" 2 "RESERVED02" 3 "TRUCK" 4 "RESERVED04" 5 "RESERVED05" 6 "MOTORCYCLIST" 7 "PEDESTRIAN" 8 "CYCLIST" 9 "BOLLARD" 10 "ROADPOST" 11 "ARROWPOST" 12 "RESERVED12" 13 "RESERVED13" 14 "RESERVED14" 15 "RESERVED15" ;
VAL_ 70 VFC_Obj16A_Measured 0 "Invalid" 1 "Measured" 2 "Predicted" 3 "Reserved3" ;
VAL_ 70 VFC_Obj16A_DirIndicator 0 "Unknown" 1 "No direction indicator" 2 "Left indicator" 3 "Right indicator" 4 "Warning Lights" ;
VAL_ 70 VFC_Obj16A_BrakeLight 0 "Unknown" 1 "No light detected" 2 "One light detected" 3 "Two lights detected" 4 "Three lights detected" 5 "Reserved5" 6 "Reserved6" 7 "Reserved7" ;
VAL_ 70 VFC_Obj16A_CompletelyInImg 0 "not completely measured" 1 "completely measured" ;
VAL_ 70 VFC_Obj16A_VisibleView 0 "UNKNOWN" 1 "CLASSIC" 2 "SIDE" 3 "CLASSIC_SIDE" 4 "SIDE_CLASSIC" ;
VAL_ 70 VFC_Obj16A_HeadOrientation 0 "N/A" 1 "Head front" 2 "Head left front" 3 "Head left" 4 "Head left back" 5 "Head back" 6 "Head right back" 7 "Head right" 8 "Head right front" 9 "Reserved09" 10 "Reserved10" 11 "Reserved11" 12 "Reserved12" 13 "Reserved13" 14 "Reserved14" 15 "Unknown" ;
VAL_ 70 VFC_Obj16A_ClassifiedView 0 "Unknown" 1 "Front" 2 "Rear" 3 "Left" 4 "Right" ;
VAL_ 71 VFC_Obj17A_ID 0 "INVALID" ;
VAL_ 71 VFC_Obj17A_Type 0 "NOTYPE" 1 "CAR" 2 "RESERVED02" 3 "TRUCK" 4 "RESERVED04" 5 "RESERVED05" 6 "MOTORCYCLIST" 7 "PEDESTRIAN" 8 "CYCLIST" 9 "BOLLARD" 10 "ROADPOST" 11 "ARROWPOST" 12 "RESERVED12" 13 "RESERVED13" 14 "RESERVED14" 15 "RESERVED15" ;
VAL_ 71 VFC_Obj17A_Measured 0 "Invalid" 1 "Measured" 2 "Predicted" 3 "Reserved3" ;
VAL_ 71 VFC_Obj17A_DirIndicator 0 "Unknown" 1 "No direction indicator" 2 "Left indicator" 3 "Right indicator" 4 "Warning Lights" ;
VAL_ 71 VFC_Obj17A_BrakeLight 0 "Unknown" 1 "No light detected" 2 "One light detected" 3 "Two lights detected" 4 "Three lights detected" 5 "Reserved5" 6 "Reserved6" 7 "Reserved7" ;
VAL_ 71 VFC_Obj17A_CompletelyInImg 0 "not completely measured" 1 "completely measured" ;
VAL_ 71 VFC_Obj17A_VisibleView 0 "UNKNOWN" 1 "CLASSIC" 2 "SIDE" 3 "CLASSIC_SIDE" 4 "SIDE_CLASSIC" ;
VAL_ 71 VFC_Obj17A_HeadOrientation 0 "N/A" 1 "Head front" 2 "Head left front" 3 "Head left" 4 "Head left back" 5 "Head back" 6 "Head right back" 7 "Head right" 8 "Head right front" 9 "Reserved09" 10 "Reserved10" 11 "Reserved11" 12 "Reserved12" 13 "Reserved13" 14 "Reserved14" 15 "Unknown" ;
VAL_ 71 VFC_Obj17A_ClassifiedView 0 "Unknown" 1 "Front" 2 "Rear" 3 "Left" 4 "Right" ;
VAL_ 72 VFC_Obj18A_ID 0 "INVALID" ;
VAL_ 72 VFC_Obj18A_Type 0 "NOTYPE" 1 "CAR" 2 "RESERVED02" 3 "TRUCK" 4 "RESERVED04" 5 "RESERVED05" 6 "MOTORCYCLIST" 7 "PEDESTRIAN" 8 "CYCLIST" 9 "BOLLARD" 10 "ROADPOST" 11 "ARROWPOST" 12 "RESERVED12" 13 "RESERVED13" 14 "RESERVED14" 15 "RESERVED15" ;
VAL_ 72 VFC_Obj18A_Measured 0 "Invalid" 1 "Measured" 2 "Predicted" 3 "Reserved3" ;
VAL_ 72 VFC_Obj18A_DirIndicator 0 "Unknown" 1 "No direction indicator" 2 "Left indicator" 3 "Right indicator" 4 "Warning Lights" ;
VAL_ 72 VFC_Obj18A_BrakeLight 0 "Unknown" 1 "No light detected" 2 "One light detected" 3 "Two lights detected" 4 "Three lights detected" 5 "Reserved5" 6 "Reserved6" 7 "Reserved7" ;
VAL_ 72 VFC_Obj18A_CompletelyInImg 0 "not completely measured" 1 "completely measured" ;
VAL_ 72 VFC_Obj18A_VisibleView 0 "UNKNOWN" 1 "CLASSIC" 2 "SIDE" 3 "CLASSIC_SIDE" 4 "SIDE_CLASSIC" ;
VAL_ 72 VFC_Obj18A_HeadOrientation 0 "N/A" 1 "Head front" 2 "Head left front" 3 "Head left" 4 "Head left back" 5 "Head back" 6 "Head right back" 7 "Head right" 8 "Head right front" 9 "Reserved09" 10 "Reserved10" 11 "Reserved11" 12 "Reserved12" 13 "Reserved13" 14 "Reserved14" 15 "Unknown" ;
VAL_ 72 VFC_Obj18A_ClassifiedView 0 "Unknown" 1 "Front" 2 "Rear" 3 "Left" 4 "Right" ;
VAL_ 73 VFC_Obj19A_ID 0 "INVALID" ;
VAL_ 73 VFC_Obj19A_Type 0 "NOTYPE" 1 "CAR" 2 "RESERVED02" 3 "TRUCK" 4 "RESERVED04" 5 "RESERVED05" 6 "MOTORCYCLIST" 7 "PEDESTRIAN" 8 "CYCLIST" 9 "BOLLARD" 10 "ROADPOST" 11 "ARROWPOST" 12 "RESERVED12" 13 "RESERVED13" 14 "RESERVED14" 15 "RESERVED15" ;
VAL_ 73 VFC_Obj19A_Measured 0 "Invalid" 1 "Measured" 2 "Predicted" 3 "Reserved3" ;
VAL_ 73 VFC_Obj19A_DirIndicator 0 "Unknown" 1 "No direction indicator" 2 "Left indicator" 3 "Right indicator" 4 "Warning Lights" ;
VAL_ 73 VFC_Obj19A_BrakeLight 0 "Unknown" 1 "No light detected" 2 "One light detected" 3 "Two lights detected" 4 "Three lights detected" 5 "Reserved5" 6 "Reserved6" 7 "Reserved7" ;
VAL_ 73 VFC_Obj19A_CompletelyInImg 0 "not completely measured" 1 "completely measured" ;
VAL_ 73 VFC_Obj19A_VisibleView 0 "UNKNOWN" 1 "CLASSIC" 2 "SIDE" 3 "CLASSIC_SIDE" 4 "SIDE_CLASSIC" ;
VAL_ 73 VFC_Obj19A_HeadOrientation 0 "N/A" 1 "Head front" 2 "Head left front" 3 "Head left" 4 "Head left back" 5 "Head back" 6 "Head right back" 7 "Head right" 8 "Head right front" 9 "Reserved09" 10 "Reserved10" 11 "Reserved11" 12 "Reserved12" 13 "Reserved13" 14 "Reserved14" 15 "Unknown" ;
VAL_ 73 VFC_Obj19A_ClassifiedView 0 "Unknown" 1 "Front" 2 "Rear" 3 "Left" 4 "Right" ;
VAL_ 74 VFC_Obj20A_ID 0 "INVALID" ;
VAL_ 74 VFC_Obj20A_Type 0 "NOTYPE" 1 "CAR" 2 "RESERVED02" 3 "TRUCK" 4 "RESERVED04" 5 "RESERVED05" 6 "MOTORCYCLIST" 7 "PEDESTRIAN" 8 "CYCLIST" 9 "BOLLARD" 10 "ROADPOST" 11 "ARROWPOST" 12 "RESERVED12" 13 "RESERVED13" 14 "RESERVED14" 15 "RESERVED15" ;
VAL_ 74 VFC_Obj20A_Measured 0 "Invalid" 1 "Measured" 2 "Predicted" 3 "Reserved3" ;
VAL_ 74 VFC_Obj20A_DirIndicator 0 "Unknown" 1 "No direction indicator" 2 "Left indicator" 3 "Right indicator" 4 "Warning Lights" ;
VAL_ 74 VFC_Obj20A_BrakeLight 0 "Unknown" 1 "No light detected" 2 "One light detected" 3 "Two lights detected" 4 "Three lights detected" 5 "Reserved5" 6 "Reserved6" 7 "Reserved7" ;
VAL_ 74 VFC_Obj20A_CompletelyInImg 0 "not completely measured" 1 "completely measured" ;
VAL_ 74 VFC_Obj20A_VisibleView 0 "UNKNOWN" 1 "CLASSIC" 2 "SIDE" 3 "CLASSIC_SIDE" 4 "SIDE_CLASSIC" ;
VAL_ 74 VFC_Obj20A_HeadOrientation 0 "N/A" 1 "Head front" 2 "Head left front" 3 "Head left" 4 "Head left back" 5 "Head back" 6 "Head right back" 7 "Head right" 8 "Head right front" 9 "Reserved09" 10 "Reserved10" 11 "Reserved11" 12 "Reserved12" 13 "Reserved13" 14 "Reserved14" 15 "Unknown" ;
VAL_ 74 VFC_Obj20A_ClassifiedView 0 "Unknown" 1 "Front" 2 "Rear" 3 "Left" 4 "Right" ;
VAL_ 75 VFC_Obj21A_ID 0 "INVALID" ;
VAL_ 75 VFC_Obj21A_Type 0 "NOTYPE" 1 "CAR" 2 "RESERVED02" 3 "TRUCK" 4 "RESERVED04" 5 "RESERVED05" 6 "MOTORCYCLIST" 7 "PEDESTRIAN" 8 "CYCLIST" 9 "BOLLARD" 10 "ROADPOST" 11 "ARROWPOST" 12 "RESERVED12" 13 "RESERVED13" 14 "RESERVED14" 15 "RESERVED15" ;
VAL_ 75 VFC_Obj21A_Measured 0 "Invalid" 1 "Measured" 2 "Predicted" 3 "Reserved3" ;
VAL_ 75 VFC_Obj21A_DirIndicator 0 "Unknown" 1 "No direction indicator" 2 "Left indicator" 3 "Right indicator" 4 "Warning Lights" ;
VAL_ 75 VFC_Obj21A_BrakeLight 0 "Unknown" 1 "No light detected" 2 "One light detected" 3 "Two lights detected" 4 "Three lights detected" 5 "Reserved5" 6 "Reserved6" 7 "Reserved7" ;
VAL_ 75 VFC_Obj21A_CompletelyInImg 0 "not completely measured" 1 "completely measured" ;
VAL_ 75 VFC_Obj21A_VisibleView 0 "UNKNOWN" 1 "CLASSIC" 2 "SIDE" 3 "CLASSIC_SIDE" 4 "SIDE_CLASSIC" ;
VAL_ 75 VFC_Obj21A_HeadOrientation 0 "N/A" 1 "Head front" 2 "Head left front" 3 "Head left" 4 "Head left back" 5 "Head back" 6 "Head right back" 7 "Head right" 8 "Head right front" 9 "Reserved09" 10 "Reserved10" 11 "Reserved11" 12 "Reserved12" 13 "Reserved13" 14 "Reserved14" 15 "Unknown" ;
VAL_ 75 VFC_Obj21A_ClassifiedView 0 "Unknown" 1 "Front" 2 "Rear" 3 "Left" 4 "Right" ;
VAL_ 76 VFC_Obj22A_ID 0 "INVALID" ;
VAL_ 76 VFC_Obj22A_Type 0 "NOTYPE" 1 "CAR" 2 "RESERVED02" 3 "TRUCK" 4 "RESERVED04" 5 "RESERVED05" 6 "MOTORCYCLIST" 7 "PEDESTRIAN" 8 "CYCLIST" 9 "BOLLARD" 10 "ROADPOST" 11 "ARROWPOST" 12 "RESERVED12" 13 "RESERVED13" 14 "RESERVED14" 15 "RESERVED15" ;
VAL_ 76 VFC_Obj22A_Measured 0 "Invalid" 1 "Measured" 2 "Predicted" 3 "Reserved3" ;
VAL_ 76 VFC_Obj22A_DirIndicator 0 "Unknown" 1 "No direction indicator" 2 "Left indicator" 3 "Right indicator" 4 "Warning Lights" ;
VAL_ 76 VFC_Obj22A_BrakeLight 0 "Unknown" 1 "No light detected" 2 "One light detected" 3 "Two lights detected" 4 "Three lights detected" 5 "Reserved5" 6 "Reserved6" 7 "Reserved7" ;
VAL_ 76 VFC_Obj22A_CompletelyInImg 0 "not completely measured" 1 "completely measured" ;
VAL_ 76 VFC_Obj22A_VisibleView 0 "UNKNOWN" 1 "CLASSIC" 2 "SIDE" 3 "CLASSIC_SIDE" 4 "SIDE_CLASSIC" ;
VAL_ 76 VFC_Obj22A_HeadOrientation 0 "N/A" 1 "Head front" 2 "Head left front" 3 "Head left" 4 "Head left back" 5 "Head back" 6 "Head right back" 7 "Head right" 8 "Head right front" 9 "Reserved09" 10 "Reserved10" 11 "Reserved11" 12 "Reserved12" 13 "Reserved13" 14 "Reserved14" 15 "Unknown" ;
VAL_ 76 VFC_Obj22A_ClassifiedView 0 "Unknown" 1 "Front" 2 "Rear" 3 "Left" 4 "Right" ;
VAL_ 77 VFC_Obj23A_ID 0 "INVALID" ;
VAL_ 77 VFC_Obj23A_Type 0 "NOTYPE" 1 "CAR" 2 "RESERVED02" 3 "TRUCK" 4 "RESERVED04" 5 "RESERVED05" 6 "MOTORCYCLIST" 7 "PEDESTRIAN" 8 "CYCLIST" 9 "BOLLARD" 10 "ROADPOST" 11 "ARROWPOST" 12 "RESERVED12" 13 "RESERVED13" 14 "RESERVED14" 15 "RESERVED15" ;
VAL_ 77 VFC_Obj23A_Measured 0 "Invalid" 1 "Measured" 2 "Predicted" 3 "Reserved3" ;
VAL_ 77 VFC_Obj23A_DirIndicator 0 "Unknown" 1 "No direction indicator" 2 "Left indicator" 3 "Right indicator" 4 "Warning Lights" ;
VAL_ 77 VFC_Obj23A_BrakeLight 0 "Unknown" 1 "No light detected" 2 "One light detected" 3 "Two lights detected" 4 "Three lights detected" 5 "Reserved5" 6 "Reserved6" 7 "Reserved7" ;
VAL_ 77 VFC_Obj23A_CompletelyInImg 0 "not completely measured" 1 "completely measured" ;
VAL_ 77 VFC_Obj23A_VisibleView 0 "UNKNOWN" 1 "CLASSIC" 2 "SIDE" 3 "CLASSIC_SIDE" 4 "SIDE_CLASSIC" ;
VAL_ 77 VFC_Obj23A_HeadOrientation 0 "N/A" 1 "Head front" 2 "Head left front" 3 "Head left" 4 "Head left back" 5 "Head back" 6 "Head right back" 7 "Head right" 8 "Head right front" 9 "Reserved09" 10 "Reserved10" 11 "Reserved11" 12 "Reserved12" 13 "Reserved13" 14 "Reserved14" 15 "Unknown" ;
VAL_ 77 VFC_Obj23A_ClassifiedView 0 "Unknown" 1 "Front" 2 "Rear" 3 "Left" 4 "Right" ;
VAL_ 128 VFC_RoadHdr_RoadType 0 "Motorway" 1 "Motorway roadworks" 2 "Rural" 3 "Urban" ;
VAL_ 128 VFC_RoadHdr_SensorStatus 0 "Off" 1 "On" 2 "Reduced" 3 "HW_Error" 4 "SW_Error" 5 "FID_Active" 6 "Reserved6" 7 "Reserved7" ;
VAL_ 128 VFC_RoadHdr_RoadSurfCondType 0 "Dry" 1 "Wet" 2 "Snow covered" 3 "Reserved3" ;
VAL_ 130 VFC_Cloth00_LaneAssociation 0 "LEFT_EGO_LINE" 1 "RIGHT_EGO_LINE" 2 "LEFT_LEFT_LINE" 3 "RIGHT_RIGHT_LINE" 4 "ROAD_EDGE_LEFT" 5 "ROAD_EDGE_RIGHT" 6 "RAISED_LEFT" 7 "RAISED_RIGHT" 8 "NOT_SELECTED_CANDIDATE" 9 "EGO_TRACK_LEFT" 10 "EGO_TRACK_RIGHT" 11 "Reserved11" 12 "Reserved12" 13 "Reserved13" 14 "Reserved14" 15 "Reserved15" ;
VAL_ 130 VFC_Cloth00_Colour 0 "COLOR_WHITE" 1 "COLOR_YELLOW" 2 "COLOR_RED" 3 "COLOR_BLUE" 4 "COLOR_GREEN" 5 "RESERVED5" 6 "RESERVED6" 7 "COLOR_UNKNOWN" ;
VAL_ 130 VFC_Cloth00_Type 0 "TYPE_SOLID_LINE" 1 "TYPE_DASHED_LINE" 2 "TYPE_DOUBLE_DASHED_DASHED" 3 "TYPE_DOUBLE_DASHED_SOLID" 4 "TYPE_DOUBLE_SOLID_DASHED" 5 "TYPE_DOUBLE_SOLID_SOLID" 6 "TYPE_MULTIPLE" 7 "TYPE_MULTIPLE_WARNING" 8 "TYPE_BOTTS_DOTS" 9 "TYPE_ROAD_EDGE" 10 "TYPE_ROAD_FURNITURE" 11 "TYPE_CURBSTONE" 12 "TYPE_TRAFFIC_STATIC" 13 "TYPE_UNKNOWN_RAISED" 14 "TYPE_UNKNOWN" 15 "Reserved15" ;
VAL_ 130 VFC_Cloth01_LaneAssociation 0 "LEFT_EGO_LINE" 1 "RIGHT_EGO_LINE" 2 "LEFT_LEFT_LINE" 3 "RIGHT_RIGHT_LINE" 4 "ROAD_EDGE_LEFT" 5 "ROAD_EDGE_RIGHT" 6 "RAISED_LEFT" 7 "RAISED_RIGHT" 8 "NOT_SELECTED_CANDIDATE" 9 "EGO_TRACK_LEFT" 10 "EGO_TRACK_RIGHT" 11 "Reserved11" 12 "Reserved12" 13 "Reserved13" 14 "Reserved14" 15 "Reserved15" ;
VAL_ 130 VFC_Cloth01_Colour 0 "COLOR_WHITE" 1 "COLOR_YELLOW" 2 "COLOR_RED" 3 "COLOR_BLUE" 4 "COLOR_GREEN" 5 "RESERVED5" 6 "RESERVED6" 7 "COLOR_UNKNOWN" ;
VAL_ 130 VFC_Cloth01_Type 0 "TYPE_SOLID_LINE" 1 "TYPE_DASHED_LINE" 2 "TYPE_DOUBLE_DASHED_DASHED" 3 "TYPE_DOUBLE_DASHED_SOLID" 4 "TYPE_DOUBLE_SOLID_DASHED" 5 "TYPE_DOUBLE_SOLID_SOLID" 6 "TYPE_MULTIPLE" 7 "TYPE_MULTIPLE_WARNING" 8 "TYPE_BOTTS_DOTS" 9 "TYPE_ROAD_EDGE" 10 "TYPE_ROAD_FURNITURE" 11 "TYPE_CURBSTONE" 12 "TYPE_TRAFFIC_STATIC" 13 "TYPE_UNKNOWN_RAISED" 14 "TYPE_UNKNOWN" 15 "Reserved15" ;
VAL_ 130 VFC_Cloth02_LaneAssociation 0 "LEFT_EGO_LINE" 1 "RIGHT_EGO_LINE" 2 "LEFT_LEFT_LINE" 3 "RIGHT_RIGHT_LINE" 4 "ROAD_EDGE_LEFT" 5 "ROAD_EDGE_RIGHT" 6 "RAISED_LEFT" 7 "RAISED_RIGHT" 8 "NOT_SELECTED_CANDIDATE" 9 "EGO_TRACK_LEFT" 10 "EGO_TRACK_RIGHT" 11 "Reserved11" 12 "Reserved12" 13 "Reserved13" 14 "Reserved14" 15 "Reserved15" ;
VAL_ 130 VFC_Cloth02_Colour 0 "COLOR_WHITE" 1 "COLOR_YELLOW" 2 "COLOR_RED" 3 "COLOR_BLUE" 4 "COLOR_GREEN" 5 "RESERVED5" 6 "RESERVED6" 7 "COLOR_UNKNOWN" ;
VAL_ 130 VFC_Cloth02_Type 0 "TYPE_SOLID_LINE" 1 "TYPE_DASHED_LINE" 2 "TYPE_DOUBLE_DASHED_DASHED" 3 "TYPE_DOUBLE_DASHED_SOLID" 4 "TYPE_DOUBLE_SOLID_DASHED" 5 "TYPE_DOUBLE_SOLID_SOLID" 6 "TYPE_MULTIPLE" 7 "TYPE_MULTIPLE_WARNING" 8 "TYPE_BOTTS_DOTS" 9 "TYPE_ROAD_EDGE" 10 "TYPE_ROAD_FURNITURE" 11 "TYPE_CURBSTONE" 12 "TYPE_TRAFFIC_STATIC" 13 "TYPE_UNKNOWN_RAISED" 14 "TYPE_UNKNOWN" 15 "Reserved15" ;
VAL_ 131 VFC_Cloth03_LaneAssociation 0 "LEFT_EGO_LINE" 1 "RIGHT_EGO_LINE" 2 "LEFT_LEFT_LINE" 3 "RIGHT_RIGHT_LINE" 4 "ROAD_EDGE_LEFT" 5 "ROAD_EDGE_RIGHT" 6 "RAISED_LEFT" 7 "RAISED_RIGHT" 8 "NOT_SELECTED_CANDIDATE" 9 "EGO_TRACK_LEFT" 10 "EGO_TRACK_RIGHT" 11 "Reserved11" 12 "Reserved12" 13 "Reserved13" 14 "Reserved14" 15 "Reserved15" ;
VAL_ 131 VFC_Cloth03_Colour 0 "COLOR_WHITE" 1 "COLOR_YELLOW" 2 "COLOR_RED" 3 "COLOR_BLUE" 4 "COLOR_GREEN" 5 "RESERVED5" 6 "RESERVED6" 7 "COLOR_UNKNOWN" ;
VAL_ 131 VFC_Cloth03_Type 0 "TYPE_SOLID_LINE" 1 "TYPE_DASHED_LINE" 2 "TYPE_DOUBLE_DASHED_DASHED" 3 "TYPE_DOUBLE_DASHED_SOLID" 4 "TYPE_DOUBLE_SOLID_DASHED" 5 "TYPE_DOUBLE_SOLID_SOLID" 6 "TYPE_MULTIPLE" 7 "TYPE_MULTIPLE_WARNING" 8 "TYPE_BOTTS_DOTS" 9 "TYPE_ROAD_EDGE" 10 "TYPE_ROAD_FURNITURE" 11 "TYPE_CURBSTONE" 12 "TYPE_TRAFFIC_STATIC" 13 "TYPE_UNKNOWN_RAISED" 14 "TYPE_UNKNOWN" 15 "Reserved15" ;
VAL_ 131 VFC_Cloth04_LaneAssociation 0 "LEFT_EGO_LINE" 1 "RIGHT_EGO_LINE" 2 "LEFT_LEFT_LINE" 3 "RIGHT_RIGHT_LINE" 4 "ROAD_EDGE_LEFT" 5 "ROAD_EDGE_RIGHT" 6 "RAISED_LEFT" 7 "RAISED_RIGHT" 8 "NOT_SELECTED_CANDIDATE" 9 "EGO_TRACK_LEFT" 10 "EGO_TRACK_RIGHT" 11 "Reserved11" 12 "Reserved12" 13 "Reserved13" 14 "Reserved14" 15 "Reserved15" ;
VAL_ 131 VFC_Cloth04_Colour 0 "COLOR_WHITE" 1 "COLOR_YELLOW" 2 "COLOR_RED" 3 "COLOR_BLUE" 4 "COLOR_GREEN" 5 "RESERVED5" 6 "RESERVED6" 7 "COLOR_UNKNOWN" ;
VAL_ 131 VFC_Cloth04_Type 0 "TYPE_SOLID_LINE" 1 "TYPE_DASHED_LINE" 2 "TYPE_DOUBLE_DASHED_DASHED" 3 "TYPE_DOUBLE_DASHED_SOLID" 4 "TYPE_DOUBLE_SOLID_DASHED" 5 "TYPE_DOUBLE_SOLID_SOLID" 6 "TYPE_MULTIPLE" 7 "TYPE_MULTIPLE_WARNING" 8 "TYPE_BOTTS_DOTS" 9 "TYPE_ROAD_EDGE" 10 "TYPE_ROAD_FURNITURE" 11 "TYPE_CURBSTONE" 12 "TYPE_TRAFFIC_STATIC" 13 "TYPE_UNKNOWN_RAISED" 14 "TYPE_UNKNOWN" 15 "Reserved15" ;
VAL_ 131 VFC_Cloth05_LaneAssociation 0 "LEFT_EGO_LINE" 1 "RIGHT_EGO_LINE" 2 "LEFT_LEFT_LINE" 3 "RIGHT_RIGHT_LINE" 4 "ROAD_EDGE_LEFT" 5 "ROAD_EDGE_RIGHT" 6 "RAISED_LEFT" 7 "RAISED_RIGHT" 8 "NOT_SELECTED_CANDIDATE" 9 "EGO_TRACK_LEFT" 10 "EGO_TRACK_RIGHT" 11 "Reserved11" 12 "Reserved12" 13 "Reserved13" 14 "Reserved14" 15 "Reserved15" ;
VAL_ 131 VFC_Cloth05_Colour 0 "COLOR_WHITE" 1 "COLOR_YELLOW" 2 "COLOR_RED" 3 "COLOR_BLUE" 4 "COLOR_GREEN" 5 "RESERVED5" 6 "RESERVED6" 7 "COLOR_UNKNOWN" ;
VAL_ 131 VFC_Cloth05_Type 0 "TYPE_SOLID_LINE" 1 "TYPE_DASHED_LINE" 2 "TYPE_DOUBLE_DASHED_DASHED" 3 "TYPE_DOUBLE_DASHED_SOLID" 4 "TYPE_DOUBLE_SOLID_DASHED" 5 "TYPE_DOUBLE_SOLID_SOLID" 6 "TYPE_MULTIPLE" 7 "TYPE_MULTIPLE_WARNING" 8 "TYPE_BOTTS_DOTS" 9 "TYPE_ROAD_EDGE" 10 "TYPE_ROAD_FURNITURE" 11 "TYPE_CURBSTONE" 12 "TYPE_TRAFFIC_STATIC" 13 "TYPE_UNKNOWN_RAISED" 14 "TYPE_UNKNOWN" 15 "Reserved15" ;
VAL_ 132 VFC_Cloth06_LaneAssociation 0 "LEFT_EGO_LINE" 1 "RIGHT_EGO_LINE" 2 "LEFT_LEFT_LINE" 3 "RIGHT_RIGHT_LINE" 4 "ROAD_EDGE_LEFT" 5 "ROAD_EDGE_RIGHT" 6 "RAISED_LEFT" 7 "RAISED_RIGHT" 8 "NOT_SELECTED_CANDIDATE" 9 "EGO_TRACK_LEFT" 10 "EGO_TRACK_RIGHT" 11 "Reserved11" 12 "Reserved12" 13 "Reserved13" 14 "Reserved14" 15 "Reserved15" ;
VAL_ 132 VFC_Cloth06_Colour 0 "COLOR_WHITE" 1 "COLOR_YELLOW" 2 "COLOR_RED" 3 "COLOR_BLUE" 4 "COLOR_GREEN" 5 "RESERVED5" 6 "RESERVED6" 7 "COLOR_UNKNOWN" ;
VAL_ 132 VFC_Cloth06_Type 0 "TYPE_SOLID_LINE" 1 "TYPE_DASHED_LINE" 2 "TYPE_DOUBLE_DASHED_DASHED" 3 "TYPE_DOUBLE_DASHED_SOLID" 4 "TYPE_DOUBLE_SOLID_DASHED" 5 "TYPE_DOUBLE_SOLID_SOLID" 6 "TYPE_MULTIPLE" 7 "TYPE_MULTIPLE_WARNING" 8 "TYPE_BOTTS_DOTS" 9 "TYPE_ROAD_EDGE" 10 "TYPE_ROAD_FURNITURE" 11 "TYPE_CURBSTONE" 12 "TYPE_TRAFFIC_STATIC" 13 "TYPE_UNKNOWN_RAISED" 14 "TYPE_UNKNOWN" 15 "Reserved15" ;
VAL_ 132 VFC_Cloth07_LaneAssociation 0 "LEFT_EGO_LINE" 1 "RIGHT_EGO_LINE" 2 "LEFT_LEFT_LINE" 3 "RIGHT_RIGHT_LINE" 4 "ROAD_EDGE_LEFT" 5 "ROAD_EDGE_RIGHT" 6 "RAISED_LEFT" 7 "RAISED_RIGHT" 8 "NOT_SELECTED_CANDIDATE" 9 "EGO_TRACK_LEFT" 10 "EGO_TRACK_RIGHT" 11 "Reserved11" 12 "Reserved12" 13 "Reserved13" 14 "Reserved14" 15 "Reserved15" ;
VAL_ 132 VFC_Cloth07_Colour 0 "COLOR_WHITE" 1 "COLOR_YELLOW" 2 "COLOR_RED" 3 "COLOR_BLUE" 4 "COLOR_GREEN" 5 "RESERVED5" 6 "RESERVED6" 7 "COLOR_UNKNOWN" ;
VAL_ 132 VFC_Cloth07_Type 0 "TYPE_SOLID_LINE" 1 "TYPE_DASHED_LINE" 2 "TYPE_DOUBLE_DASHED_DASHED" 3 "TYPE_DOUBLE_DASHED_SOLID" 4 "TYPE_DOUBLE_SOLID_DASHED" 5 "TYPE_DOUBLE_SOLID_SOLID" 6 "TYPE_MULTIPLE" 7 "TYPE_MULTIPLE_WARNING" 8 "TYPE_BOTTS_DOTS" 9 "TYPE_ROAD_EDGE" 10 "TYPE_ROAD_FURNITURE" 11 "TYPE_CURBSTONE" 12 "TYPE_TRAFFIC_STATIC" 13 "TYPE_UNKNOWN_RAISED" 14 "TYPE_UNKNOWN" 15 "Reserved15" ;
VAL_ 132 VFC_Cloth08_LaneAssociation 0 "LEFT_EGO_LINE" 1 "RIGHT_EGO_LINE" 2 "LEFT_LEFT_LINE" 3 "RIGHT_RIGHT_LINE" 4 "ROAD_EDGE_LEFT" 5 "ROAD_EDGE_RIGHT" 6 "RAISED_LEFT" 7 "RAISED_RIGHT" 8 "NOT_SELECTED_CANDIDATE" 9 "EGO_TRACK_LEFT" 10 "EGO_TRACK_RIGHT" 11 "Reserved11" 12 "Reserved12" 13 "Reserved13" 14 "Reserved14" 15 "Reserved15" ;
VAL_ 132 VFC_Cloth08_Colour 0 "COLOR_WHITE" 1 "COLOR_YELLOW" 2 "COLOR_RED" 3 "COLOR_BLUE" 4 "COLOR_GREEN" 5 "RESERVED5" 6 "RESERVED6" 7 "COLOR_UNKNOWN" ;
VAL_ 132 VFC_Cloth08_Type 0 "TYPE_SOLID_LINE" 1 "TYPE_DASHED_LINE" 2 "TYPE_DOUBLE_DASHED_DASHED" 3 "TYPE_DOUBLE_DASHED_SOLID" 4 "TYPE_DOUBLE_SOLID_DASHED" 5 "TYPE_DOUBLE_SOLID_SOLID" 6 "TYPE_MULTIPLE" 7 "TYPE_MULTIPLE_WARNING" 8 "TYPE_BOTTS_DOTS" 9 "TYPE_ROAD_EDGE" 10 "TYPE_ROAD_FURNITURE" 11 "TYPE_CURBSTONE" 12 "TYPE_TRAFFIC_STATIC" 13 "TYPE_UNKNOWN_RAISED" 14 "TYPE_UNKNOWN" 15 "Reserved15" ;
SIG_GROUP_ 67 SG_VFC_Object13A 1 : VFC_Obj13A_CRC VFC_Obj13A_AliveCtr VFC_Obj13A_ProtBlockCtr VFC_Obj13A_ID VFC_Obj13A_AxStdDev VFC_Obj13A_Dx VFC_Obj13A_Type VFC_Obj13A_Dy VFC_Obj13A_Measured VFC_Obj13A_Vx VFC_Obj13A_MeasSource VFC_Obj13A_Vy VFC_Obj13A_DirIndicator VFC_Obj13A_BrakeLight VFC_Obj13A_Ax VFC_Obj13A_CompletelyInImg VFC_Obj13A_ProbExist VFC_Obj13A_Ay VFC_Obj13A_AyStdDev VFC_Obj13A_DxStdDev VFC_Obj13A_ProbMovingLat VFC_Obj13A_DyStdDev VFC_Obj13A_ProbMovingLong VFC_Obj13A_VxStdDev VFC_Obj13A_HeadingAngleStdDev VFC_Obj13A_VyStdDev VFC_Obj13A_HeightStdDev VFC_Obj13A_Height VFC_Obj13A_Length VFC_Obj13A_HeadingAngle VFC_Obj13A_NormAx VFC_Obj13A_NormVyEdgeLeftStdDev VFC_Obj13A_NormVyEdgeLeft VFC_Obj13A_EdgeBottom VFC_Obj13A_NormVyEdgeRight VFC_Obj13A_Width VFC_Obj13A_NormVx VFC_Obj13A_NormVyEdgeRightStdDev VFC_Obj13A_NormAxStdDev VFC_Obj13A_ScaleChange VFC_Obj13A_ScaleChngStdDev VFC_Obj13A_Reliability VFC_Obj13A_NormVxStdDev VFC_Obj13A_TypeProb VFC_Obj13A_LengthStdDev VFC_Obj13A_WidthStdDev VFC_Obj13A_EdgeMid VFC_Obj13A_EdgeLeft VFC_Obj13A_EdgeRight VFC_Obj13A_VisibleView VFC_Obj13A_EdgeLeftStdDev VFC_Obj13A_EdgeTop VFC_Obj13A_HeadOrientation VFC_Obj13A_EdgeMidStdDev VFC_Obj13A_EdgeRightStdDev VFC_Obj13A_EdgeTopStdDev VFC_Obj13A_EdgeBottomStdDev VFC_Obj13A_ClassifiedView;
SIG_GROUP_ 68 SG_VFC_Object14A 1 : VFC_Obj14A_CRC VFC_Obj14A_AliveCtr VFC_Obj14A_ProtBlockCtr VFC_Obj14A_ID VFC_Obj14A_AxStdDev VFC_Obj14A_Dx VFC_Obj14A_Type VFC_Obj14A_Dy VFC_Obj14A_Measured VFC_Obj14A_Vx VFC_Obj14A_MeasSource VFC_Obj14A_Vy VFC_Obj14A_DirIndicator VFC_Obj14A_BrakeLight VFC_Obj14A_Ax VFC_Obj14A_CompletelyInImg VFC_Obj14A_ProbExist VFC_Obj14A_Ay VFC_Obj14A_AyStdDev VFC_Obj14A_DxStdDev VFC_Obj14A_ProbMovingLat VFC_Obj14A_DyStdDev VFC_Obj14A_ProbMovingLong VFC_Obj14A_VxStdDev VFC_Obj14A_HeadingAngleStdDev VFC_Obj14A_VyStdDev VFC_Obj14A_HeightStdDev VFC_Obj14A_Height VFC_Obj14A_Length VFC_Obj14A_HeadingAngle VFC_Obj14A_NormAx VFC_Obj14A_NormVyEdgeLeftStdDev VFC_Obj14A_NormVyEdgeLeft VFC_Obj14A_EdgeBottom VFC_Obj14A_NormVyEdgeRight VFC_Obj14A_Width VFC_Obj14A_NormVx VFC_Obj14A_NormVyEdgeRightStdDev VFC_Obj14A_NormAxStdDev VFC_Obj14A_ScaleChange VFC_Obj14A_ScaleChngStdDev VFC_Obj14A_Reliability VFC_Obj14A_NormVxStdDev VFC_Obj14A_TypeProb VFC_Obj14A_LengthStdDev VFC_Obj14A_WidthStdDev VFC_Obj14A_EdgeMid VFC_Obj14A_EdgeLeft VFC_Obj14A_EdgeRight VFC_Obj14A_VisibleView VFC_Obj14A_EdgeLeftStdDev VFC_Obj14A_EdgeTop VFC_Obj14A_HeadOrientation VFC_Obj14A_EdgeMidStdDev VFC_Obj14A_EdgeRightStdDev VFC_Obj14A_EdgeTopStdDev VFC_Obj14A_EdgeBottomStdDev VFC_Obj14A_ClassifiedView;
SIG_GROUP_ 69 SG_VFC_Object15A 1 : VFC_Obj15A_CRC VFC_Obj15A_AliveCtr VFC_Obj15A_ProtBlockCtr VFC_Obj15A_ID VFC_Obj15A_AxStdDev VFC_Obj15A_Dx VFC_Obj15A_Type VFC_Obj15A_Dy VFC_Obj15A_Measured VFC_Obj15A_Vx VFC_Obj15A_MeasSource VFC_Obj15A_Vy VFC_Obj15A_DirIndicator VFC_Obj15A_BrakeLight VFC_Obj15A_Ax VFC_Obj15A_CompletelyInImg VFC_Obj15A_ProbExist VFC_Obj15A_Ay VFC_Obj15A_AyStdDev VFC_Obj15A_DxStdDev VFC_Obj15A_ProbMovingLat VFC_Obj15A_DyStdDev VFC_Obj15A_ProbMovingLong VFC_Obj15A_VxStdDev VFC_Obj15A_HeadingAngleStdDev VFC_Obj15A_VyStdDev VFC_Obj15A_HeightStdDev VFC_Obj15A_Height VFC_Obj15A_Length VFC_Obj15A_HeadingAngle VFC_Obj15A_NormAx VFC_Obj15A_NormVyEdgeLeftStdDev VFC_Obj15A_NormVyEdgeLeft VFC_Obj15A_EdgeBottom VFC_Obj15A_NormVyEdgeRight VFC_Obj15A_Width VFC_Obj15A_NormVx VFC_Obj15A_NormVyEdgeRightStdDev VFC_Obj15A_NormAxStdDev VFC_Obj15A_ScaleChange VFC_Obj15A_ScaleChngStdDev VFC_Obj15A_Reliability VFC_Obj15A_NormVxStdDev VFC_Obj15A_TypeProb VFC_Obj15A_LengthStdDev VFC_Obj15A_WidthStdDev VFC_Obj15A_EdgeMid VFC_Obj15A_EdgeLeft VFC_Obj15A_EdgeRight VFC_Obj15A_VisibleView VFC_Obj15A_EdgeLeftStdDev VFC_Obj15A_EdgeTop VFC_Obj15A_HeadOrientation VFC_Obj15A_EdgeMidStdDev VFC_Obj15A_EdgeRightStdDev VFC_Obj15A_EdgeTopStdDev VFC_Obj15A_EdgeBottomStdDev VFC_Obj15A_ClassifiedView;
SIG_GROUP_ 70 SG_VFC_Object16A 1 : VFC_Obj16A_CRC VFC_Obj16A_AliveCtr VFC_Obj16A_ProtBlockCtr VFC_Obj16A_ID VFC_Obj16A_AxStdDev VFC_Obj16A_Dx VFC_Obj16A_Type VFC_Obj16A_Dy VFC_Obj16A_Measured VFC_Obj16A_Vx VFC_Obj16A_MeasSource VFC_Obj16A_Vy VFC_Obj16A_DirIndicator VFC_Obj16A_BrakeLight VFC_Obj16A_Ax VFC_Obj16A_CompletelyInImg VFC_Obj16A_ProbExist VFC_Obj16A_Ay VFC_Obj16A_AyStdDev VFC_Obj16A_DxStdDev VFC_Obj16A_ProbMovingLat VFC_Obj16A_DyStdDev VFC_Obj16A_ProbMovingLong VFC_Obj16A_VxStdDev VFC_Obj16A_HeadingAngleStdDev VFC_Obj16A_VyStdDev VFC_Obj16A_HeightStdDev VFC_Obj16A_Height VFC_Obj16A_Length VFC_Obj16A_HeadingAngle VFC_Obj16A_NormAx VFC_Obj16A_NormVyEdgeLeftStdDev VFC_Obj16A_NormVyEdgeLeft VFC_Obj16A_EdgeBottom VFC_Obj16A_NormVyEdgeRight VFC_Obj16A_Width VFC_Obj16A_NormVx VFC_Obj16A_NormVyEdgeRightStdDev VFC_Obj16A_NormAxStdDev VFC_Obj16A_ScaleChange VFC_Obj16A_ScaleChngStdDev VFC_Obj16A_Reliability VFC_Obj16A_NormVxStdDev VFC_Obj16A_TypeProb VFC_Obj16A_LengthStdDev VFC_Obj16A_WidthStdDev VFC_Obj16A_EdgeMid VFC_Obj16A_EdgeLeft VFC_Obj16A_EdgeRight VFC_Obj16A_VisibleView VFC_Obj16A_EdgeLeftStdDev VFC_Obj16A_EdgeTop VFC_Obj16A_HeadOrientation VFC_Obj16A_EdgeMidStdDev VFC_Obj16A_EdgeRightStdDev VFC_Obj16A_EdgeTopStdDev VFC_Obj16A_EdgeBottomStdDev VFC_Obj16A_ClassifiedView;
SIG_GROUP_ 71 SG_VFC_Object17A 1 : VFC_Obj17A_CRC VFC_Obj17A_AliveCtr VFC_Obj17A_ProtBlockCtr VFC_Obj17A_ID VFC_Obj17A_AxStdDev VFC_Obj17A_Dx VFC_Obj17A_Type VFC_Obj17A_Dy VFC_Obj17A_Measured VFC_Obj17A_Vx VFC_Obj17A_MeasSource VFC_Obj17A_Vy VFC_Obj17A_DirIndicator VFC_Obj17A_BrakeLight VFC_Obj17A_Ax VFC_Obj17A_CompletelyInImg VFC_Obj17A_ProbExist VFC_Obj17A_Ay VFC_Obj17A_AyStdDev VFC_Obj17A_DxStdDev VFC_Obj17A_ProbMovingLat VFC_Obj17A_DyStdDev VFC_Obj17A_ProbMovingLong VFC_Obj17A_VxStdDev VFC_Obj17A_HeadingAngleStdDev VFC_Obj17A_VyStdDev VFC_Obj17A_HeightStdDev VFC_Obj17A_Height VFC_Obj17A_Length VFC_Obj17A_HeadingAngle VFC_Obj17A_NormAx VFC_Obj17A_NormVyEdgeLeftStdDev VFC_Obj17A_NormVyEdgeLeft VFC_Obj17A_EdgeBottom VFC_Obj17A_NormVyEdgeRight VFC_Obj17A_Width VFC_Obj17A_NormVx VFC_Obj17A_NormVyEdgeRightStdDev VFC_Obj17A_NormAxStdDev VFC_Obj17A_ScaleChange VFC_Obj17A_ScaleChngStdDev VFC_Obj17A_Reliability VFC_Obj17A_NormVxStdDev VFC_Obj17A_TypeProb VFC_Obj17A_LengthStdDev VFC_Obj17A_WidthStdDev VFC_Obj17A_EdgeMid VFC_Obj17A_EdgeLeft VFC_Obj17A_EdgeRight VFC_Obj17A_VisibleView VFC_Obj17A_EdgeLeftStdDev VFC_Obj17A_EdgeTop VFC_Obj17A_HeadOrientation VFC_Obj17A_EdgeMidStdDev VFC_Obj17A_EdgeRightStdDev VFC_Obj17A_EdgeTopStdDev VFC_Obj17A_EdgeBottomStdDev VFC_Obj17A_ClassifiedView;
SIG_GROUP_ 72 SG_VFC_Object18A 1 : VFC_Obj18A_CRC VFC_Obj18A_AliveCtr VFC_Obj18A_ProtBlockCtr VFC_Obj18A_ID VFC_Obj18A_AxStdDev VFC_Obj18A_Dx VFC_Obj18A_Type VFC_Obj18A_Dy VFC_Obj18A_Measured VFC_Obj18A_Vx VFC_Obj18A_MeasSource VFC_Obj18A_Vy VFC_Obj18A_DirIndicator VFC_Obj18A_BrakeLight VFC_Obj18A_Ax VFC_Obj18A_CompletelyInImg VFC_Obj18A_ProbExist VFC_Obj18A_Ay VFC_Obj18A_AyStdDev VFC_Obj18A_DxStdDev VFC_Obj18A_ProbMovingLat VFC_Obj18A_DyStdDev VFC_Obj18A_ProbMovingLong VFC_Obj18A_VxStdDev VFC_Obj18A_HeadingAngleStdDev VFC_Obj18A_VyStdDev VFC_Obj18A_HeightStdDev VFC_Obj18A_Height VFC_Obj18A_Length VFC_Obj18A_HeadingAngle VFC_Obj18A_NormAx VFC_Obj18A_NormVyEdgeLeftStdDev VFC_Obj18A_NormVyEdgeLeft VFC_Obj18A_EdgeBottom VFC_Obj18A_NormVyEdgeRight VFC_Obj18A_Width VFC_Obj18A_NormVx VFC_Obj18A_NormVyEdgeRightStdDev VFC_Obj18A_NormAxStdDev VFC_Obj18A_ScaleChange VFC_Obj18A_ScaleChngStdDev VFC_Obj18A_Reliability VFC_Obj18A_NormVxStdDev VFC_Obj18A_TypeProb VFC_Obj18A_LengthStdDev VFC_Obj18A_WidthStdDev VFC_Obj18A_EdgeMid VFC_Obj18A_EdgeLeft VFC_Obj18A_EdgeRight VFC_Obj18A_VisibleView VFC_Obj18A_EdgeLeftStdDev VFC_Obj18A_EdgeTop VFC_Obj18A_HeadOrientation VFC_Obj18A_EdgeMidStdDev VFC_Obj18A_EdgeRightStdDev VFC_Obj18A_EdgeTopStdDev VFC_Obj18A_EdgeBottomStdDev VFC_Obj18A_ClassifiedView;
SIG_GROUP_ 73 SG_VFC_Object19A 1 : VFC_Obj19A_CRC VFC_Obj19A_AliveCtr VFC_Obj19A_ProtBlockCtr VFC_Obj19A_ID VFC_Obj19A_AxStdDev VFC_Obj19A_Dx VFC_Obj19A_Type VFC_Obj19A_Dy VFC_Obj19A_Measured VFC_Obj19A_Vx VFC_Obj19A_MeasSource VFC_Obj19A_Vy VFC_Obj19A_DirIndicator VFC_Obj19A_BrakeLight VFC_Obj19A_Ax VFC_Obj19A_CompletelyInImg VFC_Obj19A_ProbExist VFC_Obj19A_Ay VFC_Obj19A_AyStdDev VFC_Obj19A_DxStdDev VFC_Obj19A_ProbMovingLat VFC_Obj19A_DyStdDev VFC_Obj19A_ProbMovingLong VFC_Obj19A_VxStdDev VFC_Obj19A_HeadingAngleStdDev VFC_Obj19A_VyStdDev VFC_Obj19A_HeightStdDev VFC_Obj19A_Height VFC_Obj19A_Length VFC_Obj19A_HeadingAngle VFC_Obj19A_NormAx VFC_Obj19A_NormVyEdgeLeftStdDev VFC_Obj19A_NormVyEdgeLeft VFC_Obj19A_EdgeBottom VFC_Obj19A_NormVyEdgeRight VFC_Obj19A_Width VFC_Obj19A_NormVx VFC_Obj19A_NormVyEdgeRightStdDev VFC_Obj19A_NormAxStdDev VFC_Obj19A_ScaleChange VFC_Obj19A_ScaleChngStdDev VFC_Obj19A_Reliability VFC_Obj19A_NormVxStdDev VFC_Obj19A_TypeProb VFC_Obj19A_LengthStdDev VFC_Obj19A_WidthStdDev VFC_Obj19A_EdgeMid VFC_Obj19A_EdgeLeft VFC_Obj19A_EdgeRight VFC_Obj19A_VisibleView VFC_Obj19A_EdgeLeftStdDev VFC_Obj19A_EdgeTop VFC_Obj19A_HeadOrientation VFC_Obj19A_EdgeMidStdDev VFC_Obj19A_EdgeRightStdDev VFC_Obj19A_EdgeTopStdDev VFC_Obj19A_EdgeBottomStdDev VFC_Obj19A_ClassifiedView;
SIG_GROUP_ 74 SG_VFC_Object20A 1 : VFC_Obj20A_CRC VFC_Obj20A_AliveCtr VFC_Obj20A_ProtBlockCtr VFC_Obj20A_ID VFC_Obj20A_AxStdDev VFC_Obj20A_Dx VFC_Obj20A_Type VFC_Obj20A_Dy VFC_Obj20A_Measured VFC_Obj20A_Vx VFC_Obj20A_MeasSource VFC_Obj20A_Vy VFC_Obj20A_DirIndicator VFC_Obj20A_BrakeLight VFC_Obj20A_Ax VFC_Obj20A_CompletelyInImg VFC_Obj20A_ProbExist VFC_Obj20A_Ay VFC_Obj20A_AyStdDev VFC_Obj20A_DxStdDev VFC_Obj20A_ProbMovingLat VFC_Obj20A_DyStdDev VFC_Obj20A_ProbMovingLong VFC_Obj20A_VxStdDev VFC_Obj20A_HeadingAngleStdDev VFC_Obj20A_VyStdDev VFC_Obj20A_HeightStdDev VFC_Obj20A_Height VFC_Obj20A_Length VFC_Obj20A_HeadingAngle VFC_Obj20A_NormAx VFC_Obj20A_NormVyEdgeLeftStdDev VFC_Obj20A_NormVyEdgeLeft VFC_Obj20A_EdgeBottom VFC_Obj20A_NormVyEdgeRight VFC_Obj20A_Width VFC_Obj20A_NormVx VFC_Obj20A_NormVyEdgeRightStdDev VFC_Obj20A_NormAxStdDev VFC_Obj20A_ScaleChange VFC_Obj20A_ScaleChngStdDev VFC_Obj20A_Reliability VFC_Obj20A_NormVxStdDev VFC_Obj20A_TypeProb VFC_Obj20A_LengthStdDev VFC_Obj20A_WidthStdDev VFC_Obj20A_EdgeMid VFC_Obj20A_EdgeLeft VFC_Obj20A_EdgeRight VFC_Obj20A_VisibleView VFC_Obj20A_EdgeLeftStdDev VFC_Obj20A_EdgeTop VFC_Obj20A_HeadOrientation VFC_Obj20A_EdgeMidStdDev VFC_Obj20A_EdgeRightStdDev VFC_Obj20A_EdgeTopStdDev VFC_Obj20A_EdgeBottomStdDev VFC_Obj20A_ClassifiedView;
SIG_GROUP_ 75 SG_VFC_Object21A 1 : VFC_Obj21A_CRC VFC_Obj21A_AliveCtr VFC_Obj21A_ProtBlockCtr VFC_Obj21A_ID VFC_Obj21A_AxStdDev VFC_Obj21A_Dx VFC_Obj21A_Type VFC_Obj21A_Dy VFC_Obj21A_Measured VFC_Obj21A_Vx VFC_Obj21A_MeasSource VFC_Obj21A_Vy VFC_Obj21A_DirIndicator VFC_Obj21A_BrakeLight VFC_Obj21A_Ax VFC_Obj21A_CompletelyInImg VFC_Obj21A_ProbExist VFC_Obj21A_Ay VFC_Obj21A_AyStdDev VFC_Obj21A_DxStdDev VFC_Obj21A_ProbMovingLat VFC_Obj21A_DyStdDev VFC_Obj21A_ProbMovingLong VFC_Obj21A_VxStdDev VFC_Obj21A_HeadingAngleStdDev VFC_Obj21A_VyStdDev VFC_Obj21A_HeightStdDev VFC_Obj21A_Height VFC_Obj21A_Length VFC_Obj21A_HeadingAngle VFC_Obj21A_NormAx VFC_Obj21A_NormVyEdgeLeftStdDev VFC_Obj21A_NormVyEdgeLeft VFC_Obj21A_EdgeBottom VFC_Obj21A_NormVyEdgeRight VFC_Obj21A_Width VFC_Obj21A_NormVx VFC_Obj21A_NormVyEdgeRightStdDev VFC_Obj21A_NormAxStdDev VFC_Obj21A_ScaleChange VFC_Obj21A_ScaleChngStdDev VFC_Obj21A_Reliability VFC_Obj21A_NormVxStdDev VFC_Obj21A_TypeProb VFC_Obj21A_LengthStdDev VFC_Obj21A_WidthStdDev VFC_Obj21A_EdgeMid VFC_Obj21A_EdgeLeft VFC_Obj21A_EdgeRight VFC_Obj21A_VisibleView VFC_Obj21A_EdgeLeftStdDev VFC_Obj21A_EdgeTop VFC_Obj21A_HeadOrientation VFC_Obj21A_EdgeMidStdDev VFC_Obj21A_EdgeRightStdDev VFC_Obj21A_EdgeTopStdDev VFC_Obj21A_EdgeBottomStdDev VFC_Obj21A_ClassifiedView;
SIG_GROUP_ 76 SG_VFC_Object22A 1 : VFC_Obj22A_CRC VFC_Obj22A_AliveCtr VFC_Obj22A_ProtBlockCtr VFC_Obj22A_ID VFC_Obj22A_AxStdDev VFC_Obj22A_Dx VFC_Obj22A_Type VFC_Obj22A_Dy VFC_Obj22A_Measured VFC_Obj22A_Vx VFC_Obj22A_MeasSource VFC_Obj22A_Vy VFC_Obj22A_DirIndicator VFC_Obj22A_BrakeLight VFC_Obj22A_Ax VFC_Obj22A_CompletelyInImg VFC_Obj22A_ProbExist VFC_Obj22A_Ay VFC_Obj22A_AyStdDev VFC_Obj22A_DxStdDev VFC_Obj22A_ProbMovingLat VFC_Obj22A_DyStdDev VFC_Obj22A_ProbMovingLong VFC_Obj22A_VxStdDev VFC_Obj22A_HeadingAngleStdDev VFC_Obj22A_VyStdDev VFC_Obj22A_HeightStdDev VFC_Obj22A_Height VFC_Obj22A_Length VFC_Obj22A_HeadingAngle VFC_Obj22A_NormAx VFC_Obj22A_NormVyEdgeLeftStdDev VFC_Obj22A_NormVyEdgeLeft VFC_Obj22A_EdgeBottom VFC_Obj22A_NormVyEdgeRight VFC_Obj22A_Width VFC_Obj22A_NormVx VFC_Obj22A_NormVyEdgeRightStdDev VFC_Obj22A_NormAxStdDev VFC_Obj22A_ScaleChange VFC_Obj22A_ScaleChngStdDev VFC_Obj22A_Reliability VFC_Obj22A_NormVxStdDev VFC_Obj22A_TypeProb VFC_Obj22A_LengthStdDev VFC_Obj22A_WidthStdDev VFC_Obj22A_EdgeMid VFC_Obj22A_EdgeLeft VFC_Obj22A_EdgeRight VFC_Obj22A_VisibleView VFC_Obj22A_EdgeLeftStdDev VFC_Obj22A_EdgeTop VFC_Obj22A_HeadOrientation VFC_Obj22A_EdgeMidStdDev VFC_Obj22A_EdgeRightStdDev VFC_Obj22A_EdgeTopStdDev VFC_Obj22A_EdgeBottomStdDev VFC_Obj22A_ClassifiedView;
SIG_GROUP_ 77 SG_VFC_Object23A 1 : VFC_Obj23A_CRC VFC_Obj23A_AliveCtr VFC_Obj23A_ProtBlockCtr VFC_Obj23A_ID VFC_Obj23A_AxStdDev VFC_Obj23A_Dx VFC_Obj23A_Type VFC_Obj23A_Dy VFC_Obj23A_Measured VFC_Obj23A_Vx VFC_Obj23A_MeasSource VFC_Obj23A_Vy VFC_Obj23A_DirIndicator VFC_Obj23A_BrakeLight VFC_Obj23A_Ax VFC_Obj23A_CompletelyInImg VFC_Obj23A_ProbExist VFC_Obj23A_Ay VFC_Obj23A_AyStdDev VFC_Obj23A_DxStdDev VFC_Obj23A_ProbMovingLat VFC_Obj23A_DyStdDev VFC_Obj23A_ProbMovingLong VFC_Obj23A_VxStdDev VFC_Obj23A_HeadingAngleStdDev VFC_Obj23A_VyStdDev VFC_Obj23A_HeightStdDev VFC_Obj23A_Height VFC_Obj23A_Length VFC_Obj23A_HeadingAngle VFC_Obj23A_NormAx VFC_Obj23A_NormVyEdgeLeftStdDev VFC_Obj23A_NormVyEdgeLeft VFC_Obj23A_EdgeBottom VFC_Obj23A_NormVyEdgeRight VFC_Obj23A_Width VFC_Obj23A_NormVx VFC_Obj23A_NormVyEdgeRightStdDev VFC_Obj23A_NormAxStdDev VFC_Obj23A_ScaleChange VFC_Obj23A_ScaleChngStdDev VFC_Obj23A_Reliability VFC_Obj23A_NormVxStdDev VFC_Obj23A_TypeProb VFC_Obj23A_LengthStdDev VFC_Obj23A_WidthStdDev VFC_Obj23A_EdgeMid VFC_Obj23A_EdgeLeft VFC_Obj23A_EdgeRight VFC_Obj23A_VisibleView VFC_Obj23A_EdgeLeftStdDev VFC_Obj23A_EdgeTop VFC_Obj23A_HeadOrientation VFC_Obj23A_EdgeMidStdDev VFC_Obj23A_EdgeRightStdDev VFC_Obj23A_EdgeTopStdDev VFC_Obj23A_EdgeBottomStdDev VFC_Obj23A_ClassifiedView;
SIG_GROUP_ 128 SG_VFC_RoadHdr 1 : VFC_RoadHdr_CRC VFC_RoadHdr_AliveCtr VFC_RoadHdr_ProtBlockCtr VFC_RoadHdr_IfVersionIdMajor VFC_RoadHdr_IfVersionIdMinor VFC_RoadHdr_NumValidPolynomials VFC_RoadHdr_RoadType VFC_RoadHdr_TimeStampStatus VFC_RoadHdr_TimeStamp VFC_RoadHdr_SensorStatus VFC_RoadHdr_NumValid2DPolynomial VFC_RoadHdr_RoadSurfCondType VFC_RoadHdr_NumValidRoadMarkings VFC_RoadHdr_RoadTypeConf VFC_RoadHdr_RoadSurCondTypeConf VFC_RoadHdr_2DNormVMean VFC_RoadHdr_2DNormVMeanStdDev VFC_RoadHdr_NumValidClothoids;
SIG_GROUP_ 130 SG_VFC_RoadClothoid_00_02 1 : VFC_Cloth_00_02_CRC VFC_Cloth_00_02_AliveCtr VFC_Cloth_00_02_ProtBlockCtr VFC_Cloth00_LaneAssociation VFC_Cloth00_Colour VFC_Cloth00_RangeXBegin VFC_Cloth00_RangeXEnd VFC_Cloth00_ExistProb VFC_Cloth00_CurvChange VFC_Cloth00_Curv VFC_Cloth00_PyStdDev VFC_Cloth00_Py VFC_Cloth00_OrientationYaw VFC_Cloth00_Width VFC_Cloth00_Type VFC_Cloth01_LaneAssociation VFC_Cloth01_Colour VFC_Cloth01_RangeXBegin VFC_Cloth01_RangeXEnd VFC_Cloth01_ExistProb VFC_Cloth01_CurvChange VFC_Cloth01_Curv VFC_Cloth01_PyStdDev VFC_Cloth01_Py VFC_Cloth01_OrientationYaw VFC_Cloth01_Width VFC_Cloth01_Type VFC_Cloth02_LaneAssociation VFC_Cloth02_Colour VFC_Cloth02_RangeXBegin VFC_Cloth02_RangeXEnd VFC_Cloth02_ExistProb VFC_Cloth02_CurvChange VFC_Cloth02_Curv VFC_Cloth02_PyStdDev VFC_Cloth02_Py VFC_Cloth02_OrientationYaw VFC_Cloth02_Width VFC_Cloth02_Type;
SIG_GROUP_ 131 SG_VFC_RoadClothoid_03_05 1 : VFC_Cloth_03_05_CRC VFC_Cloth_03_05_AliveCtr VFC_Cloth_03_05_ProtBlockCtr VFC_Cloth03_LaneAssociation VFC_Cloth03_Colour VFC_Cloth03_RangeXBegin VFC_Cloth03_RangeXEnd VFC_Cloth03_ExistProb VFC_Cloth03_CurvChange VFC_Cloth03_Curv VFC_Cloth03_PyStdDev VFC_Cloth03_Py VFC_Cloth03_OrientationYaw VFC_Cloth03_Width VFC_Cloth03_Type VFC_Cloth04_LaneAssociation VFC_Cloth04_Colour VFC_Cloth04_RangeXBegin VFC_Cloth04_RangeXEnd VFC_Cloth04_ExistProb VFC_Cloth04_CurvChange VFC_Cloth04_Curv VFC_Cloth04_PyStdDev VFC_Cloth04_Py VFC_Cloth04_OrientationYaw VFC_Cloth04_Width VFC_Cloth04_Type VFC_Cloth05_LaneAssociation VFC_Cloth05_Colour VFC_Cloth05_RangeXBegin VFC_Cloth05_RangeXEnd VFC_Cloth05_ExistProb VFC_Cloth05_CurvChange VFC_Cloth05_Curv VFC_Cloth05_PyStdDev VFC_Cloth05_Py VFC_Cloth05_OrientationYaw VFC_Cloth05_Width VFC_Cloth05_Type;
SIG_GROUP_ 132 SG_VFC_RoadClothoid_06_08 1 : VFC_Cloth_06_08_CRC VFC_Cloth_06_08_AliveCtr VFC_Cloth_06_08_ProtBlockCtr VFC_Cloth06_LaneAssociation VFC_Cloth06_Colour VFC_Cloth06_RangeXBegin VFC_Cloth06_RangeXEnd VFC_Cloth06_ExistProb VFC_Cloth06_CurvChange VFC_Cloth06_Curv VFC_Cloth06_PyStdDev VFC_Cloth06_Py VFC_Cloth06_OrientationYaw VFC_Cloth06_Width VFC_Cloth06_Type VFC_Cloth07_LaneAssociation VFC_Cloth07_Colour VFC_Cloth07_RangeXBegin VFC_Cloth07_RangeXEnd VFC_Cloth07_ExistProb VFC_Cloth07_CurvChange VFC_Cloth07_Curv VFC_Cloth07_PyStdDev VFC_Cloth07_Py VFC_Cloth07_OrientationYaw VFC_Cloth07_Width VFC_Cloth07_Type VFC_Cloth08_LaneAssociation VFC_Cloth08_Colour VFC_Cloth08_RangeXBegin VFC_Cloth08_RangeXEnd VFC_Cloth08_ExistProb VFC_Cloth08_CurvChange VFC_Cloth08_Curv VFC_Cloth08_PyStdDev VFC_Cloth08_Py VFC_Cloth08_OrientationYaw VFC_Cloth08_Width VFC_Cloth08_Type;
