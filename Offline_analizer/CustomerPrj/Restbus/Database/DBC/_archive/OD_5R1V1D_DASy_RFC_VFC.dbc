VERSION "created by canmatrix"

NS_ :

BS_:

BU_: RadarFrontCenter VideoFrontCenter DASy ReceiveECU

BO_ 326 RFC_Location_186_188: 64 RadarFrontCenter
 SG_ RFC_Loc186_188_CRC : 0|16@1+ (1,0) [0|65535] ""  DASy
 SG_ RFC_Loc186_188_AliveCtr : 16|8@1+ (1,0) [0|255] ""  DASy
 SG_ RFC_Loc186_188_ProtBlockCtr : 24|4@1+ (1,0) [0|15] ""  DASy
 SG_ RFC_Loc186_RadialDistance : 32|15@1+ (0.01,0) [0|327.67] "m"  DASy
 SG_ RFC_Loc186_RadialVelocity : 47|15@1+ (0.01,-163.84) [-110|55] "m/s"  DASy
 SG_ RFC_Loc186_Elevation : 62|10@1+ (0.1,-51.2) [-45|45] "deg"  DASy
 SG_ RFC_Loc186_Azimuth : 72|11@1+ (0.1,-102.4) [-90|90] "deg"  DASy
 SG_ RFC_Loc186_DistVelocityCoVnce : 83|11@1+ (0.0001,-0.1024) [-0.1024|0.1023] "m^2/s"  DASy
 SG_ RFC_Loc186_RadialDistanceVnce : 94|10@1+ (5E-005,0) [0|0.05115] "m^2"  DASy
 SG_ RFC_Loc186_RadialVelocityVnce : 104|10@1+ (0.0001,0) [0|0.1023] "m^2/s^2"  DASy
 SG_ RFC_Loc186_ElevationVnce : 114|10@1+ (0.001,0) [0|1.023] "deg^2"  DASy
 SG_ RFC_Loc186_AzimuthVnce : 124|10@1+ (0.001,0) [0|1.023] "deg^2"  DASy
 SG_ RFC_Loc186_RadarCrossSection : 134|10@1+ (0.2,-102.4) [-50|70] "dBsm"  DASy
 SG_ RFC_Loc186_DistVelocityQuality : 144|8@1+ (1,0) [0|255] "unitless"  DASy
 SG_ RFC_Loc186_ElevationQuality : 152|8@1+ (1,0) [0|255] "unitless"  DASy
 SG_ RFC_Loc186_AzimuthQuality : 160|8@1+ (1,0) [0|255] "unitless"  DASy
 SG_ RFC_Loc186_RSSI : 168|10@1+ (0.1,0) [0|100] "unitless"  DASy
 SG_ RFC_Loc186_AzimuthalPartnerId : 178|10@1+ (1,0) [0|1023] "unitless"  DASy
 SG_ RFC_Loc187_RadialDistance : 192|15@1+ (0.01,0) [0|327.67] "m"  DASy
 SG_ RFC_Loc187_RadialVelocity : 207|15@1+ (0.01,-163.84) [-110|55] "m/s"  DASy
 SG_ RFC_Loc187_Elevation : 222|10@1+ (0.1,-51.2) [-45|45] "deg"  DASy
 SG_ RFC_Loc187_Azimuth : 232|11@1+ (0.1,-102.4) [-90|90] "deg"  DASy
 SG_ RFC_Loc187_DistVelocityCoVnce : 243|11@1+ (0.0001,-0.1024) [-0.1024|0.1023] "m^2/s"  DASy
 SG_ RFC_Loc187_RadialDistanceVnce : 254|10@1+ (5E-005,0) [0|0.05115] "m^2"  DASy
 SG_ RFC_Loc187_RadialVelocityVnce : 264|10@1+ (0.0001,0) [0|0.1023] "m^2/s^2"  DASy
 SG_ RFC_Loc187_ElevationVnce : 274|10@1+ (0.001,0) [0|1.023] "deg^2"  DASy
 SG_ RFC_Loc187_AzimuthVnce : 284|10@1+ (0.001,0) [0|1.023] "deg^2"  DASy
 SG_ RFC_Loc187_RadarCrossSection : 294|10@1+ (0.2,-102.4) [-50|70] "dBsm"  DASy
 SG_ RFC_Loc187_DistVelocityQuality : 304|8@1+ (1,0) [0|255] "unitless"  DASy
 SG_ RFC_Loc187_ElevationQuality : 312|8@1+ (1,0) [0|255] "unitless"  DASy
 SG_ RFC_Loc187_AzimuthQuality : 320|8@1+ (1,0) [0|255] "unitless"  DASy
 SG_ RFC_Loc187_RSSI : 328|10@1+ (0.1,0) [0|100] "unitless"  DASy
 SG_ RFC_Loc187_AzimuthalPartnerId : 338|10@1+ (1,0) [0|1023] "unitless"  DASy
 SG_ RFC_Loc188_RadialDistance : 352|15@1+ (0.01,0) [0|327.67] "m"  DASy
 SG_ RFC_Loc188_RadialVelocity : 367|15@1+ (0.01,-163.84) [-110|55] "m/s"  DASy
 SG_ RFC_Loc188_Elevation : 382|10@1+ (0.1,-51.2) [-45|45] "deg"  DASy
 SG_ RFC_Loc188_Azimuth : 392|11@1+ (0.1,-102.4) [-90|90] "deg"  DASy
 SG_ RFC_Loc188_DistVelocityCoVnce : 403|11@1+ (0.0001,-0.1024) [-0.1024|0.1023] "m^2/s"  DASy
 SG_ RFC_Loc188_RadialDistanceVnce : 414|10@1+ (5E-005,0) [0|0.05115] "m^2"  DASy
 SG_ RFC_Loc188_RadialVelocityVnce : 424|10@1+ (0.0001,0) [0|0.1023] "m^2/s^2"  DASy
 SG_ RFC_Loc188_ElevationVnce : 434|10@1+ (0.001,0) [0|1.023] "deg^2"  DASy
 SG_ RFC_Loc188_AzimuthVnce : 444|10@1+ (0.001,0) [0|1.023] "deg^2"  DASy
 SG_ RFC_Loc188_RadarCrossSection : 454|10@1+ (0.2,-102.4) [-50|70] "dBsm"  DASy
 SG_ RFC_Loc188_DistVelocityQuality : 464|8@1+ (1,0) [0|255] "unitless"  DASy
 SG_ RFC_Loc188_ElevationQuality : 472|8@1+ (1,0) [0|255] "unitless"  DASy
 SG_ RFC_Loc188_AzimuthQuality : 480|8@1+ (1,0) [0|255] "unitless"  DASy
 SG_ RFC_Loc188_RSSI : 488|10@1+ (0.1,0) [0|100] "unitless"  DASy
 SG_ RFC_Loc188_AzimuthalPartnerId : 498|10@1+ (1,0) [0|1023] "unitless"  DASy

BO_ 327 RFC_Location_189_191: 64 RadarFrontCenter
 SG_ RFC_Loc189_191_CRC : 0|16@1+ (1,0) [0|65535] ""  DASy
 SG_ RFC_Loc189_191_AliveCtr : 16|8@1+ (1,0) [0|255] ""  DASy
 SG_ RFC_Loc189_191_ProtBlockCtr : 24|4@1+ (1,0) [0|15] ""  DASy
 SG_ RFC_Loc189_RadialDistance : 32|15@1+ (0.01,0) [0|327.67] "m"  DASy
 SG_ RFC_Loc189_RadialVelocity : 47|15@1+ (0.01,-163.84) [-110|55] "m/s"  DASy
 SG_ RFC_Loc189_Elevation : 62|10@1+ (0.1,-51.2) [-45|45] "deg"  DASy
 SG_ RFC_Loc189_Azimuth : 72|11@1+ (0.1,-102.4) [-90|90] "deg"  DASy
 SG_ RFC_Loc189_DistVelocityCoVnce : 83|11@1+ (0.0001,-0.1024) [-0.1024|0.1023] "m^2/s"  DASy
 SG_ RFC_Loc189_RadialDistanceVnce : 94|10@1+ (5E-005,0) [0|0.05115] "m^2"  DASy
 SG_ RFC_Loc189_RadialVelocityVnce : 104|10@1+ (0.0001,0) [0|0.1023] "m^2/s^2"  DASy
 SG_ RFC_Loc189_ElevationVnce : 114|10@1+ (0.001,0) [0|1.023] "deg^2"  DASy
 SG_ RFC_Loc189_AzimuthVnce : 124|10@1+ (0.001,0) [0|1.023] "deg^2"  DASy
 SG_ RFC_Loc189_RadarCrossSection : 134|10@1+ (0.2,-102.4) [-50|70] "dBsm"  DASy
 SG_ RFC_Loc189_DistVelocityQuality : 144|8@1+ (1,0) [0|255] "unitless"  DASy
 SG_ RFC_Loc189_ElevationQuality : 152|8@1+ (1,0) [0|255] "unitless"  DASy
 SG_ RFC_Loc189_AzimuthQuality : 160|8@1+ (1,0) [0|255] "unitless"  DASy
 SG_ RFC_Loc189_RSSI : 168|10@1+ (0.1,0) [0|100] "unitless"  DASy
 SG_ RFC_Loc189_AzimuthalPartnerId : 178|10@1+ (1,0) [0|1023] "unitless"  DASy
 SG_ RFC_Loc190_RadialDistance : 192|15@1+ (0.01,0) [0|327.67] "m"  DASy
 SG_ RFC_Loc190_RadialVelocity : 207|15@1+ (0.01,-163.84) [-110|55] "m/s"  DASy
 SG_ RFC_Loc190_Elevation : 222|10@1+ (0.1,-51.2) [-45|45] "deg"  DASy
 SG_ RFC_Loc190_Azimuth : 232|11@1+ (0.1,-102.4) [-90|90] "deg"  DASy
 SG_ RFC_Loc190_DistVelocityCoVnce : 243|11@1+ (0.0001,-0.1024) [-0.1024|0.1023] "m^2/s"  DASy
 SG_ RFC_Loc190_RadialDistanceVnce : 254|10@1+ (5E-005,0) [0|0.05115] "m^2"  DASy
 SG_ RFC_Loc190_RadialVelocityVnce : 264|10@1+ (0.0001,0) [0|0.1023] "m^2/s^2"  DASy
 SG_ RFC_Loc190_ElevationVnce : 274|10@1+ (0.001,0) [0|1.023] "deg^2"  DASy
 SG_ RFC_Loc190_AzimuthVnce : 284|10@1+ (0.001,0) [0|1.023] "deg^2"  DASy
 SG_ RFC_Loc190_RadarCrossSection : 294|10@1+ (0.2,-102.4) [-50|70] "dBsm"  DASy
 SG_ RFC_Loc190_DistVelocityQuality : 304|8@1+ (1,0) [0|255] "unitless"  DASy
 SG_ RFC_Loc190_ElevationQuality : 312|8@1+ (1,0) [0|255] "unitless"  DASy
 SG_ RFC_Loc190_AzimuthQuality : 320|8@1+ (1,0) [0|255] "unitless"  DASy
 SG_ RFC_Loc190_RSSI : 328|10@1+ (0.1,0) [0|100] "unitless"  DASy
 SG_ RFC_Loc190_AzimuthalPartnerId : 338|10@1+ (1,0) [0|1023] "unitless"  DASy
 SG_ RFC_Loc191_RadialDistance : 352|15@1+ (0.01,0) [0|327.67] "m"  DASy
 SG_ RFC_Loc191_RadialVelocity : 367|15@1+ (0.01,-163.84) [-110|55] "m/s"  DASy
 SG_ RFC_Loc191_Elevation : 382|10@1+ (0.1,-51.2) [-45|45] "deg"  DASy
 SG_ RFC_Loc191_Azimuth : 392|11@1+ (0.1,-102.4) [-90|90] "deg"  DASy
 SG_ RFC_Loc191_DistVelocityCoVnce : 403|11@1+ (0.0001,-0.1024) [-0.1024|0.1023] "m^2/s"  DASy
 SG_ RFC_Loc191_RadialDistanceVnce : 414|10@1+ (5E-005,0) [0|0.05115] "m^2"  DASy
 SG_ RFC_Loc191_RadialVelocityVnce : 424|10@1+ (0.0001,0) [0|0.1023] "m^2/s^2"  DASy
 SG_ RFC_Loc191_ElevationVnce : 434|10@1+ (0.001,0) [0|1.023] "deg^2"  DASy
 SG_ RFC_Loc191_AzimuthVnce : 444|10@1+ (0.001,0) [0|1.023] "deg^2"  DASy
 SG_ RFC_Loc191_RadarCrossSection : 454|10@1+ (0.2,-102.4) [-50|70] "dBsm"  DASy
 SG_ RFC_Loc191_DistVelocityQuality : 464|8@1+ (1,0) [0|255] "unitless"  DASy
 SG_ RFC_Loc191_ElevationQuality : 472|8@1+ (1,0) [0|255] "unitless"  DASy
 SG_ RFC_Loc191_AzimuthQuality : 480|8@1+ (1,0) [0|255] "unitless"  DASy
 SG_ RFC_Loc191_RSSI : 488|10@1+ (0.1,0) [0|100] "unitless"  DASy
 SG_ RFC_Loc191_AzimuthalPartnerId : 498|10@1+ (1,0) [0|1023] "unitless"  DASy

BO_ 328 RFC_Location_192_194: 64 RadarFrontCenter
 SG_ RFC_Loc192_194_CRC : 0|16@1+ (1,0) [0|65535] ""  DASy
 SG_ RFC_Loc192_194_AliveCtr : 16|8@1+ (1,0) [0|255] ""  DASy
 SG_ RFC_Loc192_194_ProtBlockCtr : 24|4@1+ (1,0) [0|15] ""  DASy
 SG_ RFC_Loc192_RadialDistance : 32|15@1+ (0.01,0) [0|327.67] "m"  DASy
 SG_ RFC_Loc192_RadialVelocity : 47|15@1+ (0.01,-163.84) [-110|55] "m/s"  DASy
 SG_ RFC_Loc192_Elevation : 62|10@1+ (0.1,-51.2) [-45|45] "deg"  DASy
 SG_ RFC_Loc192_Azimuth : 72|11@1+ (0.1,-102.4) [-90|90] "deg"  DASy
 SG_ RFC_Loc192_DistVelocityCoVnce : 83|11@1+ (0.0001,-0.1024) [-0.1024|0.1023] "m^2/s"  DASy
 SG_ RFC_Loc192_RadialDistanceVnce : 94|10@1+ (5E-005,0) [0|0.05115] "m^2"  DASy
 SG_ RFC_Loc192_RadialVelocityVnce : 104|10@1+ (0.0001,0) [0|0.1023] "m^2/s^2"  DASy
 SG_ RFC_Loc192_ElevationVnce : 114|10@1+ (0.001,0) [0|1.023] "deg^2"  DASy
 SG_ RFC_Loc192_AzimuthVnce : 124|10@1+ (0.001,0) [0|1.023] "deg^2"  DASy
 SG_ RFC_Loc192_RadarCrossSection : 134|10@1+ (0.2,-102.4) [-50|70] "dBsm"  DASy
 SG_ RFC_Loc192_DistVelocityQuality : 144|8@1+ (1,0) [0|255] "unitless"  DASy
 SG_ RFC_Loc192_ElevationQuality : 152|8@1+ (1,0) [0|255] "unitless"  DASy
 SG_ RFC_Loc192_AzimuthQuality : 160|8@1+ (1,0) [0|255] "unitless"  DASy
 SG_ RFC_Loc192_RSSI : 168|10@1+ (0.1,0) [0|100] "unitless"  DASy
 SG_ RFC_Loc192_AzimuthalPartnerId : 178|10@1+ (1,0) [0|1023] "unitless"  DASy
 SG_ RFC_Loc193_RadialDistance : 192|15@1+ (0.01,0) [0|327.67] "m"  DASy
 SG_ RFC_Loc193_RadialVelocity : 207|15@1+ (0.01,-163.84) [-110|55] "m/s"  DASy
 SG_ RFC_Loc193_Elevation : 222|10@1+ (0.1,-51.2) [-45|45] "deg"  DASy
 SG_ RFC_Loc193_Azimuth : 232|11@1+ (0.1,-102.4) [-90|90] "deg"  DASy
 SG_ RFC_Loc193_DistVelocityCoVnce : 243|11@1+ (0.0001,-0.1024) [-0.1024|0.1023] "m^2/s"  DASy
 SG_ RFC_Loc193_RadialDistanceVnce : 254|10@1+ (5E-005,0) [0|0.05115] "m^2"  DASy
 SG_ RFC_Loc193_RadialVelocityVnce : 264|10@1+ (0.0001,0) [0|0.1023] "m^2/s^2"  DASy
 SG_ RFC_Loc193_ElevationVnce : 274|10@1+ (0.001,0) [0|1.023] "deg^2"  DASy
 SG_ RFC_Loc193_AzimuthVnce : 284|10@1+ (0.001,0) [0|1.023] "deg^2"  DASy
 SG_ RFC_Loc193_RadarCrossSection : 294|10@1+ (0.2,-102.4) [-50|70] "dBsm"  DASy
 SG_ RFC_Loc193_DistVelocityQuality : 304|8@1+ (1,0) [0|255] "unitless"  DASy
 SG_ RFC_Loc193_ElevationQuality : 312|8@1+ (1,0) [0|255] "unitless"  DASy
 SG_ RFC_Loc193_AzimuthQuality : 320|8@1+ (1,0) [0|255] "unitless"  DASy
 SG_ RFC_Loc193_RSSI : 328|10@1+ (0.1,0) [0|100] "unitless"  DASy
 SG_ RFC_Loc193_AzimuthalPartnerId : 338|10@1+ (1,0) [0|1023] "unitless"  DASy
 SG_ RFC_Loc194_RadialDistance : 352|15@1+ (0.01,0) [0|327.67] "m"  DASy
 SG_ RFC_Loc194_RadialVelocity : 367|15@1+ (0.01,-163.84) [-110|55] "m/s"  DASy
 SG_ RFC_Loc194_Elevation : 382|10@1+ (0.1,-51.2) [-45|45] "deg"  DASy
 SG_ RFC_Loc194_Azimuth : 392|11@1+ (0.1,-102.4) [-90|90] "deg"  DASy
 SG_ RFC_Loc194_DistVelocityCoVnce : 403|11@1+ (0.0001,-0.1024) [-0.1024|0.1023] "m^2/s"  DASy
 SG_ RFC_Loc194_RadialDistanceVnce : 414|10@1+ (5E-005,0) [0|0.05115] "m^2"  DASy
 SG_ RFC_Loc194_RadialVelocityVnce : 424|10@1+ (0.0001,0) [0|0.1023] "m^2/s^2"  DASy
 SG_ RFC_Loc194_ElevationVnce : 434|10@1+ (0.001,0) [0|1.023] "deg^2"  DASy
 SG_ RFC_Loc194_AzimuthVnce : 444|10@1+ (0.001,0) [0|1.023] "deg^2"  DASy
 SG_ RFC_Loc194_RadarCrossSection : 454|10@1+ (0.2,-102.4) [-50|70] "dBsm"  DASy
 SG_ RFC_Loc194_DistVelocityQuality : 464|8@1+ (1,0) [0|255] "unitless"  DASy
 SG_ RFC_Loc194_ElevationQuality : 472|8@1+ (1,0) [0|255] "unitless"  DASy
 SG_ RFC_Loc194_AzimuthQuality : 480|8@1+ (1,0) [0|255] "unitless"  DASy
 SG_ RFC_Loc194_RSSI : 488|10@1+ (0.1,0) [0|100] "unitless"  DASy
 SG_ RFC_Loc194_AzimuthalPartnerId : 498|10@1+ (1,0) [0|1023] "unitless"  DASy

BO_ 329 RFC_Location_195_197: 64 RadarFrontCenter
 SG_ RFC_Loc195_197_CRC : 0|16@1+ (1,0) [0|65535] ""  DASy
 SG_ RFC_Loc195_197_AliveCtr : 16|8@1+ (1,0) [0|255] ""  DASy
 SG_ RFC_Loc195_197_ProtBlockCtr : 24|4@1+ (1,0) [0|15] ""  DASy
 SG_ RFC_Loc195_RadialDistance : 32|15@1+ (0.01,0) [0|327.67] "m"  DASy
 SG_ RFC_Loc195_RadialVelocity : 47|15@1+ (0.01,-163.84) [-110|55] "m/s"  DASy
 SG_ RFC_Loc195_Elevation : 62|10@1+ (0.1,-51.2) [-45|45] "deg"  DASy
 SG_ RFC_Loc195_Azimuth : 72|11@1+ (0.1,-102.4) [-90|90] "deg"  DASy
 SG_ RFC_Loc195_DistVelocityCoVnce : 83|11@1+ (0.0001,-0.1024) [-0.1024|0.1023] "m^2/s"  DASy
 SG_ RFC_Loc195_RadialDistanceVnce : 94|10@1+ (5E-005,0) [0|0.05115] "m^2"  DASy
 SG_ RFC_Loc195_RadialVelocityVnce : 104|10@1+ (0.0001,0) [0|0.1023] "m^2/s^2"  DASy
 SG_ RFC_Loc195_ElevationVnce : 114|10@1+ (0.001,0) [0|1.023] "deg^2"  DASy
 SG_ RFC_Loc195_AzimuthVnce : 124|10@1+ (0.001,0) [0|1.023] "deg^2"  DASy
 SG_ RFC_Loc195_RadarCrossSection : 134|10@1+ (0.2,-102.4) [-50|70] "dBsm"  DASy
 SG_ RFC_Loc195_DistVelocityQuality : 144|8@1+ (1,0) [0|255] "unitless"  DASy
 SG_ RFC_Loc195_ElevationQuality : 152|8@1+ (1,0) [0|255] "unitless"  DASy
 SG_ RFC_Loc195_AzimuthQuality : 160|8@1+ (1,0) [0|255] "unitless"  DASy
 SG_ RFC_Loc195_RSSI : 168|10@1+ (0.1,0) [0|100] "unitless"  DASy
 SG_ RFC_Loc195_AzimuthalPartnerId : 178|10@1+ (1,0) [0|1023] "unitless"  DASy
 SG_ RFC_Loc196_RadialDistance : 192|15@1+ (0.01,0) [0|327.67] "m"  DASy
 SG_ RFC_Loc196_RadialVelocity : 207|15@1+ (0.01,-163.84) [-110|55] "m/s"  DASy
 SG_ RFC_Loc196_Elevation : 222|10@1+ (0.1,-51.2) [-45|45] "deg"  DASy
 SG_ RFC_Loc196_Azimuth : 232|11@1+ (0.1,-102.4) [-90|90] "deg"  DASy
 SG_ RFC_Loc196_DistVelocityCoVnce : 243|11@1+ (0.0001,-0.1024) [-0.1024|0.1023] "m^2/s"  DASy
 SG_ RFC_Loc196_RadialDistanceVnce : 254|10@1+ (5E-005,0) [0|0.05115] "m^2"  DASy
 SG_ RFC_Loc196_RadialVelocityVnce : 264|10@1+ (0.0001,0) [0|0.1023] "m^2/s^2"  DASy
 SG_ RFC_Loc196_ElevationVnce : 274|10@1+ (0.001,0) [0|1.023] "deg^2"  DASy
 SG_ RFC_Loc196_AzimuthVnce : 284|10@1+ (0.001,0) [0|1.023] "deg^2"  DASy
 SG_ RFC_Loc196_RadarCrossSection : 294|10@1+ (0.2,-102.4) [-50|70] "dBsm"  DASy
 SG_ RFC_Loc196_DistVelocityQuality : 304|8@1+ (1,0) [0|255] "unitless"  DASy
 SG_ RFC_Loc196_ElevationQuality : 312|8@1+ (1,0) [0|255] "unitless"  DASy
 SG_ RFC_Loc196_AzimuthQuality : 320|8@1+ (1,0) [0|255] "unitless"  DASy
 SG_ RFC_Loc196_RSSI : 328|10@1+ (0.1,0) [0|100] "unitless"  DASy
 SG_ RFC_Loc196_AzimuthalPartnerId : 338|10@1+ (1,0) [0|1023] "unitless"  DASy
 SG_ RFC_Loc197_RadialDistance : 352|15@1+ (0.01,0) [0|327.67] "m"  DASy
 SG_ RFC_Loc197_RadialVelocity : 367|15@1+ (0.01,-163.84) [-110|55] "m/s"  DASy
 SG_ RFC_Loc197_Elevation : 382|10@1+ (0.1,-51.2) [-45|45] "deg"  DASy
 SG_ RFC_Loc197_Azimuth : 392|11@1+ (0.1,-102.4) [-90|90] "deg"  DASy
 SG_ RFC_Loc197_DistVelocityCoVnce : 403|11@1+ (0.0001,-0.1024) [-0.1024|0.1023] "m^2/s"  DASy
 SG_ RFC_Loc197_RadialDistanceVnce : 414|10@1+ (5E-005,0) [0|0.05115] "m^2"  DASy
 SG_ RFC_Loc197_RadialVelocityVnce : 424|10@1+ (0.0001,0) [0|0.1023] "m^2/s^2"  DASy
 SG_ RFC_Loc197_ElevationVnce : 434|10@1+ (0.001,0) [0|1.023] "deg^2"  DASy
 SG_ RFC_Loc197_AzimuthVnce : 444|10@1+ (0.001,0) [0|1.023] "deg^2"  DASy
 SG_ RFC_Loc197_RadarCrossSection : 454|10@1+ (0.2,-102.4) [-50|70] "dBsm"  DASy
 SG_ RFC_Loc197_DistVelocityQuality : 464|8@1+ (1,0) [0|255] "unitless"  DASy
 SG_ RFC_Loc197_ElevationQuality : 472|8@1+ (1,0) [0|255] "unitless"  DASy
 SG_ RFC_Loc197_AzimuthQuality : 480|8@1+ (1,0) [0|255] "unitless"  DASy
 SG_ RFC_Loc197_RSSI : 488|10@1+ (0.1,0) [0|100] "unitless"  DASy
 SG_ RFC_Loc197_AzimuthalPartnerId : 498|10@1+ (1,0) [0|1023] "unitless"  DASy

BO_ 330 RFC_Location_198_200: 64 RadarFrontCenter
 SG_ RFC_Loc198_200_CRC : 0|16@1+ (1,0) [0|65535] ""  DASy
 SG_ RFC_Loc198_200_AliveCtr : 16|8@1+ (1,0) [0|255] ""  DASy
 SG_ RFC_Loc198_200_ProtBlockCtr : 24|4@1+ (1,0) [0|15] ""  DASy
 SG_ RFC_Loc198_RadialDistance : 32|15@1+ (0.01,0) [0|327.67] "m"  DASy
 SG_ RFC_Loc198_RadialVelocity : 47|15@1+ (0.01,-163.84) [-110|55] "m/s"  DASy
 SG_ RFC_Loc198_Elevation : 62|10@1+ (0.1,-51.2) [-45|45] "deg"  DASy
 SG_ RFC_Loc198_Azimuth : 72|11@1+ (0.1,-102.4) [-90|90] "deg"  DASy
 SG_ RFC_Loc198_DistVelocityCoVnce : 83|11@1+ (0.0001,-0.1024) [-0.1024|0.1023] "m^2/s"  DASy
 SG_ RFC_Loc198_RadialDistanceVnce : 94|10@1+ (5E-005,0) [0|0.05115] "m^2"  DASy
 SG_ RFC_Loc198_RadialVelocityVnce : 104|10@1+ (0.0001,0) [0|0.1023] "m^2/s^2"  DASy
 SG_ RFC_Loc198_ElevationVnce : 114|10@1+ (0.001,0) [0|1.023] "deg^2"  DASy
 SG_ RFC_Loc198_AzimuthVnce : 124|10@1+ (0.001,0) [0|1.023] "deg^2"  DASy
 SG_ RFC_Loc198_RadarCrossSection : 134|10@1+ (0.2,-102.4) [-50|70] "dBsm"  DASy
 SG_ RFC_Loc198_DistVelocityQuality : 144|8@1+ (1,0) [0|255] "unitless"  DASy
 SG_ RFC_Loc198_ElevationQuality : 152|8@1+ (1,0) [0|255] "unitless"  DASy
 SG_ RFC_Loc198_AzimuthQuality : 160|8@1+ (1,0) [0|255] "unitless"  DASy
 SG_ RFC_Loc198_RSSI : 168|10@1+ (0.1,0) [0|100] "unitless"  DASy
 SG_ RFC_Loc198_AzimuthalPartnerId : 178|10@1+ (1,0) [0|1023] "unitless"  DASy
 SG_ RFC_Loc199_RadialDistance : 192|15@1+ (0.01,0) [0|327.67] "m"  DASy
 SG_ RFC_Loc199_RadialVelocity : 207|15@1+ (0.01,-163.84) [-110|55] "m/s"  DASy
 SG_ RFC_Loc199_Elevation : 222|10@1+ (0.1,-51.2) [-45|45] "deg"  DASy
 SG_ RFC_Loc199_Azimuth : 232|11@1+ (0.1,-102.4) [-90|90] "deg"  DASy
 SG_ RFC_Loc199_DistVelocityCoVnce : 243|11@1+ (0.0001,-0.1024) [-0.1024|0.1023] "m^2/s"  DASy
 SG_ RFC_Loc199_RadialDistanceVnce : 254|10@1+ (5E-005,0) [0|0.05115] "m^2"  DASy
 SG_ RFC_Loc199_RadialVelocityVnce : 264|10@1+ (0.0001,0) [0|0.1023] "m^2/s^2"  DASy
 SG_ RFC_Loc199_ElevationVnce : 274|10@1+ (0.001,0) [0|1.023] "deg^2"  DASy
 SG_ RFC_Loc199_AzimuthVnce : 284|10@1+ (0.001,0) [0|1.023] "deg^2"  DASy
 SG_ RFC_Loc199_RadarCrossSection : 294|10@1+ (0.2,-102.4) [-50|70] "dBsm"  DASy
 SG_ RFC_Loc199_DistVelocityQuality : 304|8@1+ (1,0) [0|255] "unitless"  DASy
 SG_ RFC_Loc199_ElevationQuality : 312|8@1+ (1,0) [0|255] "unitless"  DASy
 SG_ RFC_Loc199_AzimuthQuality : 320|8@1+ (1,0) [0|255] "unitless"  DASy
 SG_ RFC_Loc199_RSSI : 328|10@1+ (0.1,0) [0|100] "unitless"  DASy
 SG_ RFC_Loc199_AzimuthalPartnerId : 338|10@1+ (1,0) [0|1023] "unitless"  DASy
 SG_ RFC_Loc200_RadialDistance : 352|15@1+ (0.01,0) [0|327.67] "m"  DASy
 SG_ RFC_Loc200_RadialVelocity : 367|15@1+ (0.01,-163.84) [-110|55] "m/s"  DASy
 SG_ RFC_Loc200_Elevation : 382|10@1+ (0.1,-51.2) [-45|45] "deg"  DASy
 SG_ RFC_Loc200_Azimuth : 392|11@1+ (0.1,-102.4) [-90|90] "deg"  DASy
 SG_ RFC_Loc200_DistVelocityCoVnce : 403|11@1+ (0.0001,-0.1024) [-0.1024|0.1023] "m^2/s"  DASy
 SG_ RFC_Loc200_RadialDistanceVnce : 414|10@1+ (5E-005,0) [0|0.05115] "m^2"  DASy
 SG_ RFC_Loc200_RadialVelocityVnce : 424|10@1+ (0.0001,0) [0|0.1023] "m^2/s^2"  DASy
 SG_ RFC_Loc200_ElevationVnce : 434|10@1+ (0.001,0) [0|1.023] "deg^2"  DASy
 SG_ RFC_Loc200_AzimuthVnce : 444|10@1+ (0.001,0) [0|1.023] "deg^2"  DASy
 SG_ RFC_Loc200_RadarCrossSection : 454|10@1+ (0.2,-102.4) [-50|70] "dBsm"  DASy
 SG_ RFC_Loc200_DistVelocityQuality : 464|8@1+ (1,0) [0|255] "unitless"  DASy
 SG_ RFC_Loc200_ElevationQuality : 472|8@1+ (1,0) [0|255] "unitless"  DASy
 SG_ RFC_Loc200_AzimuthQuality : 480|8@1+ (1,0) [0|255] "unitless"  DASy
 SG_ RFC_Loc200_RSSI : 488|10@1+ (0.1,0) [0|100] "unitless"  DASy
 SG_ RFC_Loc200_AzimuthalPartnerId : 498|10@1+ (1,0) [0|1023] "unitless"  DASy

BO_ 331 RFC_Location_201_203: 64 RadarFrontCenter
 SG_ RFC_Loc201_203_CRC : 0|16@1+ (1,0) [0|65535] ""  DASy
 SG_ RFC_Loc201_203_AliveCtr : 16|8@1+ (1,0) [0|255] ""  DASy
 SG_ RFC_Loc201_203_ProtBlockCtr : 24|4@1+ (1,0) [0|15] ""  DASy
 SG_ RFC_Loc201_RadialDistance : 32|15@1+ (0.01,0) [0|327.67] "m"  DASy
 SG_ RFC_Loc201_RadialVelocity : 47|15@1+ (0.01,-163.84) [-110|55] "m/s"  DASy
 SG_ RFC_Loc201_Elevation : 62|10@1+ (0.1,-51.2) [-45|45] "deg"  DASy
 SG_ RFC_Loc201_Azimuth : 72|11@1+ (0.1,-102.4) [-90|90] "deg"  DASy
 SG_ RFC_Loc201_DistVelocityCoVnce : 83|11@1+ (0.0001,-0.1024) [-0.1024|0.1023] "m^2/s"  DASy
 SG_ RFC_Loc201_RadialDistanceVnce : 94|10@1+ (5E-005,0) [0|0.05115] "m^2"  DASy
 SG_ RFC_Loc201_RadialVelocityVnce : 104|10@1+ (0.0001,0) [0|0.1023] "m^2/s^2"  DASy
 SG_ RFC_Loc201_ElevationVnce : 114|10@1+ (0.001,0) [0|1.023] "deg^2"  DASy
 SG_ RFC_Loc201_AzimuthVnce : 124|10@1+ (0.001,0) [0|1.023] "deg^2"  DASy
 SG_ RFC_Loc201_RadarCrossSection : 134|10@1+ (0.2,-102.4) [-50|70] "dBsm"  DASy
 SG_ RFC_Loc201_DistVelocityQuality : 144|8@1+ (1,0) [0|255] "unitless"  DASy
 SG_ RFC_Loc201_ElevationQuality : 152|8@1+ (1,0) [0|255] "unitless"  DASy
 SG_ RFC_Loc201_AzimuthQuality : 160|8@1+ (1,0) [0|255] "unitless"  DASy
 SG_ RFC_Loc201_RSSI : 168|10@1+ (0.1,0) [0|100] "unitless"  DASy
 SG_ RFC_Loc201_AzimuthalPartnerId : 178|10@1+ (1,0) [0|1023] "unitless"  DASy
 SG_ RFC_Loc202_RadialDistance : 192|15@1+ (0.01,0) [0|327.67] "m"  DASy
 SG_ RFC_Loc202_RadialVelocity : 207|15@1+ (0.01,-163.84) [-110|55] "m/s"  DASy
 SG_ RFC_Loc202_Elevation : 222|10@1+ (0.1,-51.2) [-45|45] "deg"  DASy
 SG_ RFC_Loc202_Azimuth : 232|11@1+ (0.1,-102.4) [-90|90] "deg"  DASy
 SG_ RFC_Loc202_DistVelocityCoVnce : 243|11@1+ (0.0001,-0.1024) [-0.1024|0.1023] "m^2/s"  DASy
 SG_ RFC_Loc202_RadialDistanceVnce : 254|10@1+ (5E-005,0) [0|0.05115] "m^2"  DASy
 SG_ RFC_Loc202_RadialVelocityVnce : 264|10@1+ (0.0001,0) [0|0.1023] "m^2/s^2"  DASy
 SG_ RFC_Loc202_ElevationVnce : 274|10@1+ (0.001,0) [0|1.023] "deg^2"  DASy
 SG_ RFC_Loc202_AzimuthVnce : 284|10@1+ (0.001,0) [0|1.023] "deg^2"  DASy
 SG_ RFC_Loc202_RadarCrossSection : 294|10@1+ (0.2,-102.4) [-50|70] "dBsm"  DASy
 SG_ RFC_Loc202_DistVelocityQuality : 304|8@1+ (1,0) [0|255] "unitless"  DASy
 SG_ RFC_Loc202_ElevationQuality : 312|8@1+ (1,0) [0|255] "unitless"  DASy
 SG_ RFC_Loc202_AzimuthQuality : 320|8@1+ (1,0) [0|255] "unitless"  DASy
 SG_ RFC_Loc202_RSSI : 328|10@1+ (0.1,0) [0|100] "unitless"  DASy
 SG_ RFC_Loc202_AzimuthalPartnerId : 338|10@1+ (1,0) [0|1023] "unitless"  DASy
 SG_ RFC_Loc203_RadialDistance : 352|15@1+ (0.01,0) [0|327.67] "m"  DASy
 SG_ RFC_Loc203_RadialVelocity : 367|15@1+ (0.01,-163.84) [-110|55] "m/s"  DASy
 SG_ RFC_Loc203_Elevation : 382|10@1+ (0.1,-51.2) [-45|45] "deg"  DASy
 SG_ RFC_Loc203_Azimuth : 392|11@1+ (0.1,-102.4) [-90|90] "deg"  DASy
 SG_ RFC_Loc203_DistVelocityCoVnce : 403|11@1+ (0.0001,-0.1024) [-0.1024|0.1023] "m^2/s"  DASy
 SG_ RFC_Loc203_RadialDistanceVnce : 414|10@1+ (5E-005,0) [0|0.05115] "m^2"  DASy
 SG_ RFC_Loc203_RadialVelocityVnce : 424|10@1+ (0.0001,0) [0|0.1023] "m^2/s^2"  DASy
 SG_ RFC_Loc203_ElevationVnce : 434|10@1+ (0.001,0) [0|1.023] "deg^2"  DASy
 SG_ RFC_Loc203_AzimuthVnce : 444|10@1+ (0.001,0) [0|1.023] "deg^2"  DASy
 SG_ RFC_Loc203_RadarCrossSection : 454|10@1+ (0.2,-102.4) [-50|70] "dBsm"  DASy
 SG_ RFC_Loc203_DistVelocityQuality : 464|8@1+ (1,0) [0|255] "unitless"  DASy
 SG_ RFC_Loc203_ElevationQuality : 472|8@1+ (1,0) [0|255] "unitless"  DASy
 SG_ RFC_Loc203_AzimuthQuality : 480|8@1+ (1,0) [0|255] "unitless"  DASy
 SG_ RFC_Loc203_RSSI : 488|10@1+ (0.1,0) [0|100] "unitless"  DASy
 SG_ RFC_Loc203_AzimuthalPartnerId : 498|10@1+ (1,0) [0|1023] "unitless"  DASy

BO_ 332 RFC_Location_204_206: 64 RadarFrontCenter
 SG_ RFC_Loc204_206_CRC : 0|16@1+ (1,0) [0|65535] ""  DASy
 SG_ RFC_Loc204_206_AliveCtr : 16|8@1+ (1,0) [0|255] ""  DASy
 SG_ RFC_Loc204_206_ProtBlockCtr : 24|4@1+ (1,0) [0|15] ""  DASy
 SG_ RFC_Loc204_RadialDistance : 32|15@1+ (0.01,0) [0|327.67] "m"  DASy
 SG_ RFC_Loc204_RadialVelocity : 47|15@1+ (0.01,-163.84) [-110|55] "m/s"  DASy
 SG_ RFC_Loc204_Elevation : 62|10@1+ (0.1,-51.2) [-45|45] "deg"  DASy
 SG_ RFC_Loc204_Azimuth : 72|11@1+ (0.1,-102.4) [-90|90] "deg"  DASy
 SG_ RFC_Loc204_DistVelocityCoVnce : 83|11@1+ (0.0001,-0.1024) [-0.1024|0.1023] "m^2/s"  DASy
 SG_ RFC_Loc204_RadialDistanceVnce : 94|10@1+ (5E-005,0) [0|0.05115] "m^2"  DASy
 SG_ RFC_Loc204_RadialVelocityVnce : 104|10@1+ (0.0001,0) [0|0.1023] "m^2/s^2"  DASy
 SG_ RFC_Loc204_ElevationVnce : 114|10@1+ (0.001,0) [0|1.023] "deg^2"  DASy
 SG_ RFC_Loc204_AzimuthVnce : 124|10@1+ (0.001,0) [0|1.023] "deg^2"  DASy
 SG_ RFC_Loc204_RadarCrossSection : 134|10@1+ (0.2,-102.4) [-50|70] "dBsm"  DASy
 SG_ RFC_Loc204_DistVelocityQuality : 144|8@1+ (1,0) [0|255] "unitless"  DASy
 SG_ RFC_Loc204_ElevationQuality : 152|8@1+ (1,0) [0|255] "unitless"  DASy
 SG_ RFC_Loc204_AzimuthQuality : 160|8@1+ (1,0) [0|255] "unitless"  DASy
 SG_ RFC_Loc204_RSSI : 168|10@1+ (0.1,0) [0|100] "unitless"  DASy
 SG_ RFC_Loc204_AzimuthalPartnerId : 178|10@1+ (1,0) [0|1023] "unitless"  DASy
 SG_ RFC_Loc205_RadialDistance : 192|15@1+ (0.01,0) [0|327.67] "m"  DASy
 SG_ RFC_Loc205_RadialVelocity : 207|15@1+ (0.01,-163.84) [-110|55] "m/s"  DASy
 SG_ RFC_Loc205_Elevation : 222|10@1+ (0.1,-51.2) [-45|45] "deg"  DASy
 SG_ RFC_Loc205_Azimuth : 232|11@1+ (0.1,-102.4) [-90|90] "deg"  DASy
 SG_ RFC_Loc205_DistVelocityCoVnce : 243|11@1+ (0.0001,-0.1024) [-0.1024|0.1023] "m^2/s"  DASy
 SG_ RFC_Loc205_RadialDistanceVnce : 254|10@1+ (5E-005,0) [0|0.05115] "m^2"  DASy
 SG_ RFC_Loc205_RadialVelocityVnce : 264|10@1+ (0.0001,0) [0|0.1023] "m^2/s^2"  DASy
 SG_ RFC_Loc205_ElevationVnce : 274|10@1+ (0.001,0) [0|1.023] "deg^2"  DASy
 SG_ RFC_Loc205_AzimuthVnce : 284|10@1+ (0.001,0) [0|1.023] "deg^2"  DASy
 SG_ RFC_Loc205_RadarCrossSection : 294|10@1+ (0.2,-102.4) [-50|70] "dBsm"  DASy
 SG_ RFC_Loc205_DistVelocityQuality : 304|8@1+ (1,0) [0|255] "unitless"  DASy
 SG_ RFC_Loc205_ElevationQuality : 312|8@1+ (1,0) [0|255] "unitless"  DASy
 SG_ RFC_Loc205_AzimuthQuality : 320|8@1+ (1,0) [0|255] "unitless"  DASy
 SG_ RFC_Loc205_RSSI : 328|10@1+ (0.1,0) [0|100] "unitless"  DASy
 SG_ RFC_Loc205_AzimuthalPartnerId : 338|10@1+ (1,0) [0|1023] "unitless"  DASy
 SG_ RFC_Loc206_RadialDistance : 352|15@1+ (0.01,0) [0|327.67] "m"  DASy
 SG_ RFC_Loc206_RadialVelocity : 367|15@1+ (0.01,-163.84) [-110|55] "m/s"  DASy
 SG_ RFC_Loc206_Elevation : 382|10@1+ (0.1,-51.2) [-45|45] "deg"  DASy
 SG_ RFC_Loc206_Azimuth : 392|11@1+ (0.1,-102.4) [-90|90] "deg"  DASy
 SG_ RFC_Loc206_DistVelocityCoVnce : 403|11@1+ (0.0001,-0.1024) [-0.1024|0.1023] "m^2/s"  DASy
 SG_ RFC_Loc206_RadialDistanceVnce : 414|10@1+ (5E-005,0) [0|0.05115] "m^2"  DASy
 SG_ RFC_Loc206_RadialVelocityVnce : 424|10@1+ (0.0001,0) [0|0.1023] "m^2/s^2"  DASy
 SG_ RFC_Loc206_ElevationVnce : 434|10@1+ (0.001,0) [0|1.023] "deg^2"  DASy
 SG_ RFC_Loc206_AzimuthVnce : 444|10@1+ (0.001,0) [0|1.023] "deg^2"  DASy
 SG_ RFC_Loc206_RadarCrossSection : 454|10@1+ (0.2,-102.4) [-50|70] "dBsm"  DASy
 SG_ RFC_Loc206_DistVelocityQuality : 464|8@1+ (1,0) [0|255] "unitless"  DASy
 SG_ RFC_Loc206_ElevationQuality : 472|8@1+ (1,0) [0|255] "unitless"  DASy
 SG_ RFC_Loc206_AzimuthQuality : 480|8@1+ (1,0) [0|255] "unitless"  DASy
 SG_ RFC_Loc206_RSSI : 488|10@1+ (0.1,0) [0|100] "unitless"  DASy
 SG_ RFC_Loc206_AzimuthalPartnerId : 498|10@1+ (1,0) [0|1023] "unitless"  DASy

BO_ 333 RFC_Location_207_209: 64 RadarFrontCenter
 SG_ RFC_Loc207_209_CRC : 0|16@1+ (1,0) [0|65535] ""  DASy
 SG_ RFC_Loc207_209_AliveCtr : 16|8@1+ (1,0) [0|255] ""  DASy
 SG_ RFC_Loc207_209_ProtBlockCtr : 24|4@1+ (1,0) [0|15] ""  DASy
 SG_ RFC_Loc207_RadialDistance : 32|15@1+ (0.01,0) [0|327.67] "m"  DASy
 SG_ RFC_Loc207_RadialVelocity : 47|15@1+ (0.01,-163.84) [-110|55] "m/s"  DASy
 SG_ RFC_Loc207_Elevation : 62|10@1+ (0.1,-51.2) [-45|45] "deg"  DASy
 SG_ RFC_Loc207_Azimuth : 72|11@1+ (0.1,-102.4) [-90|90] "deg"  DASy
 SG_ RFC_Loc207_DistVelocityCoVnce : 83|11@1+ (0.0001,-0.1024) [-0.1024|0.1023] "m^2/s"  DASy
 SG_ RFC_Loc207_RadialDistanceVnce : 94|10@1+ (5E-005,0) [0|0.05115] "m^2"  DASy
 SG_ RFC_Loc207_RadialVelocityVnce : 104|10@1+ (0.0001,0) [0|0.1023] "m^2/s^2"  DASy
 SG_ RFC_Loc207_ElevationVnce : 114|10@1+ (0.001,0) [0|1.023] "deg^2"  DASy
 SG_ RFC_Loc207_AzimuthVnce : 124|10@1+ (0.001,0) [0|1.023] "deg^2"  DASy
 SG_ RFC_Loc207_RadarCrossSection : 134|10@1+ (0.2,-102.4) [-50|70] "dBsm"  DASy
 SG_ RFC_Loc207_DistVelocityQuality : 144|8@1+ (1,0) [0|255] "unitless"  DASy
 SG_ RFC_Loc207_ElevationQuality : 152|8@1+ (1,0) [0|255] "unitless"  DASy
 SG_ RFC_Loc207_AzimuthQuality : 160|8@1+ (1,0) [0|255] "unitless"  DASy
 SG_ RFC_Loc207_RSSI : 168|10@1+ (0.1,0) [0|100] "unitless"  DASy
 SG_ RFC_Loc207_AzimuthalPartnerId : 178|10@1+ (1,0) [0|1023] "unitless"  DASy
 SG_ RFC_Loc208_RadialDistance : 192|15@1+ (0.01,0) [0|327.67] "m"  DASy
 SG_ RFC_Loc208_RadialVelocity : 207|15@1+ (0.01,-163.84) [-110|55] "m/s"  DASy
 SG_ RFC_Loc208_Elevation : 222|10@1+ (0.1,-51.2) [-45|45] "deg"  DASy
 SG_ RFC_Loc208_Azimuth : 232|11@1+ (0.1,-102.4) [-90|90] "deg"  DASy
 SG_ RFC_Loc208_DistVelocityCoVnce : 243|11@1+ (0.0001,-0.1024) [-0.1024|0.1023] "m^2/s"  DASy
 SG_ RFC_Loc208_RadialDistanceVnce : 254|10@1+ (5E-005,0) [0|0.05115] "m^2"  DASy
 SG_ RFC_Loc208_RadialVelocityVnce : 264|10@1+ (0.0001,0) [0|0.1023] "m^2/s^2"  DASy
 SG_ RFC_Loc208_ElevationVnce : 274|10@1+ (0.001,0) [0|1.023] "deg^2"  DASy
 SG_ RFC_Loc208_AzimuthVnce : 284|10@1+ (0.001,0) [0|1.023] "deg^2"  DASy
 SG_ RFC_Loc208_RadarCrossSection : 294|10@1+ (0.2,-102.4) [-50|70] "dBsm"  DASy
 SG_ RFC_Loc208_DistVelocityQuality : 304|8@1+ (1,0) [0|255] "unitless"  DASy
 SG_ RFC_Loc208_ElevationQuality : 312|8@1+ (1,0) [0|255] "unitless"  DASy
 SG_ RFC_Loc208_AzimuthQuality : 320|8@1+ (1,0) [0|255] "unitless"  DASy
 SG_ RFC_Loc208_RSSI : 328|10@1+ (0.1,0) [0|100] "unitless"  DASy
 SG_ RFC_Loc208_AzimuthalPartnerId : 338|10@1+ (1,0) [0|1023] "unitless"  DASy
 SG_ RFC_Loc209_RadialDistance : 352|15@1+ (0.01,0) [0|327.67] "m"  DASy
 SG_ RFC_Loc209_RadialVelocity : 367|15@1+ (0.01,-163.84) [-110|55] "m/s"  DASy
 SG_ RFC_Loc209_Elevation : 382|10@1+ (0.1,-51.2) [-45|45] "deg"  DASy
 SG_ RFC_Loc209_Azimuth : 392|11@1+ (0.1,-102.4) [-90|90] "deg"  DASy
 SG_ RFC_Loc209_DistVelocityCoVnce : 403|11@1+ (0.0001,-0.1024) [-0.1024|0.1023] "m^2/s"  DASy
 SG_ RFC_Loc209_RadialDistanceVnce : 414|10@1+ (5E-005,0) [0|0.05115] "m^2"  DASy
 SG_ RFC_Loc209_RadialVelocityVnce : 424|10@1+ (0.0001,0) [0|0.1023] "m^2/s^2"  DASy
 SG_ RFC_Loc209_ElevationVnce : 434|10@1+ (0.001,0) [0|1.023] "deg^2"  DASy
 SG_ RFC_Loc209_AzimuthVnce : 444|10@1+ (0.001,0) [0|1.023] "deg^2"  DASy
 SG_ RFC_Loc209_RadarCrossSection : 454|10@1+ (0.2,-102.4) [-50|70] "dBsm"  DASy
 SG_ RFC_Loc209_DistVelocityQuality : 464|8@1+ (1,0) [0|255] "unitless"  DASy
 SG_ RFC_Loc209_ElevationQuality : 472|8@1+ (1,0) [0|255] "unitless"  DASy
 SG_ RFC_Loc209_AzimuthQuality : 480|8@1+ (1,0) [0|255] "unitless"  DASy
 SG_ RFC_Loc209_RSSI : 488|10@1+ (0.1,0) [0|100] "unitless"  DASy
 SG_ RFC_Loc209_AzimuthalPartnerId : 498|10@1+ (1,0) [0|1023] "unitless"  DASy

BO_ 334 RFC_Location_210_212: 64 RadarFrontCenter
 SG_ RFC_Loc210_212_CRC : 0|16@1+ (1,0) [0|65535] ""  DASy
 SG_ RFC_Loc210_212_AliveCtr : 16|8@1+ (1,0) [0|255] ""  DASy
 SG_ RFC_Loc210_212_ProtBlockCtr : 24|4@1+ (1,0) [0|15] ""  DASy
 SG_ RFC_Loc210_RadialDistance : 32|15@1+ (0.01,0) [0|327.67] "m"  DASy
 SG_ RFC_Loc210_RadialVelocity : 47|15@1+ (0.01,-163.84) [-110|55] "m/s"  DASy
 SG_ RFC_Loc210_Elevation : 62|10@1+ (0.1,-51.2) [-45|45] "deg"  DASy
 SG_ RFC_Loc210_Azimuth : 72|11@1+ (0.1,-102.4) [-90|90] "deg"  DASy
 SG_ RFC_Loc210_DistVelocityCoVnce : 83|11@1+ (0.0001,-0.1024) [-0.1024|0.1023] "m^2/s"  DASy
 SG_ RFC_Loc210_RadialDistanceVnce : 94|10@1+ (5E-005,0) [0|0.05115] "m^2"  DASy
 SG_ RFC_Loc210_RadialVelocityVnce : 104|10@1+ (0.0001,0) [0|0.1023] "m^2/s^2"  DASy
 SG_ RFC_Loc210_ElevationVnce : 114|10@1+ (0.001,0) [0|1.023] "deg^2"  DASy
 SG_ RFC_Loc210_AzimuthVnce : 124|10@1+ (0.001,0) [0|1.023] "deg^2"  DASy
 SG_ RFC_Loc210_RadarCrossSection : 134|10@1+ (0.2,-102.4) [-50|70] "dBsm"  DASy
 SG_ RFC_Loc210_DistVelocityQuality : 144|8@1+ (1,0) [0|255] "unitless"  DASy
 SG_ RFC_Loc210_ElevationQuality : 152|8@1+ (1,0) [0|255] "unitless"  DASy
 SG_ RFC_Loc210_AzimuthQuality : 160|8@1+ (1,0) [0|255] "unitless"  DASy
 SG_ RFC_Loc210_RSSI : 168|10@1+ (0.1,0) [0|100] "unitless"  DASy
 SG_ RFC_Loc210_AzimuthalPartnerId : 178|10@1+ (1,0) [0|1023] "unitless"  DASy
 SG_ RFC_Loc211_RadialDistance : 192|15@1+ (0.01,0) [0|327.67] "m"  DASy
 SG_ RFC_Loc211_RadialVelocity : 207|15@1+ (0.01,-163.84) [-110|55] "m/s"  DASy
 SG_ RFC_Loc211_Elevation : 222|10@1+ (0.1,-51.2) [-45|45] "deg"  DASy
 SG_ RFC_Loc211_Azimuth : 232|11@1+ (0.1,-102.4) [-90|90] "deg"  DASy
 SG_ RFC_Loc211_DistVelocityCoVnce : 243|11@1+ (0.0001,-0.1024) [-0.1024|0.1023] "m^2/s"  DASy
 SG_ RFC_Loc211_RadialDistanceVnce : 254|10@1+ (5E-005,0) [0|0.05115] "m^2"  DASy
 SG_ RFC_Loc211_RadialVelocityVnce : 264|10@1+ (0.0001,0) [0|0.1023] "m^2/s^2"  DASy
 SG_ RFC_Loc211_ElevationVnce : 274|10@1+ (0.001,0) [0|1.023] "deg^2"  DASy
 SG_ RFC_Loc211_AzimuthVnce : 284|10@1+ (0.001,0) [0|1.023] "deg^2"  DASy
 SG_ RFC_Loc211_RadarCrossSection : 294|10@1+ (0.2,-102.4) [-50|70] "dBsm"  DASy
 SG_ RFC_Loc211_DistVelocityQuality : 304|8@1+ (1,0) [0|255] "unitless"  DASy
 SG_ RFC_Loc211_ElevationQuality : 312|8@1+ (1,0) [0|255] "unitless"  DASy
 SG_ RFC_Loc211_AzimuthQuality : 320|8@1+ (1,0) [0|255] "unitless"  DASy
 SG_ RFC_Loc211_RSSI : 328|10@1+ (0.1,0) [0|100] "unitless"  DASy
 SG_ RFC_Loc211_AzimuthalPartnerId : 338|10@1+ (1,0) [0|1023] "unitless"  DASy
 SG_ RFC_Loc212_RadialDistance : 352|15@1+ (0.01,0) [0|327.67] "m"  DASy
 SG_ RFC_Loc212_RadialVelocity : 367|15@1+ (0.01,-163.84) [-110|55] "m/s"  DASy
 SG_ RFC_Loc212_Elevation : 382|10@1+ (0.1,-51.2) [-45|45] "deg"  DASy
 SG_ RFC_Loc212_Azimuth : 392|11@1+ (0.1,-102.4) [-90|90] "deg"  DASy
 SG_ RFC_Loc212_DistVelocityCoVnce : 403|11@1+ (0.0001,-0.1024) [-0.1024|0.1023] "m^2/s"  DASy
 SG_ RFC_Loc212_RadialDistanceVnce : 414|10@1+ (5E-005,0) [0|0.05115] "m^2"  DASy
 SG_ RFC_Loc212_RadialVelocityVnce : 424|10@1+ (0.0001,0) [0|0.1023] "m^2/s^2"  DASy
 SG_ RFC_Loc212_ElevationVnce : 434|10@1+ (0.001,0) [0|1.023] "deg^2"  DASy
 SG_ RFC_Loc212_AzimuthVnce : 444|10@1+ (0.001,0) [0|1.023] "deg^2"  DASy
 SG_ RFC_Loc212_RadarCrossSection : 454|10@1+ (0.2,-102.4) [-50|70] "dBsm"  DASy
 SG_ RFC_Loc212_DistVelocityQuality : 464|8@1+ (1,0) [0|255] "unitless"  DASy
 SG_ RFC_Loc212_ElevationQuality : 472|8@1+ (1,0) [0|255] "unitless"  DASy
 SG_ RFC_Loc212_AzimuthQuality : 480|8@1+ (1,0) [0|255] "unitless"  DASy
 SG_ RFC_Loc212_RSSI : 488|10@1+ (0.1,0) [0|100] "unitless"  DASy
 SG_ RFC_Loc212_AzimuthalPartnerId : 498|10@1+ (1,0) [0|1023] "unitless"  DASy

BO_ 335 RFC_Location_213_215: 64 RadarFrontCenter
 SG_ RFC_Loc213_215_CRC : 0|16@1+ (1,0) [0|65535] ""  DASy
 SG_ RFC_Loc213_215_AliveCtr : 16|8@1+ (1,0) [0|255] ""  DASy
 SG_ RFC_Loc213_215_ProtBlockCtr : 24|4@1+ (1,0) [0|15] ""  DASy
 SG_ RFC_Loc213_RadialDistance : 32|15@1+ (0.01,0) [0|327.67] "m"  DASy
 SG_ RFC_Loc213_RadialVelocity : 47|15@1+ (0.01,-163.84) [-110|55] "m/s"  DASy
 SG_ RFC_Loc213_Elevation : 62|10@1+ (0.1,-51.2) [-45|45] "deg"  DASy
 SG_ RFC_Loc213_Azimuth : 72|11@1+ (0.1,-102.4) [-90|90] "deg"  DASy
 SG_ RFC_Loc213_DistVelocityCoVnce : 83|11@1+ (0.0001,-0.1024) [-0.1024|0.1023] "m^2/s"  DASy
 SG_ RFC_Loc213_RadialDistanceVnce : 94|10@1+ (5E-005,0) [0|0.05115] "m^2"  DASy
 SG_ RFC_Loc213_RadialVelocityVnce : 104|10@1+ (0.0001,0) [0|0.1023] "m^2/s^2"  DASy
 SG_ RFC_Loc213_ElevationVnce : 114|10@1+ (0.001,0) [0|1.023] "deg^2"  DASy
 SG_ RFC_Loc213_AzimuthVnce : 124|10@1+ (0.001,0) [0|1.023] "deg^2"  DASy
 SG_ RFC_Loc213_RadarCrossSection : 134|10@1+ (0.2,-102.4) [-50|70] "dBsm"  DASy
 SG_ RFC_Loc213_DistVelocityQuality : 144|8@1+ (1,0) [0|255] "unitless"  DASy
 SG_ RFC_Loc213_ElevationQuality : 152|8@1+ (1,0) [0|255] "unitless"  DASy
 SG_ RFC_Loc213_AzimuthQuality : 160|8@1+ (1,0) [0|255] "unitless"  DASy
 SG_ RFC_Loc213_RSSI : 168|10@1+ (0.1,0) [0|100] "unitless"  DASy
 SG_ RFC_Loc213_AzimuthalPartnerId : 178|10@1+ (1,0) [0|1023] "unitless"  DASy
 SG_ RFC_Loc214_RadialDistance : 192|15@1+ (0.01,0) [0|327.67] "m"  DASy
 SG_ RFC_Loc214_RadialVelocity : 207|15@1+ (0.01,-163.84) [-110|55] "m/s"  DASy
 SG_ RFC_Loc214_Elevation : 222|10@1+ (0.1,-51.2) [-45|45] "deg"  DASy
 SG_ RFC_Loc214_Azimuth : 232|11@1+ (0.1,-102.4) [-90|90] "deg"  DASy
 SG_ RFC_Loc214_DistVelocityCoVnce : 243|11@1+ (0.0001,-0.1024) [-0.1024|0.1023] "m^2/s"  DASy
 SG_ RFC_Loc214_RadialDistanceVnce : 254|10@1+ (5E-005,0) [0|0.05115] "m^2"  DASy
 SG_ RFC_Loc214_RadialVelocityVnce : 264|10@1+ (0.0001,0) [0|0.1023] "m^2/s^2"  DASy
 SG_ RFC_Loc214_ElevationVnce : 274|10@1+ (0.001,0) [0|1.023] "deg^2"  DASy
 SG_ RFC_Loc214_AzimuthVnce : 284|10@1+ (0.001,0) [0|1.023] "deg^2"  DASy
 SG_ RFC_Loc214_RadarCrossSection : 294|10@1+ (0.2,-102.4) [-50|70] "dBsm"  DASy
 SG_ RFC_Loc214_DistVelocityQuality : 304|8@1+ (1,0) [0|255] "unitless"  DASy
 SG_ RFC_Loc214_ElevationQuality : 312|8@1+ (1,0) [0|255] "unitless"  DASy
 SG_ RFC_Loc214_AzimuthQuality : 320|8@1+ (1,0) [0|255] "unitless"  DASy
 SG_ RFC_Loc214_RSSI : 328|10@1+ (0.1,0) [0|100] "unitless"  DASy
 SG_ RFC_Loc214_AzimuthalPartnerId : 338|10@1+ (1,0) [0|1023] "unitless"  DASy
 SG_ RFC_Loc215_RadialDistance : 352|15@1+ (0.01,0) [0|327.67] "m"  DASy
 SG_ RFC_Loc215_RadialVelocity : 367|15@1+ (0.01,-163.84) [-110|55] "m/s"  DASy
 SG_ RFC_Loc215_Elevation : 382|10@1+ (0.1,-51.2) [-45|45] "deg"  DASy
 SG_ RFC_Loc215_Azimuth : 392|11@1+ (0.1,-102.4) [-90|90] "deg"  DASy
 SG_ RFC_Loc215_DistVelocityCoVnce : 403|11@1+ (0.0001,-0.1024) [-0.1024|0.1023] "m^2/s"  DASy
 SG_ RFC_Loc215_RadialDistanceVnce : 414|10@1+ (5E-005,0) [0|0.05115] "m^2"  DASy
 SG_ RFC_Loc215_RadialVelocityVnce : 424|10@1+ (0.0001,0) [0|0.1023] "m^2/s^2"  DASy
 SG_ RFC_Loc215_ElevationVnce : 434|10@1+ (0.001,0) [0|1.023] "deg^2"  DASy
 SG_ RFC_Loc215_AzimuthVnce : 444|10@1+ (0.001,0) [0|1.023] "deg^2"  DASy
 SG_ RFC_Loc215_RadarCrossSection : 454|10@1+ (0.2,-102.4) [-50|70] "dBsm"  DASy
 SG_ RFC_Loc215_DistVelocityQuality : 464|8@1+ (1,0) [0|255] "unitless"  DASy
 SG_ RFC_Loc215_ElevationQuality : 472|8@1+ (1,0) [0|255] "unitless"  DASy
 SG_ RFC_Loc215_AzimuthQuality : 480|8@1+ (1,0) [0|255] "unitless"  DASy
 SG_ RFC_Loc215_RSSI : 488|10@1+ (0.1,0) [0|100] "unitless"  DASy
 SG_ RFC_Loc215_AzimuthalPartnerId : 498|10@1+ (1,0) [0|1023] "unitless"  DASy

BO_ 336 RFC_Location_216_218: 64 RadarFrontCenter
 SG_ RFC_Loc216_218_CRC : 0|16@1+ (1,0) [0|65535] ""  DASy
 SG_ RFC_Loc216_218_AliveCtr : 16|8@1+ (1,0) [0|255] ""  DASy
 SG_ RFC_Loc216_218_ProtBlockCtr : 24|4@1+ (1,0) [0|15] ""  DASy
 SG_ RFC_Loc216_RadialDistance : 32|15@1+ (0.01,0) [0|327.67] "m"  DASy
 SG_ RFC_Loc216_RadialVelocity : 47|15@1+ (0.01,-163.84) [-110|55] "m/s"  DASy
 SG_ RFC_Loc216_Elevation : 62|10@1+ (0.1,-51.2) [-45|45] "deg"  DASy
 SG_ RFC_Loc216_Azimuth : 72|11@1+ (0.1,-102.4) [-90|90] "deg"  DASy
 SG_ RFC_Loc216_DistVelocityCoVnce : 83|11@1+ (0.0001,-0.1024) [-0.1024|0.1023] "m^2/s"  DASy
 SG_ RFC_Loc216_RadialDistanceVnce : 94|10@1+ (5E-005,0) [0|0.05115] "m^2"  DASy
 SG_ RFC_Loc216_RadialVelocityVnce : 104|10@1+ (0.0001,0) [0|0.1023] "m^2/s^2"  DASy
 SG_ RFC_Loc216_ElevationVnce : 114|10@1+ (0.001,0) [0|1.023] "deg^2"  DASy
 SG_ RFC_Loc216_AzimuthVnce : 124|10@1+ (0.001,0) [0|1.023] "deg^2"  DASy
 SG_ RFC_Loc216_RadarCrossSection : 134|10@1+ (0.2,-102.4) [-50|70] "dBsm"  DASy
 SG_ RFC_Loc216_DistVelocityQuality : 144|8@1+ (1,0) [0|255] "unitless"  DASy
 SG_ RFC_Loc216_ElevationQuality : 152|8@1+ (1,0) [0|255] "unitless"  DASy
 SG_ RFC_Loc216_AzimuthQuality : 160|8@1+ (1,0) [0|255] "unitless"  DASy
 SG_ RFC_Loc216_RSSI : 168|10@1+ (0.1,0) [0|100] "unitless"  DASy
 SG_ RFC_Loc216_AzimuthalPartnerId : 178|10@1+ (1,0) [0|1023] "unitless"  DASy
 SG_ RFC_Loc217_RadialDistance : 192|15@1+ (0.01,0) [0|327.67] "m"  DASy
 SG_ RFC_Loc217_RadialVelocity : 207|15@1+ (0.01,-163.84) [-110|55] "m/s"  DASy
 SG_ RFC_Loc217_Elevation : 222|10@1+ (0.1,-51.2) [-45|45] "deg"  DASy
 SG_ RFC_Loc217_Azimuth : 232|11@1+ (0.1,-102.4) [-90|90] "deg"  DASy
 SG_ RFC_Loc217_DistVelocityCoVnce : 243|11@1+ (0.0001,-0.1024) [-0.1024|0.1023] "m^2/s"  DASy
 SG_ RFC_Loc217_RadialDistanceVnce : 254|10@1+ (5E-005,0) [0|0.05115] "m^2"  DASy
 SG_ RFC_Loc217_RadialVelocityVnce : 264|10@1+ (0.0001,0) [0|0.1023] "m^2/s^2"  DASy
 SG_ RFC_Loc217_ElevationVnce : 274|10@1+ (0.001,0) [0|1.023] "deg^2"  DASy
 SG_ RFC_Loc217_AzimuthVnce : 284|10@1+ (0.001,0) [0|1.023] "deg^2"  DASy
 SG_ RFC_Loc217_RadarCrossSection : 294|10@1+ (0.2,-102.4) [-50|70] "dBsm"  DASy
 SG_ RFC_Loc217_DistVelocityQuality : 304|8@1+ (1,0) [0|255] "unitless"  DASy
 SG_ RFC_Loc217_ElevationQuality : 312|8@1+ (1,0) [0|255] "unitless"  DASy
 SG_ RFC_Loc217_AzimuthQuality : 320|8@1+ (1,0) [0|255] "unitless"  DASy
 SG_ RFC_Loc217_RSSI : 328|10@1+ (0.1,0) [0|100] "unitless"  DASy
 SG_ RFC_Loc217_AzimuthalPartnerId : 338|10@1+ (1,0) [0|1023] "unitless"  DASy
 SG_ RFC_Loc218_RadialDistance : 352|15@1+ (0.01,0) [0|327.67] "m"  DASy
 SG_ RFC_Loc218_RadialVelocity : 367|15@1+ (0.01,-163.84) [-110|55] "m/s"  DASy
 SG_ RFC_Loc218_Elevation : 382|10@1+ (0.1,-51.2) [-45|45] "deg"  DASy
 SG_ RFC_Loc218_Azimuth : 392|11@1+ (0.1,-102.4) [-90|90] "deg"  DASy
 SG_ RFC_Loc218_DistVelocityCoVnce : 403|11@1+ (0.0001,-0.1024) [-0.1024|0.1023] "m^2/s"  DASy
 SG_ RFC_Loc218_RadialDistanceVnce : 414|10@1+ (5E-005,0) [0|0.05115] "m^2"  DASy
 SG_ RFC_Loc218_RadialVelocityVnce : 424|10@1+ (0.0001,0) [0|0.1023] "m^2/s^2"  DASy
 SG_ RFC_Loc218_ElevationVnce : 434|10@1+ (0.001,0) [0|1.023] "deg^2"  DASy
 SG_ RFC_Loc218_AzimuthVnce : 444|10@1+ (0.001,0) [0|1.023] "deg^2"  DASy
 SG_ RFC_Loc218_RadarCrossSection : 454|10@1+ (0.2,-102.4) [-50|70] "dBsm"  DASy
 SG_ RFC_Loc218_DistVelocityQuality : 464|8@1+ (1,0) [0|255] "unitless"  DASy
 SG_ RFC_Loc218_ElevationQuality : 472|8@1+ (1,0) [0|255] "unitless"  DASy
 SG_ RFC_Loc218_AzimuthQuality : 480|8@1+ (1,0) [0|255] "unitless"  DASy
 SG_ RFC_Loc218_RSSI : 488|10@1+ (0.1,0) [0|100] "unitless"  DASy
 SG_ RFC_Loc218_AzimuthalPartnerId : 498|10@1+ (1,0) [0|1023] "unitless"  DASy

BO_ 337 RFC_Location_219_221: 64 RadarFrontCenter
 SG_ RFC_Loc219_221_CRC : 0|16@1+ (1,0) [0|65535] ""  DASy
 SG_ RFC_Loc219_221_AliveCtr : 16|8@1+ (1,0) [0|255] ""  DASy
 SG_ RFC_Loc219_221_ProtBlockCtr : 24|4@1+ (1,0) [0|15] ""  DASy
 SG_ RFC_Loc219_RadialDistance : 32|15@1+ (0.01,0) [0|327.67] "m"  DASy
 SG_ RFC_Loc219_RadialVelocity : 47|15@1+ (0.01,-163.84) [-110|55] "m/s"  DASy
 SG_ RFC_Loc219_Elevation : 62|10@1+ (0.1,-51.2) [-45|45] "deg"  DASy
 SG_ RFC_Loc219_Azimuth : 72|11@1+ (0.1,-102.4) [-90|90] "deg"  DASy
 SG_ RFC_Loc219_DistVelocityCoVnce : 83|11@1+ (0.0001,-0.1024) [-0.1024|0.1023] "m^2/s"  DASy
 SG_ RFC_Loc219_RadialDistanceVnce : 94|10@1+ (5E-005,0) [0|0.05115] "m^2"  DASy
 SG_ RFC_Loc219_RadialVelocityVnce : 104|10@1+ (0.0001,0) [0|0.1023] "m^2/s^2"  DASy
 SG_ RFC_Loc219_ElevationVnce : 114|10@1+ (0.001,0) [0|1.023] "deg^2"  DASy
 SG_ RFC_Loc219_AzimuthVnce : 124|10@1+ (0.001,0) [0|1.023] "deg^2"  DASy
 SG_ RFC_Loc219_RadarCrossSection : 134|10@1+ (0.2,-102.4) [-50|70] "dBsm"  DASy
 SG_ RFC_Loc219_DistVelocityQuality : 144|8@1+ (1,0) [0|255] "unitless"  DASy
 SG_ RFC_Loc219_ElevationQuality : 152|8@1+ (1,0) [0|255] "unitless"  DASy
 SG_ RFC_Loc219_AzimuthQuality : 160|8@1+ (1,0) [0|255] "unitless"  DASy
 SG_ RFC_Loc219_RSSI : 168|10@1+ (0.1,0) [0|100] "unitless"  DASy
 SG_ RFC_Loc219_AzimuthalPartnerId : 178|10@1+ (1,0) [0|1023] "unitless"  DASy
 SG_ RFC_Loc220_RadialDistance : 192|15@1+ (0.01,0) [0|327.67] "m"  DASy
 SG_ RFC_Loc220_RadialVelocity : 207|15@1+ (0.01,-163.84) [-110|55] "m/s"  DASy
 SG_ RFC_Loc220_Elevation : 222|10@1+ (0.1,-51.2) [-45|45] "deg"  DASy
 SG_ RFC_Loc220_Azimuth : 232|11@1+ (0.1,-102.4) [-90|90] "deg"  DASy
 SG_ RFC_Loc220_DistVelocityCoVnce : 243|11@1+ (0.0001,-0.1024) [-0.1024|0.1023] "m^2/s"  DASy
 SG_ RFC_Loc220_RadialDistanceVnce : 254|10@1+ (5E-005,0) [0|0.05115] "m^2"  DASy
 SG_ RFC_Loc220_RadialVelocityVnce : 264|10@1+ (0.0001,0) [0|0.1023] "m^2/s^2"  DASy
 SG_ RFC_Loc220_ElevationVnce : 274|10@1+ (0.001,0) [0|1.023] "deg^2"  DASy
 SG_ RFC_Loc220_AzimuthVnce : 284|10@1+ (0.001,0) [0|1.023] "deg^2"  DASy
 SG_ RFC_Loc220_RadarCrossSection : 294|10@1+ (0.2,-102.4) [-50|70] "dBsm"  DASy
 SG_ RFC_Loc220_DistVelocityQuality : 304|8@1+ (1,0) [0|255] "unitless"  DASy
 SG_ RFC_Loc220_ElevationQuality : 312|8@1+ (1,0) [0|255] "unitless"  DASy
 SG_ RFC_Loc220_AzimuthQuality : 320|8@1+ (1,0) [0|255] "unitless"  DASy
 SG_ RFC_Loc220_RSSI : 328|10@1+ (0.1,0) [0|100] "unitless"  DASy
 SG_ RFC_Loc220_AzimuthalPartnerId : 338|10@1+ (1,0) [0|1023] "unitless"  DASy
 SG_ RFC_Loc221_RadialDistance : 352|15@1+ (0.01,0) [0|327.67] "m"  DASy
 SG_ RFC_Loc221_RadialVelocity : 367|15@1+ (0.01,-163.84) [-110|55] "m/s"  DASy
 SG_ RFC_Loc221_Elevation : 382|10@1+ (0.1,-51.2) [-45|45] "deg"  DASy
 SG_ RFC_Loc221_Azimuth : 392|11@1+ (0.1,-102.4) [-90|90] "deg"  DASy
 SG_ RFC_Loc221_DistVelocityCoVnce : 403|11@1+ (0.0001,-0.1024) [-0.1024|0.1023] "m^2/s"  DASy
 SG_ RFC_Loc221_RadialDistanceVnce : 414|10@1+ (5E-005,0) [0|0.05115] "m^2"  DASy
 SG_ RFC_Loc221_RadialVelocityVnce : 424|10@1+ (0.0001,0) [0|0.1023] "m^2/s^2"  DASy
 SG_ RFC_Loc221_ElevationVnce : 434|10@1+ (0.001,0) [0|1.023] "deg^2"  DASy
 SG_ RFC_Loc221_AzimuthVnce : 444|10@1+ (0.001,0) [0|1.023] "deg^2"  DASy
 SG_ RFC_Loc221_RadarCrossSection : 454|10@1+ (0.2,-102.4) [-50|70] "dBsm"  DASy
 SG_ RFC_Loc221_DistVelocityQuality : 464|8@1+ (1,0) [0|255] "unitless"  DASy
 SG_ RFC_Loc221_ElevationQuality : 472|8@1+ (1,0) [0|255] "unitless"  DASy
 SG_ RFC_Loc221_AzimuthQuality : 480|8@1+ (1,0) [0|255] "unitless"  DASy
 SG_ RFC_Loc221_RSSI : 488|10@1+ (0.1,0) [0|100] "unitless"  DASy
 SG_ RFC_Loc221_AzimuthalPartnerId : 498|10@1+ (1,0) [0|1023] "unitless"  DASy

BO_ 338 RFC_Location_222_224: 64 RadarFrontCenter
 SG_ RFC_Loc222_224_CRC : 0|16@1+ (1,0) [0|65535] ""  DASy
 SG_ RFC_Loc222_224_AliveCtr : 16|8@1+ (1,0) [0|255] ""  DASy
 SG_ RFC_Loc222_224_ProtBlockCtr : 24|4@1+ (1,0) [0|15] ""  DASy
 SG_ RFC_Loc222_RadialDistance : 32|15@1+ (0.01,0) [0|327.67] "m"  DASy
 SG_ RFC_Loc222_RadialVelocity : 47|15@1+ (0.01,-163.84) [-110|55] "m/s"  DASy
 SG_ RFC_Loc222_Elevation : 62|10@1+ (0.1,-51.2) [-45|45] "deg"  DASy
 SG_ RFC_Loc222_Azimuth : 72|11@1+ (0.1,-102.4) [-90|90] "deg"  DASy
 SG_ RFC_Loc222_DistVelocityCoVnce : 83|11@1+ (0.0001,-0.1024) [-0.1024|0.1023] "m^2/s"  DASy
 SG_ RFC_Loc222_RadialDistanceVnce : 94|10@1+ (5E-005,0) [0|0.05115] "m^2"  DASy
 SG_ RFC_Loc222_RadialVelocityVnce : 104|10@1+ (0.0001,0) [0|0.1023] "m^2/s^2"  DASy
 SG_ RFC_Loc222_ElevationVnce : 114|10@1+ (0.001,0) [0|1.023] "deg^2"  DASy
 SG_ RFC_Loc222_AzimuthVnce : 124|10@1+ (0.001,0) [0|1.023] "deg^2"  DASy
 SG_ RFC_Loc222_RadarCrossSection : 134|10@1+ (0.2,-102.4) [-50|70] "dBsm"  DASy
 SG_ RFC_Loc222_DistVelocityQuality : 144|8@1+ (1,0) [0|255] "unitless"  DASy
 SG_ RFC_Loc222_ElevationQuality : 152|8@1+ (1,0) [0|255] "unitless"  DASy
 SG_ RFC_Loc222_AzimuthQuality : 160|8@1+ (1,0) [0|255] "unitless"  DASy
 SG_ RFC_Loc222_RSSI : 168|10@1+ (0.1,0) [0|100] "unitless"  DASy
 SG_ RFC_Loc222_AzimuthalPartnerId : 178|10@1+ (1,0) [0|1023] "unitless"  DASy
 SG_ RFC_Loc223_RadialDistance : 192|15@1+ (0.01,0) [0|327.67] "m"  DASy
 SG_ RFC_Loc223_RadialVelocity : 207|15@1+ (0.01,-163.84) [-110|55] "m/s"  DASy
 SG_ RFC_Loc223_Elevation : 222|10@1+ (0.1,-51.2) [-45|45] "deg"  DASy
 SG_ RFC_Loc223_Azimuth : 232|11@1+ (0.1,-102.4) [-90|90] "deg"  DASy
 SG_ RFC_Loc223_DistVelocityCoVnce : 243|11@1+ (0.0001,-0.1024) [-0.1024|0.1023] "m^2/s"  DASy
 SG_ RFC_Loc223_RadialDistanceVnce : 254|10@1+ (5E-005,0) [0|0.05115] "m^2"  DASy
 SG_ RFC_Loc223_RadialVelocityVnce : 264|10@1+ (0.0001,0) [0|0.1023] "m^2/s^2"  DASy
 SG_ RFC_Loc223_ElevationVnce : 274|10@1+ (0.001,0) [0|1.023] "deg^2"  DASy
 SG_ RFC_Loc223_AzimuthVnce : 284|10@1+ (0.001,0) [0|1.023] "deg^2"  DASy
 SG_ RFC_Loc223_RadarCrossSection : 294|10@1+ (0.2,-102.4) [-50|70] "dBsm"  DASy
 SG_ RFC_Loc223_DistVelocityQuality : 304|8@1+ (1,0) [0|255] "unitless"  DASy
 SG_ RFC_Loc223_ElevationQuality : 312|8@1+ (1,0) [0|255] "unitless"  DASy
 SG_ RFC_Loc223_AzimuthQuality : 320|8@1+ (1,0) [0|255] "unitless"  DASy
 SG_ RFC_Loc223_RSSI : 328|10@1+ (0.1,0) [0|100] "unitless"  DASy
 SG_ RFC_Loc223_AzimuthalPartnerId : 338|10@1+ (1,0) [0|1023] "unitless"  DASy
 SG_ RFC_Loc224_RadialDistance : 352|15@1+ (0.01,0) [0|327.67] "m"  DASy
 SG_ RFC_Loc224_RadialVelocity : 367|15@1+ (0.01,-163.84) [-110|55] "m/s"  DASy
 SG_ RFC_Loc224_Elevation : 382|10@1+ (0.1,-51.2) [-45|45] "deg"  DASy
 SG_ RFC_Loc224_Azimuth : 392|11@1+ (0.1,-102.4) [-90|90] "deg"  DASy
 SG_ RFC_Loc224_DistVelocityCoVnce : 403|11@1+ (0.0001,-0.1024) [-0.1024|0.1023] "m^2/s"  DASy
 SG_ RFC_Loc224_RadialDistanceVnce : 414|10@1+ (5E-005,0) [0|0.05115] "m^2"  DASy
 SG_ RFC_Loc224_RadialVelocityVnce : 424|10@1+ (0.0001,0) [0|0.1023] "m^2/s^2"  DASy
 SG_ RFC_Loc224_ElevationVnce : 434|10@1+ (0.001,0) [0|1.023] "deg^2"  DASy
 SG_ RFC_Loc224_AzimuthVnce : 444|10@1+ (0.001,0) [0|1.023] "deg^2"  DASy
 SG_ RFC_Loc224_RadarCrossSection : 454|10@1+ (0.2,-102.4) [-50|70] "dBsm"  DASy
 SG_ RFC_Loc224_DistVelocityQuality : 464|8@1+ (1,0) [0|255] "unitless"  DASy
 SG_ RFC_Loc224_ElevationQuality : 472|8@1+ (1,0) [0|255] "unitless"  DASy
 SG_ RFC_Loc224_AzimuthQuality : 480|8@1+ (1,0) [0|255] "unitless"  DASy
 SG_ RFC_Loc224_RSSI : 488|10@1+ (0.1,0) [0|100] "unitless"  DASy
 SG_ RFC_Loc224_AzimuthalPartnerId : 498|10@1+ (1,0) [0|1023] "unitless"  DASy

BO_ 339 RFC_Location_225_227: 64 RadarFrontCenter
 SG_ RFC_Loc225_227_CRC : 0|16@1+ (1,0) [0|65535] ""  DASy
 SG_ RFC_Loc225_227_AliveCtr : 16|8@1+ (1,0) [0|255] ""  DASy
 SG_ RFC_Loc225_227_ProtBlockCtr : 24|4@1+ (1,0) [0|15] ""  DASy
 SG_ RFC_Loc225_RadialDistance : 32|15@1+ (0.01,0) [0|327.67] "m"  DASy
 SG_ RFC_Loc225_RadialVelocity : 47|15@1+ (0.01,-163.84) [-110|55] "m/s"  DASy
 SG_ RFC_Loc225_Elevation : 62|10@1+ (0.1,-51.2) [-45|45] "deg"  DASy
 SG_ RFC_Loc225_Azimuth : 72|11@1+ (0.1,-102.4) [-90|90] "deg"  DASy
 SG_ RFC_Loc225_DistVelocityCoVnce : 83|11@1+ (0.0001,-0.1024) [-0.1024|0.1023] "m^2/s"  DASy
 SG_ RFC_Loc225_RadialDistanceVnce : 94|10@1+ (5E-005,0) [0|0.05115] "m^2"  DASy
 SG_ RFC_Loc225_RadialVelocityVnce : 104|10@1+ (0.0001,0) [0|0.1023] "m^2/s^2"  DASy
 SG_ RFC_Loc225_ElevationVnce : 114|10@1+ (0.001,0) [0|1.023] "deg^2"  DASy
 SG_ RFC_Loc225_AzimuthVnce : 124|10@1+ (0.001,0) [0|1.023] "deg^2"  DASy
 SG_ RFC_Loc225_RadarCrossSection : 134|10@1+ (0.2,-102.4) [-50|70] "dBsm"  DASy
 SG_ RFC_Loc225_DistVelocityQuality : 144|8@1+ (1,0) [0|255] "unitless"  DASy
 SG_ RFC_Loc225_ElevationQuality : 152|8@1+ (1,0) [0|255] "unitless"  DASy
 SG_ RFC_Loc225_AzimuthQuality : 160|8@1+ (1,0) [0|255] "unitless"  DASy
 SG_ RFC_Loc225_RSSI : 168|10@1+ (0.1,0) [0|100] "unitless"  DASy
 SG_ RFC_Loc225_AzimuthalPartnerId : 178|10@1+ (1,0) [0|1023] "unitless"  DASy
 SG_ RFC_Loc226_RadialDistance : 192|15@1+ (0.01,0) [0|327.67] "m"  DASy
 SG_ RFC_Loc226_RadialVelocity : 207|15@1+ (0.01,-163.84) [-110|55] "m/s"  DASy
 SG_ RFC_Loc226_Elevation : 222|10@1+ (0.1,-51.2) [-45|45] "deg"  DASy
 SG_ RFC_Loc226_Azimuth : 232|11@1+ (0.1,-102.4) [-90|90] "deg"  DASy
 SG_ RFC_Loc226_DistVelocityCoVnce : 243|11@1+ (0.0001,-0.1024) [-0.1024|0.1023] "m^2/s"  DASy
 SG_ RFC_Loc226_RadialDistanceVnce : 254|10@1+ (5E-005,0) [0|0.05115] "m^2"  DASy
 SG_ RFC_Loc226_RadialVelocityVnce : 264|10@1+ (0.0001,0) [0|0.1023] "m^2/s^2"  DASy
 SG_ RFC_Loc226_ElevationVnce : 274|10@1+ (0.001,0) [0|1.023] "deg^2"  DASy
 SG_ RFC_Loc226_AzimuthVnce : 284|10@1+ (0.001,0) [0|1.023] "deg^2"  DASy
 SG_ RFC_Loc226_RadarCrossSection : 294|10@1+ (0.2,-102.4) [-50|70] "dBsm"  DASy
 SG_ RFC_Loc226_DistVelocityQuality : 304|8@1+ (1,0) [0|255] "unitless"  DASy
 SG_ RFC_Loc226_ElevationQuality : 312|8@1+ (1,0) [0|255] "unitless"  DASy
 SG_ RFC_Loc226_AzimuthQuality : 320|8@1+ (1,0) [0|255] "unitless"  DASy
 SG_ RFC_Loc226_RSSI : 328|10@1+ (0.1,0) [0|100] "unitless"  DASy
 SG_ RFC_Loc226_AzimuthalPartnerId : 338|10@1+ (1,0) [0|1023] "unitless"  DASy
 SG_ RFC_Loc227_RadialDistance : 352|15@1+ (0.01,0) [0|327.67] "m"  DASy
 SG_ RFC_Loc227_RadialVelocity : 367|15@1+ (0.01,-163.84) [-110|55] "m/s"  DASy
 SG_ RFC_Loc227_Elevation : 382|10@1+ (0.1,-51.2) [-45|45] "deg"  DASy
 SG_ RFC_Loc227_Azimuth : 392|11@1+ (0.1,-102.4) [-90|90] "deg"  DASy
 SG_ RFC_Loc227_DistVelocityCoVnce : 403|11@1+ (0.0001,-0.1024) [-0.1024|0.1023] "m^2/s"  DASy
 SG_ RFC_Loc227_RadialDistanceVnce : 414|10@1+ (5E-005,0) [0|0.05115] "m^2"  DASy
 SG_ RFC_Loc227_RadialVelocityVnce : 424|10@1+ (0.0001,0) [0|0.1023] "m^2/s^2"  DASy
 SG_ RFC_Loc227_ElevationVnce : 434|10@1+ (0.001,0) [0|1.023] "deg^2"  DASy
 SG_ RFC_Loc227_AzimuthVnce : 444|10@1+ (0.001,0) [0|1.023] "deg^2"  DASy
 SG_ RFC_Loc227_RadarCrossSection : 454|10@1+ (0.2,-102.4) [-50|70] "dBsm"  DASy
 SG_ RFC_Loc227_DistVelocityQuality : 464|8@1+ (1,0) [0|255] "unitless"  DASy
 SG_ RFC_Loc227_ElevationQuality : 472|8@1+ (1,0) [0|255] "unitless"  DASy
 SG_ RFC_Loc227_AzimuthQuality : 480|8@1+ (1,0) [0|255] "unitless"  DASy
 SG_ RFC_Loc227_RSSI : 488|10@1+ (0.1,0) [0|100] "unitless"  DASy
 SG_ RFC_Loc227_AzimuthalPartnerId : 498|10@1+ (1,0) [0|1023] "unitless"  DASy

BO_ 340 RFC_Location_228_230: 64 RadarFrontCenter
 SG_ RFC_Loc228_230_CRC : 0|16@1+ (1,0) [0|65535] ""  DASy
 SG_ RFC_Loc228_230_AliveCtr : 16|8@1+ (1,0) [0|255] ""  DASy
 SG_ RFC_Loc228_230_ProtBlockCtr : 24|4@1+ (1,0) [0|15] ""  DASy
 SG_ RFC_Loc228_RadialDistance : 32|15@1+ (0.01,0) [0|327.67] "m"  DASy
 SG_ RFC_Loc228_RadialVelocity : 47|15@1+ (0.01,-163.84) [-110|55] "m/s"  DASy
 SG_ RFC_Loc228_Elevation : 62|10@1+ (0.1,-51.2) [-45|45] "deg"  DASy
 SG_ RFC_Loc228_Azimuth : 72|11@1+ (0.1,-102.4) [-90|90] "deg"  DASy
 SG_ RFC_Loc228_DistVelocityCoVnce : 83|11@1+ (0.0001,-0.1024) [-0.1024|0.1023] "m^2/s"  DASy
 SG_ RFC_Loc228_RadialDistanceVnce : 94|10@1+ (5E-005,0) [0|0.05115] "m^2"  DASy
 SG_ RFC_Loc228_RadialVelocityVnce : 104|10@1+ (0.0001,0) [0|0.1023] "m^2/s^2"  DASy
 SG_ RFC_Loc228_ElevationVnce : 114|10@1+ (0.001,0) [0|1.023] "deg^2"  DASy
 SG_ RFC_Loc228_AzimuthVnce : 124|10@1+ (0.001,0) [0|1.023] "deg^2"  DASy
 SG_ RFC_Loc228_RadarCrossSection : 134|10@1+ (0.2,-102.4) [-50|70] "dBsm"  DASy
 SG_ RFC_Loc228_DistVelocityQuality : 144|8@1+ (1,0) [0|255] "unitless"  DASy
 SG_ RFC_Loc228_ElevationQuality : 152|8@1+ (1,0) [0|255] "unitless"  DASy
 SG_ RFC_Loc228_AzimuthQuality : 160|8@1+ (1,0) [0|255] "unitless"  DASy
 SG_ RFC_Loc228_RSSI : 168|10@1+ (0.1,0) [0|100] "unitless"  DASy
 SG_ RFC_Loc228_AzimuthalPartnerId : 178|10@1+ (1,0) [0|1023] "unitless"  DASy
 SG_ RFC_Loc229_RadialDistance : 192|15@1+ (0.01,0) [0|327.67] "m"  DASy
 SG_ RFC_Loc229_RadialVelocity : 207|15@1+ (0.01,-163.84) [-110|55] "m/s"  DASy
 SG_ RFC_Loc229_Elevation : 222|10@1+ (0.1,-51.2) [-45|45] "deg"  DASy
 SG_ RFC_Loc229_Azimuth : 232|11@1+ (0.1,-102.4) [-90|90] "deg"  DASy
 SG_ RFC_Loc229_DistVelocityCoVnce : 243|11@1+ (0.0001,-0.1024) [-0.1024|0.1023] "m^2/s"  DASy
 SG_ RFC_Loc229_RadialDistanceVnce : 254|10@1+ (5E-005,0) [0|0.05115] "m^2"  DASy
 SG_ RFC_Loc229_RadialVelocityVnce : 264|10@1+ (0.0001,0) [0|0.1023] "m^2/s^2"  DASy
 SG_ RFC_Loc229_ElevationVnce : 274|10@1+ (0.001,0) [0|1.023] "deg^2"  DASy
 SG_ RFC_Loc229_AzimuthVnce : 284|10@1+ (0.001,0) [0|1.023] "deg^2"  DASy
 SG_ RFC_Loc229_RadarCrossSection : 294|10@1+ (0.2,-102.4) [-50|70] "dBsm"  DASy
 SG_ RFC_Loc229_DistVelocityQuality : 304|8@1+ (1,0) [0|255] "unitless"  DASy
 SG_ RFC_Loc229_ElevationQuality : 312|8@1+ (1,0) [0|255] "unitless"  DASy
 SG_ RFC_Loc229_AzimuthQuality : 320|8@1+ (1,0) [0|255] "unitless"  DASy
 SG_ RFC_Loc229_RSSI : 328|10@1+ (0.1,0) [0|100] "unitless"  DASy
 SG_ RFC_Loc229_AzimuthalPartnerId : 338|10@1+ (1,0) [0|1023] "unitless"  DASy
 SG_ RFC_Loc230_RadialDistance : 352|15@1+ (0.01,0) [0|327.67] "m"  DASy
 SG_ RFC_Loc230_RadialVelocity : 367|15@1+ (0.01,-163.84) [-110|55] "m/s"  DASy
 SG_ RFC_Loc230_Elevation : 382|10@1+ (0.1,-51.2) [-45|45] "deg"  DASy
 SG_ RFC_Loc230_Azimuth : 392|11@1+ (0.1,-102.4) [-90|90] "deg"  DASy
 SG_ RFC_Loc230_DistVelocityCoVnce : 403|11@1+ (0.0001,-0.1024) [-0.1024|0.1023] "m^2/s"  DASy
 SG_ RFC_Loc230_RadialDistanceVnce : 414|10@1+ (5E-005,0) [0|0.05115] "m^2"  DASy
 SG_ RFC_Loc230_RadialVelocityVnce : 424|10@1+ (0.0001,0) [0|0.1023] "m^2/s^2"  DASy
 SG_ RFC_Loc230_ElevationVnce : 434|10@1+ (0.001,0) [0|1.023] "deg^2"  DASy
 SG_ RFC_Loc230_AzimuthVnce : 444|10@1+ (0.001,0) [0|1.023] "deg^2"  DASy
 SG_ RFC_Loc230_RadarCrossSection : 454|10@1+ (0.2,-102.4) [-50|70] "dBsm"  DASy
 SG_ RFC_Loc230_DistVelocityQuality : 464|8@1+ (1,0) [0|255] "unitless"  DASy
 SG_ RFC_Loc230_ElevationQuality : 472|8@1+ (1,0) [0|255] "unitless"  DASy
 SG_ RFC_Loc230_AzimuthQuality : 480|8@1+ (1,0) [0|255] "unitless"  DASy
 SG_ RFC_Loc230_RSSI : 488|10@1+ (0.1,0) [0|100] "unitless"  DASy
 SG_ RFC_Loc230_AzimuthalPartnerId : 498|10@1+ (1,0) [0|1023] "unitless"  DASy

CM_ SG_ 326 RFC_Loc186_188_CRC "CRC - Autosar E2E Profile 5";
CM_ SG_ 326 RFC_Loc186_188_AliveCtr "Alive counter - Autosar E2E Profile 5";
CM_ SG_ 326 RFC_Loc186_188_ProtBlockCtr "Protocol-Signal: Block-Counter";
CM_ SG_ 326 RFC_Loc186_RadialDistance "Location radial distance. Represented in conical coordinate system. Same as ISO 23150:2021(E): Position radial distance (A.4.16)";
CM_ SG_ 326 RFC_Loc186_RadialVelocity "Location radial relative velocity ISO 23150:2021(E): Relative velocity {radial distance} (A.4.18)";
CM_ SG_ 326 RFC_Loc186_Elevation "Location elevation angle. Represented in conical coordinate system. Same as ISO 23150:2021(E): Position elevation (A.4.16)";
CM_ SG_ 326 RFC_Loc186_Azimuth "Location azimuth angle. Represented in conical coordinate system. Deviation from ISO 23150:2021(E): Position azimuth (A.4.16). Further details refers to DSP Location Interface definition";
CM_ SG_ 326 RFC_Loc186_DistVelocityCoVnce "Covariance of radial distance and radial velocity";
CM_ SG_ 326 RFC_Loc186_RadialDistanceVnce "Variance of Location radial distance ISO 23150:2021(E): Position radial distance - error (A.4.17)";
CM_ SG_ 326 RFC_Loc186_RadialVelocityVnce "Variance of Location radial relative velocity ISO 23150:2021(E): Relative velocity {radial distance} - error (A.4.19)";
CM_ SG_ 326 RFC_Loc186_ElevationVnce "Variance of Location elevation angle ISO 23150:2021(E): Position elevation - error (A.4.17)";
CM_ SG_ 326 RFC_Loc186_AzimuthVnce "Variance of Location azimuth angle ISO 23150:2021(E): Position azimuth - error (A.4.17)";
CM_ SG_ 326 RFC_Loc186_RadarCrossSection "Radar Cross Section (RCS) estimation ISO 23150:2021(E): Radar cross section (A.4.5)";
CM_ SG_ 326 RFC_Loc186_DistVelocityQuality "Quality of radial distance and velocity resolution processing. Physical range [0..1]";
CM_ SG_ 326 RFC_Loc186_ElevationQuality "Probability for correct signal model (elevation angle). Physical range [0..1]";
CM_ SG_ 326 RFC_Loc186_AzimuthQuality "Probability for correct signal model (azimuth angle). Physical range [0..1]";
CM_ SG_ 326 RFC_Loc186_RSSI "Received Signal Strength Indication (RSSI). This signal is not exactly ISO 23150:2021(E): Signal to noise ratio - detection level (A.4.7), but SNR can be calculated from this signal. Further detail please refer to the DSP Location Interface definition";
CM_ SG_ 326 RFC_Loc186_AzimuthalPartnerId "Id of the azimuthal partner location";
CM_ SG_ 326 RFC_Loc187_RadialDistance "Location radial distance. Represented in conical coordinate system. Same as ISO 23150:2021(E): Position radial distance (A.4.16)";
CM_ SG_ 326 RFC_Loc187_RadialVelocity "Location radial relative velocity ISO 23150:2021(E): Relative velocity {radial distance} (A.4.18)";
CM_ SG_ 326 RFC_Loc187_Elevation "Location elevation angle. Represented in conical coordinate system. Same as ISO 23150:2021(E): Position elevation (A.4.16)";
CM_ SG_ 326 RFC_Loc187_Azimuth "Location azimuth angle. Represented in conical coordinate system. Deviation from ISO 23150:2021(E): Position azimuth (A.4.16). Further details refers to DSP Location Interface definition";
CM_ SG_ 326 RFC_Loc187_DistVelocityCoVnce "Covariance of radial distance and radial velocity";
CM_ SG_ 326 RFC_Loc187_RadialDistanceVnce "Variance of Location radial distance ISO 23150:2021(E): Position radial distance - error (A.4.17)";
CM_ SG_ 326 RFC_Loc187_RadialVelocityVnce "Variance of Location radial relative velocity ISO 23150:2021(E): Relative velocity {radial distance} - error (A.4.19)";
CM_ SG_ 326 RFC_Loc187_ElevationVnce "Variance of Location elevation angle ISO 23150:2021(E): Position elevation - error (A.4.17)";
CM_ SG_ 326 RFC_Loc187_AzimuthVnce "Variance of Location azimuth angle ISO 23150:2021(E): Position azimuth - error (A.4.17)";
CM_ SG_ 326 RFC_Loc187_RadarCrossSection "Radar Cross Section (RCS) estimation ISO 23150:2021(E): Radar cross section (A.4.5)";
CM_ SG_ 326 RFC_Loc187_DistVelocityQuality "Quality of radial distance and velocity resolution processing. Physical range [0..1]";
CM_ SG_ 326 RFC_Loc187_ElevationQuality "Probability for correct signal model (elevation angle). Physical range [0..1]";
CM_ SG_ 326 RFC_Loc187_AzimuthQuality "Probability for correct signal model (azimuth angle). Physical range [0..1]";
CM_ SG_ 326 RFC_Loc187_RSSI "Received Signal Strength Indication (RSSI). This signal is not exactly ISO 23150:2021(E): Signal to noise ratio - detection level (A.4.7), but SNR can be calculated from this signal. Further detail please refer to the DSP Location Interface definition";
CM_ SG_ 326 RFC_Loc187_AzimuthalPartnerId "Id of the azimuthal partner location";
CM_ SG_ 326 RFC_Loc188_RadialDistance "Location radial distance. Represented in conical coordinate system. Same as ISO 23150:2021(E): Position radial distance (A.4.16)";
CM_ SG_ 326 RFC_Loc188_RadialVelocity "Location radial relative velocity ISO 23150:2021(E): Relative velocity {radial distance} (A.4.18)";
CM_ SG_ 326 RFC_Loc188_Elevation "Location elevation angle. Represented in conical coordinate system. Same as ISO 23150:2021(E): Position elevation (A.4.16)";
CM_ SG_ 326 RFC_Loc188_Azimuth "Location azimuth angle. Represented in conical coordinate system. Deviation from ISO 23150:2021(E): Position azimuth (A.4.16). Further details refers to DSP Location Interface definition";
CM_ SG_ 326 RFC_Loc188_DistVelocityCoVnce "Covariance of radial distance and radial velocity";
CM_ SG_ 326 RFC_Loc188_RadialDistanceVnce "Variance of Location radial distance ISO 23150:2021(E): Position radial distance - error (A.4.17)";
CM_ SG_ 326 RFC_Loc188_RadialVelocityVnce "Variance of Location radial relative velocity ISO 23150:2021(E): Relative velocity {radial distance} - error (A.4.19)";
CM_ SG_ 326 RFC_Loc188_ElevationVnce "Variance of Location elevation angle ISO 23150:2021(E): Position elevation - error (A.4.17)";
CM_ SG_ 326 RFC_Loc188_AzimuthVnce "Variance of Location azimuth angle ISO 23150:2021(E): Position azimuth - error (A.4.17)";
CM_ SG_ 326 RFC_Loc188_RadarCrossSection "Radar Cross Section (RCS) estimation ISO 23150:2021(E): Radar cross section (A.4.5)";
CM_ SG_ 326 RFC_Loc188_DistVelocityQuality "Quality of radial distance and velocity resolution processing. Physical range [0..1]";
CM_ SG_ 326 RFC_Loc188_ElevationQuality "Probability for correct signal model (elevation angle). Physical range [0..1]";
CM_ SG_ 326 RFC_Loc188_AzimuthQuality "Probability for correct signal model (azimuth angle). Physical range [0..1]";
CM_ SG_ 326 RFC_Loc188_RSSI "Received Signal Strength Indication (RSSI). This signal is not exactly ISO 23150:2021(E): Signal to noise ratio - detection level (A.4.7), but SNR can be calculated from this signal. Further detail please refer to the DSP Location Interface definition";
CM_ SG_ 326 RFC_Loc188_AzimuthalPartnerId "Id of the azimuthal partner location";
CM_ SG_ 327 RFC_Loc189_191_CRC "CRC - Autosar E2E Profile 5";
CM_ SG_ 327 RFC_Loc189_191_AliveCtr "Alive counter - Autosar E2E Profile 5";
CM_ SG_ 327 RFC_Loc189_191_ProtBlockCtr "Protocol-Signal: Block-Counter";
CM_ SG_ 327 RFC_Loc189_RadialDistance "Location radial distance. Represented in conical coordinate system. Same as ISO 23150:2021(E): Position radial distance (A.4.16)";
CM_ SG_ 327 RFC_Loc189_RadialVelocity "Location radial relative velocity ISO 23150:2021(E): Relative velocity {radial distance} (A.4.18)";
CM_ SG_ 327 RFC_Loc189_Elevation "Location elevation angle. Represented in conical coordinate system. Same as ISO 23150:2021(E): Position elevation (A.4.16)";
CM_ SG_ 327 RFC_Loc189_Azimuth "Location azimuth angle. Represented in conical coordinate system. Deviation from ISO 23150:2021(E): Position azimuth (A.4.16). Further details refers to DSP Location Interface definition";
CM_ SG_ 327 RFC_Loc189_DistVelocityCoVnce "Covariance of radial distance and radial velocity";
CM_ SG_ 327 RFC_Loc189_RadialDistanceVnce "Variance of Location radial distance ISO 23150:2021(E): Position radial distance - error (A.4.17)";
CM_ SG_ 327 RFC_Loc189_RadialVelocityVnce "Variance of Location radial relative velocity ISO 23150:2021(E): Relative velocity {radial distance} - error (A.4.19)";
CM_ SG_ 327 RFC_Loc189_ElevationVnce "Variance of Location elevation angle ISO 23150:2021(E): Position elevation - error (A.4.17)";
CM_ SG_ 327 RFC_Loc189_AzimuthVnce "Variance of Location azimuth angle ISO 23150:2021(E): Position azimuth - error (A.4.17)";
CM_ SG_ 327 RFC_Loc189_RadarCrossSection "Radar Cross Section (RCS) estimation ISO 23150:2021(E): Radar cross section (A.4.5)";
CM_ SG_ 327 RFC_Loc189_DistVelocityQuality "Quality of radial distance and velocity resolution processing. Physical range [0..1]";
CM_ SG_ 327 RFC_Loc189_ElevationQuality "Probability for correct signal model (elevation angle). Physical range [0..1]";
CM_ SG_ 327 RFC_Loc189_AzimuthQuality "Probability for correct signal model (azimuth angle). Physical range [0..1]";
CM_ SG_ 327 RFC_Loc189_RSSI "Received Signal Strength Indication (RSSI). This signal is not exactly ISO 23150:2021(E): Signal to noise ratio - detection level (A.4.7), but SNR can be calculated from this signal. Further detail please refer to the DSP Location Interface definition";
CM_ SG_ 327 RFC_Loc189_AzimuthalPartnerId "Id of the azimuthal partner location";
CM_ SG_ 327 RFC_Loc190_RadialDistance "Location radial distance. Represented in conical coordinate system. Same as ISO 23150:2021(E): Position radial distance (A.4.16)";
CM_ SG_ 327 RFC_Loc190_RadialVelocity "Location radial relative velocity ISO 23150:2021(E): Relative velocity {radial distance} (A.4.18)";
CM_ SG_ 327 RFC_Loc190_Elevation "Location elevation angle. Represented in conical coordinate system. Same as ISO 23150:2021(E): Position elevation (A.4.16)";
CM_ SG_ 327 RFC_Loc190_Azimuth "Location azimuth angle. Represented in conical coordinate system. Deviation from ISO 23150:2021(E): Position azimuth (A.4.16). Further details refers to DSP Location Interface definition";
CM_ SG_ 327 RFC_Loc190_DistVelocityCoVnce "Covariance of radial distance and radial velocity";
CM_ SG_ 327 RFC_Loc190_RadialDistanceVnce "Variance of Location radial distance ISO 23150:2021(E): Position radial distance - error (A.4.17)";
CM_ SG_ 327 RFC_Loc190_RadialVelocityVnce "Variance of Location radial relative velocity ISO 23150:2021(E): Relative velocity {radial distance} - error (A.4.19)";
CM_ SG_ 327 RFC_Loc190_ElevationVnce "Variance of Location elevation angle ISO 23150:2021(E): Position elevation - error (A.4.17)";
CM_ SG_ 327 RFC_Loc190_AzimuthVnce "Variance of Location azimuth angle ISO 23150:2021(E): Position azimuth - error (A.4.17)";
CM_ SG_ 327 RFC_Loc190_RadarCrossSection "Radar Cross Section (RCS) estimation ISO 23150:2021(E): Radar cross section (A.4.5)";
CM_ SG_ 327 RFC_Loc190_DistVelocityQuality "Quality of radial distance and velocity resolution processing. Physical range [0..1]";
CM_ SG_ 327 RFC_Loc190_ElevationQuality "Probability for correct signal model (elevation angle). Physical range [0..1]";
CM_ SG_ 327 RFC_Loc190_AzimuthQuality "Probability for correct signal model (azimuth angle). Physical range [0..1]";
CM_ SG_ 327 RFC_Loc190_RSSI "Received Signal Strength Indication (RSSI). This signal is not exactly ISO 23150:2021(E): Signal to noise ratio - detection level (A.4.7), but SNR can be calculated from this signal. Further detail please refer to the DSP Location Interface definition";
CM_ SG_ 327 RFC_Loc190_AzimuthalPartnerId "Id of the azimuthal partner location";
CM_ SG_ 327 RFC_Loc191_RadialDistance "Location radial distance. Represented in conical coordinate system. Same as ISO 23150:2021(E): Position radial distance (A.4.16)";
CM_ SG_ 327 RFC_Loc191_RadialVelocity "Location radial relative velocity ISO 23150:2021(E): Relative velocity {radial distance} (A.4.18)";
CM_ SG_ 327 RFC_Loc191_Elevation "Location elevation angle. Represented in conical coordinate system. Same as ISO 23150:2021(E): Position elevation (A.4.16)";
CM_ SG_ 327 RFC_Loc191_Azimuth "Location azimuth angle. Represented in conical coordinate system. Deviation from ISO 23150:2021(E): Position azimuth (A.4.16). Further details refers to DSP Location Interface definition";
CM_ SG_ 327 RFC_Loc191_DistVelocityCoVnce "Covariance of radial distance and radial velocity";
CM_ SG_ 327 RFC_Loc191_RadialDistanceVnce "Variance of Location radial distance ISO 23150:2021(E): Position radial distance - error (A.4.17)";
CM_ SG_ 327 RFC_Loc191_RadialVelocityVnce "Variance of Location radial relative velocity ISO 23150:2021(E): Relative velocity {radial distance} - error (A.4.19)";
CM_ SG_ 327 RFC_Loc191_ElevationVnce "Variance of Location elevation angle ISO 23150:2021(E): Position elevation - error (A.4.17)";
CM_ SG_ 327 RFC_Loc191_AzimuthVnce "Variance of Location azimuth angle ISO 23150:2021(E): Position azimuth - error (A.4.17)";
CM_ SG_ 327 RFC_Loc191_RadarCrossSection "Radar Cross Section (RCS) estimation ISO 23150:2021(E): Radar cross section (A.4.5)";
CM_ SG_ 327 RFC_Loc191_DistVelocityQuality "Quality of radial distance and velocity resolution processing. Physical range [0..1]";
CM_ SG_ 327 RFC_Loc191_ElevationQuality "Probability for correct signal model (elevation angle). Physical range [0..1]";
CM_ SG_ 327 RFC_Loc191_AzimuthQuality "Probability for correct signal model (azimuth angle). Physical range [0..1]";
CM_ SG_ 327 RFC_Loc191_RSSI "Received Signal Strength Indication (RSSI). This signal is not exactly ISO 23150:2021(E): Signal to noise ratio - detection level (A.4.7), but SNR can be calculated from this signal. Further detail please refer to the DSP Location Interface definition";
CM_ SG_ 327 RFC_Loc191_AzimuthalPartnerId "Id of the azimuthal partner location";
CM_ SG_ 328 RFC_Loc192_194_CRC "CRC - Autosar E2E Profile 5";
CM_ SG_ 328 RFC_Loc192_194_AliveCtr "Alive counter - Autosar E2E Profile 5";
CM_ SG_ 328 RFC_Loc192_194_ProtBlockCtr "Protocol-Signal: Block-Counter";
CM_ SG_ 328 RFC_Loc192_RadialDistance "Location radial distance. Represented in conical coordinate system. Same as ISO 23150:2021(E): Position radial distance (A.4.16)";
CM_ SG_ 328 RFC_Loc192_RadialVelocity "Location radial relative velocity ISO 23150:2021(E): Relative velocity {radial distance} (A.4.18)";
CM_ SG_ 328 RFC_Loc192_Elevation "Location elevation angle. Represented in conical coordinate system. Same as ISO 23150:2021(E): Position elevation (A.4.16)";
CM_ SG_ 328 RFC_Loc192_Azimuth "Location azimuth angle. Represented in conical coordinate system. Deviation from ISO 23150:2021(E): Position azimuth (A.4.16). Further details refers to DSP Location Interface definition";
CM_ SG_ 328 RFC_Loc192_DistVelocityCoVnce "Covariance of radial distance and radial velocity";
CM_ SG_ 328 RFC_Loc192_RadialDistanceVnce "Variance of Location radial distance ISO 23150:2021(E): Position radial distance - error (A.4.17)";
CM_ SG_ 328 RFC_Loc192_RadialVelocityVnce "Variance of Location radial relative velocity ISO 23150:2021(E): Relative velocity {radial distance} - error (A.4.19)";
CM_ SG_ 328 RFC_Loc192_ElevationVnce "Variance of Location elevation angle ISO 23150:2021(E): Position elevation - error (A.4.17)";
CM_ SG_ 328 RFC_Loc192_AzimuthVnce "Variance of Location azimuth angle ISO 23150:2021(E): Position azimuth - error (A.4.17)";
CM_ SG_ 328 RFC_Loc192_RadarCrossSection "Radar Cross Section (RCS) estimation ISO 23150:2021(E): Radar cross section (A.4.5)";
CM_ SG_ 328 RFC_Loc192_DistVelocityQuality "Quality of radial distance and velocity resolution processing. Physical range [0..1]";
CM_ SG_ 328 RFC_Loc192_ElevationQuality "Probability for correct signal model (elevation angle). Physical range [0..1]";
CM_ SG_ 328 RFC_Loc192_AzimuthQuality "Probability for correct signal model (azimuth angle). Physical range [0..1]";
CM_ SG_ 328 RFC_Loc192_RSSI "Received Signal Strength Indication (RSSI). This signal is not exactly ISO 23150:2021(E): Signal to noise ratio - detection level (A.4.7), but SNR can be calculated from this signal. Further detail please refer to the DSP Location Interface definition";
CM_ SG_ 328 RFC_Loc192_AzimuthalPartnerId "Id of the azimuthal partner location";
CM_ SG_ 328 RFC_Loc193_RadialDistance "Location radial distance. Represented in conical coordinate system. Same as ISO 23150:2021(E): Position radial distance (A.4.16)";
CM_ SG_ 328 RFC_Loc193_RadialVelocity "Location radial relative velocity ISO 23150:2021(E): Relative velocity {radial distance} (A.4.18)";
CM_ SG_ 328 RFC_Loc193_Elevation "Location elevation angle. Represented in conical coordinate system. Same as ISO 23150:2021(E): Position elevation (A.4.16)";
CM_ SG_ 328 RFC_Loc193_Azimuth "Location azimuth angle. Represented in conical coordinate system. Deviation from ISO 23150:2021(E): Position azimuth (A.4.16). Further details refers to DSP Location Interface definition";
CM_ SG_ 328 RFC_Loc193_DistVelocityCoVnce "Covariance of radial distance and radial velocity";
CM_ SG_ 328 RFC_Loc193_RadialDistanceVnce "Variance of Location radial distance ISO 23150:2021(E): Position radial distance - error (A.4.17)";
CM_ SG_ 328 RFC_Loc193_RadialVelocityVnce "Variance of Location radial relative velocity ISO 23150:2021(E): Relative velocity {radial distance} - error (A.4.19)";
CM_ SG_ 328 RFC_Loc193_ElevationVnce "Variance of Location elevation angle ISO 23150:2021(E): Position elevation - error (A.4.17)";
CM_ SG_ 328 RFC_Loc193_AzimuthVnce "Variance of Location azimuth angle ISO 23150:2021(E): Position azimuth - error (A.4.17)";
CM_ SG_ 328 RFC_Loc193_RadarCrossSection "Radar Cross Section (RCS) estimation ISO 23150:2021(E): Radar cross section (A.4.5)";
CM_ SG_ 328 RFC_Loc193_DistVelocityQuality "Quality of radial distance and velocity resolution processing. Physical range [0..1]";
CM_ SG_ 328 RFC_Loc193_ElevationQuality "Probability for correct signal model (elevation angle). Physical range [0..1]";
CM_ SG_ 328 RFC_Loc193_AzimuthQuality "Probability for correct signal model (azimuth angle). Physical range [0..1]";
CM_ SG_ 328 RFC_Loc193_RSSI "Received Signal Strength Indication (RSSI). This signal is not exactly ISO 23150:2021(E): Signal to noise ratio - detection level (A.4.7), but SNR can be calculated from this signal. Further detail please refer to the DSP Location Interface definition";
CM_ SG_ 328 RFC_Loc193_AzimuthalPartnerId "Id of the azimuthal partner location";
CM_ SG_ 328 RFC_Loc194_RadialDistance "Location radial distance. Represented in conical coordinate system. Same as ISO 23150:2021(E): Position radial distance (A.4.16)";
CM_ SG_ 328 RFC_Loc194_RadialVelocity "Location radial relative velocity ISO 23150:2021(E): Relative velocity {radial distance} (A.4.18)";
CM_ SG_ 328 RFC_Loc194_Elevation "Location elevation angle. Represented in conical coordinate system. Same as ISO 23150:2021(E): Position elevation (A.4.16)";
CM_ SG_ 328 RFC_Loc194_Azimuth "Location azimuth angle. Represented in conical coordinate system. Deviation from ISO 23150:2021(E): Position azimuth (A.4.16). Further details refers to DSP Location Interface definition";
CM_ SG_ 328 RFC_Loc194_DistVelocityCoVnce "Covariance of radial distance and radial velocity";
CM_ SG_ 328 RFC_Loc194_RadialDistanceVnce "Variance of Location radial distance ISO 23150:2021(E): Position radial distance - error (A.4.17)";
CM_ SG_ 328 RFC_Loc194_RadialVelocityVnce "Variance of Location radial relative velocity ISO 23150:2021(E): Relative velocity {radial distance} - error (A.4.19)";
CM_ SG_ 328 RFC_Loc194_ElevationVnce "Variance of Location elevation angle ISO 23150:2021(E): Position elevation - error (A.4.17)";
CM_ SG_ 328 RFC_Loc194_AzimuthVnce "Variance of Location azimuth angle ISO 23150:2021(E): Position azimuth - error (A.4.17)";
CM_ SG_ 328 RFC_Loc194_RadarCrossSection "Radar Cross Section (RCS) estimation ISO 23150:2021(E): Radar cross section (A.4.5)";
CM_ SG_ 328 RFC_Loc194_DistVelocityQuality "Quality of radial distance and velocity resolution processing. Physical range [0..1]";
CM_ SG_ 328 RFC_Loc194_ElevationQuality "Probability for correct signal model (elevation angle). Physical range [0..1]";
CM_ SG_ 328 RFC_Loc194_AzimuthQuality "Probability for correct signal model (azimuth angle). Physical range [0..1]";
CM_ SG_ 328 RFC_Loc194_RSSI "Received Signal Strength Indication (RSSI). This signal is not exactly ISO 23150:2021(E): Signal to noise ratio - detection level (A.4.7), but SNR can be calculated from this signal. Further detail please refer to the DSP Location Interface definition";
CM_ SG_ 328 RFC_Loc194_AzimuthalPartnerId "Id of the azimuthal partner location";
CM_ SG_ 329 RFC_Loc195_197_CRC "CRC - Autosar E2E Profile 5";
CM_ SG_ 329 RFC_Loc195_197_AliveCtr "Alive counter - Autosar E2E Profile 5";
CM_ SG_ 329 RFC_Loc195_197_ProtBlockCtr "Protocol-Signal: Block-Counter";
CM_ SG_ 329 RFC_Loc195_RadialDistance "Location radial distance. Represented in conical coordinate system. Same as ISO 23150:2021(E): Position radial distance (A.4.16)";
CM_ SG_ 329 RFC_Loc195_RadialVelocity "Location radial relative velocity ISO 23150:2021(E): Relative velocity {radial distance} (A.4.18)";
CM_ SG_ 329 RFC_Loc195_Elevation "Location elevation angle. Represented in conical coordinate system. Same as ISO 23150:2021(E): Position elevation (A.4.16)";
CM_ SG_ 329 RFC_Loc195_Azimuth "Location azimuth angle. Represented in conical coordinate system. Deviation from ISO 23150:2021(E): Position azimuth (A.4.16). Further details refers to DSP Location Interface definition";
CM_ SG_ 329 RFC_Loc195_DistVelocityCoVnce "Covariance of radial distance and radial velocity";
CM_ SG_ 329 RFC_Loc195_RadialDistanceVnce "Variance of Location radial distance ISO 23150:2021(E): Position radial distance - error (A.4.17)";
CM_ SG_ 329 RFC_Loc195_RadialVelocityVnce "Variance of Location radial relative velocity ISO 23150:2021(E): Relative velocity {radial distance} - error (A.4.19)";
CM_ SG_ 329 RFC_Loc195_ElevationVnce "Variance of Location elevation angle ISO 23150:2021(E): Position elevation - error (A.4.17)";
CM_ SG_ 329 RFC_Loc195_AzimuthVnce "Variance of Location azimuth angle ISO 23150:2021(E): Position azimuth - error (A.4.17)";
CM_ SG_ 329 RFC_Loc195_RadarCrossSection "Radar Cross Section (RCS) estimation ISO 23150:2021(E): Radar cross section (A.4.5)";
CM_ SG_ 329 RFC_Loc195_DistVelocityQuality "Quality of radial distance and velocity resolution processing. Physical range [0..1]";
CM_ SG_ 329 RFC_Loc195_ElevationQuality "Probability for correct signal model (elevation angle). Physical range [0..1]";
CM_ SG_ 329 RFC_Loc195_AzimuthQuality "Probability for correct signal model (azimuth angle). Physical range [0..1]";
CM_ SG_ 329 RFC_Loc195_RSSI "Received Signal Strength Indication (RSSI). This signal is not exactly ISO 23150:2021(E): Signal to noise ratio - detection level (A.4.7), but SNR can be calculated from this signal. Further detail please refer to the DSP Location Interface definition";
CM_ SG_ 329 RFC_Loc195_AzimuthalPartnerId "Id of the azimuthal partner location";
CM_ SG_ 329 RFC_Loc196_RadialDistance "Location radial distance. Represented in conical coordinate system. Same as ISO 23150:2021(E): Position radial distance (A.4.16)";
CM_ SG_ 329 RFC_Loc196_RadialVelocity "Location radial relative velocity ISO 23150:2021(E): Relative velocity {radial distance} (A.4.18)";
CM_ SG_ 329 RFC_Loc196_Elevation "Location elevation angle. Represented in conical coordinate system. Same as ISO 23150:2021(E): Position elevation (A.4.16)";
CM_ SG_ 329 RFC_Loc196_Azimuth "Location azimuth angle. Represented in conical coordinate system. Deviation from ISO 23150:2021(E): Position azimuth (A.4.16). Further details refers to DSP Location Interface definition";
CM_ SG_ 329 RFC_Loc196_DistVelocityCoVnce "Covariance of radial distance and radial velocity";
CM_ SG_ 329 RFC_Loc196_RadialDistanceVnce "Variance of Location radial distance ISO 23150:2021(E): Position radial distance - error (A.4.17)";
CM_ SG_ 329 RFC_Loc196_RadialVelocityVnce "Variance of Location radial relative velocity ISO 23150:2021(E): Relative velocity {radial distance} - error (A.4.19)";
CM_ SG_ 329 RFC_Loc196_ElevationVnce "Variance of Location elevation angle ISO 23150:2021(E): Position elevation - error (A.4.17)";
CM_ SG_ 329 RFC_Loc196_AzimuthVnce "Variance of Location azimuth angle ISO 23150:2021(E): Position azimuth - error (A.4.17)";
CM_ SG_ 329 RFC_Loc196_RadarCrossSection "Radar Cross Section (RCS) estimation ISO 23150:2021(E): Radar cross section (A.4.5)";
CM_ SG_ 329 RFC_Loc196_DistVelocityQuality "Quality of radial distance and velocity resolution processing. Physical range [0..1]";
CM_ SG_ 329 RFC_Loc196_ElevationQuality "Probability for correct signal model (elevation angle). Physical range [0..1]";
CM_ SG_ 329 RFC_Loc196_AzimuthQuality "Probability for correct signal model (azimuth angle). Physical range [0..1]";
CM_ SG_ 329 RFC_Loc196_RSSI "Received Signal Strength Indication (RSSI). This signal is not exactly ISO 23150:2021(E): Signal to noise ratio - detection level (A.4.7), but SNR can be calculated from this signal. Further detail please refer to the DSP Location Interface definition";
CM_ SG_ 329 RFC_Loc196_AzimuthalPartnerId "Id of the azimuthal partner location";
CM_ SG_ 329 RFC_Loc197_RadialDistance "Location radial distance. Represented in conical coordinate system. Same as ISO 23150:2021(E): Position radial distance (A.4.16)";
CM_ SG_ 329 RFC_Loc197_RadialVelocity "Location radial relative velocity ISO 23150:2021(E): Relative velocity {radial distance} (A.4.18)";
CM_ SG_ 329 RFC_Loc197_Elevation "Location elevation angle. Represented in conical coordinate system. Same as ISO 23150:2021(E): Position elevation (A.4.16)";
CM_ SG_ 329 RFC_Loc197_Azimuth "Location azimuth angle. Represented in conical coordinate system. Deviation from ISO 23150:2021(E): Position azimuth (A.4.16). Further details refers to DSP Location Interface definition";
CM_ SG_ 329 RFC_Loc197_DistVelocityCoVnce "Covariance of radial distance and radial velocity";
CM_ SG_ 329 RFC_Loc197_RadialDistanceVnce "Variance of Location radial distance ISO 23150:2021(E): Position radial distance - error (A.4.17)";
CM_ SG_ 329 RFC_Loc197_RadialVelocityVnce "Variance of Location radial relative velocity ISO 23150:2021(E): Relative velocity {radial distance} - error (A.4.19)";
CM_ SG_ 329 RFC_Loc197_ElevationVnce "Variance of Location elevation angle ISO 23150:2021(E): Position elevation - error (A.4.17)";
CM_ SG_ 329 RFC_Loc197_AzimuthVnce "Variance of Location azimuth angle ISO 23150:2021(E): Position azimuth - error (A.4.17)";
CM_ SG_ 329 RFC_Loc197_RadarCrossSection "Radar Cross Section (RCS) estimation ISO 23150:2021(E): Radar cross section (A.4.5)";
CM_ SG_ 329 RFC_Loc197_DistVelocityQuality "Quality of radial distance and velocity resolution processing. Physical range [0..1]";
CM_ SG_ 329 RFC_Loc197_ElevationQuality "Probability for correct signal model (elevation angle). Physical range [0..1]";
CM_ SG_ 329 RFC_Loc197_AzimuthQuality "Probability for correct signal model (azimuth angle). Physical range [0..1]";
CM_ SG_ 329 RFC_Loc197_RSSI "Received Signal Strength Indication (RSSI). This signal is not exactly ISO 23150:2021(E): Signal to noise ratio - detection level (A.4.7), but SNR can be calculated from this signal. Further detail please refer to the DSP Location Interface definition";
CM_ SG_ 329 RFC_Loc197_AzimuthalPartnerId "Id of the azimuthal partner location";
CM_ SG_ 330 RFC_Loc198_200_CRC "CRC - Autosar E2E Profile 5";
CM_ SG_ 330 RFC_Loc198_200_AliveCtr "Alive counter - Autosar E2E Profile 5";
CM_ SG_ 330 RFC_Loc198_200_ProtBlockCtr "Protocol-Signal: Block-Counter";
CM_ SG_ 330 RFC_Loc198_RadialDistance "Location radial distance. Represented in conical coordinate system. Same as ISO 23150:2021(E): Position radial distance (A.4.16)";
CM_ SG_ 330 RFC_Loc198_RadialVelocity "Location radial relative velocity ISO 23150:2021(E): Relative velocity {radial distance} (A.4.18)";
CM_ SG_ 330 RFC_Loc198_Elevation "Location elevation angle. Represented in conical coordinate system. Same as ISO 23150:2021(E): Position elevation (A.4.16)";
CM_ SG_ 330 RFC_Loc198_Azimuth "Location azimuth angle. Represented in conical coordinate system. Deviation from ISO 23150:2021(E): Position azimuth (A.4.16). Further details refers to DSP Location Interface definition";
CM_ SG_ 330 RFC_Loc198_DistVelocityCoVnce "Covariance of radial distance and radial velocity";
CM_ SG_ 330 RFC_Loc198_RadialDistanceVnce "Variance of Location radial distance ISO 23150:2021(E): Position radial distance - error (A.4.17)";
CM_ SG_ 330 RFC_Loc198_RadialVelocityVnce "Variance of Location radial relative velocity ISO 23150:2021(E): Relative velocity {radial distance} - error (A.4.19)";
CM_ SG_ 330 RFC_Loc198_ElevationVnce "Variance of Location elevation angle ISO 23150:2021(E): Position elevation - error (A.4.17)";
CM_ SG_ 330 RFC_Loc198_AzimuthVnce "Variance of Location azimuth angle ISO 23150:2021(E): Position azimuth - error (A.4.17)";
CM_ SG_ 330 RFC_Loc198_RadarCrossSection "Radar Cross Section (RCS) estimation ISO 23150:2021(E): Radar cross section (A.4.5)";
CM_ SG_ 330 RFC_Loc198_DistVelocityQuality "Quality of radial distance and velocity resolution processing. Physical range [0..1]";
CM_ SG_ 330 RFC_Loc198_ElevationQuality "Probability for correct signal model (elevation angle). Physical range [0..1]";
CM_ SG_ 330 RFC_Loc198_AzimuthQuality "Probability for correct signal model (azimuth angle). Physical range [0..1]";
CM_ SG_ 330 RFC_Loc198_RSSI "Received Signal Strength Indication (RSSI). This signal is not exactly ISO 23150:2021(E): Signal to noise ratio - detection level (A.4.7), but SNR can be calculated from this signal. Further detail please refer to the DSP Location Interface definition";
CM_ SG_ 330 RFC_Loc198_AzimuthalPartnerId "Id of the azimuthal partner location";
CM_ SG_ 330 RFC_Loc199_RadialDistance "Location radial distance. Represented in conical coordinate system. Same as ISO 23150:2021(E): Position radial distance (A.4.16)";
CM_ SG_ 330 RFC_Loc199_RadialVelocity "Location radial relative velocity ISO 23150:2021(E): Relative velocity {radial distance} (A.4.18)";
CM_ SG_ 330 RFC_Loc199_Elevation "Location elevation angle. Represented in conical coordinate system. Same as ISO 23150:2021(E): Position elevation (A.4.16)";
CM_ SG_ 330 RFC_Loc199_Azimuth "Location azimuth angle. Represented in conical coordinate system. Deviation from ISO 23150:2021(E): Position azimuth (A.4.16). Further details refers to DSP Location Interface definition";
CM_ SG_ 330 RFC_Loc199_DistVelocityCoVnce "Covariance of radial distance and radial velocity";
CM_ SG_ 330 RFC_Loc199_RadialDistanceVnce "Variance of Location radial distance ISO 23150:2021(E): Position radial distance - error (A.4.17)";
CM_ SG_ 330 RFC_Loc199_RadialVelocityVnce "Variance of Location radial relative velocity ISO 23150:2021(E): Relative velocity {radial distance} - error (A.4.19)";
CM_ SG_ 330 RFC_Loc199_ElevationVnce "Variance of Location elevation angle ISO 23150:2021(E): Position elevation - error (A.4.17)";
CM_ SG_ 330 RFC_Loc199_AzimuthVnce "Variance of Location azimuth angle ISO 23150:2021(E): Position azimuth - error (A.4.17)";
CM_ SG_ 330 RFC_Loc199_RadarCrossSection "Radar Cross Section (RCS) estimation ISO 23150:2021(E): Radar cross section (A.4.5)";
CM_ SG_ 330 RFC_Loc199_DistVelocityQuality "Quality of radial distance and velocity resolution processing. Physical range [0..1]";
CM_ SG_ 330 RFC_Loc199_ElevationQuality "Probability for correct signal model (elevation angle). Physical range [0..1]";
CM_ SG_ 330 RFC_Loc199_AzimuthQuality "Probability for correct signal model (azimuth angle). Physical range [0..1]";
CM_ SG_ 330 RFC_Loc199_RSSI "Received Signal Strength Indication (RSSI). This signal is not exactly ISO 23150:2021(E): Signal to noise ratio - detection level (A.4.7), but SNR can be calculated from this signal. Further detail please refer to the DSP Location Interface definition";
CM_ SG_ 330 RFC_Loc199_AzimuthalPartnerId "Id of the azimuthal partner location";
CM_ SG_ 330 RFC_Loc200_RadialDistance "Location radial distance. Represented in conical coordinate system. Same as ISO 23150:2021(E): Position radial distance (A.4.16)";
CM_ SG_ 330 RFC_Loc200_RadialVelocity "Location radial relative velocity ISO 23150:2021(E): Relative velocity {radial distance} (A.4.18)";
CM_ SG_ 330 RFC_Loc200_Elevation "Location elevation angle. Represented in conical coordinate system. Same as ISO 23150:2021(E): Position elevation (A.4.16)";
CM_ SG_ 330 RFC_Loc200_Azimuth "Location azimuth angle. Represented in conical coordinate system. Deviation from ISO 23150:2021(E): Position azimuth (A.4.16). Further details refers to DSP Location Interface definition";
CM_ SG_ 330 RFC_Loc200_DistVelocityCoVnce "Covariance of radial distance and radial velocity";
CM_ SG_ 330 RFC_Loc200_RadialDistanceVnce "Variance of Location radial distance ISO 23150:2021(E): Position radial distance - error (A.4.17)";
CM_ SG_ 330 RFC_Loc200_RadialVelocityVnce "Variance of Location radial relative velocity ISO 23150:2021(E): Relative velocity {radial distance} - error (A.4.19)";
CM_ SG_ 330 RFC_Loc200_ElevationVnce "Variance of Location elevation angle ISO 23150:2021(E): Position elevation - error (A.4.17)";
CM_ SG_ 330 RFC_Loc200_AzimuthVnce "Variance of Location azimuth angle ISO 23150:2021(E): Position azimuth - error (A.4.17)";
CM_ SG_ 330 RFC_Loc200_RadarCrossSection "Radar Cross Section (RCS) estimation ISO 23150:2021(E): Radar cross section (A.4.5)";
CM_ SG_ 330 RFC_Loc200_DistVelocityQuality "Quality of radial distance and velocity resolution processing. Physical range [0..1]";
CM_ SG_ 330 RFC_Loc200_ElevationQuality "Probability for correct signal model (elevation angle). Physical range [0..1]";
CM_ SG_ 330 RFC_Loc200_AzimuthQuality "Probability for correct signal model (azimuth angle). Physical range [0..1]";
CM_ SG_ 330 RFC_Loc200_RSSI "Received Signal Strength Indication (RSSI). This signal is not exactly ISO 23150:2021(E): Signal to noise ratio - detection level (A.4.7), but SNR can be calculated from this signal. Further detail please refer to the DSP Location Interface definition";
CM_ SG_ 330 RFC_Loc200_AzimuthalPartnerId "Id of the azimuthal partner location";
CM_ SG_ 331 RFC_Loc201_203_CRC "CRC - Autosar E2E Profile 5";
CM_ SG_ 331 RFC_Loc201_203_AliveCtr "Alive counter - Autosar E2E Profile 5";
CM_ SG_ 331 RFC_Loc201_203_ProtBlockCtr "Protocol-Signal: Block-Counter";
CM_ SG_ 331 RFC_Loc201_RadialDistance "Location radial distance. Represented in conical coordinate system. Same as ISO 23150:2021(E): Position radial distance (A.4.16)";
CM_ SG_ 331 RFC_Loc201_RadialVelocity "Location radial relative velocity ISO 23150:2021(E): Relative velocity {radial distance} (A.4.18)";
CM_ SG_ 331 RFC_Loc201_Elevation "Location elevation angle. Represented in conical coordinate system. Same as ISO 23150:2021(E): Position elevation (A.4.16)";
CM_ SG_ 331 RFC_Loc201_Azimuth "Location azimuth angle. Represented in conical coordinate system. Deviation from ISO 23150:2021(E): Position azimuth (A.4.16). Further details refers to DSP Location Interface definition";
CM_ SG_ 331 RFC_Loc201_DistVelocityCoVnce "Covariance of radial distance and radial velocity";
CM_ SG_ 331 RFC_Loc201_RadialDistanceVnce "Variance of Location radial distance ISO 23150:2021(E): Position radial distance - error (A.4.17)";
CM_ SG_ 331 RFC_Loc201_RadialVelocityVnce "Variance of Location radial relative velocity ISO 23150:2021(E): Relative velocity {radial distance} - error (A.4.19)";
CM_ SG_ 331 RFC_Loc201_ElevationVnce "Variance of Location elevation angle ISO 23150:2021(E): Position elevation - error (A.4.17)";
CM_ SG_ 331 RFC_Loc201_AzimuthVnce "Variance of Location azimuth angle ISO 23150:2021(E): Position azimuth - error (A.4.17)";
CM_ SG_ 331 RFC_Loc201_RadarCrossSection "Radar Cross Section (RCS) estimation ISO 23150:2021(E): Radar cross section (A.4.5)";
CM_ SG_ 331 RFC_Loc201_DistVelocityQuality "Quality of radial distance and velocity resolution processing. Physical range [0..1]";
CM_ SG_ 331 RFC_Loc201_ElevationQuality "Probability for correct signal model (elevation angle). Physical range [0..1]";
CM_ SG_ 331 RFC_Loc201_AzimuthQuality "Probability for correct signal model (azimuth angle). Physical range [0..1]";
CM_ SG_ 331 RFC_Loc201_RSSI "Received Signal Strength Indication (RSSI). This signal is not exactly ISO 23150:2021(E): Signal to noise ratio - detection level (A.4.7), but SNR can be calculated from this signal. Further detail please refer to the DSP Location Interface definition";
CM_ SG_ 331 RFC_Loc201_AzimuthalPartnerId "Id of the azimuthal partner location";
CM_ SG_ 331 RFC_Loc202_RadialDistance "Location radial distance. Represented in conical coordinate system. Same as ISO 23150:2021(E): Position radial distance (A.4.16)";
CM_ SG_ 331 RFC_Loc202_RadialVelocity "Location radial relative velocity ISO 23150:2021(E): Relative velocity {radial distance} (A.4.18)";
CM_ SG_ 331 RFC_Loc202_Elevation "Location elevation angle. Represented in conical coordinate system. Same as ISO 23150:2021(E): Position elevation (A.4.16)";
CM_ SG_ 331 RFC_Loc202_Azimuth "Location azimuth angle. Represented in conical coordinate system. Deviation from ISO 23150:2021(E): Position azimuth (A.4.16). Further details refers to DSP Location Interface definition";
CM_ SG_ 331 RFC_Loc202_DistVelocityCoVnce "Covariance of radial distance and radial velocity";
CM_ SG_ 331 RFC_Loc202_RadialDistanceVnce "Variance of Location radial distance ISO 23150:2021(E): Position radial distance - error (A.4.17)";
CM_ SG_ 331 RFC_Loc202_RadialVelocityVnce "Variance of Location radial relative velocity ISO 23150:2021(E): Relative velocity {radial distance} - error (A.4.19)";
CM_ SG_ 331 RFC_Loc202_ElevationVnce "Variance of Location elevation angle ISO 23150:2021(E): Position elevation - error (A.4.17)";
CM_ SG_ 331 RFC_Loc202_AzimuthVnce "Variance of Location azimuth angle ISO 23150:2021(E): Position azimuth - error (A.4.17)";
CM_ SG_ 331 RFC_Loc202_RadarCrossSection "Radar Cross Section (RCS) estimation ISO 23150:2021(E): Radar cross section (A.4.5)";
CM_ SG_ 331 RFC_Loc202_DistVelocityQuality "Quality of radial distance and velocity resolution processing. Physical range [0..1]";
CM_ SG_ 331 RFC_Loc202_ElevationQuality "Probability for correct signal model (elevation angle). Physical range [0..1]";
CM_ SG_ 331 RFC_Loc202_AzimuthQuality "Probability for correct signal model (azimuth angle). Physical range [0..1]";
CM_ SG_ 331 RFC_Loc202_RSSI "Received Signal Strength Indication (RSSI). This signal is not exactly ISO 23150:2021(E): Signal to noise ratio - detection level (A.4.7), but SNR can be calculated from this signal. Further detail please refer to the DSP Location Interface definition";
CM_ SG_ 331 RFC_Loc202_AzimuthalPartnerId "Id of the azimuthal partner location";
CM_ SG_ 331 RFC_Loc203_RadialDistance "Location radial distance. Represented in conical coordinate system. Same as ISO 23150:2021(E): Position radial distance (A.4.16)";
CM_ SG_ 331 RFC_Loc203_RadialVelocity "Location radial relative velocity ISO 23150:2021(E): Relative velocity {radial distance} (A.4.18)";
CM_ SG_ 331 RFC_Loc203_Elevation "Location elevation angle. Represented in conical coordinate system. Same as ISO 23150:2021(E): Position elevation (A.4.16)";
CM_ SG_ 331 RFC_Loc203_Azimuth "Location azimuth angle. Represented in conical coordinate system. Deviation from ISO 23150:2021(E): Position azimuth (A.4.16). Further details refers to DSP Location Interface definition";
CM_ SG_ 331 RFC_Loc203_DistVelocityCoVnce "Covariance of radial distance and radial velocity";
CM_ SG_ 331 RFC_Loc203_RadialDistanceVnce "Variance of Location radial distance ISO 23150:2021(E): Position radial distance - error (A.4.17)";
CM_ SG_ 331 RFC_Loc203_RadialVelocityVnce "Variance of Location radial relative velocity ISO 23150:2021(E): Relative velocity {radial distance} - error (A.4.19)";
CM_ SG_ 331 RFC_Loc203_ElevationVnce "Variance of Location elevation angle ISO 23150:2021(E): Position elevation - error (A.4.17)";
CM_ SG_ 331 RFC_Loc203_AzimuthVnce "Variance of Location azimuth angle ISO 23150:2021(E): Position azimuth - error (A.4.17)";
CM_ SG_ 331 RFC_Loc203_RadarCrossSection "Radar Cross Section (RCS) estimation ISO 23150:2021(E): Radar cross section (A.4.5)";
CM_ SG_ 331 RFC_Loc203_DistVelocityQuality "Quality of radial distance and velocity resolution processing. Physical range [0..1]";
CM_ SG_ 331 RFC_Loc203_ElevationQuality "Probability for correct signal model (elevation angle). Physical range [0..1]";
CM_ SG_ 331 RFC_Loc203_AzimuthQuality "Probability for correct signal model (azimuth angle). Physical range [0..1]";
CM_ SG_ 331 RFC_Loc203_RSSI "Received Signal Strength Indication (RSSI). This signal is not exactly ISO 23150:2021(E): Signal to noise ratio - detection level (A.4.7), but SNR can be calculated from this signal. Further detail please refer to the DSP Location Interface definition";
CM_ SG_ 331 RFC_Loc203_AzimuthalPartnerId "Id of the azimuthal partner location";
CM_ SG_ 332 RFC_Loc204_206_CRC "CRC - Autosar E2E Profile 5";
CM_ SG_ 332 RFC_Loc204_206_AliveCtr "Alive counter - Autosar E2E Profile 5";
CM_ SG_ 332 RFC_Loc204_206_ProtBlockCtr "Protocol-Signal: Block-Counter";
CM_ SG_ 332 RFC_Loc204_RadialDistance "Location radial distance. Represented in conical coordinate system. Same as ISO 23150:2021(E): Position radial distance (A.4.16)";
CM_ SG_ 332 RFC_Loc204_RadialVelocity "Location radial relative velocity ISO 23150:2021(E): Relative velocity {radial distance} (A.4.18)";
CM_ SG_ 332 RFC_Loc204_Elevation "Location elevation angle. Represented in conical coordinate system. Same as ISO 23150:2021(E): Position elevation (A.4.16)";
CM_ SG_ 332 RFC_Loc204_Azimuth "Location azimuth angle. Represented in conical coordinate system. Deviation from ISO 23150:2021(E): Position azimuth (A.4.16). Further details refers to DSP Location Interface definition";
CM_ SG_ 332 RFC_Loc204_DistVelocityCoVnce "Covariance of radial distance and radial velocity";
CM_ SG_ 332 RFC_Loc204_RadialDistanceVnce "Variance of Location radial distance ISO 23150:2021(E): Position radial distance - error (A.4.17)";
CM_ SG_ 332 RFC_Loc204_RadialVelocityVnce "Variance of Location radial relative velocity ISO 23150:2021(E): Relative velocity {radial distance} - error (A.4.19)";
CM_ SG_ 332 RFC_Loc204_ElevationVnce "Variance of Location elevation angle ISO 23150:2021(E): Position elevation - error (A.4.17)";
CM_ SG_ 332 RFC_Loc204_AzimuthVnce "Variance of Location azimuth angle ISO 23150:2021(E): Position azimuth - error (A.4.17)";
CM_ SG_ 332 RFC_Loc204_RadarCrossSection "Radar Cross Section (RCS) estimation ISO 23150:2021(E): Radar cross section (A.4.5)";
CM_ SG_ 332 RFC_Loc204_DistVelocityQuality "Quality of radial distance and velocity resolution processing. Physical range [0..1]";
CM_ SG_ 332 RFC_Loc204_ElevationQuality "Probability for correct signal model (elevation angle). Physical range [0..1]";
CM_ SG_ 332 RFC_Loc204_AzimuthQuality "Probability for correct signal model (azimuth angle). Physical range [0..1]";
CM_ SG_ 332 RFC_Loc204_RSSI "Received Signal Strength Indication (RSSI). This signal is not exactly ISO 23150:2021(E): Signal to noise ratio - detection level (A.4.7), but SNR can be calculated from this signal. Further detail please refer to the DSP Location Interface definition";
CM_ SG_ 332 RFC_Loc204_AzimuthalPartnerId "Id of the azimuthal partner location";
CM_ SG_ 332 RFC_Loc205_RadialDistance "Location radial distance. Represented in conical coordinate system. Same as ISO 23150:2021(E): Position radial distance (A.4.16)";
CM_ SG_ 332 RFC_Loc205_RadialVelocity "Location radial relative velocity ISO 23150:2021(E): Relative velocity {radial distance} (A.4.18)";
CM_ SG_ 332 RFC_Loc205_Elevation "Location elevation angle. Represented in conical coordinate system. Same as ISO 23150:2021(E): Position elevation (A.4.16)";
CM_ SG_ 332 RFC_Loc205_Azimuth "Location azimuth angle. Represented in conical coordinate system. Deviation from ISO 23150:2021(E): Position azimuth (A.4.16). Further details refers to DSP Location Interface definition";
CM_ SG_ 332 RFC_Loc205_DistVelocityCoVnce "Covariance of radial distance and radial velocity";
CM_ SG_ 332 RFC_Loc205_RadialDistanceVnce "Variance of Location radial distance ISO 23150:2021(E): Position radial distance - error (A.4.17)";
CM_ SG_ 332 RFC_Loc205_RadialVelocityVnce "Variance of Location radial relative velocity ISO 23150:2021(E): Relative velocity {radial distance} - error (A.4.19)";
CM_ SG_ 332 RFC_Loc205_ElevationVnce "Variance of Location elevation angle ISO 23150:2021(E): Position elevation - error (A.4.17)";
CM_ SG_ 332 RFC_Loc205_AzimuthVnce "Variance of Location azimuth angle ISO 23150:2021(E): Position azimuth - error (A.4.17)";
CM_ SG_ 332 RFC_Loc205_RadarCrossSection "Radar Cross Section (RCS) estimation ISO 23150:2021(E): Radar cross section (A.4.5)";
CM_ SG_ 332 RFC_Loc205_DistVelocityQuality "Quality of radial distance and velocity resolution processing. Physical range [0..1]";
CM_ SG_ 332 RFC_Loc205_ElevationQuality "Probability for correct signal model (elevation angle). Physical range [0..1]";
CM_ SG_ 332 RFC_Loc205_AzimuthQuality "Probability for correct signal model (azimuth angle). Physical range [0..1]";
CM_ SG_ 332 RFC_Loc205_RSSI "Received Signal Strength Indication (RSSI). This signal is not exactly ISO 23150:2021(E): Signal to noise ratio - detection level (A.4.7), but SNR can be calculated from this signal. Further detail please refer to the DSP Location Interface definition";
CM_ SG_ 332 RFC_Loc205_AzimuthalPartnerId "Id of the azimuthal partner location";
CM_ SG_ 332 RFC_Loc206_RadialDistance "Location radial distance. Represented in conical coordinate system. Same as ISO 23150:2021(E): Position radial distance (A.4.16)";
CM_ SG_ 332 RFC_Loc206_RadialVelocity "Location radial relative velocity ISO 23150:2021(E): Relative velocity {radial distance} (A.4.18)";
CM_ SG_ 332 RFC_Loc206_Elevation "Location elevation angle. Represented in conical coordinate system. Same as ISO 23150:2021(E): Position elevation (A.4.16)";
CM_ SG_ 332 RFC_Loc206_Azimuth "Location azimuth angle. Represented in conical coordinate system. Deviation from ISO 23150:2021(E): Position azimuth (A.4.16). Further details refers to DSP Location Interface definition";
CM_ SG_ 332 RFC_Loc206_DistVelocityCoVnce "Covariance of radial distance and radial velocity";
CM_ SG_ 332 RFC_Loc206_RadialDistanceVnce "Variance of Location radial distance ISO 23150:2021(E): Position radial distance - error (A.4.17)";
CM_ SG_ 332 RFC_Loc206_RadialVelocityVnce "Variance of Location radial relative velocity ISO 23150:2021(E): Relative velocity {radial distance} - error (A.4.19)";
CM_ SG_ 332 RFC_Loc206_ElevationVnce "Variance of Location elevation angle ISO 23150:2021(E): Position elevation - error (A.4.17)";
CM_ SG_ 332 RFC_Loc206_AzimuthVnce "Variance of Location azimuth angle ISO 23150:2021(E): Position azimuth - error (A.4.17)";
CM_ SG_ 332 RFC_Loc206_RadarCrossSection "Radar Cross Section (RCS) estimation ISO 23150:2021(E): Radar cross section (A.4.5)";
CM_ SG_ 332 RFC_Loc206_DistVelocityQuality "Quality of radial distance and velocity resolution processing. Physical range [0..1]";
CM_ SG_ 332 RFC_Loc206_ElevationQuality "Probability for correct signal model (elevation angle). Physical range [0..1]";
CM_ SG_ 332 RFC_Loc206_AzimuthQuality "Probability for correct signal model (azimuth angle). Physical range [0..1]";
CM_ SG_ 332 RFC_Loc206_RSSI "Received Signal Strength Indication (RSSI). This signal is not exactly ISO 23150:2021(E): Signal to noise ratio - detection level (A.4.7), but SNR can be calculated from this signal. Further detail please refer to the DSP Location Interface definition";
CM_ SG_ 332 RFC_Loc206_AzimuthalPartnerId "Id of the azimuthal partner location";
CM_ SG_ 333 RFC_Loc207_209_CRC "CRC - Autosar E2E Profile 5";
CM_ SG_ 333 RFC_Loc207_209_AliveCtr "Alive counter - Autosar E2E Profile 5";
CM_ SG_ 333 RFC_Loc207_209_ProtBlockCtr "Protocol-Signal: Block-Counter";
CM_ SG_ 333 RFC_Loc207_RadialDistance "Location radial distance. Represented in conical coordinate system. Same as ISO 23150:2021(E): Position radial distance (A.4.16)";
CM_ SG_ 333 RFC_Loc207_RadialVelocity "Location radial relative velocity ISO 23150:2021(E): Relative velocity {radial distance} (A.4.18)";
CM_ SG_ 333 RFC_Loc207_Elevation "Location elevation angle. Represented in conical coordinate system. Same as ISO 23150:2021(E): Position elevation (A.4.16)";
CM_ SG_ 333 RFC_Loc207_Azimuth "Location azimuth angle. Represented in conical coordinate system. Deviation from ISO 23150:2021(E): Position azimuth (A.4.16). Further details refers to DSP Location Interface definition";
CM_ SG_ 333 RFC_Loc207_DistVelocityCoVnce "Covariance of radial distance and radial velocity";
CM_ SG_ 333 RFC_Loc207_RadialDistanceVnce "Variance of Location radial distance ISO 23150:2021(E): Position radial distance - error (A.4.17)";
CM_ SG_ 333 RFC_Loc207_RadialVelocityVnce "Variance of Location radial relative velocity ISO 23150:2021(E): Relative velocity {radial distance} - error (A.4.19)";
CM_ SG_ 333 RFC_Loc207_ElevationVnce "Variance of Location elevation angle ISO 23150:2021(E): Position elevation - error (A.4.17)";
CM_ SG_ 333 RFC_Loc207_AzimuthVnce "Variance of Location azimuth angle ISO 23150:2021(E): Position azimuth - error (A.4.17)";
CM_ SG_ 333 RFC_Loc207_RadarCrossSection "Radar Cross Section (RCS) estimation ISO 23150:2021(E): Radar cross section (A.4.5)";
CM_ SG_ 333 RFC_Loc207_DistVelocityQuality "Quality of radial distance and velocity resolution processing. Physical range [0..1]";
CM_ SG_ 333 RFC_Loc207_ElevationQuality "Probability for correct signal model (elevation angle). Physical range [0..1]";
CM_ SG_ 333 RFC_Loc207_AzimuthQuality "Probability for correct signal model (azimuth angle). Physical range [0..1]";
CM_ SG_ 333 RFC_Loc207_RSSI "Received Signal Strength Indication (RSSI). This signal is not exactly ISO 23150:2021(E): Signal to noise ratio - detection level (A.4.7), but SNR can be calculated from this signal. Further detail please refer to the DSP Location Interface definition";
CM_ SG_ 333 RFC_Loc207_AzimuthalPartnerId "Id of the azimuthal partner location";
CM_ SG_ 333 RFC_Loc208_RadialDistance "Location radial distance. Represented in conical coordinate system. Same as ISO 23150:2021(E): Position radial distance (A.4.16)";
CM_ SG_ 333 RFC_Loc208_RadialVelocity "Location radial relative velocity ISO 23150:2021(E): Relative velocity {radial distance} (A.4.18)";
CM_ SG_ 333 RFC_Loc208_Elevation "Location elevation angle. Represented in conical coordinate system. Same as ISO 23150:2021(E): Position elevation (A.4.16)";
CM_ SG_ 333 RFC_Loc208_Azimuth "Location azimuth angle. Represented in conical coordinate system. Deviation from ISO 23150:2021(E): Position azimuth (A.4.16). Further details refers to DSP Location Interface definition";
CM_ SG_ 333 RFC_Loc208_DistVelocityCoVnce "Covariance of radial distance and radial velocity";
CM_ SG_ 333 RFC_Loc208_RadialDistanceVnce "Variance of Location radial distance ISO 23150:2021(E): Position radial distance - error (A.4.17)";
CM_ SG_ 333 RFC_Loc208_RadialVelocityVnce "Variance of Location radial relative velocity ISO 23150:2021(E): Relative velocity {radial distance} - error (A.4.19)";
CM_ SG_ 333 RFC_Loc208_ElevationVnce "Variance of Location elevation angle ISO 23150:2021(E): Position elevation - error (A.4.17)";
CM_ SG_ 333 RFC_Loc208_AzimuthVnce "Variance of Location azimuth angle ISO 23150:2021(E): Position azimuth - error (A.4.17)";
CM_ SG_ 333 RFC_Loc208_RadarCrossSection "Radar Cross Section (RCS) estimation ISO 23150:2021(E): Radar cross section (A.4.5)";
CM_ SG_ 333 RFC_Loc208_DistVelocityQuality "Quality of radial distance and velocity resolution processing. Physical range [0..1]";
CM_ SG_ 333 RFC_Loc208_ElevationQuality "Probability for correct signal model (elevation angle). Physical range [0..1]";
CM_ SG_ 333 RFC_Loc208_AzimuthQuality "Probability for correct signal model (azimuth angle). Physical range [0..1]";
CM_ SG_ 333 RFC_Loc208_RSSI "Received Signal Strength Indication (RSSI). This signal is not exactly ISO 23150:2021(E): Signal to noise ratio - detection level (A.4.7), but SNR can be calculated from this signal. Further detail please refer to the DSP Location Interface definition";
CM_ SG_ 333 RFC_Loc208_AzimuthalPartnerId "Id of the azimuthal partner location";
CM_ SG_ 333 RFC_Loc209_RadialDistance "Location radial distance. Represented in conical coordinate system. Same as ISO 23150:2021(E): Position radial distance (A.4.16)";
CM_ SG_ 333 RFC_Loc209_RadialVelocity "Location radial relative velocity ISO 23150:2021(E): Relative velocity {radial distance} (A.4.18)";
CM_ SG_ 333 RFC_Loc209_Elevation "Location elevation angle. Represented in conical coordinate system. Same as ISO 23150:2021(E): Position elevation (A.4.16)";
CM_ SG_ 333 RFC_Loc209_Azimuth "Location azimuth angle. Represented in conical coordinate system. Deviation from ISO 23150:2021(E): Position azimuth (A.4.16). Further details refers to DSP Location Interface definition";
CM_ SG_ 333 RFC_Loc209_DistVelocityCoVnce "Covariance of radial distance and radial velocity";
CM_ SG_ 333 RFC_Loc209_RadialDistanceVnce "Variance of Location radial distance ISO 23150:2021(E): Position radial distance - error (A.4.17)";
CM_ SG_ 333 RFC_Loc209_RadialVelocityVnce "Variance of Location radial relative velocity ISO 23150:2021(E): Relative velocity {radial distance} - error (A.4.19)";
CM_ SG_ 333 RFC_Loc209_ElevationVnce "Variance of Location elevation angle ISO 23150:2021(E): Position elevation - error (A.4.17)";
CM_ SG_ 333 RFC_Loc209_AzimuthVnce "Variance of Location azimuth angle ISO 23150:2021(E): Position azimuth - error (A.4.17)";
CM_ SG_ 333 RFC_Loc209_RadarCrossSection "Radar Cross Section (RCS) estimation ISO 23150:2021(E): Radar cross section (A.4.5)";
CM_ SG_ 333 RFC_Loc209_DistVelocityQuality "Quality of radial distance and velocity resolution processing. Physical range [0..1]";
CM_ SG_ 333 RFC_Loc209_ElevationQuality "Probability for correct signal model (elevation angle). Physical range [0..1]";
CM_ SG_ 333 RFC_Loc209_AzimuthQuality "Probability for correct signal model (azimuth angle). Physical range [0..1]";
CM_ SG_ 333 RFC_Loc209_RSSI "Received Signal Strength Indication (RSSI). This signal is not exactly ISO 23150:2021(E): Signal to noise ratio - detection level (A.4.7), but SNR can be calculated from this signal. Further detail please refer to the DSP Location Interface definition";
CM_ SG_ 333 RFC_Loc209_AzimuthalPartnerId "Id of the azimuthal partner location";
CM_ SG_ 334 RFC_Loc210_212_CRC "CRC - Autosar E2E Profile 5";
CM_ SG_ 334 RFC_Loc210_212_AliveCtr "Alive counter - Autosar E2E Profile 5";
CM_ SG_ 334 RFC_Loc210_212_ProtBlockCtr "Protocol-Signal: Block-Counter";
CM_ SG_ 334 RFC_Loc210_RadialDistance "Location radial distance. Represented in conical coordinate system. Same as ISO 23150:2021(E): Position radial distance (A.4.16)";
CM_ SG_ 334 RFC_Loc210_RadialVelocity "Location radial relative velocity ISO 23150:2021(E): Relative velocity {radial distance} (A.4.18)";
CM_ SG_ 334 RFC_Loc210_Elevation "Location elevation angle. Represented in conical coordinate system. Same as ISO 23150:2021(E): Position elevation (A.4.16)";
CM_ SG_ 334 RFC_Loc210_Azimuth "Location azimuth angle. Represented in conical coordinate system. Deviation from ISO 23150:2021(E): Position azimuth (A.4.16). Further details refers to DSP Location Interface definition";
CM_ SG_ 334 RFC_Loc210_DistVelocityCoVnce "Covariance of radial distance and radial velocity";
CM_ SG_ 334 RFC_Loc210_RadialDistanceVnce "Variance of Location radial distance ISO 23150:2021(E): Position radial distance - error (A.4.17)";
CM_ SG_ 334 RFC_Loc210_RadialVelocityVnce "Variance of Location radial relative velocity ISO 23150:2021(E): Relative velocity {radial distance} - error (A.4.19)";
CM_ SG_ 334 RFC_Loc210_ElevationVnce "Variance of Location elevation angle ISO 23150:2021(E): Position elevation - error (A.4.17)";
CM_ SG_ 334 RFC_Loc210_AzimuthVnce "Variance of Location azimuth angle ISO 23150:2021(E): Position azimuth - error (A.4.17)";
CM_ SG_ 334 RFC_Loc210_RadarCrossSection "Radar Cross Section (RCS) estimation ISO 23150:2021(E): Radar cross section (A.4.5)";
CM_ SG_ 334 RFC_Loc210_DistVelocityQuality "Quality of radial distance and velocity resolution processing. Physical range [0..1]";
CM_ SG_ 334 RFC_Loc210_ElevationQuality "Probability for correct signal model (elevation angle). Physical range [0..1]";
CM_ SG_ 334 RFC_Loc210_AzimuthQuality "Probability for correct signal model (azimuth angle). Physical range [0..1]";
CM_ SG_ 334 RFC_Loc210_RSSI "Received Signal Strength Indication (RSSI). This signal is not exactly ISO 23150:2021(E): Signal to noise ratio - detection level (A.4.7), but SNR can be calculated from this signal. Further detail please refer to the DSP Location Interface definition";
CM_ SG_ 334 RFC_Loc210_AzimuthalPartnerId "Id of the azimuthal partner location";
CM_ SG_ 334 RFC_Loc211_RadialDistance "Location radial distance. Represented in conical coordinate system. Same as ISO 23150:2021(E): Position radial distance (A.4.16)";
CM_ SG_ 334 RFC_Loc211_RadialVelocity "Location radial relative velocity ISO 23150:2021(E): Relative velocity {radial distance} (A.4.18)";
CM_ SG_ 334 RFC_Loc211_Elevation "Location elevation angle. Represented in conical coordinate system. Same as ISO 23150:2021(E): Position elevation (A.4.16)";
CM_ SG_ 334 RFC_Loc211_Azimuth "Location azimuth angle. Represented in conical coordinate system. Deviation from ISO 23150:2021(E): Position azimuth (A.4.16). Further details refers to DSP Location Interface definition";
CM_ SG_ 334 RFC_Loc211_DistVelocityCoVnce "Covariance of radial distance and radial velocity";
CM_ SG_ 334 RFC_Loc211_RadialDistanceVnce "Variance of Location radial distance ISO 23150:2021(E): Position radial distance - error (A.4.17)";
CM_ SG_ 334 RFC_Loc211_RadialVelocityVnce "Variance of Location radial relative velocity ISO 23150:2021(E): Relative velocity {radial distance} - error (A.4.19)";
CM_ SG_ 334 RFC_Loc211_ElevationVnce "Variance of Location elevation angle ISO 23150:2021(E): Position elevation - error (A.4.17)";
CM_ SG_ 334 RFC_Loc211_AzimuthVnce "Variance of Location azimuth angle ISO 23150:2021(E): Position azimuth - error (A.4.17)";
CM_ SG_ 334 RFC_Loc211_RadarCrossSection "Radar Cross Section (RCS) estimation ISO 23150:2021(E): Radar cross section (A.4.5)";
CM_ SG_ 334 RFC_Loc211_DistVelocityQuality "Quality of radial distance and velocity resolution processing. Physical range [0..1]";
CM_ SG_ 334 RFC_Loc211_ElevationQuality "Probability for correct signal model (elevation angle). Physical range [0..1]";
CM_ SG_ 334 RFC_Loc211_AzimuthQuality "Probability for correct signal model (azimuth angle). Physical range [0..1]";
CM_ SG_ 334 RFC_Loc211_RSSI "Received Signal Strength Indication (RSSI). This signal is not exactly ISO 23150:2021(E): Signal to noise ratio - detection level (A.4.7), but SNR can be calculated from this signal. Further detail please refer to the DSP Location Interface definition";
CM_ SG_ 334 RFC_Loc211_AzimuthalPartnerId "Id of the azimuthal partner location";
CM_ SG_ 334 RFC_Loc212_RadialDistance "Location radial distance. Represented in conical coordinate system. Same as ISO 23150:2021(E): Position radial distance (A.4.16)";
CM_ SG_ 334 RFC_Loc212_RadialVelocity "Location radial relative velocity ISO 23150:2021(E): Relative velocity {radial distance} (A.4.18)";
CM_ SG_ 334 RFC_Loc212_Elevation "Location elevation angle. Represented in conical coordinate system. Same as ISO 23150:2021(E): Position elevation (A.4.16)";
CM_ SG_ 334 RFC_Loc212_Azimuth "Location azimuth angle. Represented in conical coordinate system. Deviation from ISO 23150:2021(E): Position azimuth (A.4.16). Further details refers to DSP Location Interface definition";
CM_ SG_ 334 RFC_Loc212_DistVelocityCoVnce "Covariance of radial distance and radial velocity";
CM_ SG_ 334 RFC_Loc212_RadialDistanceVnce "Variance of Location radial distance ISO 23150:2021(E): Position radial distance - error (A.4.17)";
CM_ SG_ 334 RFC_Loc212_RadialVelocityVnce "Variance of Location radial relative velocity ISO 23150:2021(E): Relative velocity {radial distance} - error (A.4.19)";
CM_ SG_ 334 RFC_Loc212_ElevationVnce "Variance of Location elevation angle ISO 23150:2021(E): Position elevation - error (A.4.17)";
CM_ SG_ 334 RFC_Loc212_AzimuthVnce "Variance of Location azimuth angle ISO 23150:2021(E): Position azimuth - error (A.4.17)";
CM_ SG_ 334 RFC_Loc212_RadarCrossSection "Radar Cross Section (RCS) estimation ISO 23150:2021(E): Radar cross section (A.4.5)";
CM_ SG_ 334 RFC_Loc212_DistVelocityQuality "Quality of radial distance and velocity resolution processing. Physical range [0..1]";
CM_ SG_ 334 RFC_Loc212_ElevationQuality "Probability for correct signal model (elevation angle). Physical range [0..1]";
CM_ SG_ 334 RFC_Loc212_AzimuthQuality "Probability for correct signal model (azimuth angle). Physical range [0..1]";
CM_ SG_ 334 RFC_Loc212_RSSI "Received Signal Strength Indication (RSSI). This signal is not exactly ISO 23150:2021(E): Signal to noise ratio - detection level (A.4.7), but SNR can be calculated from this signal. Further detail please refer to the DSP Location Interface definition";
CM_ SG_ 334 RFC_Loc212_AzimuthalPartnerId "Id of the azimuthal partner location";
CM_ SG_ 335 RFC_Loc213_215_CRC "CRC - Autosar E2E Profile 5";
CM_ SG_ 335 RFC_Loc213_215_AliveCtr "Alive counter - Autosar E2E Profile 5";
CM_ SG_ 335 RFC_Loc213_215_ProtBlockCtr "Protocol-Signal: Block-Counter";
CM_ SG_ 335 RFC_Loc213_RadialDistance "Location radial distance. Represented in conical coordinate system. Same as ISO 23150:2021(E): Position radial distance (A.4.16)";
CM_ SG_ 335 RFC_Loc213_RadialVelocity "Location radial relative velocity ISO 23150:2021(E): Relative velocity {radial distance} (A.4.18)";
CM_ SG_ 335 RFC_Loc213_Elevation "Location elevation angle. Represented in conical coordinate system. Same as ISO 23150:2021(E): Position elevation (A.4.16)";
CM_ SG_ 335 RFC_Loc213_Azimuth "Location azimuth angle. Represented in conical coordinate system. Deviation from ISO 23150:2021(E): Position azimuth (A.4.16). Further details refers to DSP Location Interface definition";
CM_ SG_ 335 RFC_Loc213_DistVelocityCoVnce "Covariance of radial distance and radial velocity";
CM_ SG_ 335 RFC_Loc213_RadialDistanceVnce "Variance of Location radial distance ISO 23150:2021(E): Position radial distance - error (A.4.17)";
CM_ SG_ 335 RFC_Loc213_RadialVelocityVnce "Variance of Location radial relative velocity ISO 23150:2021(E): Relative velocity {radial distance} - error (A.4.19)";
CM_ SG_ 335 RFC_Loc213_ElevationVnce "Variance of Location elevation angle ISO 23150:2021(E): Position elevation - error (A.4.17)";
CM_ SG_ 335 RFC_Loc213_AzimuthVnce "Variance of Location azimuth angle ISO 23150:2021(E): Position azimuth - error (A.4.17)";
CM_ SG_ 335 RFC_Loc213_RadarCrossSection "Radar Cross Section (RCS) estimation ISO 23150:2021(E): Radar cross section (A.4.5)";
CM_ SG_ 335 RFC_Loc213_DistVelocityQuality "Quality of radial distance and velocity resolution processing. Physical range [0..1]";
CM_ SG_ 335 RFC_Loc213_ElevationQuality "Probability for correct signal model (elevation angle). Physical range [0..1]";
CM_ SG_ 335 RFC_Loc213_AzimuthQuality "Probability for correct signal model (azimuth angle). Physical range [0..1]";
CM_ SG_ 335 RFC_Loc213_RSSI "Received Signal Strength Indication (RSSI). This signal is not exactly ISO 23150:2021(E): Signal to noise ratio - detection level (A.4.7), but SNR can be calculated from this signal. Further detail please refer to the DSP Location Interface definition";
CM_ SG_ 335 RFC_Loc213_AzimuthalPartnerId "Id of the azimuthal partner location";
CM_ SG_ 335 RFC_Loc214_RadialDistance "Location radial distance. Represented in conical coordinate system. Same as ISO 23150:2021(E): Position radial distance (A.4.16)";
CM_ SG_ 335 RFC_Loc214_RadialVelocity "Location radial relative velocity ISO 23150:2021(E): Relative velocity {radial distance} (A.4.18)";
CM_ SG_ 335 RFC_Loc214_Elevation "Location elevation angle. Represented in conical coordinate system. Same as ISO 23150:2021(E): Position elevation (A.4.16)";
CM_ SG_ 335 RFC_Loc214_Azimuth "Location azimuth angle. Represented in conical coordinate system. Deviation from ISO 23150:2021(E): Position azimuth (A.4.16). Further details refers to DSP Location Interface definition";
CM_ SG_ 335 RFC_Loc214_DistVelocityCoVnce "Covariance of radial distance and radial velocity";
CM_ SG_ 335 RFC_Loc214_RadialDistanceVnce "Variance of Location radial distance ISO 23150:2021(E): Position radial distance - error (A.4.17)";
CM_ SG_ 335 RFC_Loc214_RadialVelocityVnce "Variance of Location radial relative velocity ISO 23150:2021(E): Relative velocity {radial distance} - error (A.4.19)";
CM_ SG_ 335 RFC_Loc214_ElevationVnce "Variance of Location elevation angle ISO 23150:2021(E): Position elevation - error (A.4.17)";
CM_ SG_ 335 RFC_Loc214_AzimuthVnce "Variance of Location azimuth angle ISO 23150:2021(E): Position azimuth - error (A.4.17)";
CM_ SG_ 335 RFC_Loc214_RadarCrossSection "Radar Cross Section (RCS) estimation ISO 23150:2021(E): Radar cross section (A.4.5)";
CM_ SG_ 335 RFC_Loc214_DistVelocityQuality "Quality of radial distance and velocity resolution processing. Physical range [0..1]";
CM_ SG_ 335 RFC_Loc214_ElevationQuality "Probability for correct signal model (elevation angle). Physical range [0..1]";
CM_ SG_ 335 RFC_Loc214_AzimuthQuality "Probability for correct signal model (azimuth angle). Physical range [0..1]";
CM_ SG_ 335 RFC_Loc214_RSSI "Received Signal Strength Indication (RSSI). This signal is not exactly ISO 23150:2021(E): Signal to noise ratio - detection level (A.4.7), but SNR can be calculated from this signal. Further detail please refer to the DSP Location Interface definition";
CM_ SG_ 335 RFC_Loc214_AzimuthalPartnerId "Id of the azimuthal partner location";
CM_ SG_ 335 RFC_Loc215_RadialDistance "Location radial distance. Represented in conical coordinate system. Same as ISO 23150:2021(E): Position radial distance (A.4.16)";
CM_ SG_ 335 RFC_Loc215_RadialVelocity "Location radial relative velocity ISO 23150:2021(E): Relative velocity {radial distance} (A.4.18)";
CM_ SG_ 335 RFC_Loc215_Elevation "Location elevation angle. Represented in conical coordinate system. Same as ISO 23150:2021(E): Position elevation (A.4.16)";
CM_ SG_ 335 RFC_Loc215_Azimuth "Location azimuth angle. Represented in conical coordinate system. Deviation from ISO 23150:2021(E): Position azimuth (A.4.16). Further details refers to DSP Location Interface definition";
CM_ SG_ 335 RFC_Loc215_DistVelocityCoVnce "Covariance of radial distance and radial velocity";
CM_ SG_ 335 RFC_Loc215_RadialDistanceVnce "Variance of Location radial distance ISO 23150:2021(E): Position radial distance - error (A.4.17)";
CM_ SG_ 335 RFC_Loc215_RadialVelocityVnce "Variance of Location radial relative velocity ISO 23150:2021(E): Relative velocity {radial distance} - error (A.4.19)";
CM_ SG_ 335 RFC_Loc215_ElevationVnce "Variance of Location elevation angle ISO 23150:2021(E): Position elevation - error (A.4.17)";
CM_ SG_ 335 RFC_Loc215_AzimuthVnce "Variance of Location azimuth angle ISO 23150:2021(E): Position azimuth - error (A.4.17)";
CM_ SG_ 335 RFC_Loc215_RadarCrossSection "Radar Cross Section (RCS) estimation ISO 23150:2021(E): Radar cross section (A.4.5)";
CM_ SG_ 335 RFC_Loc215_DistVelocityQuality "Quality of radial distance and velocity resolution processing. Physical range [0..1]";
CM_ SG_ 335 RFC_Loc215_ElevationQuality "Probability for correct signal model (elevation angle). Physical range [0..1]";
CM_ SG_ 335 RFC_Loc215_AzimuthQuality "Probability for correct signal model (azimuth angle). Physical range [0..1]";
CM_ SG_ 335 RFC_Loc215_RSSI "Received Signal Strength Indication (RSSI). This signal is not exactly ISO 23150:2021(E): Signal to noise ratio - detection level (A.4.7), but SNR can be calculated from this signal. Further detail please refer to the DSP Location Interface definition";
CM_ SG_ 335 RFC_Loc215_AzimuthalPartnerId "Id of the azimuthal partner location";
CM_ SG_ 336 RFC_Loc216_218_CRC "CRC - Autosar E2E Profile 5";
CM_ SG_ 336 RFC_Loc216_218_AliveCtr "Alive counter - Autosar E2E Profile 5";
CM_ SG_ 336 RFC_Loc216_218_ProtBlockCtr "Protocol-Signal: Block-Counter";
CM_ SG_ 336 RFC_Loc216_RadialDistance "Location radial distance. Represented in conical coordinate system. Same as ISO 23150:2021(E): Position radial distance (A.4.16)";
CM_ SG_ 336 RFC_Loc216_RadialVelocity "Location radial relative velocity ISO 23150:2021(E): Relative velocity {radial distance} (A.4.18)";
CM_ SG_ 336 RFC_Loc216_Elevation "Location elevation angle. Represented in conical coordinate system. Same as ISO 23150:2021(E): Position elevation (A.4.16)";
CM_ SG_ 336 RFC_Loc216_Azimuth "Location azimuth angle. Represented in conical coordinate system. Deviation from ISO 23150:2021(E): Position azimuth (A.4.16). Further details refers to DSP Location Interface definition";
CM_ SG_ 336 RFC_Loc216_DistVelocityCoVnce "Covariance of radial distance and radial velocity";
CM_ SG_ 336 RFC_Loc216_RadialDistanceVnce "Variance of Location radial distance ISO 23150:2021(E): Position radial distance - error (A.4.17)";
CM_ SG_ 336 RFC_Loc216_RadialVelocityVnce "Variance of Location radial relative velocity ISO 23150:2021(E): Relative velocity {radial distance} - error (A.4.19)";
CM_ SG_ 336 RFC_Loc216_ElevationVnce "Variance of Location elevation angle ISO 23150:2021(E): Position elevation - error (A.4.17)";
CM_ SG_ 336 RFC_Loc216_AzimuthVnce "Variance of Location azimuth angle ISO 23150:2021(E): Position azimuth - error (A.4.17)";
CM_ SG_ 336 RFC_Loc216_RadarCrossSection "Radar Cross Section (RCS) estimation ISO 23150:2021(E): Radar cross section (A.4.5)";
CM_ SG_ 336 RFC_Loc216_DistVelocityQuality "Quality of radial distance and velocity resolution processing. Physical range [0..1]";
CM_ SG_ 336 RFC_Loc216_ElevationQuality "Probability for correct signal model (elevation angle). Physical range [0..1]";
CM_ SG_ 336 RFC_Loc216_AzimuthQuality "Probability for correct signal model (azimuth angle). Physical range [0..1]";
CM_ SG_ 336 RFC_Loc216_RSSI "Received Signal Strength Indication (RSSI). This signal is not exactly ISO 23150:2021(E): Signal to noise ratio - detection level (A.4.7), but SNR can be calculated from this signal. Further detail please refer to the DSP Location Interface definition";
CM_ SG_ 336 RFC_Loc216_AzimuthalPartnerId "Id of the azimuthal partner location";
CM_ SG_ 336 RFC_Loc217_RadialDistance "Location radial distance. Represented in conical coordinate system. Same as ISO 23150:2021(E): Position radial distance (A.4.16)";
CM_ SG_ 336 RFC_Loc217_RadialVelocity "Location radial relative velocity ISO 23150:2021(E): Relative velocity {radial distance} (A.4.18)";
CM_ SG_ 336 RFC_Loc217_Elevation "Location elevation angle. Represented in conical coordinate system. Same as ISO 23150:2021(E): Position elevation (A.4.16)";
CM_ SG_ 336 RFC_Loc217_Azimuth "Location azimuth angle. Represented in conical coordinate system. Deviation from ISO 23150:2021(E): Position azimuth (A.4.16). Further details refers to DSP Location Interface definition";
CM_ SG_ 336 RFC_Loc217_DistVelocityCoVnce "Covariance of radial distance and radial velocity";
CM_ SG_ 336 RFC_Loc217_RadialDistanceVnce "Variance of Location radial distance ISO 23150:2021(E): Position radial distance - error (A.4.17)";
CM_ SG_ 336 RFC_Loc217_RadialVelocityVnce "Variance of Location radial relative velocity ISO 23150:2021(E): Relative velocity {radial distance} - error (A.4.19)";
CM_ SG_ 336 RFC_Loc217_ElevationVnce "Variance of Location elevation angle ISO 23150:2021(E): Position elevation - error (A.4.17)";
CM_ SG_ 336 RFC_Loc217_AzimuthVnce "Variance of Location azimuth angle ISO 23150:2021(E): Position azimuth - error (A.4.17)";
CM_ SG_ 336 RFC_Loc217_RadarCrossSection "Radar Cross Section (RCS) estimation ISO 23150:2021(E): Radar cross section (A.4.5)";
CM_ SG_ 336 RFC_Loc217_DistVelocityQuality "Quality of radial distance and velocity resolution processing. Physical range [0..1]";
CM_ SG_ 336 RFC_Loc217_ElevationQuality "Probability for correct signal model (elevation angle). Physical range [0..1]";
CM_ SG_ 336 RFC_Loc217_AzimuthQuality "Probability for correct signal model (azimuth angle). Physical range [0..1]";
CM_ SG_ 336 RFC_Loc217_RSSI "Received Signal Strength Indication (RSSI). This signal is not exactly ISO 23150:2021(E): Signal to noise ratio - detection level (A.4.7), but SNR can be calculated from this signal. Further detail please refer to the DSP Location Interface definition";
CM_ SG_ 336 RFC_Loc217_AzimuthalPartnerId "Id of the azimuthal partner location";
CM_ SG_ 336 RFC_Loc218_RadialDistance "Location radial distance. Represented in conical coordinate system. Same as ISO 23150:2021(E): Position radial distance (A.4.16)";
CM_ SG_ 336 RFC_Loc218_RadialVelocity "Location radial relative velocity ISO 23150:2021(E): Relative velocity {radial distance} (A.4.18)";
CM_ SG_ 336 RFC_Loc218_Elevation "Location elevation angle. Represented in conical coordinate system. Same as ISO 23150:2021(E): Position elevation (A.4.16)";
CM_ SG_ 336 RFC_Loc218_Azimuth "Location azimuth angle. Represented in conical coordinate system. Deviation from ISO 23150:2021(E): Position azimuth (A.4.16). Further details refers to DSP Location Interface definition";
CM_ SG_ 336 RFC_Loc218_DistVelocityCoVnce "Covariance of radial distance and radial velocity";
CM_ SG_ 336 RFC_Loc218_RadialDistanceVnce "Variance of Location radial distance ISO 23150:2021(E): Position radial distance - error (A.4.17)";
CM_ SG_ 336 RFC_Loc218_RadialVelocityVnce "Variance of Location radial relative velocity ISO 23150:2021(E): Relative velocity {radial distance} - error (A.4.19)";
CM_ SG_ 336 RFC_Loc218_ElevationVnce "Variance of Location elevation angle ISO 23150:2021(E): Position elevation - error (A.4.17)";
CM_ SG_ 336 RFC_Loc218_AzimuthVnce "Variance of Location azimuth angle ISO 23150:2021(E): Position azimuth - error (A.4.17)";
CM_ SG_ 336 RFC_Loc218_RadarCrossSection "Radar Cross Section (RCS) estimation ISO 23150:2021(E): Radar cross section (A.4.5)";
CM_ SG_ 336 RFC_Loc218_DistVelocityQuality "Quality of radial distance and velocity resolution processing. Physical range [0..1]";
CM_ SG_ 336 RFC_Loc218_ElevationQuality "Probability for correct signal model (elevation angle). Physical range [0..1]";
CM_ SG_ 336 RFC_Loc218_AzimuthQuality "Probability for correct signal model (azimuth angle). Physical range [0..1]";
CM_ SG_ 336 RFC_Loc218_RSSI "Received Signal Strength Indication (RSSI). This signal is not exactly ISO 23150:2021(E): Signal to noise ratio - detection level (A.4.7), but SNR can be calculated from this signal. Further detail please refer to the DSP Location Interface definition";
CM_ SG_ 336 RFC_Loc218_AzimuthalPartnerId "Id of the azimuthal partner location";
CM_ SG_ 337 RFC_Loc219_221_CRC "CRC - Autosar E2E Profile 5";
CM_ SG_ 337 RFC_Loc219_221_AliveCtr "Alive counter - Autosar E2E Profile 5";
CM_ SG_ 337 RFC_Loc219_221_ProtBlockCtr "Protocol-Signal: Block-Counter";
CM_ SG_ 337 RFC_Loc219_RadialDistance "Location radial distance. Represented in conical coordinate system. Same as ISO 23150:2021(E): Position radial distance (A.4.16)";
CM_ SG_ 337 RFC_Loc219_RadialVelocity "Location radial relative velocity ISO 23150:2021(E): Relative velocity {radial distance} (A.4.18)";
CM_ SG_ 337 RFC_Loc219_Elevation "Location elevation angle. Represented in conical coordinate system. Same as ISO 23150:2021(E): Position elevation (A.4.16)";
CM_ SG_ 337 RFC_Loc219_Azimuth "Location azimuth angle. Represented in conical coordinate system. Deviation from ISO 23150:2021(E): Position azimuth (A.4.16). Further details refers to DSP Location Interface definition";
CM_ SG_ 337 RFC_Loc219_DistVelocityCoVnce "Covariance of radial distance and radial velocity";
CM_ SG_ 337 RFC_Loc219_RadialDistanceVnce "Variance of Location radial distance ISO 23150:2021(E): Position radial distance - error (A.4.17)";
CM_ SG_ 337 RFC_Loc219_RadialVelocityVnce "Variance of Location radial relative velocity ISO 23150:2021(E): Relative velocity {radial distance} - error (A.4.19)";
CM_ SG_ 337 RFC_Loc219_ElevationVnce "Variance of Location elevation angle ISO 23150:2021(E): Position elevation - error (A.4.17)";
CM_ SG_ 337 RFC_Loc219_AzimuthVnce "Variance of Location azimuth angle ISO 23150:2021(E): Position azimuth - error (A.4.17)";
CM_ SG_ 337 RFC_Loc219_RadarCrossSection "Radar Cross Section (RCS) estimation ISO 23150:2021(E): Radar cross section (A.4.5)";
CM_ SG_ 337 RFC_Loc219_DistVelocityQuality "Quality of radial distance and velocity resolution processing. Physical range [0..1]";
CM_ SG_ 337 RFC_Loc219_ElevationQuality "Probability for correct signal model (elevation angle). Physical range [0..1]";
CM_ SG_ 337 RFC_Loc219_AzimuthQuality "Probability for correct signal model (azimuth angle). Physical range [0..1]";
CM_ SG_ 337 RFC_Loc219_RSSI "Received Signal Strength Indication (RSSI). This signal is not exactly ISO 23150:2021(E): Signal to noise ratio - detection level (A.4.7), but SNR can be calculated from this signal. Further detail please refer to the DSP Location Interface definition";
CM_ SG_ 337 RFC_Loc219_AzimuthalPartnerId "Id of the azimuthal partner location";
CM_ SG_ 337 RFC_Loc220_RadialDistance "Location radial distance. Represented in conical coordinate system. Same as ISO 23150:2021(E): Position radial distance (A.4.16)";
CM_ SG_ 337 RFC_Loc220_RadialVelocity "Location radial relative velocity ISO 23150:2021(E): Relative velocity {radial distance} (A.4.18)";
CM_ SG_ 337 RFC_Loc220_Elevation "Location elevation angle. Represented in conical coordinate system. Same as ISO 23150:2021(E): Position elevation (A.4.16)";
CM_ SG_ 337 RFC_Loc220_Azimuth "Location azimuth angle. Represented in conical coordinate system. Deviation from ISO 23150:2021(E): Position azimuth (A.4.16). Further details refers to DSP Location Interface definition";
CM_ SG_ 337 RFC_Loc220_DistVelocityCoVnce "Covariance of radial distance and radial velocity";
CM_ SG_ 337 RFC_Loc220_RadialDistanceVnce "Variance of Location radial distance ISO 23150:2021(E): Position radial distance - error (A.4.17)";
CM_ SG_ 337 RFC_Loc220_RadialVelocityVnce "Variance of Location radial relative velocity ISO 23150:2021(E): Relative velocity {radial distance} - error (A.4.19)";
CM_ SG_ 337 RFC_Loc220_ElevationVnce "Variance of Location elevation angle ISO 23150:2021(E): Position elevation - error (A.4.17)";
CM_ SG_ 337 RFC_Loc220_AzimuthVnce "Variance of Location azimuth angle ISO 23150:2021(E): Position azimuth - error (A.4.17)";
CM_ SG_ 337 RFC_Loc220_RadarCrossSection "Radar Cross Section (RCS) estimation ISO 23150:2021(E): Radar cross section (A.4.5)";
CM_ SG_ 337 RFC_Loc220_DistVelocityQuality "Quality of radial distance and velocity resolution processing. Physical range [0..1]";
CM_ SG_ 337 RFC_Loc220_ElevationQuality "Probability for correct signal model (elevation angle). Physical range [0..1]";
CM_ SG_ 337 RFC_Loc220_AzimuthQuality "Probability for correct signal model (azimuth angle). Physical range [0..1]";
CM_ SG_ 337 RFC_Loc220_RSSI "Received Signal Strength Indication (RSSI). This signal is not exactly ISO 23150:2021(E): Signal to noise ratio - detection level (A.4.7), but SNR can be calculated from this signal. Further detail please refer to the DSP Location Interface definition";
CM_ SG_ 337 RFC_Loc220_AzimuthalPartnerId "Id of the azimuthal partner location";
CM_ SG_ 337 RFC_Loc221_RadialDistance "Location radial distance. Represented in conical coordinate system. Same as ISO 23150:2021(E): Position radial distance (A.4.16)";
CM_ SG_ 337 RFC_Loc221_RadialVelocity "Location radial relative velocity ISO 23150:2021(E): Relative velocity {radial distance} (A.4.18)";
CM_ SG_ 337 RFC_Loc221_Elevation "Location elevation angle. Represented in conical coordinate system. Same as ISO 23150:2021(E): Position elevation (A.4.16)";
CM_ SG_ 337 RFC_Loc221_Azimuth "Location azimuth angle. Represented in conical coordinate system. Deviation from ISO 23150:2021(E): Position azimuth (A.4.16). Further details refers to DSP Location Interface definition";
CM_ SG_ 337 RFC_Loc221_DistVelocityCoVnce "Covariance of radial distance and radial velocity";
CM_ SG_ 337 RFC_Loc221_RadialDistanceVnce "Variance of Location radial distance ISO 23150:2021(E): Position radial distance - error (A.4.17)";
CM_ SG_ 337 RFC_Loc221_RadialVelocityVnce "Variance of Location radial relative velocity ISO 23150:2021(E): Relative velocity {radial distance} - error (A.4.19)";
CM_ SG_ 337 RFC_Loc221_ElevationVnce "Variance of Location elevation angle ISO 23150:2021(E): Position elevation - error (A.4.17)";
CM_ SG_ 337 RFC_Loc221_AzimuthVnce "Variance of Location azimuth angle ISO 23150:2021(E): Position azimuth - error (A.4.17)";
CM_ SG_ 337 RFC_Loc221_RadarCrossSection "Radar Cross Section (RCS) estimation ISO 23150:2021(E): Radar cross section (A.4.5)";
CM_ SG_ 337 RFC_Loc221_DistVelocityQuality "Quality of radial distance and velocity resolution processing. Physical range [0..1]";
CM_ SG_ 337 RFC_Loc221_ElevationQuality "Probability for correct signal model (elevation angle). Physical range [0..1]";
CM_ SG_ 337 RFC_Loc221_AzimuthQuality "Probability for correct signal model (azimuth angle). Physical range [0..1]";
CM_ SG_ 337 RFC_Loc221_RSSI "Received Signal Strength Indication (RSSI). This signal is not exactly ISO 23150:2021(E): Signal to noise ratio - detection level (A.4.7), but SNR can be calculated from this signal. Further detail please refer to the DSP Location Interface definition";
CM_ SG_ 337 RFC_Loc221_AzimuthalPartnerId "Id of the azimuthal partner location";
CM_ SG_ 338 RFC_Loc222_224_CRC "CRC - Autosar E2E Profile 5";
CM_ SG_ 338 RFC_Loc222_224_AliveCtr "Alive counter - Autosar E2E Profile 5";
CM_ SG_ 338 RFC_Loc222_224_ProtBlockCtr "Protocol-Signal: Block-Counter";
CM_ SG_ 338 RFC_Loc222_RadialDistance "Location radial distance. Represented in conical coordinate system. Same as ISO 23150:2021(E): Position radial distance (A.4.16)";
CM_ SG_ 338 RFC_Loc222_RadialVelocity "Location radial relative velocity ISO 23150:2021(E): Relative velocity {radial distance} (A.4.18)";
CM_ SG_ 338 RFC_Loc222_Elevation "Location elevation angle. Represented in conical coordinate system. Same as ISO 23150:2021(E): Position elevation (A.4.16)";
CM_ SG_ 338 RFC_Loc222_Azimuth "Location azimuth angle. Represented in conical coordinate system. Deviation from ISO 23150:2021(E): Position azimuth (A.4.16). Further details refers to DSP Location Interface definition";
CM_ SG_ 338 RFC_Loc222_DistVelocityCoVnce "Covariance of radial distance and radial velocity";
CM_ SG_ 338 RFC_Loc222_RadialDistanceVnce "Variance of Location radial distance ISO 23150:2021(E): Position radial distance - error (A.4.17)";
CM_ SG_ 338 RFC_Loc222_RadialVelocityVnce "Variance of Location radial relative velocity ISO 23150:2021(E): Relative velocity {radial distance} - error (A.4.19)";
CM_ SG_ 338 RFC_Loc222_ElevationVnce "Variance of Location elevation angle ISO 23150:2021(E): Position elevation - error (A.4.17)";
CM_ SG_ 338 RFC_Loc222_AzimuthVnce "Variance of Location azimuth angle ISO 23150:2021(E): Position azimuth - error (A.4.17)";
CM_ SG_ 338 RFC_Loc222_RadarCrossSection "Radar Cross Section (RCS) estimation ISO 23150:2021(E): Radar cross section (A.4.5)";
CM_ SG_ 338 RFC_Loc222_DistVelocityQuality "Quality of radial distance and velocity resolution processing. Physical range [0..1]";
CM_ SG_ 338 RFC_Loc222_ElevationQuality "Probability for correct signal model (elevation angle). Physical range [0..1]";
CM_ SG_ 338 RFC_Loc222_AzimuthQuality "Probability for correct signal model (azimuth angle). Physical range [0..1]";
CM_ SG_ 338 RFC_Loc222_RSSI "Received Signal Strength Indication (RSSI). This signal is not exactly ISO 23150:2021(E): Signal to noise ratio - detection level (A.4.7), but SNR can be calculated from this signal. Further detail please refer to the DSP Location Interface definition";
CM_ SG_ 338 RFC_Loc222_AzimuthalPartnerId "Id of the azimuthal partner location";
CM_ SG_ 338 RFC_Loc223_RadialDistance "Location radial distance. Represented in conical coordinate system. Same as ISO 23150:2021(E): Position radial distance (A.4.16)";
CM_ SG_ 338 RFC_Loc223_RadialVelocity "Location radial relative velocity ISO 23150:2021(E): Relative velocity {radial distance} (A.4.18)";
CM_ SG_ 338 RFC_Loc223_Elevation "Location elevation angle. Represented in conical coordinate system. Same as ISO 23150:2021(E): Position elevation (A.4.16)";
CM_ SG_ 338 RFC_Loc223_Azimuth "Location azimuth angle. Represented in conical coordinate system. Deviation from ISO 23150:2021(E): Position azimuth (A.4.16). Further details refers to DSP Location Interface definition";
CM_ SG_ 338 RFC_Loc223_DistVelocityCoVnce "Covariance of radial distance and radial velocity";
CM_ SG_ 338 RFC_Loc223_RadialDistanceVnce "Variance of Location radial distance ISO 23150:2021(E): Position radial distance - error (A.4.17)";
CM_ SG_ 338 RFC_Loc223_RadialVelocityVnce "Variance of Location radial relative velocity ISO 23150:2021(E): Relative velocity {radial distance} - error (A.4.19)";
CM_ SG_ 338 RFC_Loc223_ElevationVnce "Variance of Location elevation angle ISO 23150:2021(E): Position elevation - error (A.4.17)";
CM_ SG_ 338 RFC_Loc223_AzimuthVnce "Variance of Location azimuth angle ISO 23150:2021(E): Position azimuth - error (A.4.17)";
CM_ SG_ 338 RFC_Loc223_RadarCrossSection "Radar Cross Section (RCS) estimation ISO 23150:2021(E): Radar cross section (A.4.5)";
CM_ SG_ 338 RFC_Loc223_DistVelocityQuality "Quality of radial distance and velocity resolution processing. Physical range [0..1]";
CM_ SG_ 338 RFC_Loc223_ElevationQuality "Probability for correct signal model (elevation angle). Physical range [0..1]";
CM_ SG_ 338 RFC_Loc223_AzimuthQuality "Probability for correct signal model (azimuth angle). Physical range [0..1]";
CM_ SG_ 338 RFC_Loc223_RSSI "Received Signal Strength Indication (RSSI). This signal is not exactly ISO 23150:2021(E): Signal to noise ratio - detection level (A.4.7), but SNR can be calculated from this signal. Further detail please refer to the DSP Location Interface definition";
CM_ SG_ 338 RFC_Loc223_AzimuthalPartnerId "Id of the azimuthal partner location";
CM_ SG_ 338 RFC_Loc224_RadialDistance "Location radial distance. Represented in conical coordinate system. Same as ISO 23150:2021(E): Position radial distance (A.4.16)";
CM_ SG_ 338 RFC_Loc224_RadialVelocity "Location radial relative velocity ISO 23150:2021(E): Relative velocity {radial distance} (A.4.18)";
CM_ SG_ 338 RFC_Loc224_Elevation "Location elevation angle. Represented in conical coordinate system. Same as ISO 23150:2021(E): Position elevation (A.4.16)";
CM_ SG_ 338 RFC_Loc224_Azimuth "Location azimuth angle. Represented in conical coordinate system. Deviation from ISO 23150:2021(E): Position azimuth (A.4.16). Further details refers to DSP Location Interface definition";
CM_ SG_ 338 RFC_Loc224_DistVelocityCoVnce "Covariance of radial distance and radial velocity";
CM_ SG_ 338 RFC_Loc224_RadialDistanceVnce "Variance of Location radial distance ISO 23150:2021(E): Position radial distance - error (A.4.17)";
CM_ SG_ 338 RFC_Loc224_RadialVelocityVnce "Variance of Location radial relative velocity ISO 23150:2021(E): Relative velocity {radial distance} - error (A.4.19)";
CM_ SG_ 338 RFC_Loc224_ElevationVnce "Variance of Location elevation angle ISO 23150:2021(E): Position elevation - error (A.4.17)";
CM_ SG_ 338 RFC_Loc224_AzimuthVnce "Variance of Location azimuth angle ISO 23150:2021(E): Position azimuth - error (A.4.17)";
CM_ SG_ 338 RFC_Loc224_RadarCrossSection "Radar Cross Section (RCS) estimation ISO 23150:2021(E): Radar cross section (A.4.5)";
CM_ SG_ 338 RFC_Loc224_DistVelocityQuality "Quality of radial distance and velocity resolution processing. Physical range [0..1]";
CM_ SG_ 338 RFC_Loc224_ElevationQuality "Probability for correct signal model (elevation angle). Physical range [0..1]";
CM_ SG_ 338 RFC_Loc224_AzimuthQuality "Probability for correct signal model (azimuth angle). Physical range [0..1]";
CM_ SG_ 338 RFC_Loc224_RSSI "Received Signal Strength Indication (RSSI). This signal is not exactly ISO 23150:2021(E): Signal to noise ratio - detection level (A.4.7), but SNR can be calculated from this signal. Further detail please refer to the DSP Location Interface definition";
CM_ SG_ 338 RFC_Loc224_AzimuthalPartnerId "Id of the azimuthal partner location";
CM_ SG_ 339 RFC_Loc225_227_CRC "CRC - Autosar E2E Profile 5";
CM_ SG_ 339 RFC_Loc225_227_AliveCtr "Alive counter - Autosar E2E Profile 5";
CM_ SG_ 339 RFC_Loc225_227_ProtBlockCtr "Protocol-Signal: Block-Counter";
CM_ SG_ 339 RFC_Loc225_RadialDistance "Location radial distance. Represented in conical coordinate system. Same as ISO 23150:2021(E): Position radial distance (A.4.16)";
CM_ SG_ 339 RFC_Loc225_RadialVelocity "Location radial relative velocity ISO 23150:2021(E): Relative velocity {radial distance} (A.4.18)";
CM_ SG_ 339 RFC_Loc225_Elevation "Location elevation angle. Represented in conical coordinate system. Same as ISO 23150:2021(E): Position elevation (A.4.16)";
CM_ SG_ 339 RFC_Loc225_Azimuth "Location azimuth angle. Represented in conical coordinate system. Deviation from ISO 23150:2021(E): Position azimuth (A.4.16). Further details refers to DSP Location Interface definition";
CM_ SG_ 339 RFC_Loc225_DistVelocityCoVnce "Covariance of radial distance and radial velocity";
CM_ SG_ 339 RFC_Loc225_RadialDistanceVnce "Variance of Location radial distance ISO 23150:2021(E): Position radial distance - error (A.4.17)";
CM_ SG_ 339 RFC_Loc225_RadialVelocityVnce "Variance of Location radial relative velocity ISO 23150:2021(E): Relative velocity {radial distance} - error (A.4.19)";
CM_ SG_ 339 RFC_Loc225_ElevationVnce "Variance of Location elevation angle ISO 23150:2021(E): Position elevation - error (A.4.17)";
CM_ SG_ 339 RFC_Loc225_AzimuthVnce "Variance of Location azimuth angle ISO 23150:2021(E): Position azimuth - error (A.4.17)";
CM_ SG_ 339 RFC_Loc225_RadarCrossSection "Radar Cross Section (RCS) estimation ISO 23150:2021(E): Radar cross section (A.4.5)";
CM_ SG_ 339 RFC_Loc225_DistVelocityQuality "Quality of radial distance and velocity resolution processing. Physical range [0..1]";
CM_ SG_ 339 RFC_Loc225_ElevationQuality "Probability for correct signal model (elevation angle). Physical range [0..1]";
CM_ SG_ 339 RFC_Loc225_AzimuthQuality "Probability for correct signal model (azimuth angle). Physical range [0..1]";
CM_ SG_ 339 RFC_Loc225_RSSI "Received Signal Strength Indication (RSSI). This signal is not exactly ISO 23150:2021(E): Signal to noise ratio - detection level (A.4.7), but SNR can be calculated from this signal. Further detail please refer to the DSP Location Interface definition";
CM_ SG_ 339 RFC_Loc225_AzimuthalPartnerId "Id of the azimuthal partner location";
CM_ SG_ 339 RFC_Loc226_RadialDistance "Location radial distance. Represented in conical coordinate system. Same as ISO 23150:2021(E): Position radial distance (A.4.16)";
CM_ SG_ 339 RFC_Loc226_RadialVelocity "Location radial relative velocity ISO 23150:2021(E): Relative velocity {radial distance} (A.4.18)";
CM_ SG_ 339 RFC_Loc226_Elevation "Location elevation angle. Represented in conical coordinate system. Same as ISO 23150:2021(E): Position elevation (A.4.16)";
CM_ SG_ 339 RFC_Loc226_Azimuth "Location azimuth angle. Represented in conical coordinate system. Deviation from ISO 23150:2021(E): Position azimuth (A.4.16). Further details refers to DSP Location Interface definition";
CM_ SG_ 339 RFC_Loc226_DistVelocityCoVnce "Covariance of radial distance and radial velocity";
CM_ SG_ 339 RFC_Loc226_RadialDistanceVnce "Variance of Location radial distance ISO 23150:2021(E): Position radial distance - error (A.4.17)";
CM_ SG_ 339 RFC_Loc226_RadialVelocityVnce "Variance of Location radial relative velocity ISO 23150:2021(E): Relative velocity {radial distance} - error (A.4.19)";
CM_ SG_ 339 RFC_Loc226_ElevationVnce "Variance of Location elevation angle ISO 23150:2021(E): Position elevation - error (A.4.17)";
CM_ SG_ 339 RFC_Loc226_AzimuthVnce "Variance of Location azimuth angle ISO 23150:2021(E): Position azimuth - error (A.4.17)";
CM_ SG_ 339 RFC_Loc226_RadarCrossSection "Radar Cross Section (RCS) estimation ISO 23150:2021(E): Radar cross section (A.4.5)";
CM_ SG_ 339 RFC_Loc226_DistVelocityQuality "Quality of radial distance and velocity resolution processing. Physical range [0..1]";
CM_ SG_ 339 RFC_Loc226_ElevationQuality "Probability for correct signal model (elevation angle). Physical range [0..1]";
CM_ SG_ 339 RFC_Loc226_AzimuthQuality "Probability for correct signal model (azimuth angle). Physical range [0..1]";
CM_ SG_ 339 RFC_Loc226_RSSI "Received Signal Strength Indication (RSSI). This signal is not exactly ISO 23150:2021(E): Signal to noise ratio - detection level (A.4.7), but SNR can be calculated from this signal. Further detail please refer to the DSP Location Interface definition";
CM_ SG_ 339 RFC_Loc226_AzimuthalPartnerId "Id of the azimuthal partner location";
CM_ SG_ 339 RFC_Loc227_RadialDistance "Location radial distance. Represented in conical coordinate system. Same as ISO 23150:2021(E): Position radial distance (A.4.16)";
CM_ SG_ 339 RFC_Loc227_RadialVelocity "Location radial relative velocity ISO 23150:2021(E): Relative velocity {radial distance} (A.4.18)";
CM_ SG_ 339 RFC_Loc227_Elevation "Location elevation angle. Represented in conical coordinate system. Same as ISO 23150:2021(E): Position elevation (A.4.16)";
CM_ SG_ 339 RFC_Loc227_Azimuth "Location azimuth angle. Represented in conical coordinate system. Deviation from ISO 23150:2021(E): Position azimuth (A.4.16). Further details refers to DSP Location Interface definition";
CM_ SG_ 339 RFC_Loc227_DistVelocityCoVnce "Covariance of radial distance and radial velocity";
CM_ SG_ 339 RFC_Loc227_RadialDistanceVnce "Variance of Location radial distance ISO 23150:2021(E): Position radial distance - error (A.4.17)";
CM_ SG_ 339 RFC_Loc227_RadialVelocityVnce "Variance of Location radial relative velocity ISO 23150:2021(E): Relative velocity {radial distance} - error (A.4.19)";
CM_ SG_ 339 RFC_Loc227_ElevationVnce "Variance of Location elevation angle ISO 23150:2021(E): Position elevation - error (A.4.17)";
CM_ SG_ 339 RFC_Loc227_AzimuthVnce "Variance of Location azimuth angle ISO 23150:2021(E): Position azimuth - error (A.4.17)";
CM_ SG_ 339 RFC_Loc227_RadarCrossSection "Radar Cross Section (RCS) estimation ISO 23150:2021(E): Radar cross section (A.4.5)";
CM_ SG_ 339 RFC_Loc227_DistVelocityQuality "Quality of radial distance and velocity resolution processing. Physical range [0..1]";
CM_ SG_ 339 RFC_Loc227_ElevationQuality "Probability for correct signal model (elevation angle). Physical range [0..1]";
CM_ SG_ 339 RFC_Loc227_AzimuthQuality "Probability for correct signal model (azimuth angle). Physical range [0..1]";
CM_ SG_ 339 RFC_Loc227_RSSI "Received Signal Strength Indication (RSSI). This signal is not exactly ISO 23150:2021(E): Signal to noise ratio - detection level (A.4.7), but SNR can be calculated from this signal. Further detail please refer to the DSP Location Interface definition";
CM_ SG_ 339 RFC_Loc227_AzimuthalPartnerId "Id of the azimuthal partner location";
CM_ SG_ 340 RFC_Loc228_230_CRC "CRC - Autosar E2E Profile 5";
CM_ SG_ 340 RFC_Loc228_230_AliveCtr "Alive counter - Autosar E2E Profile 5";
CM_ SG_ 340 RFC_Loc228_230_ProtBlockCtr "Protocol-Signal: Block-Counter";
CM_ SG_ 340 RFC_Loc228_RadialDistance "Location radial distance. Represented in conical coordinate system. Same as ISO 23150:2021(E): Position radial distance (A.4.16)";
CM_ SG_ 340 RFC_Loc228_RadialVelocity "Location radial relative velocity ISO 23150:2021(E): Relative velocity {radial distance} (A.4.18)";
CM_ SG_ 340 RFC_Loc228_Elevation "Location elevation angle. Represented in conical coordinate system. Same as ISO 23150:2021(E): Position elevation (A.4.16)";
CM_ SG_ 340 RFC_Loc228_Azimuth "Location azimuth angle. Represented in conical coordinate system. Deviation from ISO 23150:2021(E): Position azimuth (A.4.16). Further details refers to DSP Location Interface definition";
CM_ SG_ 340 RFC_Loc228_DistVelocityCoVnce "Covariance of radial distance and radial velocity";
CM_ SG_ 340 RFC_Loc228_RadialDistanceVnce "Variance of Location radial distance ISO 23150:2021(E): Position radial distance - error (A.4.17)";
CM_ SG_ 340 RFC_Loc228_RadialVelocityVnce "Variance of Location radial relative velocity ISO 23150:2021(E): Relative velocity {radial distance} - error (A.4.19)";
CM_ SG_ 340 RFC_Loc228_ElevationVnce "Variance of Location elevation angle ISO 23150:2021(E): Position elevation - error (A.4.17)";
CM_ SG_ 340 RFC_Loc228_AzimuthVnce "Variance of Location azimuth angle ISO 23150:2021(E): Position azimuth - error (A.4.17)";
CM_ SG_ 340 RFC_Loc228_RadarCrossSection "Radar Cross Section (RCS) estimation ISO 23150:2021(E): Radar cross section (A.4.5)";
CM_ SG_ 340 RFC_Loc228_DistVelocityQuality "Quality of radial distance and velocity resolution processing. Physical range [0..1]";
CM_ SG_ 340 RFC_Loc228_ElevationQuality "Probability for correct signal model (elevation angle). Physical range [0..1]";
CM_ SG_ 340 RFC_Loc228_AzimuthQuality "Probability for correct signal model (azimuth angle). Physical range [0..1]";
CM_ SG_ 340 RFC_Loc228_RSSI "Received Signal Strength Indication (RSSI). This signal is not exactly ISO 23150:2021(E): Signal to noise ratio - detection level (A.4.7), but SNR can be calculated from this signal. Further detail please refer to the DSP Location Interface definition";
CM_ SG_ 340 RFC_Loc228_AzimuthalPartnerId "Id of the azimuthal partner location";
CM_ SG_ 340 RFC_Loc229_RadialDistance "Location radial distance. Represented in conical coordinate system. Same as ISO 23150:2021(E): Position radial distance (A.4.16)";
CM_ SG_ 340 RFC_Loc229_RadialVelocity "Location radial relative velocity ISO 23150:2021(E): Relative velocity {radial distance} (A.4.18)";
CM_ SG_ 340 RFC_Loc229_Elevation "Location elevation angle. Represented in conical coordinate system. Same as ISO 23150:2021(E): Position elevation (A.4.16)";
CM_ SG_ 340 RFC_Loc229_Azimuth "Location azimuth angle. Represented in conical coordinate system. Deviation from ISO 23150:2021(E): Position azimuth (A.4.16). Further details refers to DSP Location Interface definition";
CM_ SG_ 340 RFC_Loc229_DistVelocityCoVnce "Covariance of radial distance and radial velocity";
CM_ SG_ 340 RFC_Loc229_RadialDistanceVnce "Variance of Location radial distance ISO 23150:2021(E): Position radial distance - error (A.4.17)";
CM_ SG_ 340 RFC_Loc229_RadialVelocityVnce "Variance of Location radial relative velocity ISO 23150:2021(E): Relative velocity {radial distance} - error (A.4.19)";
CM_ SG_ 340 RFC_Loc229_ElevationVnce "Variance of Location elevation angle ISO 23150:2021(E): Position elevation - error (A.4.17)";
CM_ SG_ 340 RFC_Loc229_AzimuthVnce "Variance of Location azimuth angle ISO 23150:2021(E): Position azimuth - error (A.4.17)";
CM_ SG_ 340 RFC_Loc229_RadarCrossSection "Radar Cross Section (RCS) estimation ISO 23150:2021(E): Radar cross section (A.4.5)";
CM_ SG_ 340 RFC_Loc229_DistVelocityQuality "Quality of radial distance and velocity resolution processing. Physical range [0..1]";
CM_ SG_ 340 RFC_Loc229_ElevationQuality "Probability for correct signal model (elevation angle). Physical range [0..1]";
CM_ SG_ 340 RFC_Loc229_AzimuthQuality "Probability for correct signal model (azimuth angle). Physical range [0..1]";
CM_ SG_ 340 RFC_Loc229_RSSI "Received Signal Strength Indication (RSSI). This signal is not exactly ISO 23150:2021(E): Signal to noise ratio - detection level (A.4.7), but SNR can be calculated from this signal. Further detail please refer to the DSP Location Interface definition";
CM_ SG_ 340 RFC_Loc229_AzimuthalPartnerId "Id of the azimuthal partner location";
CM_ SG_ 340 RFC_Loc230_RadialDistance "Location radial distance. Represented in conical coordinate system. Same as ISO 23150:2021(E): Position radial distance (A.4.16)";
CM_ SG_ 340 RFC_Loc230_RadialVelocity "Location radial relative velocity ISO 23150:2021(E): Relative velocity {radial distance} (A.4.18)";
CM_ SG_ 340 RFC_Loc230_Elevation "Location elevation angle. Represented in conical coordinate system. Same as ISO 23150:2021(E): Position elevation (A.4.16)";
CM_ SG_ 340 RFC_Loc230_Azimuth "Location azimuth angle. Represented in conical coordinate system. Deviation from ISO 23150:2021(E): Position azimuth (A.4.16). Further details refers to DSP Location Interface definition";
CM_ SG_ 340 RFC_Loc230_DistVelocityCoVnce "Covariance of radial distance and radial velocity";
CM_ SG_ 340 RFC_Loc230_RadialDistanceVnce "Variance of Location radial distance ISO 23150:2021(E): Position radial distance - error (A.4.17)";
CM_ SG_ 340 RFC_Loc230_RadialVelocityVnce "Variance of Location radial relative velocity ISO 23150:2021(E): Relative velocity {radial distance} - error (A.4.19)";
CM_ SG_ 340 RFC_Loc230_ElevationVnce "Variance of Location elevation angle ISO 23150:2021(E): Position elevation - error (A.4.17)";
CM_ SG_ 340 RFC_Loc230_AzimuthVnce "Variance of Location azimuth angle ISO 23150:2021(E): Position azimuth - error (A.4.17)";
CM_ SG_ 340 RFC_Loc230_RadarCrossSection "Radar Cross Section (RCS) estimation ISO 23150:2021(E): Radar cross section (A.4.5)";
CM_ SG_ 340 RFC_Loc230_DistVelocityQuality "Quality of radial distance and velocity resolution processing. Physical range [0..1]";
CM_ SG_ 340 RFC_Loc230_ElevationQuality "Probability for correct signal model (elevation angle). Physical range [0..1]";
CM_ SG_ 340 RFC_Loc230_AzimuthQuality "Probability for correct signal model (azimuth angle). Physical range [0..1]";
CM_ SG_ 340 RFC_Loc230_RSSI "Received Signal Strength Indication (RSSI). This signal is not exactly ISO 23150:2021(E): Signal to noise ratio - detection level (A.4.7), but SNR can be calculated from this signal. Further detail please refer to the DSP Location Interface definition";
CM_ SG_ 340 RFC_Loc230_AzimuthalPartnerId "Id of the azimuthal partner location";
BA_DEF_ BO_  "CANFD_BRS" ENUM  "0","1";
BA_DEF_ BO_  "GenMsgCycleTime" INT 0 65535;
BA_DEF_ BO_  "GenMsgILSupport" ENUM  "No","Yes";
BA_DEF_ BO_  "GenMsgSendType" ENUM  "Cyclic","Event","reserved","reserved","reserved","reserved","reserved","IfActive","NoMsgSendType","reserved","reserved","reserved";
BA_DEF_ BO_  "VFrameFormat" ENUM  "StandardCAN","ExtendedCAN","reserved","reserved","reserved","reserved","reserved","reserved","reserved","reserved","reserved","reserved","reserved","reserved","StandardCAN_FD","ExtendedCAN_FD";
BA_DEF_ BO_  "E2Eprofile" STRING ;
BA_DEF_ BO_  "DataID" HEX 0 655535;
BA_DEF_ SG_  "GenSigSendType" ENUM  "Cyclic","OnWrite","OnWriteWithRepetition","OnChange","OnChangeWithRepetition","IfActive","IfActiveWithRepetition","NoSigSendType","OnChangeAndIfActive","OnChangeAndIfActiveWithRepetition";
BA_DEF_ SG_  "GenSigStartValue" HEX 0 2147483648;
BA_DEF_DEF_  "CANFD_BRS" "1";
BA_DEF_DEF_  "GenMsgCycleTime" 0;
BA_DEF_DEF_  "GenMsgILSupport" "Yes";
BA_DEF_DEF_  "GenMsgSendType" "Cyclic";
BA_DEF_DEF_  "VFrameFormat" "";
BA_DEF_DEF_  "E2Eprofile" "None";
BA_DEF_DEF_  "DataID" 0;
BA_DEF_DEF_  "GenSigSendType" "NoSigSendType";
BA_DEF_DEF_  "GenSigStartValue" 0;
BA_ "GenMsgSendType" BO_ 326 1;
BA_ "E2Eprofile" BO_ 326 "AUTOSAR Profile 5";
BA_ "DataID" BO_ 326 8518;
BA_ "VFrameFormat" BO_ 326 14;
BA_ "GenMsgSendType" BO_ 327 1;
BA_ "E2Eprofile" BO_ 327 "AUTOSAR Profile 5";
BA_ "DataID" BO_ 327 8519;
BA_ "VFrameFormat" BO_ 327 14;
BA_ "GenMsgSendType" BO_ 328 1;
BA_ "E2Eprofile" BO_ 328 "AUTOSAR Profile 5";
BA_ "DataID" BO_ 328 8520;
BA_ "VFrameFormat" BO_ 328 14;
BA_ "GenMsgSendType" BO_ 329 1;
BA_ "E2Eprofile" BO_ 329 "AUTOSAR Profile 5";
BA_ "DataID" BO_ 329 8521;
BA_ "VFrameFormat" BO_ 329 14;
BA_ "GenMsgSendType" BO_ 330 1;
BA_ "E2Eprofile" BO_ 330 "AUTOSAR Profile 5";
BA_ "DataID" BO_ 330 8522;
BA_ "VFrameFormat" BO_ 330 14;
BA_ "GenMsgSendType" BO_ 331 1;
BA_ "E2Eprofile" BO_ 331 "AUTOSAR Profile 5";
BA_ "DataID" BO_ 331 8523;
BA_ "VFrameFormat" BO_ 331 14;
BA_ "GenMsgSendType" BO_ 332 1;
BA_ "E2Eprofile" BO_ 332 "AUTOSAR Profile 5";
BA_ "DataID" BO_ 332 8524;
BA_ "VFrameFormat" BO_ 332 14;
BA_ "GenMsgSendType" BO_ 333 1;
BA_ "E2Eprofile" BO_ 333 "AUTOSAR Profile 5";
BA_ "DataID" BO_ 333 8525;
BA_ "VFrameFormat" BO_ 333 14;
BA_ "GenMsgSendType" BO_ 334 1;
BA_ "E2Eprofile" BO_ 334 "AUTOSAR Profile 5";
BA_ "DataID" BO_ 334 8526;
BA_ "VFrameFormat" BO_ 334 14;
BA_ "GenMsgSendType" BO_ 335 1;
BA_ "E2Eprofile" BO_ 335 "AUTOSAR Profile 5";
BA_ "DataID" BO_ 335 8527;
BA_ "VFrameFormat" BO_ 335 14;
BA_ "GenMsgSendType" BO_ 336 1;
BA_ "E2Eprofile" BO_ 336 "AUTOSAR Profile 5";
BA_ "DataID" BO_ 336 8528;
BA_ "VFrameFormat" BO_ 336 14;
BA_ "GenMsgSendType" BO_ 337 1;
BA_ "E2Eprofile" BO_ 337 "AUTOSAR Profile 5";
BA_ "DataID" BO_ 337 8529;
BA_ "VFrameFormat" BO_ 337 14;
BA_ "GenMsgSendType" BO_ 338 1;
BA_ "E2Eprofile" BO_ 338 "AUTOSAR Profile 5";
BA_ "DataID" BO_ 338 8530;
BA_ "VFrameFormat" BO_ 338 14;
BA_ "GenMsgSendType" BO_ 339 1;
BA_ "E2Eprofile" BO_ 339 "AUTOSAR Profile 5";
BA_ "DataID" BO_ 339 8531;
BA_ "VFrameFormat" BO_ 339 14;
BA_ "GenMsgSendType" BO_ 340 1;
BA_ "E2Eprofile" BO_ 340 "AUTOSAR Profile 5";
BA_ "DataID" BO_ 340 8532;
BA_ "VFrameFormat" BO_ 340 14;
BA_ "GenSigStartValue" SG_ 326 RFC_Loc186_RadialVelocity 16384;
BA_ "GenSigStartValue" SG_ 326 RFC_Loc186_Elevation 512;
BA_ "GenSigStartValue" SG_ 326 RFC_Loc186_Azimuth 1024;
BA_ "GenSigStartValue" SG_ 326 RFC_Loc186_DistVelocityCoVnce 1024;
BA_ "GenSigStartValue" SG_ 326 RFC_Loc186_RadarCrossSection 512;
BA_ "GenSigStartValue" SG_ 326 RFC_Loc187_RadialVelocity 16384;
BA_ "GenSigStartValue" SG_ 326 RFC_Loc187_Elevation 512;
BA_ "GenSigStartValue" SG_ 326 RFC_Loc187_Azimuth 1024;
BA_ "GenSigStartValue" SG_ 326 RFC_Loc187_DistVelocityCoVnce 1024;
BA_ "GenSigStartValue" SG_ 326 RFC_Loc187_RadarCrossSection 512;
BA_ "GenSigStartValue" SG_ 326 RFC_Loc188_RadialVelocity 16384;
BA_ "GenSigStartValue" SG_ 326 RFC_Loc188_Elevation 512;
BA_ "GenSigStartValue" SG_ 326 RFC_Loc188_Azimuth 1024;
BA_ "GenSigStartValue" SG_ 326 RFC_Loc188_DistVelocityCoVnce 1024;
BA_ "GenSigStartValue" SG_ 326 RFC_Loc188_RadarCrossSection 512;
BA_ "GenSigStartValue" SG_ 327 RFC_Loc189_RadialVelocity 16384;
BA_ "GenSigStartValue" SG_ 327 RFC_Loc189_Elevation 512;
BA_ "GenSigStartValue" SG_ 327 RFC_Loc189_Azimuth 1024;
BA_ "GenSigStartValue" SG_ 327 RFC_Loc189_DistVelocityCoVnce 1024;
BA_ "GenSigStartValue" SG_ 327 RFC_Loc189_RadarCrossSection 512;
BA_ "GenSigStartValue" SG_ 327 RFC_Loc190_RadialVelocity 16384;
BA_ "GenSigStartValue" SG_ 327 RFC_Loc190_Elevation 512;
BA_ "GenSigStartValue" SG_ 327 RFC_Loc190_Azimuth 1024;
BA_ "GenSigStartValue" SG_ 327 RFC_Loc190_DistVelocityCoVnce 1024;
BA_ "GenSigStartValue" SG_ 327 RFC_Loc190_RadarCrossSection 512;
BA_ "GenSigStartValue" SG_ 327 RFC_Loc191_RadialVelocity 16384;
BA_ "GenSigStartValue" SG_ 327 RFC_Loc191_Elevation 512;
BA_ "GenSigStartValue" SG_ 327 RFC_Loc191_Azimuth 1024;
BA_ "GenSigStartValue" SG_ 327 RFC_Loc191_DistVelocityCoVnce 1024;
BA_ "GenSigStartValue" SG_ 327 RFC_Loc191_RadarCrossSection 512;
BA_ "GenSigStartValue" SG_ 328 RFC_Loc192_RadialVelocity 16384;
BA_ "GenSigStartValue" SG_ 328 RFC_Loc192_Elevation 512;
BA_ "GenSigStartValue" SG_ 328 RFC_Loc192_Azimuth 1024;
BA_ "GenSigStartValue" SG_ 328 RFC_Loc192_DistVelocityCoVnce 1024;
BA_ "GenSigStartValue" SG_ 328 RFC_Loc192_RadarCrossSection 512;
BA_ "GenSigStartValue" SG_ 328 RFC_Loc193_RadialVelocity 16384;
BA_ "GenSigStartValue" SG_ 328 RFC_Loc193_Elevation 512;
BA_ "GenSigStartValue" SG_ 328 RFC_Loc193_Azimuth 1024;
BA_ "GenSigStartValue" SG_ 328 RFC_Loc193_DistVelocityCoVnce 1024;
BA_ "GenSigStartValue" SG_ 328 RFC_Loc193_RadarCrossSection 512;
BA_ "GenSigStartValue" SG_ 328 RFC_Loc194_RadialVelocity 16384;
BA_ "GenSigStartValue" SG_ 328 RFC_Loc194_Elevation 512;
BA_ "GenSigStartValue" SG_ 328 RFC_Loc194_Azimuth 1024;
BA_ "GenSigStartValue" SG_ 328 RFC_Loc194_DistVelocityCoVnce 1024;
BA_ "GenSigStartValue" SG_ 328 RFC_Loc194_RadarCrossSection 512;
BA_ "GenSigStartValue" SG_ 329 RFC_Loc195_RadialVelocity 16384;
BA_ "GenSigStartValue" SG_ 329 RFC_Loc195_Elevation 512;
BA_ "GenSigStartValue" SG_ 329 RFC_Loc195_Azimuth 1024;
BA_ "GenSigStartValue" SG_ 329 RFC_Loc195_DistVelocityCoVnce 1024;
BA_ "GenSigStartValue" SG_ 329 RFC_Loc195_RadarCrossSection 512;
BA_ "GenSigStartValue" SG_ 329 RFC_Loc196_RadialVelocity 16384;
BA_ "GenSigStartValue" SG_ 329 RFC_Loc196_Elevation 512;
BA_ "GenSigStartValue" SG_ 329 RFC_Loc196_Azimuth 1024;
BA_ "GenSigStartValue" SG_ 329 RFC_Loc196_DistVelocityCoVnce 1024;
BA_ "GenSigStartValue" SG_ 329 RFC_Loc196_RadarCrossSection 512;
BA_ "GenSigStartValue" SG_ 329 RFC_Loc197_RadialVelocity 16384;
BA_ "GenSigStartValue" SG_ 329 RFC_Loc197_Elevation 512;
BA_ "GenSigStartValue" SG_ 329 RFC_Loc197_Azimuth 1024;
BA_ "GenSigStartValue" SG_ 329 RFC_Loc197_DistVelocityCoVnce 1024;
BA_ "GenSigStartValue" SG_ 329 RFC_Loc197_RadarCrossSection 512;
BA_ "GenSigStartValue" SG_ 330 RFC_Loc198_RadialVelocity 16384;
BA_ "GenSigStartValue" SG_ 330 RFC_Loc198_Elevation 512;
BA_ "GenSigStartValue" SG_ 330 RFC_Loc198_Azimuth 1024;
BA_ "GenSigStartValue" SG_ 330 RFC_Loc198_DistVelocityCoVnce 1024;
BA_ "GenSigStartValue" SG_ 330 RFC_Loc198_RadarCrossSection 512;
BA_ "GenSigStartValue" SG_ 330 RFC_Loc199_RadialVelocity 16384;
BA_ "GenSigStartValue" SG_ 330 RFC_Loc199_Elevation 512;
BA_ "GenSigStartValue" SG_ 330 RFC_Loc199_Azimuth 1024;
BA_ "GenSigStartValue" SG_ 330 RFC_Loc199_DistVelocityCoVnce 1024;
BA_ "GenSigStartValue" SG_ 330 RFC_Loc199_RadarCrossSection 512;
BA_ "GenSigStartValue" SG_ 330 RFC_Loc200_RadialVelocity 16384;
BA_ "GenSigStartValue" SG_ 330 RFC_Loc200_Elevation 512;
BA_ "GenSigStartValue" SG_ 330 RFC_Loc200_Azimuth 1024;
BA_ "GenSigStartValue" SG_ 330 RFC_Loc200_DistVelocityCoVnce 1024;
BA_ "GenSigStartValue" SG_ 330 RFC_Loc200_RadarCrossSection 512;
BA_ "GenSigStartValue" SG_ 331 RFC_Loc201_RadialVelocity 16384;
BA_ "GenSigStartValue" SG_ 331 RFC_Loc201_Elevation 512;
BA_ "GenSigStartValue" SG_ 331 RFC_Loc201_Azimuth 1024;
BA_ "GenSigStartValue" SG_ 331 RFC_Loc201_DistVelocityCoVnce 1024;
BA_ "GenSigStartValue" SG_ 331 RFC_Loc201_RadarCrossSection 512;
BA_ "GenSigStartValue" SG_ 331 RFC_Loc202_RadialVelocity 16384;
BA_ "GenSigStartValue" SG_ 331 RFC_Loc202_Elevation 512;
BA_ "GenSigStartValue" SG_ 331 RFC_Loc202_Azimuth 1024;
BA_ "GenSigStartValue" SG_ 331 RFC_Loc202_DistVelocityCoVnce 1024;
BA_ "GenSigStartValue" SG_ 331 RFC_Loc202_RadarCrossSection 512;
BA_ "GenSigStartValue" SG_ 331 RFC_Loc203_RadialVelocity 16384;
BA_ "GenSigStartValue" SG_ 331 RFC_Loc203_Elevation 512;
BA_ "GenSigStartValue" SG_ 331 RFC_Loc203_Azimuth 1024;
BA_ "GenSigStartValue" SG_ 331 RFC_Loc203_DistVelocityCoVnce 1024;
BA_ "GenSigStartValue" SG_ 331 RFC_Loc203_RadarCrossSection 512;
BA_ "GenSigStartValue" SG_ 332 RFC_Loc204_RadialVelocity 16384;
BA_ "GenSigStartValue" SG_ 332 RFC_Loc204_Elevation 512;
BA_ "GenSigStartValue" SG_ 332 RFC_Loc204_Azimuth 1024;
BA_ "GenSigStartValue" SG_ 332 RFC_Loc204_DistVelocityCoVnce 1024;
BA_ "GenSigStartValue" SG_ 332 RFC_Loc204_RadarCrossSection 512;
BA_ "GenSigStartValue" SG_ 332 RFC_Loc205_RadialVelocity 16384;
BA_ "GenSigStartValue" SG_ 332 RFC_Loc205_Elevation 512;
BA_ "GenSigStartValue" SG_ 332 RFC_Loc205_Azimuth 1024;
BA_ "GenSigStartValue" SG_ 332 RFC_Loc205_DistVelocityCoVnce 1024;
BA_ "GenSigStartValue" SG_ 332 RFC_Loc205_RadarCrossSection 512;
BA_ "GenSigStartValue" SG_ 332 RFC_Loc206_RadialVelocity 16384;
BA_ "GenSigStartValue" SG_ 332 RFC_Loc206_Elevation 512;
BA_ "GenSigStartValue" SG_ 332 RFC_Loc206_Azimuth 1024;
BA_ "GenSigStartValue" SG_ 332 RFC_Loc206_DistVelocityCoVnce 1024;
BA_ "GenSigStartValue" SG_ 332 RFC_Loc206_RadarCrossSection 512;
BA_ "GenSigStartValue" SG_ 333 RFC_Loc207_RadialVelocity 16384;
BA_ "GenSigStartValue" SG_ 333 RFC_Loc207_Elevation 512;
BA_ "GenSigStartValue" SG_ 333 RFC_Loc207_Azimuth 1024;
BA_ "GenSigStartValue" SG_ 333 RFC_Loc207_DistVelocityCoVnce 1024;
BA_ "GenSigStartValue" SG_ 333 RFC_Loc207_RadarCrossSection 512;
BA_ "GenSigStartValue" SG_ 333 RFC_Loc208_RadialVelocity 16384;
BA_ "GenSigStartValue" SG_ 333 RFC_Loc208_Elevation 512;
BA_ "GenSigStartValue" SG_ 333 RFC_Loc208_Azimuth 1024;
BA_ "GenSigStartValue" SG_ 333 RFC_Loc208_DistVelocityCoVnce 1024;
BA_ "GenSigStartValue" SG_ 333 RFC_Loc208_RadarCrossSection 512;
BA_ "GenSigStartValue" SG_ 333 RFC_Loc209_RadialVelocity 16384;
BA_ "GenSigStartValue" SG_ 333 RFC_Loc209_Elevation 512;
BA_ "GenSigStartValue" SG_ 333 RFC_Loc209_Azimuth 1024;
BA_ "GenSigStartValue" SG_ 333 RFC_Loc209_DistVelocityCoVnce 1024;
BA_ "GenSigStartValue" SG_ 333 RFC_Loc209_RadarCrossSection 512;
BA_ "GenSigStartValue" SG_ 334 RFC_Loc210_RadialVelocity 16384;
BA_ "GenSigStartValue" SG_ 334 RFC_Loc210_Elevation 512;
BA_ "GenSigStartValue" SG_ 334 RFC_Loc210_Azimuth 1024;
BA_ "GenSigStartValue" SG_ 334 RFC_Loc210_DistVelocityCoVnce 1024;
BA_ "GenSigStartValue" SG_ 334 RFC_Loc210_RadarCrossSection 512;
BA_ "GenSigStartValue" SG_ 334 RFC_Loc211_RadialVelocity 16384;
BA_ "GenSigStartValue" SG_ 334 RFC_Loc211_Elevation 512;
BA_ "GenSigStartValue" SG_ 334 RFC_Loc211_Azimuth 1024;
BA_ "GenSigStartValue" SG_ 334 RFC_Loc211_DistVelocityCoVnce 1024;
BA_ "GenSigStartValue" SG_ 334 RFC_Loc211_RadarCrossSection 512;
BA_ "GenSigStartValue" SG_ 334 RFC_Loc212_RadialVelocity 16384;
BA_ "GenSigStartValue" SG_ 334 RFC_Loc212_Elevation 512;
BA_ "GenSigStartValue" SG_ 334 RFC_Loc212_Azimuth 1024;
BA_ "GenSigStartValue" SG_ 334 RFC_Loc212_DistVelocityCoVnce 1024;
BA_ "GenSigStartValue" SG_ 334 RFC_Loc212_RadarCrossSection 512;
BA_ "GenSigStartValue" SG_ 335 RFC_Loc213_RadialVelocity 16384;
BA_ "GenSigStartValue" SG_ 335 RFC_Loc213_Elevation 512;
BA_ "GenSigStartValue" SG_ 335 RFC_Loc213_Azimuth 1024;
BA_ "GenSigStartValue" SG_ 335 RFC_Loc213_DistVelocityCoVnce 1024;
BA_ "GenSigStartValue" SG_ 335 RFC_Loc213_RadarCrossSection 512;
BA_ "GenSigStartValue" SG_ 335 RFC_Loc214_RadialVelocity 16384;
BA_ "GenSigStartValue" SG_ 335 RFC_Loc214_Elevation 512;
BA_ "GenSigStartValue" SG_ 335 RFC_Loc214_Azimuth 1024;
BA_ "GenSigStartValue" SG_ 335 RFC_Loc214_DistVelocityCoVnce 1024;
BA_ "GenSigStartValue" SG_ 335 RFC_Loc214_RadarCrossSection 512;
BA_ "GenSigStartValue" SG_ 335 RFC_Loc215_RadialVelocity 16384;
BA_ "GenSigStartValue" SG_ 335 RFC_Loc215_Elevation 512;
BA_ "GenSigStartValue" SG_ 335 RFC_Loc215_Azimuth 1024;
BA_ "GenSigStartValue" SG_ 335 RFC_Loc215_DistVelocityCoVnce 1024;
BA_ "GenSigStartValue" SG_ 335 RFC_Loc215_RadarCrossSection 512;
BA_ "GenSigStartValue" SG_ 336 RFC_Loc216_RadialVelocity 16384;
BA_ "GenSigStartValue" SG_ 336 RFC_Loc216_Elevation 512;
BA_ "GenSigStartValue" SG_ 336 RFC_Loc216_Azimuth 1024;
BA_ "GenSigStartValue" SG_ 336 RFC_Loc216_DistVelocityCoVnce 1024;
BA_ "GenSigStartValue" SG_ 336 RFC_Loc216_RadarCrossSection 512;
BA_ "GenSigStartValue" SG_ 336 RFC_Loc217_RadialVelocity 16384;
BA_ "GenSigStartValue" SG_ 336 RFC_Loc217_Elevation 512;
BA_ "GenSigStartValue" SG_ 336 RFC_Loc217_Azimuth 1024;
BA_ "GenSigStartValue" SG_ 336 RFC_Loc217_DistVelocityCoVnce 1024;
BA_ "GenSigStartValue" SG_ 336 RFC_Loc217_RadarCrossSection 512;
BA_ "GenSigStartValue" SG_ 336 RFC_Loc218_RadialVelocity 16384;
BA_ "GenSigStartValue" SG_ 336 RFC_Loc218_Elevation 512;
BA_ "GenSigStartValue" SG_ 336 RFC_Loc218_Azimuth 1024;
BA_ "GenSigStartValue" SG_ 336 RFC_Loc218_DistVelocityCoVnce 1024;
BA_ "GenSigStartValue" SG_ 336 RFC_Loc218_RadarCrossSection 512;
BA_ "GenSigStartValue" SG_ 337 RFC_Loc219_RadialVelocity 16384;
BA_ "GenSigStartValue" SG_ 337 RFC_Loc219_Elevation 512;
BA_ "GenSigStartValue" SG_ 337 RFC_Loc219_Azimuth 1024;
BA_ "GenSigStartValue" SG_ 337 RFC_Loc219_DistVelocityCoVnce 1024;
BA_ "GenSigStartValue" SG_ 337 RFC_Loc219_RadarCrossSection 512;
BA_ "GenSigStartValue" SG_ 337 RFC_Loc220_RadialVelocity 16384;
BA_ "GenSigStartValue" SG_ 337 RFC_Loc220_Elevation 512;
BA_ "GenSigStartValue" SG_ 337 RFC_Loc220_Azimuth 1024;
BA_ "GenSigStartValue" SG_ 337 RFC_Loc220_DistVelocityCoVnce 1024;
BA_ "GenSigStartValue" SG_ 337 RFC_Loc220_RadarCrossSection 512;
BA_ "GenSigStartValue" SG_ 337 RFC_Loc221_RadialVelocity 16384;
BA_ "GenSigStartValue" SG_ 337 RFC_Loc221_Elevation 512;
BA_ "GenSigStartValue" SG_ 337 RFC_Loc221_Azimuth 1024;
BA_ "GenSigStartValue" SG_ 337 RFC_Loc221_DistVelocityCoVnce 1024;
BA_ "GenSigStartValue" SG_ 337 RFC_Loc221_RadarCrossSection 512;
BA_ "GenSigStartValue" SG_ 338 RFC_Loc222_RadialVelocity 16384;
BA_ "GenSigStartValue" SG_ 338 RFC_Loc222_Elevation 512;
BA_ "GenSigStartValue" SG_ 338 RFC_Loc222_Azimuth 1024;
BA_ "GenSigStartValue" SG_ 338 RFC_Loc222_DistVelocityCoVnce 1024;
BA_ "GenSigStartValue" SG_ 338 RFC_Loc222_RadarCrossSection 512;
BA_ "GenSigStartValue" SG_ 338 RFC_Loc223_RadialVelocity 16384;
BA_ "GenSigStartValue" SG_ 338 RFC_Loc223_Elevation 512;
BA_ "GenSigStartValue" SG_ 338 RFC_Loc223_Azimuth 1024;
BA_ "GenSigStartValue" SG_ 338 RFC_Loc223_DistVelocityCoVnce 1024;
BA_ "GenSigStartValue" SG_ 338 RFC_Loc223_RadarCrossSection 512;
BA_ "GenSigStartValue" SG_ 338 RFC_Loc224_RadialVelocity 16384;
BA_ "GenSigStartValue" SG_ 338 RFC_Loc224_Elevation 512;
BA_ "GenSigStartValue" SG_ 338 RFC_Loc224_Azimuth 1024;
BA_ "GenSigStartValue" SG_ 338 RFC_Loc224_DistVelocityCoVnce 1024;
BA_ "GenSigStartValue" SG_ 338 RFC_Loc224_RadarCrossSection 512;
BA_ "GenSigStartValue" SG_ 339 RFC_Loc225_RadialVelocity 16384;
BA_ "GenSigStartValue" SG_ 339 RFC_Loc225_Elevation 512;
BA_ "GenSigStartValue" SG_ 339 RFC_Loc225_Azimuth 1024;
BA_ "GenSigStartValue" SG_ 339 RFC_Loc225_DistVelocityCoVnce 1024;
BA_ "GenSigStartValue" SG_ 339 RFC_Loc225_RadarCrossSection 512;
BA_ "GenSigStartValue" SG_ 339 RFC_Loc226_RadialVelocity 16384;
BA_ "GenSigStartValue" SG_ 339 RFC_Loc226_Elevation 512;
BA_ "GenSigStartValue" SG_ 339 RFC_Loc226_Azimuth 1024;
BA_ "GenSigStartValue" SG_ 339 RFC_Loc226_DistVelocityCoVnce 1024;
BA_ "GenSigStartValue" SG_ 339 RFC_Loc226_RadarCrossSection 512;
BA_ "GenSigStartValue" SG_ 339 RFC_Loc227_RadialVelocity 16384;
BA_ "GenSigStartValue" SG_ 339 RFC_Loc227_Elevation 512;
BA_ "GenSigStartValue" SG_ 339 RFC_Loc227_Azimuth 1024;
BA_ "GenSigStartValue" SG_ 339 RFC_Loc227_DistVelocityCoVnce 1024;
BA_ "GenSigStartValue" SG_ 339 RFC_Loc227_RadarCrossSection 512;
BA_ "GenSigStartValue" SG_ 340 RFC_Loc228_RadialVelocity 16384;
BA_ "GenSigStartValue" SG_ 340 RFC_Loc228_Elevation 512;
BA_ "GenSigStartValue" SG_ 340 RFC_Loc228_Azimuth 1024;
BA_ "GenSigStartValue" SG_ 340 RFC_Loc228_DistVelocityCoVnce 1024;
BA_ "GenSigStartValue" SG_ 340 RFC_Loc228_RadarCrossSection 512;
BA_ "GenSigStartValue" SG_ 340 RFC_Loc229_RadialVelocity 16384;
BA_ "GenSigStartValue" SG_ 340 RFC_Loc229_Elevation 512;
BA_ "GenSigStartValue" SG_ 340 RFC_Loc229_Azimuth 1024;
BA_ "GenSigStartValue" SG_ 340 RFC_Loc229_DistVelocityCoVnce 1024;
BA_ "GenSigStartValue" SG_ 340 RFC_Loc229_RadarCrossSection 512;
BA_ "GenSigStartValue" SG_ 340 RFC_Loc230_RadialVelocity 16384;
BA_ "GenSigStartValue" SG_ 340 RFC_Loc230_Elevation 512;
BA_ "GenSigStartValue" SG_ 340 RFC_Loc230_Azimuth 1024;
BA_ "GenSigStartValue" SG_ 340 RFC_Loc230_DistVelocityCoVnce 1024;
BA_ "GenSigStartValue" SG_ 340 RFC_Loc230_RadarCrossSection 512;
SIG_GROUP_ 326 SG_RFC_Location_186_188 1 : RFC_Loc186_188_CRC RFC_Loc186_188_AliveCtr RFC_Loc186_188_ProtBlockCtr RFC_Loc186_RadialDistance RFC_Loc186_RadialVelocity RFC_Loc186_Elevation RFC_Loc186_Azimuth RFC_Loc186_DistVelocityCoVnce RFC_Loc186_RadialDistanceVnce RFC_Loc186_RadialVelocityVnce RFC_Loc186_ElevationVnce RFC_Loc186_AzimuthVnce RFC_Loc186_RadarCrossSection RFC_Loc186_DistVelocityQuality RFC_Loc186_ElevationQuality RFC_Loc186_AzimuthQuality RFC_Loc186_RSSI RFC_Loc186_AzimuthalPartnerId RFC_Loc187_RadialDistance RFC_Loc187_RadialVelocity RFC_Loc187_Elevation RFC_Loc187_Azimuth RFC_Loc187_DistVelocityCoVnce RFC_Loc187_RadialDistanceVnce RFC_Loc187_RadialVelocityVnce RFC_Loc187_ElevationVnce RFC_Loc187_AzimuthVnce RFC_Loc187_RadarCrossSection RFC_Loc187_DistVelocityQuality RFC_Loc187_ElevationQuality RFC_Loc187_AzimuthQuality RFC_Loc187_RSSI RFC_Loc187_AzimuthalPartnerId RFC_Loc188_RadialDistance RFC_Loc188_RadialVelocity RFC_Loc188_Elevation RFC_Loc188_Azimuth RFC_Loc188_DistVelocityCoVnce RFC_Loc188_RadialDistanceVnce RFC_Loc188_RadialVelocityVnce RFC_Loc188_ElevationVnce RFC_Loc188_AzimuthVnce RFC_Loc188_RadarCrossSection RFC_Loc188_DistVelocityQuality RFC_Loc188_ElevationQuality RFC_Loc188_AzimuthQuality RFC_Loc188_RSSI RFC_Loc188_AzimuthalPartnerId;
SIG_GROUP_ 327 SG_RFC_Location_189_191 1 : RFC_Loc189_191_CRC RFC_Loc189_191_AliveCtr RFC_Loc189_191_ProtBlockCtr RFC_Loc189_RadialDistance RFC_Loc189_RadialVelocity RFC_Loc189_Elevation RFC_Loc189_Azimuth RFC_Loc189_DistVelocityCoVnce RFC_Loc189_RadialDistanceVnce RFC_Loc189_RadialVelocityVnce RFC_Loc189_ElevationVnce RFC_Loc189_AzimuthVnce RFC_Loc189_RadarCrossSection RFC_Loc189_DistVelocityQuality RFC_Loc189_ElevationQuality RFC_Loc189_AzimuthQuality RFC_Loc189_RSSI RFC_Loc189_AzimuthalPartnerId RFC_Loc190_RadialDistance RFC_Loc190_RadialVelocity RFC_Loc190_Elevation RFC_Loc190_Azimuth RFC_Loc190_DistVelocityCoVnce RFC_Loc190_RadialDistanceVnce RFC_Loc190_RadialVelocityVnce RFC_Loc190_ElevationVnce RFC_Loc190_AzimuthVnce RFC_Loc190_RadarCrossSection RFC_Loc190_DistVelocityQuality RFC_Loc190_ElevationQuality RFC_Loc190_AzimuthQuality RFC_Loc190_RSSI RFC_Loc190_AzimuthalPartnerId RFC_Loc191_RadialDistance RFC_Loc191_RadialVelocity RFC_Loc191_Elevation RFC_Loc191_Azimuth RFC_Loc191_DistVelocityCoVnce RFC_Loc191_RadialDistanceVnce RFC_Loc191_RadialVelocityVnce RFC_Loc191_ElevationVnce RFC_Loc191_AzimuthVnce RFC_Loc191_RadarCrossSection RFC_Loc191_DistVelocityQuality RFC_Loc191_ElevationQuality RFC_Loc191_AzimuthQuality RFC_Loc191_RSSI RFC_Loc191_AzimuthalPartnerId;
SIG_GROUP_ 328 SG_RFC_Location_192_194 1 : RFC_Loc192_194_CRC RFC_Loc192_194_AliveCtr RFC_Loc192_194_ProtBlockCtr RFC_Loc192_RadialDistance RFC_Loc192_RadialVelocity RFC_Loc192_Elevation RFC_Loc192_Azimuth RFC_Loc192_DistVelocityCoVnce RFC_Loc192_RadialDistanceVnce RFC_Loc192_RadialVelocityVnce RFC_Loc192_ElevationVnce RFC_Loc192_AzimuthVnce RFC_Loc192_RadarCrossSection RFC_Loc192_DistVelocityQuality RFC_Loc192_ElevationQuality RFC_Loc192_AzimuthQuality RFC_Loc192_RSSI RFC_Loc192_AzimuthalPartnerId RFC_Loc193_RadialDistance RFC_Loc193_RadialVelocity RFC_Loc193_Elevation RFC_Loc193_Azimuth RFC_Loc193_DistVelocityCoVnce RFC_Loc193_RadialDistanceVnce RFC_Loc193_RadialVelocityVnce RFC_Loc193_ElevationVnce RFC_Loc193_AzimuthVnce RFC_Loc193_RadarCrossSection RFC_Loc193_DistVelocityQuality RFC_Loc193_ElevationQuality RFC_Loc193_AzimuthQuality RFC_Loc193_RSSI RFC_Loc193_AzimuthalPartnerId RFC_Loc194_RadialDistance RFC_Loc194_RadialVelocity RFC_Loc194_Elevation RFC_Loc194_Azimuth RFC_Loc194_DistVelocityCoVnce RFC_Loc194_RadialDistanceVnce RFC_Loc194_RadialVelocityVnce RFC_Loc194_ElevationVnce RFC_Loc194_AzimuthVnce RFC_Loc194_RadarCrossSection RFC_Loc194_DistVelocityQuality RFC_Loc194_ElevationQuality RFC_Loc194_AzimuthQuality RFC_Loc194_RSSI RFC_Loc194_AzimuthalPartnerId;
SIG_GROUP_ 329 SG_RFC_Location_195_197 1 : RFC_Loc195_197_CRC RFC_Loc195_197_AliveCtr RFC_Loc195_197_ProtBlockCtr RFC_Loc195_RadialDistance RFC_Loc195_RadialVelocity RFC_Loc195_Elevation RFC_Loc195_Azimuth RFC_Loc195_DistVelocityCoVnce RFC_Loc195_RadialDistanceVnce RFC_Loc195_RadialVelocityVnce RFC_Loc195_ElevationVnce RFC_Loc195_AzimuthVnce RFC_Loc195_RadarCrossSection RFC_Loc195_DistVelocityQuality RFC_Loc195_ElevationQuality RFC_Loc195_AzimuthQuality RFC_Loc195_RSSI RFC_Loc195_AzimuthalPartnerId RFC_Loc196_RadialDistance RFC_Loc196_RadialVelocity RFC_Loc196_Elevation RFC_Loc196_Azimuth RFC_Loc196_DistVelocityCoVnce RFC_Loc196_RadialDistanceVnce RFC_Loc196_RadialVelocityVnce RFC_Loc196_ElevationVnce RFC_Loc196_AzimuthVnce RFC_Loc196_RadarCrossSection RFC_Loc196_DistVelocityQuality RFC_Loc196_ElevationQuality RFC_Loc196_AzimuthQuality RFC_Loc196_RSSI RFC_Loc196_AzimuthalPartnerId RFC_Loc197_RadialDistance RFC_Loc197_RadialVelocity RFC_Loc197_Elevation RFC_Loc197_Azimuth RFC_Loc197_DistVelocityCoVnce RFC_Loc197_RadialDistanceVnce RFC_Loc197_RadialVelocityVnce RFC_Loc197_ElevationVnce RFC_Loc197_AzimuthVnce RFC_Loc197_RadarCrossSection RFC_Loc197_DistVelocityQuality RFC_Loc197_ElevationQuality RFC_Loc197_AzimuthQuality RFC_Loc197_RSSI RFC_Loc197_AzimuthalPartnerId;
SIG_GROUP_ 330 SG_RFC_Location_198_200 1 : RFC_Loc198_200_CRC RFC_Loc198_200_AliveCtr RFC_Loc198_200_ProtBlockCtr RFC_Loc198_RadialDistance RFC_Loc198_RadialVelocity RFC_Loc198_Elevation RFC_Loc198_Azimuth RFC_Loc198_DistVelocityCoVnce RFC_Loc198_RadialDistanceVnce RFC_Loc198_RadialVelocityVnce RFC_Loc198_ElevationVnce RFC_Loc198_AzimuthVnce RFC_Loc198_RadarCrossSection RFC_Loc198_DistVelocityQuality RFC_Loc198_ElevationQuality RFC_Loc198_AzimuthQuality RFC_Loc198_RSSI RFC_Loc198_AzimuthalPartnerId RFC_Loc199_RadialDistance RFC_Loc199_RadialVelocity RFC_Loc199_Elevation RFC_Loc199_Azimuth RFC_Loc199_DistVelocityCoVnce RFC_Loc199_RadialDistanceVnce RFC_Loc199_RadialVelocityVnce RFC_Loc199_ElevationVnce RFC_Loc199_AzimuthVnce RFC_Loc199_RadarCrossSection RFC_Loc199_DistVelocityQuality RFC_Loc199_ElevationQuality RFC_Loc199_AzimuthQuality RFC_Loc199_RSSI RFC_Loc199_AzimuthalPartnerId RFC_Loc200_RadialDistance RFC_Loc200_RadialVelocity RFC_Loc200_Elevation RFC_Loc200_Azimuth RFC_Loc200_DistVelocityCoVnce RFC_Loc200_RadialDistanceVnce RFC_Loc200_RadialVelocityVnce RFC_Loc200_ElevationVnce RFC_Loc200_AzimuthVnce RFC_Loc200_RadarCrossSection RFC_Loc200_DistVelocityQuality RFC_Loc200_ElevationQuality RFC_Loc200_AzimuthQuality RFC_Loc200_RSSI RFC_Loc200_AzimuthalPartnerId;
SIG_GROUP_ 331 SG_RFC_Location_201_203 1 : RFC_Loc201_203_CRC RFC_Loc201_203_AliveCtr RFC_Loc201_203_ProtBlockCtr RFC_Loc201_RadialDistance RFC_Loc201_RadialVelocity RFC_Loc201_Elevation RFC_Loc201_Azimuth RFC_Loc201_DistVelocityCoVnce RFC_Loc201_RadialDistanceVnce RFC_Loc201_RadialVelocityVnce RFC_Loc201_ElevationVnce RFC_Loc201_AzimuthVnce RFC_Loc201_RadarCrossSection RFC_Loc201_DistVelocityQuality RFC_Loc201_ElevationQuality RFC_Loc201_AzimuthQuality RFC_Loc201_RSSI RFC_Loc201_AzimuthalPartnerId RFC_Loc202_RadialDistance RFC_Loc202_RadialVelocity RFC_Loc202_Elevation RFC_Loc202_Azimuth RFC_Loc202_DistVelocityCoVnce RFC_Loc202_RadialDistanceVnce RFC_Loc202_RadialVelocityVnce RFC_Loc202_ElevationVnce RFC_Loc202_AzimuthVnce RFC_Loc202_RadarCrossSection RFC_Loc202_DistVelocityQuality RFC_Loc202_ElevationQuality RFC_Loc202_AzimuthQuality RFC_Loc202_RSSI RFC_Loc202_AzimuthalPartnerId RFC_Loc203_RadialDistance RFC_Loc203_RadialVelocity RFC_Loc203_Elevation RFC_Loc203_Azimuth RFC_Loc203_DistVelocityCoVnce RFC_Loc203_RadialDistanceVnce RFC_Loc203_RadialVelocityVnce RFC_Loc203_ElevationVnce RFC_Loc203_AzimuthVnce RFC_Loc203_RadarCrossSection RFC_Loc203_DistVelocityQuality RFC_Loc203_ElevationQuality RFC_Loc203_AzimuthQuality RFC_Loc203_RSSI RFC_Loc203_AzimuthalPartnerId;
SIG_GROUP_ 332 SG_RFC_Location_204_206 1 : RFC_Loc204_206_CRC RFC_Loc204_206_AliveCtr RFC_Loc204_206_ProtBlockCtr RFC_Loc204_RadialDistance RFC_Loc204_RadialVelocity RFC_Loc204_Elevation RFC_Loc204_Azimuth RFC_Loc204_DistVelocityCoVnce RFC_Loc204_RadialDistanceVnce RFC_Loc204_RadialVelocityVnce RFC_Loc204_ElevationVnce RFC_Loc204_AzimuthVnce RFC_Loc204_RadarCrossSection RFC_Loc204_DistVelocityQuality RFC_Loc204_ElevationQuality RFC_Loc204_AzimuthQuality RFC_Loc204_RSSI RFC_Loc204_AzimuthalPartnerId RFC_Loc205_RadialDistance RFC_Loc205_RadialVelocity RFC_Loc205_Elevation RFC_Loc205_Azimuth RFC_Loc205_DistVelocityCoVnce RFC_Loc205_RadialDistanceVnce RFC_Loc205_RadialVelocityVnce RFC_Loc205_ElevationVnce RFC_Loc205_AzimuthVnce RFC_Loc205_RadarCrossSection RFC_Loc205_DistVelocityQuality RFC_Loc205_ElevationQuality RFC_Loc205_AzimuthQuality RFC_Loc205_RSSI RFC_Loc205_AzimuthalPartnerId RFC_Loc206_RadialDistance RFC_Loc206_RadialVelocity RFC_Loc206_Elevation RFC_Loc206_Azimuth RFC_Loc206_DistVelocityCoVnce RFC_Loc206_RadialDistanceVnce RFC_Loc206_RadialVelocityVnce RFC_Loc206_ElevationVnce RFC_Loc206_AzimuthVnce RFC_Loc206_RadarCrossSection RFC_Loc206_DistVelocityQuality RFC_Loc206_ElevationQuality RFC_Loc206_AzimuthQuality RFC_Loc206_RSSI RFC_Loc206_AzimuthalPartnerId;
SIG_GROUP_ 333 SG_RFC_Location_207_209 1 : RFC_Loc207_209_CRC RFC_Loc207_209_AliveCtr RFC_Loc207_209_ProtBlockCtr RFC_Loc207_RadialDistance RFC_Loc207_RadialVelocity RFC_Loc207_Elevation RFC_Loc207_Azimuth RFC_Loc207_DistVelocityCoVnce RFC_Loc207_RadialDistanceVnce RFC_Loc207_RadialVelocityVnce RFC_Loc207_ElevationVnce RFC_Loc207_AzimuthVnce RFC_Loc207_RadarCrossSection RFC_Loc207_DistVelocityQuality RFC_Loc207_ElevationQuality RFC_Loc207_AzimuthQuality RFC_Loc207_RSSI RFC_Loc207_AzimuthalPartnerId RFC_Loc208_RadialDistance RFC_Loc208_RadialVelocity RFC_Loc208_Elevation RFC_Loc208_Azimuth RFC_Loc208_DistVelocityCoVnce RFC_Loc208_RadialDistanceVnce RFC_Loc208_RadialVelocityVnce RFC_Loc208_ElevationVnce RFC_Loc208_AzimuthVnce RFC_Loc208_RadarCrossSection RFC_Loc208_DistVelocityQuality RFC_Loc208_ElevationQuality RFC_Loc208_AzimuthQuality RFC_Loc208_RSSI RFC_Loc208_AzimuthalPartnerId RFC_Loc209_RadialDistance RFC_Loc209_RadialVelocity RFC_Loc209_Elevation RFC_Loc209_Azimuth RFC_Loc209_DistVelocityCoVnce RFC_Loc209_RadialDistanceVnce RFC_Loc209_RadialVelocityVnce RFC_Loc209_ElevationVnce RFC_Loc209_AzimuthVnce RFC_Loc209_RadarCrossSection RFC_Loc209_DistVelocityQuality RFC_Loc209_ElevationQuality RFC_Loc209_AzimuthQuality RFC_Loc209_RSSI RFC_Loc209_AzimuthalPartnerId;
SIG_GROUP_ 334 SG_RFC_Location_210_212 1 : RFC_Loc210_212_CRC RFC_Loc210_212_AliveCtr RFC_Loc210_212_ProtBlockCtr RFC_Loc210_RadialDistance RFC_Loc210_RadialVelocity RFC_Loc210_Elevation RFC_Loc210_Azimuth RFC_Loc210_DistVelocityCoVnce RFC_Loc210_RadialDistanceVnce RFC_Loc210_RadialVelocityVnce RFC_Loc210_ElevationVnce RFC_Loc210_AzimuthVnce RFC_Loc210_RadarCrossSection RFC_Loc210_DistVelocityQuality RFC_Loc210_ElevationQuality RFC_Loc210_AzimuthQuality RFC_Loc210_RSSI RFC_Loc210_AzimuthalPartnerId RFC_Loc211_RadialDistance RFC_Loc211_RadialVelocity RFC_Loc211_Elevation RFC_Loc211_Azimuth RFC_Loc211_DistVelocityCoVnce RFC_Loc211_RadialDistanceVnce RFC_Loc211_RadialVelocityVnce RFC_Loc211_ElevationVnce RFC_Loc211_AzimuthVnce RFC_Loc211_RadarCrossSection RFC_Loc211_DistVelocityQuality RFC_Loc211_ElevationQuality RFC_Loc211_AzimuthQuality RFC_Loc211_RSSI RFC_Loc211_AzimuthalPartnerId RFC_Loc212_RadialDistance RFC_Loc212_RadialVelocity RFC_Loc212_Elevation RFC_Loc212_Azimuth RFC_Loc212_DistVelocityCoVnce RFC_Loc212_RadialDistanceVnce RFC_Loc212_RadialVelocityVnce RFC_Loc212_ElevationVnce RFC_Loc212_AzimuthVnce RFC_Loc212_RadarCrossSection RFC_Loc212_DistVelocityQuality RFC_Loc212_ElevationQuality RFC_Loc212_AzimuthQuality RFC_Loc212_RSSI RFC_Loc212_AzimuthalPartnerId;
SIG_GROUP_ 335 SG_RFC_Location_213_215 1 : RFC_Loc213_215_CRC RFC_Loc213_215_AliveCtr RFC_Loc213_215_ProtBlockCtr RFC_Loc213_RadialDistance RFC_Loc213_RadialVelocity RFC_Loc213_Elevation RFC_Loc213_Azimuth RFC_Loc213_DistVelocityCoVnce RFC_Loc213_RadialDistanceVnce RFC_Loc213_RadialVelocityVnce RFC_Loc213_ElevationVnce RFC_Loc213_AzimuthVnce RFC_Loc213_RadarCrossSection RFC_Loc213_DistVelocityQuality RFC_Loc213_ElevationQuality RFC_Loc213_AzimuthQuality RFC_Loc213_RSSI RFC_Loc213_AzimuthalPartnerId RFC_Loc214_RadialDistance RFC_Loc214_RadialVelocity RFC_Loc214_Elevation RFC_Loc214_Azimuth RFC_Loc214_DistVelocityCoVnce RFC_Loc214_RadialDistanceVnce RFC_Loc214_RadialVelocityVnce RFC_Loc214_ElevationVnce RFC_Loc214_AzimuthVnce RFC_Loc214_RadarCrossSection RFC_Loc214_DistVelocityQuality RFC_Loc214_ElevationQuality RFC_Loc214_AzimuthQuality RFC_Loc214_RSSI RFC_Loc214_AzimuthalPartnerId RFC_Loc215_RadialDistance RFC_Loc215_RadialVelocity RFC_Loc215_Elevation RFC_Loc215_Azimuth RFC_Loc215_DistVelocityCoVnce RFC_Loc215_RadialDistanceVnce RFC_Loc215_RadialVelocityVnce RFC_Loc215_ElevationVnce RFC_Loc215_AzimuthVnce RFC_Loc215_RadarCrossSection RFC_Loc215_DistVelocityQuality RFC_Loc215_ElevationQuality RFC_Loc215_AzimuthQuality RFC_Loc215_RSSI RFC_Loc215_AzimuthalPartnerId;
SIG_GROUP_ 336 SG_RFC_Location_216_218 1 : RFC_Loc216_218_CRC RFC_Loc216_218_AliveCtr RFC_Loc216_218_ProtBlockCtr RFC_Loc216_RadialDistance RFC_Loc216_RadialVelocity RFC_Loc216_Elevation RFC_Loc216_Azimuth RFC_Loc216_DistVelocityCoVnce RFC_Loc216_RadialDistanceVnce RFC_Loc216_RadialVelocityVnce RFC_Loc216_ElevationVnce RFC_Loc216_AzimuthVnce RFC_Loc216_RadarCrossSection RFC_Loc216_DistVelocityQuality RFC_Loc216_ElevationQuality RFC_Loc216_AzimuthQuality RFC_Loc216_RSSI RFC_Loc216_AzimuthalPartnerId RFC_Loc217_RadialDistance RFC_Loc217_RadialVelocity RFC_Loc217_Elevation RFC_Loc217_Azimuth RFC_Loc217_DistVelocityCoVnce RFC_Loc217_RadialDistanceVnce RFC_Loc217_RadialVelocityVnce RFC_Loc217_ElevationVnce RFC_Loc217_AzimuthVnce RFC_Loc217_RadarCrossSection RFC_Loc217_DistVelocityQuality RFC_Loc217_ElevationQuality RFC_Loc217_AzimuthQuality RFC_Loc217_RSSI RFC_Loc217_AzimuthalPartnerId RFC_Loc218_RadialDistance RFC_Loc218_RadialVelocity RFC_Loc218_Elevation RFC_Loc218_Azimuth RFC_Loc218_DistVelocityCoVnce RFC_Loc218_RadialDistanceVnce RFC_Loc218_RadialVelocityVnce RFC_Loc218_ElevationVnce RFC_Loc218_AzimuthVnce RFC_Loc218_RadarCrossSection RFC_Loc218_DistVelocityQuality RFC_Loc218_ElevationQuality RFC_Loc218_AzimuthQuality RFC_Loc218_RSSI RFC_Loc218_AzimuthalPartnerId;
SIG_GROUP_ 337 SG_RFC_Location_219_221 1 : RFC_Loc219_221_CRC RFC_Loc219_221_AliveCtr RFC_Loc219_221_ProtBlockCtr RFC_Loc219_RadialDistance RFC_Loc219_RadialVelocity RFC_Loc219_Elevation RFC_Loc219_Azimuth RFC_Loc219_DistVelocityCoVnce RFC_Loc219_RadialDistanceVnce RFC_Loc219_RadialVelocityVnce RFC_Loc219_ElevationVnce RFC_Loc219_AzimuthVnce RFC_Loc219_RadarCrossSection RFC_Loc219_DistVelocityQuality RFC_Loc219_ElevationQuality RFC_Loc219_AzimuthQuality RFC_Loc219_RSSI RFC_Loc219_AzimuthalPartnerId RFC_Loc220_RadialDistance RFC_Loc220_RadialVelocity RFC_Loc220_Elevation RFC_Loc220_Azimuth RFC_Loc220_DistVelocityCoVnce RFC_Loc220_RadialDistanceVnce RFC_Loc220_RadialVelocityVnce RFC_Loc220_ElevationVnce RFC_Loc220_AzimuthVnce RFC_Loc220_RadarCrossSection RFC_Loc220_DistVelocityQuality RFC_Loc220_ElevationQuality RFC_Loc220_AzimuthQuality RFC_Loc220_RSSI RFC_Loc220_AzimuthalPartnerId RFC_Loc221_RadialDistance RFC_Loc221_RadialVelocity RFC_Loc221_Elevation RFC_Loc221_Azimuth RFC_Loc221_DistVelocityCoVnce RFC_Loc221_RadialDistanceVnce RFC_Loc221_RadialVelocityVnce RFC_Loc221_ElevationVnce RFC_Loc221_AzimuthVnce RFC_Loc221_RadarCrossSection RFC_Loc221_DistVelocityQuality RFC_Loc221_ElevationQuality RFC_Loc221_AzimuthQuality RFC_Loc221_RSSI RFC_Loc221_AzimuthalPartnerId;
SIG_GROUP_ 338 SG_RFC_Location_222_224 1 : RFC_Loc222_224_CRC RFC_Loc222_224_AliveCtr RFC_Loc222_224_ProtBlockCtr RFC_Loc222_RadialDistance RFC_Loc222_RadialVelocity RFC_Loc222_Elevation RFC_Loc222_Azimuth RFC_Loc222_DistVelocityCoVnce RFC_Loc222_RadialDistanceVnce RFC_Loc222_RadialVelocityVnce RFC_Loc222_ElevationVnce RFC_Loc222_AzimuthVnce RFC_Loc222_RadarCrossSection RFC_Loc222_DistVelocityQuality RFC_Loc222_ElevationQuality RFC_Loc222_AzimuthQuality RFC_Loc222_RSSI RFC_Loc222_AzimuthalPartnerId RFC_Loc223_RadialDistance RFC_Loc223_RadialVelocity RFC_Loc223_Elevation RFC_Loc223_Azimuth RFC_Loc223_DistVelocityCoVnce RFC_Loc223_RadialDistanceVnce RFC_Loc223_RadialVelocityVnce RFC_Loc223_ElevationVnce RFC_Loc223_AzimuthVnce RFC_Loc223_RadarCrossSection RFC_Loc223_DistVelocityQuality RFC_Loc223_ElevationQuality RFC_Loc223_AzimuthQuality RFC_Loc223_RSSI RFC_Loc223_AzimuthalPartnerId RFC_Loc224_RadialDistance RFC_Loc224_RadialVelocity RFC_Loc224_Elevation RFC_Loc224_Azimuth RFC_Loc224_DistVelocityCoVnce RFC_Loc224_RadialDistanceVnce RFC_Loc224_RadialVelocityVnce RFC_Loc224_ElevationVnce RFC_Loc224_AzimuthVnce RFC_Loc224_RadarCrossSection RFC_Loc224_DistVelocityQuality RFC_Loc224_ElevationQuality RFC_Loc224_AzimuthQuality RFC_Loc224_RSSI RFC_Loc224_AzimuthalPartnerId;
SIG_GROUP_ 339 SG_RFC_Location_225_227 1 : RFC_Loc225_227_CRC RFC_Loc225_227_AliveCtr RFC_Loc225_227_ProtBlockCtr RFC_Loc225_RadialDistance RFC_Loc225_RadialVelocity RFC_Loc225_Elevation RFC_Loc225_Azimuth RFC_Loc225_DistVelocityCoVnce RFC_Loc225_RadialDistanceVnce RFC_Loc225_RadialVelocityVnce RFC_Loc225_ElevationVnce RFC_Loc225_AzimuthVnce RFC_Loc225_RadarCrossSection RFC_Loc225_DistVelocityQuality RFC_Loc225_ElevationQuality RFC_Loc225_AzimuthQuality RFC_Loc225_RSSI RFC_Loc225_AzimuthalPartnerId RFC_Loc226_RadialDistance RFC_Loc226_RadialVelocity RFC_Loc226_Elevation RFC_Loc226_Azimuth RFC_Loc226_DistVelocityCoVnce RFC_Loc226_RadialDistanceVnce RFC_Loc226_RadialVelocityVnce RFC_Loc226_ElevationVnce RFC_Loc226_AzimuthVnce RFC_Loc226_RadarCrossSection RFC_Loc226_DistVelocityQuality RFC_Loc226_ElevationQuality RFC_Loc226_AzimuthQuality RFC_Loc226_RSSI RFC_Loc226_AzimuthalPartnerId RFC_Loc227_RadialDistance RFC_Loc227_RadialVelocity RFC_Loc227_Elevation RFC_Loc227_Azimuth RFC_Loc227_DistVelocityCoVnce RFC_Loc227_RadialDistanceVnce RFC_Loc227_RadialVelocityVnce RFC_Loc227_ElevationVnce RFC_Loc227_AzimuthVnce RFC_Loc227_RadarCrossSection RFC_Loc227_DistVelocityQuality RFC_Loc227_ElevationQuality RFC_Loc227_AzimuthQuality RFC_Loc227_RSSI RFC_Loc227_AzimuthalPartnerId;
SIG_GROUP_ 340 SG_RFC_Location_228_230 1 : RFC_Loc228_230_CRC RFC_Loc228_230_AliveCtr RFC_Loc228_230_ProtBlockCtr RFC_Loc228_RadialDistance RFC_Loc228_RadialVelocity RFC_Loc228_Elevation RFC_Loc228_Azimuth RFC_Loc228_DistVelocityCoVnce RFC_Loc228_RadialDistanceVnce RFC_Loc228_RadialVelocityVnce RFC_Loc228_ElevationVnce RFC_Loc228_AzimuthVnce RFC_Loc228_RadarCrossSection RFC_Loc228_DistVelocityQuality RFC_Loc228_ElevationQuality RFC_Loc228_AzimuthQuality RFC_Loc228_RSSI RFC_Loc228_AzimuthalPartnerId RFC_Loc229_RadialDistance RFC_Loc229_RadialVelocity RFC_Loc229_Elevation RFC_Loc229_Azimuth RFC_Loc229_DistVelocityCoVnce RFC_Loc229_RadialDistanceVnce RFC_Loc229_RadialVelocityVnce RFC_Loc229_ElevationVnce RFC_Loc229_AzimuthVnce RFC_Loc229_RadarCrossSection RFC_Loc229_DistVelocityQuality RFC_Loc229_ElevationQuality RFC_Loc229_AzimuthQuality RFC_Loc229_RSSI RFC_Loc229_AzimuthalPartnerId RFC_Loc230_RadialDistance RFC_Loc230_RadialVelocity RFC_Loc230_Elevation RFC_Loc230_Azimuth RFC_Loc230_DistVelocityCoVnce RFC_Loc230_RadialDistanceVnce RFC_Loc230_RadialVelocityVnce RFC_Loc230_ElevationVnce RFC_Loc230_AzimuthVnce RFC_Loc230_RadarCrossSection RFC_Loc230_DistVelocityQuality RFC_Loc230_ElevationQuality RFC_Loc230_AzimuthQuality RFC_Loc230_RSSI RFC_Loc230_AzimuthalPartnerId;
