VERSION "created by canmatrix"

NS_ :

BS_:

BU_: RadarFrontCenter VideoFrontCenter DASy ReceiveECU

BO_ 281 RFC_Location_051_053: 64 RadarFrontCenter
 SG_ RFC_Loc051_053_CRC : 0|16@1+ (1,0) [0|65535] ""  DASy
 SG_ RFC_Loc051_053_AliveCtr : 16|8@1+ (1,0) [0|255] ""  DASy
 SG_ RFC_Loc051_053_ProtBlockCtr : 24|4@1+ (1,0) [0|15] ""  DASy
 SG_ RFC_Loc051_RadialDistance : 32|15@1+ (0.01,0) [0|327.67] "m"  DASy
 SG_ RFC_Loc051_RadialVelocity : 47|15@1+ (0.01,-163.84) [-110|55] "m/s"  DASy
 SG_ RFC_Loc051_Elevation : 62|10@1+ (0.1,-51.2) [-45|45] "deg"  DASy
 SG_ RFC_Loc051_Azimuth : 72|11@1+ (0.1,-102.4) [-90|90] "deg"  DASy
 SG_ RFC_Loc051_DistVelocityCoVnce : 83|11@1+ (0.0001,-0.1024) [-0.1024|0.1023] "m^2/s"  DASy
 SG_ RFC_Loc051_RadialDistanceVnce : 94|10@1+ (5E-005,0) [0|0.05115] "m^2"  DASy
 SG_ RFC_Loc051_RadialVelocityVnce : 104|10@1+ (0.0001,0) [0|0.1023] "m^2/s^2"  DASy
 SG_ RFC_Loc051_ElevationVnce : 114|10@1+ (0.001,0) [0|1.023] "deg^2"  DASy
 SG_ RFC_Loc051_AzimuthVnce : 124|10@1+ (0.001,0) [0|1.023] "deg^2"  DASy
 SG_ RFC_Loc051_RadarCrossSection : 134|10@1+ (0.2,-102.4) [-50|70] "dBsm"  DASy
 SG_ RFC_Loc051_DistVelocityQuality : 144|8@1+ (1,0) [0|255] "unitless"  DASy
 SG_ RFC_Loc051_ElevationQuality : 152|8@1+ (1,0) [0|255] "unitless"  DASy
 SG_ RFC_Loc051_AzimuthQuality : 160|8@1+ (1,0) [0|255] "unitless"  DASy
 SG_ RFC_Loc051_RSSI : 168|10@1+ (0.1,0) [0|100] "unitless"  DASy
 SG_ RFC_Loc051_AzimuthalPartnerId : 178|10@1+ (1,0) [0|1023] "unitless"  DASy
 SG_ RFC_Loc052_RadialDistance : 192|15@1+ (0.01,0) [0|327.67] "m"  DASy
 SG_ RFC_Loc052_RadialVelocity : 207|15@1+ (0.01,-163.84) [-110|55] "m/s"  DASy
 SG_ RFC_Loc052_Elevation : 222|10@1+ (0.1,-51.2) [-45|45] "deg"  DASy
 SG_ RFC_Loc052_Azimuth : 232|11@1+ (0.1,-102.4) [-90|90] "deg"  DASy
 SG_ RFC_Loc052_DistVelocityCoVnce : 243|11@1+ (0.0001,-0.1024) [-0.1024|0.1023] "m^2/s"  DASy
 SG_ RFC_Loc052_RadialDistanceVnce : 254|10@1+ (5E-005,0) [0|0.05115] "m^2"  DASy
 SG_ RFC_Loc052_RadialVelocityVnce : 264|10@1+ (0.0001,0) [0|0.1023] "m^2/s^2"  DASy
 SG_ RFC_Loc052_ElevationVnce : 274|10@1+ (0.001,0) [0|1.023] "deg^2"  DASy
 SG_ RFC_Loc052_AzimuthVnce : 284|10@1+ (0.001,0) [0|1.023] "deg^2"  DASy
 SG_ RFC_Loc052_RadarCrossSection : 294|10@1+ (0.2,-102.4) [-50|70] "dBsm"  DASy
 SG_ RFC_Loc052_DistVelocityQuality : 304|8@1+ (1,0) [0|255] "unitless"  DASy
 SG_ RFC_Loc052_ElevationQuality : 312|8@1+ (1,0) [0|255] "unitless"  DASy
 SG_ RFC_Loc052_AzimuthQuality : 320|8@1+ (1,0) [0|255] "unitless"  DASy
 SG_ RFC_Loc052_RSSI : 328|10@1+ (0.1,0) [0|100] "unitless"  DASy
 SG_ RFC_Loc052_AzimuthalPartnerId : 338|10@1+ (1,0) [0|1023] "unitless"  DASy
 SG_ RFC_Loc053_RadialDistance : 352|15@1+ (0.01,0) [0|327.67] "m"  DASy
 SG_ RFC_Loc053_RadialVelocity : 367|15@1+ (0.01,-163.84) [-110|55] "m/s"  DASy
 SG_ RFC_Loc053_Elevation : 382|10@1+ (0.1,-51.2) [-45|45] "deg"  DASy
 SG_ RFC_Loc053_Azimuth : 392|11@1+ (0.1,-102.4) [-90|90] "deg"  DASy
 SG_ RFC_Loc053_DistVelocityCoVnce : 403|11@1+ (0.0001,-0.1024) [-0.1024|0.1023] "m^2/s"  DASy
 SG_ RFC_Loc053_RadialDistanceVnce : 414|10@1+ (5E-005,0) [0|0.05115] "m^2"  DASy
 SG_ RFC_Loc053_RadialVelocityVnce : 424|10@1+ (0.0001,0) [0|0.1023] "m^2/s^2"  DASy
 SG_ RFC_Loc053_ElevationVnce : 434|10@1+ (0.001,0) [0|1.023] "deg^2"  DASy
 SG_ RFC_Loc053_AzimuthVnce : 444|10@1+ (0.001,0) [0|1.023] "deg^2"  DASy
 SG_ RFC_Loc053_RadarCrossSection : 454|10@1+ (0.2,-102.4) [-50|70] "dBsm"  DASy
 SG_ RFC_Loc053_DistVelocityQuality : 464|8@1+ (1,0) [0|255] "unitless"  DASy
 SG_ RFC_Loc053_ElevationQuality : 472|8@1+ (1,0) [0|255] "unitless"  DASy
 SG_ RFC_Loc053_AzimuthQuality : 480|8@1+ (1,0) [0|255] "unitless"  DASy
 SG_ RFC_Loc053_RSSI : 488|10@1+ (0.1,0) [0|100] "unitless"  DASy
 SG_ RFC_Loc053_AzimuthalPartnerId : 498|10@1+ (1,0) [0|1023] "unitless"  DASy

BO_ 282 RFC_Location_054_056: 64 RadarFrontCenter
 SG_ RFC_Loc054_056_CRC : 0|16@1+ (1,0) [0|65535] ""  DASy
 SG_ RFC_Loc054_056_AliveCtr : 16|8@1+ (1,0) [0|255] ""  DASy
 SG_ RFC_Loc054_056_ProtBlockCtr : 24|4@1+ (1,0) [0|15] ""  DASy
 SG_ RFC_Loc054_RadialDistance : 32|15@1+ (0.01,0) [0|327.67] "m"  DASy
 SG_ RFC_Loc054_RadialVelocity : 47|15@1+ (0.01,-163.84) [-110|55] "m/s"  DASy
 SG_ RFC_Loc054_Elevation : 62|10@1+ (0.1,-51.2) [-45|45] "deg"  DASy
 SG_ RFC_Loc054_Azimuth : 72|11@1+ (0.1,-102.4) [-90|90] "deg"  DASy
 SG_ RFC_Loc054_DistVelocityCoVnce : 83|11@1+ (0.0001,-0.1024) [-0.1024|0.1023] "m^2/s"  DASy
 SG_ RFC_Loc054_RadialDistanceVnce : 94|10@1+ (5E-005,0) [0|0.05115] "m^2"  DASy
 SG_ RFC_Loc054_RadialVelocityVnce : 104|10@1+ (0.0001,0) [0|0.1023] "m^2/s^2"  DASy
 SG_ RFC_Loc054_ElevationVnce : 114|10@1+ (0.001,0) [0|1.023] "deg^2"  DASy
 SG_ RFC_Loc054_AzimuthVnce : 124|10@1+ (0.001,0) [0|1.023] "deg^2"  DASy
 SG_ RFC_Loc054_RadarCrossSection : 134|10@1+ (0.2,-102.4) [-50|70] "dBsm"  DASy
 SG_ RFC_Loc054_DistVelocityQuality : 144|8@1+ (1,0) [0|255] "unitless"  DASy
 SG_ RFC_Loc054_ElevationQuality : 152|8@1+ (1,0) [0|255] "unitless"  DASy
 SG_ RFC_Loc054_AzimuthQuality : 160|8@1+ (1,0) [0|255] "unitless"  DASy
 SG_ RFC_Loc054_RSSI : 168|10@1+ (0.1,0) [0|100] "unitless"  DASy
 SG_ RFC_Loc054_AzimuthalPartnerId : 178|10@1+ (1,0) [0|1023] "unitless"  DASy
 SG_ RFC_Loc055_RadialDistance : 192|15@1+ (0.01,0) [0|327.67] "m"  DASy
 SG_ RFC_Loc055_RadialVelocity : 207|15@1+ (0.01,-163.84) [-110|55] "m/s"  DASy
 SG_ RFC_Loc055_Elevation : 222|10@1+ (0.1,-51.2) [-45|45] "deg"  DASy
 SG_ RFC_Loc055_Azimuth : 232|11@1+ (0.1,-102.4) [-90|90] "deg"  DASy
 SG_ RFC_Loc055_DistVelocityCoVnce : 243|11@1+ (0.0001,-0.1024) [-0.1024|0.1023] "m^2/s"  DASy
 SG_ RFC_Loc055_RadialDistanceVnce : 254|10@1+ (5E-005,0) [0|0.05115] "m^2"  DASy
 SG_ RFC_Loc055_RadialVelocityVnce : 264|10@1+ (0.0001,0) [0|0.1023] "m^2/s^2"  DASy
 SG_ RFC_Loc055_ElevationVnce : 274|10@1+ (0.001,0) [0|1.023] "deg^2"  DASy
 SG_ RFC_Loc055_AzimuthVnce : 284|10@1+ (0.001,0) [0|1.023] "deg^2"  DASy
 SG_ RFC_Loc055_RadarCrossSection : 294|10@1+ (0.2,-102.4) [-50|70] "dBsm"  DASy
 SG_ RFC_Loc055_DistVelocityQuality : 304|8@1+ (1,0) [0|255] "unitless"  DASy
 SG_ RFC_Loc055_ElevationQuality : 312|8@1+ (1,0) [0|255] "unitless"  DASy
 SG_ RFC_Loc055_AzimuthQuality : 320|8@1+ (1,0) [0|255] "unitless"  DASy
 SG_ RFC_Loc055_RSSI : 328|10@1+ (0.1,0) [0|100] "unitless"  DASy
 SG_ RFC_Loc055_AzimuthalPartnerId : 338|10@1+ (1,0) [0|1023] "unitless"  DASy
 SG_ RFC_Loc056_RadialDistance : 352|15@1+ (0.01,0) [0|327.67] "m"  DASy
 SG_ RFC_Loc056_RadialVelocity : 367|15@1+ (0.01,-163.84) [-110|55] "m/s"  DASy
 SG_ RFC_Loc056_Elevation : 382|10@1+ (0.1,-51.2) [-45|45] "deg"  DASy
 SG_ RFC_Loc056_Azimuth : 392|11@1+ (0.1,-102.4) [-90|90] "deg"  DASy
 SG_ RFC_Loc056_DistVelocityCoVnce : 403|11@1+ (0.0001,-0.1024) [-0.1024|0.1023] "m^2/s"  DASy
 SG_ RFC_Loc056_RadialDistanceVnce : 414|10@1+ (5E-005,0) [0|0.05115] "m^2"  DASy
 SG_ RFC_Loc056_RadialVelocityVnce : 424|10@1+ (0.0001,0) [0|0.1023] "m^2/s^2"  DASy
 SG_ RFC_Loc056_ElevationVnce : 434|10@1+ (0.001,0) [0|1.023] "deg^2"  DASy
 SG_ RFC_Loc056_AzimuthVnce : 444|10@1+ (0.001,0) [0|1.023] "deg^2"  DASy
 SG_ RFC_Loc056_RadarCrossSection : 454|10@1+ (0.2,-102.4) [-50|70] "dBsm"  DASy
 SG_ RFC_Loc056_DistVelocityQuality : 464|8@1+ (1,0) [0|255] "unitless"  DASy
 SG_ RFC_Loc056_ElevationQuality : 472|8@1+ (1,0) [0|255] "unitless"  DASy
 SG_ RFC_Loc056_AzimuthQuality : 480|8@1+ (1,0) [0|255] "unitless"  DASy
 SG_ RFC_Loc056_RSSI : 488|10@1+ (0.1,0) [0|100] "unitless"  DASy
 SG_ RFC_Loc056_AzimuthalPartnerId : 498|10@1+ (1,0) [0|1023] "unitless"  DASy

BO_ 283 RFC_Location_057_059: 64 RadarFrontCenter
 SG_ RFC_Loc057_059_CRC : 0|16@1+ (1,0) [0|65535] ""  DASy
 SG_ RFC_Loc057_059_AliveCtr : 16|8@1+ (1,0) [0|255] ""  DASy
 SG_ RFC_Loc057_059_ProtBlockCtr : 24|4@1+ (1,0) [0|15] ""  DASy
 SG_ RFC_Loc057_RadialDistance : 32|15@1+ (0.01,0) [0|327.67] "m"  DASy
 SG_ RFC_Loc057_RadialVelocity : 47|15@1+ (0.01,-163.84) [-110|55] "m/s"  DASy
 SG_ RFC_Loc057_Elevation : 62|10@1+ (0.1,-51.2) [-45|45] "deg"  DASy
 SG_ RFC_Loc057_Azimuth : 72|11@1+ (0.1,-102.4) [-90|90] "deg"  DASy
 SG_ RFC_Loc057_DistVelocityCoVnce : 83|11@1+ (0.0001,-0.1024) [-0.1024|0.1023] "m^2/s"  DASy
 SG_ RFC_Loc057_RadialDistanceVnce : 94|10@1+ (5E-005,0) [0|0.05115] "m^2"  DASy
 SG_ RFC_Loc057_RadialVelocityVnce : 104|10@1+ (0.0001,0) [0|0.1023] "m^2/s^2"  DASy
 SG_ RFC_Loc057_ElevationVnce : 114|10@1+ (0.001,0) [0|1.023] "deg^2"  DASy
 SG_ RFC_Loc057_AzimuthVnce : 124|10@1+ (0.001,0) [0|1.023] "deg^2"  DASy
 SG_ RFC_Loc057_RadarCrossSection : 134|10@1+ (0.2,-102.4) [-50|70] "dBsm"  DASy
 SG_ RFC_Loc057_DistVelocityQuality : 144|8@1+ (1,0) [0|255] "unitless"  DASy
 SG_ RFC_Loc057_ElevationQuality : 152|8@1+ (1,0) [0|255] "unitless"  DASy
 SG_ RFC_Loc057_AzimuthQuality : 160|8@1+ (1,0) [0|255] "unitless"  DASy
 SG_ RFC_Loc057_RSSI : 168|10@1+ (0.1,0) [0|100] "unitless"  DASy
 SG_ RFC_Loc057_AzimuthalPartnerId : 178|10@1+ (1,0) [0|1023] "unitless"  DASy
 SG_ RFC_Loc058_RadialDistance : 192|15@1+ (0.01,0) [0|327.67] "m"  DASy
 SG_ RFC_Loc058_RadialVelocity : 207|15@1+ (0.01,-163.84) [-110|55] "m/s"  DASy
 SG_ RFC_Loc058_Elevation : 222|10@1+ (0.1,-51.2) [-45|45] "deg"  DASy
 SG_ RFC_Loc058_Azimuth : 232|11@1+ (0.1,-102.4) [-90|90] "deg"  DASy
 SG_ RFC_Loc058_DistVelocityCoVnce : 243|11@1+ (0.0001,-0.1024) [-0.1024|0.1023] "m^2/s"  DASy
 SG_ RFC_Loc058_RadialDistanceVnce : 254|10@1+ (5E-005,0) [0|0.05115] "m^2"  DASy
 SG_ RFC_Loc058_RadialVelocityVnce : 264|10@1+ (0.0001,0) [0|0.1023] "m^2/s^2"  DASy
 SG_ RFC_Loc058_ElevationVnce : 274|10@1+ (0.001,0) [0|1.023] "deg^2"  DASy
 SG_ RFC_Loc058_AzimuthVnce : 284|10@1+ (0.001,0) [0|1.023] "deg^2"  DASy
 SG_ RFC_Loc058_RadarCrossSection : 294|10@1+ (0.2,-102.4) [-50|70] "dBsm"  DASy
 SG_ RFC_Loc058_DistVelocityQuality : 304|8@1+ (1,0) [0|255] "unitless"  DASy
 SG_ RFC_Loc058_ElevationQuality : 312|8@1+ (1,0) [0|255] "unitless"  DASy
 SG_ RFC_Loc058_AzimuthQuality : 320|8@1+ (1,0) [0|255] "unitless"  DASy
 SG_ RFC_Loc058_RSSI : 328|10@1+ (0.1,0) [0|100] "unitless"  DASy
 SG_ RFC_Loc058_AzimuthalPartnerId : 338|10@1+ (1,0) [0|1023] "unitless"  DASy
 SG_ RFC_Loc059_RadialDistance : 352|15@1+ (0.01,0) [0|327.67] "m"  DASy
 SG_ RFC_Loc059_RadialVelocity : 367|15@1+ (0.01,-163.84) [-110|55] "m/s"  DASy
 SG_ RFC_Loc059_Elevation : 382|10@1+ (0.1,-51.2) [-45|45] "deg"  DASy
 SG_ RFC_Loc059_Azimuth : 392|11@1+ (0.1,-102.4) [-90|90] "deg"  DASy
 SG_ RFC_Loc059_DistVelocityCoVnce : 403|11@1+ (0.0001,-0.1024) [-0.1024|0.1023] "m^2/s"  DASy
 SG_ RFC_Loc059_RadialDistanceVnce : 414|10@1+ (5E-005,0) [0|0.05115] "m^2"  DASy
 SG_ RFC_Loc059_RadialVelocityVnce : 424|10@1+ (0.0001,0) [0|0.1023] "m^2/s^2"  DASy
 SG_ RFC_Loc059_ElevationVnce : 434|10@1+ (0.001,0) [0|1.023] "deg^2"  DASy
 SG_ RFC_Loc059_AzimuthVnce : 444|10@1+ (0.001,0) [0|1.023] "deg^2"  DASy
 SG_ RFC_Loc059_RadarCrossSection : 454|10@1+ (0.2,-102.4) [-50|70] "dBsm"  DASy
 SG_ RFC_Loc059_DistVelocityQuality : 464|8@1+ (1,0) [0|255] "unitless"  DASy
 SG_ RFC_Loc059_ElevationQuality : 472|8@1+ (1,0) [0|255] "unitless"  DASy
 SG_ RFC_Loc059_AzimuthQuality : 480|8@1+ (1,0) [0|255] "unitless"  DASy
 SG_ RFC_Loc059_RSSI : 488|10@1+ (0.1,0) [0|100] "unitless"  DASy
 SG_ RFC_Loc059_AzimuthalPartnerId : 498|10@1+ (1,0) [0|1023] "unitless"  DASy

BO_ 284 RFC_Location_060_062: 64 RadarFrontCenter
 SG_ RFC_Loc060_062_CRC : 0|16@1+ (1,0) [0|65535] ""  DASy
 SG_ RFC_Loc060_062_AliveCtr : 16|8@1+ (1,0) [0|255] ""  DASy
 SG_ RFC_Loc060_062_ProtBlockCtr : 24|4@1+ (1,0) [0|15] ""  DASy
 SG_ RFC_Loc060_RadialDistance : 32|15@1+ (0.01,0) [0|327.67] "m"  DASy
 SG_ RFC_Loc060_RadialVelocity : 47|15@1+ (0.01,-163.84) [-110|55] "m/s"  DASy
 SG_ RFC_Loc060_Elevation : 62|10@1+ (0.1,-51.2) [-45|45] "deg"  DASy
 SG_ RFC_Loc060_Azimuth : 72|11@1+ (0.1,-102.4) [-90|90] "deg"  DASy
 SG_ RFC_Loc060_DistVelocityCoVnce : 83|11@1+ (0.0001,-0.1024) [-0.1024|0.1023] "m^2/s"  DASy
 SG_ RFC_Loc060_RadialDistanceVnce : 94|10@1+ (5E-005,0) [0|0.05115] "m^2"  DASy
 SG_ RFC_Loc060_RadialVelocityVnce : 104|10@1+ (0.0001,0) [0|0.1023] "m^2/s^2"  DASy
 SG_ RFC_Loc060_ElevationVnce : 114|10@1+ (0.001,0) [0|1.023] "deg^2"  DASy
 SG_ RFC_Loc060_AzimuthVnce : 124|10@1+ (0.001,0) [0|1.023] "deg^2"  DASy
 SG_ RFC_Loc060_RadarCrossSection : 134|10@1+ (0.2,-102.4) [-50|70] "dBsm"  DASy
 SG_ RFC_Loc060_DistVelocityQuality : 144|8@1+ (1,0) [0|255] "unitless"  DASy
 SG_ RFC_Loc060_ElevationQuality : 152|8@1+ (1,0) [0|255] "unitless"  DASy
 SG_ RFC_Loc060_AzimuthQuality : 160|8@1+ (1,0) [0|255] "unitless"  DASy
 SG_ RFC_Loc060_RSSI : 168|10@1+ (0.1,0) [0|100] "unitless"  DASy
 SG_ RFC_Loc060_AzimuthalPartnerId : 178|10@1+ (1,0) [0|1023] "unitless"  DASy
 SG_ RFC_Loc061_RadialDistance : 192|15@1+ (0.01,0) [0|327.67] "m"  DASy
 SG_ RFC_Loc061_RadialVelocity : 207|15@1+ (0.01,-163.84) [-110|55] "m/s"  DASy
 SG_ RFC_Loc061_Elevation : 222|10@1+ (0.1,-51.2) [-45|45] "deg"  DASy
 SG_ RFC_Loc061_Azimuth : 232|11@1+ (0.1,-102.4) [-90|90] "deg"  DASy
 SG_ RFC_Loc061_DistVelocityCoVnce : 243|11@1+ (0.0001,-0.1024) [-0.1024|0.1023] "m^2/s"  DASy
 SG_ RFC_Loc061_RadialDistanceVnce : 254|10@1+ (5E-005,0) [0|0.05115] "m^2"  DASy
 SG_ RFC_Loc061_RadialVelocityVnce : 264|10@1+ (0.0001,0) [0|0.1023] "m^2/s^2"  DASy
 SG_ RFC_Loc061_ElevationVnce : 274|10@1+ (0.001,0) [0|1.023] "deg^2"  DASy
 SG_ RFC_Loc061_AzimuthVnce : 284|10@1+ (0.001,0) [0|1.023] "deg^2"  DASy
 SG_ RFC_Loc061_RadarCrossSection : 294|10@1+ (0.2,-102.4) [-50|70] "dBsm"  DASy
 SG_ RFC_Loc061_DistVelocityQuality : 304|8@1+ (1,0) [0|255] "unitless"  DASy
 SG_ RFC_Loc061_ElevationQuality : 312|8@1+ (1,0) [0|255] "unitless"  DASy
 SG_ RFC_Loc061_AzimuthQuality : 320|8@1+ (1,0) [0|255] "unitless"  DASy
 SG_ RFC_Loc061_RSSI : 328|10@1+ (0.1,0) [0|100] "unitless"  DASy
 SG_ RFC_Loc061_AzimuthalPartnerId : 338|10@1+ (1,0) [0|1023] "unitless"  DASy
 SG_ RFC_Loc062_RadialDistance : 352|15@1+ (0.01,0) [0|327.67] "m"  DASy
 SG_ RFC_Loc062_RadialVelocity : 367|15@1+ (0.01,-163.84) [-110|55] "m/s"  DASy
 SG_ RFC_Loc062_Elevation : 382|10@1+ (0.1,-51.2) [-45|45] "deg"  DASy
 SG_ RFC_Loc062_Azimuth : 392|11@1+ (0.1,-102.4) [-90|90] "deg"  DASy
 SG_ RFC_Loc062_DistVelocityCoVnce : 403|11@1+ (0.0001,-0.1024) [-0.1024|0.1023] "m^2/s"  DASy
 SG_ RFC_Loc062_RadialDistanceVnce : 414|10@1+ (5E-005,0) [0|0.05115] "m^2"  DASy
 SG_ RFC_Loc062_RadialVelocityVnce : 424|10@1+ (0.0001,0) [0|0.1023] "m^2/s^2"  DASy
 SG_ RFC_Loc062_ElevationVnce : 434|10@1+ (0.001,0) [0|1.023] "deg^2"  DASy
 SG_ RFC_Loc062_AzimuthVnce : 444|10@1+ (0.001,0) [0|1.023] "deg^2"  DASy
 SG_ RFC_Loc062_RadarCrossSection : 454|10@1+ (0.2,-102.4) [-50|70] "dBsm"  DASy
 SG_ RFC_Loc062_DistVelocityQuality : 464|8@1+ (1,0) [0|255] "unitless"  DASy
 SG_ RFC_Loc062_ElevationQuality : 472|8@1+ (1,0) [0|255] "unitless"  DASy
 SG_ RFC_Loc062_AzimuthQuality : 480|8@1+ (1,0) [0|255] "unitless"  DASy
 SG_ RFC_Loc062_RSSI : 488|10@1+ (0.1,0) [0|100] "unitless"  DASy
 SG_ RFC_Loc062_AzimuthalPartnerId : 498|10@1+ (1,0) [0|1023] "unitless"  DASy

BO_ 285 RFC_Location_063_065: 64 RadarFrontCenter
 SG_ RFC_Loc063_065_CRC : 0|16@1+ (1,0) [0|65535] ""  DASy
 SG_ RFC_Loc063_065_AliveCtr : 16|8@1+ (1,0) [0|255] ""  DASy
 SG_ RFC_Loc063_065_ProtBlockCtr : 24|4@1+ (1,0) [0|15] ""  DASy
 SG_ RFC_Loc063_RadialDistance : 32|15@1+ (0.01,0) [0|327.67] "m"  DASy
 SG_ RFC_Loc063_RadialVelocity : 47|15@1+ (0.01,-163.84) [-110|55] "m/s"  DASy
 SG_ RFC_Loc063_Elevation : 62|10@1+ (0.1,-51.2) [-45|45] "deg"  DASy
 SG_ RFC_Loc063_Azimuth : 72|11@1+ (0.1,-102.4) [-90|90] "deg"  DASy
 SG_ RFC_Loc063_DistVelocityCoVnce : 83|11@1+ (0.0001,-0.1024) [-0.1024|0.1023] "m^2/s"  DASy
 SG_ RFC_Loc063_RadialDistanceVnce : 94|10@1+ (5E-005,0) [0|0.05115] "m^2"  DASy
 SG_ RFC_Loc063_RadialVelocityVnce : 104|10@1+ (0.0001,0) [0|0.1023] "m^2/s^2"  DASy
 SG_ RFC_Loc063_ElevationVnce : 114|10@1+ (0.001,0) [0|1.023] "deg^2"  DASy
 SG_ RFC_Loc063_AzimuthVnce : 124|10@1+ (0.001,0) [0|1.023] "deg^2"  DASy
 SG_ RFC_Loc063_RadarCrossSection : 134|10@1+ (0.2,-102.4) [-50|70] "dBsm"  DASy
 SG_ RFC_Loc063_DistVelocityQuality : 144|8@1+ (1,0) [0|255] "unitless"  DASy
 SG_ RFC_Loc063_ElevationQuality : 152|8@1+ (1,0) [0|255] "unitless"  DASy
 SG_ RFC_Loc063_AzimuthQuality : 160|8@1+ (1,0) [0|255] "unitless"  DASy
 SG_ RFC_Loc063_RSSI : 168|10@1+ (0.1,0) [0|100] "unitless"  DASy
 SG_ RFC_Loc063_AzimuthalPartnerId : 178|10@1+ (1,0) [0|1023] "unitless"  DASy
 SG_ RFC_Loc064_RadialDistance : 192|15@1+ (0.01,0) [0|327.67] "m"  DASy
 SG_ RFC_Loc064_RadialVelocity : 207|15@1+ (0.01,-163.84) [-110|55] "m/s"  DASy
 SG_ RFC_Loc064_Elevation : 222|10@1+ (0.1,-51.2) [-45|45] "deg"  DASy
 SG_ RFC_Loc064_Azimuth : 232|11@1+ (0.1,-102.4) [-90|90] "deg"  DASy
 SG_ RFC_Loc064_DistVelocityCoVnce : 243|11@1+ (0.0001,-0.1024) [-0.1024|0.1023] "m^2/s"  DASy
 SG_ RFC_Loc064_RadialDistanceVnce : 254|10@1+ (5E-005,0) [0|0.05115] "m^2"  DASy
 SG_ RFC_Loc064_RadialVelocityVnce : 264|10@1+ (0.0001,0) [0|0.1023] "m^2/s^2"  DASy
 SG_ RFC_Loc064_ElevationVnce : 274|10@1+ (0.001,0) [0|1.023] "deg^2"  DASy
 SG_ RFC_Loc064_AzimuthVnce : 284|10@1+ (0.001,0) [0|1.023] "deg^2"  DASy
 SG_ RFC_Loc064_RadarCrossSection : 294|10@1+ (0.2,-102.4) [-50|70] "dBsm"  DASy
 SG_ RFC_Loc064_DistVelocityQuality : 304|8@1+ (1,0) [0|255] "unitless"  DASy
 SG_ RFC_Loc064_ElevationQuality : 312|8@1+ (1,0) [0|255] "unitless"  DASy
 SG_ RFC_Loc064_AzimuthQuality : 320|8@1+ (1,0) [0|255] "unitless"  DASy
 SG_ RFC_Loc064_RSSI : 328|10@1+ (0.1,0) [0|100] "unitless"  DASy
 SG_ RFC_Loc064_AzimuthalPartnerId : 338|10@1+ (1,0) [0|1023] "unitless"  DASy
 SG_ RFC_Loc065_RadialDistance : 352|15@1+ (0.01,0) [0|327.67] "m"  DASy
 SG_ RFC_Loc065_RadialVelocity : 367|15@1+ (0.01,-163.84) [-110|55] "m/s"  DASy
 SG_ RFC_Loc065_Elevation : 382|10@1+ (0.1,-51.2) [-45|45] "deg"  DASy
 SG_ RFC_Loc065_Azimuth : 392|11@1+ (0.1,-102.4) [-90|90] "deg"  DASy
 SG_ RFC_Loc065_DistVelocityCoVnce : 403|11@1+ (0.0001,-0.1024) [-0.1024|0.1023] "m^2/s"  DASy
 SG_ RFC_Loc065_RadialDistanceVnce : 414|10@1+ (5E-005,0) [0|0.05115] "m^2"  DASy
 SG_ RFC_Loc065_RadialVelocityVnce : 424|10@1+ (0.0001,0) [0|0.1023] "m^2/s^2"  DASy
 SG_ RFC_Loc065_ElevationVnce : 434|10@1+ (0.001,0) [0|1.023] "deg^2"  DASy
 SG_ RFC_Loc065_AzimuthVnce : 444|10@1+ (0.001,0) [0|1.023] "deg^2"  DASy
 SG_ RFC_Loc065_RadarCrossSection : 454|10@1+ (0.2,-102.4) [-50|70] "dBsm"  DASy
 SG_ RFC_Loc065_DistVelocityQuality : 464|8@1+ (1,0) [0|255] "unitless"  DASy
 SG_ RFC_Loc065_ElevationQuality : 472|8@1+ (1,0) [0|255] "unitless"  DASy
 SG_ RFC_Loc065_AzimuthQuality : 480|8@1+ (1,0) [0|255] "unitless"  DASy
 SG_ RFC_Loc065_RSSI : 488|10@1+ (0.1,0) [0|100] "unitless"  DASy
 SG_ RFC_Loc065_AzimuthalPartnerId : 498|10@1+ (1,0) [0|1023] "unitless"  DASy

BO_ 286 RFC_Location_066_068: 64 RadarFrontCenter
 SG_ RFC_Loc066_068_CRC : 0|16@1+ (1,0) [0|65535] ""  DASy
 SG_ RFC_Loc066_068_AliveCtr : 16|8@1+ (1,0) [0|255] ""  DASy
 SG_ RFC_Loc066_068_ProtBlockCtr : 24|4@1+ (1,0) [0|15] ""  DASy
 SG_ RFC_Loc066_RadialDistance : 32|15@1+ (0.01,0) [0|327.67] "m"  DASy
 SG_ RFC_Loc066_RadialVelocity : 47|15@1+ (0.01,-163.84) [-110|55] "m/s"  DASy
 SG_ RFC_Loc066_Elevation : 62|10@1+ (0.1,-51.2) [-45|45] "deg"  DASy
 SG_ RFC_Loc066_Azimuth : 72|11@1+ (0.1,-102.4) [-90|90] "deg"  DASy
 SG_ RFC_Loc066_DistVelocityCoVnce : 83|11@1+ (0.0001,-0.1024) [-0.1024|0.1023] "m^2/s"  DASy
 SG_ RFC_Loc066_RadialDistanceVnce : 94|10@1+ (5E-005,0) [0|0.05115] "m^2"  DASy
 SG_ RFC_Loc066_RadialVelocityVnce : 104|10@1+ (0.0001,0) [0|0.1023] "m^2/s^2"  DASy
 SG_ RFC_Loc066_ElevationVnce : 114|10@1+ (0.001,0) [0|1.023] "deg^2"  DASy
 SG_ RFC_Loc066_AzimuthVnce : 124|10@1+ (0.001,0) [0|1.023] "deg^2"  DASy
 SG_ RFC_Loc066_RadarCrossSection : 134|10@1+ (0.2,-102.4) [-50|70] "dBsm"  DASy
 SG_ RFC_Loc066_DistVelocityQuality : 144|8@1+ (1,0) [0|255] "unitless"  DASy
 SG_ RFC_Loc066_ElevationQuality : 152|8@1+ (1,0) [0|255] "unitless"  DASy
 SG_ RFC_Loc066_AzimuthQuality : 160|8@1+ (1,0) [0|255] "unitless"  DASy
 SG_ RFC_Loc066_RSSI : 168|10@1+ (0.1,0) [0|100] "unitless"  DASy
 SG_ RFC_Loc066_AzimuthalPartnerId : 178|10@1+ (1,0) [0|1023] "unitless"  DASy
 SG_ RFC_Loc067_RadialDistance : 192|15@1+ (0.01,0) [0|327.67] "m"  DASy
 SG_ RFC_Loc067_RadialVelocity : 207|15@1+ (0.01,-163.84) [-110|55] "m/s"  DASy
 SG_ RFC_Loc067_Elevation : 222|10@1+ (0.1,-51.2) [-45|45] "deg"  DASy
 SG_ RFC_Loc067_Azimuth : 232|11@1+ (0.1,-102.4) [-90|90] "deg"  DASy
 SG_ RFC_Loc067_DistVelocityCoVnce : 243|11@1+ (0.0001,-0.1024) [-0.1024|0.1023] "m^2/s"  DASy
 SG_ RFC_Loc067_RadialDistanceVnce : 254|10@1+ (5E-005,0) [0|0.05115] "m^2"  DASy
 SG_ RFC_Loc067_RadialVelocityVnce : 264|10@1+ (0.0001,0) [0|0.1023] "m^2/s^2"  DASy
 SG_ RFC_Loc067_ElevationVnce : 274|10@1+ (0.001,0) [0|1.023] "deg^2"  DASy
 SG_ RFC_Loc067_AzimuthVnce : 284|10@1+ (0.001,0) [0|1.023] "deg^2"  DASy
 SG_ RFC_Loc067_RadarCrossSection : 294|10@1+ (0.2,-102.4) [-50|70] "dBsm"  DASy
 SG_ RFC_Loc067_DistVelocityQuality : 304|8@1+ (1,0) [0|255] "unitless"  DASy
 SG_ RFC_Loc067_ElevationQuality : 312|8@1+ (1,0) [0|255] "unitless"  DASy
 SG_ RFC_Loc067_AzimuthQuality : 320|8@1+ (1,0) [0|255] "unitless"  DASy
 SG_ RFC_Loc067_RSSI : 328|10@1+ (0.1,0) [0|100] "unitless"  DASy
 SG_ RFC_Loc067_AzimuthalPartnerId : 338|10@1+ (1,0) [0|1023] "unitless"  DASy
 SG_ RFC_Loc068_RadialDistance : 352|15@1+ (0.01,0) [0|327.67] "m"  DASy
 SG_ RFC_Loc068_RadialVelocity : 367|15@1+ (0.01,-163.84) [-110|55] "m/s"  DASy
 SG_ RFC_Loc068_Elevation : 382|10@1+ (0.1,-51.2) [-45|45] "deg"  DASy
 SG_ RFC_Loc068_Azimuth : 392|11@1+ (0.1,-102.4) [-90|90] "deg"  DASy
 SG_ RFC_Loc068_DistVelocityCoVnce : 403|11@1+ (0.0001,-0.1024) [-0.1024|0.1023] "m^2/s"  DASy
 SG_ RFC_Loc068_RadialDistanceVnce : 414|10@1+ (5E-005,0) [0|0.05115] "m^2"  DASy
 SG_ RFC_Loc068_RadialVelocityVnce : 424|10@1+ (0.0001,0) [0|0.1023] "m^2/s^2"  DASy
 SG_ RFC_Loc068_ElevationVnce : 434|10@1+ (0.001,0) [0|1.023] "deg^2"  DASy
 SG_ RFC_Loc068_AzimuthVnce : 444|10@1+ (0.001,0) [0|1.023] "deg^2"  DASy
 SG_ RFC_Loc068_RadarCrossSection : 454|10@1+ (0.2,-102.4) [-50|70] "dBsm"  DASy
 SG_ RFC_Loc068_DistVelocityQuality : 464|8@1+ (1,0) [0|255] "unitless"  DASy
 SG_ RFC_Loc068_ElevationQuality : 472|8@1+ (1,0) [0|255] "unitless"  DASy
 SG_ RFC_Loc068_AzimuthQuality : 480|8@1+ (1,0) [0|255] "unitless"  DASy
 SG_ RFC_Loc068_RSSI : 488|10@1+ (0.1,0) [0|100] "unitless"  DASy
 SG_ RFC_Loc068_AzimuthalPartnerId : 498|10@1+ (1,0) [0|1023] "unitless"  DASy

BO_ 287 RFC_Location_069_071: 64 RadarFrontCenter
 SG_ RFC_Loc069_071_CRC : 0|16@1+ (1,0) [0|65535] ""  DASy
 SG_ RFC_Loc069_071_AliveCtr : 16|8@1+ (1,0) [0|255] ""  DASy
 SG_ RFC_Loc069_071_ProtBlockCtr : 24|4@1+ (1,0) [0|15] ""  DASy
 SG_ RFC_Loc069_RadialDistance : 32|15@1+ (0.01,0) [0|327.67] "m"  DASy
 SG_ RFC_Loc069_RadialVelocity : 47|15@1+ (0.01,-163.84) [-110|55] "m/s"  DASy
 SG_ RFC_Loc069_Elevation : 62|10@1+ (0.1,-51.2) [-45|45] "deg"  DASy
 SG_ RFC_Loc069_Azimuth : 72|11@1+ (0.1,-102.4) [-90|90] "deg"  DASy
 SG_ RFC_Loc069_DistVelocityCoVnce : 83|11@1+ (0.0001,-0.1024) [-0.1024|0.1023] "m^2/s"  DASy
 SG_ RFC_Loc069_RadialDistanceVnce : 94|10@1+ (5E-005,0) [0|0.05115] "m^2"  DASy
 SG_ RFC_Loc069_RadialVelocityVnce : 104|10@1+ (0.0001,0) [0|0.1023] "m^2/s^2"  DASy
 SG_ RFC_Loc069_ElevationVnce : 114|10@1+ (0.001,0) [0|1.023] "deg^2"  DASy
 SG_ RFC_Loc069_AzimuthVnce : 124|10@1+ (0.001,0) [0|1.023] "deg^2"  DASy
 SG_ RFC_Loc069_RadarCrossSection : 134|10@1+ (0.2,-102.4) [-50|70] "dBsm"  DASy
 SG_ RFC_Loc069_DistVelocityQuality : 144|8@1+ (1,0) [0|255] "unitless"  DASy
 SG_ RFC_Loc069_ElevationQuality : 152|8@1+ (1,0) [0|255] "unitless"  DASy
 SG_ RFC_Loc069_AzimuthQuality : 160|8@1+ (1,0) [0|255] "unitless"  DASy
 SG_ RFC_Loc069_RSSI : 168|10@1+ (0.1,0) [0|100] "unitless"  DASy
 SG_ RFC_Loc069_AzimuthalPartnerId : 178|10@1+ (1,0) [0|1023] "unitless"  DASy
 SG_ RFC_Loc070_RadialDistance : 192|15@1+ (0.01,0) [0|327.67] "m"  DASy
 SG_ RFC_Loc070_RadialVelocity : 207|15@1+ (0.01,-163.84) [-110|55] "m/s"  DASy
 SG_ RFC_Loc070_Elevation : 222|10@1+ (0.1,-51.2) [-45|45] "deg"  DASy
 SG_ RFC_Loc070_Azimuth : 232|11@1+ (0.1,-102.4) [-90|90] "deg"  DASy
 SG_ RFC_Loc070_DistVelocityCoVnce : 243|11@1+ (0.0001,-0.1024) [-0.1024|0.1023] "m^2/s"  DASy
 SG_ RFC_Loc070_RadialDistanceVnce : 254|10@1+ (5E-005,0) [0|0.05115] "m^2"  DASy
 SG_ RFC_Loc070_RadialVelocityVnce : 264|10@1+ (0.0001,0) [0|0.1023] "m^2/s^2"  DASy
 SG_ RFC_Loc070_ElevationVnce : 274|10@1+ (0.001,0) [0|1.023] "deg^2"  DASy
 SG_ RFC_Loc070_AzimuthVnce : 284|10@1+ (0.001,0) [0|1.023] "deg^2"  DASy
 SG_ RFC_Loc070_RadarCrossSection : 294|10@1+ (0.2,-102.4) [-50|70] "dBsm"  DASy
 SG_ RFC_Loc070_DistVelocityQuality : 304|8@1+ (1,0) [0|255] "unitless"  DASy
 SG_ RFC_Loc070_ElevationQuality : 312|8@1+ (1,0) [0|255] "unitless"  DASy
 SG_ RFC_Loc070_AzimuthQuality : 320|8@1+ (1,0) [0|255] "unitless"  DASy
 SG_ RFC_Loc070_RSSI : 328|10@1+ (0.1,0) [0|100] "unitless"  DASy
 SG_ RFC_Loc070_AzimuthalPartnerId : 338|10@1+ (1,0) [0|1023] "unitless"  DASy
 SG_ RFC_Loc071_RadialDistance : 352|15@1+ (0.01,0) [0|327.67] "m"  DASy
 SG_ RFC_Loc071_RadialVelocity : 367|15@1+ (0.01,-163.84) [-110|55] "m/s"  DASy
 SG_ RFC_Loc071_Elevation : 382|10@1+ (0.1,-51.2) [-45|45] "deg"  DASy
 SG_ RFC_Loc071_Azimuth : 392|11@1+ (0.1,-102.4) [-90|90] "deg"  DASy
 SG_ RFC_Loc071_DistVelocityCoVnce : 403|11@1+ (0.0001,-0.1024) [-0.1024|0.1023] "m^2/s"  DASy
 SG_ RFC_Loc071_RadialDistanceVnce : 414|10@1+ (5E-005,0) [0|0.05115] "m^2"  DASy
 SG_ RFC_Loc071_RadialVelocityVnce : 424|10@1+ (0.0001,0) [0|0.1023] "m^2/s^2"  DASy
 SG_ RFC_Loc071_ElevationVnce : 434|10@1+ (0.001,0) [0|1.023] "deg^2"  DASy
 SG_ RFC_Loc071_AzimuthVnce : 444|10@1+ (0.001,0) [0|1.023] "deg^2"  DASy
 SG_ RFC_Loc071_RadarCrossSection : 454|10@1+ (0.2,-102.4) [-50|70] "dBsm"  DASy
 SG_ RFC_Loc071_DistVelocityQuality : 464|8@1+ (1,0) [0|255] "unitless"  DASy
 SG_ RFC_Loc071_ElevationQuality : 472|8@1+ (1,0) [0|255] "unitless"  DASy
 SG_ RFC_Loc071_AzimuthQuality : 480|8@1+ (1,0) [0|255] "unitless"  DASy
 SG_ RFC_Loc071_RSSI : 488|10@1+ (0.1,0) [0|100] "unitless"  DASy
 SG_ RFC_Loc071_AzimuthalPartnerId : 498|10@1+ (1,0) [0|1023] "unitless"  DASy

BO_ 288 RFC_Location_072_074: 64 RadarFrontCenter
 SG_ RFC_Loc072_074_CRC : 0|16@1+ (1,0) [0|65535] ""  DASy
 SG_ RFC_Loc072_074_AliveCtr : 16|8@1+ (1,0) [0|255] ""  DASy
 SG_ RFC_Loc072_074_ProtBlockCtr : 24|4@1+ (1,0) [0|15] ""  DASy
 SG_ RFC_Loc072_RadialDistance : 32|15@1+ (0.01,0) [0|327.67] "m"  DASy
 SG_ RFC_Loc072_RadialVelocity : 47|15@1+ (0.01,-163.84) [-110|55] "m/s"  DASy
 SG_ RFC_Loc072_Elevation : 62|10@1+ (0.1,-51.2) [-45|45] "deg"  DASy
 SG_ RFC_Loc072_Azimuth : 72|11@1+ (0.1,-102.4) [-90|90] "deg"  DASy
 SG_ RFC_Loc072_DistVelocityCoVnce : 83|11@1+ (0.0001,-0.1024) [-0.1024|0.1023] "m^2/s"  DASy
 SG_ RFC_Loc072_RadialDistanceVnce : 94|10@1+ (5E-005,0) [0|0.05115] "m^2"  DASy
 SG_ RFC_Loc072_RadialVelocityVnce : 104|10@1+ (0.0001,0) [0|0.1023] "m^2/s^2"  DASy
 SG_ RFC_Loc072_ElevationVnce : 114|10@1+ (0.001,0) [0|1.023] "deg^2"  DASy
 SG_ RFC_Loc072_AzimuthVnce : 124|10@1+ (0.001,0) [0|1.023] "deg^2"  DASy
 SG_ RFC_Loc072_RadarCrossSection : 134|10@1+ (0.2,-102.4) [-50|70] "dBsm"  DASy
 SG_ RFC_Loc072_DistVelocityQuality : 144|8@1+ (1,0) [0|255] "unitless"  DASy
 SG_ RFC_Loc072_ElevationQuality : 152|8@1+ (1,0) [0|255] "unitless"  DASy
 SG_ RFC_Loc072_AzimuthQuality : 160|8@1+ (1,0) [0|255] "unitless"  DASy
 SG_ RFC_Loc072_RSSI : 168|10@1+ (0.1,0) [0|100] "unitless"  DASy
 SG_ RFC_Loc072_AzimuthalPartnerId : 178|10@1+ (1,0) [0|1023] "unitless"  DASy
 SG_ RFC_Loc073_RadialDistance : 192|15@1+ (0.01,0) [0|327.67] "m"  DASy
 SG_ RFC_Loc073_RadialVelocity : 207|15@1+ (0.01,-163.84) [-110|55] "m/s"  DASy
 SG_ RFC_Loc073_Elevation : 222|10@1+ (0.1,-51.2) [-45|45] "deg"  DASy
 SG_ RFC_Loc073_Azimuth : 232|11@1+ (0.1,-102.4) [-90|90] "deg"  DASy
 SG_ RFC_Loc073_DistVelocityCoVnce : 243|11@1+ (0.0001,-0.1024) [-0.1024|0.1023] "m^2/s"  DASy
 SG_ RFC_Loc073_RadialDistanceVnce : 254|10@1+ (5E-005,0) [0|0.05115] "m^2"  DASy
 SG_ RFC_Loc073_RadialVelocityVnce : 264|10@1+ (0.0001,0) [0|0.1023] "m^2/s^2"  DASy
 SG_ RFC_Loc073_ElevationVnce : 274|10@1+ (0.001,0) [0|1.023] "deg^2"  DASy
 SG_ RFC_Loc073_AzimuthVnce : 284|10@1+ (0.001,0) [0|1.023] "deg^2"  DASy
 SG_ RFC_Loc073_RadarCrossSection : 294|10@1+ (0.2,-102.4) [-50|70] "dBsm"  DASy
 SG_ RFC_Loc073_DistVelocityQuality : 304|8@1+ (1,0) [0|255] "unitless"  DASy
 SG_ RFC_Loc073_ElevationQuality : 312|8@1+ (1,0) [0|255] "unitless"  DASy
 SG_ RFC_Loc073_AzimuthQuality : 320|8@1+ (1,0) [0|255] "unitless"  DASy
 SG_ RFC_Loc073_RSSI : 328|10@1+ (0.1,0) [0|100] "unitless"  DASy
 SG_ RFC_Loc073_AzimuthalPartnerId : 338|10@1+ (1,0) [0|1023] "unitless"  DASy
 SG_ RFC_Loc074_RadialDistance : 352|15@1+ (0.01,0) [0|327.67] "m"  DASy
 SG_ RFC_Loc074_RadialVelocity : 367|15@1+ (0.01,-163.84) [-110|55] "m/s"  DASy
 SG_ RFC_Loc074_Elevation : 382|10@1+ (0.1,-51.2) [-45|45] "deg"  DASy
 SG_ RFC_Loc074_Azimuth : 392|11@1+ (0.1,-102.4) [-90|90] "deg"  DASy
 SG_ RFC_Loc074_DistVelocityCoVnce : 403|11@1+ (0.0001,-0.1024) [-0.1024|0.1023] "m^2/s"  DASy
 SG_ RFC_Loc074_RadialDistanceVnce : 414|10@1+ (5E-005,0) [0|0.05115] "m^2"  DASy
 SG_ RFC_Loc074_RadialVelocityVnce : 424|10@1+ (0.0001,0) [0|0.1023] "m^2/s^2"  DASy
 SG_ RFC_Loc074_ElevationVnce : 434|10@1+ (0.001,0) [0|1.023] "deg^2"  DASy
 SG_ RFC_Loc074_AzimuthVnce : 444|10@1+ (0.001,0) [0|1.023] "deg^2"  DASy
 SG_ RFC_Loc074_RadarCrossSection : 454|10@1+ (0.2,-102.4) [-50|70] "dBsm"  DASy
 SG_ RFC_Loc074_DistVelocityQuality : 464|8@1+ (1,0) [0|255] "unitless"  DASy
 SG_ RFC_Loc074_ElevationQuality : 472|8@1+ (1,0) [0|255] "unitless"  DASy
 SG_ RFC_Loc074_AzimuthQuality : 480|8@1+ (1,0) [0|255] "unitless"  DASy
 SG_ RFC_Loc074_RSSI : 488|10@1+ (0.1,0) [0|100] "unitless"  DASy
 SG_ RFC_Loc074_AzimuthalPartnerId : 498|10@1+ (1,0) [0|1023] "unitless"  DASy

BO_ 289 RFC_Location_075_077: 64 RadarFrontCenter
 SG_ RFC_Loc075_077_CRC : 0|16@1+ (1,0) [0|65535] ""  DASy
 SG_ RFC_Loc075_077_AliveCtr : 16|8@1+ (1,0) [0|255] ""  DASy
 SG_ RFC_Loc075_077_ProtBlockCtr : 24|4@1+ (1,0) [0|15] ""  DASy
 SG_ RFC_Loc075_RadialDistance : 32|15@1+ (0.01,0) [0|327.67] "m"  DASy
 SG_ RFC_Loc075_RadialVelocity : 47|15@1+ (0.01,-163.84) [-110|55] "m/s"  DASy
 SG_ RFC_Loc075_Elevation : 62|10@1+ (0.1,-51.2) [-45|45] "deg"  DASy
 SG_ RFC_Loc075_Azimuth : 72|11@1+ (0.1,-102.4) [-90|90] "deg"  DASy
 SG_ RFC_Loc075_DistVelocityCoVnce : 83|11@1+ (0.0001,-0.1024) [-0.1024|0.1023] "m^2/s"  DASy
 SG_ RFC_Loc075_RadialDistanceVnce : 94|10@1+ (5E-005,0) [0|0.05115] "m^2"  DASy
 SG_ RFC_Loc075_RadialVelocityVnce : 104|10@1+ (0.0001,0) [0|0.1023] "m^2/s^2"  DASy
 SG_ RFC_Loc075_ElevationVnce : 114|10@1+ (0.001,0) [0|1.023] "deg^2"  DASy
 SG_ RFC_Loc075_AzimuthVnce : 124|10@1+ (0.001,0) [0|1.023] "deg^2"  DASy
 SG_ RFC_Loc075_RadarCrossSection : 134|10@1+ (0.2,-102.4) [-50|70] "dBsm"  DASy
 SG_ RFC_Loc075_DistVelocityQuality : 144|8@1+ (1,0) [0|255] "unitless"  DASy
 SG_ RFC_Loc075_ElevationQuality : 152|8@1+ (1,0) [0|255] "unitless"  DASy
 SG_ RFC_Loc075_AzimuthQuality : 160|8@1+ (1,0) [0|255] "unitless"  DASy
 SG_ RFC_Loc075_RSSI : 168|10@1+ (0.1,0) [0|100] "unitless"  DASy
 SG_ RFC_Loc075_AzimuthalPartnerId : 178|10@1+ (1,0) [0|1023] "unitless"  DASy
 SG_ RFC_Loc076_RadialDistance : 192|15@1+ (0.01,0) [0|327.67] "m"  DASy
 SG_ RFC_Loc076_RadialVelocity : 207|15@1+ (0.01,-163.84) [-110|55] "m/s"  DASy
 SG_ RFC_Loc076_Elevation : 222|10@1+ (0.1,-51.2) [-45|45] "deg"  DASy
 SG_ RFC_Loc076_Azimuth : 232|11@1+ (0.1,-102.4) [-90|90] "deg"  DASy
 SG_ RFC_Loc076_DistVelocityCoVnce : 243|11@1+ (0.0001,-0.1024) [-0.1024|0.1023] "m^2/s"  DASy
 SG_ RFC_Loc076_RadialDistanceVnce : 254|10@1+ (5E-005,0) [0|0.05115] "m^2"  DASy
 SG_ RFC_Loc076_RadialVelocityVnce : 264|10@1+ (0.0001,0) [0|0.1023] "m^2/s^2"  DASy
 SG_ RFC_Loc076_ElevationVnce : 274|10@1+ (0.001,0) [0|1.023] "deg^2"  DASy
 SG_ RFC_Loc076_AzimuthVnce : 284|10@1+ (0.001,0) [0|1.023] "deg^2"  DASy
 SG_ RFC_Loc076_RadarCrossSection : 294|10@1+ (0.2,-102.4) [-50|70] "dBsm"  DASy
 SG_ RFC_Loc076_DistVelocityQuality : 304|8@1+ (1,0) [0|255] "unitless"  DASy
 SG_ RFC_Loc076_ElevationQuality : 312|8@1+ (1,0) [0|255] "unitless"  DASy
 SG_ RFC_Loc076_AzimuthQuality : 320|8@1+ (1,0) [0|255] "unitless"  DASy
 SG_ RFC_Loc076_RSSI : 328|10@1+ (0.1,0) [0|100] "unitless"  DASy
 SG_ RFC_Loc076_AzimuthalPartnerId : 338|10@1+ (1,0) [0|1023] "unitless"  DASy
 SG_ RFC_Loc077_RadialDistance : 352|15@1+ (0.01,0) [0|327.67] "m"  DASy
 SG_ RFC_Loc077_RadialVelocity : 367|15@1+ (0.01,-163.84) [-110|55] "m/s"  DASy
 SG_ RFC_Loc077_Elevation : 382|10@1+ (0.1,-51.2) [-45|45] "deg"  DASy
 SG_ RFC_Loc077_Azimuth : 392|11@1+ (0.1,-102.4) [-90|90] "deg"  DASy
 SG_ RFC_Loc077_DistVelocityCoVnce : 403|11@1+ (0.0001,-0.1024) [-0.1024|0.1023] "m^2/s"  DASy
 SG_ RFC_Loc077_RadialDistanceVnce : 414|10@1+ (5E-005,0) [0|0.05115] "m^2"  DASy
 SG_ RFC_Loc077_RadialVelocityVnce : 424|10@1+ (0.0001,0) [0|0.1023] "m^2/s^2"  DASy
 SG_ RFC_Loc077_ElevationVnce : 434|10@1+ (0.001,0) [0|1.023] "deg^2"  DASy
 SG_ RFC_Loc077_AzimuthVnce : 444|10@1+ (0.001,0) [0|1.023] "deg^2"  DASy
 SG_ RFC_Loc077_RadarCrossSection : 454|10@1+ (0.2,-102.4) [-50|70] "dBsm"  DASy
 SG_ RFC_Loc077_DistVelocityQuality : 464|8@1+ (1,0) [0|255] "unitless"  DASy
 SG_ RFC_Loc077_ElevationQuality : 472|8@1+ (1,0) [0|255] "unitless"  DASy
 SG_ RFC_Loc077_AzimuthQuality : 480|8@1+ (1,0) [0|255] "unitless"  DASy
 SG_ RFC_Loc077_RSSI : 488|10@1+ (0.1,0) [0|100] "unitless"  DASy
 SG_ RFC_Loc077_AzimuthalPartnerId : 498|10@1+ (1,0) [0|1023] "unitless"  DASy

BO_ 290 RFC_Location_078_080: 64 RadarFrontCenter
 SG_ RFC_Loc078_080_CRC : 0|16@1+ (1,0) [0|65535] ""  DASy
 SG_ RFC_Loc078_080_AliveCtr : 16|8@1+ (1,0) [0|255] ""  DASy
 SG_ RFC_Loc078_080_ProtBlockCtr : 24|4@1+ (1,0) [0|15] ""  DASy
 SG_ RFC_Loc078_RadialDistance : 32|15@1+ (0.01,0) [0|327.67] "m"  DASy
 SG_ RFC_Loc078_RadialVelocity : 47|15@1+ (0.01,-163.84) [-110|55] "m/s"  DASy
 SG_ RFC_Loc078_Elevation : 62|10@1+ (0.1,-51.2) [-45|45] "deg"  DASy
 SG_ RFC_Loc078_Azimuth : 72|11@1+ (0.1,-102.4) [-90|90] "deg"  DASy
 SG_ RFC_Loc078_DistVelocityCoVnce : 83|11@1+ (0.0001,-0.1024) [-0.1024|0.1023] "m^2/s"  DASy
 SG_ RFC_Loc078_RadialDistanceVnce : 94|10@1+ (5E-005,0) [0|0.05115] "m^2"  DASy
 SG_ RFC_Loc078_RadialVelocityVnce : 104|10@1+ (0.0001,0) [0|0.1023] "m^2/s^2"  DASy
 SG_ RFC_Loc078_ElevationVnce : 114|10@1+ (0.001,0) [0|1.023] "deg^2"  DASy
 SG_ RFC_Loc078_AzimuthVnce : 124|10@1+ (0.001,0) [0|1.023] "deg^2"  DASy
 SG_ RFC_Loc078_RadarCrossSection : 134|10@1+ (0.2,-102.4) [-50|70] "dBsm"  DASy
 SG_ RFC_Loc078_DistVelocityQuality : 144|8@1+ (1,0) [0|255] "unitless"  DASy
 SG_ RFC_Loc078_ElevationQuality : 152|8@1+ (1,0) [0|255] "unitless"  DASy
 SG_ RFC_Loc078_AzimuthQuality : 160|8@1+ (1,0) [0|255] "unitless"  DASy
 SG_ RFC_Loc078_RSSI : 168|10@1+ (0.1,0) [0|100] "unitless"  DASy
 SG_ RFC_Loc078_AzimuthalPartnerId : 178|10@1+ (1,0) [0|1023] "unitless"  DASy
 SG_ RFC_Loc079_RadialDistance : 192|15@1+ (0.01,0) [0|327.67] "m"  DASy
 SG_ RFC_Loc079_RadialVelocity : 207|15@1+ (0.01,-163.84) [-110|55] "m/s"  DASy
 SG_ RFC_Loc079_Elevation : 222|10@1+ (0.1,-51.2) [-45|45] "deg"  DASy
 SG_ RFC_Loc079_Azimuth : 232|11@1+ (0.1,-102.4) [-90|90] "deg"  DASy
 SG_ RFC_Loc079_DistVelocityCoVnce : 243|11@1+ (0.0001,-0.1024) [-0.1024|0.1023] "m^2/s"  DASy
 SG_ RFC_Loc079_RadialDistanceVnce : 254|10@1+ (5E-005,0) [0|0.05115] "m^2"  DASy
 SG_ RFC_Loc079_RadialVelocityVnce : 264|10@1+ (0.0001,0) [0|0.1023] "m^2/s^2"  DASy
 SG_ RFC_Loc079_ElevationVnce : 274|10@1+ (0.001,0) [0|1.023] "deg^2"  DASy
 SG_ RFC_Loc079_AzimuthVnce : 284|10@1+ (0.001,0) [0|1.023] "deg^2"  DASy
 SG_ RFC_Loc079_RadarCrossSection : 294|10@1+ (0.2,-102.4) [-50|70] "dBsm"  DASy
 SG_ RFC_Loc079_DistVelocityQuality : 304|8@1+ (1,0) [0|255] "unitless"  DASy
 SG_ RFC_Loc079_ElevationQuality : 312|8@1+ (1,0) [0|255] "unitless"  DASy
 SG_ RFC_Loc079_AzimuthQuality : 320|8@1+ (1,0) [0|255] "unitless"  DASy
 SG_ RFC_Loc079_RSSI : 328|10@1+ (0.1,0) [0|100] "unitless"  DASy
 SG_ RFC_Loc079_AzimuthalPartnerId : 338|10@1+ (1,0) [0|1023] "unitless"  DASy
 SG_ RFC_Loc080_RadialDistance : 352|15@1+ (0.01,0) [0|327.67] "m"  DASy
 SG_ RFC_Loc080_RadialVelocity : 367|15@1+ (0.01,-163.84) [-110|55] "m/s"  DASy
 SG_ RFC_Loc080_Elevation : 382|10@1+ (0.1,-51.2) [-45|45] "deg"  DASy
 SG_ RFC_Loc080_Azimuth : 392|11@1+ (0.1,-102.4) [-90|90] "deg"  DASy
 SG_ RFC_Loc080_DistVelocityCoVnce : 403|11@1+ (0.0001,-0.1024) [-0.1024|0.1023] "m^2/s"  DASy
 SG_ RFC_Loc080_RadialDistanceVnce : 414|10@1+ (5E-005,0) [0|0.05115] "m^2"  DASy
 SG_ RFC_Loc080_RadialVelocityVnce : 424|10@1+ (0.0001,0) [0|0.1023] "m^2/s^2"  DASy
 SG_ RFC_Loc080_ElevationVnce : 434|10@1+ (0.001,0) [0|1.023] "deg^2"  DASy
 SG_ RFC_Loc080_AzimuthVnce : 444|10@1+ (0.001,0) [0|1.023] "deg^2"  DASy
 SG_ RFC_Loc080_RadarCrossSection : 454|10@1+ (0.2,-102.4) [-50|70] "dBsm"  DASy
 SG_ RFC_Loc080_DistVelocityQuality : 464|8@1+ (1,0) [0|255] "unitless"  DASy
 SG_ RFC_Loc080_ElevationQuality : 472|8@1+ (1,0) [0|255] "unitless"  DASy
 SG_ RFC_Loc080_AzimuthQuality : 480|8@1+ (1,0) [0|255] "unitless"  DASy
 SG_ RFC_Loc080_RSSI : 488|10@1+ (0.1,0) [0|100] "unitless"  DASy
 SG_ RFC_Loc080_AzimuthalPartnerId : 498|10@1+ (1,0) [0|1023] "unitless"  DASy

BO_ 291 RFC_Location_081_083: 64 RadarFrontCenter
 SG_ RFC_Loc081_083_CRC : 0|16@1+ (1,0) [0|65535] ""  DASy
 SG_ RFC_Loc081_083_AliveCtr : 16|8@1+ (1,0) [0|255] ""  DASy
 SG_ RFC_Loc081_083_ProtBlockCtr : 24|4@1+ (1,0) [0|15] ""  DASy
 SG_ RFC_Loc081_RadialDistance : 32|15@1+ (0.01,0) [0|327.67] "m"  DASy
 SG_ RFC_Loc081_RadialVelocity : 47|15@1+ (0.01,-163.84) [-110|55] "m/s"  DASy
 SG_ RFC_Loc081_Elevation : 62|10@1+ (0.1,-51.2) [-45|45] "deg"  DASy
 SG_ RFC_Loc081_Azimuth : 72|11@1+ (0.1,-102.4) [-90|90] "deg"  DASy
 SG_ RFC_Loc081_DistVelocityCoVnce : 83|11@1+ (0.0001,-0.1024) [-0.1024|0.1023] "m^2/s"  DASy
 SG_ RFC_Loc081_RadialDistanceVnce : 94|10@1+ (5E-005,0) [0|0.05115] "m^2"  DASy
 SG_ RFC_Loc081_RadialVelocityVnce : 104|10@1+ (0.0001,0) [0|0.1023] "m^2/s^2"  DASy
 SG_ RFC_Loc081_ElevationVnce : 114|10@1+ (0.001,0) [0|1.023] "deg^2"  DASy
 SG_ RFC_Loc081_AzimuthVnce : 124|10@1+ (0.001,0) [0|1.023] "deg^2"  DASy
 SG_ RFC_Loc081_RadarCrossSection : 134|10@1+ (0.2,-102.4) [-50|70] "dBsm"  DASy
 SG_ RFC_Loc081_DistVelocityQuality : 144|8@1+ (1,0) [0|255] "unitless"  DASy
 SG_ RFC_Loc081_ElevationQuality : 152|8@1+ (1,0) [0|255] "unitless"  DASy
 SG_ RFC_Loc081_AzimuthQuality : 160|8@1+ (1,0) [0|255] "unitless"  DASy
 SG_ RFC_Loc081_RSSI : 168|10@1+ (0.1,0) [0|100] "unitless"  DASy
 SG_ RFC_Loc081_AzimuthalPartnerId : 178|10@1+ (1,0) [0|1023] "unitless"  DASy
 SG_ RFC_Loc082_RadialDistance : 192|15@1+ (0.01,0) [0|327.67] "m"  DASy
 SG_ RFC_Loc082_RadialVelocity : 207|15@1+ (0.01,-163.84) [-110|55] "m/s"  DASy
 SG_ RFC_Loc082_Elevation : 222|10@1+ (0.1,-51.2) [-45|45] "deg"  DASy
 SG_ RFC_Loc082_Azimuth : 232|11@1+ (0.1,-102.4) [-90|90] "deg"  DASy
 SG_ RFC_Loc082_DistVelocityCoVnce : 243|11@1+ (0.0001,-0.1024) [-0.1024|0.1023] "m^2/s"  DASy
 SG_ RFC_Loc082_RadialDistanceVnce : 254|10@1+ (5E-005,0) [0|0.05115] "m^2"  DASy
 SG_ RFC_Loc082_RadialVelocityVnce : 264|10@1+ (0.0001,0) [0|0.1023] "m^2/s^2"  DASy
 SG_ RFC_Loc082_ElevationVnce : 274|10@1+ (0.001,0) [0|1.023] "deg^2"  DASy
 SG_ RFC_Loc082_AzimuthVnce : 284|10@1+ (0.001,0) [0|1.023] "deg^2"  DASy
 SG_ RFC_Loc082_RadarCrossSection : 294|10@1+ (0.2,-102.4) [-50|70] "dBsm"  DASy
 SG_ RFC_Loc082_DistVelocityQuality : 304|8@1+ (1,0) [0|255] "unitless"  DASy
 SG_ RFC_Loc082_ElevationQuality : 312|8@1+ (1,0) [0|255] "unitless"  DASy
 SG_ RFC_Loc082_AzimuthQuality : 320|8@1+ (1,0) [0|255] "unitless"  DASy
 SG_ RFC_Loc082_RSSI : 328|10@1+ (0.1,0) [0|100] "unitless"  DASy
 SG_ RFC_Loc082_AzimuthalPartnerId : 338|10@1+ (1,0) [0|1023] "unitless"  DASy
 SG_ RFC_Loc083_RadialDistance : 352|15@1+ (0.01,0) [0|327.67] "m"  DASy
 SG_ RFC_Loc083_RadialVelocity : 367|15@1+ (0.01,-163.84) [-110|55] "m/s"  DASy
 SG_ RFC_Loc083_Elevation : 382|10@1+ (0.1,-51.2) [-45|45] "deg"  DASy
 SG_ RFC_Loc083_Azimuth : 392|11@1+ (0.1,-102.4) [-90|90] "deg"  DASy
 SG_ RFC_Loc083_DistVelocityCoVnce : 403|11@1+ (0.0001,-0.1024) [-0.1024|0.1023] "m^2/s"  DASy
 SG_ RFC_Loc083_RadialDistanceVnce : 414|10@1+ (5E-005,0) [0|0.05115] "m^2"  DASy
 SG_ RFC_Loc083_RadialVelocityVnce : 424|10@1+ (0.0001,0) [0|0.1023] "m^2/s^2"  DASy
 SG_ RFC_Loc083_ElevationVnce : 434|10@1+ (0.001,0) [0|1.023] "deg^2"  DASy
 SG_ RFC_Loc083_AzimuthVnce : 444|10@1+ (0.001,0) [0|1.023] "deg^2"  DASy
 SG_ RFC_Loc083_RadarCrossSection : 454|10@1+ (0.2,-102.4) [-50|70] "dBsm"  DASy
 SG_ RFC_Loc083_DistVelocityQuality : 464|8@1+ (1,0) [0|255] "unitless"  DASy
 SG_ RFC_Loc083_ElevationQuality : 472|8@1+ (1,0) [0|255] "unitless"  DASy
 SG_ RFC_Loc083_AzimuthQuality : 480|8@1+ (1,0) [0|255] "unitless"  DASy
 SG_ RFC_Loc083_RSSI : 488|10@1+ (0.1,0) [0|100] "unitless"  DASy
 SG_ RFC_Loc083_AzimuthalPartnerId : 498|10@1+ (1,0) [0|1023] "unitless"  DASy

BO_ 292 RFC_Location_084_086: 64 RadarFrontCenter
 SG_ RFC_Loc084_086_CRC : 0|16@1+ (1,0) [0|65535] ""  DASy
 SG_ RFC_Loc084_086_AliveCtr : 16|8@1+ (1,0) [0|255] ""  DASy
 SG_ RFC_Loc084_086_ProtBlockCtr : 24|4@1+ (1,0) [0|15] ""  DASy
 SG_ RFC_Loc084_RadialDistance : 32|15@1+ (0.01,0) [0|327.67] "m"  DASy
 SG_ RFC_Loc084_RadialVelocity : 47|15@1+ (0.01,-163.84) [-110|55] "m/s"  DASy
 SG_ RFC_Loc084_Elevation : 62|10@1+ (0.1,-51.2) [-45|45] "deg"  DASy
 SG_ RFC_Loc084_Azimuth : 72|11@1+ (0.1,-102.4) [-90|90] "deg"  DASy
 SG_ RFC_Loc084_DistVelocityCoVnce : 83|11@1+ (0.0001,-0.1024) [-0.1024|0.1023] "m^2/s"  DASy
 SG_ RFC_Loc084_RadialDistanceVnce : 94|10@1+ (5E-005,0) [0|0.05115] "m^2"  DASy
 SG_ RFC_Loc084_RadialVelocityVnce : 104|10@1+ (0.0001,0) [0|0.1023] "m^2/s^2"  DASy
 SG_ RFC_Loc084_ElevationVnce : 114|10@1+ (0.001,0) [0|1.023] "deg^2"  DASy
 SG_ RFC_Loc084_AzimuthVnce : 124|10@1+ (0.001,0) [0|1.023] "deg^2"  DASy
 SG_ RFC_Loc084_RadarCrossSection : 134|10@1+ (0.2,-102.4) [-50|70] "dBsm"  DASy
 SG_ RFC_Loc084_DistVelocityQuality : 144|8@1+ (1,0) [0|255] "unitless"  DASy
 SG_ RFC_Loc084_ElevationQuality : 152|8@1+ (1,0) [0|255] "unitless"  DASy
 SG_ RFC_Loc084_AzimuthQuality : 160|8@1+ (1,0) [0|255] "unitless"  DASy
 SG_ RFC_Loc084_RSSI : 168|10@1+ (0.1,0) [0|100] "unitless"  DASy
 SG_ RFC_Loc084_AzimuthalPartnerId : 178|10@1+ (1,0) [0|1023] "unitless"  DASy
 SG_ RFC_Loc085_RadialDistance : 192|15@1+ (0.01,0) [0|327.67] "m"  DASy
 SG_ RFC_Loc085_RadialVelocity : 207|15@1+ (0.01,-163.84) [-110|55] "m/s"  DASy
 SG_ RFC_Loc085_Elevation : 222|10@1+ (0.1,-51.2) [-45|45] "deg"  DASy
 SG_ RFC_Loc085_Azimuth : 232|11@1+ (0.1,-102.4) [-90|90] "deg"  DASy
 SG_ RFC_Loc085_DistVelocityCoVnce : 243|11@1+ (0.0001,-0.1024) [-0.1024|0.1023] "m^2/s"  DASy
 SG_ RFC_Loc085_RadialDistanceVnce : 254|10@1+ (5E-005,0) [0|0.05115] "m^2"  DASy
 SG_ RFC_Loc085_RadialVelocityVnce : 264|10@1+ (0.0001,0) [0|0.1023] "m^2/s^2"  DASy
 SG_ RFC_Loc085_ElevationVnce : 274|10@1+ (0.001,0) [0|1.023] "deg^2"  DASy
 SG_ RFC_Loc085_AzimuthVnce : 284|10@1+ (0.001,0) [0|1.023] "deg^2"  DASy
 SG_ RFC_Loc085_RadarCrossSection : 294|10@1+ (0.2,-102.4) [-50|70] "dBsm"  DASy
 SG_ RFC_Loc085_DistVelocityQuality : 304|8@1+ (1,0) [0|255] "unitless"  DASy
 SG_ RFC_Loc085_ElevationQuality : 312|8@1+ (1,0) [0|255] "unitless"  DASy
 SG_ RFC_Loc085_AzimuthQuality : 320|8@1+ (1,0) [0|255] "unitless"  DASy
 SG_ RFC_Loc085_RSSI : 328|10@1+ (0.1,0) [0|100] "unitless"  DASy
 SG_ RFC_Loc085_AzimuthalPartnerId : 338|10@1+ (1,0) [0|1023] "unitless"  DASy
 SG_ RFC_Loc086_RadialDistance : 352|15@1+ (0.01,0) [0|327.67] "m"  DASy
 SG_ RFC_Loc086_RadialVelocity : 367|15@1+ (0.01,-163.84) [-110|55] "m/s"  DASy
 SG_ RFC_Loc086_Elevation : 382|10@1+ (0.1,-51.2) [-45|45] "deg"  DASy
 SG_ RFC_Loc086_Azimuth : 392|11@1+ (0.1,-102.4) [-90|90] "deg"  DASy
 SG_ RFC_Loc086_DistVelocityCoVnce : 403|11@1+ (0.0001,-0.1024) [-0.1024|0.1023] "m^2/s"  DASy
 SG_ RFC_Loc086_RadialDistanceVnce : 414|10@1+ (5E-005,0) [0|0.05115] "m^2"  DASy
 SG_ RFC_Loc086_RadialVelocityVnce : 424|10@1+ (0.0001,0) [0|0.1023] "m^2/s^2"  DASy
 SG_ RFC_Loc086_ElevationVnce : 434|10@1+ (0.001,0) [0|1.023] "deg^2"  DASy
 SG_ RFC_Loc086_AzimuthVnce : 444|10@1+ (0.001,0) [0|1.023] "deg^2"  DASy
 SG_ RFC_Loc086_RadarCrossSection : 454|10@1+ (0.2,-102.4) [-50|70] "dBsm"  DASy
 SG_ RFC_Loc086_DistVelocityQuality : 464|8@1+ (1,0) [0|255] "unitless"  DASy
 SG_ RFC_Loc086_ElevationQuality : 472|8@1+ (1,0) [0|255] "unitless"  DASy
 SG_ RFC_Loc086_AzimuthQuality : 480|8@1+ (1,0) [0|255] "unitless"  DASy
 SG_ RFC_Loc086_RSSI : 488|10@1+ (0.1,0) [0|100] "unitless"  DASy
 SG_ RFC_Loc086_AzimuthalPartnerId : 498|10@1+ (1,0) [0|1023] "unitless"  DASy

BO_ 293 RFC_Location_087_089: 64 RadarFrontCenter
 SG_ RFC_Loc087_089_CRC : 0|16@1+ (1,0) [0|65535] ""  DASy
 SG_ RFC_Loc087_089_AliveCtr : 16|8@1+ (1,0) [0|255] ""  DASy
 SG_ RFC_Loc087_089_ProtBlockCtr : 24|4@1+ (1,0) [0|15] ""  DASy
 SG_ RFC_Loc087_RadialDistance : 32|15@1+ (0.01,0) [0|327.67] "m"  DASy
 SG_ RFC_Loc087_RadialVelocity : 47|15@1+ (0.01,-163.84) [-110|55] "m/s"  DASy
 SG_ RFC_Loc087_Elevation : 62|10@1+ (0.1,-51.2) [-45|45] "deg"  DASy
 SG_ RFC_Loc087_Azimuth : 72|11@1+ (0.1,-102.4) [-90|90] "deg"  DASy
 SG_ RFC_Loc087_DistVelocityCoVnce : 83|11@1+ (0.0001,-0.1024) [-0.1024|0.1023] "m^2/s"  DASy
 SG_ RFC_Loc087_RadialDistanceVnce : 94|10@1+ (5E-005,0) [0|0.05115] "m^2"  DASy
 SG_ RFC_Loc087_RadialVelocityVnce : 104|10@1+ (0.0001,0) [0|0.1023] "m^2/s^2"  DASy
 SG_ RFC_Loc087_ElevationVnce : 114|10@1+ (0.001,0) [0|1.023] "deg^2"  DASy
 SG_ RFC_Loc087_AzimuthVnce : 124|10@1+ (0.001,0) [0|1.023] "deg^2"  DASy
 SG_ RFC_Loc087_RadarCrossSection : 134|10@1+ (0.2,-102.4) [-50|70] "dBsm"  DASy
 SG_ RFC_Loc087_DistVelocityQuality : 144|8@1+ (1,0) [0|255] "unitless"  DASy
 SG_ RFC_Loc087_ElevationQuality : 152|8@1+ (1,0) [0|255] "unitless"  DASy
 SG_ RFC_Loc087_AzimuthQuality : 160|8@1+ (1,0) [0|255] "unitless"  DASy
 SG_ RFC_Loc087_RSSI : 168|10@1+ (0.1,0) [0|100] "unitless"  DASy
 SG_ RFC_Loc087_AzimuthalPartnerId : 178|10@1+ (1,0) [0|1023] "unitless"  DASy
 SG_ RFC_Loc088_RadialDistance : 192|15@1+ (0.01,0) [0|327.67] "m"  DASy
 SG_ RFC_Loc088_RadialVelocity : 207|15@1+ (0.01,-163.84) [-110|55] "m/s"  DASy
 SG_ RFC_Loc088_Elevation : 222|10@1+ (0.1,-51.2) [-45|45] "deg"  DASy
 SG_ RFC_Loc088_Azimuth : 232|11@1+ (0.1,-102.4) [-90|90] "deg"  DASy
 SG_ RFC_Loc088_DistVelocityCoVnce : 243|11@1+ (0.0001,-0.1024) [-0.1024|0.1023] "m^2/s"  DASy
 SG_ RFC_Loc088_RadialDistanceVnce : 254|10@1+ (5E-005,0) [0|0.05115] "m^2"  DASy
 SG_ RFC_Loc088_RadialVelocityVnce : 264|10@1+ (0.0001,0) [0|0.1023] "m^2/s^2"  DASy
 SG_ RFC_Loc088_ElevationVnce : 274|10@1+ (0.001,0) [0|1.023] "deg^2"  DASy
 SG_ RFC_Loc088_AzimuthVnce : 284|10@1+ (0.001,0) [0|1.023] "deg^2"  DASy
 SG_ RFC_Loc088_RadarCrossSection : 294|10@1+ (0.2,-102.4) [-50|70] "dBsm"  DASy
 SG_ RFC_Loc088_DistVelocityQuality : 304|8@1+ (1,0) [0|255] "unitless"  DASy
 SG_ RFC_Loc088_ElevationQuality : 312|8@1+ (1,0) [0|255] "unitless"  DASy
 SG_ RFC_Loc088_AzimuthQuality : 320|8@1+ (1,0) [0|255] "unitless"  DASy
 SG_ RFC_Loc088_RSSI : 328|10@1+ (0.1,0) [0|100] "unitless"  DASy
 SG_ RFC_Loc088_AzimuthalPartnerId : 338|10@1+ (1,0) [0|1023] "unitless"  DASy
 SG_ RFC_Loc089_RadialDistance : 352|15@1+ (0.01,0) [0|327.67] "m"  DASy
 SG_ RFC_Loc089_RadialVelocity : 367|15@1+ (0.01,-163.84) [-110|55] "m/s"  DASy
 SG_ RFC_Loc089_Elevation : 382|10@1+ (0.1,-51.2) [-45|45] "deg"  DASy
 SG_ RFC_Loc089_Azimuth : 392|11@1+ (0.1,-102.4) [-90|90] "deg"  DASy
 SG_ RFC_Loc089_DistVelocityCoVnce : 403|11@1+ (0.0001,-0.1024) [-0.1024|0.1023] "m^2/s"  DASy
 SG_ RFC_Loc089_RadialDistanceVnce : 414|10@1+ (5E-005,0) [0|0.05115] "m^2"  DASy
 SG_ RFC_Loc089_RadialVelocityVnce : 424|10@1+ (0.0001,0) [0|0.1023] "m^2/s^2"  DASy
 SG_ RFC_Loc089_ElevationVnce : 434|10@1+ (0.001,0) [0|1.023] "deg^2"  DASy
 SG_ RFC_Loc089_AzimuthVnce : 444|10@1+ (0.001,0) [0|1.023] "deg^2"  DASy
 SG_ RFC_Loc089_RadarCrossSection : 454|10@1+ (0.2,-102.4) [-50|70] "dBsm"  DASy
 SG_ RFC_Loc089_DistVelocityQuality : 464|8@1+ (1,0) [0|255] "unitless"  DASy
 SG_ RFC_Loc089_ElevationQuality : 472|8@1+ (1,0) [0|255] "unitless"  DASy
 SG_ RFC_Loc089_AzimuthQuality : 480|8@1+ (1,0) [0|255] "unitless"  DASy
 SG_ RFC_Loc089_RSSI : 488|10@1+ (0.1,0) [0|100] "unitless"  DASy
 SG_ RFC_Loc089_AzimuthalPartnerId : 498|10@1+ (1,0) [0|1023] "unitless"  DASy

BO_ 294 RFC_Location_090_092: 64 RadarFrontCenter
 SG_ RFC_Loc090_092_CRC : 0|16@1+ (1,0) [0|65535] ""  DASy
 SG_ RFC_Loc090_092_AliveCtr : 16|8@1+ (1,0) [0|255] ""  DASy
 SG_ RFC_Loc090_092_ProtBlockCtr : 24|4@1+ (1,0) [0|15] ""  DASy
 SG_ RFC_Loc090_RadialDistance : 32|15@1+ (0.01,0) [0|327.67] "m"  DASy
 SG_ RFC_Loc090_RadialVelocity : 47|15@1+ (0.01,-163.84) [-110|55] "m/s"  DASy
 SG_ RFC_Loc090_Elevation : 62|10@1+ (0.1,-51.2) [-45|45] "deg"  DASy
 SG_ RFC_Loc090_Azimuth : 72|11@1+ (0.1,-102.4) [-90|90] "deg"  DASy
 SG_ RFC_Loc090_DistVelocityCoVnce : 83|11@1+ (0.0001,-0.1024) [-0.1024|0.1023] "m^2/s"  DASy
 SG_ RFC_Loc090_RadialDistanceVnce : 94|10@1+ (5E-005,0) [0|0.05115] "m^2"  DASy
 SG_ RFC_Loc090_RadialVelocityVnce : 104|10@1+ (0.0001,0) [0|0.1023] "m^2/s^2"  DASy
 SG_ RFC_Loc090_ElevationVnce : 114|10@1+ (0.001,0) [0|1.023] "deg^2"  DASy
 SG_ RFC_Loc090_AzimuthVnce : 124|10@1+ (0.001,0) [0|1.023] "deg^2"  DASy
 SG_ RFC_Loc090_RadarCrossSection : 134|10@1+ (0.2,-102.4) [-50|70] "dBsm"  DASy
 SG_ RFC_Loc090_DistVelocityQuality : 144|8@1+ (1,0) [0|255] "unitless"  DASy
 SG_ RFC_Loc090_ElevationQuality : 152|8@1+ (1,0) [0|255] "unitless"  DASy
 SG_ RFC_Loc090_AzimuthQuality : 160|8@1+ (1,0) [0|255] "unitless"  DASy
 SG_ RFC_Loc090_RSSI : 168|10@1+ (0.1,0) [0|100] "unitless"  DASy
 SG_ RFC_Loc090_AzimuthalPartnerId : 178|10@1+ (1,0) [0|1023] "unitless"  DASy
 SG_ RFC_Loc091_RadialDistance : 192|15@1+ (0.01,0) [0|327.67] "m"  DASy
 SG_ RFC_Loc091_RadialVelocity : 207|15@1+ (0.01,-163.84) [-110|55] "m/s"  DASy
 SG_ RFC_Loc091_Elevation : 222|10@1+ (0.1,-51.2) [-45|45] "deg"  DASy
 SG_ RFC_Loc091_Azimuth : 232|11@1+ (0.1,-102.4) [-90|90] "deg"  DASy
 SG_ RFC_Loc091_DistVelocityCoVnce : 243|11@1+ (0.0001,-0.1024) [-0.1024|0.1023] "m^2/s"  DASy
 SG_ RFC_Loc091_RadialDistanceVnce : 254|10@1+ (5E-005,0) [0|0.05115] "m^2"  DASy
 SG_ RFC_Loc091_RadialVelocityVnce : 264|10@1+ (0.0001,0) [0|0.1023] "m^2/s^2"  DASy
 SG_ RFC_Loc091_ElevationVnce : 274|10@1+ (0.001,0) [0|1.023] "deg^2"  DASy
 SG_ RFC_Loc091_AzimuthVnce : 284|10@1+ (0.001,0) [0|1.023] "deg^2"  DASy
 SG_ RFC_Loc091_RadarCrossSection : 294|10@1+ (0.2,-102.4) [-50|70] "dBsm"  DASy
 SG_ RFC_Loc091_DistVelocityQuality : 304|8@1+ (1,0) [0|255] "unitless"  DASy
 SG_ RFC_Loc091_ElevationQuality : 312|8@1+ (1,0) [0|255] "unitless"  DASy
 SG_ RFC_Loc091_AzimuthQuality : 320|8@1+ (1,0) [0|255] "unitless"  DASy
 SG_ RFC_Loc091_RSSI : 328|10@1+ (0.1,0) [0|100] "unitless"  DASy
 SG_ RFC_Loc091_AzimuthalPartnerId : 338|10@1+ (1,0) [0|1023] "unitless"  DASy
 SG_ RFC_Loc092_RadialDistance : 352|15@1+ (0.01,0) [0|327.67] "m"  DASy
 SG_ RFC_Loc092_RadialVelocity : 367|15@1+ (0.01,-163.84) [-110|55] "m/s"  DASy
 SG_ RFC_Loc092_Elevation : 382|10@1+ (0.1,-51.2) [-45|45] "deg"  DASy
 SG_ RFC_Loc092_Azimuth : 392|11@1+ (0.1,-102.4) [-90|90] "deg"  DASy
 SG_ RFC_Loc092_DistVelocityCoVnce : 403|11@1+ (0.0001,-0.1024) [-0.1024|0.1023] "m^2/s"  DASy
 SG_ RFC_Loc092_RadialDistanceVnce : 414|10@1+ (5E-005,0) [0|0.05115] "m^2"  DASy
 SG_ RFC_Loc092_RadialVelocityVnce : 424|10@1+ (0.0001,0) [0|0.1023] "m^2/s^2"  DASy
 SG_ RFC_Loc092_ElevationVnce : 434|10@1+ (0.001,0) [0|1.023] "deg^2"  DASy
 SG_ RFC_Loc092_AzimuthVnce : 444|10@1+ (0.001,0) [0|1.023] "deg^2"  DASy
 SG_ RFC_Loc092_RadarCrossSection : 454|10@1+ (0.2,-102.4) [-50|70] "dBsm"  DASy
 SG_ RFC_Loc092_DistVelocityQuality : 464|8@1+ (1,0) [0|255] "unitless"  DASy
 SG_ RFC_Loc092_ElevationQuality : 472|8@1+ (1,0) [0|255] "unitless"  DASy
 SG_ RFC_Loc092_AzimuthQuality : 480|8@1+ (1,0) [0|255] "unitless"  DASy
 SG_ RFC_Loc092_RSSI : 488|10@1+ (0.1,0) [0|100] "unitless"  DASy
 SG_ RFC_Loc092_AzimuthalPartnerId : 498|10@1+ (1,0) [0|1023] "unitless"  DASy

BO_ 295 RFC_Location_093_095: 64 RadarFrontCenter
 SG_ RFC_Loc093_095_CRC : 0|16@1+ (1,0) [0|65535] ""  DASy
 SG_ RFC_Loc093_095_AliveCtr : 16|8@1+ (1,0) [0|255] ""  DASy
 SG_ RFC_Loc093_095_ProtBlockCtr : 24|4@1+ (1,0) [0|15] ""  DASy
 SG_ RFC_Loc093_RadialDistance : 32|15@1+ (0.01,0) [0|327.67] "m"  DASy
 SG_ RFC_Loc093_RadialVelocity : 47|15@1+ (0.01,-163.84) [-110|55] "m/s"  DASy
 SG_ RFC_Loc093_Elevation : 62|10@1+ (0.1,-51.2) [-45|45] "deg"  DASy
 SG_ RFC_Loc093_Azimuth : 72|11@1+ (0.1,-102.4) [-90|90] "deg"  DASy
 SG_ RFC_Loc093_DistVelocityCoVnce : 83|11@1+ (0.0001,-0.1024) [-0.1024|0.1023] "m^2/s"  DASy
 SG_ RFC_Loc093_RadialDistanceVnce : 94|10@1+ (5E-005,0) [0|0.05115] "m^2"  DASy
 SG_ RFC_Loc093_RadialVelocityVnce : 104|10@1+ (0.0001,0) [0|0.1023] "m^2/s^2"  DASy
 SG_ RFC_Loc093_ElevationVnce : 114|10@1+ (0.001,0) [0|1.023] "deg^2"  DASy
 SG_ RFC_Loc093_AzimuthVnce : 124|10@1+ (0.001,0) [0|1.023] "deg^2"  DASy
 SG_ RFC_Loc093_RadarCrossSection : 134|10@1+ (0.2,-102.4) [-50|70] "dBsm"  DASy
 SG_ RFC_Loc093_DistVelocityQuality : 144|8@1+ (1,0) [0|255] "unitless"  DASy
 SG_ RFC_Loc093_ElevationQuality : 152|8@1+ (1,0) [0|255] "unitless"  DASy
 SG_ RFC_Loc093_AzimuthQuality : 160|8@1+ (1,0) [0|255] "unitless"  DASy
 SG_ RFC_Loc093_RSSI : 168|10@1+ (0.1,0) [0|100] "unitless"  DASy
 SG_ RFC_Loc093_AzimuthalPartnerId : 178|10@1+ (1,0) [0|1023] "unitless"  DASy
 SG_ RFC_Loc094_RadialDistance : 192|15@1+ (0.01,0) [0|327.67] "m"  DASy
 SG_ RFC_Loc094_RadialVelocity : 207|15@1+ (0.01,-163.84) [-110|55] "m/s"  DASy
 SG_ RFC_Loc094_Elevation : 222|10@1+ (0.1,-51.2) [-45|45] "deg"  DASy
 SG_ RFC_Loc094_Azimuth : 232|11@1+ (0.1,-102.4) [-90|90] "deg"  DASy
 SG_ RFC_Loc094_DistVelocityCoVnce : 243|11@1+ (0.0001,-0.1024) [-0.1024|0.1023] "m^2/s"  DASy
 SG_ RFC_Loc094_RadialDistanceVnce : 254|10@1+ (5E-005,0) [0|0.05115] "m^2"  DASy
 SG_ RFC_Loc094_RadialVelocityVnce : 264|10@1+ (0.0001,0) [0|0.1023] "m^2/s^2"  DASy
 SG_ RFC_Loc094_ElevationVnce : 274|10@1+ (0.001,0) [0|1.023] "deg^2"  DASy
 SG_ RFC_Loc094_AzimuthVnce : 284|10@1+ (0.001,0) [0|1.023] "deg^2"  DASy
 SG_ RFC_Loc094_RadarCrossSection : 294|10@1+ (0.2,-102.4) [-50|70] "dBsm"  DASy
 SG_ RFC_Loc094_DistVelocityQuality : 304|8@1+ (1,0) [0|255] "unitless"  DASy
 SG_ RFC_Loc094_ElevationQuality : 312|8@1+ (1,0) [0|255] "unitless"  DASy
 SG_ RFC_Loc094_AzimuthQuality : 320|8@1+ (1,0) [0|255] "unitless"  DASy
 SG_ RFC_Loc094_RSSI : 328|10@1+ (0.1,0) [0|100] "unitless"  DASy
 SG_ RFC_Loc094_AzimuthalPartnerId : 338|10@1+ (1,0) [0|1023] "unitless"  DASy
 SG_ RFC_Loc095_RadialDistance : 352|15@1+ (0.01,0) [0|327.67] "m"  DASy
 SG_ RFC_Loc095_RadialVelocity : 367|15@1+ (0.01,-163.84) [-110|55] "m/s"  DASy
 SG_ RFC_Loc095_Elevation : 382|10@1+ (0.1,-51.2) [-45|45] "deg"  DASy
 SG_ RFC_Loc095_Azimuth : 392|11@1+ (0.1,-102.4) [-90|90] "deg"  DASy
 SG_ RFC_Loc095_DistVelocityCoVnce : 403|11@1+ (0.0001,-0.1024) [-0.1024|0.1023] "m^2/s"  DASy
 SG_ RFC_Loc095_RadialDistanceVnce : 414|10@1+ (5E-005,0) [0|0.05115] "m^2"  DASy
 SG_ RFC_Loc095_RadialVelocityVnce : 424|10@1+ (0.0001,0) [0|0.1023] "m^2/s^2"  DASy
 SG_ RFC_Loc095_ElevationVnce : 434|10@1+ (0.001,0) [0|1.023] "deg^2"  DASy
 SG_ RFC_Loc095_AzimuthVnce : 444|10@1+ (0.001,0) [0|1.023] "deg^2"  DASy
 SG_ RFC_Loc095_RadarCrossSection : 454|10@1+ (0.2,-102.4) [-50|70] "dBsm"  DASy
 SG_ RFC_Loc095_DistVelocityQuality : 464|8@1+ (1,0) [0|255] "unitless"  DASy
 SG_ RFC_Loc095_ElevationQuality : 472|8@1+ (1,0) [0|255] "unitless"  DASy
 SG_ RFC_Loc095_AzimuthQuality : 480|8@1+ (1,0) [0|255] "unitless"  DASy
 SG_ RFC_Loc095_RSSI : 488|10@1+ (0.1,0) [0|100] "unitless"  DASy
 SG_ RFC_Loc095_AzimuthalPartnerId : 498|10@1+ (1,0) [0|1023] "unitless"  DASy

CM_ SG_ 281 RFC_Loc051_053_CRC "CRC - Autosar E2E Profile 5";
CM_ SG_ 281 RFC_Loc051_053_AliveCtr "Alive counter - Autosar E2E Profile 5";
CM_ SG_ 281 RFC_Loc051_053_ProtBlockCtr "Protocol-Signal: Block-Counter";
CM_ SG_ 281 RFC_Loc051_RadialDistance "Location radial distance. Represented in conical coordinate system. Same as ISO 23150:2021(E): Position radial distance (A.4.16)";
CM_ SG_ 281 RFC_Loc051_RadialVelocity "Location radial relative velocity ISO 23150:2021(E): Relative velocity {radial distance} (A.4.18)";
CM_ SG_ 281 RFC_Loc051_Elevation "Location elevation angle. Represented in conical coordinate system. Same as ISO 23150:2021(E): Position elevation (A.4.16)";
CM_ SG_ 281 RFC_Loc051_Azimuth "Location azimuth angle. Represented in conical coordinate system. Deviation from ISO 23150:2021(E): Position azimuth (A.4.16). Further details refers to DSP Location Interface definition";
CM_ SG_ 281 RFC_Loc051_DistVelocityCoVnce "Covariance of radial distance and radial velocity";
CM_ SG_ 281 RFC_Loc051_RadialDistanceVnce "Variance of Location radial distance ISO 23150:2021(E): Position radial distance - error (A.4.17)";
CM_ SG_ 281 RFC_Loc051_RadialVelocityVnce "Variance of Location radial relative velocity ISO 23150:2021(E): Relative velocity {radial distance} - error (A.4.19)";
CM_ SG_ 281 RFC_Loc051_ElevationVnce "Variance of Location elevation angle ISO 23150:2021(E): Position elevation - error (A.4.17)";
CM_ SG_ 281 RFC_Loc051_AzimuthVnce "Variance of Location azimuth angle ISO 23150:2021(E): Position azimuth - error (A.4.17)";
CM_ SG_ 281 RFC_Loc051_RadarCrossSection "Radar Cross Section (RCS) estimation ISO 23150:2021(E): Radar cross section (A.4.5)";
CM_ SG_ 281 RFC_Loc051_DistVelocityQuality "Quality of radial distance and velocity resolution processing. Physical range [0..1]";
CM_ SG_ 281 RFC_Loc051_ElevationQuality "Probability for correct signal model (elevation angle). Physical range [0..1]";
CM_ SG_ 281 RFC_Loc051_AzimuthQuality "Probability for correct signal model (azimuth angle). Physical range [0..1]";
CM_ SG_ 281 RFC_Loc051_RSSI "Received Signal Strength Indication (RSSI). This signal is not exactly ISO 23150:2021(E): Signal to noise ratio - detection level (A.4.7), but SNR can be calculated from this signal. Further detail please refer to the DSP Location Interface definition";
CM_ SG_ 281 RFC_Loc051_AzimuthalPartnerId "Id of the azimuthal partner location";
CM_ SG_ 281 RFC_Loc052_RadialDistance "Location radial distance. Represented in conical coordinate system. Same as ISO 23150:2021(E): Position radial distance (A.4.16)";
CM_ SG_ 281 RFC_Loc052_RadialVelocity "Location radial relative velocity ISO 23150:2021(E): Relative velocity {radial distance} (A.4.18)";
CM_ SG_ 281 RFC_Loc052_Elevation "Location elevation angle. Represented in conical coordinate system. Same as ISO 23150:2021(E): Position elevation (A.4.16)";
CM_ SG_ 281 RFC_Loc052_Azimuth "Location azimuth angle. Represented in conical coordinate system. Deviation from ISO 23150:2021(E): Position azimuth (A.4.16). Further details refers to DSP Location Interface definition";
CM_ SG_ 281 RFC_Loc052_DistVelocityCoVnce "Covariance of radial distance and radial velocity";
CM_ SG_ 281 RFC_Loc052_RadialDistanceVnce "Variance of Location radial distance ISO 23150:2021(E): Position radial distance - error (A.4.17)";
CM_ SG_ 281 RFC_Loc052_RadialVelocityVnce "Variance of Location radial relative velocity ISO 23150:2021(E): Relative velocity {radial distance} - error (A.4.19)";
CM_ SG_ 281 RFC_Loc052_ElevationVnce "Variance of Location elevation angle ISO 23150:2021(E): Position elevation - error (A.4.17)";
CM_ SG_ 281 RFC_Loc052_AzimuthVnce "Variance of Location azimuth angle ISO 23150:2021(E): Position azimuth - error (A.4.17)";
CM_ SG_ 281 RFC_Loc052_RadarCrossSection "Radar Cross Section (RCS) estimation ISO 23150:2021(E): Radar cross section (A.4.5)";
CM_ SG_ 281 RFC_Loc052_DistVelocityQuality "Quality of radial distance and velocity resolution processing. Physical range [0..1]";
CM_ SG_ 281 RFC_Loc052_ElevationQuality "Probability for correct signal model (elevation angle). Physical range [0..1]";
CM_ SG_ 281 RFC_Loc052_AzimuthQuality "Probability for correct signal model (azimuth angle). Physical range [0..1]";
CM_ SG_ 281 RFC_Loc052_RSSI "Received Signal Strength Indication (RSSI). This signal is not exactly ISO 23150:2021(E): Signal to noise ratio - detection level (A.4.7), but SNR can be calculated from this signal. Further detail please refer to the DSP Location Interface definition";
CM_ SG_ 281 RFC_Loc052_AzimuthalPartnerId "Id of the azimuthal partner location";
CM_ SG_ 281 RFC_Loc053_RadialDistance "Location radial distance. Represented in conical coordinate system. Same as ISO 23150:2021(E): Position radial distance (A.4.16)";
CM_ SG_ 281 RFC_Loc053_RadialVelocity "Location radial relative velocity ISO 23150:2021(E): Relative velocity {radial distance} (A.4.18)";
CM_ SG_ 281 RFC_Loc053_Elevation "Location elevation angle. Represented in conical coordinate system. Same as ISO 23150:2021(E): Position elevation (A.4.16)";
CM_ SG_ 281 RFC_Loc053_Azimuth "Location azimuth angle. Represented in conical coordinate system. Deviation from ISO 23150:2021(E): Position azimuth (A.4.16). Further details refers to DSP Location Interface definition";
CM_ SG_ 281 RFC_Loc053_DistVelocityCoVnce "Covariance of radial distance and radial velocity";
CM_ SG_ 281 RFC_Loc053_RadialDistanceVnce "Variance of Location radial distance ISO 23150:2021(E): Position radial distance - error (A.4.17)";
CM_ SG_ 281 RFC_Loc053_RadialVelocityVnce "Variance of Location radial relative velocity ISO 23150:2021(E): Relative velocity {radial distance} - error (A.4.19)";
CM_ SG_ 281 RFC_Loc053_ElevationVnce "Variance of Location elevation angle ISO 23150:2021(E): Position elevation - error (A.4.17)";
CM_ SG_ 281 RFC_Loc053_AzimuthVnce "Variance of Location azimuth angle ISO 23150:2021(E): Position azimuth - error (A.4.17)";
CM_ SG_ 281 RFC_Loc053_RadarCrossSection "Radar Cross Section (RCS) estimation ISO 23150:2021(E): Radar cross section (A.4.5)";
CM_ SG_ 281 RFC_Loc053_DistVelocityQuality "Quality of radial distance and velocity resolution processing. Physical range [0..1]";
CM_ SG_ 281 RFC_Loc053_ElevationQuality "Probability for correct signal model (elevation angle). Physical range [0..1]";
CM_ SG_ 281 RFC_Loc053_AzimuthQuality "Probability for correct signal model (azimuth angle). Physical range [0..1]";
CM_ SG_ 281 RFC_Loc053_RSSI "Received Signal Strength Indication (RSSI). This signal is not exactly ISO 23150:2021(E): Signal to noise ratio - detection level (A.4.7), but SNR can be calculated from this signal. Further detail please refer to the DSP Location Interface definition";
CM_ SG_ 281 RFC_Loc053_AzimuthalPartnerId "Id of the azimuthal partner location";
CM_ SG_ 282 RFC_Loc054_056_CRC "CRC - Autosar E2E Profile 5";
CM_ SG_ 282 RFC_Loc054_056_AliveCtr "Alive counter - Autosar E2E Profile 5";
CM_ SG_ 282 RFC_Loc054_056_ProtBlockCtr "Protocol-Signal: Block-Counter";
CM_ SG_ 282 RFC_Loc054_RadialDistance "Location radial distance. Represented in conical coordinate system. Same as ISO 23150:2021(E): Position radial distance (A.4.16)";
CM_ SG_ 282 RFC_Loc054_RadialVelocity "Location radial relative velocity ISO 23150:2021(E): Relative velocity {radial distance} (A.4.18)";
CM_ SG_ 282 RFC_Loc054_Elevation "Location elevation angle. Represented in conical coordinate system. Same as ISO 23150:2021(E): Position elevation (A.4.16)";
CM_ SG_ 282 RFC_Loc054_Azimuth "Location azimuth angle. Represented in conical coordinate system. Deviation from ISO 23150:2021(E): Position azimuth (A.4.16). Further details refers to DSP Location Interface definition";
CM_ SG_ 282 RFC_Loc054_DistVelocityCoVnce "Covariance of radial distance and radial velocity";
CM_ SG_ 282 RFC_Loc054_RadialDistanceVnce "Variance of Location radial distance ISO 23150:2021(E): Position radial distance - error (A.4.17)";
CM_ SG_ 282 RFC_Loc054_RadialVelocityVnce "Variance of Location radial relative velocity ISO 23150:2021(E): Relative velocity {radial distance} - error (A.4.19)";
CM_ SG_ 282 RFC_Loc054_ElevationVnce "Variance of Location elevation angle ISO 23150:2021(E): Position elevation - error (A.4.17)";
CM_ SG_ 282 RFC_Loc054_AzimuthVnce "Variance of Location azimuth angle ISO 23150:2021(E): Position azimuth - error (A.4.17)";
CM_ SG_ 282 RFC_Loc054_RadarCrossSection "Radar Cross Section (RCS) estimation ISO 23150:2021(E): Radar cross section (A.4.5)";
CM_ SG_ 282 RFC_Loc054_DistVelocityQuality "Quality of radial distance and velocity resolution processing. Physical range [0..1]";
CM_ SG_ 282 RFC_Loc054_ElevationQuality "Probability for correct signal model (elevation angle). Physical range [0..1]";
CM_ SG_ 282 RFC_Loc054_AzimuthQuality "Probability for correct signal model (azimuth angle). Physical range [0..1]";
CM_ SG_ 282 RFC_Loc054_RSSI "Received Signal Strength Indication (RSSI). This signal is not exactly ISO 23150:2021(E): Signal to noise ratio - detection level (A.4.7), but SNR can be calculated from this signal. Further detail please refer to the DSP Location Interface definition";
CM_ SG_ 282 RFC_Loc054_AzimuthalPartnerId "Id of the azimuthal partner location";
CM_ SG_ 282 RFC_Loc055_RadialDistance "Location radial distance. Represented in conical coordinate system. Same as ISO 23150:2021(E): Position radial distance (A.4.16)";
CM_ SG_ 282 RFC_Loc055_RadialVelocity "Location radial relative velocity ISO 23150:2021(E): Relative velocity {radial distance} (A.4.18)";
CM_ SG_ 282 RFC_Loc055_Elevation "Location elevation angle. Represented in conical coordinate system. Same as ISO 23150:2021(E): Position elevation (A.4.16)";
CM_ SG_ 282 RFC_Loc055_Azimuth "Location azimuth angle. Represented in conical coordinate system. Deviation from ISO 23150:2021(E): Position azimuth (A.4.16). Further details refers to DSP Location Interface definition";
CM_ SG_ 282 RFC_Loc055_DistVelocityCoVnce "Covariance of radial distance and radial velocity";
CM_ SG_ 282 RFC_Loc055_RadialDistanceVnce "Variance of Location radial distance ISO 23150:2021(E): Position radial distance - error (A.4.17)";
CM_ SG_ 282 RFC_Loc055_RadialVelocityVnce "Variance of Location radial relative velocity ISO 23150:2021(E): Relative velocity {radial distance} - error (A.4.19)";
CM_ SG_ 282 RFC_Loc055_ElevationVnce "Variance of Location elevation angle ISO 23150:2021(E): Position elevation - error (A.4.17)";
CM_ SG_ 282 RFC_Loc055_AzimuthVnce "Variance of Location azimuth angle ISO 23150:2021(E): Position azimuth - error (A.4.17)";
CM_ SG_ 282 RFC_Loc055_RadarCrossSection "Radar Cross Section (RCS) estimation ISO 23150:2021(E): Radar cross section (A.4.5)";
CM_ SG_ 282 RFC_Loc055_DistVelocityQuality "Quality of radial distance and velocity resolution processing. Physical range [0..1]";
CM_ SG_ 282 RFC_Loc055_ElevationQuality "Probability for correct signal model (elevation angle). Physical range [0..1]";
CM_ SG_ 282 RFC_Loc055_AzimuthQuality "Probability for correct signal model (azimuth angle). Physical range [0..1]";
CM_ SG_ 282 RFC_Loc055_RSSI "Received Signal Strength Indication (RSSI). This signal is not exactly ISO 23150:2021(E): Signal to noise ratio - detection level (A.4.7), but SNR can be calculated from this signal. Further detail please refer to the DSP Location Interface definition";
CM_ SG_ 282 RFC_Loc055_AzimuthalPartnerId "Id of the azimuthal partner location";
CM_ SG_ 282 RFC_Loc056_RadialDistance "Location radial distance. Represented in conical coordinate system. Same as ISO 23150:2021(E): Position radial distance (A.4.16)";
CM_ SG_ 282 RFC_Loc056_RadialVelocity "Location radial relative velocity ISO 23150:2021(E): Relative velocity {radial distance} (A.4.18)";
CM_ SG_ 282 RFC_Loc056_Elevation "Location elevation angle. Represented in conical coordinate system. Same as ISO 23150:2021(E): Position elevation (A.4.16)";
CM_ SG_ 282 RFC_Loc056_Azimuth "Location azimuth angle. Represented in conical coordinate system. Deviation from ISO 23150:2021(E): Position azimuth (A.4.16). Further details refers to DSP Location Interface definition";
CM_ SG_ 282 RFC_Loc056_DistVelocityCoVnce "Covariance of radial distance and radial velocity";
CM_ SG_ 282 RFC_Loc056_RadialDistanceVnce "Variance of Location radial distance ISO 23150:2021(E): Position radial distance - error (A.4.17)";
CM_ SG_ 282 RFC_Loc056_RadialVelocityVnce "Variance of Location radial relative velocity ISO 23150:2021(E): Relative velocity {radial distance} - error (A.4.19)";
CM_ SG_ 282 RFC_Loc056_ElevationVnce "Variance of Location elevation angle ISO 23150:2021(E): Position elevation - error (A.4.17)";
CM_ SG_ 282 RFC_Loc056_AzimuthVnce "Variance of Location azimuth angle ISO 23150:2021(E): Position azimuth - error (A.4.17)";
CM_ SG_ 282 RFC_Loc056_RadarCrossSection "Radar Cross Section (RCS) estimation ISO 23150:2021(E): Radar cross section (A.4.5)";
CM_ SG_ 282 RFC_Loc056_DistVelocityQuality "Quality of radial distance and velocity resolution processing. Physical range [0..1]";
CM_ SG_ 282 RFC_Loc056_ElevationQuality "Probability for correct signal model (elevation angle). Physical range [0..1]";
CM_ SG_ 282 RFC_Loc056_AzimuthQuality "Probability for correct signal model (azimuth angle). Physical range [0..1]";
CM_ SG_ 282 RFC_Loc056_RSSI "Received Signal Strength Indication (RSSI). This signal is not exactly ISO 23150:2021(E): Signal to noise ratio - detection level (A.4.7), but SNR can be calculated from this signal. Further detail please refer to the DSP Location Interface definition";
CM_ SG_ 282 RFC_Loc056_AzimuthalPartnerId "Id of the azimuthal partner location";
CM_ SG_ 283 RFC_Loc057_059_CRC "CRC - Autosar E2E Profile 5";
CM_ SG_ 283 RFC_Loc057_059_AliveCtr "Alive counter - Autosar E2E Profile 5";
CM_ SG_ 283 RFC_Loc057_059_ProtBlockCtr "Protocol-Signal: Block-Counter";
CM_ SG_ 283 RFC_Loc057_RadialDistance "Location radial distance. Represented in conical coordinate system. Same as ISO 23150:2021(E): Position radial distance (A.4.16)";
CM_ SG_ 283 RFC_Loc057_RadialVelocity "Location radial relative velocity ISO 23150:2021(E): Relative velocity {radial distance} (A.4.18)";
CM_ SG_ 283 RFC_Loc057_Elevation "Location elevation angle. Represented in conical coordinate system. Same as ISO 23150:2021(E): Position elevation (A.4.16)";
CM_ SG_ 283 RFC_Loc057_Azimuth "Location azimuth angle. Represented in conical coordinate system. Deviation from ISO 23150:2021(E): Position azimuth (A.4.16). Further details refers to DSP Location Interface definition";
CM_ SG_ 283 RFC_Loc057_DistVelocityCoVnce "Covariance of radial distance and radial velocity";
CM_ SG_ 283 RFC_Loc057_RadialDistanceVnce "Variance of Location radial distance ISO 23150:2021(E): Position radial distance - error (A.4.17)";
CM_ SG_ 283 RFC_Loc057_RadialVelocityVnce "Variance of Location radial relative velocity ISO 23150:2021(E): Relative velocity {radial distance} - error (A.4.19)";
CM_ SG_ 283 RFC_Loc057_ElevationVnce "Variance of Location elevation angle ISO 23150:2021(E): Position elevation - error (A.4.17)";
CM_ SG_ 283 RFC_Loc057_AzimuthVnce "Variance of Location azimuth angle ISO 23150:2021(E): Position azimuth - error (A.4.17)";
CM_ SG_ 283 RFC_Loc057_RadarCrossSection "Radar Cross Section (RCS) estimation ISO 23150:2021(E): Radar cross section (A.4.5)";
CM_ SG_ 283 RFC_Loc057_DistVelocityQuality "Quality of radial distance and velocity resolution processing. Physical range [0..1]";
CM_ SG_ 283 RFC_Loc057_ElevationQuality "Probability for correct signal model (elevation angle). Physical range [0..1]";
CM_ SG_ 283 RFC_Loc057_AzimuthQuality "Probability for correct signal model (azimuth angle). Physical range [0..1]";
CM_ SG_ 283 RFC_Loc057_RSSI "Received Signal Strength Indication (RSSI). This signal is not exactly ISO 23150:2021(E): Signal to noise ratio - detection level (A.4.7), but SNR can be calculated from this signal. Further detail please refer to the DSP Location Interface definition";
CM_ SG_ 283 RFC_Loc057_AzimuthalPartnerId "Id of the azimuthal partner location";
CM_ SG_ 283 RFC_Loc058_RadialDistance "Location radial distance. Represented in conical coordinate system. Same as ISO 23150:2021(E): Position radial distance (A.4.16)";
CM_ SG_ 283 RFC_Loc058_RadialVelocity "Location radial relative velocity ISO 23150:2021(E): Relative velocity {radial distance} (A.4.18)";
CM_ SG_ 283 RFC_Loc058_Elevation "Location elevation angle. Represented in conical coordinate system. Same as ISO 23150:2021(E): Position elevation (A.4.16)";
CM_ SG_ 283 RFC_Loc058_Azimuth "Location azimuth angle. Represented in conical coordinate system. Deviation from ISO 23150:2021(E): Position azimuth (A.4.16). Further details refers to DSP Location Interface definition";
CM_ SG_ 283 RFC_Loc058_DistVelocityCoVnce "Covariance of radial distance and radial velocity";
CM_ SG_ 283 RFC_Loc058_RadialDistanceVnce "Variance of Location radial distance ISO 23150:2021(E): Position radial distance - error (A.4.17)";
CM_ SG_ 283 RFC_Loc058_RadialVelocityVnce "Variance of Location radial relative velocity ISO 23150:2021(E): Relative velocity {radial distance} - error (A.4.19)";
CM_ SG_ 283 RFC_Loc058_ElevationVnce "Variance of Location elevation angle ISO 23150:2021(E): Position elevation - error (A.4.17)";
CM_ SG_ 283 RFC_Loc058_AzimuthVnce "Variance of Location azimuth angle ISO 23150:2021(E): Position azimuth - error (A.4.17)";
CM_ SG_ 283 RFC_Loc058_RadarCrossSection "Radar Cross Section (RCS) estimation ISO 23150:2021(E): Radar cross section (A.4.5)";
CM_ SG_ 283 RFC_Loc058_DistVelocityQuality "Quality of radial distance and velocity resolution processing. Physical range [0..1]";
CM_ SG_ 283 RFC_Loc058_ElevationQuality "Probability for correct signal model (elevation angle). Physical range [0..1]";
CM_ SG_ 283 RFC_Loc058_AzimuthQuality "Probability for correct signal model (azimuth angle). Physical range [0..1]";
CM_ SG_ 283 RFC_Loc058_RSSI "Received Signal Strength Indication (RSSI). This signal is not exactly ISO 23150:2021(E): Signal to noise ratio - detection level (A.4.7), but SNR can be calculated from this signal. Further detail please refer to the DSP Location Interface definition";
CM_ SG_ 283 RFC_Loc058_AzimuthalPartnerId "Id of the azimuthal partner location";
CM_ SG_ 283 RFC_Loc059_RadialDistance "Location radial distance. Represented in conical coordinate system. Same as ISO 23150:2021(E): Position radial distance (A.4.16)";
CM_ SG_ 283 RFC_Loc059_RadialVelocity "Location radial relative velocity ISO 23150:2021(E): Relative velocity {radial distance} (A.4.18)";
CM_ SG_ 283 RFC_Loc059_Elevation "Location elevation angle. Represented in conical coordinate system. Same as ISO 23150:2021(E): Position elevation (A.4.16)";
CM_ SG_ 283 RFC_Loc059_Azimuth "Location azimuth angle. Represented in conical coordinate system. Deviation from ISO 23150:2021(E): Position azimuth (A.4.16). Further details refers to DSP Location Interface definition";
CM_ SG_ 283 RFC_Loc059_DistVelocityCoVnce "Covariance of radial distance and radial velocity";
CM_ SG_ 283 RFC_Loc059_RadialDistanceVnce "Variance of Location radial distance ISO 23150:2021(E): Position radial distance - error (A.4.17)";
CM_ SG_ 283 RFC_Loc059_RadialVelocityVnce "Variance of Location radial relative velocity ISO 23150:2021(E): Relative velocity {radial distance} - error (A.4.19)";
CM_ SG_ 283 RFC_Loc059_ElevationVnce "Variance of Location elevation angle ISO 23150:2021(E): Position elevation - error (A.4.17)";
CM_ SG_ 283 RFC_Loc059_AzimuthVnce "Variance of Location azimuth angle ISO 23150:2021(E): Position azimuth - error (A.4.17)";
CM_ SG_ 283 RFC_Loc059_RadarCrossSection "Radar Cross Section (RCS) estimation ISO 23150:2021(E): Radar cross section (A.4.5)";
CM_ SG_ 283 RFC_Loc059_DistVelocityQuality "Quality of radial distance and velocity resolution processing. Physical range [0..1]";
CM_ SG_ 283 RFC_Loc059_ElevationQuality "Probability for correct signal model (elevation angle). Physical range [0..1]";
CM_ SG_ 283 RFC_Loc059_AzimuthQuality "Probability for correct signal model (azimuth angle). Physical range [0..1]";
CM_ SG_ 283 RFC_Loc059_RSSI "Received Signal Strength Indication (RSSI). This signal is not exactly ISO 23150:2021(E): Signal to noise ratio - detection level (A.4.7), but SNR can be calculated from this signal. Further detail please refer to the DSP Location Interface definition";
CM_ SG_ 283 RFC_Loc059_AzimuthalPartnerId "Id of the azimuthal partner location";
CM_ SG_ 284 RFC_Loc060_062_CRC "CRC - Autosar E2E Profile 5";
CM_ SG_ 284 RFC_Loc060_062_AliveCtr "Alive counter - Autosar E2E Profile 5";
CM_ SG_ 284 RFC_Loc060_062_ProtBlockCtr "Protocol-Signal: Block-Counter";
CM_ SG_ 284 RFC_Loc060_RadialDistance "Location radial distance. Represented in conical coordinate system. Same as ISO 23150:2021(E): Position radial distance (A.4.16)";
CM_ SG_ 284 RFC_Loc060_RadialVelocity "Location radial relative velocity ISO 23150:2021(E): Relative velocity {radial distance} (A.4.18)";
CM_ SG_ 284 RFC_Loc060_Elevation "Location elevation angle. Represented in conical coordinate system. Same as ISO 23150:2021(E): Position elevation (A.4.16)";
CM_ SG_ 284 RFC_Loc060_Azimuth "Location azimuth angle. Represented in conical coordinate system. Deviation from ISO 23150:2021(E): Position azimuth (A.4.16). Further details refers to DSP Location Interface definition";
CM_ SG_ 284 RFC_Loc060_DistVelocityCoVnce "Covariance of radial distance and radial velocity";
CM_ SG_ 284 RFC_Loc060_RadialDistanceVnce "Variance of Location radial distance ISO 23150:2021(E): Position radial distance - error (A.4.17)";
CM_ SG_ 284 RFC_Loc060_RadialVelocityVnce "Variance of Location radial relative velocity ISO 23150:2021(E): Relative velocity {radial distance} - error (A.4.19)";
CM_ SG_ 284 RFC_Loc060_ElevationVnce "Variance of Location elevation angle ISO 23150:2021(E): Position elevation - error (A.4.17)";
CM_ SG_ 284 RFC_Loc060_AzimuthVnce "Variance of Location azimuth angle ISO 23150:2021(E): Position azimuth - error (A.4.17)";
CM_ SG_ 284 RFC_Loc060_RadarCrossSection "Radar Cross Section (RCS) estimation ISO 23150:2021(E): Radar cross section (A.4.5)";
CM_ SG_ 284 RFC_Loc060_DistVelocityQuality "Quality of radial distance and velocity resolution processing. Physical range [0..1]";
CM_ SG_ 284 RFC_Loc060_ElevationQuality "Probability for correct signal model (elevation angle). Physical range [0..1]";
CM_ SG_ 284 RFC_Loc060_AzimuthQuality "Probability for correct signal model (azimuth angle). Physical range [0..1]";
CM_ SG_ 284 RFC_Loc060_RSSI "Received Signal Strength Indication (RSSI). This signal is not exactly ISO 23150:2021(E): Signal to noise ratio - detection level (A.4.7), but SNR can be calculated from this signal. Further detail please refer to the DSP Location Interface definition";
CM_ SG_ 284 RFC_Loc060_AzimuthalPartnerId "Id of the azimuthal partner location";
CM_ SG_ 284 RFC_Loc061_RadialDistance "Location radial distance. Represented in conical coordinate system. Same as ISO 23150:2021(E): Position radial distance (A.4.16)";
CM_ SG_ 284 RFC_Loc061_RadialVelocity "Location radial relative velocity ISO 23150:2021(E): Relative velocity {radial distance} (A.4.18)";
CM_ SG_ 284 RFC_Loc061_Elevation "Location elevation angle. Represented in conical coordinate system. Same as ISO 23150:2021(E): Position elevation (A.4.16)";
CM_ SG_ 284 RFC_Loc061_Azimuth "Location azimuth angle. Represented in conical coordinate system. Deviation from ISO 23150:2021(E): Position azimuth (A.4.16). Further details refers to DSP Location Interface definition";
CM_ SG_ 284 RFC_Loc061_DistVelocityCoVnce "Covariance of radial distance and radial velocity";
CM_ SG_ 284 RFC_Loc061_RadialDistanceVnce "Variance of Location radial distance ISO 23150:2021(E): Position radial distance - error (A.4.17)";
CM_ SG_ 284 RFC_Loc061_RadialVelocityVnce "Variance of Location radial relative velocity ISO 23150:2021(E): Relative velocity {radial distance} - error (A.4.19)";
CM_ SG_ 284 RFC_Loc061_ElevationVnce "Variance of Location elevation angle ISO 23150:2021(E): Position elevation - error (A.4.17)";
CM_ SG_ 284 RFC_Loc061_AzimuthVnce "Variance of Location azimuth angle ISO 23150:2021(E): Position azimuth - error (A.4.17)";
CM_ SG_ 284 RFC_Loc061_RadarCrossSection "Radar Cross Section (RCS) estimation ISO 23150:2021(E): Radar cross section (A.4.5)";
CM_ SG_ 284 RFC_Loc061_DistVelocityQuality "Quality of radial distance and velocity resolution processing. Physical range [0..1]";
CM_ SG_ 284 RFC_Loc061_ElevationQuality "Probability for correct signal model (elevation angle). Physical range [0..1]";
CM_ SG_ 284 RFC_Loc061_AzimuthQuality "Probability for correct signal model (azimuth angle). Physical range [0..1]";
CM_ SG_ 284 RFC_Loc061_RSSI "Received Signal Strength Indication (RSSI). This signal is not exactly ISO 23150:2021(E): Signal to noise ratio - detection level (A.4.7), but SNR can be calculated from this signal. Further detail please refer to the DSP Location Interface definition";
CM_ SG_ 284 RFC_Loc061_AzimuthalPartnerId "Id of the azimuthal partner location";
CM_ SG_ 284 RFC_Loc062_RadialDistance "Location radial distance. Represented in conical coordinate system. Same as ISO 23150:2021(E): Position radial distance (A.4.16)";
CM_ SG_ 284 RFC_Loc062_RadialVelocity "Location radial relative velocity ISO 23150:2021(E): Relative velocity {radial distance} (A.4.18)";
CM_ SG_ 284 RFC_Loc062_Elevation "Location elevation angle. Represented in conical coordinate system. Same as ISO 23150:2021(E): Position elevation (A.4.16)";
CM_ SG_ 284 RFC_Loc062_Azimuth "Location azimuth angle. Represented in conical coordinate system. Deviation from ISO 23150:2021(E): Position azimuth (A.4.16). Further details refers to DSP Location Interface definition";
CM_ SG_ 284 RFC_Loc062_DistVelocityCoVnce "Covariance of radial distance and radial velocity";
CM_ SG_ 284 RFC_Loc062_RadialDistanceVnce "Variance of Location radial distance ISO 23150:2021(E): Position radial distance - error (A.4.17)";
CM_ SG_ 284 RFC_Loc062_RadialVelocityVnce "Variance of Location radial relative velocity ISO 23150:2021(E): Relative velocity {radial distance} - error (A.4.19)";
CM_ SG_ 284 RFC_Loc062_ElevationVnce "Variance of Location elevation angle ISO 23150:2021(E): Position elevation - error (A.4.17)";
CM_ SG_ 284 RFC_Loc062_AzimuthVnce "Variance of Location azimuth angle ISO 23150:2021(E): Position azimuth - error (A.4.17)";
CM_ SG_ 284 RFC_Loc062_RadarCrossSection "Radar Cross Section (RCS) estimation ISO 23150:2021(E): Radar cross section (A.4.5)";
CM_ SG_ 284 RFC_Loc062_DistVelocityQuality "Quality of radial distance and velocity resolution processing. Physical range [0..1]";
CM_ SG_ 284 RFC_Loc062_ElevationQuality "Probability for correct signal model (elevation angle). Physical range [0..1]";
CM_ SG_ 284 RFC_Loc062_AzimuthQuality "Probability for correct signal model (azimuth angle). Physical range [0..1]";
CM_ SG_ 284 RFC_Loc062_RSSI "Received Signal Strength Indication (RSSI). This signal is not exactly ISO 23150:2021(E): Signal to noise ratio - detection level (A.4.7), but SNR can be calculated from this signal. Further detail please refer to the DSP Location Interface definition";
CM_ SG_ 284 RFC_Loc062_AzimuthalPartnerId "Id of the azimuthal partner location";
CM_ SG_ 285 RFC_Loc063_065_CRC "CRC - Autosar E2E Profile 5";
CM_ SG_ 285 RFC_Loc063_065_AliveCtr "Alive counter - Autosar E2E Profile 5";
CM_ SG_ 285 RFC_Loc063_065_ProtBlockCtr "Protocol-Signal: Block-Counter";
CM_ SG_ 285 RFC_Loc063_RadialDistance "Location radial distance. Represented in conical coordinate system. Same as ISO 23150:2021(E): Position radial distance (A.4.16)";
CM_ SG_ 285 RFC_Loc063_RadialVelocity "Location radial relative velocity ISO 23150:2021(E): Relative velocity {radial distance} (A.4.18)";
CM_ SG_ 285 RFC_Loc063_Elevation "Location elevation angle. Represented in conical coordinate system. Same as ISO 23150:2021(E): Position elevation (A.4.16)";
CM_ SG_ 285 RFC_Loc063_Azimuth "Location azimuth angle. Represented in conical coordinate system. Deviation from ISO 23150:2021(E): Position azimuth (A.4.16). Further details refers to DSP Location Interface definition";
CM_ SG_ 285 RFC_Loc063_DistVelocityCoVnce "Covariance of radial distance and radial velocity";
CM_ SG_ 285 RFC_Loc063_RadialDistanceVnce "Variance of Location radial distance ISO 23150:2021(E): Position radial distance - error (A.4.17)";
CM_ SG_ 285 RFC_Loc063_RadialVelocityVnce "Variance of Location radial relative velocity ISO 23150:2021(E): Relative velocity {radial distance} - error (A.4.19)";
CM_ SG_ 285 RFC_Loc063_ElevationVnce "Variance of Location elevation angle ISO 23150:2021(E): Position elevation - error (A.4.17)";
CM_ SG_ 285 RFC_Loc063_AzimuthVnce "Variance of Location azimuth angle ISO 23150:2021(E): Position azimuth - error (A.4.17)";
CM_ SG_ 285 RFC_Loc063_RadarCrossSection "Radar Cross Section (RCS) estimation ISO 23150:2021(E): Radar cross section (A.4.5)";
CM_ SG_ 285 RFC_Loc063_DistVelocityQuality "Quality of radial distance and velocity resolution processing. Physical range [0..1]";
CM_ SG_ 285 RFC_Loc063_ElevationQuality "Probability for correct signal model (elevation angle). Physical range [0..1]";
CM_ SG_ 285 RFC_Loc063_AzimuthQuality "Probability for correct signal model (azimuth angle). Physical range [0..1]";
CM_ SG_ 285 RFC_Loc063_RSSI "Received Signal Strength Indication (RSSI). This signal is not exactly ISO 23150:2021(E): Signal to noise ratio - detection level (A.4.7), but SNR can be calculated from this signal. Further detail please refer to the DSP Location Interface definition";
CM_ SG_ 285 RFC_Loc063_AzimuthalPartnerId "Id of the azimuthal partner location";
CM_ SG_ 285 RFC_Loc064_RadialDistance "Location radial distance. Represented in conical coordinate system. Same as ISO 23150:2021(E): Position radial distance (A.4.16)";
CM_ SG_ 285 RFC_Loc064_RadialVelocity "Location radial relative velocity ISO 23150:2021(E): Relative velocity {radial distance} (A.4.18)";
CM_ SG_ 285 RFC_Loc064_Elevation "Location elevation angle. Represented in conical coordinate system. Same as ISO 23150:2021(E): Position elevation (A.4.16)";
CM_ SG_ 285 RFC_Loc064_Azimuth "Location azimuth angle. Represented in conical coordinate system. Deviation from ISO 23150:2021(E): Position azimuth (A.4.16). Further details refers to DSP Location Interface definition";
CM_ SG_ 285 RFC_Loc064_DistVelocityCoVnce "Covariance of radial distance and radial velocity";
CM_ SG_ 285 RFC_Loc064_RadialDistanceVnce "Variance of Location radial distance ISO 23150:2021(E): Position radial distance - error (A.4.17)";
CM_ SG_ 285 RFC_Loc064_RadialVelocityVnce "Variance of Location radial relative velocity ISO 23150:2021(E): Relative velocity {radial distance} - error (A.4.19)";
CM_ SG_ 285 RFC_Loc064_ElevationVnce "Variance of Location elevation angle ISO 23150:2021(E): Position elevation - error (A.4.17)";
CM_ SG_ 285 RFC_Loc064_AzimuthVnce "Variance of Location azimuth angle ISO 23150:2021(E): Position azimuth - error (A.4.17)";
CM_ SG_ 285 RFC_Loc064_RadarCrossSection "Radar Cross Section (RCS) estimation ISO 23150:2021(E): Radar cross section (A.4.5)";
CM_ SG_ 285 RFC_Loc064_DistVelocityQuality "Quality of radial distance and velocity resolution processing. Physical range [0..1]";
CM_ SG_ 285 RFC_Loc064_ElevationQuality "Probability for correct signal model (elevation angle). Physical range [0..1]";
CM_ SG_ 285 RFC_Loc064_AzimuthQuality "Probability for correct signal model (azimuth angle). Physical range [0..1]";
CM_ SG_ 285 RFC_Loc064_RSSI "Received Signal Strength Indication (RSSI). This signal is not exactly ISO 23150:2021(E): Signal to noise ratio - detection level (A.4.7), but SNR can be calculated from this signal. Further detail please refer to the DSP Location Interface definition";
CM_ SG_ 285 RFC_Loc064_AzimuthalPartnerId "Id of the azimuthal partner location";
CM_ SG_ 285 RFC_Loc065_RadialDistance "Location radial distance. Represented in conical coordinate system. Same as ISO 23150:2021(E): Position radial distance (A.4.16)";
CM_ SG_ 285 RFC_Loc065_RadialVelocity "Location radial relative velocity ISO 23150:2021(E): Relative velocity {radial distance} (A.4.18)";
CM_ SG_ 285 RFC_Loc065_Elevation "Location elevation angle. Represented in conical coordinate system. Same as ISO 23150:2021(E): Position elevation (A.4.16)";
CM_ SG_ 285 RFC_Loc065_Azimuth "Location azimuth angle. Represented in conical coordinate system. Deviation from ISO 23150:2021(E): Position azimuth (A.4.16). Further details refers to DSP Location Interface definition";
CM_ SG_ 285 RFC_Loc065_DistVelocityCoVnce "Covariance of radial distance and radial velocity";
CM_ SG_ 285 RFC_Loc065_RadialDistanceVnce "Variance of Location radial distance ISO 23150:2021(E): Position radial distance - error (A.4.17)";
CM_ SG_ 285 RFC_Loc065_RadialVelocityVnce "Variance of Location radial relative velocity ISO 23150:2021(E): Relative velocity {radial distance} - error (A.4.19)";
CM_ SG_ 285 RFC_Loc065_ElevationVnce "Variance of Location elevation angle ISO 23150:2021(E): Position elevation - error (A.4.17)";
CM_ SG_ 285 RFC_Loc065_AzimuthVnce "Variance of Location azimuth angle ISO 23150:2021(E): Position azimuth - error (A.4.17)";
CM_ SG_ 285 RFC_Loc065_RadarCrossSection "Radar Cross Section (RCS) estimation ISO 23150:2021(E): Radar cross section (A.4.5)";
CM_ SG_ 285 RFC_Loc065_DistVelocityQuality "Quality of radial distance and velocity resolution processing. Physical range [0..1]";
CM_ SG_ 285 RFC_Loc065_ElevationQuality "Probability for correct signal model (elevation angle). Physical range [0..1]";
CM_ SG_ 285 RFC_Loc065_AzimuthQuality "Probability for correct signal model (azimuth angle). Physical range [0..1]";
CM_ SG_ 285 RFC_Loc065_RSSI "Received Signal Strength Indication (RSSI). This signal is not exactly ISO 23150:2021(E): Signal to noise ratio - detection level (A.4.7), but SNR can be calculated from this signal. Further detail please refer to the DSP Location Interface definition";
CM_ SG_ 285 RFC_Loc065_AzimuthalPartnerId "Id of the azimuthal partner location";
CM_ SG_ 286 RFC_Loc066_068_CRC "CRC - Autosar E2E Profile 5";
CM_ SG_ 286 RFC_Loc066_068_AliveCtr "Alive counter - Autosar E2E Profile 5";
CM_ SG_ 286 RFC_Loc066_068_ProtBlockCtr "Protocol-Signal: Block-Counter";
CM_ SG_ 286 RFC_Loc066_RadialDistance "Location radial distance. Represented in conical coordinate system. Same as ISO 23150:2021(E): Position radial distance (A.4.16)";
CM_ SG_ 286 RFC_Loc066_RadialVelocity "Location radial relative velocity ISO 23150:2021(E): Relative velocity {radial distance} (A.4.18)";
CM_ SG_ 286 RFC_Loc066_Elevation "Location elevation angle. Represented in conical coordinate system. Same as ISO 23150:2021(E): Position elevation (A.4.16)";
CM_ SG_ 286 RFC_Loc066_Azimuth "Location azimuth angle. Represented in conical coordinate system. Deviation from ISO 23150:2021(E): Position azimuth (A.4.16). Further details refers to DSP Location Interface definition";
CM_ SG_ 286 RFC_Loc066_DistVelocityCoVnce "Covariance of radial distance and radial velocity";
CM_ SG_ 286 RFC_Loc066_RadialDistanceVnce "Variance of Location radial distance ISO 23150:2021(E): Position radial distance - error (A.4.17)";
CM_ SG_ 286 RFC_Loc066_RadialVelocityVnce "Variance of Location radial relative velocity ISO 23150:2021(E): Relative velocity {radial distance} - error (A.4.19)";
CM_ SG_ 286 RFC_Loc066_ElevationVnce "Variance of Location elevation angle ISO 23150:2021(E): Position elevation - error (A.4.17)";
CM_ SG_ 286 RFC_Loc066_AzimuthVnce "Variance of Location azimuth angle ISO 23150:2021(E): Position azimuth - error (A.4.17)";
CM_ SG_ 286 RFC_Loc066_RadarCrossSection "Radar Cross Section (RCS) estimation ISO 23150:2021(E): Radar cross section (A.4.5)";
CM_ SG_ 286 RFC_Loc066_DistVelocityQuality "Quality of radial distance and velocity resolution processing. Physical range [0..1]";
CM_ SG_ 286 RFC_Loc066_ElevationQuality "Probability for correct signal model (elevation angle). Physical range [0..1]";
CM_ SG_ 286 RFC_Loc066_AzimuthQuality "Probability for correct signal model (azimuth angle). Physical range [0..1]";
CM_ SG_ 286 RFC_Loc066_RSSI "Received Signal Strength Indication (RSSI). This signal is not exactly ISO 23150:2021(E): Signal to noise ratio - detection level (A.4.7), but SNR can be calculated from this signal. Further detail please refer to the DSP Location Interface definition";
CM_ SG_ 286 RFC_Loc066_AzimuthalPartnerId "Id of the azimuthal partner location";
CM_ SG_ 286 RFC_Loc067_RadialDistance "Location radial distance. Represented in conical coordinate system. Same as ISO 23150:2021(E): Position radial distance (A.4.16)";
CM_ SG_ 286 RFC_Loc067_RadialVelocity "Location radial relative velocity ISO 23150:2021(E): Relative velocity {radial distance} (A.4.18)";
CM_ SG_ 286 RFC_Loc067_Elevation "Location elevation angle. Represented in conical coordinate system. Same as ISO 23150:2021(E): Position elevation (A.4.16)";
CM_ SG_ 286 RFC_Loc067_Azimuth "Location azimuth angle. Represented in conical coordinate system. Deviation from ISO 23150:2021(E): Position azimuth (A.4.16). Further details refers to DSP Location Interface definition";
CM_ SG_ 286 RFC_Loc067_DistVelocityCoVnce "Covariance of radial distance and radial velocity";
CM_ SG_ 286 RFC_Loc067_RadialDistanceVnce "Variance of Location radial distance ISO 23150:2021(E): Position radial distance - error (A.4.17)";
CM_ SG_ 286 RFC_Loc067_RadialVelocityVnce "Variance of Location radial relative velocity ISO 23150:2021(E): Relative velocity {radial distance} - error (A.4.19)";
CM_ SG_ 286 RFC_Loc067_ElevationVnce "Variance of Location elevation angle ISO 23150:2021(E): Position elevation - error (A.4.17)";
CM_ SG_ 286 RFC_Loc067_AzimuthVnce "Variance of Location azimuth angle ISO 23150:2021(E): Position azimuth - error (A.4.17)";
CM_ SG_ 286 RFC_Loc067_RadarCrossSection "Radar Cross Section (RCS) estimation ISO 23150:2021(E): Radar cross section (A.4.5)";
CM_ SG_ 286 RFC_Loc067_DistVelocityQuality "Quality of radial distance and velocity resolution processing. Physical range [0..1]";
CM_ SG_ 286 RFC_Loc067_ElevationQuality "Probability for correct signal model (elevation angle). Physical range [0..1]";
CM_ SG_ 286 RFC_Loc067_AzimuthQuality "Probability for correct signal model (azimuth angle). Physical range [0..1]";
CM_ SG_ 286 RFC_Loc067_RSSI "Received Signal Strength Indication (RSSI). This signal is not exactly ISO 23150:2021(E): Signal to noise ratio - detection level (A.4.7), but SNR can be calculated from this signal. Further detail please refer to the DSP Location Interface definition";
CM_ SG_ 286 RFC_Loc067_AzimuthalPartnerId "Id of the azimuthal partner location";
CM_ SG_ 286 RFC_Loc068_RadialDistance "Location radial distance. Represented in conical coordinate system. Same as ISO 23150:2021(E): Position radial distance (A.4.16)";
CM_ SG_ 286 RFC_Loc068_RadialVelocity "Location radial relative velocity ISO 23150:2021(E): Relative velocity {radial distance} (A.4.18)";
CM_ SG_ 286 RFC_Loc068_Elevation "Location elevation angle. Represented in conical coordinate system. Same as ISO 23150:2021(E): Position elevation (A.4.16)";
CM_ SG_ 286 RFC_Loc068_Azimuth "Location azimuth angle. Represented in conical coordinate system. Deviation from ISO 23150:2021(E): Position azimuth (A.4.16). Further details refers to DSP Location Interface definition";
CM_ SG_ 286 RFC_Loc068_DistVelocityCoVnce "Covariance of radial distance and radial velocity";
CM_ SG_ 286 RFC_Loc068_RadialDistanceVnce "Variance of Location radial distance ISO 23150:2021(E): Position radial distance - error (A.4.17)";
CM_ SG_ 286 RFC_Loc068_RadialVelocityVnce "Variance of Location radial relative velocity ISO 23150:2021(E): Relative velocity {radial distance} - error (A.4.19)";
CM_ SG_ 286 RFC_Loc068_ElevationVnce "Variance of Location elevation angle ISO 23150:2021(E): Position elevation - error (A.4.17)";
CM_ SG_ 286 RFC_Loc068_AzimuthVnce "Variance of Location azimuth angle ISO 23150:2021(E): Position azimuth - error (A.4.17)";
CM_ SG_ 286 RFC_Loc068_RadarCrossSection "Radar Cross Section (RCS) estimation ISO 23150:2021(E): Radar cross section (A.4.5)";
CM_ SG_ 286 RFC_Loc068_DistVelocityQuality "Quality of radial distance and velocity resolution processing. Physical range [0..1]";
CM_ SG_ 286 RFC_Loc068_ElevationQuality "Probability for correct signal model (elevation angle). Physical range [0..1]";
CM_ SG_ 286 RFC_Loc068_AzimuthQuality "Probability for correct signal model (azimuth angle). Physical range [0..1]";
CM_ SG_ 286 RFC_Loc068_RSSI "Received Signal Strength Indication (RSSI). This signal is not exactly ISO 23150:2021(E): Signal to noise ratio - detection level (A.4.7), but SNR can be calculated from this signal. Further detail please refer to the DSP Location Interface definition";
CM_ SG_ 286 RFC_Loc068_AzimuthalPartnerId "Id of the azimuthal partner location";
CM_ SG_ 287 RFC_Loc069_071_CRC "CRC - Autosar E2E Profile 5";
CM_ SG_ 287 RFC_Loc069_071_AliveCtr "Alive counter - Autosar E2E Profile 5";
CM_ SG_ 287 RFC_Loc069_071_ProtBlockCtr "Protocol-Signal: Block-Counter";
CM_ SG_ 287 RFC_Loc069_RadialDistance "Location radial distance. Represented in conical coordinate system. Same as ISO 23150:2021(E): Position radial distance (A.4.16)";
CM_ SG_ 287 RFC_Loc069_RadialVelocity "Location radial relative velocity ISO 23150:2021(E): Relative velocity {radial distance} (A.4.18)";
CM_ SG_ 287 RFC_Loc069_Elevation "Location elevation angle. Represented in conical coordinate system. Same as ISO 23150:2021(E): Position elevation (A.4.16)";
CM_ SG_ 287 RFC_Loc069_Azimuth "Location azimuth angle. Represented in conical coordinate system. Deviation from ISO 23150:2021(E): Position azimuth (A.4.16). Further details refers to DSP Location Interface definition";
CM_ SG_ 287 RFC_Loc069_DistVelocityCoVnce "Covariance of radial distance and radial velocity";
CM_ SG_ 287 RFC_Loc069_RadialDistanceVnce "Variance of Location radial distance ISO 23150:2021(E): Position radial distance - error (A.4.17)";
CM_ SG_ 287 RFC_Loc069_RadialVelocityVnce "Variance of Location radial relative velocity ISO 23150:2021(E): Relative velocity {radial distance} - error (A.4.19)";
CM_ SG_ 287 RFC_Loc069_ElevationVnce "Variance of Location elevation angle ISO 23150:2021(E): Position elevation - error (A.4.17)";
CM_ SG_ 287 RFC_Loc069_AzimuthVnce "Variance of Location azimuth angle ISO 23150:2021(E): Position azimuth - error (A.4.17)";
CM_ SG_ 287 RFC_Loc069_RadarCrossSection "Radar Cross Section (RCS) estimation ISO 23150:2021(E): Radar cross section (A.4.5)";
CM_ SG_ 287 RFC_Loc069_DistVelocityQuality "Quality of radial distance and velocity resolution processing. Physical range [0..1]";
CM_ SG_ 287 RFC_Loc069_ElevationQuality "Probability for correct signal model (elevation angle). Physical range [0..1]";
CM_ SG_ 287 RFC_Loc069_AzimuthQuality "Probability for correct signal model (azimuth angle). Physical range [0..1]";
CM_ SG_ 287 RFC_Loc069_RSSI "Received Signal Strength Indication (RSSI). This signal is not exactly ISO 23150:2021(E): Signal to noise ratio - detection level (A.4.7), but SNR can be calculated from this signal. Further detail please refer to the DSP Location Interface definition";
CM_ SG_ 287 RFC_Loc069_AzimuthalPartnerId "Id of the azimuthal partner location";
CM_ SG_ 287 RFC_Loc070_RadialDistance "Location radial distance. Represented in conical coordinate system. Same as ISO 23150:2021(E): Position radial distance (A.4.16)";
CM_ SG_ 287 RFC_Loc070_RadialVelocity "Location radial relative velocity ISO 23150:2021(E): Relative velocity {radial distance} (A.4.18)";
CM_ SG_ 287 RFC_Loc070_Elevation "Location elevation angle. Represented in conical coordinate system. Same as ISO 23150:2021(E): Position elevation (A.4.16)";
CM_ SG_ 287 RFC_Loc070_Azimuth "Location azimuth angle. Represented in conical coordinate system. Deviation from ISO 23150:2021(E): Position azimuth (A.4.16). Further details refers to DSP Location Interface definition";
CM_ SG_ 287 RFC_Loc070_DistVelocityCoVnce "Covariance of radial distance and radial velocity";
CM_ SG_ 287 RFC_Loc070_RadialDistanceVnce "Variance of Location radial distance ISO 23150:2021(E): Position radial distance - error (A.4.17)";
CM_ SG_ 287 RFC_Loc070_RadialVelocityVnce "Variance of Location radial relative velocity ISO 23150:2021(E): Relative velocity {radial distance} - error (A.4.19)";
CM_ SG_ 287 RFC_Loc070_ElevationVnce "Variance of Location elevation angle ISO 23150:2021(E): Position elevation - error (A.4.17)";
CM_ SG_ 287 RFC_Loc070_AzimuthVnce "Variance of Location azimuth angle ISO 23150:2021(E): Position azimuth - error (A.4.17)";
CM_ SG_ 287 RFC_Loc070_RadarCrossSection "Radar Cross Section (RCS) estimation ISO 23150:2021(E): Radar cross section (A.4.5)";
CM_ SG_ 287 RFC_Loc070_DistVelocityQuality "Quality of radial distance and velocity resolution processing. Physical range [0..1]";
CM_ SG_ 287 RFC_Loc070_ElevationQuality "Probability for correct signal model (elevation angle). Physical range [0..1]";
CM_ SG_ 287 RFC_Loc070_AzimuthQuality "Probability for correct signal model (azimuth angle). Physical range [0..1]";
CM_ SG_ 287 RFC_Loc070_RSSI "Received Signal Strength Indication (RSSI). This signal is not exactly ISO 23150:2021(E): Signal to noise ratio - detection level (A.4.7), but SNR can be calculated from this signal. Further detail please refer to the DSP Location Interface definition";
CM_ SG_ 287 RFC_Loc070_AzimuthalPartnerId "Id of the azimuthal partner location";
CM_ SG_ 287 RFC_Loc071_RadialDistance "Location radial distance. Represented in conical coordinate system. Same as ISO 23150:2021(E): Position radial distance (A.4.16)";
CM_ SG_ 287 RFC_Loc071_RadialVelocity "Location radial relative velocity ISO 23150:2021(E): Relative velocity {radial distance} (A.4.18)";
CM_ SG_ 287 RFC_Loc071_Elevation "Location elevation angle. Represented in conical coordinate system. Same as ISO 23150:2021(E): Position elevation (A.4.16)";
CM_ SG_ 287 RFC_Loc071_Azimuth "Location azimuth angle. Represented in conical coordinate system. Deviation from ISO 23150:2021(E): Position azimuth (A.4.16). Further details refers to DSP Location Interface definition";
CM_ SG_ 287 RFC_Loc071_DistVelocityCoVnce "Covariance of radial distance and radial velocity";
CM_ SG_ 287 RFC_Loc071_RadialDistanceVnce "Variance of Location radial distance ISO 23150:2021(E): Position radial distance - error (A.4.17)";
CM_ SG_ 287 RFC_Loc071_RadialVelocityVnce "Variance of Location radial relative velocity ISO 23150:2021(E): Relative velocity {radial distance} - error (A.4.19)";
CM_ SG_ 287 RFC_Loc071_ElevationVnce "Variance of Location elevation angle ISO 23150:2021(E): Position elevation - error (A.4.17)";
CM_ SG_ 287 RFC_Loc071_AzimuthVnce "Variance of Location azimuth angle ISO 23150:2021(E): Position azimuth - error (A.4.17)";
CM_ SG_ 287 RFC_Loc071_RadarCrossSection "Radar Cross Section (RCS) estimation ISO 23150:2021(E): Radar cross section (A.4.5)";
CM_ SG_ 287 RFC_Loc071_DistVelocityQuality "Quality of radial distance and velocity resolution processing. Physical range [0..1]";
CM_ SG_ 287 RFC_Loc071_ElevationQuality "Probability for correct signal model (elevation angle). Physical range [0..1]";
CM_ SG_ 287 RFC_Loc071_AzimuthQuality "Probability for correct signal model (azimuth angle). Physical range [0..1]";
CM_ SG_ 287 RFC_Loc071_RSSI "Received Signal Strength Indication (RSSI). This signal is not exactly ISO 23150:2021(E): Signal to noise ratio - detection level (A.4.7), but SNR can be calculated from this signal. Further detail please refer to the DSP Location Interface definition";
CM_ SG_ 287 RFC_Loc071_AzimuthalPartnerId "Id of the azimuthal partner location";
CM_ SG_ 288 RFC_Loc072_074_CRC "CRC - Autosar E2E Profile 5";
CM_ SG_ 288 RFC_Loc072_074_AliveCtr "Alive counter - Autosar E2E Profile 5";
CM_ SG_ 288 RFC_Loc072_074_ProtBlockCtr "Protocol-Signal: Block-Counter";
CM_ SG_ 288 RFC_Loc072_RadialDistance "Location radial distance. Represented in conical coordinate system. Same as ISO 23150:2021(E): Position radial distance (A.4.16)";
CM_ SG_ 288 RFC_Loc072_RadialVelocity "Location radial relative velocity ISO 23150:2021(E): Relative velocity {radial distance} (A.4.18)";
CM_ SG_ 288 RFC_Loc072_Elevation "Location elevation angle. Represented in conical coordinate system. Same as ISO 23150:2021(E): Position elevation (A.4.16)";
CM_ SG_ 288 RFC_Loc072_Azimuth "Location azimuth angle. Represented in conical coordinate system. Deviation from ISO 23150:2021(E): Position azimuth (A.4.16). Further details refers to DSP Location Interface definition";
CM_ SG_ 288 RFC_Loc072_DistVelocityCoVnce "Covariance of radial distance and radial velocity";
CM_ SG_ 288 RFC_Loc072_RadialDistanceVnce "Variance of Location radial distance ISO 23150:2021(E): Position radial distance - error (A.4.17)";
CM_ SG_ 288 RFC_Loc072_RadialVelocityVnce "Variance of Location radial relative velocity ISO 23150:2021(E): Relative velocity {radial distance} - error (A.4.19)";
CM_ SG_ 288 RFC_Loc072_ElevationVnce "Variance of Location elevation angle ISO 23150:2021(E): Position elevation - error (A.4.17)";
CM_ SG_ 288 RFC_Loc072_AzimuthVnce "Variance of Location azimuth angle ISO 23150:2021(E): Position azimuth - error (A.4.17)";
CM_ SG_ 288 RFC_Loc072_RadarCrossSection "Radar Cross Section (RCS) estimation ISO 23150:2021(E): Radar cross section (A.4.5)";
CM_ SG_ 288 RFC_Loc072_DistVelocityQuality "Quality of radial distance and velocity resolution processing. Physical range [0..1]";
CM_ SG_ 288 RFC_Loc072_ElevationQuality "Probability for correct signal model (elevation angle). Physical range [0..1]";
CM_ SG_ 288 RFC_Loc072_AzimuthQuality "Probability for correct signal model (azimuth angle). Physical range [0..1]";
CM_ SG_ 288 RFC_Loc072_RSSI "Received Signal Strength Indication (RSSI). This signal is not exactly ISO 23150:2021(E): Signal to noise ratio - detection level (A.4.7), but SNR can be calculated from this signal. Further detail please refer to the DSP Location Interface definition";
CM_ SG_ 288 RFC_Loc072_AzimuthalPartnerId "Id of the azimuthal partner location";
CM_ SG_ 288 RFC_Loc073_RadialDistance "Location radial distance. Represented in conical coordinate system. Same as ISO 23150:2021(E): Position radial distance (A.4.16)";
CM_ SG_ 288 RFC_Loc073_RadialVelocity "Location radial relative velocity ISO 23150:2021(E): Relative velocity {radial distance} (A.4.18)";
CM_ SG_ 288 RFC_Loc073_Elevation "Location elevation angle. Represented in conical coordinate system. Same as ISO 23150:2021(E): Position elevation (A.4.16)";
CM_ SG_ 288 RFC_Loc073_Azimuth "Location azimuth angle. Represented in conical coordinate system. Deviation from ISO 23150:2021(E): Position azimuth (A.4.16). Further details refers to DSP Location Interface definition";
CM_ SG_ 288 RFC_Loc073_DistVelocityCoVnce "Covariance of radial distance and radial velocity";
CM_ SG_ 288 RFC_Loc073_RadialDistanceVnce "Variance of Location radial distance ISO 23150:2021(E): Position radial distance - error (A.4.17)";
CM_ SG_ 288 RFC_Loc073_RadialVelocityVnce "Variance of Location radial relative velocity ISO 23150:2021(E): Relative velocity {radial distance} - error (A.4.19)";
CM_ SG_ 288 RFC_Loc073_ElevationVnce "Variance of Location elevation angle ISO 23150:2021(E): Position elevation - error (A.4.17)";
CM_ SG_ 288 RFC_Loc073_AzimuthVnce "Variance of Location azimuth angle ISO 23150:2021(E): Position azimuth - error (A.4.17)";
CM_ SG_ 288 RFC_Loc073_RadarCrossSection "Radar Cross Section (RCS) estimation ISO 23150:2021(E): Radar cross section (A.4.5)";
CM_ SG_ 288 RFC_Loc073_DistVelocityQuality "Quality of radial distance and velocity resolution processing. Physical range [0..1]";
CM_ SG_ 288 RFC_Loc073_ElevationQuality "Probability for correct signal model (elevation angle). Physical range [0..1]";
CM_ SG_ 288 RFC_Loc073_AzimuthQuality "Probability for correct signal model (azimuth angle). Physical range [0..1]";
CM_ SG_ 288 RFC_Loc073_RSSI "Received Signal Strength Indication (RSSI). This signal is not exactly ISO 23150:2021(E): Signal to noise ratio - detection level (A.4.7), but SNR can be calculated from this signal. Further detail please refer to the DSP Location Interface definition";
CM_ SG_ 288 RFC_Loc073_AzimuthalPartnerId "Id of the azimuthal partner location";
CM_ SG_ 288 RFC_Loc074_RadialDistance "Location radial distance. Represented in conical coordinate system. Same as ISO 23150:2021(E): Position radial distance (A.4.16)";
CM_ SG_ 288 RFC_Loc074_RadialVelocity "Location radial relative velocity ISO 23150:2021(E): Relative velocity {radial distance} (A.4.18)";
CM_ SG_ 288 RFC_Loc074_Elevation "Location elevation angle. Represented in conical coordinate system. Same as ISO 23150:2021(E): Position elevation (A.4.16)";
CM_ SG_ 288 RFC_Loc074_Azimuth "Location azimuth angle. Represented in conical coordinate system. Deviation from ISO 23150:2021(E): Position azimuth (A.4.16). Further details refers to DSP Location Interface definition";
CM_ SG_ 288 RFC_Loc074_DistVelocityCoVnce "Covariance of radial distance and radial velocity";
CM_ SG_ 288 RFC_Loc074_RadialDistanceVnce "Variance of Location radial distance ISO 23150:2021(E): Position radial distance - error (A.4.17)";
CM_ SG_ 288 RFC_Loc074_RadialVelocityVnce "Variance of Location radial relative velocity ISO 23150:2021(E): Relative velocity {radial distance} - error (A.4.19)";
CM_ SG_ 288 RFC_Loc074_ElevationVnce "Variance of Location elevation angle ISO 23150:2021(E): Position elevation - error (A.4.17)";
CM_ SG_ 288 RFC_Loc074_AzimuthVnce "Variance of Location azimuth angle ISO 23150:2021(E): Position azimuth - error (A.4.17)";
CM_ SG_ 288 RFC_Loc074_RadarCrossSection "Radar Cross Section (RCS) estimation ISO 23150:2021(E): Radar cross section (A.4.5)";
CM_ SG_ 288 RFC_Loc074_DistVelocityQuality "Quality of radial distance and velocity resolution processing. Physical range [0..1]";
CM_ SG_ 288 RFC_Loc074_ElevationQuality "Probability for correct signal model (elevation angle). Physical range [0..1]";
CM_ SG_ 288 RFC_Loc074_AzimuthQuality "Probability for correct signal model (azimuth angle). Physical range [0..1]";
CM_ SG_ 288 RFC_Loc074_RSSI "Received Signal Strength Indication (RSSI). This signal is not exactly ISO 23150:2021(E): Signal to noise ratio - detection level (A.4.7), but SNR can be calculated from this signal. Further detail please refer to the DSP Location Interface definition";
CM_ SG_ 288 RFC_Loc074_AzimuthalPartnerId "Id of the azimuthal partner location";
CM_ SG_ 289 RFC_Loc075_077_CRC "CRC - Autosar E2E Profile 5";
CM_ SG_ 289 RFC_Loc075_077_AliveCtr "Alive counter - Autosar E2E Profile 5";
CM_ SG_ 289 RFC_Loc075_077_ProtBlockCtr "Protocol-Signal: Block-Counter";
CM_ SG_ 289 RFC_Loc075_RadialDistance "Location radial distance. Represented in conical coordinate system. Same as ISO 23150:2021(E): Position radial distance (A.4.16)";
CM_ SG_ 289 RFC_Loc075_RadialVelocity "Location radial relative velocity ISO 23150:2021(E): Relative velocity {radial distance} (A.4.18)";
CM_ SG_ 289 RFC_Loc075_Elevation "Location elevation angle. Represented in conical coordinate system. Same as ISO 23150:2021(E): Position elevation (A.4.16)";
CM_ SG_ 289 RFC_Loc075_Azimuth "Location azimuth angle. Represented in conical coordinate system. Deviation from ISO 23150:2021(E): Position azimuth (A.4.16). Further details refers to DSP Location Interface definition";
CM_ SG_ 289 RFC_Loc075_DistVelocityCoVnce "Covariance of radial distance and radial velocity";
CM_ SG_ 289 RFC_Loc075_RadialDistanceVnce "Variance of Location radial distance ISO 23150:2021(E): Position radial distance - error (A.4.17)";
CM_ SG_ 289 RFC_Loc075_RadialVelocityVnce "Variance of Location radial relative velocity ISO 23150:2021(E): Relative velocity {radial distance} - error (A.4.19)";
CM_ SG_ 289 RFC_Loc075_ElevationVnce "Variance of Location elevation angle ISO 23150:2021(E): Position elevation - error (A.4.17)";
CM_ SG_ 289 RFC_Loc075_AzimuthVnce "Variance of Location azimuth angle ISO 23150:2021(E): Position azimuth - error (A.4.17)";
CM_ SG_ 289 RFC_Loc075_RadarCrossSection "Radar Cross Section (RCS) estimation ISO 23150:2021(E): Radar cross section (A.4.5)";
CM_ SG_ 289 RFC_Loc075_DistVelocityQuality "Quality of radial distance and velocity resolution processing. Physical range [0..1]";
CM_ SG_ 289 RFC_Loc075_ElevationQuality "Probability for correct signal model (elevation angle). Physical range [0..1]";
CM_ SG_ 289 RFC_Loc075_AzimuthQuality "Probability for correct signal model (azimuth angle). Physical range [0..1]";
CM_ SG_ 289 RFC_Loc075_RSSI "Received Signal Strength Indication (RSSI). This signal is not exactly ISO 23150:2021(E): Signal to noise ratio - detection level (A.4.7), but SNR can be calculated from this signal. Further detail please refer to the DSP Location Interface definition";
CM_ SG_ 289 RFC_Loc075_AzimuthalPartnerId "Id of the azimuthal partner location";
CM_ SG_ 289 RFC_Loc076_RadialDistance "Location radial distance. Represented in conical coordinate system. Same as ISO 23150:2021(E): Position radial distance (A.4.16)";
CM_ SG_ 289 RFC_Loc076_RadialVelocity "Location radial relative velocity ISO 23150:2021(E): Relative velocity {radial distance} (A.4.18)";
CM_ SG_ 289 RFC_Loc076_Elevation "Location elevation angle. Represented in conical coordinate system. Same as ISO 23150:2021(E): Position elevation (A.4.16)";
CM_ SG_ 289 RFC_Loc076_Azimuth "Location azimuth angle. Represented in conical coordinate system. Deviation from ISO 23150:2021(E): Position azimuth (A.4.16). Further details refers to DSP Location Interface definition";
CM_ SG_ 289 RFC_Loc076_DistVelocityCoVnce "Covariance of radial distance and radial velocity";
CM_ SG_ 289 RFC_Loc076_RadialDistanceVnce "Variance of Location radial distance ISO 23150:2021(E): Position radial distance - error (A.4.17)";
CM_ SG_ 289 RFC_Loc076_RadialVelocityVnce "Variance of Location radial relative velocity ISO 23150:2021(E): Relative velocity {radial distance} - error (A.4.19)";
CM_ SG_ 289 RFC_Loc076_ElevationVnce "Variance of Location elevation angle ISO 23150:2021(E): Position elevation - error (A.4.17)";
CM_ SG_ 289 RFC_Loc076_AzimuthVnce "Variance of Location azimuth angle ISO 23150:2021(E): Position azimuth - error (A.4.17)";
CM_ SG_ 289 RFC_Loc076_RadarCrossSection "Radar Cross Section (RCS) estimation ISO 23150:2021(E): Radar cross section (A.4.5)";
CM_ SG_ 289 RFC_Loc076_DistVelocityQuality "Quality of radial distance and velocity resolution processing. Physical range [0..1]";
CM_ SG_ 289 RFC_Loc076_ElevationQuality "Probability for correct signal model (elevation angle). Physical range [0..1]";
CM_ SG_ 289 RFC_Loc076_AzimuthQuality "Probability for correct signal model (azimuth angle). Physical range [0..1]";
CM_ SG_ 289 RFC_Loc076_RSSI "Received Signal Strength Indication (RSSI). This signal is not exactly ISO 23150:2021(E): Signal to noise ratio - detection level (A.4.7), but SNR can be calculated from this signal. Further detail please refer to the DSP Location Interface definition";
CM_ SG_ 289 RFC_Loc076_AzimuthalPartnerId "Id of the azimuthal partner location";
CM_ SG_ 289 RFC_Loc077_RadialDistance "Location radial distance. Represented in conical coordinate system. Same as ISO 23150:2021(E): Position radial distance (A.4.16)";
CM_ SG_ 289 RFC_Loc077_RadialVelocity "Location radial relative velocity ISO 23150:2021(E): Relative velocity {radial distance} (A.4.18)";
CM_ SG_ 289 RFC_Loc077_Elevation "Location elevation angle. Represented in conical coordinate system. Same as ISO 23150:2021(E): Position elevation (A.4.16)";
CM_ SG_ 289 RFC_Loc077_Azimuth "Location azimuth angle. Represented in conical coordinate system. Deviation from ISO 23150:2021(E): Position azimuth (A.4.16). Further details refers to DSP Location Interface definition";
CM_ SG_ 289 RFC_Loc077_DistVelocityCoVnce "Covariance of radial distance and radial velocity";
CM_ SG_ 289 RFC_Loc077_RadialDistanceVnce "Variance of Location radial distance ISO 23150:2021(E): Position radial distance - error (A.4.17)";
CM_ SG_ 289 RFC_Loc077_RadialVelocityVnce "Variance of Location radial relative velocity ISO 23150:2021(E): Relative velocity {radial distance} - error (A.4.19)";
CM_ SG_ 289 RFC_Loc077_ElevationVnce "Variance of Location elevation angle ISO 23150:2021(E): Position elevation - error (A.4.17)";
CM_ SG_ 289 RFC_Loc077_AzimuthVnce "Variance of Location azimuth angle ISO 23150:2021(E): Position azimuth - error (A.4.17)";
CM_ SG_ 289 RFC_Loc077_RadarCrossSection "Radar Cross Section (RCS) estimation ISO 23150:2021(E): Radar cross section (A.4.5)";
CM_ SG_ 289 RFC_Loc077_DistVelocityQuality "Quality of radial distance and velocity resolution processing. Physical range [0..1]";
CM_ SG_ 289 RFC_Loc077_ElevationQuality "Probability for correct signal model (elevation angle). Physical range [0..1]";
CM_ SG_ 289 RFC_Loc077_AzimuthQuality "Probability for correct signal model (azimuth angle). Physical range [0..1]";
CM_ SG_ 289 RFC_Loc077_RSSI "Received Signal Strength Indication (RSSI). This signal is not exactly ISO 23150:2021(E): Signal to noise ratio - detection level (A.4.7), but SNR can be calculated from this signal. Further detail please refer to the DSP Location Interface definition";
CM_ SG_ 289 RFC_Loc077_AzimuthalPartnerId "Id of the azimuthal partner location";
CM_ SG_ 290 RFC_Loc078_080_CRC "CRC - Autosar E2E Profile 5";
CM_ SG_ 290 RFC_Loc078_080_AliveCtr "Alive counter - Autosar E2E Profile 5";
CM_ SG_ 290 RFC_Loc078_080_ProtBlockCtr "Protocol-Signal: Block-Counter";
CM_ SG_ 290 RFC_Loc078_RadialDistance "Location radial distance. Represented in conical coordinate system. Same as ISO 23150:2021(E): Position radial distance (A.4.16)";
CM_ SG_ 290 RFC_Loc078_RadialVelocity "Location radial relative velocity ISO 23150:2021(E): Relative velocity {radial distance} (A.4.18)";
CM_ SG_ 290 RFC_Loc078_Elevation "Location elevation angle. Represented in conical coordinate system. Same as ISO 23150:2021(E): Position elevation (A.4.16)";
CM_ SG_ 290 RFC_Loc078_Azimuth "Location azimuth angle. Represented in conical coordinate system. Deviation from ISO 23150:2021(E): Position azimuth (A.4.16). Further details refers to DSP Location Interface definition";
CM_ SG_ 290 RFC_Loc078_DistVelocityCoVnce "Covariance of radial distance and radial velocity";
CM_ SG_ 290 RFC_Loc078_RadialDistanceVnce "Variance of Location radial distance ISO 23150:2021(E): Position radial distance - error (A.4.17)";
CM_ SG_ 290 RFC_Loc078_RadialVelocityVnce "Variance of Location radial relative velocity ISO 23150:2021(E): Relative velocity {radial distance} - error (A.4.19)";
CM_ SG_ 290 RFC_Loc078_ElevationVnce "Variance of Location elevation angle ISO 23150:2021(E): Position elevation - error (A.4.17)";
CM_ SG_ 290 RFC_Loc078_AzimuthVnce "Variance of Location azimuth angle ISO 23150:2021(E): Position azimuth - error (A.4.17)";
CM_ SG_ 290 RFC_Loc078_RadarCrossSection "Radar Cross Section (RCS) estimation ISO 23150:2021(E): Radar cross section (A.4.5)";
CM_ SG_ 290 RFC_Loc078_DistVelocityQuality "Quality of radial distance and velocity resolution processing. Physical range [0..1]";
CM_ SG_ 290 RFC_Loc078_ElevationQuality "Probability for correct signal model (elevation angle). Physical range [0..1]";
CM_ SG_ 290 RFC_Loc078_AzimuthQuality "Probability for correct signal model (azimuth angle). Physical range [0..1]";
CM_ SG_ 290 RFC_Loc078_RSSI "Received Signal Strength Indication (RSSI). This signal is not exactly ISO 23150:2021(E): Signal to noise ratio - detection level (A.4.7), but SNR can be calculated from this signal. Further detail please refer to the DSP Location Interface definition";
CM_ SG_ 290 RFC_Loc078_AzimuthalPartnerId "Id of the azimuthal partner location";
CM_ SG_ 290 RFC_Loc079_RadialDistance "Location radial distance. Represented in conical coordinate system. Same as ISO 23150:2021(E): Position radial distance (A.4.16)";
CM_ SG_ 290 RFC_Loc079_RadialVelocity "Location radial relative velocity ISO 23150:2021(E): Relative velocity {radial distance} (A.4.18)";
CM_ SG_ 290 RFC_Loc079_Elevation "Location elevation angle. Represented in conical coordinate system. Same as ISO 23150:2021(E): Position elevation (A.4.16)";
CM_ SG_ 290 RFC_Loc079_Azimuth "Location azimuth angle. Represented in conical coordinate system. Deviation from ISO 23150:2021(E): Position azimuth (A.4.16). Further details refers to DSP Location Interface definition";
CM_ SG_ 290 RFC_Loc079_DistVelocityCoVnce "Covariance of radial distance and radial velocity";
CM_ SG_ 290 RFC_Loc079_RadialDistanceVnce "Variance of Location radial distance ISO 23150:2021(E): Position radial distance - error (A.4.17)";
CM_ SG_ 290 RFC_Loc079_RadialVelocityVnce "Variance of Location radial relative velocity ISO 23150:2021(E): Relative velocity {radial distance} - error (A.4.19)";
CM_ SG_ 290 RFC_Loc079_ElevationVnce "Variance of Location elevation angle ISO 23150:2021(E): Position elevation - error (A.4.17)";
CM_ SG_ 290 RFC_Loc079_AzimuthVnce "Variance of Location azimuth angle ISO 23150:2021(E): Position azimuth - error (A.4.17)";
CM_ SG_ 290 RFC_Loc079_RadarCrossSection "Radar Cross Section (RCS) estimation ISO 23150:2021(E): Radar cross section (A.4.5)";
CM_ SG_ 290 RFC_Loc079_DistVelocityQuality "Quality of radial distance and velocity resolution processing. Physical range [0..1]";
CM_ SG_ 290 RFC_Loc079_ElevationQuality "Probability for correct signal model (elevation angle). Physical range [0..1]";
CM_ SG_ 290 RFC_Loc079_AzimuthQuality "Probability for correct signal model (azimuth angle). Physical range [0..1]";
CM_ SG_ 290 RFC_Loc079_RSSI "Received Signal Strength Indication (RSSI). This signal is not exactly ISO 23150:2021(E): Signal to noise ratio - detection level (A.4.7), but SNR can be calculated from this signal. Further detail please refer to the DSP Location Interface definition";
CM_ SG_ 290 RFC_Loc079_AzimuthalPartnerId "Id of the azimuthal partner location";
CM_ SG_ 290 RFC_Loc080_RadialDistance "Location radial distance. Represented in conical coordinate system. Same as ISO 23150:2021(E): Position radial distance (A.4.16)";
CM_ SG_ 290 RFC_Loc080_RadialVelocity "Location radial relative velocity ISO 23150:2021(E): Relative velocity {radial distance} (A.4.18)";
CM_ SG_ 290 RFC_Loc080_Elevation "Location elevation angle. Represented in conical coordinate system. Same as ISO 23150:2021(E): Position elevation (A.4.16)";
CM_ SG_ 290 RFC_Loc080_Azimuth "Location azimuth angle. Represented in conical coordinate system. Deviation from ISO 23150:2021(E): Position azimuth (A.4.16). Further details refers to DSP Location Interface definition";
CM_ SG_ 290 RFC_Loc080_DistVelocityCoVnce "Covariance of radial distance and radial velocity";
CM_ SG_ 290 RFC_Loc080_RadialDistanceVnce "Variance of Location radial distance ISO 23150:2021(E): Position radial distance - error (A.4.17)";
CM_ SG_ 290 RFC_Loc080_RadialVelocityVnce "Variance of Location radial relative velocity ISO 23150:2021(E): Relative velocity {radial distance} - error (A.4.19)";
CM_ SG_ 290 RFC_Loc080_ElevationVnce "Variance of Location elevation angle ISO 23150:2021(E): Position elevation - error (A.4.17)";
CM_ SG_ 290 RFC_Loc080_AzimuthVnce "Variance of Location azimuth angle ISO 23150:2021(E): Position azimuth - error (A.4.17)";
CM_ SG_ 290 RFC_Loc080_RadarCrossSection "Radar Cross Section (RCS) estimation ISO 23150:2021(E): Radar cross section (A.4.5)";
CM_ SG_ 290 RFC_Loc080_DistVelocityQuality "Quality of radial distance and velocity resolution processing. Physical range [0..1]";
CM_ SG_ 290 RFC_Loc080_ElevationQuality "Probability for correct signal model (elevation angle). Physical range [0..1]";
CM_ SG_ 290 RFC_Loc080_AzimuthQuality "Probability for correct signal model (azimuth angle). Physical range [0..1]";
CM_ SG_ 290 RFC_Loc080_RSSI "Received Signal Strength Indication (RSSI). This signal is not exactly ISO 23150:2021(E): Signal to noise ratio - detection level (A.4.7), but SNR can be calculated from this signal. Further detail please refer to the DSP Location Interface definition";
CM_ SG_ 290 RFC_Loc080_AzimuthalPartnerId "Id of the azimuthal partner location";
CM_ SG_ 291 RFC_Loc081_083_CRC "CRC - Autosar E2E Profile 5";
CM_ SG_ 291 RFC_Loc081_083_AliveCtr "Alive counter - Autosar E2E Profile 5";
CM_ SG_ 291 RFC_Loc081_083_ProtBlockCtr "Protocol-Signal: Block-Counter";
CM_ SG_ 291 RFC_Loc081_RadialDistance "Location radial distance. Represented in conical coordinate system. Same as ISO 23150:2021(E): Position radial distance (A.4.16)";
CM_ SG_ 291 RFC_Loc081_RadialVelocity "Location radial relative velocity ISO 23150:2021(E): Relative velocity {radial distance} (A.4.18)";
CM_ SG_ 291 RFC_Loc081_Elevation "Location elevation angle. Represented in conical coordinate system. Same as ISO 23150:2021(E): Position elevation (A.4.16)";
CM_ SG_ 291 RFC_Loc081_Azimuth "Location azimuth angle. Represented in conical coordinate system. Deviation from ISO 23150:2021(E): Position azimuth (A.4.16). Further details refers to DSP Location Interface definition";
CM_ SG_ 291 RFC_Loc081_DistVelocityCoVnce "Covariance of radial distance and radial velocity";
CM_ SG_ 291 RFC_Loc081_RadialDistanceVnce "Variance of Location radial distance ISO 23150:2021(E): Position radial distance - error (A.4.17)";
CM_ SG_ 291 RFC_Loc081_RadialVelocityVnce "Variance of Location radial relative velocity ISO 23150:2021(E): Relative velocity {radial distance} - error (A.4.19)";
CM_ SG_ 291 RFC_Loc081_ElevationVnce "Variance of Location elevation angle ISO 23150:2021(E): Position elevation - error (A.4.17)";
CM_ SG_ 291 RFC_Loc081_AzimuthVnce "Variance of Location azimuth angle ISO 23150:2021(E): Position azimuth - error (A.4.17)";
CM_ SG_ 291 RFC_Loc081_RadarCrossSection "Radar Cross Section (RCS) estimation ISO 23150:2021(E): Radar cross section (A.4.5)";
CM_ SG_ 291 RFC_Loc081_DistVelocityQuality "Quality of radial distance and velocity resolution processing. Physical range [0..1]";
CM_ SG_ 291 RFC_Loc081_ElevationQuality "Probability for correct signal model (elevation angle). Physical range [0..1]";
CM_ SG_ 291 RFC_Loc081_AzimuthQuality "Probability for correct signal model (azimuth angle). Physical range [0..1]";
CM_ SG_ 291 RFC_Loc081_RSSI "Received Signal Strength Indication (RSSI). This signal is not exactly ISO 23150:2021(E): Signal to noise ratio - detection level (A.4.7), but SNR can be calculated from this signal. Further detail please refer to the DSP Location Interface definition";
CM_ SG_ 291 RFC_Loc081_AzimuthalPartnerId "Id of the azimuthal partner location";
CM_ SG_ 291 RFC_Loc082_RadialDistance "Location radial distance. Represented in conical coordinate system. Same as ISO 23150:2021(E): Position radial distance (A.4.16)";
CM_ SG_ 291 RFC_Loc082_RadialVelocity "Location radial relative velocity ISO 23150:2021(E): Relative velocity {radial distance} (A.4.18)";
CM_ SG_ 291 RFC_Loc082_Elevation "Location elevation angle. Represented in conical coordinate system. Same as ISO 23150:2021(E): Position elevation (A.4.16)";
CM_ SG_ 291 RFC_Loc082_Azimuth "Location azimuth angle. Represented in conical coordinate system. Deviation from ISO 23150:2021(E): Position azimuth (A.4.16). Further details refers to DSP Location Interface definition";
CM_ SG_ 291 RFC_Loc082_DistVelocityCoVnce "Covariance of radial distance and radial velocity";
CM_ SG_ 291 RFC_Loc082_RadialDistanceVnce "Variance of Location radial distance ISO 23150:2021(E): Position radial distance - error (A.4.17)";
CM_ SG_ 291 RFC_Loc082_RadialVelocityVnce "Variance of Location radial relative velocity ISO 23150:2021(E): Relative velocity {radial distance} - error (A.4.19)";
CM_ SG_ 291 RFC_Loc082_ElevationVnce "Variance of Location elevation angle ISO 23150:2021(E): Position elevation - error (A.4.17)";
CM_ SG_ 291 RFC_Loc082_AzimuthVnce "Variance of Location azimuth angle ISO 23150:2021(E): Position azimuth - error (A.4.17)";
CM_ SG_ 291 RFC_Loc082_RadarCrossSection "Radar Cross Section (RCS) estimation ISO 23150:2021(E): Radar cross section (A.4.5)";
CM_ SG_ 291 RFC_Loc082_DistVelocityQuality "Quality of radial distance and velocity resolution processing. Physical range [0..1]";
CM_ SG_ 291 RFC_Loc082_ElevationQuality "Probability for correct signal model (elevation angle). Physical range [0..1]";
CM_ SG_ 291 RFC_Loc082_AzimuthQuality "Probability for correct signal model (azimuth angle). Physical range [0..1]";
CM_ SG_ 291 RFC_Loc082_RSSI "Received Signal Strength Indication (RSSI). This signal is not exactly ISO 23150:2021(E): Signal to noise ratio - detection level (A.4.7), but SNR can be calculated from this signal. Further detail please refer to the DSP Location Interface definition";
CM_ SG_ 291 RFC_Loc082_AzimuthalPartnerId "Id of the azimuthal partner location";
CM_ SG_ 291 RFC_Loc083_RadialDistance "Location radial distance. Represented in conical coordinate system. Same as ISO 23150:2021(E): Position radial distance (A.4.16)";
CM_ SG_ 291 RFC_Loc083_RadialVelocity "Location radial relative velocity ISO 23150:2021(E): Relative velocity {radial distance} (A.4.18)";
CM_ SG_ 291 RFC_Loc083_Elevation "Location elevation angle. Represented in conical coordinate system. Same as ISO 23150:2021(E): Position elevation (A.4.16)";
CM_ SG_ 291 RFC_Loc083_Azimuth "Location azimuth angle. Represented in conical coordinate system. Deviation from ISO 23150:2021(E): Position azimuth (A.4.16). Further details refers to DSP Location Interface definition";
CM_ SG_ 291 RFC_Loc083_DistVelocityCoVnce "Covariance of radial distance and radial velocity";
CM_ SG_ 291 RFC_Loc083_RadialDistanceVnce "Variance of Location radial distance ISO 23150:2021(E): Position radial distance - error (A.4.17)";
CM_ SG_ 291 RFC_Loc083_RadialVelocityVnce "Variance of Location radial relative velocity ISO 23150:2021(E): Relative velocity {radial distance} - error (A.4.19)";
CM_ SG_ 291 RFC_Loc083_ElevationVnce "Variance of Location elevation angle ISO 23150:2021(E): Position elevation - error (A.4.17)";
CM_ SG_ 291 RFC_Loc083_AzimuthVnce "Variance of Location azimuth angle ISO 23150:2021(E): Position azimuth - error (A.4.17)";
CM_ SG_ 291 RFC_Loc083_RadarCrossSection "Radar Cross Section (RCS) estimation ISO 23150:2021(E): Radar cross section (A.4.5)";
CM_ SG_ 291 RFC_Loc083_DistVelocityQuality "Quality of radial distance and velocity resolution processing. Physical range [0..1]";
CM_ SG_ 291 RFC_Loc083_ElevationQuality "Probability for correct signal model (elevation angle). Physical range [0..1]";
CM_ SG_ 291 RFC_Loc083_AzimuthQuality "Probability for correct signal model (azimuth angle). Physical range [0..1]";
CM_ SG_ 291 RFC_Loc083_RSSI "Received Signal Strength Indication (RSSI). This signal is not exactly ISO 23150:2021(E): Signal to noise ratio - detection level (A.4.7), but SNR can be calculated from this signal. Further detail please refer to the DSP Location Interface definition";
CM_ SG_ 291 RFC_Loc083_AzimuthalPartnerId "Id of the azimuthal partner location";
CM_ SG_ 292 RFC_Loc084_086_CRC "CRC - Autosar E2E Profile 5";
CM_ SG_ 292 RFC_Loc084_086_AliveCtr "Alive counter - Autosar E2E Profile 5";
CM_ SG_ 292 RFC_Loc084_086_ProtBlockCtr "Protocol-Signal: Block-Counter";
CM_ SG_ 292 RFC_Loc084_RadialDistance "Location radial distance. Represented in conical coordinate system. Same as ISO 23150:2021(E): Position radial distance (A.4.16)";
CM_ SG_ 292 RFC_Loc084_RadialVelocity "Location radial relative velocity ISO 23150:2021(E): Relative velocity {radial distance} (A.4.18)";
CM_ SG_ 292 RFC_Loc084_Elevation "Location elevation angle. Represented in conical coordinate system. Same as ISO 23150:2021(E): Position elevation (A.4.16)";
CM_ SG_ 292 RFC_Loc084_Azimuth "Location azimuth angle. Represented in conical coordinate system. Deviation from ISO 23150:2021(E): Position azimuth (A.4.16). Further details refers to DSP Location Interface definition";
CM_ SG_ 292 RFC_Loc084_DistVelocityCoVnce "Covariance of radial distance and radial velocity";
CM_ SG_ 292 RFC_Loc084_RadialDistanceVnce "Variance of Location radial distance ISO 23150:2021(E): Position radial distance - error (A.4.17)";
CM_ SG_ 292 RFC_Loc084_RadialVelocityVnce "Variance of Location radial relative velocity ISO 23150:2021(E): Relative velocity {radial distance} - error (A.4.19)";
CM_ SG_ 292 RFC_Loc084_ElevationVnce "Variance of Location elevation angle ISO 23150:2021(E): Position elevation - error (A.4.17)";
CM_ SG_ 292 RFC_Loc084_AzimuthVnce "Variance of Location azimuth angle ISO 23150:2021(E): Position azimuth - error (A.4.17)";
CM_ SG_ 292 RFC_Loc084_RadarCrossSection "Radar Cross Section (RCS) estimation ISO 23150:2021(E): Radar cross section (A.4.5)";
CM_ SG_ 292 RFC_Loc084_DistVelocityQuality "Quality of radial distance and velocity resolution processing. Physical range [0..1]";
CM_ SG_ 292 RFC_Loc084_ElevationQuality "Probability for correct signal model (elevation angle). Physical range [0..1]";
CM_ SG_ 292 RFC_Loc084_AzimuthQuality "Probability for correct signal model (azimuth angle). Physical range [0..1]";
CM_ SG_ 292 RFC_Loc084_RSSI "Received Signal Strength Indication (RSSI). This signal is not exactly ISO 23150:2021(E): Signal to noise ratio - detection level (A.4.7), but SNR can be calculated from this signal. Further detail please refer to the DSP Location Interface definition";
CM_ SG_ 292 RFC_Loc084_AzimuthalPartnerId "Id of the azimuthal partner location";
CM_ SG_ 292 RFC_Loc085_RadialDistance "Location radial distance. Represented in conical coordinate system. Same as ISO 23150:2021(E): Position radial distance (A.4.16)";
CM_ SG_ 292 RFC_Loc085_RadialVelocity "Location radial relative velocity ISO 23150:2021(E): Relative velocity {radial distance} (A.4.18)";
CM_ SG_ 292 RFC_Loc085_Elevation "Location elevation angle. Represented in conical coordinate system. Same as ISO 23150:2021(E): Position elevation (A.4.16)";
CM_ SG_ 292 RFC_Loc085_Azimuth "Location azimuth angle. Represented in conical coordinate system. Deviation from ISO 23150:2021(E): Position azimuth (A.4.16). Further details refers to DSP Location Interface definition";
CM_ SG_ 292 RFC_Loc085_DistVelocityCoVnce "Covariance of radial distance and radial velocity";
CM_ SG_ 292 RFC_Loc085_RadialDistanceVnce "Variance of Location radial distance ISO 23150:2021(E): Position radial distance - error (A.4.17)";
CM_ SG_ 292 RFC_Loc085_RadialVelocityVnce "Variance of Location radial relative velocity ISO 23150:2021(E): Relative velocity {radial distance} - error (A.4.19)";
CM_ SG_ 292 RFC_Loc085_ElevationVnce "Variance of Location elevation angle ISO 23150:2021(E): Position elevation - error (A.4.17)";
CM_ SG_ 292 RFC_Loc085_AzimuthVnce "Variance of Location azimuth angle ISO 23150:2021(E): Position azimuth - error (A.4.17)";
CM_ SG_ 292 RFC_Loc085_RadarCrossSection "Radar Cross Section (RCS) estimation ISO 23150:2021(E): Radar cross section (A.4.5)";
CM_ SG_ 292 RFC_Loc085_DistVelocityQuality "Quality of radial distance and velocity resolution processing. Physical range [0..1]";
CM_ SG_ 292 RFC_Loc085_ElevationQuality "Probability for correct signal model (elevation angle). Physical range [0..1]";
CM_ SG_ 292 RFC_Loc085_AzimuthQuality "Probability for correct signal model (azimuth angle). Physical range [0..1]";
CM_ SG_ 292 RFC_Loc085_RSSI "Received Signal Strength Indication (RSSI). This signal is not exactly ISO 23150:2021(E): Signal to noise ratio - detection level (A.4.7), but SNR can be calculated from this signal. Further detail please refer to the DSP Location Interface definition";
CM_ SG_ 292 RFC_Loc085_AzimuthalPartnerId "Id of the azimuthal partner location";
CM_ SG_ 292 RFC_Loc086_RadialDistance "Location radial distance. Represented in conical coordinate system. Same as ISO 23150:2021(E): Position radial distance (A.4.16)";
CM_ SG_ 292 RFC_Loc086_RadialVelocity "Location radial relative velocity ISO 23150:2021(E): Relative velocity {radial distance} (A.4.18)";
CM_ SG_ 292 RFC_Loc086_Elevation "Location elevation angle. Represented in conical coordinate system. Same as ISO 23150:2021(E): Position elevation (A.4.16)";
CM_ SG_ 292 RFC_Loc086_Azimuth "Location azimuth angle. Represented in conical coordinate system. Deviation from ISO 23150:2021(E): Position azimuth (A.4.16). Further details refers to DSP Location Interface definition";
CM_ SG_ 292 RFC_Loc086_DistVelocityCoVnce "Covariance of radial distance and radial velocity";
CM_ SG_ 292 RFC_Loc086_RadialDistanceVnce "Variance of Location radial distance ISO 23150:2021(E): Position radial distance - error (A.4.17)";
CM_ SG_ 292 RFC_Loc086_RadialVelocityVnce "Variance of Location radial relative velocity ISO 23150:2021(E): Relative velocity {radial distance} - error (A.4.19)";
CM_ SG_ 292 RFC_Loc086_ElevationVnce "Variance of Location elevation angle ISO 23150:2021(E): Position elevation - error (A.4.17)";
CM_ SG_ 292 RFC_Loc086_AzimuthVnce "Variance of Location azimuth angle ISO 23150:2021(E): Position azimuth - error (A.4.17)";
CM_ SG_ 292 RFC_Loc086_RadarCrossSection "Radar Cross Section (RCS) estimation ISO 23150:2021(E): Radar cross section (A.4.5)";
CM_ SG_ 292 RFC_Loc086_DistVelocityQuality "Quality of radial distance and velocity resolution processing. Physical range [0..1]";
CM_ SG_ 292 RFC_Loc086_ElevationQuality "Probability for correct signal model (elevation angle). Physical range [0..1]";
CM_ SG_ 292 RFC_Loc086_AzimuthQuality "Probability for correct signal model (azimuth angle). Physical range [0..1]";
CM_ SG_ 292 RFC_Loc086_RSSI "Received Signal Strength Indication (RSSI). This signal is not exactly ISO 23150:2021(E): Signal to noise ratio - detection level (A.4.7), but SNR can be calculated from this signal. Further detail please refer to the DSP Location Interface definition";
CM_ SG_ 292 RFC_Loc086_AzimuthalPartnerId "Id of the azimuthal partner location";
CM_ SG_ 293 RFC_Loc087_089_CRC "CRC - Autosar E2E Profile 5";
CM_ SG_ 293 RFC_Loc087_089_AliveCtr "Alive counter - Autosar E2E Profile 5";
CM_ SG_ 293 RFC_Loc087_089_ProtBlockCtr "Protocol-Signal: Block-Counter";
CM_ SG_ 293 RFC_Loc087_RadialDistance "Location radial distance. Represented in conical coordinate system. Same as ISO 23150:2021(E): Position radial distance (A.4.16)";
CM_ SG_ 293 RFC_Loc087_RadialVelocity "Location radial relative velocity ISO 23150:2021(E): Relative velocity {radial distance} (A.4.18)";
CM_ SG_ 293 RFC_Loc087_Elevation "Location elevation angle. Represented in conical coordinate system. Same as ISO 23150:2021(E): Position elevation (A.4.16)";
CM_ SG_ 293 RFC_Loc087_Azimuth "Location azimuth angle. Represented in conical coordinate system. Deviation from ISO 23150:2021(E): Position azimuth (A.4.16). Further details refers to DSP Location Interface definition";
CM_ SG_ 293 RFC_Loc087_DistVelocityCoVnce "Covariance of radial distance and radial velocity";
CM_ SG_ 293 RFC_Loc087_RadialDistanceVnce "Variance of Location radial distance ISO 23150:2021(E): Position radial distance - error (A.4.17)";
CM_ SG_ 293 RFC_Loc087_RadialVelocityVnce "Variance of Location radial relative velocity ISO 23150:2021(E): Relative velocity {radial distance} - error (A.4.19)";
CM_ SG_ 293 RFC_Loc087_ElevationVnce "Variance of Location elevation angle ISO 23150:2021(E): Position elevation - error (A.4.17)";
CM_ SG_ 293 RFC_Loc087_AzimuthVnce "Variance of Location azimuth angle ISO 23150:2021(E): Position azimuth - error (A.4.17)";
CM_ SG_ 293 RFC_Loc087_RadarCrossSection "Radar Cross Section (RCS) estimation ISO 23150:2021(E): Radar cross section (A.4.5)";
CM_ SG_ 293 RFC_Loc087_DistVelocityQuality "Quality of radial distance and velocity resolution processing. Physical range [0..1]";
CM_ SG_ 293 RFC_Loc087_ElevationQuality "Probability for correct signal model (elevation angle). Physical range [0..1]";
CM_ SG_ 293 RFC_Loc087_AzimuthQuality "Probability for correct signal model (azimuth angle). Physical range [0..1]";
CM_ SG_ 293 RFC_Loc087_RSSI "Received Signal Strength Indication (RSSI). This signal is not exactly ISO 23150:2021(E): Signal to noise ratio - detection level (A.4.7), but SNR can be calculated from this signal. Further detail please refer to the DSP Location Interface definition";
CM_ SG_ 293 RFC_Loc087_AzimuthalPartnerId "Id of the azimuthal partner location";
CM_ SG_ 293 RFC_Loc088_RadialDistance "Location radial distance. Represented in conical coordinate system. Same as ISO 23150:2021(E): Position radial distance (A.4.16)";
CM_ SG_ 293 RFC_Loc088_RadialVelocity "Location radial relative velocity ISO 23150:2021(E): Relative velocity {radial distance} (A.4.18)";
CM_ SG_ 293 RFC_Loc088_Elevation "Location elevation angle. Represented in conical coordinate system. Same as ISO 23150:2021(E): Position elevation (A.4.16)";
CM_ SG_ 293 RFC_Loc088_Azimuth "Location azimuth angle. Represented in conical coordinate system. Deviation from ISO 23150:2021(E): Position azimuth (A.4.16). Further details refers to DSP Location Interface definition";
CM_ SG_ 293 RFC_Loc088_DistVelocityCoVnce "Covariance of radial distance and radial velocity";
CM_ SG_ 293 RFC_Loc088_RadialDistanceVnce "Variance of Location radial distance ISO 23150:2021(E): Position radial distance - error (A.4.17)";
CM_ SG_ 293 RFC_Loc088_RadialVelocityVnce "Variance of Location radial relative velocity ISO 23150:2021(E): Relative velocity {radial distance} - error (A.4.19)";
CM_ SG_ 293 RFC_Loc088_ElevationVnce "Variance of Location elevation angle ISO 23150:2021(E): Position elevation - error (A.4.17)";
CM_ SG_ 293 RFC_Loc088_AzimuthVnce "Variance of Location azimuth angle ISO 23150:2021(E): Position azimuth - error (A.4.17)";
CM_ SG_ 293 RFC_Loc088_RadarCrossSection "Radar Cross Section (RCS) estimation ISO 23150:2021(E): Radar cross section (A.4.5)";
CM_ SG_ 293 RFC_Loc088_DistVelocityQuality "Quality of radial distance and velocity resolution processing. Physical range [0..1]";
CM_ SG_ 293 RFC_Loc088_ElevationQuality "Probability for correct signal model (elevation angle). Physical range [0..1]";
CM_ SG_ 293 RFC_Loc088_AzimuthQuality "Probability for correct signal model (azimuth angle). Physical range [0..1]";
CM_ SG_ 293 RFC_Loc088_RSSI "Received Signal Strength Indication (RSSI). This signal is not exactly ISO 23150:2021(E): Signal to noise ratio - detection level (A.4.7), but SNR can be calculated from this signal. Further detail please refer to the DSP Location Interface definition";
CM_ SG_ 293 RFC_Loc088_AzimuthalPartnerId "Id of the azimuthal partner location";
CM_ SG_ 293 RFC_Loc089_RadialDistance "Location radial distance. Represented in conical coordinate system. Same as ISO 23150:2021(E): Position radial distance (A.4.16)";
CM_ SG_ 293 RFC_Loc089_RadialVelocity "Location radial relative velocity ISO 23150:2021(E): Relative velocity {radial distance} (A.4.18)";
CM_ SG_ 293 RFC_Loc089_Elevation "Location elevation angle. Represented in conical coordinate system. Same as ISO 23150:2021(E): Position elevation (A.4.16)";
CM_ SG_ 293 RFC_Loc089_Azimuth "Location azimuth angle. Represented in conical coordinate system. Deviation from ISO 23150:2021(E): Position azimuth (A.4.16). Further details refers to DSP Location Interface definition";
CM_ SG_ 293 RFC_Loc089_DistVelocityCoVnce "Covariance of radial distance and radial velocity";
CM_ SG_ 293 RFC_Loc089_RadialDistanceVnce "Variance of Location radial distance ISO 23150:2021(E): Position radial distance - error (A.4.17)";
CM_ SG_ 293 RFC_Loc089_RadialVelocityVnce "Variance of Location radial relative velocity ISO 23150:2021(E): Relative velocity {radial distance} - error (A.4.19)";
CM_ SG_ 293 RFC_Loc089_ElevationVnce "Variance of Location elevation angle ISO 23150:2021(E): Position elevation - error (A.4.17)";
CM_ SG_ 293 RFC_Loc089_AzimuthVnce "Variance of Location azimuth angle ISO 23150:2021(E): Position azimuth - error (A.4.17)";
CM_ SG_ 293 RFC_Loc089_RadarCrossSection "Radar Cross Section (RCS) estimation ISO 23150:2021(E): Radar cross section (A.4.5)";
CM_ SG_ 293 RFC_Loc089_DistVelocityQuality "Quality of radial distance and velocity resolution processing. Physical range [0..1]";
CM_ SG_ 293 RFC_Loc089_ElevationQuality "Probability for correct signal model (elevation angle). Physical range [0..1]";
CM_ SG_ 293 RFC_Loc089_AzimuthQuality "Probability for correct signal model (azimuth angle). Physical range [0..1]";
CM_ SG_ 293 RFC_Loc089_RSSI "Received Signal Strength Indication (RSSI). This signal is not exactly ISO 23150:2021(E): Signal to noise ratio - detection level (A.4.7), but SNR can be calculated from this signal. Further detail please refer to the DSP Location Interface definition";
CM_ SG_ 293 RFC_Loc089_AzimuthalPartnerId "Id of the azimuthal partner location";
CM_ SG_ 294 RFC_Loc090_092_CRC "CRC - Autosar E2E Profile 5";
CM_ SG_ 294 RFC_Loc090_092_AliveCtr "Alive counter - Autosar E2E Profile 5";
CM_ SG_ 294 RFC_Loc090_092_ProtBlockCtr "Protocol-Signal: Block-Counter";
CM_ SG_ 294 RFC_Loc090_RadialDistance "Location radial distance. Represented in conical coordinate system. Same as ISO 23150:2021(E): Position radial distance (A.4.16)";
CM_ SG_ 294 RFC_Loc090_RadialVelocity "Location radial relative velocity ISO 23150:2021(E): Relative velocity {radial distance} (A.4.18)";
CM_ SG_ 294 RFC_Loc090_Elevation "Location elevation angle. Represented in conical coordinate system. Same as ISO 23150:2021(E): Position elevation (A.4.16)";
CM_ SG_ 294 RFC_Loc090_Azimuth "Location azimuth angle. Represented in conical coordinate system. Deviation from ISO 23150:2021(E): Position azimuth (A.4.16). Further details refers to DSP Location Interface definition";
CM_ SG_ 294 RFC_Loc090_DistVelocityCoVnce "Covariance of radial distance and radial velocity";
CM_ SG_ 294 RFC_Loc090_RadialDistanceVnce "Variance of Location radial distance ISO 23150:2021(E): Position radial distance - error (A.4.17)";
CM_ SG_ 294 RFC_Loc090_RadialVelocityVnce "Variance of Location radial relative velocity ISO 23150:2021(E): Relative velocity {radial distance} - error (A.4.19)";
CM_ SG_ 294 RFC_Loc090_ElevationVnce "Variance of Location elevation angle ISO 23150:2021(E): Position elevation - error (A.4.17)";
CM_ SG_ 294 RFC_Loc090_AzimuthVnce "Variance of Location azimuth angle ISO 23150:2021(E): Position azimuth - error (A.4.17)";
CM_ SG_ 294 RFC_Loc090_RadarCrossSection "Radar Cross Section (RCS) estimation ISO 23150:2021(E): Radar cross section (A.4.5)";
CM_ SG_ 294 RFC_Loc090_DistVelocityQuality "Quality of radial distance and velocity resolution processing. Physical range [0..1]";
CM_ SG_ 294 RFC_Loc090_ElevationQuality "Probability for correct signal model (elevation angle). Physical range [0..1]";
CM_ SG_ 294 RFC_Loc090_AzimuthQuality "Probability for correct signal model (azimuth angle). Physical range [0..1]";
CM_ SG_ 294 RFC_Loc090_RSSI "Received Signal Strength Indication (RSSI). This signal is not exactly ISO 23150:2021(E): Signal to noise ratio - detection level (A.4.7), but SNR can be calculated from this signal. Further detail please refer to the DSP Location Interface definition";
CM_ SG_ 294 RFC_Loc090_AzimuthalPartnerId "Id of the azimuthal partner location";
CM_ SG_ 294 RFC_Loc091_RadialDistance "Location radial distance. Represented in conical coordinate system. Same as ISO 23150:2021(E): Position radial distance (A.4.16)";
CM_ SG_ 294 RFC_Loc091_RadialVelocity "Location radial relative velocity ISO 23150:2021(E): Relative velocity {radial distance} (A.4.18)";
CM_ SG_ 294 RFC_Loc091_Elevation "Location elevation angle. Represented in conical coordinate system. Same as ISO 23150:2021(E): Position elevation (A.4.16)";
CM_ SG_ 294 RFC_Loc091_Azimuth "Location azimuth angle. Represented in conical coordinate system. Deviation from ISO 23150:2021(E): Position azimuth (A.4.16). Further details refers to DSP Location Interface definition";
CM_ SG_ 294 RFC_Loc091_DistVelocityCoVnce "Covariance of radial distance and radial velocity";
CM_ SG_ 294 RFC_Loc091_RadialDistanceVnce "Variance of Location radial distance ISO 23150:2021(E): Position radial distance - error (A.4.17)";
CM_ SG_ 294 RFC_Loc091_RadialVelocityVnce "Variance of Location radial relative velocity ISO 23150:2021(E): Relative velocity {radial distance} - error (A.4.19)";
CM_ SG_ 294 RFC_Loc091_ElevationVnce "Variance of Location elevation angle ISO 23150:2021(E): Position elevation - error (A.4.17)";
CM_ SG_ 294 RFC_Loc091_AzimuthVnce "Variance of Location azimuth angle ISO 23150:2021(E): Position azimuth - error (A.4.17)";
CM_ SG_ 294 RFC_Loc091_RadarCrossSection "Radar Cross Section (RCS) estimation ISO 23150:2021(E): Radar cross section (A.4.5)";
CM_ SG_ 294 RFC_Loc091_DistVelocityQuality "Quality of radial distance and velocity resolution processing. Physical range [0..1]";
CM_ SG_ 294 RFC_Loc091_ElevationQuality "Probability for correct signal model (elevation angle). Physical range [0..1]";
CM_ SG_ 294 RFC_Loc091_AzimuthQuality "Probability for correct signal model (azimuth angle). Physical range [0..1]";
CM_ SG_ 294 RFC_Loc091_RSSI "Received Signal Strength Indication (RSSI). This signal is not exactly ISO 23150:2021(E): Signal to noise ratio - detection level (A.4.7), but SNR can be calculated from this signal. Further detail please refer to the DSP Location Interface definition";
CM_ SG_ 294 RFC_Loc091_AzimuthalPartnerId "Id of the azimuthal partner location";
CM_ SG_ 294 RFC_Loc092_RadialDistance "Location radial distance. Represented in conical coordinate system. Same as ISO 23150:2021(E): Position radial distance (A.4.16)";
CM_ SG_ 294 RFC_Loc092_RadialVelocity "Location radial relative velocity ISO 23150:2021(E): Relative velocity {radial distance} (A.4.18)";
CM_ SG_ 294 RFC_Loc092_Elevation "Location elevation angle. Represented in conical coordinate system. Same as ISO 23150:2021(E): Position elevation (A.4.16)";
CM_ SG_ 294 RFC_Loc092_Azimuth "Location azimuth angle. Represented in conical coordinate system. Deviation from ISO 23150:2021(E): Position azimuth (A.4.16). Further details refers to DSP Location Interface definition";
CM_ SG_ 294 RFC_Loc092_DistVelocityCoVnce "Covariance of radial distance and radial velocity";
CM_ SG_ 294 RFC_Loc092_RadialDistanceVnce "Variance of Location radial distance ISO 23150:2021(E): Position radial distance - error (A.4.17)";
CM_ SG_ 294 RFC_Loc092_RadialVelocityVnce "Variance of Location radial relative velocity ISO 23150:2021(E): Relative velocity {radial distance} - error (A.4.19)";
CM_ SG_ 294 RFC_Loc092_ElevationVnce "Variance of Location elevation angle ISO 23150:2021(E): Position elevation - error (A.4.17)";
CM_ SG_ 294 RFC_Loc092_AzimuthVnce "Variance of Location azimuth angle ISO 23150:2021(E): Position azimuth - error (A.4.17)";
CM_ SG_ 294 RFC_Loc092_RadarCrossSection "Radar Cross Section (RCS) estimation ISO 23150:2021(E): Radar cross section (A.4.5)";
CM_ SG_ 294 RFC_Loc092_DistVelocityQuality "Quality of radial distance and velocity resolution processing. Physical range [0..1]";
CM_ SG_ 294 RFC_Loc092_ElevationQuality "Probability for correct signal model (elevation angle). Physical range [0..1]";
CM_ SG_ 294 RFC_Loc092_AzimuthQuality "Probability for correct signal model (azimuth angle). Physical range [0..1]";
CM_ SG_ 294 RFC_Loc092_RSSI "Received Signal Strength Indication (RSSI). This signal is not exactly ISO 23150:2021(E): Signal to noise ratio - detection level (A.4.7), but SNR can be calculated from this signal. Further detail please refer to the DSP Location Interface definition";
CM_ SG_ 294 RFC_Loc092_AzimuthalPartnerId "Id of the azimuthal partner location";
CM_ SG_ 295 RFC_Loc093_095_CRC "CRC - Autosar E2E Profile 5";
CM_ SG_ 295 RFC_Loc093_095_AliveCtr "Alive counter - Autosar E2E Profile 5";
CM_ SG_ 295 RFC_Loc093_095_ProtBlockCtr "Protocol-Signal: Block-Counter";
CM_ SG_ 295 RFC_Loc093_RadialDistance "Location radial distance. Represented in conical coordinate system. Same as ISO 23150:2021(E): Position radial distance (A.4.16)";
CM_ SG_ 295 RFC_Loc093_RadialVelocity "Location radial relative velocity ISO 23150:2021(E): Relative velocity {radial distance} (A.4.18)";
CM_ SG_ 295 RFC_Loc093_Elevation "Location elevation angle. Represented in conical coordinate system. Same as ISO 23150:2021(E): Position elevation (A.4.16)";
CM_ SG_ 295 RFC_Loc093_Azimuth "Location azimuth angle. Represented in conical coordinate system. Deviation from ISO 23150:2021(E): Position azimuth (A.4.16). Further details refers to DSP Location Interface definition";
CM_ SG_ 295 RFC_Loc093_DistVelocityCoVnce "Covariance of radial distance and radial velocity";
CM_ SG_ 295 RFC_Loc093_RadialDistanceVnce "Variance of Location radial distance ISO 23150:2021(E): Position radial distance - error (A.4.17)";
CM_ SG_ 295 RFC_Loc093_RadialVelocityVnce "Variance of Location radial relative velocity ISO 23150:2021(E): Relative velocity {radial distance} - error (A.4.19)";
CM_ SG_ 295 RFC_Loc093_ElevationVnce "Variance of Location elevation angle ISO 23150:2021(E): Position elevation - error (A.4.17)";
CM_ SG_ 295 RFC_Loc093_AzimuthVnce "Variance of Location azimuth angle ISO 23150:2021(E): Position azimuth - error (A.4.17)";
CM_ SG_ 295 RFC_Loc093_RadarCrossSection "Radar Cross Section (RCS) estimation ISO 23150:2021(E): Radar cross section (A.4.5)";
CM_ SG_ 295 RFC_Loc093_DistVelocityQuality "Quality of radial distance and velocity resolution processing. Physical range [0..1]";
CM_ SG_ 295 RFC_Loc093_ElevationQuality "Probability for correct signal model (elevation angle). Physical range [0..1]";
CM_ SG_ 295 RFC_Loc093_AzimuthQuality "Probability for correct signal model (azimuth angle). Physical range [0..1]";
CM_ SG_ 295 RFC_Loc093_RSSI "Received Signal Strength Indication (RSSI). This signal is not exactly ISO 23150:2021(E): Signal to noise ratio - detection level (A.4.7), but SNR can be calculated from this signal. Further detail please refer to the DSP Location Interface definition";
CM_ SG_ 295 RFC_Loc093_AzimuthalPartnerId "Id of the azimuthal partner location";
CM_ SG_ 295 RFC_Loc094_RadialDistance "Location radial distance. Represented in conical coordinate system. Same as ISO 23150:2021(E): Position radial distance (A.4.16)";
CM_ SG_ 295 RFC_Loc094_RadialVelocity "Location radial relative velocity ISO 23150:2021(E): Relative velocity {radial distance} (A.4.18)";
CM_ SG_ 295 RFC_Loc094_Elevation "Location elevation angle. Represented in conical coordinate system. Same as ISO 23150:2021(E): Position elevation (A.4.16)";
CM_ SG_ 295 RFC_Loc094_Azimuth "Location azimuth angle. Represented in conical coordinate system. Deviation from ISO 23150:2021(E): Position azimuth (A.4.16). Further details refers to DSP Location Interface definition";
CM_ SG_ 295 RFC_Loc094_DistVelocityCoVnce "Covariance of radial distance and radial velocity";
CM_ SG_ 295 RFC_Loc094_RadialDistanceVnce "Variance of Location radial distance ISO 23150:2021(E): Position radial distance - error (A.4.17)";
CM_ SG_ 295 RFC_Loc094_RadialVelocityVnce "Variance of Location radial relative velocity ISO 23150:2021(E): Relative velocity {radial distance} - error (A.4.19)";
CM_ SG_ 295 RFC_Loc094_ElevationVnce "Variance of Location elevation angle ISO 23150:2021(E): Position elevation - error (A.4.17)";
CM_ SG_ 295 RFC_Loc094_AzimuthVnce "Variance of Location azimuth angle ISO 23150:2021(E): Position azimuth - error (A.4.17)";
CM_ SG_ 295 RFC_Loc094_RadarCrossSection "Radar Cross Section (RCS) estimation ISO 23150:2021(E): Radar cross section (A.4.5)";
CM_ SG_ 295 RFC_Loc094_DistVelocityQuality "Quality of radial distance and velocity resolution processing. Physical range [0..1]";
CM_ SG_ 295 RFC_Loc094_ElevationQuality "Probability for correct signal model (elevation angle). Physical range [0..1]";
CM_ SG_ 295 RFC_Loc094_AzimuthQuality "Probability for correct signal model (azimuth angle). Physical range [0..1]";
CM_ SG_ 295 RFC_Loc094_RSSI "Received Signal Strength Indication (RSSI). This signal is not exactly ISO 23150:2021(E): Signal to noise ratio - detection level (A.4.7), but SNR can be calculated from this signal. Further detail please refer to the DSP Location Interface definition";
CM_ SG_ 295 RFC_Loc094_AzimuthalPartnerId "Id of the azimuthal partner location";
CM_ SG_ 295 RFC_Loc095_RadialDistance "Location radial distance. Represented in conical coordinate system. Same as ISO 23150:2021(E): Position radial distance (A.4.16)";
CM_ SG_ 295 RFC_Loc095_RadialVelocity "Location radial relative velocity ISO 23150:2021(E): Relative velocity {radial distance} (A.4.18)";
CM_ SG_ 295 RFC_Loc095_Elevation "Location elevation angle. Represented in conical coordinate system. Same as ISO 23150:2021(E): Position elevation (A.4.16)";
CM_ SG_ 295 RFC_Loc095_Azimuth "Location azimuth angle. Represented in conical coordinate system. Deviation from ISO 23150:2021(E): Position azimuth (A.4.16). Further details refers to DSP Location Interface definition";
CM_ SG_ 295 RFC_Loc095_DistVelocityCoVnce "Covariance of radial distance and radial velocity";
CM_ SG_ 295 RFC_Loc095_RadialDistanceVnce "Variance of Location radial distance ISO 23150:2021(E): Position radial distance - error (A.4.17)";
CM_ SG_ 295 RFC_Loc095_RadialVelocityVnce "Variance of Location radial relative velocity ISO 23150:2021(E): Relative velocity {radial distance} - error (A.4.19)";
CM_ SG_ 295 RFC_Loc095_ElevationVnce "Variance of Location elevation angle ISO 23150:2021(E): Position elevation - error (A.4.17)";
CM_ SG_ 295 RFC_Loc095_AzimuthVnce "Variance of Location azimuth angle ISO 23150:2021(E): Position azimuth - error (A.4.17)";
CM_ SG_ 295 RFC_Loc095_RadarCrossSection "Radar Cross Section (RCS) estimation ISO 23150:2021(E): Radar cross section (A.4.5)";
CM_ SG_ 295 RFC_Loc095_DistVelocityQuality "Quality of radial distance and velocity resolution processing. Physical range [0..1]";
CM_ SG_ 295 RFC_Loc095_ElevationQuality "Probability for correct signal model (elevation angle). Physical range [0..1]";
CM_ SG_ 295 RFC_Loc095_AzimuthQuality "Probability for correct signal model (azimuth angle). Physical range [0..1]";
CM_ SG_ 295 RFC_Loc095_RSSI "Received Signal Strength Indication (RSSI). This signal is not exactly ISO 23150:2021(E): Signal to noise ratio - detection level (A.4.7), but SNR can be calculated from this signal. Further detail please refer to the DSP Location Interface definition";
CM_ SG_ 295 RFC_Loc095_AzimuthalPartnerId "Id of the azimuthal partner location";
BA_DEF_ BO_  "CANFD_BRS" ENUM  "0","1";
BA_DEF_ BO_  "GenMsgCycleTime" INT 0 65535;
BA_DEF_ BO_  "GenMsgILSupport" ENUM  "No","Yes";
BA_DEF_ BO_  "GenMsgSendType" ENUM  "Cyclic","Event","reserved","reserved","reserved","reserved","reserved","IfActive","NoMsgSendType","reserved","reserved","reserved";
BA_DEF_ BO_  "VFrameFormat" ENUM  "StandardCAN","ExtendedCAN","reserved","reserved","reserved","reserved","reserved","reserved","reserved","reserved","reserved","reserved","reserved","reserved","StandardCAN_FD","ExtendedCAN_FD";
BA_DEF_ BO_  "E2Eprofile" STRING ;
BA_DEF_ BO_  "DataID" HEX 0 655535;
BA_DEF_ SG_  "GenSigSendType" ENUM  "Cyclic","OnWrite","OnWriteWithRepetition","OnChange","OnChangeWithRepetition","IfActive","IfActiveWithRepetition","NoSigSendType","OnChangeAndIfActive","OnChangeAndIfActiveWithRepetition";
BA_DEF_ SG_  "GenSigStartValue" HEX 0 2147483648;
BA_DEF_DEF_  "CANFD_BRS" "1";
BA_DEF_DEF_  "GenMsgCycleTime" 0;
BA_DEF_DEF_  "GenMsgILSupport" "Yes";
BA_DEF_DEF_  "GenMsgSendType" "Cyclic";
BA_DEF_DEF_  "VFrameFormat" "";
BA_DEF_DEF_  "E2Eprofile" "None";
BA_DEF_DEF_  "DataID" 0;
BA_DEF_DEF_  "GenSigSendType" "NoSigSendType";
BA_DEF_DEF_  "GenSigStartValue" 0;
BA_ "GenMsgSendType" BO_ 281 1;
BA_ "E2Eprofile" BO_ 281 "AUTOSAR Profile 5";
BA_ "DataID" BO_ 281 8473;
BA_ "VFrameFormat" BO_ 281 14;
BA_ "GenMsgSendType" BO_ 282 1;
BA_ "E2Eprofile" BO_ 282 "AUTOSAR Profile 5";
BA_ "DataID" BO_ 282 8474;
BA_ "VFrameFormat" BO_ 282 14;
BA_ "GenMsgSendType" BO_ 283 1;
BA_ "E2Eprofile" BO_ 283 "AUTOSAR Profile 5";
BA_ "DataID" BO_ 283 8475;
BA_ "VFrameFormat" BO_ 283 14;
BA_ "GenMsgSendType" BO_ 284 1;
BA_ "E2Eprofile" BO_ 284 "AUTOSAR Profile 5";
BA_ "DataID" BO_ 284 8476;
BA_ "VFrameFormat" BO_ 284 14;
BA_ "GenMsgSendType" BO_ 285 1;
BA_ "E2Eprofile" BO_ 285 "AUTOSAR Profile 5";
BA_ "DataID" BO_ 285 8477;
BA_ "VFrameFormat" BO_ 285 14;
BA_ "GenMsgSendType" BO_ 286 1;
BA_ "E2Eprofile" BO_ 286 "AUTOSAR Profile 5";
BA_ "DataID" BO_ 286 8478;
BA_ "VFrameFormat" BO_ 286 14;
BA_ "GenMsgSendType" BO_ 287 1;
BA_ "E2Eprofile" BO_ 287 "AUTOSAR Profile 5";
BA_ "DataID" BO_ 287 8479;
BA_ "VFrameFormat" BO_ 287 14;
BA_ "GenMsgSendType" BO_ 288 1;
BA_ "E2Eprofile" BO_ 288 "AUTOSAR Profile 5";
BA_ "DataID" BO_ 288 8480;
BA_ "VFrameFormat" BO_ 288 14;
BA_ "GenMsgSendType" BO_ 289 1;
BA_ "E2Eprofile" BO_ 289 "AUTOSAR Profile 5";
BA_ "DataID" BO_ 289 8481;
BA_ "VFrameFormat" BO_ 289 14;
BA_ "GenMsgSendType" BO_ 290 1;
BA_ "E2Eprofile" BO_ 290 "AUTOSAR Profile 5";
BA_ "DataID" BO_ 290 8482;
BA_ "VFrameFormat" BO_ 290 14;
BA_ "GenMsgSendType" BO_ 291 1;
BA_ "E2Eprofile" BO_ 291 "AUTOSAR Profile 5";
BA_ "DataID" BO_ 291 8483;
BA_ "VFrameFormat" BO_ 291 14;
BA_ "GenMsgSendType" BO_ 292 1;
BA_ "E2Eprofile" BO_ 292 "AUTOSAR Profile 5";
BA_ "DataID" BO_ 292 8484;
BA_ "VFrameFormat" BO_ 292 14;
BA_ "GenMsgSendType" BO_ 293 1;
BA_ "E2Eprofile" BO_ 293 "AUTOSAR Profile 5";
BA_ "DataID" BO_ 293 8485;
BA_ "VFrameFormat" BO_ 293 14;
BA_ "GenMsgSendType" BO_ 294 1;
BA_ "E2Eprofile" BO_ 294 "AUTOSAR Profile 5";
BA_ "DataID" BO_ 294 8486;
BA_ "VFrameFormat" BO_ 294 14;
BA_ "GenMsgSendType" BO_ 295 1;
BA_ "E2Eprofile" BO_ 295 "AUTOSAR Profile 5";
BA_ "DataID" BO_ 295 8487;
BA_ "VFrameFormat" BO_ 295 14;
BA_ "GenSigStartValue" SG_ 281 RFC_Loc051_RadialVelocity 16384;
BA_ "GenSigStartValue" SG_ 281 RFC_Loc051_Elevation 512;
BA_ "GenSigStartValue" SG_ 281 RFC_Loc051_Azimuth 1024;
BA_ "GenSigStartValue" SG_ 281 RFC_Loc051_DistVelocityCoVnce 1024;
BA_ "GenSigStartValue" SG_ 281 RFC_Loc051_RadarCrossSection 512;
BA_ "GenSigStartValue" SG_ 281 RFC_Loc052_RadialVelocity 16384;
BA_ "GenSigStartValue" SG_ 281 RFC_Loc052_Elevation 512;
BA_ "GenSigStartValue" SG_ 281 RFC_Loc052_Azimuth 1024;
BA_ "GenSigStartValue" SG_ 281 RFC_Loc052_DistVelocityCoVnce 1024;
BA_ "GenSigStartValue" SG_ 281 RFC_Loc052_RadarCrossSection 512;
BA_ "GenSigStartValue" SG_ 281 RFC_Loc053_RadialVelocity 16384;
BA_ "GenSigStartValue" SG_ 281 RFC_Loc053_Elevation 512;
BA_ "GenSigStartValue" SG_ 281 RFC_Loc053_Azimuth 1024;
BA_ "GenSigStartValue" SG_ 281 RFC_Loc053_DistVelocityCoVnce 1024;
BA_ "GenSigStartValue" SG_ 281 RFC_Loc053_RadarCrossSection 512;
BA_ "GenSigStartValue" SG_ 282 RFC_Loc054_RadialVelocity 16384;
BA_ "GenSigStartValue" SG_ 282 RFC_Loc054_Elevation 512;
BA_ "GenSigStartValue" SG_ 282 RFC_Loc054_Azimuth 1024;
BA_ "GenSigStartValue" SG_ 282 RFC_Loc054_DistVelocityCoVnce 1024;
BA_ "GenSigStartValue" SG_ 282 RFC_Loc054_RadarCrossSection 512;
BA_ "GenSigStartValue" SG_ 282 RFC_Loc055_RadialVelocity 16384;
BA_ "GenSigStartValue" SG_ 282 RFC_Loc055_Elevation 512;
BA_ "GenSigStartValue" SG_ 282 RFC_Loc055_Azimuth 1024;
BA_ "GenSigStartValue" SG_ 282 RFC_Loc055_DistVelocityCoVnce 1024;
BA_ "GenSigStartValue" SG_ 282 RFC_Loc055_RadarCrossSection 512;
BA_ "GenSigStartValue" SG_ 282 RFC_Loc056_RadialVelocity 16384;
BA_ "GenSigStartValue" SG_ 282 RFC_Loc056_Elevation 512;
BA_ "GenSigStartValue" SG_ 282 RFC_Loc056_Azimuth 1024;
BA_ "GenSigStartValue" SG_ 282 RFC_Loc056_DistVelocityCoVnce 1024;
BA_ "GenSigStartValue" SG_ 282 RFC_Loc056_RadarCrossSection 512;
BA_ "GenSigStartValue" SG_ 283 RFC_Loc057_RadialVelocity 16384;
BA_ "GenSigStartValue" SG_ 283 RFC_Loc057_Elevation 512;
BA_ "GenSigStartValue" SG_ 283 RFC_Loc057_Azimuth 1024;
BA_ "GenSigStartValue" SG_ 283 RFC_Loc057_DistVelocityCoVnce 1024;
BA_ "GenSigStartValue" SG_ 283 RFC_Loc057_RadarCrossSection 512;
BA_ "GenSigStartValue" SG_ 283 RFC_Loc058_RadialVelocity 16384;
BA_ "GenSigStartValue" SG_ 283 RFC_Loc058_Elevation 512;
BA_ "GenSigStartValue" SG_ 283 RFC_Loc058_Azimuth 1024;
BA_ "GenSigStartValue" SG_ 283 RFC_Loc058_DistVelocityCoVnce 1024;
BA_ "GenSigStartValue" SG_ 283 RFC_Loc058_RadarCrossSection 512;
BA_ "GenSigStartValue" SG_ 283 RFC_Loc059_RadialVelocity 16384;
BA_ "GenSigStartValue" SG_ 283 RFC_Loc059_Elevation 512;
BA_ "GenSigStartValue" SG_ 283 RFC_Loc059_Azimuth 1024;
BA_ "GenSigStartValue" SG_ 283 RFC_Loc059_DistVelocityCoVnce 1024;
BA_ "GenSigStartValue" SG_ 283 RFC_Loc059_RadarCrossSection 512;
BA_ "GenSigStartValue" SG_ 284 RFC_Loc060_RadialVelocity 16384;
BA_ "GenSigStartValue" SG_ 284 RFC_Loc060_Elevation 512;
BA_ "GenSigStartValue" SG_ 284 RFC_Loc060_Azimuth 1024;
BA_ "GenSigStartValue" SG_ 284 RFC_Loc060_DistVelocityCoVnce 1024;
BA_ "GenSigStartValue" SG_ 284 RFC_Loc060_RadarCrossSection 512;
BA_ "GenSigStartValue" SG_ 284 RFC_Loc061_RadialVelocity 16384;
BA_ "GenSigStartValue" SG_ 284 RFC_Loc061_Elevation 512;
BA_ "GenSigStartValue" SG_ 284 RFC_Loc061_Azimuth 1024;
BA_ "GenSigStartValue" SG_ 284 RFC_Loc061_DistVelocityCoVnce 1024;
BA_ "GenSigStartValue" SG_ 284 RFC_Loc061_RadarCrossSection 512;
BA_ "GenSigStartValue" SG_ 284 RFC_Loc062_RadialVelocity 16384;
BA_ "GenSigStartValue" SG_ 284 RFC_Loc062_Elevation 512;
BA_ "GenSigStartValue" SG_ 284 RFC_Loc062_Azimuth 1024;
BA_ "GenSigStartValue" SG_ 284 RFC_Loc062_DistVelocityCoVnce 1024;
BA_ "GenSigStartValue" SG_ 284 RFC_Loc062_RadarCrossSection 512;
BA_ "GenSigStartValue" SG_ 285 RFC_Loc063_RadialVelocity 16384;
BA_ "GenSigStartValue" SG_ 285 RFC_Loc063_Elevation 512;
BA_ "GenSigStartValue" SG_ 285 RFC_Loc063_Azimuth 1024;
BA_ "GenSigStartValue" SG_ 285 RFC_Loc063_DistVelocityCoVnce 1024;
BA_ "GenSigStartValue" SG_ 285 RFC_Loc063_RadarCrossSection 512;
BA_ "GenSigStartValue" SG_ 285 RFC_Loc064_RadialVelocity 16384;
BA_ "GenSigStartValue" SG_ 285 RFC_Loc064_Elevation 512;
BA_ "GenSigStartValue" SG_ 285 RFC_Loc064_Azimuth 1024;
BA_ "GenSigStartValue" SG_ 285 RFC_Loc064_DistVelocityCoVnce 1024;
BA_ "GenSigStartValue" SG_ 285 RFC_Loc064_RadarCrossSection 512;
BA_ "GenSigStartValue" SG_ 285 RFC_Loc065_RadialVelocity 16384;
BA_ "GenSigStartValue" SG_ 285 RFC_Loc065_Elevation 512;
BA_ "GenSigStartValue" SG_ 285 RFC_Loc065_Azimuth 1024;
BA_ "GenSigStartValue" SG_ 285 RFC_Loc065_DistVelocityCoVnce 1024;
BA_ "GenSigStartValue" SG_ 285 RFC_Loc065_RadarCrossSection 512;
BA_ "GenSigStartValue" SG_ 286 RFC_Loc066_RadialVelocity 16384;
BA_ "GenSigStartValue" SG_ 286 RFC_Loc066_Elevation 512;
BA_ "GenSigStartValue" SG_ 286 RFC_Loc066_Azimuth 1024;
BA_ "GenSigStartValue" SG_ 286 RFC_Loc066_DistVelocityCoVnce 1024;
BA_ "GenSigStartValue" SG_ 286 RFC_Loc066_RadarCrossSection 512;
BA_ "GenSigStartValue" SG_ 286 RFC_Loc067_RadialVelocity 16384;
BA_ "GenSigStartValue" SG_ 286 RFC_Loc067_Elevation 512;
BA_ "GenSigStartValue" SG_ 286 RFC_Loc067_Azimuth 1024;
BA_ "GenSigStartValue" SG_ 286 RFC_Loc067_DistVelocityCoVnce 1024;
BA_ "GenSigStartValue" SG_ 286 RFC_Loc067_RadarCrossSection 512;
BA_ "GenSigStartValue" SG_ 286 RFC_Loc068_RadialVelocity 16384;
BA_ "GenSigStartValue" SG_ 286 RFC_Loc068_Elevation 512;
BA_ "GenSigStartValue" SG_ 286 RFC_Loc068_Azimuth 1024;
BA_ "GenSigStartValue" SG_ 286 RFC_Loc068_DistVelocityCoVnce 1024;
BA_ "GenSigStartValue" SG_ 286 RFC_Loc068_RadarCrossSection 512;
BA_ "GenSigStartValue" SG_ 287 RFC_Loc069_RadialVelocity 16384;
BA_ "GenSigStartValue" SG_ 287 RFC_Loc069_Elevation 512;
BA_ "GenSigStartValue" SG_ 287 RFC_Loc069_Azimuth 1024;
BA_ "GenSigStartValue" SG_ 287 RFC_Loc069_DistVelocityCoVnce 1024;
BA_ "GenSigStartValue" SG_ 287 RFC_Loc069_RadarCrossSection 512;
BA_ "GenSigStartValue" SG_ 287 RFC_Loc070_RadialVelocity 16384;
BA_ "GenSigStartValue" SG_ 287 RFC_Loc070_Elevation 512;
BA_ "GenSigStartValue" SG_ 287 RFC_Loc070_Azimuth 1024;
BA_ "GenSigStartValue" SG_ 287 RFC_Loc070_DistVelocityCoVnce 1024;
BA_ "GenSigStartValue" SG_ 287 RFC_Loc070_RadarCrossSection 512;
BA_ "GenSigStartValue" SG_ 287 RFC_Loc071_RadialVelocity 16384;
BA_ "GenSigStartValue" SG_ 287 RFC_Loc071_Elevation 512;
BA_ "GenSigStartValue" SG_ 287 RFC_Loc071_Azimuth 1024;
BA_ "GenSigStartValue" SG_ 287 RFC_Loc071_DistVelocityCoVnce 1024;
BA_ "GenSigStartValue" SG_ 287 RFC_Loc071_RadarCrossSection 512;
BA_ "GenSigStartValue" SG_ 288 RFC_Loc072_RadialVelocity 16384;
BA_ "GenSigStartValue" SG_ 288 RFC_Loc072_Elevation 512;
BA_ "GenSigStartValue" SG_ 288 RFC_Loc072_Azimuth 1024;
BA_ "GenSigStartValue" SG_ 288 RFC_Loc072_DistVelocityCoVnce 1024;
BA_ "GenSigStartValue" SG_ 288 RFC_Loc072_RadarCrossSection 512;
BA_ "GenSigStartValue" SG_ 288 RFC_Loc073_RadialVelocity 16384;
BA_ "GenSigStartValue" SG_ 288 RFC_Loc073_Elevation 512;
BA_ "GenSigStartValue" SG_ 288 RFC_Loc073_Azimuth 1024;
BA_ "GenSigStartValue" SG_ 288 RFC_Loc073_DistVelocityCoVnce 1024;
BA_ "GenSigStartValue" SG_ 288 RFC_Loc073_RadarCrossSection 512;
BA_ "GenSigStartValue" SG_ 288 RFC_Loc074_RadialVelocity 16384;
BA_ "GenSigStartValue" SG_ 288 RFC_Loc074_Elevation 512;
BA_ "GenSigStartValue" SG_ 288 RFC_Loc074_Azimuth 1024;
BA_ "GenSigStartValue" SG_ 288 RFC_Loc074_DistVelocityCoVnce 1024;
BA_ "GenSigStartValue" SG_ 288 RFC_Loc074_RadarCrossSection 512;
BA_ "GenSigStartValue" SG_ 289 RFC_Loc075_RadialVelocity 16384;
BA_ "GenSigStartValue" SG_ 289 RFC_Loc075_Elevation 512;
BA_ "GenSigStartValue" SG_ 289 RFC_Loc075_Azimuth 1024;
BA_ "GenSigStartValue" SG_ 289 RFC_Loc075_DistVelocityCoVnce 1024;
BA_ "GenSigStartValue" SG_ 289 RFC_Loc075_RadarCrossSection 512;
BA_ "GenSigStartValue" SG_ 289 RFC_Loc076_RadialVelocity 16384;
BA_ "GenSigStartValue" SG_ 289 RFC_Loc076_Elevation 512;
BA_ "GenSigStartValue" SG_ 289 RFC_Loc076_Azimuth 1024;
BA_ "GenSigStartValue" SG_ 289 RFC_Loc076_DistVelocityCoVnce 1024;
BA_ "GenSigStartValue" SG_ 289 RFC_Loc076_RadarCrossSection 512;
BA_ "GenSigStartValue" SG_ 289 RFC_Loc077_RadialVelocity 16384;
BA_ "GenSigStartValue" SG_ 289 RFC_Loc077_Elevation 512;
BA_ "GenSigStartValue" SG_ 289 RFC_Loc077_Azimuth 1024;
BA_ "GenSigStartValue" SG_ 289 RFC_Loc077_DistVelocityCoVnce 1024;
BA_ "GenSigStartValue" SG_ 289 RFC_Loc077_RadarCrossSection 512;
BA_ "GenSigStartValue" SG_ 290 RFC_Loc078_RadialVelocity 16384;
BA_ "GenSigStartValue" SG_ 290 RFC_Loc078_Elevation 512;
BA_ "GenSigStartValue" SG_ 290 RFC_Loc078_Azimuth 1024;
BA_ "GenSigStartValue" SG_ 290 RFC_Loc078_DistVelocityCoVnce 1024;
BA_ "GenSigStartValue" SG_ 290 RFC_Loc078_RadarCrossSection 512;
BA_ "GenSigStartValue" SG_ 290 RFC_Loc079_RadialVelocity 16384;
BA_ "GenSigStartValue" SG_ 290 RFC_Loc079_Elevation 512;
BA_ "GenSigStartValue" SG_ 290 RFC_Loc079_Azimuth 1024;
BA_ "GenSigStartValue" SG_ 290 RFC_Loc079_DistVelocityCoVnce 1024;
BA_ "GenSigStartValue" SG_ 290 RFC_Loc079_RadarCrossSection 512;
BA_ "GenSigStartValue" SG_ 290 RFC_Loc080_RadialVelocity 16384;
BA_ "GenSigStartValue" SG_ 290 RFC_Loc080_Elevation 512;
BA_ "GenSigStartValue" SG_ 290 RFC_Loc080_Azimuth 1024;
BA_ "GenSigStartValue" SG_ 290 RFC_Loc080_DistVelocityCoVnce 1024;
BA_ "GenSigStartValue" SG_ 290 RFC_Loc080_RadarCrossSection 512;
BA_ "GenSigStartValue" SG_ 291 RFC_Loc081_RadialVelocity 16384;
BA_ "GenSigStartValue" SG_ 291 RFC_Loc081_Elevation 512;
BA_ "GenSigStartValue" SG_ 291 RFC_Loc081_Azimuth 1024;
BA_ "GenSigStartValue" SG_ 291 RFC_Loc081_DistVelocityCoVnce 1024;
BA_ "GenSigStartValue" SG_ 291 RFC_Loc081_RadarCrossSection 512;
BA_ "GenSigStartValue" SG_ 291 RFC_Loc082_RadialVelocity 16384;
BA_ "GenSigStartValue" SG_ 291 RFC_Loc082_Elevation 512;
BA_ "GenSigStartValue" SG_ 291 RFC_Loc082_Azimuth 1024;
BA_ "GenSigStartValue" SG_ 291 RFC_Loc082_DistVelocityCoVnce 1024;
BA_ "GenSigStartValue" SG_ 291 RFC_Loc082_RadarCrossSection 512;
BA_ "GenSigStartValue" SG_ 291 RFC_Loc083_RadialVelocity 16384;
BA_ "GenSigStartValue" SG_ 291 RFC_Loc083_Elevation 512;
BA_ "GenSigStartValue" SG_ 291 RFC_Loc083_Azimuth 1024;
BA_ "GenSigStartValue" SG_ 291 RFC_Loc083_DistVelocityCoVnce 1024;
BA_ "GenSigStartValue" SG_ 291 RFC_Loc083_RadarCrossSection 512;
BA_ "GenSigStartValue" SG_ 292 RFC_Loc084_RadialVelocity 16384;
BA_ "GenSigStartValue" SG_ 292 RFC_Loc084_Elevation 512;
BA_ "GenSigStartValue" SG_ 292 RFC_Loc084_Azimuth 1024;
BA_ "GenSigStartValue" SG_ 292 RFC_Loc084_DistVelocityCoVnce 1024;
BA_ "GenSigStartValue" SG_ 292 RFC_Loc084_RadarCrossSection 512;
BA_ "GenSigStartValue" SG_ 292 RFC_Loc085_RadialVelocity 16384;
BA_ "GenSigStartValue" SG_ 292 RFC_Loc085_Elevation 512;
BA_ "GenSigStartValue" SG_ 292 RFC_Loc085_Azimuth 1024;
BA_ "GenSigStartValue" SG_ 292 RFC_Loc085_DistVelocityCoVnce 1024;
BA_ "GenSigStartValue" SG_ 292 RFC_Loc085_RadarCrossSection 512;
BA_ "GenSigStartValue" SG_ 292 RFC_Loc086_RadialVelocity 16384;
BA_ "GenSigStartValue" SG_ 292 RFC_Loc086_Elevation 512;
BA_ "GenSigStartValue" SG_ 292 RFC_Loc086_Azimuth 1024;
BA_ "GenSigStartValue" SG_ 292 RFC_Loc086_DistVelocityCoVnce 1024;
BA_ "GenSigStartValue" SG_ 292 RFC_Loc086_RadarCrossSection 512;
BA_ "GenSigStartValue" SG_ 293 RFC_Loc087_RadialVelocity 16384;
BA_ "GenSigStartValue" SG_ 293 RFC_Loc087_Elevation 512;
BA_ "GenSigStartValue" SG_ 293 RFC_Loc087_Azimuth 1024;
BA_ "GenSigStartValue" SG_ 293 RFC_Loc087_DistVelocityCoVnce 1024;
BA_ "GenSigStartValue" SG_ 293 RFC_Loc087_RadarCrossSection 512;
BA_ "GenSigStartValue" SG_ 293 RFC_Loc088_RadialVelocity 16384;
BA_ "GenSigStartValue" SG_ 293 RFC_Loc088_Elevation 512;
BA_ "GenSigStartValue" SG_ 293 RFC_Loc088_Azimuth 1024;
BA_ "GenSigStartValue" SG_ 293 RFC_Loc088_DistVelocityCoVnce 1024;
BA_ "GenSigStartValue" SG_ 293 RFC_Loc088_RadarCrossSection 512;
BA_ "GenSigStartValue" SG_ 293 RFC_Loc089_RadialVelocity 16384;
BA_ "GenSigStartValue" SG_ 293 RFC_Loc089_Elevation 512;
BA_ "GenSigStartValue" SG_ 293 RFC_Loc089_Azimuth 1024;
BA_ "GenSigStartValue" SG_ 293 RFC_Loc089_DistVelocityCoVnce 1024;
BA_ "GenSigStartValue" SG_ 293 RFC_Loc089_RadarCrossSection 512;
BA_ "GenSigStartValue" SG_ 294 RFC_Loc090_RadialVelocity 16384;
BA_ "GenSigStartValue" SG_ 294 RFC_Loc090_Elevation 512;
BA_ "GenSigStartValue" SG_ 294 RFC_Loc090_Azimuth 1024;
BA_ "GenSigStartValue" SG_ 294 RFC_Loc090_DistVelocityCoVnce 1024;
BA_ "GenSigStartValue" SG_ 294 RFC_Loc090_RadarCrossSection 512;
BA_ "GenSigStartValue" SG_ 294 RFC_Loc091_RadialVelocity 16384;
BA_ "GenSigStartValue" SG_ 294 RFC_Loc091_Elevation 512;
BA_ "GenSigStartValue" SG_ 294 RFC_Loc091_Azimuth 1024;
BA_ "GenSigStartValue" SG_ 294 RFC_Loc091_DistVelocityCoVnce 1024;
BA_ "GenSigStartValue" SG_ 294 RFC_Loc091_RadarCrossSection 512;
BA_ "GenSigStartValue" SG_ 294 RFC_Loc092_RadialVelocity 16384;
BA_ "GenSigStartValue" SG_ 294 RFC_Loc092_Elevation 512;
BA_ "GenSigStartValue" SG_ 294 RFC_Loc092_Azimuth 1024;
BA_ "GenSigStartValue" SG_ 294 RFC_Loc092_DistVelocityCoVnce 1024;
BA_ "GenSigStartValue" SG_ 294 RFC_Loc092_RadarCrossSection 512;
BA_ "GenSigStartValue" SG_ 295 RFC_Loc093_RadialVelocity 16384;
BA_ "GenSigStartValue" SG_ 295 RFC_Loc093_Elevation 512;
BA_ "GenSigStartValue" SG_ 295 RFC_Loc093_Azimuth 1024;
BA_ "GenSigStartValue" SG_ 295 RFC_Loc093_DistVelocityCoVnce 1024;
BA_ "GenSigStartValue" SG_ 295 RFC_Loc093_RadarCrossSection 512;
BA_ "GenSigStartValue" SG_ 295 RFC_Loc094_RadialVelocity 16384;
BA_ "GenSigStartValue" SG_ 295 RFC_Loc094_Elevation 512;
BA_ "GenSigStartValue" SG_ 295 RFC_Loc094_Azimuth 1024;
BA_ "GenSigStartValue" SG_ 295 RFC_Loc094_DistVelocityCoVnce 1024;
BA_ "GenSigStartValue" SG_ 295 RFC_Loc094_RadarCrossSection 512;
BA_ "GenSigStartValue" SG_ 295 RFC_Loc095_RadialVelocity 16384;
BA_ "GenSigStartValue" SG_ 295 RFC_Loc095_Elevation 512;
BA_ "GenSigStartValue" SG_ 295 RFC_Loc095_Azimuth 1024;
BA_ "GenSigStartValue" SG_ 295 RFC_Loc095_DistVelocityCoVnce 1024;
BA_ "GenSigStartValue" SG_ 295 RFC_Loc095_RadarCrossSection 512;
SIG_GROUP_ 281 SG_RFC_Location_051_053 1 : RFC_Loc051_053_CRC RFC_Loc051_053_AliveCtr RFC_Loc051_053_ProtBlockCtr RFC_Loc051_RadialDistance RFC_Loc051_RadialVelocity RFC_Loc051_Elevation RFC_Loc051_Azimuth RFC_Loc051_DistVelocityCoVnce RFC_Loc051_RadialDistanceVnce RFC_Loc051_RadialVelocityVnce RFC_Loc051_ElevationVnce RFC_Loc051_AzimuthVnce RFC_Loc051_RadarCrossSection RFC_Loc051_DistVelocityQuality RFC_Loc051_ElevationQuality RFC_Loc051_AzimuthQuality RFC_Loc051_RSSI RFC_Loc051_AzimuthalPartnerId RFC_Loc052_RadialDistance RFC_Loc052_RadialVelocity RFC_Loc052_Elevation RFC_Loc052_Azimuth RFC_Loc052_DistVelocityCoVnce RFC_Loc052_RadialDistanceVnce RFC_Loc052_RadialVelocityVnce RFC_Loc052_ElevationVnce RFC_Loc052_AzimuthVnce RFC_Loc052_RadarCrossSection RFC_Loc052_DistVelocityQuality RFC_Loc052_ElevationQuality RFC_Loc052_AzimuthQuality RFC_Loc052_RSSI RFC_Loc052_AzimuthalPartnerId RFC_Loc053_RadialDistance RFC_Loc053_RadialVelocity RFC_Loc053_Elevation RFC_Loc053_Azimuth RFC_Loc053_DistVelocityCoVnce RFC_Loc053_RadialDistanceVnce RFC_Loc053_RadialVelocityVnce RFC_Loc053_ElevationVnce RFC_Loc053_AzimuthVnce RFC_Loc053_RadarCrossSection RFC_Loc053_DistVelocityQuality RFC_Loc053_ElevationQuality RFC_Loc053_AzimuthQuality RFC_Loc053_RSSI RFC_Loc053_AzimuthalPartnerId;
SIG_GROUP_ 282 SG_RFC_Location_054_056 1 : RFC_Loc054_056_CRC RFC_Loc054_056_AliveCtr RFC_Loc054_056_ProtBlockCtr RFC_Loc054_RadialDistance RFC_Loc054_RadialVelocity RFC_Loc054_Elevation RFC_Loc054_Azimuth RFC_Loc054_DistVelocityCoVnce RFC_Loc054_RadialDistanceVnce RFC_Loc054_RadialVelocityVnce RFC_Loc054_ElevationVnce RFC_Loc054_AzimuthVnce RFC_Loc054_RadarCrossSection RFC_Loc054_DistVelocityQuality RFC_Loc054_ElevationQuality RFC_Loc054_AzimuthQuality RFC_Loc054_RSSI RFC_Loc054_AzimuthalPartnerId RFC_Loc055_RadialDistance RFC_Loc055_RadialVelocity RFC_Loc055_Elevation RFC_Loc055_Azimuth RFC_Loc055_DistVelocityCoVnce RFC_Loc055_RadialDistanceVnce RFC_Loc055_RadialVelocityVnce RFC_Loc055_ElevationVnce RFC_Loc055_AzimuthVnce RFC_Loc055_RadarCrossSection RFC_Loc055_DistVelocityQuality RFC_Loc055_ElevationQuality RFC_Loc055_AzimuthQuality RFC_Loc055_RSSI RFC_Loc055_AzimuthalPartnerId RFC_Loc056_RadialDistance RFC_Loc056_RadialVelocity RFC_Loc056_Elevation RFC_Loc056_Azimuth RFC_Loc056_DistVelocityCoVnce RFC_Loc056_RadialDistanceVnce RFC_Loc056_RadialVelocityVnce RFC_Loc056_ElevationVnce RFC_Loc056_AzimuthVnce RFC_Loc056_RadarCrossSection RFC_Loc056_DistVelocityQuality RFC_Loc056_ElevationQuality RFC_Loc056_AzimuthQuality RFC_Loc056_RSSI RFC_Loc056_AzimuthalPartnerId;
SIG_GROUP_ 283 SG_RFC_Location_057_059 1 : RFC_Loc057_059_CRC RFC_Loc057_059_AliveCtr RFC_Loc057_059_ProtBlockCtr RFC_Loc057_RadialDistance RFC_Loc057_RadialVelocity RFC_Loc057_Elevation RFC_Loc057_Azimuth RFC_Loc057_DistVelocityCoVnce RFC_Loc057_RadialDistanceVnce RFC_Loc057_RadialVelocityVnce RFC_Loc057_ElevationVnce RFC_Loc057_AzimuthVnce RFC_Loc057_RadarCrossSection RFC_Loc057_DistVelocityQuality RFC_Loc057_ElevationQuality RFC_Loc057_AzimuthQuality RFC_Loc057_RSSI RFC_Loc057_AzimuthalPartnerId RFC_Loc058_RadialDistance RFC_Loc058_RadialVelocity RFC_Loc058_Elevation RFC_Loc058_Azimuth RFC_Loc058_DistVelocityCoVnce RFC_Loc058_RadialDistanceVnce RFC_Loc058_RadialVelocityVnce RFC_Loc058_ElevationVnce RFC_Loc058_AzimuthVnce RFC_Loc058_RadarCrossSection RFC_Loc058_DistVelocityQuality RFC_Loc058_ElevationQuality RFC_Loc058_AzimuthQuality RFC_Loc058_RSSI RFC_Loc058_AzimuthalPartnerId RFC_Loc059_RadialDistance RFC_Loc059_RadialVelocity RFC_Loc059_Elevation RFC_Loc059_Azimuth RFC_Loc059_DistVelocityCoVnce RFC_Loc059_RadialDistanceVnce RFC_Loc059_RadialVelocityVnce RFC_Loc059_ElevationVnce RFC_Loc059_AzimuthVnce RFC_Loc059_RadarCrossSection RFC_Loc059_DistVelocityQuality RFC_Loc059_ElevationQuality RFC_Loc059_AzimuthQuality RFC_Loc059_RSSI RFC_Loc059_AzimuthalPartnerId;
SIG_GROUP_ 284 SG_RFC_Location_060_062 1 : RFC_Loc060_062_CRC RFC_Loc060_062_AliveCtr RFC_Loc060_062_ProtBlockCtr RFC_Loc060_RadialDistance RFC_Loc060_RadialVelocity RFC_Loc060_Elevation RFC_Loc060_Azimuth RFC_Loc060_DistVelocityCoVnce RFC_Loc060_RadialDistanceVnce RFC_Loc060_RadialVelocityVnce RFC_Loc060_ElevationVnce RFC_Loc060_AzimuthVnce RFC_Loc060_RadarCrossSection RFC_Loc060_DistVelocityQuality RFC_Loc060_ElevationQuality RFC_Loc060_AzimuthQuality RFC_Loc060_RSSI RFC_Loc060_AzimuthalPartnerId RFC_Loc061_RadialDistance RFC_Loc061_RadialVelocity RFC_Loc061_Elevation RFC_Loc061_Azimuth RFC_Loc061_DistVelocityCoVnce RFC_Loc061_RadialDistanceVnce RFC_Loc061_RadialVelocityVnce RFC_Loc061_ElevationVnce RFC_Loc061_AzimuthVnce RFC_Loc061_RadarCrossSection RFC_Loc061_DistVelocityQuality RFC_Loc061_ElevationQuality RFC_Loc061_AzimuthQuality RFC_Loc061_RSSI RFC_Loc061_AzimuthalPartnerId RFC_Loc062_RadialDistance RFC_Loc062_RadialVelocity RFC_Loc062_Elevation RFC_Loc062_Azimuth RFC_Loc062_DistVelocityCoVnce RFC_Loc062_RadialDistanceVnce RFC_Loc062_RadialVelocityVnce RFC_Loc062_ElevationVnce RFC_Loc062_AzimuthVnce RFC_Loc062_RadarCrossSection RFC_Loc062_DistVelocityQuality RFC_Loc062_ElevationQuality RFC_Loc062_AzimuthQuality RFC_Loc062_RSSI RFC_Loc062_AzimuthalPartnerId;
SIG_GROUP_ 285 SG_RFC_Location_063_065 1 : RFC_Loc063_065_CRC RFC_Loc063_065_AliveCtr RFC_Loc063_065_ProtBlockCtr RFC_Loc063_RadialDistance RFC_Loc063_RadialVelocity RFC_Loc063_Elevation RFC_Loc063_Azimuth RFC_Loc063_DistVelocityCoVnce RFC_Loc063_RadialDistanceVnce RFC_Loc063_RadialVelocityVnce RFC_Loc063_ElevationVnce RFC_Loc063_AzimuthVnce RFC_Loc063_RadarCrossSection RFC_Loc063_DistVelocityQuality RFC_Loc063_ElevationQuality RFC_Loc063_AzimuthQuality RFC_Loc063_RSSI RFC_Loc063_AzimuthalPartnerId RFC_Loc064_RadialDistance RFC_Loc064_RadialVelocity RFC_Loc064_Elevation RFC_Loc064_Azimuth RFC_Loc064_DistVelocityCoVnce RFC_Loc064_RadialDistanceVnce RFC_Loc064_RadialVelocityVnce RFC_Loc064_ElevationVnce RFC_Loc064_AzimuthVnce RFC_Loc064_RadarCrossSection RFC_Loc064_DistVelocityQuality RFC_Loc064_ElevationQuality RFC_Loc064_AzimuthQuality RFC_Loc064_RSSI RFC_Loc064_AzimuthalPartnerId RFC_Loc065_RadialDistance RFC_Loc065_RadialVelocity RFC_Loc065_Elevation RFC_Loc065_Azimuth RFC_Loc065_DistVelocityCoVnce RFC_Loc065_RadialDistanceVnce RFC_Loc065_RadialVelocityVnce RFC_Loc065_ElevationVnce RFC_Loc065_AzimuthVnce RFC_Loc065_RadarCrossSection RFC_Loc065_DistVelocityQuality RFC_Loc065_ElevationQuality RFC_Loc065_AzimuthQuality RFC_Loc065_RSSI RFC_Loc065_AzimuthalPartnerId;
SIG_GROUP_ 286 SG_RFC_Location_066_068 1 : RFC_Loc066_068_CRC RFC_Loc066_068_AliveCtr RFC_Loc066_068_ProtBlockCtr RFC_Loc066_RadialDistance RFC_Loc066_RadialVelocity RFC_Loc066_Elevation RFC_Loc066_Azimuth RFC_Loc066_DistVelocityCoVnce RFC_Loc066_RadialDistanceVnce RFC_Loc066_RadialVelocityVnce RFC_Loc066_ElevationVnce RFC_Loc066_AzimuthVnce RFC_Loc066_RadarCrossSection RFC_Loc066_DistVelocityQuality RFC_Loc066_ElevationQuality RFC_Loc066_AzimuthQuality RFC_Loc066_RSSI RFC_Loc066_AzimuthalPartnerId RFC_Loc067_RadialDistance RFC_Loc067_RadialVelocity RFC_Loc067_Elevation RFC_Loc067_Azimuth RFC_Loc067_DistVelocityCoVnce RFC_Loc067_RadialDistanceVnce RFC_Loc067_RadialVelocityVnce RFC_Loc067_ElevationVnce RFC_Loc067_AzimuthVnce RFC_Loc067_RadarCrossSection RFC_Loc067_DistVelocityQuality RFC_Loc067_ElevationQuality RFC_Loc067_AzimuthQuality RFC_Loc067_RSSI RFC_Loc067_AzimuthalPartnerId RFC_Loc068_RadialDistance RFC_Loc068_RadialVelocity RFC_Loc068_Elevation RFC_Loc068_Azimuth RFC_Loc068_DistVelocityCoVnce RFC_Loc068_RadialDistanceVnce RFC_Loc068_RadialVelocityVnce RFC_Loc068_ElevationVnce RFC_Loc068_AzimuthVnce RFC_Loc068_RadarCrossSection RFC_Loc068_DistVelocityQuality RFC_Loc068_ElevationQuality RFC_Loc068_AzimuthQuality RFC_Loc068_RSSI RFC_Loc068_AzimuthalPartnerId;
SIG_GROUP_ 287 SG_RFC_Location_069_071 1 : RFC_Loc069_071_CRC RFC_Loc069_071_AliveCtr RFC_Loc069_071_ProtBlockCtr RFC_Loc069_RadialDistance RFC_Loc069_RadialVelocity RFC_Loc069_Elevation RFC_Loc069_Azimuth RFC_Loc069_DistVelocityCoVnce RFC_Loc069_RadialDistanceVnce RFC_Loc069_RadialVelocityVnce RFC_Loc069_ElevationVnce RFC_Loc069_AzimuthVnce RFC_Loc069_RadarCrossSection RFC_Loc069_DistVelocityQuality RFC_Loc069_ElevationQuality RFC_Loc069_AzimuthQuality RFC_Loc069_RSSI RFC_Loc069_AzimuthalPartnerId RFC_Loc070_RadialDistance RFC_Loc070_RadialVelocity RFC_Loc070_Elevation RFC_Loc070_Azimuth RFC_Loc070_DistVelocityCoVnce RFC_Loc070_RadialDistanceVnce RFC_Loc070_RadialVelocityVnce RFC_Loc070_ElevationVnce RFC_Loc070_AzimuthVnce RFC_Loc070_RadarCrossSection RFC_Loc070_DistVelocityQuality RFC_Loc070_ElevationQuality RFC_Loc070_AzimuthQuality RFC_Loc070_RSSI RFC_Loc070_AzimuthalPartnerId RFC_Loc071_RadialDistance RFC_Loc071_RadialVelocity RFC_Loc071_Elevation RFC_Loc071_Azimuth RFC_Loc071_DistVelocityCoVnce RFC_Loc071_RadialDistanceVnce RFC_Loc071_RadialVelocityVnce RFC_Loc071_ElevationVnce RFC_Loc071_AzimuthVnce RFC_Loc071_RadarCrossSection RFC_Loc071_DistVelocityQuality RFC_Loc071_ElevationQuality RFC_Loc071_AzimuthQuality RFC_Loc071_RSSI RFC_Loc071_AzimuthalPartnerId;
SIG_GROUP_ 288 SG_RFC_Location_072_074 1 : RFC_Loc072_074_CRC RFC_Loc072_074_AliveCtr RFC_Loc072_074_ProtBlockCtr RFC_Loc072_RadialDistance RFC_Loc072_RadialVelocity RFC_Loc072_Elevation RFC_Loc072_Azimuth RFC_Loc072_DistVelocityCoVnce RFC_Loc072_RadialDistanceVnce RFC_Loc072_RadialVelocityVnce RFC_Loc072_ElevationVnce RFC_Loc072_AzimuthVnce RFC_Loc072_RadarCrossSection RFC_Loc072_DistVelocityQuality RFC_Loc072_ElevationQuality RFC_Loc072_AzimuthQuality RFC_Loc072_RSSI RFC_Loc072_AzimuthalPartnerId RFC_Loc073_RadialDistance RFC_Loc073_RadialVelocity RFC_Loc073_Elevation RFC_Loc073_Azimuth RFC_Loc073_DistVelocityCoVnce RFC_Loc073_RadialDistanceVnce RFC_Loc073_RadialVelocityVnce RFC_Loc073_ElevationVnce RFC_Loc073_AzimuthVnce RFC_Loc073_RadarCrossSection RFC_Loc073_DistVelocityQuality RFC_Loc073_ElevationQuality RFC_Loc073_AzimuthQuality RFC_Loc073_RSSI RFC_Loc073_AzimuthalPartnerId RFC_Loc074_RadialDistance RFC_Loc074_RadialVelocity RFC_Loc074_Elevation RFC_Loc074_Azimuth RFC_Loc074_DistVelocityCoVnce RFC_Loc074_RadialDistanceVnce RFC_Loc074_RadialVelocityVnce RFC_Loc074_ElevationVnce RFC_Loc074_AzimuthVnce RFC_Loc074_RadarCrossSection RFC_Loc074_DistVelocityQuality RFC_Loc074_ElevationQuality RFC_Loc074_AzimuthQuality RFC_Loc074_RSSI RFC_Loc074_AzimuthalPartnerId;
SIG_GROUP_ 289 SG_RFC_Location_075_077 1 : RFC_Loc075_077_CRC RFC_Loc075_077_AliveCtr RFC_Loc075_077_ProtBlockCtr RFC_Loc075_RadialDistance RFC_Loc075_RadialVelocity RFC_Loc075_Elevation RFC_Loc075_Azimuth RFC_Loc075_DistVelocityCoVnce RFC_Loc075_RadialDistanceVnce RFC_Loc075_RadialVelocityVnce RFC_Loc075_ElevationVnce RFC_Loc075_AzimuthVnce RFC_Loc075_RadarCrossSection RFC_Loc075_DistVelocityQuality RFC_Loc075_ElevationQuality RFC_Loc075_AzimuthQuality RFC_Loc075_RSSI RFC_Loc075_AzimuthalPartnerId RFC_Loc076_RadialDistance RFC_Loc076_RadialVelocity RFC_Loc076_Elevation RFC_Loc076_Azimuth RFC_Loc076_DistVelocityCoVnce RFC_Loc076_RadialDistanceVnce RFC_Loc076_RadialVelocityVnce RFC_Loc076_ElevationVnce RFC_Loc076_AzimuthVnce RFC_Loc076_RadarCrossSection RFC_Loc076_DistVelocityQuality RFC_Loc076_ElevationQuality RFC_Loc076_AzimuthQuality RFC_Loc076_RSSI RFC_Loc076_AzimuthalPartnerId RFC_Loc077_RadialDistance RFC_Loc077_RadialVelocity RFC_Loc077_Elevation RFC_Loc077_Azimuth RFC_Loc077_DistVelocityCoVnce RFC_Loc077_RadialDistanceVnce RFC_Loc077_RadialVelocityVnce RFC_Loc077_ElevationVnce RFC_Loc077_AzimuthVnce RFC_Loc077_RadarCrossSection RFC_Loc077_DistVelocityQuality RFC_Loc077_ElevationQuality RFC_Loc077_AzimuthQuality RFC_Loc077_RSSI RFC_Loc077_AzimuthalPartnerId;
SIG_GROUP_ 290 SG_RFC_Location_078_080 1 : RFC_Loc078_080_CRC RFC_Loc078_080_AliveCtr RFC_Loc078_080_ProtBlockCtr RFC_Loc078_RadialDistance RFC_Loc078_RadialVelocity RFC_Loc078_Elevation RFC_Loc078_Azimuth RFC_Loc078_DistVelocityCoVnce RFC_Loc078_RadialDistanceVnce RFC_Loc078_RadialVelocityVnce RFC_Loc078_ElevationVnce RFC_Loc078_AzimuthVnce RFC_Loc078_RadarCrossSection RFC_Loc078_DistVelocityQuality RFC_Loc078_ElevationQuality RFC_Loc078_AzimuthQuality RFC_Loc078_RSSI RFC_Loc078_AzimuthalPartnerId RFC_Loc079_RadialDistance RFC_Loc079_RadialVelocity RFC_Loc079_Elevation RFC_Loc079_Azimuth RFC_Loc079_DistVelocityCoVnce RFC_Loc079_RadialDistanceVnce RFC_Loc079_RadialVelocityVnce RFC_Loc079_ElevationVnce RFC_Loc079_AzimuthVnce RFC_Loc079_RadarCrossSection RFC_Loc079_DistVelocityQuality RFC_Loc079_ElevationQuality RFC_Loc079_AzimuthQuality RFC_Loc079_RSSI RFC_Loc079_AzimuthalPartnerId RFC_Loc080_RadialDistance RFC_Loc080_RadialVelocity RFC_Loc080_Elevation RFC_Loc080_Azimuth RFC_Loc080_DistVelocityCoVnce RFC_Loc080_RadialDistanceVnce RFC_Loc080_RadialVelocityVnce RFC_Loc080_ElevationVnce RFC_Loc080_AzimuthVnce RFC_Loc080_RadarCrossSection RFC_Loc080_DistVelocityQuality RFC_Loc080_ElevationQuality RFC_Loc080_AzimuthQuality RFC_Loc080_RSSI RFC_Loc080_AzimuthalPartnerId;
SIG_GROUP_ 291 SG_RFC_Location_081_083 1 : RFC_Loc081_083_CRC RFC_Loc081_083_AliveCtr RFC_Loc081_083_ProtBlockCtr RFC_Loc081_RadialDistance RFC_Loc081_RadialVelocity RFC_Loc081_Elevation RFC_Loc081_Azimuth RFC_Loc081_DistVelocityCoVnce RFC_Loc081_RadialDistanceVnce RFC_Loc081_RadialVelocityVnce RFC_Loc081_ElevationVnce RFC_Loc081_AzimuthVnce RFC_Loc081_RadarCrossSection RFC_Loc081_DistVelocityQuality RFC_Loc081_ElevationQuality RFC_Loc081_AzimuthQuality RFC_Loc081_RSSI RFC_Loc081_AzimuthalPartnerId RFC_Loc082_RadialDistance RFC_Loc082_RadialVelocity RFC_Loc082_Elevation RFC_Loc082_Azimuth RFC_Loc082_DistVelocityCoVnce RFC_Loc082_RadialDistanceVnce RFC_Loc082_RadialVelocityVnce RFC_Loc082_ElevationVnce RFC_Loc082_AzimuthVnce RFC_Loc082_RadarCrossSection RFC_Loc082_DistVelocityQuality RFC_Loc082_ElevationQuality RFC_Loc082_AzimuthQuality RFC_Loc082_RSSI RFC_Loc082_AzimuthalPartnerId RFC_Loc083_RadialDistance RFC_Loc083_RadialVelocity RFC_Loc083_Elevation RFC_Loc083_Azimuth RFC_Loc083_DistVelocityCoVnce RFC_Loc083_RadialDistanceVnce RFC_Loc083_RadialVelocityVnce RFC_Loc083_ElevationVnce RFC_Loc083_AzimuthVnce RFC_Loc083_RadarCrossSection RFC_Loc083_DistVelocityQuality RFC_Loc083_ElevationQuality RFC_Loc083_AzimuthQuality RFC_Loc083_RSSI RFC_Loc083_AzimuthalPartnerId;
SIG_GROUP_ 292 SG_RFC_Location_084_086 1 : RFC_Loc084_086_CRC RFC_Loc084_086_AliveCtr RFC_Loc084_086_ProtBlockCtr RFC_Loc084_RadialDistance RFC_Loc084_RadialVelocity RFC_Loc084_Elevation RFC_Loc084_Azimuth RFC_Loc084_DistVelocityCoVnce RFC_Loc084_RadialDistanceVnce RFC_Loc084_RadialVelocityVnce RFC_Loc084_ElevationVnce RFC_Loc084_AzimuthVnce RFC_Loc084_RadarCrossSection RFC_Loc084_DistVelocityQuality RFC_Loc084_ElevationQuality RFC_Loc084_AzimuthQuality RFC_Loc084_RSSI RFC_Loc084_AzimuthalPartnerId RFC_Loc085_RadialDistance RFC_Loc085_RadialVelocity RFC_Loc085_Elevation RFC_Loc085_Azimuth RFC_Loc085_DistVelocityCoVnce RFC_Loc085_RadialDistanceVnce RFC_Loc085_RadialVelocityVnce RFC_Loc085_ElevationVnce RFC_Loc085_AzimuthVnce RFC_Loc085_RadarCrossSection RFC_Loc085_DistVelocityQuality RFC_Loc085_ElevationQuality RFC_Loc085_AzimuthQuality RFC_Loc085_RSSI RFC_Loc085_AzimuthalPartnerId RFC_Loc086_RadialDistance RFC_Loc086_RadialVelocity RFC_Loc086_Elevation RFC_Loc086_Azimuth RFC_Loc086_DistVelocityCoVnce RFC_Loc086_RadialDistanceVnce RFC_Loc086_RadialVelocityVnce RFC_Loc086_ElevationVnce RFC_Loc086_AzimuthVnce RFC_Loc086_RadarCrossSection RFC_Loc086_DistVelocityQuality RFC_Loc086_ElevationQuality RFC_Loc086_AzimuthQuality RFC_Loc086_RSSI RFC_Loc086_AzimuthalPartnerId;
SIG_GROUP_ 293 SG_RFC_Location_087_089 1 : RFC_Loc087_089_CRC RFC_Loc087_089_AliveCtr RFC_Loc087_089_ProtBlockCtr RFC_Loc087_RadialDistance RFC_Loc087_RadialVelocity RFC_Loc087_Elevation RFC_Loc087_Azimuth RFC_Loc087_DistVelocityCoVnce RFC_Loc087_RadialDistanceVnce RFC_Loc087_RadialVelocityVnce RFC_Loc087_ElevationVnce RFC_Loc087_AzimuthVnce RFC_Loc087_RadarCrossSection RFC_Loc087_DistVelocityQuality RFC_Loc087_ElevationQuality RFC_Loc087_AzimuthQuality RFC_Loc087_RSSI RFC_Loc087_AzimuthalPartnerId RFC_Loc088_RadialDistance RFC_Loc088_RadialVelocity RFC_Loc088_Elevation RFC_Loc088_Azimuth RFC_Loc088_DistVelocityCoVnce RFC_Loc088_RadialDistanceVnce RFC_Loc088_RadialVelocityVnce RFC_Loc088_ElevationVnce RFC_Loc088_AzimuthVnce RFC_Loc088_RadarCrossSection RFC_Loc088_DistVelocityQuality RFC_Loc088_ElevationQuality RFC_Loc088_AzimuthQuality RFC_Loc088_RSSI RFC_Loc088_AzimuthalPartnerId RFC_Loc089_RadialDistance RFC_Loc089_RadialVelocity RFC_Loc089_Elevation RFC_Loc089_Azimuth RFC_Loc089_DistVelocityCoVnce RFC_Loc089_RadialDistanceVnce RFC_Loc089_RadialVelocityVnce RFC_Loc089_ElevationVnce RFC_Loc089_AzimuthVnce RFC_Loc089_RadarCrossSection RFC_Loc089_DistVelocityQuality RFC_Loc089_ElevationQuality RFC_Loc089_AzimuthQuality RFC_Loc089_RSSI RFC_Loc089_AzimuthalPartnerId;
SIG_GROUP_ 294 SG_RFC_Location_090_092 1 : RFC_Loc090_092_CRC RFC_Loc090_092_AliveCtr RFC_Loc090_092_ProtBlockCtr RFC_Loc090_RadialDistance RFC_Loc090_RadialVelocity RFC_Loc090_Elevation RFC_Loc090_Azimuth RFC_Loc090_DistVelocityCoVnce RFC_Loc090_RadialDistanceVnce RFC_Loc090_RadialVelocityVnce RFC_Loc090_ElevationVnce RFC_Loc090_AzimuthVnce RFC_Loc090_RadarCrossSection RFC_Loc090_DistVelocityQuality RFC_Loc090_ElevationQuality RFC_Loc090_AzimuthQuality RFC_Loc090_RSSI RFC_Loc090_AzimuthalPartnerId RFC_Loc091_RadialDistance RFC_Loc091_RadialVelocity RFC_Loc091_Elevation RFC_Loc091_Azimuth RFC_Loc091_DistVelocityCoVnce RFC_Loc091_RadialDistanceVnce RFC_Loc091_RadialVelocityVnce RFC_Loc091_ElevationVnce RFC_Loc091_AzimuthVnce RFC_Loc091_RadarCrossSection RFC_Loc091_DistVelocityQuality RFC_Loc091_ElevationQuality RFC_Loc091_AzimuthQuality RFC_Loc091_RSSI RFC_Loc091_AzimuthalPartnerId RFC_Loc092_RadialDistance RFC_Loc092_RadialVelocity RFC_Loc092_Elevation RFC_Loc092_Azimuth RFC_Loc092_DistVelocityCoVnce RFC_Loc092_RadialDistanceVnce RFC_Loc092_RadialVelocityVnce RFC_Loc092_ElevationVnce RFC_Loc092_AzimuthVnce RFC_Loc092_RadarCrossSection RFC_Loc092_DistVelocityQuality RFC_Loc092_ElevationQuality RFC_Loc092_AzimuthQuality RFC_Loc092_RSSI RFC_Loc092_AzimuthalPartnerId;
SIG_GROUP_ 295 SG_RFC_Location_093_095 1 : RFC_Loc093_095_CRC RFC_Loc093_095_AliveCtr RFC_Loc093_095_ProtBlockCtr RFC_Loc093_RadialDistance RFC_Loc093_RadialVelocity RFC_Loc093_Elevation RFC_Loc093_Azimuth RFC_Loc093_DistVelocityCoVnce RFC_Loc093_RadialDistanceVnce RFC_Loc093_RadialVelocityVnce RFC_Loc093_ElevationVnce RFC_Loc093_AzimuthVnce RFC_Loc093_RadarCrossSection RFC_Loc093_DistVelocityQuality RFC_Loc093_ElevationQuality RFC_Loc093_AzimuthQuality RFC_Loc093_RSSI RFC_Loc093_AzimuthalPartnerId RFC_Loc094_RadialDistance RFC_Loc094_RadialVelocity RFC_Loc094_Elevation RFC_Loc094_Azimuth RFC_Loc094_DistVelocityCoVnce RFC_Loc094_RadialDistanceVnce RFC_Loc094_RadialVelocityVnce RFC_Loc094_ElevationVnce RFC_Loc094_AzimuthVnce RFC_Loc094_RadarCrossSection RFC_Loc094_DistVelocityQuality RFC_Loc094_ElevationQuality RFC_Loc094_AzimuthQuality RFC_Loc094_RSSI RFC_Loc094_AzimuthalPartnerId RFC_Loc095_RadialDistance RFC_Loc095_RadialVelocity RFC_Loc095_Elevation RFC_Loc095_Azimuth RFC_Loc095_DistVelocityCoVnce RFC_Loc095_RadialDistanceVnce RFC_Loc095_RadialVelocityVnce RFC_Loc095_ElevationVnce RFC_Loc095_AzimuthVnce RFC_Loc095_RadarCrossSection RFC_Loc095_DistVelocityQuality RFC_Loc095_ElevationQuality RFC_Loc095_AzimuthQuality RFC_Loc095_RSSI RFC_Loc095_AzimuthalPartnerId;
