VERSION "created by canmatrix"

NS_ :

BS_:

BU_: RadarFrontCenter VideoFrontCenter DASy ReceiveECU

BO_ 75 VFC_Object21: 64 VideoFrontCenter
 SG_ VFC_Obj21_CRC : 0|16@1+ (1,0) [0|65535] ""  DASy
 SG_ VFC_Obj21_AliveCtr : 16|8@1+ (1,0) [0|255] ""  DASy
 SG_ VFC_Obj21_ProtBlockCtr : 24|4@1+ (1,0) [0|15] ""  DASy
 SG_ VFC_Obj21_ExistProb : 32|6@1+ (2,0) [0|100] "%"  DASy
 SG_ VFC_Obj21_MeasurementStatus : 38|2@1+ (1,0) [0|3] ""  DASy
 SG_ VFC_Obj21_ObjId : 40|6@1+ (1,0) [1|63] ""  DASy
 SG_ VFC_Obj21_Type : 46|4@1+ (1,0) [0|15] ""  DASy
 SG_ VFC_Obj21_TypeConf : 50|6@1+ (2,0) [0|100] "%"  DASy
 SG_ VFC_Obj21_VisibleView : 56|3@1+ (1,0) [0|7] ""  DASy
 SG_ VFC_Obj21_ClassifiedView : 59|3@1+ (1,0) [0|7] ""  DASy
 SG_ VFC_Obj21_Px : 62|12@1+ (0.05,0) [0|204.75] "m"  DASy
 SG_ VFC_Obj21_Py : 74|14@1+ (0.01,-81.92) [-81.92|81.91] "m"  DASy
 SG_ VFC_Obj21_PxStdDev : 88|10@1+ (0.05,0) [0|51.15] "m"  DASy
 SG_ VFC_Obj21_PyStdDev : 98|10@1+ (0.02,0) [0|20.46] "m"  DASy
 SG_ VFC_Obj21_OrientationYaw : 108|9@1+ (0.01,-2.56) [-1.57|1.57] "rad"  DASy
 SG_ VFC_Obj21_OrientationYawStdDev : 117|6@1+ (0.01,0) [0|0.63] "rad"  DASy
 SG_ VFC_Obj21_Length : 123|9@1+ (0.05,0) [0|25.55] "m"  DASy
 SG_ VFC_Obj21_Width : 132|10@1+ (0.01,0) [0|10.23] "m"  DASy
 SG_ VFC_Obj21_Height : 142|9@1+ (0.01,0) [0|5.11] "m"  DASy
 SG_ VFC_Obj21_LengthStdDev : 151|7@1+ (0.05,0) [0|6.35] "m"  DASy
 SG_ VFC_Obj21_WidthStdDev : 158|7@1+ (0.01,0) [0|1.27] "m"  DASy
 SG_ VFC_Obj21_HeightStdDev : 165|7@1+ (0.01,0) [0|1.27] "m"  DASy
 SG_ VFC_Obj21_Vx : 172|11@1+ (0.1,-154) [-154|50.7] "m/s"  DASy
 SG_ VFC_Obj21_Vy : 183|10@1+ (0.1,-51.2) [-51.2|51.1] "m/s"  DASy
 SG_ VFC_Obj21_VxStdDev : 193|10@1+ (0.1,0) [0|102.3] "m/s"  DASy
 SG_ VFC_Obj21_VyStdDev : 203|9@1+ (0.1,0) [0|51.1] "m/s"  DASy
 SG_ VFC_Obj21_Ax : 212|9@1+ (0.1,-25.6) [-25.6|25.5] "m/s^2"  DASy
 SG_ VFC_Obj21_LightStatTurnIndicator : 221|3@1+ (1,0) [0|7] ""  DASy
 SG_ VFC_Obj21_Ay : 224|8@1+ (0.1,-12.8) [-12.8|12.7] "m/s^2"  DASy
 SG_ VFC_Obj21_AxStdDev : 232|8@1+ (0.1,0) [0|25.5] "m/s^2"  DASy
 SG_ VFC_Obj21_AyStdDev : 240|8@1+ (0.1,0) [0|25.5] "m/s^2"  DASy
 SG_ VFC_Obj21_MovementProbLat : 248|6@1+ (2,0) [0|100] "%"  DASy
 SG_ VFC_Obj21_MovementProbLong : 254|6@1+ (2,0) [0|100] "%"  DASy
 SG_ VFC_Obj21_2DAngPosEdgeLeft : 260|13@1+ (0.00025,-1.024) [-1.024|1.02375] "unitless"  DASy
 SG_ VFC_Obj21_2DAngPosEdgeRight : 273|13@1+ (0.00025,-1.024) [-1.024|1.02375] "unitless"  DASy
 SG_ VFC_Obj21_2DAngPosEdgeFar : 286|13@1+ (0.00025,-1.024) [-1.024|1.02375] "unitless"  DASy
 SG_ VFC_Obj21_2DAngPosEdgeBot : 299|12@1+ (0.00025,-0.512) [-0.512|0.51175] "unitless"  DASy
 SG_ VFC_Obj21_OutsideRoad : 311|1@1+ (1,0) [0|1] "unitless"  DASy
 SG_ VFC_Obj21_2DAngPosEdgeLeftStdDev : 312|8@1+ (0.0002,0) [0|0.051] "unitless"  DASy
 SG_ VFC_Obj21_2DAngPosEdgeRightStdDe : 320|8@1+ (0.0002,0) [0|0.051] "unitless"  DASy
 SG_ VFC_Obj21_2DAngPosEdgeFarStdDev : 328|8@1+ (0.0002,0) [0|0.051] "unitless"  DASy
 SG_ VFC_Obj21_2DAngPosEdgeBotStdDev : 336|8@1+ (0.0002,0) [0|0.051] "unitless"  DASy
 SG_ VFC_Obj21_2DNormVx : 344|16@1+ (0.001,-40) [-40|25.535] "1/s"  DASy
 SG_ VFC_Obj21_2DNormVy : 360|13@1+ (0.001,-4.096) [-4.096|4.095] "1/s"  DASy
 SG_ VFC_Obj21_2DNormAx : 373|13@1+ (0.002,-10) [-10|6.382] "1/s^2"  DASy
 SG_ VFC_Obj21_2DNormVxStdDev : 386|10@1+ (0.001,0) [0|1.023] "1/s"  DASy
 SG_ VFC_Obj21_MeasurementSource : 396|4@1+ (1,0) [0|15] ""  DASy
 SG_ VFC_Obj21_2DNormVyStdDev : 400|8@1+ (0.001,0) [0|0.255] "1/s"  DASy
 SG_ VFC_Obj21_2DNormAxStdDev : 408|10@1+ (0.0025,0) [0|2.5575] "1/s^2"  DASy
 SG_ VFC_Obj21_2DScaleChange : 418|14@1+ (0.0001,0.5) [0.5|2.1383] "unitless"  DASy
 SG_ VFC_Obj21_2DScaleChangeStdDev : 432|10@1+ (0.0001,0) [0|0.1023] "unitless"  DASy
 SG_ VFC_Obj21_Reliability : 442|6@1+ (1,0) [0|63] ""  DASy
 SG_ VFC_Obj21_LightStatBrakeLight : 448|3@1+ (1,0) [0|7] ""  DASy
 SG_ VFC_Obj21_OutsideRoadMeasStatus : 451|2@1+ (1,0) [0|3] ""  DASy
 SG_ VFC_Obj21_Oncoming : 453|1@1+ (1,0) [0|1] "unitless"  DASy
 SG_ VFC_Obj21_OncomingMeasStatus : 454|2@1+ (1,0) [0|3] ""  DASy
 SG_ VFC_Obj21_MovementStanding : 456|1@1+ (1,0) [0|1] "unitless"  DASy
 SG_ VFC_Obj21_MovementStandingMeasSt : 457|2@1+ (1,0) [0|3] ""  DASy
 SG_ VFC_Obj21_MovementObserved : 459|1@1+ (1,0) [0|1] "unitless"  DASy
 SG_ VFC_Obj21_MovementObservedMeasSt : 460|1@1+ (1,0) [0|1] ""  DASy
 SG_ VFC_Obj21_TargetObjTypeAcc : 461|3@1+ (1,0) [0|7] ""  DASy
 SG_ VFC_Obj21_TargetObjTypeAccConf : 464|6@1+ (2,0) [0|100] "%"  DASy

BO_ 76 VFC_Object22: 64 VideoFrontCenter
 SG_ VFC_Obj22_CRC : 0|16@1+ (1,0) [0|65535] ""  DASy
 SG_ VFC_Obj22_AliveCtr : 16|8@1+ (1,0) [0|255] ""  DASy
 SG_ VFC_Obj22_ProtBlockCtr : 24|4@1+ (1,0) [0|15] ""  DASy
 SG_ VFC_Obj22_ExistProb : 32|6@1+ (2,0) [0|100] "%"  DASy
 SG_ VFC_Obj22_MeasurementStatus : 38|2@1+ (1,0) [0|3] ""  DASy
 SG_ VFC_Obj22_ObjId : 40|6@1+ (1,0) [1|63] ""  DASy
 SG_ VFC_Obj22_Type : 46|4@1+ (1,0) [0|15] ""  DASy
 SG_ VFC_Obj22_TypeConf : 50|6@1+ (2,0) [0|100] "%"  DASy
 SG_ VFC_Obj22_VisibleView : 56|3@1+ (1,0) [0|7] ""  DASy
 SG_ VFC_Obj22_ClassifiedView : 59|3@1+ (1,0) [0|7] ""  DASy
 SG_ VFC_Obj22_Px : 62|12@1+ (0.05,0) [0|204.75] "m"  DASy
 SG_ VFC_Obj22_Py : 74|14@1+ (0.01,-81.92) [-81.92|81.91] "m"  DASy
 SG_ VFC_Obj22_PxStdDev : 88|10@1+ (0.05,0) [0|51.15] "m"  DASy
 SG_ VFC_Obj22_PyStdDev : 98|10@1+ (0.02,0) [0|20.46] "m"  DASy
 SG_ VFC_Obj22_OrientationYaw : 108|9@1+ (0.01,-2.56) [-1.57|1.57] "rad"  DASy
 SG_ VFC_Obj22_OrientationYawStdDev : 117|6@1+ (0.01,0) [0|0.63] "rad"  DASy
 SG_ VFC_Obj22_Length : 123|9@1+ (0.05,0) [0|25.55] "m"  DASy
 SG_ VFC_Obj22_Width : 132|10@1+ (0.01,0) [0|10.23] "m"  DASy
 SG_ VFC_Obj22_Height : 142|9@1+ (0.01,0) [0|5.11] "m"  DASy
 SG_ VFC_Obj22_LengthStdDev : 151|7@1+ (0.05,0) [0|6.35] "m"  DASy
 SG_ VFC_Obj22_WidthStdDev : 158|7@1+ (0.01,0) [0|1.27] "m"  DASy
 SG_ VFC_Obj22_HeightStdDev : 165|7@1+ (0.01,0) [0|1.27] "m"  DASy
 SG_ VFC_Obj22_Vx : 172|11@1+ (0.1,-154) [-154|50.7] "m/s"  DASy
 SG_ VFC_Obj22_Vy : 183|10@1+ (0.1,-51.2) [-51.2|51.1] "m/s"  DASy
 SG_ VFC_Obj22_VxStdDev : 193|10@1+ (0.1,0) [0|102.3] "m/s"  DASy
 SG_ VFC_Obj22_VyStdDev : 203|9@1+ (0.1,0) [0|51.1] "m/s"  DASy
 SG_ VFC_Obj22_Ax : 212|9@1+ (0.1,-25.6) [-25.6|25.5] "m/s^2"  DASy
 SG_ VFC_Obj22_LightStatTurnIndicator : 221|3@1+ (1,0) [0|7] ""  DASy
 SG_ VFC_Obj22_Ay : 224|8@1+ (0.1,-12.8) [-12.8|12.7] "m/s^2"  DASy
 SG_ VFC_Obj22_AxStdDev : 232|8@1+ (0.1,0) [0|25.5] "m/s^2"  DASy
 SG_ VFC_Obj22_AyStdDev : 240|8@1+ (0.1,0) [0|25.5] "m/s^2"  DASy
 SG_ VFC_Obj22_MovementProbLat : 248|6@1+ (2,0) [0|100] "%"  DASy
 SG_ VFC_Obj22_MovementProbLong : 254|6@1+ (2,0) [0|100] "%"  DASy
 SG_ VFC_Obj22_2DAngPosEdgeLeft : 260|13@1+ (0.00025,-1.024) [-1.024|1.02375] "unitless"  DASy
 SG_ VFC_Obj22_2DAngPosEdgeRight : 273|13@1+ (0.00025,-1.024) [-1.024|1.02375] "unitless"  DASy
 SG_ VFC_Obj22_2DAngPosEdgeFar : 286|13@1+ (0.00025,-1.024) [-1.024|1.02375] "unitless"  DASy
 SG_ VFC_Obj22_2DAngPosEdgeBot : 299|12@1+ (0.00025,-0.512) [-0.512|0.51175] "unitless"  DASy
 SG_ VFC_Obj22_OutsideRoad : 311|1@1+ (1,0) [0|1] "unitless"  DASy
 SG_ VFC_Obj22_2DAngPosEdgeLeftStdDev : 312|8@1+ (0.0002,0) [0|0.051] "unitless"  DASy
 SG_ VFC_Obj22_2DAngPosEdgeRightStdDe : 320|8@1+ (0.0002,0) [0|0.051] "unitless"  DASy
 SG_ VFC_Obj22_2DAngPosEdgeFarStdDev : 328|8@1+ (0.0002,0) [0|0.051] "unitless"  DASy
 SG_ VFC_Obj22_2DAngPosEdgeBotStdDev : 336|8@1+ (0.0002,0) [0|0.051] "unitless"  DASy
 SG_ VFC_Obj22_2DNormVx : 344|16@1+ (0.001,-40) [-40|25.535] "1/s"  DASy
 SG_ VFC_Obj22_2DNormVy : 360|13@1+ (0.001,-4.096) [-4.096|4.095] "1/s"  DASy
 SG_ VFC_Obj22_2DNormAx : 373|13@1+ (0.002,-10) [-10|6.382] "1/s^2"  DASy
 SG_ VFC_Obj22_2DNormVxStdDev : 386|10@1+ (0.001,0) [0|1.023] "1/s"  DASy
 SG_ VFC_Obj22_MeasurementSource : 396|4@1+ (1,0) [0|15] ""  DASy
 SG_ VFC_Obj22_2DNormVyStdDev : 400|8@1+ (0.001,0) [0|0.255] "1/s"  DASy
 SG_ VFC_Obj22_2DNormAxStdDev : 408|10@1+ (0.0025,0) [0|2.5575] "1/s^2"  DASy
 SG_ VFC_Obj22_2DScaleChange : 418|14@1+ (0.0001,0.5) [0.5|2.1383] "unitless"  DASy
 SG_ VFC_Obj22_2DScaleChangeStdDev : 432|10@1+ (0.0001,0) [0|0.1023] "unitless"  DASy
 SG_ VFC_Obj22_Reliability : 442|6@1+ (1,0) [0|63] ""  DASy
 SG_ VFC_Obj22_LightStatBrakeLight : 448|3@1+ (1,0) [0|7] ""  DASy
 SG_ VFC_Obj22_OutsideRoadMeasStatus : 451|2@1+ (1,0) [0|3] ""  DASy
 SG_ VFC_Obj22_Oncoming : 453|1@1+ (1,0) [0|1] "unitless"  DASy
 SG_ VFC_Obj22_OncomingMeasStatus : 454|2@1+ (1,0) [0|3] ""  DASy
 SG_ VFC_Obj22_MovementStanding : 456|1@1+ (1,0) [0|1] "unitless"  DASy
 SG_ VFC_Obj22_MovementStandingMeasSt : 457|2@1+ (1,0) [0|3] ""  DASy
 SG_ VFC_Obj22_MovementObserved : 459|1@1+ (1,0) [0|1] "unitless"  DASy
 SG_ VFC_Obj22_MovementObservedMeasSt : 460|1@1+ (1,0) [0|1] ""  DASy
 SG_ VFC_Obj22_TargetObjTypeAcc : 461|3@1+ (1,0) [0|7] ""  DASy
 SG_ VFC_Obj22_TargetObjTypeAccConf : 464|6@1+ (2,0) [0|100] "%"  DASy

BO_ 77 VFC_Object23: 64 VideoFrontCenter
 SG_ VFC_Obj23_CRC : 0|16@1+ (1,0) [0|65535] ""  DASy
 SG_ VFC_Obj23_AliveCtr : 16|8@1+ (1,0) [0|255] ""  DASy
 SG_ VFC_Obj23_ProtBlockCtr : 24|4@1+ (1,0) [0|15] ""  DASy
 SG_ VFC_Obj23_ExistProb : 32|6@1+ (2,0) [0|100] "%"  DASy
 SG_ VFC_Obj23_MeasurementStatus : 38|2@1+ (1,0) [0|3] ""  DASy
 SG_ VFC_Obj23_ObjId : 40|6@1+ (1,0) [1|63] ""  DASy
 SG_ VFC_Obj23_Type : 46|4@1+ (1,0) [0|15] ""  DASy
 SG_ VFC_Obj23_TypeConf : 50|6@1+ (2,0) [0|100] "%"  DASy
 SG_ VFC_Obj23_VisibleView : 56|3@1+ (1,0) [0|7] ""  DASy
 SG_ VFC_Obj23_ClassifiedView : 59|3@1+ (1,0) [0|7] ""  DASy
 SG_ VFC_Obj23_Px : 62|12@1+ (0.05,0) [0|204.75] "m"  DASy
 SG_ VFC_Obj23_Py : 74|14@1+ (0.01,-81.92) [-81.92|81.91] "m"  DASy
 SG_ VFC_Obj23_PxStdDev : 88|10@1+ (0.05,0) [0|51.15] "m"  DASy
 SG_ VFC_Obj23_PyStdDev : 98|10@1+ (0.02,0) [0|20.46] "m"  DASy
 SG_ VFC_Obj23_OrientationYaw : 108|9@1+ (0.01,-2.56) [-1.57|1.57] "rad"  DASy
 SG_ VFC_Obj23_OrientationYawStdDev : 117|6@1+ (0.01,0) [0|0.63] "rad"  DASy
 SG_ VFC_Obj23_Length : 123|9@1+ (0.05,0) [0|25.55] "m"  DASy
 SG_ VFC_Obj23_Width : 132|10@1+ (0.01,0) [0|10.23] "m"  DASy
 SG_ VFC_Obj23_Height : 142|9@1+ (0.01,0) [0|5.11] "m"  DASy
 SG_ VFC_Obj23_LengthStdDev : 151|7@1+ (0.05,0) [0|6.35] "m"  DASy
 SG_ VFC_Obj23_WidthStdDev : 158|7@1+ (0.01,0) [0|1.27] "m"  DASy
 SG_ VFC_Obj23_HeightStdDev : 165|7@1+ (0.01,0) [0|1.27] "m"  DASy
 SG_ VFC_Obj23_Vx : 172|11@1+ (0.1,-154) [-154|50.7] "m/s"  DASy
 SG_ VFC_Obj23_Vy : 183|10@1+ (0.1,-51.2) [-51.2|51.1] "m/s"  DASy
 SG_ VFC_Obj23_VxStdDev : 193|10@1+ (0.1,0) [0|102.3] "m/s"  DASy
 SG_ VFC_Obj23_VyStdDev : 203|9@1+ (0.1,0) [0|51.1] "m/s"  DASy
 SG_ VFC_Obj23_Ax : 212|9@1+ (0.1,-25.6) [-25.6|25.5] "m/s^2"  DASy
 SG_ VFC_Obj23_LightStatTurnIndicator : 221|3@1+ (1,0) [0|7] ""  DASy
 SG_ VFC_Obj23_Ay : 224|8@1+ (0.1,-12.8) [-12.8|12.7] "m/s^2"  DASy
 SG_ VFC_Obj23_AxStdDev : 232|8@1+ (0.1,0) [0|25.5] "m/s^2"  DASy
 SG_ VFC_Obj23_AyStdDev : 240|8@1+ (0.1,0) [0|25.5] "m/s^2"  DASy
 SG_ VFC_Obj23_MovementProbLat : 248|6@1+ (2,0) [0|100] "%"  DASy
 SG_ VFC_Obj23_MovementProbLong : 254|6@1+ (2,0) [0|100] "%"  DASy
 SG_ VFC_Obj23_2DAngPosEdgeLeft : 260|13@1+ (0.00025,-1.024) [-1.024|1.02375] "unitless"  DASy
 SG_ VFC_Obj23_2DAngPosEdgeRight : 273|13@1+ (0.00025,-1.024) [-1.024|1.02375] "unitless"  DASy
 SG_ VFC_Obj23_2DAngPosEdgeFar : 286|13@1+ (0.00025,-1.024) [-1.024|1.02375] "unitless"  DASy
 SG_ VFC_Obj23_2DAngPosEdgeBot : 299|12@1+ (0.00025,-0.512) [-0.512|0.51175] "unitless"  DASy
 SG_ VFC_Obj23_OutsideRoad : 311|1@1+ (1,0) [0|1] "unitless"  DASy
 SG_ VFC_Obj23_2DAngPosEdgeLeftStdDev : 312|8@1+ (0.0002,0) [0|0.051] "unitless"  DASy
 SG_ VFC_Obj23_2DAngPosEdgeRightStdDe : 320|8@1+ (0.0002,0) [0|0.051] "unitless"  DASy
 SG_ VFC_Obj23_2DAngPosEdgeFarStdDev : 328|8@1+ (0.0002,0) [0|0.051] "unitless"  DASy
 SG_ VFC_Obj23_2DAngPosEdgeBotStdDev : 336|8@1+ (0.0002,0) [0|0.051] "unitless"  DASy
 SG_ VFC_Obj23_2DNormVx : 344|16@1+ (0.001,-40) [-40|25.535] "1/s"  DASy
 SG_ VFC_Obj23_2DNormVy : 360|13@1+ (0.001,-4.096) [-4.096|4.095] "1/s"  DASy
 SG_ VFC_Obj23_2DNormAx : 373|13@1+ (0.002,-10) [-10|6.382] "1/s^2"  DASy
 SG_ VFC_Obj23_2DNormVxStdDev : 386|10@1+ (0.001,0) [0|1.023] "1/s"  DASy
 SG_ VFC_Obj23_MeasurementSource : 396|4@1+ (1,0) [0|15] ""  DASy
 SG_ VFC_Obj23_2DNormVyStdDev : 400|8@1+ (0.001,0) [0|0.255] "1/s"  DASy
 SG_ VFC_Obj23_2DNormAxStdDev : 408|10@1+ (0.0025,0) [0|2.5575] "1/s^2"  DASy
 SG_ VFC_Obj23_2DScaleChange : 418|14@1+ (0.0001,0.5) [0.5|2.1383] "unitless"  DASy
 SG_ VFC_Obj23_2DScaleChangeStdDev : 432|10@1+ (0.0001,0) [0|0.1023] "unitless"  DASy
 SG_ VFC_Obj23_Reliability : 442|6@1+ (1,0) [0|63] ""  DASy
 SG_ VFC_Obj23_LightStatBrakeLight : 448|3@1+ (1,0) [0|7] ""  DASy
 SG_ VFC_Obj23_OutsideRoadMeasStatus : 451|2@1+ (1,0) [0|3] ""  DASy
 SG_ VFC_Obj23_Oncoming : 453|1@1+ (1,0) [0|1] "unitless"  DASy
 SG_ VFC_Obj23_OncomingMeasStatus : 454|2@1+ (1,0) [0|3] ""  DASy
 SG_ VFC_Obj23_MovementStanding : 456|1@1+ (1,0) [0|1] "unitless"  DASy
 SG_ VFC_Obj23_MovementStandingMeasSt : 457|2@1+ (1,0) [0|3] ""  DASy
 SG_ VFC_Obj23_MovementObserved : 459|1@1+ (1,0) [0|1] "unitless"  DASy
 SG_ VFC_Obj23_MovementObservedMeasSt : 460|1@1+ (1,0) [0|1] ""  DASy
 SG_ VFC_Obj23_TargetObjTypeAcc : 461|3@1+ (1,0) [0|7] ""  DASy
 SG_ VFC_Obj23_TargetObjTypeAccConf : 464|6@1+ (2,0) [0|100] "%"  DASy

BO_ 86 VFC_OcaHdr: 24 VideoFrontCenter
 SG_ VFC_OcaHdr_CRC : 0|16@1+ (1,0) [0|65535] ""  DASy
 SG_ VFC_OcaHdr_AliveCtr : 16|8@1+ (1,0) [0|255] ""  DASy
 SG_ VFC_OcaHdr_ProtBlockCtr : 24|4@1+ (1,0) [0|15] ""  DASy
 SG_ VFC_OcaHdr_IfVersionIdMajor : 32|8@1+ (1,0) [0|255] ""  DASy
 SG_ VFC_OcaHdr_IfVersionIdMinor : 40|8@1+ (1,0) [0|255] ""  DASy
 SG_ VFC_OcaHdr_NumValidOCAs : 48|7@1+ (1,0) [0|72] ""  DASy
 SG_ VFC_OcaHdr_TimeStampStatus : 56|8@1+ (1,0) [0|255] ""  DASy
 SG_ VFC_OcaHdr_TimeStamp : 64|26@1+ (1,0) [0|67108863] "ms"  DASy
 SG_ VFC_OcaHdr_CorrEgoLineTypeLeft : 112|3@1+ (1,0) [0|7] ""  DASy
 SG_ VFC_OcaHdr_CorrEgoLineTypeRight : 115|3@1+ (1,0) [0|7] ""  DASy
 SG_ VFC_OcaHdr_CorrLeftLineTypeLeft : 118|3@1+ (1,0) [0|7] ""  DASy
 SG_ VFC_OcaHdr_CorrLeftLineTypeRight : 121|3@1+ (1,0) [0|7] ""  DASy
 SG_ VFC_OcaHdr_CorrRightLineTypeLeft : 124|3@1+ (1,0) [0|7] ""  DASy
 SG_ VFC_OcaHdr_CorrRightLineTypeR : 127|3@1+ (1,0) [0|7] ""  DASy
 SG_ VFC_OcaHdr_CorrEgoLaneLineTypeL : 130|3@1+ (1,0) [0|7] ""  DASy
 SG_ VFC_OcaHdr_CorrEgoLaneLineTypeR : 133|3@1+ (1,0) [0|7] ""  DASy
 SG_ VFC_OcaHdr_PreReactObjAccConf : 136|6@1+ (2,0) [0|100] "%"  DASy
 SG_ VFC_OcaHdr_PreReactObjAcc : 142|1@1+ (1,0) [0|1] ""  DASy
 SG_ VFC_OcaHdr_PreReactObjAccPx : 143|12@1+ (0.05,0) [0|204.75] "m"  DASy
 SG_ VFC_OcaHdr_PreReactObjAccVx : 155|11@1+ (0.1,-154) [-154|50.7] "m/s"  DASy

BO_ 88 VFC_Oca_000_017: 64 VideoFrontCenter
 SG_ VFC_Oca_000_017_CRC : 0|16@1+ (1,0) [0|65535] ""  DASy
 SG_ VFC_Oca_000_017_AliveCtr : 16|8@1+ (1,0) [0|255] ""  DASy
 SG_ VFC_Oca_000_017_ProtBlockCtr : 24|4@1+ (1,0) [0|15] ""  DASy
 SG_ VFC_Oca000_ObjIdRef : 32|6@1+ (1,0) [1|63] ""  DASy
 SG_ VFC_Oca000_CorridorTypeRef : 38|3@1+ (1,0) [0|7] ""  DASy
 SG_ VFC_Oca000_ObjPosition : 41|3@1+ (1,0) [0|7] ""  DASy
 SG_ VFC_Oca000_CorridorOverlap : 44|5@1+ (5,0) [0|100] "%"  DASy
 SG_ VFC_Oca000_InMeasuredLines : 49|1@1+ (1,0) [0|1] ""  DASy
 SG_ VFC_Oca000_TimeToEnterCorridor : 50|4@1+ (0.25,0) [0|3.75] "s"  DASy
 SG_ VFC_Oca000_TimeToLeaveCorridor : 54|4@1+ (0.25,0) [0|3.75] "s"  DASy
 SG_ VFC_Oca001_ObjIdRef : 58|6@1+ (1,0) [1|63] ""  DASy
 SG_ VFC_Oca001_CorridorTypeRef : 64|3@1+ (1,0) [0|7] ""  DASy
 SG_ VFC_Oca001_ObjPosition : 67|3@1+ (1,0) [0|7] ""  DASy
 SG_ VFC_Oca001_CorridorOverlap : 70|5@1+ (5,0) [0|100] "%"  DASy
 SG_ VFC_Oca001_InMeasuredLines : 75|1@1+ (1,0) [0|1] ""  DASy
 SG_ VFC_Oca001_TimeToEnterCorridor : 76|4@1+ (0.25,0) [0|3.75] "s"  DASy
 SG_ VFC_Oca001_TimeToLeaveCorridor : 80|4@1+ (0.25,0) [0|3.75] "s"  DASy
 SG_ VFC_Oca002_ObjIdRef : 84|6@1+ (1,0) [1|63] ""  DASy
 SG_ VFC_Oca002_CorridorTypeRef : 90|3@1+ (1,0) [0|7] ""  DASy
 SG_ VFC_Oca002_ObjPosition : 93|3@1+ (1,0) [0|7] ""  DASy
 SG_ VFC_Oca002_CorridorOverlap : 96|5@1+ (5,0) [0|100] "%"  DASy
 SG_ VFC_Oca002_InMeasuredLines : 101|1@1+ (1,0) [0|1] ""  DASy
 SG_ VFC_Oca002_TimeToEnterCorridor : 102|4@1+ (0.25,0) [0|3.75] "s"  DASy
 SG_ VFC_Oca002_TimeToLeaveCorridor : 106|4@1+ (0.25,0) [0|3.75] "s"  DASy
 SG_ VFC_Oca003_ObjIdRef : 110|6@1+ (1,0) [1|63] ""  DASy
 SG_ VFC_Oca003_CorridorTypeRef : 116|3@1+ (1,0) [0|7] ""  DASy
 SG_ VFC_Oca003_ObjPosition : 119|3@1+ (1,0) [0|7] ""  DASy
 SG_ VFC_Oca003_CorridorOverlap : 122|5@1+ (5,0) [0|100] "%"  DASy
 SG_ VFC_Oca003_InMeasuredLines : 127|1@1+ (1,0) [0|1] ""  DASy
 SG_ VFC_Oca003_TimeToEnterCorridor : 128|4@1+ (0.25,0) [0|3.75] "s"  DASy
 SG_ VFC_Oca003_TimeToLeaveCorridor : 132|4@1+ (0.25,0) [0|3.75] "s"  DASy
 SG_ VFC_Oca004_ObjIdRef : 136|6@1+ (1,0) [1|63] ""  DASy
 SG_ VFC_Oca004_CorridorTypeRef : 142|3@1+ (1,0) [0|7] ""  DASy
 SG_ VFC_Oca004_ObjPosition : 145|3@1+ (1,0) [0|7] ""  DASy
 SG_ VFC_Oca004_CorridorOverlap : 148|5@1+ (5,0) [0|100] "%"  DASy
 SG_ VFC_Oca004_InMeasuredLines : 153|1@1+ (1,0) [0|1] ""  DASy
 SG_ VFC_Oca004_TimeToEnterCorridor : 154|4@1+ (0.25,0) [0|3.75] "s"  DASy
 SG_ VFC_Oca004_TimeToLeaveCorridor : 158|4@1+ (0.25,0) [0|3.75] "s"  DASy
 SG_ VFC_Oca005_ObjIdRef : 162|6@1+ (1,0) [1|63] ""  DASy
 SG_ VFC_Oca005_CorridorTypeRef : 168|3@1+ (1,0) [0|7] ""  DASy
 SG_ VFC_Oca005_ObjPosition : 171|3@1+ (1,0) [0|7] ""  DASy
 SG_ VFC_Oca005_CorridorOverlap : 174|5@1+ (5,0) [0|100] "%"  DASy
 SG_ VFC_Oca005_InMeasuredLines : 179|1@1+ (1,0) [0|1] ""  DASy
 SG_ VFC_Oca005_TimeToEnterCorridor : 180|4@1+ (0.25,0) [0|3.75] "s"  DASy
 SG_ VFC_Oca005_TimeToLeaveCorridor : 184|4@1+ (0.25,0) [0|3.75] "s"  DASy
 SG_ VFC_Oca006_ObjIdRef : 188|6@1+ (1,0) [1|63] ""  DASy
 SG_ VFC_Oca006_CorridorTypeRef : 194|3@1+ (1,0) [0|7] ""  DASy
 SG_ VFC_Oca006_ObjPosition : 197|3@1+ (1,0) [0|7] ""  DASy
 SG_ VFC_Oca006_CorridorOverlap : 200|5@1+ (5,0) [0|100] "%"  DASy
 SG_ VFC_Oca006_InMeasuredLines : 205|1@1+ (1,0) [0|1] ""  DASy
 SG_ VFC_Oca006_TimeToEnterCorridor : 206|4@1+ (0.25,0) [0|3.75] "s"  DASy
 SG_ VFC_Oca006_TimeToLeaveCorridor : 210|4@1+ (0.25,0) [0|3.75] "s"  DASy
 SG_ VFC_Oca007_ObjIdRef : 214|6@1+ (1,0) [1|63] ""  DASy
 SG_ VFC_Oca007_CorridorTypeRef : 220|3@1+ (1,0) [0|7] ""  DASy
 SG_ VFC_Oca007_ObjPosition : 223|3@1+ (1,0) [0|7] ""  DASy
 SG_ VFC_Oca007_CorridorOverlap : 226|5@1+ (5,0) [0|100] "%"  DASy
 SG_ VFC_Oca007_InMeasuredLines : 231|1@1+ (1,0) [0|1] ""  DASy
 SG_ VFC_Oca007_TimeToEnterCorridor : 232|4@1+ (0.25,0) [0|3.75] "s"  DASy
 SG_ VFC_Oca007_TimeToLeaveCorridor : 236|4@1+ (0.25,0) [0|3.75] "s"  DASy
 SG_ VFC_Oca008_ObjIdRef : 240|6@1+ (1,0) [1|63] ""  DASy
 SG_ VFC_Oca008_CorridorTypeRef : 246|3@1+ (1,0) [0|7] ""  DASy
 SG_ VFC_Oca008_ObjPosition : 249|3@1+ (1,0) [0|7] ""  DASy
 SG_ VFC_Oca008_CorridorOverlap : 252|5@1+ (5,0) [0|100] "%"  DASy
 SG_ VFC_Oca008_InMeasuredLines : 257|1@1+ (1,0) [0|1] ""  DASy
 SG_ VFC_Oca008_TimeToEnterCorridor : 258|4@1+ (0.25,0) [0|3.75] "s"  DASy
 SG_ VFC_Oca008_TimeToLeaveCorridor : 262|4@1+ (0.25,0) [0|3.75] "s"  DASy
 SG_ VFC_Oca009_ObjIdRef : 266|6@1+ (1,0) [1|63] ""  DASy
 SG_ VFC_Oca009_CorridorTypeRef : 272|3@1+ (1,0) [0|7] ""  DASy
 SG_ VFC_Oca009_ObjPosition : 275|3@1+ (1,0) [0|7] ""  DASy
 SG_ VFC_Oca009_CorridorOverlap : 278|5@1+ (5,0) [0|100] "%"  DASy
 SG_ VFC_Oca009_InMeasuredLines : 283|1@1+ (1,0) [0|1] ""  DASy
 SG_ VFC_Oca009_TimeToEnterCorridor : 284|4@1+ (0.25,0) [0|3.75] "s"  DASy
 SG_ VFC_Oca009_TimeToLeaveCorridor : 288|4@1+ (0.25,0) [0|3.75] "s"  DASy
 SG_ VFC_Oca010_ObjIdRef : 292|6@1+ (1,0) [1|63] ""  DASy
 SG_ VFC_Oca010_CorridorTypeRef : 298|3@1+ (1,0) [0|7] ""  DASy
 SG_ VFC_Oca010_ObjPosition : 301|3@1+ (1,0) [0|7] ""  DASy
 SG_ VFC_Oca010_CorridorOverlap : 304|5@1+ (5,0) [0|100] "%"  DASy
 SG_ VFC_Oca010_InMeasuredLines : 309|1@1+ (1,0) [0|1] ""  DASy
 SG_ VFC_Oca010_TimeToEnterCorridor : 310|4@1+ (0.25,0) [0|3.75] "s"  DASy
 SG_ VFC_Oca010_TimeToLeaveCorridor : 314|4@1+ (0.25,0) [0|3.75] "s"  DASy
 SG_ VFC_Oca011_ObjIdRef : 318|6@1+ (1,0) [1|63] ""  DASy
 SG_ VFC_Oca011_CorridorTypeRef : 324|3@1+ (1,0) [0|7] ""  DASy
 SG_ VFC_Oca011_ObjPosition : 327|3@1+ (1,0) [0|7] ""  DASy
 SG_ VFC_Oca011_CorridorOverlap : 330|5@1+ (5,0) [0|100] "%"  DASy
 SG_ VFC_Oca011_InMeasuredLines : 335|1@1+ (1,0) [0|1] ""  DASy
 SG_ VFC_Oca011_TimeToEnterCorridor : 336|4@1+ (0.25,0) [0|3.75] "s"  DASy
 SG_ VFC_Oca011_TimeToLeaveCorridor : 340|4@1+ (0.25,0) [0|3.75] "s"  DASy
 SG_ VFC_Oca012_ObjIdRef : 344|6@1+ (1,0) [1|63] ""  DASy
 SG_ VFC_Oca012_CorridorTypeRef : 350|3@1+ (1,0) [0|7] ""  DASy
 SG_ VFC_Oca012_ObjPosition : 353|3@1+ (1,0) [0|7] ""  DASy
 SG_ VFC_Oca012_CorridorOverlap : 356|5@1+ (5,0) [0|100] "%"  DASy
 SG_ VFC_Oca012_InMeasuredLines : 361|1@1+ (1,0) [0|1] ""  DASy
 SG_ VFC_Oca012_TimeToEnterCorridor : 362|4@1+ (0.25,0) [0|3.75] "s"  DASy
 SG_ VFC_Oca012_TimeToLeaveCorridor : 366|4@1+ (0.25,0) [0|3.75] "s"  DASy
 SG_ VFC_Oca013_ObjIdRef : 370|6@1+ (1,0) [1|63] ""  DASy
 SG_ VFC_Oca013_CorridorTypeRef : 376|3@1+ (1,0) [0|7] ""  DASy
 SG_ VFC_Oca013_ObjPosition : 379|3@1+ (1,0) [0|7] ""  DASy
 SG_ VFC_Oca013_CorridorOverlap : 382|5@1+ (5,0) [0|100] "%"  DASy
 SG_ VFC_Oca013_InMeasuredLines : 387|1@1+ (1,0) [0|1] ""  DASy
 SG_ VFC_Oca013_TimeToEnterCorridor : 388|4@1+ (0.25,0) [0|3.75] "s"  DASy
 SG_ VFC_Oca013_TimeToLeaveCorridor : 392|4@1+ (0.25,0) [0|3.75] "s"  DASy
 SG_ VFC_Oca014_ObjIdRef : 396|6@1+ (1,0) [1|63] ""  DASy
 SG_ VFC_Oca014_CorridorTypeRef : 402|3@1+ (1,0) [0|7] ""  DASy
 SG_ VFC_Oca014_ObjPosition : 405|3@1+ (1,0) [0|7] ""  DASy
 SG_ VFC_Oca014_CorridorOverlap : 408|5@1+ (5,0) [0|100] "%"  DASy
 SG_ VFC_Oca014_InMeasuredLines : 413|1@1+ (1,0) [0|1] ""  DASy
 SG_ VFC_Oca014_TimeToEnterCorridor : 414|4@1+ (0.25,0) [0|3.75] "s"  DASy
 SG_ VFC_Oca014_TimeToLeaveCorridor : 418|4@1+ (0.25,0) [0|3.75] "s"  DASy
 SG_ VFC_Oca015_ObjIdRef : 422|6@1+ (1,0) [1|63] ""  DASy
 SG_ VFC_Oca015_CorridorTypeRef : 428|3@1+ (1,0) [0|7] ""  DASy
 SG_ VFC_Oca015_ObjPosition : 431|3@1+ (1,0) [0|7] ""  DASy
 SG_ VFC_Oca015_CorridorOverlap : 434|5@1+ (5,0) [0|100] "%"  DASy
 SG_ VFC_Oca015_InMeasuredLines : 439|1@1+ (1,0) [0|1] ""  DASy
 SG_ VFC_Oca015_TimeToEnterCorridor : 440|4@1+ (0.25,0) [0|3.75] "s"  DASy
 SG_ VFC_Oca015_TimeToLeaveCorridor : 444|4@1+ (0.25,0) [0|3.75] "s"  DASy
 SG_ VFC_Oca016_ObjIdRef : 448|6@1+ (1,0) [1|63] ""  DASy
 SG_ VFC_Oca016_CorridorTypeRef : 454|3@1+ (1,0) [0|7] ""  DASy
 SG_ VFC_Oca016_ObjPosition : 457|3@1+ (1,0) [0|7] ""  DASy
 SG_ VFC_Oca016_CorridorOverlap : 460|5@1+ (5,0) [0|100] "%"  DASy
 SG_ VFC_Oca016_InMeasuredLines : 465|1@1+ (1,0) [0|1] ""  DASy
 SG_ VFC_Oca016_TimeToEnterCorridor : 466|4@1+ (0.25,0) [0|3.75] "s"  DASy
 SG_ VFC_Oca016_TimeToLeaveCorridor : 470|4@1+ (0.25,0) [0|3.75] "s"  DASy
 SG_ VFC_Oca017_ObjIdRef : 474|6@1+ (1,0) [1|63] ""  DASy
 SG_ VFC_Oca017_CorridorTypeRef : 480|3@1+ (1,0) [0|7] ""  DASy
 SG_ VFC_Oca017_ObjPosition : 483|3@1+ (1,0) [0|7] ""  DASy
 SG_ VFC_Oca017_CorridorOverlap : 486|5@1+ (5,0) [0|100] "%"  DASy
 SG_ VFC_Oca017_InMeasuredLines : 491|1@1+ (1,0) [0|1] ""  DASy
 SG_ VFC_Oca017_TimeToEnterCorridor : 492|4@1+ (0.25,0) [0|3.75] "s"  DASy
 SG_ VFC_Oca017_TimeToLeaveCorridor : 496|4@1+ (0.25,0) [0|3.75] "s"  DASy

BO_ 89 VFC_Oca_018_035: 64 VideoFrontCenter
 SG_ VFC_Oca_018_035_CRC : 0|16@1+ (1,0) [0|65535] ""  DASy
 SG_ VFC_Oca_018_035_AliveCtr : 16|8@1+ (1,0) [0|255] ""  DASy
 SG_ VFC_Oca_018_035_ProtBlockCtr : 24|4@1+ (1,0) [0|15] ""  DASy
 SG_ VFC_Oca018_ObjIdRef : 32|6@1+ (1,0) [1|63] ""  DASy
 SG_ VFC_Oca018_CorridorTypeRef : 38|3@1+ (1,0) [0|7] ""  DASy
 SG_ VFC_Oca018_ObjPosition : 41|3@1+ (1,0) [0|7] ""  DASy
 SG_ VFC_Oca018_CorridorOverlap : 44|5@1+ (5,0) [0|100] "%"  DASy
 SG_ VFC_Oca018_InMeasuredLines : 49|1@1+ (1,0) [0|1] ""  DASy
 SG_ VFC_Oca018_TimeToEnterCorridor : 50|4@1+ (0.25,0) [0|3.75] "s"  DASy
 SG_ VFC_Oca018_TimeToLeaveCorridor : 54|4@1+ (0.25,0) [0|3.75] "s"  DASy
 SG_ VFC_Oca019_ObjIdRef : 58|6@1+ (1,0) [1|63] ""  DASy
 SG_ VFC_Oca019_CorridorTypeRef : 64|3@1+ (1,0) [0|7] ""  DASy
 SG_ VFC_Oca019_ObjPosition : 67|3@1+ (1,0) [0|7] ""  DASy
 SG_ VFC_Oca019_CorridorOverlap : 70|5@1+ (5,0) [0|100] "%"  DASy
 SG_ VFC_Oca019_InMeasuredLines : 75|1@1+ (1,0) [0|1] ""  DASy
 SG_ VFC_Oca019_TimeToEnterCorridor : 76|4@1+ (0.25,0) [0|3.75] "s"  DASy
 SG_ VFC_Oca019_TimeToLeaveCorridor : 80|4@1+ (0.25,0) [0|3.75] "s"  DASy
 SG_ VFC_Oca020_ObjIdRef : 84|6@1+ (1,0) [1|63] ""  DASy
 SG_ VFC_Oca020_CorridorTypeRef : 90|3@1+ (1,0) [0|7] ""  DASy
 SG_ VFC_Oca020_ObjPosition : 93|3@1+ (1,0) [0|7] ""  DASy
 SG_ VFC_Oca020_CorridorOverlap : 96|5@1+ (5,0) [0|100] "%"  DASy
 SG_ VFC_Oca020_InMeasuredLines : 101|1@1+ (1,0) [0|1] ""  DASy
 SG_ VFC_Oca020_TimeToEnterCorridor : 102|4@1+ (0.25,0) [0|3.75] "s"  DASy
 SG_ VFC_Oca020_TimeToLeaveCorridor : 106|4@1+ (0.25,0) [0|3.75] "s"  DASy
 SG_ VFC_Oca021_ObjIdRef : 110|6@1+ (1,0) [1|63] ""  DASy
 SG_ VFC_Oca021_CorridorTypeRef : 116|3@1+ (1,0) [0|7] ""  DASy
 SG_ VFC_Oca021_ObjPosition : 119|3@1+ (1,0) [0|7] ""  DASy
 SG_ VFC_Oca021_CorridorOverlap : 122|5@1+ (5,0) [0|100] "%"  DASy
 SG_ VFC_Oca021_InMeasuredLines : 127|1@1+ (1,0) [0|1] ""  DASy
 SG_ VFC_Oca021_TimeToEnterCorridor : 128|4@1+ (0.25,0) [0|3.75] "s"  DASy
 SG_ VFC_Oca021_TimeToLeaveCorridor : 132|4@1+ (0.25,0) [0|3.75] "s"  DASy
 SG_ VFC_Oca022_ObjIdRef : 136|6@1+ (1,0) [1|63] ""  DASy
 SG_ VFC_Oca022_CorridorTypeRef : 142|3@1+ (1,0) [0|7] ""  DASy
 SG_ VFC_Oca022_ObjPosition : 145|3@1+ (1,0) [0|7] ""  DASy
 SG_ VFC_Oca022_CorridorOverlap : 148|5@1+ (5,0) [0|100] "%"  DASy
 SG_ VFC_Oca022_InMeasuredLines : 153|1@1+ (1,0) [0|1] ""  DASy
 SG_ VFC_Oca022_TimeToEnterCorridor : 154|4@1+ (0.25,0) [0|3.75] "s"  DASy
 SG_ VFC_Oca022_TimeToLeaveCorridor : 158|4@1+ (0.25,0) [0|3.75] "s"  DASy
 SG_ VFC_Oca023_ObjIdRef : 162|6@1+ (1,0) [1|63] ""  DASy
 SG_ VFC_Oca023_CorridorTypeRef : 168|3@1+ (1,0) [0|7] ""  DASy
 SG_ VFC_Oca023_ObjPosition : 171|3@1+ (1,0) [0|7] ""  DASy
 SG_ VFC_Oca023_CorridorOverlap : 174|5@1+ (5,0) [0|100] "%"  DASy
 SG_ VFC_Oca023_InMeasuredLines : 179|1@1+ (1,0) [0|1] ""  DASy
 SG_ VFC_Oca023_TimeToEnterCorridor : 180|4@1+ (0.25,0) [0|3.75] "s"  DASy
 SG_ VFC_Oca023_TimeToLeaveCorridor : 184|4@1+ (0.25,0) [0|3.75] "s"  DASy
 SG_ VFC_Oca024_ObjIdRef : 188|6@1+ (1,0) [1|63] ""  DASy
 SG_ VFC_Oca024_CorridorTypeRef : 194|3@1+ (1,0) [0|7] ""  DASy
 SG_ VFC_Oca024_ObjPosition : 197|3@1+ (1,0) [0|7] ""  DASy
 SG_ VFC_Oca024_CorridorOverlap : 200|5@1+ (5,0) [0|100] "%"  DASy
 SG_ VFC_Oca024_InMeasuredLines : 205|1@1+ (1,0) [0|1] ""  DASy
 SG_ VFC_Oca024_TimeToEnterCorridor : 206|4@1+ (0.25,0) [0|3.75] "s"  DASy
 SG_ VFC_Oca024_TimeToLeaveCorridor : 210|4@1+ (0.25,0) [0|3.75] "s"  DASy
 SG_ VFC_Oca025_ObjIdRef : 214|6@1+ (1,0) [1|63] ""  DASy
 SG_ VFC_Oca025_CorridorTypeRef : 220|3@1+ (1,0) [0|7] ""  DASy
 SG_ VFC_Oca025_ObjPosition : 223|3@1+ (1,0) [0|7] ""  DASy
 SG_ VFC_Oca025_CorridorOverlap : 226|5@1+ (5,0) [0|100] "%"  DASy
 SG_ VFC_Oca025_InMeasuredLines : 231|1@1+ (1,0) [0|1] ""  DASy
 SG_ VFC_Oca025_TimeToEnterCorridor : 232|4@1+ (0.25,0) [0|3.75] "s"  DASy
 SG_ VFC_Oca025_TimeToLeaveCorridor : 236|4@1+ (0.25,0) [0|3.75] "s"  DASy
 SG_ VFC_Oca026_ObjIdRef : 240|6@1+ (1,0) [1|63] ""  DASy
 SG_ VFC_Oca026_CorridorTypeRef : 246|3@1+ (1,0) [0|7] ""  DASy
 SG_ VFC_Oca026_ObjPosition : 249|3@1+ (1,0) [0|7] ""  DASy
 SG_ VFC_Oca026_CorridorOverlap : 252|5@1+ (5,0) [0|100] "%"  DASy
 SG_ VFC_Oca026_InMeasuredLines : 257|1@1+ (1,0) [0|1] ""  DASy
 SG_ VFC_Oca026_TimeToEnterCorridor : 258|4@1+ (0.25,0) [0|3.75] "s"  DASy
 SG_ VFC_Oca026_TimeToLeaveCorridor : 262|4@1+ (0.25,0) [0|3.75] "s"  DASy
 SG_ VFC_Oca027_ObjIdRef : 266|6@1+ (1,0) [1|63] ""  DASy
 SG_ VFC_Oca027_CorridorTypeRef : 272|3@1+ (1,0) [0|7] ""  DASy
 SG_ VFC_Oca027_ObjPosition : 275|3@1+ (1,0) [0|7] ""  DASy
 SG_ VFC_Oca027_CorridorOverlap : 278|5@1+ (5,0) [0|100] "%"  DASy
 SG_ VFC_Oca027_InMeasuredLines : 283|1@1+ (1,0) [0|1] ""  DASy
 SG_ VFC_Oca027_TimeToEnterCorridor : 284|4@1+ (0.25,0) [0|3.75] "s"  DASy
 SG_ VFC_Oca027_TimeToLeaveCorridor : 288|4@1+ (0.25,0) [0|3.75] "s"  DASy
 SG_ VFC_Oca028_ObjIdRef : 292|6@1+ (1,0) [1|63] ""  DASy
 SG_ VFC_Oca028_CorridorTypeRef : 298|3@1+ (1,0) [0|7] ""  DASy
 SG_ VFC_Oca028_ObjPosition : 301|3@1+ (1,0) [0|7] ""  DASy
 SG_ VFC_Oca028_CorridorOverlap : 304|5@1+ (5,0) [0|100] "%"  DASy
 SG_ VFC_Oca028_InMeasuredLines : 309|1@1+ (1,0) [0|1] ""  DASy
 SG_ VFC_Oca028_TimeToEnterCorridor : 310|4@1+ (0.25,0) [0|3.75] "s"  DASy
 SG_ VFC_Oca028_TimeToLeaveCorridor : 314|4@1+ (0.25,0) [0|3.75] "s"  DASy
 SG_ VFC_Oca029_ObjIdRef : 318|6@1+ (1,0) [1|63] ""  DASy
 SG_ VFC_Oca029_CorridorTypeRef : 324|3@1+ (1,0) [0|7] ""  DASy
 SG_ VFC_Oca029_ObjPosition : 327|3@1+ (1,0) [0|7] ""  DASy
 SG_ VFC_Oca029_CorridorOverlap : 330|5@1+ (5,0) [0|100] "%"  DASy
 SG_ VFC_Oca029_InMeasuredLines : 335|1@1+ (1,0) [0|1] ""  DASy
 SG_ VFC_Oca029_TimeToEnterCorridor : 336|4@1+ (0.25,0) [0|3.75] "s"  DASy
 SG_ VFC_Oca029_TimeToLeaveCorridor : 340|4@1+ (0.25,0) [0|3.75] "s"  DASy
 SG_ VFC_Oca030_ObjIdRef : 344|6@1+ (1,0) [1|63] ""  DASy
 SG_ VFC_Oca030_CorridorTypeRef : 350|3@1+ (1,0) [0|7] ""  DASy
 SG_ VFC_Oca030_ObjPosition : 353|3@1+ (1,0) [0|7] ""  DASy
 SG_ VFC_Oca030_CorridorOverlap : 356|5@1+ (5,0) [0|100] "%"  DASy
 SG_ VFC_Oca030_InMeasuredLines : 361|1@1+ (1,0) [0|1] ""  DASy
 SG_ VFC_Oca030_TimeToEnterCorridor : 362|4@1+ (0.25,0) [0|3.75] "s"  DASy
 SG_ VFC_Oca030_TimeToLeaveCorridor : 366|4@1+ (0.25,0) [0|3.75] "s"  DASy
 SG_ VFC_Oca031_ObjIdRef : 370|6@1+ (1,0) [1|63] ""  DASy
 SG_ VFC_Oca031_CorridorTypeRef : 376|3@1+ (1,0) [0|7] ""  DASy
 SG_ VFC_Oca031_ObjPosition : 379|3@1+ (1,0) [0|7] ""  DASy
 SG_ VFC_Oca031_CorridorOverlap : 382|5@1+ (5,0) [0|100] "%"  DASy
 SG_ VFC_Oca031_InMeasuredLines : 387|1@1+ (1,0) [0|1] ""  DASy
 SG_ VFC_Oca031_TimeToEnterCorridor : 388|4@1+ (0.25,0) [0|3.75] "s"  DASy
 SG_ VFC_Oca031_TimeToLeaveCorridor : 392|4@1+ (0.25,0) [0|3.75] "s"  DASy
 SG_ VFC_Oca032_ObjIdRef : 396|6@1+ (1,0) [1|63] ""  DASy
 SG_ VFC_Oca032_CorridorTypeRef : 402|3@1+ (1,0) [0|7] ""  DASy
 SG_ VFC_Oca032_ObjPosition : 405|3@1+ (1,0) [0|7] ""  DASy
 SG_ VFC_Oca032_CorridorOverlap : 408|5@1+ (5,0) [0|100] "%"  DASy
 SG_ VFC_Oca032_InMeasuredLines : 413|1@1+ (1,0) [0|1] ""  DASy
 SG_ VFC_Oca032_TimeToEnterCorridor : 414|4@1+ (0.25,0) [0|3.75] "s"  DASy
 SG_ VFC_Oca032_TimeToLeaveCorridor : 418|4@1+ (0.25,0) [0|3.75] "s"  DASy
 SG_ VFC_Oca033_ObjIdRef : 422|6@1+ (1,0) [1|63] ""  DASy
 SG_ VFC_Oca033_CorridorTypeRef : 428|3@1+ (1,0) [0|7] ""  DASy
 SG_ VFC_Oca033_ObjPosition : 431|3@1+ (1,0) [0|7] ""  DASy
 SG_ VFC_Oca033_CorridorOverlap : 434|5@1+ (5,0) [0|100] "%"  DASy
 SG_ VFC_Oca033_InMeasuredLines : 439|1@1+ (1,0) [0|1] ""  DASy
 SG_ VFC_Oca033_TimeToEnterCorridor : 440|4@1+ (0.25,0) [0|3.75] "s"  DASy
 SG_ VFC_Oca033_TimeToLeaveCorridor : 444|4@1+ (0.25,0) [0|3.75] "s"  DASy
 SG_ VFC_Oca034_ObjIdRef : 448|6@1+ (1,0) [1|63] ""  DASy
 SG_ VFC_Oca034_CorridorTypeRef : 454|3@1+ (1,0) [0|7] ""  DASy
 SG_ VFC_Oca034_ObjPosition : 457|3@1+ (1,0) [0|7] ""  DASy
 SG_ VFC_Oca034_CorridorOverlap : 460|5@1+ (5,0) [0|100] "%"  DASy
 SG_ VFC_Oca034_InMeasuredLines : 465|1@1+ (1,0) [0|1] ""  DASy
 SG_ VFC_Oca034_TimeToEnterCorridor : 466|4@1+ (0.25,0) [0|3.75] "s"  DASy
 SG_ VFC_Oca034_TimeToLeaveCorridor : 470|4@1+ (0.25,0) [0|3.75] "s"  DASy
 SG_ VFC_Oca035_ObjIdRef : 474|6@1+ (1,0) [1|63] ""  DASy
 SG_ VFC_Oca035_CorridorTypeRef : 480|3@1+ (1,0) [0|7] ""  DASy
 SG_ VFC_Oca035_ObjPosition : 483|3@1+ (1,0) [0|7] ""  DASy
 SG_ VFC_Oca035_CorridorOverlap : 486|5@1+ (5,0) [0|100] "%"  DASy
 SG_ VFC_Oca035_InMeasuredLines : 491|1@1+ (1,0) [0|1] ""  DASy
 SG_ VFC_Oca035_TimeToEnterCorridor : 492|4@1+ (0.25,0) [0|3.75] "s"  DASy
 SG_ VFC_Oca035_TimeToLeaveCorridor : 496|4@1+ (0.25,0) [0|3.75] "s"  DASy

BO_ 90 VFC_Oca_036_053: 64 VideoFrontCenter
 SG_ VFC_Oca_036_053_CRC : 0|16@1+ (1,0) [0|65535] ""  DASy
 SG_ VFC_Oca_036_053_AliveCtr : 16|8@1+ (1,0) [0|255] ""  DASy
 SG_ VFC_Oca_036_053_ProtBlockCtr : 24|4@1+ (1,0) [0|15] ""  DASy
 SG_ VFC_Oca036_ObjIdRef : 32|6@1+ (1,0) [1|63] ""  DASy
 SG_ VFC_Oca036_CorridorTypeRef : 38|3@1+ (1,0) [0|7] ""  DASy
 SG_ VFC_Oca036_ObjPosition : 41|3@1+ (1,0) [0|7] ""  DASy
 SG_ VFC_Oca036_CorridorOverlap : 44|5@1+ (5,0) [0|100] "%"  DASy
 SG_ VFC_Oca036_InMeasuredLines : 49|1@1+ (1,0) [0|1] ""  DASy
 SG_ VFC_Oca036_TimeToEnterCorridor : 50|4@1+ (0.25,0) [0|3.75] "s"  DASy
 SG_ VFC_Oca036_TimeToLeaveCorridor : 54|4@1+ (0.25,0) [0|3.75] "s"  DASy
 SG_ VFC_Oca037_ObjIdRef : 58|6@1+ (1,0) [1|63] ""  DASy
 SG_ VFC_Oca037_CorridorTypeRef : 64|3@1+ (1,0) [0|7] ""  DASy
 SG_ VFC_Oca037_ObjPosition : 67|3@1+ (1,0) [0|7] ""  DASy
 SG_ VFC_Oca037_CorridorOverlap : 70|5@1+ (5,0) [0|100] "%"  DASy
 SG_ VFC_Oca037_InMeasuredLines : 75|1@1+ (1,0) [0|1] ""  DASy
 SG_ VFC_Oca037_TimeToEnterCorridor : 76|4@1+ (0.25,0) [0|3.75] "s"  DASy
 SG_ VFC_Oca037_TimeToLeaveCorridor : 80|4@1+ (0.25,0) [0|3.75] "s"  DASy
 SG_ VFC_Oca038_ObjIdRef : 84|6@1+ (1,0) [1|63] ""  DASy
 SG_ VFC_Oca038_CorridorTypeRef : 90|3@1+ (1,0) [0|7] ""  DASy
 SG_ VFC_Oca038_ObjPosition : 93|3@1+ (1,0) [0|7] ""  DASy
 SG_ VFC_Oca038_CorridorOverlap : 96|5@1+ (5,0) [0|100] "%"  DASy
 SG_ VFC_Oca038_InMeasuredLines : 101|1@1+ (1,0) [0|1] ""  DASy
 SG_ VFC_Oca038_TimeToEnterCorridor : 102|4@1+ (0.25,0) [0|3.75] "s"  DASy
 SG_ VFC_Oca038_TimeToLeaveCorridor : 106|4@1+ (0.25,0) [0|3.75] "s"  DASy
 SG_ VFC_Oca039_ObjIdRef : 110|6@1+ (1,0) [1|63] ""  DASy
 SG_ VFC_Oca039_CorridorTypeRef : 116|3@1+ (1,0) [0|7] ""  DASy
 SG_ VFC_Oca039_ObjPosition : 119|3@1+ (1,0) [0|7] ""  DASy
 SG_ VFC_Oca039_CorridorOverlap : 122|5@1+ (5,0) [0|100] "%"  DASy
 SG_ VFC_Oca039_InMeasuredLines : 127|1@1+ (1,0) [0|1] ""  DASy
 SG_ VFC_Oca039_TimeToEnterCorridor : 128|4@1+ (0.25,0) [0|3.75] "s"  DASy
 SG_ VFC_Oca039_TimeToLeaveCorridor : 132|4@1+ (0.25,0) [0|3.75] "s"  DASy
 SG_ VFC_Oca040_ObjIdRef : 136|6@1+ (1,0) [1|63] ""  DASy
 SG_ VFC_Oca040_CorridorTypeRef : 142|3@1+ (1,0) [0|7] ""  DASy
 SG_ VFC_Oca040_ObjPosition : 145|3@1+ (1,0) [0|7] ""  DASy
 SG_ VFC_Oca040_CorridorOverlap : 148|5@1+ (5,0) [0|100] "%"  DASy
 SG_ VFC_Oca040_InMeasuredLines : 153|1@1+ (1,0) [0|1] ""  DASy
 SG_ VFC_Oca040_TimeToEnterCorridor : 154|4@1+ (0.25,0) [0|3.75] "s"  DASy
 SG_ VFC_Oca040_TimeToLeaveCorridor : 158|4@1+ (0.25,0) [0|3.75] "s"  DASy
 SG_ VFC_Oca041_ObjIdRef : 162|6@1+ (1,0) [1|63] ""  DASy
 SG_ VFC_Oca041_CorridorTypeRef : 168|3@1+ (1,0) [0|7] ""  DASy
 SG_ VFC_Oca041_ObjPosition : 171|3@1+ (1,0) [0|7] ""  DASy
 SG_ VFC_Oca041_CorridorOverlap : 174|5@1+ (5,0) [0|100] "%"  DASy
 SG_ VFC_Oca041_InMeasuredLines : 179|1@1+ (1,0) [0|1] ""  DASy
 SG_ VFC_Oca041_TimeToEnterCorridor : 180|4@1+ (0.25,0) [0|3.75] "s"  DASy
 SG_ VFC_Oca041_TimeToLeaveCorridor : 184|4@1+ (0.25,0) [0|3.75] "s"  DASy
 SG_ VFC_Oca042_ObjIdRef : 188|6@1+ (1,0) [1|63] ""  DASy
 SG_ VFC_Oca042_CorridorTypeRef : 194|3@1+ (1,0) [0|7] ""  DASy
 SG_ VFC_Oca042_ObjPosition : 197|3@1+ (1,0) [0|7] ""  DASy
 SG_ VFC_Oca042_CorridorOverlap : 200|5@1+ (5,0) [0|100] "%"  DASy
 SG_ VFC_Oca042_InMeasuredLines : 205|1@1+ (1,0) [0|1] ""  DASy
 SG_ VFC_Oca042_TimeToEnterCorridor : 206|4@1+ (0.25,0) [0|3.75] "s"  DASy
 SG_ VFC_Oca042_TimeToLeaveCorridor : 210|4@1+ (0.25,0) [0|3.75] "s"  DASy
 SG_ VFC_Oca043_ObjIdRef : 214|6@1+ (1,0) [1|63] ""  DASy
 SG_ VFC_Oca043_CorridorTypeRef : 220|3@1+ (1,0) [0|7] ""  DASy
 SG_ VFC_Oca043_ObjPosition : 223|3@1+ (1,0) [0|7] ""  DASy
 SG_ VFC_Oca043_CorridorOverlap : 226|5@1+ (5,0) [0|100] "%"  DASy
 SG_ VFC_Oca043_InMeasuredLines : 231|1@1+ (1,0) [0|1] ""  DASy
 SG_ VFC_Oca043_TimeToEnterCorridor : 232|4@1+ (0.25,0) [0|3.75] "s"  DASy
 SG_ VFC_Oca043_TimeToLeaveCorridor : 236|4@1+ (0.25,0) [0|3.75] "s"  DASy
 SG_ VFC_Oca044_ObjIdRef : 240|6@1+ (1,0) [1|63] ""  DASy
 SG_ VFC_Oca044_CorridorTypeRef : 246|3@1+ (1,0) [0|7] ""  DASy
 SG_ VFC_Oca044_ObjPosition : 249|3@1+ (1,0) [0|7] ""  DASy
 SG_ VFC_Oca044_CorridorOverlap : 252|5@1+ (5,0) [0|100] "%"  DASy
 SG_ VFC_Oca044_InMeasuredLines : 257|1@1+ (1,0) [0|1] ""  DASy
 SG_ VFC_Oca044_TimeToEnterCorridor : 258|4@1+ (0.25,0) [0|3.75] "s"  DASy
 SG_ VFC_Oca044_TimeToLeaveCorridor : 262|4@1+ (0.25,0) [0|3.75] "s"  DASy
 SG_ VFC_Oca045_ObjIdRef : 266|6@1+ (1,0) [1|63] ""  DASy
 SG_ VFC_Oca045_CorridorTypeRef : 272|3@1+ (1,0) [0|7] ""  DASy
 SG_ VFC_Oca045_ObjPosition : 275|3@1+ (1,0) [0|7] ""  DASy
 SG_ VFC_Oca045_CorridorOverlap : 278|5@1+ (5,0) [0|100] "%"  DASy
 SG_ VFC_Oca045_InMeasuredLines : 283|1@1+ (1,0) [0|1] ""  DASy
 SG_ VFC_Oca045_TimeToEnterCorridor : 284|4@1+ (0.25,0) [0|3.75] "s"  DASy
 SG_ VFC_Oca045_TimeToLeaveCorridor : 288|4@1+ (0.25,0) [0|3.75] "s"  DASy
 SG_ VFC_Oca046_ObjIdRef : 292|6@1+ (1,0) [1|63] ""  DASy
 SG_ VFC_Oca046_CorridorTypeRef : 298|3@1+ (1,0) [0|7] ""  DASy
 SG_ VFC_Oca046_ObjPosition : 301|3@1+ (1,0) [0|7] ""  DASy
 SG_ VFC_Oca046_CorridorOverlap : 304|5@1+ (5,0) [0|100] "%"  DASy
 SG_ VFC_Oca046_InMeasuredLines : 309|1@1+ (1,0) [0|1] ""  DASy
 SG_ VFC_Oca046_TimeToEnterCorridor : 310|4@1+ (0.25,0) [0|3.75] "s"  DASy
 SG_ VFC_Oca046_TimeToLeaveCorridor : 314|4@1+ (0.25,0) [0|3.75] "s"  DASy
 SG_ VFC_Oca047_ObjIdRef : 318|6@1+ (1,0) [1|63] ""  DASy
 SG_ VFC_Oca047_CorridorTypeRef : 324|3@1+ (1,0) [0|7] ""  DASy
 SG_ VFC_Oca047_ObjPosition : 327|3@1+ (1,0) [0|7] ""  DASy
 SG_ VFC_Oca047_CorridorOverlap : 330|5@1+ (5,0) [0|100] "%"  DASy
 SG_ VFC_Oca047_InMeasuredLines : 335|1@1+ (1,0) [0|1] ""  DASy
 SG_ VFC_Oca047_TimeToEnterCorridor : 336|4@1+ (0.25,0) [0|3.75] "s"  DASy
 SG_ VFC_Oca047_TimeToLeaveCorridor : 340|4@1+ (0.25,0) [0|3.75] "s"  DASy
 SG_ VFC_Oca048_ObjIdRef : 344|6@1+ (1,0) [1|63] ""  DASy
 SG_ VFC_Oca048_CorridorTypeRef : 350|3@1+ (1,0) [0|7] ""  DASy
 SG_ VFC_Oca048_ObjPosition : 353|3@1+ (1,0) [0|7] ""  DASy
 SG_ VFC_Oca048_CorridorOverlap : 356|5@1+ (5,0) [0|100] "%"  DASy
 SG_ VFC_Oca048_InMeasuredLines : 361|1@1+ (1,0) [0|1] ""  DASy
 SG_ VFC_Oca048_TimeToEnterCorridor : 362|4@1+ (0.25,0) [0|3.75] "s"  DASy
 SG_ VFC_Oca048_TimeToLeaveCorridor : 366|4@1+ (0.25,0) [0|3.75] "s"  DASy
 SG_ VFC_Oca049_ObjIdRef : 370|6@1+ (1,0) [1|63] ""  DASy
 SG_ VFC_Oca049_CorridorTypeRef : 376|3@1+ (1,0) [0|7] ""  DASy
 SG_ VFC_Oca049_ObjPosition : 379|3@1+ (1,0) [0|7] ""  DASy
 SG_ VFC_Oca049_CorridorOverlap : 382|5@1+ (5,0) [0|100] "%"  DASy
 SG_ VFC_Oca049_InMeasuredLines : 387|1@1+ (1,0) [0|1] ""  DASy
 SG_ VFC_Oca049_TimeToEnterCorridor : 388|4@1+ (0.25,0) [0|3.75] "s"  DASy
 SG_ VFC_Oca049_TimeToLeaveCorridor : 392|4@1+ (0.25,0) [0|3.75] "s"  DASy
 SG_ VFC_Oca050_ObjIdRef : 396|6@1+ (1,0) [1|63] ""  DASy
 SG_ VFC_Oca050_CorridorTypeRef : 402|3@1+ (1,0) [0|7] ""  DASy
 SG_ VFC_Oca050_ObjPosition : 405|3@1+ (1,0) [0|7] ""  DASy
 SG_ VFC_Oca050_CorridorOverlap : 408|5@1+ (5,0) [0|100] "%"  DASy
 SG_ VFC_Oca050_InMeasuredLines : 413|1@1+ (1,0) [0|1] ""  DASy
 SG_ VFC_Oca050_TimeToEnterCorridor : 414|4@1+ (0.25,0) [0|3.75] "s"  DASy
 SG_ VFC_Oca050_TimeToLeaveCorridor : 418|4@1+ (0.25,0) [0|3.75] "s"  DASy
 SG_ VFC_Oca051_ObjIdRef : 422|6@1+ (1,0) [1|63] ""  DASy
 SG_ VFC_Oca051_CorridorTypeRef : 428|3@1+ (1,0) [0|7] ""  DASy
 SG_ VFC_Oca051_ObjPosition : 431|3@1+ (1,0) [0|7] ""  DASy
 SG_ VFC_Oca051_CorridorOverlap : 434|5@1+ (5,0) [0|100] "%"  DASy
 SG_ VFC_Oca051_InMeasuredLines : 439|1@1+ (1,0) [0|1] ""  DASy
 SG_ VFC_Oca051_TimeToEnterCorridor : 440|4@1+ (0.25,0) [0|3.75] "s"  DASy
 SG_ VFC_Oca051_TimeToLeaveCorridor : 444|4@1+ (0.25,0) [0|3.75] "s"  DASy
 SG_ VFC_Oca052_ObjIdRef : 448|6@1+ (1,0) [1|63] ""  DASy
 SG_ VFC_Oca052_CorridorTypeRef : 454|3@1+ (1,0) [0|7] ""  DASy
 SG_ VFC_Oca052_ObjPosition : 457|3@1+ (1,0) [0|7] ""  DASy
 SG_ VFC_Oca052_CorridorOverlap : 460|5@1+ (5,0) [0|100] "%"  DASy
 SG_ VFC_Oca052_InMeasuredLines : 465|1@1+ (1,0) [0|1] ""  DASy
 SG_ VFC_Oca052_TimeToEnterCorridor : 466|4@1+ (0.25,0) [0|3.75] "s"  DASy
 SG_ VFC_Oca052_TimeToLeaveCorridor : 470|4@1+ (0.25,0) [0|3.75] "s"  DASy
 SG_ VFC_Oca053_ObjIdRef : 474|6@1+ (1,0) [1|63] ""  DASy
 SG_ VFC_Oca053_CorridorTypeRef : 480|3@1+ (1,0) [0|7] ""  DASy
 SG_ VFC_Oca053_ObjPosition : 483|3@1+ (1,0) [0|7] ""  DASy
 SG_ VFC_Oca053_CorridorOverlap : 486|5@1+ (5,0) [0|100] "%"  DASy
 SG_ VFC_Oca053_InMeasuredLines : 491|1@1+ (1,0) [0|1] ""  DASy
 SG_ VFC_Oca053_TimeToEnterCorridor : 492|4@1+ (0.25,0) [0|3.75] "s"  DASy
 SG_ VFC_Oca053_TimeToLeaveCorridor : 496|4@1+ (0.25,0) [0|3.75] "s"  DASy

BO_ 91 VFC_Oca_054_071: 64 VideoFrontCenter
 SG_ VFC_Oca_054_071_CRC : 0|16@1+ (1,0) [0|65535] ""  DASy
 SG_ VFC_Oca_054_071_AliveCtr : 16|8@1+ (1,0) [0|255] ""  DASy
 SG_ VFC_Oca_054_071_ProtBlockCtr : 24|4@1+ (1,0) [0|15] ""  DASy
 SG_ VFC_Oca054_ObjIdRef : 32|6@1+ (1,0) [1|63] ""  DASy
 SG_ VFC_Oca054_CorridorTypeRef : 38|3@1+ (1,0) [0|7] ""  DASy
 SG_ VFC_Oca054_ObjPosition : 41|3@1+ (1,0) [0|7] ""  DASy
 SG_ VFC_Oca054_CorridorOverlap : 44|5@1+ (5,0) [0|100] "%"  DASy
 SG_ VFC_Oca054_InMeasuredLines : 49|1@1+ (1,0) [0|1] ""  DASy
 SG_ VFC_Oca054_TimeToEnterCorridor : 50|4@1+ (0.25,0) [0|3.75] "s"  DASy
 SG_ VFC_Oca054_TimeToLeaveCorridor : 54|4@1+ (0.25,0) [0|3.75] "s"  DASy
 SG_ VFC_Oca055_ObjIdRef : 58|6@1+ (1,0) [1|63] ""  DASy
 SG_ VFC_Oca055_CorridorTypeRef : 64|3@1+ (1,0) [0|7] ""  DASy
 SG_ VFC_Oca055_ObjPosition : 67|3@1+ (1,0) [0|7] ""  DASy
 SG_ VFC_Oca055_CorridorOverlap : 70|5@1+ (5,0) [0|100] "%"  DASy
 SG_ VFC_Oca055_InMeasuredLines : 75|1@1+ (1,0) [0|1] ""  DASy
 SG_ VFC_Oca055_TimeToEnterCorridor : 76|4@1+ (0.25,0) [0|3.75] "s"  DASy
 SG_ VFC_Oca055_TimeToLeaveCorridor : 80|4@1+ (0.25,0) [0|3.75] "s"  DASy
 SG_ VFC_Oca056_ObjIdRef : 84|6@1+ (1,0) [1|63] ""  DASy
 SG_ VFC_Oca056_CorridorTypeRef : 90|3@1+ (1,0) [0|7] ""  DASy
 SG_ VFC_Oca056_ObjPosition : 93|3@1+ (1,0) [0|7] ""  DASy
 SG_ VFC_Oca056_CorridorOverlap : 96|5@1+ (5,0) [0|100] "%"  DASy
 SG_ VFC_Oca056_InMeasuredLines : 101|1@1+ (1,0) [0|1] ""  DASy
 SG_ VFC_Oca056_TimeToEnterCorridor : 102|4@1+ (0.25,0) [0|3.75] "s"  DASy
 SG_ VFC_Oca056_TimeToLeaveCorridor : 106|4@1+ (0.25,0) [0|3.75] "s"  DASy
 SG_ VFC_Oca057_ObjIdRef : 110|6@1+ (1,0) [1|63] ""  DASy
 SG_ VFC_Oca057_CorridorTypeRef : 116|3@1+ (1,0) [0|7] ""  DASy
 SG_ VFC_Oca057_ObjPosition : 119|3@1+ (1,0) [0|7] ""  DASy
 SG_ VFC_Oca057_CorridorOverlap : 122|5@1+ (5,0) [0|100] "%"  DASy
 SG_ VFC_Oca057_InMeasuredLines : 127|1@1+ (1,0) [0|1] ""  DASy
 SG_ VFC_Oca057_TimeToEnterCorridor : 128|4@1+ (0.25,0) [0|3.75] "s"  DASy
 SG_ VFC_Oca057_TimeToLeaveCorridor : 132|4@1+ (0.25,0) [0|3.75] "s"  DASy
 SG_ VFC_Oca058_ObjIdRef : 136|6@1+ (1,0) [1|63] ""  DASy
 SG_ VFC_Oca058_CorridorTypeRef : 142|3@1+ (1,0) [0|7] ""  DASy
 SG_ VFC_Oca058_ObjPosition : 145|3@1+ (1,0) [0|7] ""  DASy
 SG_ VFC_Oca058_CorridorOverlap : 148|5@1+ (5,0) [0|100] "%"  DASy
 SG_ VFC_Oca058_InMeasuredLines : 153|1@1+ (1,0) [0|1] ""  DASy
 SG_ VFC_Oca058_TimeToEnterCorridor : 154|4@1+ (0.25,0) [0|3.75] "s"  DASy
 SG_ VFC_Oca058_TimeToLeaveCorridor : 158|4@1+ (0.25,0) [0|3.75] "s"  DASy
 SG_ VFC_Oca059_ObjIdRef : 162|6@1+ (1,0) [1|63] ""  DASy
 SG_ VFC_Oca059_CorridorTypeRef : 168|3@1+ (1,0) [0|7] ""  DASy
 SG_ VFC_Oca059_ObjPosition : 171|3@1+ (1,0) [0|7] ""  DASy
 SG_ VFC_Oca059_CorridorOverlap : 174|5@1+ (5,0) [0|100] "%"  DASy
 SG_ VFC_Oca059_InMeasuredLines : 179|1@1+ (1,0) [0|1] ""  DASy
 SG_ VFC_Oca059_TimeToEnterCorridor : 180|4@1+ (0.25,0) [0|3.75] "s"  DASy
 SG_ VFC_Oca059_TimeToLeaveCorridor : 184|4@1+ (0.25,0) [0|3.75] "s"  DASy
 SG_ VFC_Oca060_ObjIdRef : 188|6@1+ (1,0) [1|63] ""  DASy
 SG_ VFC_Oca060_CorridorTypeRef : 194|3@1+ (1,0) [0|7] ""  DASy
 SG_ VFC_Oca060_ObjPosition : 197|3@1+ (1,0) [0|7] ""  DASy
 SG_ VFC_Oca060_CorridorOverlap : 200|5@1+ (5,0) [0|100] "%"  DASy
 SG_ VFC_Oca060_InMeasuredLines : 205|1@1+ (1,0) [0|1] ""  DASy
 SG_ VFC_Oca060_TimeToEnterCorridor : 206|4@1+ (0.25,0) [0|3.75] "s"  DASy
 SG_ VFC_Oca060_TimeToLeaveCorridor : 210|4@1+ (0.25,0) [0|3.75] "s"  DASy
 SG_ VFC_Oca061_ObjIdRef : 214|6@1+ (1,0) [1|63] ""  DASy
 SG_ VFC_Oca061_CorridorTypeRef : 220|3@1+ (1,0) [0|7] ""  DASy
 SG_ VFC_Oca061_ObjPosition : 223|3@1+ (1,0) [0|7] ""  DASy
 SG_ VFC_Oca061_CorridorOverlap : 226|5@1+ (5,0) [0|100] "%"  DASy
 SG_ VFC_Oca061_InMeasuredLines : 231|1@1+ (1,0) [0|1] ""  DASy
 SG_ VFC_Oca061_TimeToEnterCorridor : 232|4@1+ (0.25,0) [0|3.75] "s"  DASy
 SG_ VFC_Oca061_TimeToLeaveCorridor : 236|4@1+ (0.25,0) [0|3.75] "s"  DASy
 SG_ VFC_Oca062_ObjIdRef : 240|6@1+ (1,0) [1|63] ""  DASy
 SG_ VFC_Oca062_CorridorTypeRef : 246|3@1+ (1,0) [0|7] ""  DASy
 SG_ VFC_Oca062_ObjPosition : 249|3@1+ (1,0) [0|7] ""  DASy
 SG_ VFC_Oca062_CorridorOverlap : 252|5@1+ (5,0) [0|100] "%"  DASy
 SG_ VFC_Oca062_InMeasuredLines : 257|1@1+ (1,0) [0|1] ""  DASy
 SG_ VFC_Oca062_TimeToEnterCorridor : 258|4@1+ (0.25,0) [0|3.75] "s"  DASy
 SG_ VFC_Oca062_TimeToLeaveCorridor : 262|4@1+ (0.25,0) [0|3.75] "s"  DASy
 SG_ VFC_Oca063_ObjIdRef : 266|6@1+ (1,0) [1|63] ""  DASy
 SG_ VFC_Oca063_CorridorTypeRef : 272|3@1+ (1,0) [0|7] ""  DASy
 SG_ VFC_Oca063_ObjPosition : 275|3@1+ (1,0) [0|7] ""  DASy
 SG_ VFC_Oca063_CorridorOverlap : 278|5@1+ (5,0) [0|100] "%"  DASy
 SG_ VFC_Oca063_InMeasuredLines : 283|1@1+ (1,0) [0|1] ""  DASy
 SG_ VFC_Oca063_TimeToEnterCorridor : 284|4@1+ (0.25,0) [0|3.75] "s"  DASy
 SG_ VFC_Oca063_TimeToLeaveCorridor : 288|4@1+ (0.25,0) [0|3.75] "s"  DASy
 SG_ VFC_Oca064_ObjIdRef : 292|6@1+ (1,0) [1|63] ""  DASy
 SG_ VFC_Oca064_CorridorTypeRef : 298|3@1+ (1,0) [0|7] ""  DASy
 SG_ VFC_Oca064_ObjPosition : 301|3@1+ (1,0) [0|7] ""  DASy
 SG_ VFC_Oca064_CorridorOverlap : 304|5@1+ (5,0) [0|100] "%"  DASy
 SG_ VFC_Oca064_InMeasuredLines : 309|1@1+ (1,0) [0|1] ""  DASy
 SG_ VFC_Oca064_TimeToEnterCorridor : 310|4@1+ (0.25,0) [0|3.75] "s"  DASy
 SG_ VFC_Oca064_TimeToLeaveCorridor : 314|4@1+ (0.25,0) [0|3.75] "s"  DASy
 SG_ VFC_Oca065_ObjIdRef : 318|6@1+ (1,0) [1|63] ""  DASy
 SG_ VFC_Oca065_CorridorTypeRef : 324|3@1+ (1,0) [0|7] ""  DASy
 SG_ VFC_Oca065_ObjPosition : 327|3@1+ (1,0) [0|7] ""  DASy
 SG_ VFC_Oca065_CorridorOverlap : 330|5@1+ (5,0) [0|100] "%"  DASy
 SG_ VFC_Oca065_InMeasuredLines : 335|1@1+ (1,0) [0|1] ""  DASy
 SG_ VFC_Oca065_TimeToEnterCorridor : 336|4@1+ (0.25,0) [0|3.75] "s"  DASy
 SG_ VFC_Oca065_TimeToLeaveCorridor : 340|4@1+ (0.25,0) [0|3.75] "s"  DASy
 SG_ VFC_Oca066_ObjIdRef : 344|6@1+ (1,0) [1|63] ""  DASy
 SG_ VFC_Oca066_CorridorTypeRef : 350|3@1+ (1,0) [0|7] ""  DASy
 SG_ VFC_Oca066_ObjPosition : 353|3@1+ (1,0) [0|7] ""  DASy
 SG_ VFC_Oca066_CorridorOverlap : 356|5@1+ (5,0) [0|100] "%"  DASy
 SG_ VFC_Oca066_InMeasuredLines : 361|1@1+ (1,0) [0|1] ""  DASy
 SG_ VFC_Oca066_TimeToEnterCorridor : 362|4@1+ (0.25,0) [0|3.75] "s"  DASy
 SG_ VFC_Oca066_TimeToLeaveCorridor : 366|4@1+ (0.25,0) [0|3.75] "s"  DASy
 SG_ VFC_Oca067_ObjIdRef : 370|6@1+ (1,0) [1|63] ""  DASy
 SG_ VFC_Oca067_CorridorTypeRef : 376|3@1+ (1,0) [0|7] ""  DASy
 SG_ VFC_Oca067_ObjPosition : 379|3@1+ (1,0) [0|7] ""  DASy
 SG_ VFC_Oca067_CorridorOverlap : 382|5@1+ (5,0) [0|100] "%"  DASy
 SG_ VFC_Oca067_InMeasuredLines : 387|1@1+ (1,0) [0|1] ""  DASy
 SG_ VFC_Oca067_TimeToEnterCorridor : 388|4@1+ (0.25,0) [0|3.75] "s"  DASy
 SG_ VFC_Oca067_TimeToLeaveCorridor : 392|4@1+ (0.25,0) [0|3.75] "s"  DASy
 SG_ VFC_Oca068_ObjIdRef : 396|6@1+ (1,0) [1|63] ""  DASy
 SG_ VFC_Oca068_CorridorTypeRef : 402|3@1+ (1,0) [0|7] ""  DASy
 SG_ VFC_Oca068_ObjPosition : 405|3@1+ (1,0) [0|7] ""  DASy
 SG_ VFC_Oca068_CorridorOverlap : 408|5@1+ (5,0) [0|100] "%"  DASy
 SG_ VFC_Oca068_InMeasuredLines : 413|1@1+ (1,0) [0|1] ""  DASy
 SG_ VFC_Oca068_TimeToEnterCorridor : 414|4@1+ (0.25,0) [0|3.75] "s"  DASy
 SG_ VFC_Oca068_TimeToLeaveCorridor : 418|4@1+ (0.25,0) [0|3.75] "s"  DASy
 SG_ VFC_Oca069_ObjIdRef : 422|6@1+ (1,0) [1|63] ""  DASy
 SG_ VFC_Oca069_CorridorTypeRef : 428|3@1+ (1,0) [0|7] ""  DASy
 SG_ VFC_Oca069_ObjPosition : 431|3@1+ (1,0) [0|7] ""  DASy
 SG_ VFC_Oca069_CorridorOverlap : 434|5@1+ (5,0) [0|100] "%"  DASy
 SG_ VFC_Oca069_InMeasuredLines : 439|1@1+ (1,0) [0|1] ""  DASy
 SG_ VFC_Oca069_TimeToEnterCorridor : 440|4@1+ (0.25,0) [0|3.75] "s"  DASy
 SG_ VFC_Oca069_TimeToLeaveCorridor : 444|4@1+ (0.25,0) [0|3.75] "s"  DASy
 SG_ VFC_Oca070_ObjIdRef : 448|6@1+ (1,0) [1|63] ""  DASy
 SG_ VFC_Oca070_CorridorTypeRef : 454|3@1+ (1,0) [0|7] ""  DASy
 SG_ VFC_Oca070_ObjPosition : 457|3@1+ (1,0) [0|7] ""  DASy
 SG_ VFC_Oca070_CorridorOverlap : 460|5@1+ (5,0) [0|100] "%"  DASy
 SG_ VFC_Oca070_InMeasuredLines : 465|1@1+ (1,0) [0|1] ""  DASy
 SG_ VFC_Oca070_TimeToEnterCorridor : 466|4@1+ (0.25,0) [0|3.75] "s"  DASy
 SG_ VFC_Oca070_TimeToLeaveCorridor : 470|4@1+ (0.25,0) [0|3.75] "s"  DASy
 SG_ VFC_Oca071_ObjIdRef : 474|6@1+ (1,0) [1|63] ""  DASy
 SG_ VFC_Oca071_CorridorTypeRef : 480|3@1+ (1,0) [0|7] ""  DASy
 SG_ VFC_Oca071_ObjPosition : 483|3@1+ (1,0) [0|7] ""  DASy
 SG_ VFC_Oca071_CorridorOverlap : 486|5@1+ (5,0) [0|100] "%"  DASy
 SG_ VFC_Oca071_InMeasuredLines : 491|1@1+ (1,0) [0|1] ""  DASy
 SG_ VFC_Oca071_TimeToEnterCorridor : 492|4@1+ (0.25,0) [0|3.75] "s"  DASy
 SG_ VFC_Oca071_TimeToLeaveCorridor : 496|4@1+ (0.25,0) [0|3.75] "s"  DASy

BO_ 128 VFC_RoadHdr: 24 VideoFrontCenter
 SG_ VFC_RoadHdr_CRC : 0|16@1+ (1,0) [0|65535] ""  DASy
 SG_ VFC_RoadHdr_AliveCtr : 16|8@1+ (1,0) [0|255] ""  DASy
 SG_ VFC_RoadHdr_ProtBlockCtr : 24|4@1+ (1,0) [0|15] ""  DASy
 SG_ VFC_RoadHdr_IfVersionIdMajor : 32|8@1+ (1,0) [0|255] ""  DASy
 SG_ VFC_RoadHdr_IfVersionIdMinor : 40|8@1+ (1,0) [0|255] ""  DASy
 SG_ VFC_RoadHdr_NumValidPolynomials : 48|5@1+ (1,0) [0|31] ""  DASy
 SG_ VFC_RoadHdr_RoadType : 54|2@1+ (1,0) [0|3] ""  DASy
 SG_ VFC_RoadHdr_TimeStampStatus : 56|8@1+ (1,0) [0|255] ""  DASy
 SG_ VFC_RoadHdr_TimeStamp : 64|26@1+ (1,0) [0|67108863] "ms"  DASy
 SG_ VFC_RoadHdr_SensorStatus : 96|3@1+ (1,0) [0|7] ""  DASy
 SG_ VFC_RoadHdr_NumValid2DPolynomial : 112|5@1+ (1,0) [0|31] ""  DASy
 SG_ VFC_RoadHdr_RoadSurfCondType : 118|2@1+ (1,0) [0|3] ""  DASy
 SG_ VFC_RoadHdr_NumValidRoadMarkings : 120|5@1+ (1,0) [0|31] ""  DASy
 SG_ VFC_RoadHdr_RoadTypeConf : 126|1@1+ (100,0) [0|100] "%"  DASy
 SG_ VFC_RoadHdr_RoadSurCondTypeConf : 127|1@1+ (100,0) [0|100] "%"  DASy
 SG_ VFC_RoadHdr_2DNormVMean : 128|12@1+ (1,0) [0|4095] "pixel"  DASy
 SG_ VFC_RoadHdr_2DNormVMeanStdDev : 140|11@1+ (1,0) [0|2047] "pixel"  DASy
 SG_ VFC_RoadHdr_NumValidClothoids : 151|5@1+ (1,0) [0|31] ""  DASy

BO_ 130 VFC_RoadClothoid_00_02: 64 VideoFrontCenter
 SG_ VFC_Cloth_00_02_CRC : 0|16@1+ (1,0) [0|65535] ""  DASy
 SG_ VFC_Cloth_00_02_AliveCtr : 16|8@1+ (1,0) [0|255] ""  DASy
 SG_ VFC_Cloth_00_02_ProtBlockCtr : 24|4@1+ (1,0) [0|15] ""  DASy
 SG_ VFC_Cloth00_LaneAssociation : 32|4@1+ (1,0) [0|15] ""  DASy
 SG_ VFC_Cloth00_Colour : 37|3@1+ (1,0) [0|7] ""  DASy
 SG_ VFC_Cloth00_RangeXBegin : 40|9@1+ (0.25,0) [0|127.75] "m"  DASy
 SG_ VFC_Cloth00_RangeXEnd : 49|9@1+ (0.5,0) [0|255.5] "m"  DASy
 SG_ VFC_Cloth00_ExistProb : 58|6@1+ (2,0) [0|100] "%"  DASy
 SG_ VFC_Cloth00_CurvChange : 64|24@1+ (1.86264514923096E-009,-0.015625) [-0.015625|0.0156249981373549] "1/m^2"  DASy
 SG_ VFC_Cloth00_Curv : 88|15@1+ (3.814697265625E-006,-0.0625) [-0.0625|0.0624961853027344] "1/m"  DASy
 SG_ VFC_Cloth00_PyStdDev : 103|9@1+ (0.0078125,0) [0|3.9921875] "m"  DASy
 SG_ VFC_Cloth00_Py : 112|12@1+ (0.0078125,-16) [-16|15.9921875] "m"  DASy
 SG_ VFC_Cloth00_OrientationYaw : 124|12@1+ (0.00048828125,-1) [-1|0.99951171875] "rad"  DASy
 SG_ VFC_Cloth00_Width : 136|8@1+ (0.01,0) [0|2.55] "m"  DASy
 SG_ VFC_Cloth00_Type : 144|4@1+ (1,0) [0|15] ""  DASy
 SG_ VFC_Cloth01_LaneAssociation : 192|4@1+ (1,0) [0|15] ""  DASy
 SG_ VFC_Cloth01_Colour : 197|3@1+ (1,0) [0|7] ""  DASy
 SG_ VFC_Cloth01_RangeXBegin : 200|9@1+ (0.25,0) [0|127.75] "m"  DASy
 SG_ VFC_Cloth01_RangeXEnd : 209|9@1+ (0.5,0) [0|255.5] "m"  DASy
 SG_ VFC_Cloth01_ExistProb : 218|6@1+ (2,0) [0|100] "%"  DASy
 SG_ VFC_Cloth01_CurvChange : 224|24@1+ (1.86264514923096E-009,-0.015625) [-0.015625|0.0156249981373549] "1/m^2"  DASy
 SG_ VFC_Cloth01_Curv : 248|15@1+ (3.814697265625E-006,-0.0625) [-0.0625|0.0624961853027344] "1/m"  DASy
 SG_ VFC_Cloth01_PyStdDev : 263|9@1+ (0.0078125,0) [0|3.9921875] "m"  DASy
 SG_ VFC_Cloth01_Py : 272|12@1+ (0.0078125,-16) [-16|15.9921875] "m"  DASy
 SG_ VFC_Cloth01_OrientationYaw : 284|12@1+ (0.00048828125,-1) [-1|0.99951171875] "rad"  DASy
 SG_ VFC_Cloth01_Width : 296|8@1+ (0.01,0) [0|2.55] "m"  DASy
 SG_ VFC_Cloth01_Type : 304|4@1+ (1,0) [0|15] ""  DASy
 SG_ VFC_Cloth02_LaneAssociation : 352|4@1+ (1,0) [0|15] ""  DASy
 SG_ VFC_Cloth02_Colour : 357|3@1+ (1,0) [0|7] ""  DASy
 SG_ VFC_Cloth02_RangeXBegin : 360|9@1+ (0.25,0) [0|127.75] "m"  DASy
 SG_ VFC_Cloth02_RangeXEnd : 369|9@1+ (0.5,0) [0|255.5] "m"  DASy
 SG_ VFC_Cloth02_ExistProb : 378|6@1+ (2,0) [0|100] "%"  DASy
 SG_ VFC_Cloth02_CurvChange : 384|24@1+ (1.86264514923096E-009,-0.015625) [-0.015625|0.0156249981373549] "1/m^2"  DASy
 SG_ VFC_Cloth02_Curv : 408|15@1+ (3.814697265625E-006,-0.0625) [-0.0625|0.0624961853027344] "1/m"  DASy
 SG_ VFC_Cloth02_PyStdDev : 423|9@1+ (0.0078125,0) [0|3.9921875] "m"  DASy
 SG_ VFC_Cloth02_Py : 432|12@1+ (0.0078125,-16) [-16|15.9921875] "m"  DASy
 SG_ VFC_Cloth02_OrientationYaw : 444|12@1+ (0.00048828125,-1) [-1|0.99951171875] "rad"  DASy
 SG_ VFC_Cloth02_Width : 456|8@1+ (0.01,0) [0|2.55] "m"  DASy
 SG_ VFC_Cloth02_Type : 464|4@1+ (1,0) [0|15] ""  DASy

CM_ SG_ 75 VFC_Obj21_CRC "CRC - Autosar E2E Profile 5";
CM_ SG_ 75 VFC_Obj21_AliveCtr "Alive counter - Autosar E2E Profile 5";
CM_ SG_ 75 VFC_Obj21_ProtBlockCtr "Protocol-Signal: Block-Counter";
CM_ SG_ 75 VFC_Obj21_ExistProb "Object existence probability. ISO 23150:2023: Existence probability - object level (A.2.1)";
CM_ SG_ 75 VFC_Obj21_MeasurementStatus "Indicator if the object detected is measured or predicted. ISO 23150:2023: Measurement status - object level (A.2.9)";
CM_ SG_ 75 VFC_Obj21_ObjId "Unique Object ID. ISO 23150:2023: Object ID (A.2.2)";
CM_ SG_ 75 VFC_Obj21_Type "Classification of the object. ISO 23150:2023: Potentially moving object classification type (A.2.12)";
CM_ SG_ 75 VFC_Obj21_TypeConf "Confidence of the classified object type. ISO 23150:2023: Potentially moving object classification type - confidence (A.2.13)";
CM_ SG_ 75 VFC_Obj21_VisibleView "The visible view of the detected object. Reference point is in the middle of CLASSIC (front/rear) or SIDE (left/right). Related to ISO 23150:2023: Reference point (A.2.14)";
CM_ SG_ 75 VFC_Obj21_ClassifiedView "The classified view of object to be used in connection with VisibleView and Heading angle. Related to ISO 23150:2023: Reference point (A.2.14)";
CM_ SG_ 75 VFC_Obj21_Px "Object distance in longitudinal direction. ISO 23150:2023: Position - object level {x, y, z} (A.2.15)";
CM_ SG_ 75 VFC_Obj21_Py "Object distance in lateral direction. ISO 23150:2023: Position - object level {x, y, z} (A.2.15)";
CM_ SG_ 75 VFC_Obj21_PxStdDev "Standard deviation of Object distance in longitudinal direction. ISO 23150:2023: Position - object level {x, y, z} - error (A.2.16)";
CM_ SG_ 75 VFC_Obj21_PyStdDev "Standard deviation of Object distance in lateral direction. ISO 23150:2023: Position - object level {x, y, z} - error (A.2.16)";
CM_ SG_ 75 VFC_Obj21_OrientationYaw "Heading angle of the object. ISO 23150:2023: Orientation {yaw, pitch, roll} (A.2.17)";
CM_ SG_ 75 VFC_Obj21_OrientationYawStdDev "Standard deviation of object Heading angle. ISO 23150:2023: Orientation {yaw, pitch, roll} - error (A.2.18)";
CM_ SG_ 75 VFC_Obj21_Length "Length of the object. ISO 23150:2023: Bounding box extent {length, width, height} (A.2.20)";
CM_ SG_ 75 VFC_Obj21_Width "Width of the object. ISO 23150:2023: Bounding box extent {length, width, height} (A.2.20)";
CM_ SG_ 75 VFC_Obj21_Height "Height of the object. ISO 23150:2023: Bounding box extent {length, width, height} (A.2.20)";
CM_ SG_ 75 VFC_Obj21_LengthStdDev "Standard deviation of object length. ISO 23150:2023: Bounding box extent {length, width, height} - error (A.2.21)";
CM_ SG_ 75 VFC_Obj21_WidthStdDev "Standard deviation of object width. ISO 23150:2023: Bounding box extent {length, width, height} - error (A.2.21)";
CM_ SG_ 75 VFC_Obj21_HeightStdDev "Standard deviation of object height. ISO 23150:2023: Bounding box extent {length, width, height} - error (A.2.21)";
CM_ SG_ 75 VFC_Obj21_Vx "Object velocity in longitudinal direction. ISO 23150:2023: Velocity {x, y, z} - object level (A.2.24)";
CM_ SG_ 75 VFC_Obj21_Vy "Object velocity in lateral direction. ISO 23150:2023: Velocity {x, y, z} - object level (A.2.24)";
CM_ SG_ 75 VFC_Obj21_VxStdDev "Standard deviation of Object velocity in longitudinal direction. ISO 23150:2023: Velocity {x, y, z} - object level - error (A.2.25)";
CM_ SG_ 75 VFC_Obj21_VyStdDev "Standard deviation of Object velocity in lateral direction. ISO 23150:2023: Velocity {x, y, z} - object level - error (A.2.25)";
CM_ SG_ 75 VFC_Obj21_Ax "Object acceleration in longitudinal direction. ISO 23150:2023: Acceleration {x, y, z} (A.2.26)";
CM_ SG_ 75 VFC_Obj21_LightStatTurnIndicator "The detected direction indicator lights. Similar to ISO 23150:2023: Light status (A.2.35)";
CM_ SG_ 75 VFC_Obj21_Ay "Object acceleration in lateral direction. ISO 23150:2023: Acceleration {x, y, z} (A.2.26)";
CM_ SG_ 75 VFC_Obj21_AxStdDev "Standard deviation of Object acceleration in longitudinal direction. ISO 23150:2023: Acceleration {x, y, z} - error (A.2.27)";
CM_ SG_ 75 VFC_Obj21_AyStdDev "Standard deviation of Object acceleration in lateral direction. ISO 23150:2023: Acceleration {x, y, z} - error (A.2.27)";
CM_ SG_ 75 VFC_Obj21_MovementProbLat "Probability of object moving laterally (current state, not if moved at all in object history). Related to ISO 23150:2023: Movement status (A.2.32)";
CM_ SG_ 75 VFC_Obj21_MovementProbLong "Probability of object moving longitudinally (current state, not if moved at all in object history). Related to ISO 23150:2023: Movement status (A.2.32)";
CM_ SG_ 75 VFC_Obj21_2DAngPosEdgeLeft "Bounding box left edge in sensor coordinate system in ACCS coordinates; corresponds to tan(viewing angle of  object edge). ISO 23150:2023: Angular position {azimuth} (A.2.68)";
CM_ SG_ 75 VFC_Obj21_2DAngPosEdgeRight "Bounding box right edge in sensor coordinate system in ACCS coordinates; corresponds to tan(viewing angle of  object edge). ISO 23150:2023: Angular position {azimuth} (A.2.68)";
CM_ SG_ 75 VFC_Obj21_2DAngPosEdgeFar "Bounding box far edge in sensor coordinate system in ACCS coordinates; corresponds to tan(viewing angle of  object edge). ISO 23150:2023: Angular position {azimuth} (A.2.68)";
CM_ SG_ 75 VFC_Obj21_2DAngPosEdgeBot "Bounding box bottom edge in sensor coordinate system in ACCS coordinates; corresponds to tan(viewing angle of  object edge). Sign: upward direction negative value. ISO 23150:2023: Angular position {azimuth} (A.2.68)";
CM_ SG_ 75 VFC_Obj21_OutsideRoad "2D object is located outside road boundary (if signal is available)";
CM_ SG_ 75 VFC_Obj21_2DAngPosEdgeLeftStdDev "Standard deviation of the bounding box left edge";
CM_ SG_ 75 VFC_Obj21_2DAngPosEdgeRightStdDe "Standard deviation of the bounding box right edge";
CM_ SG_ 75 VFC_Obj21_2DAngPosEdgeFarStdDev "Standard deviation of the bounding box far edge";
CM_ SG_ 75 VFC_Obj21_2DAngPosEdgeBotStdDev "Standard deviation of the bounding box bottom edge";
CM_ SG_ 75 VFC_Obj21_2DNormVx "Normalised Object velocity in longitudinal direction (vx/dx_cam). Related to ISO 23150:2023: Angular velocity {azimuth} (A.2.69)";
CM_ SG_ 75 VFC_Obj21_2DNormVy "Normalised Object velocity in lateral direction (vy/dx_cam)";
CM_ SG_ 75 VFC_Obj21_2DNormAx "Normalised Object acceleration in longitudinal direction (ax/dx_cam)";
CM_ SG_ 75 VFC_Obj21_2DNormVxStdDev "Standard deviation of Normalised Object velocity in longitudinal direction";
CM_ SG_ 75 VFC_Obj21_MeasurementSource "Bitfield for the measurement programs from which this object originates
Bit 0: MOD
Bit 1: PDET
Bit 2: OFT
Bit 3: INVALID";
CM_ SG_ 75 VFC_Obj21_2DNormVyStdDev "Standard deviation of Normalised Object velocity in lateral direction";
CM_ SG_ 75 VFC_Obj21_2DNormAxStdDev "Standard deviation of Normalised Object acceleration in longitudinal direction";
CM_ SG_ 75 VFC_Obj21_2DScaleChange "Change in scale of the object in sensor's projection plane. ISO 23150:2023: Scale change - object level (A.2.70)";
CM_ SG_ 75 VFC_Obj21_2DScaleChangeStdDev "Standard deviation of object scale change";
CM_ SG_ 75 VFC_Obj21_Reliability "The bitfield shows if the signal quality is assumed to be sufficient for functions with safety target -no false positives-
Bit 0: DYNAMIC
Bit 1: SEMSEG_SURFACE
Bit 2: WDD_CRITICAL
Bit 3: GOD_CONFIRMED
Bit 4: RESTRICTED
Bit 5: ISO26262_SAFE";
CM_ SG_ 75 VFC_Obj21_LightStatBrakeLight "The number of detected lights. More confident if more lights are detected. Similar to ISO 23150:2023: Light status (A.2.35)";
CM_ SG_ 75 VFC_Obj21_OutsideRoadMeasStatus "2D object outside road boundary measurement status, indicator if it is measured or predicted (if signal is available)";
CM_ SG_ 75 VFC_Obj21_Oncoming "Object is oncoming (if signal is available)";
CM_ SG_ 75 VFC_Obj21_OncomingMeasStatus "Object oncoming measurement status, indicator if it is measured or predicted (if signal is available)";
CM_ SG_ 75 VFC_Obj21_MovementStanding "Object is standing (if signal is available). Related to ISO 23150:2023: Movement status (A.2.32)";
CM_ SG_ 75 VFC_Obj21_MovementStandingMeasSt "Object standing measurement status, indicator if it is measured or predicted (if signal is available)";
CM_ SG_ 75 VFC_Obj21_MovementObserved "Object has been observed moving over the ground since it was first detected (if signal is available). Related to ISO 23150:2023: Movement status (A.2.32)";
CM_ SG_ 75 VFC_Obj21_MovementObservedMeasSt "Measurement status for object has been observed moving (if signal is available)";
CM_ SG_ 75 VFC_Obj21_TargetObjTypeAcc "2D target object type for ACC (if signal is available)";
CM_ SG_ 75 VFC_Obj21_TargetObjTypeAccConf "Confidence of 2D target object type detection for ACC (if signal is available)";
CM_ SG_ 76 VFC_Obj22_CRC "CRC - Autosar E2E Profile 5";
CM_ SG_ 76 VFC_Obj22_AliveCtr "Alive counter - Autosar E2E Profile 5";
CM_ SG_ 76 VFC_Obj22_ProtBlockCtr "Protocol-Signal: Block-Counter";
CM_ SG_ 76 VFC_Obj22_ExistProb "Object existence probability. ISO 23150:2023: Existence probability - object level (A.2.1)";
CM_ SG_ 76 VFC_Obj22_MeasurementStatus "Indicator if the object detected is measured or predicted. ISO 23150:2023: Measurement status - object level (A.2.9)";
CM_ SG_ 76 VFC_Obj22_ObjId "Unique Object ID. ISO 23150:2023: Object ID (A.2.2)";
CM_ SG_ 76 VFC_Obj22_Type "Classification of the object. ISO 23150:2023: Potentially moving object classification type (A.2.12)";
CM_ SG_ 76 VFC_Obj22_TypeConf "Confidence of the classified object type. ISO 23150:2023: Potentially moving object classification type - confidence (A.2.13)";
CM_ SG_ 76 VFC_Obj22_VisibleView "The visible view of the detected object. Reference point is in the middle of CLASSIC (front/rear) or SIDE (left/right). Related to ISO 23150:2023: Reference point (A.2.14)";
CM_ SG_ 76 VFC_Obj22_ClassifiedView "The classified view of object to be used in connection with VisibleView and Heading angle. Related to ISO 23150:2023: Reference point (A.2.14)";
CM_ SG_ 76 VFC_Obj22_Px "Object distance in longitudinal direction. ISO 23150:2023: Position - object level {x, y, z} (A.2.15)";
CM_ SG_ 76 VFC_Obj22_Py "Object distance in lateral direction. ISO 23150:2023: Position - object level {x, y, z} (A.2.15)";
CM_ SG_ 76 VFC_Obj22_PxStdDev "Standard deviation of Object distance in longitudinal direction. ISO 23150:2023: Position - object level {x, y, z} - error (A.2.16)";
CM_ SG_ 76 VFC_Obj22_PyStdDev "Standard deviation of Object distance in lateral direction. ISO 23150:2023: Position - object level {x, y, z} - error (A.2.16)";
CM_ SG_ 76 VFC_Obj22_OrientationYaw "Heading angle of the object. ISO 23150:2023: Orientation {yaw, pitch, roll} (A.2.17)";
CM_ SG_ 76 VFC_Obj22_OrientationYawStdDev "Standard deviation of object Heading angle. ISO 23150:2023: Orientation {yaw, pitch, roll} - error (A.2.18)";
CM_ SG_ 76 VFC_Obj22_Length "Length of the object. ISO 23150:2023: Bounding box extent {length, width, height} (A.2.20)";
CM_ SG_ 76 VFC_Obj22_Width "Width of the object. ISO 23150:2023: Bounding box extent {length, width, height} (A.2.20)";
CM_ SG_ 76 VFC_Obj22_Height "Height of the object. ISO 23150:2023: Bounding box extent {length, width, height} (A.2.20)";
CM_ SG_ 76 VFC_Obj22_LengthStdDev "Standard deviation of object length. ISO 23150:2023: Bounding box extent {length, width, height} - error (A.2.21)";
CM_ SG_ 76 VFC_Obj22_WidthStdDev "Standard deviation of object width. ISO 23150:2023: Bounding box extent {length, width, height} - error (A.2.21)";
CM_ SG_ 76 VFC_Obj22_HeightStdDev "Standard deviation of object height. ISO 23150:2023: Bounding box extent {length, width, height} - error (A.2.21)";
CM_ SG_ 76 VFC_Obj22_Vx "Object velocity in longitudinal direction. ISO 23150:2023: Velocity {x, y, z} - object level (A.2.24)";
CM_ SG_ 76 VFC_Obj22_Vy "Object velocity in lateral direction. ISO 23150:2023: Velocity {x, y, z} - object level (A.2.24)";
CM_ SG_ 76 VFC_Obj22_VxStdDev "Standard deviation of Object velocity in longitudinal direction. ISO 23150:2023: Velocity {x, y, z} - object level - error (A.2.25)";
CM_ SG_ 76 VFC_Obj22_VyStdDev "Standard deviation of Object velocity in lateral direction. ISO 23150:2023: Velocity {x, y, z} - object level - error (A.2.25)";
CM_ SG_ 76 VFC_Obj22_Ax "Object acceleration in longitudinal direction. ISO 23150:2023: Acceleration {x, y, z} (A.2.26)";
CM_ SG_ 76 VFC_Obj22_LightStatTurnIndicator "The detected direction indicator lights. Similar to ISO 23150:2023: Light status (A.2.35)";
CM_ SG_ 76 VFC_Obj22_Ay "Object acceleration in lateral direction. ISO 23150:2023: Acceleration {x, y, z} (A.2.26)";
CM_ SG_ 76 VFC_Obj22_AxStdDev "Standard deviation of Object acceleration in longitudinal direction. ISO 23150:2023: Acceleration {x, y, z} - error (A.2.27)";
CM_ SG_ 76 VFC_Obj22_AyStdDev "Standard deviation of Object acceleration in lateral direction. ISO 23150:2023: Acceleration {x, y, z} - error (A.2.27)";
CM_ SG_ 76 VFC_Obj22_MovementProbLat "Probability of object moving laterally (current state, not if moved at all in object history). Related to ISO 23150:2023: Movement status (A.2.32)";
CM_ SG_ 76 VFC_Obj22_MovementProbLong "Probability of object moving longitudinally (current state, not if moved at all in object history). Related to ISO 23150:2023: Movement status (A.2.32)";
CM_ SG_ 76 VFC_Obj22_2DAngPosEdgeLeft "Bounding box left edge in sensor coordinate system in ACCS coordinates; corresponds to tan(viewing angle of  object edge). ISO 23150:2023: Angular position {azimuth} (A.2.68)";
CM_ SG_ 76 VFC_Obj22_2DAngPosEdgeRight "Bounding box right edge in sensor coordinate system in ACCS coordinates; corresponds to tan(viewing angle of  object edge). ISO 23150:2023: Angular position {azimuth} (A.2.68)";
CM_ SG_ 76 VFC_Obj22_2DAngPosEdgeFar "Bounding box far edge in sensor coordinate system in ACCS coordinates; corresponds to tan(viewing angle of  object edge). ISO 23150:2023: Angular position {azimuth} (A.2.68)";
CM_ SG_ 76 VFC_Obj22_2DAngPosEdgeBot "Bounding box bottom edge in sensor coordinate system in ACCS coordinates; corresponds to tan(viewing angle of  object edge). Sign: upward direction negative value. ISO 23150:2023: Angular position {azimuth} (A.2.68)";
CM_ SG_ 76 VFC_Obj22_OutsideRoad "2D object is located outside road boundary (if signal is available)";
CM_ SG_ 76 VFC_Obj22_2DAngPosEdgeLeftStdDev "Standard deviation of the bounding box left edge";
CM_ SG_ 76 VFC_Obj22_2DAngPosEdgeRightStdDe "Standard deviation of the bounding box right edge";
CM_ SG_ 76 VFC_Obj22_2DAngPosEdgeFarStdDev "Standard deviation of the bounding box far edge";
CM_ SG_ 76 VFC_Obj22_2DAngPosEdgeBotStdDev "Standard deviation of the bounding box bottom edge";
CM_ SG_ 76 VFC_Obj22_2DNormVx "Normalised Object velocity in longitudinal direction (vx/dx_cam). Related to ISO 23150:2023: Angular velocity {azimuth} (A.2.69)";
CM_ SG_ 76 VFC_Obj22_2DNormVy "Normalised Object velocity in lateral direction (vy/dx_cam)";
CM_ SG_ 76 VFC_Obj22_2DNormAx "Normalised Object acceleration in longitudinal direction (ax/dx_cam)";
CM_ SG_ 76 VFC_Obj22_2DNormVxStdDev "Standard deviation of Normalised Object velocity in longitudinal direction";
CM_ SG_ 76 VFC_Obj22_MeasurementSource "Bitfield for the measurement programs from which this object originates
Bit 0: MOD
Bit 1: PDET
Bit 2: OFT
Bit 3: INVALID";
CM_ SG_ 76 VFC_Obj22_2DNormVyStdDev "Standard deviation of Normalised Object velocity in lateral direction";
CM_ SG_ 76 VFC_Obj22_2DNormAxStdDev "Standard deviation of Normalised Object acceleration in longitudinal direction";
CM_ SG_ 76 VFC_Obj22_2DScaleChange "Change in scale of the object in sensor's projection plane. ISO 23150:2023: Scale change - object level (A.2.70)";
CM_ SG_ 76 VFC_Obj22_2DScaleChangeStdDev "Standard deviation of object scale change";
CM_ SG_ 76 VFC_Obj22_Reliability "The bitfield shows if the signal quality is assumed to be sufficient for functions with safety target -no false positives-
Bit 0: DYNAMIC
Bit 1: SEMSEG_SURFACE
Bit 2: WDD_CRITICAL
Bit 3: GOD_CONFIRMED
Bit 4: RESTRICTED
Bit 5: ISO26262_SAFE";
CM_ SG_ 76 VFC_Obj22_LightStatBrakeLight "The number of detected lights. More confident if more lights are detected. Similar to ISO 23150:2023: Light status (A.2.35)";
CM_ SG_ 76 VFC_Obj22_OutsideRoadMeasStatus "2D object outside road boundary measurement status, indicator if it is measured or predicted (if signal is available)";
CM_ SG_ 76 VFC_Obj22_Oncoming "Object is oncoming (if signal is available)";
CM_ SG_ 76 VFC_Obj22_OncomingMeasStatus "Object oncoming measurement status, indicator if it is measured or predicted (if signal is available)";
CM_ SG_ 76 VFC_Obj22_MovementStanding "Object is standing (if signal is available). Related to ISO 23150:2023: Movement status (A.2.32)";
CM_ SG_ 76 VFC_Obj22_MovementStandingMeasSt "Object standing measurement status, indicator if it is measured or predicted (if signal is available)";
CM_ SG_ 76 VFC_Obj22_MovementObserved "Object has been observed moving over the ground since it was first detected (if signal is available). Related to ISO 23150:2023: Movement status (A.2.32)";
CM_ SG_ 76 VFC_Obj22_MovementObservedMeasSt "Measurement status for object has been observed moving (if signal is available)";
CM_ SG_ 76 VFC_Obj22_TargetObjTypeAcc "2D target object type for ACC (if signal is available)";
CM_ SG_ 76 VFC_Obj22_TargetObjTypeAccConf "Confidence of 2D target object type detection for ACC (if signal is available)";
CM_ SG_ 77 VFC_Obj23_CRC "CRC - Autosar E2E Profile 5";
CM_ SG_ 77 VFC_Obj23_AliveCtr "Alive counter - Autosar E2E Profile 5";
CM_ SG_ 77 VFC_Obj23_ProtBlockCtr "Protocol-Signal: Block-Counter";
CM_ SG_ 77 VFC_Obj23_ExistProb "Object existence probability. ISO 23150:2023: Existence probability - object level (A.2.1)";
CM_ SG_ 77 VFC_Obj23_MeasurementStatus "Indicator if the object detected is measured or predicted. ISO 23150:2023: Measurement status - object level (A.2.9)";
CM_ SG_ 77 VFC_Obj23_ObjId "Unique Object ID. ISO 23150:2023: Object ID (A.2.2)";
CM_ SG_ 77 VFC_Obj23_Type "Classification of the object. ISO 23150:2023: Potentially moving object classification type (A.2.12)";
CM_ SG_ 77 VFC_Obj23_TypeConf "Confidence of the classified object type. ISO 23150:2023: Potentially moving object classification type - confidence (A.2.13)";
CM_ SG_ 77 VFC_Obj23_VisibleView "The visible view of the detected object. Reference point is in the middle of CLASSIC (front/rear) or SIDE (left/right). Related to ISO 23150:2023: Reference point (A.2.14)";
CM_ SG_ 77 VFC_Obj23_ClassifiedView "The classified view of object to be used in connection with VisibleView and Heading angle. Related to ISO 23150:2023: Reference point (A.2.14)";
CM_ SG_ 77 VFC_Obj23_Px "Object distance in longitudinal direction. ISO 23150:2023: Position - object level {x, y, z} (A.2.15)";
CM_ SG_ 77 VFC_Obj23_Py "Object distance in lateral direction. ISO 23150:2023: Position - object level {x, y, z} (A.2.15)";
CM_ SG_ 77 VFC_Obj23_PxStdDev "Standard deviation of Object distance in longitudinal direction. ISO 23150:2023: Position - object level {x, y, z} - error (A.2.16)";
CM_ SG_ 77 VFC_Obj23_PyStdDev "Standard deviation of Object distance in lateral direction. ISO 23150:2023: Position - object level {x, y, z} - error (A.2.16)";
CM_ SG_ 77 VFC_Obj23_OrientationYaw "Heading angle of the object. ISO 23150:2023: Orientation {yaw, pitch, roll} (A.2.17)";
CM_ SG_ 77 VFC_Obj23_OrientationYawStdDev "Standard deviation of object Heading angle. ISO 23150:2023: Orientation {yaw, pitch, roll} - error (A.2.18)";
CM_ SG_ 77 VFC_Obj23_Length "Length of the object. ISO 23150:2023: Bounding box extent {length, width, height} (A.2.20)";
CM_ SG_ 77 VFC_Obj23_Width "Width of the object. ISO 23150:2023: Bounding box extent {length, width, height} (A.2.20)";
CM_ SG_ 77 VFC_Obj23_Height "Height of the object. ISO 23150:2023: Bounding box extent {length, width, height} (A.2.20)";
CM_ SG_ 77 VFC_Obj23_LengthStdDev "Standard deviation of object length. ISO 23150:2023: Bounding box extent {length, width, height} - error (A.2.21)";
CM_ SG_ 77 VFC_Obj23_WidthStdDev "Standard deviation of object width. ISO 23150:2023: Bounding box extent {length, width, height} - error (A.2.21)";
CM_ SG_ 77 VFC_Obj23_HeightStdDev "Standard deviation of object height. ISO 23150:2023: Bounding box extent {length, width, height} - error (A.2.21)";
CM_ SG_ 77 VFC_Obj23_Vx "Object velocity in longitudinal direction. ISO 23150:2023: Velocity {x, y, z} - object level (A.2.24)";
CM_ SG_ 77 VFC_Obj23_Vy "Object velocity in lateral direction. ISO 23150:2023: Velocity {x, y, z} - object level (A.2.24)";
CM_ SG_ 77 VFC_Obj23_VxStdDev "Standard deviation of Object velocity in longitudinal direction. ISO 23150:2023: Velocity {x, y, z} - object level - error (A.2.25)";
CM_ SG_ 77 VFC_Obj23_VyStdDev "Standard deviation of Object velocity in lateral direction. ISO 23150:2023: Velocity {x, y, z} - object level - error (A.2.25)";
CM_ SG_ 77 VFC_Obj23_Ax "Object acceleration in longitudinal direction. ISO 23150:2023: Acceleration {x, y, z} (A.2.26)";
CM_ SG_ 77 VFC_Obj23_LightStatTurnIndicator "The detected direction indicator lights. Similar to ISO 23150:2023: Light status (A.2.35)";
CM_ SG_ 77 VFC_Obj23_Ay "Object acceleration in lateral direction. ISO 23150:2023: Acceleration {x, y, z} (A.2.26)";
CM_ SG_ 77 VFC_Obj23_AxStdDev "Standard deviation of Object acceleration in longitudinal direction. ISO 23150:2023: Acceleration {x, y, z} - error (A.2.27)";
CM_ SG_ 77 VFC_Obj23_AyStdDev "Standard deviation of Object acceleration in lateral direction. ISO 23150:2023: Acceleration {x, y, z} - error (A.2.27)";
CM_ SG_ 77 VFC_Obj23_MovementProbLat "Probability of object moving laterally (current state, not if moved at all in object history). Related to ISO 23150:2023: Movement status (A.2.32)";
CM_ SG_ 77 VFC_Obj23_MovementProbLong "Probability of object moving longitudinally (current state, not if moved at all in object history). Related to ISO 23150:2023: Movement status (A.2.32)";
CM_ SG_ 77 VFC_Obj23_2DAngPosEdgeLeft "Bounding box left edge in sensor coordinate system in ACCS coordinates; corresponds to tan(viewing angle of  object edge). ISO 23150:2023: Angular position {azimuth} (A.2.68)";
CM_ SG_ 77 VFC_Obj23_2DAngPosEdgeRight "Bounding box right edge in sensor coordinate system in ACCS coordinates; corresponds to tan(viewing angle of  object edge). ISO 23150:2023: Angular position {azimuth} (A.2.68)";
CM_ SG_ 77 VFC_Obj23_2DAngPosEdgeFar "Bounding box far edge in sensor coordinate system in ACCS coordinates; corresponds to tan(viewing angle of  object edge). ISO 23150:2023: Angular position {azimuth} (A.2.68)";
CM_ SG_ 77 VFC_Obj23_2DAngPosEdgeBot "Bounding box bottom edge in sensor coordinate system in ACCS coordinates; corresponds to tan(viewing angle of  object edge). Sign: upward direction negative value. ISO 23150:2023: Angular position {azimuth} (A.2.68)";
CM_ SG_ 77 VFC_Obj23_OutsideRoad "2D object is located outside road boundary (if signal is available)";
CM_ SG_ 77 VFC_Obj23_2DAngPosEdgeLeftStdDev "Standard deviation of the bounding box left edge";
CM_ SG_ 77 VFC_Obj23_2DAngPosEdgeRightStdDe "Standard deviation of the bounding box right edge";
CM_ SG_ 77 VFC_Obj23_2DAngPosEdgeFarStdDev "Standard deviation of the bounding box far edge";
CM_ SG_ 77 VFC_Obj23_2DAngPosEdgeBotStdDev "Standard deviation of the bounding box bottom edge";
CM_ SG_ 77 VFC_Obj23_2DNormVx "Normalised Object velocity in longitudinal direction (vx/dx_cam). Related to ISO 23150:2023: Angular velocity {azimuth} (A.2.69)";
CM_ SG_ 77 VFC_Obj23_2DNormVy "Normalised Object velocity in lateral direction (vy/dx_cam)";
CM_ SG_ 77 VFC_Obj23_2DNormAx "Normalised Object acceleration in longitudinal direction (ax/dx_cam)";
CM_ SG_ 77 VFC_Obj23_2DNormVxStdDev "Standard deviation of Normalised Object velocity in longitudinal direction";
CM_ SG_ 77 VFC_Obj23_MeasurementSource "Bitfield for the measurement programs from which this object originates
Bit 0: MOD
Bit 1: PDET
Bit 2: OFT
Bit 3: INVALID";
CM_ SG_ 77 VFC_Obj23_2DNormVyStdDev "Standard deviation of Normalised Object velocity in lateral direction";
CM_ SG_ 77 VFC_Obj23_2DNormAxStdDev "Standard deviation of Normalised Object acceleration in longitudinal direction";
CM_ SG_ 77 VFC_Obj23_2DScaleChange "Change in scale of the object in sensor's projection plane. ISO 23150:2023: Scale change - object level (A.2.70)";
CM_ SG_ 77 VFC_Obj23_2DScaleChangeStdDev "Standard deviation of object scale change";
CM_ SG_ 77 VFC_Obj23_Reliability "The bitfield shows if the signal quality is assumed to be sufficient for functions with safety target -no false positives-
Bit 0: DYNAMIC
Bit 1: SEMSEG_SURFACE
Bit 2: WDD_CRITICAL
Bit 3: GOD_CONFIRMED
Bit 4: RESTRICTED
Bit 5: ISO26262_SAFE";
CM_ SG_ 77 VFC_Obj23_LightStatBrakeLight "The number of detected lights. More confident if more lights are detected. Similar to ISO 23150:2023: Light status (A.2.35)";
CM_ SG_ 77 VFC_Obj23_OutsideRoadMeasStatus "2D object outside road boundary measurement status, indicator if it is measured or predicted (if signal is available)";
CM_ SG_ 77 VFC_Obj23_Oncoming "Object is oncoming (if signal is available)";
CM_ SG_ 77 VFC_Obj23_OncomingMeasStatus "Object oncoming measurement status, indicator if it is measured or predicted (if signal is available)";
CM_ SG_ 77 VFC_Obj23_MovementStanding "Object is standing (if signal is available). Related to ISO 23150:2023: Movement status (A.2.32)";
CM_ SG_ 77 VFC_Obj23_MovementStandingMeasSt "Object standing measurement status, indicator if it is measured or predicted (if signal is available)";
CM_ SG_ 77 VFC_Obj23_MovementObserved "Object has been observed moving over the ground since it was first detected (if signal is available). Related to ISO 23150:2023: Movement status (A.2.32)";
CM_ SG_ 77 VFC_Obj23_MovementObservedMeasSt "Measurement status for object has been observed moving (if signal is available)";
CM_ SG_ 77 VFC_Obj23_TargetObjTypeAcc "2D target object type for ACC (if signal is available)";
CM_ SG_ 77 VFC_Obj23_TargetObjTypeAccConf "Confidence of 2D target object type detection for ACC (if signal is available)";
CM_ SG_ 86 VFC_OcaHdr_CRC "CRC - Autosar E2E Profile 5";
CM_ SG_ 86 VFC_OcaHdr_AliveCtr "Alive counter - Autosar E2E Profile 5";
CM_ SG_ 86 VFC_OcaHdr_ProtBlockCtr "Protocol-Signal: Block-Counter";
CM_ SG_ 86 VFC_OcaHdr_IfVersionIdMajor "Version information of the interface. e. g. version 1.0: Major = 1. ISO 23150:2023: Interface version ID {major, minor, patch} (A.1.1)";
CM_ SG_ 86 VFC_OcaHdr_IfVersionIdMinor "Version information of the interface. e. g. version 1.0: Minor = 0. ISO 23150:2023: Interface version ID {major, minor, patch} (A.1.1)";
CM_ SG_ 86 VFC_OcaHdr_NumValidOCAs "Number of valid Object Corridor Associations (OCA)";
CM_ SG_ 86 VFC_OcaHdr_TimeStampStatus "Autosar StbM_TimeBaseStatusType bitfield with extension:
Bit 0: TIMEOUT
Bit 1: Reserved1
Bit 2: SYNC_TO_GATEWAY
Bit 3: GLOBAL_TIME_BASE
Bit 4: TIMELEAP_FUTURE
Bit 5: TIMELEAP_PAST
Bit 6: Reserved6
Bit 7: Extension: GENERAL_ERROR";
CM_ SG_ 86 VFC_OcaHdr_TimeStamp "ISO 23150:2023: Time stamp - prediction (A.1.5.1)";
CM_ SG_ 86 VFC_OcaHdr_CorrEgoLineTypeLeft "Line type for the left line of the ego corridor.";
CM_ SG_ 86 VFC_OcaHdr_CorrEgoLineTypeRight "Line type for the right line of the ego corridor.";
CM_ SG_ 86 VFC_OcaHdr_CorrLeftLineTypeLeft "Line type for the left line of the left corridor.";
CM_ SG_ 86 VFC_OcaHdr_CorrLeftLineTypeRight "Line type for the right line of the left corridor.";
CM_ SG_ 86 VFC_OcaHdr_CorrRightLineTypeLeft "Line type for the left line of the right corridor.";
CM_ SG_ 86 VFC_OcaHdr_CorrRightLineTypeR "Line type for the right line of the right corridor.";
CM_ SG_ 86 VFC_OcaHdr_CorrEgoLaneLineTypeL "Line type for the left line of the ego corridor only delimited with the measured lines from lane detection.";
CM_ SG_ 86 VFC_OcaHdr_CorrEgoLaneLineTypeR "Line type for the right line of the ego corridor only delimited with the measured lines from lane detection.";
CM_ SG_ 86 VFC_OcaHdr_PreReactObjAccConf "Confidence of pre reaction object detection for ACC";
CM_ SG_ 86 VFC_OcaHdr_PreReactObjAcc "ACC target object for a pre reaction of the vehicle control. This object is not be part of the object list.";
CM_ SG_ 86 VFC_OcaHdr_PreReactObjAccPx "Pre reaction object distance in longitudinal direction for ACC";
CM_ SG_ 86 VFC_OcaHdr_PreReactObjAccVx "Pre reaction object velocity in longitudinal direction for ACC";
CM_ SG_ 88 VFC_Oca_000_017_CRC "CRC - Autosar E2E Profile 5";
CM_ SG_ 88 VFC_Oca_000_017_AliveCtr "Alive counter - Autosar E2E Profile 5";
CM_ SG_ 88 VFC_Oca_000_017_ProtBlockCtr "Protocol-Signal: Block-Counter";
CM_ SG_ 88 VFC_Oca000_ObjIdRef "Reference to unique Object ID (VFC_Objxx_ObjId). Reference to PreReactionObject not needed. ISO 23150:2023: Object ID reference - object level (A.2.179)";
CM_ SG_ 88 VFC_Oca000_CorridorTypeRef "Reference to Corridor type";
CM_ SG_ 88 VFC_Oca000_ObjPosition "2D object position to a corridor";
CM_ SG_ 88 VFC_Oca000_CorridorOverlap "2D relation between object width and corridor";
CM_ SG_ 88 VFC_Oca000_InMeasuredLines "2D object located in measured lines of the corridor";
CM_ SG_ 88 VFC_Oca000_TimeToEnterCorridor "Time to enter corridor (TTEC)";
CM_ SG_ 88 VFC_Oca000_TimeToLeaveCorridor "Time to leave corridor (TTLC)";
CM_ SG_ 88 VFC_Oca001_ObjIdRef "Reference to unique Object ID (VFC_Objxx_ObjId). Reference to PreReactionObject not needed. ISO 23150:2023: Object ID reference - object level (A.2.179)";
CM_ SG_ 88 VFC_Oca001_CorridorTypeRef "Reference to Corridor type";
CM_ SG_ 88 VFC_Oca001_ObjPosition "2D object position to a corridor";
CM_ SG_ 88 VFC_Oca001_CorridorOverlap "2D relation between object width and corridor";
CM_ SG_ 88 VFC_Oca001_InMeasuredLines "2D object located in measured lines of the corridor";
CM_ SG_ 88 VFC_Oca001_TimeToEnterCorridor "Time to enter corridor (TTEC)";
CM_ SG_ 88 VFC_Oca001_TimeToLeaveCorridor "Time to leave corridor (TTLC)";
CM_ SG_ 88 VFC_Oca002_ObjIdRef "Reference to unique Object ID (VFC_Objxx_ObjId). Reference to PreReactionObject not needed. ISO 23150:2023: Object ID reference - object level (A.2.179)";
CM_ SG_ 88 VFC_Oca002_CorridorTypeRef "Reference to Corridor type";
CM_ SG_ 88 VFC_Oca002_ObjPosition "2D object position to a corridor";
CM_ SG_ 88 VFC_Oca002_CorridorOverlap "2D relation between object width and corridor";
CM_ SG_ 88 VFC_Oca002_InMeasuredLines "2D object located in measured lines of the corridor";
CM_ SG_ 88 VFC_Oca002_TimeToEnterCorridor "Time to enter corridor (TTEC)";
CM_ SG_ 88 VFC_Oca002_TimeToLeaveCorridor "Time to leave corridor (TTLC)";
CM_ SG_ 88 VFC_Oca003_ObjIdRef "Reference to unique Object ID (VFC_Objxx_ObjId). Reference to PreReactionObject not needed. ISO 23150:2023: Object ID reference - object level (A.2.179)";
CM_ SG_ 88 VFC_Oca003_CorridorTypeRef "Reference to Corridor type";
CM_ SG_ 88 VFC_Oca003_ObjPosition "2D object position to a corridor";
CM_ SG_ 88 VFC_Oca003_CorridorOverlap "2D relation between object width and corridor";
CM_ SG_ 88 VFC_Oca003_InMeasuredLines "2D object located in measured lines of the corridor";
CM_ SG_ 88 VFC_Oca003_TimeToEnterCorridor "Time to enter corridor (TTEC)";
CM_ SG_ 88 VFC_Oca003_TimeToLeaveCorridor "Time to leave corridor (TTLC)";
CM_ SG_ 88 VFC_Oca004_ObjIdRef "Reference to unique Object ID (VFC_Objxx_ObjId). Reference to PreReactionObject not needed. ISO 23150:2023: Object ID reference - object level (A.2.179)";
CM_ SG_ 88 VFC_Oca004_CorridorTypeRef "Reference to Corridor type";
CM_ SG_ 88 VFC_Oca004_ObjPosition "2D object position to a corridor";
CM_ SG_ 88 VFC_Oca004_CorridorOverlap "2D relation between object width and corridor";
CM_ SG_ 88 VFC_Oca004_InMeasuredLines "2D object located in measured lines of the corridor";
CM_ SG_ 88 VFC_Oca004_TimeToEnterCorridor "Time to enter corridor (TTEC)";
CM_ SG_ 88 VFC_Oca004_TimeToLeaveCorridor "Time to leave corridor (TTLC)";
CM_ SG_ 88 VFC_Oca005_ObjIdRef "Reference to unique Object ID (VFC_Objxx_ObjId). Reference to PreReactionObject not needed. ISO 23150:2023: Object ID reference - object level (A.2.179)";
CM_ SG_ 88 VFC_Oca005_CorridorTypeRef "Reference to Corridor type";
CM_ SG_ 88 VFC_Oca005_ObjPosition "2D object position to a corridor";
CM_ SG_ 88 VFC_Oca005_CorridorOverlap "2D relation between object width and corridor";
CM_ SG_ 88 VFC_Oca005_InMeasuredLines "2D object located in measured lines of the corridor";
CM_ SG_ 88 VFC_Oca005_TimeToEnterCorridor "Time to enter corridor (TTEC)";
CM_ SG_ 88 VFC_Oca005_TimeToLeaveCorridor "Time to leave corridor (TTLC)";
CM_ SG_ 88 VFC_Oca006_ObjIdRef "Reference to unique Object ID (VFC_Objxx_ObjId). Reference to PreReactionObject not needed. ISO 23150:2023: Object ID reference - object level (A.2.179)";
CM_ SG_ 88 VFC_Oca006_CorridorTypeRef "Reference to Corridor type";
CM_ SG_ 88 VFC_Oca006_ObjPosition "2D object position to a corridor";
CM_ SG_ 88 VFC_Oca006_CorridorOverlap "2D relation between object width and corridor";
CM_ SG_ 88 VFC_Oca006_InMeasuredLines "2D object located in measured lines of the corridor";
CM_ SG_ 88 VFC_Oca006_TimeToEnterCorridor "Time to enter corridor (TTEC)";
CM_ SG_ 88 VFC_Oca006_TimeToLeaveCorridor "Time to leave corridor (TTLC)";
CM_ SG_ 88 VFC_Oca007_ObjIdRef "Reference to unique Object ID (VFC_Objxx_ObjId). Reference to PreReactionObject not needed. ISO 23150:2023: Object ID reference - object level (A.2.179)";
CM_ SG_ 88 VFC_Oca007_CorridorTypeRef "Reference to Corridor type";
CM_ SG_ 88 VFC_Oca007_ObjPosition "2D object position to a corridor";
CM_ SG_ 88 VFC_Oca007_CorridorOverlap "2D relation between object width and corridor";
CM_ SG_ 88 VFC_Oca007_InMeasuredLines "2D object located in measured lines of the corridor";
CM_ SG_ 88 VFC_Oca007_TimeToEnterCorridor "Time to enter corridor (TTEC)";
CM_ SG_ 88 VFC_Oca007_TimeToLeaveCorridor "Time to leave corridor (TTLC)";
CM_ SG_ 88 VFC_Oca008_ObjIdRef "Reference to unique Object ID (VFC_Objxx_ObjId). Reference to PreReactionObject not needed. ISO 23150:2023: Object ID reference - object level (A.2.179)";
CM_ SG_ 88 VFC_Oca008_CorridorTypeRef "Reference to Corridor type";
CM_ SG_ 88 VFC_Oca008_ObjPosition "2D object position to a corridor";
CM_ SG_ 88 VFC_Oca008_CorridorOverlap "2D relation between object width and corridor";
CM_ SG_ 88 VFC_Oca008_InMeasuredLines "2D object located in measured lines of the corridor";
CM_ SG_ 88 VFC_Oca008_TimeToEnterCorridor "Time to enter corridor (TTEC)";
CM_ SG_ 88 VFC_Oca008_TimeToLeaveCorridor "Time to leave corridor (TTLC)";
CM_ SG_ 88 VFC_Oca009_ObjIdRef "Reference to unique Object ID (VFC_Objxx_ObjId). Reference to PreReactionObject not needed. ISO 23150:2023: Object ID reference - object level (A.2.179)";
CM_ SG_ 88 VFC_Oca009_CorridorTypeRef "Reference to Corridor type";
CM_ SG_ 88 VFC_Oca009_ObjPosition "2D object position to a corridor";
CM_ SG_ 88 VFC_Oca009_CorridorOverlap "2D relation between object width and corridor";
CM_ SG_ 88 VFC_Oca009_InMeasuredLines "2D object located in measured lines of the corridor";
CM_ SG_ 88 VFC_Oca009_TimeToEnterCorridor "Time to enter corridor (TTEC)";
CM_ SG_ 88 VFC_Oca009_TimeToLeaveCorridor "Time to leave corridor (TTLC)";
CM_ SG_ 88 VFC_Oca010_ObjIdRef "Reference to unique Object ID (VFC_Objxx_ObjId). Reference to PreReactionObject not needed. ISO 23150:2023: Object ID reference - object level (A.2.179)";
CM_ SG_ 88 VFC_Oca010_CorridorTypeRef "Reference to Corridor type";
CM_ SG_ 88 VFC_Oca010_ObjPosition "2D object position to a corridor";
CM_ SG_ 88 VFC_Oca010_CorridorOverlap "2D relation between object width and corridor";
CM_ SG_ 88 VFC_Oca010_InMeasuredLines "2D object located in measured lines of the corridor";
CM_ SG_ 88 VFC_Oca010_TimeToEnterCorridor "Time to enter corridor (TTEC)";
CM_ SG_ 88 VFC_Oca010_TimeToLeaveCorridor "Time to leave corridor (TTLC)";
CM_ SG_ 88 VFC_Oca011_ObjIdRef "Reference to unique Object ID (VFC_Objxx_ObjId). Reference to PreReactionObject not needed. ISO 23150:2023: Object ID reference - object level (A.2.179)";
CM_ SG_ 88 VFC_Oca011_CorridorTypeRef "Reference to Corridor type";
CM_ SG_ 88 VFC_Oca011_ObjPosition "2D object position to a corridor";
CM_ SG_ 88 VFC_Oca011_CorridorOverlap "2D relation between object width and corridor";
CM_ SG_ 88 VFC_Oca011_InMeasuredLines "2D object located in measured lines of the corridor";
CM_ SG_ 88 VFC_Oca011_TimeToEnterCorridor "Time to enter corridor (TTEC)";
CM_ SG_ 88 VFC_Oca011_TimeToLeaveCorridor "Time to leave corridor (TTLC)";
CM_ SG_ 88 VFC_Oca012_ObjIdRef "Reference to unique Object ID (VFC_Objxx_ObjId). Reference to PreReactionObject not needed. ISO 23150:2023: Object ID reference - object level (A.2.179)";
CM_ SG_ 88 VFC_Oca012_CorridorTypeRef "Reference to Corridor type";
CM_ SG_ 88 VFC_Oca012_ObjPosition "2D object position to a corridor";
CM_ SG_ 88 VFC_Oca012_CorridorOverlap "2D relation between object width and corridor";
CM_ SG_ 88 VFC_Oca012_InMeasuredLines "2D object located in measured lines of the corridor";
CM_ SG_ 88 VFC_Oca012_TimeToEnterCorridor "Time to enter corridor (TTEC)";
CM_ SG_ 88 VFC_Oca012_TimeToLeaveCorridor "Time to leave corridor (TTLC)";
CM_ SG_ 88 VFC_Oca013_ObjIdRef "Reference to unique Object ID (VFC_Objxx_ObjId). Reference to PreReactionObject not needed. ISO 23150:2023: Object ID reference - object level (A.2.179)";
CM_ SG_ 88 VFC_Oca013_CorridorTypeRef "Reference to Corridor type";
CM_ SG_ 88 VFC_Oca013_ObjPosition "2D object position to a corridor";
CM_ SG_ 88 VFC_Oca013_CorridorOverlap "2D relation between object width and corridor";
CM_ SG_ 88 VFC_Oca013_InMeasuredLines "2D object located in measured lines of the corridor";
CM_ SG_ 88 VFC_Oca013_TimeToEnterCorridor "Time to enter corridor (TTEC)";
CM_ SG_ 88 VFC_Oca013_TimeToLeaveCorridor "Time to leave corridor (TTLC)";
CM_ SG_ 88 VFC_Oca014_ObjIdRef "Reference to unique Object ID (VFC_Objxx_ObjId). Reference to PreReactionObject not needed. ISO 23150:2023: Object ID reference - object level (A.2.179)";
CM_ SG_ 88 VFC_Oca014_CorridorTypeRef "Reference to Corridor type";
CM_ SG_ 88 VFC_Oca014_ObjPosition "2D object position to a corridor";
CM_ SG_ 88 VFC_Oca014_CorridorOverlap "2D relation between object width and corridor";
CM_ SG_ 88 VFC_Oca014_InMeasuredLines "2D object located in measured lines of the corridor";
CM_ SG_ 88 VFC_Oca014_TimeToEnterCorridor "Time to enter corridor (TTEC)";
CM_ SG_ 88 VFC_Oca014_TimeToLeaveCorridor "Time to leave corridor (TTLC)";
CM_ SG_ 88 VFC_Oca015_ObjIdRef "Reference to unique Object ID (VFC_Objxx_ObjId). Reference to PreReactionObject not needed. ISO 23150:2023: Object ID reference - object level (A.2.179)";
CM_ SG_ 88 VFC_Oca015_CorridorTypeRef "Reference to Corridor type";
CM_ SG_ 88 VFC_Oca015_ObjPosition "2D object position to a corridor";
CM_ SG_ 88 VFC_Oca015_CorridorOverlap "2D relation between object width and corridor";
CM_ SG_ 88 VFC_Oca015_InMeasuredLines "2D object located in measured lines of the corridor";
CM_ SG_ 88 VFC_Oca015_TimeToEnterCorridor "Time to enter corridor (TTEC)";
CM_ SG_ 88 VFC_Oca015_TimeToLeaveCorridor "Time to leave corridor (TTLC)";
CM_ SG_ 88 VFC_Oca016_ObjIdRef "Reference to unique Object ID (VFC_Objxx_ObjId). Reference to PreReactionObject not needed. ISO 23150:2023: Object ID reference - object level (A.2.179)";
CM_ SG_ 88 VFC_Oca016_CorridorTypeRef "Reference to Corridor type";
CM_ SG_ 88 VFC_Oca016_ObjPosition "2D object position to a corridor";
CM_ SG_ 88 VFC_Oca016_CorridorOverlap "2D relation between object width and corridor";
CM_ SG_ 88 VFC_Oca016_InMeasuredLines "2D object located in measured lines of the corridor";
CM_ SG_ 88 VFC_Oca016_TimeToEnterCorridor "Time to enter corridor (TTEC)";
CM_ SG_ 88 VFC_Oca016_TimeToLeaveCorridor "Time to leave corridor (TTLC)";
CM_ SG_ 88 VFC_Oca017_ObjIdRef "Reference to unique Object ID (VFC_Objxx_ObjId). Reference to PreReactionObject not needed. ISO 23150:2023: Object ID reference - object level (A.2.179)";
CM_ SG_ 88 VFC_Oca017_CorridorTypeRef "Reference to Corridor type";
CM_ SG_ 88 VFC_Oca017_ObjPosition "2D object position to a corridor";
CM_ SG_ 88 VFC_Oca017_CorridorOverlap "2D relation between object width and corridor";
CM_ SG_ 88 VFC_Oca017_InMeasuredLines "2D object located in measured lines of the corridor";
CM_ SG_ 88 VFC_Oca017_TimeToEnterCorridor "Time to enter corridor (TTEC)";
CM_ SG_ 88 VFC_Oca017_TimeToLeaveCorridor "Time to leave corridor (TTLC)";
CM_ SG_ 89 VFC_Oca_018_035_CRC "CRC - Autosar E2E Profile 5";
CM_ SG_ 89 VFC_Oca_018_035_AliveCtr "Alive counter - Autosar E2E Profile 5";
CM_ SG_ 89 VFC_Oca_018_035_ProtBlockCtr "Protocol-Signal: Block-Counter";
CM_ SG_ 89 VFC_Oca018_ObjIdRef "Reference to unique Object ID (VFC_Objxx_ObjId). Reference to PreReactionObject not needed. ISO 23150:2023: Object ID reference - object level (A.2.179)";
CM_ SG_ 89 VFC_Oca018_CorridorTypeRef "Reference to Corridor type";
CM_ SG_ 89 VFC_Oca018_ObjPosition "2D object position to a corridor";
CM_ SG_ 89 VFC_Oca018_CorridorOverlap "2D relation between object width and corridor";
CM_ SG_ 89 VFC_Oca018_InMeasuredLines "2D object located in measured lines of the corridor";
CM_ SG_ 89 VFC_Oca018_TimeToEnterCorridor "Time to enter corridor (TTEC)";
CM_ SG_ 89 VFC_Oca018_TimeToLeaveCorridor "Time to leave corridor (TTLC)";
CM_ SG_ 89 VFC_Oca019_ObjIdRef "Reference to unique Object ID (VFC_Objxx_ObjId). Reference to PreReactionObject not needed. ISO 23150:2023: Object ID reference - object level (A.2.179)";
CM_ SG_ 89 VFC_Oca019_CorridorTypeRef "Reference to Corridor type";
CM_ SG_ 89 VFC_Oca019_ObjPosition "2D object position to a corridor";
CM_ SG_ 89 VFC_Oca019_CorridorOverlap "2D relation between object width and corridor";
CM_ SG_ 89 VFC_Oca019_InMeasuredLines "2D object located in measured lines of the corridor";
CM_ SG_ 89 VFC_Oca019_TimeToEnterCorridor "Time to enter corridor (TTEC)";
CM_ SG_ 89 VFC_Oca019_TimeToLeaveCorridor "Time to leave corridor (TTLC)";
CM_ SG_ 89 VFC_Oca020_ObjIdRef "Reference to unique Object ID (VFC_Objxx_ObjId). Reference to PreReactionObject not needed. ISO 23150:2023: Object ID reference - object level (A.2.179)";
CM_ SG_ 89 VFC_Oca020_CorridorTypeRef "Reference to Corridor type";
CM_ SG_ 89 VFC_Oca020_ObjPosition "2D object position to a corridor";
CM_ SG_ 89 VFC_Oca020_CorridorOverlap "2D relation between object width and corridor";
CM_ SG_ 89 VFC_Oca020_InMeasuredLines "2D object located in measured lines of the corridor";
CM_ SG_ 89 VFC_Oca020_TimeToEnterCorridor "Time to enter corridor (TTEC)";
CM_ SG_ 89 VFC_Oca020_TimeToLeaveCorridor "Time to leave corridor (TTLC)";
CM_ SG_ 89 VFC_Oca021_ObjIdRef "Reference to unique Object ID (VFC_Objxx_ObjId). Reference to PreReactionObject not needed. ISO 23150:2023: Object ID reference - object level (A.2.179)";
CM_ SG_ 89 VFC_Oca021_CorridorTypeRef "Reference to Corridor type";
CM_ SG_ 89 VFC_Oca021_ObjPosition "2D object position to a corridor";
CM_ SG_ 89 VFC_Oca021_CorridorOverlap "2D relation between object width and corridor";
CM_ SG_ 89 VFC_Oca021_InMeasuredLines "2D object located in measured lines of the corridor";
CM_ SG_ 89 VFC_Oca021_TimeToEnterCorridor "Time to enter corridor (TTEC)";
CM_ SG_ 89 VFC_Oca021_TimeToLeaveCorridor "Time to leave corridor (TTLC)";
CM_ SG_ 89 VFC_Oca022_ObjIdRef "Reference to unique Object ID (VFC_Objxx_ObjId). Reference to PreReactionObject not needed. ISO 23150:2023: Object ID reference - object level (A.2.179)";
CM_ SG_ 89 VFC_Oca022_CorridorTypeRef "Reference to Corridor type";
CM_ SG_ 89 VFC_Oca022_ObjPosition "2D object position to a corridor";
CM_ SG_ 89 VFC_Oca022_CorridorOverlap "2D relation between object width and corridor";
CM_ SG_ 89 VFC_Oca022_InMeasuredLines "2D object located in measured lines of the corridor";
CM_ SG_ 89 VFC_Oca022_TimeToEnterCorridor "Time to enter corridor (TTEC)";
CM_ SG_ 89 VFC_Oca022_TimeToLeaveCorridor "Time to leave corridor (TTLC)";
CM_ SG_ 89 VFC_Oca023_ObjIdRef "Reference to unique Object ID (VFC_Objxx_ObjId). Reference to PreReactionObject not needed. ISO 23150:2023: Object ID reference - object level (A.2.179)";
CM_ SG_ 89 VFC_Oca023_CorridorTypeRef "Reference to Corridor type";
CM_ SG_ 89 VFC_Oca023_ObjPosition "2D object position to a corridor";
CM_ SG_ 89 VFC_Oca023_CorridorOverlap "2D relation between object width and corridor";
CM_ SG_ 89 VFC_Oca023_InMeasuredLines "2D object located in measured lines of the corridor";
CM_ SG_ 89 VFC_Oca023_TimeToEnterCorridor "Time to enter corridor (TTEC)";
CM_ SG_ 89 VFC_Oca023_TimeToLeaveCorridor "Time to leave corridor (TTLC)";
CM_ SG_ 89 VFC_Oca024_ObjIdRef "Reference to unique Object ID (VFC_Objxx_ObjId). Reference to PreReactionObject not needed. ISO 23150:2023: Object ID reference - object level (A.2.179)";
CM_ SG_ 89 VFC_Oca024_CorridorTypeRef "Reference to Corridor type";
CM_ SG_ 89 VFC_Oca024_ObjPosition "2D object position to a corridor";
CM_ SG_ 89 VFC_Oca024_CorridorOverlap "2D relation between object width and corridor";
CM_ SG_ 89 VFC_Oca024_InMeasuredLines "2D object located in measured lines of the corridor";
CM_ SG_ 89 VFC_Oca024_TimeToEnterCorridor "Time to enter corridor (TTEC)";
CM_ SG_ 89 VFC_Oca024_TimeToLeaveCorridor "Time to leave corridor (TTLC)";
CM_ SG_ 89 VFC_Oca025_ObjIdRef "Reference to unique Object ID (VFC_Objxx_ObjId). Reference to PreReactionObject not needed. ISO 23150:2023: Object ID reference - object level (A.2.179)";
CM_ SG_ 89 VFC_Oca025_CorridorTypeRef "Reference to Corridor type";
CM_ SG_ 89 VFC_Oca025_ObjPosition "2D object position to a corridor";
CM_ SG_ 89 VFC_Oca025_CorridorOverlap "2D relation between object width and corridor";
CM_ SG_ 89 VFC_Oca025_InMeasuredLines "2D object located in measured lines of the corridor";
CM_ SG_ 89 VFC_Oca025_TimeToEnterCorridor "Time to enter corridor (TTEC)";
CM_ SG_ 89 VFC_Oca025_TimeToLeaveCorridor "Time to leave corridor (TTLC)";
CM_ SG_ 89 VFC_Oca026_ObjIdRef "Reference to unique Object ID (VFC_Objxx_ObjId). Reference to PreReactionObject not needed. ISO 23150:2023: Object ID reference - object level (A.2.179)";
CM_ SG_ 89 VFC_Oca026_CorridorTypeRef "Reference to Corridor type";
CM_ SG_ 89 VFC_Oca026_ObjPosition "2D object position to a corridor";
CM_ SG_ 89 VFC_Oca026_CorridorOverlap "2D relation between object width and corridor";
CM_ SG_ 89 VFC_Oca026_InMeasuredLines "2D object located in measured lines of the corridor";
CM_ SG_ 89 VFC_Oca026_TimeToEnterCorridor "Time to enter corridor (TTEC)";
CM_ SG_ 89 VFC_Oca026_TimeToLeaveCorridor "Time to leave corridor (TTLC)";
CM_ SG_ 89 VFC_Oca027_ObjIdRef "Reference to unique Object ID (VFC_Objxx_ObjId). Reference to PreReactionObject not needed. ISO 23150:2023: Object ID reference - object level (A.2.179)";
CM_ SG_ 89 VFC_Oca027_CorridorTypeRef "Reference to Corridor type";
CM_ SG_ 89 VFC_Oca027_ObjPosition "2D object position to a corridor";
CM_ SG_ 89 VFC_Oca027_CorridorOverlap "2D relation between object width and corridor";
CM_ SG_ 89 VFC_Oca027_InMeasuredLines "2D object located in measured lines of the corridor";
CM_ SG_ 89 VFC_Oca027_TimeToEnterCorridor "Time to enter corridor (TTEC)";
CM_ SG_ 89 VFC_Oca027_TimeToLeaveCorridor "Time to leave corridor (TTLC)";
CM_ SG_ 89 VFC_Oca028_ObjIdRef "Reference to unique Object ID (VFC_Objxx_ObjId). Reference to PreReactionObject not needed. ISO 23150:2023: Object ID reference - object level (A.2.179)";
CM_ SG_ 89 VFC_Oca028_CorridorTypeRef "Reference to Corridor type";
CM_ SG_ 89 VFC_Oca028_ObjPosition "2D object position to a corridor";
CM_ SG_ 89 VFC_Oca028_CorridorOverlap "2D relation between object width and corridor";
CM_ SG_ 89 VFC_Oca028_InMeasuredLines "2D object located in measured lines of the corridor";
CM_ SG_ 89 VFC_Oca028_TimeToEnterCorridor "Time to enter corridor (TTEC)";
CM_ SG_ 89 VFC_Oca028_TimeToLeaveCorridor "Time to leave corridor (TTLC)";
CM_ SG_ 89 VFC_Oca029_ObjIdRef "Reference to unique Object ID (VFC_Objxx_ObjId). Reference to PreReactionObject not needed. ISO 23150:2023: Object ID reference - object level (A.2.179)";
CM_ SG_ 89 VFC_Oca029_CorridorTypeRef "Reference to Corridor type";
CM_ SG_ 89 VFC_Oca029_ObjPosition "2D object position to a corridor";
CM_ SG_ 89 VFC_Oca029_CorridorOverlap "2D relation between object width and corridor";
CM_ SG_ 89 VFC_Oca029_InMeasuredLines "2D object located in measured lines of the corridor";
CM_ SG_ 89 VFC_Oca029_TimeToEnterCorridor "Time to enter corridor (TTEC)";
CM_ SG_ 89 VFC_Oca029_TimeToLeaveCorridor "Time to leave corridor (TTLC)";
CM_ SG_ 89 VFC_Oca030_ObjIdRef "Reference to unique Object ID (VFC_Objxx_ObjId). Reference to PreReactionObject not needed. ISO 23150:2023: Object ID reference - object level (A.2.179)";
CM_ SG_ 89 VFC_Oca030_CorridorTypeRef "Reference to Corridor type";
CM_ SG_ 89 VFC_Oca030_ObjPosition "2D object position to a corridor";
CM_ SG_ 89 VFC_Oca030_CorridorOverlap "2D relation between object width and corridor";
CM_ SG_ 89 VFC_Oca030_InMeasuredLines "2D object located in measured lines of the corridor";
CM_ SG_ 89 VFC_Oca030_TimeToEnterCorridor "Time to enter corridor (TTEC)";
CM_ SG_ 89 VFC_Oca030_TimeToLeaveCorridor "Time to leave corridor (TTLC)";
CM_ SG_ 89 VFC_Oca031_ObjIdRef "Reference to unique Object ID (VFC_Objxx_ObjId). Reference to PreReactionObject not needed. ISO 23150:2023: Object ID reference - object level (A.2.179)";
CM_ SG_ 89 VFC_Oca031_CorridorTypeRef "Reference to Corridor type";
CM_ SG_ 89 VFC_Oca031_ObjPosition "2D object position to a corridor";
CM_ SG_ 89 VFC_Oca031_CorridorOverlap "2D relation between object width and corridor";
CM_ SG_ 89 VFC_Oca031_InMeasuredLines "2D object located in measured lines of the corridor";
CM_ SG_ 89 VFC_Oca031_TimeToEnterCorridor "Time to enter corridor (TTEC)";
CM_ SG_ 89 VFC_Oca031_TimeToLeaveCorridor "Time to leave corridor (TTLC)";
CM_ SG_ 89 VFC_Oca032_ObjIdRef "Reference to unique Object ID (VFC_Objxx_ObjId). Reference to PreReactionObject not needed. ISO 23150:2023: Object ID reference - object level (A.2.179)";
CM_ SG_ 89 VFC_Oca032_CorridorTypeRef "Reference to Corridor type";
CM_ SG_ 89 VFC_Oca032_ObjPosition "2D object position to a corridor";
CM_ SG_ 89 VFC_Oca032_CorridorOverlap "2D relation between object width and corridor";
CM_ SG_ 89 VFC_Oca032_InMeasuredLines "2D object located in measured lines of the corridor";
CM_ SG_ 89 VFC_Oca032_TimeToEnterCorridor "Time to enter corridor (TTEC)";
CM_ SG_ 89 VFC_Oca032_TimeToLeaveCorridor "Time to leave corridor (TTLC)";
CM_ SG_ 89 VFC_Oca033_ObjIdRef "Reference to unique Object ID (VFC_Objxx_ObjId). Reference to PreReactionObject not needed. ISO 23150:2023: Object ID reference - object level (A.2.179)";
CM_ SG_ 89 VFC_Oca033_CorridorTypeRef "Reference to Corridor type";
CM_ SG_ 89 VFC_Oca033_ObjPosition "2D object position to a corridor";
CM_ SG_ 89 VFC_Oca033_CorridorOverlap "2D relation between object width and corridor";
CM_ SG_ 89 VFC_Oca033_InMeasuredLines "2D object located in measured lines of the corridor";
CM_ SG_ 89 VFC_Oca033_TimeToEnterCorridor "Time to enter corridor (TTEC)";
CM_ SG_ 89 VFC_Oca033_TimeToLeaveCorridor "Time to leave corridor (TTLC)";
CM_ SG_ 89 VFC_Oca034_ObjIdRef "Reference to unique Object ID (VFC_Objxx_ObjId). Reference to PreReactionObject not needed. ISO 23150:2023: Object ID reference - object level (A.2.179)";
CM_ SG_ 89 VFC_Oca034_CorridorTypeRef "Reference to Corridor type";
CM_ SG_ 89 VFC_Oca034_ObjPosition "2D object position to a corridor";
CM_ SG_ 89 VFC_Oca034_CorridorOverlap "2D relation between object width and corridor";
CM_ SG_ 89 VFC_Oca034_InMeasuredLines "2D object located in measured lines of the corridor";
CM_ SG_ 89 VFC_Oca034_TimeToEnterCorridor "Time to enter corridor (TTEC)";
CM_ SG_ 89 VFC_Oca034_TimeToLeaveCorridor "Time to leave corridor (TTLC)";
CM_ SG_ 89 VFC_Oca035_ObjIdRef "Reference to unique Object ID (VFC_Objxx_ObjId). Reference to PreReactionObject not needed. ISO 23150:2023: Object ID reference - object level (A.2.179)";
CM_ SG_ 89 VFC_Oca035_CorridorTypeRef "Reference to Corridor type";
CM_ SG_ 89 VFC_Oca035_ObjPosition "2D object position to a corridor";
CM_ SG_ 89 VFC_Oca035_CorridorOverlap "2D relation between object width and corridor";
CM_ SG_ 89 VFC_Oca035_InMeasuredLines "2D object located in measured lines of the corridor";
CM_ SG_ 89 VFC_Oca035_TimeToEnterCorridor "Time to enter corridor (TTEC)";
CM_ SG_ 89 VFC_Oca035_TimeToLeaveCorridor "Time to leave corridor (TTLC)";
CM_ SG_ 90 VFC_Oca_036_053_CRC "CRC - Autosar E2E Profile 5";
CM_ SG_ 90 VFC_Oca_036_053_AliveCtr "Alive counter - Autosar E2E Profile 5";
CM_ SG_ 90 VFC_Oca_036_053_ProtBlockCtr "Protocol-Signal: Block-Counter";
CM_ SG_ 90 VFC_Oca036_ObjIdRef "Reference to unique Object ID (VFC_Objxx_ObjId). Reference to PreReactionObject not needed. ISO 23150:2023: Object ID reference - object level (A.2.179)";
CM_ SG_ 90 VFC_Oca036_CorridorTypeRef "Reference to Corridor type";
CM_ SG_ 90 VFC_Oca036_ObjPosition "2D object position to a corridor";
CM_ SG_ 90 VFC_Oca036_CorridorOverlap "2D relation between object width and corridor";
CM_ SG_ 90 VFC_Oca036_InMeasuredLines "2D object located in measured lines of the corridor";
CM_ SG_ 90 VFC_Oca036_TimeToEnterCorridor "Time to enter corridor (TTEC)";
CM_ SG_ 90 VFC_Oca036_TimeToLeaveCorridor "Time to leave corridor (TTLC)";
CM_ SG_ 90 VFC_Oca037_ObjIdRef "Reference to unique Object ID (VFC_Objxx_ObjId). Reference to PreReactionObject not needed. ISO 23150:2023: Object ID reference - object level (A.2.179)";
CM_ SG_ 90 VFC_Oca037_CorridorTypeRef "Reference to Corridor type";
CM_ SG_ 90 VFC_Oca037_ObjPosition "2D object position to a corridor";
CM_ SG_ 90 VFC_Oca037_CorridorOverlap "2D relation between object width and corridor";
CM_ SG_ 90 VFC_Oca037_InMeasuredLines "2D object located in measured lines of the corridor";
CM_ SG_ 90 VFC_Oca037_TimeToEnterCorridor "Time to enter corridor (TTEC)";
CM_ SG_ 90 VFC_Oca037_TimeToLeaveCorridor "Time to leave corridor (TTLC)";
CM_ SG_ 90 VFC_Oca038_ObjIdRef "Reference to unique Object ID (VFC_Objxx_ObjId). Reference to PreReactionObject not needed. ISO 23150:2023: Object ID reference - object level (A.2.179)";
CM_ SG_ 90 VFC_Oca038_CorridorTypeRef "Reference to Corridor type";
CM_ SG_ 90 VFC_Oca038_ObjPosition "2D object position to a corridor";
CM_ SG_ 90 VFC_Oca038_CorridorOverlap "2D relation between object width and corridor";
CM_ SG_ 90 VFC_Oca038_InMeasuredLines "2D object located in measured lines of the corridor";
CM_ SG_ 90 VFC_Oca038_TimeToEnterCorridor "Time to enter corridor (TTEC)";
CM_ SG_ 90 VFC_Oca038_TimeToLeaveCorridor "Time to leave corridor (TTLC)";
CM_ SG_ 90 VFC_Oca039_ObjIdRef "Reference to unique Object ID (VFC_Objxx_ObjId). Reference to PreReactionObject not needed. ISO 23150:2023: Object ID reference - object level (A.2.179)";
CM_ SG_ 90 VFC_Oca039_CorridorTypeRef "Reference to Corridor type";
CM_ SG_ 90 VFC_Oca039_ObjPosition "2D object position to a corridor";
CM_ SG_ 90 VFC_Oca039_CorridorOverlap "2D relation between object width and corridor";
CM_ SG_ 90 VFC_Oca039_InMeasuredLines "2D object located in measured lines of the corridor";
CM_ SG_ 90 VFC_Oca039_TimeToEnterCorridor "Time to enter corridor (TTEC)";
CM_ SG_ 90 VFC_Oca039_TimeToLeaveCorridor "Time to leave corridor (TTLC)";
CM_ SG_ 90 VFC_Oca040_ObjIdRef "Reference to unique Object ID (VFC_Objxx_ObjId). Reference to PreReactionObject not needed. ISO 23150:2023: Object ID reference - object level (A.2.179)";
CM_ SG_ 90 VFC_Oca040_CorridorTypeRef "Reference to Corridor type";
CM_ SG_ 90 VFC_Oca040_ObjPosition "2D object position to a corridor";
CM_ SG_ 90 VFC_Oca040_CorridorOverlap "2D relation between object width and corridor";
CM_ SG_ 90 VFC_Oca040_InMeasuredLines "2D object located in measured lines of the corridor";
CM_ SG_ 90 VFC_Oca040_TimeToEnterCorridor "Time to enter corridor (TTEC)";
CM_ SG_ 90 VFC_Oca040_TimeToLeaveCorridor "Time to leave corridor (TTLC)";
CM_ SG_ 90 VFC_Oca041_ObjIdRef "Reference to unique Object ID (VFC_Objxx_ObjId). Reference to PreReactionObject not needed. ISO 23150:2023: Object ID reference - object level (A.2.179)";
CM_ SG_ 90 VFC_Oca041_CorridorTypeRef "Reference to Corridor type";
CM_ SG_ 90 VFC_Oca041_ObjPosition "2D object position to a corridor";
CM_ SG_ 90 VFC_Oca041_CorridorOverlap "2D relation between object width and corridor";
CM_ SG_ 90 VFC_Oca041_InMeasuredLines "2D object located in measured lines of the corridor";
CM_ SG_ 90 VFC_Oca041_TimeToEnterCorridor "Time to enter corridor (TTEC)";
CM_ SG_ 90 VFC_Oca041_TimeToLeaveCorridor "Time to leave corridor (TTLC)";
CM_ SG_ 90 VFC_Oca042_ObjIdRef "Reference to unique Object ID (VFC_Objxx_ObjId). Reference to PreReactionObject not needed. ISO 23150:2023: Object ID reference - object level (A.2.179)";
CM_ SG_ 90 VFC_Oca042_CorridorTypeRef "Reference to Corridor type";
CM_ SG_ 90 VFC_Oca042_ObjPosition "2D object position to a corridor";
CM_ SG_ 90 VFC_Oca042_CorridorOverlap "2D relation between object width and corridor";
CM_ SG_ 90 VFC_Oca042_InMeasuredLines "2D object located in measured lines of the corridor";
CM_ SG_ 90 VFC_Oca042_TimeToEnterCorridor "Time to enter corridor (TTEC)";
CM_ SG_ 90 VFC_Oca042_TimeToLeaveCorridor "Time to leave corridor (TTLC)";
CM_ SG_ 90 VFC_Oca043_ObjIdRef "Reference to unique Object ID (VFC_Objxx_ObjId). Reference to PreReactionObject not needed. ISO 23150:2023: Object ID reference - object level (A.2.179)";
CM_ SG_ 90 VFC_Oca043_CorridorTypeRef "Reference to Corridor type";
CM_ SG_ 90 VFC_Oca043_ObjPosition "2D object position to a corridor";
CM_ SG_ 90 VFC_Oca043_CorridorOverlap "2D relation between object width and corridor";
CM_ SG_ 90 VFC_Oca043_InMeasuredLines "2D object located in measured lines of the corridor";
CM_ SG_ 90 VFC_Oca043_TimeToEnterCorridor "Time to enter corridor (TTEC)";
CM_ SG_ 90 VFC_Oca043_TimeToLeaveCorridor "Time to leave corridor (TTLC)";
CM_ SG_ 90 VFC_Oca044_ObjIdRef "Reference to unique Object ID (VFC_Objxx_ObjId). Reference to PreReactionObject not needed. ISO 23150:2023: Object ID reference - object level (A.2.179)";
CM_ SG_ 90 VFC_Oca044_CorridorTypeRef "Reference to Corridor type";
CM_ SG_ 90 VFC_Oca044_ObjPosition "2D object position to a corridor";
CM_ SG_ 90 VFC_Oca044_CorridorOverlap "2D relation between object width and corridor";
CM_ SG_ 90 VFC_Oca044_InMeasuredLines "2D object located in measured lines of the corridor";
CM_ SG_ 90 VFC_Oca044_TimeToEnterCorridor "Time to enter corridor (TTEC)";
CM_ SG_ 90 VFC_Oca044_TimeToLeaveCorridor "Time to leave corridor (TTLC)";
CM_ SG_ 90 VFC_Oca045_ObjIdRef "Reference to unique Object ID (VFC_Objxx_ObjId). Reference to PreReactionObject not needed. ISO 23150:2023: Object ID reference - object level (A.2.179)";
CM_ SG_ 90 VFC_Oca045_CorridorTypeRef "Reference to Corridor type";
CM_ SG_ 90 VFC_Oca045_ObjPosition "2D object position to a corridor";
CM_ SG_ 90 VFC_Oca045_CorridorOverlap "2D relation between object width and corridor";
CM_ SG_ 90 VFC_Oca045_InMeasuredLines "2D object located in measured lines of the corridor";
CM_ SG_ 90 VFC_Oca045_TimeToEnterCorridor "Time to enter corridor (TTEC)";
CM_ SG_ 90 VFC_Oca045_TimeToLeaveCorridor "Time to leave corridor (TTLC)";
CM_ SG_ 90 VFC_Oca046_ObjIdRef "Reference to unique Object ID (VFC_Objxx_ObjId). Reference to PreReactionObject not needed. ISO 23150:2023: Object ID reference - object level (A.2.179)";
CM_ SG_ 90 VFC_Oca046_CorridorTypeRef "Reference to Corridor type";
CM_ SG_ 90 VFC_Oca046_ObjPosition "2D object position to a corridor";
CM_ SG_ 90 VFC_Oca046_CorridorOverlap "2D relation between object width and corridor";
CM_ SG_ 90 VFC_Oca046_InMeasuredLines "2D object located in measured lines of the corridor";
CM_ SG_ 90 VFC_Oca046_TimeToEnterCorridor "Time to enter corridor (TTEC)";
CM_ SG_ 90 VFC_Oca046_TimeToLeaveCorridor "Time to leave corridor (TTLC)";
CM_ SG_ 90 VFC_Oca047_ObjIdRef "Reference to unique Object ID (VFC_Objxx_ObjId). Reference to PreReactionObject not needed. ISO 23150:2023: Object ID reference - object level (A.2.179)";
CM_ SG_ 90 VFC_Oca047_CorridorTypeRef "Reference to Corridor type";
CM_ SG_ 90 VFC_Oca047_ObjPosition "2D object position to a corridor";
CM_ SG_ 90 VFC_Oca047_CorridorOverlap "2D relation between object width and corridor";
CM_ SG_ 90 VFC_Oca047_InMeasuredLines "2D object located in measured lines of the corridor";
CM_ SG_ 90 VFC_Oca047_TimeToEnterCorridor "Time to enter corridor (TTEC)";
CM_ SG_ 90 VFC_Oca047_TimeToLeaveCorridor "Time to leave corridor (TTLC)";
CM_ SG_ 90 VFC_Oca048_ObjIdRef "Reference to unique Object ID (VFC_Objxx_ObjId). Reference to PreReactionObject not needed. ISO 23150:2023: Object ID reference - object level (A.2.179)";
CM_ SG_ 90 VFC_Oca048_CorridorTypeRef "Reference to Corridor type";
CM_ SG_ 90 VFC_Oca048_ObjPosition "2D object position to a corridor";
CM_ SG_ 90 VFC_Oca048_CorridorOverlap "2D relation between object width and corridor";
CM_ SG_ 90 VFC_Oca048_InMeasuredLines "2D object located in measured lines of the corridor";
CM_ SG_ 90 VFC_Oca048_TimeToEnterCorridor "Time to enter corridor (TTEC)";
CM_ SG_ 90 VFC_Oca048_TimeToLeaveCorridor "Time to leave corridor (TTLC)";
CM_ SG_ 90 VFC_Oca049_ObjIdRef "Reference to unique Object ID (VFC_Objxx_ObjId). Reference to PreReactionObject not needed. ISO 23150:2023: Object ID reference - object level (A.2.179)";
CM_ SG_ 90 VFC_Oca049_CorridorTypeRef "Reference to Corridor type";
CM_ SG_ 90 VFC_Oca049_ObjPosition "2D object position to a corridor";
CM_ SG_ 90 VFC_Oca049_CorridorOverlap "2D relation between object width and corridor";
CM_ SG_ 90 VFC_Oca049_InMeasuredLines "2D object located in measured lines of the corridor";
CM_ SG_ 90 VFC_Oca049_TimeToEnterCorridor "Time to enter corridor (TTEC)";
CM_ SG_ 90 VFC_Oca049_TimeToLeaveCorridor "Time to leave corridor (TTLC)";
CM_ SG_ 90 VFC_Oca050_ObjIdRef "Reference to unique Object ID (VFC_Objxx_ObjId). Reference to PreReactionObject not needed. ISO 23150:2023: Object ID reference - object level (A.2.179)";
CM_ SG_ 90 VFC_Oca050_CorridorTypeRef "Reference to Corridor type";
CM_ SG_ 90 VFC_Oca050_ObjPosition "2D object position to a corridor";
CM_ SG_ 90 VFC_Oca050_CorridorOverlap "2D relation between object width and corridor";
CM_ SG_ 90 VFC_Oca050_InMeasuredLines "2D object located in measured lines of the corridor";
CM_ SG_ 90 VFC_Oca050_TimeToEnterCorridor "Time to enter corridor (TTEC)";
CM_ SG_ 90 VFC_Oca050_TimeToLeaveCorridor "Time to leave corridor (TTLC)";
CM_ SG_ 90 VFC_Oca051_ObjIdRef "Reference to unique Object ID (VFC_Objxx_ObjId). Reference to PreReactionObject not needed. ISO 23150:2023: Object ID reference - object level (A.2.179)";
CM_ SG_ 90 VFC_Oca051_CorridorTypeRef "Reference to Corridor type";
CM_ SG_ 90 VFC_Oca051_ObjPosition "2D object position to a corridor";
CM_ SG_ 90 VFC_Oca051_CorridorOverlap "2D relation between object width and corridor";
CM_ SG_ 90 VFC_Oca051_InMeasuredLines "2D object located in measured lines of the corridor";
CM_ SG_ 90 VFC_Oca051_TimeToEnterCorridor "Time to enter corridor (TTEC)";
CM_ SG_ 90 VFC_Oca051_TimeToLeaveCorridor "Time to leave corridor (TTLC)";
CM_ SG_ 90 VFC_Oca052_ObjIdRef "Reference to unique Object ID (VFC_Objxx_ObjId). Reference to PreReactionObject not needed. ISO 23150:2023: Object ID reference - object level (A.2.179)";
CM_ SG_ 90 VFC_Oca052_CorridorTypeRef "Reference to Corridor type";
CM_ SG_ 90 VFC_Oca052_ObjPosition "2D object position to a corridor";
CM_ SG_ 90 VFC_Oca052_CorridorOverlap "2D relation between object width and corridor";
CM_ SG_ 90 VFC_Oca052_InMeasuredLines "2D object located in measured lines of the corridor";
CM_ SG_ 90 VFC_Oca052_TimeToEnterCorridor "Time to enter corridor (TTEC)";
CM_ SG_ 90 VFC_Oca052_TimeToLeaveCorridor "Time to leave corridor (TTLC)";
CM_ SG_ 90 VFC_Oca053_ObjIdRef "Reference to unique Object ID (VFC_Objxx_ObjId). Reference to PreReactionObject not needed. ISO 23150:2023: Object ID reference - object level (A.2.179)";
CM_ SG_ 90 VFC_Oca053_CorridorTypeRef "Reference to Corridor type";
CM_ SG_ 90 VFC_Oca053_ObjPosition "2D object position to a corridor";
CM_ SG_ 90 VFC_Oca053_CorridorOverlap "2D relation between object width and corridor";
CM_ SG_ 90 VFC_Oca053_InMeasuredLines "2D object located in measured lines of the corridor";
CM_ SG_ 90 VFC_Oca053_TimeToEnterCorridor "Time to enter corridor (TTEC)";
CM_ SG_ 90 VFC_Oca053_TimeToLeaveCorridor "Time to leave corridor (TTLC)";
CM_ SG_ 91 VFC_Oca_054_071_CRC "CRC - Autosar E2E Profile 5";
CM_ SG_ 91 VFC_Oca_054_071_AliveCtr "Alive counter - Autosar E2E Profile 5";
CM_ SG_ 91 VFC_Oca_054_071_ProtBlockCtr "Protocol-Signal: Block-Counter";
CM_ SG_ 91 VFC_Oca054_ObjIdRef "Reference to unique Object ID (VFC_Objxx_ObjId). Reference to PreReactionObject not needed. ISO 23150:2023: Object ID reference - object level (A.2.179)";
CM_ SG_ 91 VFC_Oca054_CorridorTypeRef "Reference to Corridor type";
CM_ SG_ 91 VFC_Oca054_ObjPosition "2D object position to a corridor";
CM_ SG_ 91 VFC_Oca054_CorridorOverlap "2D relation between object width and corridor";
CM_ SG_ 91 VFC_Oca054_InMeasuredLines "2D object located in measured lines of the corridor";
CM_ SG_ 91 VFC_Oca054_TimeToEnterCorridor "Time to enter corridor (TTEC)";
CM_ SG_ 91 VFC_Oca054_TimeToLeaveCorridor "Time to leave corridor (TTLC)";
CM_ SG_ 91 VFC_Oca055_ObjIdRef "Reference to unique Object ID (VFC_Objxx_ObjId). Reference to PreReactionObject not needed. ISO 23150:2023: Object ID reference - object level (A.2.179)";
CM_ SG_ 91 VFC_Oca055_CorridorTypeRef "Reference to Corridor type";
CM_ SG_ 91 VFC_Oca055_ObjPosition "2D object position to a corridor";
CM_ SG_ 91 VFC_Oca055_CorridorOverlap "2D relation between object width and corridor";
CM_ SG_ 91 VFC_Oca055_InMeasuredLines "2D object located in measured lines of the corridor";
CM_ SG_ 91 VFC_Oca055_TimeToEnterCorridor "Time to enter corridor (TTEC)";
CM_ SG_ 91 VFC_Oca055_TimeToLeaveCorridor "Time to leave corridor (TTLC)";
CM_ SG_ 91 VFC_Oca056_ObjIdRef "Reference to unique Object ID (VFC_Objxx_ObjId). Reference to PreReactionObject not needed. ISO 23150:2023: Object ID reference - object level (A.2.179)";
CM_ SG_ 91 VFC_Oca056_CorridorTypeRef "Reference to Corridor type";
CM_ SG_ 91 VFC_Oca056_ObjPosition "2D object position to a corridor";
CM_ SG_ 91 VFC_Oca056_CorridorOverlap "2D relation between object width and corridor";
CM_ SG_ 91 VFC_Oca056_InMeasuredLines "2D object located in measured lines of the corridor";
CM_ SG_ 91 VFC_Oca056_TimeToEnterCorridor "Time to enter corridor (TTEC)";
CM_ SG_ 91 VFC_Oca056_TimeToLeaveCorridor "Time to leave corridor (TTLC)";
CM_ SG_ 91 VFC_Oca057_ObjIdRef "Reference to unique Object ID (VFC_Objxx_ObjId). Reference to PreReactionObject not needed. ISO 23150:2023: Object ID reference - object level (A.2.179)";
CM_ SG_ 91 VFC_Oca057_CorridorTypeRef "Reference to Corridor type";
CM_ SG_ 91 VFC_Oca057_ObjPosition "2D object position to a corridor";
CM_ SG_ 91 VFC_Oca057_CorridorOverlap "2D relation between object width and corridor";
CM_ SG_ 91 VFC_Oca057_InMeasuredLines "2D object located in measured lines of the corridor";
CM_ SG_ 91 VFC_Oca057_TimeToEnterCorridor "Time to enter corridor (TTEC)";
CM_ SG_ 91 VFC_Oca057_TimeToLeaveCorridor "Time to leave corridor (TTLC)";
CM_ SG_ 91 VFC_Oca058_ObjIdRef "Reference to unique Object ID (VFC_Objxx_ObjId). Reference to PreReactionObject not needed. ISO 23150:2023: Object ID reference - object level (A.2.179)";
CM_ SG_ 91 VFC_Oca058_CorridorTypeRef "Reference to Corridor type";
CM_ SG_ 91 VFC_Oca058_ObjPosition "2D object position to a corridor";
CM_ SG_ 91 VFC_Oca058_CorridorOverlap "2D relation between object width and corridor";
CM_ SG_ 91 VFC_Oca058_InMeasuredLines "2D object located in measured lines of the corridor";
CM_ SG_ 91 VFC_Oca058_TimeToEnterCorridor "Time to enter corridor (TTEC)";
CM_ SG_ 91 VFC_Oca058_TimeToLeaveCorridor "Time to leave corridor (TTLC)";
CM_ SG_ 91 VFC_Oca059_ObjIdRef "Reference to unique Object ID (VFC_Objxx_ObjId). Reference to PreReactionObject not needed. ISO 23150:2023: Object ID reference - object level (A.2.179)";
CM_ SG_ 91 VFC_Oca059_CorridorTypeRef "Reference to Corridor type";
CM_ SG_ 91 VFC_Oca059_ObjPosition "2D object position to a corridor";
CM_ SG_ 91 VFC_Oca059_CorridorOverlap "2D relation between object width and corridor";
CM_ SG_ 91 VFC_Oca059_InMeasuredLines "2D object located in measured lines of the corridor";
CM_ SG_ 91 VFC_Oca059_TimeToEnterCorridor "Time to enter corridor (TTEC)";
CM_ SG_ 91 VFC_Oca059_TimeToLeaveCorridor "Time to leave corridor (TTLC)";
CM_ SG_ 91 VFC_Oca060_ObjIdRef "Reference to unique Object ID (VFC_Objxx_ObjId). Reference to PreReactionObject not needed. ISO 23150:2023: Object ID reference - object level (A.2.179)";
CM_ SG_ 91 VFC_Oca060_CorridorTypeRef "Reference to Corridor type";
CM_ SG_ 91 VFC_Oca060_ObjPosition "2D object position to a corridor";
CM_ SG_ 91 VFC_Oca060_CorridorOverlap "2D relation between object width and corridor";
CM_ SG_ 91 VFC_Oca060_InMeasuredLines "2D object located in measured lines of the corridor";
CM_ SG_ 91 VFC_Oca060_TimeToEnterCorridor "Time to enter corridor (TTEC)";
CM_ SG_ 91 VFC_Oca060_TimeToLeaveCorridor "Time to leave corridor (TTLC)";
CM_ SG_ 91 VFC_Oca061_ObjIdRef "Reference to unique Object ID (VFC_Objxx_ObjId). Reference to PreReactionObject not needed. ISO 23150:2023: Object ID reference - object level (A.2.179)";
CM_ SG_ 91 VFC_Oca061_CorridorTypeRef "Reference to Corridor type";
CM_ SG_ 91 VFC_Oca061_ObjPosition "2D object position to a corridor";
CM_ SG_ 91 VFC_Oca061_CorridorOverlap "2D relation between object width and corridor";
CM_ SG_ 91 VFC_Oca061_InMeasuredLines "2D object located in measured lines of the corridor";
CM_ SG_ 91 VFC_Oca061_TimeToEnterCorridor "Time to enter corridor (TTEC)";
CM_ SG_ 91 VFC_Oca061_TimeToLeaveCorridor "Time to leave corridor (TTLC)";
CM_ SG_ 91 VFC_Oca062_ObjIdRef "Reference to unique Object ID (VFC_Objxx_ObjId). Reference to PreReactionObject not needed. ISO 23150:2023: Object ID reference - object level (A.2.179)";
CM_ SG_ 91 VFC_Oca062_CorridorTypeRef "Reference to Corridor type";
CM_ SG_ 91 VFC_Oca062_ObjPosition "2D object position to a corridor";
CM_ SG_ 91 VFC_Oca062_CorridorOverlap "2D relation between object width and corridor";
CM_ SG_ 91 VFC_Oca062_InMeasuredLines "2D object located in measured lines of the corridor";
CM_ SG_ 91 VFC_Oca062_TimeToEnterCorridor "Time to enter corridor (TTEC)";
CM_ SG_ 91 VFC_Oca062_TimeToLeaveCorridor "Time to leave corridor (TTLC)";
CM_ SG_ 91 VFC_Oca063_ObjIdRef "Reference to unique Object ID (VFC_Objxx_ObjId). Reference to PreReactionObject not needed. ISO 23150:2023: Object ID reference - object level (A.2.179)";
CM_ SG_ 91 VFC_Oca063_CorridorTypeRef "Reference to Corridor type";
CM_ SG_ 91 VFC_Oca063_ObjPosition "2D object position to a corridor";
CM_ SG_ 91 VFC_Oca063_CorridorOverlap "2D relation between object width and corridor";
CM_ SG_ 91 VFC_Oca063_InMeasuredLines "2D object located in measured lines of the corridor";
CM_ SG_ 91 VFC_Oca063_TimeToEnterCorridor "Time to enter corridor (TTEC)";
CM_ SG_ 91 VFC_Oca063_TimeToLeaveCorridor "Time to leave corridor (TTLC)";
CM_ SG_ 91 VFC_Oca064_ObjIdRef "Reference to unique Object ID (VFC_Objxx_ObjId). Reference to PreReactionObject not needed. ISO 23150:2023: Object ID reference - object level (A.2.179)";
CM_ SG_ 91 VFC_Oca064_CorridorTypeRef "Reference to Corridor type";
CM_ SG_ 91 VFC_Oca064_ObjPosition "2D object position to a corridor";
CM_ SG_ 91 VFC_Oca064_CorridorOverlap "2D relation between object width and corridor";
CM_ SG_ 91 VFC_Oca064_InMeasuredLines "2D object located in measured lines of the corridor";
CM_ SG_ 91 VFC_Oca064_TimeToEnterCorridor "Time to enter corridor (TTEC)";
CM_ SG_ 91 VFC_Oca064_TimeToLeaveCorridor "Time to leave corridor (TTLC)";
CM_ SG_ 91 VFC_Oca065_ObjIdRef "Reference to unique Object ID (VFC_Objxx_ObjId). Reference to PreReactionObject not needed. ISO 23150:2023: Object ID reference - object level (A.2.179)";
CM_ SG_ 91 VFC_Oca065_CorridorTypeRef "Reference to Corridor type";
CM_ SG_ 91 VFC_Oca065_ObjPosition "2D object position to a corridor";
CM_ SG_ 91 VFC_Oca065_CorridorOverlap "2D relation between object width and corridor";
CM_ SG_ 91 VFC_Oca065_InMeasuredLines "2D object located in measured lines of the corridor";
CM_ SG_ 91 VFC_Oca065_TimeToEnterCorridor "Time to enter corridor (TTEC)";
CM_ SG_ 91 VFC_Oca065_TimeToLeaveCorridor "Time to leave corridor (TTLC)";
CM_ SG_ 91 VFC_Oca066_ObjIdRef "Reference to unique Object ID (VFC_Objxx_ObjId). Reference to PreReactionObject not needed. ISO 23150:2023: Object ID reference - object level (A.2.179)";
CM_ SG_ 91 VFC_Oca066_CorridorTypeRef "Reference to Corridor type";
CM_ SG_ 91 VFC_Oca066_ObjPosition "2D object position to a corridor";
CM_ SG_ 91 VFC_Oca066_CorridorOverlap "2D relation between object width and corridor";
CM_ SG_ 91 VFC_Oca066_InMeasuredLines "2D object located in measured lines of the corridor";
CM_ SG_ 91 VFC_Oca066_TimeToEnterCorridor "Time to enter corridor (TTEC)";
CM_ SG_ 91 VFC_Oca066_TimeToLeaveCorridor "Time to leave corridor (TTLC)";
CM_ SG_ 91 VFC_Oca067_ObjIdRef "Reference to unique Object ID (VFC_Objxx_ObjId). Reference to PreReactionObject not needed. ISO 23150:2023: Object ID reference - object level (A.2.179)";
CM_ SG_ 91 VFC_Oca067_CorridorTypeRef "Reference to Corridor type";
CM_ SG_ 91 VFC_Oca067_ObjPosition "2D object position to a corridor";
CM_ SG_ 91 VFC_Oca067_CorridorOverlap "2D relation between object width and corridor";
CM_ SG_ 91 VFC_Oca067_InMeasuredLines "2D object located in measured lines of the corridor";
CM_ SG_ 91 VFC_Oca067_TimeToEnterCorridor "Time to enter corridor (TTEC)";
CM_ SG_ 91 VFC_Oca067_TimeToLeaveCorridor "Time to leave corridor (TTLC)";
CM_ SG_ 91 VFC_Oca068_ObjIdRef "Reference to unique Object ID (VFC_Objxx_ObjId). Reference to PreReactionObject not needed. ISO 23150:2023: Object ID reference - object level (A.2.179)";
CM_ SG_ 91 VFC_Oca068_CorridorTypeRef "Reference to Corridor type";
CM_ SG_ 91 VFC_Oca068_ObjPosition "2D object position to a corridor";
CM_ SG_ 91 VFC_Oca068_CorridorOverlap "2D relation between object width and corridor";
CM_ SG_ 91 VFC_Oca068_InMeasuredLines "2D object located in measured lines of the corridor";
CM_ SG_ 91 VFC_Oca068_TimeToEnterCorridor "Time to enter corridor (TTEC)";
CM_ SG_ 91 VFC_Oca068_TimeToLeaveCorridor "Time to leave corridor (TTLC)";
CM_ SG_ 91 VFC_Oca069_ObjIdRef "Reference to unique Object ID (VFC_Objxx_ObjId). Reference to PreReactionObject not needed. ISO 23150:2023: Object ID reference - object level (A.2.179)";
CM_ SG_ 91 VFC_Oca069_CorridorTypeRef "Reference to Corridor type";
CM_ SG_ 91 VFC_Oca069_ObjPosition "2D object position to a corridor";
CM_ SG_ 91 VFC_Oca069_CorridorOverlap "2D relation between object width and corridor";
CM_ SG_ 91 VFC_Oca069_InMeasuredLines "2D object located in measured lines of the corridor";
CM_ SG_ 91 VFC_Oca069_TimeToEnterCorridor "Time to enter corridor (TTEC)";
CM_ SG_ 91 VFC_Oca069_TimeToLeaveCorridor "Time to leave corridor (TTLC)";
CM_ SG_ 91 VFC_Oca070_ObjIdRef "Reference to unique Object ID (VFC_Objxx_ObjId). Reference to PreReactionObject not needed. ISO 23150:2023: Object ID reference - object level (A.2.179)";
CM_ SG_ 91 VFC_Oca070_CorridorTypeRef "Reference to Corridor type";
CM_ SG_ 91 VFC_Oca070_ObjPosition "2D object position to a corridor";
CM_ SG_ 91 VFC_Oca070_CorridorOverlap "2D relation between object width and corridor";
CM_ SG_ 91 VFC_Oca070_InMeasuredLines "2D object located in measured lines of the corridor";
CM_ SG_ 91 VFC_Oca070_TimeToEnterCorridor "Time to enter corridor (TTEC)";
CM_ SG_ 91 VFC_Oca070_TimeToLeaveCorridor "Time to leave corridor (TTLC)";
CM_ SG_ 91 VFC_Oca071_ObjIdRef "Reference to unique Object ID (VFC_Objxx_ObjId). Reference to PreReactionObject not needed. ISO 23150:2023: Object ID reference - object level (A.2.179)";
CM_ SG_ 91 VFC_Oca071_CorridorTypeRef "Reference to Corridor type";
CM_ SG_ 91 VFC_Oca071_ObjPosition "2D object position to a corridor";
CM_ SG_ 91 VFC_Oca071_CorridorOverlap "2D relation between object width and corridor";
CM_ SG_ 91 VFC_Oca071_InMeasuredLines "2D object located in measured lines of the corridor";
CM_ SG_ 91 VFC_Oca071_TimeToEnterCorridor "Time to enter corridor (TTEC)";
CM_ SG_ 91 VFC_Oca071_TimeToLeaveCorridor "Time to leave corridor (TTLC)";
CM_ SG_ 128 VFC_RoadHdr_CRC "CRC - Autosar E2E Profile 5";
CM_ SG_ 128 VFC_RoadHdr_AliveCtr "Alive counter - Autosar E2E Profile 5";
CM_ SG_ 128 VFC_RoadHdr_ProtBlockCtr "Protocol-Signal: Block-Counter";
CM_ SG_ 128 VFC_RoadHdr_IfVersionIdMajor "Version information of the interface. e. g. version 1.0: Major = 1. ISO 23150:2022(E): Interface version ID {major, minor, patch} (A.1.1)";
CM_ SG_ 128 VFC_RoadHdr_IfVersionIdMinor "Version information of the interface. e. g. version 1.0: Minor = 0. ISO 23150:2022(E): Interface version ID {major, minor, patch} (A.1.1)";
CM_ SG_ 128 VFC_RoadHdr_NumValidPolynomials "Number of valid polynomials. ISO 23150:2022(E): Number of valid road markings (A.1.12.2)";
CM_ SG_ 128 VFC_RoadHdr_RoadType "ISO 23150:2022(E): Road type (A.2.81)";
CM_ SG_ 128 VFC_RoadHdr_TimeStampStatus "Autosar StbM_TimeBaseStatusType bitfield with extension:
Bit 0: TIMEOUT
Bit 1: Reserved1
Bit 2: SYNC_TO_GATEWAY
Bit 3: GLOBAL_TIME_BASE
Bit 4: TIMELEAP_FUTURE
Bit 5: TIMELEAP_PAST
Bit 6: Reserved6
Bit 7: Extension: GENERAL_ERROR";
CM_ SG_ 128 VFC_RoadHdr_TimeStamp "ISO 23150:2022(E): Time stamp - prediction (A.1.5.1)";
CM_ SG_ 128 VFC_RoadHdr_SensorStatus "Informs the system of the current status of the road detection system";
CM_ SG_ 128 VFC_RoadHdr_NumValid2DPolynomial "Number of valid 2D polynomials. ISO 23150:2022(E): Number of valid road markings (A.1.12.2)";
CM_ SG_ 128 VFC_RoadHdr_RoadSurfCondType "ISO 23150:2022(E): Road surface condition classification type (A.2.88)";
CM_ SG_ 128 VFC_RoadHdr_NumValidRoadMarkings "Number of valid road markings. ISO 23150:2022(E): Number of valid road markings (A.1.12.2)";
CM_ SG_ 128 VFC_RoadHdr_RoadTypeConf "ISO 23150:2022(E): Road type - confidence (A.2.82)";
CM_ SG_ 128 VFC_RoadHdr_RoadSurCondTypeConf "ISO 23150:2022(E): Road surface condition classification type - confidence (A.2.89)";
CM_ SG_ 128 VFC_RoadHdr_2DNormVMean "V-coordinate normalization mean value (in CV coordinates, origin top left)";
CM_ SG_ 128 VFC_RoadHdr_2DNormVMeanStdDev "Standard deviation of v-coordinate normalization mean value (in CV coordinates, origin top left)";
CM_ SG_ 128 VFC_RoadHdr_NumValidClothoids "Number of valid clothoids. ISO 23150:2022(E): Number of valid road markings (A.1.12.2)";
CM_ SG_ 130 VFC_Cloth_00_02_CRC "CRC - Autosar E2E Profile 5";
CM_ SG_ 130 VFC_Cloth_00_02_AliveCtr "Alive counter - Autosar E2E Profile 5";
CM_ SG_ 130 VFC_Cloth_00_02_ProtBlockCtr "Protocol-Signal: Block-Counter";
CM_ SG_ 130 VFC_Cloth00_LaneAssociation "Position relative to the ego lane. ISO 23150:2022(E): Road object lane association (A.2.93)";
CM_ SG_ 130 VFC_Cloth00_Colour "The color of the line. Similar to ISO 23150:2022(E): Colour value - object level (A.2.107)";
CM_ SG_ 130 VFC_Cloth00_RangeXBegin "Longitudinal begin of the clothoid. ISO 23150:2022(E): Polynomial range x {begin, end} (A.2.120)";
CM_ SG_ 130 VFC_Cloth00_RangeXEnd "Longitudinal end of the clothoid. ISO 23150:2022(E): Polynomial range x {begin, end} (A.2.120)";
CM_ SG_ 130 VFC_Cloth00_ExistProb "Confidence for this clothoid, probability that it describes the true lane boundary. ISO 23150:2022(E): Existence probability - object level (A.2.1)";
CM_ SG_ 130 VFC_Cloth00_CurvChange "Curvature change or alteration of the clothoid, also called kappaDt (resolution = 2^-29)";
CM_ SG_ 130 VFC_Cloth00_Curv "Curvature of the clothoid, also called kappa (resolution = 2^-18)";
CM_ SG_ 130 VFC_Cloth00_PyStdDev "Standard deviation at x=0 of the lateral offset (resolution = 2^-7)";
CM_ SG_ 130 VFC_Cloth00_Py "Lateral offset at x=0, also called LatDeviation (resolution = 2^-7)";
CM_ SG_ 130 VFC_Cloth00_OrientationYaw "Heading angle, difference in yaw angle between vehicle heading and clothoid (resolution = 2^-11). ISO 23150:2022(E): Orientation {yaw, pitch, roll} (A.2.17)";
CM_ SG_ 130 VFC_Cloth00_Width "Width of the line. ISO 23150:2022(E): Extent {width} - polynomial (A.2.121)";
CM_ SG_ 130 VFC_Cloth00_Type "Type of the Line. ISO 23150:2022(E): Road marking type (A.2.91)";
CM_ SG_ 130 VFC_Cloth01_LaneAssociation "Position relative to the ego lane. ISO 23150:2022(E): Road object lane association (A.2.93)";
CM_ SG_ 130 VFC_Cloth01_Colour "The color of the line. Similar to ISO 23150:2022(E): Colour value - object level (A.2.107)";
CM_ SG_ 130 VFC_Cloth01_RangeXBegin "Longitudinal begin of the clothoid. ISO 23150:2022(E): Polynomial range x {begin, end} (A.2.120)";
CM_ SG_ 130 VFC_Cloth01_RangeXEnd "Longitudinal end of the clothoid. ISO 23150:2022(E): Polynomial range x {begin, end} (A.2.120)";
CM_ SG_ 130 VFC_Cloth01_ExistProb "Confidence for this clothoid, probability that it describes the true lane boundary. ISO 23150:2022(E): Existence probability - object level (A.2.1)";
CM_ SG_ 130 VFC_Cloth01_CurvChange "Curvature change or alteration of the clothoid, also called kappaDt (resolution = 2^-29)";
CM_ SG_ 130 VFC_Cloth01_Curv "Curvature of the clothoid, also called kappa (resolution = 2^-18)";
CM_ SG_ 130 VFC_Cloth01_PyStdDev "Standard deviation at x=0 of the lateral offset (resolution = 2^-7)";
CM_ SG_ 130 VFC_Cloth01_Py "Lateral offset at x=0, also called LatDeviation (resolution = 2^-7)";
CM_ SG_ 130 VFC_Cloth01_OrientationYaw "Heading angle, difference in yaw angle between vehicle heading and clothoid (resolution = 2^-11). ISO 23150:2022(E): Orientation {yaw, pitch, roll} (A.2.17)";
CM_ SG_ 130 VFC_Cloth01_Width "Width of the line. ISO 23150:2022(E): Extent {width} - polynomial (A.2.121)";
CM_ SG_ 130 VFC_Cloth01_Type "Type of the Line. ISO 23150:2022(E): Road marking type (A.2.91)";
CM_ SG_ 130 VFC_Cloth02_LaneAssociation "Position relative to the ego lane. ISO 23150:2022(E): Road object lane association (A.2.93)";
CM_ SG_ 130 VFC_Cloth02_Colour "The color of the line. Similar to ISO 23150:2022(E): Colour value - object level (A.2.107)";
CM_ SG_ 130 VFC_Cloth02_RangeXBegin "Longitudinal begin of the clothoid. ISO 23150:2022(E): Polynomial range x {begin, end} (A.2.120)";
CM_ SG_ 130 VFC_Cloth02_RangeXEnd "Longitudinal end of the clothoid. ISO 23150:2022(E): Polynomial range x {begin, end} (A.2.120)";
CM_ SG_ 130 VFC_Cloth02_ExistProb "Confidence for this clothoid, probability that it describes the true lane boundary. ISO 23150:2022(E): Existence probability - object level (A.2.1)";
CM_ SG_ 130 VFC_Cloth02_CurvChange "Curvature change or alteration of the clothoid, also called kappaDt (resolution = 2^-29)";
CM_ SG_ 130 VFC_Cloth02_Curv "Curvature of the clothoid, also called kappa (resolution = 2^-18)";
CM_ SG_ 130 VFC_Cloth02_PyStdDev "Standard deviation at x=0 of the lateral offset (resolution = 2^-7)";
CM_ SG_ 130 VFC_Cloth02_Py "Lateral offset at x=0, also called LatDeviation (resolution = 2^-7)";
CM_ SG_ 130 VFC_Cloth02_OrientationYaw "Heading angle, difference in yaw angle between vehicle heading and clothoid (resolution = 2^-11). ISO 23150:2022(E): Orientation {yaw, pitch, roll} (A.2.17)";
CM_ SG_ 130 VFC_Cloth02_Width "Width of the line. ISO 23150:2022(E): Extent {width} - polynomial (A.2.121)";
CM_ SG_ 130 VFC_Cloth02_Type "Type of the Line. ISO 23150:2022(E): Road marking type (A.2.91)";
BA_DEF_ BO_  "CANFD_BRS" ENUM  "0","1";
BA_DEF_ BO_  "GenMsgCycleTime" INT 0 65535;
BA_DEF_ BO_  "GenMsgILSupport" ENUM  "No","Yes";
BA_DEF_ BO_  "GenMsgSendType" ENUM  "Cyclic","Event","reserved","reserved","reserved","reserved","reserved","IfActive","NoMsgSendType","reserved","reserved","reserved";
BA_DEF_ BO_  "VFrameFormat" ENUM  "StandardCAN","ExtendedCAN","reserved","reserved","reserved","reserved","reserved","reserved","reserved","reserved","reserved","reserved","reserved","reserved","StandardCAN_FD","ExtendedCAN_FD";
BA_DEF_ BO_  "E2Eprofile" STRING ;
BA_DEF_ BO_  "DataID" HEX 0 655535;
BA_DEF_ SG_  "GenSigSendType" ENUM  "Cyclic","OnWrite","OnWriteWithRepetition","OnChange","OnChangeWithRepetition","IfActive","IfActiveWithRepetition","NoSigSendType","OnChangeAndIfActive","OnChangeAndIfActiveWithRepetition";
BA_DEF_ SG_  "GenSigStartValue" HEX 0 2147483648;
BA_DEF_DEF_  "CANFD_BRS" "1";
BA_DEF_DEF_  "GenMsgCycleTime" 0;
BA_DEF_DEF_  "GenMsgILSupport" "Yes";
BA_DEF_DEF_  "GenMsgSendType" "Cyclic";
BA_DEF_DEF_  "VFrameFormat" "";
BA_DEF_DEF_  "E2Eprofile" "None";
BA_DEF_DEF_  "DataID" 0;
BA_DEF_DEF_  "GenSigSendType" "NoSigSendType";
BA_DEF_DEF_  "GenSigStartValue" 0;
BA_ "GenMsgSendType" BO_ 75 1;
BA_ "E2Eprofile" BO_ 75 "AUTOSAR Profile 5";
BA_ "DataID" BO_ 75 8267;
BA_ "VFrameFormat" BO_ 75 14;
BA_ "GenMsgSendType" BO_ 76 1;
BA_ "E2Eprofile" BO_ 76 "AUTOSAR Profile 5";
BA_ "DataID" BO_ 76 8268;
BA_ "VFrameFormat" BO_ 76 14;
BA_ "GenMsgSendType" BO_ 77 1;
BA_ "E2Eprofile" BO_ 77 "AUTOSAR Profile 5";
BA_ "DataID" BO_ 77 8269;
BA_ "VFrameFormat" BO_ 77 14;
BA_ "GenMsgSendType" BO_ 86 1;
BA_ "E2Eprofile" BO_ 86 "AUTOSAR Profile 5";
BA_ "DataID" BO_ 86 8278;
BA_ "VFrameFormat" BO_ 86 14;
BA_ "GenMsgSendType" BO_ 88 1;
BA_ "E2Eprofile" BO_ 88 "AUTOSAR Profile 5";
BA_ "DataID" BO_ 88 8280;
BA_ "VFrameFormat" BO_ 88 14;
BA_ "GenMsgSendType" BO_ 89 1;
BA_ "E2Eprofile" BO_ 89 "AUTOSAR Profile 5";
BA_ "DataID" BO_ 89 8281;
BA_ "VFrameFormat" BO_ 89 14;
BA_ "GenMsgSendType" BO_ 90 1;
BA_ "E2Eprofile" BO_ 90 "AUTOSAR Profile 5";
BA_ "DataID" BO_ 90 8282;
BA_ "VFrameFormat" BO_ 90 14;
BA_ "GenMsgSendType" BO_ 91 1;
BA_ "E2Eprofile" BO_ 91 "AUTOSAR Profile 5";
BA_ "DataID" BO_ 91 8283;
BA_ "VFrameFormat" BO_ 91 14;
BA_ "GenMsgSendType" BO_ 128 1;
BA_ "E2Eprofile" BO_ 128 "AUTOSAR Profile 5";
BA_ "DataID" BO_ 128 8320;
BA_ "VFrameFormat" BO_ 128 14;
BA_ "GenMsgSendType" BO_ 130 1;
BA_ "E2Eprofile" BO_ 130 "AUTOSAR Profile 5";
BA_ "DataID" BO_ 130 8322;
BA_ "VFrameFormat" BO_ 130 14;
BA_ "GenSigStartValue" SG_ 75 VFC_Obj21_Py 8192;
BA_ "GenSigStartValue" SG_ 75 VFC_Obj21_OrientationYaw 256;
BA_ "GenSigStartValue" SG_ 75 VFC_Obj21_Vx 1540;
BA_ "GenSigStartValue" SG_ 75 VFC_Obj21_Vy 512;
BA_ "GenSigStartValue" SG_ 75 VFC_Obj21_Ax 256;
BA_ "GenSigStartValue" SG_ 75 VFC_Obj21_Ay 128;
BA_ "GenSigStartValue" SG_ 75 VFC_Obj21_2DAngPosEdgeLeft 4096;
BA_ "GenSigStartValue" SG_ 75 VFC_Obj21_2DAngPosEdgeRight 4096;
BA_ "GenSigStartValue" SG_ 75 VFC_Obj21_2DAngPosEdgeFar 4096;
BA_ "GenSigStartValue" SG_ 75 VFC_Obj21_2DAngPosEdgeBot 2048;
BA_ "GenSigStartValue" SG_ 75 VFC_Obj21_2DNormVx 40000;
BA_ "GenSigStartValue" SG_ 75 VFC_Obj21_2DNormVy 4096;
BA_ "GenSigStartValue" SG_ 75 VFC_Obj21_2DNormAx 5000;
BA_ "GenSigStartValue" SG_ 76 VFC_Obj22_Py 8192;
BA_ "GenSigStartValue" SG_ 76 VFC_Obj22_OrientationYaw 256;
BA_ "GenSigStartValue" SG_ 76 VFC_Obj22_Vx 1540;
BA_ "GenSigStartValue" SG_ 76 VFC_Obj22_Vy 512;
BA_ "GenSigStartValue" SG_ 76 VFC_Obj22_Ax 256;
BA_ "GenSigStartValue" SG_ 76 VFC_Obj22_Ay 128;
BA_ "GenSigStartValue" SG_ 76 VFC_Obj22_2DAngPosEdgeLeft 4096;
BA_ "GenSigStartValue" SG_ 76 VFC_Obj22_2DAngPosEdgeRight 4096;
BA_ "GenSigStartValue" SG_ 76 VFC_Obj22_2DAngPosEdgeFar 4096;
BA_ "GenSigStartValue" SG_ 76 VFC_Obj22_2DAngPosEdgeBot 2048;
BA_ "GenSigStartValue" SG_ 76 VFC_Obj22_2DNormVx 40000;
BA_ "GenSigStartValue" SG_ 76 VFC_Obj22_2DNormVy 4096;
BA_ "GenSigStartValue" SG_ 76 VFC_Obj22_2DNormAx 5000;
BA_ "GenSigStartValue" SG_ 77 VFC_Obj23_Py 8192;
BA_ "GenSigStartValue" SG_ 77 VFC_Obj23_OrientationYaw 256;
BA_ "GenSigStartValue" SG_ 77 VFC_Obj23_Vx 1540;
BA_ "GenSigStartValue" SG_ 77 VFC_Obj23_Vy 512;
BA_ "GenSigStartValue" SG_ 77 VFC_Obj23_Ax 256;
BA_ "GenSigStartValue" SG_ 77 VFC_Obj23_Ay 128;
BA_ "GenSigStartValue" SG_ 77 VFC_Obj23_2DAngPosEdgeLeft 4096;
BA_ "GenSigStartValue" SG_ 77 VFC_Obj23_2DAngPosEdgeRight 4096;
BA_ "GenSigStartValue" SG_ 77 VFC_Obj23_2DAngPosEdgeFar 4096;
BA_ "GenSigStartValue" SG_ 77 VFC_Obj23_2DAngPosEdgeBot 2048;
BA_ "GenSigStartValue" SG_ 77 VFC_Obj23_2DNormVx 40000;
BA_ "GenSigStartValue" SG_ 77 VFC_Obj23_2DNormVy 4096;
BA_ "GenSigStartValue" SG_ 77 VFC_Obj23_2DNormAx 5000;
BA_ "GenSigStartValue" SG_ 86 VFC_OcaHdr_IfVersionIdMajor 1;
BA_ "GenSigStartValue" SG_ 86 VFC_OcaHdr_PreReactObjAccVx 1540;
BA_ "GenSigStartValue" SG_ 128 VFC_RoadHdr_IfVersionIdMajor 3;
BA_ "GenSigStartValue" SG_ 130 VFC_Cloth00_CurvChange 8388607;
BA_ "GenSigStartValue" SG_ 130 VFC_Cloth00_Curv 16384;
BA_ "GenSigStartValue" SG_ 130 VFC_Cloth00_Py 2048;
BA_ "GenSigStartValue" SG_ 130 VFC_Cloth00_OrientationYaw 2048;
BA_ "GenSigStartValue" SG_ 130 VFC_Cloth01_CurvChange 8388607;
BA_ "GenSigStartValue" SG_ 130 VFC_Cloth01_Curv 16384;
BA_ "GenSigStartValue" SG_ 130 VFC_Cloth01_Py 2048;
BA_ "GenSigStartValue" SG_ 130 VFC_Cloth01_OrientationYaw 2048;
BA_ "GenSigStartValue" SG_ 130 VFC_Cloth02_CurvChange 8388607;
BA_ "GenSigStartValue" SG_ 130 VFC_Cloth02_Curv 16384;
BA_ "GenSigStartValue" SG_ 130 VFC_Cloth02_Py 2048;
BA_ "GenSigStartValue" SG_ 130 VFC_Cloth02_OrientationYaw 2048;
VAL_ 75 VFC_Obj21_MeasurementStatus 0 "Invalid" 1 "Measured" 2 "Predicted" 3 "Reserved3" ;
VAL_ 75 VFC_Obj21_ObjId 0 "INVALID" ;
VAL_ 75 VFC_Obj21_Type 0 "NOTYPE" 1 "CAR" 2 "RESERVED02" 3 "TRUCK" 4 "RESERVED04" 5 "RESERVED05" 6 "MOTORCYCLIST" 7 "PEDESTRIAN" 8 "CYCLIST" 9 "BOLLARD" 10 "ROADPOST" 11 "ARROWPOST" 12 "RESERVED12" 13 "RESERVED13" 14 "RESERVED14" 15 "RESERVED15" ;
VAL_ 75 VFC_Obj21_VisibleView 0 "UNKNOWN" 1 "CLASSIC" 2 "SIDE" 3 "CLASSIC_LSHAPE" 4 "SIDE_LSHAPE" 5 "Reserved5" 6 "Reserved6" 7 "Reserved7" ;
VAL_ 75 VFC_Obj21_ClassifiedView 0 "Unknown" 1 "Front" 2 "Rear" 3 "Left" 4 "Right" 5 "Reserved5" 6 "Reserved6" 7 "Reserved7" ;
VAL_ 75 VFC_Obj21_LightStatTurnIndicator 0 "Unknown" 1 "No direction indicator" 2 "Left indicator" 3 "Right indicator" 4 "Warning Lights" 5 "Reserved5" 6 "Reserved6" 7 "Reserved7" ;
VAL_ 75 VFC_Obj21_LightStatBrakeLight 0 "Unknown" 1 "No light detected" 2 "One light detected" 3 "Two lights detected" 4 "Three lights detected" 5 "Reserved5" 6 "Reserved6" 7 "Reserved7" ;
VAL_ 75 VFC_Obj21_OutsideRoadMeasStatus 0 "Invalid" 1 "Measured" 2 "Predicted" 3 "Reserved3" ;
VAL_ 75 VFC_Obj21_OncomingMeasStatus 0 "Invalid" 1 "Measured" 2 "Predicted" 3 "Reserved3" ;
VAL_ 75 VFC_Obj21_MovementStandingMeasSt 0 "Invalid" 1 "Measured" 2 "Predicted" 3 "Reserved3" ;
VAL_ 75 VFC_Obj21_MovementObservedMeasSt 0 "Invalid" 1 "Valid" ;
VAL_ 75 VFC_Obj21_TargetObjTypeAcc 0 "No_target_object" 1 "Ego_0" 2 "Ego_1" 3 "Left_0" 4 "Left_1" 5 "Right_0" 6 "Right_1" 7 "Reserved7" ;
VAL_ 76 VFC_Obj22_MeasurementStatus 0 "Invalid" 1 "Measured" 2 "Predicted" 3 "Reserved3" ;
VAL_ 76 VFC_Obj22_ObjId 0 "INVALID" ;
VAL_ 76 VFC_Obj22_Type 0 "NOTYPE" 1 "CAR" 2 "RESERVED02" 3 "TRUCK" 4 "RESERVED04" 5 "RESERVED05" 6 "MOTORCYCLIST" 7 "PEDESTRIAN" 8 "CYCLIST" 9 "BOLLARD" 10 "ROADPOST" 11 "ARROWPOST" 12 "RESERVED12" 13 "RESERVED13" 14 "RESERVED14" 15 "RESERVED15" ;
VAL_ 76 VFC_Obj22_VisibleView 0 "UNKNOWN" 1 "CLASSIC" 2 "SIDE" 3 "CLASSIC_LSHAPE" 4 "SIDE_LSHAPE" 5 "Reserved5" 6 "Reserved6" 7 "Reserved7" ;
VAL_ 76 VFC_Obj22_ClassifiedView 0 "Unknown" 1 "Front" 2 "Rear" 3 "Left" 4 "Right" 5 "Reserved5" 6 "Reserved6" 7 "Reserved7" ;
VAL_ 76 VFC_Obj22_LightStatTurnIndicator 0 "Unknown" 1 "No direction indicator" 2 "Left indicator" 3 "Right indicator" 4 "Warning Lights" 5 "Reserved5" 6 "Reserved6" 7 "Reserved7" ;
VAL_ 76 VFC_Obj22_LightStatBrakeLight 0 "Unknown" 1 "No light detected" 2 "One light detected" 3 "Two lights detected" 4 "Three lights detected" 5 "Reserved5" 6 "Reserved6" 7 "Reserved7" ;
VAL_ 76 VFC_Obj22_OutsideRoadMeasStatus 0 "Invalid" 1 "Measured" 2 "Predicted" 3 "Reserved3" ;
VAL_ 76 VFC_Obj22_OncomingMeasStatus 0 "Invalid" 1 "Measured" 2 "Predicted" 3 "Reserved3" ;
VAL_ 76 VFC_Obj22_MovementStandingMeasSt 0 "Invalid" 1 "Measured" 2 "Predicted" 3 "Reserved3" ;
VAL_ 76 VFC_Obj22_MovementObservedMeasSt 0 "Invalid" 1 "Valid" ;
VAL_ 76 VFC_Obj22_TargetObjTypeAcc 0 "No_target_object" 1 "Ego_0" 2 "Ego_1" 3 "Left_0" 4 "Left_1" 5 "Right_0" 6 "Right_1" 7 "Reserved7" ;
VAL_ 77 VFC_Obj23_MeasurementStatus 0 "Invalid" 1 "Measured" 2 "Predicted" 3 "Reserved3" ;
VAL_ 77 VFC_Obj23_ObjId 0 "INVALID" ;
VAL_ 77 VFC_Obj23_Type 0 "NOTYPE" 1 "CAR" 2 "RESERVED02" 3 "TRUCK" 4 "RESERVED04" 5 "RESERVED05" 6 "MOTORCYCLIST" 7 "PEDESTRIAN" 8 "CYCLIST" 9 "BOLLARD" 10 "ROADPOST" 11 "ARROWPOST" 12 "RESERVED12" 13 "RESERVED13" 14 "RESERVED14" 15 "RESERVED15" ;
VAL_ 77 VFC_Obj23_VisibleView 0 "UNKNOWN" 1 "CLASSIC" 2 "SIDE" 3 "CLASSIC_LSHAPE" 4 "SIDE_LSHAPE" 5 "Reserved5" 6 "Reserved6" 7 "Reserved7" ;
VAL_ 77 VFC_Obj23_ClassifiedView 0 "Unknown" 1 "Front" 2 "Rear" 3 "Left" 4 "Right" 5 "Reserved5" 6 "Reserved6" 7 "Reserved7" ;
VAL_ 77 VFC_Obj23_LightStatTurnIndicator 0 "Unknown" 1 "No direction indicator" 2 "Left indicator" 3 "Right indicator" 4 "Warning Lights" 5 "Reserved5" 6 "Reserved6" 7 "Reserved7" ;
VAL_ 77 VFC_Obj23_LightStatBrakeLight 0 "Unknown" 1 "No light detected" 2 "One light detected" 3 "Two lights detected" 4 "Three lights detected" 5 "Reserved5" 6 "Reserved6" 7 "Reserved7" ;
VAL_ 77 VFC_Obj23_OutsideRoadMeasStatus 0 "Invalid" 1 "Measured" 2 "Predicted" 3 "Reserved3" ;
VAL_ 77 VFC_Obj23_OncomingMeasStatus 0 "Invalid" 1 "Measured" 2 "Predicted" 3 "Reserved3" ;
VAL_ 77 VFC_Obj23_MovementStandingMeasSt 0 "Invalid" 1 "Measured" 2 "Predicted" 3 "Reserved3" ;
VAL_ 77 VFC_Obj23_MovementObservedMeasSt 0 "Invalid" 1 "Valid" ;
VAL_ 77 VFC_Obj23_TargetObjTypeAcc 0 "No_target_object" 1 "Ego_0" 2 "Ego_1" 3 "Left_0" 4 "Left_1" 5 "Right_0" 6 "Right_1" 7 "Reserved7" ;
VAL_ 86 VFC_OcaHdr_CorrEgoLineTypeLeft 0 "Invalid" 1 "Measured" 2 "Virtual" 3 "VehicleTrack" 4 "RoadBoundary" 5 "Reserved5" 6 "Reserved6" 7 "Reserved7" ;
VAL_ 86 VFC_OcaHdr_CorrEgoLineTypeRight 0 "Invalid" 1 "Measured" 2 "Virtual" 3 "VehicleTrack" 4 "RoadBoundary" 5 "Reserved5" 6 "Reserved6" 7 "Reserved7" ;
VAL_ 86 VFC_OcaHdr_CorrLeftLineTypeLeft 0 "Invalid" 1 "Measured" 2 "Virtual" 3 "VehicleTrack" 4 "RoadBoundary" 5 "Reserved5" 6 "Reserved6" 7 "Reserved7" ;
VAL_ 86 VFC_OcaHdr_CorrLeftLineTypeRight 0 "Invalid" 1 "Measured" 2 "Virtual" 3 "VehicleTrack" 4 "RoadBoundary" 5 "Reserved5" 6 "Reserved6" 7 "Reserved7" ;
VAL_ 86 VFC_OcaHdr_CorrRightLineTypeLeft 0 "Invalid" 1 "Measured" 2 "Virtual" 3 "VehicleTrack" 4 "RoadBoundary" 5 "Reserved5" 6 "Reserved6" 7 "Reserved7" ;
VAL_ 86 VFC_OcaHdr_CorrRightLineTypeR 0 "Invalid" 1 "Measured" 2 "Virtual" 3 "VehicleTrack" 4 "RoadBoundary" 5 "Reserved5" 6 "Reserved6" 7 "Reserved7" ;
VAL_ 86 VFC_OcaHdr_CorrEgoLaneLineTypeL 0 "Invalid" 1 "Measured" 2 "Virtual" 3 "VehicleTrack" 4 "RoadBoundary" 5 "Reserved5" 6 "Reserved6" 7 "Reserved7" ;
VAL_ 86 VFC_OcaHdr_CorrEgoLaneLineTypeR 0 "Invalid" 1 "Measured" 2 "Virtual" 3 "VehicleTrack" 4 "RoadBoundary" 5 "Reserved5" 6 "Reserved6" 7 "Reserved7" ;
VAL_ 88 VFC_Oca000_ObjIdRef 0 "INVALID" ;
VAL_ 88 VFC_Oca000_CorridorTypeRef 0 "Invalid" 1 "Ego" 2 "Left" 3 "Right" 4 "Ego_Lane" 5 "Reserved5" 6 "Reserved6" 7 "Reserved7" ;
VAL_ 88 VFC_Oca000_ObjPosition 0 "Unknown" 1 "On_Line_Left" 2 "On_Line_Right" 3 "On_Side_Left" 4 "On_Side_Right" 5 "In_Corridor" 6 "Reserved6" 7 "Reserved7" ;
VAL_ 88 VFC_Oca001_ObjIdRef 0 "INVALID" ;
VAL_ 88 VFC_Oca001_CorridorTypeRef 0 "Invalid" 1 "Ego" 2 "Left" 3 "Right" 4 "Ego_Lane" 5 "Reserved5" 6 "Reserved6" 7 "Reserved7" ;
VAL_ 88 VFC_Oca001_ObjPosition 0 "Unknown" 1 "On_Line_Left" 2 "On_Line_Right" 3 "On_Side_Left" 4 "On_Side_Right" 5 "In_Corridor" 6 "Reserved6" 7 "Reserved7" ;
VAL_ 88 VFC_Oca002_ObjIdRef 0 "INVALID" ;
VAL_ 88 VFC_Oca002_CorridorTypeRef 0 "Invalid" 1 "Ego" 2 "Left" 3 "Right" 4 "Ego_Lane" 5 "Reserved5" 6 "Reserved6" 7 "Reserved7" ;
VAL_ 88 VFC_Oca002_ObjPosition 0 "Unknown" 1 "On_Line_Left" 2 "On_Line_Right" 3 "On_Side_Left" 4 "On_Side_Right" 5 "In_Corridor" 6 "Reserved6" 7 "Reserved7" ;
VAL_ 88 VFC_Oca003_ObjIdRef 0 "INVALID" ;
VAL_ 88 VFC_Oca003_CorridorTypeRef 0 "Invalid" 1 "Ego" 2 "Left" 3 "Right" 4 "Ego_Lane" 5 "Reserved5" 6 "Reserved6" 7 "Reserved7" ;
VAL_ 88 VFC_Oca003_ObjPosition 0 "Unknown" 1 "On_Line_Left" 2 "On_Line_Right" 3 "On_Side_Left" 4 "On_Side_Right" 5 "In_Corridor" 6 "Reserved6" 7 "Reserved7" ;
VAL_ 88 VFC_Oca004_ObjIdRef 0 "INVALID" ;
VAL_ 88 VFC_Oca004_CorridorTypeRef 0 "Invalid" 1 "Ego" 2 "Left" 3 "Right" 4 "Ego_Lane" 5 "Reserved5" 6 "Reserved6" 7 "Reserved7" ;
VAL_ 88 VFC_Oca004_ObjPosition 0 "Unknown" 1 "On_Line_Left" 2 "On_Line_Right" 3 "On_Side_Left" 4 "On_Side_Right" 5 "In_Corridor" 6 "Reserved6" 7 "Reserved7" ;
VAL_ 88 VFC_Oca005_ObjIdRef 0 "INVALID" ;
VAL_ 88 VFC_Oca005_CorridorTypeRef 0 "Invalid" 1 "Ego" 2 "Left" 3 "Right" 4 "Ego_Lane" 5 "Reserved5" 6 "Reserved6" 7 "Reserved7" ;
VAL_ 88 VFC_Oca005_ObjPosition 0 "Unknown" 1 "On_Line_Left" 2 "On_Line_Right" 3 "On_Side_Left" 4 "On_Side_Right" 5 "In_Corridor" 6 "Reserved6" 7 "Reserved7" ;
VAL_ 88 VFC_Oca006_ObjIdRef 0 "INVALID" ;
VAL_ 88 VFC_Oca006_CorridorTypeRef 0 "Invalid" 1 "Ego" 2 "Left" 3 "Right" 4 "Ego_Lane" 5 "Reserved5" 6 "Reserved6" 7 "Reserved7" ;
VAL_ 88 VFC_Oca006_ObjPosition 0 "Unknown" 1 "On_Line_Left" 2 "On_Line_Right" 3 "On_Side_Left" 4 "On_Side_Right" 5 "In_Corridor" 6 "Reserved6" 7 "Reserved7" ;
VAL_ 88 VFC_Oca007_ObjIdRef 0 "INVALID" ;
VAL_ 88 VFC_Oca007_CorridorTypeRef 0 "Invalid" 1 "Ego" 2 "Left" 3 "Right" 4 "Ego_Lane" 5 "Reserved5" 6 "Reserved6" 7 "Reserved7" ;
VAL_ 88 VFC_Oca007_ObjPosition 0 "Unknown" 1 "On_Line_Left" 2 "On_Line_Right" 3 "On_Side_Left" 4 "On_Side_Right" 5 "In_Corridor" 6 "Reserved6" 7 "Reserved7" ;
VAL_ 88 VFC_Oca008_ObjIdRef 0 "INVALID" ;
VAL_ 88 VFC_Oca008_CorridorTypeRef 0 "Invalid" 1 "Ego" 2 "Left" 3 "Right" 4 "Ego_Lane" 5 "Reserved5" 6 "Reserved6" 7 "Reserved7" ;
VAL_ 88 VFC_Oca008_ObjPosition 0 "Unknown" 1 "On_Line_Left" 2 "On_Line_Right" 3 "On_Side_Left" 4 "On_Side_Right" 5 "In_Corridor" 6 "Reserved6" 7 "Reserved7" ;
VAL_ 88 VFC_Oca009_ObjIdRef 0 "INVALID" ;
VAL_ 88 VFC_Oca009_CorridorTypeRef 0 "Invalid" 1 "Ego" 2 "Left" 3 "Right" 4 "Ego_Lane" 5 "Reserved5" 6 "Reserved6" 7 "Reserved7" ;
VAL_ 88 VFC_Oca009_ObjPosition 0 "Unknown" 1 "On_Line_Left" 2 "On_Line_Right" 3 "On_Side_Left" 4 "On_Side_Right" 5 "In_Corridor" 6 "Reserved6" 7 "Reserved7" ;
VAL_ 88 VFC_Oca010_ObjIdRef 0 "INVALID" ;
VAL_ 88 VFC_Oca010_CorridorTypeRef 0 "Invalid" 1 "Ego" 2 "Left" 3 "Right" 4 "Ego_Lane" 5 "Reserved5" 6 "Reserved6" 7 "Reserved7" ;
VAL_ 88 VFC_Oca010_ObjPosition 0 "Unknown" 1 "On_Line_Left" 2 "On_Line_Right" 3 "On_Side_Left" 4 "On_Side_Right" 5 "In_Corridor" 6 "Reserved6" 7 "Reserved7" ;
VAL_ 88 VFC_Oca011_ObjIdRef 0 "INVALID" ;
VAL_ 88 VFC_Oca011_CorridorTypeRef 0 "Invalid" 1 "Ego" 2 "Left" 3 "Right" 4 "Ego_Lane" 5 "Reserved5" 6 "Reserved6" 7 "Reserved7" ;
VAL_ 88 VFC_Oca011_ObjPosition 0 "Unknown" 1 "On_Line_Left" 2 "On_Line_Right" 3 "On_Side_Left" 4 "On_Side_Right" 5 "In_Corridor" 6 "Reserved6" 7 "Reserved7" ;
VAL_ 88 VFC_Oca012_ObjIdRef 0 "INVALID" ;
VAL_ 88 VFC_Oca012_CorridorTypeRef 0 "Invalid" 1 "Ego" 2 "Left" 3 "Right" 4 "Ego_Lane" 5 "Reserved5" 6 "Reserved6" 7 "Reserved7" ;
VAL_ 88 VFC_Oca012_ObjPosition 0 "Unknown" 1 "On_Line_Left" 2 "On_Line_Right" 3 "On_Side_Left" 4 "On_Side_Right" 5 "In_Corridor" 6 "Reserved6" 7 "Reserved7" ;
VAL_ 88 VFC_Oca013_ObjIdRef 0 "INVALID" ;
VAL_ 88 VFC_Oca013_CorridorTypeRef 0 "Invalid" 1 "Ego" 2 "Left" 3 "Right" 4 "Ego_Lane" 5 "Reserved5" 6 "Reserved6" 7 "Reserved7" ;
VAL_ 88 VFC_Oca013_ObjPosition 0 "Unknown" 1 "On_Line_Left" 2 "On_Line_Right" 3 "On_Side_Left" 4 "On_Side_Right" 5 "In_Corridor" 6 "Reserved6" 7 "Reserved7" ;
VAL_ 88 VFC_Oca014_ObjIdRef 0 "INVALID" ;
VAL_ 88 VFC_Oca014_CorridorTypeRef 0 "Invalid" 1 "Ego" 2 "Left" 3 "Right" 4 "Ego_Lane" 5 "Reserved5" 6 "Reserved6" 7 "Reserved7" ;
VAL_ 88 VFC_Oca014_ObjPosition 0 "Unknown" 1 "On_Line_Left" 2 "On_Line_Right" 3 "On_Side_Left" 4 "On_Side_Right" 5 "In_Corridor" 6 "Reserved6" 7 "Reserved7" ;
VAL_ 88 VFC_Oca015_ObjIdRef 0 "INVALID" ;
VAL_ 88 VFC_Oca015_CorridorTypeRef 0 "Invalid" 1 "Ego" 2 "Left" 3 "Right" 4 "Ego_Lane" 5 "Reserved5" 6 "Reserved6" 7 "Reserved7" ;
VAL_ 88 VFC_Oca015_ObjPosition 0 "Unknown" 1 "On_Line_Left" 2 "On_Line_Right" 3 "On_Side_Left" 4 "On_Side_Right" 5 "In_Corridor" 6 "Reserved6" 7 "Reserved7" ;
VAL_ 88 VFC_Oca016_ObjIdRef 0 "INVALID" ;
VAL_ 88 VFC_Oca016_CorridorTypeRef 0 "Invalid" 1 "Ego" 2 "Left" 3 "Right" 4 "Ego_Lane" 5 "Reserved5" 6 "Reserved6" 7 "Reserved7" ;
VAL_ 88 VFC_Oca016_ObjPosition 0 "Unknown" 1 "On_Line_Left" 2 "On_Line_Right" 3 "On_Side_Left" 4 "On_Side_Right" 5 "In_Corridor" 6 "Reserved6" 7 "Reserved7" ;
VAL_ 88 VFC_Oca017_ObjIdRef 0 "INVALID" ;
VAL_ 88 VFC_Oca017_CorridorTypeRef 0 "Invalid" 1 "Ego" 2 "Left" 3 "Right" 4 "Ego_Lane" 5 "Reserved5" 6 "Reserved6" 7 "Reserved7" ;
VAL_ 88 VFC_Oca017_ObjPosition 0 "Unknown" 1 "On_Line_Left" 2 "On_Line_Right" 3 "On_Side_Left" 4 "On_Side_Right" 5 "In_Corridor" 6 "Reserved6" 7 "Reserved7" ;
VAL_ 89 VFC_Oca018_ObjIdRef 0 "INVALID" ;
VAL_ 89 VFC_Oca018_CorridorTypeRef 0 "Invalid" 1 "Ego" 2 "Left" 3 "Right" 4 "Ego_Lane" 5 "Reserved5" 6 "Reserved6" 7 "Reserved7" ;
VAL_ 89 VFC_Oca018_ObjPosition 0 "Unknown" 1 "On_Line_Left" 2 "On_Line_Right" 3 "On_Side_Left" 4 "On_Side_Right" 5 "In_Corridor" 6 "Reserved6" 7 "Reserved7" ;
VAL_ 89 VFC_Oca019_ObjIdRef 0 "INVALID" ;
VAL_ 89 VFC_Oca019_CorridorTypeRef 0 "Invalid" 1 "Ego" 2 "Left" 3 "Right" 4 "Ego_Lane" 5 "Reserved5" 6 "Reserved6" 7 "Reserved7" ;
VAL_ 89 VFC_Oca019_ObjPosition 0 "Unknown" 1 "On_Line_Left" 2 "On_Line_Right" 3 "On_Side_Left" 4 "On_Side_Right" 5 "In_Corridor" 6 "Reserved6" 7 "Reserved7" ;
VAL_ 89 VFC_Oca020_ObjIdRef 0 "INVALID" ;
VAL_ 89 VFC_Oca020_CorridorTypeRef 0 "Invalid" 1 "Ego" 2 "Left" 3 "Right" 4 "Ego_Lane" 5 "Reserved5" 6 "Reserved6" 7 "Reserved7" ;
VAL_ 89 VFC_Oca020_ObjPosition 0 "Unknown" 1 "On_Line_Left" 2 "On_Line_Right" 3 "On_Side_Left" 4 "On_Side_Right" 5 "In_Corridor" 6 "Reserved6" 7 "Reserved7" ;
VAL_ 89 VFC_Oca021_ObjIdRef 0 "INVALID" ;
VAL_ 89 VFC_Oca021_CorridorTypeRef 0 "Invalid" 1 "Ego" 2 "Left" 3 "Right" 4 "Ego_Lane" 5 "Reserved5" 6 "Reserved6" 7 "Reserved7" ;
VAL_ 89 VFC_Oca021_ObjPosition 0 "Unknown" 1 "On_Line_Left" 2 "On_Line_Right" 3 "On_Side_Left" 4 "On_Side_Right" 5 "In_Corridor" 6 "Reserved6" 7 "Reserved7" ;
VAL_ 89 VFC_Oca022_ObjIdRef 0 "INVALID" ;
VAL_ 89 VFC_Oca022_CorridorTypeRef 0 "Invalid" 1 "Ego" 2 "Left" 3 "Right" 4 "Ego_Lane" 5 "Reserved5" 6 "Reserved6" 7 "Reserved7" ;
VAL_ 89 VFC_Oca022_ObjPosition 0 "Unknown" 1 "On_Line_Left" 2 "On_Line_Right" 3 "On_Side_Left" 4 "On_Side_Right" 5 "In_Corridor" 6 "Reserved6" 7 "Reserved7" ;
VAL_ 89 VFC_Oca023_ObjIdRef 0 "INVALID" ;
VAL_ 89 VFC_Oca023_CorridorTypeRef 0 "Invalid" 1 "Ego" 2 "Left" 3 "Right" 4 "Ego_Lane" 5 "Reserved5" 6 "Reserved6" 7 "Reserved7" ;
VAL_ 89 VFC_Oca023_ObjPosition 0 "Unknown" 1 "On_Line_Left" 2 "On_Line_Right" 3 "On_Side_Left" 4 "On_Side_Right" 5 "In_Corridor" 6 "Reserved6" 7 "Reserved7" ;
VAL_ 89 VFC_Oca024_ObjIdRef 0 "INVALID" ;
VAL_ 89 VFC_Oca024_CorridorTypeRef 0 "Invalid" 1 "Ego" 2 "Left" 3 "Right" 4 "Ego_Lane" 5 "Reserved5" 6 "Reserved6" 7 "Reserved7" ;
VAL_ 89 VFC_Oca024_ObjPosition 0 "Unknown" 1 "On_Line_Left" 2 "On_Line_Right" 3 "On_Side_Left" 4 "On_Side_Right" 5 "In_Corridor" 6 "Reserved6" 7 "Reserved7" ;
VAL_ 89 VFC_Oca025_ObjIdRef 0 "INVALID" ;
VAL_ 89 VFC_Oca025_CorridorTypeRef 0 "Invalid" 1 "Ego" 2 "Left" 3 "Right" 4 "Ego_Lane" 5 "Reserved5" 6 "Reserved6" 7 "Reserved7" ;
VAL_ 89 VFC_Oca025_ObjPosition 0 "Unknown" 1 "On_Line_Left" 2 "On_Line_Right" 3 "On_Side_Left" 4 "On_Side_Right" 5 "In_Corridor" 6 "Reserved6" 7 "Reserved7" ;
VAL_ 89 VFC_Oca026_ObjIdRef 0 "INVALID" ;
VAL_ 89 VFC_Oca026_CorridorTypeRef 0 "Invalid" 1 "Ego" 2 "Left" 3 "Right" 4 "Ego_Lane" 5 "Reserved5" 6 "Reserved6" 7 "Reserved7" ;
VAL_ 89 VFC_Oca026_ObjPosition 0 "Unknown" 1 "On_Line_Left" 2 "On_Line_Right" 3 "On_Side_Left" 4 "On_Side_Right" 5 "In_Corridor" 6 "Reserved6" 7 "Reserved7" ;
VAL_ 89 VFC_Oca027_ObjIdRef 0 "INVALID" ;
VAL_ 89 VFC_Oca027_CorridorTypeRef 0 "Invalid" 1 "Ego" 2 "Left" 3 "Right" 4 "Ego_Lane" 5 "Reserved5" 6 "Reserved6" 7 "Reserved7" ;
VAL_ 89 VFC_Oca027_ObjPosition 0 "Unknown" 1 "On_Line_Left" 2 "On_Line_Right" 3 "On_Side_Left" 4 "On_Side_Right" 5 "In_Corridor" 6 "Reserved6" 7 "Reserved7" ;
VAL_ 89 VFC_Oca028_ObjIdRef 0 "INVALID" ;
VAL_ 89 VFC_Oca028_CorridorTypeRef 0 "Invalid" 1 "Ego" 2 "Left" 3 "Right" 4 "Ego_Lane" 5 "Reserved5" 6 "Reserved6" 7 "Reserved7" ;
VAL_ 89 VFC_Oca028_ObjPosition 0 "Unknown" 1 "On_Line_Left" 2 "On_Line_Right" 3 "On_Side_Left" 4 "On_Side_Right" 5 "In_Corridor" 6 "Reserved6" 7 "Reserved7" ;
VAL_ 89 VFC_Oca029_ObjIdRef 0 "INVALID" ;
VAL_ 89 VFC_Oca029_CorridorTypeRef 0 "Invalid" 1 "Ego" 2 "Left" 3 "Right" 4 "Ego_Lane" 5 "Reserved5" 6 "Reserved6" 7 "Reserved7" ;
VAL_ 89 VFC_Oca029_ObjPosition 0 "Unknown" 1 "On_Line_Left" 2 "On_Line_Right" 3 "On_Side_Left" 4 "On_Side_Right" 5 "In_Corridor" 6 "Reserved6" 7 "Reserved7" ;
VAL_ 89 VFC_Oca030_ObjIdRef 0 "INVALID" ;
VAL_ 89 VFC_Oca030_CorridorTypeRef 0 "Invalid" 1 "Ego" 2 "Left" 3 "Right" 4 "Ego_Lane" 5 "Reserved5" 6 "Reserved6" 7 "Reserved7" ;
VAL_ 89 VFC_Oca030_ObjPosition 0 "Unknown" 1 "On_Line_Left" 2 "On_Line_Right" 3 "On_Side_Left" 4 "On_Side_Right" 5 "In_Corridor" 6 "Reserved6" 7 "Reserved7" ;
VAL_ 89 VFC_Oca031_ObjIdRef 0 "INVALID" ;
VAL_ 89 VFC_Oca031_CorridorTypeRef 0 "Invalid" 1 "Ego" 2 "Left" 3 "Right" 4 "Ego_Lane" 5 "Reserved5" 6 "Reserved6" 7 "Reserved7" ;
VAL_ 89 VFC_Oca031_ObjPosition 0 "Unknown" 1 "On_Line_Left" 2 "On_Line_Right" 3 "On_Side_Left" 4 "On_Side_Right" 5 "In_Corridor" 6 "Reserved6" 7 "Reserved7" ;
VAL_ 89 VFC_Oca032_ObjIdRef 0 "INVALID" ;
VAL_ 89 VFC_Oca032_CorridorTypeRef 0 "Invalid" 1 "Ego" 2 "Left" 3 "Right" 4 "Ego_Lane" 5 "Reserved5" 6 "Reserved6" 7 "Reserved7" ;
VAL_ 89 VFC_Oca032_ObjPosition 0 "Unknown" 1 "On_Line_Left" 2 "On_Line_Right" 3 "On_Side_Left" 4 "On_Side_Right" 5 "In_Corridor" 6 "Reserved6" 7 "Reserved7" ;
VAL_ 89 VFC_Oca033_ObjIdRef 0 "INVALID" ;
VAL_ 89 VFC_Oca033_CorridorTypeRef 0 "Invalid" 1 "Ego" 2 "Left" 3 "Right" 4 "Ego_Lane" 5 "Reserved5" 6 "Reserved6" 7 "Reserved7" ;
VAL_ 89 VFC_Oca033_ObjPosition 0 "Unknown" 1 "On_Line_Left" 2 "On_Line_Right" 3 "On_Side_Left" 4 "On_Side_Right" 5 "In_Corridor" 6 "Reserved6" 7 "Reserved7" ;
VAL_ 89 VFC_Oca034_ObjIdRef 0 "INVALID" ;
VAL_ 89 VFC_Oca034_CorridorTypeRef 0 "Invalid" 1 "Ego" 2 "Left" 3 "Right" 4 "Ego_Lane" 5 "Reserved5" 6 "Reserved6" 7 "Reserved7" ;
VAL_ 89 VFC_Oca034_ObjPosition 0 "Unknown" 1 "On_Line_Left" 2 "On_Line_Right" 3 "On_Side_Left" 4 "On_Side_Right" 5 "In_Corridor" 6 "Reserved6" 7 "Reserved7" ;
VAL_ 89 VFC_Oca035_ObjIdRef 0 "INVALID" ;
VAL_ 89 VFC_Oca035_CorridorTypeRef 0 "Invalid" 1 "Ego" 2 "Left" 3 "Right" 4 "Ego_Lane" 5 "Reserved5" 6 "Reserved6" 7 "Reserved7" ;
VAL_ 89 VFC_Oca035_ObjPosition 0 "Unknown" 1 "On_Line_Left" 2 "On_Line_Right" 3 "On_Side_Left" 4 "On_Side_Right" 5 "In_Corridor" 6 "Reserved6" 7 "Reserved7" ;
VAL_ 90 VFC_Oca036_ObjIdRef 0 "INVALID" ;
VAL_ 90 VFC_Oca036_CorridorTypeRef 0 "Invalid" 1 "Ego" 2 "Left" 3 "Right" 4 "Ego_Lane" 5 "Reserved5" 6 "Reserved6" 7 "Reserved7" ;
VAL_ 90 VFC_Oca036_ObjPosition 0 "Unknown" 1 "On_Line_Left" 2 "On_Line_Right" 3 "On_Side_Left" 4 "On_Side_Right" 5 "In_Corridor" 6 "Reserved6" 7 "Reserved7" ;
VAL_ 90 VFC_Oca037_ObjIdRef 0 "INVALID" ;
VAL_ 90 VFC_Oca037_CorridorTypeRef 0 "Invalid" 1 "Ego" 2 "Left" 3 "Right" 4 "Ego_Lane" 5 "Reserved5" 6 "Reserved6" 7 "Reserved7" ;
VAL_ 90 VFC_Oca037_ObjPosition 0 "Unknown" 1 "On_Line_Left" 2 "On_Line_Right" 3 "On_Side_Left" 4 "On_Side_Right" 5 "In_Corridor" 6 "Reserved6" 7 "Reserved7" ;
VAL_ 90 VFC_Oca038_ObjIdRef 0 "INVALID" ;
VAL_ 90 VFC_Oca038_CorridorTypeRef 0 "Invalid" 1 "Ego" 2 "Left" 3 "Right" 4 "Ego_Lane" 5 "Reserved5" 6 "Reserved6" 7 "Reserved7" ;
VAL_ 90 VFC_Oca038_ObjPosition 0 "Unknown" 1 "On_Line_Left" 2 "On_Line_Right" 3 "On_Side_Left" 4 "On_Side_Right" 5 "In_Corridor" 6 "Reserved6" 7 "Reserved7" ;
VAL_ 90 VFC_Oca039_ObjIdRef 0 "INVALID" ;
VAL_ 90 VFC_Oca039_CorridorTypeRef 0 "Invalid" 1 "Ego" 2 "Left" 3 "Right" 4 "Ego_Lane" 5 "Reserved5" 6 "Reserved6" 7 "Reserved7" ;
VAL_ 90 VFC_Oca039_ObjPosition 0 "Unknown" 1 "On_Line_Left" 2 "On_Line_Right" 3 "On_Side_Left" 4 "On_Side_Right" 5 "In_Corridor" 6 "Reserved6" 7 "Reserved7" ;
VAL_ 90 VFC_Oca040_ObjIdRef 0 "INVALID" ;
VAL_ 90 VFC_Oca040_CorridorTypeRef 0 "Invalid" 1 "Ego" 2 "Left" 3 "Right" 4 "Ego_Lane" 5 "Reserved5" 6 "Reserved6" 7 "Reserved7" ;
VAL_ 90 VFC_Oca040_ObjPosition 0 "Unknown" 1 "On_Line_Left" 2 "On_Line_Right" 3 "On_Side_Left" 4 "On_Side_Right" 5 "In_Corridor" 6 "Reserved6" 7 "Reserved7" ;
VAL_ 90 VFC_Oca041_ObjIdRef 0 "INVALID" ;
VAL_ 90 VFC_Oca041_CorridorTypeRef 0 "Invalid" 1 "Ego" 2 "Left" 3 "Right" 4 "Ego_Lane" 5 "Reserved5" 6 "Reserved6" 7 "Reserved7" ;
VAL_ 90 VFC_Oca041_ObjPosition 0 "Unknown" 1 "On_Line_Left" 2 "On_Line_Right" 3 "On_Side_Left" 4 "On_Side_Right" 5 "In_Corridor" 6 "Reserved6" 7 "Reserved7" ;
VAL_ 90 VFC_Oca042_ObjIdRef 0 "INVALID" ;
VAL_ 90 VFC_Oca042_CorridorTypeRef 0 "Invalid" 1 "Ego" 2 "Left" 3 "Right" 4 "Ego_Lane" 5 "Reserved5" 6 "Reserved6" 7 "Reserved7" ;
VAL_ 90 VFC_Oca042_ObjPosition 0 "Unknown" 1 "On_Line_Left" 2 "On_Line_Right" 3 "On_Side_Left" 4 "On_Side_Right" 5 "In_Corridor" 6 "Reserved6" 7 "Reserved7" ;
VAL_ 90 VFC_Oca043_ObjIdRef 0 "INVALID" ;
VAL_ 90 VFC_Oca043_CorridorTypeRef 0 "Invalid" 1 "Ego" 2 "Left" 3 "Right" 4 "Ego_Lane" 5 "Reserved5" 6 "Reserved6" 7 "Reserved7" ;
VAL_ 90 VFC_Oca043_ObjPosition 0 "Unknown" 1 "On_Line_Left" 2 "On_Line_Right" 3 "On_Side_Left" 4 "On_Side_Right" 5 "In_Corridor" 6 "Reserved6" 7 "Reserved7" ;
VAL_ 90 VFC_Oca044_ObjIdRef 0 "INVALID" ;
VAL_ 90 VFC_Oca044_CorridorTypeRef 0 "Invalid" 1 "Ego" 2 "Left" 3 "Right" 4 "Ego_Lane" 5 "Reserved5" 6 "Reserved6" 7 "Reserved7" ;
VAL_ 90 VFC_Oca044_ObjPosition 0 "Unknown" 1 "On_Line_Left" 2 "On_Line_Right" 3 "On_Side_Left" 4 "On_Side_Right" 5 "In_Corridor" 6 "Reserved6" 7 "Reserved7" ;
VAL_ 90 VFC_Oca045_ObjIdRef 0 "INVALID" ;
VAL_ 90 VFC_Oca045_CorridorTypeRef 0 "Invalid" 1 "Ego" 2 "Left" 3 "Right" 4 "Ego_Lane" 5 "Reserved5" 6 "Reserved6" 7 "Reserved7" ;
VAL_ 90 VFC_Oca045_ObjPosition 0 "Unknown" 1 "On_Line_Left" 2 "On_Line_Right" 3 "On_Side_Left" 4 "On_Side_Right" 5 "In_Corridor" 6 "Reserved6" 7 "Reserved7" ;
VAL_ 90 VFC_Oca046_ObjIdRef 0 "INVALID" ;
VAL_ 90 VFC_Oca046_CorridorTypeRef 0 "Invalid" 1 "Ego" 2 "Left" 3 "Right" 4 "Ego_Lane" 5 "Reserved5" 6 "Reserved6" 7 "Reserved7" ;
VAL_ 90 VFC_Oca046_ObjPosition 0 "Unknown" 1 "On_Line_Left" 2 "On_Line_Right" 3 "On_Side_Left" 4 "On_Side_Right" 5 "In_Corridor" 6 "Reserved6" 7 "Reserved7" ;
VAL_ 90 VFC_Oca047_ObjIdRef 0 "INVALID" ;
VAL_ 90 VFC_Oca047_CorridorTypeRef 0 "Invalid" 1 "Ego" 2 "Left" 3 "Right" 4 "Ego_Lane" 5 "Reserved5" 6 "Reserved6" 7 "Reserved7" ;
VAL_ 90 VFC_Oca047_ObjPosition 0 "Unknown" 1 "On_Line_Left" 2 "On_Line_Right" 3 "On_Side_Left" 4 "On_Side_Right" 5 "In_Corridor" 6 "Reserved6" 7 "Reserved7" ;
VAL_ 90 VFC_Oca048_ObjIdRef 0 "INVALID" ;
VAL_ 90 VFC_Oca048_CorridorTypeRef 0 "Invalid" 1 "Ego" 2 "Left" 3 "Right" 4 "Ego_Lane" 5 "Reserved5" 6 "Reserved6" 7 "Reserved7" ;
VAL_ 90 VFC_Oca048_ObjPosition 0 "Unknown" 1 "On_Line_Left" 2 "On_Line_Right" 3 "On_Side_Left" 4 "On_Side_Right" 5 "In_Corridor" 6 "Reserved6" 7 "Reserved7" ;
VAL_ 90 VFC_Oca049_ObjIdRef 0 "INVALID" ;
VAL_ 90 VFC_Oca049_CorridorTypeRef 0 "Invalid" 1 "Ego" 2 "Left" 3 "Right" 4 "Ego_Lane" 5 "Reserved5" 6 "Reserved6" 7 "Reserved7" ;
VAL_ 90 VFC_Oca049_ObjPosition 0 "Unknown" 1 "On_Line_Left" 2 "On_Line_Right" 3 "On_Side_Left" 4 "On_Side_Right" 5 "In_Corridor" 6 "Reserved6" 7 "Reserved7" ;
VAL_ 90 VFC_Oca050_ObjIdRef 0 "INVALID" ;
VAL_ 90 VFC_Oca050_CorridorTypeRef 0 "Invalid" 1 "Ego" 2 "Left" 3 "Right" 4 "Ego_Lane" 5 "Reserved5" 6 "Reserved6" 7 "Reserved7" ;
VAL_ 90 VFC_Oca050_ObjPosition 0 "Unknown" 1 "On_Line_Left" 2 "On_Line_Right" 3 "On_Side_Left" 4 "On_Side_Right" 5 "In_Corridor" 6 "Reserved6" 7 "Reserved7" ;
VAL_ 90 VFC_Oca051_ObjIdRef 0 "INVALID" ;
VAL_ 90 VFC_Oca051_CorridorTypeRef 0 "Invalid" 1 "Ego" 2 "Left" 3 "Right" 4 "Ego_Lane" 5 "Reserved5" 6 "Reserved6" 7 "Reserved7" ;
VAL_ 90 VFC_Oca051_ObjPosition 0 "Unknown" 1 "On_Line_Left" 2 "On_Line_Right" 3 "On_Side_Left" 4 "On_Side_Right" 5 "In_Corridor" 6 "Reserved6" 7 "Reserved7" ;
VAL_ 90 VFC_Oca052_ObjIdRef 0 "INVALID" ;
VAL_ 90 VFC_Oca052_CorridorTypeRef 0 "Invalid" 1 "Ego" 2 "Left" 3 "Right" 4 "Ego_Lane" 5 "Reserved5" 6 "Reserved6" 7 "Reserved7" ;
VAL_ 90 VFC_Oca052_ObjPosition 0 "Unknown" 1 "On_Line_Left" 2 "On_Line_Right" 3 "On_Side_Left" 4 "On_Side_Right" 5 "In_Corridor" 6 "Reserved6" 7 "Reserved7" ;
VAL_ 90 VFC_Oca053_ObjIdRef 0 "INVALID" ;
VAL_ 90 VFC_Oca053_CorridorTypeRef 0 "Invalid" 1 "Ego" 2 "Left" 3 "Right" 4 "Ego_Lane" 5 "Reserved5" 6 "Reserved6" 7 "Reserved7" ;
VAL_ 90 VFC_Oca053_ObjPosition 0 "Unknown" 1 "On_Line_Left" 2 "On_Line_Right" 3 "On_Side_Left" 4 "On_Side_Right" 5 "In_Corridor" 6 "Reserved6" 7 "Reserved7" ;
VAL_ 91 VFC_Oca054_ObjIdRef 0 "INVALID" ;
VAL_ 91 VFC_Oca054_CorridorTypeRef 0 "Invalid" 1 "Ego" 2 "Left" 3 "Right" 4 "Ego_Lane" 5 "Reserved5" 6 "Reserved6" 7 "Reserved7" ;
VAL_ 91 VFC_Oca054_ObjPosition 0 "Unknown" 1 "On_Line_Left" 2 "On_Line_Right" 3 "On_Side_Left" 4 "On_Side_Right" 5 "In_Corridor" 6 "Reserved6" 7 "Reserved7" ;
VAL_ 91 VFC_Oca055_ObjIdRef 0 "INVALID" ;
VAL_ 91 VFC_Oca055_CorridorTypeRef 0 "Invalid" 1 "Ego" 2 "Left" 3 "Right" 4 "Ego_Lane" 5 "Reserved5" 6 "Reserved6" 7 "Reserved7" ;
VAL_ 91 VFC_Oca055_ObjPosition 0 "Unknown" 1 "On_Line_Left" 2 "On_Line_Right" 3 "On_Side_Left" 4 "On_Side_Right" 5 "In_Corridor" 6 "Reserved6" 7 "Reserved7" ;
VAL_ 91 VFC_Oca056_ObjIdRef 0 "INVALID" ;
VAL_ 91 VFC_Oca056_CorridorTypeRef 0 "Invalid" 1 "Ego" 2 "Left" 3 "Right" 4 "Ego_Lane" 5 "Reserved5" 6 "Reserved6" 7 "Reserved7" ;
VAL_ 91 VFC_Oca056_ObjPosition 0 "Unknown" 1 "On_Line_Left" 2 "On_Line_Right" 3 "On_Side_Left" 4 "On_Side_Right" 5 "In_Corridor" 6 "Reserved6" 7 "Reserved7" ;
VAL_ 91 VFC_Oca057_ObjIdRef 0 "INVALID" ;
VAL_ 91 VFC_Oca057_CorridorTypeRef 0 "Invalid" 1 "Ego" 2 "Left" 3 "Right" 4 "Ego_Lane" 5 "Reserved5" 6 "Reserved6" 7 "Reserved7" ;
VAL_ 91 VFC_Oca057_ObjPosition 0 "Unknown" 1 "On_Line_Left" 2 "On_Line_Right" 3 "On_Side_Left" 4 "On_Side_Right" 5 "In_Corridor" 6 "Reserved6" 7 "Reserved7" ;
VAL_ 91 VFC_Oca058_ObjIdRef 0 "INVALID" ;
VAL_ 91 VFC_Oca058_CorridorTypeRef 0 "Invalid" 1 "Ego" 2 "Left" 3 "Right" 4 "Ego_Lane" 5 "Reserved5" 6 "Reserved6" 7 "Reserved7" ;
VAL_ 91 VFC_Oca058_ObjPosition 0 "Unknown" 1 "On_Line_Left" 2 "On_Line_Right" 3 "On_Side_Left" 4 "On_Side_Right" 5 "In_Corridor" 6 "Reserved6" 7 "Reserved7" ;
VAL_ 91 VFC_Oca059_ObjIdRef 0 "INVALID" ;
VAL_ 91 VFC_Oca059_CorridorTypeRef 0 "Invalid" 1 "Ego" 2 "Left" 3 "Right" 4 "Ego_Lane" 5 "Reserved5" 6 "Reserved6" 7 "Reserved7" ;
VAL_ 91 VFC_Oca059_ObjPosition 0 "Unknown" 1 "On_Line_Left" 2 "On_Line_Right" 3 "On_Side_Left" 4 "On_Side_Right" 5 "In_Corridor" 6 "Reserved6" 7 "Reserved7" ;
VAL_ 91 VFC_Oca060_ObjIdRef 0 "INVALID" ;
VAL_ 91 VFC_Oca060_CorridorTypeRef 0 "Invalid" 1 "Ego" 2 "Left" 3 "Right" 4 "Ego_Lane" 5 "Reserved5" 6 "Reserved6" 7 "Reserved7" ;
VAL_ 91 VFC_Oca060_ObjPosition 0 "Unknown" 1 "On_Line_Left" 2 "On_Line_Right" 3 "On_Side_Left" 4 "On_Side_Right" 5 "In_Corridor" 6 "Reserved6" 7 "Reserved7" ;
VAL_ 91 VFC_Oca061_ObjIdRef 0 "INVALID" ;
VAL_ 91 VFC_Oca061_CorridorTypeRef 0 "Invalid" 1 "Ego" 2 "Left" 3 "Right" 4 "Ego_Lane" 5 "Reserved5" 6 "Reserved6" 7 "Reserved7" ;
VAL_ 91 VFC_Oca061_ObjPosition 0 "Unknown" 1 "On_Line_Left" 2 "On_Line_Right" 3 "On_Side_Left" 4 "On_Side_Right" 5 "In_Corridor" 6 "Reserved6" 7 "Reserved7" ;
VAL_ 91 VFC_Oca062_ObjIdRef 0 "INVALID" ;
VAL_ 91 VFC_Oca062_CorridorTypeRef 0 "Invalid" 1 "Ego" 2 "Left" 3 "Right" 4 "Ego_Lane" 5 "Reserved5" 6 "Reserved6" 7 "Reserved7" ;
VAL_ 91 VFC_Oca062_ObjPosition 0 "Unknown" 1 "On_Line_Left" 2 "On_Line_Right" 3 "On_Side_Left" 4 "On_Side_Right" 5 "In_Corridor" 6 "Reserved6" 7 "Reserved7" ;
VAL_ 91 VFC_Oca063_ObjIdRef 0 "INVALID" ;
VAL_ 91 VFC_Oca063_CorridorTypeRef 0 "Invalid" 1 "Ego" 2 "Left" 3 "Right" 4 "Ego_Lane" 5 "Reserved5" 6 "Reserved6" 7 "Reserved7" ;
VAL_ 91 VFC_Oca063_ObjPosition 0 "Unknown" 1 "On_Line_Left" 2 "On_Line_Right" 3 "On_Side_Left" 4 "On_Side_Right" 5 "In_Corridor" 6 "Reserved6" 7 "Reserved7" ;
VAL_ 91 VFC_Oca064_ObjIdRef 0 "INVALID" ;
VAL_ 91 VFC_Oca064_CorridorTypeRef 0 "Invalid" 1 "Ego" 2 "Left" 3 "Right" 4 "Ego_Lane" 5 "Reserved5" 6 "Reserved6" 7 "Reserved7" ;
VAL_ 91 VFC_Oca064_ObjPosition 0 "Unknown" 1 "On_Line_Left" 2 "On_Line_Right" 3 "On_Side_Left" 4 "On_Side_Right" 5 "In_Corridor" 6 "Reserved6" 7 "Reserved7" ;
VAL_ 91 VFC_Oca065_ObjIdRef 0 "INVALID" ;
VAL_ 91 VFC_Oca065_CorridorTypeRef 0 "Invalid" 1 "Ego" 2 "Left" 3 "Right" 4 "Ego_Lane" 5 "Reserved5" 6 "Reserved6" 7 "Reserved7" ;
VAL_ 91 VFC_Oca065_ObjPosition 0 "Unknown" 1 "On_Line_Left" 2 "On_Line_Right" 3 "On_Side_Left" 4 "On_Side_Right" 5 "In_Corridor" 6 "Reserved6" 7 "Reserved7" ;
VAL_ 91 VFC_Oca066_ObjIdRef 0 "INVALID" ;
VAL_ 91 VFC_Oca066_CorridorTypeRef 0 "Invalid" 1 "Ego" 2 "Left" 3 "Right" 4 "Ego_Lane" 5 "Reserved5" 6 "Reserved6" 7 "Reserved7" ;
VAL_ 91 VFC_Oca066_ObjPosition 0 "Unknown" 1 "On_Line_Left" 2 "On_Line_Right" 3 "On_Side_Left" 4 "On_Side_Right" 5 "In_Corridor" 6 "Reserved6" 7 "Reserved7" ;
VAL_ 91 VFC_Oca067_ObjIdRef 0 "INVALID" ;
VAL_ 91 VFC_Oca067_CorridorTypeRef 0 "Invalid" 1 "Ego" 2 "Left" 3 "Right" 4 "Ego_Lane" 5 "Reserved5" 6 "Reserved6" 7 "Reserved7" ;
VAL_ 91 VFC_Oca067_ObjPosition 0 "Unknown" 1 "On_Line_Left" 2 "On_Line_Right" 3 "On_Side_Left" 4 "On_Side_Right" 5 "In_Corridor" 6 "Reserved6" 7 "Reserved7" ;
VAL_ 91 VFC_Oca068_ObjIdRef 0 "INVALID" ;
VAL_ 91 VFC_Oca068_CorridorTypeRef 0 "Invalid" 1 "Ego" 2 "Left" 3 "Right" 4 "Ego_Lane" 5 "Reserved5" 6 "Reserved6" 7 "Reserved7" ;
VAL_ 91 VFC_Oca068_ObjPosition 0 "Unknown" 1 "On_Line_Left" 2 "On_Line_Right" 3 "On_Side_Left" 4 "On_Side_Right" 5 "In_Corridor" 6 "Reserved6" 7 "Reserved7" ;
VAL_ 91 VFC_Oca069_ObjIdRef 0 "INVALID" ;
VAL_ 91 VFC_Oca069_CorridorTypeRef 0 "Invalid" 1 "Ego" 2 "Left" 3 "Right" 4 "Ego_Lane" 5 "Reserved5" 6 "Reserved6" 7 "Reserved7" ;
VAL_ 91 VFC_Oca069_ObjPosition 0 "Unknown" 1 "On_Line_Left" 2 "On_Line_Right" 3 "On_Side_Left" 4 "On_Side_Right" 5 "In_Corridor" 6 "Reserved6" 7 "Reserved7" ;
VAL_ 91 VFC_Oca070_ObjIdRef 0 "INVALID" ;
VAL_ 91 VFC_Oca070_CorridorTypeRef 0 "Invalid" 1 "Ego" 2 "Left" 3 "Right" 4 "Ego_Lane" 5 "Reserved5" 6 "Reserved6" 7 "Reserved7" ;
VAL_ 91 VFC_Oca070_ObjPosition 0 "Unknown" 1 "On_Line_Left" 2 "On_Line_Right" 3 "On_Side_Left" 4 "On_Side_Right" 5 "In_Corridor" 6 "Reserved6" 7 "Reserved7" ;
VAL_ 91 VFC_Oca071_ObjIdRef 0 "INVALID" ;
VAL_ 91 VFC_Oca071_CorridorTypeRef 0 "Invalid" 1 "Ego" 2 "Left" 3 "Right" 4 "Ego_Lane" 5 "Reserved5" 6 "Reserved6" 7 "Reserved7" ;
VAL_ 91 VFC_Oca071_ObjPosition 0 "Unknown" 1 "On_Line_Left" 2 "On_Line_Right" 3 "On_Side_Left" 4 "On_Side_Right" 5 "In_Corridor" 6 "Reserved6" 7 "Reserved7" ;
VAL_ 128 VFC_RoadHdr_RoadType 0 "Motorway" 1 "Motorway roadworks" 2 "Rural" 3 "Urban" ;
VAL_ 128 VFC_RoadHdr_SensorStatus 0 "Off" 1 "On" 2 "Reduced" 3 "HW_Error" 4 "SW_Error" 5 "FID_Active" 6 "Reserved6" 7 "Reserved7" ;
VAL_ 128 VFC_RoadHdr_RoadSurfCondType 0 "Dry" 1 "Wet" 2 "Snow covered" 3 "Reserved3" ;
VAL_ 130 VFC_Cloth00_LaneAssociation 0 "LEFT_EGO_LINE" 1 "RIGHT_EGO_LINE" 2 "LEFT_LEFT_LINE" 3 "RIGHT_RIGHT_LINE" 4 "ROAD_EDGE_LEFT" 5 "ROAD_EDGE_RIGHT" 6 "RAISED_LEFT" 7 "RAISED_RIGHT" 8 "NOT_SELECTED_CANDIDATE" 9 "EGO_TRACK_LEFT" 10 "EGO_TRACK_RIGHT" 11 "HOLISTIC_EGO_LINE" 12 "Reserved12" 13 "Reserved13" 14 "Reserved14" 15 "Reserved15" ;
VAL_ 130 VFC_Cloth00_Colour 0 "COLOR_WHITE" 1 "COLOR_YELLOW" 2 "COLOR_RED" 3 "COLOR_BLUE" 4 "COLOR_GREEN" 5 "RESERVED5" 6 "RESERVED6" 7 "COLOR_UNKNOWN" ;
VAL_ 130 VFC_Cloth00_Type 0 "TYPE_SOLID_LINE" 1 "TYPE_DASHED_LINE" 2 "TYPE_DOUBLE_DASHED_DASHED" 3 "TYPE_DOUBLE_DASHED_SOLID" 4 "TYPE_DOUBLE_SOLID_DASHED" 5 "TYPE_DOUBLE_SOLID_SOLID" 6 "TYPE_MULTIPLE" 7 "TYPE_MULTIPLE_WARNING" 8 "TYPE_BOTTS_DOTS" 9 "TYPE_ROAD_EDGE" 10 "TYPE_ROAD_FURNITURE" 11 "TYPE_CURBSTONE" 12 "TYPE_TRAFFIC_STATIC" 13 "TYPE_UNKNOWN_RAISED" 14 "TYPE_UNKNOWN" 15 "Reserved15" ;
VAL_ 130 VFC_Cloth01_LaneAssociation 0 "LEFT_EGO_LINE" 1 "RIGHT_EGO_LINE" 2 "LEFT_LEFT_LINE" 3 "RIGHT_RIGHT_LINE" 4 "ROAD_EDGE_LEFT" 5 "ROAD_EDGE_RIGHT" 6 "RAISED_LEFT" 7 "RAISED_RIGHT" 8 "NOT_SELECTED_CANDIDATE" 9 "EGO_TRACK_LEFT" 10 "EGO_TRACK_RIGHT" 11 "HOLISTIC_EGO_LINE" 12 "Reserved12" 13 "Reserved13" 14 "Reserved14" 15 "Reserved15" ;
VAL_ 130 VFC_Cloth01_Colour 0 "COLOR_WHITE" 1 "COLOR_YELLOW" 2 "COLOR_RED" 3 "COLOR_BLUE" 4 "COLOR_GREEN" 5 "RESERVED5" 6 "RESERVED6" 7 "COLOR_UNKNOWN" ;
VAL_ 130 VFC_Cloth01_Type 0 "TYPE_SOLID_LINE" 1 "TYPE_DASHED_LINE" 2 "TYPE_DOUBLE_DASHED_DASHED" 3 "TYPE_DOUBLE_DASHED_SOLID" 4 "TYPE_DOUBLE_SOLID_DASHED" 5 "TYPE_DOUBLE_SOLID_SOLID" 6 "TYPE_MULTIPLE" 7 "TYPE_MULTIPLE_WARNING" 8 "TYPE_BOTTS_DOTS" 9 "TYPE_ROAD_EDGE" 10 "TYPE_ROAD_FURNITURE" 11 "TYPE_CURBSTONE" 12 "TYPE_TRAFFIC_STATIC" 13 "TYPE_UNKNOWN_RAISED" 14 "TYPE_UNKNOWN" 15 "Reserved15" ;
VAL_ 130 VFC_Cloth02_LaneAssociation 0 "LEFT_EGO_LINE" 1 "RIGHT_EGO_LINE" 2 "LEFT_LEFT_LINE" 3 "RIGHT_RIGHT_LINE" 4 "ROAD_EDGE_LEFT" 5 "ROAD_EDGE_RIGHT" 6 "RAISED_LEFT" 7 "RAISED_RIGHT" 8 "NOT_SELECTED_CANDIDATE" 9 "EGO_TRACK_LEFT" 10 "EGO_TRACK_RIGHT" 11 "HOLISTIC_EGO_LINE" 12 "Reserved12" 13 "Reserved13" 14 "Reserved14" 15 "Reserved15" ;
VAL_ 130 VFC_Cloth02_Colour 0 "COLOR_WHITE" 1 "COLOR_YELLOW" 2 "COLOR_RED" 3 "COLOR_BLUE" 4 "COLOR_GREEN" 5 "RESERVED5" 6 "RESERVED6" 7 "COLOR_UNKNOWN" ;
VAL_ 130 VFC_Cloth02_Type 0 "TYPE_SOLID_LINE" 1 "TYPE_DASHED_LINE" 2 "TYPE_DOUBLE_DASHED_DASHED" 3 "TYPE_DOUBLE_DASHED_SOLID" 4 "TYPE_DOUBLE_SOLID_DASHED" 5 "TYPE_DOUBLE_SOLID_SOLID" 6 "TYPE_MULTIPLE" 7 "TYPE_MULTIPLE_WARNING" 8 "TYPE_BOTTS_DOTS" 9 "TYPE_ROAD_EDGE" 10 "TYPE_ROAD_FURNITURE" 11 "TYPE_CURBSTONE" 12 "TYPE_TRAFFIC_STATIC" 13 "TYPE_UNKNOWN_RAISED" 14 "TYPE_UNKNOWN" 15 "Reserved15" ;
SIG_GROUP_ 75 SG_VFC_Object21 1 : VFC_Obj21_CRC VFC_Obj21_AliveCtr VFC_Obj21_ProtBlockCtr VFC_Obj21_ExistProb VFC_Obj21_MeasurementStatus VFC_Obj21_ObjId VFC_Obj21_Type VFC_Obj21_TypeConf VFC_Obj21_VisibleView VFC_Obj21_ClassifiedView VFC_Obj21_Px VFC_Obj21_Py VFC_Obj21_PxStdDev VFC_Obj21_PyStdDev VFC_Obj21_OrientationYaw VFC_Obj21_OrientationYawStdDev VFC_Obj21_Length VFC_Obj21_Width VFC_Obj21_Height VFC_Obj21_LengthStdDev VFC_Obj21_WidthStdDev VFC_Obj21_HeightStdDev VFC_Obj21_Vx VFC_Obj21_Vy VFC_Obj21_VxStdDev VFC_Obj21_VyStdDev VFC_Obj21_Ax VFC_Obj21_LightStatTurnIndicator VFC_Obj21_Ay VFC_Obj21_AxStdDev VFC_Obj21_AyStdDev VFC_Obj21_MovementProbLat VFC_Obj21_MovementProbLong VFC_Obj21_2DAngPosEdgeLeft VFC_Obj21_2DAngPosEdgeRight VFC_Obj21_2DAngPosEdgeFar VFC_Obj21_2DAngPosEdgeBot VFC_Obj21_OutsideRoad VFC_Obj21_2DAngPosEdgeLeftStdDev VFC_Obj21_2DAngPosEdgeRightStdDe VFC_Obj21_2DAngPosEdgeFarStdDev VFC_Obj21_2DAngPosEdgeBotStdDev VFC_Obj21_2DNormVx VFC_Obj21_2DNormVy VFC_Obj21_2DNormAx VFC_Obj21_2DNormVxStdDev VFC_Obj21_MeasurementSource VFC_Obj21_2DNormVyStdDev VFC_Obj21_2DNormAxStdDev VFC_Obj21_2DScaleChange VFC_Obj21_2DScaleChangeStdDev VFC_Obj21_Reliability VFC_Obj21_LightStatBrakeLight VFC_Obj21_OutsideRoadMeasStatus VFC_Obj21_Oncoming VFC_Obj21_OncomingMeasStatus VFC_Obj21_MovementStanding VFC_Obj21_MovementStandingMeasSt VFC_Obj21_MovementObserved VFC_Obj21_MovementObservedMeasSt VFC_Obj21_TargetObjTypeAcc VFC_Obj21_TargetObjTypeAccConf;
SIG_GROUP_ 76 SG_VFC_Object22 1 : VFC_Obj22_CRC VFC_Obj22_AliveCtr VFC_Obj22_ProtBlockCtr VFC_Obj22_ExistProb VFC_Obj22_MeasurementStatus VFC_Obj22_ObjId VFC_Obj22_Type VFC_Obj22_TypeConf VFC_Obj22_VisibleView VFC_Obj22_ClassifiedView VFC_Obj22_Px VFC_Obj22_Py VFC_Obj22_PxStdDev VFC_Obj22_PyStdDev VFC_Obj22_OrientationYaw VFC_Obj22_OrientationYawStdDev VFC_Obj22_Length VFC_Obj22_Width VFC_Obj22_Height VFC_Obj22_LengthStdDev VFC_Obj22_WidthStdDev VFC_Obj22_HeightStdDev VFC_Obj22_Vx VFC_Obj22_Vy VFC_Obj22_VxStdDev VFC_Obj22_VyStdDev VFC_Obj22_Ax VFC_Obj22_LightStatTurnIndicator VFC_Obj22_Ay VFC_Obj22_AxStdDev VFC_Obj22_AyStdDev VFC_Obj22_MovementProbLat VFC_Obj22_MovementProbLong VFC_Obj22_2DAngPosEdgeLeft VFC_Obj22_2DAngPosEdgeRight VFC_Obj22_2DAngPosEdgeFar VFC_Obj22_2DAngPosEdgeBot VFC_Obj22_OutsideRoad VFC_Obj22_2DAngPosEdgeLeftStdDev VFC_Obj22_2DAngPosEdgeRightStdDe VFC_Obj22_2DAngPosEdgeFarStdDev VFC_Obj22_2DAngPosEdgeBotStdDev VFC_Obj22_2DNormVx VFC_Obj22_2DNormVy VFC_Obj22_2DNormAx VFC_Obj22_2DNormVxStdDev VFC_Obj22_MeasurementSource VFC_Obj22_2DNormVyStdDev VFC_Obj22_2DNormAxStdDev VFC_Obj22_2DScaleChange VFC_Obj22_2DScaleChangeStdDev VFC_Obj22_Reliability VFC_Obj22_LightStatBrakeLight VFC_Obj22_OutsideRoadMeasStatus VFC_Obj22_Oncoming VFC_Obj22_OncomingMeasStatus VFC_Obj22_MovementStanding VFC_Obj22_MovementStandingMeasSt VFC_Obj22_MovementObserved VFC_Obj22_MovementObservedMeasSt VFC_Obj22_TargetObjTypeAcc VFC_Obj22_TargetObjTypeAccConf;
SIG_GROUP_ 77 SG_VFC_Object23 1 : VFC_Obj23_CRC VFC_Obj23_AliveCtr VFC_Obj23_ProtBlockCtr VFC_Obj23_ExistProb VFC_Obj23_MeasurementStatus VFC_Obj23_ObjId VFC_Obj23_Type VFC_Obj23_TypeConf VFC_Obj23_VisibleView VFC_Obj23_ClassifiedView VFC_Obj23_Px VFC_Obj23_Py VFC_Obj23_PxStdDev VFC_Obj23_PyStdDev VFC_Obj23_OrientationYaw VFC_Obj23_OrientationYawStdDev VFC_Obj23_Length VFC_Obj23_Width VFC_Obj23_Height VFC_Obj23_LengthStdDev VFC_Obj23_WidthStdDev VFC_Obj23_HeightStdDev VFC_Obj23_Vx VFC_Obj23_Vy VFC_Obj23_VxStdDev VFC_Obj23_VyStdDev VFC_Obj23_Ax VFC_Obj23_LightStatTurnIndicator VFC_Obj23_Ay VFC_Obj23_AxStdDev VFC_Obj23_AyStdDev VFC_Obj23_MovementProbLat VFC_Obj23_MovementProbLong VFC_Obj23_2DAngPosEdgeLeft VFC_Obj23_2DAngPosEdgeRight VFC_Obj23_2DAngPosEdgeFar VFC_Obj23_2DAngPosEdgeBot VFC_Obj23_OutsideRoad VFC_Obj23_2DAngPosEdgeLeftStdDev VFC_Obj23_2DAngPosEdgeRightStdDe VFC_Obj23_2DAngPosEdgeFarStdDev VFC_Obj23_2DAngPosEdgeBotStdDev VFC_Obj23_2DNormVx VFC_Obj23_2DNormVy VFC_Obj23_2DNormAx VFC_Obj23_2DNormVxStdDev VFC_Obj23_MeasurementSource VFC_Obj23_2DNormVyStdDev VFC_Obj23_2DNormAxStdDev VFC_Obj23_2DScaleChange VFC_Obj23_2DScaleChangeStdDev VFC_Obj23_Reliability VFC_Obj23_LightStatBrakeLight VFC_Obj23_OutsideRoadMeasStatus VFC_Obj23_Oncoming VFC_Obj23_OncomingMeasStatus VFC_Obj23_MovementStanding VFC_Obj23_MovementStandingMeasSt VFC_Obj23_MovementObserved VFC_Obj23_MovementObservedMeasSt VFC_Obj23_TargetObjTypeAcc VFC_Obj23_TargetObjTypeAccConf;
SIG_GROUP_ 86 SG_VFC_OcaHdr 1 : VFC_OcaHdr_CRC VFC_OcaHdr_AliveCtr VFC_OcaHdr_ProtBlockCtr VFC_OcaHdr_IfVersionIdMajor VFC_OcaHdr_IfVersionIdMinor VFC_OcaHdr_NumValidOCAs VFC_OcaHdr_TimeStampStatus VFC_OcaHdr_TimeStamp VFC_OcaHdr_CorrEgoLineTypeLeft VFC_OcaHdr_CorrEgoLineTypeRight VFC_OcaHdr_CorrLeftLineTypeLeft VFC_OcaHdr_CorrLeftLineTypeRight VFC_OcaHdr_CorrRightLineTypeLeft VFC_OcaHdr_CorrRightLineTypeR VFC_OcaHdr_CorrEgoLaneLineTypeL VFC_OcaHdr_CorrEgoLaneLineTypeR VFC_OcaHdr_PreReactObjAccConf VFC_OcaHdr_PreReactObjAcc VFC_OcaHdr_PreReactObjAccPx VFC_OcaHdr_PreReactObjAccVx;
SIG_GROUP_ 88 SG_VFC_Oca_000_017 1 : VFC_Oca_000_017_CRC VFC_Oca_000_017_AliveCtr VFC_Oca_000_017_ProtBlockCtr VFC_Oca000_ObjIdRef VFC_Oca000_CorridorTypeRef VFC_Oca000_ObjPosition VFC_Oca000_CorridorOverlap VFC_Oca000_InMeasuredLines VFC_Oca000_TimeToEnterCorridor VFC_Oca000_TimeToLeaveCorridor VFC_Oca001_ObjIdRef VFC_Oca001_CorridorTypeRef VFC_Oca001_ObjPosition VFC_Oca001_CorridorOverlap VFC_Oca001_InMeasuredLines VFC_Oca001_TimeToEnterCorridor VFC_Oca001_TimeToLeaveCorridor VFC_Oca002_ObjIdRef VFC_Oca002_CorridorTypeRef VFC_Oca002_ObjPosition VFC_Oca002_CorridorOverlap VFC_Oca002_InMeasuredLines VFC_Oca002_TimeToEnterCorridor VFC_Oca002_TimeToLeaveCorridor VFC_Oca003_ObjIdRef VFC_Oca003_CorridorTypeRef VFC_Oca003_ObjPosition VFC_Oca003_CorridorOverlap VFC_Oca003_InMeasuredLines VFC_Oca003_TimeToEnterCorridor VFC_Oca003_TimeToLeaveCorridor VFC_Oca004_ObjIdRef VFC_Oca004_CorridorTypeRef VFC_Oca004_ObjPosition VFC_Oca004_CorridorOverlap VFC_Oca004_InMeasuredLines VFC_Oca004_TimeToEnterCorridor VFC_Oca004_TimeToLeaveCorridor VFC_Oca005_ObjIdRef VFC_Oca005_CorridorTypeRef VFC_Oca005_ObjPosition VFC_Oca005_CorridorOverlap VFC_Oca005_InMeasuredLines VFC_Oca005_TimeToEnterCorridor VFC_Oca005_TimeToLeaveCorridor VFC_Oca006_ObjIdRef VFC_Oca006_CorridorTypeRef VFC_Oca006_ObjPosition VFC_Oca006_CorridorOverlap VFC_Oca006_InMeasuredLines VFC_Oca006_TimeToEnterCorridor VFC_Oca006_TimeToLeaveCorridor VFC_Oca007_ObjIdRef VFC_Oca007_CorridorTypeRef VFC_Oca007_ObjPosition VFC_Oca007_CorridorOverlap VFC_Oca007_InMeasuredLines VFC_Oca007_TimeToEnterCorridor VFC_Oca007_TimeToLeaveCorridor VFC_Oca008_ObjIdRef VFC_Oca008_CorridorTypeRef VFC_Oca008_ObjPosition VFC_Oca008_CorridorOverlap VFC_Oca008_InMeasuredLines VFC_Oca008_TimeToEnterCorridor VFC_Oca008_TimeToLeaveCorridor VFC_Oca009_ObjIdRef VFC_Oca009_CorridorTypeRef VFC_Oca009_ObjPosition VFC_Oca009_CorridorOverlap VFC_Oca009_InMeasuredLines VFC_Oca009_TimeToEnterCorridor VFC_Oca009_TimeToLeaveCorridor VFC_Oca010_ObjIdRef VFC_Oca010_CorridorTypeRef VFC_Oca010_ObjPosition VFC_Oca010_CorridorOverlap VFC_Oca010_InMeasuredLines VFC_Oca010_TimeToEnterCorridor VFC_Oca010_TimeToLeaveCorridor VFC_Oca011_ObjIdRef VFC_Oca011_CorridorTypeRef VFC_Oca011_ObjPosition VFC_Oca011_CorridorOverlap VFC_Oca011_InMeasuredLines VFC_Oca011_TimeToEnterCorridor VFC_Oca011_TimeToLeaveCorridor VFC_Oca012_ObjIdRef VFC_Oca012_CorridorTypeRef VFC_Oca012_ObjPosition VFC_Oca012_CorridorOverlap VFC_Oca012_InMeasuredLines VFC_Oca012_TimeToEnterCorridor VFC_Oca012_TimeToLeaveCorridor VFC_Oca013_ObjIdRef VFC_Oca013_CorridorTypeRef VFC_Oca013_ObjPosition VFC_Oca013_CorridorOverlap VFC_Oca013_InMeasuredLines VFC_Oca013_TimeToEnterCorridor VFC_Oca013_TimeToLeaveCorridor VFC_Oca014_ObjIdRef VFC_Oca014_CorridorTypeRef VFC_Oca014_ObjPosition VFC_Oca014_CorridorOverlap VFC_Oca014_InMeasuredLines VFC_Oca014_TimeToEnterCorridor VFC_Oca014_TimeToLeaveCorridor VFC_Oca015_ObjIdRef VFC_Oca015_CorridorTypeRef VFC_Oca015_ObjPosition VFC_Oca015_CorridorOverlap VFC_Oca015_InMeasuredLines VFC_Oca015_TimeToEnterCorridor VFC_Oca015_TimeToLeaveCorridor VFC_Oca016_ObjIdRef VFC_Oca016_CorridorTypeRef VFC_Oca016_ObjPosition VFC_Oca016_CorridorOverlap VFC_Oca016_InMeasuredLines VFC_Oca016_TimeToEnterCorridor VFC_Oca016_TimeToLeaveCorridor VFC_Oca017_ObjIdRef VFC_Oca017_CorridorTypeRef VFC_Oca017_ObjPosition VFC_Oca017_CorridorOverlap VFC_Oca017_InMeasuredLines VFC_Oca017_TimeToEnterCorridor VFC_Oca017_TimeToLeaveCorridor;
SIG_GROUP_ 89 SG_VFC_Oca_018_035 1 : VFC_Oca_018_035_CRC VFC_Oca_018_035_AliveCtr VFC_Oca_018_035_ProtBlockCtr VFC_Oca018_ObjIdRef VFC_Oca018_CorridorTypeRef VFC_Oca018_ObjPosition VFC_Oca018_CorridorOverlap VFC_Oca018_InMeasuredLines VFC_Oca018_TimeToEnterCorridor VFC_Oca018_TimeToLeaveCorridor VFC_Oca019_ObjIdRef VFC_Oca019_CorridorTypeRef VFC_Oca019_ObjPosition VFC_Oca019_CorridorOverlap VFC_Oca019_InMeasuredLines VFC_Oca019_TimeToEnterCorridor VFC_Oca019_TimeToLeaveCorridor VFC_Oca020_ObjIdRef VFC_Oca020_CorridorTypeRef VFC_Oca020_ObjPosition VFC_Oca020_CorridorOverlap VFC_Oca020_InMeasuredLines VFC_Oca020_TimeToEnterCorridor VFC_Oca020_TimeToLeaveCorridor VFC_Oca021_ObjIdRef VFC_Oca021_CorridorTypeRef VFC_Oca021_ObjPosition VFC_Oca021_CorridorOverlap VFC_Oca021_InMeasuredLines VFC_Oca021_TimeToEnterCorridor VFC_Oca021_TimeToLeaveCorridor VFC_Oca022_ObjIdRef VFC_Oca022_CorridorTypeRef VFC_Oca022_ObjPosition VFC_Oca022_CorridorOverlap VFC_Oca022_InMeasuredLines VFC_Oca022_TimeToEnterCorridor VFC_Oca022_TimeToLeaveCorridor VFC_Oca023_ObjIdRef VFC_Oca023_CorridorTypeRef VFC_Oca023_ObjPosition VFC_Oca023_CorridorOverlap VFC_Oca023_InMeasuredLines VFC_Oca023_TimeToEnterCorridor VFC_Oca023_TimeToLeaveCorridor VFC_Oca024_ObjIdRef VFC_Oca024_CorridorTypeRef VFC_Oca024_ObjPosition VFC_Oca024_CorridorOverlap VFC_Oca024_InMeasuredLines VFC_Oca024_TimeToEnterCorridor VFC_Oca024_TimeToLeaveCorridor VFC_Oca025_ObjIdRef VFC_Oca025_CorridorTypeRef VFC_Oca025_ObjPosition VFC_Oca025_CorridorOverlap VFC_Oca025_InMeasuredLines VFC_Oca025_TimeToEnterCorridor VFC_Oca025_TimeToLeaveCorridor VFC_Oca026_ObjIdRef VFC_Oca026_CorridorTypeRef VFC_Oca026_ObjPosition VFC_Oca026_CorridorOverlap VFC_Oca026_InMeasuredLines VFC_Oca026_TimeToEnterCorridor VFC_Oca026_TimeToLeaveCorridor VFC_Oca027_ObjIdRef VFC_Oca027_CorridorTypeRef VFC_Oca027_ObjPosition VFC_Oca027_CorridorOverlap VFC_Oca027_InMeasuredLines VFC_Oca027_TimeToEnterCorridor VFC_Oca027_TimeToLeaveCorridor VFC_Oca028_ObjIdRef VFC_Oca028_CorridorTypeRef VFC_Oca028_ObjPosition VFC_Oca028_CorridorOverlap VFC_Oca028_InMeasuredLines VFC_Oca028_TimeToEnterCorridor VFC_Oca028_TimeToLeaveCorridor VFC_Oca029_ObjIdRef VFC_Oca029_CorridorTypeRef VFC_Oca029_ObjPosition VFC_Oca029_CorridorOverlap VFC_Oca029_InMeasuredLines VFC_Oca029_TimeToEnterCorridor VFC_Oca029_TimeToLeaveCorridor VFC_Oca030_ObjIdRef VFC_Oca030_CorridorTypeRef VFC_Oca030_ObjPosition VFC_Oca030_CorridorOverlap VFC_Oca030_InMeasuredLines VFC_Oca030_TimeToEnterCorridor VFC_Oca030_TimeToLeaveCorridor VFC_Oca031_ObjIdRef VFC_Oca031_CorridorTypeRef VFC_Oca031_ObjPosition VFC_Oca031_CorridorOverlap VFC_Oca031_InMeasuredLines VFC_Oca031_TimeToEnterCorridor VFC_Oca031_TimeToLeaveCorridor VFC_Oca032_ObjIdRef VFC_Oca032_CorridorTypeRef VFC_Oca032_ObjPosition VFC_Oca032_CorridorOverlap VFC_Oca032_InMeasuredLines VFC_Oca032_TimeToEnterCorridor VFC_Oca032_TimeToLeaveCorridor VFC_Oca033_ObjIdRef VFC_Oca033_CorridorTypeRef VFC_Oca033_ObjPosition VFC_Oca033_CorridorOverlap VFC_Oca033_InMeasuredLines VFC_Oca033_TimeToEnterCorridor VFC_Oca033_TimeToLeaveCorridor VFC_Oca034_ObjIdRef VFC_Oca034_CorridorTypeRef VFC_Oca034_ObjPosition VFC_Oca034_CorridorOverlap VFC_Oca034_InMeasuredLines VFC_Oca034_TimeToEnterCorridor VFC_Oca034_TimeToLeaveCorridor VFC_Oca035_ObjIdRef VFC_Oca035_CorridorTypeRef VFC_Oca035_ObjPosition VFC_Oca035_CorridorOverlap VFC_Oca035_InMeasuredLines VFC_Oca035_TimeToEnterCorridor VFC_Oca035_TimeToLeaveCorridor;
SIG_GROUP_ 90 SG_VFC_Oca_036_053 1 : VFC_Oca_036_053_CRC VFC_Oca_036_053_AliveCtr VFC_Oca_036_053_ProtBlockCtr VFC_Oca036_ObjIdRef VFC_Oca036_CorridorTypeRef VFC_Oca036_ObjPosition VFC_Oca036_CorridorOverlap VFC_Oca036_InMeasuredLines VFC_Oca036_TimeToEnterCorridor VFC_Oca036_TimeToLeaveCorridor VFC_Oca037_ObjIdRef VFC_Oca037_CorridorTypeRef VFC_Oca037_ObjPosition VFC_Oca037_CorridorOverlap VFC_Oca037_InMeasuredLines VFC_Oca037_TimeToEnterCorridor VFC_Oca037_TimeToLeaveCorridor VFC_Oca038_ObjIdRef VFC_Oca038_CorridorTypeRef VFC_Oca038_ObjPosition VFC_Oca038_CorridorOverlap VFC_Oca038_InMeasuredLines VFC_Oca038_TimeToEnterCorridor VFC_Oca038_TimeToLeaveCorridor VFC_Oca039_ObjIdRef VFC_Oca039_CorridorTypeRef VFC_Oca039_ObjPosition VFC_Oca039_CorridorOverlap VFC_Oca039_InMeasuredLines VFC_Oca039_TimeToEnterCorridor VFC_Oca039_TimeToLeaveCorridor VFC_Oca040_ObjIdRef VFC_Oca040_CorridorTypeRef VFC_Oca040_ObjPosition VFC_Oca040_CorridorOverlap VFC_Oca040_InMeasuredLines VFC_Oca040_TimeToEnterCorridor VFC_Oca040_TimeToLeaveCorridor VFC_Oca041_ObjIdRef VFC_Oca041_CorridorTypeRef VFC_Oca041_ObjPosition VFC_Oca041_CorridorOverlap VFC_Oca041_InMeasuredLines VFC_Oca041_TimeToEnterCorridor VFC_Oca041_TimeToLeaveCorridor VFC_Oca042_ObjIdRef VFC_Oca042_CorridorTypeRef VFC_Oca042_ObjPosition VFC_Oca042_CorridorOverlap VFC_Oca042_InMeasuredLines VFC_Oca042_TimeToEnterCorridor VFC_Oca042_TimeToLeaveCorridor VFC_Oca043_ObjIdRef VFC_Oca043_CorridorTypeRef VFC_Oca043_ObjPosition VFC_Oca043_CorridorOverlap VFC_Oca043_InMeasuredLines VFC_Oca043_TimeToEnterCorridor VFC_Oca043_TimeToLeaveCorridor VFC_Oca044_ObjIdRef VFC_Oca044_CorridorTypeRef VFC_Oca044_ObjPosition VFC_Oca044_CorridorOverlap VFC_Oca044_InMeasuredLines VFC_Oca044_TimeToEnterCorridor VFC_Oca044_TimeToLeaveCorridor VFC_Oca045_ObjIdRef VFC_Oca045_CorridorTypeRef VFC_Oca045_ObjPosition VFC_Oca045_CorridorOverlap VFC_Oca045_InMeasuredLines VFC_Oca045_TimeToEnterCorridor VFC_Oca045_TimeToLeaveCorridor VFC_Oca046_ObjIdRef VFC_Oca046_CorridorTypeRef VFC_Oca046_ObjPosition VFC_Oca046_CorridorOverlap VFC_Oca046_InMeasuredLines VFC_Oca046_TimeToEnterCorridor VFC_Oca046_TimeToLeaveCorridor VFC_Oca047_ObjIdRef VFC_Oca047_CorridorTypeRef VFC_Oca047_ObjPosition VFC_Oca047_CorridorOverlap VFC_Oca047_InMeasuredLines VFC_Oca047_TimeToEnterCorridor VFC_Oca047_TimeToLeaveCorridor VFC_Oca048_ObjIdRef VFC_Oca048_CorridorTypeRef VFC_Oca048_ObjPosition VFC_Oca048_CorridorOverlap VFC_Oca048_InMeasuredLines VFC_Oca048_TimeToEnterCorridor VFC_Oca048_TimeToLeaveCorridor VFC_Oca049_ObjIdRef VFC_Oca049_CorridorTypeRef VFC_Oca049_ObjPosition VFC_Oca049_CorridorOverlap VFC_Oca049_InMeasuredLines VFC_Oca049_TimeToEnterCorridor VFC_Oca049_TimeToLeaveCorridor VFC_Oca050_ObjIdRef VFC_Oca050_CorridorTypeRef VFC_Oca050_ObjPosition VFC_Oca050_CorridorOverlap VFC_Oca050_InMeasuredLines VFC_Oca050_TimeToEnterCorridor VFC_Oca050_TimeToLeaveCorridor VFC_Oca051_ObjIdRef VFC_Oca051_CorridorTypeRef VFC_Oca051_ObjPosition VFC_Oca051_CorridorOverlap VFC_Oca051_InMeasuredLines VFC_Oca051_TimeToEnterCorridor VFC_Oca051_TimeToLeaveCorridor VFC_Oca052_ObjIdRef VFC_Oca052_CorridorTypeRef VFC_Oca052_ObjPosition VFC_Oca052_CorridorOverlap VFC_Oca052_InMeasuredLines VFC_Oca052_TimeToEnterCorridor VFC_Oca052_TimeToLeaveCorridor VFC_Oca053_ObjIdRef VFC_Oca053_CorridorTypeRef VFC_Oca053_ObjPosition VFC_Oca053_CorridorOverlap VFC_Oca053_InMeasuredLines VFC_Oca053_TimeToEnterCorridor VFC_Oca053_TimeToLeaveCorridor;
SIG_GROUP_ 91 SG_VFC_Oca_054_071 1 : VFC_Oca_054_071_CRC VFC_Oca_054_071_AliveCtr VFC_Oca_054_071_ProtBlockCtr VFC_Oca054_ObjIdRef VFC_Oca054_CorridorTypeRef VFC_Oca054_ObjPosition VFC_Oca054_CorridorOverlap VFC_Oca054_InMeasuredLines VFC_Oca054_TimeToEnterCorridor VFC_Oca054_TimeToLeaveCorridor VFC_Oca055_ObjIdRef VFC_Oca055_CorridorTypeRef VFC_Oca055_ObjPosition VFC_Oca055_CorridorOverlap VFC_Oca055_InMeasuredLines VFC_Oca055_TimeToEnterCorridor VFC_Oca055_TimeToLeaveCorridor VFC_Oca056_ObjIdRef VFC_Oca056_CorridorTypeRef VFC_Oca056_ObjPosition VFC_Oca056_CorridorOverlap VFC_Oca056_InMeasuredLines VFC_Oca056_TimeToEnterCorridor VFC_Oca056_TimeToLeaveCorridor VFC_Oca057_ObjIdRef VFC_Oca057_CorridorTypeRef VFC_Oca057_ObjPosition VFC_Oca057_CorridorOverlap VFC_Oca057_InMeasuredLines VFC_Oca057_TimeToEnterCorridor VFC_Oca057_TimeToLeaveCorridor VFC_Oca058_ObjIdRef VFC_Oca058_CorridorTypeRef VFC_Oca058_ObjPosition VFC_Oca058_CorridorOverlap VFC_Oca058_InMeasuredLines VFC_Oca058_TimeToEnterCorridor VFC_Oca058_TimeToLeaveCorridor VFC_Oca059_ObjIdRef VFC_Oca059_CorridorTypeRef VFC_Oca059_ObjPosition VFC_Oca059_CorridorOverlap VFC_Oca059_InMeasuredLines VFC_Oca059_TimeToEnterCorridor VFC_Oca059_TimeToLeaveCorridor VFC_Oca060_ObjIdRef VFC_Oca060_CorridorTypeRef VFC_Oca060_ObjPosition VFC_Oca060_CorridorOverlap VFC_Oca060_InMeasuredLines VFC_Oca060_TimeToEnterCorridor VFC_Oca060_TimeToLeaveCorridor VFC_Oca061_ObjIdRef VFC_Oca061_CorridorTypeRef VFC_Oca061_ObjPosition VFC_Oca061_CorridorOverlap VFC_Oca061_InMeasuredLines VFC_Oca061_TimeToEnterCorridor VFC_Oca061_TimeToLeaveCorridor VFC_Oca062_ObjIdRef VFC_Oca062_CorridorTypeRef VFC_Oca062_ObjPosition VFC_Oca062_CorridorOverlap VFC_Oca062_InMeasuredLines VFC_Oca062_TimeToEnterCorridor VFC_Oca062_TimeToLeaveCorridor VFC_Oca063_ObjIdRef VFC_Oca063_CorridorTypeRef VFC_Oca063_ObjPosition VFC_Oca063_CorridorOverlap VFC_Oca063_InMeasuredLines VFC_Oca063_TimeToEnterCorridor VFC_Oca063_TimeToLeaveCorridor VFC_Oca064_ObjIdRef VFC_Oca064_CorridorTypeRef VFC_Oca064_ObjPosition VFC_Oca064_CorridorOverlap VFC_Oca064_InMeasuredLines VFC_Oca064_TimeToEnterCorridor VFC_Oca064_TimeToLeaveCorridor VFC_Oca065_ObjIdRef VFC_Oca065_CorridorTypeRef VFC_Oca065_ObjPosition VFC_Oca065_CorridorOverlap VFC_Oca065_InMeasuredLines VFC_Oca065_TimeToEnterCorridor VFC_Oca065_TimeToLeaveCorridor VFC_Oca066_ObjIdRef VFC_Oca066_CorridorTypeRef VFC_Oca066_ObjPosition VFC_Oca066_CorridorOverlap VFC_Oca066_InMeasuredLines VFC_Oca066_TimeToEnterCorridor VFC_Oca066_TimeToLeaveCorridor VFC_Oca067_ObjIdRef VFC_Oca067_CorridorTypeRef VFC_Oca067_ObjPosition VFC_Oca067_CorridorOverlap VFC_Oca067_InMeasuredLines VFC_Oca067_TimeToEnterCorridor VFC_Oca067_TimeToLeaveCorridor VFC_Oca068_ObjIdRef VFC_Oca068_CorridorTypeRef VFC_Oca068_ObjPosition VFC_Oca068_CorridorOverlap VFC_Oca068_InMeasuredLines VFC_Oca068_TimeToEnterCorridor VFC_Oca068_TimeToLeaveCorridor VFC_Oca069_ObjIdRef VFC_Oca069_CorridorTypeRef VFC_Oca069_ObjPosition VFC_Oca069_CorridorOverlap VFC_Oca069_InMeasuredLines VFC_Oca069_TimeToEnterCorridor VFC_Oca069_TimeToLeaveCorridor VFC_Oca070_ObjIdRef VFC_Oca070_CorridorTypeRef VFC_Oca070_ObjPosition VFC_Oca070_CorridorOverlap VFC_Oca070_InMeasuredLines VFC_Oca070_TimeToEnterCorridor VFC_Oca070_TimeToLeaveCorridor VFC_Oca071_ObjIdRef VFC_Oca071_CorridorTypeRef VFC_Oca071_ObjPosition VFC_Oca071_CorridorOverlap VFC_Oca071_InMeasuredLines VFC_Oca071_TimeToEnterCorridor VFC_Oca071_TimeToLeaveCorridor;
SIG_GROUP_ 128 SG_VFC_RoadHdr 1 : VFC_RoadHdr_CRC VFC_RoadHdr_AliveCtr VFC_RoadHdr_ProtBlockCtr VFC_RoadHdr_IfVersionIdMajor VFC_RoadHdr_IfVersionIdMinor VFC_RoadHdr_NumValidPolynomials VFC_RoadHdr_RoadType VFC_RoadHdr_TimeStampStatus VFC_RoadHdr_TimeStamp VFC_RoadHdr_SensorStatus VFC_RoadHdr_NumValid2DPolynomial VFC_RoadHdr_RoadSurfCondType VFC_RoadHdr_NumValidRoadMarkings VFC_RoadHdr_RoadTypeConf VFC_RoadHdr_RoadSurCondTypeConf VFC_RoadHdr_2DNormVMean VFC_RoadHdr_2DNormVMeanStdDev VFC_RoadHdr_NumValidClothoids;
SIG_GROUP_ 130 SG_VFC_RoadClothoid_00_02 1 : VFC_Cloth_00_02_CRC VFC_Cloth_00_02_AliveCtr VFC_Cloth_00_02_ProtBlockCtr VFC_Cloth00_LaneAssociation VFC_Cloth00_Colour VFC_Cloth00_RangeXBegin VFC_Cloth00_RangeXEnd VFC_Cloth00_ExistProb VFC_Cloth00_CurvChange VFC_Cloth00_Curv VFC_Cloth00_PyStdDev VFC_Cloth00_Py VFC_Cloth00_OrientationYaw VFC_Cloth00_Width VFC_Cloth00_Type VFC_Cloth01_LaneAssociation VFC_Cloth01_Colour VFC_Cloth01_RangeXBegin VFC_Cloth01_RangeXEnd VFC_Cloth01_ExistProb VFC_Cloth01_CurvChange VFC_Cloth01_Curv VFC_Cloth01_PyStdDev VFC_Cloth01_Py VFC_Cloth01_OrientationYaw VFC_Cloth01_Width VFC_Cloth01_Type VFC_Cloth02_LaneAssociation VFC_Cloth02_Colour VFC_Cloth02_RangeXBegin VFC_Cloth02_RangeXEnd VFC_Cloth02_ExistProb VFC_Cloth02_CurvChange VFC_Cloth02_Curv VFC_Cloth02_PyStdDev VFC_Cloth02_Py VFC_Cloth02_OrientationYaw VFC_Cloth02_Width VFC_Cloth02_Type;
