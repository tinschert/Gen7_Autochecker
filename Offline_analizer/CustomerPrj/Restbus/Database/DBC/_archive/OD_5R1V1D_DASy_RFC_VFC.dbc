VERSION "created by canmatrix"

NS_ :

BS_:

BU_: RadarFrontCenter VideoFrontCenter DASy ReceiveECU

BO_ 266 RFC_Location_006_008: 64 RadarFrontCenter
 SG_ RFC_Loc006_008_CRC : 0|16@1+ (1,0) [0|65535] ""  DASy
 SG_ RFC_Loc006_008_AliveCtr : 16|8@1+ (1,0) [0|255] ""  DASy
 SG_ RFC_Loc006_008_ProtBlockCtr : 24|4@1+ (1,0) [0|15] ""  DASy
 SG_ RFC_Loc006_RadialDistance : 32|15@1+ (0.01,0) [0|327.67] "m"  DASy
 SG_ RFC_Loc006_RadialVelocity : 47|15@1+ (0.01,-163.84) [-110|55] "m/s"  DASy
 SG_ RFC_Loc006_Elevation : 62|10@1+ (0.1,-51.2) [-45|45] "deg"  DASy
 SG_ RFC_Loc006_Azimuth : 72|11@1+ (0.1,-102.4) [-90|90] "deg"  DASy
 SG_ RFC_Loc006_DistVelocityCoVnce : 83|11@1+ (0.0001,-0.1024) [-0.1024|0.1023] "m^2/s"  DASy
 SG_ RFC_Loc006_RadialDistanceVnce : 94|10@1+ (5E-005,0) [0|0.05115] "m^2"  DASy
 SG_ RFC_Loc006_RadialVelocityVnce : 104|10@1+ (0.0001,0) [0|0.1023] "m^2/s^2"  DASy
 SG_ RFC_Loc006_ElevationVnce : 114|10@1+ (0.001,0) [0|1.023] "deg^2"  DASy
 SG_ RFC_Loc006_AzimuthVnce : 124|10@1+ (0.001,0) [0|1.023] "deg^2"  DASy
 SG_ RFC_Loc006_RadarCrossSection : 134|10@1+ (0.2,-102.4) [-50|70] "dBsm"  DASy
 SG_ RFC_Loc006_DistVelocityQuality : 144|8@1+ (1,0) [0|255] "unitless"  DASy
 SG_ RFC_Loc006_ElevationQuality : 152|8@1+ (1,0) [0|255] "unitless"  DASy
 SG_ RFC_Loc006_AzimuthQuality : 160|8@1+ (1,0) [0|255] "unitless"  DASy
 SG_ RFC_Loc006_RSSI : 168|10@1+ (0.1,0) [0|100] "unitless"  DASy
 SG_ RFC_Loc006_AzimuthalPartnerId : 178|10@1+ (1,0) [0|1023] "unitless"  DASy
 SG_ RFC_Loc007_RadialDistance : 192|15@1+ (0.01,0) [0|327.67] "m"  DASy
 SG_ RFC_Loc007_RadialVelocity : 207|15@1+ (0.01,-163.84) [-110|55] "m/s"  DASy
 SG_ RFC_Loc007_Elevation : 222|10@1+ (0.1,-51.2) [-45|45] "deg"  DASy
 SG_ RFC_Loc007_Azimuth : 232|11@1+ (0.1,-102.4) [-90|90] "deg"  DASy
 SG_ RFC_Loc007_DistVelocityCoVnce : 243|11@1+ (0.0001,-0.1024) [-0.1024|0.1023] "m^2/s"  DASy
 SG_ RFC_Loc007_RadialDistanceVnce : 254|10@1+ (5E-005,0) [0|0.05115] "m^2"  DASy
 SG_ RFC_Loc007_RadialVelocityVnce : 264|10@1+ (0.0001,0) [0|0.1023] "m^2/s^2"  DASy
 SG_ RFC_Loc007_ElevationVnce : 274|10@1+ (0.001,0) [0|1.023] "deg^2"  DASy
 SG_ RFC_Loc007_AzimuthVnce : 284|10@1+ (0.001,0) [0|1.023] "deg^2"  DASy
 SG_ RFC_Loc007_RadarCrossSection : 294|10@1+ (0.2,-102.4) [-50|70] "dBsm"  DASy
 SG_ RFC_Loc007_DistVelocityQuality : 304|8@1+ (1,0) [0|255] "unitless"  DASy
 SG_ RFC_Loc007_ElevationQuality : 312|8@1+ (1,0) [0|255] "unitless"  DASy
 SG_ RFC_Loc007_AzimuthQuality : 320|8@1+ (1,0) [0|255] "unitless"  DASy
 SG_ RFC_Loc007_RSSI : 328|10@1+ (0.1,0) [0|100] "unitless"  DASy
 SG_ RFC_Loc007_AzimuthalPartnerId : 338|10@1+ (1,0) [0|1023] "unitless"  DASy
 SG_ RFC_Loc008_RadialDistance : 352|15@1+ (0.01,0) [0|327.67] "m"  DASy
 SG_ RFC_Loc008_RadialVelocity : 367|15@1+ (0.01,-163.84) [-110|55] "m/s"  DASy
 SG_ RFC_Loc008_Elevation : 382|10@1+ (0.1,-51.2) [-45|45] "deg"  DASy
 SG_ RFC_Loc008_Azimuth : 392|11@1+ (0.1,-102.4) [-90|90] "deg"  DASy
 SG_ RFC_Loc008_DistVelocityCoVnce : 403|11@1+ (0.0001,-0.1024) [-0.1024|0.1023] "m^2/s"  DASy
 SG_ RFC_Loc008_RadialDistanceVnce : 414|10@1+ (5E-005,0) [0|0.05115] "m^2"  DASy
 SG_ RFC_Loc008_RadialVelocityVnce : 424|10@1+ (0.0001,0) [0|0.1023] "m^2/s^2"  DASy
 SG_ RFC_Loc008_ElevationVnce : 434|10@1+ (0.001,0) [0|1.023] "deg^2"  DASy
 SG_ RFC_Loc008_AzimuthVnce : 444|10@1+ (0.001,0) [0|1.023] "deg^2"  DASy
 SG_ RFC_Loc008_RadarCrossSection : 454|10@1+ (0.2,-102.4) [-50|70] "dBsm"  DASy
 SG_ RFC_Loc008_DistVelocityQuality : 464|8@1+ (1,0) [0|255] "unitless"  DASy
 SG_ RFC_Loc008_ElevationQuality : 472|8@1+ (1,0) [0|255] "unitless"  DASy
 SG_ RFC_Loc008_AzimuthQuality : 480|8@1+ (1,0) [0|255] "unitless"  DASy
 SG_ RFC_Loc008_RSSI : 488|10@1+ (0.1,0) [0|100] "unitless"  DASy
 SG_ RFC_Loc008_AzimuthalPartnerId : 498|10@1+ (1,0) [0|1023] "unitless"  DASy

BO_ 267 RFC_Location_009_011: 64 RadarFrontCenter
 SG_ RFC_Loc009_011_CRC : 0|16@1+ (1,0) [0|65535] ""  DASy
 SG_ RFC_Loc009_011_AliveCtr : 16|8@1+ (1,0) [0|255] ""  DASy
 SG_ RFC_Loc009_011_ProtBlockCtr : 24|4@1+ (1,0) [0|15] ""  DASy
 SG_ RFC_Loc009_RadialDistance : 32|15@1+ (0.01,0) [0|327.67] "m"  DASy
 SG_ RFC_Loc009_RadialVelocity : 47|15@1+ (0.01,-163.84) [-110|55] "m/s"  DASy
 SG_ RFC_Loc009_Elevation : 62|10@1+ (0.1,-51.2) [-45|45] "deg"  DASy
 SG_ RFC_Loc009_Azimuth : 72|11@1+ (0.1,-102.4) [-90|90] "deg"  DASy
 SG_ RFC_Loc009_DistVelocityCoVnce : 83|11@1+ (0.0001,-0.1024) [-0.1024|0.1023] "m^2/s"  DASy
 SG_ RFC_Loc009_RadialDistanceVnce : 94|10@1+ (5E-005,0) [0|0.05115] "m^2"  DASy
 SG_ RFC_Loc009_RadialVelocityVnce : 104|10@1+ (0.0001,0) [0|0.1023] "m^2/s^2"  DASy
 SG_ RFC_Loc009_ElevationVnce : 114|10@1+ (0.001,0) [0|1.023] "deg^2"  DASy
 SG_ RFC_Loc009_AzimuthVnce : 124|10@1+ (0.001,0) [0|1.023] "deg^2"  DASy
 SG_ RFC_Loc009_RadarCrossSection : 134|10@1+ (0.2,-102.4) [-50|70] "dBsm"  DASy
 SG_ RFC_Loc009_DistVelocityQuality : 144|8@1+ (1,0) [0|255] "unitless"  DASy
 SG_ RFC_Loc009_ElevationQuality : 152|8@1+ (1,0) [0|255] "unitless"  DASy
 SG_ RFC_Loc009_AzimuthQuality : 160|8@1+ (1,0) [0|255] "unitless"  DASy
 SG_ RFC_Loc009_RSSI : 168|10@1+ (0.1,0) [0|100] "unitless"  DASy
 SG_ RFC_Loc009_AzimuthalPartnerId : 178|10@1+ (1,0) [0|1023] "unitless"  DASy
 SG_ RFC_Loc010_RadialDistance : 192|15@1+ (0.01,0) [0|327.67] "m"  DASy
 SG_ RFC_Loc010_RadialVelocity : 207|15@1+ (0.01,-163.84) [-110|55] "m/s"  DASy
 SG_ RFC_Loc010_Elevation : 222|10@1+ (0.1,-51.2) [-45|45] "deg"  DASy
 SG_ RFC_Loc010_Azimuth : 232|11@1+ (0.1,-102.4) [-90|90] "deg"  DASy
 SG_ RFC_Loc010_DistVelocityCoVnce : 243|11@1+ (0.0001,-0.1024) [-0.1024|0.1023] "m^2/s"  DASy
 SG_ RFC_Loc010_RadialDistanceVnce : 254|10@1+ (5E-005,0) [0|0.05115] "m^2"  DASy
 SG_ RFC_Loc010_RadialVelocityVnce : 264|10@1+ (0.0001,0) [0|0.1023] "m^2/s^2"  DASy
 SG_ RFC_Loc010_ElevationVnce : 274|10@1+ (0.001,0) [0|1.023] "deg^2"  DASy
 SG_ RFC_Loc010_AzimuthVnce : 284|10@1+ (0.001,0) [0|1.023] "deg^2"  DASy
 SG_ RFC_Loc010_RadarCrossSection : 294|10@1+ (0.2,-102.4) [-50|70] "dBsm"  DASy
 SG_ RFC_Loc010_DistVelocityQuality : 304|8@1+ (1,0) [0|255] "unitless"  DASy
 SG_ RFC_Loc010_ElevationQuality : 312|8@1+ (1,0) [0|255] "unitless"  DASy
 SG_ RFC_Loc010_AzimuthQuality : 320|8@1+ (1,0) [0|255] "unitless"  DASy
 SG_ RFC_Loc010_RSSI : 328|10@1+ (0.1,0) [0|100] "unitless"  DASy
 SG_ RFC_Loc010_AzimuthalPartnerId : 338|10@1+ (1,0) [0|1023] "unitless"  DASy
 SG_ RFC_Loc011_RadialDistance : 352|15@1+ (0.01,0) [0|327.67] "m"  DASy
 SG_ RFC_Loc011_RadialVelocity : 367|15@1+ (0.01,-163.84) [-110|55] "m/s"  DASy
 SG_ RFC_Loc011_Elevation : 382|10@1+ (0.1,-51.2) [-45|45] "deg"  DASy
 SG_ RFC_Loc011_Azimuth : 392|11@1+ (0.1,-102.4) [-90|90] "deg"  DASy
 SG_ RFC_Loc011_DistVelocityCoVnce : 403|11@1+ (0.0001,-0.1024) [-0.1024|0.1023] "m^2/s"  DASy
 SG_ RFC_Loc011_RadialDistanceVnce : 414|10@1+ (5E-005,0) [0|0.05115] "m^2"  DASy
 SG_ RFC_Loc011_RadialVelocityVnce : 424|10@1+ (0.0001,0) [0|0.1023] "m^2/s^2"  DASy
 SG_ RFC_Loc011_ElevationVnce : 434|10@1+ (0.001,0) [0|1.023] "deg^2"  DASy
 SG_ RFC_Loc011_AzimuthVnce : 444|10@1+ (0.001,0) [0|1.023] "deg^2"  DASy
 SG_ RFC_Loc011_RadarCrossSection : 454|10@1+ (0.2,-102.4) [-50|70] "dBsm"  DASy
 SG_ RFC_Loc011_DistVelocityQuality : 464|8@1+ (1,0) [0|255] "unitless"  DASy
 SG_ RFC_Loc011_ElevationQuality : 472|8@1+ (1,0) [0|255] "unitless"  DASy
 SG_ RFC_Loc011_AzimuthQuality : 480|8@1+ (1,0) [0|255] "unitless"  DASy
 SG_ RFC_Loc011_RSSI : 488|10@1+ (0.1,0) [0|100] "unitless"  DASy
 SG_ RFC_Loc011_AzimuthalPartnerId : 498|10@1+ (1,0) [0|1023] "unitless"  DASy

BO_ 268 RFC_Location_012_014: 64 RadarFrontCenter
 SG_ RFC_Loc012_014_CRC : 0|16@1+ (1,0) [0|65535] ""  DASy
 SG_ RFC_Loc012_014_AliveCtr : 16|8@1+ (1,0) [0|255] ""  DASy
 SG_ RFC_Loc012_014_ProtBlockCtr : 24|4@1+ (1,0) [0|15] ""  DASy
 SG_ RFC_Loc012_RadialDistance : 32|15@1+ (0.01,0) [0|327.67] "m"  DASy
 SG_ RFC_Loc012_RadialVelocity : 47|15@1+ (0.01,-163.84) [-110|55] "m/s"  DASy
 SG_ RFC_Loc012_Elevation : 62|10@1+ (0.1,-51.2) [-45|45] "deg"  DASy
 SG_ RFC_Loc012_Azimuth : 72|11@1+ (0.1,-102.4) [-90|90] "deg"  DASy
 SG_ RFC_Loc012_DistVelocityCoVnce : 83|11@1+ (0.0001,-0.1024) [-0.1024|0.1023] "m^2/s"  DASy
 SG_ RFC_Loc012_RadialDistanceVnce : 94|10@1+ (5E-005,0) [0|0.05115] "m^2"  DASy
 SG_ RFC_Loc012_RadialVelocityVnce : 104|10@1+ (0.0001,0) [0|0.1023] "m^2/s^2"  DASy
 SG_ RFC_Loc012_ElevationVnce : 114|10@1+ (0.001,0) [0|1.023] "deg^2"  DASy
 SG_ RFC_Loc012_AzimuthVnce : 124|10@1+ (0.001,0) [0|1.023] "deg^2"  DASy
 SG_ RFC_Loc012_RadarCrossSection : 134|10@1+ (0.2,-102.4) [-50|70] "dBsm"  DASy
 SG_ RFC_Loc012_DistVelocityQuality : 144|8@1+ (1,0) [0|255] "unitless"  DASy
 SG_ RFC_Loc012_ElevationQuality : 152|8@1+ (1,0) [0|255] "unitless"  DASy
 SG_ RFC_Loc012_AzimuthQuality : 160|8@1+ (1,0) [0|255] "unitless"  DASy
 SG_ RFC_Loc012_RSSI : 168|10@1+ (0.1,0) [0|100] "unitless"  DASy
 SG_ RFC_Loc012_AzimuthalPartnerId : 178|10@1+ (1,0) [0|1023] "unitless"  DASy
 SG_ RFC_Loc013_RadialDistance : 192|15@1+ (0.01,0) [0|327.67] "m"  DASy
 SG_ RFC_Loc013_RadialVelocity : 207|15@1+ (0.01,-163.84) [-110|55] "m/s"  DASy
 SG_ RFC_Loc013_Elevation : 222|10@1+ (0.1,-51.2) [-45|45] "deg"  DASy
 SG_ RFC_Loc013_Azimuth : 232|11@1+ (0.1,-102.4) [-90|90] "deg"  DASy
 SG_ RFC_Loc013_DistVelocityCoVnce : 243|11@1+ (0.0001,-0.1024) [-0.1024|0.1023] "m^2/s"  DASy
 SG_ RFC_Loc013_RadialDistanceVnce : 254|10@1+ (5E-005,0) [0|0.05115] "m^2"  DASy
 SG_ RFC_Loc013_RadialVelocityVnce : 264|10@1+ (0.0001,0) [0|0.1023] "m^2/s^2"  DASy
 SG_ RFC_Loc013_ElevationVnce : 274|10@1+ (0.001,0) [0|1.023] "deg^2"  DASy
 SG_ RFC_Loc013_AzimuthVnce : 284|10@1+ (0.001,0) [0|1.023] "deg^2"  DASy
 SG_ RFC_Loc013_RadarCrossSection : 294|10@1+ (0.2,-102.4) [-50|70] "dBsm"  DASy
 SG_ RFC_Loc013_DistVelocityQuality : 304|8@1+ (1,0) [0|255] "unitless"  DASy
 SG_ RFC_Loc013_ElevationQuality : 312|8@1+ (1,0) [0|255] "unitless"  DASy
 SG_ RFC_Loc013_AzimuthQuality : 320|8@1+ (1,0) [0|255] "unitless"  DASy
 SG_ RFC_Loc013_RSSI : 328|10@1+ (0.1,0) [0|100] "unitless"  DASy
 SG_ RFC_Loc013_AzimuthalPartnerId : 338|10@1+ (1,0) [0|1023] "unitless"  DASy
 SG_ RFC_Loc014_RadialDistance : 352|15@1+ (0.01,0) [0|327.67] "m"  DASy
 SG_ RFC_Loc014_RadialVelocity : 367|15@1+ (0.01,-163.84) [-110|55] "m/s"  DASy
 SG_ RFC_Loc014_Elevation : 382|10@1+ (0.1,-51.2) [-45|45] "deg"  DASy
 SG_ RFC_Loc014_Azimuth : 392|11@1+ (0.1,-102.4) [-90|90] "deg"  DASy
 SG_ RFC_Loc014_DistVelocityCoVnce : 403|11@1+ (0.0001,-0.1024) [-0.1024|0.1023] "m^2/s"  DASy
 SG_ RFC_Loc014_RadialDistanceVnce : 414|10@1+ (5E-005,0) [0|0.05115] "m^2"  DASy
 SG_ RFC_Loc014_RadialVelocityVnce : 424|10@1+ (0.0001,0) [0|0.1023] "m^2/s^2"  DASy
 SG_ RFC_Loc014_ElevationVnce : 434|10@1+ (0.001,0) [0|1.023] "deg^2"  DASy
 SG_ RFC_Loc014_AzimuthVnce : 444|10@1+ (0.001,0) [0|1.023] "deg^2"  DASy
 SG_ RFC_Loc014_RadarCrossSection : 454|10@1+ (0.2,-102.4) [-50|70] "dBsm"  DASy
 SG_ RFC_Loc014_DistVelocityQuality : 464|8@1+ (1,0) [0|255] "unitless"  DASy
 SG_ RFC_Loc014_ElevationQuality : 472|8@1+ (1,0) [0|255] "unitless"  DASy
 SG_ RFC_Loc014_AzimuthQuality : 480|8@1+ (1,0) [0|255] "unitless"  DASy
 SG_ RFC_Loc014_RSSI : 488|10@1+ (0.1,0) [0|100] "unitless"  DASy
 SG_ RFC_Loc014_AzimuthalPartnerId : 498|10@1+ (1,0) [0|1023] "unitless"  DASy

BO_ 269 RFC_Location_015_017: 64 RadarFrontCenter
 SG_ RFC_Loc015_017_CRC : 0|16@1+ (1,0) [0|65535] ""  DASy
 SG_ RFC_Loc015_017_AliveCtr : 16|8@1+ (1,0) [0|255] ""  DASy
 SG_ RFC_Loc015_017_ProtBlockCtr : 24|4@1+ (1,0) [0|15] ""  DASy
 SG_ RFC_Loc015_RadialDistance : 32|15@1+ (0.01,0) [0|327.67] "m"  DASy
 SG_ RFC_Loc015_RadialVelocity : 47|15@1+ (0.01,-163.84) [-110|55] "m/s"  DASy
 SG_ RFC_Loc015_Elevation : 62|10@1+ (0.1,-51.2) [-45|45] "deg"  DASy
 SG_ RFC_Loc015_Azimuth : 72|11@1+ (0.1,-102.4) [-90|90] "deg"  DASy
 SG_ RFC_Loc015_DistVelocityCoVnce : 83|11@1+ (0.0001,-0.1024) [-0.1024|0.1023] "m^2/s"  DASy
 SG_ RFC_Loc015_RadialDistanceVnce : 94|10@1+ (5E-005,0) [0|0.05115] "m^2"  DASy
 SG_ RFC_Loc015_RadialVelocityVnce : 104|10@1+ (0.0001,0) [0|0.1023] "m^2/s^2"  DASy
 SG_ RFC_Loc015_ElevationVnce : 114|10@1+ (0.001,0) [0|1.023] "deg^2"  DASy
 SG_ RFC_Loc015_AzimuthVnce : 124|10@1+ (0.001,0) [0|1.023] "deg^2"  DASy
 SG_ RFC_Loc015_RadarCrossSection : 134|10@1+ (0.2,-102.4) [-50|70] "dBsm"  DASy
 SG_ RFC_Loc015_DistVelocityQuality : 144|8@1+ (1,0) [0|255] "unitless"  DASy
 SG_ RFC_Loc015_ElevationQuality : 152|8@1+ (1,0) [0|255] "unitless"  DASy
 SG_ RFC_Loc015_AzimuthQuality : 160|8@1+ (1,0) [0|255] "unitless"  DASy
 SG_ RFC_Loc015_RSSI : 168|10@1+ (0.1,0) [0|100] "unitless"  DASy
 SG_ RFC_Loc015_AzimuthalPartnerId : 178|10@1+ (1,0) [0|1023] "unitless"  DASy
 SG_ RFC_Loc016_RadialDistance : 192|15@1+ (0.01,0) [0|327.67] "m"  DASy
 SG_ RFC_Loc016_RadialVelocity : 207|15@1+ (0.01,-163.84) [-110|55] "m/s"  DASy
 SG_ RFC_Loc016_Elevation : 222|10@1+ (0.1,-51.2) [-45|45] "deg"  DASy
 SG_ RFC_Loc016_Azimuth : 232|11@1+ (0.1,-102.4) [-90|90] "deg"  DASy
 SG_ RFC_Loc016_DistVelocityCoVnce : 243|11@1+ (0.0001,-0.1024) [-0.1024|0.1023] "m^2/s"  DASy
 SG_ RFC_Loc016_RadialDistanceVnce : 254|10@1+ (5E-005,0) [0|0.05115] "m^2"  DASy
 SG_ RFC_Loc016_RadialVelocityVnce : 264|10@1+ (0.0001,0) [0|0.1023] "m^2/s^2"  DASy
 SG_ RFC_Loc016_ElevationVnce : 274|10@1+ (0.001,0) [0|1.023] "deg^2"  DASy
 SG_ RFC_Loc016_AzimuthVnce : 284|10@1+ (0.001,0) [0|1.023] "deg^2"  DASy
 SG_ RFC_Loc016_RadarCrossSection : 294|10@1+ (0.2,-102.4) [-50|70] "dBsm"  DASy
 SG_ RFC_Loc016_DistVelocityQuality : 304|8@1+ (1,0) [0|255] "unitless"  DASy
 SG_ RFC_Loc016_ElevationQuality : 312|8@1+ (1,0) [0|255] "unitless"  DASy
 SG_ RFC_Loc016_AzimuthQuality : 320|8@1+ (1,0) [0|255] "unitless"  DASy
 SG_ RFC_Loc016_RSSI : 328|10@1+ (0.1,0) [0|100] "unitless"  DASy
 SG_ RFC_Loc016_AzimuthalPartnerId : 338|10@1+ (1,0) [0|1023] "unitless"  DASy
 SG_ RFC_Loc017_RadialDistance : 352|15@1+ (0.01,0) [0|327.67] "m"  DASy
 SG_ RFC_Loc017_RadialVelocity : 367|15@1+ (0.01,-163.84) [-110|55] "m/s"  DASy
 SG_ RFC_Loc017_Elevation : 382|10@1+ (0.1,-51.2) [-45|45] "deg"  DASy
 SG_ RFC_Loc017_Azimuth : 392|11@1+ (0.1,-102.4) [-90|90] "deg"  DASy
 SG_ RFC_Loc017_DistVelocityCoVnce : 403|11@1+ (0.0001,-0.1024) [-0.1024|0.1023] "m^2/s"  DASy
 SG_ RFC_Loc017_RadialDistanceVnce : 414|10@1+ (5E-005,0) [0|0.05115] "m^2"  DASy
 SG_ RFC_Loc017_RadialVelocityVnce : 424|10@1+ (0.0001,0) [0|0.1023] "m^2/s^2"  DASy
 SG_ RFC_Loc017_ElevationVnce : 434|10@1+ (0.001,0) [0|1.023] "deg^2"  DASy
 SG_ RFC_Loc017_AzimuthVnce : 444|10@1+ (0.001,0) [0|1.023] "deg^2"  DASy
 SG_ RFC_Loc017_RadarCrossSection : 454|10@1+ (0.2,-102.4) [-50|70] "dBsm"  DASy
 SG_ RFC_Loc017_DistVelocityQuality : 464|8@1+ (1,0) [0|255] "unitless"  DASy
 SG_ RFC_Loc017_ElevationQuality : 472|8@1+ (1,0) [0|255] "unitless"  DASy
 SG_ RFC_Loc017_AzimuthQuality : 480|8@1+ (1,0) [0|255] "unitless"  DASy
 SG_ RFC_Loc017_RSSI : 488|10@1+ (0.1,0) [0|100] "unitless"  DASy
 SG_ RFC_Loc017_AzimuthalPartnerId : 498|10@1+ (1,0) [0|1023] "unitless"  DASy

BO_ 270 RFC_Location_018_020: 64 RadarFrontCenter
 SG_ RFC_Loc018_020_CRC : 0|16@1+ (1,0) [0|65535] ""  DASy
 SG_ RFC_Loc018_020_AliveCtr : 16|8@1+ (1,0) [0|255] ""  DASy
 SG_ RFC_Loc018_020_ProtBlockCtr : 24|4@1+ (1,0) [0|15] ""  DASy
 SG_ RFC_Loc018_RadialDistance : 32|15@1+ (0.01,0) [0|327.67] "m"  DASy
 SG_ RFC_Loc018_RadialVelocity : 47|15@1+ (0.01,-163.84) [-110|55] "m/s"  DASy
 SG_ RFC_Loc018_Elevation : 62|10@1+ (0.1,-51.2) [-45|45] "deg"  DASy
 SG_ RFC_Loc018_Azimuth : 72|11@1+ (0.1,-102.4) [-90|90] "deg"  DASy
 SG_ RFC_Loc018_DistVelocityCoVnce : 83|11@1+ (0.0001,-0.1024) [-0.1024|0.1023] "m^2/s"  DASy
 SG_ RFC_Loc018_RadialDistanceVnce : 94|10@1+ (5E-005,0) [0|0.05115] "m^2"  DASy
 SG_ RFC_Loc018_RadialVelocityVnce : 104|10@1+ (0.0001,0) [0|0.1023] "m^2/s^2"  DASy
 SG_ RFC_Loc018_ElevationVnce : 114|10@1+ (0.001,0) [0|1.023] "deg^2"  DASy
 SG_ RFC_Loc018_AzimuthVnce : 124|10@1+ (0.001,0) [0|1.023] "deg^2"  DASy
 SG_ RFC_Loc018_RadarCrossSection : 134|10@1+ (0.2,-102.4) [-50|70] "dBsm"  DASy
 SG_ RFC_Loc018_DistVelocityQuality : 144|8@1+ (1,0) [0|255] "unitless"  DASy
 SG_ RFC_Loc018_ElevationQuality : 152|8@1+ (1,0) [0|255] "unitless"  DASy
 SG_ RFC_Loc018_AzimuthQuality : 160|8@1+ (1,0) [0|255] "unitless"  DASy
 SG_ RFC_Loc018_RSSI : 168|10@1+ (0.1,0) [0|100] "unitless"  DASy
 SG_ RFC_Loc018_AzimuthalPartnerId : 178|10@1+ (1,0) [0|1023] "unitless"  DASy
 SG_ RFC_Loc019_RadialDistance : 192|15@1+ (0.01,0) [0|327.67] "m"  DASy
 SG_ RFC_Loc019_RadialVelocity : 207|15@1+ (0.01,-163.84) [-110|55] "m/s"  DASy
 SG_ RFC_Loc019_Elevation : 222|10@1+ (0.1,-51.2) [-45|45] "deg"  DASy
 SG_ RFC_Loc019_Azimuth : 232|11@1+ (0.1,-102.4) [-90|90] "deg"  DASy
 SG_ RFC_Loc019_DistVelocityCoVnce : 243|11@1+ (0.0001,-0.1024) [-0.1024|0.1023] "m^2/s"  DASy
 SG_ RFC_Loc019_RadialDistanceVnce : 254|10@1+ (5E-005,0) [0|0.05115] "m^2"  DASy
 SG_ RFC_Loc019_RadialVelocityVnce : 264|10@1+ (0.0001,0) [0|0.1023] "m^2/s^2"  DASy
 SG_ RFC_Loc019_ElevationVnce : 274|10@1+ (0.001,0) [0|1.023] "deg^2"  DASy
 SG_ RFC_Loc019_AzimuthVnce : 284|10@1+ (0.001,0) [0|1.023] "deg^2"  DASy
 SG_ RFC_Loc019_RadarCrossSection : 294|10@1+ (0.2,-102.4) [-50|70] "dBsm"  DASy
 SG_ RFC_Loc019_DistVelocityQuality : 304|8@1+ (1,0) [0|255] "unitless"  DASy
 SG_ RFC_Loc019_ElevationQuality : 312|8@1+ (1,0) [0|255] "unitless"  DASy
 SG_ RFC_Loc019_AzimuthQuality : 320|8@1+ (1,0) [0|255] "unitless"  DASy
 SG_ RFC_Loc019_RSSI : 328|10@1+ (0.1,0) [0|100] "unitless"  DASy
 SG_ RFC_Loc019_AzimuthalPartnerId : 338|10@1+ (1,0) [0|1023] "unitless"  DASy
 SG_ RFC_Loc020_RadialDistance : 352|15@1+ (0.01,0) [0|327.67] "m"  DASy
 SG_ RFC_Loc020_RadialVelocity : 367|15@1+ (0.01,-163.84) [-110|55] "m/s"  DASy
 SG_ RFC_Loc020_Elevation : 382|10@1+ (0.1,-51.2) [-45|45] "deg"  DASy
 SG_ RFC_Loc020_Azimuth : 392|11@1+ (0.1,-102.4) [-90|90] "deg"  DASy
 SG_ RFC_Loc020_DistVelocityCoVnce : 403|11@1+ (0.0001,-0.1024) [-0.1024|0.1023] "m^2/s"  DASy
 SG_ RFC_Loc020_RadialDistanceVnce : 414|10@1+ (5E-005,0) [0|0.05115] "m^2"  DASy
 SG_ RFC_Loc020_RadialVelocityVnce : 424|10@1+ (0.0001,0) [0|0.1023] "m^2/s^2"  DASy
 SG_ RFC_Loc020_ElevationVnce : 434|10@1+ (0.001,0) [0|1.023] "deg^2"  DASy
 SG_ RFC_Loc020_AzimuthVnce : 444|10@1+ (0.001,0) [0|1.023] "deg^2"  DASy
 SG_ RFC_Loc020_RadarCrossSection : 454|10@1+ (0.2,-102.4) [-50|70] "dBsm"  DASy
 SG_ RFC_Loc020_DistVelocityQuality : 464|8@1+ (1,0) [0|255] "unitless"  DASy
 SG_ RFC_Loc020_ElevationQuality : 472|8@1+ (1,0) [0|255] "unitless"  DASy
 SG_ RFC_Loc020_AzimuthQuality : 480|8@1+ (1,0) [0|255] "unitless"  DASy
 SG_ RFC_Loc020_RSSI : 488|10@1+ (0.1,0) [0|100] "unitless"  DASy
 SG_ RFC_Loc020_AzimuthalPartnerId : 498|10@1+ (1,0) [0|1023] "unitless"  DASy

BO_ 271 RFC_Location_021_023: 64 RadarFrontCenter
 SG_ RFC_Loc021_023_CRC : 0|16@1+ (1,0) [0|65535] ""  DASy
 SG_ RFC_Loc021_023_AliveCtr : 16|8@1+ (1,0) [0|255] ""  DASy
 SG_ RFC_Loc021_023_ProtBlockCtr : 24|4@1+ (1,0) [0|15] ""  DASy
 SG_ RFC_Loc021_RadialDistance : 32|15@1+ (0.01,0) [0|327.67] "m"  DASy
 SG_ RFC_Loc021_RadialVelocity : 47|15@1+ (0.01,-163.84) [-110|55] "m/s"  DASy
 SG_ RFC_Loc021_Elevation : 62|10@1+ (0.1,-51.2) [-45|45] "deg"  DASy
 SG_ RFC_Loc021_Azimuth : 72|11@1+ (0.1,-102.4) [-90|90] "deg"  DASy
 SG_ RFC_Loc021_DistVelocityCoVnce : 83|11@1+ (0.0001,-0.1024) [-0.1024|0.1023] "m^2/s"  DASy
 SG_ RFC_Loc021_RadialDistanceVnce : 94|10@1+ (5E-005,0) [0|0.05115] "m^2"  DASy
 SG_ RFC_Loc021_RadialVelocityVnce : 104|10@1+ (0.0001,0) [0|0.1023] "m^2/s^2"  DASy
 SG_ RFC_Loc021_ElevationVnce : 114|10@1+ (0.001,0) [0|1.023] "deg^2"  DASy
 SG_ RFC_Loc021_AzimuthVnce : 124|10@1+ (0.001,0) [0|1.023] "deg^2"  DASy
 SG_ RFC_Loc021_RadarCrossSection : 134|10@1+ (0.2,-102.4) [-50|70] "dBsm"  DASy
 SG_ RFC_Loc021_DistVelocityQuality : 144|8@1+ (1,0) [0|255] "unitless"  DASy
 SG_ RFC_Loc021_ElevationQuality : 152|8@1+ (1,0) [0|255] "unitless"  DASy
 SG_ RFC_Loc021_AzimuthQuality : 160|8@1+ (1,0) [0|255] "unitless"  DASy
 SG_ RFC_Loc021_RSSI : 168|10@1+ (0.1,0) [0|100] "unitless"  DASy
 SG_ RFC_Loc021_AzimuthalPartnerId : 178|10@1+ (1,0) [0|1023] "unitless"  DASy
 SG_ RFC_Loc022_RadialDistance : 192|15@1+ (0.01,0) [0|327.67] "m"  DASy
 SG_ RFC_Loc022_RadialVelocity : 207|15@1+ (0.01,-163.84) [-110|55] "m/s"  DASy
 SG_ RFC_Loc022_Elevation : 222|10@1+ (0.1,-51.2) [-45|45] "deg"  DASy
 SG_ RFC_Loc022_Azimuth : 232|11@1+ (0.1,-102.4) [-90|90] "deg"  DASy
 SG_ RFC_Loc022_DistVelocityCoVnce : 243|11@1+ (0.0001,-0.1024) [-0.1024|0.1023] "m^2/s"  DASy
 SG_ RFC_Loc022_RadialDistanceVnce : 254|10@1+ (5E-005,0) [0|0.05115] "m^2"  DASy
 SG_ RFC_Loc022_RadialVelocityVnce : 264|10@1+ (0.0001,0) [0|0.1023] "m^2/s^2"  DASy
 SG_ RFC_Loc022_ElevationVnce : 274|10@1+ (0.001,0) [0|1.023] "deg^2"  DASy
 SG_ RFC_Loc022_AzimuthVnce : 284|10@1+ (0.001,0) [0|1.023] "deg^2"  DASy
 SG_ RFC_Loc022_RadarCrossSection : 294|10@1+ (0.2,-102.4) [-50|70] "dBsm"  DASy
 SG_ RFC_Loc022_DistVelocityQuality : 304|8@1+ (1,0) [0|255] "unitless"  DASy
 SG_ RFC_Loc022_ElevationQuality : 312|8@1+ (1,0) [0|255] "unitless"  DASy
 SG_ RFC_Loc022_AzimuthQuality : 320|8@1+ (1,0) [0|255] "unitless"  DASy
 SG_ RFC_Loc022_RSSI : 328|10@1+ (0.1,0) [0|100] "unitless"  DASy
 SG_ RFC_Loc022_AzimuthalPartnerId : 338|10@1+ (1,0) [0|1023] "unitless"  DASy
 SG_ RFC_Loc023_RadialDistance : 352|15@1+ (0.01,0) [0|327.67] "m"  DASy
 SG_ RFC_Loc023_RadialVelocity : 367|15@1+ (0.01,-163.84) [-110|55] "m/s"  DASy
 SG_ RFC_Loc023_Elevation : 382|10@1+ (0.1,-51.2) [-45|45] "deg"  DASy
 SG_ RFC_Loc023_Azimuth : 392|11@1+ (0.1,-102.4) [-90|90] "deg"  DASy
 SG_ RFC_Loc023_DistVelocityCoVnce : 403|11@1+ (0.0001,-0.1024) [-0.1024|0.1023] "m^2/s"  DASy
 SG_ RFC_Loc023_RadialDistanceVnce : 414|10@1+ (5E-005,0) [0|0.05115] "m^2"  DASy
 SG_ RFC_Loc023_RadialVelocityVnce : 424|10@1+ (0.0001,0) [0|0.1023] "m^2/s^2"  DASy
 SG_ RFC_Loc023_ElevationVnce : 434|10@1+ (0.001,0) [0|1.023] "deg^2"  DASy
 SG_ RFC_Loc023_AzimuthVnce : 444|10@1+ (0.001,0) [0|1.023] "deg^2"  DASy
 SG_ RFC_Loc023_RadarCrossSection : 454|10@1+ (0.2,-102.4) [-50|70] "dBsm"  DASy
 SG_ RFC_Loc023_DistVelocityQuality : 464|8@1+ (1,0) [0|255] "unitless"  DASy
 SG_ RFC_Loc023_ElevationQuality : 472|8@1+ (1,0) [0|255] "unitless"  DASy
 SG_ RFC_Loc023_AzimuthQuality : 480|8@1+ (1,0) [0|255] "unitless"  DASy
 SG_ RFC_Loc023_RSSI : 488|10@1+ (0.1,0) [0|100] "unitless"  DASy
 SG_ RFC_Loc023_AzimuthalPartnerId : 498|10@1+ (1,0) [0|1023] "unitless"  DASy

BO_ 272 RFC_Location_024_026: 64 RadarFrontCenter
 SG_ RFC_Loc024_026_CRC : 0|16@1+ (1,0) [0|65535] ""  DASy
 SG_ RFC_Loc024_026_AliveCtr : 16|8@1+ (1,0) [0|255] ""  DASy
 SG_ RFC_Loc024_026_ProtBlockCtr : 24|4@1+ (1,0) [0|15] ""  DASy
 SG_ RFC_Loc024_RadialDistance : 32|15@1+ (0.01,0) [0|327.67] "m"  DASy
 SG_ RFC_Loc024_RadialVelocity : 47|15@1+ (0.01,-163.84) [-110|55] "m/s"  DASy
 SG_ RFC_Loc024_Elevation : 62|10@1+ (0.1,-51.2) [-45|45] "deg"  DASy
 SG_ RFC_Loc024_Azimuth : 72|11@1+ (0.1,-102.4) [-90|90] "deg"  DASy
 SG_ RFC_Loc024_DistVelocityCoVnce : 83|11@1+ (0.0001,-0.1024) [-0.1024|0.1023] "m^2/s"  DASy
 SG_ RFC_Loc024_RadialDistanceVnce : 94|10@1+ (5E-005,0) [0|0.05115] "m^2"  DASy
 SG_ RFC_Loc024_RadialVelocityVnce : 104|10@1+ (0.0001,0) [0|0.1023] "m^2/s^2"  DASy
 SG_ RFC_Loc024_ElevationVnce : 114|10@1+ (0.001,0) [0|1.023] "deg^2"  DASy
 SG_ RFC_Loc024_AzimuthVnce : 124|10@1+ (0.001,0) [0|1.023] "deg^2"  DASy
 SG_ RFC_Loc024_RadarCrossSection : 134|10@1+ (0.2,-102.4) [-50|70] "dBsm"  DASy
 SG_ RFC_Loc024_DistVelocityQuality : 144|8@1+ (1,0) [0|255] "unitless"  DASy
 SG_ RFC_Loc024_ElevationQuality : 152|8@1+ (1,0) [0|255] "unitless"  DASy
 SG_ RFC_Loc024_AzimuthQuality : 160|8@1+ (1,0) [0|255] "unitless"  DASy
 SG_ RFC_Loc024_RSSI : 168|10@1+ (0.1,0) [0|100] "unitless"  DASy
 SG_ RFC_Loc024_AzimuthalPartnerId : 178|10@1+ (1,0) [0|1023] "unitless"  DASy
 SG_ RFC_Loc025_RadialDistance : 192|15@1+ (0.01,0) [0|327.67] "m"  DASy
 SG_ RFC_Loc025_RadialVelocity : 207|15@1+ (0.01,-163.84) [-110|55] "m/s"  DASy
 SG_ RFC_Loc025_Elevation : 222|10@1+ (0.1,-51.2) [-45|45] "deg"  DASy
 SG_ RFC_Loc025_Azimuth : 232|11@1+ (0.1,-102.4) [-90|90] "deg"  DASy
 SG_ RFC_Loc025_DistVelocityCoVnce : 243|11@1+ (0.0001,-0.1024) [-0.1024|0.1023] "m^2/s"  DASy
 SG_ RFC_Loc025_RadialDistanceVnce : 254|10@1+ (5E-005,0) [0|0.05115] "m^2"  DASy
 SG_ RFC_Loc025_RadialVelocityVnce : 264|10@1+ (0.0001,0) [0|0.1023] "m^2/s^2"  DASy
 SG_ RFC_Loc025_ElevationVnce : 274|10@1+ (0.001,0) [0|1.023] "deg^2"  DASy
 SG_ RFC_Loc025_AzimuthVnce : 284|10@1+ (0.001,0) [0|1.023] "deg^2"  DASy
 SG_ RFC_Loc025_RadarCrossSection : 294|10@1+ (0.2,-102.4) [-50|70] "dBsm"  DASy
 SG_ RFC_Loc025_DistVelocityQuality : 304|8@1+ (1,0) [0|255] "unitless"  DASy
 SG_ RFC_Loc025_ElevationQuality : 312|8@1+ (1,0) [0|255] "unitless"  DASy
 SG_ RFC_Loc025_AzimuthQuality : 320|8@1+ (1,0) [0|255] "unitless"  DASy
 SG_ RFC_Loc025_RSSI : 328|10@1+ (0.1,0) [0|100] "unitless"  DASy
 SG_ RFC_Loc025_AzimuthalPartnerId : 338|10@1+ (1,0) [0|1023] "unitless"  DASy
 SG_ RFC_Loc026_RadialDistance : 352|15@1+ (0.01,0) [0|327.67] "m"  DASy
 SG_ RFC_Loc026_RadialVelocity : 367|15@1+ (0.01,-163.84) [-110|55] "m/s"  DASy
 SG_ RFC_Loc026_Elevation : 382|10@1+ (0.1,-51.2) [-45|45] "deg"  DASy
 SG_ RFC_Loc026_Azimuth : 392|11@1+ (0.1,-102.4) [-90|90] "deg"  DASy
 SG_ RFC_Loc026_DistVelocityCoVnce : 403|11@1+ (0.0001,-0.1024) [-0.1024|0.1023] "m^2/s"  DASy
 SG_ RFC_Loc026_RadialDistanceVnce : 414|10@1+ (5E-005,0) [0|0.05115] "m^2"  DASy
 SG_ RFC_Loc026_RadialVelocityVnce : 424|10@1+ (0.0001,0) [0|0.1023] "m^2/s^2"  DASy
 SG_ RFC_Loc026_ElevationVnce : 434|10@1+ (0.001,0) [0|1.023] "deg^2"  DASy
 SG_ RFC_Loc026_AzimuthVnce : 444|10@1+ (0.001,0) [0|1.023] "deg^2"  DASy
 SG_ RFC_Loc026_RadarCrossSection : 454|10@1+ (0.2,-102.4) [-50|70] "dBsm"  DASy
 SG_ RFC_Loc026_DistVelocityQuality : 464|8@1+ (1,0) [0|255] "unitless"  DASy
 SG_ RFC_Loc026_ElevationQuality : 472|8@1+ (1,0) [0|255] "unitless"  DASy
 SG_ RFC_Loc026_AzimuthQuality : 480|8@1+ (1,0) [0|255] "unitless"  DASy
 SG_ RFC_Loc026_RSSI : 488|10@1+ (0.1,0) [0|100] "unitless"  DASy
 SG_ RFC_Loc026_AzimuthalPartnerId : 498|10@1+ (1,0) [0|1023] "unitless"  DASy

BO_ 273 RFC_Location_027_029: 64 RadarFrontCenter
 SG_ RFC_Loc027_029_CRC : 0|16@1+ (1,0) [0|65535] ""  DASy
 SG_ RFC_Loc027_029_AliveCtr : 16|8@1+ (1,0) [0|255] ""  DASy
 SG_ RFC_Loc027_029_ProtBlockCtr : 24|4@1+ (1,0) [0|15] ""  DASy
 SG_ RFC_Loc027_RadialDistance : 32|15@1+ (0.01,0) [0|327.67] "m"  DASy
 SG_ RFC_Loc027_RadialVelocity : 47|15@1+ (0.01,-163.84) [-110|55] "m/s"  DASy
 SG_ RFC_Loc027_Elevation : 62|10@1+ (0.1,-51.2) [-45|45] "deg"  DASy
 SG_ RFC_Loc027_Azimuth : 72|11@1+ (0.1,-102.4) [-90|90] "deg"  DASy
 SG_ RFC_Loc027_DistVelocityCoVnce : 83|11@1+ (0.0001,-0.1024) [-0.1024|0.1023] "m^2/s"  DASy
 SG_ RFC_Loc027_RadialDistanceVnce : 94|10@1+ (5E-005,0) [0|0.05115] "m^2"  DASy
 SG_ RFC_Loc027_RadialVelocityVnce : 104|10@1+ (0.0001,0) [0|0.1023] "m^2/s^2"  DASy
 SG_ RFC_Loc027_ElevationVnce : 114|10@1+ (0.001,0) [0|1.023] "deg^2"  DASy
 SG_ RFC_Loc027_AzimuthVnce : 124|10@1+ (0.001,0) [0|1.023] "deg^2"  DASy
 SG_ RFC_Loc027_RadarCrossSection : 134|10@1+ (0.2,-102.4) [-50|70] "dBsm"  DASy
 SG_ RFC_Loc027_DistVelocityQuality : 144|8@1+ (1,0) [0|255] "unitless"  DASy
 SG_ RFC_Loc027_ElevationQuality : 152|8@1+ (1,0) [0|255] "unitless"  DASy
 SG_ RFC_Loc027_AzimuthQuality : 160|8@1+ (1,0) [0|255] "unitless"  DASy
 SG_ RFC_Loc027_RSSI : 168|10@1+ (0.1,0) [0|100] "unitless"  DASy
 SG_ RFC_Loc027_AzimuthalPartnerId : 178|10@1+ (1,0) [0|1023] "unitless"  DASy
 SG_ RFC_Loc028_RadialDistance : 192|15@1+ (0.01,0) [0|327.67] "m"  DASy
 SG_ RFC_Loc028_RadialVelocity : 207|15@1+ (0.01,-163.84) [-110|55] "m/s"  DASy
 SG_ RFC_Loc028_Elevation : 222|10@1+ (0.1,-51.2) [-45|45] "deg"  DASy
 SG_ RFC_Loc028_Azimuth : 232|11@1+ (0.1,-102.4) [-90|90] "deg"  DASy
 SG_ RFC_Loc028_DistVelocityCoVnce : 243|11@1+ (0.0001,-0.1024) [-0.1024|0.1023] "m^2/s"  DASy
 SG_ RFC_Loc028_RadialDistanceVnce : 254|10@1+ (5E-005,0) [0|0.05115] "m^2"  DASy
 SG_ RFC_Loc028_RadialVelocityVnce : 264|10@1+ (0.0001,0) [0|0.1023] "m^2/s^2"  DASy
 SG_ RFC_Loc028_ElevationVnce : 274|10@1+ (0.001,0) [0|1.023] "deg^2"  DASy
 SG_ RFC_Loc028_AzimuthVnce : 284|10@1+ (0.001,0) [0|1.023] "deg^2"  DASy
 SG_ RFC_Loc028_RadarCrossSection : 294|10@1+ (0.2,-102.4) [-50|70] "dBsm"  DASy
 SG_ RFC_Loc028_DistVelocityQuality : 304|8@1+ (1,0) [0|255] "unitless"  DASy
 SG_ RFC_Loc028_ElevationQuality : 312|8@1+ (1,0) [0|255] "unitless"  DASy
 SG_ RFC_Loc028_AzimuthQuality : 320|8@1+ (1,0) [0|255] "unitless"  DASy
 SG_ RFC_Loc028_RSSI : 328|10@1+ (0.1,0) [0|100] "unitless"  DASy
 SG_ RFC_Loc028_AzimuthalPartnerId : 338|10@1+ (1,0) [0|1023] "unitless"  DASy
 SG_ RFC_Loc029_RadialDistance : 352|15@1+ (0.01,0) [0|327.67] "m"  DASy
 SG_ RFC_Loc029_RadialVelocity : 367|15@1+ (0.01,-163.84) [-110|55] "m/s"  DASy
 SG_ RFC_Loc029_Elevation : 382|10@1+ (0.1,-51.2) [-45|45] "deg"  DASy
 SG_ RFC_Loc029_Azimuth : 392|11@1+ (0.1,-102.4) [-90|90] "deg"  DASy
 SG_ RFC_Loc029_DistVelocityCoVnce : 403|11@1+ (0.0001,-0.1024) [-0.1024|0.1023] "m^2/s"  DASy
 SG_ RFC_Loc029_RadialDistanceVnce : 414|10@1+ (5E-005,0) [0|0.05115] "m^2"  DASy
 SG_ RFC_Loc029_RadialVelocityVnce : 424|10@1+ (0.0001,0) [0|0.1023] "m^2/s^2"  DASy
 SG_ RFC_Loc029_ElevationVnce : 434|10@1+ (0.001,0) [0|1.023] "deg^2"  DASy
 SG_ RFC_Loc029_AzimuthVnce : 444|10@1+ (0.001,0) [0|1.023] "deg^2"  DASy
 SG_ RFC_Loc029_RadarCrossSection : 454|10@1+ (0.2,-102.4) [-50|70] "dBsm"  DASy
 SG_ RFC_Loc029_DistVelocityQuality : 464|8@1+ (1,0) [0|255] "unitless"  DASy
 SG_ RFC_Loc029_ElevationQuality : 472|8@1+ (1,0) [0|255] "unitless"  DASy
 SG_ RFC_Loc029_AzimuthQuality : 480|8@1+ (1,0) [0|255] "unitless"  DASy
 SG_ RFC_Loc029_RSSI : 488|10@1+ (0.1,0) [0|100] "unitless"  DASy
 SG_ RFC_Loc029_AzimuthalPartnerId : 498|10@1+ (1,0) [0|1023] "unitless"  DASy

BO_ 274 RFC_Location_030_032: 64 RadarFrontCenter
 SG_ RFC_Loc030_032_CRC : 0|16@1+ (1,0) [0|65535] ""  DASy
 SG_ RFC_Loc030_032_AliveCtr : 16|8@1+ (1,0) [0|255] ""  DASy
 SG_ RFC_Loc030_032_ProtBlockCtr : 24|4@1+ (1,0) [0|15] ""  DASy
 SG_ RFC_Loc030_RadialDistance : 32|15@1+ (0.01,0) [0|327.67] "m"  DASy
 SG_ RFC_Loc030_RadialVelocity : 47|15@1+ (0.01,-163.84) [-110|55] "m/s"  DASy
 SG_ RFC_Loc030_Elevation : 62|10@1+ (0.1,-51.2) [-45|45] "deg"  DASy
 SG_ RFC_Loc030_Azimuth : 72|11@1+ (0.1,-102.4) [-90|90] "deg"  DASy
 SG_ RFC_Loc030_DistVelocityCoVnce : 83|11@1+ (0.0001,-0.1024) [-0.1024|0.1023] "m^2/s"  DASy
 SG_ RFC_Loc030_RadialDistanceVnce : 94|10@1+ (5E-005,0) [0|0.05115] "m^2"  DASy
 SG_ RFC_Loc030_RadialVelocityVnce : 104|10@1+ (0.0001,0) [0|0.1023] "m^2/s^2"  DASy
 SG_ RFC_Loc030_ElevationVnce : 114|10@1+ (0.001,0) [0|1.023] "deg^2"  DASy
 SG_ RFC_Loc030_AzimuthVnce : 124|10@1+ (0.001,0) [0|1.023] "deg^2"  DASy
 SG_ RFC_Loc030_RadarCrossSection : 134|10@1+ (0.2,-102.4) [-50|70] "dBsm"  DASy
 SG_ RFC_Loc030_DistVelocityQuality : 144|8@1+ (1,0) [0|255] "unitless"  DASy
 SG_ RFC_Loc030_ElevationQuality : 152|8@1+ (1,0) [0|255] "unitless"  DASy
 SG_ RFC_Loc030_AzimuthQuality : 160|8@1+ (1,0) [0|255] "unitless"  DASy
 SG_ RFC_Loc030_RSSI : 168|10@1+ (0.1,0) [0|100] "unitless"  DASy
 SG_ RFC_Loc030_AzimuthalPartnerId : 178|10@1+ (1,0) [0|1023] "unitless"  DASy
 SG_ RFC_Loc031_RadialDistance : 192|15@1+ (0.01,0) [0|327.67] "m"  DASy
 SG_ RFC_Loc031_RadialVelocity : 207|15@1+ (0.01,-163.84) [-110|55] "m/s"  DASy
 SG_ RFC_Loc031_Elevation : 222|10@1+ (0.1,-51.2) [-45|45] "deg"  DASy
 SG_ RFC_Loc031_Azimuth : 232|11@1+ (0.1,-102.4) [-90|90] "deg"  DASy
 SG_ RFC_Loc031_DistVelocityCoVnce : 243|11@1+ (0.0001,-0.1024) [-0.1024|0.1023] "m^2/s"  DASy
 SG_ RFC_Loc031_RadialDistanceVnce : 254|10@1+ (5E-005,0) [0|0.05115] "m^2"  DASy
 SG_ RFC_Loc031_RadialVelocityVnce : 264|10@1+ (0.0001,0) [0|0.1023] "m^2/s^2"  DASy
 SG_ RFC_Loc031_ElevationVnce : 274|10@1+ (0.001,0) [0|1.023] "deg^2"  DASy
 SG_ RFC_Loc031_AzimuthVnce : 284|10@1+ (0.001,0) [0|1.023] "deg^2"  DASy
 SG_ RFC_Loc031_RadarCrossSection : 294|10@1+ (0.2,-102.4) [-50|70] "dBsm"  DASy
 SG_ RFC_Loc031_DistVelocityQuality : 304|8@1+ (1,0) [0|255] "unitless"  DASy
 SG_ RFC_Loc031_ElevationQuality : 312|8@1+ (1,0) [0|255] "unitless"  DASy
 SG_ RFC_Loc031_AzimuthQuality : 320|8@1+ (1,0) [0|255] "unitless"  DASy
 SG_ RFC_Loc031_RSSI : 328|10@1+ (0.1,0) [0|100] "unitless"  DASy
 SG_ RFC_Loc031_AzimuthalPartnerId : 338|10@1+ (1,0) [0|1023] "unitless"  DASy
 SG_ RFC_Loc032_RadialDistance : 352|15@1+ (0.01,0) [0|327.67] "m"  DASy
 SG_ RFC_Loc032_RadialVelocity : 367|15@1+ (0.01,-163.84) [-110|55] "m/s"  DASy
 SG_ RFC_Loc032_Elevation : 382|10@1+ (0.1,-51.2) [-45|45] "deg"  DASy
 SG_ RFC_Loc032_Azimuth : 392|11@1+ (0.1,-102.4) [-90|90] "deg"  DASy
 SG_ RFC_Loc032_DistVelocityCoVnce : 403|11@1+ (0.0001,-0.1024) [-0.1024|0.1023] "m^2/s"  DASy
 SG_ RFC_Loc032_RadialDistanceVnce : 414|10@1+ (5E-005,0) [0|0.05115] "m^2"  DASy
 SG_ RFC_Loc032_RadialVelocityVnce : 424|10@1+ (0.0001,0) [0|0.1023] "m^2/s^2"  DASy
 SG_ RFC_Loc032_ElevationVnce : 434|10@1+ (0.001,0) [0|1.023] "deg^2"  DASy
 SG_ RFC_Loc032_AzimuthVnce : 444|10@1+ (0.001,0) [0|1.023] "deg^2"  DASy
 SG_ RFC_Loc032_RadarCrossSection : 454|10@1+ (0.2,-102.4) [-50|70] "dBsm"  DASy
 SG_ RFC_Loc032_DistVelocityQuality : 464|8@1+ (1,0) [0|255] "unitless"  DASy
 SG_ RFC_Loc032_ElevationQuality : 472|8@1+ (1,0) [0|255] "unitless"  DASy
 SG_ RFC_Loc032_AzimuthQuality : 480|8@1+ (1,0) [0|255] "unitless"  DASy
 SG_ RFC_Loc032_RSSI : 488|10@1+ (0.1,0) [0|100] "unitless"  DASy
 SG_ RFC_Loc032_AzimuthalPartnerId : 498|10@1+ (1,0) [0|1023] "unitless"  DASy

BO_ 275 RFC_Location_033_035: 64 RadarFrontCenter
 SG_ RFC_Loc033_035_CRC : 0|16@1+ (1,0) [0|65535] ""  DASy
 SG_ RFC_Loc033_035_AliveCtr : 16|8@1+ (1,0) [0|255] ""  DASy
 SG_ RFC_Loc033_035_ProtBlockCtr : 24|4@1+ (1,0) [0|15] ""  DASy
 SG_ RFC_Loc033_RadialDistance : 32|15@1+ (0.01,0) [0|327.67] "m"  DASy
 SG_ RFC_Loc033_RadialVelocity : 47|15@1+ (0.01,-163.84) [-110|55] "m/s"  DASy
 SG_ RFC_Loc033_Elevation : 62|10@1+ (0.1,-51.2) [-45|45] "deg"  DASy
 SG_ RFC_Loc033_Azimuth : 72|11@1+ (0.1,-102.4) [-90|90] "deg"  DASy
 SG_ RFC_Loc033_DistVelocityCoVnce : 83|11@1+ (0.0001,-0.1024) [-0.1024|0.1023] "m^2/s"  DASy
 SG_ RFC_Loc033_RadialDistanceVnce : 94|10@1+ (5E-005,0) [0|0.05115] "m^2"  DASy
 SG_ RFC_Loc033_RadialVelocityVnce : 104|10@1+ (0.0001,0) [0|0.1023] "m^2/s^2"  DASy
 SG_ RFC_Loc033_ElevationVnce : 114|10@1+ (0.001,0) [0|1.023] "deg^2"  DASy
 SG_ RFC_Loc033_AzimuthVnce : 124|10@1+ (0.001,0) [0|1.023] "deg^2"  DASy
 SG_ RFC_Loc033_RadarCrossSection : 134|10@1+ (0.2,-102.4) [-50|70] "dBsm"  DASy
 SG_ RFC_Loc033_DistVelocityQuality : 144|8@1+ (1,0) [0|255] "unitless"  DASy
 SG_ RFC_Loc033_ElevationQuality : 152|8@1+ (1,0) [0|255] "unitless"  DASy
 SG_ RFC_Loc033_AzimuthQuality : 160|8@1+ (1,0) [0|255] "unitless"  DASy
 SG_ RFC_Loc033_RSSI : 168|10@1+ (0.1,0) [0|100] "unitless"  DASy
 SG_ RFC_Loc033_AzimuthalPartnerId : 178|10@1+ (1,0) [0|1023] "unitless"  DASy
 SG_ RFC_Loc034_RadialDistance : 192|15@1+ (0.01,0) [0|327.67] "m"  DASy
 SG_ RFC_Loc034_RadialVelocity : 207|15@1+ (0.01,-163.84) [-110|55] "m/s"  DASy
 SG_ RFC_Loc034_Elevation : 222|10@1+ (0.1,-51.2) [-45|45] "deg"  DASy
 SG_ RFC_Loc034_Azimuth : 232|11@1+ (0.1,-102.4) [-90|90] "deg"  DASy
 SG_ RFC_Loc034_DistVelocityCoVnce : 243|11@1+ (0.0001,-0.1024) [-0.1024|0.1023] "m^2/s"  DASy
 SG_ RFC_Loc034_RadialDistanceVnce : 254|10@1+ (5E-005,0) [0|0.05115] "m^2"  DASy
 SG_ RFC_Loc034_RadialVelocityVnce : 264|10@1+ (0.0001,0) [0|0.1023] "m^2/s^2"  DASy
 SG_ RFC_Loc034_ElevationVnce : 274|10@1+ (0.001,0) [0|1.023] "deg^2"  DASy
 SG_ RFC_Loc034_AzimuthVnce : 284|10@1+ (0.001,0) [0|1.023] "deg^2"  DASy
 SG_ RFC_Loc034_RadarCrossSection : 294|10@1+ (0.2,-102.4) [-50|70] "dBsm"  DASy
 SG_ RFC_Loc034_DistVelocityQuality : 304|8@1+ (1,0) [0|255] "unitless"  DASy
 SG_ RFC_Loc034_ElevationQuality : 312|8@1+ (1,0) [0|255] "unitless"  DASy
 SG_ RFC_Loc034_AzimuthQuality : 320|8@1+ (1,0) [0|255] "unitless"  DASy
 SG_ RFC_Loc034_RSSI : 328|10@1+ (0.1,0) [0|100] "unitless"  DASy
 SG_ RFC_Loc034_AzimuthalPartnerId : 338|10@1+ (1,0) [0|1023] "unitless"  DASy
 SG_ RFC_Loc035_RadialDistance : 352|15@1+ (0.01,0) [0|327.67] "m"  DASy
 SG_ RFC_Loc035_RadialVelocity : 367|15@1+ (0.01,-163.84) [-110|55] "m/s"  DASy
 SG_ RFC_Loc035_Elevation : 382|10@1+ (0.1,-51.2) [-45|45] "deg"  DASy
 SG_ RFC_Loc035_Azimuth : 392|11@1+ (0.1,-102.4) [-90|90] "deg"  DASy
 SG_ RFC_Loc035_DistVelocityCoVnce : 403|11@1+ (0.0001,-0.1024) [-0.1024|0.1023] "m^2/s"  DASy
 SG_ RFC_Loc035_RadialDistanceVnce : 414|10@1+ (5E-005,0) [0|0.05115] "m^2"  DASy
 SG_ RFC_Loc035_RadialVelocityVnce : 424|10@1+ (0.0001,0) [0|0.1023] "m^2/s^2"  DASy
 SG_ RFC_Loc035_ElevationVnce : 434|10@1+ (0.001,0) [0|1.023] "deg^2"  DASy
 SG_ RFC_Loc035_AzimuthVnce : 444|10@1+ (0.001,0) [0|1.023] "deg^2"  DASy
 SG_ RFC_Loc035_RadarCrossSection : 454|10@1+ (0.2,-102.4) [-50|70] "dBsm"  DASy
 SG_ RFC_Loc035_DistVelocityQuality : 464|8@1+ (1,0) [0|255] "unitless"  DASy
 SG_ RFC_Loc035_ElevationQuality : 472|8@1+ (1,0) [0|255] "unitless"  DASy
 SG_ RFC_Loc035_AzimuthQuality : 480|8@1+ (1,0) [0|255] "unitless"  DASy
 SG_ RFC_Loc035_RSSI : 488|10@1+ (0.1,0) [0|100] "unitless"  DASy
 SG_ RFC_Loc035_AzimuthalPartnerId : 498|10@1+ (1,0) [0|1023] "unitless"  DASy

BO_ 276 RFC_Location_036_038: 64 RadarFrontCenter
 SG_ RFC_Loc036_038_CRC : 0|16@1+ (1,0) [0|65535] ""  DASy
 SG_ RFC_Loc036_038_AliveCtr : 16|8@1+ (1,0) [0|255] ""  DASy
 SG_ RFC_Loc036_038_ProtBlockCtr : 24|4@1+ (1,0) [0|15] ""  DASy
 SG_ RFC_Loc036_RadialDistance : 32|15@1+ (0.01,0) [0|327.67] "m"  DASy
 SG_ RFC_Loc036_RadialVelocity : 47|15@1+ (0.01,-163.84) [-110|55] "m/s"  DASy
 SG_ RFC_Loc036_Elevation : 62|10@1+ (0.1,-51.2) [-45|45] "deg"  DASy
 SG_ RFC_Loc036_Azimuth : 72|11@1+ (0.1,-102.4) [-90|90] "deg"  DASy
 SG_ RFC_Loc036_DistVelocityCoVnce : 83|11@1+ (0.0001,-0.1024) [-0.1024|0.1023] "m^2/s"  DASy
 SG_ RFC_Loc036_RadialDistanceVnce : 94|10@1+ (5E-005,0) [0|0.05115] "m^2"  DASy
 SG_ RFC_Loc036_RadialVelocityVnce : 104|10@1+ (0.0001,0) [0|0.1023] "m^2/s^2"  DASy
 SG_ RFC_Loc036_ElevationVnce : 114|10@1+ (0.001,0) [0|1.023] "deg^2"  DASy
 SG_ RFC_Loc036_AzimuthVnce : 124|10@1+ (0.001,0) [0|1.023] "deg^2"  DASy
 SG_ RFC_Loc036_RadarCrossSection : 134|10@1+ (0.2,-102.4) [-50|70] "dBsm"  DASy
 SG_ RFC_Loc036_DistVelocityQuality : 144|8@1+ (1,0) [0|255] "unitless"  DASy
 SG_ RFC_Loc036_ElevationQuality : 152|8@1+ (1,0) [0|255] "unitless"  DASy
 SG_ RFC_Loc036_AzimuthQuality : 160|8@1+ (1,0) [0|255] "unitless"  DASy
 SG_ RFC_Loc036_RSSI : 168|10@1+ (0.1,0) [0|100] "unitless"  DASy
 SG_ RFC_Loc036_AzimuthalPartnerId : 178|10@1+ (1,0) [0|1023] "unitless"  DASy
 SG_ RFC_Loc037_RadialDistance : 192|15@1+ (0.01,0) [0|327.67] "m"  DASy
 SG_ RFC_Loc037_RadialVelocity : 207|15@1+ (0.01,-163.84) [-110|55] "m/s"  DASy
 SG_ RFC_Loc037_Elevation : 222|10@1+ (0.1,-51.2) [-45|45] "deg"  DASy
 SG_ RFC_Loc037_Azimuth : 232|11@1+ (0.1,-102.4) [-90|90] "deg"  DASy
 SG_ RFC_Loc037_DistVelocityCoVnce : 243|11@1+ (0.0001,-0.1024) [-0.1024|0.1023] "m^2/s"  DASy
 SG_ RFC_Loc037_RadialDistanceVnce : 254|10@1+ (5E-005,0) [0|0.05115] "m^2"  DASy
 SG_ RFC_Loc037_RadialVelocityVnce : 264|10@1+ (0.0001,0) [0|0.1023] "m^2/s^2"  DASy
 SG_ RFC_Loc037_ElevationVnce : 274|10@1+ (0.001,0) [0|1.023] "deg^2"  DASy
 SG_ RFC_Loc037_AzimuthVnce : 284|10@1+ (0.001,0) [0|1.023] "deg^2"  DASy
 SG_ RFC_Loc037_RadarCrossSection : 294|10@1+ (0.2,-102.4) [-50|70] "dBsm"  DASy
 SG_ RFC_Loc037_DistVelocityQuality : 304|8@1+ (1,0) [0|255] "unitless"  DASy
 SG_ RFC_Loc037_ElevationQuality : 312|8@1+ (1,0) [0|255] "unitless"  DASy
 SG_ RFC_Loc037_AzimuthQuality : 320|8@1+ (1,0) [0|255] "unitless"  DASy
 SG_ RFC_Loc037_RSSI : 328|10@1+ (0.1,0) [0|100] "unitless"  DASy
 SG_ RFC_Loc037_AzimuthalPartnerId : 338|10@1+ (1,0) [0|1023] "unitless"  DASy
 SG_ RFC_Loc038_RadialDistance : 352|15@1+ (0.01,0) [0|327.67] "m"  DASy
 SG_ RFC_Loc038_RadialVelocity : 367|15@1+ (0.01,-163.84) [-110|55] "m/s"  DASy
 SG_ RFC_Loc038_Elevation : 382|10@1+ (0.1,-51.2) [-45|45] "deg"  DASy
 SG_ RFC_Loc038_Azimuth : 392|11@1+ (0.1,-102.4) [-90|90] "deg"  DASy
 SG_ RFC_Loc038_DistVelocityCoVnce : 403|11@1+ (0.0001,-0.1024) [-0.1024|0.1023] "m^2/s"  DASy
 SG_ RFC_Loc038_RadialDistanceVnce : 414|10@1+ (5E-005,0) [0|0.05115] "m^2"  DASy
 SG_ RFC_Loc038_RadialVelocityVnce : 424|10@1+ (0.0001,0) [0|0.1023] "m^2/s^2"  DASy
 SG_ RFC_Loc038_ElevationVnce : 434|10@1+ (0.001,0) [0|1.023] "deg^2"  DASy
 SG_ RFC_Loc038_AzimuthVnce : 444|10@1+ (0.001,0) [0|1.023] "deg^2"  DASy
 SG_ RFC_Loc038_RadarCrossSection : 454|10@1+ (0.2,-102.4) [-50|70] "dBsm"  DASy
 SG_ RFC_Loc038_DistVelocityQuality : 464|8@1+ (1,0) [0|255] "unitless"  DASy
 SG_ RFC_Loc038_ElevationQuality : 472|8@1+ (1,0) [0|255] "unitless"  DASy
 SG_ RFC_Loc038_AzimuthQuality : 480|8@1+ (1,0) [0|255] "unitless"  DASy
 SG_ RFC_Loc038_RSSI : 488|10@1+ (0.1,0) [0|100] "unitless"  DASy
 SG_ RFC_Loc038_AzimuthalPartnerId : 498|10@1+ (1,0) [0|1023] "unitless"  DASy

BO_ 277 RFC_Location_039_041: 64 RadarFrontCenter
 SG_ RFC_Loc039_041_CRC : 0|16@1+ (1,0) [0|65535] ""  DASy
 SG_ RFC_Loc039_041_AliveCtr : 16|8@1+ (1,0) [0|255] ""  DASy
 SG_ RFC_Loc039_041_ProtBlockCtr : 24|4@1+ (1,0) [0|15] ""  DASy
 SG_ RFC_Loc039_RadialDistance : 32|15@1+ (0.01,0) [0|327.67] "m"  DASy
 SG_ RFC_Loc039_RadialVelocity : 47|15@1+ (0.01,-163.84) [-110|55] "m/s"  DASy
 SG_ RFC_Loc039_Elevation : 62|10@1+ (0.1,-51.2) [-45|45] "deg"  DASy
 SG_ RFC_Loc039_Azimuth : 72|11@1+ (0.1,-102.4) [-90|90] "deg"  DASy
 SG_ RFC_Loc039_DistVelocityCoVnce : 83|11@1+ (0.0001,-0.1024) [-0.1024|0.1023] "m^2/s"  DASy
 SG_ RFC_Loc039_RadialDistanceVnce : 94|10@1+ (5E-005,0) [0|0.05115] "m^2"  DASy
 SG_ RFC_Loc039_RadialVelocityVnce : 104|10@1+ (0.0001,0) [0|0.1023] "m^2/s^2"  DASy
 SG_ RFC_Loc039_ElevationVnce : 114|10@1+ (0.001,0) [0|1.023] "deg^2"  DASy
 SG_ RFC_Loc039_AzimuthVnce : 124|10@1+ (0.001,0) [0|1.023] "deg^2"  DASy
 SG_ RFC_Loc039_RadarCrossSection : 134|10@1+ (0.2,-102.4) [-50|70] "dBsm"  DASy
 SG_ RFC_Loc039_DistVelocityQuality : 144|8@1+ (1,0) [0|255] "unitless"  DASy
 SG_ RFC_Loc039_ElevationQuality : 152|8@1+ (1,0) [0|255] "unitless"  DASy
 SG_ RFC_Loc039_AzimuthQuality : 160|8@1+ (1,0) [0|255] "unitless"  DASy
 SG_ RFC_Loc039_RSSI : 168|10@1+ (0.1,0) [0|100] "unitless"  DASy
 SG_ RFC_Loc039_AzimuthalPartnerId : 178|10@1+ (1,0) [0|1023] "unitless"  DASy
 SG_ RFC_Loc040_RadialDistance : 192|15@1+ (0.01,0) [0|327.67] "m"  DASy
 SG_ RFC_Loc040_RadialVelocity : 207|15@1+ (0.01,-163.84) [-110|55] "m/s"  DASy
 SG_ RFC_Loc040_Elevation : 222|10@1+ (0.1,-51.2) [-45|45] "deg"  DASy
 SG_ RFC_Loc040_Azimuth : 232|11@1+ (0.1,-102.4) [-90|90] "deg"  DASy
 SG_ RFC_Loc040_DistVelocityCoVnce : 243|11@1+ (0.0001,-0.1024) [-0.1024|0.1023] "m^2/s"  DASy
 SG_ RFC_Loc040_RadialDistanceVnce : 254|10@1+ (5E-005,0) [0|0.05115] "m^2"  DASy
 SG_ RFC_Loc040_RadialVelocityVnce : 264|10@1+ (0.0001,0) [0|0.1023] "m^2/s^2"  DASy
 SG_ RFC_Loc040_ElevationVnce : 274|10@1+ (0.001,0) [0|1.023] "deg^2"  DASy
 SG_ RFC_Loc040_AzimuthVnce : 284|10@1+ (0.001,0) [0|1.023] "deg^2"  DASy
 SG_ RFC_Loc040_RadarCrossSection : 294|10@1+ (0.2,-102.4) [-50|70] "dBsm"  DASy
 SG_ RFC_Loc040_DistVelocityQuality : 304|8@1+ (1,0) [0|255] "unitless"  DASy
 SG_ RFC_Loc040_ElevationQuality : 312|8@1+ (1,0) [0|255] "unitless"  DASy
 SG_ RFC_Loc040_AzimuthQuality : 320|8@1+ (1,0) [0|255] "unitless"  DASy
 SG_ RFC_Loc040_RSSI : 328|10@1+ (0.1,0) [0|100] "unitless"  DASy
 SG_ RFC_Loc040_AzimuthalPartnerId : 338|10@1+ (1,0) [0|1023] "unitless"  DASy
 SG_ RFC_Loc041_RadialDistance : 352|15@1+ (0.01,0) [0|327.67] "m"  DASy
 SG_ RFC_Loc041_RadialVelocity : 367|15@1+ (0.01,-163.84) [-110|55] "m/s"  DASy
 SG_ RFC_Loc041_Elevation : 382|10@1+ (0.1,-51.2) [-45|45] "deg"  DASy
 SG_ RFC_Loc041_Azimuth : 392|11@1+ (0.1,-102.4) [-90|90] "deg"  DASy
 SG_ RFC_Loc041_DistVelocityCoVnce : 403|11@1+ (0.0001,-0.1024) [-0.1024|0.1023] "m^2/s"  DASy
 SG_ RFC_Loc041_RadialDistanceVnce : 414|10@1+ (5E-005,0) [0|0.05115] "m^2"  DASy
 SG_ RFC_Loc041_RadialVelocityVnce : 424|10@1+ (0.0001,0) [0|0.1023] "m^2/s^2"  DASy
 SG_ RFC_Loc041_ElevationVnce : 434|10@1+ (0.001,0) [0|1.023] "deg^2"  DASy
 SG_ RFC_Loc041_AzimuthVnce : 444|10@1+ (0.001,0) [0|1.023] "deg^2"  DASy
 SG_ RFC_Loc041_RadarCrossSection : 454|10@1+ (0.2,-102.4) [-50|70] "dBsm"  DASy
 SG_ RFC_Loc041_DistVelocityQuality : 464|8@1+ (1,0) [0|255] "unitless"  DASy
 SG_ RFC_Loc041_ElevationQuality : 472|8@1+ (1,0) [0|255] "unitless"  DASy
 SG_ RFC_Loc041_AzimuthQuality : 480|8@1+ (1,0) [0|255] "unitless"  DASy
 SG_ RFC_Loc041_RSSI : 488|10@1+ (0.1,0) [0|100] "unitless"  DASy
 SG_ RFC_Loc041_AzimuthalPartnerId : 498|10@1+ (1,0) [0|1023] "unitless"  DASy

BO_ 278 RFC_Location_042_044: 64 RadarFrontCenter
 SG_ RFC_Loc042_044_CRC : 0|16@1+ (1,0) [0|65535] ""  DASy
 SG_ RFC_Loc042_044_AliveCtr : 16|8@1+ (1,0) [0|255] ""  DASy
 SG_ RFC_Loc042_044_ProtBlockCtr : 24|4@1+ (1,0) [0|15] ""  DASy
 SG_ RFC_Loc042_RadialDistance : 32|15@1+ (0.01,0) [0|327.67] "m"  DASy
 SG_ RFC_Loc042_RadialVelocity : 47|15@1+ (0.01,-163.84) [-110|55] "m/s"  DASy
 SG_ RFC_Loc042_Elevation : 62|10@1+ (0.1,-51.2) [-45|45] "deg"  DASy
 SG_ RFC_Loc042_Azimuth : 72|11@1+ (0.1,-102.4) [-90|90] "deg"  DASy
 SG_ RFC_Loc042_DistVelocityCoVnce : 83|11@1+ (0.0001,-0.1024) [-0.1024|0.1023] "m^2/s"  DASy
 SG_ RFC_Loc042_RadialDistanceVnce : 94|10@1+ (5E-005,0) [0|0.05115] "m^2"  DASy
 SG_ RFC_Loc042_RadialVelocityVnce : 104|10@1+ (0.0001,0) [0|0.1023] "m^2/s^2"  DASy
 SG_ RFC_Loc042_ElevationVnce : 114|10@1+ (0.001,0) [0|1.023] "deg^2"  DASy
 SG_ RFC_Loc042_AzimuthVnce : 124|10@1+ (0.001,0) [0|1.023] "deg^2"  DASy
 SG_ RFC_Loc042_RadarCrossSection : 134|10@1+ (0.2,-102.4) [-50|70] "dBsm"  DASy
 SG_ RFC_Loc042_DistVelocityQuality : 144|8@1+ (1,0) [0|255] "unitless"  DASy
 SG_ RFC_Loc042_ElevationQuality : 152|8@1+ (1,0) [0|255] "unitless"  DASy
 SG_ RFC_Loc042_AzimuthQuality : 160|8@1+ (1,0) [0|255] "unitless"  DASy
 SG_ RFC_Loc042_RSSI : 168|10@1+ (0.1,0) [0|100] "unitless"  DASy
 SG_ RFC_Loc042_AzimuthalPartnerId : 178|10@1+ (1,0) [0|1023] "unitless"  DASy
 SG_ RFC_Loc043_RadialDistance : 192|15@1+ (0.01,0) [0|327.67] "m"  DASy
 SG_ RFC_Loc043_RadialVelocity : 207|15@1+ (0.01,-163.84) [-110|55] "m/s"  DASy
 SG_ RFC_Loc043_Elevation : 222|10@1+ (0.1,-51.2) [-45|45] "deg"  DASy
 SG_ RFC_Loc043_Azimuth : 232|11@1+ (0.1,-102.4) [-90|90] "deg"  DASy
 SG_ RFC_Loc043_DistVelocityCoVnce : 243|11@1+ (0.0001,-0.1024) [-0.1024|0.1023] "m^2/s"  DASy
 SG_ RFC_Loc043_RadialDistanceVnce : 254|10@1+ (5E-005,0) [0|0.05115] "m^2"  DASy
 SG_ RFC_Loc043_RadialVelocityVnce : 264|10@1+ (0.0001,0) [0|0.1023] "m^2/s^2"  DASy
 SG_ RFC_Loc043_ElevationVnce : 274|10@1+ (0.001,0) [0|1.023] "deg^2"  DASy
 SG_ RFC_Loc043_AzimuthVnce : 284|10@1+ (0.001,0) [0|1.023] "deg^2"  DASy
 SG_ RFC_Loc043_RadarCrossSection : 294|10@1+ (0.2,-102.4) [-50|70] "dBsm"  DASy
 SG_ RFC_Loc043_DistVelocityQuality : 304|8@1+ (1,0) [0|255] "unitless"  DASy
 SG_ RFC_Loc043_ElevationQuality : 312|8@1+ (1,0) [0|255] "unitless"  DASy
 SG_ RFC_Loc043_AzimuthQuality : 320|8@1+ (1,0) [0|255] "unitless"  DASy
 SG_ RFC_Loc043_RSSI : 328|10@1+ (0.1,0) [0|100] "unitless"  DASy
 SG_ RFC_Loc043_AzimuthalPartnerId : 338|10@1+ (1,0) [0|1023] "unitless"  DASy
 SG_ RFC_Loc044_RadialDistance : 352|15@1+ (0.01,0) [0|327.67] "m"  DASy
 SG_ RFC_Loc044_RadialVelocity : 367|15@1+ (0.01,-163.84) [-110|55] "m/s"  DASy
 SG_ RFC_Loc044_Elevation : 382|10@1+ (0.1,-51.2) [-45|45] "deg"  DASy
 SG_ RFC_Loc044_Azimuth : 392|11@1+ (0.1,-102.4) [-90|90] "deg"  DASy
 SG_ RFC_Loc044_DistVelocityCoVnce : 403|11@1+ (0.0001,-0.1024) [-0.1024|0.1023] "m^2/s"  DASy
 SG_ RFC_Loc044_RadialDistanceVnce : 414|10@1+ (5E-005,0) [0|0.05115] "m^2"  DASy
 SG_ RFC_Loc044_RadialVelocityVnce : 424|10@1+ (0.0001,0) [0|0.1023] "m^2/s^2"  DASy
 SG_ RFC_Loc044_ElevationVnce : 434|10@1+ (0.001,0) [0|1.023] "deg^2"  DASy
 SG_ RFC_Loc044_AzimuthVnce : 444|10@1+ (0.001,0) [0|1.023] "deg^2"  DASy
 SG_ RFC_Loc044_RadarCrossSection : 454|10@1+ (0.2,-102.4) [-50|70] "dBsm"  DASy
 SG_ RFC_Loc044_DistVelocityQuality : 464|8@1+ (1,0) [0|255] "unitless"  DASy
 SG_ RFC_Loc044_ElevationQuality : 472|8@1+ (1,0) [0|255] "unitless"  DASy
 SG_ RFC_Loc044_AzimuthQuality : 480|8@1+ (1,0) [0|255] "unitless"  DASy
 SG_ RFC_Loc044_RSSI : 488|10@1+ (0.1,0) [0|100] "unitless"  DASy
 SG_ RFC_Loc044_AzimuthalPartnerId : 498|10@1+ (1,0) [0|1023] "unitless"  DASy

BO_ 279 RFC_Location_045_047: 64 RadarFrontCenter
 SG_ RFC_Loc045_047_CRC : 0|16@1+ (1,0) [0|65535] ""  DASy
 SG_ RFC_Loc045_047_AliveCtr : 16|8@1+ (1,0) [0|255] ""  DASy
 SG_ RFC_Loc045_047_ProtBlockCtr : 24|4@1+ (1,0) [0|15] ""  DASy
 SG_ RFC_Loc045_RadialDistance : 32|15@1+ (0.01,0) [0|327.67] "m"  DASy
 SG_ RFC_Loc045_RadialVelocity : 47|15@1+ (0.01,-163.84) [-110|55] "m/s"  DASy
 SG_ RFC_Loc045_Elevation : 62|10@1+ (0.1,-51.2) [-45|45] "deg"  DASy
 SG_ RFC_Loc045_Azimuth : 72|11@1+ (0.1,-102.4) [-90|90] "deg"  DASy
 SG_ RFC_Loc045_DistVelocityCoVnce : 83|11@1+ (0.0001,-0.1024) [-0.1024|0.1023] "m^2/s"  DASy
 SG_ RFC_Loc045_RadialDistanceVnce : 94|10@1+ (5E-005,0) [0|0.05115] "m^2"  DASy
 SG_ RFC_Loc045_RadialVelocityVnce : 104|10@1+ (0.0001,0) [0|0.1023] "m^2/s^2"  DASy
 SG_ RFC_Loc045_ElevationVnce : 114|10@1+ (0.001,0) [0|1.023] "deg^2"  DASy
 SG_ RFC_Loc045_AzimuthVnce : 124|10@1+ (0.001,0) [0|1.023] "deg^2"  DASy
 SG_ RFC_Loc045_RadarCrossSection : 134|10@1+ (0.2,-102.4) [-50|70] "dBsm"  DASy
 SG_ RFC_Loc045_DistVelocityQuality : 144|8@1+ (1,0) [0|255] "unitless"  DASy
 SG_ RFC_Loc045_ElevationQuality : 152|8@1+ (1,0) [0|255] "unitless"  DASy
 SG_ RFC_Loc045_AzimuthQuality : 160|8@1+ (1,0) [0|255] "unitless"  DASy
 SG_ RFC_Loc045_RSSI : 168|10@1+ (0.1,0) [0|100] "unitless"  DASy
 SG_ RFC_Loc045_AzimuthalPartnerId : 178|10@1+ (1,0) [0|1023] "unitless"  DASy
 SG_ RFC_Loc046_RadialDistance : 192|15@1+ (0.01,0) [0|327.67] "m"  DASy
 SG_ RFC_Loc046_RadialVelocity : 207|15@1+ (0.01,-163.84) [-110|55] "m/s"  DASy
 SG_ RFC_Loc046_Elevation : 222|10@1+ (0.1,-51.2) [-45|45] "deg"  DASy
 SG_ RFC_Loc046_Azimuth : 232|11@1+ (0.1,-102.4) [-90|90] "deg"  DASy
 SG_ RFC_Loc046_DistVelocityCoVnce : 243|11@1+ (0.0001,-0.1024) [-0.1024|0.1023] "m^2/s"  DASy
 SG_ RFC_Loc046_RadialDistanceVnce : 254|10@1+ (5E-005,0) [0|0.05115] "m^2"  DASy
 SG_ RFC_Loc046_RadialVelocityVnce : 264|10@1+ (0.0001,0) [0|0.1023] "m^2/s^2"  DASy
 SG_ RFC_Loc046_ElevationVnce : 274|10@1+ (0.001,0) [0|1.023] "deg^2"  DASy
 SG_ RFC_Loc046_AzimuthVnce : 284|10@1+ (0.001,0) [0|1.023] "deg^2"  DASy
 SG_ RFC_Loc046_RadarCrossSection : 294|10@1+ (0.2,-102.4) [-50|70] "dBsm"  DASy
 SG_ RFC_Loc046_DistVelocityQuality : 304|8@1+ (1,0) [0|255] "unitless"  DASy
 SG_ RFC_Loc046_ElevationQuality : 312|8@1+ (1,0) [0|255] "unitless"  DASy
 SG_ RFC_Loc046_AzimuthQuality : 320|8@1+ (1,0) [0|255] "unitless"  DASy
 SG_ RFC_Loc046_RSSI : 328|10@1+ (0.1,0) [0|100] "unitless"  DASy
 SG_ RFC_Loc046_AzimuthalPartnerId : 338|10@1+ (1,0) [0|1023] "unitless"  DASy
 SG_ RFC_Loc047_RadialDistance : 352|15@1+ (0.01,0) [0|327.67] "m"  DASy
 SG_ RFC_Loc047_RadialVelocity : 367|15@1+ (0.01,-163.84) [-110|55] "m/s"  DASy
 SG_ RFC_Loc047_Elevation : 382|10@1+ (0.1,-51.2) [-45|45] "deg"  DASy
 SG_ RFC_Loc047_Azimuth : 392|11@1+ (0.1,-102.4) [-90|90] "deg"  DASy
 SG_ RFC_Loc047_DistVelocityCoVnce : 403|11@1+ (0.0001,-0.1024) [-0.1024|0.1023] "m^2/s"  DASy
 SG_ RFC_Loc047_RadialDistanceVnce : 414|10@1+ (5E-005,0) [0|0.05115] "m^2"  DASy
 SG_ RFC_Loc047_RadialVelocityVnce : 424|10@1+ (0.0001,0) [0|0.1023] "m^2/s^2"  DASy
 SG_ RFC_Loc047_ElevationVnce : 434|10@1+ (0.001,0) [0|1.023] "deg^2"  DASy
 SG_ RFC_Loc047_AzimuthVnce : 444|10@1+ (0.001,0) [0|1.023] "deg^2"  DASy
 SG_ RFC_Loc047_RadarCrossSection : 454|10@1+ (0.2,-102.4) [-50|70] "dBsm"  DASy
 SG_ RFC_Loc047_DistVelocityQuality : 464|8@1+ (1,0) [0|255] "unitless"  DASy
 SG_ RFC_Loc047_ElevationQuality : 472|8@1+ (1,0) [0|255] "unitless"  DASy
 SG_ RFC_Loc047_AzimuthQuality : 480|8@1+ (1,0) [0|255] "unitless"  DASy
 SG_ RFC_Loc047_RSSI : 488|10@1+ (0.1,0) [0|100] "unitless"  DASy
 SG_ RFC_Loc047_AzimuthalPartnerId : 498|10@1+ (1,0) [0|1023] "unitless"  DASy

BO_ 280 RFC_Location_048_050: 64 RadarFrontCenter
 SG_ RFC_Loc048_050_CRC : 0|16@1+ (1,0) [0|65535] ""  DASy
 SG_ RFC_Loc048_050_AliveCtr : 16|8@1+ (1,0) [0|255] ""  DASy
 SG_ RFC_Loc048_050_ProtBlockCtr : 24|4@1+ (1,0) [0|15] ""  DASy
 SG_ RFC_Loc048_RadialDistance : 32|15@1+ (0.01,0) [0|327.67] "m"  DASy
 SG_ RFC_Loc048_RadialVelocity : 47|15@1+ (0.01,-163.84) [-110|55] "m/s"  DASy
 SG_ RFC_Loc048_Elevation : 62|10@1+ (0.1,-51.2) [-45|45] "deg"  DASy
 SG_ RFC_Loc048_Azimuth : 72|11@1+ (0.1,-102.4) [-90|90] "deg"  DASy
 SG_ RFC_Loc048_DistVelocityCoVnce : 83|11@1+ (0.0001,-0.1024) [-0.1024|0.1023] "m^2/s"  DASy
 SG_ RFC_Loc048_RadialDistanceVnce : 94|10@1+ (5E-005,0) [0|0.05115] "m^2"  DASy
 SG_ RFC_Loc048_RadialVelocityVnce : 104|10@1+ (0.0001,0) [0|0.1023] "m^2/s^2"  DASy
 SG_ RFC_Loc048_ElevationVnce : 114|10@1+ (0.001,0) [0|1.023] "deg^2"  DASy
 SG_ RFC_Loc048_AzimuthVnce : 124|10@1+ (0.001,0) [0|1.023] "deg^2"  DASy
 SG_ RFC_Loc048_RadarCrossSection : 134|10@1+ (0.2,-102.4) [-50|70] "dBsm"  DASy
 SG_ RFC_Loc048_DistVelocityQuality : 144|8@1+ (1,0) [0|255] "unitless"  DASy
 SG_ RFC_Loc048_ElevationQuality : 152|8@1+ (1,0) [0|255] "unitless"  DASy
 SG_ RFC_Loc048_AzimuthQuality : 160|8@1+ (1,0) [0|255] "unitless"  DASy
 SG_ RFC_Loc048_RSSI : 168|10@1+ (0.1,0) [0|100] "unitless"  DASy
 SG_ RFC_Loc048_AzimuthalPartnerId : 178|10@1+ (1,0) [0|1023] "unitless"  DASy
 SG_ RFC_Loc049_RadialDistance : 192|15@1+ (0.01,0) [0|327.67] "m"  DASy
 SG_ RFC_Loc049_RadialVelocity : 207|15@1+ (0.01,-163.84) [-110|55] "m/s"  DASy
 SG_ RFC_Loc049_Elevation : 222|10@1+ (0.1,-51.2) [-45|45] "deg"  DASy
 SG_ RFC_Loc049_Azimuth : 232|11@1+ (0.1,-102.4) [-90|90] "deg"  DASy
 SG_ RFC_Loc049_DistVelocityCoVnce : 243|11@1+ (0.0001,-0.1024) [-0.1024|0.1023] "m^2/s"  DASy
 SG_ RFC_Loc049_RadialDistanceVnce : 254|10@1+ (5E-005,0) [0|0.05115] "m^2"  DASy
 SG_ RFC_Loc049_RadialVelocityVnce : 264|10@1+ (0.0001,0) [0|0.1023] "m^2/s^2"  DASy
 SG_ RFC_Loc049_ElevationVnce : 274|10@1+ (0.001,0) [0|1.023] "deg^2"  DASy
 SG_ RFC_Loc049_AzimuthVnce : 284|10@1+ (0.001,0) [0|1.023] "deg^2"  DASy
 SG_ RFC_Loc049_RadarCrossSection : 294|10@1+ (0.2,-102.4) [-50|70] "dBsm"  DASy
 SG_ RFC_Loc049_DistVelocityQuality : 304|8@1+ (1,0) [0|255] "unitless"  DASy
 SG_ RFC_Loc049_ElevationQuality : 312|8@1+ (1,0) [0|255] "unitless"  DASy
 SG_ RFC_Loc049_AzimuthQuality : 320|8@1+ (1,0) [0|255] "unitless"  DASy
 SG_ RFC_Loc049_RSSI : 328|10@1+ (0.1,0) [0|100] "unitless"  DASy
 SG_ RFC_Loc049_AzimuthalPartnerId : 338|10@1+ (1,0) [0|1023] "unitless"  DASy
 SG_ RFC_Loc050_RadialDistance : 352|15@1+ (0.01,0) [0|327.67] "m"  DASy
 SG_ RFC_Loc050_RadialVelocity : 367|15@1+ (0.01,-163.84) [-110|55] "m/s"  DASy
 SG_ RFC_Loc050_Elevation : 382|10@1+ (0.1,-51.2) [-45|45] "deg"  DASy
 SG_ RFC_Loc050_Azimuth : 392|11@1+ (0.1,-102.4) [-90|90] "deg"  DASy
 SG_ RFC_Loc050_DistVelocityCoVnce : 403|11@1+ (0.0001,-0.1024) [-0.1024|0.1023] "m^2/s"  DASy
 SG_ RFC_Loc050_RadialDistanceVnce : 414|10@1+ (5E-005,0) [0|0.05115] "m^2"  DASy
 SG_ RFC_Loc050_RadialVelocityVnce : 424|10@1+ (0.0001,0) [0|0.1023] "m^2/s^2"  DASy
 SG_ RFC_Loc050_ElevationVnce : 434|10@1+ (0.001,0) [0|1.023] "deg^2"  DASy
 SG_ RFC_Loc050_AzimuthVnce : 444|10@1+ (0.001,0) [0|1.023] "deg^2"  DASy
 SG_ RFC_Loc050_RadarCrossSection : 454|10@1+ (0.2,-102.4) [-50|70] "dBsm"  DASy
 SG_ RFC_Loc050_DistVelocityQuality : 464|8@1+ (1,0) [0|255] "unitless"  DASy
 SG_ RFC_Loc050_ElevationQuality : 472|8@1+ (1,0) [0|255] "unitless"  DASy
 SG_ RFC_Loc050_AzimuthQuality : 480|8@1+ (1,0) [0|255] "unitless"  DASy
 SG_ RFC_Loc050_RSSI : 488|10@1+ (0.1,0) [0|100] "unitless"  DASy
 SG_ RFC_Loc050_AzimuthalPartnerId : 498|10@1+ (1,0) [0|1023] "unitless"  DASy

CM_ SG_ 266 RFC_Loc006_008_CRC "CRC - Autosar E2E Profile 5";
CM_ SG_ 266 RFC_Loc006_008_AliveCtr "Alive counter - Autosar E2E Profile 5";
CM_ SG_ 266 RFC_Loc006_008_ProtBlockCtr "Protocol-Signal: Block-Counter";
CM_ SG_ 266 RFC_Loc006_RadialDistance "Location radial distance. Represented in conical coordinate system. Same as ISO 23150:2021(E): Position radial distance (A.4.16)";
CM_ SG_ 266 RFC_Loc006_RadialVelocity "Location radial relative velocity ISO 23150:2021(E): Relative velocity {radial distance} (A.4.18)";
CM_ SG_ 266 RFC_Loc006_Elevation "Location elevation angle. Represented in conical coordinate system. Same as ISO 23150:2021(E): Position elevation (A.4.16)";
CM_ SG_ 266 RFC_Loc006_Azimuth "Location azimuth angle. Represented in conical coordinate system. Deviation from ISO 23150:2021(E): Position azimuth (A.4.16). Further details refers to DSP Location Interface definition";
CM_ SG_ 266 RFC_Loc006_DistVelocityCoVnce "Covariance of radial distance and radial velocity";
CM_ SG_ 266 RFC_Loc006_RadialDistanceVnce "Variance of Location radial distance ISO 23150:2021(E): Position radial distance - error (A.4.17)";
CM_ SG_ 266 RFC_Loc006_RadialVelocityVnce "Variance of Location radial relative velocity ISO 23150:2021(E): Relative velocity {radial distance} - error (A.4.19)";
CM_ SG_ 266 RFC_Loc006_ElevationVnce "Variance of Location elevation angle ISO 23150:2021(E): Position elevation - error (A.4.17)";
CM_ SG_ 266 RFC_Loc006_AzimuthVnce "Variance of Location azimuth angle ISO 23150:2021(E): Position azimuth - error (A.4.17)";
CM_ SG_ 266 RFC_Loc006_RadarCrossSection "Radar Cross Section (RCS) estimation ISO 23150:2021(E): Radar cross section (A.4.5)";
CM_ SG_ 266 RFC_Loc006_DistVelocityQuality "Quality of radial distance and velocity resolution processing. Physical range [0..1]";
CM_ SG_ 266 RFC_Loc006_ElevationQuality "Probability for correct signal model (elevation angle). Physical range [0..1]";
CM_ SG_ 266 RFC_Loc006_AzimuthQuality "Probability for correct signal model (azimuth angle). Physical range [0..1]";
CM_ SG_ 266 RFC_Loc006_RSSI "Received Signal Strength Indication (RSSI). This signal is not exactly ISO 23150:2021(E): Signal to noise ratio - detection level (A.4.7), but SNR can be calculated from this signal. Further detail please refer to the DSP Location Interface definition";
CM_ SG_ 266 RFC_Loc006_AzimuthalPartnerId "Id of the azimuthal partner location";
CM_ SG_ 266 RFC_Loc007_RadialDistance "Location radial distance. Represented in conical coordinate system. Same as ISO 23150:2021(E): Position radial distance (A.4.16)";
CM_ SG_ 266 RFC_Loc007_RadialVelocity "Location radial relative velocity ISO 23150:2021(E): Relative velocity {radial distance} (A.4.18)";
CM_ SG_ 266 RFC_Loc007_Elevation "Location elevation angle. Represented in conical coordinate system. Same as ISO 23150:2021(E): Position elevation (A.4.16)";
CM_ SG_ 266 RFC_Loc007_Azimuth "Location azimuth angle. Represented in conical coordinate system. Deviation from ISO 23150:2021(E): Position azimuth (A.4.16). Further details refers to DSP Location Interface definition";
CM_ SG_ 266 RFC_Loc007_DistVelocityCoVnce "Covariance of radial distance and radial velocity";
CM_ SG_ 266 RFC_Loc007_RadialDistanceVnce "Variance of Location radial distance ISO 23150:2021(E): Position radial distance - error (A.4.17)";
CM_ SG_ 266 RFC_Loc007_RadialVelocityVnce "Variance of Location radial relative velocity ISO 23150:2021(E): Relative velocity {radial distance} - error (A.4.19)";
CM_ SG_ 266 RFC_Loc007_ElevationVnce "Variance of Location elevation angle ISO 23150:2021(E): Position elevation - error (A.4.17)";
CM_ SG_ 266 RFC_Loc007_AzimuthVnce "Variance of Location azimuth angle ISO 23150:2021(E): Position azimuth - error (A.4.17)";
CM_ SG_ 266 RFC_Loc007_RadarCrossSection "Radar Cross Section (RCS) estimation ISO 23150:2021(E): Radar cross section (A.4.5)";
CM_ SG_ 266 RFC_Loc007_DistVelocityQuality "Quality of radial distance and velocity resolution processing. Physical range [0..1]";
CM_ SG_ 266 RFC_Loc007_ElevationQuality "Probability for correct signal model (elevation angle). Physical range [0..1]";
CM_ SG_ 266 RFC_Loc007_AzimuthQuality "Probability for correct signal model (azimuth angle). Physical range [0..1]";
CM_ SG_ 266 RFC_Loc007_RSSI "Received Signal Strength Indication (RSSI). This signal is not exactly ISO 23150:2021(E): Signal to noise ratio - detection level (A.4.7), but SNR can be calculated from this signal. Further detail please refer to the DSP Location Interface definition";
CM_ SG_ 266 RFC_Loc007_AzimuthalPartnerId "Id of the azimuthal partner location";
CM_ SG_ 266 RFC_Loc008_RadialDistance "Location radial distance. Represented in conical coordinate system. Same as ISO 23150:2021(E): Position radial distance (A.4.16)";
CM_ SG_ 266 RFC_Loc008_RadialVelocity "Location radial relative velocity ISO 23150:2021(E): Relative velocity {radial distance} (A.4.18)";
CM_ SG_ 266 RFC_Loc008_Elevation "Location elevation angle. Represented in conical coordinate system. Same as ISO 23150:2021(E): Position elevation (A.4.16)";
CM_ SG_ 266 RFC_Loc008_Azimuth "Location azimuth angle. Represented in conical coordinate system. Deviation from ISO 23150:2021(E): Position azimuth (A.4.16). Further details refers to DSP Location Interface definition";
CM_ SG_ 266 RFC_Loc008_DistVelocityCoVnce "Covariance of radial distance and radial velocity";
CM_ SG_ 266 RFC_Loc008_RadialDistanceVnce "Variance of Location radial distance ISO 23150:2021(E): Position radial distance - error (A.4.17)";
CM_ SG_ 266 RFC_Loc008_RadialVelocityVnce "Variance of Location radial relative velocity ISO 23150:2021(E): Relative velocity {radial distance} - error (A.4.19)";
CM_ SG_ 266 RFC_Loc008_ElevationVnce "Variance of Location elevation angle ISO 23150:2021(E): Position elevation - error (A.4.17)";
CM_ SG_ 266 RFC_Loc008_AzimuthVnce "Variance of Location azimuth angle ISO 23150:2021(E): Position azimuth - error (A.4.17)";
CM_ SG_ 266 RFC_Loc008_RadarCrossSection "Radar Cross Section (RCS) estimation ISO 23150:2021(E): Radar cross section (A.4.5)";
CM_ SG_ 266 RFC_Loc008_DistVelocityQuality "Quality of radial distance and velocity resolution processing. Physical range [0..1]";
CM_ SG_ 266 RFC_Loc008_ElevationQuality "Probability for correct signal model (elevation angle). Physical range [0..1]";
CM_ SG_ 266 RFC_Loc008_AzimuthQuality "Probability for correct signal model (azimuth angle). Physical range [0..1]";
CM_ SG_ 266 RFC_Loc008_RSSI "Received Signal Strength Indication (RSSI). This signal is not exactly ISO 23150:2021(E): Signal to noise ratio - detection level (A.4.7), but SNR can be calculated from this signal. Further detail please refer to the DSP Location Interface definition";
CM_ SG_ 266 RFC_Loc008_AzimuthalPartnerId "Id of the azimuthal partner location";
CM_ SG_ 267 RFC_Loc009_011_CRC "CRC - Autosar E2E Profile 5";
CM_ SG_ 267 RFC_Loc009_011_AliveCtr "Alive counter - Autosar E2E Profile 5";
CM_ SG_ 267 RFC_Loc009_011_ProtBlockCtr "Protocol-Signal: Block-Counter";
CM_ SG_ 267 RFC_Loc009_RadialDistance "Location radial distance. Represented in conical coordinate system. Same as ISO 23150:2021(E): Position radial distance (A.4.16)";
CM_ SG_ 267 RFC_Loc009_RadialVelocity "Location radial relative velocity ISO 23150:2021(E): Relative velocity {radial distance} (A.4.18)";
CM_ SG_ 267 RFC_Loc009_Elevation "Location elevation angle. Represented in conical coordinate system. Same as ISO 23150:2021(E): Position elevation (A.4.16)";
CM_ SG_ 267 RFC_Loc009_Azimuth "Location azimuth angle. Represented in conical coordinate system. Deviation from ISO 23150:2021(E): Position azimuth (A.4.16). Further details refers to DSP Location Interface definition";
CM_ SG_ 267 RFC_Loc009_DistVelocityCoVnce "Covariance of radial distance and radial velocity";
CM_ SG_ 267 RFC_Loc009_RadialDistanceVnce "Variance of Location radial distance ISO 23150:2021(E): Position radial distance - error (A.4.17)";
CM_ SG_ 267 RFC_Loc009_RadialVelocityVnce "Variance of Location radial relative velocity ISO 23150:2021(E): Relative velocity {radial distance} - error (A.4.19)";
CM_ SG_ 267 RFC_Loc009_ElevationVnce "Variance of Location elevation angle ISO 23150:2021(E): Position elevation - error (A.4.17)";
CM_ SG_ 267 RFC_Loc009_AzimuthVnce "Variance of Location azimuth angle ISO 23150:2021(E): Position azimuth - error (A.4.17)";
CM_ SG_ 267 RFC_Loc009_RadarCrossSection "Radar Cross Section (RCS) estimation ISO 23150:2021(E): Radar cross section (A.4.5)";
CM_ SG_ 267 RFC_Loc009_DistVelocityQuality "Quality of radial distance and velocity resolution processing. Physical range [0..1]";
CM_ SG_ 267 RFC_Loc009_ElevationQuality "Probability for correct signal model (elevation angle). Physical range [0..1]";
CM_ SG_ 267 RFC_Loc009_AzimuthQuality "Probability for correct signal model (azimuth angle). Physical range [0..1]";
CM_ SG_ 267 RFC_Loc009_RSSI "Received Signal Strength Indication (RSSI). This signal is not exactly ISO 23150:2021(E): Signal to noise ratio - detection level (A.4.7), but SNR can be calculated from this signal. Further detail please refer to the DSP Location Interface definition";
CM_ SG_ 267 RFC_Loc009_AzimuthalPartnerId "Id of the azimuthal partner location";
CM_ SG_ 267 RFC_Loc010_RadialDistance "Location radial distance. Represented in conical coordinate system. Same as ISO 23150:2021(E): Position radial distance (A.4.16)";
CM_ SG_ 267 RFC_Loc010_RadialVelocity "Location radial relative velocity ISO 23150:2021(E): Relative velocity {radial distance} (A.4.18)";
CM_ SG_ 267 RFC_Loc010_Elevation "Location elevation angle. Represented in conical coordinate system. Same as ISO 23150:2021(E): Position elevation (A.4.16)";
CM_ SG_ 267 RFC_Loc010_Azimuth "Location azimuth angle. Represented in conical coordinate system. Deviation from ISO 23150:2021(E): Position azimuth (A.4.16). Further details refers to DSP Location Interface definition";
CM_ SG_ 267 RFC_Loc010_DistVelocityCoVnce "Covariance of radial distance and radial velocity";
CM_ SG_ 267 RFC_Loc010_RadialDistanceVnce "Variance of Location radial distance ISO 23150:2021(E): Position radial distance - error (A.4.17)";
CM_ SG_ 267 RFC_Loc010_RadialVelocityVnce "Variance of Location radial relative velocity ISO 23150:2021(E): Relative velocity {radial distance} - error (A.4.19)";
CM_ SG_ 267 RFC_Loc010_ElevationVnce "Variance of Location elevation angle ISO 23150:2021(E): Position elevation - error (A.4.17)";
CM_ SG_ 267 RFC_Loc010_AzimuthVnce "Variance of Location azimuth angle ISO 23150:2021(E): Position azimuth - error (A.4.17)";
CM_ SG_ 267 RFC_Loc010_RadarCrossSection "Radar Cross Section (RCS) estimation ISO 23150:2021(E): Radar cross section (A.4.5)";
CM_ SG_ 267 RFC_Loc010_DistVelocityQuality "Quality of radial distance and velocity resolution processing. Physical range [0..1]";
CM_ SG_ 267 RFC_Loc010_ElevationQuality "Probability for correct signal model (elevation angle). Physical range [0..1]";
CM_ SG_ 267 RFC_Loc010_AzimuthQuality "Probability for correct signal model (azimuth angle). Physical range [0..1]";
CM_ SG_ 267 RFC_Loc010_RSSI "Received Signal Strength Indication (RSSI). This signal is not exactly ISO 23150:2021(E): Signal to noise ratio - detection level (A.4.7), but SNR can be calculated from this signal. Further detail please refer to the DSP Location Interface definition";
CM_ SG_ 267 RFC_Loc010_AzimuthalPartnerId "Id of the azimuthal partner location";
CM_ SG_ 267 RFC_Loc011_RadialDistance "Location radial distance. Represented in conical coordinate system. Same as ISO 23150:2021(E): Position radial distance (A.4.16)";
CM_ SG_ 267 RFC_Loc011_RadialVelocity "Location radial relative velocity ISO 23150:2021(E): Relative velocity {radial distance} (A.4.18)";
CM_ SG_ 267 RFC_Loc011_Elevation "Location elevation angle. Represented in conical coordinate system. Same as ISO 23150:2021(E): Position elevation (A.4.16)";
CM_ SG_ 267 RFC_Loc011_Azimuth "Location azimuth angle. Represented in conical coordinate system. Deviation from ISO 23150:2021(E): Position azimuth (A.4.16). Further details refers to DSP Location Interface definition";
CM_ SG_ 267 RFC_Loc011_DistVelocityCoVnce "Covariance of radial distance and radial velocity";
CM_ SG_ 267 RFC_Loc011_RadialDistanceVnce "Variance of Location radial distance ISO 23150:2021(E): Position radial distance - error (A.4.17)";
CM_ SG_ 267 RFC_Loc011_RadialVelocityVnce "Variance of Location radial relative velocity ISO 23150:2021(E): Relative velocity {radial distance} - error (A.4.19)";
CM_ SG_ 267 RFC_Loc011_ElevationVnce "Variance of Location elevation angle ISO 23150:2021(E): Position elevation - error (A.4.17)";
CM_ SG_ 267 RFC_Loc011_AzimuthVnce "Variance of Location azimuth angle ISO 23150:2021(E): Position azimuth - error (A.4.17)";
CM_ SG_ 267 RFC_Loc011_RadarCrossSection "Radar Cross Section (RCS) estimation ISO 23150:2021(E): Radar cross section (A.4.5)";
CM_ SG_ 267 RFC_Loc011_DistVelocityQuality "Quality of radial distance and velocity resolution processing. Physical range [0..1]";
CM_ SG_ 267 RFC_Loc011_ElevationQuality "Probability for correct signal model (elevation angle). Physical range [0..1]";
CM_ SG_ 267 RFC_Loc011_AzimuthQuality "Probability for correct signal model (azimuth angle). Physical range [0..1]";
CM_ SG_ 267 RFC_Loc011_RSSI "Received Signal Strength Indication (RSSI). This signal is not exactly ISO 23150:2021(E): Signal to noise ratio - detection level (A.4.7), but SNR can be calculated from this signal. Further detail please refer to the DSP Location Interface definition";
CM_ SG_ 267 RFC_Loc011_AzimuthalPartnerId "Id of the azimuthal partner location";
CM_ SG_ 268 RFC_Loc012_014_CRC "CRC - Autosar E2E Profile 5";
CM_ SG_ 268 RFC_Loc012_014_AliveCtr "Alive counter - Autosar E2E Profile 5";
CM_ SG_ 268 RFC_Loc012_014_ProtBlockCtr "Protocol-Signal: Block-Counter";
CM_ SG_ 268 RFC_Loc012_RadialDistance "Location radial distance. Represented in conical coordinate system. Same as ISO 23150:2021(E): Position radial distance (A.4.16)";
CM_ SG_ 268 RFC_Loc012_RadialVelocity "Location radial relative velocity ISO 23150:2021(E): Relative velocity {radial distance} (A.4.18)";
CM_ SG_ 268 RFC_Loc012_Elevation "Location elevation angle. Represented in conical coordinate system. Same as ISO 23150:2021(E): Position elevation (A.4.16)";
CM_ SG_ 268 RFC_Loc012_Azimuth "Location azimuth angle. Represented in conical coordinate system. Deviation from ISO 23150:2021(E): Position azimuth (A.4.16). Further details refers to DSP Location Interface definition";
CM_ SG_ 268 RFC_Loc012_DistVelocityCoVnce "Covariance of radial distance and radial velocity";
CM_ SG_ 268 RFC_Loc012_RadialDistanceVnce "Variance of Location radial distance ISO 23150:2021(E): Position radial distance - error (A.4.17)";
CM_ SG_ 268 RFC_Loc012_RadialVelocityVnce "Variance of Location radial relative velocity ISO 23150:2021(E): Relative velocity {radial distance} - error (A.4.19)";
CM_ SG_ 268 RFC_Loc012_ElevationVnce "Variance of Location elevation angle ISO 23150:2021(E): Position elevation - error (A.4.17)";
CM_ SG_ 268 RFC_Loc012_AzimuthVnce "Variance of Location azimuth angle ISO 23150:2021(E): Position azimuth - error (A.4.17)";
CM_ SG_ 268 RFC_Loc012_RadarCrossSection "Radar Cross Section (RCS) estimation ISO 23150:2021(E): Radar cross section (A.4.5)";
CM_ SG_ 268 RFC_Loc012_DistVelocityQuality "Quality of radial distance and velocity resolution processing. Physical range [0..1]";
CM_ SG_ 268 RFC_Loc012_ElevationQuality "Probability for correct signal model (elevation angle). Physical range [0..1]";
CM_ SG_ 268 RFC_Loc012_AzimuthQuality "Probability for correct signal model (azimuth angle). Physical range [0..1]";
CM_ SG_ 268 RFC_Loc012_RSSI "Received Signal Strength Indication (RSSI). This signal is not exactly ISO 23150:2021(E): Signal to noise ratio - detection level (A.4.7), but SNR can be calculated from this signal. Further detail please refer to the DSP Location Interface definition";
CM_ SG_ 268 RFC_Loc012_AzimuthalPartnerId "Id of the azimuthal partner location";
CM_ SG_ 268 RFC_Loc013_RadialDistance "Location radial distance. Represented in conical coordinate system. Same as ISO 23150:2021(E): Position radial distance (A.4.16)";
CM_ SG_ 268 RFC_Loc013_RadialVelocity "Location radial relative velocity ISO 23150:2021(E): Relative velocity {radial distance} (A.4.18)";
CM_ SG_ 268 RFC_Loc013_Elevation "Location elevation angle. Represented in conical coordinate system. Same as ISO 23150:2021(E): Position elevation (A.4.16)";
CM_ SG_ 268 RFC_Loc013_Azimuth "Location azimuth angle. Represented in conical coordinate system. Deviation from ISO 23150:2021(E): Position azimuth (A.4.16). Further details refers to DSP Location Interface definition";
CM_ SG_ 268 RFC_Loc013_DistVelocityCoVnce "Covariance of radial distance and radial velocity";
CM_ SG_ 268 RFC_Loc013_RadialDistanceVnce "Variance of Location radial distance ISO 23150:2021(E): Position radial distance - error (A.4.17)";
CM_ SG_ 268 RFC_Loc013_RadialVelocityVnce "Variance of Location radial relative velocity ISO 23150:2021(E): Relative velocity {radial distance} - error (A.4.19)";
CM_ SG_ 268 RFC_Loc013_ElevationVnce "Variance of Location elevation angle ISO 23150:2021(E): Position elevation - error (A.4.17)";
CM_ SG_ 268 RFC_Loc013_AzimuthVnce "Variance of Location azimuth angle ISO 23150:2021(E): Position azimuth - error (A.4.17)";
CM_ SG_ 268 RFC_Loc013_RadarCrossSection "Radar Cross Section (RCS) estimation ISO 23150:2021(E): Radar cross section (A.4.5)";
CM_ SG_ 268 RFC_Loc013_DistVelocityQuality "Quality of radial distance and velocity resolution processing. Physical range [0..1]";
CM_ SG_ 268 RFC_Loc013_ElevationQuality "Probability for correct signal model (elevation angle). Physical range [0..1]";
CM_ SG_ 268 RFC_Loc013_AzimuthQuality "Probability for correct signal model (azimuth angle). Physical range [0..1]";
CM_ SG_ 268 RFC_Loc013_RSSI "Received Signal Strength Indication (RSSI). This signal is not exactly ISO 23150:2021(E): Signal to noise ratio - detection level (A.4.7), but SNR can be calculated from this signal. Further detail please refer to the DSP Location Interface definition";
CM_ SG_ 268 RFC_Loc013_AzimuthalPartnerId "Id of the azimuthal partner location";
CM_ SG_ 268 RFC_Loc014_RadialDistance "Location radial distance. Represented in conical coordinate system. Same as ISO 23150:2021(E): Position radial distance (A.4.16)";
CM_ SG_ 268 RFC_Loc014_RadialVelocity "Location radial relative velocity ISO 23150:2021(E): Relative velocity {radial distance} (A.4.18)";
CM_ SG_ 268 RFC_Loc014_Elevation "Location elevation angle. Represented in conical coordinate system. Same as ISO 23150:2021(E): Position elevation (A.4.16)";
CM_ SG_ 268 RFC_Loc014_Azimuth "Location azimuth angle. Represented in conical coordinate system. Deviation from ISO 23150:2021(E): Position azimuth (A.4.16). Further details refers to DSP Location Interface definition";
CM_ SG_ 268 RFC_Loc014_DistVelocityCoVnce "Covariance of radial distance and radial velocity";
CM_ SG_ 268 RFC_Loc014_RadialDistanceVnce "Variance of Location radial distance ISO 23150:2021(E): Position radial distance - error (A.4.17)";
CM_ SG_ 268 RFC_Loc014_RadialVelocityVnce "Variance of Location radial relative velocity ISO 23150:2021(E): Relative velocity {radial distance} - error (A.4.19)";
CM_ SG_ 268 RFC_Loc014_ElevationVnce "Variance of Location elevation angle ISO 23150:2021(E): Position elevation - error (A.4.17)";
CM_ SG_ 268 RFC_Loc014_AzimuthVnce "Variance of Location azimuth angle ISO 23150:2021(E): Position azimuth - error (A.4.17)";
CM_ SG_ 268 RFC_Loc014_RadarCrossSection "Radar Cross Section (RCS) estimation ISO 23150:2021(E): Radar cross section (A.4.5)";
CM_ SG_ 268 RFC_Loc014_DistVelocityQuality "Quality of radial distance and velocity resolution processing. Physical range [0..1]";
CM_ SG_ 268 RFC_Loc014_ElevationQuality "Probability for correct signal model (elevation angle). Physical range [0..1]";
CM_ SG_ 268 RFC_Loc014_AzimuthQuality "Probability for correct signal model (azimuth angle). Physical range [0..1]";
CM_ SG_ 268 RFC_Loc014_RSSI "Received Signal Strength Indication (RSSI). This signal is not exactly ISO 23150:2021(E): Signal to noise ratio - detection level (A.4.7), but SNR can be calculated from this signal. Further detail please refer to the DSP Location Interface definition";
CM_ SG_ 268 RFC_Loc014_AzimuthalPartnerId "Id of the azimuthal partner location";
CM_ SG_ 269 RFC_Loc015_017_CRC "CRC - Autosar E2E Profile 5";
CM_ SG_ 269 RFC_Loc015_017_AliveCtr "Alive counter - Autosar E2E Profile 5";
CM_ SG_ 269 RFC_Loc015_017_ProtBlockCtr "Protocol-Signal: Block-Counter";
CM_ SG_ 269 RFC_Loc015_RadialDistance "Location radial distance. Represented in conical coordinate system. Same as ISO 23150:2021(E): Position radial distance (A.4.16)";
CM_ SG_ 269 RFC_Loc015_RadialVelocity "Location radial relative velocity ISO 23150:2021(E): Relative velocity {radial distance} (A.4.18)";
CM_ SG_ 269 RFC_Loc015_Elevation "Location elevation angle. Represented in conical coordinate system. Same as ISO 23150:2021(E): Position elevation (A.4.16)";
CM_ SG_ 269 RFC_Loc015_Azimuth "Location azimuth angle. Represented in conical coordinate system. Deviation from ISO 23150:2021(E): Position azimuth (A.4.16). Further details refers to DSP Location Interface definition";
CM_ SG_ 269 RFC_Loc015_DistVelocityCoVnce "Covariance of radial distance and radial velocity";
CM_ SG_ 269 RFC_Loc015_RadialDistanceVnce "Variance of Location radial distance ISO 23150:2021(E): Position radial distance - error (A.4.17)";
CM_ SG_ 269 RFC_Loc015_RadialVelocityVnce "Variance of Location radial relative velocity ISO 23150:2021(E): Relative velocity {radial distance} - error (A.4.19)";
CM_ SG_ 269 RFC_Loc015_ElevationVnce "Variance of Location elevation angle ISO 23150:2021(E): Position elevation - error (A.4.17)";
CM_ SG_ 269 RFC_Loc015_AzimuthVnce "Variance of Location azimuth angle ISO 23150:2021(E): Position azimuth - error (A.4.17)";
CM_ SG_ 269 RFC_Loc015_RadarCrossSection "Radar Cross Section (RCS) estimation ISO 23150:2021(E): Radar cross section (A.4.5)";
CM_ SG_ 269 RFC_Loc015_DistVelocityQuality "Quality of radial distance and velocity resolution processing. Physical range [0..1]";
CM_ SG_ 269 RFC_Loc015_ElevationQuality "Probability for correct signal model (elevation angle). Physical range [0..1]";
CM_ SG_ 269 RFC_Loc015_AzimuthQuality "Probability for correct signal model (azimuth angle). Physical range [0..1]";
CM_ SG_ 269 RFC_Loc015_RSSI "Received Signal Strength Indication (RSSI). This signal is not exactly ISO 23150:2021(E): Signal to noise ratio - detection level (A.4.7), but SNR can be calculated from this signal. Further detail please refer to the DSP Location Interface definition";
CM_ SG_ 269 RFC_Loc015_AzimuthalPartnerId "Id of the azimuthal partner location";
CM_ SG_ 269 RFC_Loc016_RadialDistance "Location radial distance. Represented in conical coordinate system. Same as ISO 23150:2021(E): Position radial distance (A.4.16)";
CM_ SG_ 269 RFC_Loc016_RadialVelocity "Location radial relative velocity ISO 23150:2021(E): Relative velocity {radial distance} (A.4.18)";
CM_ SG_ 269 RFC_Loc016_Elevation "Location elevation angle. Represented in conical coordinate system. Same as ISO 23150:2021(E): Position elevation (A.4.16)";
CM_ SG_ 269 RFC_Loc016_Azimuth "Location azimuth angle. Represented in conical coordinate system. Deviation from ISO 23150:2021(E): Position azimuth (A.4.16). Further details refers to DSP Location Interface definition";
CM_ SG_ 269 RFC_Loc016_DistVelocityCoVnce "Covariance of radial distance and radial velocity";
CM_ SG_ 269 RFC_Loc016_RadialDistanceVnce "Variance of Location radial distance ISO 23150:2021(E): Position radial distance - error (A.4.17)";
CM_ SG_ 269 RFC_Loc016_RadialVelocityVnce "Variance of Location radial relative velocity ISO 23150:2021(E): Relative velocity {radial distance} - error (A.4.19)";
CM_ SG_ 269 RFC_Loc016_ElevationVnce "Variance of Location elevation angle ISO 23150:2021(E): Position elevation - error (A.4.17)";
CM_ SG_ 269 RFC_Loc016_AzimuthVnce "Variance of Location azimuth angle ISO 23150:2021(E): Position azimuth - error (A.4.17)";
CM_ SG_ 269 RFC_Loc016_RadarCrossSection "Radar Cross Section (RCS) estimation ISO 23150:2021(E): Radar cross section (A.4.5)";
CM_ SG_ 269 RFC_Loc016_DistVelocityQuality "Quality of radial distance and velocity resolution processing. Physical range [0..1]";
CM_ SG_ 269 RFC_Loc016_ElevationQuality "Probability for correct signal model (elevation angle). Physical range [0..1]";
CM_ SG_ 269 RFC_Loc016_AzimuthQuality "Probability for correct signal model (azimuth angle). Physical range [0..1]";
CM_ SG_ 269 RFC_Loc016_RSSI "Received Signal Strength Indication (RSSI). This signal is not exactly ISO 23150:2021(E): Signal to noise ratio - detection level (A.4.7), but SNR can be calculated from this signal. Further detail please refer to the DSP Location Interface definition";
CM_ SG_ 269 RFC_Loc016_AzimuthalPartnerId "Id of the azimuthal partner location";
CM_ SG_ 269 RFC_Loc017_RadialDistance "Location radial distance. Represented in conical coordinate system. Same as ISO 23150:2021(E): Position radial distance (A.4.16)";
CM_ SG_ 269 RFC_Loc017_RadialVelocity "Location radial relative velocity ISO 23150:2021(E): Relative velocity {radial distance} (A.4.18)";
CM_ SG_ 269 RFC_Loc017_Elevation "Location elevation angle. Represented in conical coordinate system. Same as ISO 23150:2021(E): Position elevation (A.4.16)";
CM_ SG_ 269 RFC_Loc017_Azimuth "Location azimuth angle. Represented in conical coordinate system. Deviation from ISO 23150:2021(E): Position azimuth (A.4.16). Further details refers to DSP Location Interface definition";
CM_ SG_ 269 RFC_Loc017_DistVelocityCoVnce "Covariance of radial distance and radial velocity";
CM_ SG_ 269 RFC_Loc017_RadialDistanceVnce "Variance of Location radial distance ISO 23150:2021(E): Position radial distance - error (A.4.17)";
CM_ SG_ 269 RFC_Loc017_RadialVelocityVnce "Variance of Location radial relative velocity ISO 23150:2021(E): Relative velocity {radial distance} - error (A.4.19)";
CM_ SG_ 269 RFC_Loc017_ElevationVnce "Variance of Location elevation angle ISO 23150:2021(E): Position elevation - error (A.4.17)";
CM_ SG_ 269 RFC_Loc017_AzimuthVnce "Variance of Location azimuth angle ISO 23150:2021(E): Position azimuth - error (A.4.17)";
CM_ SG_ 269 RFC_Loc017_RadarCrossSection "Radar Cross Section (RCS) estimation ISO 23150:2021(E): Radar cross section (A.4.5)";
CM_ SG_ 269 RFC_Loc017_DistVelocityQuality "Quality of radial distance and velocity resolution processing. Physical range [0..1]";
CM_ SG_ 269 RFC_Loc017_ElevationQuality "Probability for correct signal model (elevation angle). Physical range [0..1]";
CM_ SG_ 269 RFC_Loc017_AzimuthQuality "Probability for correct signal model (azimuth angle). Physical range [0..1]";
CM_ SG_ 269 RFC_Loc017_RSSI "Received Signal Strength Indication (RSSI). This signal is not exactly ISO 23150:2021(E): Signal to noise ratio - detection level (A.4.7), but SNR can be calculated from this signal. Further detail please refer to the DSP Location Interface definition";
CM_ SG_ 269 RFC_Loc017_AzimuthalPartnerId "Id of the azimuthal partner location";
CM_ SG_ 270 RFC_Loc018_020_CRC "CRC - Autosar E2E Profile 5";
CM_ SG_ 270 RFC_Loc018_020_AliveCtr "Alive counter - Autosar E2E Profile 5";
CM_ SG_ 270 RFC_Loc018_020_ProtBlockCtr "Protocol-Signal: Block-Counter";
CM_ SG_ 270 RFC_Loc018_RadialDistance "Location radial distance. Represented in conical coordinate system. Same as ISO 23150:2021(E): Position radial distance (A.4.16)";
CM_ SG_ 270 RFC_Loc018_RadialVelocity "Location radial relative velocity ISO 23150:2021(E): Relative velocity {radial distance} (A.4.18)";
CM_ SG_ 270 RFC_Loc018_Elevation "Location elevation angle. Represented in conical coordinate system. Same as ISO 23150:2021(E): Position elevation (A.4.16)";
CM_ SG_ 270 RFC_Loc018_Azimuth "Location azimuth angle. Represented in conical coordinate system. Deviation from ISO 23150:2021(E): Position azimuth (A.4.16). Further details refers to DSP Location Interface definition";
CM_ SG_ 270 RFC_Loc018_DistVelocityCoVnce "Covariance of radial distance and radial velocity";
CM_ SG_ 270 RFC_Loc018_RadialDistanceVnce "Variance of Location radial distance ISO 23150:2021(E): Position radial distance - error (A.4.17)";
CM_ SG_ 270 RFC_Loc018_RadialVelocityVnce "Variance of Location radial relative velocity ISO 23150:2021(E): Relative velocity {radial distance} - error (A.4.19)";
CM_ SG_ 270 RFC_Loc018_ElevationVnce "Variance of Location elevation angle ISO 23150:2021(E): Position elevation - error (A.4.17)";
CM_ SG_ 270 RFC_Loc018_AzimuthVnce "Variance of Location azimuth angle ISO 23150:2021(E): Position azimuth - error (A.4.17)";
CM_ SG_ 270 RFC_Loc018_RadarCrossSection "Radar Cross Section (RCS) estimation ISO 23150:2021(E): Radar cross section (A.4.5)";
CM_ SG_ 270 RFC_Loc018_DistVelocityQuality "Quality of radial distance and velocity resolution processing. Physical range [0..1]";
CM_ SG_ 270 RFC_Loc018_ElevationQuality "Probability for correct signal model (elevation angle). Physical range [0..1]";
CM_ SG_ 270 RFC_Loc018_AzimuthQuality "Probability for correct signal model (azimuth angle). Physical range [0..1]";
CM_ SG_ 270 RFC_Loc018_RSSI "Received Signal Strength Indication (RSSI). This signal is not exactly ISO 23150:2021(E): Signal to noise ratio - detection level (A.4.7), but SNR can be calculated from this signal. Further detail please refer to the DSP Location Interface definition";
CM_ SG_ 270 RFC_Loc018_AzimuthalPartnerId "Id of the azimuthal partner location";
CM_ SG_ 270 RFC_Loc019_RadialDistance "Location radial distance. Represented in conical coordinate system. Same as ISO 23150:2021(E): Position radial distance (A.4.16)";
CM_ SG_ 270 RFC_Loc019_RadialVelocity "Location radial relative velocity ISO 23150:2021(E): Relative velocity {radial distance} (A.4.18)";
CM_ SG_ 270 RFC_Loc019_Elevation "Location elevation angle. Represented in conical coordinate system. Same as ISO 23150:2021(E): Position elevation (A.4.16)";
CM_ SG_ 270 RFC_Loc019_Azimuth "Location azimuth angle. Represented in conical coordinate system. Deviation from ISO 23150:2021(E): Position azimuth (A.4.16). Further details refers to DSP Location Interface definition";
CM_ SG_ 270 RFC_Loc019_DistVelocityCoVnce "Covariance of radial distance and radial velocity";
CM_ SG_ 270 RFC_Loc019_RadialDistanceVnce "Variance of Location radial distance ISO 23150:2021(E): Position radial distance - error (A.4.17)";
CM_ SG_ 270 RFC_Loc019_RadialVelocityVnce "Variance of Location radial relative velocity ISO 23150:2021(E): Relative velocity {radial distance} - error (A.4.19)";
CM_ SG_ 270 RFC_Loc019_ElevationVnce "Variance of Location elevation angle ISO 23150:2021(E): Position elevation - error (A.4.17)";
CM_ SG_ 270 RFC_Loc019_AzimuthVnce "Variance of Location azimuth angle ISO 23150:2021(E): Position azimuth - error (A.4.17)";
CM_ SG_ 270 RFC_Loc019_RadarCrossSection "Radar Cross Section (RCS) estimation ISO 23150:2021(E): Radar cross section (A.4.5)";
CM_ SG_ 270 RFC_Loc019_DistVelocityQuality "Quality of radial distance and velocity resolution processing. Physical range [0..1]";
CM_ SG_ 270 RFC_Loc019_ElevationQuality "Probability for correct signal model (elevation angle). Physical range [0..1]";
CM_ SG_ 270 RFC_Loc019_AzimuthQuality "Probability for correct signal model (azimuth angle). Physical range [0..1]";
CM_ SG_ 270 RFC_Loc019_RSSI "Received Signal Strength Indication (RSSI). This signal is not exactly ISO 23150:2021(E): Signal to noise ratio - detection level (A.4.7), but SNR can be calculated from this signal. Further detail please refer to the DSP Location Interface definition";
CM_ SG_ 270 RFC_Loc019_AzimuthalPartnerId "Id of the azimuthal partner location";
CM_ SG_ 270 RFC_Loc020_RadialDistance "Location radial distance. Represented in conical coordinate system. Same as ISO 23150:2021(E): Position radial distance (A.4.16)";
CM_ SG_ 270 RFC_Loc020_RadialVelocity "Location radial relative velocity ISO 23150:2021(E): Relative velocity {radial distance} (A.4.18)";
CM_ SG_ 270 RFC_Loc020_Elevation "Location elevation angle. Represented in conical coordinate system. Same as ISO 23150:2021(E): Position elevation (A.4.16)";
CM_ SG_ 270 RFC_Loc020_Azimuth "Location azimuth angle. Represented in conical coordinate system. Deviation from ISO 23150:2021(E): Position azimuth (A.4.16). Further details refers to DSP Location Interface definition";
CM_ SG_ 270 RFC_Loc020_DistVelocityCoVnce "Covariance of radial distance and radial velocity";
CM_ SG_ 270 RFC_Loc020_RadialDistanceVnce "Variance of Location radial distance ISO 23150:2021(E): Position radial distance - error (A.4.17)";
CM_ SG_ 270 RFC_Loc020_RadialVelocityVnce "Variance of Location radial relative velocity ISO 23150:2021(E): Relative velocity {radial distance} - error (A.4.19)";
CM_ SG_ 270 RFC_Loc020_ElevationVnce "Variance of Location elevation angle ISO 23150:2021(E): Position elevation - error (A.4.17)";
CM_ SG_ 270 RFC_Loc020_AzimuthVnce "Variance of Location azimuth angle ISO 23150:2021(E): Position azimuth - error (A.4.17)";
CM_ SG_ 270 RFC_Loc020_RadarCrossSection "Radar Cross Section (RCS) estimation ISO 23150:2021(E): Radar cross section (A.4.5)";
CM_ SG_ 270 RFC_Loc020_DistVelocityQuality "Quality of radial distance and velocity resolution processing. Physical range [0..1]";
CM_ SG_ 270 RFC_Loc020_ElevationQuality "Probability for correct signal model (elevation angle). Physical range [0..1]";
CM_ SG_ 270 RFC_Loc020_AzimuthQuality "Probability for correct signal model (azimuth angle). Physical range [0..1]";
CM_ SG_ 270 RFC_Loc020_RSSI "Received Signal Strength Indication (RSSI). This signal is not exactly ISO 23150:2021(E): Signal to noise ratio - detection level (A.4.7), but SNR can be calculated from this signal. Further detail please refer to the DSP Location Interface definition";
CM_ SG_ 270 RFC_Loc020_AzimuthalPartnerId "Id of the azimuthal partner location";
CM_ SG_ 271 RFC_Loc021_023_CRC "CRC - Autosar E2E Profile 5";
CM_ SG_ 271 RFC_Loc021_023_AliveCtr "Alive counter - Autosar E2E Profile 5";
CM_ SG_ 271 RFC_Loc021_023_ProtBlockCtr "Protocol-Signal: Block-Counter";
CM_ SG_ 271 RFC_Loc021_RadialDistance "Location radial distance. Represented in conical coordinate system. Same as ISO 23150:2021(E): Position radial distance (A.4.16)";
CM_ SG_ 271 RFC_Loc021_RadialVelocity "Location radial relative velocity ISO 23150:2021(E): Relative velocity {radial distance} (A.4.18)";
CM_ SG_ 271 RFC_Loc021_Elevation "Location elevation angle. Represented in conical coordinate system. Same as ISO 23150:2021(E): Position elevation (A.4.16)";
CM_ SG_ 271 RFC_Loc021_Azimuth "Location azimuth angle. Represented in conical coordinate system. Deviation from ISO 23150:2021(E): Position azimuth (A.4.16). Further details refers to DSP Location Interface definition";
CM_ SG_ 271 RFC_Loc021_DistVelocityCoVnce "Covariance of radial distance and radial velocity";
CM_ SG_ 271 RFC_Loc021_RadialDistanceVnce "Variance of Location radial distance ISO 23150:2021(E): Position radial distance - error (A.4.17)";
CM_ SG_ 271 RFC_Loc021_RadialVelocityVnce "Variance of Location radial relative velocity ISO 23150:2021(E): Relative velocity {radial distance} - error (A.4.19)";
CM_ SG_ 271 RFC_Loc021_ElevationVnce "Variance of Location elevation angle ISO 23150:2021(E): Position elevation - error (A.4.17)";
CM_ SG_ 271 RFC_Loc021_AzimuthVnce "Variance of Location azimuth angle ISO 23150:2021(E): Position azimuth - error (A.4.17)";
CM_ SG_ 271 RFC_Loc021_RadarCrossSection "Radar Cross Section (RCS) estimation ISO 23150:2021(E): Radar cross section (A.4.5)";
CM_ SG_ 271 RFC_Loc021_DistVelocityQuality "Quality of radial distance and velocity resolution processing. Physical range [0..1]";
CM_ SG_ 271 RFC_Loc021_ElevationQuality "Probability for correct signal model (elevation angle). Physical range [0..1]";
CM_ SG_ 271 RFC_Loc021_AzimuthQuality "Probability for correct signal model (azimuth angle). Physical range [0..1]";
CM_ SG_ 271 RFC_Loc021_RSSI "Received Signal Strength Indication (RSSI). This signal is not exactly ISO 23150:2021(E): Signal to noise ratio - detection level (A.4.7), but SNR can be calculated from this signal. Further detail please refer to the DSP Location Interface definition";
CM_ SG_ 271 RFC_Loc021_AzimuthalPartnerId "Id of the azimuthal partner location";
CM_ SG_ 271 RFC_Loc022_RadialDistance "Location radial distance. Represented in conical coordinate system. Same as ISO 23150:2021(E): Position radial distance (A.4.16)";
CM_ SG_ 271 RFC_Loc022_RadialVelocity "Location radial relative velocity ISO 23150:2021(E): Relative velocity {radial distance} (A.4.18)";
CM_ SG_ 271 RFC_Loc022_Elevation "Location elevation angle. Represented in conical coordinate system. Same as ISO 23150:2021(E): Position elevation (A.4.16)";
CM_ SG_ 271 RFC_Loc022_Azimuth "Location azimuth angle. Represented in conical coordinate system. Deviation from ISO 23150:2021(E): Position azimuth (A.4.16). Further details refers to DSP Location Interface definition";
CM_ SG_ 271 RFC_Loc022_DistVelocityCoVnce "Covariance of radial distance and radial velocity";
CM_ SG_ 271 RFC_Loc022_RadialDistanceVnce "Variance of Location radial distance ISO 23150:2021(E): Position radial distance - error (A.4.17)";
CM_ SG_ 271 RFC_Loc022_RadialVelocityVnce "Variance of Location radial relative velocity ISO 23150:2021(E): Relative velocity {radial distance} - error (A.4.19)";
CM_ SG_ 271 RFC_Loc022_ElevationVnce "Variance of Location elevation angle ISO 23150:2021(E): Position elevation - error (A.4.17)";
CM_ SG_ 271 RFC_Loc022_AzimuthVnce "Variance of Location azimuth angle ISO 23150:2021(E): Position azimuth - error (A.4.17)";
CM_ SG_ 271 RFC_Loc022_RadarCrossSection "Radar Cross Section (RCS) estimation ISO 23150:2021(E): Radar cross section (A.4.5)";
CM_ SG_ 271 RFC_Loc022_DistVelocityQuality "Quality of radial distance and velocity resolution processing. Physical range [0..1]";
CM_ SG_ 271 RFC_Loc022_ElevationQuality "Probability for correct signal model (elevation angle). Physical range [0..1]";
CM_ SG_ 271 RFC_Loc022_AzimuthQuality "Probability for correct signal model (azimuth angle). Physical range [0..1]";
CM_ SG_ 271 RFC_Loc022_RSSI "Received Signal Strength Indication (RSSI). This signal is not exactly ISO 23150:2021(E): Signal to noise ratio - detection level (A.4.7), but SNR can be calculated from this signal. Further detail please refer to the DSP Location Interface definition";
CM_ SG_ 271 RFC_Loc022_AzimuthalPartnerId "Id of the azimuthal partner location";
CM_ SG_ 271 RFC_Loc023_RadialDistance "Location radial distance. Represented in conical coordinate system. Same as ISO 23150:2021(E): Position radial distance (A.4.16)";
CM_ SG_ 271 RFC_Loc023_RadialVelocity "Location radial relative velocity ISO 23150:2021(E): Relative velocity {radial distance} (A.4.18)";
CM_ SG_ 271 RFC_Loc023_Elevation "Location elevation angle. Represented in conical coordinate system. Same as ISO 23150:2021(E): Position elevation (A.4.16)";
CM_ SG_ 271 RFC_Loc023_Azimuth "Location azimuth angle. Represented in conical coordinate system. Deviation from ISO 23150:2021(E): Position azimuth (A.4.16). Further details refers to DSP Location Interface definition";
CM_ SG_ 271 RFC_Loc023_DistVelocityCoVnce "Covariance of radial distance and radial velocity";
CM_ SG_ 271 RFC_Loc023_RadialDistanceVnce "Variance of Location radial distance ISO 23150:2021(E): Position radial distance - error (A.4.17)";
CM_ SG_ 271 RFC_Loc023_RadialVelocityVnce "Variance of Location radial relative velocity ISO 23150:2021(E): Relative velocity {radial distance} - error (A.4.19)";
CM_ SG_ 271 RFC_Loc023_ElevationVnce "Variance of Location elevation angle ISO 23150:2021(E): Position elevation - error (A.4.17)";
CM_ SG_ 271 RFC_Loc023_AzimuthVnce "Variance of Location azimuth angle ISO 23150:2021(E): Position azimuth - error (A.4.17)";
CM_ SG_ 271 RFC_Loc023_RadarCrossSection "Radar Cross Section (RCS) estimation ISO 23150:2021(E): Radar cross section (A.4.5)";
CM_ SG_ 271 RFC_Loc023_DistVelocityQuality "Quality of radial distance and velocity resolution processing. Physical range [0..1]";
CM_ SG_ 271 RFC_Loc023_ElevationQuality "Probability for correct signal model (elevation angle). Physical range [0..1]";
CM_ SG_ 271 RFC_Loc023_AzimuthQuality "Probability for correct signal model (azimuth angle). Physical range [0..1]";
CM_ SG_ 271 RFC_Loc023_RSSI "Received Signal Strength Indication (RSSI). This signal is not exactly ISO 23150:2021(E): Signal to noise ratio - detection level (A.4.7), but SNR can be calculated from this signal. Further detail please refer to the DSP Location Interface definition";
CM_ SG_ 271 RFC_Loc023_AzimuthalPartnerId "Id of the azimuthal partner location";
CM_ SG_ 272 RFC_Loc024_026_CRC "CRC - Autosar E2E Profile 5";
CM_ SG_ 272 RFC_Loc024_026_AliveCtr "Alive counter - Autosar E2E Profile 5";
CM_ SG_ 272 RFC_Loc024_026_ProtBlockCtr "Protocol-Signal: Block-Counter";
CM_ SG_ 272 RFC_Loc024_RadialDistance "Location radial distance. Represented in conical coordinate system. Same as ISO 23150:2021(E): Position radial distance (A.4.16)";
CM_ SG_ 272 RFC_Loc024_RadialVelocity "Location radial relative velocity ISO 23150:2021(E): Relative velocity {radial distance} (A.4.18)";
CM_ SG_ 272 RFC_Loc024_Elevation "Location elevation angle. Represented in conical coordinate system. Same as ISO 23150:2021(E): Position elevation (A.4.16)";
CM_ SG_ 272 RFC_Loc024_Azimuth "Location azimuth angle. Represented in conical coordinate system. Deviation from ISO 23150:2021(E): Position azimuth (A.4.16). Further details refers to DSP Location Interface definition";
CM_ SG_ 272 RFC_Loc024_DistVelocityCoVnce "Covariance of radial distance and radial velocity";
CM_ SG_ 272 RFC_Loc024_RadialDistanceVnce "Variance of Location radial distance ISO 23150:2021(E): Position radial distance - error (A.4.17)";
CM_ SG_ 272 RFC_Loc024_RadialVelocityVnce "Variance of Location radial relative velocity ISO 23150:2021(E): Relative velocity {radial distance} - error (A.4.19)";
CM_ SG_ 272 RFC_Loc024_ElevationVnce "Variance of Location elevation angle ISO 23150:2021(E): Position elevation - error (A.4.17)";
CM_ SG_ 272 RFC_Loc024_AzimuthVnce "Variance of Location azimuth angle ISO 23150:2021(E): Position azimuth - error (A.4.17)";
CM_ SG_ 272 RFC_Loc024_RadarCrossSection "Radar Cross Section (RCS) estimation ISO 23150:2021(E): Radar cross section (A.4.5)";
CM_ SG_ 272 RFC_Loc024_DistVelocityQuality "Quality of radial distance and velocity resolution processing. Physical range [0..1]";
CM_ SG_ 272 RFC_Loc024_ElevationQuality "Probability for correct signal model (elevation angle). Physical range [0..1]";
CM_ SG_ 272 RFC_Loc024_AzimuthQuality "Probability for correct signal model (azimuth angle). Physical range [0..1]";
CM_ SG_ 272 RFC_Loc024_RSSI "Received Signal Strength Indication (RSSI). This signal is not exactly ISO 23150:2021(E): Signal to noise ratio - detection level (A.4.7), but SNR can be calculated from this signal. Further detail please refer to the DSP Location Interface definition";
CM_ SG_ 272 RFC_Loc024_AzimuthalPartnerId "Id of the azimuthal partner location";
CM_ SG_ 272 RFC_Loc025_RadialDistance "Location radial distance. Represented in conical coordinate system. Same as ISO 23150:2021(E): Position radial distance (A.4.16)";
CM_ SG_ 272 RFC_Loc025_RadialVelocity "Location radial relative velocity ISO 23150:2021(E): Relative velocity {radial distance} (A.4.18)";
CM_ SG_ 272 RFC_Loc025_Elevation "Location elevation angle. Represented in conical coordinate system. Same as ISO 23150:2021(E): Position elevation (A.4.16)";
CM_ SG_ 272 RFC_Loc025_Azimuth "Location azimuth angle. Represented in conical coordinate system. Deviation from ISO 23150:2021(E): Position azimuth (A.4.16). Further details refers to DSP Location Interface definition";
CM_ SG_ 272 RFC_Loc025_DistVelocityCoVnce "Covariance of radial distance and radial velocity";
CM_ SG_ 272 RFC_Loc025_RadialDistanceVnce "Variance of Location radial distance ISO 23150:2021(E): Position radial distance - error (A.4.17)";
CM_ SG_ 272 RFC_Loc025_RadialVelocityVnce "Variance of Location radial relative velocity ISO 23150:2021(E): Relative velocity {radial distance} - error (A.4.19)";
CM_ SG_ 272 RFC_Loc025_ElevationVnce "Variance of Location elevation angle ISO 23150:2021(E): Position elevation - error (A.4.17)";
CM_ SG_ 272 RFC_Loc025_AzimuthVnce "Variance of Location azimuth angle ISO 23150:2021(E): Position azimuth - error (A.4.17)";
CM_ SG_ 272 RFC_Loc025_RadarCrossSection "Radar Cross Section (RCS) estimation ISO 23150:2021(E): Radar cross section (A.4.5)";
CM_ SG_ 272 RFC_Loc025_DistVelocityQuality "Quality of radial distance and velocity resolution processing. Physical range [0..1]";
CM_ SG_ 272 RFC_Loc025_ElevationQuality "Probability for correct signal model (elevation angle). Physical range [0..1]";
CM_ SG_ 272 RFC_Loc025_AzimuthQuality "Probability for correct signal model (azimuth angle). Physical range [0..1]";
CM_ SG_ 272 RFC_Loc025_RSSI "Received Signal Strength Indication (RSSI). This signal is not exactly ISO 23150:2021(E): Signal to noise ratio - detection level (A.4.7), but SNR can be calculated from this signal. Further detail please refer to the DSP Location Interface definition";
CM_ SG_ 272 RFC_Loc025_AzimuthalPartnerId "Id of the azimuthal partner location";
CM_ SG_ 272 RFC_Loc026_RadialDistance "Location radial distance. Represented in conical coordinate system. Same as ISO 23150:2021(E): Position radial distance (A.4.16)";
CM_ SG_ 272 RFC_Loc026_RadialVelocity "Location radial relative velocity ISO 23150:2021(E): Relative velocity {radial distance} (A.4.18)";
CM_ SG_ 272 RFC_Loc026_Elevation "Location elevation angle. Represented in conical coordinate system. Same as ISO 23150:2021(E): Position elevation (A.4.16)";
CM_ SG_ 272 RFC_Loc026_Azimuth "Location azimuth angle. Represented in conical coordinate system. Deviation from ISO 23150:2021(E): Position azimuth (A.4.16). Further details refers to DSP Location Interface definition";
CM_ SG_ 272 RFC_Loc026_DistVelocityCoVnce "Covariance of radial distance and radial velocity";
CM_ SG_ 272 RFC_Loc026_RadialDistanceVnce "Variance of Location radial distance ISO 23150:2021(E): Position radial distance - error (A.4.17)";
CM_ SG_ 272 RFC_Loc026_RadialVelocityVnce "Variance of Location radial relative velocity ISO 23150:2021(E): Relative velocity {radial distance} - error (A.4.19)";
CM_ SG_ 272 RFC_Loc026_ElevationVnce "Variance of Location elevation angle ISO 23150:2021(E): Position elevation - error (A.4.17)";
CM_ SG_ 272 RFC_Loc026_AzimuthVnce "Variance of Location azimuth angle ISO 23150:2021(E): Position azimuth - error (A.4.17)";
CM_ SG_ 272 RFC_Loc026_RadarCrossSection "Radar Cross Section (RCS) estimation ISO 23150:2021(E): Radar cross section (A.4.5)";
CM_ SG_ 272 RFC_Loc026_DistVelocityQuality "Quality of radial distance and velocity resolution processing. Physical range [0..1]";
CM_ SG_ 272 RFC_Loc026_ElevationQuality "Probability for correct signal model (elevation angle). Physical range [0..1]";
CM_ SG_ 272 RFC_Loc026_AzimuthQuality "Probability for correct signal model (azimuth angle). Physical range [0..1]";
CM_ SG_ 272 RFC_Loc026_RSSI "Received Signal Strength Indication (RSSI). This signal is not exactly ISO 23150:2021(E): Signal to noise ratio - detection level (A.4.7), but SNR can be calculated from this signal. Further detail please refer to the DSP Location Interface definition";
CM_ SG_ 272 RFC_Loc026_AzimuthalPartnerId "Id of the azimuthal partner location";
CM_ SG_ 273 RFC_Loc027_029_CRC "CRC - Autosar E2E Profile 5";
CM_ SG_ 273 RFC_Loc027_029_AliveCtr "Alive counter - Autosar E2E Profile 5";
CM_ SG_ 273 RFC_Loc027_029_ProtBlockCtr "Protocol-Signal: Block-Counter";
CM_ SG_ 273 RFC_Loc027_RadialDistance "Location radial distance. Represented in conical coordinate system. Same as ISO 23150:2021(E): Position radial distance (A.4.16)";
CM_ SG_ 273 RFC_Loc027_RadialVelocity "Location radial relative velocity ISO 23150:2021(E): Relative velocity {radial distance} (A.4.18)";
CM_ SG_ 273 RFC_Loc027_Elevation "Location elevation angle. Represented in conical coordinate system. Same as ISO 23150:2021(E): Position elevation (A.4.16)";
CM_ SG_ 273 RFC_Loc027_Azimuth "Location azimuth angle. Represented in conical coordinate system. Deviation from ISO 23150:2021(E): Position azimuth (A.4.16). Further details refers to DSP Location Interface definition";
CM_ SG_ 273 RFC_Loc027_DistVelocityCoVnce "Covariance of radial distance and radial velocity";
CM_ SG_ 273 RFC_Loc027_RadialDistanceVnce "Variance of Location radial distance ISO 23150:2021(E): Position radial distance - error (A.4.17)";
CM_ SG_ 273 RFC_Loc027_RadialVelocityVnce "Variance of Location radial relative velocity ISO 23150:2021(E): Relative velocity {radial distance} - error (A.4.19)";
CM_ SG_ 273 RFC_Loc027_ElevationVnce "Variance of Location elevation angle ISO 23150:2021(E): Position elevation - error (A.4.17)";
CM_ SG_ 273 RFC_Loc027_AzimuthVnce "Variance of Location azimuth angle ISO 23150:2021(E): Position azimuth - error (A.4.17)";
CM_ SG_ 273 RFC_Loc027_RadarCrossSection "Radar Cross Section (RCS) estimation ISO 23150:2021(E): Radar cross section (A.4.5)";
CM_ SG_ 273 RFC_Loc027_DistVelocityQuality "Quality of radial distance and velocity resolution processing. Physical range [0..1]";
CM_ SG_ 273 RFC_Loc027_ElevationQuality "Probability for correct signal model (elevation angle). Physical range [0..1]";
CM_ SG_ 273 RFC_Loc027_AzimuthQuality "Probability for correct signal model (azimuth angle). Physical range [0..1]";
CM_ SG_ 273 RFC_Loc027_RSSI "Received Signal Strength Indication (RSSI). This signal is not exactly ISO 23150:2021(E): Signal to noise ratio - detection level (A.4.7), but SNR can be calculated from this signal. Further detail please refer to the DSP Location Interface definition";
CM_ SG_ 273 RFC_Loc027_AzimuthalPartnerId "Id of the azimuthal partner location";
CM_ SG_ 273 RFC_Loc028_RadialDistance "Location radial distance. Represented in conical coordinate system. Same as ISO 23150:2021(E): Position radial distance (A.4.16)";
CM_ SG_ 273 RFC_Loc028_RadialVelocity "Location radial relative velocity ISO 23150:2021(E): Relative velocity {radial distance} (A.4.18)";
CM_ SG_ 273 RFC_Loc028_Elevation "Location elevation angle. Represented in conical coordinate system. Same as ISO 23150:2021(E): Position elevation (A.4.16)";
CM_ SG_ 273 RFC_Loc028_Azimuth "Location azimuth angle. Represented in conical coordinate system. Deviation from ISO 23150:2021(E): Position azimuth (A.4.16). Further details refers to DSP Location Interface definition";
CM_ SG_ 273 RFC_Loc028_DistVelocityCoVnce "Covariance of radial distance and radial velocity";
CM_ SG_ 273 RFC_Loc028_RadialDistanceVnce "Variance of Location radial distance ISO 23150:2021(E): Position radial distance - error (A.4.17)";
CM_ SG_ 273 RFC_Loc028_RadialVelocityVnce "Variance of Location radial relative velocity ISO 23150:2021(E): Relative velocity {radial distance} - error (A.4.19)";
CM_ SG_ 273 RFC_Loc028_ElevationVnce "Variance of Location elevation angle ISO 23150:2021(E): Position elevation - error (A.4.17)";
CM_ SG_ 273 RFC_Loc028_AzimuthVnce "Variance of Location azimuth angle ISO 23150:2021(E): Position azimuth - error (A.4.17)";
CM_ SG_ 273 RFC_Loc028_RadarCrossSection "Radar Cross Section (RCS) estimation ISO 23150:2021(E): Radar cross section (A.4.5)";
CM_ SG_ 273 RFC_Loc028_DistVelocityQuality "Quality of radial distance and velocity resolution processing. Physical range [0..1]";
CM_ SG_ 273 RFC_Loc028_ElevationQuality "Probability for correct signal model (elevation angle). Physical range [0..1]";
CM_ SG_ 273 RFC_Loc028_AzimuthQuality "Probability for correct signal model (azimuth angle). Physical range [0..1]";
CM_ SG_ 273 RFC_Loc028_RSSI "Received Signal Strength Indication (RSSI). This signal is not exactly ISO 23150:2021(E): Signal to noise ratio - detection level (A.4.7), but SNR can be calculated from this signal. Further detail please refer to the DSP Location Interface definition";
CM_ SG_ 273 RFC_Loc028_AzimuthalPartnerId "Id of the azimuthal partner location";
CM_ SG_ 273 RFC_Loc029_RadialDistance "Location radial distance. Represented in conical coordinate system. Same as ISO 23150:2021(E): Position radial distance (A.4.16)";
CM_ SG_ 273 RFC_Loc029_RadialVelocity "Location radial relative velocity ISO 23150:2021(E): Relative velocity {radial distance} (A.4.18)";
CM_ SG_ 273 RFC_Loc029_Elevation "Location elevation angle. Represented in conical coordinate system. Same as ISO 23150:2021(E): Position elevation (A.4.16)";
CM_ SG_ 273 RFC_Loc029_Azimuth "Location azimuth angle. Represented in conical coordinate system. Deviation from ISO 23150:2021(E): Position azimuth (A.4.16). Further details refers to DSP Location Interface definition";
CM_ SG_ 273 RFC_Loc029_DistVelocityCoVnce "Covariance of radial distance and radial velocity";
CM_ SG_ 273 RFC_Loc029_RadialDistanceVnce "Variance of Location radial distance ISO 23150:2021(E): Position radial distance - error (A.4.17)";
CM_ SG_ 273 RFC_Loc029_RadialVelocityVnce "Variance of Location radial relative velocity ISO 23150:2021(E): Relative velocity {radial distance} - error (A.4.19)";
CM_ SG_ 273 RFC_Loc029_ElevationVnce "Variance of Location elevation angle ISO 23150:2021(E): Position elevation - error (A.4.17)";
CM_ SG_ 273 RFC_Loc029_AzimuthVnce "Variance of Location azimuth angle ISO 23150:2021(E): Position azimuth - error (A.4.17)";
CM_ SG_ 273 RFC_Loc029_RadarCrossSection "Radar Cross Section (RCS) estimation ISO 23150:2021(E): Radar cross section (A.4.5)";
CM_ SG_ 273 RFC_Loc029_DistVelocityQuality "Quality of radial distance and velocity resolution processing. Physical range [0..1]";
CM_ SG_ 273 RFC_Loc029_ElevationQuality "Probability for correct signal model (elevation angle). Physical range [0..1]";
CM_ SG_ 273 RFC_Loc029_AzimuthQuality "Probability for correct signal model (azimuth angle). Physical range [0..1]";
CM_ SG_ 273 RFC_Loc029_RSSI "Received Signal Strength Indication (RSSI). This signal is not exactly ISO 23150:2021(E): Signal to noise ratio - detection level (A.4.7), but SNR can be calculated from this signal. Further detail please refer to the DSP Location Interface definition";
CM_ SG_ 273 RFC_Loc029_AzimuthalPartnerId "Id of the azimuthal partner location";
CM_ SG_ 274 RFC_Loc030_032_CRC "CRC - Autosar E2E Profile 5";
CM_ SG_ 274 RFC_Loc030_032_AliveCtr "Alive counter - Autosar E2E Profile 5";
CM_ SG_ 274 RFC_Loc030_032_ProtBlockCtr "Protocol-Signal: Block-Counter";
CM_ SG_ 274 RFC_Loc030_RadialDistance "Location radial distance. Represented in conical coordinate system. Same as ISO 23150:2021(E): Position radial distance (A.4.16)";
CM_ SG_ 274 RFC_Loc030_RadialVelocity "Location radial relative velocity ISO 23150:2021(E): Relative velocity {radial distance} (A.4.18)";
CM_ SG_ 274 RFC_Loc030_Elevation "Location elevation angle. Represented in conical coordinate system. Same as ISO 23150:2021(E): Position elevation (A.4.16)";
CM_ SG_ 274 RFC_Loc030_Azimuth "Location azimuth angle. Represented in conical coordinate system. Deviation from ISO 23150:2021(E): Position azimuth (A.4.16). Further details refers to DSP Location Interface definition";
CM_ SG_ 274 RFC_Loc030_DistVelocityCoVnce "Covariance of radial distance and radial velocity";
CM_ SG_ 274 RFC_Loc030_RadialDistanceVnce "Variance of Location radial distance ISO 23150:2021(E): Position radial distance - error (A.4.17)";
CM_ SG_ 274 RFC_Loc030_RadialVelocityVnce "Variance of Location radial relative velocity ISO 23150:2021(E): Relative velocity {radial distance} - error (A.4.19)";
CM_ SG_ 274 RFC_Loc030_ElevationVnce "Variance of Location elevation angle ISO 23150:2021(E): Position elevation - error (A.4.17)";
CM_ SG_ 274 RFC_Loc030_AzimuthVnce "Variance of Location azimuth angle ISO 23150:2021(E): Position azimuth - error (A.4.17)";
CM_ SG_ 274 RFC_Loc030_RadarCrossSection "Radar Cross Section (RCS) estimation ISO 23150:2021(E): Radar cross section (A.4.5)";
CM_ SG_ 274 RFC_Loc030_DistVelocityQuality "Quality of radial distance and velocity resolution processing. Physical range [0..1]";
CM_ SG_ 274 RFC_Loc030_ElevationQuality "Probability for correct signal model (elevation angle). Physical range [0..1]";
CM_ SG_ 274 RFC_Loc030_AzimuthQuality "Probability for correct signal model (azimuth angle). Physical range [0..1]";
CM_ SG_ 274 RFC_Loc030_RSSI "Received Signal Strength Indication (RSSI). This signal is not exactly ISO 23150:2021(E): Signal to noise ratio - detection level (A.4.7), but SNR can be calculated from this signal. Further detail please refer to the DSP Location Interface definition";
CM_ SG_ 274 RFC_Loc030_AzimuthalPartnerId "Id of the azimuthal partner location";
CM_ SG_ 274 RFC_Loc031_RadialDistance "Location radial distance. Represented in conical coordinate system. Same as ISO 23150:2021(E): Position radial distance (A.4.16)";
CM_ SG_ 274 RFC_Loc031_RadialVelocity "Location radial relative velocity ISO 23150:2021(E): Relative velocity {radial distance} (A.4.18)";
CM_ SG_ 274 RFC_Loc031_Elevation "Location elevation angle. Represented in conical coordinate system. Same as ISO 23150:2021(E): Position elevation (A.4.16)";
CM_ SG_ 274 RFC_Loc031_Azimuth "Location azimuth angle. Represented in conical coordinate system. Deviation from ISO 23150:2021(E): Position azimuth (A.4.16). Further details refers to DSP Location Interface definition";
CM_ SG_ 274 RFC_Loc031_DistVelocityCoVnce "Covariance of radial distance and radial velocity";
CM_ SG_ 274 RFC_Loc031_RadialDistanceVnce "Variance of Location radial distance ISO 23150:2021(E): Position radial distance - error (A.4.17)";
CM_ SG_ 274 RFC_Loc031_RadialVelocityVnce "Variance of Location radial relative velocity ISO 23150:2021(E): Relative velocity {radial distance} - error (A.4.19)";
CM_ SG_ 274 RFC_Loc031_ElevationVnce "Variance of Location elevation angle ISO 23150:2021(E): Position elevation - error (A.4.17)";
CM_ SG_ 274 RFC_Loc031_AzimuthVnce "Variance of Location azimuth angle ISO 23150:2021(E): Position azimuth - error (A.4.17)";
CM_ SG_ 274 RFC_Loc031_RadarCrossSection "Radar Cross Section (RCS) estimation ISO 23150:2021(E): Radar cross section (A.4.5)";
CM_ SG_ 274 RFC_Loc031_DistVelocityQuality "Quality of radial distance and velocity resolution processing. Physical range [0..1]";
CM_ SG_ 274 RFC_Loc031_ElevationQuality "Probability for correct signal model (elevation angle). Physical range [0..1]";
CM_ SG_ 274 RFC_Loc031_AzimuthQuality "Probability for correct signal model (azimuth angle). Physical range [0..1]";
CM_ SG_ 274 RFC_Loc031_RSSI "Received Signal Strength Indication (RSSI). This signal is not exactly ISO 23150:2021(E): Signal to noise ratio - detection level (A.4.7), but SNR can be calculated from this signal. Further detail please refer to the DSP Location Interface definition";
CM_ SG_ 274 RFC_Loc031_AzimuthalPartnerId "Id of the azimuthal partner location";
CM_ SG_ 274 RFC_Loc032_RadialDistance "Location radial distance. Represented in conical coordinate system. Same as ISO 23150:2021(E): Position radial distance (A.4.16)";
CM_ SG_ 274 RFC_Loc032_RadialVelocity "Location radial relative velocity ISO 23150:2021(E): Relative velocity {radial distance} (A.4.18)";
CM_ SG_ 274 RFC_Loc032_Elevation "Location elevation angle. Represented in conical coordinate system. Same as ISO 23150:2021(E): Position elevation (A.4.16)";
CM_ SG_ 274 RFC_Loc032_Azimuth "Location azimuth angle. Represented in conical coordinate system. Deviation from ISO 23150:2021(E): Position azimuth (A.4.16). Further details refers to DSP Location Interface definition";
CM_ SG_ 274 RFC_Loc032_DistVelocityCoVnce "Covariance of radial distance and radial velocity";
CM_ SG_ 274 RFC_Loc032_RadialDistanceVnce "Variance of Location radial distance ISO 23150:2021(E): Position radial distance - error (A.4.17)";
CM_ SG_ 274 RFC_Loc032_RadialVelocityVnce "Variance of Location radial relative velocity ISO 23150:2021(E): Relative velocity {radial distance} - error (A.4.19)";
CM_ SG_ 274 RFC_Loc032_ElevationVnce "Variance of Location elevation angle ISO 23150:2021(E): Position elevation - error (A.4.17)";
CM_ SG_ 274 RFC_Loc032_AzimuthVnce "Variance of Location azimuth angle ISO 23150:2021(E): Position azimuth - error (A.4.17)";
CM_ SG_ 274 RFC_Loc032_RadarCrossSection "Radar Cross Section (RCS) estimation ISO 23150:2021(E): Radar cross section (A.4.5)";
CM_ SG_ 274 RFC_Loc032_DistVelocityQuality "Quality of radial distance and velocity resolution processing. Physical range [0..1]";
CM_ SG_ 274 RFC_Loc032_ElevationQuality "Probability for correct signal model (elevation angle). Physical range [0..1]";
CM_ SG_ 274 RFC_Loc032_AzimuthQuality "Probability for correct signal model (azimuth angle). Physical range [0..1]";
CM_ SG_ 274 RFC_Loc032_RSSI "Received Signal Strength Indication (RSSI). This signal is not exactly ISO 23150:2021(E): Signal to noise ratio - detection level (A.4.7), but SNR can be calculated from this signal. Further detail please refer to the DSP Location Interface definition";
CM_ SG_ 274 RFC_Loc032_AzimuthalPartnerId "Id of the azimuthal partner location";
CM_ SG_ 275 RFC_Loc033_035_CRC "CRC - Autosar E2E Profile 5";
CM_ SG_ 275 RFC_Loc033_035_AliveCtr "Alive counter - Autosar E2E Profile 5";
CM_ SG_ 275 RFC_Loc033_035_ProtBlockCtr "Protocol-Signal: Block-Counter";
CM_ SG_ 275 RFC_Loc033_RadialDistance "Location radial distance. Represented in conical coordinate system. Same as ISO 23150:2021(E): Position radial distance (A.4.16)";
CM_ SG_ 275 RFC_Loc033_RadialVelocity "Location radial relative velocity ISO 23150:2021(E): Relative velocity {radial distance} (A.4.18)";
CM_ SG_ 275 RFC_Loc033_Elevation "Location elevation angle. Represented in conical coordinate system. Same as ISO 23150:2021(E): Position elevation (A.4.16)";
CM_ SG_ 275 RFC_Loc033_Azimuth "Location azimuth angle. Represented in conical coordinate system. Deviation from ISO 23150:2021(E): Position azimuth (A.4.16). Further details refers to DSP Location Interface definition";
CM_ SG_ 275 RFC_Loc033_DistVelocityCoVnce "Covariance of radial distance and radial velocity";
CM_ SG_ 275 RFC_Loc033_RadialDistanceVnce "Variance of Location radial distance ISO 23150:2021(E): Position radial distance - error (A.4.17)";
CM_ SG_ 275 RFC_Loc033_RadialVelocityVnce "Variance of Location radial relative velocity ISO 23150:2021(E): Relative velocity {radial distance} - error (A.4.19)";
CM_ SG_ 275 RFC_Loc033_ElevationVnce "Variance of Location elevation angle ISO 23150:2021(E): Position elevation - error (A.4.17)";
CM_ SG_ 275 RFC_Loc033_AzimuthVnce "Variance of Location azimuth angle ISO 23150:2021(E): Position azimuth - error (A.4.17)";
CM_ SG_ 275 RFC_Loc033_RadarCrossSection "Radar Cross Section (RCS) estimation ISO 23150:2021(E): Radar cross section (A.4.5)";
CM_ SG_ 275 RFC_Loc033_DistVelocityQuality "Quality of radial distance and velocity resolution processing. Physical range [0..1]";
CM_ SG_ 275 RFC_Loc033_ElevationQuality "Probability for correct signal model (elevation angle). Physical range [0..1]";
CM_ SG_ 275 RFC_Loc033_AzimuthQuality "Probability for correct signal model (azimuth angle). Physical range [0..1]";
CM_ SG_ 275 RFC_Loc033_RSSI "Received Signal Strength Indication (RSSI). This signal is not exactly ISO 23150:2021(E): Signal to noise ratio - detection level (A.4.7), but SNR can be calculated from this signal. Further detail please refer to the DSP Location Interface definition";
CM_ SG_ 275 RFC_Loc033_AzimuthalPartnerId "Id of the azimuthal partner location";
CM_ SG_ 275 RFC_Loc034_RadialDistance "Location radial distance. Represented in conical coordinate system. Same as ISO 23150:2021(E): Position radial distance (A.4.16)";
CM_ SG_ 275 RFC_Loc034_RadialVelocity "Location radial relative velocity ISO 23150:2021(E): Relative velocity {radial distance} (A.4.18)";
CM_ SG_ 275 RFC_Loc034_Elevation "Location elevation angle. Represented in conical coordinate system. Same as ISO 23150:2021(E): Position elevation (A.4.16)";
CM_ SG_ 275 RFC_Loc034_Azimuth "Location azimuth angle. Represented in conical coordinate system. Deviation from ISO 23150:2021(E): Position azimuth (A.4.16). Further details refers to DSP Location Interface definition";
CM_ SG_ 275 RFC_Loc034_DistVelocityCoVnce "Covariance of radial distance and radial velocity";
CM_ SG_ 275 RFC_Loc034_RadialDistanceVnce "Variance of Location radial distance ISO 23150:2021(E): Position radial distance - error (A.4.17)";
CM_ SG_ 275 RFC_Loc034_RadialVelocityVnce "Variance of Location radial relative velocity ISO 23150:2021(E): Relative velocity {radial distance} - error (A.4.19)";
CM_ SG_ 275 RFC_Loc034_ElevationVnce "Variance of Location elevation angle ISO 23150:2021(E): Position elevation - error (A.4.17)";
CM_ SG_ 275 RFC_Loc034_AzimuthVnce "Variance of Location azimuth angle ISO 23150:2021(E): Position azimuth - error (A.4.17)";
CM_ SG_ 275 RFC_Loc034_RadarCrossSection "Radar Cross Section (RCS) estimation ISO 23150:2021(E): Radar cross section (A.4.5)";
CM_ SG_ 275 RFC_Loc034_DistVelocityQuality "Quality of radial distance and velocity resolution processing. Physical range [0..1]";
CM_ SG_ 275 RFC_Loc034_ElevationQuality "Probability for correct signal model (elevation angle). Physical range [0..1]";
CM_ SG_ 275 RFC_Loc034_AzimuthQuality "Probability for correct signal model (azimuth angle). Physical range [0..1]";
CM_ SG_ 275 RFC_Loc034_RSSI "Received Signal Strength Indication (RSSI). This signal is not exactly ISO 23150:2021(E): Signal to noise ratio - detection level (A.4.7), but SNR can be calculated from this signal. Further detail please refer to the DSP Location Interface definition";
CM_ SG_ 275 RFC_Loc034_AzimuthalPartnerId "Id of the azimuthal partner location";
CM_ SG_ 275 RFC_Loc035_RadialDistance "Location radial distance. Represented in conical coordinate system. Same as ISO 23150:2021(E): Position radial distance (A.4.16)";
CM_ SG_ 275 RFC_Loc035_RadialVelocity "Location radial relative velocity ISO 23150:2021(E): Relative velocity {radial distance} (A.4.18)";
CM_ SG_ 275 RFC_Loc035_Elevation "Location elevation angle. Represented in conical coordinate system. Same as ISO 23150:2021(E): Position elevation (A.4.16)";
CM_ SG_ 275 RFC_Loc035_Azimuth "Location azimuth angle. Represented in conical coordinate system. Deviation from ISO 23150:2021(E): Position azimuth (A.4.16). Further details refers to DSP Location Interface definition";
CM_ SG_ 275 RFC_Loc035_DistVelocityCoVnce "Covariance of radial distance and radial velocity";
CM_ SG_ 275 RFC_Loc035_RadialDistanceVnce "Variance of Location radial distance ISO 23150:2021(E): Position radial distance - error (A.4.17)";
CM_ SG_ 275 RFC_Loc035_RadialVelocityVnce "Variance of Location radial relative velocity ISO 23150:2021(E): Relative velocity {radial distance} - error (A.4.19)";
CM_ SG_ 275 RFC_Loc035_ElevationVnce "Variance of Location elevation angle ISO 23150:2021(E): Position elevation - error (A.4.17)";
CM_ SG_ 275 RFC_Loc035_AzimuthVnce "Variance of Location azimuth angle ISO 23150:2021(E): Position azimuth - error (A.4.17)";
CM_ SG_ 275 RFC_Loc035_RadarCrossSection "Radar Cross Section (RCS) estimation ISO 23150:2021(E): Radar cross section (A.4.5)";
CM_ SG_ 275 RFC_Loc035_DistVelocityQuality "Quality of radial distance and velocity resolution processing. Physical range [0..1]";
CM_ SG_ 275 RFC_Loc035_ElevationQuality "Probability for correct signal model (elevation angle). Physical range [0..1]";
CM_ SG_ 275 RFC_Loc035_AzimuthQuality "Probability for correct signal model (azimuth angle). Physical range [0..1]";
CM_ SG_ 275 RFC_Loc035_RSSI "Received Signal Strength Indication (RSSI). This signal is not exactly ISO 23150:2021(E): Signal to noise ratio - detection level (A.4.7), but SNR can be calculated from this signal. Further detail please refer to the DSP Location Interface definition";
CM_ SG_ 275 RFC_Loc035_AzimuthalPartnerId "Id of the azimuthal partner location";
CM_ SG_ 276 RFC_Loc036_038_CRC "CRC - Autosar E2E Profile 5";
CM_ SG_ 276 RFC_Loc036_038_AliveCtr "Alive counter - Autosar E2E Profile 5";
CM_ SG_ 276 RFC_Loc036_038_ProtBlockCtr "Protocol-Signal: Block-Counter";
CM_ SG_ 276 RFC_Loc036_RadialDistance "Location radial distance. Represented in conical coordinate system. Same as ISO 23150:2021(E): Position radial distance (A.4.16)";
CM_ SG_ 276 RFC_Loc036_RadialVelocity "Location radial relative velocity ISO 23150:2021(E): Relative velocity {radial distance} (A.4.18)";
CM_ SG_ 276 RFC_Loc036_Elevation "Location elevation angle. Represented in conical coordinate system. Same as ISO 23150:2021(E): Position elevation (A.4.16)";
CM_ SG_ 276 RFC_Loc036_Azimuth "Location azimuth angle. Represented in conical coordinate system. Deviation from ISO 23150:2021(E): Position azimuth (A.4.16). Further details refers to DSP Location Interface definition";
CM_ SG_ 276 RFC_Loc036_DistVelocityCoVnce "Covariance of radial distance and radial velocity";
CM_ SG_ 276 RFC_Loc036_RadialDistanceVnce "Variance of Location radial distance ISO 23150:2021(E): Position radial distance - error (A.4.17)";
CM_ SG_ 276 RFC_Loc036_RadialVelocityVnce "Variance of Location radial relative velocity ISO 23150:2021(E): Relative velocity {radial distance} - error (A.4.19)";
CM_ SG_ 276 RFC_Loc036_ElevationVnce "Variance of Location elevation angle ISO 23150:2021(E): Position elevation - error (A.4.17)";
CM_ SG_ 276 RFC_Loc036_AzimuthVnce "Variance of Location azimuth angle ISO 23150:2021(E): Position azimuth - error (A.4.17)";
CM_ SG_ 276 RFC_Loc036_RadarCrossSection "Radar Cross Section (RCS) estimation ISO 23150:2021(E): Radar cross section (A.4.5)";
CM_ SG_ 276 RFC_Loc036_DistVelocityQuality "Quality of radial distance and velocity resolution processing. Physical range [0..1]";
CM_ SG_ 276 RFC_Loc036_ElevationQuality "Probability for correct signal model (elevation angle). Physical range [0..1]";
CM_ SG_ 276 RFC_Loc036_AzimuthQuality "Probability for correct signal model (azimuth angle). Physical range [0..1]";
CM_ SG_ 276 RFC_Loc036_RSSI "Received Signal Strength Indication (RSSI). This signal is not exactly ISO 23150:2021(E): Signal to noise ratio - detection level (A.4.7), but SNR can be calculated from this signal. Further detail please refer to the DSP Location Interface definition";
CM_ SG_ 276 RFC_Loc036_AzimuthalPartnerId "Id of the azimuthal partner location";
CM_ SG_ 276 RFC_Loc037_RadialDistance "Location radial distance. Represented in conical coordinate system. Same as ISO 23150:2021(E): Position radial distance (A.4.16)";
CM_ SG_ 276 RFC_Loc037_RadialVelocity "Location radial relative velocity ISO 23150:2021(E): Relative velocity {radial distance} (A.4.18)";
CM_ SG_ 276 RFC_Loc037_Elevation "Location elevation angle. Represented in conical coordinate system. Same as ISO 23150:2021(E): Position elevation (A.4.16)";
CM_ SG_ 276 RFC_Loc037_Azimuth "Location azimuth angle. Represented in conical coordinate system. Deviation from ISO 23150:2021(E): Position azimuth (A.4.16). Further details refers to DSP Location Interface definition";
CM_ SG_ 276 RFC_Loc037_DistVelocityCoVnce "Covariance of radial distance and radial velocity";
CM_ SG_ 276 RFC_Loc037_RadialDistanceVnce "Variance of Location radial distance ISO 23150:2021(E): Position radial distance - error (A.4.17)";
CM_ SG_ 276 RFC_Loc037_RadialVelocityVnce "Variance of Location radial relative velocity ISO 23150:2021(E): Relative velocity {radial distance} - error (A.4.19)";
CM_ SG_ 276 RFC_Loc037_ElevationVnce "Variance of Location elevation angle ISO 23150:2021(E): Position elevation - error (A.4.17)";
CM_ SG_ 276 RFC_Loc037_AzimuthVnce "Variance of Location azimuth angle ISO 23150:2021(E): Position azimuth - error (A.4.17)";
CM_ SG_ 276 RFC_Loc037_RadarCrossSection "Radar Cross Section (RCS) estimation ISO 23150:2021(E): Radar cross section (A.4.5)";
CM_ SG_ 276 RFC_Loc037_DistVelocityQuality "Quality of radial distance and velocity resolution processing. Physical range [0..1]";
CM_ SG_ 276 RFC_Loc037_ElevationQuality "Probability for correct signal model (elevation angle). Physical range [0..1]";
CM_ SG_ 276 RFC_Loc037_AzimuthQuality "Probability for correct signal model (azimuth angle). Physical range [0..1]";
CM_ SG_ 276 RFC_Loc037_RSSI "Received Signal Strength Indication (RSSI). This signal is not exactly ISO 23150:2021(E): Signal to noise ratio - detection level (A.4.7), but SNR can be calculated from this signal. Further detail please refer to the DSP Location Interface definition";
CM_ SG_ 276 RFC_Loc037_AzimuthalPartnerId "Id of the azimuthal partner location";
CM_ SG_ 276 RFC_Loc038_RadialDistance "Location radial distance. Represented in conical coordinate system. Same as ISO 23150:2021(E): Position radial distance (A.4.16)";
CM_ SG_ 276 RFC_Loc038_RadialVelocity "Location radial relative velocity ISO 23150:2021(E): Relative velocity {radial distance} (A.4.18)";
CM_ SG_ 276 RFC_Loc038_Elevation "Location elevation angle. Represented in conical coordinate system. Same as ISO 23150:2021(E): Position elevation (A.4.16)";
CM_ SG_ 276 RFC_Loc038_Azimuth "Location azimuth angle. Represented in conical coordinate system. Deviation from ISO 23150:2021(E): Position azimuth (A.4.16). Further details refers to DSP Location Interface definition";
CM_ SG_ 276 RFC_Loc038_DistVelocityCoVnce "Covariance of radial distance and radial velocity";
CM_ SG_ 276 RFC_Loc038_RadialDistanceVnce "Variance of Location radial distance ISO 23150:2021(E): Position radial distance - error (A.4.17)";
CM_ SG_ 276 RFC_Loc038_RadialVelocityVnce "Variance of Location radial relative velocity ISO 23150:2021(E): Relative velocity {radial distance} - error (A.4.19)";
CM_ SG_ 276 RFC_Loc038_ElevationVnce "Variance of Location elevation angle ISO 23150:2021(E): Position elevation - error (A.4.17)";
CM_ SG_ 276 RFC_Loc038_AzimuthVnce "Variance of Location azimuth angle ISO 23150:2021(E): Position azimuth - error (A.4.17)";
CM_ SG_ 276 RFC_Loc038_RadarCrossSection "Radar Cross Section (RCS) estimation ISO 23150:2021(E): Radar cross section (A.4.5)";
CM_ SG_ 276 RFC_Loc038_DistVelocityQuality "Quality of radial distance and velocity resolution processing. Physical range [0..1]";
CM_ SG_ 276 RFC_Loc038_ElevationQuality "Probability for correct signal model (elevation angle). Physical range [0..1]";
CM_ SG_ 276 RFC_Loc038_AzimuthQuality "Probability for correct signal model (azimuth angle). Physical range [0..1]";
CM_ SG_ 276 RFC_Loc038_RSSI "Received Signal Strength Indication (RSSI). This signal is not exactly ISO 23150:2021(E): Signal to noise ratio - detection level (A.4.7), but SNR can be calculated from this signal. Further detail please refer to the DSP Location Interface definition";
CM_ SG_ 276 RFC_Loc038_AzimuthalPartnerId "Id of the azimuthal partner location";
CM_ SG_ 277 RFC_Loc039_041_CRC "CRC - Autosar E2E Profile 5";
CM_ SG_ 277 RFC_Loc039_041_AliveCtr "Alive counter - Autosar E2E Profile 5";
CM_ SG_ 277 RFC_Loc039_041_ProtBlockCtr "Protocol-Signal: Block-Counter";
CM_ SG_ 277 RFC_Loc039_RadialDistance "Location radial distance. Represented in conical coordinate system. Same as ISO 23150:2021(E): Position radial distance (A.4.16)";
CM_ SG_ 277 RFC_Loc039_RadialVelocity "Location radial relative velocity ISO 23150:2021(E): Relative velocity {radial distance} (A.4.18)";
CM_ SG_ 277 RFC_Loc039_Elevation "Location elevation angle. Represented in conical coordinate system. Same as ISO 23150:2021(E): Position elevation (A.4.16)";
CM_ SG_ 277 RFC_Loc039_Azimuth "Location azimuth angle. Represented in conical coordinate system. Deviation from ISO 23150:2021(E): Position azimuth (A.4.16). Further details refers to DSP Location Interface definition";
CM_ SG_ 277 RFC_Loc039_DistVelocityCoVnce "Covariance of radial distance and radial velocity";
CM_ SG_ 277 RFC_Loc039_RadialDistanceVnce "Variance of Location radial distance ISO 23150:2021(E): Position radial distance - error (A.4.17)";
CM_ SG_ 277 RFC_Loc039_RadialVelocityVnce "Variance of Location radial relative velocity ISO 23150:2021(E): Relative velocity {radial distance} - error (A.4.19)";
CM_ SG_ 277 RFC_Loc039_ElevationVnce "Variance of Location elevation angle ISO 23150:2021(E): Position elevation - error (A.4.17)";
CM_ SG_ 277 RFC_Loc039_AzimuthVnce "Variance of Location azimuth angle ISO 23150:2021(E): Position azimuth - error (A.4.17)";
CM_ SG_ 277 RFC_Loc039_RadarCrossSection "Radar Cross Section (RCS) estimation ISO 23150:2021(E): Radar cross section (A.4.5)";
CM_ SG_ 277 RFC_Loc039_DistVelocityQuality "Quality of radial distance and velocity resolution processing. Physical range [0..1]";
CM_ SG_ 277 RFC_Loc039_ElevationQuality "Probability for correct signal model (elevation angle). Physical range [0..1]";
CM_ SG_ 277 RFC_Loc039_AzimuthQuality "Probability for correct signal model (azimuth angle). Physical range [0..1]";
CM_ SG_ 277 RFC_Loc039_RSSI "Received Signal Strength Indication (RSSI). This signal is not exactly ISO 23150:2021(E): Signal to noise ratio - detection level (A.4.7), but SNR can be calculated from this signal. Further detail please refer to the DSP Location Interface definition";
CM_ SG_ 277 RFC_Loc039_AzimuthalPartnerId "Id of the azimuthal partner location";
CM_ SG_ 277 RFC_Loc040_RadialDistance "Location radial distance. Represented in conical coordinate system. Same as ISO 23150:2021(E): Position radial distance (A.4.16)";
CM_ SG_ 277 RFC_Loc040_RadialVelocity "Location radial relative velocity ISO 23150:2021(E): Relative velocity {radial distance} (A.4.18)";
CM_ SG_ 277 RFC_Loc040_Elevation "Location elevation angle. Represented in conical coordinate system. Same as ISO 23150:2021(E): Position elevation (A.4.16)";
CM_ SG_ 277 RFC_Loc040_Azimuth "Location azimuth angle. Represented in conical coordinate system. Deviation from ISO 23150:2021(E): Position azimuth (A.4.16). Further details refers to DSP Location Interface definition";
CM_ SG_ 277 RFC_Loc040_DistVelocityCoVnce "Covariance of radial distance and radial velocity";
CM_ SG_ 277 RFC_Loc040_RadialDistanceVnce "Variance of Location radial distance ISO 23150:2021(E): Position radial distance - error (A.4.17)";
CM_ SG_ 277 RFC_Loc040_RadialVelocityVnce "Variance of Location radial relative velocity ISO 23150:2021(E): Relative velocity {radial distance} - error (A.4.19)";
CM_ SG_ 277 RFC_Loc040_ElevationVnce "Variance of Location elevation angle ISO 23150:2021(E): Position elevation - error (A.4.17)";
CM_ SG_ 277 RFC_Loc040_AzimuthVnce "Variance of Location azimuth angle ISO 23150:2021(E): Position azimuth - error (A.4.17)";
CM_ SG_ 277 RFC_Loc040_RadarCrossSection "Radar Cross Section (RCS) estimation ISO 23150:2021(E): Radar cross section (A.4.5)";
CM_ SG_ 277 RFC_Loc040_DistVelocityQuality "Quality of radial distance and velocity resolution processing. Physical range [0..1]";
CM_ SG_ 277 RFC_Loc040_ElevationQuality "Probability for correct signal model (elevation angle). Physical range [0..1]";
CM_ SG_ 277 RFC_Loc040_AzimuthQuality "Probability for correct signal model (azimuth angle). Physical range [0..1]";
CM_ SG_ 277 RFC_Loc040_RSSI "Received Signal Strength Indication (RSSI). This signal is not exactly ISO 23150:2021(E): Signal to noise ratio - detection level (A.4.7), but SNR can be calculated from this signal. Further detail please refer to the DSP Location Interface definition";
CM_ SG_ 277 RFC_Loc040_AzimuthalPartnerId "Id of the azimuthal partner location";
CM_ SG_ 277 RFC_Loc041_RadialDistance "Location radial distance. Represented in conical coordinate system. Same as ISO 23150:2021(E): Position radial distance (A.4.16)";
CM_ SG_ 277 RFC_Loc041_RadialVelocity "Location radial relative velocity ISO 23150:2021(E): Relative velocity {radial distance} (A.4.18)";
CM_ SG_ 277 RFC_Loc041_Elevation "Location elevation angle. Represented in conical coordinate system. Same as ISO 23150:2021(E): Position elevation (A.4.16)";
CM_ SG_ 277 RFC_Loc041_Azimuth "Location azimuth angle. Represented in conical coordinate system. Deviation from ISO 23150:2021(E): Position azimuth (A.4.16). Further details refers to DSP Location Interface definition";
CM_ SG_ 277 RFC_Loc041_DistVelocityCoVnce "Covariance of radial distance and radial velocity";
CM_ SG_ 277 RFC_Loc041_RadialDistanceVnce "Variance of Location radial distance ISO 23150:2021(E): Position radial distance - error (A.4.17)";
CM_ SG_ 277 RFC_Loc041_RadialVelocityVnce "Variance of Location radial relative velocity ISO 23150:2021(E): Relative velocity {radial distance} - error (A.4.19)";
CM_ SG_ 277 RFC_Loc041_ElevationVnce "Variance of Location elevation angle ISO 23150:2021(E): Position elevation - error (A.4.17)";
CM_ SG_ 277 RFC_Loc041_AzimuthVnce "Variance of Location azimuth angle ISO 23150:2021(E): Position azimuth - error (A.4.17)";
CM_ SG_ 277 RFC_Loc041_RadarCrossSection "Radar Cross Section (RCS) estimation ISO 23150:2021(E): Radar cross section (A.4.5)";
CM_ SG_ 277 RFC_Loc041_DistVelocityQuality "Quality of radial distance and velocity resolution processing. Physical range [0..1]";
CM_ SG_ 277 RFC_Loc041_ElevationQuality "Probability for correct signal model (elevation angle). Physical range [0..1]";
CM_ SG_ 277 RFC_Loc041_AzimuthQuality "Probability for correct signal model (azimuth angle). Physical range [0..1]";
CM_ SG_ 277 RFC_Loc041_RSSI "Received Signal Strength Indication (RSSI). This signal is not exactly ISO 23150:2021(E): Signal to noise ratio - detection level (A.4.7), but SNR can be calculated from this signal. Further detail please refer to the DSP Location Interface definition";
CM_ SG_ 277 RFC_Loc041_AzimuthalPartnerId "Id of the azimuthal partner location";
CM_ SG_ 278 RFC_Loc042_044_CRC "CRC - Autosar E2E Profile 5";
CM_ SG_ 278 RFC_Loc042_044_AliveCtr "Alive counter - Autosar E2E Profile 5";
CM_ SG_ 278 RFC_Loc042_044_ProtBlockCtr "Protocol-Signal: Block-Counter";
CM_ SG_ 278 RFC_Loc042_RadialDistance "Location radial distance. Represented in conical coordinate system. Same as ISO 23150:2021(E): Position radial distance (A.4.16)";
CM_ SG_ 278 RFC_Loc042_RadialVelocity "Location radial relative velocity ISO 23150:2021(E): Relative velocity {radial distance} (A.4.18)";
CM_ SG_ 278 RFC_Loc042_Elevation "Location elevation angle. Represented in conical coordinate system. Same as ISO 23150:2021(E): Position elevation (A.4.16)";
CM_ SG_ 278 RFC_Loc042_Azimuth "Location azimuth angle. Represented in conical coordinate system. Deviation from ISO 23150:2021(E): Position azimuth (A.4.16). Further details refers to DSP Location Interface definition";
CM_ SG_ 278 RFC_Loc042_DistVelocityCoVnce "Covariance of radial distance and radial velocity";
CM_ SG_ 278 RFC_Loc042_RadialDistanceVnce "Variance of Location radial distance ISO 23150:2021(E): Position radial distance - error (A.4.17)";
CM_ SG_ 278 RFC_Loc042_RadialVelocityVnce "Variance of Location radial relative velocity ISO 23150:2021(E): Relative velocity {radial distance} - error (A.4.19)";
CM_ SG_ 278 RFC_Loc042_ElevationVnce "Variance of Location elevation angle ISO 23150:2021(E): Position elevation - error (A.4.17)";
CM_ SG_ 278 RFC_Loc042_AzimuthVnce "Variance of Location azimuth angle ISO 23150:2021(E): Position azimuth - error (A.4.17)";
CM_ SG_ 278 RFC_Loc042_RadarCrossSection "Radar Cross Section (RCS) estimation ISO 23150:2021(E): Radar cross section (A.4.5)";
CM_ SG_ 278 RFC_Loc042_DistVelocityQuality "Quality of radial distance and velocity resolution processing. Physical range [0..1]";
CM_ SG_ 278 RFC_Loc042_ElevationQuality "Probability for correct signal model (elevation angle). Physical range [0..1]";
CM_ SG_ 278 RFC_Loc042_AzimuthQuality "Probability for correct signal model (azimuth angle). Physical range [0..1]";
CM_ SG_ 278 RFC_Loc042_RSSI "Received Signal Strength Indication (RSSI). This signal is not exactly ISO 23150:2021(E): Signal to noise ratio - detection level (A.4.7), but SNR can be calculated from this signal. Further detail please refer to the DSP Location Interface definition";
CM_ SG_ 278 RFC_Loc042_AzimuthalPartnerId "Id of the azimuthal partner location";
CM_ SG_ 278 RFC_Loc043_RadialDistance "Location radial distance. Represented in conical coordinate system. Same as ISO 23150:2021(E): Position radial distance (A.4.16)";
CM_ SG_ 278 RFC_Loc043_RadialVelocity "Location radial relative velocity ISO 23150:2021(E): Relative velocity {radial distance} (A.4.18)";
CM_ SG_ 278 RFC_Loc043_Elevation "Location elevation angle. Represented in conical coordinate system. Same as ISO 23150:2021(E): Position elevation (A.4.16)";
CM_ SG_ 278 RFC_Loc043_Azimuth "Location azimuth angle. Represented in conical coordinate system. Deviation from ISO 23150:2021(E): Position azimuth (A.4.16). Further details refers to DSP Location Interface definition";
CM_ SG_ 278 RFC_Loc043_DistVelocityCoVnce "Covariance of radial distance and radial velocity";
CM_ SG_ 278 RFC_Loc043_RadialDistanceVnce "Variance of Location radial distance ISO 23150:2021(E): Position radial distance - error (A.4.17)";
CM_ SG_ 278 RFC_Loc043_RadialVelocityVnce "Variance of Location radial relative velocity ISO 23150:2021(E): Relative velocity {radial distance} - error (A.4.19)";
CM_ SG_ 278 RFC_Loc043_ElevationVnce "Variance of Location elevation angle ISO 23150:2021(E): Position elevation - error (A.4.17)";
CM_ SG_ 278 RFC_Loc043_AzimuthVnce "Variance of Location azimuth angle ISO 23150:2021(E): Position azimuth - error (A.4.17)";
CM_ SG_ 278 RFC_Loc043_RadarCrossSection "Radar Cross Section (RCS) estimation ISO 23150:2021(E): Radar cross section (A.4.5)";
CM_ SG_ 278 RFC_Loc043_DistVelocityQuality "Quality of radial distance and velocity resolution processing. Physical range [0..1]";
CM_ SG_ 278 RFC_Loc043_ElevationQuality "Probability for correct signal model (elevation angle). Physical range [0..1]";
CM_ SG_ 278 RFC_Loc043_AzimuthQuality "Probability for correct signal model (azimuth angle). Physical range [0..1]";
CM_ SG_ 278 RFC_Loc043_RSSI "Received Signal Strength Indication (RSSI). This signal is not exactly ISO 23150:2021(E): Signal to noise ratio - detection level (A.4.7), but SNR can be calculated from this signal. Further detail please refer to the DSP Location Interface definition";
CM_ SG_ 278 RFC_Loc043_AzimuthalPartnerId "Id of the azimuthal partner location";
CM_ SG_ 278 RFC_Loc044_RadialDistance "Location radial distance. Represented in conical coordinate system. Same as ISO 23150:2021(E): Position radial distance (A.4.16)";
CM_ SG_ 278 RFC_Loc044_RadialVelocity "Location radial relative velocity ISO 23150:2021(E): Relative velocity {radial distance} (A.4.18)";
CM_ SG_ 278 RFC_Loc044_Elevation "Location elevation angle. Represented in conical coordinate system. Same as ISO 23150:2021(E): Position elevation (A.4.16)";
CM_ SG_ 278 RFC_Loc044_Azimuth "Location azimuth angle. Represented in conical coordinate system. Deviation from ISO 23150:2021(E): Position azimuth (A.4.16). Further details refers to DSP Location Interface definition";
CM_ SG_ 278 RFC_Loc044_DistVelocityCoVnce "Covariance of radial distance and radial velocity";
CM_ SG_ 278 RFC_Loc044_RadialDistanceVnce "Variance of Location radial distance ISO 23150:2021(E): Position radial distance - error (A.4.17)";
CM_ SG_ 278 RFC_Loc044_RadialVelocityVnce "Variance of Location radial relative velocity ISO 23150:2021(E): Relative velocity {radial distance} - error (A.4.19)";
CM_ SG_ 278 RFC_Loc044_ElevationVnce "Variance of Location elevation angle ISO 23150:2021(E): Position elevation - error (A.4.17)";
CM_ SG_ 278 RFC_Loc044_AzimuthVnce "Variance of Location azimuth angle ISO 23150:2021(E): Position azimuth - error (A.4.17)";
CM_ SG_ 278 RFC_Loc044_RadarCrossSection "Radar Cross Section (RCS) estimation ISO 23150:2021(E): Radar cross section (A.4.5)";
CM_ SG_ 278 RFC_Loc044_DistVelocityQuality "Quality of radial distance and velocity resolution processing. Physical range [0..1]";
CM_ SG_ 278 RFC_Loc044_ElevationQuality "Probability for correct signal model (elevation angle). Physical range [0..1]";
CM_ SG_ 278 RFC_Loc044_AzimuthQuality "Probability for correct signal model (azimuth angle). Physical range [0..1]";
CM_ SG_ 278 RFC_Loc044_RSSI "Received Signal Strength Indication (RSSI). This signal is not exactly ISO 23150:2021(E): Signal to noise ratio - detection level (A.4.7), but SNR can be calculated from this signal. Further detail please refer to the DSP Location Interface definition";
CM_ SG_ 278 RFC_Loc044_AzimuthalPartnerId "Id of the azimuthal partner location";
CM_ SG_ 279 RFC_Loc045_047_CRC "CRC - Autosar E2E Profile 5";
CM_ SG_ 279 RFC_Loc045_047_AliveCtr "Alive counter - Autosar E2E Profile 5";
CM_ SG_ 279 RFC_Loc045_047_ProtBlockCtr "Protocol-Signal: Block-Counter";
CM_ SG_ 279 RFC_Loc045_RadialDistance "Location radial distance. Represented in conical coordinate system. Same as ISO 23150:2021(E): Position radial distance (A.4.16)";
CM_ SG_ 279 RFC_Loc045_RadialVelocity "Location radial relative velocity ISO 23150:2021(E): Relative velocity {radial distance} (A.4.18)";
CM_ SG_ 279 RFC_Loc045_Elevation "Location elevation angle. Represented in conical coordinate system. Same as ISO 23150:2021(E): Position elevation (A.4.16)";
CM_ SG_ 279 RFC_Loc045_Azimuth "Location azimuth angle. Represented in conical coordinate system. Deviation from ISO 23150:2021(E): Position azimuth (A.4.16). Further details refers to DSP Location Interface definition";
CM_ SG_ 279 RFC_Loc045_DistVelocityCoVnce "Covariance of radial distance and radial velocity";
CM_ SG_ 279 RFC_Loc045_RadialDistanceVnce "Variance of Location radial distance ISO 23150:2021(E): Position radial distance - error (A.4.17)";
CM_ SG_ 279 RFC_Loc045_RadialVelocityVnce "Variance of Location radial relative velocity ISO 23150:2021(E): Relative velocity {radial distance} - error (A.4.19)";
CM_ SG_ 279 RFC_Loc045_ElevationVnce "Variance of Location elevation angle ISO 23150:2021(E): Position elevation - error (A.4.17)";
CM_ SG_ 279 RFC_Loc045_AzimuthVnce "Variance of Location azimuth angle ISO 23150:2021(E): Position azimuth - error (A.4.17)";
CM_ SG_ 279 RFC_Loc045_RadarCrossSection "Radar Cross Section (RCS) estimation ISO 23150:2021(E): Radar cross section (A.4.5)";
CM_ SG_ 279 RFC_Loc045_DistVelocityQuality "Quality of radial distance and velocity resolution processing. Physical range [0..1]";
CM_ SG_ 279 RFC_Loc045_ElevationQuality "Probability for correct signal model (elevation angle). Physical range [0..1]";
CM_ SG_ 279 RFC_Loc045_AzimuthQuality "Probability for correct signal model (azimuth angle). Physical range [0..1]";
CM_ SG_ 279 RFC_Loc045_RSSI "Received Signal Strength Indication (RSSI). This signal is not exactly ISO 23150:2021(E): Signal to noise ratio - detection level (A.4.7), but SNR can be calculated from this signal. Further detail please refer to the DSP Location Interface definition";
CM_ SG_ 279 RFC_Loc045_AzimuthalPartnerId "Id of the azimuthal partner location";
CM_ SG_ 279 RFC_Loc046_RadialDistance "Location radial distance. Represented in conical coordinate system. Same as ISO 23150:2021(E): Position radial distance (A.4.16)";
CM_ SG_ 279 RFC_Loc046_RadialVelocity "Location radial relative velocity ISO 23150:2021(E): Relative velocity {radial distance} (A.4.18)";
CM_ SG_ 279 RFC_Loc046_Elevation "Location elevation angle. Represented in conical coordinate system. Same as ISO 23150:2021(E): Position elevation (A.4.16)";
CM_ SG_ 279 RFC_Loc046_Azimuth "Location azimuth angle. Represented in conical coordinate system. Deviation from ISO 23150:2021(E): Position azimuth (A.4.16). Further details refers to DSP Location Interface definition";
CM_ SG_ 279 RFC_Loc046_DistVelocityCoVnce "Covariance of radial distance and radial velocity";
CM_ SG_ 279 RFC_Loc046_RadialDistanceVnce "Variance of Location radial distance ISO 23150:2021(E): Position radial distance - error (A.4.17)";
CM_ SG_ 279 RFC_Loc046_RadialVelocityVnce "Variance of Location radial relative velocity ISO 23150:2021(E): Relative velocity {radial distance} - error (A.4.19)";
CM_ SG_ 279 RFC_Loc046_ElevationVnce "Variance of Location elevation angle ISO 23150:2021(E): Position elevation - error (A.4.17)";
CM_ SG_ 279 RFC_Loc046_AzimuthVnce "Variance of Location azimuth angle ISO 23150:2021(E): Position azimuth - error (A.4.17)";
CM_ SG_ 279 RFC_Loc046_RadarCrossSection "Radar Cross Section (RCS) estimation ISO 23150:2021(E): Radar cross section (A.4.5)";
CM_ SG_ 279 RFC_Loc046_DistVelocityQuality "Quality of radial distance and velocity resolution processing. Physical range [0..1]";
CM_ SG_ 279 RFC_Loc046_ElevationQuality "Probability for correct signal model (elevation angle). Physical range [0..1]";
CM_ SG_ 279 RFC_Loc046_AzimuthQuality "Probability for correct signal model (azimuth angle). Physical range [0..1]";
CM_ SG_ 279 RFC_Loc046_RSSI "Received Signal Strength Indication (RSSI). This signal is not exactly ISO 23150:2021(E): Signal to noise ratio - detection level (A.4.7), but SNR can be calculated from this signal. Further detail please refer to the DSP Location Interface definition";
CM_ SG_ 279 RFC_Loc046_AzimuthalPartnerId "Id of the azimuthal partner location";
CM_ SG_ 279 RFC_Loc047_RadialDistance "Location radial distance. Represented in conical coordinate system. Same as ISO 23150:2021(E): Position radial distance (A.4.16)";
CM_ SG_ 279 RFC_Loc047_RadialVelocity "Location radial relative velocity ISO 23150:2021(E): Relative velocity {radial distance} (A.4.18)";
CM_ SG_ 279 RFC_Loc047_Elevation "Location elevation angle. Represented in conical coordinate system. Same as ISO 23150:2021(E): Position elevation (A.4.16)";
CM_ SG_ 279 RFC_Loc047_Azimuth "Location azimuth angle. Represented in conical coordinate system. Deviation from ISO 23150:2021(E): Position azimuth (A.4.16). Further details refers to DSP Location Interface definition";
CM_ SG_ 279 RFC_Loc047_DistVelocityCoVnce "Covariance of radial distance and radial velocity";
CM_ SG_ 279 RFC_Loc047_RadialDistanceVnce "Variance of Location radial distance ISO 23150:2021(E): Position radial distance - error (A.4.17)";
CM_ SG_ 279 RFC_Loc047_RadialVelocityVnce "Variance of Location radial relative velocity ISO 23150:2021(E): Relative velocity {radial distance} - error (A.4.19)";
CM_ SG_ 279 RFC_Loc047_ElevationVnce "Variance of Location elevation angle ISO 23150:2021(E): Position elevation - error (A.4.17)";
CM_ SG_ 279 RFC_Loc047_AzimuthVnce "Variance of Location azimuth angle ISO 23150:2021(E): Position azimuth - error (A.4.17)";
CM_ SG_ 279 RFC_Loc047_RadarCrossSection "Radar Cross Section (RCS) estimation ISO 23150:2021(E): Radar cross section (A.4.5)";
CM_ SG_ 279 RFC_Loc047_DistVelocityQuality "Quality of radial distance and velocity resolution processing. Physical range [0..1]";
CM_ SG_ 279 RFC_Loc047_ElevationQuality "Probability for correct signal model (elevation angle). Physical range [0..1]";
CM_ SG_ 279 RFC_Loc047_AzimuthQuality "Probability for correct signal model (azimuth angle). Physical range [0..1]";
CM_ SG_ 279 RFC_Loc047_RSSI "Received Signal Strength Indication (RSSI). This signal is not exactly ISO 23150:2021(E): Signal to noise ratio - detection level (A.4.7), but SNR can be calculated from this signal. Further detail please refer to the DSP Location Interface definition";
CM_ SG_ 279 RFC_Loc047_AzimuthalPartnerId "Id of the azimuthal partner location";
CM_ SG_ 280 RFC_Loc048_050_CRC "CRC - Autosar E2E Profile 5";
CM_ SG_ 280 RFC_Loc048_050_AliveCtr "Alive counter - Autosar E2E Profile 5";
CM_ SG_ 280 RFC_Loc048_050_ProtBlockCtr "Protocol-Signal: Block-Counter";
CM_ SG_ 280 RFC_Loc048_RadialDistance "Location radial distance. Represented in conical coordinate system. Same as ISO 23150:2021(E): Position radial distance (A.4.16)";
CM_ SG_ 280 RFC_Loc048_RadialVelocity "Location radial relative velocity ISO 23150:2021(E): Relative velocity {radial distance} (A.4.18)";
CM_ SG_ 280 RFC_Loc048_Elevation "Location elevation angle. Represented in conical coordinate system. Same as ISO 23150:2021(E): Position elevation (A.4.16)";
CM_ SG_ 280 RFC_Loc048_Azimuth "Location azimuth angle. Represented in conical coordinate system. Deviation from ISO 23150:2021(E): Position azimuth (A.4.16). Further details refers to DSP Location Interface definition";
CM_ SG_ 280 RFC_Loc048_DistVelocityCoVnce "Covariance of radial distance and radial velocity";
CM_ SG_ 280 RFC_Loc048_RadialDistanceVnce "Variance of Location radial distance ISO 23150:2021(E): Position radial distance - error (A.4.17)";
CM_ SG_ 280 RFC_Loc048_RadialVelocityVnce "Variance of Location radial relative velocity ISO 23150:2021(E): Relative velocity {radial distance} - error (A.4.19)";
CM_ SG_ 280 RFC_Loc048_ElevationVnce "Variance of Location elevation angle ISO 23150:2021(E): Position elevation - error (A.4.17)";
CM_ SG_ 280 RFC_Loc048_AzimuthVnce "Variance of Location azimuth angle ISO 23150:2021(E): Position azimuth - error (A.4.17)";
CM_ SG_ 280 RFC_Loc048_RadarCrossSection "Radar Cross Section (RCS) estimation ISO 23150:2021(E): Radar cross section (A.4.5)";
CM_ SG_ 280 RFC_Loc048_DistVelocityQuality "Quality of radial distance and velocity resolution processing. Physical range [0..1]";
CM_ SG_ 280 RFC_Loc048_ElevationQuality "Probability for correct signal model (elevation angle). Physical range [0..1]";
CM_ SG_ 280 RFC_Loc048_AzimuthQuality "Probability for correct signal model (azimuth angle). Physical range [0..1]";
CM_ SG_ 280 RFC_Loc048_RSSI "Received Signal Strength Indication (RSSI). This signal is not exactly ISO 23150:2021(E): Signal to noise ratio - detection level (A.4.7), but SNR can be calculated from this signal. Further detail please refer to the DSP Location Interface definition";
CM_ SG_ 280 RFC_Loc048_AzimuthalPartnerId "Id of the azimuthal partner location";
CM_ SG_ 280 RFC_Loc049_RadialDistance "Location radial distance. Represented in conical coordinate system. Same as ISO 23150:2021(E): Position radial distance (A.4.16)";
CM_ SG_ 280 RFC_Loc049_RadialVelocity "Location radial relative velocity ISO 23150:2021(E): Relative velocity {radial distance} (A.4.18)";
CM_ SG_ 280 RFC_Loc049_Elevation "Location elevation angle. Represented in conical coordinate system. Same as ISO 23150:2021(E): Position elevation (A.4.16)";
CM_ SG_ 280 RFC_Loc049_Azimuth "Location azimuth angle. Represented in conical coordinate system. Deviation from ISO 23150:2021(E): Position azimuth (A.4.16). Further details refers to DSP Location Interface definition";
CM_ SG_ 280 RFC_Loc049_DistVelocityCoVnce "Covariance of radial distance and radial velocity";
CM_ SG_ 280 RFC_Loc049_RadialDistanceVnce "Variance of Location radial distance ISO 23150:2021(E): Position radial distance - error (A.4.17)";
CM_ SG_ 280 RFC_Loc049_RadialVelocityVnce "Variance of Location radial relative velocity ISO 23150:2021(E): Relative velocity {radial distance} - error (A.4.19)";
CM_ SG_ 280 RFC_Loc049_ElevationVnce "Variance of Location elevation angle ISO 23150:2021(E): Position elevation - error (A.4.17)";
CM_ SG_ 280 RFC_Loc049_AzimuthVnce "Variance of Location azimuth angle ISO 23150:2021(E): Position azimuth - error (A.4.17)";
CM_ SG_ 280 RFC_Loc049_RadarCrossSection "Radar Cross Section (RCS) estimation ISO 23150:2021(E): Radar cross section (A.4.5)";
CM_ SG_ 280 RFC_Loc049_DistVelocityQuality "Quality of radial distance and velocity resolution processing. Physical range [0..1]";
CM_ SG_ 280 RFC_Loc049_ElevationQuality "Probability for correct signal model (elevation angle). Physical range [0..1]";
CM_ SG_ 280 RFC_Loc049_AzimuthQuality "Probability for correct signal model (azimuth angle). Physical range [0..1]";
CM_ SG_ 280 RFC_Loc049_RSSI "Received Signal Strength Indication (RSSI). This signal is not exactly ISO 23150:2021(E): Signal to noise ratio - detection level (A.4.7), but SNR can be calculated from this signal. Further detail please refer to the DSP Location Interface definition";
CM_ SG_ 280 RFC_Loc049_AzimuthalPartnerId "Id of the azimuthal partner location";
CM_ SG_ 280 RFC_Loc050_RadialDistance "Location radial distance. Represented in conical coordinate system. Same as ISO 23150:2021(E): Position radial distance (A.4.16)";
CM_ SG_ 280 RFC_Loc050_RadialVelocity "Location radial relative velocity ISO 23150:2021(E): Relative velocity {radial distance} (A.4.18)";
CM_ SG_ 280 RFC_Loc050_Elevation "Location elevation angle. Represented in conical coordinate system. Same as ISO 23150:2021(E): Position elevation (A.4.16)";
CM_ SG_ 280 RFC_Loc050_Azimuth "Location azimuth angle. Represented in conical coordinate system. Deviation from ISO 23150:2021(E): Position azimuth (A.4.16). Further details refers to DSP Location Interface definition";
CM_ SG_ 280 RFC_Loc050_DistVelocityCoVnce "Covariance of radial distance and radial velocity";
CM_ SG_ 280 RFC_Loc050_RadialDistanceVnce "Variance of Location radial distance ISO 23150:2021(E): Position radial distance - error (A.4.17)";
CM_ SG_ 280 RFC_Loc050_RadialVelocityVnce "Variance of Location radial relative velocity ISO 23150:2021(E): Relative velocity {radial distance} - error (A.4.19)";
CM_ SG_ 280 RFC_Loc050_ElevationVnce "Variance of Location elevation angle ISO 23150:2021(E): Position elevation - error (A.4.17)";
CM_ SG_ 280 RFC_Loc050_AzimuthVnce "Variance of Location azimuth angle ISO 23150:2021(E): Position azimuth - error (A.4.17)";
CM_ SG_ 280 RFC_Loc050_RadarCrossSection "Radar Cross Section (RCS) estimation ISO 23150:2021(E): Radar cross section (A.4.5)";
CM_ SG_ 280 RFC_Loc050_DistVelocityQuality "Quality of radial distance and velocity resolution processing. Physical range [0..1]";
CM_ SG_ 280 RFC_Loc050_ElevationQuality "Probability for correct signal model (elevation angle). Physical range [0..1]";
CM_ SG_ 280 RFC_Loc050_AzimuthQuality "Probability for correct signal model (azimuth angle). Physical range [0..1]";
CM_ SG_ 280 RFC_Loc050_RSSI "Received Signal Strength Indication (RSSI). This signal is not exactly ISO 23150:2021(E): Signal to noise ratio - detection level (A.4.7), but SNR can be calculated from this signal. Further detail please refer to the DSP Location Interface definition";
CM_ SG_ 280 RFC_Loc050_AzimuthalPartnerId "Id of the azimuthal partner location";
BA_DEF_ BO_  "CANFD_BRS" ENUM  "0","1";
BA_DEF_ BO_  "GenMsgCycleTime" INT 0 65535;
BA_DEF_ BO_  "GenMsgILSupport" ENUM  "No","Yes";
BA_DEF_ BO_  "GenMsgSendType" ENUM  "Cyclic","Event","reserved","reserved","reserved","reserved","reserved","IfActive","NoMsgSendType","reserved","reserved","reserved";
BA_DEF_ BO_  "VFrameFormat" ENUM  "StandardCAN","ExtendedCAN","reserved","reserved","reserved","reserved","reserved","reserved","reserved","reserved","reserved","reserved","reserved","reserved","StandardCAN_FD","ExtendedCAN_FD";
BA_DEF_ BO_  "E2Eprofile" STRING ;
BA_DEF_ BO_  "DataID" HEX 0 655535;
BA_DEF_ SG_  "GenSigSendType" ENUM  "Cyclic","OnWrite","OnWriteWithRepetition","OnChange","OnChangeWithRepetition","IfActive","IfActiveWithRepetition","NoSigSendType","OnChangeAndIfActive","OnChangeAndIfActiveWithRepetition";
BA_DEF_ SG_  "GenSigStartValue" HEX 0 2147483648;
BA_DEF_DEF_  "CANFD_BRS" "1";
BA_DEF_DEF_  "GenMsgCycleTime" 0;
BA_DEF_DEF_  "GenMsgILSupport" "Yes";
BA_DEF_DEF_  "GenMsgSendType" "Cyclic";
BA_DEF_DEF_  "VFrameFormat" "";
BA_DEF_DEF_  "E2Eprofile" "None";
BA_DEF_DEF_  "DataID" 0;
BA_DEF_DEF_  "GenSigSendType" "NoSigSendType";
BA_DEF_DEF_  "GenSigStartValue" 0;
BA_ "GenMsgSendType" BO_ 266 1;
BA_ "E2Eprofile" BO_ 266 "AUTOSAR Profile 5";
BA_ "DataID" BO_ 266 8458;
BA_ "VFrameFormat" BO_ 266 14;
BA_ "GenMsgSendType" BO_ 267 1;
BA_ "E2Eprofile" BO_ 267 "AUTOSAR Profile 5";
BA_ "DataID" BO_ 267 8459;
BA_ "VFrameFormat" BO_ 267 14;
BA_ "GenMsgSendType" BO_ 268 1;
BA_ "E2Eprofile" BO_ 268 "AUTOSAR Profile 5";
BA_ "DataID" BO_ 268 8460;
BA_ "VFrameFormat" BO_ 268 14;
BA_ "GenMsgSendType" BO_ 269 1;
BA_ "E2Eprofile" BO_ 269 "AUTOSAR Profile 5";
BA_ "DataID" BO_ 269 8461;
BA_ "VFrameFormat" BO_ 269 14;
BA_ "GenMsgSendType" BO_ 270 1;
BA_ "E2Eprofile" BO_ 270 "AUTOSAR Profile 5";
BA_ "DataID" BO_ 270 8462;
BA_ "VFrameFormat" BO_ 270 14;
BA_ "GenMsgSendType" BO_ 271 1;
BA_ "E2Eprofile" BO_ 271 "AUTOSAR Profile 5";
BA_ "DataID" BO_ 271 8463;
BA_ "VFrameFormat" BO_ 271 14;
BA_ "GenMsgSendType" BO_ 272 1;
BA_ "E2Eprofile" BO_ 272 "AUTOSAR Profile 5";
BA_ "DataID" BO_ 272 8464;
BA_ "VFrameFormat" BO_ 272 14;
BA_ "GenMsgSendType" BO_ 273 1;
BA_ "E2Eprofile" BO_ 273 "AUTOSAR Profile 5";
BA_ "DataID" BO_ 273 8465;
BA_ "VFrameFormat" BO_ 273 14;
BA_ "GenMsgSendType" BO_ 274 1;
BA_ "E2Eprofile" BO_ 274 "AUTOSAR Profile 5";
BA_ "DataID" BO_ 274 8466;
BA_ "VFrameFormat" BO_ 274 14;
BA_ "GenMsgSendType" BO_ 275 1;
BA_ "E2Eprofile" BO_ 275 "AUTOSAR Profile 5";
BA_ "DataID" BO_ 275 8467;
BA_ "VFrameFormat" BO_ 275 14;
BA_ "GenMsgSendType" BO_ 276 1;
BA_ "E2Eprofile" BO_ 276 "AUTOSAR Profile 5";
BA_ "DataID" BO_ 276 8468;
BA_ "VFrameFormat" BO_ 276 14;
BA_ "GenMsgSendType" BO_ 277 1;
BA_ "E2Eprofile" BO_ 277 "AUTOSAR Profile 5";
BA_ "DataID" BO_ 277 8469;
BA_ "VFrameFormat" BO_ 277 14;
BA_ "GenMsgSendType" BO_ 278 1;
BA_ "E2Eprofile" BO_ 278 "AUTOSAR Profile 5";
BA_ "DataID" BO_ 278 8470;
BA_ "VFrameFormat" BO_ 278 14;
BA_ "GenMsgSendType" BO_ 279 1;
BA_ "E2Eprofile" BO_ 279 "AUTOSAR Profile 5";
BA_ "DataID" BO_ 279 8471;
BA_ "VFrameFormat" BO_ 279 14;
BA_ "GenMsgSendType" BO_ 280 1;
BA_ "E2Eprofile" BO_ 280 "AUTOSAR Profile 5";
BA_ "DataID" BO_ 280 8472;
BA_ "VFrameFormat" BO_ 280 14;
BA_ "GenSigStartValue" SG_ 266 RFC_Loc006_RadialVelocity 16384;
BA_ "GenSigStartValue" SG_ 266 RFC_Loc006_Elevation 512;
BA_ "GenSigStartValue" SG_ 266 RFC_Loc006_Azimuth 1024;
BA_ "GenSigStartValue" SG_ 266 RFC_Loc006_DistVelocityCoVnce 1024;
BA_ "GenSigStartValue" SG_ 266 RFC_Loc006_RadarCrossSection 512;
BA_ "GenSigStartValue" SG_ 266 RFC_Loc007_RadialVelocity 16384;
BA_ "GenSigStartValue" SG_ 266 RFC_Loc007_Elevation 512;
BA_ "GenSigStartValue" SG_ 266 RFC_Loc007_Azimuth 1024;
BA_ "GenSigStartValue" SG_ 266 RFC_Loc007_DistVelocityCoVnce 1024;
BA_ "GenSigStartValue" SG_ 266 RFC_Loc007_RadarCrossSection 512;
BA_ "GenSigStartValue" SG_ 266 RFC_Loc008_RadialVelocity 16384;
BA_ "GenSigStartValue" SG_ 266 RFC_Loc008_Elevation 512;
BA_ "GenSigStartValue" SG_ 266 RFC_Loc008_Azimuth 1024;
BA_ "GenSigStartValue" SG_ 266 RFC_Loc008_DistVelocityCoVnce 1024;
BA_ "GenSigStartValue" SG_ 266 RFC_Loc008_RadarCrossSection 512;
BA_ "GenSigStartValue" SG_ 267 RFC_Loc009_RadialVelocity 16384;
BA_ "GenSigStartValue" SG_ 267 RFC_Loc009_Elevation 512;
BA_ "GenSigStartValue" SG_ 267 RFC_Loc009_Azimuth 1024;
BA_ "GenSigStartValue" SG_ 267 RFC_Loc009_DistVelocityCoVnce 1024;
BA_ "GenSigStartValue" SG_ 267 RFC_Loc009_RadarCrossSection 512;
BA_ "GenSigStartValue" SG_ 267 RFC_Loc010_RadialVelocity 16384;
BA_ "GenSigStartValue" SG_ 267 RFC_Loc010_Elevation 512;
BA_ "GenSigStartValue" SG_ 267 RFC_Loc010_Azimuth 1024;
BA_ "GenSigStartValue" SG_ 267 RFC_Loc010_DistVelocityCoVnce 1024;
BA_ "GenSigStartValue" SG_ 267 RFC_Loc010_RadarCrossSection 512;
BA_ "GenSigStartValue" SG_ 267 RFC_Loc011_RadialVelocity 16384;
BA_ "GenSigStartValue" SG_ 267 RFC_Loc011_Elevation 512;
BA_ "GenSigStartValue" SG_ 267 RFC_Loc011_Azimuth 1024;
BA_ "GenSigStartValue" SG_ 267 RFC_Loc011_DistVelocityCoVnce 1024;
BA_ "GenSigStartValue" SG_ 267 RFC_Loc011_RadarCrossSection 512;
BA_ "GenSigStartValue" SG_ 268 RFC_Loc012_RadialVelocity 16384;
BA_ "GenSigStartValue" SG_ 268 RFC_Loc012_Elevation 512;
BA_ "GenSigStartValue" SG_ 268 RFC_Loc012_Azimuth 1024;
BA_ "GenSigStartValue" SG_ 268 RFC_Loc012_DistVelocityCoVnce 1024;
BA_ "GenSigStartValue" SG_ 268 RFC_Loc012_RadarCrossSection 512;
BA_ "GenSigStartValue" SG_ 268 RFC_Loc013_RadialVelocity 16384;
BA_ "GenSigStartValue" SG_ 268 RFC_Loc013_Elevation 512;
BA_ "GenSigStartValue" SG_ 268 RFC_Loc013_Azimuth 1024;
BA_ "GenSigStartValue" SG_ 268 RFC_Loc013_DistVelocityCoVnce 1024;
BA_ "GenSigStartValue" SG_ 268 RFC_Loc013_RadarCrossSection 512;
BA_ "GenSigStartValue" SG_ 268 RFC_Loc014_RadialVelocity 16384;
BA_ "GenSigStartValue" SG_ 268 RFC_Loc014_Elevation 512;
BA_ "GenSigStartValue" SG_ 268 RFC_Loc014_Azimuth 1024;
BA_ "GenSigStartValue" SG_ 268 RFC_Loc014_DistVelocityCoVnce 1024;
BA_ "GenSigStartValue" SG_ 268 RFC_Loc014_RadarCrossSection 512;
BA_ "GenSigStartValue" SG_ 269 RFC_Loc015_RadialVelocity 16384;
BA_ "GenSigStartValue" SG_ 269 RFC_Loc015_Elevation 512;
BA_ "GenSigStartValue" SG_ 269 RFC_Loc015_Azimuth 1024;
BA_ "GenSigStartValue" SG_ 269 RFC_Loc015_DistVelocityCoVnce 1024;
BA_ "GenSigStartValue" SG_ 269 RFC_Loc015_RadarCrossSection 512;
BA_ "GenSigStartValue" SG_ 269 RFC_Loc016_RadialVelocity 16384;
BA_ "GenSigStartValue" SG_ 269 RFC_Loc016_Elevation 512;
BA_ "GenSigStartValue" SG_ 269 RFC_Loc016_Azimuth 1024;
BA_ "GenSigStartValue" SG_ 269 RFC_Loc016_DistVelocityCoVnce 1024;
BA_ "GenSigStartValue" SG_ 269 RFC_Loc016_RadarCrossSection 512;
BA_ "GenSigStartValue" SG_ 269 RFC_Loc017_RadialVelocity 16384;
BA_ "GenSigStartValue" SG_ 269 RFC_Loc017_Elevation 512;
BA_ "GenSigStartValue" SG_ 269 RFC_Loc017_Azimuth 1024;
BA_ "GenSigStartValue" SG_ 269 RFC_Loc017_DistVelocityCoVnce 1024;
BA_ "GenSigStartValue" SG_ 269 RFC_Loc017_RadarCrossSection 512;
BA_ "GenSigStartValue" SG_ 270 RFC_Loc018_RadialVelocity 16384;
BA_ "GenSigStartValue" SG_ 270 RFC_Loc018_Elevation 512;
BA_ "GenSigStartValue" SG_ 270 RFC_Loc018_Azimuth 1024;
BA_ "GenSigStartValue" SG_ 270 RFC_Loc018_DistVelocityCoVnce 1024;
BA_ "GenSigStartValue" SG_ 270 RFC_Loc018_RadarCrossSection 512;
BA_ "GenSigStartValue" SG_ 270 RFC_Loc019_RadialVelocity 16384;
BA_ "GenSigStartValue" SG_ 270 RFC_Loc019_Elevation 512;
BA_ "GenSigStartValue" SG_ 270 RFC_Loc019_Azimuth 1024;
BA_ "GenSigStartValue" SG_ 270 RFC_Loc019_DistVelocityCoVnce 1024;
BA_ "GenSigStartValue" SG_ 270 RFC_Loc019_RadarCrossSection 512;
BA_ "GenSigStartValue" SG_ 270 RFC_Loc020_RadialVelocity 16384;
BA_ "GenSigStartValue" SG_ 270 RFC_Loc020_Elevation 512;
BA_ "GenSigStartValue" SG_ 270 RFC_Loc020_Azimuth 1024;
BA_ "GenSigStartValue" SG_ 270 RFC_Loc020_DistVelocityCoVnce 1024;
BA_ "GenSigStartValue" SG_ 270 RFC_Loc020_RadarCrossSection 512;
BA_ "GenSigStartValue" SG_ 271 RFC_Loc021_RadialVelocity 16384;
BA_ "GenSigStartValue" SG_ 271 RFC_Loc021_Elevation 512;
BA_ "GenSigStartValue" SG_ 271 RFC_Loc021_Azimuth 1024;
BA_ "GenSigStartValue" SG_ 271 RFC_Loc021_DistVelocityCoVnce 1024;
BA_ "GenSigStartValue" SG_ 271 RFC_Loc021_RadarCrossSection 512;
BA_ "GenSigStartValue" SG_ 271 RFC_Loc022_RadialVelocity 16384;
BA_ "GenSigStartValue" SG_ 271 RFC_Loc022_Elevation 512;
BA_ "GenSigStartValue" SG_ 271 RFC_Loc022_Azimuth 1024;
BA_ "GenSigStartValue" SG_ 271 RFC_Loc022_DistVelocityCoVnce 1024;
BA_ "GenSigStartValue" SG_ 271 RFC_Loc022_RadarCrossSection 512;
BA_ "GenSigStartValue" SG_ 271 RFC_Loc023_RadialVelocity 16384;
BA_ "GenSigStartValue" SG_ 271 RFC_Loc023_Elevation 512;
BA_ "GenSigStartValue" SG_ 271 RFC_Loc023_Azimuth 1024;
BA_ "GenSigStartValue" SG_ 271 RFC_Loc023_DistVelocityCoVnce 1024;
BA_ "GenSigStartValue" SG_ 271 RFC_Loc023_RadarCrossSection 512;
BA_ "GenSigStartValue" SG_ 272 RFC_Loc024_RadialVelocity 16384;
BA_ "GenSigStartValue" SG_ 272 RFC_Loc024_Elevation 512;
BA_ "GenSigStartValue" SG_ 272 RFC_Loc024_Azimuth 1024;
BA_ "GenSigStartValue" SG_ 272 RFC_Loc024_DistVelocityCoVnce 1024;
BA_ "GenSigStartValue" SG_ 272 RFC_Loc024_RadarCrossSection 512;
BA_ "GenSigStartValue" SG_ 272 RFC_Loc025_RadialVelocity 16384;
BA_ "GenSigStartValue" SG_ 272 RFC_Loc025_Elevation 512;
BA_ "GenSigStartValue" SG_ 272 RFC_Loc025_Azimuth 1024;
BA_ "GenSigStartValue" SG_ 272 RFC_Loc025_DistVelocityCoVnce 1024;
BA_ "GenSigStartValue" SG_ 272 RFC_Loc025_RadarCrossSection 512;
BA_ "GenSigStartValue" SG_ 272 RFC_Loc026_RadialVelocity 16384;
BA_ "GenSigStartValue" SG_ 272 RFC_Loc026_Elevation 512;
BA_ "GenSigStartValue" SG_ 272 RFC_Loc026_Azimuth 1024;
BA_ "GenSigStartValue" SG_ 272 RFC_Loc026_DistVelocityCoVnce 1024;
BA_ "GenSigStartValue" SG_ 272 RFC_Loc026_RadarCrossSection 512;
BA_ "GenSigStartValue" SG_ 273 RFC_Loc027_RadialVelocity 16384;
BA_ "GenSigStartValue" SG_ 273 RFC_Loc027_Elevation 512;
BA_ "GenSigStartValue" SG_ 273 RFC_Loc027_Azimuth 1024;
BA_ "GenSigStartValue" SG_ 273 RFC_Loc027_DistVelocityCoVnce 1024;
BA_ "GenSigStartValue" SG_ 273 RFC_Loc027_RadarCrossSection 512;
BA_ "GenSigStartValue" SG_ 273 RFC_Loc028_RadialVelocity 16384;
BA_ "GenSigStartValue" SG_ 273 RFC_Loc028_Elevation 512;
BA_ "GenSigStartValue" SG_ 273 RFC_Loc028_Azimuth 1024;
BA_ "GenSigStartValue" SG_ 273 RFC_Loc028_DistVelocityCoVnce 1024;
BA_ "GenSigStartValue" SG_ 273 RFC_Loc028_RadarCrossSection 512;
BA_ "GenSigStartValue" SG_ 273 RFC_Loc029_RadialVelocity 16384;
BA_ "GenSigStartValue" SG_ 273 RFC_Loc029_Elevation 512;
BA_ "GenSigStartValue" SG_ 273 RFC_Loc029_Azimuth 1024;
BA_ "GenSigStartValue" SG_ 273 RFC_Loc029_DistVelocityCoVnce 1024;
BA_ "GenSigStartValue" SG_ 273 RFC_Loc029_RadarCrossSection 512;
BA_ "GenSigStartValue" SG_ 274 RFC_Loc030_RadialVelocity 16384;
BA_ "GenSigStartValue" SG_ 274 RFC_Loc030_Elevation 512;
BA_ "GenSigStartValue" SG_ 274 RFC_Loc030_Azimuth 1024;
BA_ "GenSigStartValue" SG_ 274 RFC_Loc030_DistVelocityCoVnce 1024;
BA_ "GenSigStartValue" SG_ 274 RFC_Loc030_RadarCrossSection 512;
BA_ "GenSigStartValue" SG_ 274 RFC_Loc031_RadialVelocity 16384;
BA_ "GenSigStartValue" SG_ 274 RFC_Loc031_Elevation 512;
BA_ "GenSigStartValue" SG_ 274 RFC_Loc031_Azimuth 1024;
BA_ "GenSigStartValue" SG_ 274 RFC_Loc031_DistVelocityCoVnce 1024;
BA_ "GenSigStartValue" SG_ 274 RFC_Loc031_RadarCrossSection 512;
BA_ "GenSigStartValue" SG_ 274 RFC_Loc032_RadialVelocity 16384;
BA_ "GenSigStartValue" SG_ 274 RFC_Loc032_Elevation 512;
BA_ "GenSigStartValue" SG_ 274 RFC_Loc032_Azimuth 1024;
BA_ "GenSigStartValue" SG_ 274 RFC_Loc032_DistVelocityCoVnce 1024;
BA_ "GenSigStartValue" SG_ 274 RFC_Loc032_RadarCrossSection 512;
BA_ "GenSigStartValue" SG_ 275 RFC_Loc033_RadialVelocity 16384;
BA_ "GenSigStartValue" SG_ 275 RFC_Loc033_Elevation 512;
BA_ "GenSigStartValue" SG_ 275 RFC_Loc033_Azimuth 1024;
BA_ "GenSigStartValue" SG_ 275 RFC_Loc033_DistVelocityCoVnce 1024;
BA_ "GenSigStartValue" SG_ 275 RFC_Loc033_RadarCrossSection 512;
BA_ "GenSigStartValue" SG_ 275 RFC_Loc034_RadialVelocity 16384;
BA_ "GenSigStartValue" SG_ 275 RFC_Loc034_Elevation 512;
BA_ "GenSigStartValue" SG_ 275 RFC_Loc034_Azimuth 1024;
BA_ "GenSigStartValue" SG_ 275 RFC_Loc034_DistVelocityCoVnce 1024;
BA_ "GenSigStartValue" SG_ 275 RFC_Loc034_RadarCrossSection 512;
BA_ "GenSigStartValue" SG_ 275 RFC_Loc035_RadialVelocity 16384;
BA_ "GenSigStartValue" SG_ 275 RFC_Loc035_Elevation 512;
BA_ "GenSigStartValue" SG_ 275 RFC_Loc035_Azimuth 1024;
BA_ "GenSigStartValue" SG_ 275 RFC_Loc035_DistVelocityCoVnce 1024;
BA_ "GenSigStartValue" SG_ 275 RFC_Loc035_RadarCrossSection 512;
BA_ "GenSigStartValue" SG_ 276 RFC_Loc036_RadialVelocity 16384;
BA_ "GenSigStartValue" SG_ 276 RFC_Loc036_Elevation 512;
BA_ "GenSigStartValue" SG_ 276 RFC_Loc036_Azimuth 1024;
BA_ "GenSigStartValue" SG_ 276 RFC_Loc036_DistVelocityCoVnce 1024;
BA_ "GenSigStartValue" SG_ 276 RFC_Loc036_RadarCrossSection 512;
BA_ "GenSigStartValue" SG_ 276 RFC_Loc037_RadialVelocity 16384;
BA_ "GenSigStartValue" SG_ 276 RFC_Loc037_Elevation 512;
BA_ "GenSigStartValue" SG_ 276 RFC_Loc037_Azimuth 1024;
BA_ "GenSigStartValue" SG_ 276 RFC_Loc037_DistVelocityCoVnce 1024;
BA_ "GenSigStartValue" SG_ 276 RFC_Loc037_RadarCrossSection 512;
BA_ "GenSigStartValue" SG_ 276 RFC_Loc038_RadialVelocity 16384;
BA_ "GenSigStartValue" SG_ 276 RFC_Loc038_Elevation 512;
BA_ "GenSigStartValue" SG_ 276 RFC_Loc038_Azimuth 1024;
BA_ "GenSigStartValue" SG_ 276 RFC_Loc038_DistVelocityCoVnce 1024;
BA_ "GenSigStartValue" SG_ 276 RFC_Loc038_RadarCrossSection 512;
BA_ "GenSigStartValue" SG_ 277 RFC_Loc039_RadialVelocity 16384;
BA_ "GenSigStartValue" SG_ 277 RFC_Loc039_Elevation 512;
BA_ "GenSigStartValue" SG_ 277 RFC_Loc039_Azimuth 1024;
BA_ "GenSigStartValue" SG_ 277 RFC_Loc039_DistVelocityCoVnce 1024;
BA_ "GenSigStartValue" SG_ 277 RFC_Loc039_RadarCrossSection 512;
BA_ "GenSigStartValue" SG_ 277 RFC_Loc040_RadialVelocity 16384;
BA_ "GenSigStartValue" SG_ 277 RFC_Loc040_Elevation 512;
BA_ "GenSigStartValue" SG_ 277 RFC_Loc040_Azimuth 1024;
BA_ "GenSigStartValue" SG_ 277 RFC_Loc040_DistVelocityCoVnce 1024;
BA_ "GenSigStartValue" SG_ 277 RFC_Loc040_RadarCrossSection 512;
BA_ "GenSigStartValue" SG_ 277 RFC_Loc041_RadialVelocity 16384;
BA_ "GenSigStartValue" SG_ 277 RFC_Loc041_Elevation 512;
BA_ "GenSigStartValue" SG_ 277 RFC_Loc041_Azimuth 1024;
BA_ "GenSigStartValue" SG_ 277 RFC_Loc041_DistVelocityCoVnce 1024;
BA_ "GenSigStartValue" SG_ 277 RFC_Loc041_RadarCrossSection 512;
BA_ "GenSigStartValue" SG_ 278 RFC_Loc042_RadialVelocity 16384;
BA_ "GenSigStartValue" SG_ 278 RFC_Loc042_Elevation 512;
BA_ "GenSigStartValue" SG_ 278 RFC_Loc042_Azimuth 1024;
BA_ "GenSigStartValue" SG_ 278 RFC_Loc042_DistVelocityCoVnce 1024;
BA_ "GenSigStartValue" SG_ 278 RFC_Loc042_RadarCrossSection 512;
BA_ "GenSigStartValue" SG_ 278 RFC_Loc043_RadialVelocity 16384;
BA_ "GenSigStartValue" SG_ 278 RFC_Loc043_Elevation 512;
BA_ "GenSigStartValue" SG_ 278 RFC_Loc043_Azimuth 1024;
BA_ "GenSigStartValue" SG_ 278 RFC_Loc043_DistVelocityCoVnce 1024;
BA_ "GenSigStartValue" SG_ 278 RFC_Loc043_RadarCrossSection 512;
BA_ "GenSigStartValue" SG_ 278 RFC_Loc044_RadialVelocity 16384;
BA_ "GenSigStartValue" SG_ 278 RFC_Loc044_Elevation 512;
BA_ "GenSigStartValue" SG_ 278 RFC_Loc044_Azimuth 1024;
BA_ "GenSigStartValue" SG_ 278 RFC_Loc044_DistVelocityCoVnce 1024;
BA_ "GenSigStartValue" SG_ 278 RFC_Loc044_RadarCrossSection 512;
BA_ "GenSigStartValue" SG_ 279 RFC_Loc045_RadialVelocity 16384;
BA_ "GenSigStartValue" SG_ 279 RFC_Loc045_Elevation 512;
BA_ "GenSigStartValue" SG_ 279 RFC_Loc045_Azimuth 1024;
BA_ "GenSigStartValue" SG_ 279 RFC_Loc045_DistVelocityCoVnce 1024;
BA_ "GenSigStartValue" SG_ 279 RFC_Loc045_RadarCrossSection 512;
BA_ "GenSigStartValue" SG_ 279 RFC_Loc046_RadialVelocity 16384;
BA_ "GenSigStartValue" SG_ 279 RFC_Loc046_Elevation 512;
BA_ "GenSigStartValue" SG_ 279 RFC_Loc046_Azimuth 1024;
BA_ "GenSigStartValue" SG_ 279 RFC_Loc046_DistVelocityCoVnce 1024;
BA_ "GenSigStartValue" SG_ 279 RFC_Loc046_RadarCrossSection 512;
BA_ "GenSigStartValue" SG_ 279 RFC_Loc047_RadialVelocity 16384;
BA_ "GenSigStartValue" SG_ 279 RFC_Loc047_Elevation 512;
BA_ "GenSigStartValue" SG_ 279 RFC_Loc047_Azimuth 1024;
BA_ "GenSigStartValue" SG_ 279 RFC_Loc047_DistVelocityCoVnce 1024;
BA_ "GenSigStartValue" SG_ 279 RFC_Loc047_RadarCrossSection 512;
BA_ "GenSigStartValue" SG_ 280 RFC_Loc048_RadialVelocity 16384;
BA_ "GenSigStartValue" SG_ 280 RFC_Loc048_Elevation 512;
BA_ "GenSigStartValue" SG_ 280 RFC_Loc048_Azimuth 1024;
BA_ "GenSigStartValue" SG_ 280 RFC_Loc048_DistVelocityCoVnce 1024;
BA_ "GenSigStartValue" SG_ 280 RFC_Loc048_RadarCrossSection 512;
BA_ "GenSigStartValue" SG_ 280 RFC_Loc049_RadialVelocity 16384;
BA_ "GenSigStartValue" SG_ 280 RFC_Loc049_Elevation 512;
BA_ "GenSigStartValue" SG_ 280 RFC_Loc049_Azimuth 1024;
BA_ "GenSigStartValue" SG_ 280 RFC_Loc049_DistVelocityCoVnce 1024;
BA_ "GenSigStartValue" SG_ 280 RFC_Loc049_RadarCrossSection 512;
BA_ "GenSigStartValue" SG_ 280 RFC_Loc050_RadialVelocity 16384;
BA_ "GenSigStartValue" SG_ 280 RFC_Loc050_Elevation 512;
BA_ "GenSigStartValue" SG_ 280 RFC_Loc050_Azimuth 1024;
BA_ "GenSigStartValue" SG_ 280 RFC_Loc050_DistVelocityCoVnce 1024;
BA_ "GenSigStartValue" SG_ 280 RFC_Loc050_RadarCrossSection 512;
SIG_GROUP_ 266 SG_RFC_Location_006_008 1 : RFC_Loc006_008_CRC RFC_Loc006_008_AliveCtr RFC_Loc006_008_ProtBlockCtr RFC_Loc006_RadialDistance RFC_Loc006_RadialVelocity RFC_Loc006_Elevation RFC_Loc006_Azimuth RFC_Loc006_DistVelocityCoVnce RFC_Loc006_RadialDistanceVnce RFC_Loc006_RadialVelocityVnce RFC_Loc006_ElevationVnce RFC_Loc006_AzimuthVnce RFC_Loc006_RadarCrossSection RFC_Loc006_DistVelocityQuality RFC_Loc006_ElevationQuality RFC_Loc006_AzimuthQuality RFC_Loc006_RSSI RFC_Loc006_AzimuthalPartnerId RFC_Loc007_RadialDistance RFC_Loc007_RadialVelocity RFC_Loc007_Elevation RFC_Loc007_Azimuth RFC_Loc007_DistVelocityCoVnce RFC_Loc007_RadialDistanceVnce RFC_Loc007_RadialVelocityVnce RFC_Loc007_ElevationVnce RFC_Loc007_AzimuthVnce RFC_Loc007_RadarCrossSection RFC_Loc007_DistVelocityQuality RFC_Loc007_ElevationQuality RFC_Loc007_AzimuthQuality RFC_Loc007_RSSI RFC_Loc007_AzimuthalPartnerId RFC_Loc008_RadialDistance RFC_Loc008_RadialVelocity RFC_Loc008_Elevation RFC_Loc008_Azimuth RFC_Loc008_DistVelocityCoVnce RFC_Loc008_RadialDistanceVnce RFC_Loc008_RadialVelocityVnce RFC_Loc008_ElevationVnce RFC_Loc008_AzimuthVnce RFC_Loc008_RadarCrossSection RFC_Loc008_DistVelocityQuality RFC_Loc008_ElevationQuality RFC_Loc008_AzimuthQuality RFC_Loc008_RSSI RFC_Loc008_AzimuthalPartnerId;
SIG_GROUP_ 267 SG_RFC_Location_009_011 1 : RFC_Loc009_011_CRC RFC_Loc009_011_AliveCtr RFC_Loc009_011_ProtBlockCtr RFC_Loc009_RadialDistance RFC_Loc009_RadialVelocity RFC_Loc009_Elevation RFC_Loc009_Azimuth RFC_Loc009_DistVelocityCoVnce RFC_Loc009_RadialDistanceVnce RFC_Loc009_RadialVelocityVnce RFC_Loc009_ElevationVnce RFC_Loc009_AzimuthVnce RFC_Loc009_RadarCrossSection RFC_Loc009_DistVelocityQuality RFC_Loc009_ElevationQuality RFC_Loc009_AzimuthQuality RFC_Loc009_RSSI RFC_Loc009_AzimuthalPartnerId RFC_Loc010_RadialDistance RFC_Loc010_RadialVelocity RFC_Loc010_Elevation RFC_Loc010_Azimuth RFC_Loc010_DistVelocityCoVnce RFC_Loc010_RadialDistanceVnce RFC_Loc010_RadialVelocityVnce RFC_Loc010_ElevationVnce RFC_Loc010_AzimuthVnce RFC_Loc010_RadarCrossSection RFC_Loc010_DistVelocityQuality RFC_Loc010_ElevationQuality RFC_Loc010_AzimuthQuality RFC_Loc010_RSSI RFC_Loc010_AzimuthalPartnerId RFC_Loc011_RadialDistance RFC_Loc011_RadialVelocity RFC_Loc011_Elevation RFC_Loc011_Azimuth RFC_Loc011_DistVelocityCoVnce RFC_Loc011_RadialDistanceVnce RFC_Loc011_RadialVelocityVnce RFC_Loc011_ElevationVnce RFC_Loc011_AzimuthVnce RFC_Loc011_RadarCrossSection RFC_Loc011_DistVelocityQuality RFC_Loc011_ElevationQuality RFC_Loc011_AzimuthQuality RFC_Loc011_RSSI RFC_Loc011_AzimuthalPartnerId;
SIG_GROUP_ 268 SG_RFC_Location_012_014 1 : RFC_Loc012_014_CRC RFC_Loc012_014_AliveCtr RFC_Loc012_014_ProtBlockCtr RFC_Loc012_RadialDistance RFC_Loc012_RadialVelocity RFC_Loc012_Elevation RFC_Loc012_Azimuth RFC_Loc012_DistVelocityCoVnce RFC_Loc012_RadialDistanceVnce RFC_Loc012_RadialVelocityVnce RFC_Loc012_ElevationVnce RFC_Loc012_AzimuthVnce RFC_Loc012_RadarCrossSection RFC_Loc012_DistVelocityQuality RFC_Loc012_ElevationQuality RFC_Loc012_AzimuthQuality RFC_Loc012_RSSI RFC_Loc012_AzimuthalPartnerId RFC_Loc013_RadialDistance RFC_Loc013_RadialVelocity RFC_Loc013_Elevation RFC_Loc013_Azimuth RFC_Loc013_DistVelocityCoVnce RFC_Loc013_RadialDistanceVnce RFC_Loc013_RadialVelocityVnce RFC_Loc013_ElevationVnce RFC_Loc013_AzimuthVnce RFC_Loc013_RadarCrossSection RFC_Loc013_DistVelocityQuality RFC_Loc013_ElevationQuality RFC_Loc013_AzimuthQuality RFC_Loc013_RSSI RFC_Loc013_AzimuthalPartnerId RFC_Loc014_RadialDistance RFC_Loc014_RadialVelocity RFC_Loc014_Elevation RFC_Loc014_Azimuth RFC_Loc014_DistVelocityCoVnce RFC_Loc014_RadialDistanceVnce RFC_Loc014_RadialVelocityVnce RFC_Loc014_ElevationVnce RFC_Loc014_AzimuthVnce RFC_Loc014_RadarCrossSection RFC_Loc014_DistVelocityQuality RFC_Loc014_ElevationQuality RFC_Loc014_AzimuthQuality RFC_Loc014_RSSI RFC_Loc014_AzimuthalPartnerId;
SIG_GROUP_ 269 SG_RFC_Location_015_017 1 : RFC_Loc015_017_CRC RFC_Loc015_017_AliveCtr RFC_Loc015_017_ProtBlockCtr RFC_Loc015_RadialDistance RFC_Loc015_RadialVelocity RFC_Loc015_Elevation RFC_Loc015_Azimuth RFC_Loc015_DistVelocityCoVnce RFC_Loc015_RadialDistanceVnce RFC_Loc015_RadialVelocityVnce RFC_Loc015_ElevationVnce RFC_Loc015_AzimuthVnce RFC_Loc015_RadarCrossSection RFC_Loc015_DistVelocityQuality RFC_Loc015_ElevationQuality RFC_Loc015_AzimuthQuality RFC_Loc015_RSSI RFC_Loc015_AzimuthalPartnerId RFC_Loc016_RadialDistance RFC_Loc016_RadialVelocity RFC_Loc016_Elevation RFC_Loc016_Azimuth RFC_Loc016_DistVelocityCoVnce RFC_Loc016_RadialDistanceVnce RFC_Loc016_RadialVelocityVnce RFC_Loc016_ElevationVnce RFC_Loc016_AzimuthVnce RFC_Loc016_RadarCrossSection RFC_Loc016_DistVelocityQuality RFC_Loc016_ElevationQuality RFC_Loc016_AzimuthQuality RFC_Loc016_RSSI RFC_Loc016_AzimuthalPartnerId RFC_Loc017_RadialDistance RFC_Loc017_RadialVelocity RFC_Loc017_Elevation RFC_Loc017_Azimuth RFC_Loc017_DistVelocityCoVnce RFC_Loc017_RadialDistanceVnce RFC_Loc017_RadialVelocityVnce RFC_Loc017_ElevationVnce RFC_Loc017_AzimuthVnce RFC_Loc017_RadarCrossSection RFC_Loc017_DistVelocityQuality RFC_Loc017_ElevationQuality RFC_Loc017_AzimuthQuality RFC_Loc017_RSSI RFC_Loc017_AzimuthalPartnerId;
SIG_GROUP_ 270 SG_RFC_Location_018_020 1 : RFC_Loc018_020_CRC RFC_Loc018_020_AliveCtr RFC_Loc018_020_ProtBlockCtr RFC_Loc018_RadialDistance RFC_Loc018_RadialVelocity RFC_Loc018_Elevation RFC_Loc018_Azimuth RFC_Loc018_DistVelocityCoVnce RFC_Loc018_RadialDistanceVnce RFC_Loc018_RadialVelocityVnce RFC_Loc018_ElevationVnce RFC_Loc018_AzimuthVnce RFC_Loc018_RadarCrossSection RFC_Loc018_DistVelocityQuality RFC_Loc018_ElevationQuality RFC_Loc018_AzimuthQuality RFC_Loc018_RSSI RFC_Loc018_AzimuthalPartnerId RFC_Loc019_RadialDistance RFC_Loc019_RadialVelocity RFC_Loc019_Elevation RFC_Loc019_Azimuth RFC_Loc019_DistVelocityCoVnce RFC_Loc019_RadialDistanceVnce RFC_Loc019_RadialVelocityVnce RFC_Loc019_ElevationVnce RFC_Loc019_AzimuthVnce RFC_Loc019_RadarCrossSection RFC_Loc019_DistVelocityQuality RFC_Loc019_ElevationQuality RFC_Loc019_AzimuthQuality RFC_Loc019_RSSI RFC_Loc019_AzimuthalPartnerId RFC_Loc020_RadialDistance RFC_Loc020_RadialVelocity RFC_Loc020_Elevation RFC_Loc020_Azimuth RFC_Loc020_DistVelocityCoVnce RFC_Loc020_RadialDistanceVnce RFC_Loc020_RadialVelocityVnce RFC_Loc020_ElevationVnce RFC_Loc020_AzimuthVnce RFC_Loc020_RadarCrossSection RFC_Loc020_DistVelocityQuality RFC_Loc020_ElevationQuality RFC_Loc020_AzimuthQuality RFC_Loc020_RSSI RFC_Loc020_AzimuthalPartnerId;
SIG_GROUP_ 271 SG_RFC_Location_021_023 1 : RFC_Loc021_023_CRC RFC_Loc021_023_AliveCtr RFC_Loc021_023_ProtBlockCtr RFC_Loc021_RadialDistance RFC_Loc021_RadialVelocity RFC_Loc021_Elevation RFC_Loc021_Azimuth RFC_Loc021_DistVelocityCoVnce RFC_Loc021_RadialDistanceVnce RFC_Loc021_RadialVelocityVnce RFC_Loc021_ElevationVnce RFC_Loc021_AzimuthVnce RFC_Loc021_RadarCrossSection RFC_Loc021_DistVelocityQuality RFC_Loc021_ElevationQuality RFC_Loc021_AzimuthQuality RFC_Loc021_RSSI RFC_Loc021_AzimuthalPartnerId RFC_Loc022_RadialDistance RFC_Loc022_RadialVelocity RFC_Loc022_Elevation RFC_Loc022_Azimuth RFC_Loc022_DistVelocityCoVnce RFC_Loc022_RadialDistanceVnce RFC_Loc022_RadialVelocityVnce RFC_Loc022_ElevationVnce RFC_Loc022_AzimuthVnce RFC_Loc022_RadarCrossSection RFC_Loc022_DistVelocityQuality RFC_Loc022_ElevationQuality RFC_Loc022_AzimuthQuality RFC_Loc022_RSSI RFC_Loc022_AzimuthalPartnerId RFC_Loc023_RadialDistance RFC_Loc023_RadialVelocity RFC_Loc023_Elevation RFC_Loc023_Azimuth RFC_Loc023_DistVelocityCoVnce RFC_Loc023_RadialDistanceVnce RFC_Loc023_RadialVelocityVnce RFC_Loc023_ElevationVnce RFC_Loc023_AzimuthVnce RFC_Loc023_RadarCrossSection RFC_Loc023_DistVelocityQuality RFC_Loc023_ElevationQuality RFC_Loc023_AzimuthQuality RFC_Loc023_RSSI RFC_Loc023_AzimuthalPartnerId;
SIG_GROUP_ 272 SG_RFC_Location_024_026 1 : RFC_Loc024_026_CRC RFC_Loc024_026_AliveCtr RFC_Loc024_026_ProtBlockCtr RFC_Loc024_RadialDistance RFC_Loc024_RadialVelocity RFC_Loc024_Elevation RFC_Loc024_Azimuth RFC_Loc024_DistVelocityCoVnce RFC_Loc024_RadialDistanceVnce RFC_Loc024_RadialVelocityVnce RFC_Loc024_ElevationVnce RFC_Loc024_AzimuthVnce RFC_Loc024_RadarCrossSection RFC_Loc024_DistVelocityQuality RFC_Loc024_ElevationQuality RFC_Loc024_AzimuthQuality RFC_Loc024_RSSI RFC_Loc024_AzimuthalPartnerId RFC_Loc025_RadialDistance RFC_Loc025_RadialVelocity RFC_Loc025_Elevation RFC_Loc025_Azimuth RFC_Loc025_DistVelocityCoVnce RFC_Loc025_RadialDistanceVnce RFC_Loc025_RadialVelocityVnce RFC_Loc025_ElevationVnce RFC_Loc025_AzimuthVnce RFC_Loc025_RadarCrossSection RFC_Loc025_DistVelocityQuality RFC_Loc025_ElevationQuality RFC_Loc025_AzimuthQuality RFC_Loc025_RSSI RFC_Loc025_AzimuthalPartnerId RFC_Loc026_RadialDistance RFC_Loc026_RadialVelocity RFC_Loc026_Elevation RFC_Loc026_Azimuth RFC_Loc026_DistVelocityCoVnce RFC_Loc026_RadialDistanceVnce RFC_Loc026_RadialVelocityVnce RFC_Loc026_ElevationVnce RFC_Loc026_AzimuthVnce RFC_Loc026_RadarCrossSection RFC_Loc026_DistVelocityQuality RFC_Loc026_ElevationQuality RFC_Loc026_AzimuthQuality RFC_Loc026_RSSI RFC_Loc026_AzimuthalPartnerId;
SIG_GROUP_ 273 SG_RFC_Location_027_029 1 : RFC_Loc027_029_CRC RFC_Loc027_029_AliveCtr RFC_Loc027_029_ProtBlockCtr RFC_Loc027_RadialDistance RFC_Loc027_RadialVelocity RFC_Loc027_Elevation RFC_Loc027_Azimuth RFC_Loc027_DistVelocityCoVnce RFC_Loc027_RadialDistanceVnce RFC_Loc027_RadialVelocityVnce RFC_Loc027_ElevationVnce RFC_Loc027_AzimuthVnce RFC_Loc027_RadarCrossSection RFC_Loc027_DistVelocityQuality RFC_Loc027_ElevationQuality RFC_Loc027_AzimuthQuality RFC_Loc027_RSSI RFC_Loc027_AzimuthalPartnerId RFC_Loc028_RadialDistance RFC_Loc028_RadialVelocity RFC_Loc028_Elevation RFC_Loc028_Azimuth RFC_Loc028_DistVelocityCoVnce RFC_Loc028_RadialDistanceVnce RFC_Loc028_RadialVelocityVnce RFC_Loc028_ElevationVnce RFC_Loc028_AzimuthVnce RFC_Loc028_RadarCrossSection RFC_Loc028_DistVelocityQuality RFC_Loc028_ElevationQuality RFC_Loc028_AzimuthQuality RFC_Loc028_RSSI RFC_Loc028_AzimuthalPartnerId RFC_Loc029_RadialDistance RFC_Loc029_RadialVelocity RFC_Loc029_Elevation RFC_Loc029_Azimuth RFC_Loc029_DistVelocityCoVnce RFC_Loc029_RadialDistanceVnce RFC_Loc029_RadialVelocityVnce RFC_Loc029_ElevationVnce RFC_Loc029_AzimuthVnce RFC_Loc029_RadarCrossSection RFC_Loc029_DistVelocityQuality RFC_Loc029_ElevationQuality RFC_Loc029_AzimuthQuality RFC_Loc029_RSSI RFC_Loc029_AzimuthalPartnerId;
SIG_GROUP_ 274 SG_RFC_Location_030_032 1 : RFC_Loc030_032_CRC RFC_Loc030_032_AliveCtr RFC_Loc030_032_ProtBlockCtr RFC_Loc030_RadialDistance RFC_Loc030_RadialVelocity RFC_Loc030_Elevation RFC_Loc030_Azimuth RFC_Loc030_DistVelocityCoVnce RFC_Loc030_RadialDistanceVnce RFC_Loc030_RadialVelocityVnce RFC_Loc030_ElevationVnce RFC_Loc030_AzimuthVnce RFC_Loc030_RadarCrossSection RFC_Loc030_DistVelocityQuality RFC_Loc030_ElevationQuality RFC_Loc030_AzimuthQuality RFC_Loc030_RSSI RFC_Loc030_AzimuthalPartnerId RFC_Loc031_RadialDistance RFC_Loc031_RadialVelocity RFC_Loc031_Elevation RFC_Loc031_Azimuth RFC_Loc031_DistVelocityCoVnce RFC_Loc031_RadialDistanceVnce RFC_Loc031_RadialVelocityVnce RFC_Loc031_ElevationVnce RFC_Loc031_AzimuthVnce RFC_Loc031_RadarCrossSection RFC_Loc031_DistVelocityQuality RFC_Loc031_ElevationQuality RFC_Loc031_AzimuthQuality RFC_Loc031_RSSI RFC_Loc031_AzimuthalPartnerId RFC_Loc032_RadialDistance RFC_Loc032_RadialVelocity RFC_Loc032_Elevation RFC_Loc032_Azimuth RFC_Loc032_DistVelocityCoVnce RFC_Loc032_RadialDistanceVnce RFC_Loc032_RadialVelocityVnce RFC_Loc032_ElevationVnce RFC_Loc032_AzimuthVnce RFC_Loc032_RadarCrossSection RFC_Loc032_DistVelocityQuality RFC_Loc032_ElevationQuality RFC_Loc032_AzimuthQuality RFC_Loc032_RSSI RFC_Loc032_AzimuthalPartnerId;
SIG_GROUP_ 275 SG_RFC_Location_033_035 1 : RFC_Loc033_035_CRC RFC_Loc033_035_AliveCtr RFC_Loc033_035_ProtBlockCtr RFC_Loc033_RadialDistance RFC_Loc033_RadialVelocity RFC_Loc033_Elevation RFC_Loc033_Azimuth RFC_Loc033_DistVelocityCoVnce RFC_Loc033_RadialDistanceVnce RFC_Loc033_RadialVelocityVnce RFC_Loc033_ElevationVnce RFC_Loc033_AzimuthVnce RFC_Loc033_RadarCrossSection RFC_Loc033_DistVelocityQuality RFC_Loc033_ElevationQuality RFC_Loc033_AzimuthQuality RFC_Loc033_RSSI RFC_Loc033_AzimuthalPartnerId RFC_Loc034_RadialDistance RFC_Loc034_RadialVelocity RFC_Loc034_Elevation RFC_Loc034_Azimuth RFC_Loc034_DistVelocityCoVnce RFC_Loc034_RadialDistanceVnce RFC_Loc034_RadialVelocityVnce RFC_Loc034_ElevationVnce RFC_Loc034_AzimuthVnce RFC_Loc034_RadarCrossSection RFC_Loc034_DistVelocityQuality RFC_Loc034_ElevationQuality RFC_Loc034_AzimuthQuality RFC_Loc034_RSSI RFC_Loc034_AzimuthalPartnerId RFC_Loc035_RadialDistance RFC_Loc035_RadialVelocity RFC_Loc035_Elevation RFC_Loc035_Azimuth RFC_Loc035_DistVelocityCoVnce RFC_Loc035_RadialDistanceVnce RFC_Loc035_RadialVelocityVnce RFC_Loc035_ElevationVnce RFC_Loc035_AzimuthVnce RFC_Loc035_RadarCrossSection RFC_Loc035_DistVelocityQuality RFC_Loc035_ElevationQuality RFC_Loc035_AzimuthQuality RFC_Loc035_RSSI RFC_Loc035_AzimuthalPartnerId;
SIG_GROUP_ 276 SG_RFC_Location_036_038 1 : RFC_Loc036_038_CRC RFC_Loc036_038_AliveCtr RFC_Loc036_038_ProtBlockCtr RFC_Loc036_RadialDistance RFC_Loc036_RadialVelocity RFC_Loc036_Elevation RFC_Loc036_Azimuth RFC_Loc036_DistVelocityCoVnce RFC_Loc036_RadialDistanceVnce RFC_Loc036_RadialVelocityVnce RFC_Loc036_ElevationVnce RFC_Loc036_AzimuthVnce RFC_Loc036_RadarCrossSection RFC_Loc036_DistVelocityQuality RFC_Loc036_ElevationQuality RFC_Loc036_AzimuthQuality RFC_Loc036_RSSI RFC_Loc036_AzimuthalPartnerId RFC_Loc037_RadialDistance RFC_Loc037_RadialVelocity RFC_Loc037_Elevation RFC_Loc037_Azimuth RFC_Loc037_DistVelocityCoVnce RFC_Loc037_RadialDistanceVnce RFC_Loc037_RadialVelocityVnce RFC_Loc037_ElevationVnce RFC_Loc037_AzimuthVnce RFC_Loc037_RadarCrossSection RFC_Loc037_DistVelocityQuality RFC_Loc037_ElevationQuality RFC_Loc037_AzimuthQuality RFC_Loc037_RSSI RFC_Loc037_AzimuthalPartnerId RFC_Loc038_RadialDistance RFC_Loc038_RadialVelocity RFC_Loc038_Elevation RFC_Loc038_Azimuth RFC_Loc038_DistVelocityCoVnce RFC_Loc038_RadialDistanceVnce RFC_Loc038_RadialVelocityVnce RFC_Loc038_ElevationVnce RFC_Loc038_AzimuthVnce RFC_Loc038_RadarCrossSection RFC_Loc038_DistVelocityQuality RFC_Loc038_ElevationQuality RFC_Loc038_AzimuthQuality RFC_Loc038_RSSI RFC_Loc038_AzimuthalPartnerId;
SIG_GROUP_ 277 SG_RFC_Location_039_041 1 : RFC_Loc039_041_CRC RFC_Loc039_041_AliveCtr RFC_Loc039_041_ProtBlockCtr RFC_Loc039_RadialDistance RFC_Loc039_RadialVelocity RFC_Loc039_Elevation RFC_Loc039_Azimuth RFC_Loc039_DistVelocityCoVnce RFC_Loc039_RadialDistanceVnce RFC_Loc039_RadialVelocityVnce RFC_Loc039_ElevationVnce RFC_Loc039_AzimuthVnce RFC_Loc039_RadarCrossSection RFC_Loc039_DistVelocityQuality RFC_Loc039_ElevationQuality RFC_Loc039_AzimuthQuality RFC_Loc039_RSSI RFC_Loc039_AzimuthalPartnerId RFC_Loc040_RadialDistance RFC_Loc040_RadialVelocity RFC_Loc040_Elevation RFC_Loc040_Azimuth RFC_Loc040_DistVelocityCoVnce RFC_Loc040_RadialDistanceVnce RFC_Loc040_RadialVelocityVnce RFC_Loc040_ElevationVnce RFC_Loc040_AzimuthVnce RFC_Loc040_RadarCrossSection RFC_Loc040_DistVelocityQuality RFC_Loc040_ElevationQuality RFC_Loc040_AzimuthQuality RFC_Loc040_RSSI RFC_Loc040_AzimuthalPartnerId RFC_Loc041_RadialDistance RFC_Loc041_RadialVelocity RFC_Loc041_Elevation RFC_Loc041_Azimuth RFC_Loc041_DistVelocityCoVnce RFC_Loc041_RadialDistanceVnce RFC_Loc041_RadialVelocityVnce RFC_Loc041_ElevationVnce RFC_Loc041_AzimuthVnce RFC_Loc041_RadarCrossSection RFC_Loc041_DistVelocityQuality RFC_Loc041_ElevationQuality RFC_Loc041_AzimuthQuality RFC_Loc041_RSSI RFC_Loc041_AzimuthalPartnerId;
SIG_GROUP_ 278 SG_RFC_Location_042_044 1 : RFC_Loc042_044_CRC RFC_Loc042_044_AliveCtr RFC_Loc042_044_ProtBlockCtr RFC_Loc042_RadialDistance RFC_Loc042_RadialVelocity RFC_Loc042_Elevation RFC_Loc042_Azimuth RFC_Loc042_DistVelocityCoVnce RFC_Loc042_RadialDistanceVnce RFC_Loc042_RadialVelocityVnce RFC_Loc042_ElevationVnce RFC_Loc042_AzimuthVnce RFC_Loc042_RadarCrossSection RFC_Loc042_DistVelocityQuality RFC_Loc042_ElevationQuality RFC_Loc042_AzimuthQuality RFC_Loc042_RSSI RFC_Loc042_AzimuthalPartnerId RFC_Loc043_RadialDistance RFC_Loc043_RadialVelocity RFC_Loc043_Elevation RFC_Loc043_Azimuth RFC_Loc043_DistVelocityCoVnce RFC_Loc043_RadialDistanceVnce RFC_Loc043_RadialVelocityVnce RFC_Loc043_ElevationVnce RFC_Loc043_AzimuthVnce RFC_Loc043_RadarCrossSection RFC_Loc043_DistVelocityQuality RFC_Loc043_ElevationQuality RFC_Loc043_AzimuthQuality RFC_Loc043_RSSI RFC_Loc043_AzimuthalPartnerId RFC_Loc044_RadialDistance RFC_Loc044_RadialVelocity RFC_Loc044_Elevation RFC_Loc044_Azimuth RFC_Loc044_DistVelocityCoVnce RFC_Loc044_RadialDistanceVnce RFC_Loc044_RadialVelocityVnce RFC_Loc044_ElevationVnce RFC_Loc044_AzimuthVnce RFC_Loc044_RadarCrossSection RFC_Loc044_DistVelocityQuality RFC_Loc044_ElevationQuality RFC_Loc044_AzimuthQuality RFC_Loc044_RSSI RFC_Loc044_AzimuthalPartnerId;
SIG_GROUP_ 279 SG_RFC_Location_045_047 1 : RFC_Loc045_047_CRC RFC_Loc045_047_AliveCtr RFC_Loc045_047_ProtBlockCtr RFC_Loc045_RadialDistance RFC_Loc045_RadialVelocity RFC_Loc045_Elevation RFC_Loc045_Azimuth RFC_Loc045_DistVelocityCoVnce RFC_Loc045_RadialDistanceVnce RFC_Loc045_RadialVelocityVnce RFC_Loc045_ElevationVnce RFC_Loc045_AzimuthVnce RFC_Loc045_RadarCrossSection RFC_Loc045_DistVelocityQuality RFC_Loc045_ElevationQuality RFC_Loc045_AzimuthQuality RFC_Loc045_RSSI RFC_Loc045_AzimuthalPartnerId RFC_Loc046_RadialDistance RFC_Loc046_RadialVelocity RFC_Loc046_Elevation RFC_Loc046_Azimuth RFC_Loc046_DistVelocityCoVnce RFC_Loc046_RadialDistanceVnce RFC_Loc046_RadialVelocityVnce RFC_Loc046_ElevationVnce RFC_Loc046_AzimuthVnce RFC_Loc046_RadarCrossSection RFC_Loc046_DistVelocityQuality RFC_Loc046_ElevationQuality RFC_Loc046_AzimuthQuality RFC_Loc046_RSSI RFC_Loc046_AzimuthalPartnerId RFC_Loc047_RadialDistance RFC_Loc047_RadialVelocity RFC_Loc047_Elevation RFC_Loc047_Azimuth RFC_Loc047_DistVelocityCoVnce RFC_Loc047_RadialDistanceVnce RFC_Loc047_RadialVelocityVnce RFC_Loc047_ElevationVnce RFC_Loc047_AzimuthVnce RFC_Loc047_RadarCrossSection RFC_Loc047_DistVelocityQuality RFC_Loc047_ElevationQuality RFC_Loc047_AzimuthQuality RFC_Loc047_RSSI RFC_Loc047_AzimuthalPartnerId;
SIG_GROUP_ 280 SG_RFC_Location_048_050 1 : RFC_Loc048_050_CRC RFC_Loc048_050_AliveCtr RFC_Loc048_050_ProtBlockCtr RFC_Loc048_RadialDistance RFC_Loc048_RadialVelocity RFC_Loc048_Elevation RFC_Loc048_Azimuth RFC_Loc048_DistVelocityCoVnce RFC_Loc048_RadialDistanceVnce RFC_Loc048_RadialVelocityVnce RFC_Loc048_ElevationVnce RFC_Loc048_AzimuthVnce RFC_Loc048_RadarCrossSection RFC_Loc048_DistVelocityQuality RFC_Loc048_ElevationQuality RFC_Loc048_AzimuthQuality RFC_Loc048_RSSI RFC_Loc048_AzimuthalPartnerId RFC_Loc049_RadialDistance RFC_Loc049_RadialVelocity RFC_Loc049_Elevation RFC_Loc049_Azimuth RFC_Loc049_DistVelocityCoVnce RFC_Loc049_RadialDistanceVnce RFC_Loc049_RadialVelocityVnce RFC_Loc049_ElevationVnce RFC_Loc049_AzimuthVnce RFC_Loc049_RadarCrossSection RFC_Loc049_DistVelocityQuality RFC_Loc049_ElevationQuality RFC_Loc049_AzimuthQuality RFC_Loc049_RSSI RFC_Loc049_AzimuthalPartnerId RFC_Loc050_RadialDistance RFC_Loc050_RadialVelocity RFC_Loc050_Elevation RFC_Loc050_Azimuth RFC_Loc050_DistVelocityCoVnce RFC_Loc050_RadialDistanceVnce RFC_Loc050_RadialVelocityVnce RFC_Loc050_ElevationVnce RFC_Loc050_AzimuthVnce RFC_Loc050_RadarCrossSection RFC_Loc050_DistVelocityQuality RFC_Loc050_ElevationQuality RFC_Loc050_AzimuthQuality RFC_Loc050_RSSI RFC_Loc050_AzimuthalPartnerId;
