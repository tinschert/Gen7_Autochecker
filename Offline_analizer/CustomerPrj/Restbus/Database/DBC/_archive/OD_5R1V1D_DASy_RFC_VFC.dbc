VERSION "created by canmatrix"

NS_ :

BS_:

BU_: RadarFrontCenter VideoFrontCenter DASy ReceiveECU

BO_ 244 VFC_TrafficSign_12_13: 64 VideoFrontCenter
 SG_ VFC_TS_12_13_CRC : 0|16@1+ (1,0) [0|65535] ""  DASy
 SG_ VFC_TS_12_13_AliveCtr : 16|8@1+ (1,0) [0|255] ""  DASy
 SG_ VFC_TS_12_13_ProtBlockCtr : 24|4@1+ (1,0) [0|15] ""  DASy
 SG_ VFC_TS12_ObjId : 32|8@1+ (1,0) [0|255] ""  DASy
 SG_ VFC_TS12_Type : 40|10@1+ (1,0) [0|1023] ""  DASy
 SG_ VFC_TS12_ExistProb : 50|5@1+ (5,0) [0|100] "%"  DASy
 SG_ VFC_TS12_Px : 55|9@1+ (0.25,0) [0|127.75] "m"  DASy
 SG_ VFC_TS12_Py : 64|8@1+ (0.2,-25.6) [-25.6|25.4] "m"  DASy
 SG_ VFC_TS12_Pz : 72|6@1+ (0.2,0) [0|12.6] "m"  DASy
 SG_ VFC_TS12_PxStdDev : 78|9@1+ (0.25,0) [0|127.75] "m"  DASy
 SG_ VFC_TS12_Width : 87|4@1+ (0.2,0) [0|3] "m"  DASy
 SG_ VFC_TS12_Height : 91|4@1+ (0.2,0) [0|3] "m"  DASy
 SG_ VFC_TS12_EmbeddedInfo : 95|4@1+ (1,0) [0|15] ""  DASy
 SG_ VFC_TS12_ValidLane : 99|5@1+ (1,0) [0|31] ""  DASy
 SG_ VFC_TS12_ValidDay : 104|7@1+ (1,0) [0|127] ""  DASy
 SG_ VFC_TS12_ValidTimeRange1Start : 111|7@1+ (15,0) [0|1440] "min"  DASy
 SG_ VFC_TS12_ValidTimeRange1End : 118|7@1+ (15,0) [0|1440] "min"  DASy
 SG_ VFC_TS12_ValidTimeRange2Start : 125|7@1+ (15,0) [0|1440] "min"  DASy
 SG_ VFC_TS12_ValidTimeRange2End : 132|7@1+ (15,0) [0|1440] "min"  DASy
 SG_ VFC_TS12_ValidInDist : 139|15@1+ (0.1,0) [0|3276.7] ""  DASy
 SG_ VFC_TS12_ValidInDistUnit : 154|3@1+ (1,0) [0|7] ""  DASy
 SG_ VFC_TS12_ValidSection : 157|15@1+ (0.1,0) [0|3276.7] ""  DASy
 SG_ VFC_TS12_ValidSectionUnit : 172|3@1+ (1,0) [0|7] ""  DASy
 SG_ VFC_TS12_NumValidSupSigns : 175|3@1+ (1,0) [0|6] ""  DASy
 SG_ VFC_TS12_SupSign0ExistProb : 178|5@1+ (5,0) [0|100] "%"  DASy
 SG_ VFC_TS12_SupSign1ExistProb : 183|5@1+ (5,0) [0|100] "%"  DASy
 SG_ VFC_TS12_SupSign2ExistProb : 188|5@1+ (5,0) [0|100] "%"  DASy
 SG_ VFC_TS12_SupSign3ExistProb : 193|5@1+ (5,0) [0|100] "%"  DASy
 SG_ VFC_TS12_SupSign4ExistProb : 198|5@1+ (5,0) [0|100] "%"  DASy
 SG_ VFC_TS12_SupSign5ExistProb : 203|5@1+ (5,0) [0|100] "%"  DASy
 SG_ VFC_TS12_SupSign0Type : 208|8@1+ (1,0) [0|255] ""  DASy
 SG_ VFC_TS12_SupSign1Type : 216|8@1+ (1,0) [0|255] ""  DASy
 SG_ VFC_TS12_SupSign2Type : 224|8@1+ (1,0) [0|255] ""  DASy
 SG_ VFC_TS12_SupSign3Type : 232|8@1+ (1,0) [0|255] ""  DASy
 SG_ VFC_TS12_SupSign4Type : 240|8@1+ (1,0) [0|255] ""  DASy
 SG_ VFC_TS12_SupSign5Type : 248|8@1+ (1,0) [0|255] ""  DASy
 SG_ VFC_TS13_ObjId : 272|8@1+ (1,0) [0|255] ""  DASy
 SG_ VFC_TS13_Type : 280|10@1+ (1,0) [0|1023] ""  DASy
 SG_ VFC_TS13_ExistProb : 290|5@1+ (5,0) [0|100] "%"  DASy
 SG_ VFC_TS13_Px : 295|9@1+ (0.25,0) [0|127.75] "m"  DASy
 SG_ VFC_TS13_Py : 304|8@1+ (0.2,-25.6) [-25.6|25.4] "m"  DASy
 SG_ VFC_TS13_Pz : 312|6@1+ (0.2,0) [0|12.6] "m"  DASy
 SG_ VFC_TS13_PxStdDev : 318|9@1+ (0.25,0) [0|127.75] "m"  DASy
 SG_ VFC_TS13_Width : 327|4@1+ (0.2,0) [0|3] "m"  DASy
 SG_ VFC_TS13_Height : 331|4@1+ (0.2,0) [0|3] "m"  DASy
 SG_ VFC_TS13_EmbeddedInfo : 335|4@1+ (1,0) [0|15] ""  DASy
 SG_ VFC_TS13_ValidLane : 339|5@1+ (1,0) [0|31] ""  DASy
 SG_ VFC_TS13_ValidDay : 344|7@1+ (1,0) [0|127] ""  DASy
 SG_ VFC_TS13_ValidTimeRange1Start : 351|7@1+ (15,0) [0|1440] "min"  DASy
 SG_ VFC_TS13_ValidTimeRange1End : 358|7@1+ (15,0) [0|1440] "min"  DASy
 SG_ VFC_TS13_ValidTimeRange2Start : 365|7@1+ (15,0) [0|1440] "min"  DASy
 SG_ VFC_TS13_ValidTimeRange2End : 372|7@1+ (15,0) [0|1440] "min"  DASy
 SG_ VFC_TS13_ValidInDist : 379|15@1+ (0.1,0) [0|3276.7] ""  DASy
 SG_ VFC_TS13_ValidInDistUnit : 394|3@1+ (1,0) [0|7] ""  DASy
 SG_ VFC_TS13_ValidSection : 397|15@1+ (0.1,0) [0|3276.7] ""  DASy
 SG_ VFC_TS13_ValidSectionUnit : 412|3@1+ (1,0) [0|7] ""  DASy
 SG_ VFC_TS13_NumValidSupSigns : 415|3@1+ (1,0) [0|6] ""  DASy
 SG_ VFC_TS13_SupSign0ExistProb : 418|5@1+ (5,0) [0|100] "%"  DASy
 SG_ VFC_TS13_SupSign1ExistProb : 423|5@1+ (5,0) [0|100] "%"  DASy
 SG_ VFC_TS13_SupSign2ExistProb : 428|5@1+ (5,0) [0|100] "%"  DASy
 SG_ VFC_TS13_SupSign3ExistProb : 433|5@1+ (5,0) [0|100] "%"  DASy
 SG_ VFC_TS13_SupSign4ExistProb : 438|5@1+ (5,0) [0|100] "%"  DASy
 SG_ VFC_TS13_SupSign5ExistProb : 443|5@1+ (5,0) [0|100] "%"  DASy
 SG_ VFC_TS13_SupSign0Type : 448|8@1+ (1,0) [0|255] ""  DASy
 SG_ VFC_TS13_SupSign1Type : 456|8@1+ (1,0) [0|255] ""  DASy
 SG_ VFC_TS13_SupSign2Type : 464|8@1+ (1,0) [0|255] ""  DASy
 SG_ VFC_TS13_SupSign3Type : 472|8@1+ (1,0) [0|255] ""  DASy
 SG_ VFC_TS13_SupSign4Type : 480|8@1+ (1,0) [0|255] ""  DASy
 SG_ VFC_TS13_SupSign5Type : 488|8@1+ (1,0) [0|255] ""  DASy

BO_ 245 VFC_TrafficSign_14_15: 64 VideoFrontCenter
 SG_ VFC_TS_14_15_CRC : 0|16@1+ (1,0) [0|65535] ""  DASy
 SG_ VFC_TS_14_15_AliveCtr : 16|8@1+ (1,0) [0|255] ""  DASy
 SG_ VFC_TS_14_15_ProtBlockCtr : 24|4@1+ (1,0) [0|15] ""  DASy
 SG_ VFC_TS14_ObjId : 32|8@1+ (1,0) [0|255] ""  DASy
 SG_ VFC_TS14_Type : 40|10@1+ (1,0) [0|1023] ""  DASy
 SG_ VFC_TS14_ExistProb : 50|5@1+ (5,0) [0|100] "%"  DASy
 SG_ VFC_TS14_Px : 55|9@1+ (0.25,0) [0|127.75] "m"  DASy
 SG_ VFC_TS14_Py : 64|8@1+ (0.2,-25.6) [-25.6|25.4] "m"  DASy
 SG_ VFC_TS14_Pz : 72|6@1+ (0.2,0) [0|12.6] "m"  DASy
 SG_ VFC_TS14_PxStdDev : 78|9@1+ (0.25,0) [0|127.75] "m"  DASy
 SG_ VFC_TS14_Width : 87|4@1+ (0.2,0) [0|3] "m"  DASy
 SG_ VFC_TS14_Height : 91|4@1+ (0.2,0) [0|3] "m"  DASy
 SG_ VFC_TS14_EmbeddedInfo : 95|4@1+ (1,0) [0|15] ""  DASy
 SG_ VFC_TS14_ValidLane : 99|5@1+ (1,0) [0|31] ""  DASy
 SG_ VFC_TS14_ValidDay : 104|7@1+ (1,0) [0|127] ""  DASy
 SG_ VFC_TS14_ValidTimeRange1Start : 111|7@1+ (15,0) [0|1440] "min"  DASy
 SG_ VFC_TS14_ValidTimeRange1End : 118|7@1+ (15,0) [0|1440] "min"  DASy
 SG_ VFC_TS14_ValidTimeRange2Start : 125|7@1+ (15,0) [0|1440] "min"  DASy
 SG_ VFC_TS14_ValidTimeRange2End : 132|7@1+ (15,0) [0|1440] "min"  DASy
 SG_ VFC_TS14_ValidInDist : 139|15@1+ (0.1,0) [0|3276.7] ""  DASy
 SG_ VFC_TS14_ValidInDistUnit : 154|3@1+ (1,0) [0|7] ""  DASy
 SG_ VFC_TS14_ValidSection : 157|15@1+ (0.1,0) [0|3276.7] ""  DASy
 SG_ VFC_TS14_ValidSectionUnit : 172|3@1+ (1,0) [0|7] ""  DASy
 SG_ VFC_TS14_NumValidSupSigns : 175|3@1+ (1,0) [0|6] ""  DASy
 SG_ VFC_TS14_SupSign0ExistProb : 178|5@1+ (5,0) [0|100] "%"  DASy
 SG_ VFC_TS14_SupSign1ExistProb : 183|5@1+ (5,0) [0|100] "%"  DASy
 SG_ VFC_TS14_SupSign2ExistProb : 188|5@1+ (5,0) [0|100] "%"  DASy
 SG_ VFC_TS14_SupSign3ExistProb : 193|5@1+ (5,0) [0|100] "%"  DASy
 SG_ VFC_TS14_SupSign4ExistProb : 198|5@1+ (5,0) [0|100] "%"  DASy
 SG_ VFC_TS14_SupSign5ExistProb : 203|5@1+ (5,0) [0|100] "%"  DASy
 SG_ VFC_TS14_SupSign0Type : 208|8@1+ (1,0) [0|255] ""  DASy
 SG_ VFC_TS14_SupSign1Type : 216|8@1+ (1,0) [0|255] ""  DASy
 SG_ VFC_TS14_SupSign2Type : 224|8@1+ (1,0) [0|255] ""  DASy
 SG_ VFC_TS14_SupSign3Type : 232|8@1+ (1,0) [0|255] ""  DASy
 SG_ VFC_TS14_SupSign4Type : 240|8@1+ (1,0) [0|255] ""  DASy
 SG_ VFC_TS14_SupSign5Type : 248|8@1+ (1,0) [0|255] ""  DASy
 SG_ VFC_TS15_ObjId : 272|8@1+ (1,0) [0|255] ""  DASy
 SG_ VFC_TS15_Type : 280|10@1+ (1,0) [0|1023] ""  DASy
 SG_ VFC_TS15_ExistProb : 290|5@1+ (5,0) [0|100] "%"  DASy
 SG_ VFC_TS15_Px : 295|9@1+ (0.25,0) [0|127.75] "m"  DASy
 SG_ VFC_TS15_Py : 304|8@1+ (0.2,-25.6) [-25.6|25.4] "m"  DASy
 SG_ VFC_TS15_Pz : 312|6@1+ (0.2,0) [0|12.6] "m"  DASy
 SG_ VFC_TS15_PxStdDev : 318|9@1+ (0.25,0) [0|127.75] "m"  DASy
 SG_ VFC_TS15_Width : 327|4@1+ (0.2,0) [0|3] "m"  DASy
 SG_ VFC_TS15_Height : 331|4@1+ (0.2,0) [0|3] "m"  DASy
 SG_ VFC_TS15_EmbeddedInfo : 335|4@1+ (1,0) [0|15] ""  DASy
 SG_ VFC_TS15_ValidLane : 339|5@1+ (1,0) [0|31] ""  DASy
 SG_ VFC_TS15_ValidDay : 344|7@1+ (1,0) [0|127] ""  DASy
 SG_ VFC_TS15_ValidTimeRange1Start : 351|7@1+ (15,0) [0|1440] "min"  DASy
 SG_ VFC_TS15_ValidTimeRange1End : 358|7@1+ (15,0) [0|1440] "min"  DASy
 SG_ VFC_TS15_ValidTimeRange2Start : 365|7@1+ (15,0) [0|1440] "min"  DASy
 SG_ VFC_TS15_ValidTimeRange2End : 372|7@1+ (15,0) [0|1440] "min"  DASy
 SG_ VFC_TS15_ValidInDist : 379|15@1+ (0.1,0) [0|3276.7] ""  DASy
 SG_ VFC_TS15_ValidInDistUnit : 394|3@1+ (1,0) [0|7] ""  DASy
 SG_ VFC_TS15_ValidSection : 397|15@1+ (0.1,0) [0|3276.7] ""  DASy
 SG_ VFC_TS15_ValidSectionUnit : 412|3@1+ (1,0) [0|7] ""  DASy
 SG_ VFC_TS15_NumValidSupSigns : 415|3@1+ (1,0) [0|6] ""  DASy
 SG_ VFC_TS15_SupSign0ExistProb : 418|5@1+ (5,0) [0|100] "%"  DASy
 SG_ VFC_TS15_SupSign1ExistProb : 423|5@1+ (5,0) [0|100] "%"  DASy
 SG_ VFC_TS15_SupSign2ExistProb : 428|5@1+ (5,0) [0|100] "%"  DASy
 SG_ VFC_TS15_SupSign3ExistProb : 433|5@1+ (5,0) [0|100] "%"  DASy
 SG_ VFC_TS15_SupSign4ExistProb : 438|5@1+ (5,0) [0|100] "%"  DASy
 SG_ VFC_TS15_SupSign5ExistProb : 443|5@1+ (5,0) [0|100] "%"  DASy
 SG_ VFC_TS15_SupSign0Type : 448|8@1+ (1,0) [0|255] ""  DASy
 SG_ VFC_TS15_SupSign1Type : 456|8@1+ (1,0) [0|255] ""  DASy
 SG_ VFC_TS15_SupSign2Type : 464|8@1+ (1,0) [0|255] ""  DASy
 SG_ VFC_TS15_SupSign3Type : 472|8@1+ (1,0) [0|255] ""  DASy
 SG_ VFC_TS15_SupSign4Type : 480|8@1+ (1,0) [0|255] ""  DASy
 SG_ VFC_TS15_SupSign5Type : 488|8@1+ (1,0) [0|255] ""  DASy

BO_ 260 RFC_LocationHdrA: 64 RadarFrontCenter
 SG_ RFC_LocHdrA_CRC : 0|16@1+ (1,0) [0|65535] ""  DASy
 SG_ RFC_LocHdrA_AliveCtr : 16|8@1+ (1,0) [0|255] ""  DASy
 SG_ RFC_LocHdrA_ProtBlockCtr : 24|4@1+ (1,0) [0|15] ""  DASy
 SG_ RFC_LocHdr_IfVersionIdMajor : 32|8@1+ (1,0) [0|255] ""  DASy
 SG_ RFC_LocHdr_IfVersionIdMinor : 40|8@1+ (1,0) [0|255] ""  DASy
 SG_ RFC_LocHdr_NumValidDetections : 48|10@1+ (1,0) [0|1023] ""  DASy
 SG_ RFC_LocHdr_TimeStamp : 64|26@1+ (1,0) [0|67108863] "ms"  DASy
 SG_ RFC_LocHdr_SensorStatus : 96|8@1+ (1,0) [0|255] ""  DASy
 SG_ RFC_LocHdr_SensorStatusExt : 104|7@1+ (1,0) [0|127] ""  DASy
 SG_ RFC_LocHdr_LocDownSel : 111|1@1+ (1,0) [0|1] ""  DASy
 SG_ RFC_LocHdr_TimeStampStatus : 112|8@1+ (1,0) [0|255] ""  DASy
 SG_ RFC_LocHdr_BlindnessEvent : 120|8@1+ (1,0) [0|255] ""  DASy
 SG_ RFC_LocHdr_SwVersion : 128|20@1+ (0.01,0) [0|9999.99] ""  DASy
 SG_ RFC_LocHdr_SensorOriginPointY : 152|8@1+ (0.01,-1.28) [-1.28|1.27] "m"  DASy
 SG_ RFC_LocHdr_SensorOriginPointX : 160|9@1+ (0.02,-5.12) [-5.12|5.1] "m"  DASy
 SG_ RFC_LocHdr_SensorOriginPointZ : 171|5@1+ (0.05,0) [0|1.55] "m"  DASy
 SG_ RFC_LocHdr_SensorOrientCorrYaw : 176|16@1+ (0.0001,-3.2768) [-3.2|3.2] "rad"  DASy
 SG_ RFC_LocHdr_SensorOrientCorrPitch : 192|14@1+ (0.0001,-0.8192) [-0.8192|0.8191] "rad"  DASy
 SG_ RFC_LocHdr_SensorOrientYaw : 208|16@1+ (0.0001,-3.2768) [-3.2|3.2] "rad"  DASy
 SG_ RFC_LocHdr_SensorOrientPitch : 224|14@1+ (0.0001,-0.8192) [-0.8192|0.8191] "rad"  DASy
 SG_ RFC_LocHdr_ModPerfDistanceMax : 288|16@1+ (0.01,0) [0|655.35] "m"  DASy
 SG_ RFC_LocHdr_FovElev00RangeGain : 304|7@1+ (0.01,0) [0|1] "unitless"  DASy
 SG_ RFC_LocHdr_FovElev01RangeGain : 312|7@1+ (0.01,0) [0|1] "unitless"  DASy
 SG_ RFC_LocHdr_FovElev02RangeGain : 320|7@1+ (0.01,0) [0|1] "unitless"  DASy
 SG_ RFC_LocHdr_FovElev03RangeGain : 328|7@1+ (0.01,0) [0|1] "unitless"  DASy
 SG_ RFC_LocHdr_FovElev04RangeGain : 336|7@1+ (0.01,0) [0|1] "unitless"  DASy
 SG_ RFC_LocHdr_FovElev05RangeGain : 344|7@1+ (0.01,0) [0|1] "unitless"  DASy
 SG_ RFC_LocHdr_FovElev06RangeGain : 352|7@1+ (0.01,0) [0|1] "unitless"  DASy
 SG_ RFC_LocHdr_FovElev07RangeGain : 360|7@1+ (0.01,0) [0|1] "unitless"  DASy
 SG_ RFC_LocHdr_FovElev08RangeGain : 368|7@1+ (0.01,0) [0|1] "unitless"  DASy
 SG_ RFC_LocHdr_FovElev09RangeGain : 376|7@1+ (0.01,0) [0|1] "unitless"  DASy
 SG_ RFC_LocHdr_FovElev10RangeGain : 384|7@1+ (0.01,0) [0|1] "unitless"  DASy
 SG_ RFC_LocHdr_FovElevation00 : 392|7@1+ (1,-64) [-45|45] "deg"  DASy
 SG_ RFC_LocHdr_FovElevation01 : 400|7@1+ (1,-64) [-45|45] "deg"  DASy
 SG_ RFC_LocHdr_FovElevation02 : 408|7@1+ (1,-64) [-45|45] "deg"  DASy
 SG_ RFC_LocHdr_FovElevation03 : 416|7@1+ (1,-64) [-45|45] "deg"  DASy
 SG_ RFC_LocHdr_FovElevation04 : 424|7@1+ (1,-64) [-45|45] "deg"  DASy
 SG_ RFC_LocHdr_FovElevation05 : 432|7@1+ (1,-64) [-45|45] "deg"  DASy
 SG_ RFC_LocHdr_FovElevation06 : 440|7@1+ (1,-64) [-45|45] "deg"  DASy
 SG_ RFC_LocHdr_FovElevation07 : 448|7@1+ (1,-64) [-45|45] "deg"  DASy
 SG_ RFC_LocHdr_FovElevation08 : 456|7@1+ (1,-64) [-45|45] "deg"  DASy
 SG_ RFC_LocHdr_FovElevation09 : 464|7@1+ (1,-64) [-45|45] "deg"  DASy
 SG_ RFC_LocHdr_FovElevation10 : 472|7@1+ (1,-64) [-45|45] "deg"  DASy

BO_ 261 RFC_LocationHdrB: 64 RadarFrontCenter
 SG_ RFC_LocHdrB_CRC : 0|16@1+ (1,0) [0|65535] ""  DASy
 SG_ RFC_LocHdrB_AliveCtr : 16|8@1+ (1,0) [0|255] ""  DASy
 SG_ RFC_LocHdrB_ProtBlockCtr : 24|4@1+ (1,0) [0|15] ""  DASy
 SG_ RFC_LocHdr_FovAzimuth00Range : 32|9@1+ (1,0) [0|511] "m"  DASy
 SG_ RFC_LocHdr_FovAzimuth01Range : 41|9@1+ (1,0) [0|511] "m"  DASy
 SG_ RFC_LocHdr_FovAzimuth02Range : 50|9@1+ (1,0) [0|511] "m"  DASy
 SG_ RFC_LocHdr_FovAzimuth03Range : 59|9@1+ (1,0) [0|511] "m"  DASy
 SG_ RFC_LocHdr_FovAzimuth04Range : 68|9@1+ (1,0) [0|511] "m"  DASy
 SG_ RFC_LocHdr_FovAzimuth05Range : 77|9@1+ (1,0) [0|511] "m"  DASy
 SG_ RFC_LocHdr_FovAzimuth06Range : 86|9@1+ (1,0) [0|511] "m"  DASy
 SG_ RFC_LocHdr_FovAzimuth07Range : 95|9@1+ (1,0) [0|511] "m"  DASy
 SG_ RFC_LocHdr_FovAzimuth08Range : 104|9@1+ (1,0) [0|511] "m"  DASy
 SG_ RFC_LocHdr_FovAzimuth09Range : 113|9@1+ (1,0) [0|511] "m"  DASy
 SG_ RFC_LocHdr_FovAzimuth10Range : 122|9@1+ (1,0) [0|511] "m"  DASy
 SG_ RFC_LocHdr_FovAzimuth11Range : 131|9@1+ (1,0) [0|511] "m"  DASy
 SG_ RFC_LocHdr_FovAzimuth12Range : 140|9@1+ (1,0) [0|511] "m"  DASy
 SG_ RFC_LocHdr_FovAzimuth13Range : 149|9@1+ (1,0) [0|511] "m"  DASy
 SG_ RFC_LocHdr_FovAzimuth14Range : 158|9@1+ (1,0) [0|511] "m"  DASy
 SG_ RFC_LocHdr_FovAzimuth15Range : 167|9@1+ (1,0) [0|511] "m"  DASy
 SG_ RFC_LocHdr_FovAzimuth16Range : 176|9@1+ (1,0) [0|511] "m"  DASy
 SG_ RFC_LocHdr_FovAzimuth17Range : 185|9@1+ (1,0) [0|511] "m"  DASy
 SG_ RFC_LocHdr_FovAzimuth18Range : 194|9@1+ (1,0) [0|511] "m"  DASy
 SG_ RFC_LocHdr_FovAzimuth19Range : 203|9@1+ (1,0) [0|511] "m"  DASy
 SG_ RFC_LocHdr_FovAzimuth20Range : 212|9@1+ (1,0) [0|511] "m"  DASy
 SG_ RFC_LocHdr_FovAzimuth21Range : 221|9@1+ (1,0) [0|511] "m"  DASy
 SG_ RFC_LocHdr_FovAzimuth22Range : 230|9@1+ (1,0) [0|511] "m"  DASy
 SG_ RFC_LocHdr_FovAzimuth23Range : 239|9@1+ (1,0) [0|511] "m"  DASy
 SG_ RFC_LocHdr_FovAzimuth24Range : 248|9@1+ (1,0) [0|511] "m"  DASy
 SG_ RFC_LocHdr_FovAzimuth00 : 264|8@1+ (1,-128) [-90|90] "deg"  DASy
 SG_ RFC_LocHdr_FovAzimuth01 : 272|8@1+ (1,-128) [-90|90] "deg"  DASy
 SG_ RFC_LocHdr_FovAzimuth02 : 280|8@1+ (1,-128) [-90|90] "deg"  DASy
 SG_ RFC_LocHdr_FovAzimuth03 : 288|8@1+ (1,-128) [-90|90] "deg"  DASy
 SG_ RFC_LocHdr_FovAzimuth04 : 296|8@1+ (1,-128) [-90|90] "deg"  DASy
 SG_ RFC_LocHdr_FovAzimuth05 : 304|8@1+ (1,-128) [-90|90] "deg"  DASy
 SG_ RFC_LocHdr_FovAzimuth06 : 312|8@1+ (1,-128) [-90|90] "deg"  DASy
 SG_ RFC_LocHdr_FovAzimuth07 : 320|8@1+ (1,-128) [-90|90] "deg"  DASy
 SG_ RFC_LocHdr_FovAzimuth08 : 328|8@1+ (1,-128) [-90|90] "deg"  DASy
 SG_ RFC_LocHdr_FovAzimuth09 : 336|8@1+ (1,-128) [-90|90] "deg"  DASy
 SG_ RFC_LocHdr_FovAzimuth10 : 344|8@1+ (1,-128) [-90|90] "deg"  DASy
 SG_ RFC_LocHdr_FovAzimuth11 : 352|8@1+ (1,-128) [-90|90] "deg"  DASy
 SG_ RFC_LocHdr_FovAzimuth12 : 360|8@1+ (1,-128) [-90|90] "deg"  DASy
 SG_ RFC_LocHdr_FovAzimuth13 : 368|8@1+ (1,-128) [-90|90] "deg"  DASy
 SG_ RFC_LocHdr_FovAzimuth14 : 376|8@1+ (1,-128) [-90|90] "deg"  DASy
 SG_ RFC_LocHdr_FovAzimuth15 : 384|8@1+ (1,-128) [-90|90] "deg"  DASy
 SG_ RFC_LocHdr_FovAzimuth16 : 392|8@1+ (1,-128) [-90|90] "deg"  DASy
 SG_ RFC_LocHdr_FovAzimuth17 : 400|8@1+ (1,-128) [-90|90] "deg"  DASy
 SG_ RFC_LocHdr_FovAzimuth18 : 408|8@1+ (1,-128) [-90|90] "deg"  DASy
 SG_ RFC_LocHdr_FovAzimuth19 : 416|8@1+ (1,-128) [-90|90] "deg"  DASy
 SG_ RFC_LocHdr_FovAzimuth20 : 424|8@1+ (1,-128) [-90|90] "deg"  DASy
 SG_ RFC_LocHdr_FovAzimuth21 : 432|8@1+ (1,-128) [-90|90] "deg"  DASy
 SG_ RFC_LocHdr_FovAzimuth22 : 440|8@1+ (1,-128) [-90|90] "deg"  DASy
 SG_ RFC_LocHdr_FovAzimuth23 : 448|8@1+ (1,-128) [-90|90] "deg"  DASy
 SG_ RFC_LocHdr_FovAzimuth24 : 456|8@1+ (1,-128) [-90|90] "deg"  DASy

BO_ 264 RFC_Location_000_002: 64 RadarFrontCenter
 SG_ RFC_Loc000_002_CRC : 0|16@1+ (1,0) [0|65535] ""  DASy
 SG_ RFC_Loc000_002_AliveCtr : 16|8@1+ (1,0) [0|255] ""  DASy
 SG_ RFC_Loc000_002_ProtBlockCtr : 24|4@1+ (1,0) [0|15] ""  DASy
 SG_ RFC_Loc000_RadialDistance : 32|15@1+ (0.01,0) [0|327.67] "m"  DASy
 SG_ RFC_Loc000_RadialVelocity : 47|15@1+ (0.01,-163.84) [-110|55] "m/s"  DASy
 SG_ RFC_Loc000_Elevation : 62|10@1+ (0.1,-51.2) [-45|45] "deg"  DASy
 SG_ RFC_Loc000_Azimuth : 72|11@1+ (0.1,-102.4) [-90|90] "deg"  DASy
 SG_ RFC_Loc000_DistVelocityCoVnce : 83|11@1+ (0.0001,-0.1024) [-0.1024|0.1023] "m^2/s"  DASy
 SG_ RFC_Loc000_RadialDistanceVnce : 94|10@1+ (5E-005,0) [0|0.05115] "m^2"  DASy
 SG_ RFC_Loc000_RadialVelocityVnce : 104|10@1+ (0.0001,0) [0|0.1023] "m^2/s^2"  DASy
 SG_ RFC_Loc000_ElevationVnce : 114|10@1+ (0.001,0) [0|1.023] "deg^2"  DASy
 SG_ RFC_Loc000_AzimuthVnce : 124|10@1+ (0.001,0) [0|1.023] "deg^2"  DASy
 SG_ RFC_Loc000_RadarCrossSection : 134|10@1+ (0.2,-102.4) [-50|70] "dBsm"  DASy
 SG_ RFC_Loc000_DistVelocityQuality : 144|8@1+ (1,0) [0|255] "unitless"  DASy
 SG_ RFC_Loc000_ElevationQuality : 152|8@1+ (1,0) [0|255] "unitless"  DASy
 SG_ RFC_Loc000_AzimuthQuality : 160|8@1+ (1,0) [0|255] "unitless"  DASy
 SG_ RFC_Loc000_RSSI : 168|10@1+ (0.1,0) [0|100] "unitless"  DASy
 SG_ RFC_Loc000_AzimuthalPartnerId : 178|10@1+ (1,0) [0|1023] "unitless"  DASy
 SG_ RFC_Loc001_RadialDistance : 192|15@1+ (0.01,0) [0|327.67] "m"  DASy
 SG_ RFC_Loc001_RadialVelocity : 207|15@1+ (0.01,-163.84) [-110|55] "m/s"  DASy
 SG_ RFC_Loc001_Elevation : 222|10@1+ (0.1,-51.2) [-45|45] "deg"  DASy
 SG_ RFC_Loc001_Azimuth : 232|11@1+ (0.1,-102.4) [-90|90] "deg"  DASy
 SG_ RFC_Loc001_DistVelocityCoVnce : 243|11@1+ (0.0001,-0.1024) [-0.1024|0.1023] "m^2/s"  DASy
 SG_ RFC_Loc001_RadialDistanceVnce : 254|10@1+ (5E-005,0) [0|0.05115] "m^2"  DASy
 SG_ RFC_Loc001_RadialVelocityVnce : 264|10@1+ (0.0001,0) [0|0.1023] "m^2/s^2"  DASy
 SG_ RFC_Loc001_ElevationVnce : 274|10@1+ (0.001,0) [0|1.023] "deg^2"  DASy
 SG_ RFC_Loc001_AzimuthVnce : 284|10@1+ (0.001,0) [0|1.023] "deg^2"  DASy
 SG_ RFC_Loc001_RadarCrossSection : 294|10@1+ (0.2,-102.4) [-50|70] "dBsm"  DASy
 SG_ RFC_Loc001_DistVelocityQuality : 304|8@1+ (1,0) [0|255] "unitless"  DASy
 SG_ RFC_Loc001_ElevationQuality : 312|8@1+ (1,0) [0|255] "unitless"  DASy
 SG_ RFC_Loc001_AzimuthQuality : 320|8@1+ (1,0) [0|255] "unitless"  DASy
 SG_ RFC_Loc001_RSSI : 328|10@1+ (0.1,0) [0|100] "unitless"  DASy
 SG_ RFC_Loc001_AzimuthalPartnerId : 338|10@1+ (1,0) [0|1023] "unitless"  DASy
 SG_ RFC_Loc002_RadialDistance : 352|15@1+ (0.01,0) [0|327.67] "m"  DASy
 SG_ RFC_Loc002_RadialVelocity : 367|15@1+ (0.01,-163.84) [-110|55] "m/s"  DASy
 SG_ RFC_Loc002_Elevation : 382|10@1+ (0.1,-51.2) [-45|45] "deg"  DASy
 SG_ RFC_Loc002_Azimuth : 392|11@1+ (0.1,-102.4) [-90|90] "deg"  DASy
 SG_ RFC_Loc002_DistVelocityCoVnce : 403|11@1+ (0.0001,-0.1024) [-0.1024|0.1023] "m^2/s"  DASy
 SG_ RFC_Loc002_RadialDistanceVnce : 414|10@1+ (5E-005,0) [0|0.05115] "m^2"  DASy
 SG_ RFC_Loc002_RadialVelocityVnce : 424|10@1+ (0.0001,0) [0|0.1023] "m^2/s^2"  DASy
 SG_ RFC_Loc002_ElevationVnce : 434|10@1+ (0.001,0) [0|1.023] "deg^2"  DASy
 SG_ RFC_Loc002_AzimuthVnce : 444|10@1+ (0.001,0) [0|1.023] "deg^2"  DASy
 SG_ RFC_Loc002_RadarCrossSection : 454|10@1+ (0.2,-102.4) [-50|70] "dBsm"  DASy
 SG_ RFC_Loc002_DistVelocityQuality : 464|8@1+ (1,0) [0|255] "unitless"  DASy
 SG_ RFC_Loc002_ElevationQuality : 472|8@1+ (1,0) [0|255] "unitless"  DASy
 SG_ RFC_Loc002_AzimuthQuality : 480|8@1+ (1,0) [0|255] "unitless"  DASy
 SG_ RFC_Loc002_RSSI : 488|10@1+ (0.1,0) [0|100] "unitless"  DASy
 SG_ RFC_Loc002_AzimuthalPartnerId : 498|10@1+ (1,0) [0|1023] "unitless"  DASy

BO_ 265 RFC_Location_003_005: 64 RadarFrontCenter
 SG_ RFC_Loc003_005_CRC : 0|16@1+ (1,0) [0|65535] ""  DASy
 SG_ RFC_Loc003_005_AliveCtr : 16|8@1+ (1,0) [0|255] ""  DASy
 SG_ RFC_Loc003_005_ProtBlockCtr : 24|4@1+ (1,0) [0|15] ""  DASy
 SG_ RFC_Loc003_RadialDistance : 32|15@1+ (0.01,0) [0|327.67] "m"  DASy
 SG_ RFC_Loc003_RadialVelocity : 47|15@1+ (0.01,-163.84) [-110|55] "m/s"  DASy
 SG_ RFC_Loc003_Elevation : 62|10@1+ (0.1,-51.2) [-45|45] "deg"  DASy
 SG_ RFC_Loc003_Azimuth : 72|11@1+ (0.1,-102.4) [-90|90] "deg"  DASy
 SG_ RFC_Loc003_DistVelocityCoVnce : 83|11@1+ (0.0001,-0.1024) [-0.1024|0.1023] "m^2/s"  DASy
 SG_ RFC_Loc003_RadialDistanceVnce : 94|10@1+ (5E-005,0) [0|0.05115] "m^2"  DASy
 SG_ RFC_Loc003_RadialVelocityVnce : 104|10@1+ (0.0001,0) [0|0.1023] "m^2/s^2"  DASy
 SG_ RFC_Loc003_ElevationVnce : 114|10@1+ (0.001,0) [0|1.023] "deg^2"  DASy
 SG_ RFC_Loc003_AzimuthVnce : 124|10@1+ (0.001,0) [0|1.023] "deg^2"  DASy
 SG_ RFC_Loc003_RadarCrossSection : 134|10@1+ (0.2,-102.4) [-50|70] "dBsm"  DASy
 SG_ RFC_Loc003_DistVelocityQuality : 144|8@1+ (1,0) [0|255] "unitless"  DASy
 SG_ RFC_Loc003_ElevationQuality : 152|8@1+ (1,0) [0|255] "unitless"  DASy
 SG_ RFC_Loc003_AzimuthQuality : 160|8@1+ (1,0) [0|255] "unitless"  DASy
 SG_ RFC_Loc003_RSSI : 168|10@1+ (0.1,0) [0|100] "unitless"  DASy
 SG_ RFC_Loc003_AzimuthalPartnerId : 178|10@1+ (1,0) [0|1023] "unitless"  DASy
 SG_ RFC_Loc004_RadialDistance : 192|15@1+ (0.01,0) [0|327.67] "m"  DASy
 SG_ RFC_Loc004_RadialVelocity : 207|15@1+ (0.01,-163.84) [-110|55] "m/s"  DASy
 SG_ RFC_Loc004_Elevation : 222|10@1+ (0.1,-51.2) [-45|45] "deg"  DASy
 SG_ RFC_Loc004_Azimuth : 232|11@1+ (0.1,-102.4) [-90|90] "deg"  DASy
 SG_ RFC_Loc004_DistVelocityCoVnce : 243|11@1+ (0.0001,-0.1024) [-0.1024|0.1023] "m^2/s"  DASy
 SG_ RFC_Loc004_RadialDistanceVnce : 254|10@1+ (5E-005,0) [0|0.05115] "m^2"  DASy
 SG_ RFC_Loc004_RadialVelocityVnce : 264|10@1+ (0.0001,0) [0|0.1023] "m^2/s^2"  DASy
 SG_ RFC_Loc004_ElevationVnce : 274|10@1+ (0.001,0) [0|1.023] "deg^2"  DASy
 SG_ RFC_Loc004_AzimuthVnce : 284|10@1+ (0.001,0) [0|1.023] "deg^2"  DASy
 SG_ RFC_Loc004_RadarCrossSection : 294|10@1+ (0.2,-102.4) [-50|70] "dBsm"  DASy
 SG_ RFC_Loc004_DistVelocityQuality : 304|8@1+ (1,0) [0|255] "unitless"  DASy
 SG_ RFC_Loc004_ElevationQuality : 312|8@1+ (1,0) [0|255] "unitless"  DASy
 SG_ RFC_Loc004_AzimuthQuality : 320|8@1+ (1,0) [0|255] "unitless"  DASy
 SG_ RFC_Loc004_RSSI : 328|10@1+ (0.1,0) [0|100] "unitless"  DASy
 SG_ RFC_Loc004_AzimuthalPartnerId : 338|10@1+ (1,0) [0|1023] "unitless"  DASy
 SG_ RFC_Loc005_RadialDistance : 352|15@1+ (0.01,0) [0|327.67] "m"  DASy
 SG_ RFC_Loc005_RadialVelocity : 367|15@1+ (0.01,-163.84) [-110|55] "m/s"  DASy
 SG_ RFC_Loc005_Elevation : 382|10@1+ (0.1,-51.2) [-45|45] "deg"  DASy
 SG_ RFC_Loc005_Azimuth : 392|11@1+ (0.1,-102.4) [-90|90] "deg"  DASy
 SG_ RFC_Loc005_DistVelocityCoVnce : 403|11@1+ (0.0001,-0.1024) [-0.1024|0.1023] "m^2/s"  DASy
 SG_ RFC_Loc005_RadialDistanceVnce : 414|10@1+ (5E-005,0) [0|0.05115] "m^2"  DASy
 SG_ RFC_Loc005_RadialVelocityVnce : 424|10@1+ (0.0001,0) [0|0.1023] "m^2/s^2"  DASy
 SG_ RFC_Loc005_ElevationVnce : 434|10@1+ (0.001,0) [0|1.023] "deg^2"  DASy
 SG_ RFC_Loc005_AzimuthVnce : 444|10@1+ (0.001,0) [0|1.023] "deg^2"  DASy
 SG_ RFC_Loc005_RadarCrossSection : 454|10@1+ (0.2,-102.4) [-50|70] "dBsm"  DASy
 SG_ RFC_Loc005_DistVelocityQuality : 464|8@1+ (1,0) [0|255] "unitless"  DASy
 SG_ RFC_Loc005_ElevationQuality : 472|8@1+ (1,0) [0|255] "unitless"  DASy
 SG_ RFC_Loc005_AzimuthQuality : 480|8@1+ (1,0) [0|255] "unitless"  DASy
 SG_ RFC_Loc005_RSSI : 488|10@1+ (0.1,0) [0|100] "unitless"  DASy
 SG_ RFC_Loc005_AzimuthalPartnerId : 498|10@1+ (1,0) [0|1023] "unitless"  DASy

CM_ SG_ 244 VFC_TS_12_13_CRC "CRC - Autosar E2E Profile 5";
CM_ SG_ 244 VFC_TS_12_13_AliveCtr "Alive counter - Autosar E2E Profile 5";
CM_ SG_ 244 VFC_TS_12_13_ProtBlockCtr "Protocol-Signal: Block-Counter";
CM_ SG_ 244 VFC_TS12_ObjId "Unique Traffic Sign ID. ISO 23150:2022(E): Object ID (A.2.2)";
CM_ SG_ 244 VFC_TS12_Type "The type of main sign. ISO 23150:2022(E): Sign classification type (A.2.98)";
CM_ SG_ 244 VFC_TS12_ExistProb "Probability that the sign is a traffic sign. ISO 23150:2022(E): Existence probability - object level (A.2.1)";
CM_ SG_ 244 VFC_TS12_Px "Traffic sign position in longitudinal direction. ISO 23150:2022(E): Position - object level {x, y, z} (A.2.15)";
CM_ SG_ 244 VFC_TS12_Py "Traffic sign position in lateral direction. ISO 23150:2022(E): Position - object level {x, y, z} (A.2.15)";
CM_ SG_ 244 VFC_TS12_Pz "Traffic sign position in vertical direction. ISO 23150:2022(E): Position - object level {x, y, z} (A.2.15)";
CM_ SG_ 244 VFC_TS12_PxStdDev "Standard deviation of Traffic sign position in longitudinal direction. ISO 23150:2022(E): Position - object level {x, y, z} - error (A.2.16)";
CM_ SG_ 244 VFC_TS12_Width "Width of the traffic sign. ISO 23150:2022(E): Bounding box extent {length, width, height} (A.2.20)";
CM_ SG_ 244 VFC_TS12_Height "Height of the traffic sign. ISO 23150:2022(E): Bounding box extent {length, width, height} (A.2.20)";
CM_ SG_ 244 VFC_TS12_EmbeddedInfo "Information how the sign is embedded or not";
CM_ SG_ 244 VFC_TS12_ValidLane "Indicates on which lane the detected sign is valid. If traffic sign is generally valid, all bits shall be set. No relevance to ego lane, signal related to ISO 23150:2022(E): Lane relevance classification type (A.2.147)
Bitfield:
Bit 0: valid on first right hand lane
Bit 1: valid on second right hand lane
Bit 2: valid on third right hand lane
Bit 3: valid on fourth right hand lane
Bit 4: valid on fifth right hand lane";
CM_ SG_ 244 VFC_TS12_ValidDay "The week days for which the main traffic sign is valid. If traffic sign is generally valid, all bits shall be set. Related to ISO 23150:2022(E): Sign text (A.2.102)
Bitfield:
Bit 0: MONDAY
Bit 1: TUESDAY
Bit 2: WEDNESDAY
Bit 3: THURSDAY
Bit 4: FRIDAY
Bit 5: SATURDAY
Bit 6: SUNDAY";
CM_ SG_ 244 VFC_TS12_ValidTimeRange1Start "Start time for the first time range in which the main traffic sign is valid. Minutes since midnight. Related to ISO 23150:2022(E): Sign text (A.2.102)";
CM_ SG_ 244 VFC_TS12_ValidTimeRange1End "End time for the first time range in which the main traffic sign is valid. Minutes since midnight. Related to ISO 23150:2022(E): Sign text (A.2.102)";
CM_ SG_ 244 VFC_TS12_ValidTimeRange2Start "Start time for the second time range in which the main traffic sign is valid. Minutes since midnight. Related to ISO 23150:2022(E): Sign text (A.2.102)";
CM_ SG_ 244 VFC_TS12_ValidTimeRange2End "End time for the second time range in which the main traffic sign is valid. Minutes since midnight. Related to ISO 23150:2022(E): Sign text (A.2.102)";
CM_ SG_ 244 VFC_TS12_ValidInDist "Indicates the longitudinal distance in which the validity of the main traffic sign starts. Unit is set in signal ValidInDistUnit. Related to ISO 23150:2022(E): Sign text (A.2.102)";
CM_ SG_ 244 VFC_TS12_ValidInDistUnit "Unit for signal ValidInDist. ISO 23150:2022(E): Sign value unit (A.2.101)";
CM_ SG_ 244 VFC_TS12_ValidSection "Indicates the longitudinal section for which the main traffic sign is valid. Unit is set in signal ValidSectionUnit. Related to ISO 23150:2022(E): Sign text (A.2.102)";
CM_ SG_ 244 VFC_TS12_ValidSectionUnit "Unit for signal ValidSection. ISO 23150:2022(E): Sign value unit (A.2.101)";
CM_ SG_ 244 VFC_TS12_NumValidSupSigns "Number of valid supplementary signs attached to the main sign. ISO 23150:2022(E): Number of valid traffic supplementary signs (A.2.149)";
CM_ SG_ 244 VFC_TS12_SupSign0ExistProb "Probability that the sign is a supplementary traffic sign. ISO 23150:2022(E): Existence probability - object level (A.2.1)";
CM_ SG_ 244 VFC_TS12_SupSign1ExistProb "Probability that the sign is a supplementary traffic sign. ISO 23150:2022(E): Existence probability - object level (A.2.1)";
CM_ SG_ 244 VFC_TS12_SupSign2ExistProb "Probability that the sign is a supplementary traffic sign. ISO 23150:2022(E): Existence probability - object level (A.2.1)";
CM_ SG_ 244 VFC_TS12_SupSign3ExistProb "Probability that the sign is a supplementary traffic sign. ISO 23150:2022(E): Existence probability - object level (A.2.1)";
CM_ SG_ 244 VFC_TS12_SupSign4ExistProb "Probability that the sign is a supplementary traffic sign. ISO 23150:2022(E): Existence probability - object level (A.2.1)";
CM_ SG_ 244 VFC_TS12_SupSign5ExistProb "Probability that the sign is a supplementary traffic sign. ISO 23150:2022(E): Existence probability - object level (A.2.1)";
CM_ SG_ 244 VFC_TS12_SupSign0Type "The type of supplementary sign. ISO 23150:2022(E): Supplementary sign classification type (A.2.151)";
CM_ SG_ 244 VFC_TS12_SupSign1Type "The type of supplementary sign. ISO 23150:2022(E): Supplementary sign classification type (A.2.151)";
CM_ SG_ 244 VFC_TS12_SupSign2Type "The type of supplementary sign. ISO 23150:2022(E): Supplementary sign classification type (A.2.151)";
CM_ SG_ 244 VFC_TS12_SupSign3Type "The type of supplementary sign. ISO 23150:2022(E): Supplementary sign classification type (A.2.151)";
CM_ SG_ 244 VFC_TS12_SupSign4Type "The type of supplementary sign. ISO 23150:2022(E): Supplementary sign classification type (A.2.151)";
CM_ SG_ 244 VFC_TS12_SupSign5Type "The type of supplementary sign. ISO 23150:2022(E): Supplementary sign classification type (A.2.151)";
CM_ SG_ 244 VFC_TS13_ObjId "Unique Traffic Sign ID. ISO 23150:2022(E): Object ID (A.2.2)";
CM_ SG_ 244 VFC_TS13_Type "The type of main sign. ISO 23150:2022(E): Sign classification type (A.2.98)";
CM_ SG_ 244 VFC_TS13_ExistProb "Probability that the sign is a traffic sign. ISO 23150:2022(E): Existence probability - object level (A.2.1)";
CM_ SG_ 244 VFC_TS13_Px "Traffic sign position in longitudinal direction. ISO 23150:2022(E): Position - object level {x, y, z} (A.2.15)";
CM_ SG_ 244 VFC_TS13_Py "Traffic sign position in lateral direction. ISO 23150:2022(E): Position - object level {x, y, z} (A.2.15)";
CM_ SG_ 244 VFC_TS13_Pz "Traffic sign position in vertical direction. ISO 23150:2022(E): Position - object level {x, y, z} (A.2.15)";
CM_ SG_ 244 VFC_TS13_PxStdDev "Standard deviation of Traffic sign position in longitudinal direction. ISO 23150:2022(E): Position - object level {x, y, z} - error (A.2.16)";
CM_ SG_ 244 VFC_TS13_Width "Width of the traffic sign. ISO 23150:2022(E): Bounding box extent {length, width, height} (A.2.20)";
CM_ SG_ 244 VFC_TS13_Height "Height of the traffic sign. ISO 23150:2022(E): Bounding box extent {length, width, height} (A.2.20)";
CM_ SG_ 244 VFC_TS13_EmbeddedInfo "Information how the sign is embedded or not";
CM_ SG_ 244 VFC_TS13_ValidLane "Indicates on which lane the detected sign is valid. If traffic sign is generally valid, all bits shall be set. No relevance to ego lane, signal related to ISO 23150:2022(E): Lane relevance classification type (A.2.147)
Bitfield:
Bit 0: valid on first right hand lane
Bit 1: valid on second right hand lane
Bit 2: valid on third right hand lane
Bit 3: valid on fourth right hand lane
Bit 4: valid on fifth right hand lane";
CM_ SG_ 244 VFC_TS13_ValidDay "The week days for which the main traffic sign is valid. If traffic sign is generally valid, all bits shall be set. Related to ISO 23150:2022(E): Sign text (A.2.102)
Bitfield:
Bit 0: MONDAY
Bit 1: TUESDAY
Bit 2: WEDNESDAY
Bit 3: THURSDAY
Bit 4: FRIDAY
Bit 5: SATURDAY
Bit 6: SUNDAY";
CM_ SG_ 244 VFC_TS13_ValidTimeRange1Start "Start time for the first time range in which the main traffic sign is valid. Minutes since midnight. Related to ISO 23150:2022(E): Sign text (A.2.102)";
CM_ SG_ 244 VFC_TS13_ValidTimeRange1End "End time for the first time range in which the main traffic sign is valid. Minutes since midnight. Related to ISO 23150:2022(E): Sign text (A.2.102)";
CM_ SG_ 244 VFC_TS13_ValidTimeRange2Start "Start time for the second time range in which the main traffic sign is valid. Minutes since midnight. Related to ISO 23150:2022(E): Sign text (A.2.102)";
CM_ SG_ 244 VFC_TS13_ValidTimeRange2End "End time for the second time range in which the main traffic sign is valid. Minutes since midnight. Related to ISO 23150:2022(E): Sign text (A.2.102)";
CM_ SG_ 244 VFC_TS13_ValidInDist "Indicates the longitudinal distance in which the validity of the main traffic sign starts. Unit is set in signal ValidInDistUnit. Related to ISO 23150:2022(E): Sign text (A.2.102)";
CM_ SG_ 244 VFC_TS13_ValidInDistUnit "Unit for signal ValidInDist. ISO 23150:2022(E): Sign value unit (A.2.101)";
CM_ SG_ 244 VFC_TS13_ValidSection "Indicates the longitudinal section for which the main traffic sign is valid. Unit is set in signal ValidSectionUnit. Related to ISO 23150:2022(E): Sign text (A.2.102)";
CM_ SG_ 244 VFC_TS13_ValidSectionUnit "Unit for signal ValidSection. ISO 23150:2022(E): Sign value unit (A.2.101)";
CM_ SG_ 244 VFC_TS13_NumValidSupSigns "Number of valid supplementary signs attached to the main sign. ISO 23150:2022(E): Number of valid traffic supplementary signs (A.2.149)";
CM_ SG_ 244 VFC_TS13_SupSign0ExistProb "Probability that the sign is a supplementary traffic sign. ISO 23150:2022(E): Existence probability - object level (A.2.1)";
CM_ SG_ 244 VFC_TS13_SupSign1ExistProb "Probability that the sign is a supplementary traffic sign. ISO 23150:2022(E): Existence probability - object level (A.2.1)";
CM_ SG_ 244 VFC_TS13_SupSign2ExistProb "Probability that the sign is a supplementary traffic sign. ISO 23150:2022(E): Existence probability - object level (A.2.1)";
CM_ SG_ 244 VFC_TS13_SupSign3ExistProb "Probability that the sign is a supplementary traffic sign. ISO 23150:2022(E): Existence probability - object level (A.2.1)";
CM_ SG_ 244 VFC_TS13_SupSign4ExistProb "Probability that the sign is a supplementary traffic sign. ISO 23150:2022(E): Existence probability - object level (A.2.1)";
CM_ SG_ 244 VFC_TS13_SupSign5ExistProb "Probability that the sign is a supplementary traffic sign. ISO 23150:2022(E): Existence probability - object level (A.2.1)";
CM_ SG_ 244 VFC_TS13_SupSign0Type "The type of supplementary sign. ISO 23150:2022(E): Supplementary sign classification type (A.2.151)";
CM_ SG_ 244 VFC_TS13_SupSign1Type "The type of supplementary sign. ISO 23150:2022(E): Supplementary sign classification type (A.2.151)";
CM_ SG_ 244 VFC_TS13_SupSign2Type "The type of supplementary sign. ISO 23150:2022(E): Supplementary sign classification type (A.2.151)";
CM_ SG_ 244 VFC_TS13_SupSign3Type "The type of supplementary sign. ISO 23150:2022(E): Supplementary sign classification type (A.2.151)";
CM_ SG_ 244 VFC_TS13_SupSign4Type "The type of supplementary sign. ISO 23150:2022(E): Supplementary sign classification type (A.2.151)";
CM_ SG_ 244 VFC_TS13_SupSign5Type "The type of supplementary sign. ISO 23150:2022(E): Supplementary sign classification type (A.2.151)";
CM_ SG_ 245 VFC_TS_14_15_CRC "CRC - Autosar E2E Profile 5";
CM_ SG_ 245 VFC_TS_14_15_AliveCtr "Alive counter - Autosar E2E Profile 5";
CM_ SG_ 245 VFC_TS_14_15_ProtBlockCtr "Protocol-Signal: Block-Counter";
CM_ SG_ 245 VFC_TS14_ObjId "Unique Traffic Sign ID. ISO 23150:2022(E): Object ID (A.2.2)";
CM_ SG_ 245 VFC_TS14_Type "The type of main sign. ISO 23150:2022(E): Sign classification type (A.2.98)";
CM_ SG_ 245 VFC_TS14_ExistProb "Probability that the sign is a traffic sign. ISO 23150:2022(E): Existence probability - object level (A.2.1)";
CM_ SG_ 245 VFC_TS14_Px "Traffic sign position in longitudinal direction. ISO 23150:2022(E): Position - object level {x, y, z} (A.2.15)";
CM_ SG_ 245 VFC_TS14_Py "Traffic sign position in lateral direction. ISO 23150:2022(E): Position - object level {x, y, z} (A.2.15)";
CM_ SG_ 245 VFC_TS14_Pz "Traffic sign position in vertical direction. ISO 23150:2022(E): Position - object level {x, y, z} (A.2.15)";
CM_ SG_ 245 VFC_TS14_PxStdDev "Standard deviation of Traffic sign position in longitudinal direction. ISO 23150:2022(E): Position - object level {x, y, z} - error (A.2.16)";
CM_ SG_ 245 VFC_TS14_Width "Width of the traffic sign. ISO 23150:2022(E): Bounding box extent {length, width, height} (A.2.20)";
CM_ SG_ 245 VFC_TS14_Height "Height of the traffic sign. ISO 23150:2022(E): Bounding box extent {length, width, height} (A.2.20)";
CM_ SG_ 245 VFC_TS14_EmbeddedInfo "Information how the sign is embedded or not";
CM_ SG_ 245 VFC_TS14_ValidLane "Indicates on which lane the detected sign is valid. If traffic sign is generally valid, all bits shall be set. No relevance to ego lane, signal related to ISO 23150:2022(E): Lane relevance classification type (A.2.147)
Bitfield:
Bit 0: valid on first right hand lane
Bit 1: valid on second right hand lane
Bit 2: valid on third right hand lane
Bit 3: valid on fourth right hand lane
Bit 4: valid on fifth right hand lane";
CM_ SG_ 245 VFC_TS14_ValidDay "The week days for which the main traffic sign is valid. If traffic sign is generally valid, all bits shall be set. Related to ISO 23150:2022(E): Sign text (A.2.102)
Bitfield:
Bit 0: MONDAY
Bit 1: TUESDAY
Bit 2: WEDNESDAY
Bit 3: THURSDAY
Bit 4: FRIDAY
Bit 5: SATURDAY
Bit 6: SUNDAY";
CM_ SG_ 245 VFC_TS14_ValidTimeRange1Start "Start time for the first time range in which the main traffic sign is valid. Minutes since midnight. Related to ISO 23150:2022(E): Sign text (A.2.102)";
CM_ SG_ 245 VFC_TS14_ValidTimeRange1End "End time for the first time range in which the main traffic sign is valid. Minutes since midnight. Related to ISO 23150:2022(E): Sign text (A.2.102)";
CM_ SG_ 245 VFC_TS14_ValidTimeRange2Start "Start time for the second time range in which the main traffic sign is valid. Minutes since midnight. Related to ISO 23150:2022(E): Sign text (A.2.102)";
CM_ SG_ 245 VFC_TS14_ValidTimeRange2End "End time for the second time range in which the main traffic sign is valid. Minutes since midnight. Related to ISO 23150:2022(E): Sign text (A.2.102)";
CM_ SG_ 245 VFC_TS14_ValidInDist "Indicates the longitudinal distance in which the validity of the main traffic sign starts. Unit is set in signal ValidInDistUnit. Related to ISO 23150:2022(E): Sign text (A.2.102)";
CM_ SG_ 245 VFC_TS14_ValidInDistUnit "Unit for signal ValidInDist. ISO 23150:2022(E): Sign value unit (A.2.101)";
CM_ SG_ 245 VFC_TS14_ValidSection "Indicates the longitudinal section for which the main traffic sign is valid. Unit is set in signal ValidSectionUnit. Related to ISO 23150:2022(E): Sign text (A.2.102)";
CM_ SG_ 245 VFC_TS14_ValidSectionUnit "Unit for signal ValidSection. ISO 23150:2022(E): Sign value unit (A.2.101)";
CM_ SG_ 245 VFC_TS14_NumValidSupSigns "Number of valid supplementary signs attached to the main sign. ISO 23150:2022(E): Number of valid traffic supplementary signs (A.2.149)";
CM_ SG_ 245 VFC_TS14_SupSign0ExistProb "Probability that the sign is a supplementary traffic sign. ISO 23150:2022(E): Existence probability - object level (A.2.1)";
CM_ SG_ 245 VFC_TS14_SupSign1ExistProb "Probability that the sign is a supplementary traffic sign. ISO 23150:2022(E): Existence probability - object level (A.2.1)";
CM_ SG_ 245 VFC_TS14_SupSign2ExistProb "Probability that the sign is a supplementary traffic sign. ISO 23150:2022(E): Existence probability - object level (A.2.1)";
CM_ SG_ 245 VFC_TS14_SupSign3ExistProb "Probability that the sign is a supplementary traffic sign. ISO 23150:2022(E): Existence probability - object level (A.2.1)";
CM_ SG_ 245 VFC_TS14_SupSign4ExistProb "Probability that the sign is a supplementary traffic sign. ISO 23150:2022(E): Existence probability - object level (A.2.1)";
CM_ SG_ 245 VFC_TS14_SupSign5ExistProb "Probability that the sign is a supplementary traffic sign. ISO 23150:2022(E): Existence probability - object level (A.2.1)";
CM_ SG_ 245 VFC_TS14_SupSign0Type "The type of supplementary sign. ISO 23150:2022(E): Supplementary sign classification type (A.2.151)";
CM_ SG_ 245 VFC_TS14_SupSign1Type "The type of supplementary sign. ISO 23150:2022(E): Supplementary sign classification type (A.2.151)";
CM_ SG_ 245 VFC_TS14_SupSign2Type "The type of supplementary sign. ISO 23150:2022(E): Supplementary sign classification type (A.2.151)";
CM_ SG_ 245 VFC_TS14_SupSign3Type "The type of supplementary sign. ISO 23150:2022(E): Supplementary sign classification type (A.2.151)";
CM_ SG_ 245 VFC_TS14_SupSign4Type "The type of supplementary sign. ISO 23150:2022(E): Supplementary sign classification type (A.2.151)";
CM_ SG_ 245 VFC_TS14_SupSign5Type "The type of supplementary sign. ISO 23150:2022(E): Supplementary sign classification type (A.2.151)";
CM_ SG_ 245 VFC_TS15_ObjId "Unique Traffic Sign ID. ISO 23150:2022(E): Object ID (A.2.2)";
CM_ SG_ 245 VFC_TS15_Type "The type of main sign. ISO 23150:2022(E): Sign classification type (A.2.98)";
CM_ SG_ 245 VFC_TS15_ExistProb "Probability that the sign is a traffic sign. ISO 23150:2022(E): Existence probability - object level (A.2.1)";
CM_ SG_ 245 VFC_TS15_Px "Traffic sign position in longitudinal direction. ISO 23150:2022(E): Position - object level {x, y, z} (A.2.15)";
CM_ SG_ 245 VFC_TS15_Py "Traffic sign position in lateral direction. ISO 23150:2022(E): Position - object level {x, y, z} (A.2.15)";
CM_ SG_ 245 VFC_TS15_Pz "Traffic sign position in vertical direction. ISO 23150:2022(E): Position - object level {x, y, z} (A.2.15)";
CM_ SG_ 245 VFC_TS15_PxStdDev "Standard deviation of Traffic sign position in longitudinal direction. ISO 23150:2022(E): Position - object level {x, y, z} - error (A.2.16)";
CM_ SG_ 245 VFC_TS15_Width "Width of the traffic sign. ISO 23150:2022(E): Bounding box extent {length, width, height} (A.2.20)";
CM_ SG_ 245 VFC_TS15_Height "Height of the traffic sign. ISO 23150:2022(E): Bounding box extent {length, width, height} (A.2.20)";
CM_ SG_ 245 VFC_TS15_EmbeddedInfo "Information how the sign is embedded or not";
CM_ SG_ 245 VFC_TS15_ValidLane "Indicates on which lane the detected sign is valid. If traffic sign is generally valid, all bits shall be set. No relevance to ego lane, signal related to ISO 23150:2022(E): Lane relevance classification type (A.2.147)
Bitfield:
Bit 0: valid on first right hand lane
Bit 1: valid on second right hand lane
Bit 2: valid on third right hand lane
Bit 3: valid on fourth right hand lane
Bit 4: valid on fifth right hand lane";
CM_ SG_ 245 VFC_TS15_ValidDay "The week days for which the main traffic sign is valid. If traffic sign is generally valid, all bits shall be set. Related to ISO 23150:2022(E): Sign text (A.2.102)
Bitfield:
Bit 0: MONDAY
Bit 1: TUESDAY
Bit 2: WEDNESDAY
Bit 3: THURSDAY
Bit 4: FRIDAY
Bit 5: SATURDAY
Bit 6: SUNDAY";
CM_ SG_ 245 VFC_TS15_ValidTimeRange1Start "Start time for the first time range in which the main traffic sign is valid. Minutes since midnight. Related to ISO 23150:2022(E): Sign text (A.2.102)";
CM_ SG_ 245 VFC_TS15_ValidTimeRange1End "End time for the first time range in which the main traffic sign is valid. Minutes since midnight. Related to ISO 23150:2022(E): Sign text (A.2.102)";
CM_ SG_ 245 VFC_TS15_ValidTimeRange2Start "Start time for the second time range in which the main traffic sign is valid. Minutes since midnight. Related to ISO 23150:2022(E): Sign text (A.2.102)";
CM_ SG_ 245 VFC_TS15_ValidTimeRange2End "End time for the second time range in which the main traffic sign is valid. Minutes since midnight. Related to ISO 23150:2022(E): Sign text (A.2.102)";
CM_ SG_ 245 VFC_TS15_ValidInDist "Indicates the longitudinal distance in which the validity of the main traffic sign starts. Unit is set in signal ValidInDistUnit. Related to ISO 23150:2022(E): Sign text (A.2.102)";
CM_ SG_ 245 VFC_TS15_ValidInDistUnit "Unit for signal ValidInDist. ISO 23150:2022(E): Sign value unit (A.2.101)";
CM_ SG_ 245 VFC_TS15_ValidSection "Indicates the longitudinal section for which the main traffic sign is valid. Unit is set in signal ValidSectionUnit. Related to ISO 23150:2022(E): Sign text (A.2.102)";
CM_ SG_ 245 VFC_TS15_ValidSectionUnit "Unit for signal ValidSection. ISO 23150:2022(E): Sign value unit (A.2.101)";
CM_ SG_ 245 VFC_TS15_NumValidSupSigns "Number of valid supplementary signs attached to the main sign. ISO 23150:2022(E): Number of valid traffic supplementary signs (A.2.149)";
CM_ SG_ 245 VFC_TS15_SupSign0ExistProb "Probability that the sign is a supplementary traffic sign. ISO 23150:2022(E): Existence probability - object level (A.2.1)";
CM_ SG_ 245 VFC_TS15_SupSign1ExistProb "Probability that the sign is a supplementary traffic sign. ISO 23150:2022(E): Existence probability - object level (A.2.1)";
CM_ SG_ 245 VFC_TS15_SupSign2ExistProb "Probability that the sign is a supplementary traffic sign. ISO 23150:2022(E): Existence probability - object level (A.2.1)";
CM_ SG_ 245 VFC_TS15_SupSign3ExistProb "Probability that the sign is a supplementary traffic sign. ISO 23150:2022(E): Existence probability - object level (A.2.1)";
CM_ SG_ 245 VFC_TS15_SupSign4ExistProb "Probability that the sign is a supplementary traffic sign. ISO 23150:2022(E): Existence probability - object level (A.2.1)";
CM_ SG_ 245 VFC_TS15_SupSign5ExistProb "Probability that the sign is a supplementary traffic sign. ISO 23150:2022(E): Existence probability - object level (A.2.1)";
CM_ SG_ 245 VFC_TS15_SupSign0Type "The type of supplementary sign. ISO 23150:2022(E): Supplementary sign classification type (A.2.151)";
CM_ SG_ 245 VFC_TS15_SupSign1Type "The type of supplementary sign. ISO 23150:2022(E): Supplementary sign classification type (A.2.151)";
CM_ SG_ 245 VFC_TS15_SupSign2Type "The type of supplementary sign. ISO 23150:2022(E): Supplementary sign classification type (A.2.151)";
CM_ SG_ 245 VFC_TS15_SupSign3Type "The type of supplementary sign. ISO 23150:2022(E): Supplementary sign classification type (A.2.151)";
CM_ SG_ 245 VFC_TS15_SupSign4Type "The type of supplementary sign. ISO 23150:2022(E): Supplementary sign classification type (A.2.151)";
CM_ SG_ 245 VFC_TS15_SupSign5Type "The type of supplementary sign. ISO 23150:2022(E): Supplementary sign classification type (A.2.151)";
CM_ SG_ 260 RFC_LocHdrA_CRC "CRC - Autosar E2E Profile 5";
CM_ SG_ 260 RFC_LocHdrA_AliveCtr "Alive counter - Autosar E2E Profile 5";
CM_ SG_ 260 RFC_LocHdrA_ProtBlockCtr "Protocol-Signal: Block-Counter";
CM_ SG_ 260 RFC_LocHdr_IfVersionIdMajor "Version information of the interface. e. g. version 1.0: Major = 1. ISO 23150:2021(E): Interface version ID {major, minor, patch} (A.1.1)";
CM_ SG_ 260 RFC_LocHdr_IfVersionIdMinor "Version information of the interface. e. g. version 1.0: Minor = 0. ISO 23150:2021(E): Interface version ID {major, minor, patch} (A.1.1)";
CM_ SG_ 260 RFC_LocHdr_NumValidDetections "Number of detected VALID Locations that have been sent to the bus ISO 23150:2021(E): Number of valid detections (A.1.12.8)";
CM_ SG_ 260 RFC_LocHdr_TimeStamp "Time Stamp ISO 23150:2021(E): Time stamp  measured (A.1.5.2)";
CM_ SG_ 260 RFC_LocHdr_SensorStatus "Bit 0: HW MALFUNCTION
Bit 1: DSP ISSUES
Bit 2: COMMUNICATION ERRORS
Bit 3: MISALIGNMENT (OUT OF SPEC)
Bit 4: SENSOR BLIDNESS DETECTED
Bit 5: SENSOR DISTURBED
Bit 6: OTHER ISSUES
Bit 7: RESERVED
Value 0: no event
Value 1: event occured";
CM_ SG_ 260 RFC_LocHdr_SensorStatusExt "Bit 0-4: RESERVED
Bit 5: AZIMUTH OUT OF SPEC
Bit 6: ELEVATION OUT OF SPEC
Value 0: no event
Value 1: event occured";
CM_ SG_ 260 RFC_LocHdr_LocDownSel "The detected number of locations exceeded the number of max. locations that can be transmitted";
CM_ SG_ 260 RFC_LocHdr_TimeStampStatus "Autosar StbM_TimeBaseStatusType bitfield with extension:
Bit 0: TIMEOUT
Bit 1: Reserved1
Bit 2: SYNC_TO_GATEWAY
Bit 3: GLOBAL_TIME_BASE
Bit 4: TIMELEAP_FUTURE
Bit 5: TIMELEAP_PAST
Bit 6: Reserved6
Bit 7: Extension: GENERAL_ERROR";
CM_ SG_ 260 RFC_LocHdr_BlindnessEvent "Bit 0: General blindness
-----------
Detailed blindness info:
Bit 1: Blindness algo event (deprecated)
Bit 2: Absorbtion blindness
Bit 3: Distortion blindness azimuth
Bit 4: Distortion blindness elevation
Value 0: no event
Value 1: event occured";
CM_ SG_ 260 RFC_LocHdr_SwVersion "SW version: 4 digits major version, 2 digits minor version";
CM_ SG_ 260 RFC_LocHdr_SensorOriginPointY "Nominal mounting position in the lateral direction ISO 23150:2021(E): Sensor origin point {y} (A.1.22)";
CM_ SG_ 260 RFC_LocHdr_SensorOriginPointX "Nominal mounting position in the longitudinal direction  ISO 23150:2021(E): Sensor origin point {x} (A.1.22)";
CM_ SG_ 260 RFC_LocHdr_SensorOriginPointZ "Nominal mounting position in the vertical direction  ISO 23150:2021(E): Sensor origin point {z} (A.1.22)";
CM_ SG_ 260 RFC_LocHdr_SensorOrientCorrYaw "Sensor mounting angle azimuth current ISO 23150:2021(E): Sensor orientation - correction {yaw} (A.5.46) - this signal contains the absolute value not the difference to the nominal";
CM_ SG_ 260 RFC_LocHdr_SensorOrientCorrPitch "Sensor mounting angle elevation current ISO 23150:2021(E): Sensor orientation - correction {pitch} (A.5.46) - this signal contains the absolute value not the difference to the nominal";
CM_ SG_ 260 RFC_LocHdr_SensorOrientYaw "Sensor mounting angle azimuth nominal, similar to ISO 23150:2021(E): Sensor orientation {yaw} (A.1.24) but sensor orientation correction is not applied";
CM_ SG_ 260 RFC_LocHdr_SensorOrientPitch "Sensor mounting angle elevation nominal, similar to ISO 23150:2021(E): Sensor orientation {pitch} (A.1.24) but sensor orientation correction is not applied";
CM_ SG_ 260 RFC_LocHdr_ModPerfDistanceMax "Modulation performance max. measurable distance";
CM_ SG_ 260 RFC_LocHdr_FovElev00RangeGain "Maximal detection distance elevation related scaling parameter. Similar ISO 23150:2021(E) definition: Range gain (A.5.5). Further details refer to DSP Location Interface definition";
CM_ SG_ 260 RFC_LocHdr_FovElev01RangeGain "Maximal detection distance elevation related scaling parameter. Similar ISO 23150:2021(E) definition: Range gain (A.5.5). Further details refer to DSP Location Interface definition";
CM_ SG_ 260 RFC_LocHdr_FovElev02RangeGain "Maximal detection distance elevation related scaling parameter. Similar ISO 23150:2021(E) definition: Range gain (A.5.5). Further details refer to DSP Location Interface definition";
CM_ SG_ 260 RFC_LocHdr_FovElev03RangeGain "Maximal detection distance elevation related scaling parameter. Similar ISO 23150:2021(E) definition: Range gain (A.5.5). Further details refer to DSP Location Interface definition";
CM_ SG_ 260 RFC_LocHdr_FovElev04RangeGain "Maximal detection distance elevation related scaling parameter. Similar ISO 23150:2021(E) definition: Range gain (A.5.5). Further details refer to DSP Location Interface definition";
CM_ SG_ 260 RFC_LocHdr_FovElev05RangeGain "Maximal detection distance elevation related scaling parameter. Similar ISO 23150:2021(E) definition: Range gain (A.5.5). Further details refer to DSP Location Interface definition";
CM_ SG_ 260 RFC_LocHdr_FovElev06RangeGain "Maximal detection distance elevation related scaling parameter. Similar ISO 23150:2021(E) definition: Range gain (A.5.5). Further details refer to DSP Location Interface definition";
CM_ SG_ 260 RFC_LocHdr_FovElev07RangeGain "Maximal detection distance elevation related scaling parameter. Similar ISO 23150:2021(E) definition: Range gain (A.5.5). Further details refer to DSP Location Interface definition";
CM_ SG_ 260 RFC_LocHdr_FovElev08RangeGain "Maximal detection distance elevation related scaling parameter. Similar ISO 23150:2021(E) definition: Range gain (A.5.5). Further details refer to DSP Location Interface definition";
CM_ SG_ 260 RFC_LocHdr_FovElev09RangeGain "Maximal detection distance elevation related scaling parameter. Similar ISO 23150:2021(E) definition: Range gain (A.5.5). Further details refer to DSP Location Interface definition";
CM_ SG_ 260 RFC_LocHdr_FovElev10RangeGain "Maximal detection distance elevation related scaling parameter. Similar ISO 23150:2021(E) definition: Range gain (A.5.5). Further details refer to DSP Location Interface definition";
CM_ SG_ 260 RFC_LocHdr_FovElevation00 "Field of view elevation angle definition. ISO 23150:2021(E): Segment elevation {begin, end} (A.5.2) can be calculated from this signal value. Further details refers to DSP Location Interface definition";
CM_ SG_ 260 RFC_LocHdr_FovElevation01 "Field of view elevation angle definition. ISO 23150:2021(E): Segment elevation {begin, end} (A.5.2) can be calculated from this signal value. Further details refers to DSP Location Interface definition";
CM_ SG_ 260 RFC_LocHdr_FovElevation02 "Field of view elevation angle definition. ISO 23150:2021(E): Segment elevation {begin, end} (A.5.2) can be calculated from this signal value. Further details refers to DSP Location Interface definition";
CM_ SG_ 260 RFC_LocHdr_FovElevation03 "Field of view elevation angle definition. ISO 23150:2021(E): Segment elevation {begin, end} (A.5.2) can be calculated from this signal value. Further details refers to DSP Location Interface definition";
CM_ SG_ 260 RFC_LocHdr_FovElevation04 "Field of view elevation angle definition. ISO 23150:2021(E): Segment elevation {begin, end} (A.5.2) can be calculated from this signal value. Further details refers to DSP Location Interface definition";
CM_ SG_ 260 RFC_LocHdr_FovElevation05 "Field of view elevation angle definition. ISO 23150:2021(E): Segment elevation {begin, end} (A.5.2) can be calculated from this signal value. Further details refers to DSP Location Interface definition";
CM_ SG_ 260 RFC_LocHdr_FovElevation06 "Field of view elevation angle definition. ISO 23150:2021(E): Segment elevation {begin, end} (A.5.2) can be calculated from this signal value. Further details refers to DSP Location Interface definition";
CM_ SG_ 260 RFC_LocHdr_FovElevation07 "Field of view elevation angle definition. ISO 23150:2021(E): Segment elevation {begin, end} (A.5.2) can be calculated from this signal value. Further details refers to DSP Location Interface definition";
CM_ SG_ 260 RFC_LocHdr_FovElevation08 "Field of view elevation angle definition. ISO 23150:2021(E): Segment elevation {begin, end} (A.5.2) can be calculated from this signal value. Further details refers to DSP Location Interface definition";
CM_ SG_ 260 RFC_LocHdr_FovElevation09 "Field of view elevation angle definition. ISO 23150:2021(E): Segment elevation {begin, end} (A.5.2) can be calculated from this signal value. Further details refers to DSP Location Interface definition";
CM_ SG_ 260 RFC_LocHdr_FovElevation10 "Field of view elevation angle definition. ISO 23150:2021(E): Segment elevation {begin, end} (A.5.2) can be calculated from this signal value. Further details refers to DSP Location Interface definition";
CM_ SG_ 261 RFC_LocHdrB_CRC "CRC - Autosar E2E Profile 5";
CM_ SG_ 261 RFC_LocHdrB_AliveCtr "Alive counter - Autosar E2E Profile 5";
CM_ SG_ 261 RFC_LocHdrB_ProtBlockCtr "Protocol-Signal: Block-Counter";
CM_ SG_ 261 RFC_LocHdr_FovAzimuth00Range "Maximal detection distance in the corresponding azimuth angle. Similar ISO 23150:2021(E) definition: Range gain (A.5.5). Further details refer to DSP Location Interface definition";
CM_ SG_ 261 RFC_LocHdr_FovAzimuth01Range "Maximal detection distance in the corresponding azimuth angle. Similar ISO 23150:2021(E) definition: Range gain (A.5.5). Further details refer to DSP Location Interface definition";
CM_ SG_ 261 RFC_LocHdr_FovAzimuth02Range "Maximal detection distance in the corresponding azimuth angle. Similar ISO 23150:2021(E) definition: Range gain (A.5.5). Further details refer to DSP Location Interface definition";
CM_ SG_ 261 RFC_LocHdr_FovAzimuth03Range "Maximal detection distance in the corresponding azimuth angle. Similar ISO 23150:2021(E) definition: Range gain (A.5.5). Further details refer to DSP Location Interface definition";
CM_ SG_ 261 RFC_LocHdr_FovAzimuth04Range "Maximal detection distance in the corresponding azimuth angle. Similar ISO 23150:2021(E) definition: Range gain (A.5.5). Further details refer to DSP Location Interface definition";
CM_ SG_ 261 RFC_LocHdr_FovAzimuth05Range "Maximal detection distance in the corresponding azimuth angle. Similar ISO 23150:2021(E) definition: Range gain (A.5.5). Further details refer to DSP Location Interface definition";
CM_ SG_ 261 RFC_LocHdr_FovAzimuth06Range "Maximal detection distance in the corresponding azimuth angle. Similar ISO 23150:2021(E) definition: Range gain (A.5.5). Further details refer to DSP Location Interface definition";
CM_ SG_ 261 RFC_LocHdr_FovAzimuth07Range "Maximal detection distance in the corresponding azimuth angle. Similar ISO 23150:2021(E) definition: Range gain (A.5.5). Further details refer to DSP Location Interface definition";
CM_ SG_ 261 RFC_LocHdr_FovAzimuth08Range "Maximal detection distance in the corresponding azimuth angle. Similar ISO 23150:2021(E) definition: Range gain (A.5.5). Further details refer to DSP Location Interface definition";
CM_ SG_ 261 RFC_LocHdr_FovAzimuth09Range "Maximal detection distance in the corresponding azimuth angle. Similar ISO 23150:2021(E) definition: Range gain (A.5.5). Further details refer to DSP Location Interface definition";
CM_ SG_ 261 RFC_LocHdr_FovAzimuth10Range "Maximal detection distance in the corresponding azimuth angle. Similar ISO 23150:2021(E) definition: Range gain (A.5.5). Further details refer to DSP Location Interface definition";
CM_ SG_ 261 RFC_LocHdr_FovAzimuth11Range "Maximal detection distance in the corresponding azimuth angle. Similar ISO 23150:2021(E) definition: Range gain (A.5.5). Further details refer to DSP Location Interface definition";
CM_ SG_ 261 RFC_LocHdr_FovAzimuth12Range "Maximal detection distance in the corresponding azimuth angle. Similar ISO 23150:2021(E) definition: Range gain (A.5.5). Further details refer to DSP Location Interface definition";
CM_ SG_ 261 RFC_LocHdr_FovAzimuth13Range "Maximal detection distance in the corresponding azimuth angle. Similar ISO 23150:2021(E) definition: Range gain (A.5.5). Further details refer to DSP Location Interface definition";
CM_ SG_ 261 RFC_LocHdr_FovAzimuth14Range "Maximal detection distance in the corresponding azimuth angle. Similar ISO 23150:2021(E) definition: Range gain (A.5.5). Further details refer to DSP Location Interface definition";
CM_ SG_ 261 RFC_LocHdr_FovAzimuth15Range "Maximal detection distance in the corresponding azimuth angle. Similar ISO 23150:2021(E) definition: Range gain (A.5.5). Further details refer to DSP Location Interface definition";
CM_ SG_ 261 RFC_LocHdr_FovAzimuth16Range "Maximal detection distance in the corresponding azimuth angle. Similar ISO 23150:2021(E) definition: Range gain (A.5.5). Further details refer to DSP Location Interface definition";
CM_ SG_ 261 RFC_LocHdr_FovAzimuth17Range "Maximal detection distance in the corresponding azimuth angle. Similar ISO 23150:2021(E) definition: Range gain (A.5.5). Further details refer to DSP Location Interface definition";
CM_ SG_ 261 RFC_LocHdr_FovAzimuth18Range "Maximal detection distance in the corresponding azimuth angle. Similar ISO 23150:2021(E) definition: Range gain (A.5.5). Further details refer to DSP Location Interface definition";
CM_ SG_ 261 RFC_LocHdr_FovAzimuth19Range "Maximal detection distance in the corresponding azimuth angle. Similar ISO 23150:2021(E) definition: Range gain (A.5.5). Further details refer to DSP Location Interface definition";
CM_ SG_ 261 RFC_LocHdr_FovAzimuth20Range "Maximal detection distance in the corresponding azimuth angle. Similar ISO 23150:2021(E) definition: Range gain (A.5.5). Further details refer to DSP Location Interface definition";
CM_ SG_ 261 RFC_LocHdr_FovAzimuth21Range "Maximal detection distance in the corresponding azimuth angle. Similar ISO 23150:2021(E) definition: Range gain (A.5.5). Further details refer to DSP Location Interface definition";
CM_ SG_ 261 RFC_LocHdr_FovAzimuth22Range "Maximal detection distance in the corresponding azimuth angle. Similar ISO 23150:2021(E) definition: Range gain (A.5.5). Further details refer to DSP Location Interface definition";
CM_ SG_ 261 RFC_LocHdr_FovAzimuth23Range "Maximal detection distance in the corresponding azimuth angle. Similar ISO 23150:2021(E) definition: Range gain (A.5.5). Further details refer to DSP Location Interface definition";
CM_ SG_ 261 RFC_LocHdr_FovAzimuth24Range "Maximal detection distance in the corresponding azimuth angle. Similar ISO 23150:2021(E) definition: Range gain (A.5.5). Further details refer to DSP Location Interface definition";
CM_ SG_ 261 RFC_LocHdr_FovAzimuth00 "Field of view azimuthal angle definition. ISO 23150:2021(E): Segment azimuth {begin, end} (A.5.1) can be calculated from this signal value. Further details refers to DSP Location Interface definition";
CM_ SG_ 261 RFC_LocHdr_FovAzimuth01 "Field of view azimuthal angle definition. ISO 23150:2021(E): Segment azimuth {begin, end} (A.5.1) can be calculated from this signal value. Further details refers to DSP Location Interface definition";
CM_ SG_ 261 RFC_LocHdr_FovAzimuth02 "Field of view azimuthal angle definition. ISO 23150:2021(E): Segment azimuth {begin, end} (A.5.1) can be calculated from this signal value. Further details refers to DSP Location Interface definition";
CM_ SG_ 261 RFC_LocHdr_FovAzimuth03 "Field of view azimuthal angle definition. ISO 23150:2021(E): Segment azimuth {begin, end} (A.5.1) can be calculated from this signal value. Further details refers to DSP Location Interface definition";
CM_ SG_ 261 RFC_LocHdr_FovAzimuth04 "Field of view azimuthal angle definition. ISO 23150:2021(E): Segment azimuth {begin, end} (A.5.1) can be calculated from this signal value. Further details refers to DSP Location Interface definition";
CM_ SG_ 261 RFC_LocHdr_FovAzimuth05 "Field of view azimuthal angle definition. ISO 23150:2021(E): Segment azimuth {begin, end} (A.5.1) can be calculated from this signal value. Further details refers to DSP Location Interface definition";
CM_ SG_ 261 RFC_LocHdr_FovAzimuth06 "Field of view azimuthal angle definition. ISO 23150:2021(E): Segment azimuth {begin, end} (A.5.1) can be calculated from this signal value. Further details refers to DSP Location Interface definition";
CM_ SG_ 261 RFC_LocHdr_FovAzimuth07 "Field of view azimuthal angle definition. ISO 23150:2021(E): Segment azimuth {begin, end} (A.5.1) can be calculated from this signal value. Further details refers to DSP Location Interface definition";
CM_ SG_ 261 RFC_LocHdr_FovAzimuth08 "Field of view azimuthal angle definition. ISO 23150:2021(E): Segment azimuth {begin, end} (A.5.1) can be calculated from this signal value. Further details refers to DSP Location Interface definition";
CM_ SG_ 261 RFC_LocHdr_FovAzimuth09 "Field of view azimuthal angle definition. ISO 23150:2021(E): Segment azimuth {begin, end} (A.5.1) can be calculated from this signal value. Further details refers to DSP Location Interface definition";
CM_ SG_ 261 RFC_LocHdr_FovAzimuth10 "Field of view azimuthal angle definition. ISO 23150:2021(E): Segment azimuth {begin, end} (A.5.1) can be calculated from this signal value. Further details refers to DSP Location Interface definition";
CM_ SG_ 261 RFC_LocHdr_FovAzimuth11 "Field of view azimuthal angle definition. ISO 23150:2021(E): Segment azimuth {begin, end} (A.5.1) can be calculated from this signal value. Further details refers to DSP Location Interface definition";
CM_ SG_ 261 RFC_LocHdr_FovAzimuth12 "Field of view azimuthal angle definition. ISO 23150:2021(E): Segment azimuth {begin, end} (A.5.1) can be calculated from this signal value. Further details refers to DSP Location Interface definition";
CM_ SG_ 261 RFC_LocHdr_FovAzimuth13 "Field of view azimuthal angle definition. ISO 23150:2021(E): Segment azimuth {begin, end} (A.5.1) can be calculated from this signal value. Further details refers to DSP Location Interface definition";
CM_ SG_ 261 RFC_LocHdr_FovAzimuth14 "Field of view azimuthal angle definition. ISO 23150:2021(E): Segment azimuth {begin, end} (A.5.1) can be calculated from this signal value. Further details refers to DSP Location Interface definition";
CM_ SG_ 261 RFC_LocHdr_FovAzimuth15 "Field of view azimuthal angle definition. ISO 23150:2021(E): Segment azimuth {begin, end} (A.5.1) can be calculated from this signal value. Further details refers to DSP Location Interface definition";
CM_ SG_ 261 RFC_LocHdr_FovAzimuth16 "Field of view azimuthal angle definition. ISO 23150:2021(E): Segment azimuth {begin, end} (A.5.1) can be calculated from this signal value. Further details refers to DSP Location Interface definition";
CM_ SG_ 261 RFC_LocHdr_FovAzimuth17 "Field of view azimuthal angle definition. ISO 23150:2021(E): Segment azimuth {begin, end} (A.5.1) can be calculated from this signal value. Further details refers to DSP Location Interface definition";
CM_ SG_ 261 RFC_LocHdr_FovAzimuth18 "Field of view azimuthal angle definition. ISO 23150:2021(E): Segment azimuth {begin, end} (A.5.1) can be calculated from this signal value. Further details refers to DSP Location Interface definition";
CM_ SG_ 261 RFC_LocHdr_FovAzimuth19 "Field of view azimuthal angle definition. ISO 23150:2021(E): Segment azimuth {begin, end} (A.5.1) can be calculated from this signal value. Further details refers to DSP Location Interface definition";
CM_ SG_ 261 RFC_LocHdr_FovAzimuth20 "Field of view azimuthal angle definition. ISO 23150:2021(E): Segment azimuth {begin, end} (A.5.1) can be calculated from this signal value. Further details refers to DSP Location Interface definition";
CM_ SG_ 261 RFC_LocHdr_FovAzimuth21 "Field of view azimuthal angle definition. ISO 23150:2021(E): Segment azimuth {begin, end} (A.5.1) can be calculated from this signal value. Further details refers to DSP Location Interface definition";
CM_ SG_ 261 RFC_LocHdr_FovAzimuth22 "Field of view azimuthal angle definition. ISO 23150:2021(E): Segment azimuth {begin, end} (A.5.1) can be calculated from this signal value. Further details refers to DSP Location Interface definition";
CM_ SG_ 261 RFC_LocHdr_FovAzimuth23 "Field of view azimuthal angle definition. ISO 23150:2021(E): Segment azimuth {begin, end} (A.5.1) can be calculated from this signal value. Further details refers to DSP Location Interface definition";
CM_ SG_ 261 RFC_LocHdr_FovAzimuth24 "Field of view azimuthal angle definition. ISO 23150:2021(E): Segment azimuth {begin, end} (A.5.1) can be calculated from this signal value. Further details refers to DSP Location Interface definition";
CM_ SG_ 264 RFC_Loc000_002_CRC "CRC - Autosar E2E Profile 5";
CM_ SG_ 264 RFC_Loc000_002_AliveCtr "Alive counter - Autosar E2E Profile 5";
CM_ SG_ 264 RFC_Loc000_002_ProtBlockCtr "Protocol-Signal: Block-Counter";
CM_ SG_ 264 RFC_Loc000_RadialDistance "Location radial distance. Represented in conical coordinate system. Same as ISO 23150:2021(E): Position radial distance (A.4.16)";
CM_ SG_ 264 RFC_Loc000_RadialVelocity "Location radial relative velocity ISO 23150:2021(E): Relative velocity {radial distance} (A.4.18)";
CM_ SG_ 264 RFC_Loc000_Elevation "Location elevation angle. Represented in conical coordinate system. Same as ISO 23150:2021(E): Position elevation (A.4.16)";
CM_ SG_ 264 RFC_Loc000_Azimuth "Location azimuth angle. Represented in conical coordinate system. Deviation from ISO 23150:2021(E): Position azimuth (A.4.16). Further details refers to DSP Location Interface definition";
CM_ SG_ 264 RFC_Loc000_DistVelocityCoVnce "Covariance of radial distance and radial velocity";
CM_ SG_ 264 RFC_Loc000_RadialDistanceVnce "Variance of Location radial distance ISO 23150:2021(E): Position radial distance - error (A.4.17)";
CM_ SG_ 264 RFC_Loc000_RadialVelocityVnce "Variance of Location radial relative velocity ISO 23150:2021(E): Relative velocity {radial distance} - error (A.4.19)";
CM_ SG_ 264 RFC_Loc000_ElevationVnce "Variance of Location elevation angle ISO 23150:2021(E): Position elevation - error (A.4.17)";
CM_ SG_ 264 RFC_Loc000_AzimuthVnce "Variance of Location azimuth angle ISO 23150:2021(E): Position azimuth - error (A.4.17)";
CM_ SG_ 264 RFC_Loc000_RadarCrossSection "Radar Cross Section (RCS) estimation ISO 23150:2021(E): Radar cross section (A.4.5)";
CM_ SG_ 264 RFC_Loc000_DistVelocityQuality "Quality of radial distance and velocity resolution processing. Physical range [0..1]";
CM_ SG_ 264 RFC_Loc000_ElevationQuality "Probability for correct signal model (elevation angle). Physical range [0..1]";
CM_ SG_ 264 RFC_Loc000_AzimuthQuality "Probability for correct signal model (azimuth angle). Physical range [0..1]";
CM_ SG_ 264 RFC_Loc000_RSSI "Received Signal Strength Indication (RSSI). This signal is not exactly ISO 23150:2021(E): Signal to noise ratio - detection level (A.4.7), but SNR can be calculated from this signal. Further detail please refer to the DSP Location Interface definition";
CM_ SG_ 264 RFC_Loc000_AzimuthalPartnerId "Id of the azimuthal partner location";
CM_ SG_ 264 RFC_Loc001_RadialDistance "Location radial distance. Represented in conical coordinate system. Same as ISO 23150:2021(E): Position radial distance (A.4.16)";
CM_ SG_ 264 RFC_Loc001_RadialVelocity "Location radial relative velocity ISO 23150:2021(E): Relative velocity {radial distance} (A.4.18)";
CM_ SG_ 264 RFC_Loc001_Elevation "Location elevation angle. Represented in conical coordinate system. Same as ISO 23150:2021(E): Position elevation (A.4.16)";
CM_ SG_ 264 RFC_Loc001_Azimuth "Location azimuth angle. Represented in conical coordinate system. Deviation from ISO 23150:2021(E): Position azimuth (A.4.16). Further details refers to DSP Location Interface definition";
CM_ SG_ 264 RFC_Loc001_DistVelocityCoVnce "Covariance of radial distance and radial velocity";
CM_ SG_ 264 RFC_Loc001_RadialDistanceVnce "Variance of Location radial distance ISO 23150:2021(E): Position radial distance - error (A.4.17)";
CM_ SG_ 264 RFC_Loc001_RadialVelocityVnce "Variance of Location radial relative velocity ISO 23150:2021(E): Relative velocity {radial distance} - error (A.4.19)";
CM_ SG_ 264 RFC_Loc001_ElevationVnce "Variance of Location elevation angle ISO 23150:2021(E): Position elevation - error (A.4.17)";
CM_ SG_ 264 RFC_Loc001_AzimuthVnce "Variance of Location azimuth angle ISO 23150:2021(E): Position azimuth - error (A.4.17)";
CM_ SG_ 264 RFC_Loc001_RadarCrossSection "Radar Cross Section (RCS) estimation ISO 23150:2021(E): Radar cross section (A.4.5)";
CM_ SG_ 264 RFC_Loc001_DistVelocityQuality "Quality of radial distance and velocity resolution processing. Physical range [0..1]";
CM_ SG_ 264 RFC_Loc001_ElevationQuality "Probability for correct signal model (elevation angle). Physical range [0..1]";
CM_ SG_ 264 RFC_Loc001_AzimuthQuality "Probability for correct signal model (azimuth angle). Physical range [0..1]";
CM_ SG_ 264 RFC_Loc001_RSSI "Received Signal Strength Indication (RSSI). This signal is not exactly ISO 23150:2021(E): Signal to noise ratio - detection level (A.4.7), but SNR can be calculated from this signal. Further detail please refer to the DSP Location Interface definition";
CM_ SG_ 264 RFC_Loc001_AzimuthalPartnerId "Id of the azimuthal partner location";
CM_ SG_ 264 RFC_Loc002_RadialDistance "Location radial distance. Represented in conical coordinate system. Same as ISO 23150:2021(E): Position radial distance (A.4.16)";
CM_ SG_ 264 RFC_Loc002_RadialVelocity "Location radial relative velocity ISO 23150:2021(E): Relative velocity {radial distance} (A.4.18)";
CM_ SG_ 264 RFC_Loc002_Elevation "Location elevation angle. Represented in conical coordinate system. Same as ISO 23150:2021(E): Position elevation (A.4.16)";
CM_ SG_ 264 RFC_Loc002_Azimuth "Location azimuth angle. Represented in conical coordinate system. Deviation from ISO 23150:2021(E): Position azimuth (A.4.16). Further details refers to DSP Location Interface definition";
CM_ SG_ 264 RFC_Loc002_DistVelocityCoVnce "Covariance of radial distance and radial velocity";
CM_ SG_ 264 RFC_Loc002_RadialDistanceVnce "Variance of Location radial distance ISO 23150:2021(E): Position radial distance - error (A.4.17)";
CM_ SG_ 264 RFC_Loc002_RadialVelocityVnce "Variance of Location radial relative velocity ISO 23150:2021(E): Relative velocity {radial distance} - error (A.4.19)";
CM_ SG_ 264 RFC_Loc002_ElevationVnce "Variance of Location elevation angle ISO 23150:2021(E): Position elevation - error (A.4.17)";
CM_ SG_ 264 RFC_Loc002_AzimuthVnce "Variance of Location azimuth angle ISO 23150:2021(E): Position azimuth - error (A.4.17)";
CM_ SG_ 264 RFC_Loc002_RadarCrossSection "Radar Cross Section (RCS) estimation ISO 23150:2021(E): Radar cross section (A.4.5)";
CM_ SG_ 264 RFC_Loc002_DistVelocityQuality "Quality of radial distance and velocity resolution processing. Physical range [0..1]";
CM_ SG_ 264 RFC_Loc002_ElevationQuality "Probability for correct signal model (elevation angle). Physical range [0..1]";
CM_ SG_ 264 RFC_Loc002_AzimuthQuality "Probability for correct signal model (azimuth angle). Physical range [0..1]";
CM_ SG_ 264 RFC_Loc002_RSSI "Received Signal Strength Indication (RSSI). This signal is not exactly ISO 23150:2021(E): Signal to noise ratio - detection level (A.4.7), but SNR can be calculated from this signal. Further detail please refer to the DSP Location Interface definition";
CM_ SG_ 264 RFC_Loc002_AzimuthalPartnerId "Id of the azimuthal partner location";
CM_ SG_ 265 RFC_Loc003_005_CRC "CRC - Autosar E2E Profile 5";
CM_ SG_ 265 RFC_Loc003_005_AliveCtr "Alive counter - Autosar E2E Profile 5";
CM_ SG_ 265 RFC_Loc003_005_ProtBlockCtr "Protocol-Signal: Block-Counter";
CM_ SG_ 265 RFC_Loc003_RadialDistance "Location radial distance. Represented in conical coordinate system. Same as ISO 23150:2021(E): Position radial distance (A.4.16)";
CM_ SG_ 265 RFC_Loc003_RadialVelocity "Location radial relative velocity ISO 23150:2021(E): Relative velocity {radial distance} (A.4.18)";
CM_ SG_ 265 RFC_Loc003_Elevation "Location elevation angle. Represented in conical coordinate system. Same as ISO 23150:2021(E): Position elevation (A.4.16)";
CM_ SG_ 265 RFC_Loc003_Azimuth "Location azimuth angle. Represented in conical coordinate system. Deviation from ISO 23150:2021(E): Position azimuth (A.4.16). Further details refers to DSP Location Interface definition";
CM_ SG_ 265 RFC_Loc003_DistVelocityCoVnce "Covariance of radial distance and radial velocity";
CM_ SG_ 265 RFC_Loc003_RadialDistanceVnce "Variance of Location radial distance ISO 23150:2021(E): Position radial distance - error (A.4.17)";
CM_ SG_ 265 RFC_Loc003_RadialVelocityVnce "Variance of Location radial relative velocity ISO 23150:2021(E): Relative velocity {radial distance} - error (A.4.19)";
CM_ SG_ 265 RFC_Loc003_ElevationVnce "Variance of Location elevation angle ISO 23150:2021(E): Position elevation - error (A.4.17)";
CM_ SG_ 265 RFC_Loc003_AzimuthVnce "Variance of Location azimuth angle ISO 23150:2021(E): Position azimuth - error (A.4.17)";
CM_ SG_ 265 RFC_Loc003_RadarCrossSection "Radar Cross Section (RCS) estimation ISO 23150:2021(E): Radar cross section (A.4.5)";
CM_ SG_ 265 RFC_Loc003_DistVelocityQuality "Quality of radial distance and velocity resolution processing. Physical range [0..1]";
CM_ SG_ 265 RFC_Loc003_ElevationQuality "Probability for correct signal model (elevation angle). Physical range [0..1]";
CM_ SG_ 265 RFC_Loc003_AzimuthQuality "Probability for correct signal model (azimuth angle). Physical range [0..1]";
CM_ SG_ 265 RFC_Loc003_RSSI "Received Signal Strength Indication (RSSI). This signal is not exactly ISO 23150:2021(E): Signal to noise ratio - detection level (A.4.7), but SNR can be calculated from this signal. Further detail please refer to the DSP Location Interface definition";
CM_ SG_ 265 RFC_Loc003_AzimuthalPartnerId "Id of the azimuthal partner location";
CM_ SG_ 265 RFC_Loc004_RadialDistance "Location radial distance. Represented in conical coordinate system. Same as ISO 23150:2021(E): Position radial distance (A.4.16)";
CM_ SG_ 265 RFC_Loc004_RadialVelocity "Location radial relative velocity ISO 23150:2021(E): Relative velocity {radial distance} (A.4.18)";
CM_ SG_ 265 RFC_Loc004_Elevation "Location elevation angle. Represented in conical coordinate system. Same as ISO 23150:2021(E): Position elevation (A.4.16)";
CM_ SG_ 265 RFC_Loc004_Azimuth "Location azimuth angle. Represented in conical coordinate system. Deviation from ISO 23150:2021(E): Position azimuth (A.4.16). Further details refers to DSP Location Interface definition";
CM_ SG_ 265 RFC_Loc004_DistVelocityCoVnce "Covariance of radial distance and radial velocity";
CM_ SG_ 265 RFC_Loc004_RadialDistanceVnce "Variance of Location radial distance ISO 23150:2021(E): Position radial distance - error (A.4.17)";
CM_ SG_ 265 RFC_Loc004_RadialVelocityVnce "Variance of Location radial relative velocity ISO 23150:2021(E): Relative velocity {radial distance} - error (A.4.19)";
CM_ SG_ 265 RFC_Loc004_ElevationVnce "Variance of Location elevation angle ISO 23150:2021(E): Position elevation - error (A.4.17)";
CM_ SG_ 265 RFC_Loc004_AzimuthVnce "Variance of Location azimuth angle ISO 23150:2021(E): Position azimuth - error (A.4.17)";
CM_ SG_ 265 RFC_Loc004_RadarCrossSection "Radar Cross Section (RCS) estimation ISO 23150:2021(E): Radar cross section (A.4.5)";
CM_ SG_ 265 RFC_Loc004_DistVelocityQuality "Quality of radial distance and velocity resolution processing. Physical range [0..1]";
CM_ SG_ 265 RFC_Loc004_ElevationQuality "Probability for correct signal model (elevation angle). Physical range [0..1]";
CM_ SG_ 265 RFC_Loc004_AzimuthQuality "Probability for correct signal model (azimuth angle). Physical range [0..1]";
CM_ SG_ 265 RFC_Loc004_RSSI "Received Signal Strength Indication (RSSI). This signal is not exactly ISO 23150:2021(E): Signal to noise ratio - detection level (A.4.7), but SNR can be calculated from this signal. Further detail please refer to the DSP Location Interface definition";
CM_ SG_ 265 RFC_Loc004_AzimuthalPartnerId "Id of the azimuthal partner location";
CM_ SG_ 265 RFC_Loc005_RadialDistance "Location radial distance. Represented in conical coordinate system. Same as ISO 23150:2021(E): Position radial distance (A.4.16)";
CM_ SG_ 265 RFC_Loc005_RadialVelocity "Location radial relative velocity ISO 23150:2021(E): Relative velocity {radial distance} (A.4.18)";
CM_ SG_ 265 RFC_Loc005_Elevation "Location elevation angle. Represented in conical coordinate system. Same as ISO 23150:2021(E): Position elevation (A.4.16)";
CM_ SG_ 265 RFC_Loc005_Azimuth "Location azimuth angle. Represented in conical coordinate system. Deviation from ISO 23150:2021(E): Position azimuth (A.4.16). Further details refers to DSP Location Interface definition";
CM_ SG_ 265 RFC_Loc005_DistVelocityCoVnce "Covariance of radial distance and radial velocity";
CM_ SG_ 265 RFC_Loc005_RadialDistanceVnce "Variance of Location radial distance ISO 23150:2021(E): Position radial distance - error (A.4.17)";
CM_ SG_ 265 RFC_Loc005_RadialVelocityVnce "Variance of Location radial relative velocity ISO 23150:2021(E): Relative velocity {radial distance} - error (A.4.19)";
CM_ SG_ 265 RFC_Loc005_ElevationVnce "Variance of Location elevation angle ISO 23150:2021(E): Position elevation - error (A.4.17)";
CM_ SG_ 265 RFC_Loc005_AzimuthVnce "Variance of Location azimuth angle ISO 23150:2021(E): Position azimuth - error (A.4.17)";
CM_ SG_ 265 RFC_Loc005_RadarCrossSection "Radar Cross Section (RCS) estimation ISO 23150:2021(E): Radar cross section (A.4.5)";
CM_ SG_ 265 RFC_Loc005_DistVelocityQuality "Quality of radial distance and velocity resolution processing. Physical range [0..1]";
CM_ SG_ 265 RFC_Loc005_ElevationQuality "Probability for correct signal model (elevation angle). Physical range [0..1]";
CM_ SG_ 265 RFC_Loc005_AzimuthQuality "Probability for correct signal model (azimuth angle). Physical range [0..1]";
CM_ SG_ 265 RFC_Loc005_RSSI "Received Signal Strength Indication (RSSI). This signal is not exactly ISO 23150:2021(E): Signal to noise ratio - detection level (A.4.7), but SNR can be calculated from this signal. Further detail please refer to the DSP Location Interface definition";
CM_ SG_ 265 RFC_Loc005_AzimuthalPartnerId "Id of the azimuthal partner location";
BA_DEF_ BO_  "CANFD_BRS" ENUM  "0","1";
BA_DEF_ BO_  "GenMsgCycleTime" INT 0 65535;
BA_DEF_ BO_  "GenMsgILSupport" ENUM  "No","Yes";
BA_DEF_ BO_  "GenMsgSendType" ENUM  "Cyclic","Event","reserved","reserved","reserved","reserved","reserved","IfActive","NoMsgSendType","reserved","reserved","reserved";
BA_DEF_ BO_  "VFrameFormat" ENUM  "StandardCAN","ExtendedCAN","reserved","reserved","reserved","reserved","reserved","reserved","reserved","reserved","reserved","reserved","reserved","reserved","StandardCAN_FD","ExtendedCAN_FD";
BA_DEF_ BO_  "E2Eprofile" STRING ;
BA_DEF_ BO_  "DataID" HEX 0 655535;
BA_DEF_ SG_  "GenSigSendType" ENUM  "Cyclic","OnWrite","OnWriteWithRepetition","OnChange","OnChangeWithRepetition","IfActive","IfActiveWithRepetition","NoSigSendType","OnChangeAndIfActive","OnChangeAndIfActiveWithRepetition";
BA_DEF_ SG_  "GenSigStartValue" HEX 0 2147483648;
BA_DEF_DEF_  "CANFD_BRS" "1";
BA_DEF_DEF_  "GenMsgCycleTime" 0;
BA_DEF_DEF_  "GenMsgILSupport" "Yes";
BA_DEF_DEF_  "GenMsgSendType" "Cyclic";
BA_DEF_DEF_  "VFrameFormat" "";
BA_DEF_DEF_  "E2Eprofile" "None";
BA_DEF_DEF_  "DataID" 0;
BA_DEF_DEF_  "GenSigSendType" "NoSigSendType";
BA_DEF_DEF_  "GenSigStartValue" 0;
BA_ "GenMsgSendType" BO_ 244 1;
BA_ "E2Eprofile" BO_ 244 "AUTOSAR Profile 5";
BA_ "DataID" BO_ 244 8436;
BA_ "VFrameFormat" BO_ 244 14;
BA_ "GenMsgSendType" BO_ 245 1;
BA_ "E2Eprofile" BO_ 245 "AUTOSAR Profile 5";
BA_ "DataID" BO_ 245 8437;
BA_ "VFrameFormat" BO_ 245 14;
BA_ "GenMsgSendType" BO_ 260 1;
BA_ "E2Eprofile" BO_ 260 "AUTOSAR Profile 5";
BA_ "DataID" BO_ 260 8452;
BA_ "VFrameFormat" BO_ 260 14;
BA_ "GenMsgSendType" BO_ 261 1;
BA_ "E2Eprofile" BO_ 261 "AUTOSAR Profile 5";
BA_ "DataID" BO_ 261 8453;
BA_ "VFrameFormat" BO_ 261 14;
BA_ "GenMsgSendType" BO_ 264 1;
BA_ "E2Eprofile" BO_ 264 "AUTOSAR Profile 5";
BA_ "DataID" BO_ 264 8456;
BA_ "VFrameFormat" BO_ 264 14;
BA_ "GenMsgSendType" BO_ 265 1;
BA_ "E2Eprofile" BO_ 265 "AUTOSAR Profile 5";
BA_ "DataID" BO_ 265 8457;
BA_ "VFrameFormat" BO_ 265 14;
BA_ "GenSigStartValue" SG_ 244 VFC_TS12_Py 128;
BA_ "GenSigStartValue" SG_ 244 VFC_TS13_Py 128;
BA_ "GenSigStartValue" SG_ 245 VFC_TS14_Py 128;
BA_ "GenSigStartValue" SG_ 245 VFC_TS15_Py 128;
BA_ "GenSigStartValue" SG_ 260 RFC_LocHdr_IfVersionIdMajor 1;
BA_ "GenSigStartValue" SG_ 260 RFC_LocHdr_IfVersionIdMinor 3;
BA_ "GenSigStartValue" SG_ 260 RFC_LocHdr_SensorOriginPointY 128;
BA_ "GenSigStartValue" SG_ 260 RFC_LocHdr_SensorOriginPointX 256;
BA_ "GenSigStartValue" SG_ 260 RFC_LocHdr_SensorOrientCorrYaw 32768;
BA_ "GenSigStartValue" SG_ 260 RFC_LocHdr_SensorOrientCorrPitch 8192;
BA_ "GenSigStartValue" SG_ 260 RFC_LocHdr_SensorOrientYaw 32768;
BA_ "GenSigStartValue" SG_ 260 RFC_LocHdr_SensorOrientPitch 8192;
BA_ "GenSigStartValue" SG_ 260 RFC_LocHdr_FovElevation00 64;
BA_ "GenSigStartValue" SG_ 260 RFC_LocHdr_FovElevation01 64;
BA_ "GenSigStartValue" SG_ 260 RFC_LocHdr_FovElevation02 64;
BA_ "GenSigStartValue" SG_ 260 RFC_LocHdr_FovElevation03 64;
BA_ "GenSigStartValue" SG_ 260 RFC_LocHdr_FovElevation04 64;
BA_ "GenSigStartValue" SG_ 260 RFC_LocHdr_FovElevation05 64;
BA_ "GenSigStartValue" SG_ 260 RFC_LocHdr_FovElevation06 64;
BA_ "GenSigStartValue" SG_ 260 RFC_LocHdr_FovElevation07 64;
BA_ "GenSigStartValue" SG_ 260 RFC_LocHdr_FovElevation08 64;
BA_ "GenSigStartValue" SG_ 260 RFC_LocHdr_FovElevation09 64;
BA_ "GenSigStartValue" SG_ 260 RFC_LocHdr_FovElevation10 64;
BA_ "GenSigStartValue" SG_ 261 RFC_LocHdr_FovAzimuth00 128;
BA_ "GenSigStartValue" SG_ 261 RFC_LocHdr_FovAzimuth01 128;
BA_ "GenSigStartValue" SG_ 261 RFC_LocHdr_FovAzimuth02 128;
BA_ "GenSigStartValue" SG_ 261 RFC_LocHdr_FovAzimuth03 128;
BA_ "GenSigStartValue" SG_ 261 RFC_LocHdr_FovAzimuth04 128;
BA_ "GenSigStartValue" SG_ 261 RFC_LocHdr_FovAzimuth05 128;
BA_ "GenSigStartValue" SG_ 261 RFC_LocHdr_FovAzimuth06 128;
BA_ "GenSigStartValue" SG_ 261 RFC_LocHdr_FovAzimuth07 128;
BA_ "GenSigStartValue" SG_ 261 RFC_LocHdr_FovAzimuth08 128;
BA_ "GenSigStartValue" SG_ 261 RFC_LocHdr_FovAzimuth09 128;
BA_ "GenSigStartValue" SG_ 261 RFC_LocHdr_FovAzimuth10 128;
BA_ "GenSigStartValue" SG_ 261 RFC_LocHdr_FovAzimuth11 128;
BA_ "GenSigStartValue" SG_ 261 RFC_LocHdr_FovAzimuth12 128;
BA_ "GenSigStartValue" SG_ 261 RFC_LocHdr_FovAzimuth13 128;
BA_ "GenSigStartValue" SG_ 261 RFC_LocHdr_FovAzimuth14 128;
BA_ "GenSigStartValue" SG_ 261 RFC_LocHdr_FovAzimuth15 128;
BA_ "GenSigStartValue" SG_ 261 RFC_LocHdr_FovAzimuth16 128;
BA_ "GenSigStartValue" SG_ 261 RFC_LocHdr_FovAzimuth17 128;
BA_ "GenSigStartValue" SG_ 261 RFC_LocHdr_FovAzimuth18 128;
BA_ "GenSigStartValue" SG_ 261 RFC_LocHdr_FovAzimuth19 128;
BA_ "GenSigStartValue" SG_ 261 RFC_LocHdr_FovAzimuth20 128;
BA_ "GenSigStartValue" SG_ 261 RFC_LocHdr_FovAzimuth21 128;
BA_ "GenSigStartValue" SG_ 261 RFC_LocHdr_FovAzimuth22 128;
BA_ "GenSigStartValue" SG_ 261 RFC_LocHdr_FovAzimuth23 128;
BA_ "GenSigStartValue" SG_ 261 RFC_LocHdr_FovAzimuth24 128;
BA_ "GenSigStartValue" SG_ 264 RFC_Loc000_RadialVelocity 16384;
BA_ "GenSigStartValue" SG_ 264 RFC_Loc000_Elevation 512;
BA_ "GenSigStartValue" SG_ 264 RFC_Loc000_Azimuth 1024;
BA_ "GenSigStartValue" SG_ 264 RFC_Loc000_DistVelocityCoVnce 1024;
BA_ "GenSigStartValue" SG_ 264 RFC_Loc000_RadarCrossSection 512;
BA_ "GenSigStartValue" SG_ 264 RFC_Loc001_RadialVelocity 16384;
BA_ "GenSigStartValue" SG_ 264 RFC_Loc001_Elevation 512;
BA_ "GenSigStartValue" SG_ 264 RFC_Loc001_Azimuth 1024;
BA_ "GenSigStartValue" SG_ 264 RFC_Loc001_DistVelocityCoVnce 1024;
BA_ "GenSigStartValue" SG_ 264 RFC_Loc001_RadarCrossSection 512;
BA_ "GenSigStartValue" SG_ 264 RFC_Loc002_RadialVelocity 16384;
BA_ "GenSigStartValue" SG_ 264 RFC_Loc002_Elevation 512;
BA_ "GenSigStartValue" SG_ 264 RFC_Loc002_Azimuth 1024;
BA_ "GenSigStartValue" SG_ 264 RFC_Loc002_DistVelocityCoVnce 1024;
BA_ "GenSigStartValue" SG_ 264 RFC_Loc002_RadarCrossSection 512;
BA_ "GenSigStartValue" SG_ 265 RFC_Loc003_RadialVelocity 16384;
BA_ "GenSigStartValue" SG_ 265 RFC_Loc003_Elevation 512;
BA_ "GenSigStartValue" SG_ 265 RFC_Loc003_Azimuth 1024;
BA_ "GenSigStartValue" SG_ 265 RFC_Loc003_DistVelocityCoVnce 1024;
BA_ "GenSigStartValue" SG_ 265 RFC_Loc003_RadarCrossSection 512;
BA_ "GenSigStartValue" SG_ 265 RFC_Loc004_RadialVelocity 16384;
BA_ "GenSigStartValue" SG_ 265 RFC_Loc004_Elevation 512;
BA_ "GenSigStartValue" SG_ 265 RFC_Loc004_Azimuth 1024;
BA_ "GenSigStartValue" SG_ 265 RFC_Loc004_DistVelocityCoVnce 1024;
BA_ "GenSigStartValue" SG_ 265 RFC_Loc004_RadarCrossSection 512;
BA_ "GenSigStartValue" SG_ 265 RFC_Loc005_RadialVelocity 16384;
BA_ "GenSigStartValue" SG_ 265 RFC_Loc005_Elevation 512;
BA_ "GenSigStartValue" SG_ 265 RFC_Loc005_Azimuth 1024;
BA_ "GenSigStartValue" SG_ 265 RFC_Loc005_DistVelocityCoVnce 1024;
BA_ "GenSigStartValue" SG_ 265 RFC_Loc005_RadarCrossSection 512;
VAL_ 244 VFC_TS12_Type 0 "UNKNOWN" 1 "SL5" 2 "SL10" 3 "SL15" 4 "SL20" 5 "SL25" 6 "SL30" 7 "SL35" 8 "SL40" 9 "SL45" 10 "SL50" 11 "SL55" 12 "SL60" 13 "SL65" 14 "SL70" 15 "SL75" 16 "SL80" 17 "SL85" 18 "SL90" 19 "SL95" 20 "SL100" 21 "SL105" 22 "SL110" 23 "SL115" 24 "SL120" 25 "SL125" 26 "SL130" 27 "SL135" 28 "SL140" 29 "SL145" 30 "SL150" 31 "SL155" 32 "SL160" 33 "OP" 34 "OL" 35 "ESL" 36 "EOP" 37 "EOL" 38 "EA" 39 "VSL5" 40 "VSL10" 41 "VSL15" 42 "VSL20" 43 "VSL25" 44 "VSL30" 45 "VSL35" 46 "VSL40" 47 "VSL45" 48 "VSL50" 49 "VSL55" 50 "VSL60" 51 "VSL65" 52 "VSL70" 53 "VSL75" 54 "VSL80" 55 "VSL85" 56 "VSL90" 57 "VSL95" 58 "VSL100" 59 "VSL105" 60 "VSL110" 61 "VSL115" 62 "VSL120" 63 "VSL125" 64 "VSL130" 65 "VSL135" 66 "VSL140" 67 "VSL145" 68 "VSL150" 69 "VSL155" 70 "VSL160" 71 "VOP" 72 "VOL" 73 "VESL" 74 "VEOP" 75 "VEOL" 76 "VEA" 77 "NOENTRY" 78 "NOALL" 79 "NOCAR" 80 "NOLORRY" 81 "NOHAZMAT" 82 "NOBIKE" 83 "NOPED" 84 "NOCARBIKE" 85 "NOTWOWAY" 86 "WEIGHT" 87 "HEIGHT" 88 "WIDTH" 89 "LENGTH" 90 "PRIOCROSS" 91 "GIVEWAY" 92 "PRIOCROSSYIELDTORIGHT" 93 "WARNDANGER" 94 "WARNCURVEL" 95 "WARNCURVER" 96 "WARNDCURVEL" 97 "WARNDCURVER" 98 "WARNTRAIN" 99 "WARNJAM" 100 "WARNANIMAL_DEPRECATED" 101 "WARNRWORKS" 102 "WARNSLOPED" 103 "WARNSLOPEU" 104 "PRIOSTREET" 105 "EPRIOSTREET" 106 "STOP" 107 "ASL" 108 "EASL" 109 "MSL" 110 "EMSL" 111 "MLC" 112 "WBDIAGL" 113 "WBDIAGR" 114 "WBROUND" 115 "NOLTURN" 116 "NORTURN" 117 "NOUTURN" 118 "NOPARK" 119 "NOSTOP" 120 "SMOG" 121 "UMWELT" 122 "EUMWELT" 123 "DOUANE" 124 "FWAY" 125 "EFWAY" 126 "HWAY" 127 "EHWAY" 128 "NORIDER" 129 "WARNCONST" 130 "WARNCONSTL" 131 "WARNCONSTR" 132 "WARNPED" 133 "WARNKIDS" 134 "WARNBIKE" 135 "WARNSKID" 136 "ZEBRA" 137 "ONEWAYS" 138 "ONEWAYU" 139 "SLOWDOWN" 140 "NOCARRIAGE" 141 "NOLORRYTRAILER" 142 "NOBUS" 143 "NOTRACTOR" 144 "LORRYDIST" 145 "CARDIST" 146 "WARNROUND" 147 "WARNWILDANIMAL" 148 "WARNCATTLE" 149 "WARNFROG" 150 "WARNBUS" 151 "WARNWIND" 152 "WARNSNOW" 153 "WARNPCROSS" 154 "WARNHUMP" 155 "WARNROCK" 156 "WARNLOWTREE" 157 "WARNGRAVEL" 158 "WARNTWOWAY" 159 "WARNLIGHTS" 160 "WARNPLANE" 161 "VNOENTRY" 162 "VNOALL" 163 "VNOCAR" 164 "VNOLORRY" 165 "VNOCARBIKE" 166 "VWEIGHT" 167 "VHEIGHT" 168 "VWIDTH" 169 "VLENGTH" 170 "VWARNDANGER" 171 "VWARNJAM" 172 "VWARNRWORKS" 173 "VWARNSKID" 174 "VASL" 175 "VEASL" 176 "VNOLORRYTRAILER" 177 "VNOBUS" 178 "VLORRYDIST" 179 "VCARDIST" 180 "VWARNSNOW" 181 "VWARNHUMP" 182 "VWARNGRAVEL" 183 "CALM" 184 "ECALM" 185 "TWN" 186 "ETWN" 187 "DEADEND" 188 "AXLEWEIGHT" 189 "WARNRIDER" 190 "WARNDRAWBRIDGE" 191 "WARNPIER" 192 "TRINATURE" 193 "VWARNCONST" 194 "VWARNCONSTL" 195 "VWARNCONSTR" 196 "VWARNCURVEL" 197 "VWARNCURVER" 198 "VWARNDCURVEL" 199 "VWARNDCURVER" 200 "VWARNLIGHTS" 201 "WBBENTLEFT" 202 "WBBENTLEFTRIGHT" 203 "WBBENTRIGHT" 204 "WBDIAGLR" 205 "WBLEFT" 206 "WBRIGHT" 207 "WBUP" 208 "WBUPLEFT" 209 "WBUPRIGHT" 210 "WBHAZWATER" 211 "NOHAZWATER" 212 "SCHOOL" 213 "ESCHOOL" 214 "HAZMAT" 215 "EMERGENCYBAY" 216 "ENDOFLANEL" 217 "ENDOFLANER" 218 "ENOPARK" 219 "EONEWAY" 220 "EPARK" 221 "ETOLL" 222 "NOPARKL" 223 "NOPARKLR" 224 "NOPARKR" 225 "NOSTOPL" 226 "NOSTOPLR" 227 "NOSTOPR" 228 "NOTURNONRED" 229 "ONEWAYL" 230 "ONEWAYR" 231 "PARK" 232 "PRIOCROSSL" 233 "PRIOCROSSR" 234 "TOLL" 235 "TUNNEL" 236 "TWOWAY" 237 "WARNCROSS" 238 "WARNCROSSL" 239 "WARNCROSSLR" 240 "WARNCROSSR" 241 "WARNCROSSRL" 242 "WARNCROSST" 243 "WARNGIVEWAYAHEAD" 244 "WARNSLAHEAD" 245 "WARNSTOPAHEAD" 246 "WBBUS" 247 "WRONGWAY" 248 "HAZWATER" 249 "GIVEWAYROUND" 250 "WARNWINDINGL" 251 "WARNWINDINGR" 252 "WARNHAIRPINL" 253 "WARNHAIRPINR" 254 "WARNPEDBIKE" 255 "WARNCROSSY" 256 "WARNBRANCHL" 257 "WARNBRANCHR" 258 "WARNAXLEWEIGHT" 259 "WARNWEIGHT" 260 "WARNHEIGHT" 261 "WARNLENGTH" 262 "WARNWIDTH" 263 "WARNBLACKSPOT" 264 "WARNMERGEL" 265 "WARNMERGER" 266 "WARNTUNNEL" 267 "WARNTRACTOR" 268 "WARNRWORKSVEHICLE" 269 "WARNNARROWBRIDGE" 270 "WARNFLAGGER" 271 "LANES" 272 "LANESHIFTL" 273 "LANESHIFTR" 274 "NEWLANEL" 275 "NEWLANER" 276 "RIGHTTURNONRED" 277 "BORDERLIMIT" 278 "EMBEDDEDRAIN" 279 "VWARNWEIGHT" 280 "VWARNHEIGHT" 281 "VWARNLENGTH" 282 "VWARNWIDTH" 283 "VENDOFLANEL" 284 "VENDOFLANER" 285 "VLANES" 286 "VLANESHIFTL" 287 "VLANESHIFTR" 288 "VNEWLANEL" 289 "VNEWLANER" 290 "NOUP" 291 "VOFF" 292 "ASL5" 293 "ASL10" 294 "ASL15" 295 "ASL20" 296 "ASL25" 297 "ASL30" 298 "ASL35" 299 "ASL40" 300 "ASL45" 301 "ASL50" 302 "ASL55" 303 "ASL60" 304 "ASL65" 305 "ASL70" 306 "ASL75" 307 "ASL80" 308 "ASL85" 309 "ASL90" 310 "ASL95" 311 "ASL100" 312 "ASL105" 313 "ASL110" 314 "ASL115" 315 "ASL120" 316 "ASL125" 317 "ASL130" 318 "ASL135" 319 "ASL140" 320 "ASL145" 321 "ASL150" 322 "ASL155" 323 "ASL160" 324 "VASL5" 325 "VASL10" 326 "VASL15" 327 "VASL20" 328 "VASL25" 329 "VASL30" 330 "VASL35" 331 "VASL40" 332 "VASL45" 333 "VASL50" 334 "VASL55" 335 "VASL60" 336 "VASL65" 337 "VASL70" 338 "VASL75" 339 "VASL80" 340 "VASL85" 341 "VASL90" 342 "VASL95" 343 "VASL100" 344 "VASL105" 345 "VASL110" 346 "VASL115" 347 "VASL120" 348 "VASL125" 349 "VASL130" 350 "VASL135" 351 "VASL140" 352 "VASL145" 353 "VASL150" 354 "VASL155" 355 "VASL160" 356 "WARNTRAINGATED" 357 "KEEPRIGHTCAR" 358 "ASLCURVE5" 359 "ASLCURVE10" 360 "ASLCURVE15" 361 "ASLCURVE20" 362 "ASLCURVE25" 363 "ASLCURVE30" 364 "ASLCURVE35" 365 "ASLCURVE40" 366 "ASLCURVE45" 367 "ASLCURVE50" 368 "ASLCURVE55" 369 "ASLCURVE60" 370 "ASLCURVE65" 371 "ASLCURVE70" 372 "ASLCURVE75" 373 "ASLCURVE80" 374 "ASLCURVE85" 375 "ASLCURVE90" 376 "ASLCURVE95" 377 "ASLCURVE100" 378 "ASLCURVE105" 379 "ASLCURVE110" 380 "ASLCURVE115" 381 "ASLCURVE120" 382 "ASLCURVE125" 383 "ASLCURVE130" 384 "ASLCURVE135" 385 "ASLCURVE140" 386 "ASLCURVE145" 387 "ASLCURVE150" 388 "ASLCURVE155" 389 "ASLCURVE160" 390 "KIDS" 391 "EKIDS" 392 "BIKEROAD" 393 "EBIKEROAD" 394 "PEDSTREET" 395 "EPEDSTREET" 396 "PEDBIKESTREET" 397 "EPEDBIKESTREET" 398 "EWARNKIDS" 399 "CALM20" 400 "CALM30" 401 "ECALM20" 402 "ECALM30" 403 "FWAYGREEN" 404 "TWN40" 405 "TWN50" 406 "TWN60" 407 "TWN70" 408 "ETWN40" 409 "ETWN50" 410 "ETWN60" 411 "ETWN70" 412 "WBBIKE" 413 "EWBBIKE" 414 "WBPED" 415 "EWBPED" 416 "WBPEDBIKESEP" 417 "EWBPEDBIKESEP" 418 "WBPEDBIKESHARED" 419 "EWBPEDBIKESHARED" 420 "EFWAYGREEN" 421 "Reserved0421" 422 "Reserved0422" 423 "Reserved0423" 424 "Reserved0424" 425 "Reserved0425" 426 "Reserved0426" 427 "Reserved0427" 428 "Reserved0428" 429 "Reserved0429" 430 "Reserved0430" 431 "Reserved0431" 432 "Reserved0432" 433 "Reserved0433" 434 "Reserved0434" 435 "Reserved0435" 436 "Reserved0436" 437 "Reserved0437" 438 "Reserved0438" 439 "Reserved0439" 440 "Reserved0440" 441 "Reserved0441" 442 "Reserved0442" 443 "Reserved0443" 444 "Reserved0444" 445 "Reserved0445" 446 "Reserved0446" 447 "Reserved0447" 448 "Reserved0448" 449 "Reserved0449" ;
VAL_ 244 VFC_TS12_EmbeddedInfo 0 "Unknown" 1 "Not Embedded" 2 "Border Limit" 3 "Multi Lane" 4 "Rain" 5 "Vehicle Type" 6 "Plate" 7 "Error Value" 8 "Vehicle Sticker" 9 "Reserved09" 10 "Reserved10" 11 "Reserved11" 12 "Reserved12" 13 "Reserved13" 14 "Reserved14" 15 "Reserved15" ;
VAL_ 244 VFC_TS12_ValidTimeRange1Start 127 "Unknown" ;
VAL_ 244 VFC_TS12_ValidTimeRange1End 127 "Unknown" ;
VAL_ 244 VFC_TS12_ValidTimeRange2Start 127 "Unknown" ;
VAL_ 244 VFC_TS12_ValidTimeRange2End 127 "Unknown" ;
VAL_ 244 VFC_TS12_ValidInDistUnit 0 "Unknown" ;
VAL_ 244 VFC_TS12_ValidSectionUnit 0 "Unknown" 1 "Meter" 2 "Kilometer" 3 "Foot" 4 "Yard" 5 "Mile" 6 "Reserved6" 7 "Reserved7" ;
VAL_ 244 VFC_TS12_SupSign0Type 0 "UNKNOWN" 1 "ADDCAR" 2 "ADDLORRY" 3 "ADDTRAILER" 4 "ADDCARAVAN" 5 "ADDBUS" 6 "ADDTRACTOR" 7 "ADDMCYCLE" 8 "ADDLORRYBUSTRAILER_DEPRECATED" 9 "ADDLORRYBUS_DEPRECATED" 10 "ADDHAZMAT" 11 "ADDTANK" 12 "ADDTRAM" 13 "ADDWET" 14 "ADDFOG" 15 "ADDRAIN" 16 "ADDSNOW" 17 "ADDTIME" 18 "ADDSECTION" 19 "ADDDISTANCE" 20 "ADDWEIGHT" 21 "ADDEXITL" 22 "ADDEXITR" 23 "ADDLANES" 24 "ADDRADAR" 25 "ADDRAPPEL" 26 "ADDPRIOTURN" 27 "ADDLORRY_EXCEPT" 28 "ADDTRACTOR_OVER" 29 "ADDTEXT" 30 "ADDSIGN" 31 "ADDRAINSNOW" 32 "ADDHUMP" 33 "VADDLORRYBUSTRAILER_DEPRECATED" 34 "VADDLORRYBUS_DEPRECATED" 35 "VADDLORRYTRAILER_DEPRECATED" 36 "ADDLORRYTRAILER_DEPRECATED" 37 "ADDCAMPER" 38 "ADDZONE" 39 "ADDCRASHRISK" 40 "ADDACCIDENT" 41 "ADDJAM" 42 "ADDSMOKE" 43 "ADDOILTRAIL" 44 "ADDGRAVEL" 45 "ADDDIRT" 46 "ADDRWORKSEXIT" 47 "ADDROADDAMAGE" 48 "ADDRWORKSENTRY" 49 "ADDLOWTREE" 50 "ADDRWORKSACCESS" 51 "ADDRUTS" 52 "ADDSOFTSHOULDERCAR" 53 "ADDSOFTSHOULDERLORRY" 54 "VADDSIGN" 55 "VADDCAR" 56 "VADDLORRY" 57 "VADDTRAILER" 58 "VADDCARAVAN" 59 "VADDBUS" 60 "VADDWET" 61 "VADDFOG" 62 "VADDRAIN" 63 "VADDSNOW" 64 "VADDRAINSNOW" 65 "VADDTEXT" 66 "VADDSECTION" 67 "VADDDISTANCE" 68 "VADDWEIGHT" 69 "VADDZONE" 70 "VADDCRASHRISK" 71 "VADDACCIDENT" 72 "VADDJAM" 73 "VADDOILTRAIL" 74 "VADDGRAVEL" 75 "VADDDIRT" 76 "VADDROADDAMAGE" 77 "VADDRUTS" 78 "ADDNOSTOPSHOULDER" 79 "ADDTOWING" 80 "ADDSCHOOL" 81 "ADDNIGHT" 82 "ADDEND" 83 "ADDBEGINS" 84 "ADDWITHIN" 85 "ADDDISTANCEBARS" 86 "ADDMINIMUM" 87 "ADDADVICE" 88 "ADDACCESS" 89 "ADDALLWAY" 90 "ADDBUS_EXCEPT" 91 "ADDEXCEPTDELIVERY" 92 "ADDEXCEPTLOCAL" 93 "ADDFROG" 94 "ADDPRIOTURNL" 95 "ADDPRIOTURNR" 96 "ADDSTART" 97 "ADDSTOPIN" 98 "ADDEXIT" 99 "ADDHAZWATER" 100 "ADDDAY" 101 "ADDSL" 102 "ADDLORRYTRAILER" 103 "ADDLORRYSEMI" 104 "VADDLORRYTRAILER" 105 "VADDLORRYSEMI" 106 "ADDSLOW" 107 "ADDSL5" 108 "ADDSL10" 109 "ADDSL15" 110 "ADDSL20" 111 "ADDSL25" 112 "ADDSL30" 113 "ADDSL35" 114 "ADDSL40" 115 "ADDSL45" 116 "ADDSL50" 117 "ADDSL55" 118 "ADDSL60" 119 "ADDSL65" 120 "ADDSL70" 121 "ADDSL75" 122 "ADDSL80" 123 "ADDSL85" 124 "ADDSL90" 125 "ADDSL95" 126 "ADDSL100" 127 "ADDSL105" 128 "ADDSL110" 129 "ADDSL115" 130 "ADDSL120" 131 "ADDSL125" 132 "ADDSL130" 133 "ADDSL135" 134 "ADDSL140" 135 "ADDSL145" 136 "ADDSL150" 137 "ADDSL155" 138 "ADDSL160" 139 "ADDBIKEROAD" 140 "ADDLORRYTRAILER_EXCEPT" 141 "ADDLORRYSEMI_EXCEPT" 142 "Reserved142" 143 "Reserved143" 144 "Reserved144" 145 "Reserved145" 146 "Reserved146" 147 "Reserved147" 148 "Reserved148" 149 "Reserved149" 150 "Reserved150" 151 "Reserved151" 152 "Reserved152" 153 "Reserved153" 154 "Reserved154" 155 "Reserved155" 156 "Reserved156" 157 "Reserved157" 158 "Reserved158" 159 "Reserved159" 160 "Reserved160" 161 "Reserved161" 162 "Reserved162" 163 "Reserved163" 164 "Reserved164" 165 "Reserved165" 166 "Reserved166" 167 "Reserved167" 168 "Reserved168" 169 "Reserved169" ;
VAL_ 244 VFC_TS12_SupSign1Type 0 "UNKNOWN" 1 "ADDCAR" 2 "ADDLORRY" 3 "ADDTRAILER" 4 "ADDCARAVAN" 5 "ADDBUS" 6 "ADDTRACTOR" 7 "ADDMCYCLE" 8 "ADDLORRYBUSTRAILER_DEPRECATED" 9 "ADDLORRYBUS_DEPRECATED" 10 "ADDHAZMAT" 11 "ADDTANK" 12 "ADDTRAM" 13 "ADDWET" 14 "ADDFOG" 15 "ADDRAIN" 16 "ADDSNOW" 17 "ADDTIME" 18 "ADDSECTION" 19 "ADDDISTANCE" 20 "ADDWEIGHT" 21 "ADDEXITL" 22 "ADDEXITR" 23 "ADDLANES" 24 "ADDRADAR" 25 "ADDRAPPEL" 26 "ADDPRIOTURN" 27 "ADDLORRY_EXCEPT" 28 "ADDTRACTOR_OVER" 29 "ADDTEXT" 30 "ADDSIGN" 31 "ADDRAINSNOW" 32 "ADDHUMP" 33 "VADDLORRYBUSTRAILER_DEPRECATED" 34 "VADDLORRYBUS_DEPRECATED" 35 "VADDLORRYTRAILER_DEPRECATED" 36 "ADDLORRYTRAILER_DEPRECATED" 37 "ADDCAMPER" 38 "ADDZONE" 39 "ADDCRASHRISK" 40 "ADDACCIDENT" 41 "ADDJAM" 42 "ADDSMOKE" 43 "ADDOILTRAIL" 44 "ADDGRAVEL" 45 "ADDDIRT" 46 "ADDRWORKSEXIT" 47 "ADDROADDAMAGE" 48 "ADDRWORKSENTRY" 49 "ADDLOWTREE" 50 "ADDRWORKSACCESS" 51 "ADDRUTS" 52 "ADDSOFTSHOULDERCAR" 53 "ADDSOFTSHOULDERLORRY" 54 "VADDSIGN" 55 "VADDCAR" 56 "VADDLORRY" 57 "VADDTRAILER" 58 "VADDCARAVAN" 59 "VADDBUS" 60 "VADDWET" 61 "VADDFOG" 62 "VADDRAIN" 63 "VADDSNOW" 64 "VADDRAINSNOW" 65 "VADDTEXT" 66 "VADDSECTION" 67 "VADDDISTANCE" 68 "VADDWEIGHT" 69 "VADDZONE" 70 "VADDCRASHRISK" 71 "VADDACCIDENT" 72 "VADDJAM" 73 "VADDOILTRAIL" 74 "VADDGRAVEL" 75 "VADDDIRT" 76 "VADDROADDAMAGE" 77 "VADDRUTS" 78 "ADDNOSTOPSHOULDER" 79 "ADDTOWING" 80 "ADDSCHOOL" 81 "ADDNIGHT" 82 "ADDEND" 83 "ADDBEGINS" 84 "ADDWITHIN" 85 "ADDDISTANCEBARS" 86 "ADDMINIMUM" 87 "ADDADVICE" 88 "ADDACCESS" 89 "ADDALLWAY" 90 "ADDBUS_EXCEPT" 91 "ADDEXCEPTDELIVERY" 92 "ADDEXCEPTLOCAL" 93 "ADDFROG" 94 "ADDPRIOTURNL" 95 "ADDPRIOTURNR" 96 "ADDSTART" 97 "ADDSTOPIN" 98 "ADDEXIT" 99 "ADDHAZWATER" 100 "ADDDAY" 101 "ADDSL" 102 "ADDLORRYTRAILER" 103 "ADDLORRYSEMI" 104 "VADDLORRYTRAILER" 105 "VADDLORRYSEMI" 106 "ADDSLOW" 107 "ADDSL5" 108 "ADDSL10" 109 "ADDSL15" 110 "ADDSL20" 111 "ADDSL25" 112 "ADDSL30" 113 "ADDSL35" 114 "ADDSL40" 115 "ADDSL45" 116 "ADDSL50" 117 "ADDSL55" 118 "ADDSL60" 119 "ADDSL65" 120 "ADDSL70" 121 "ADDSL75" 122 "ADDSL80" 123 "ADDSL85" 124 "ADDSL90" 125 "ADDSL95" 126 "ADDSL100" 127 "ADDSL105" 128 "ADDSL110" 129 "ADDSL115" 130 "ADDSL120" 131 "ADDSL125" 132 "ADDSL130" 133 "ADDSL135" 134 "ADDSL140" 135 "ADDSL145" 136 "ADDSL150" 137 "ADDSL155" 138 "ADDSL160" 139 "ADDBIKEROAD" 140 "ADDLORRYTRAILER_EXCEPT" 141 "ADDLORRYSEMI_EXCEPT" 142 "Reserved142" 143 "Reserved143" 144 "Reserved144" 145 "Reserved145" 146 "Reserved146" 147 "Reserved147" 148 "Reserved148" 149 "Reserved149" 150 "Reserved150" 151 "Reserved151" 152 "Reserved152" 153 "Reserved153" 154 "Reserved154" 155 "Reserved155" 156 "Reserved156" 157 "Reserved157" 158 "Reserved158" 159 "Reserved159" 160 "Reserved160" 161 "Reserved161" 162 "Reserved162" 163 "Reserved163" 164 "Reserved164" 165 "Reserved165" 166 "Reserved166" 167 "Reserved167" 168 "Reserved168" 169 "Reserved169" ;
VAL_ 244 VFC_TS12_SupSign2Type 0 "UNKNOWN" 1 "ADDCAR" 2 "ADDLORRY" 3 "ADDTRAILER" 4 "ADDCARAVAN" 5 "ADDBUS" 6 "ADDTRACTOR" 7 "ADDMCYCLE" 8 "ADDLORRYBUSTRAILER_DEPRECATED" 9 "ADDLORRYBUS_DEPRECATED" 10 "ADDHAZMAT" 11 "ADDTANK" 12 "ADDTRAM" 13 "ADDWET" 14 "ADDFOG" 15 "ADDRAIN" 16 "ADDSNOW" 17 "ADDTIME" 18 "ADDSECTION" 19 "ADDDISTANCE" 20 "ADDWEIGHT" 21 "ADDEXITL" 22 "ADDEXITR" 23 "ADDLANES" 24 "ADDRADAR" 25 "ADDRAPPEL" 26 "ADDPRIOTURN" 27 "ADDLORRY_EXCEPT" 28 "ADDTRACTOR_OVER" 29 "ADDTEXT" 30 "ADDSIGN" 31 "ADDRAINSNOW" 32 "ADDHUMP" 33 "VADDLORRYBUSTRAILER_DEPRECATED" 34 "VADDLORRYBUS_DEPRECATED" 35 "VADDLORRYTRAILER_DEPRECATED" 36 "ADDLORRYTRAILER_DEPRECATED" 37 "ADDCAMPER" 38 "ADDZONE" 39 "ADDCRASHRISK" 40 "ADDACCIDENT" 41 "ADDJAM" 42 "ADDSMOKE" 43 "ADDOILTRAIL" 44 "ADDGRAVEL" 45 "ADDDIRT" 46 "ADDRWORKSEXIT" 47 "ADDROADDAMAGE" 48 "ADDRWORKSENTRY" 49 "ADDLOWTREE" 50 "ADDRWORKSACCESS" 51 "ADDRUTS" 52 "ADDSOFTSHOULDERCAR" 53 "ADDSOFTSHOULDERLORRY" 54 "VADDSIGN" 55 "VADDCAR" 56 "VADDLORRY" 57 "VADDTRAILER" 58 "VADDCARAVAN" 59 "VADDBUS" 60 "VADDWET" 61 "VADDFOG" 62 "VADDRAIN" 63 "VADDSNOW" 64 "VADDRAINSNOW" 65 "VADDTEXT" 66 "VADDSECTION" 67 "VADDDISTANCE" 68 "VADDWEIGHT" 69 "VADDZONE" 70 "VADDCRASHRISK" 71 "VADDACCIDENT" 72 "VADDJAM" 73 "VADDOILTRAIL" 74 "VADDGRAVEL" 75 "VADDDIRT" 76 "VADDROADDAMAGE" 77 "VADDRUTS" 78 "ADDNOSTOPSHOULDER" 79 "ADDTOWING" 80 "ADDSCHOOL" 81 "ADDNIGHT" 82 "ADDEND" 83 "ADDBEGINS" 84 "ADDWITHIN" 85 "ADDDISTANCEBARS" 86 "ADDMINIMUM" 87 "ADDADVICE" 88 "ADDACCESS" 89 "ADDALLWAY" 90 "ADDBUS_EXCEPT" 91 "ADDEXCEPTDELIVERY" 92 "ADDEXCEPTLOCAL" 93 "ADDFROG" 94 "ADDPRIOTURNL" 95 "ADDPRIOTURNR" 96 "ADDSTART" 97 "ADDSTOPIN" 98 "ADDEXIT" 99 "ADDHAZWATER" 100 "ADDDAY" 101 "ADDSL" 102 "ADDLORRYTRAILER" 103 "ADDLORRYSEMI" 104 "VADDLORRYTRAILER" 105 "VADDLORRYSEMI" 106 "ADDSLOW" 107 "ADDSL5" 108 "ADDSL10" 109 "ADDSL15" 110 "ADDSL20" 111 "ADDSL25" 112 "ADDSL30" 113 "ADDSL35" 114 "ADDSL40" 115 "ADDSL45" 116 "ADDSL50" 117 "ADDSL55" 118 "ADDSL60" 119 "ADDSL65" 120 "ADDSL70" 121 "ADDSL75" 122 "ADDSL80" 123 "ADDSL85" 124 "ADDSL90" 125 "ADDSL95" 126 "ADDSL100" 127 "ADDSL105" 128 "ADDSL110" 129 "ADDSL115" 130 "ADDSL120" 131 "ADDSL125" 132 "ADDSL130" 133 "ADDSL135" 134 "ADDSL140" 135 "ADDSL145" 136 "ADDSL150" 137 "ADDSL155" 138 "ADDSL160" 139 "ADDBIKEROAD" 140 "ADDLORRYTRAILER_EXCEPT" 141 "ADDLORRYSEMI_EXCEPT" 142 "Reserved142" 143 "Reserved143" 144 "Reserved144" 145 "Reserved145" 146 "Reserved146" 147 "Reserved147" 148 "Reserved148" 149 "Reserved149" 150 "Reserved150" 151 "Reserved151" 152 "Reserved152" 153 "Reserved153" 154 "Reserved154" 155 "Reserved155" 156 "Reserved156" 157 "Reserved157" 158 "Reserved158" 159 "Reserved159" 160 "Reserved160" 161 "Reserved161" 162 "Reserved162" 163 "Reserved163" 164 "Reserved164" 165 "Reserved165" 166 "Reserved166" 167 "Reserved167" 168 "Reserved168" 169 "Reserved169" ;
VAL_ 244 VFC_TS12_SupSign3Type 0 "UNKNOWN" 1 "ADDCAR" 2 "ADDLORRY" 3 "ADDTRAILER" 4 "ADDCARAVAN" 5 "ADDBUS" 6 "ADDTRACTOR" 7 "ADDMCYCLE" 8 "ADDLORRYBUSTRAILER_DEPRECATED" 9 "ADDLORRYBUS_DEPRECATED" 10 "ADDHAZMAT" 11 "ADDTANK" 12 "ADDTRAM" 13 "ADDWET" 14 "ADDFOG" 15 "ADDRAIN" 16 "ADDSNOW" 17 "ADDTIME" 18 "ADDSECTION" 19 "ADDDISTANCE" 20 "ADDWEIGHT" 21 "ADDEXITL" 22 "ADDEXITR" 23 "ADDLANES" 24 "ADDRADAR" 25 "ADDRAPPEL" 26 "ADDPRIOTURN" 27 "ADDLORRY_EXCEPT" 28 "ADDTRACTOR_OVER" 29 "ADDTEXT" 30 "ADDSIGN" 31 "ADDRAINSNOW" 32 "ADDHUMP" 33 "VADDLORRYBUSTRAILER_DEPRECATED" 34 "VADDLORRYBUS_DEPRECATED" 35 "VADDLORRYTRAILER_DEPRECATED" 36 "ADDLORRYTRAILER_DEPRECATED" 37 "ADDCAMPER" 38 "ADDZONE" 39 "ADDCRASHRISK" 40 "ADDACCIDENT" 41 "ADDJAM" 42 "ADDSMOKE" 43 "ADDOILTRAIL" 44 "ADDGRAVEL" 45 "ADDDIRT" 46 "ADDRWORKSEXIT" 47 "ADDROADDAMAGE" 48 "ADDRWORKSENTRY" 49 "ADDLOWTREE" 50 "ADDRWORKSACCESS" 51 "ADDRUTS" 52 "ADDSOFTSHOULDERCAR" 53 "ADDSOFTSHOULDERLORRY" 54 "VADDSIGN" 55 "VADDCAR" 56 "VADDLORRY" 57 "VADDTRAILER" 58 "VADDCARAVAN" 59 "VADDBUS" 60 "VADDWET" 61 "VADDFOG" 62 "VADDRAIN" 63 "VADDSNOW" 64 "VADDRAINSNOW" 65 "VADDTEXT" 66 "VADDSECTION" 67 "VADDDISTANCE" 68 "VADDWEIGHT" 69 "VADDZONE" 70 "VADDCRASHRISK" 71 "VADDACCIDENT" 72 "VADDJAM" 73 "VADDOILTRAIL" 74 "VADDGRAVEL" 75 "VADDDIRT" 76 "VADDROADDAMAGE" 77 "VADDRUTS" 78 "ADDNOSTOPSHOULDER" 79 "ADDTOWING" 80 "ADDSCHOOL" 81 "ADDNIGHT" 82 "ADDEND" 83 "ADDBEGINS" 84 "ADDWITHIN" 85 "ADDDISTANCEBARS" 86 "ADDMINIMUM" 87 "ADDADVICE" 88 "ADDACCESS" 89 "ADDALLWAY" 90 "ADDBUS_EXCEPT" 91 "ADDEXCEPTDELIVERY" 92 "ADDEXCEPTLOCAL" 93 "ADDFROG" 94 "ADDPRIOTURNL" 95 "ADDPRIOTURNR" 96 "ADDSTART" 97 "ADDSTOPIN" 98 "ADDEXIT" 99 "ADDHAZWATER" 100 "ADDDAY" 101 "ADDSL" 102 "ADDLORRYTRAILER" 103 "ADDLORRYSEMI" 104 "VADDLORRYTRAILER" 105 "VADDLORRYSEMI" 106 "ADDSLOW" 107 "ADDSL5" 108 "ADDSL10" 109 "ADDSL15" 110 "ADDSL20" 111 "ADDSL25" 112 "ADDSL30" 113 "ADDSL35" 114 "ADDSL40" 115 "ADDSL45" 116 "ADDSL50" 117 "ADDSL55" 118 "ADDSL60" 119 "ADDSL65" 120 "ADDSL70" 121 "ADDSL75" 122 "ADDSL80" 123 "ADDSL85" 124 "ADDSL90" 125 "ADDSL95" 126 "ADDSL100" 127 "ADDSL105" 128 "ADDSL110" 129 "ADDSL115" 130 "ADDSL120" 131 "ADDSL125" 132 "ADDSL130" 133 "ADDSL135" 134 "ADDSL140" 135 "ADDSL145" 136 "ADDSL150" 137 "ADDSL155" 138 "ADDSL160" 139 "ADDBIKEROAD" 140 "ADDLORRYTRAILER_EXCEPT" 141 "ADDLORRYSEMI_EXCEPT" 142 "Reserved142" 143 "Reserved143" 144 "Reserved144" 145 "Reserved145" 146 "Reserved146" 147 "Reserved147" 148 "Reserved148" 149 "Reserved149" 150 "Reserved150" 151 "Reserved151" 152 "Reserved152" 153 "Reserved153" 154 "Reserved154" 155 "Reserved155" 156 "Reserved156" 157 "Reserved157" 158 "Reserved158" 159 "Reserved159" 160 "Reserved160" 161 "Reserved161" 162 "Reserved162" 163 "Reserved163" 164 "Reserved164" 165 "Reserved165" 166 "Reserved166" 167 "Reserved167" 168 "Reserved168" 169 "Reserved169" ;
VAL_ 244 VFC_TS12_SupSign4Type 0 "UNKNOWN" 1 "ADDCAR" 2 "ADDLORRY" 3 "ADDTRAILER" 4 "ADDCARAVAN" 5 "ADDBUS" 6 "ADDTRACTOR" 7 "ADDMCYCLE" 8 "ADDLORRYBUSTRAILER_DEPRECATED" 9 "ADDLORRYBUS_DEPRECATED" 10 "ADDHAZMAT" 11 "ADDTANK" 12 "ADDTRAM" 13 "ADDWET" 14 "ADDFOG" 15 "ADDRAIN" 16 "ADDSNOW" 17 "ADDTIME" 18 "ADDSECTION" 19 "ADDDISTANCE" 20 "ADDWEIGHT" 21 "ADDEXITL" 22 "ADDEXITR" 23 "ADDLANES" 24 "ADDRADAR" 25 "ADDRAPPEL" 26 "ADDPRIOTURN" 27 "ADDLORRY_EXCEPT" 28 "ADDTRACTOR_OVER" 29 "ADDTEXT" 30 "ADDSIGN" 31 "ADDRAINSNOW" 32 "ADDHUMP" 33 "VADDLORRYBUSTRAILER_DEPRECATED" 34 "VADDLORRYBUS_DEPRECATED" 35 "VADDLORRYTRAILER_DEPRECATED" 36 "ADDLORRYTRAILER_DEPRECATED" 37 "ADDCAMPER" 38 "ADDZONE" 39 "ADDCRASHRISK" 40 "ADDACCIDENT" 41 "ADDJAM" 42 "ADDSMOKE" 43 "ADDOILTRAIL" 44 "ADDGRAVEL" 45 "ADDDIRT" 46 "ADDRWORKSEXIT" 47 "ADDROADDAMAGE" 48 "ADDRWORKSENTRY" 49 "ADDLOWTREE" 50 "ADDRWORKSACCESS" 51 "ADDRUTS" 52 "ADDSOFTSHOULDERCAR" 53 "ADDSOFTSHOULDERLORRY" 54 "VADDSIGN" 55 "VADDCAR" 56 "VADDLORRY" 57 "VADDTRAILER" 58 "VADDCARAVAN" 59 "VADDBUS" 60 "VADDWET" 61 "VADDFOG" 62 "VADDRAIN" 63 "VADDSNOW" 64 "VADDRAINSNOW" 65 "VADDTEXT" 66 "VADDSECTION" 67 "VADDDISTANCE" 68 "VADDWEIGHT" 69 "VADDZONE" 70 "VADDCRASHRISK" 71 "VADDACCIDENT" 72 "VADDJAM" 73 "VADDOILTRAIL" 74 "VADDGRAVEL" 75 "VADDDIRT" 76 "VADDROADDAMAGE" 77 "VADDRUTS" 78 "ADDNOSTOPSHOULDER" 79 "ADDTOWING" 80 "ADDSCHOOL" 81 "ADDNIGHT" 82 "ADDEND" 83 "ADDBEGINS" 84 "ADDWITHIN" 85 "ADDDISTANCEBARS" 86 "ADDMINIMUM" 87 "ADDADVICE" 88 "ADDACCESS" 89 "ADDALLWAY" 90 "ADDBUS_EXCEPT" 91 "ADDEXCEPTDELIVERY" 92 "ADDEXCEPTLOCAL" 93 "ADDFROG" 94 "ADDPRIOTURNL" 95 "ADDPRIOTURNR" 96 "ADDSTART" 97 "ADDSTOPIN" 98 "ADDEXIT" 99 "ADDHAZWATER" 100 "ADDDAY" 101 "ADDSL" 102 "ADDLORRYTRAILER" 103 "ADDLORRYSEMI" 104 "VADDLORRYTRAILER" 105 "VADDLORRYSEMI" 106 "ADDSLOW" 107 "ADDSL5" 108 "ADDSL10" 109 "ADDSL15" 110 "ADDSL20" 111 "ADDSL25" 112 "ADDSL30" 113 "ADDSL35" 114 "ADDSL40" 115 "ADDSL45" 116 "ADDSL50" 117 "ADDSL55" 118 "ADDSL60" 119 "ADDSL65" 120 "ADDSL70" 121 "ADDSL75" 122 "ADDSL80" 123 "ADDSL85" 124 "ADDSL90" 125 "ADDSL95" 126 "ADDSL100" 127 "ADDSL105" 128 "ADDSL110" 129 "ADDSL115" 130 "ADDSL120" 131 "ADDSL125" 132 "ADDSL130" 133 "ADDSL135" 134 "ADDSL140" 135 "ADDSL145" 136 "ADDSL150" 137 "ADDSL155" 138 "ADDSL160" 139 "ADDBIKEROAD" 140 "ADDLORRYTRAILER_EXCEPT" 141 "ADDLORRYSEMI_EXCEPT" 142 "Reserved142" 143 "Reserved143" 144 "Reserved144" 145 "Reserved145" 146 "Reserved146" 147 "Reserved147" 148 "Reserved148" 149 "Reserved149" 150 "Reserved150" 151 "Reserved151" 152 "Reserved152" 153 "Reserved153" 154 "Reserved154" 155 "Reserved155" 156 "Reserved156" 157 "Reserved157" 158 "Reserved158" 159 "Reserved159" 160 "Reserved160" 161 "Reserved161" 162 "Reserved162" 163 "Reserved163" 164 "Reserved164" 165 "Reserved165" 166 "Reserved166" 167 "Reserved167" 168 "Reserved168" 169 "Reserved169" ;
VAL_ 244 VFC_TS12_SupSign5Type 0 "UNKNOWN" 1 "ADDCAR" 2 "ADDLORRY" 3 "ADDTRAILER" 4 "ADDCARAVAN" 5 "ADDBUS" 6 "ADDTRACTOR" 7 "ADDMCYCLE" 8 "ADDLORRYBUSTRAILER_DEPRECATED" 9 "ADDLORRYBUS_DEPRECATED" 10 "ADDHAZMAT" 11 "ADDTANK" 12 "ADDTRAM" 13 "ADDWET" 14 "ADDFOG" 15 "ADDRAIN" 16 "ADDSNOW" 17 "ADDTIME" 18 "ADDSECTION" 19 "ADDDISTANCE" 20 "ADDWEIGHT" 21 "ADDEXITL" 22 "ADDEXITR" 23 "ADDLANES" 24 "ADDRADAR" 25 "ADDRAPPEL" 26 "ADDPRIOTURN" 27 "ADDLORRY_EXCEPT" 28 "ADDTRACTOR_OVER" 29 "ADDTEXT" 30 "ADDSIGN" 31 "ADDRAINSNOW" 32 "ADDHUMP" 33 "VADDLORRYBUSTRAILER_DEPRECATED" 34 "VADDLORRYBUS_DEPRECATED" 35 "VADDLORRYTRAILER_DEPRECATED" 36 "ADDLORRYTRAILER_DEPRECATED" 37 "ADDCAMPER" 38 "ADDZONE" 39 "ADDCRASHRISK" 40 "ADDACCIDENT" 41 "ADDJAM" 42 "ADDSMOKE" 43 "ADDOILTRAIL" 44 "ADDGRAVEL" 45 "ADDDIRT" 46 "ADDRWORKSEXIT" 47 "ADDROADDAMAGE" 48 "ADDRWORKSENTRY" 49 "ADDLOWTREE" 50 "ADDRWORKSACCESS" 51 "ADDRUTS" 52 "ADDSOFTSHOULDERCAR" 53 "ADDSOFTSHOULDERLORRY" 54 "VADDSIGN" 55 "VADDCAR" 56 "VADDLORRY" 57 "VADDTRAILER" 58 "VADDCARAVAN" 59 "VADDBUS" 60 "VADDWET" 61 "VADDFOG" 62 "VADDRAIN" 63 "VADDSNOW" 64 "VADDRAINSNOW" 65 "VADDTEXT" 66 "VADDSECTION" 67 "VADDDISTANCE" 68 "VADDWEIGHT" 69 "VADDZONE" 70 "VADDCRASHRISK" 71 "VADDACCIDENT" 72 "VADDJAM" 73 "VADDOILTRAIL" 74 "VADDGRAVEL" 75 "VADDDIRT" 76 "VADDROADDAMAGE" 77 "VADDRUTS" 78 "ADDNOSTOPSHOULDER" 79 "ADDTOWING" 80 "ADDSCHOOL" 81 "ADDNIGHT" 82 "ADDEND" 83 "ADDBEGINS" 84 "ADDWITHIN" 85 "ADDDISTANCEBARS" 86 "ADDMINIMUM" 87 "ADDADVICE" 88 "ADDACCESS" 89 "ADDALLWAY" 90 "ADDBUS_EXCEPT" 91 "ADDEXCEPTDELIVERY" 92 "ADDEXCEPTLOCAL" 93 "ADDFROG" 94 "ADDPRIOTURNL" 95 "ADDPRIOTURNR" 96 "ADDSTART" 97 "ADDSTOPIN" 98 "ADDEXIT" 99 "ADDHAZWATER" 100 "ADDDAY" 101 "ADDSL" 102 "ADDLORRYTRAILER" 103 "ADDLORRYSEMI" 104 "VADDLORRYTRAILER" 105 "VADDLORRYSEMI" 106 "ADDSLOW" 107 "ADDSL5" 108 "ADDSL10" 109 "ADDSL15" 110 "ADDSL20" 111 "ADDSL25" 112 "ADDSL30" 113 "ADDSL35" 114 "ADDSL40" 115 "ADDSL45" 116 "ADDSL50" 117 "ADDSL55" 118 "ADDSL60" 119 "ADDSL65" 120 "ADDSL70" 121 "ADDSL75" 122 "ADDSL80" 123 "ADDSL85" 124 "ADDSL90" 125 "ADDSL95" 126 "ADDSL100" 127 "ADDSL105" 128 "ADDSL110" 129 "ADDSL115" 130 "ADDSL120" 131 "ADDSL125" 132 "ADDSL130" 133 "ADDSL135" 134 "ADDSL140" 135 "ADDSL145" 136 "ADDSL150" 137 "ADDSL155" 138 "ADDSL160" 139 "ADDBIKEROAD" 140 "ADDLORRYTRAILER_EXCEPT" 141 "ADDLORRYSEMI_EXCEPT" 142 "Reserved142" 143 "Reserved143" 144 "Reserved144" 145 "Reserved145" 146 "Reserved146" 147 "Reserved147" 148 "Reserved148" 149 "Reserved149" 150 "Reserved150" 151 "Reserved151" 152 "Reserved152" 153 "Reserved153" 154 "Reserved154" 155 "Reserved155" 156 "Reserved156" 157 "Reserved157" 158 "Reserved158" 159 "Reserved159" 160 "Reserved160" 161 "Reserved161" 162 "Reserved162" 163 "Reserved163" 164 "Reserved164" 165 "Reserved165" 166 "Reserved166" 167 "Reserved167" 168 "Reserved168" 169 "Reserved169" ;
VAL_ 244 VFC_TS13_Type 0 "UNKNOWN" 1 "SL5" 2 "SL10" 3 "SL15" 4 "SL20" 5 "SL25" 6 "SL30" 7 "SL35" 8 "SL40" 9 "SL45" 10 "SL50" 11 "SL55" 12 "SL60" 13 "SL65" 14 "SL70" 15 "SL75" 16 "SL80" 17 "SL85" 18 "SL90" 19 "SL95" 20 "SL100" 21 "SL105" 22 "SL110" 23 "SL115" 24 "SL120" 25 "SL125" 26 "SL130" 27 "SL135" 28 "SL140" 29 "SL145" 30 "SL150" 31 "SL155" 32 "SL160" 33 "OP" 34 "OL" 35 "ESL" 36 "EOP" 37 "EOL" 38 "EA" 39 "VSL5" 40 "VSL10" 41 "VSL15" 42 "VSL20" 43 "VSL25" 44 "VSL30" 45 "VSL35" 46 "VSL40" 47 "VSL45" 48 "VSL50" 49 "VSL55" 50 "VSL60" 51 "VSL65" 52 "VSL70" 53 "VSL75" 54 "VSL80" 55 "VSL85" 56 "VSL90" 57 "VSL95" 58 "VSL100" 59 "VSL105" 60 "VSL110" 61 "VSL115" 62 "VSL120" 63 "VSL125" 64 "VSL130" 65 "VSL135" 66 "VSL140" 67 "VSL145" 68 "VSL150" 69 "VSL155" 70 "VSL160" 71 "VOP" 72 "VOL" 73 "VESL" 74 "VEOP" 75 "VEOL" 76 "VEA" 77 "NOENTRY" 78 "NOALL" 79 "NOCAR" 80 "NOLORRY" 81 "NOHAZMAT" 82 "NOBIKE" 83 "NOPED" 84 "NOCARBIKE" 85 "NOTWOWAY" 86 "WEIGHT" 87 "HEIGHT" 88 "WIDTH" 89 "LENGTH" 90 "PRIOCROSS" 91 "GIVEWAY" 92 "PRIOCROSSYIELDTORIGHT" 93 "WARNDANGER" 94 "WARNCURVEL" 95 "WARNCURVER" 96 "WARNDCURVEL" 97 "WARNDCURVER" 98 "WARNTRAIN" 99 "WARNJAM" 100 "WARNANIMAL_DEPRECATED" 101 "WARNRWORKS" 102 "WARNSLOPED" 103 "WARNSLOPEU" 104 "PRIOSTREET" 105 "EPRIOSTREET" 106 "STOP" 107 "ASL" 108 "EASL" 109 "MSL" 110 "EMSL" 111 "MLC" 112 "WBDIAGL" 113 "WBDIAGR" 114 "WBROUND" 115 "NOLTURN" 116 "NORTURN" 117 "NOUTURN" 118 "NOPARK" 119 "NOSTOP" 120 "SMOG" 121 "UMWELT" 122 "EUMWELT" 123 "DOUANE" 124 "FWAY" 125 "EFWAY" 126 "HWAY" 127 "EHWAY" 128 "NORIDER" 129 "WARNCONST" 130 "WARNCONSTL" 131 "WARNCONSTR" 132 "WARNPED" 133 "WARNKIDS" 134 "WARNBIKE" 135 "WARNSKID" 136 "ZEBRA" 137 "ONEWAYS" 138 "ONEWAYU" 139 "SLOWDOWN" 140 "NOCARRIAGE" 141 "NOLORRYTRAILER" 142 "NOBUS" 143 "NOTRACTOR" 144 "LORRYDIST" 145 "CARDIST" 146 "WARNROUND" 147 "WARNWILDANIMAL" 148 "WARNCATTLE" 149 "WARNFROG" 150 "WARNBUS" 151 "WARNWIND" 152 "WARNSNOW" 153 "WARNPCROSS" 154 "WARNHUMP" 155 "WARNROCK" 156 "WARNLOWTREE" 157 "WARNGRAVEL" 158 "WARNTWOWAY" 159 "WARNLIGHTS" 160 "WARNPLANE" 161 "VNOENTRY" 162 "VNOALL" 163 "VNOCAR" 164 "VNOLORRY" 165 "VNOCARBIKE" 166 "VWEIGHT" 167 "VHEIGHT" 168 "VWIDTH" 169 "VLENGTH" 170 "VWARNDANGER" 171 "VWARNJAM" 172 "VWARNRWORKS" 173 "VWARNSKID" 174 "VASL" 175 "VEASL" 176 "VNOLORRYTRAILER" 177 "VNOBUS" 178 "VLORRYDIST" 179 "VCARDIST" 180 "VWARNSNOW" 181 "VWARNHUMP" 182 "VWARNGRAVEL" 183 "CALM" 184 "ECALM" 185 "TWN" 186 "ETWN" 187 "DEADEND" 188 "AXLEWEIGHT" 189 "WARNRIDER" 190 "WARNDRAWBRIDGE" 191 "WARNPIER" 192 "TRINATURE" 193 "VWARNCONST" 194 "VWARNCONSTL" 195 "VWARNCONSTR" 196 "VWARNCURVEL" 197 "VWARNCURVER" 198 "VWARNDCURVEL" 199 "VWARNDCURVER" 200 "VWARNLIGHTS" 201 "WBBENTLEFT" 202 "WBBENTLEFTRIGHT" 203 "WBBENTRIGHT" 204 "WBDIAGLR" 205 "WBLEFT" 206 "WBRIGHT" 207 "WBUP" 208 "WBUPLEFT" 209 "WBUPRIGHT" 210 "WBHAZWATER" 211 "NOHAZWATER" 212 "SCHOOL" 213 "ESCHOOL" 214 "HAZMAT" 215 "EMERGENCYBAY" 216 "ENDOFLANEL" 217 "ENDOFLANER" 218 "ENOPARK" 219 "EONEWAY" 220 "EPARK" 221 "ETOLL" 222 "NOPARKL" 223 "NOPARKLR" 224 "NOPARKR" 225 "NOSTOPL" 226 "NOSTOPLR" 227 "NOSTOPR" 228 "NOTURNONRED" 229 "ONEWAYL" 230 "ONEWAYR" 231 "PARK" 232 "PRIOCROSSL" 233 "PRIOCROSSR" 234 "TOLL" 235 "TUNNEL" 236 "TWOWAY" 237 "WARNCROSS" 238 "WARNCROSSL" 239 "WARNCROSSLR" 240 "WARNCROSSR" 241 "WARNCROSSRL" 242 "WARNCROSST" 243 "WARNGIVEWAYAHEAD" 244 "WARNSLAHEAD" 245 "WARNSTOPAHEAD" 246 "WBBUS" 247 "WRONGWAY" 248 "HAZWATER" 249 "GIVEWAYROUND" 250 "WARNWINDINGL" 251 "WARNWINDINGR" 252 "WARNHAIRPINL" 253 "WARNHAIRPINR" 254 "WARNPEDBIKE" 255 "WARNCROSSY" 256 "WARNBRANCHL" 257 "WARNBRANCHR" 258 "WARNAXLEWEIGHT" 259 "WARNWEIGHT" 260 "WARNHEIGHT" 261 "WARNLENGTH" 262 "WARNWIDTH" 263 "WARNBLACKSPOT" 264 "WARNMERGEL" 265 "WARNMERGER" 266 "WARNTUNNEL" 267 "WARNTRACTOR" 268 "WARNRWORKSVEHICLE" 269 "WARNNARROWBRIDGE" 270 "WARNFLAGGER" 271 "LANES" 272 "LANESHIFTL" 273 "LANESHIFTR" 274 "NEWLANEL" 275 "NEWLANER" 276 "RIGHTTURNONRED" 277 "BORDERLIMIT" 278 "EMBEDDEDRAIN" 279 "VWARNWEIGHT" 280 "VWARNHEIGHT" 281 "VWARNLENGTH" 282 "VWARNWIDTH" 283 "VENDOFLANEL" 284 "VENDOFLANER" 285 "VLANES" 286 "VLANESHIFTL" 287 "VLANESHIFTR" 288 "VNEWLANEL" 289 "VNEWLANER" 290 "NOUP" 291 "VOFF" 292 "ASL5" 293 "ASL10" 294 "ASL15" 295 "ASL20" 296 "ASL25" 297 "ASL30" 298 "ASL35" 299 "ASL40" 300 "ASL45" 301 "ASL50" 302 "ASL55" 303 "ASL60" 304 "ASL65" 305 "ASL70" 306 "ASL75" 307 "ASL80" 308 "ASL85" 309 "ASL90" 310 "ASL95" 311 "ASL100" 312 "ASL105" 313 "ASL110" 314 "ASL115" 315 "ASL120" 316 "ASL125" 317 "ASL130" 318 "ASL135" 319 "ASL140" 320 "ASL145" 321 "ASL150" 322 "ASL155" 323 "ASL160" 324 "VASL5" 325 "VASL10" 326 "VASL15" 327 "VASL20" 328 "VASL25" 329 "VASL30" 330 "VASL35" 331 "VASL40" 332 "VASL45" 333 "VASL50" 334 "VASL55" 335 "VASL60" 336 "VASL65" 337 "VASL70" 338 "VASL75" 339 "VASL80" 340 "VASL85" 341 "VASL90" 342 "VASL95" 343 "VASL100" 344 "VASL105" 345 "VASL110" 346 "VASL115" 347 "VASL120" 348 "VASL125" 349 "VASL130" 350 "VASL135" 351 "VASL140" 352 "VASL145" 353 "VASL150" 354 "VASL155" 355 "VASL160" 356 "WARNTRAINGATED" 357 "KEEPRIGHTCAR" 358 "ASLCURVE5" 359 "ASLCURVE10" 360 "ASLCURVE15" 361 "ASLCURVE20" 362 "ASLCURVE25" 363 "ASLCURVE30" 364 "ASLCURVE35" 365 "ASLCURVE40" 366 "ASLCURVE45" 367 "ASLCURVE50" 368 "ASLCURVE55" 369 "ASLCURVE60" 370 "ASLCURVE65" 371 "ASLCURVE70" 372 "ASLCURVE75" 373 "ASLCURVE80" 374 "ASLCURVE85" 375 "ASLCURVE90" 376 "ASLCURVE95" 377 "ASLCURVE100" 378 "ASLCURVE105" 379 "ASLCURVE110" 380 "ASLCURVE115" 381 "ASLCURVE120" 382 "ASLCURVE125" 383 "ASLCURVE130" 384 "ASLCURVE135" 385 "ASLCURVE140" 386 "ASLCURVE145" 387 "ASLCURVE150" 388 "ASLCURVE155" 389 "ASLCURVE160" 390 "KIDS" 391 "EKIDS" 392 "BIKEROAD" 393 "EBIKEROAD" 394 "PEDSTREET" 395 "EPEDSTREET" 396 "PEDBIKESTREET" 397 "EPEDBIKESTREET" 398 "EWARNKIDS" 399 "CALM20" 400 "CALM30" 401 "ECALM20" 402 "ECALM30" 403 "FWAYGREEN" 404 "TWN40" 405 "TWN50" 406 "TWN60" 407 "TWN70" 408 "ETWN40" 409 "ETWN50" 410 "ETWN60" 411 "ETWN70" 412 "WBBIKE" 413 "EWBBIKE" 414 "WBPED" 415 "EWBPED" 416 "WBPEDBIKESEP" 417 "EWBPEDBIKESEP" 418 "WBPEDBIKESHARED" 419 "EWBPEDBIKESHARED" 420 "EFWAYGREEN" 421 "Reserved0421" 422 "Reserved0422" 423 "Reserved0423" 424 "Reserved0424" 425 "Reserved0425" 426 "Reserved0426" 427 "Reserved0427" 428 "Reserved0428" 429 "Reserved0429" 430 "Reserved0430" 431 "Reserved0431" 432 "Reserved0432" 433 "Reserved0433" 434 "Reserved0434" 435 "Reserved0435" 436 "Reserved0436" 437 "Reserved0437" 438 "Reserved0438" 439 "Reserved0439" 440 "Reserved0440" 441 "Reserved0441" 442 "Reserved0442" 443 "Reserved0443" 444 "Reserved0444" 445 "Reserved0445" 446 "Reserved0446" 447 "Reserved0447" 448 "Reserved0448" 449 "Reserved0449" ;
VAL_ 244 VFC_TS13_EmbeddedInfo 0 "Unknown" 1 "Not Embedded" 2 "Border Limit" 3 "Multi Lane" 4 "Rain" 5 "Vehicle Type" 6 "Plate" 7 "Error Value" 8 "Vehicle Sticker" 9 "Reserved09" 10 "Reserved10" 11 "Reserved11" 12 "Reserved12" 13 "Reserved13" 14 "Reserved14" 15 "Reserved15" ;
VAL_ 244 VFC_TS13_ValidTimeRange1Start 127 "Unknown" ;
VAL_ 244 VFC_TS13_ValidTimeRange1End 127 "Unknown" ;
VAL_ 244 VFC_TS13_ValidTimeRange2Start 127 "Unknown" ;
VAL_ 244 VFC_TS13_ValidTimeRange2End 127 "Unknown" ;
VAL_ 244 VFC_TS13_ValidInDistUnit 0 "Unknown" ;
VAL_ 244 VFC_TS13_ValidSectionUnit 0 "Unknown" 1 "Meter" 2 "Kilometer" 3 "Foot" 4 "Yard" 5 "Mile" 6 "Reserved6" 7 "Reserved7" ;
VAL_ 244 VFC_TS13_SupSign0Type 0 "UNKNOWN" 1 "ADDCAR" 2 "ADDLORRY" 3 "ADDTRAILER" 4 "ADDCARAVAN" 5 "ADDBUS" 6 "ADDTRACTOR" 7 "ADDMCYCLE" 8 "ADDLORRYBUSTRAILER_DEPRECATED" 9 "ADDLORRYBUS_DEPRECATED" 10 "ADDHAZMAT" 11 "ADDTANK" 12 "ADDTRAM" 13 "ADDWET" 14 "ADDFOG" 15 "ADDRAIN" 16 "ADDSNOW" 17 "ADDTIME" 18 "ADDSECTION" 19 "ADDDISTANCE" 20 "ADDWEIGHT" 21 "ADDEXITL" 22 "ADDEXITR" 23 "ADDLANES" 24 "ADDRADAR" 25 "ADDRAPPEL" 26 "ADDPRIOTURN" 27 "ADDLORRY_EXCEPT" 28 "ADDTRACTOR_OVER" 29 "ADDTEXT" 30 "ADDSIGN" 31 "ADDRAINSNOW" 32 "ADDHUMP" 33 "VADDLORRYBUSTRAILER_DEPRECATED" 34 "VADDLORRYBUS_DEPRECATED" 35 "VADDLORRYTRAILER_DEPRECATED" 36 "ADDLORRYTRAILER_DEPRECATED" 37 "ADDCAMPER" 38 "ADDZONE" 39 "ADDCRASHRISK" 40 "ADDACCIDENT" 41 "ADDJAM" 42 "ADDSMOKE" 43 "ADDOILTRAIL" 44 "ADDGRAVEL" 45 "ADDDIRT" 46 "ADDRWORKSEXIT" 47 "ADDROADDAMAGE" 48 "ADDRWORKSENTRY" 49 "ADDLOWTREE" 50 "ADDRWORKSACCESS" 51 "ADDRUTS" 52 "ADDSOFTSHOULDERCAR" 53 "ADDSOFTSHOULDERLORRY" 54 "VADDSIGN" 55 "VADDCAR" 56 "VADDLORRY" 57 "VADDTRAILER" 58 "VADDCARAVAN" 59 "VADDBUS" 60 "VADDWET" 61 "VADDFOG" 62 "VADDRAIN" 63 "VADDSNOW" 64 "VADDRAINSNOW" 65 "VADDTEXT" 66 "VADDSECTION" 67 "VADDDISTANCE" 68 "VADDWEIGHT" 69 "VADDZONE" 70 "VADDCRASHRISK" 71 "VADDACCIDENT" 72 "VADDJAM" 73 "VADDOILTRAIL" 74 "VADDGRAVEL" 75 "VADDDIRT" 76 "VADDROADDAMAGE" 77 "VADDRUTS" 78 "ADDNOSTOPSHOULDER" 79 "ADDTOWING" 80 "ADDSCHOOL" 81 "ADDNIGHT" 82 "ADDEND" 83 "ADDBEGINS" 84 "ADDWITHIN" 85 "ADDDISTANCEBARS" 86 "ADDMINIMUM" 87 "ADDADVICE" 88 "ADDACCESS" 89 "ADDALLWAY" 90 "ADDBUS_EXCEPT" 91 "ADDEXCEPTDELIVERY" 92 "ADDEXCEPTLOCAL" 93 "ADDFROG" 94 "ADDPRIOTURNL" 95 "ADDPRIOTURNR" 96 "ADDSTART" 97 "ADDSTOPIN" 98 "ADDEXIT" 99 "ADDHAZWATER" 100 "ADDDAY" 101 "ADDSL" 102 "ADDLORRYTRAILER" 103 "ADDLORRYSEMI" 104 "VADDLORRYTRAILER" 105 "VADDLORRYSEMI" 106 "ADDSLOW" 107 "ADDSL5" 108 "ADDSL10" 109 "ADDSL15" 110 "ADDSL20" 111 "ADDSL25" 112 "ADDSL30" 113 "ADDSL35" 114 "ADDSL40" 115 "ADDSL45" 116 "ADDSL50" 117 "ADDSL55" 118 "ADDSL60" 119 "ADDSL65" 120 "ADDSL70" 121 "ADDSL75" 122 "ADDSL80" 123 "ADDSL85" 124 "ADDSL90" 125 "ADDSL95" 126 "ADDSL100" 127 "ADDSL105" 128 "ADDSL110" 129 "ADDSL115" 130 "ADDSL120" 131 "ADDSL125" 132 "ADDSL130" 133 "ADDSL135" 134 "ADDSL140" 135 "ADDSL145" 136 "ADDSL150" 137 "ADDSL155" 138 "ADDSL160" 139 "ADDBIKEROAD" 140 "ADDLORRYTRAILER_EXCEPT" 141 "ADDLORRYSEMI_EXCEPT" 142 "Reserved142" 143 "Reserved143" 144 "Reserved144" 145 "Reserved145" 146 "Reserved146" 147 "Reserved147" 148 "Reserved148" 149 "Reserved149" 150 "Reserved150" 151 "Reserved151" 152 "Reserved152" 153 "Reserved153" 154 "Reserved154" 155 "Reserved155" 156 "Reserved156" 157 "Reserved157" 158 "Reserved158" 159 "Reserved159" 160 "Reserved160" 161 "Reserved161" 162 "Reserved162" 163 "Reserved163" 164 "Reserved164" 165 "Reserved165" 166 "Reserved166" 167 "Reserved167" 168 "Reserved168" 169 "Reserved169" ;
VAL_ 244 VFC_TS13_SupSign1Type 0 "UNKNOWN" 1 "ADDCAR" 2 "ADDLORRY" 3 "ADDTRAILER" 4 "ADDCARAVAN" 5 "ADDBUS" 6 "ADDTRACTOR" 7 "ADDMCYCLE" 8 "ADDLORRYBUSTRAILER_DEPRECATED" 9 "ADDLORRYBUS_DEPRECATED" 10 "ADDHAZMAT" 11 "ADDTANK" 12 "ADDTRAM" 13 "ADDWET" 14 "ADDFOG" 15 "ADDRAIN" 16 "ADDSNOW" 17 "ADDTIME" 18 "ADDSECTION" 19 "ADDDISTANCE" 20 "ADDWEIGHT" 21 "ADDEXITL" 22 "ADDEXITR" 23 "ADDLANES" 24 "ADDRADAR" 25 "ADDRAPPEL" 26 "ADDPRIOTURN" 27 "ADDLORRY_EXCEPT" 28 "ADDTRACTOR_OVER" 29 "ADDTEXT" 30 "ADDSIGN" 31 "ADDRAINSNOW" 32 "ADDHUMP" 33 "VADDLORRYBUSTRAILER_DEPRECATED" 34 "VADDLORRYBUS_DEPRECATED" 35 "VADDLORRYTRAILER_DEPRECATED" 36 "ADDLORRYTRAILER_DEPRECATED" 37 "ADDCAMPER" 38 "ADDZONE" 39 "ADDCRASHRISK" 40 "ADDACCIDENT" 41 "ADDJAM" 42 "ADDSMOKE" 43 "ADDOILTRAIL" 44 "ADDGRAVEL" 45 "ADDDIRT" 46 "ADDRWORKSEXIT" 47 "ADDROADDAMAGE" 48 "ADDRWORKSENTRY" 49 "ADDLOWTREE" 50 "ADDRWORKSACCESS" 51 "ADDRUTS" 52 "ADDSOFTSHOULDERCAR" 53 "ADDSOFTSHOULDERLORRY" 54 "VADDSIGN" 55 "VADDCAR" 56 "VADDLORRY" 57 "VADDTRAILER" 58 "VADDCARAVAN" 59 "VADDBUS" 60 "VADDWET" 61 "VADDFOG" 62 "VADDRAIN" 63 "VADDSNOW" 64 "VADDRAINSNOW" 65 "VADDTEXT" 66 "VADDSECTION" 67 "VADDDISTANCE" 68 "VADDWEIGHT" 69 "VADDZONE" 70 "VADDCRASHRISK" 71 "VADDACCIDENT" 72 "VADDJAM" 73 "VADDOILTRAIL" 74 "VADDGRAVEL" 75 "VADDDIRT" 76 "VADDROADDAMAGE" 77 "VADDRUTS" 78 "ADDNOSTOPSHOULDER" 79 "ADDTOWING" 80 "ADDSCHOOL" 81 "ADDNIGHT" 82 "ADDEND" 83 "ADDBEGINS" 84 "ADDWITHIN" 85 "ADDDISTANCEBARS" 86 "ADDMINIMUM" 87 "ADDADVICE" 88 "ADDACCESS" 89 "ADDALLWAY" 90 "ADDBUS_EXCEPT" 91 "ADDEXCEPTDELIVERY" 92 "ADDEXCEPTLOCAL" 93 "ADDFROG" 94 "ADDPRIOTURNL" 95 "ADDPRIOTURNR" 96 "ADDSTART" 97 "ADDSTOPIN" 98 "ADDEXIT" 99 "ADDHAZWATER" 100 "ADDDAY" 101 "ADDSL" 102 "ADDLORRYTRAILER" 103 "ADDLORRYSEMI" 104 "VADDLORRYTRAILER" 105 "VADDLORRYSEMI" 106 "ADDSLOW" 107 "ADDSL5" 108 "ADDSL10" 109 "ADDSL15" 110 "ADDSL20" 111 "ADDSL25" 112 "ADDSL30" 113 "ADDSL35" 114 "ADDSL40" 115 "ADDSL45" 116 "ADDSL50" 117 "ADDSL55" 118 "ADDSL60" 119 "ADDSL65" 120 "ADDSL70" 121 "ADDSL75" 122 "ADDSL80" 123 "ADDSL85" 124 "ADDSL90" 125 "ADDSL95" 126 "ADDSL100" 127 "ADDSL105" 128 "ADDSL110" 129 "ADDSL115" 130 "ADDSL120" 131 "ADDSL125" 132 "ADDSL130" 133 "ADDSL135" 134 "ADDSL140" 135 "ADDSL145" 136 "ADDSL150" 137 "ADDSL155" 138 "ADDSL160" 139 "ADDBIKEROAD" 140 "ADDLORRYTRAILER_EXCEPT" 141 "ADDLORRYSEMI_EXCEPT" 142 "Reserved142" 143 "Reserved143" 144 "Reserved144" 145 "Reserved145" 146 "Reserved146" 147 "Reserved147" 148 "Reserved148" 149 "Reserved149" 150 "Reserved150" 151 "Reserved151" 152 "Reserved152" 153 "Reserved153" 154 "Reserved154" 155 "Reserved155" 156 "Reserved156" 157 "Reserved157" 158 "Reserved158" 159 "Reserved159" 160 "Reserved160" 161 "Reserved161" 162 "Reserved162" 163 "Reserved163" 164 "Reserved164" 165 "Reserved165" 166 "Reserved166" 167 "Reserved167" 168 "Reserved168" 169 "Reserved169" ;
VAL_ 244 VFC_TS13_SupSign2Type 0 "UNKNOWN" 1 "ADDCAR" 2 "ADDLORRY" 3 "ADDTRAILER" 4 "ADDCARAVAN" 5 "ADDBUS" 6 "ADDTRACTOR" 7 "ADDMCYCLE" 8 "ADDLORRYBUSTRAILER_DEPRECATED" 9 "ADDLORRYBUS_DEPRECATED" 10 "ADDHAZMAT" 11 "ADDTANK" 12 "ADDTRAM" 13 "ADDWET" 14 "ADDFOG" 15 "ADDRAIN" 16 "ADDSNOW" 17 "ADDTIME" 18 "ADDSECTION" 19 "ADDDISTANCE" 20 "ADDWEIGHT" 21 "ADDEXITL" 22 "ADDEXITR" 23 "ADDLANES" 24 "ADDRADAR" 25 "ADDRAPPEL" 26 "ADDPRIOTURN" 27 "ADDLORRY_EXCEPT" 28 "ADDTRACTOR_OVER" 29 "ADDTEXT" 30 "ADDSIGN" 31 "ADDRAINSNOW" 32 "ADDHUMP" 33 "VADDLORRYBUSTRAILER_DEPRECATED" 34 "VADDLORRYBUS_DEPRECATED" 35 "VADDLORRYTRAILER_DEPRECATED" 36 "ADDLORRYTRAILER_DEPRECATED" 37 "ADDCAMPER" 38 "ADDZONE" 39 "ADDCRASHRISK" 40 "ADDACCIDENT" 41 "ADDJAM" 42 "ADDSMOKE" 43 "ADDOILTRAIL" 44 "ADDGRAVEL" 45 "ADDDIRT" 46 "ADDRWORKSEXIT" 47 "ADDROADDAMAGE" 48 "ADDRWORKSENTRY" 49 "ADDLOWTREE" 50 "ADDRWORKSACCESS" 51 "ADDRUTS" 52 "ADDSOFTSHOULDERCAR" 53 "ADDSOFTSHOULDERLORRY" 54 "VADDSIGN" 55 "VADDCAR" 56 "VADDLORRY" 57 "VADDTRAILER" 58 "VADDCARAVAN" 59 "VADDBUS" 60 "VADDWET" 61 "VADDFOG" 62 "VADDRAIN" 63 "VADDSNOW" 64 "VADDRAINSNOW" 65 "VADDTEXT" 66 "VADDSECTION" 67 "VADDDISTANCE" 68 "VADDWEIGHT" 69 "VADDZONE" 70 "VADDCRASHRISK" 71 "VADDACCIDENT" 72 "VADDJAM" 73 "VADDOILTRAIL" 74 "VADDGRAVEL" 75 "VADDDIRT" 76 "VADDROADDAMAGE" 77 "VADDRUTS" 78 "ADDNOSTOPSHOULDER" 79 "ADDTOWING" 80 "ADDSCHOOL" 81 "ADDNIGHT" 82 "ADDEND" 83 "ADDBEGINS" 84 "ADDWITHIN" 85 "ADDDISTANCEBARS" 86 "ADDMINIMUM" 87 "ADDADVICE" 88 "ADDACCESS" 89 "ADDALLWAY" 90 "ADDBUS_EXCEPT" 91 "ADDEXCEPTDELIVERY" 92 "ADDEXCEPTLOCAL" 93 "ADDFROG" 94 "ADDPRIOTURNL" 95 "ADDPRIOTURNR" 96 "ADDSTART" 97 "ADDSTOPIN" 98 "ADDEXIT" 99 "ADDHAZWATER" 100 "ADDDAY" 101 "ADDSL" 102 "ADDLORRYTRAILER" 103 "ADDLORRYSEMI" 104 "VADDLORRYTRAILER" 105 "VADDLORRYSEMI" 106 "ADDSLOW" 107 "ADDSL5" 108 "ADDSL10" 109 "ADDSL15" 110 "ADDSL20" 111 "ADDSL25" 112 "ADDSL30" 113 "ADDSL35" 114 "ADDSL40" 115 "ADDSL45" 116 "ADDSL50" 117 "ADDSL55" 118 "ADDSL60" 119 "ADDSL65" 120 "ADDSL70" 121 "ADDSL75" 122 "ADDSL80" 123 "ADDSL85" 124 "ADDSL90" 125 "ADDSL95" 126 "ADDSL100" 127 "ADDSL105" 128 "ADDSL110" 129 "ADDSL115" 130 "ADDSL120" 131 "ADDSL125" 132 "ADDSL130" 133 "ADDSL135" 134 "ADDSL140" 135 "ADDSL145" 136 "ADDSL150" 137 "ADDSL155" 138 "ADDSL160" 139 "ADDBIKEROAD" 140 "ADDLORRYTRAILER_EXCEPT" 141 "ADDLORRYSEMI_EXCEPT" 142 "Reserved142" 143 "Reserved143" 144 "Reserved144" 145 "Reserved145" 146 "Reserved146" 147 "Reserved147" 148 "Reserved148" 149 "Reserved149" 150 "Reserved150" 151 "Reserved151" 152 "Reserved152" 153 "Reserved153" 154 "Reserved154" 155 "Reserved155" 156 "Reserved156" 157 "Reserved157" 158 "Reserved158" 159 "Reserved159" 160 "Reserved160" 161 "Reserved161" 162 "Reserved162" 163 "Reserved163" 164 "Reserved164" 165 "Reserved165" 166 "Reserved166" 167 "Reserved167" 168 "Reserved168" 169 "Reserved169" ;
VAL_ 244 VFC_TS13_SupSign3Type 0 "UNKNOWN" 1 "ADDCAR" 2 "ADDLORRY" 3 "ADDTRAILER" 4 "ADDCARAVAN" 5 "ADDBUS" 6 "ADDTRACTOR" 7 "ADDMCYCLE" 8 "ADDLORRYBUSTRAILER_DEPRECATED" 9 "ADDLORRYBUS_DEPRECATED" 10 "ADDHAZMAT" 11 "ADDTANK" 12 "ADDTRAM" 13 "ADDWET" 14 "ADDFOG" 15 "ADDRAIN" 16 "ADDSNOW" 17 "ADDTIME" 18 "ADDSECTION" 19 "ADDDISTANCE" 20 "ADDWEIGHT" 21 "ADDEXITL" 22 "ADDEXITR" 23 "ADDLANES" 24 "ADDRADAR" 25 "ADDRAPPEL" 26 "ADDPRIOTURN" 27 "ADDLORRY_EXCEPT" 28 "ADDTRACTOR_OVER" 29 "ADDTEXT" 30 "ADDSIGN" 31 "ADDRAINSNOW" 32 "ADDHUMP" 33 "VADDLORRYBUSTRAILER_DEPRECATED" 34 "VADDLORRYBUS_DEPRECATED" 35 "VADDLORRYTRAILER_DEPRECATED" 36 "ADDLORRYTRAILER_DEPRECATED" 37 "ADDCAMPER" 38 "ADDZONE" 39 "ADDCRASHRISK" 40 "ADDACCIDENT" 41 "ADDJAM" 42 "ADDSMOKE" 43 "ADDOILTRAIL" 44 "ADDGRAVEL" 45 "ADDDIRT" 46 "ADDRWORKSEXIT" 47 "ADDROADDAMAGE" 48 "ADDRWORKSENTRY" 49 "ADDLOWTREE" 50 "ADDRWORKSACCESS" 51 "ADDRUTS" 52 "ADDSOFTSHOULDERCAR" 53 "ADDSOFTSHOULDERLORRY" 54 "VADDSIGN" 55 "VADDCAR" 56 "VADDLORRY" 57 "VADDTRAILER" 58 "VADDCARAVAN" 59 "VADDBUS" 60 "VADDWET" 61 "VADDFOG" 62 "VADDRAIN" 63 "VADDSNOW" 64 "VADDRAINSNOW" 65 "VADDTEXT" 66 "VADDSECTION" 67 "VADDDISTANCE" 68 "VADDWEIGHT" 69 "VADDZONE" 70 "VADDCRASHRISK" 71 "VADDACCIDENT" 72 "VADDJAM" 73 "VADDOILTRAIL" 74 "VADDGRAVEL" 75 "VADDDIRT" 76 "VADDROADDAMAGE" 77 "VADDRUTS" 78 "ADDNOSTOPSHOULDER" 79 "ADDTOWING" 80 "ADDSCHOOL" 81 "ADDNIGHT" 82 "ADDEND" 83 "ADDBEGINS" 84 "ADDWITHIN" 85 "ADDDISTANCEBARS" 86 "ADDMINIMUM" 87 "ADDADVICE" 88 "ADDACCESS" 89 "ADDALLWAY" 90 "ADDBUS_EXCEPT" 91 "ADDEXCEPTDELIVERY" 92 "ADDEXCEPTLOCAL" 93 "ADDFROG" 94 "ADDPRIOTURNL" 95 "ADDPRIOTURNR" 96 "ADDSTART" 97 "ADDSTOPIN" 98 "ADDEXIT" 99 "ADDHAZWATER" 100 "ADDDAY" 101 "ADDSL" 102 "ADDLORRYTRAILER" 103 "ADDLORRYSEMI" 104 "VADDLORRYTRAILER" 105 "VADDLORRYSEMI" 106 "ADDSLOW" 107 "ADDSL5" 108 "ADDSL10" 109 "ADDSL15" 110 "ADDSL20" 111 "ADDSL25" 112 "ADDSL30" 113 "ADDSL35" 114 "ADDSL40" 115 "ADDSL45" 116 "ADDSL50" 117 "ADDSL55" 118 "ADDSL60" 119 "ADDSL65" 120 "ADDSL70" 121 "ADDSL75" 122 "ADDSL80" 123 "ADDSL85" 124 "ADDSL90" 125 "ADDSL95" 126 "ADDSL100" 127 "ADDSL105" 128 "ADDSL110" 129 "ADDSL115" 130 "ADDSL120" 131 "ADDSL125" 132 "ADDSL130" 133 "ADDSL135" 134 "ADDSL140" 135 "ADDSL145" 136 "ADDSL150" 137 "ADDSL155" 138 "ADDSL160" 139 "ADDBIKEROAD" 140 "ADDLORRYTRAILER_EXCEPT" 141 "ADDLORRYSEMI_EXCEPT" 142 "Reserved142" 143 "Reserved143" 144 "Reserved144" 145 "Reserved145" 146 "Reserved146" 147 "Reserved147" 148 "Reserved148" 149 "Reserved149" 150 "Reserved150" 151 "Reserved151" 152 "Reserved152" 153 "Reserved153" 154 "Reserved154" 155 "Reserved155" 156 "Reserved156" 157 "Reserved157" 158 "Reserved158" 159 "Reserved159" 160 "Reserved160" 161 "Reserved161" 162 "Reserved162" 163 "Reserved163" 164 "Reserved164" 165 "Reserved165" 166 "Reserved166" 167 "Reserved167" 168 "Reserved168" 169 "Reserved169" ;
VAL_ 244 VFC_TS13_SupSign4Type 0 "UNKNOWN" 1 "ADDCAR" 2 "ADDLORRY" 3 "ADDTRAILER" 4 "ADDCARAVAN" 5 "ADDBUS" 6 "ADDTRACTOR" 7 "ADDMCYCLE" 8 "ADDLORRYBUSTRAILER_DEPRECATED" 9 "ADDLORRYBUS_DEPRECATED" 10 "ADDHAZMAT" 11 "ADDTANK" 12 "ADDTRAM" 13 "ADDWET" 14 "ADDFOG" 15 "ADDRAIN" 16 "ADDSNOW" 17 "ADDTIME" 18 "ADDSECTION" 19 "ADDDISTANCE" 20 "ADDWEIGHT" 21 "ADDEXITL" 22 "ADDEXITR" 23 "ADDLANES" 24 "ADDRADAR" 25 "ADDRAPPEL" 26 "ADDPRIOTURN" 27 "ADDLORRY_EXCEPT" 28 "ADDTRACTOR_OVER" 29 "ADDTEXT" 30 "ADDSIGN" 31 "ADDRAINSNOW" 32 "ADDHUMP" 33 "VADDLORRYBUSTRAILER_DEPRECATED" 34 "VADDLORRYBUS_DEPRECATED" 35 "VADDLORRYTRAILER_DEPRECATED" 36 "ADDLORRYTRAILER_DEPRECATED" 37 "ADDCAMPER" 38 "ADDZONE" 39 "ADDCRASHRISK" 40 "ADDACCIDENT" 41 "ADDJAM" 42 "ADDSMOKE" 43 "ADDOILTRAIL" 44 "ADDGRAVEL" 45 "ADDDIRT" 46 "ADDRWORKSEXIT" 47 "ADDROADDAMAGE" 48 "ADDRWORKSENTRY" 49 "ADDLOWTREE" 50 "ADDRWORKSACCESS" 51 "ADDRUTS" 52 "ADDSOFTSHOULDERCAR" 53 "ADDSOFTSHOULDERLORRY" 54 "VADDSIGN" 55 "VADDCAR" 56 "VADDLORRY" 57 "VADDTRAILER" 58 "VADDCARAVAN" 59 "VADDBUS" 60 "VADDWET" 61 "VADDFOG" 62 "VADDRAIN" 63 "VADDSNOW" 64 "VADDRAINSNOW" 65 "VADDTEXT" 66 "VADDSECTION" 67 "VADDDISTANCE" 68 "VADDWEIGHT" 69 "VADDZONE" 70 "VADDCRASHRISK" 71 "VADDACCIDENT" 72 "VADDJAM" 73 "VADDOILTRAIL" 74 "VADDGRAVEL" 75 "VADDDIRT" 76 "VADDROADDAMAGE" 77 "VADDRUTS" 78 "ADDNOSTOPSHOULDER" 79 "ADDTOWING" 80 "ADDSCHOOL" 81 "ADDNIGHT" 82 "ADDEND" 83 "ADDBEGINS" 84 "ADDWITHIN" 85 "ADDDISTANCEBARS" 86 "ADDMINIMUM" 87 "ADDADVICE" 88 "ADDACCESS" 89 "ADDALLWAY" 90 "ADDBUS_EXCEPT" 91 "ADDEXCEPTDELIVERY" 92 "ADDEXCEPTLOCAL" 93 "ADDFROG" 94 "ADDPRIOTURNL" 95 "ADDPRIOTURNR" 96 "ADDSTART" 97 "ADDSTOPIN" 98 "ADDEXIT" 99 "ADDHAZWATER" 100 "ADDDAY" 101 "ADDSL" 102 "ADDLORRYTRAILER" 103 "ADDLORRYSEMI" 104 "VADDLORRYTRAILER" 105 "VADDLORRYSEMI" 106 "ADDSLOW" 107 "ADDSL5" 108 "ADDSL10" 109 "ADDSL15" 110 "ADDSL20" 111 "ADDSL25" 112 "ADDSL30" 113 "ADDSL35" 114 "ADDSL40" 115 "ADDSL45" 116 "ADDSL50" 117 "ADDSL55" 118 "ADDSL60" 119 "ADDSL65" 120 "ADDSL70" 121 "ADDSL75" 122 "ADDSL80" 123 "ADDSL85" 124 "ADDSL90" 125 "ADDSL95" 126 "ADDSL100" 127 "ADDSL105" 128 "ADDSL110" 129 "ADDSL115" 130 "ADDSL120" 131 "ADDSL125" 132 "ADDSL130" 133 "ADDSL135" 134 "ADDSL140" 135 "ADDSL145" 136 "ADDSL150" 137 "ADDSL155" 138 "ADDSL160" 139 "ADDBIKEROAD" 140 "ADDLORRYTRAILER_EXCEPT" 141 "ADDLORRYSEMI_EXCEPT" 142 "Reserved142" 143 "Reserved143" 144 "Reserved144" 145 "Reserved145" 146 "Reserved146" 147 "Reserved147" 148 "Reserved148" 149 "Reserved149" 150 "Reserved150" 151 "Reserved151" 152 "Reserved152" 153 "Reserved153" 154 "Reserved154" 155 "Reserved155" 156 "Reserved156" 157 "Reserved157" 158 "Reserved158" 159 "Reserved159" 160 "Reserved160" 161 "Reserved161" 162 "Reserved162" 163 "Reserved163" 164 "Reserved164" 165 "Reserved165" 166 "Reserved166" 167 "Reserved167" 168 "Reserved168" 169 "Reserved169" ;
VAL_ 244 VFC_TS13_SupSign5Type 0 "UNKNOWN" 1 "ADDCAR" 2 "ADDLORRY" 3 "ADDTRAILER" 4 "ADDCARAVAN" 5 "ADDBUS" 6 "ADDTRACTOR" 7 "ADDMCYCLE" 8 "ADDLORRYBUSTRAILER_DEPRECATED" 9 "ADDLORRYBUS_DEPRECATED" 10 "ADDHAZMAT" 11 "ADDTANK" 12 "ADDTRAM" 13 "ADDWET" 14 "ADDFOG" 15 "ADDRAIN" 16 "ADDSNOW" 17 "ADDTIME" 18 "ADDSECTION" 19 "ADDDISTANCE" 20 "ADDWEIGHT" 21 "ADDEXITL" 22 "ADDEXITR" 23 "ADDLANES" 24 "ADDRADAR" 25 "ADDRAPPEL" 26 "ADDPRIOTURN" 27 "ADDLORRY_EXCEPT" 28 "ADDTRACTOR_OVER" 29 "ADDTEXT" 30 "ADDSIGN" 31 "ADDRAINSNOW" 32 "ADDHUMP" 33 "VADDLORRYBUSTRAILER_DEPRECATED" 34 "VADDLORRYBUS_DEPRECATED" 35 "VADDLORRYTRAILER_DEPRECATED" 36 "ADDLORRYTRAILER_DEPRECATED" 37 "ADDCAMPER" 38 "ADDZONE" 39 "ADDCRASHRISK" 40 "ADDACCIDENT" 41 "ADDJAM" 42 "ADDSMOKE" 43 "ADDOILTRAIL" 44 "ADDGRAVEL" 45 "ADDDIRT" 46 "ADDRWORKSEXIT" 47 "ADDROADDAMAGE" 48 "ADDRWORKSENTRY" 49 "ADDLOWTREE" 50 "ADDRWORKSACCESS" 51 "ADDRUTS" 52 "ADDSOFTSHOULDERCAR" 53 "ADDSOFTSHOULDERLORRY" 54 "VADDSIGN" 55 "VADDCAR" 56 "VADDLORRY" 57 "VADDTRAILER" 58 "VADDCARAVAN" 59 "VADDBUS" 60 "VADDWET" 61 "VADDFOG" 62 "VADDRAIN" 63 "VADDSNOW" 64 "VADDRAINSNOW" 65 "VADDTEXT" 66 "VADDSECTION" 67 "VADDDISTANCE" 68 "VADDWEIGHT" 69 "VADDZONE" 70 "VADDCRASHRISK" 71 "VADDACCIDENT" 72 "VADDJAM" 73 "VADDOILTRAIL" 74 "VADDGRAVEL" 75 "VADDDIRT" 76 "VADDROADDAMAGE" 77 "VADDRUTS" 78 "ADDNOSTOPSHOULDER" 79 "ADDTOWING" 80 "ADDSCHOOL" 81 "ADDNIGHT" 82 "ADDEND" 83 "ADDBEGINS" 84 "ADDWITHIN" 85 "ADDDISTANCEBARS" 86 "ADDMINIMUM" 87 "ADDADVICE" 88 "ADDACCESS" 89 "ADDALLWAY" 90 "ADDBUS_EXCEPT" 91 "ADDEXCEPTDELIVERY" 92 "ADDEXCEPTLOCAL" 93 "ADDFROG" 94 "ADDPRIOTURNL" 95 "ADDPRIOTURNR" 96 "ADDSTART" 97 "ADDSTOPIN" 98 "ADDEXIT" 99 "ADDHAZWATER" 100 "ADDDAY" 101 "ADDSL" 102 "ADDLORRYTRAILER" 103 "ADDLORRYSEMI" 104 "VADDLORRYTRAILER" 105 "VADDLORRYSEMI" 106 "ADDSLOW" 107 "ADDSL5" 108 "ADDSL10" 109 "ADDSL15" 110 "ADDSL20" 111 "ADDSL25" 112 "ADDSL30" 113 "ADDSL35" 114 "ADDSL40" 115 "ADDSL45" 116 "ADDSL50" 117 "ADDSL55" 118 "ADDSL60" 119 "ADDSL65" 120 "ADDSL70" 121 "ADDSL75" 122 "ADDSL80" 123 "ADDSL85" 124 "ADDSL90" 125 "ADDSL95" 126 "ADDSL100" 127 "ADDSL105" 128 "ADDSL110" 129 "ADDSL115" 130 "ADDSL120" 131 "ADDSL125" 132 "ADDSL130" 133 "ADDSL135" 134 "ADDSL140" 135 "ADDSL145" 136 "ADDSL150" 137 "ADDSL155" 138 "ADDSL160" 139 "ADDBIKEROAD" 140 "ADDLORRYTRAILER_EXCEPT" 141 "ADDLORRYSEMI_EXCEPT" 142 "Reserved142" 143 "Reserved143" 144 "Reserved144" 145 "Reserved145" 146 "Reserved146" 147 "Reserved147" 148 "Reserved148" 149 "Reserved149" 150 "Reserved150" 151 "Reserved151" 152 "Reserved152" 153 "Reserved153" 154 "Reserved154" 155 "Reserved155" 156 "Reserved156" 157 "Reserved157" 158 "Reserved158" 159 "Reserved159" 160 "Reserved160" 161 "Reserved161" 162 "Reserved162" 163 "Reserved163" 164 "Reserved164" 165 "Reserved165" 166 "Reserved166" 167 "Reserved167" 168 "Reserved168" 169 "Reserved169" ;
VAL_ 245 VFC_TS14_Type 0 "UNKNOWN" 1 "SL5" 2 "SL10" 3 "SL15" 4 "SL20" 5 "SL25" 6 "SL30" 7 "SL35" 8 "SL40" 9 "SL45" 10 "SL50" 11 "SL55" 12 "SL60" 13 "SL65" 14 "SL70" 15 "SL75" 16 "SL80" 17 "SL85" 18 "SL90" 19 "SL95" 20 "SL100" 21 "SL105" 22 "SL110" 23 "SL115" 24 "SL120" 25 "SL125" 26 "SL130" 27 "SL135" 28 "SL140" 29 "SL145" 30 "SL150" 31 "SL155" 32 "SL160" 33 "OP" 34 "OL" 35 "ESL" 36 "EOP" 37 "EOL" 38 "EA" 39 "VSL5" 40 "VSL10" 41 "VSL15" 42 "VSL20" 43 "VSL25" 44 "VSL30" 45 "VSL35" 46 "VSL40" 47 "VSL45" 48 "VSL50" 49 "VSL55" 50 "VSL60" 51 "VSL65" 52 "VSL70" 53 "VSL75" 54 "VSL80" 55 "VSL85" 56 "VSL90" 57 "VSL95" 58 "VSL100" 59 "VSL105" 60 "VSL110" 61 "VSL115" 62 "VSL120" 63 "VSL125" 64 "VSL130" 65 "VSL135" 66 "VSL140" 67 "VSL145" 68 "VSL150" 69 "VSL155" 70 "VSL160" 71 "VOP" 72 "VOL" 73 "VESL" 74 "VEOP" 75 "VEOL" 76 "VEA" 77 "NOENTRY" 78 "NOALL" 79 "NOCAR" 80 "NOLORRY" 81 "NOHAZMAT" 82 "NOBIKE" 83 "NOPED" 84 "NOCARBIKE" 85 "NOTWOWAY" 86 "WEIGHT" 87 "HEIGHT" 88 "WIDTH" 89 "LENGTH" 90 "PRIOCROSS" 91 "GIVEWAY" 92 "PRIOCROSSYIELDTORIGHT" 93 "WARNDANGER" 94 "WARNCURVEL" 95 "WARNCURVER" 96 "WARNDCURVEL" 97 "WARNDCURVER" 98 "WARNTRAIN" 99 "WARNJAM" 100 "WARNANIMAL_DEPRECATED" 101 "WARNRWORKS" 102 "WARNSLOPED" 103 "WARNSLOPEU" 104 "PRIOSTREET" 105 "EPRIOSTREET" 106 "STOP" 107 "ASL" 108 "EASL" 109 "MSL" 110 "EMSL" 111 "MLC" 112 "WBDIAGL" 113 "WBDIAGR" 114 "WBROUND" 115 "NOLTURN" 116 "NORTURN" 117 "NOUTURN" 118 "NOPARK" 119 "NOSTOP" 120 "SMOG" 121 "UMWELT" 122 "EUMWELT" 123 "DOUANE" 124 "FWAY" 125 "EFWAY" 126 "HWAY" 127 "EHWAY" 128 "NORIDER" 129 "WARNCONST" 130 "WARNCONSTL" 131 "WARNCONSTR" 132 "WARNPED" 133 "WARNKIDS" 134 "WARNBIKE" 135 "WARNSKID" 136 "ZEBRA" 137 "ONEWAYS" 138 "ONEWAYU" 139 "SLOWDOWN" 140 "NOCARRIAGE" 141 "NOLORRYTRAILER" 142 "NOBUS" 143 "NOTRACTOR" 144 "LORRYDIST" 145 "CARDIST" 146 "WARNROUND" 147 "WARNWILDANIMAL" 148 "WARNCATTLE" 149 "WARNFROG" 150 "WARNBUS" 151 "WARNWIND" 152 "WARNSNOW" 153 "WARNPCROSS" 154 "WARNHUMP" 155 "WARNROCK" 156 "WARNLOWTREE" 157 "WARNGRAVEL" 158 "WARNTWOWAY" 159 "WARNLIGHTS" 160 "WARNPLANE" 161 "VNOENTRY" 162 "VNOALL" 163 "VNOCAR" 164 "VNOLORRY" 165 "VNOCARBIKE" 166 "VWEIGHT" 167 "VHEIGHT" 168 "VWIDTH" 169 "VLENGTH" 170 "VWARNDANGER" 171 "VWARNJAM" 172 "VWARNRWORKS" 173 "VWARNSKID" 174 "VASL" 175 "VEASL" 176 "VNOLORRYTRAILER" 177 "VNOBUS" 178 "VLORRYDIST" 179 "VCARDIST" 180 "VWARNSNOW" 181 "VWARNHUMP" 182 "VWARNGRAVEL" 183 "CALM" 184 "ECALM" 185 "TWN" 186 "ETWN" 187 "DEADEND" 188 "AXLEWEIGHT" 189 "WARNRIDER" 190 "WARNDRAWBRIDGE" 191 "WARNPIER" 192 "TRINATURE" 193 "VWARNCONST" 194 "VWARNCONSTL" 195 "VWARNCONSTR" 196 "VWARNCURVEL" 197 "VWARNCURVER" 198 "VWARNDCURVEL" 199 "VWARNDCURVER" 200 "VWARNLIGHTS" 201 "WBBENTLEFT" 202 "WBBENTLEFTRIGHT" 203 "WBBENTRIGHT" 204 "WBDIAGLR" 205 "WBLEFT" 206 "WBRIGHT" 207 "WBUP" 208 "WBUPLEFT" 209 "WBUPRIGHT" 210 "WBHAZWATER" 211 "NOHAZWATER" 212 "SCHOOL" 213 "ESCHOOL" 214 "HAZMAT" 215 "EMERGENCYBAY" 216 "ENDOFLANEL" 217 "ENDOFLANER" 218 "ENOPARK" 219 "EONEWAY" 220 "EPARK" 221 "ETOLL" 222 "NOPARKL" 223 "NOPARKLR" 224 "NOPARKR" 225 "NOSTOPL" 226 "NOSTOPLR" 227 "NOSTOPR" 228 "NOTURNONRED" 229 "ONEWAYL" 230 "ONEWAYR" 231 "PARK" 232 "PRIOCROSSL" 233 "PRIOCROSSR" 234 "TOLL" 235 "TUNNEL" 236 "TWOWAY" 237 "WARNCROSS" 238 "WARNCROSSL" 239 "WARNCROSSLR" 240 "WARNCROSSR" 241 "WARNCROSSRL" 242 "WARNCROSST" 243 "WARNGIVEWAYAHEAD" 244 "WARNSLAHEAD" 245 "WARNSTOPAHEAD" 246 "WBBUS" 247 "WRONGWAY" 248 "HAZWATER" 249 "GIVEWAYROUND" 250 "WARNWINDINGL" 251 "WARNWINDINGR" 252 "WARNHAIRPINL" 253 "WARNHAIRPINR" 254 "WARNPEDBIKE" 255 "WARNCROSSY" 256 "WARNBRANCHL" 257 "WARNBRANCHR" 258 "WARNAXLEWEIGHT" 259 "WARNWEIGHT" 260 "WARNHEIGHT" 261 "WARNLENGTH" 262 "WARNWIDTH" 263 "WARNBLACKSPOT" 264 "WARNMERGEL" 265 "WARNMERGER" 266 "WARNTUNNEL" 267 "WARNTRACTOR" 268 "WARNRWORKSVEHICLE" 269 "WARNNARROWBRIDGE" 270 "WARNFLAGGER" 271 "LANES" 272 "LANESHIFTL" 273 "LANESHIFTR" 274 "NEWLANEL" 275 "NEWLANER" 276 "RIGHTTURNONRED" 277 "BORDERLIMIT" 278 "EMBEDDEDRAIN" 279 "VWARNWEIGHT" 280 "VWARNHEIGHT" 281 "VWARNLENGTH" 282 "VWARNWIDTH" 283 "VENDOFLANEL" 284 "VENDOFLANER" 285 "VLANES" 286 "VLANESHIFTL" 287 "VLANESHIFTR" 288 "VNEWLANEL" 289 "VNEWLANER" 290 "NOUP" 291 "VOFF" 292 "ASL5" 293 "ASL10" 294 "ASL15" 295 "ASL20" 296 "ASL25" 297 "ASL30" 298 "ASL35" 299 "ASL40" 300 "ASL45" 301 "ASL50" 302 "ASL55" 303 "ASL60" 304 "ASL65" 305 "ASL70" 306 "ASL75" 307 "ASL80" 308 "ASL85" 309 "ASL90" 310 "ASL95" 311 "ASL100" 312 "ASL105" 313 "ASL110" 314 "ASL115" 315 "ASL120" 316 "ASL125" 317 "ASL130" 318 "ASL135" 319 "ASL140" 320 "ASL145" 321 "ASL150" 322 "ASL155" 323 "ASL160" 324 "VASL5" 325 "VASL10" 326 "VASL15" 327 "VASL20" 328 "VASL25" 329 "VASL30" 330 "VASL35" 331 "VASL40" 332 "VASL45" 333 "VASL50" 334 "VASL55" 335 "VASL60" 336 "VASL65" 337 "VASL70" 338 "VASL75" 339 "VASL80" 340 "VASL85" 341 "VASL90" 342 "VASL95" 343 "VASL100" 344 "VASL105" 345 "VASL110" 346 "VASL115" 347 "VASL120" 348 "VASL125" 349 "VASL130" 350 "VASL135" 351 "VASL140" 352 "VASL145" 353 "VASL150" 354 "VASL155" 355 "VASL160" 356 "WARNTRAINGATED" 357 "KEEPRIGHTCAR" 358 "ASLCURVE5" 359 "ASLCURVE10" 360 "ASLCURVE15" 361 "ASLCURVE20" 362 "ASLCURVE25" 363 "ASLCURVE30" 364 "ASLCURVE35" 365 "ASLCURVE40" 366 "ASLCURVE45" 367 "ASLCURVE50" 368 "ASLCURVE55" 369 "ASLCURVE60" 370 "ASLCURVE65" 371 "ASLCURVE70" 372 "ASLCURVE75" 373 "ASLCURVE80" 374 "ASLCURVE85" 375 "ASLCURVE90" 376 "ASLCURVE95" 377 "ASLCURVE100" 378 "ASLCURVE105" 379 "ASLCURVE110" 380 "ASLCURVE115" 381 "ASLCURVE120" 382 "ASLCURVE125" 383 "ASLCURVE130" 384 "ASLCURVE135" 385 "ASLCURVE140" 386 "ASLCURVE145" 387 "ASLCURVE150" 388 "ASLCURVE155" 389 "ASLCURVE160" 390 "KIDS" 391 "EKIDS" 392 "BIKEROAD" 393 "EBIKEROAD" 394 "PEDSTREET" 395 "EPEDSTREET" 396 "PEDBIKESTREET" 397 "EPEDBIKESTREET" 398 "EWARNKIDS" 399 "CALM20" 400 "CALM30" 401 "ECALM20" 402 "ECALM30" 403 "FWAYGREEN" 404 "TWN40" 405 "TWN50" 406 "TWN60" 407 "TWN70" 408 "ETWN40" 409 "ETWN50" 410 "ETWN60" 411 "ETWN70" 412 "WBBIKE" 413 "EWBBIKE" 414 "WBPED" 415 "EWBPED" 416 "WBPEDBIKESEP" 417 "EWBPEDBIKESEP" 418 "WBPEDBIKESHARED" 419 "EWBPEDBIKESHARED" 420 "EFWAYGREEN" 421 "Reserved0421" 422 "Reserved0422" 423 "Reserved0423" 424 "Reserved0424" 425 "Reserved0425" 426 "Reserved0426" 427 "Reserved0427" 428 "Reserved0428" 429 "Reserved0429" 430 "Reserved0430" 431 "Reserved0431" 432 "Reserved0432" 433 "Reserved0433" 434 "Reserved0434" 435 "Reserved0435" 436 "Reserved0436" 437 "Reserved0437" 438 "Reserved0438" 439 "Reserved0439" 440 "Reserved0440" 441 "Reserved0441" 442 "Reserved0442" 443 "Reserved0443" 444 "Reserved0444" 445 "Reserved0445" 446 "Reserved0446" 447 "Reserved0447" 448 "Reserved0448" 449 "Reserved0449" ;
VAL_ 245 VFC_TS14_EmbeddedInfo 0 "Unknown" 1 "Not Embedded" 2 "Border Limit" 3 "Multi Lane" 4 "Rain" 5 "Vehicle Type" 6 "Plate" 7 "Error Value" 8 "Vehicle Sticker" 9 "Reserved09" 10 "Reserved10" 11 "Reserved11" 12 "Reserved12" 13 "Reserved13" 14 "Reserved14" 15 "Reserved15" ;
VAL_ 245 VFC_TS14_ValidTimeRange1Start 127 "Unknown" ;
VAL_ 245 VFC_TS14_ValidTimeRange1End 127 "Unknown" ;
VAL_ 245 VFC_TS14_ValidTimeRange2Start 127 "Unknown" ;
VAL_ 245 VFC_TS14_ValidTimeRange2End 127 "Unknown" ;
VAL_ 245 VFC_TS14_ValidInDistUnit 0 "Unknown" ;
VAL_ 245 VFC_TS14_ValidSectionUnit 0 "Unknown" 1 "Meter" 2 "Kilometer" 3 "Foot" 4 "Yard" 5 "Mile" 6 "Reserved6" 7 "Reserved7" ;
VAL_ 245 VFC_TS14_SupSign0Type 0 "UNKNOWN" 1 "ADDCAR" 2 "ADDLORRY" 3 "ADDTRAILER" 4 "ADDCARAVAN" 5 "ADDBUS" 6 "ADDTRACTOR" 7 "ADDMCYCLE" 8 "ADDLORRYBUSTRAILER_DEPRECATED" 9 "ADDLORRYBUS_DEPRECATED" 10 "ADDHAZMAT" 11 "ADDTANK" 12 "ADDTRAM" 13 "ADDWET" 14 "ADDFOG" 15 "ADDRAIN" 16 "ADDSNOW" 17 "ADDTIME" 18 "ADDSECTION" 19 "ADDDISTANCE" 20 "ADDWEIGHT" 21 "ADDEXITL" 22 "ADDEXITR" 23 "ADDLANES" 24 "ADDRADAR" 25 "ADDRAPPEL" 26 "ADDPRIOTURN" 27 "ADDLORRY_EXCEPT" 28 "ADDTRACTOR_OVER" 29 "ADDTEXT" 30 "ADDSIGN" 31 "ADDRAINSNOW" 32 "ADDHUMP" 33 "VADDLORRYBUSTRAILER_DEPRECATED" 34 "VADDLORRYBUS_DEPRECATED" 35 "VADDLORRYTRAILER_DEPRECATED" 36 "ADDLORRYTRAILER_DEPRECATED" 37 "ADDCAMPER" 38 "ADDZONE" 39 "ADDCRASHRISK" 40 "ADDACCIDENT" 41 "ADDJAM" 42 "ADDSMOKE" 43 "ADDOILTRAIL" 44 "ADDGRAVEL" 45 "ADDDIRT" 46 "ADDRWORKSEXIT" 47 "ADDROADDAMAGE" 48 "ADDRWORKSENTRY" 49 "ADDLOWTREE" 50 "ADDRWORKSACCESS" 51 "ADDRUTS" 52 "ADDSOFTSHOULDERCAR" 53 "ADDSOFTSHOULDERLORRY" 54 "VADDSIGN" 55 "VADDCAR" 56 "VADDLORRY" 57 "VADDTRAILER" 58 "VADDCARAVAN" 59 "VADDBUS" 60 "VADDWET" 61 "VADDFOG" 62 "VADDRAIN" 63 "VADDSNOW" 64 "VADDRAINSNOW" 65 "VADDTEXT" 66 "VADDSECTION" 67 "VADDDISTANCE" 68 "VADDWEIGHT" 69 "VADDZONE" 70 "VADDCRASHRISK" 71 "VADDACCIDENT" 72 "VADDJAM" 73 "VADDOILTRAIL" 74 "VADDGRAVEL" 75 "VADDDIRT" 76 "VADDROADDAMAGE" 77 "VADDRUTS" 78 "ADDNOSTOPSHOULDER" 79 "ADDTOWING" 80 "ADDSCHOOL" 81 "ADDNIGHT" 82 "ADDEND" 83 "ADDBEGINS" 84 "ADDWITHIN" 85 "ADDDISTANCEBARS" 86 "ADDMINIMUM" 87 "ADDADVICE" 88 "ADDACCESS" 89 "ADDALLWAY" 90 "ADDBUS_EXCEPT" 91 "ADDEXCEPTDELIVERY" 92 "ADDEXCEPTLOCAL" 93 "ADDFROG" 94 "ADDPRIOTURNL" 95 "ADDPRIOTURNR" 96 "ADDSTART" 97 "ADDSTOPIN" 98 "ADDEXIT" 99 "ADDHAZWATER" 100 "ADDDAY" 101 "ADDSL" 102 "ADDLORRYTRAILER" 103 "ADDLORRYSEMI" 104 "VADDLORRYTRAILER" 105 "VADDLORRYSEMI" 106 "ADDSLOW" 107 "ADDSL5" 108 "ADDSL10" 109 "ADDSL15" 110 "ADDSL20" 111 "ADDSL25" 112 "ADDSL30" 113 "ADDSL35" 114 "ADDSL40" 115 "ADDSL45" 116 "ADDSL50" 117 "ADDSL55" 118 "ADDSL60" 119 "ADDSL65" 120 "ADDSL70" 121 "ADDSL75" 122 "ADDSL80" 123 "ADDSL85" 124 "ADDSL90" 125 "ADDSL95" 126 "ADDSL100" 127 "ADDSL105" 128 "ADDSL110" 129 "ADDSL115" 130 "ADDSL120" 131 "ADDSL125" 132 "ADDSL130" 133 "ADDSL135" 134 "ADDSL140" 135 "ADDSL145" 136 "ADDSL150" 137 "ADDSL155" 138 "ADDSL160" 139 "ADDBIKEROAD" 140 "ADDLORRYTRAILER_EXCEPT" 141 "ADDLORRYSEMI_EXCEPT" 142 "Reserved142" 143 "Reserved143" 144 "Reserved144" 145 "Reserved145" 146 "Reserved146" 147 "Reserved147" 148 "Reserved148" 149 "Reserved149" 150 "Reserved150" 151 "Reserved151" 152 "Reserved152" 153 "Reserved153" 154 "Reserved154" 155 "Reserved155" 156 "Reserved156" 157 "Reserved157" 158 "Reserved158" 159 "Reserved159" 160 "Reserved160" 161 "Reserved161" 162 "Reserved162" 163 "Reserved163" 164 "Reserved164" 165 "Reserved165" 166 "Reserved166" 167 "Reserved167" 168 "Reserved168" 169 "Reserved169" ;
VAL_ 245 VFC_TS14_SupSign1Type 0 "UNKNOWN" 1 "ADDCAR" 2 "ADDLORRY" 3 "ADDTRAILER" 4 "ADDCARAVAN" 5 "ADDBUS" 6 "ADDTRACTOR" 7 "ADDMCYCLE" 8 "ADDLORRYBUSTRAILER_DEPRECATED" 9 "ADDLORRYBUS_DEPRECATED" 10 "ADDHAZMAT" 11 "ADDTANK" 12 "ADDTRAM" 13 "ADDWET" 14 "ADDFOG" 15 "ADDRAIN" 16 "ADDSNOW" 17 "ADDTIME" 18 "ADDSECTION" 19 "ADDDISTANCE" 20 "ADDWEIGHT" 21 "ADDEXITL" 22 "ADDEXITR" 23 "ADDLANES" 24 "ADDRADAR" 25 "ADDRAPPEL" 26 "ADDPRIOTURN" 27 "ADDLORRY_EXCEPT" 28 "ADDTRACTOR_OVER" 29 "ADDTEXT" 30 "ADDSIGN" 31 "ADDRAINSNOW" 32 "ADDHUMP" 33 "VADDLORRYBUSTRAILER_DEPRECATED" 34 "VADDLORRYBUS_DEPRECATED" 35 "VADDLORRYTRAILER_DEPRECATED" 36 "ADDLORRYTRAILER_DEPRECATED" 37 "ADDCAMPER" 38 "ADDZONE" 39 "ADDCRASHRISK" 40 "ADDACCIDENT" 41 "ADDJAM" 42 "ADDSMOKE" 43 "ADDOILTRAIL" 44 "ADDGRAVEL" 45 "ADDDIRT" 46 "ADDRWORKSEXIT" 47 "ADDROADDAMAGE" 48 "ADDRWORKSENTRY" 49 "ADDLOWTREE" 50 "ADDRWORKSACCESS" 51 "ADDRUTS" 52 "ADDSOFTSHOULDERCAR" 53 "ADDSOFTSHOULDERLORRY" 54 "VADDSIGN" 55 "VADDCAR" 56 "VADDLORRY" 57 "VADDTRAILER" 58 "VADDCARAVAN" 59 "VADDBUS" 60 "VADDWET" 61 "VADDFOG" 62 "VADDRAIN" 63 "VADDSNOW" 64 "VADDRAINSNOW" 65 "VADDTEXT" 66 "VADDSECTION" 67 "VADDDISTANCE" 68 "VADDWEIGHT" 69 "VADDZONE" 70 "VADDCRASHRISK" 71 "VADDACCIDENT" 72 "VADDJAM" 73 "VADDOILTRAIL" 74 "VADDGRAVEL" 75 "VADDDIRT" 76 "VADDROADDAMAGE" 77 "VADDRUTS" 78 "ADDNOSTOPSHOULDER" 79 "ADDTOWING" 80 "ADDSCHOOL" 81 "ADDNIGHT" 82 "ADDEND" 83 "ADDBEGINS" 84 "ADDWITHIN" 85 "ADDDISTANCEBARS" 86 "ADDMINIMUM" 87 "ADDADVICE" 88 "ADDACCESS" 89 "ADDALLWAY" 90 "ADDBUS_EXCEPT" 91 "ADDEXCEPTDELIVERY" 92 "ADDEXCEPTLOCAL" 93 "ADDFROG" 94 "ADDPRIOTURNL" 95 "ADDPRIOTURNR" 96 "ADDSTART" 97 "ADDSTOPIN" 98 "ADDEXIT" 99 "ADDHAZWATER" 100 "ADDDAY" 101 "ADDSL" 102 "ADDLORRYTRAILER" 103 "ADDLORRYSEMI" 104 "VADDLORRYTRAILER" 105 "VADDLORRYSEMI" 106 "ADDSLOW" 107 "ADDSL5" 108 "ADDSL10" 109 "ADDSL15" 110 "ADDSL20" 111 "ADDSL25" 112 "ADDSL30" 113 "ADDSL35" 114 "ADDSL40" 115 "ADDSL45" 116 "ADDSL50" 117 "ADDSL55" 118 "ADDSL60" 119 "ADDSL65" 120 "ADDSL70" 121 "ADDSL75" 122 "ADDSL80" 123 "ADDSL85" 124 "ADDSL90" 125 "ADDSL95" 126 "ADDSL100" 127 "ADDSL105" 128 "ADDSL110" 129 "ADDSL115" 130 "ADDSL120" 131 "ADDSL125" 132 "ADDSL130" 133 "ADDSL135" 134 "ADDSL140" 135 "ADDSL145" 136 "ADDSL150" 137 "ADDSL155" 138 "ADDSL160" 139 "ADDBIKEROAD" 140 "ADDLORRYTRAILER_EXCEPT" 141 "ADDLORRYSEMI_EXCEPT" 142 "Reserved142" 143 "Reserved143" 144 "Reserved144" 145 "Reserved145" 146 "Reserved146" 147 "Reserved147" 148 "Reserved148" 149 "Reserved149" 150 "Reserved150" 151 "Reserved151" 152 "Reserved152" 153 "Reserved153" 154 "Reserved154" 155 "Reserved155" 156 "Reserved156" 157 "Reserved157" 158 "Reserved158" 159 "Reserved159" 160 "Reserved160" 161 "Reserved161" 162 "Reserved162" 163 "Reserved163" 164 "Reserved164" 165 "Reserved165" 166 "Reserved166" 167 "Reserved167" 168 "Reserved168" 169 "Reserved169" ;
VAL_ 245 VFC_TS14_SupSign2Type 0 "UNKNOWN" 1 "ADDCAR" 2 "ADDLORRY" 3 "ADDTRAILER" 4 "ADDCARAVAN" 5 "ADDBUS" 6 "ADDTRACTOR" 7 "ADDMCYCLE" 8 "ADDLORRYBUSTRAILER_DEPRECATED" 9 "ADDLORRYBUS_DEPRECATED" 10 "ADDHAZMAT" 11 "ADDTANK" 12 "ADDTRAM" 13 "ADDWET" 14 "ADDFOG" 15 "ADDRAIN" 16 "ADDSNOW" 17 "ADDTIME" 18 "ADDSECTION" 19 "ADDDISTANCE" 20 "ADDWEIGHT" 21 "ADDEXITL" 22 "ADDEXITR" 23 "ADDLANES" 24 "ADDRADAR" 25 "ADDRAPPEL" 26 "ADDPRIOTURN" 27 "ADDLORRY_EXCEPT" 28 "ADDTRACTOR_OVER" 29 "ADDTEXT" 30 "ADDSIGN" 31 "ADDRAINSNOW" 32 "ADDHUMP" 33 "VADDLORRYBUSTRAILER_DEPRECATED" 34 "VADDLORRYBUS_DEPRECATED" 35 "VADDLORRYTRAILER_DEPRECATED" 36 "ADDLORRYTRAILER_DEPRECATED" 37 "ADDCAMPER" 38 "ADDZONE" 39 "ADDCRASHRISK" 40 "ADDACCIDENT" 41 "ADDJAM" 42 "ADDSMOKE" 43 "ADDOILTRAIL" 44 "ADDGRAVEL" 45 "ADDDIRT" 46 "ADDRWORKSEXIT" 47 "ADDROADDAMAGE" 48 "ADDRWORKSENTRY" 49 "ADDLOWTREE" 50 "ADDRWORKSACCESS" 51 "ADDRUTS" 52 "ADDSOFTSHOULDERCAR" 53 "ADDSOFTSHOULDERLORRY" 54 "VADDSIGN" 55 "VADDCAR" 56 "VADDLORRY" 57 "VADDTRAILER" 58 "VADDCARAVAN" 59 "VADDBUS" 60 "VADDWET" 61 "VADDFOG" 62 "VADDRAIN" 63 "VADDSNOW" 64 "VADDRAINSNOW" 65 "VADDTEXT" 66 "VADDSECTION" 67 "VADDDISTANCE" 68 "VADDWEIGHT" 69 "VADDZONE" 70 "VADDCRASHRISK" 71 "VADDACCIDENT" 72 "VADDJAM" 73 "VADDOILTRAIL" 74 "VADDGRAVEL" 75 "VADDDIRT" 76 "VADDROADDAMAGE" 77 "VADDRUTS" 78 "ADDNOSTOPSHOULDER" 79 "ADDTOWING" 80 "ADDSCHOOL" 81 "ADDNIGHT" 82 "ADDEND" 83 "ADDBEGINS" 84 "ADDWITHIN" 85 "ADDDISTANCEBARS" 86 "ADDMINIMUM" 87 "ADDADVICE" 88 "ADDACCESS" 89 "ADDALLWAY" 90 "ADDBUS_EXCEPT" 91 "ADDEXCEPTDELIVERY" 92 "ADDEXCEPTLOCAL" 93 "ADDFROG" 94 "ADDPRIOTURNL" 95 "ADDPRIOTURNR" 96 "ADDSTART" 97 "ADDSTOPIN" 98 "ADDEXIT" 99 "ADDHAZWATER" 100 "ADDDAY" 101 "ADDSL" 102 "ADDLORRYTRAILER" 103 "ADDLORRYSEMI" 104 "VADDLORRYTRAILER" 105 "VADDLORRYSEMI" 106 "ADDSLOW" 107 "ADDSL5" 108 "ADDSL10" 109 "ADDSL15" 110 "ADDSL20" 111 "ADDSL25" 112 "ADDSL30" 113 "ADDSL35" 114 "ADDSL40" 115 "ADDSL45" 116 "ADDSL50" 117 "ADDSL55" 118 "ADDSL60" 119 "ADDSL65" 120 "ADDSL70" 121 "ADDSL75" 122 "ADDSL80" 123 "ADDSL85" 124 "ADDSL90" 125 "ADDSL95" 126 "ADDSL100" 127 "ADDSL105" 128 "ADDSL110" 129 "ADDSL115" 130 "ADDSL120" 131 "ADDSL125" 132 "ADDSL130" 133 "ADDSL135" 134 "ADDSL140" 135 "ADDSL145" 136 "ADDSL150" 137 "ADDSL155" 138 "ADDSL160" 139 "ADDBIKEROAD" 140 "ADDLORRYTRAILER_EXCEPT" 141 "ADDLORRYSEMI_EXCEPT" 142 "Reserved142" 143 "Reserved143" 144 "Reserved144" 145 "Reserved145" 146 "Reserved146" 147 "Reserved147" 148 "Reserved148" 149 "Reserved149" 150 "Reserved150" 151 "Reserved151" 152 "Reserved152" 153 "Reserved153" 154 "Reserved154" 155 "Reserved155" 156 "Reserved156" 157 "Reserved157" 158 "Reserved158" 159 "Reserved159" 160 "Reserved160" 161 "Reserved161" 162 "Reserved162" 163 "Reserved163" 164 "Reserved164" 165 "Reserved165" 166 "Reserved166" 167 "Reserved167" 168 "Reserved168" 169 "Reserved169" ;
VAL_ 245 VFC_TS14_SupSign3Type 0 "UNKNOWN" 1 "ADDCAR" 2 "ADDLORRY" 3 "ADDTRAILER" 4 "ADDCARAVAN" 5 "ADDBUS" 6 "ADDTRACTOR" 7 "ADDMCYCLE" 8 "ADDLORRYBUSTRAILER_DEPRECATED" 9 "ADDLORRYBUS_DEPRECATED" 10 "ADDHAZMAT" 11 "ADDTANK" 12 "ADDTRAM" 13 "ADDWET" 14 "ADDFOG" 15 "ADDRAIN" 16 "ADDSNOW" 17 "ADDTIME" 18 "ADDSECTION" 19 "ADDDISTANCE" 20 "ADDWEIGHT" 21 "ADDEXITL" 22 "ADDEXITR" 23 "ADDLANES" 24 "ADDRADAR" 25 "ADDRAPPEL" 26 "ADDPRIOTURN" 27 "ADDLORRY_EXCEPT" 28 "ADDTRACTOR_OVER" 29 "ADDTEXT" 30 "ADDSIGN" 31 "ADDRAINSNOW" 32 "ADDHUMP" 33 "VADDLORRYBUSTRAILER_DEPRECATED" 34 "VADDLORRYBUS_DEPRECATED" 35 "VADDLORRYTRAILER_DEPRECATED" 36 "ADDLORRYTRAILER_DEPRECATED" 37 "ADDCAMPER" 38 "ADDZONE" 39 "ADDCRASHRISK" 40 "ADDACCIDENT" 41 "ADDJAM" 42 "ADDSMOKE" 43 "ADDOILTRAIL" 44 "ADDGRAVEL" 45 "ADDDIRT" 46 "ADDRWORKSEXIT" 47 "ADDROADDAMAGE" 48 "ADDRWORKSENTRY" 49 "ADDLOWTREE" 50 "ADDRWORKSACCESS" 51 "ADDRUTS" 52 "ADDSOFTSHOULDERCAR" 53 "ADDSOFTSHOULDERLORRY" 54 "VADDSIGN" 55 "VADDCAR" 56 "VADDLORRY" 57 "VADDTRAILER" 58 "VADDCARAVAN" 59 "VADDBUS" 60 "VADDWET" 61 "VADDFOG" 62 "VADDRAIN" 63 "VADDSNOW" 64 "VADDRAINSNOW" 65 "VADDTEXT" 66 "VADDSECTION" 67 "VADDDISTANCE" 68 "VADDWEIGHT" 69 "VADDZONE" 70 "VADDCRASHRISK" 71 "VADDACCIDENT" 72 "VADDJAM" 73 "VADDOILTRAIL" 74 "VADDGRAVEL" 75 "VADDDIRT" 76 "VADDROADDAMAGE" 77 "VADDRUTS" 78 "ADDNOSTOPSHOULDER" 79 "ADDTOWING" 80 "ADDSCHOOL" 81 "ADDNIGHT" 82 "ADDEND" 83 "ADDBEGINS" 84 "ADDWITHIN" 85 "ADDDISTANCEBARS" 86 "ADDMINIMUM" 87 "ADDADVICE" 88 "ADDACCESS" 89 "ADDALLWAY" 90 "ADDBUS_EXCEPT" 91 "ADDEXCEPTDELIVERY" 92 "ADDEXCEPTLOCAL" 93 "ADDFROG" 94 "ADDPRIOTURNL" 95 "ADDPRIOTURNR" 96 "ADDSTART" 97 "ADDSTOPIN" 98 "ADDEXIT" 99 "ADDHAZWATER" 100 "ADDDAY" 101 "ADDSL" 102 "ADDLORRYTRAILER" 103 "ADDLORRYSEMI" 104 "VADDLORRYTRAILER" 105 "VADDLORRYSEMI" 106 "ADDSLOW" 107 "ADDSL5" 108 "ADDSL10" 109 "ADDSL15" 110 "ADDSL20" 111 "ADDSL25" 112 "ADDSL30" 113 "ADDSL35" 114 "ADDSL40" 115 "ADDSL45" 116 "ADDSL50" 117 "ADDSL55" 118 "ADDSL60" 119 "ADDSL65" 120 "ADDSL70" 121 "ADDSL75" 122 "ADDSL80" 123 "ADDSL85" 124 "ADDSL90" 125 "ADDSL95" 126 "ADDSL100" 127 "ADDSL105" 128 "ADDSL110" 129 "ADDSL115" 130 "ADDSL120" 131 "ADDSL125" 132 "ADDSL130" 133 "ADDSL135" 134 "ADDSL140" 135 "ADDSL145" 136 "ADDSL150" 137 "ADDSL155" 138 "ADDSL160" 139 "ADDBIKEROAD" 140 "ADDLORRYTRAILER_EXCEPT" 141 "ADDLORRYSEMI_EXCEPT" 142 "Reserved142" 143 "Reserved143" 144 "Reserved144" 145 "Reserved145" 146 "Reserved146" 147 "Reserved147" 148 "Reserved148" 149 "Reserved149" 150 "Reserved150" 151 "Reserved151" 152 "Reserved152" 153 "Reserved153" 154 "Reserved154" 155 "Reserved155" 156 "Reserved156" 157 "Reserved157" 158 "Reserved158" 159 "Reserved159" 160 "Reserved160" 161 "Reserved161" 162 "Reserved162" 163 "Reserved163" 164 "Reserved164" 165 "Reserved165" 166 "Reserved166" 167 "Reserved167" 168 "Reserved168" 169 "Reserved169" ;
VAL_ 245 VFC_TS14_SupSign4Type 0 "UNKNOWN" 1 "ADDCAR" 2 "ADDLORRY" 3 "ADDTRAILER" 4 "ADDCARAVAN" 5 "ADDBUS" 6 "ADDTRACTOR" 7 "ADDMCYCLE" 8 "ADDLORRYBUSTRAILER_DEPRECATED" 9 "ADDLORRYBUS_DEPRECATED" 10 "ADDHAZMAT" 11 "ADDTANK" 12 "ADDTRAM" 13 "ADDWET" 14 "ADDFOG" 15 "ADDRAIN" 16 "ADDSNOW" 17 "ADDTIME" 18 "ADDSECTION" 19 "ADDDISTANCE" 20 "ADDWEIGHT" 21 "ADDEXITL" 22 "ADDEXITR" 23 "ADDLANES" 24 "ADDRADAR" 25 "ADDRAPPEL" 26 "ADDPRIOTURN" 27 "ADDLORRY_EXCEPT" 28 "ADDTRACTOR_OVER" 29 "ADDTEXT" 30 "ADDSIGN" 31 "ADDRAINSNOW" 32 "ADDHUMP" 33 "VADDLORRYBUSTRAILER_DEPRECATED" 34 "VADDLORRYBUS_DEPRECATED" 35 "VADDLORRYTRAILER_DEPRECATED" 36 "ADDLORRYTRAILER_DEPRECATED" 37 "ADDCAMPER" 38 "ADDZONE" 39 "ADDCRASHRISK" 40 "ADDACCIDENT" 41 "ADDJAM" 42 "ADDSMOKE" 43 "ADDOILTRAIL" 44 "ADDGRAVEL" 45 "ADDDIRT" 46 "ADDRWORKSEXIT" 47 "ADDROADDAMAGE" 48 "ADDRWORKSENTRY" 49 "ADDLOWTREE" 50 "ADDRWORKSACCESS" 51 "ADDRUTS" 52 "ADDSOFTSHOULDERCAR" 53 "ADDSOFTSHOULDERLORRY" 54 "VADDSIGN" 55 "VADDCAR" 56 "VADDLORRY" 57 "VADDTRAILER" 58 "VADDCARAVAN" 59 "VADDBUS" 60 "VADDWET" 61 "VADDFOG" 62 "VADDRAIN" 63 "VADDSNOW" 64 "VADDRAINSNOW" 65 "VADDTEXT" 66 "VADDSECTION" 67 "VADDDISTANCE" 68 "VADDWEIGHT" 69 "VADDZONE" 70 "VADDCRASHRISK" 71 "VADDACCIDENT" 72 "VADDJAM" 73 "VADDOILTRAIL" 74 "VADDGRAVEL" 75 "VADDDIRT" 76 "VADDROADDAMAGE" 77 "VADDRUTS" 78 "ADDNOSTOPSHOULDER" 79 "ADDTOWING" 80 "ADDSCHOOL" 81 "ADDNIGHT" 82 "ADDEND" 83 "ADDBEGINS" 84 "ADDWITHIN" 85 "ADDDISTANCEBARS" 86 "ADDMINIMUM" 87 "ADDADVICE" 88 "ADDACCESS" 89 "ADDALLWAY" 90 "ADDBUS_EXCEPT" 91 "ADDEXCEPTDELIVERY" 92 "ADDEXCEPTLOCAL" 93 "ADDFROG" 94 "ADDPRIOTURNL" 95 "ADDPRIOTURNR" 96 "ADDSTART" 97 "ADDSTOPIN" 98 "ADDEXIT" 99 "ADDHAZWATER" 100 "ADDDAY" 101 "ADDSL" 102 "ADDLORRYTRAILER" 103 "ADDLORRYSEMI" 104 "VADDLORRYTRAILER" 105 "VADDLORRYSEMI" 106 "ADDSLOW" 107 "ADDSL5" 108 "ADDSL10" 109 "ADDSL15" 110 "ADDSL20" 111 "ADDSL25" 112 "ADDSL30" 113 "ADDSL35" 114 "ADDSL40" 115 "ADDSL45" 116 "ADDSL50" 117 "ADDSL55" 118 "ADDSL60" 119 "ADDSL65" 120 "ADDSL70" 121 "ADDSL75" 122 "ADDSL80" 123 "ADDSL85" 124 "ADDSL90" 125 "ADDSL95" 126 "ADDSL100" 127 "ADDSL105" 128 "ADDSL110" 129 "ADDSL115" 130 "ADDSL120" 131 "ADDSL125" 132 "ADDSL130" 133 "ADDSL135" 134 "ADDSL140" 135 "ADDSL145" 136 "ADDSL150" 137 "ADDSL155" 138 "ADDSL160" 139 "ADDBIKEROAD" 140 "ADDLORRYTRAILER_EXCEPT" 141 "ADDLORRYSEMI_EXCEPT" 142 "Reserved142" 143 "Reserved143" 144 "Reserved144" 145 "Reserved145" 146 "Reserved146" 147 "Reserved147" 148 "Reserved148" 149 "Reserved149" 150 "Reserved150" 151 "Reserved151" 152 "Reserved152" 153 "Reserved153" 154 "Reserved154" 155 "Reserved155" 156 "Reserved156" 157 "Reserved157" 158 "Reserved158" 159 "Reserved159" 160 "Reserved160" 161 "Reserved161" 162 "Reserved162" 163 "Reserved163" 164 "Reserved164" 165 "Reserved165" 166 "Reserved166" 167 "Reserved167" 168 "Reserved168" 169 "Reserved169" ;
VAL_ 245 VFC_TS14_SupSign5Type 0 "UNKNOWN" 1 "ADDCAR" 2 "ADDLORRY" 3 "ADDTRAILER" 4 "ADDCARAVAN" 5 "ADDBUS" 6 "ADDTRACTOR" 7 "ADDMCYCLE" 8 "ADDLORRYBUSTRAILER_DEPRECATED" 9 "ADDLORRYBUS_DEPRECATED" 10 "ADDHAZMAT" 11 "ADDTANK" 12 "ADDTRAM" 13 "ADDWET" 14 "ADDFOG" 15 "ADDRAIN" 16 "ADDSNOW" 17 "ADDTIME" 18 "ADDSECTION" 19 "ADDDISTANCE" 20 "ADDWEIGHT" 21 "ADDEXITL" 22 "ADDEXITR" 23 "ADDLANES" 24 "ADDRADAR" 25 "ADDRAPPEL" 26 "ADDPRIOTURN" 27 "ADDLORRY_EXCEPT" 28 "ADDTRACTOR_OVER" 29 "ADDTEXT" 30 "ADDSIGN" 31 "ADDRAINSNOW" 32 "ADDHUMP" 33 "VADDLORRYBUSTRAILER_DEPRECATED" 34 "VADDLORRYBUS_DEPRECATED" 35 "VADDLORRYTRAILER_DEPRECATED" 36 "ADDLORRYTRAILER_DEPRECATED" 37 "ADDCAMPER" 38 "ADDZONE" 39 "ADDCRASHRISK" 40 "ADDACCIDENT" 41 "ADDJAM" 42 "ADDSMOKE" 43 "ADDOILTRAIL" 44 "ADDGRAVEL" 45 "ADDDIRT" 46 "ADDRWORKSEXIT" 47 "ADDROADDAMAGE" 48 "ADDRWORKSENTRY" 49 "ADDLOWTREE" 50 "ADDRWORKSACCESS" 51 "ADDRUTS" 52 "ADDSOFTSHOULDERCAR" 53 "ADDSOFTSHOULDERLORRY" 54 "VADDSIGN" 55 "VADDCAR" 56 "VADDLORRY" 57 "VADDTRAILER" 58 "VADDCARAVAN" 59 "VADDBUS" 60 "VADDWET" 61 "VADDFOG" 62 "VADDRAIN" 63 "VADDSNOW" 64 "VADDRAINSNOW" 65 "VADDTEXT" 66 "VADDSECTION" 67 "VADDDISTANCE" 68 "VADDWEIGHT" 69 "VADDZONE" 70 "VADDCRASHRISK" 71 "VADDACCIDENT" 72 "VADDJAM" 73 "VADDOILTRAIL" 74 "VADDGRAVEL" 75 "VADDDIRT" 76 "VADDROADDAMAGE" 77 "VADDRUTS" 78 "ADDNOSTOPSHOULDER" 79 "ADDTOWING" 80 "ADDSCHOOL" 81 "ADDNIGHT" 82 "ADDEND" 83 "ADDBEGINS" 84 "ADDWITHIN" 85 "ADDDISTANCEBARS" 86 "ADDMINIMUM" 87 "ADDADVICE" 88 "ADDACCESS" 89 "ADDALLWAY" 90 "ADDBUS_EXCEPT" 91 "ADDEXCEPTDELIVERY" 92 "ADDEXCEPTLOCAL" 93 "ADDFROG" 94 "ADDPRIOTURNL" 95 "ADDPRIOTURNR" 96 "ADDSTART" 97 "ADDSTOPIN" 98 "ADDEXIT" 99 "ADDHAZWATER" 100 "ADDDAY" 101 "ADDSL" 102 "ADDLORRYTRAILER" 103 "ADDLORRYSEMI" 104 "VADDLORRYTRAILER" 105 "VADDLORRYSEMI" 106 "ADDSLOW" 107 "ADDSL5" 108 "ADDSL10" 109 "ADDSL15" 110 "ADDSL20" 111 "ADDSL25" 112 "ADDSL30" 113 "ADDSL35" 114 "ADDSL40" 115 "ADDSL45" 116 "ADDSL50" 117 "ADDSL55" 118 "ADDSL60" 119 "ADDSL65" 120 "ADDSL70" 121 "ADDSL75" 122 "ADDSL80" 123 "ADDSL85" 124 "ADDSL90" 125 "ADDSL95" 126 "ADDSL100" 127 "ADDSL105" 128 "ADDSL110" 129 "ADDSL115" 130 "ADDSL120" 131 "ADDSL125" 132 "ADDSL130" 133 "ADDSL135" 134 "ADDSL140" 135 "ADDSL145" 136 "ADDSL150" 137 "ADDSL155" 138 "ADDSL160" 139 "ADDBIKEROAD" 140 "ADDLORRYTRAILER_EXCEPT" 141 "ADDLORRYSEMI_EXCEPT" 142 "Reserved142" 143 "Reserved143" 144 "Reserved144" 145 "Reserved145" 146 "Reserved146" 147 "Reserved147" 148 "Reserved148" 149 "Reserved149" 150 "Reserved150" 151 "Reserved151" 152 "Reserved152" 153 "Reserved153" 154 "Reserved154" 155 "Reserved155" 156 "Reserved156" 157 "Reserved157" 158 "Reserved158" 159 "Reserved159" 160 "Reserved160" 161 "Reserved161" 162 "Reserved162" 163 "Reserved163" 164 "Reserved164" 165 "Reserved165" 166 "Reserved166" 167 "Reserved167" 168 "Reserved168" 169 "Reserved169" ;
VAL_ 245 VFC_TS15_Type 0 "UNKNOWN" 1 "SL5" 2 "SL10" 3 "SL15" 4 "SL20" 5 "SL25" 6 "SL30" 7 "SL35" 8 "SL40" 9 "SL45" 10 "SL50" 11 "SL55" 12 "SL60" 13 "SL65" 14 "SL70" 15 "SL75" 16 "SL80" 17 "SL85" 18 "SL90" 19 "SL95" 20 "SL100" 21 "SL105" 22 "SL110" 23 "SL115" 24 "SL120" 25 "SL125" 26 "SL130" 27 "SL135" 28 "SL140" 29 "SL145" 30 "SL150" 31 "SL155" 32 "SL160" 33 "OP" 34 "OL" 35 "ESL" 36 "EOP" 37 "EOL" 38 "EA" 39 "VSL5" 40 "VSL10" 41 "VSL15" 42 "VSL20" 43 "VSL25" 44 "VSL30" 45 "VSL35" 46 "VSL40" 47 "VSL45" 48 "VSL50" 49 "VSL55" 50 "VSL60" 51 "VSL65" 52 "VSL70" 53 "VSL75" 54 "VSL80" 55 "VSL85" 56 "VSL90" 57 "VSL95" 58 "VSL100" 59 "VSL105" 60 "VSL110" 61 "VSL115" 62 "VSL120" 63 "VSL125" 64 "VSL130" 65 "VSL135" 66 "VSL140" 67 "VSL145" 68 "VSL150" 69 "VSL155" 70 "VSL160" 71 "VOP" 72 "VOL" 73 "VESL" 74 "VEOP" 75 "VEOL" 76 "VEA" 77 "NOENTRY" 78 "NOALL" 79 "NOCAR" 80 "NOLORRY" 81 "NOHAZMAT" 82 "NOBIKE" 83 "NOPED" 84 "NOCARBIKE" 85 "NOTWOWAY" 86 "WEIGHT" 87 "HEIGHT" 88 "WIDTH" 89 "LENGTH" 90 "PRIOCROSS" 91 "GIVEWAY" 92 "PRIOCROSSYIELDTORIGHT" 93 "WARNDANGER" 94 "WARNCURVEL" 95 "WARNCURVER" 96 "WARNDCURVEL" 97 "WARNDCURVER" 98 "WARNTRAIN" 99 "WARNJAM" 100 "WARNANIMAL_DEPRECATED" 101 "WARNRWORKS" 102 "WARNSLOPED" 103 "WARNSLOPEU" 104 "PRIOSTREET" 105 "EPRIOSTREET" 106 "STOP" 107 "ASL" 108 "EASL" 109 "MSL" 110 "EMSL" 111 "MLC" 112 "WBDIAGL" 113 "WBDIAGR" 114 "WBROUND" 115 "NOLTURN" 116 "NORTURN" 117 "NOUTURN" 118 "NOPARK" 119 "NOSTOP" 120 "SMOG" 121 "UMWELT" 122 "EUMWELT" 123 "DOUANE" 124 "FWAY" 125 "EFWAY" 126 "HWAY" 127 "EHWAY" 128 "NORIDER" 129 "WARNCONST" 130 "WARNCONSTL" 131 "WARNCONSTR" 132 "WARNPED" 133 "WARNKIDS" 134 "WARNBIKE" 135 "WARNSKID" 136 "ZEBRA" 137 "ONEWAYS" 138 "ONEWAYU" 139 "SLOWDOWN" 140 "NOCARRIAGE" 141 "NOLORRYTRAILER" 142 "NOBUS" 143 "NOTRACTOR" 144 "LORRYDIST" 145 "CARDIST" 146 "WARNROUND" 147 "WARNWILDANIMAL" 148 "WARNCATTLE" 149 "WARNFROG" 150 "WARNBUS" 151 "WARNWIND" 152 "WARNSNOW" 153 "WARNPCROSS" 154 "WARNHUMP" 155 "WARNROCK" 156 "WARNLOWTREE" 157 "WARNGRAVEL" 158 "WARNTWOWAY" 159 "WARNLIGHTS" 160 "WARNPLANE" 161 "VNOENTRY" 162 "VNOALL" 163 "VNOCAR" 164 "VNOLORRY" 165 "VNOCARBIKE" 166 "VWEIGHT" 167 "VHEIGHT" 168 "VWIDTH" 169 "VLENGTH" 170 "VWARNDANGER" 171 "VWARNJAM" 172 "VWARNRWORKS" 173 "VWARNSKID" 174 "VASL" 175 "VEASL" 176 "VNOLORRYTRAILER" 177 "VNOBUS" 178 "VLORRYDIST" 179 "VCARDIST" 180 "VWARNSNOW" 181 "VWARNHUMP" 182 "VWARNGRAVEL" 183 "CALM" 184 "ECALM" 185 "TWN" 186 "ETWN" 187 "DEADEND" 188 "AXLEWEIGHT" 189 "WARNRIDER" 190 "WARNDRAWBRIDGE" 191 "WARNPIER" 192 "TRINATURE" 193 "VWARNCONST" 194 "VWARNCONSTL" 195 "VWARNCONSTR" 196 "VWARNCURVEL" 197 "VWARNCURVER" 198 "VWARNDCURVEL" 199 "VWARNDCURVER" 200 "VWARNLIGHTS" 201 "WBBENTLEFT" 202 "WBBENTLEFTRIGHT" 203 "WBBENTRIGHT" 204 "WBDIAGLR" 205 "WBLEFT" 206 "WBRIGHT" 207 "WBUP" 208 "WBUPLEFT" 209 "WBUPRIGHT" 210 "WBHAZWATER" 211 "NOHAZWATER" 212 "SCHOOL" 213 "ESCHOOL" 214 "HAZMAT" 215 "EMERGENCYBAY" 216 "ENDOFLANEL" 217 "ENDOFLANER" 218 "ENOPARK" 219 "EONEWAY" 220 "EPARK" 221 "ETOLL" 222 "NOPARKL" 223 "NOPARKLR" 224 "NOPARKR" 225 "NOSTOPL" 226 "NOSTOPLR" 227 "NOSTOPR" 228 "NOTURNONRED" 229 "ONEWAYL" 230 "ONEWAYR" 231 "PARK" 232 "PRIOCROSSL" 233 "PRIOCROSSR" 234 "TOLL" 235 "TUNNEL" 236 "TWOWAY" 237 "WARNCROSS" 238 "WARNCROSSL" 239 "WARNCROSSLR" 240 "WARNCROSSR" 241 "WARNCROSSRL" 242 "WARNCROSST" 243 "WARNGIVEWAYAHEAD" 244 "WARNSLAHEAD" 245 "WARNSTOPAHEAD" 246 "WBBUS" 247 "WRONGWAY" 248 "HAZWATER" 249 "GIVEWAYROUND" 250 "WARNWINDINGL" 251 "WARNWINDINGR" 252 "WARNHAIRPINL" 253 "WARNHAIRPINR" 254 "WARNPEDBIKE" 255 "WARNCROSSY" 256 "WARNBRANCHL" 257 "WARNBRANCHR" 258 "WARNAXLEWEIGHT" 259 "WARNWEIGHT" 260 "WARNHEIGHT" 261 "WARNLENGTH" 262 "WARNWIDTH" 263 "WARNBLACKSPOT" 264 "WARNMERGEL" 265 "WARNMERGER" 266 "WARNTUNNEL" 267 "WARNTRACTOR" 268 "WARNRWORKSVEHICLE" 269 "WARNNARROWBRIDGE" 270 "WARNFLAGGER" 271 "LANES" 272 "LANESHIFTL" 273 "LANESHIFTR" 274 "NEWLANEL" 275 "NEWLANER" 276 "RIGHTTURNONRED" 277 "BORDERLIMIT" 278 "EMBEDDEDRAIN" 279 "VWARNWEIGHT" 280 "VWARNHEIGHT" 281 "VWARNLENGTH" 282 "VWARNWIDTH" 283 "VENDOFLANEL" 284 "VENDOFLANER" 285 "VLANES" 286 "VLANESHIFTL" 287 "VLANESHIFTR" 288 "VNEWLANEL" 289 "VNEWLANER" 290 "NOUP" 291 "VOFF" 292 "ASL5" 293 "ASL10" 294 "ASL15" 295 "ASL20" 296 "ASL25" 297 "ASL30" 298 "ASL35" 299 "ASL40" 300 "ASL45" 301 "ASL50" 302 "ASL55" 303 "ASL60" 304 "ASL65" 305 "ASL70" 306 "ASL75" 307 "ASL80" 308 "ASL85" 309 "ASL90" 310 "ASL95" 311 "ASL100" 312 "ASL105" 313 "ASL110" 314 "ASL115" 315 "ASL120" 316 "ASL125" 317 "ASL130" 318 "ASL135" 319 "ASL140" 320 "ASL145" 321 "ASL150" 322 "ASL155" 323 "ASL160" 324 "VASL5" 325 "VASL10" 326 "VASL15" 327 "VASL20" 328 "VASL25" 329 "VASL30" 330 "VASL35" 331 "VASL40" 332 "VASL45" 333 "VASL50" 334 "VASL55" 335 "VASL60" 336 "VASL65" 337 "VASL70" 338 "VASL75" 339 "VASL80" 340 "VASL85" 341 "VASL90" 342 "VASL95" 343 "VASL100" 344 "VASL105" 345 "VASL110" 346 "VASL115" 347 "VASL120" 348 "VASL125" 349 "VASL130" 350 "VASL135" 351 "VASL140" 352 "VASL145" 353 "VASL150" 354 "VASL155" 355 "VASL160" 356 "WARNTRAINGATED" 357 "KEEPRIGHTCAR" 358 "ASLCURVE5" 359 "ASLCURVE10" 360 "ASLCURVE15" 361 "ASLCURVE20" 362 "ASLCURVE25" 363 "ASLCURVE30" 364 "ASLCURVE35" 365 "ASLCURVE40" 366 "ASLCURVE45" 367 "ASLCURVE50" 368 "ASLCURVE55" 369 "ASLCURVE60" 370 "ASLCURVE65" 371 "ASLCURVE70" 372 "ASLCURVE75" 373 "ASLCURVE80" 374 "ASLCURVE85" 375 "ASLCURVE90" 376 "ASLCURVE95" 377 "ASLCURVE100" 378 "ASLCURVE105" 379 "ASLCURVE110" 380 "ASLCURVE115" 381 "ASLCURVE120" 382 "ASLCURVE125" 383 "ASLCURVE130" 384 "ASLCURVE135" 385 "ASLCURVE140" 386 "ASLCURVE145" 387 "ASLCURVE150" 388 "ASLCURVE155" 389 "ASLCURVE160" 390 "KIDS" 391 "EKIDS" 392 "BIKEROAD" 393 "EBIKEROAD" 394 "PEDSTREET" 395 "EPEDSTREET" 396 "PEDBIKESTREET" 397 "EPEDBIKESTREET" 398 "EWARNKIDS" 399 "CALM20" 400 "CALM30" 401 "ECALM20" 402 "ECALM30" 403 "FWAYGREEN" 404 "TWN40" 405 "TWN50" 406 "TWN60" 407 "TWN70" 408 "ETWN40" 409 "ETWN50" 410 "ETWN60" 411 "ETWN70" 412 "WBBIKE" 413 "EWBBIKE" 414 "WBPED" 415 "EWBPED" 416 "WBPEDBIKESEP" 417 "EWBPEDBIKESEP" 418 "WBPEDBIKESHARED" 419 "EWBPEDBIKESHARED" 420 "EFWAYGREEN" 421 "Reserved0421" 422 "Reserved0422" 423 "Reserved0423" 424 "Reserved0424" 425 "Reserved0425" 426 "Reserved0426" 427 "Reserved0427" 428 "Reserved0428" 429 "Reserved0429" 430 "Reserved0430" 431 "Reserved0431" 432 "Reserved0432" 433 "Reserved0433" 434 "Reserved0434" 435 "Reserved0435" 436 "Reserved0436" 437 "Reserved0437" 438 "Reserved0438" 439 "Reserved0439" 440 "Reserved0440" 441 "Reserved0441" 442 "Reserved0442" 443 "Reserved0443" 444 "Reserved0444" 445 "Reserved0445" 446 "Reserved0446" 447 "Reserved0447" 448 "Reserved0448" 449 "Reserved0449" ;
VAL_ 245 VFC_TS15_EmbeddedInfo 0 "Unknown" 1 "Not Embedded" 2 "Border Limit" 3 "Multi Lane" 4 "Rain" 5 "Vehicle Type" 6 "Plate" 7 "Error Value" 8 "Vehicle Sticker" 9 "Reserved09" 10 "Reserved10" 11 "Reserved11" 12 "Reserved12" 13 "Reserved13" 14 "Reserved14" 15 "Reserved15" ;
VAL_ 245 VFC_TS15_ValidTimeRange1Start 127 "Unknown" ;
VAL_ 245 VFC_TS15_ValidTimeRange1End 127 "Unknown" ;
VAL_ 245 VFC_TS15_ValidTimeRange2Start 127 "Unknown" ;
VAL_ 245 VFC_TS15_ValidTimeRange2End 127 "Unknown" ;
VAL_ 245 VFC_TS15_ValidInDistUnit 0 "Unknown" ;
VAL_ 245 VFC_TS15_ValidSectionUnit 0 "Unknown" 1 "Meter" 2 "Kilometer" 3 "Foot" 4 "Yard" 5 "Mile" 6 "Reserved6" 7 "Reserved7" ;
VAL_ 245 VFC_TS15_SupSign0Type 0 "UNKNOWN" 1 "ADDCAR" 2 "ADDLORRY" 3 "ADDTRAILER" 4 "ADDCARAVAN" 5 "ADDBUS" 6 "ADDTRACTOR" 7 "ADDMCYCLE" 8 "ADDLORRYBUSTRAILER_DEPRECATED" 9 "ADDLORRYBUS_DEPRECATED" 10 "ADDHAZMAT" 11 "ADDTANK" 12 "ADDTRAM" 13 "ADDWET" 14 "ADDFOG" 15 "ADDRAIN" 16 "ADDSNOW" 17 "ADDTIME" 18 "ADDSECTION" 19 "ADDDISTANCE" 20 "ADDWEIGHT" 21 "ADDEXITL" 22 "ADDEXITR" 23 "ADDLANES" 24 "ADDRADAR" 25 "ADDRAPPEL" 26 "ADDPRIOTURN" 27 "ADDLORRY_EXCEPT" 28 "ADDTRACTOR_OVER" 29 "ADDTEXT" 30 "ADDSIGN" 31 "ADDRAINSNOW" 32 "ADDHUMP" 33 "VADDLORRYBUSTRAILER_DEPRECATED" 34 "VADDLORRYBUS_DEPRECATED" 35 "VADDLORRYTRAILER_DEPRECATED" 36 "ADDLORRYTRAILER_DEPRECATED" 37 "ADDCAMPER" 38 "ADDZONE" 39 "ADDCRASHRISK" 40 "ADDACCIDENT" 41 "ADDJAM" 42 "ADDSMOKE" 43 "ADDOILTRAIL" 44 "ADDGRAVEL" 45 "ADDDIRT" 46 "ADDRWORKSEXIT" 47 "ADDROADDAMAGE" 48 "ADDRWORKSENTRY" 49 "ADDLOWTREE" 50 "ADDRWORKSACCESS" 51 "ADDRUTS" 52 "ADDSOFTSHOULDERCAR" 53 "ADDSOFTSHOULDERLORRY" 54 "VADDSIGN" 55 "VADDCAR" 56 "VADDLORRY" 57 "VADDTRAILER" 58 "VADDCARAVAN" 59 "VADDBUS" 60 "VADDWET" 61 "VADDFOG" 62 "VADDRAIN" 63 "VADDSNOW" 64 "VADDRAINSNOW" 65 "VADDTEXT" 66 "VADDSECTION" 67 "VADDDISTANCE" 68 "VADDWEIGHT" 69 "VADDZONE" 70 "VADDCRASHRISK" 71 "VADDACCIDENT" 72 "VADDJAM" 73 "VADDOILTRAIL" 74 "VADDGRAVEL" 75 "VADDDIRT" 76 "VADDROADDAMAGE" 77 "VADDRUTS" 78 "ADDNOSTOPSHOULDER" 79 "ADDTOWING" 80 "ADDSCHOOL" 81 "ADDNIGHT" 82 "ADDEND" 83 "ADDBEGINS" 84 "ADDWITHIN" 85 "ADDDISTANCEBARS" 86 "ADDMINIMUM" 87 "ADDADVICE" 88 "ADDACCESS" 89 "ADDALLWAY" 90 "ADDBUS_EXCEPT" 91 "ADDEXCEPTDELIVERY" 92 "ADDEXCEPTLOCAL" 93 "ADDFROG" 94 "ADDPRIOTURNL" 95 "ADDPRIOTURNR" 96 "ADDSTART" 97 "ADDSTOPIN" 98 "ADDEXIT" 99 "ADDHAZWATER" 100 "ADDDAY" 101 "ADDSL" 102 "ADDLORRYTRAILER" 103 "ADDLORRYSEMI" 104 "VADDLORRYTRAILER" 105 "VADDLORRYSEMI" 106 "ADDSLOW" 107 "ADDSL5" 108 "ADDSL10" 109 "ADDSL15" 110 "ADDSL20" 111 "ADDSL25" 112 "ADDSL30" 113 "ADDSL35" 114 "ADDSL40" 115 "ADDSL45" 116 "ADDSL50" 117 "ADDSL55" 118 "ADDSL60" 119 "ADDSL65" 120 "ADDSL70" 121 "ADDSL75" 122 "ADDSL80" 123 "ADDSL85" 124 "ADDSL90" 125 "ADDSL95" 126 "ADDSL100" 127 "ADDSL105" 128 "ADDSL110" 129 "ADDSL115" 130 "ADDSL120" 131 "ADDSL125" 132 "ADDSL130" 133 "ADDSL135" 134 "ADDSL140" 135 "ADDSL145" 136 "ADDSL150" 137 "ADDSL155" 138 "ADDSL160" 139 "ADDBIKEROAD" 140 "ADDLORRYTRAILER_EXCEPT" 141 "ADDLORRYSEMI_EXCEPT" 142 "Reserved142" 143 "Reserved143" 144 "Reserved144" 145 "Reserved145" 146 "Reserved146" 147 "Reserved147" 148 "Reserved148" 149 "Reserved149" 150 "Reserved150" 151 "Reserved151" 152 "Reserved152" 153 "Reserved153" 154 "Reserved154" 155 "Reserved155" 156 "Reserved156" 157 "Reserved157" 158 "Reserved158" 159 "Reserved159" 160 "Reserved160" 161 "Reserved161" 162 "Reserved162" 163 "Reserved163" 164 "Reserved164" 165 "Reserved165" 166 "Reserved166" 167 "Reserved167" 168 "Reserved168" 169 "Reserved169" ;
VAL_ 245 VFC_TS15_SupSign1Type 0 "UNKNOWN" 1 "ADDCAR" 2 "ADDLORRY" 3 "ADDTRAILER" 4 "ADDCARAVAN" 5 "ADDBUS" 6 "ADDTRACTOR" 7 "ADDMCYCLE" 8 "ADDLORRYBUSTRAILER_DEPRECATED" 9 "ADDLORRYBUS_DEPRECATED" 10 "ADDHAZMAT" 11 "ADDTANK" 12 "ADDTRAM" 13 "ADDWET" 14 "ADDFOG" 15 "ADDRAIN" 16 "ADDSNOW" 17 "ADDTIME" 18 "ADDSECTION" 19 "ADDDISTANCE" 20 "ADDWEIGHT" 21 "ADDEXITL" 22 "ADDEXITR" 23 "ADDLANES" 24 "ADDRADAR" 25 "ADDRAPPEL" 26 "ADDPRIOTURN" 27 "ADDLORRY_EXCEPT" 28 "ADDTRACTOR_OVER" 29 "ADDTEXT" 30 "ADDSIGN" 31 "ADDRAINSNOW" 32 "ADDHUMP" 33 "VADDLORRYBUSTRAILER_DEPRECATED" 34 "VADDLORRYBUS_DEPRECATED" 35 "VADDLORRYTRAILER_DEPRECATED" 36 "ADDLORRYTRAILER_DEPRECATED" 37 "ADDCAMPER" 38 "ADDZONE" 39 "ADDCRASHRISK" 40 "ADDACCIDENT" 41 "ADDJAM" 42 "ADDSMOKE" 43 "ADDOILTRAIL" 44 "ADDGRAVEL" 45 "ADDDIRT" 46 "ADDRWORKSEXIT" 47 "ADDROADDAMAGE" 48 "ADDRWORKSENTRY" 49 "ADDLOWTREE" 50 "ADDRWORKSACCESS" 51 "ADDRUTS" 52 "ADDSOFTSHOULDERCAR" 53 "ADDSOFTSHOULDERLORRY" 54 "VADDSIGN" 55 "VADDCAR" 56 "VADDLORRY" 57 "VADDTRAILER" 58 "VADDCARAVAN" 59 "VADDBUS" 60 "VADDWET" 61 "VADDFOG" 62 "VADDRAIN" 63 "VADDSNOW" 64 "VADDRAINSNOW" 65 "VADDTEXT" 66 "VADDSECTION" 67 "VADDDISTANCE" 68 "VADDWEIGHT" 69 "VADDZONE" 70 "VADDCRASHRISK" 71 "VADDACCIDENT" 72 "VADDJAM" 73 "VADDOILTRAIL" 74 "VADDGRAVEL" 75 "VADDDIRT" 76 "VADDROADDAMAGE" 77 "VADDRUTS" 78 "ADDNOSTOPSHOULDER" 79 "ADDTOWING" 80 "ADDSCHOOL" 81 "ADDNIGHT" 82 "ADDEND" 83 "ADDBEGINS" 84 "ADDWITHIN" 85 "ADDDISTANCEBARS" 86 "ADDMINIMUM" 87 "ADDADVICE" 88 "ADDACCESS" 89 "ADDALLWAY" 90 "ADDBUS_EXCEPT" 91 "ADDEXCEPTDELIVERY" 92 "ADDEXCEPTLOCAL" 93 "ADDFROG" 94 "ADDPRIOTURNL" 95 "ADDPRIOTURNR" 96 "ADDSTART" 97 "ADDSTOPIN" 98 "ADDEXIT" 99 "ADDHAZWATER" 100 "ADDDAY" 101 "ADDSL" 102 "ADDLORRYTRAILER" 103 "ADDLORRYSEMI" 104 "VADDLORRYTRAILER" 105 "VADDLORRYSEMI" 106 "ADDSLOW" 107 "ADDSL5" 108 "ADDSL10" 109 "ADDSL15" 110 "ADDSL20" 111 "ADDSL25" 112 "ADDSL30" 113 "ADDSL35" 114 "ADDSL40" 115 "ADDSL45" 116 "ADDSL50" 117 "ADDSL55" 118 "ADDSL60" 119 "ADDSL65" 120 "ADDSL70" 121 "ADDSL75" 122 "ADDSL80" 123 "ADDSL85" 124 "ADDSL90" 125 "ADDSL95" 126 "ADDSL100" 127 "ADDSL105" 128 "ADDSL110" 129 "ADDSL115" 130 "ADDSL120" 131 "ADDSL125" 132 "ADDSL130" 133 "ADDSL135" 134 "ADDSL140" 135 "ADDSL145" 136 "ADDSL150" 137 "ADDSL155" 138 "ADDSL160" 139 "ADDBIKEROAD" 140 "ADDLORRYTRAILER_EXCEPT" 141 "ADDLORRYSEMI_EXCEPT" 142 "Reserved142" 143 "Reserved143" 144 "Reserved144" 145 "Reserved145" 146 "Reserved146" 147 "Reserved147" 148 "Reserved148" 149 "Reserved149" 150 "Reserved150" 151 "Reserved151" 152 "Reserved152" 153 "Reserved153" 154 "Reserved154" 155 "Reserved155" 156 "Reserved156" 157 "Reserved157" 158 "Reserved158" 159 "Reserved159" 160 "Reserved160" 161 "Reserved161" 162 "Reserved162" 163 "Reserved163" 164 "Reserved164" 165 "Reserved165" 166 "Reserved166" 167 "Reserved167" 168 "Reserved168" 169 "Reserved169" ;
VAL_ 245 VFC_TS15_SupSign2Type 0 "UNKNOWN" 1 "ADDCAR" 2 "ADDLORRY" 3 "ADDTRAILER" 4 "ADDCARAVAN" 5 "ADDBUS" 6 "ADDTRACTOR" 7 "ADDMCYCLE" 8 "ADDLORRYBUSTRAILER_DEPRECATED" 9 "ADDLORRYBUS_DEPRECATED" 10 "ADDHAZMAT" 11 "ADDTANK" 12 "ADDTRAM" 13 "ADDWET" 14 "ADDFOG" 15 "ADDRAIN" 16 "ADDSNOW" 17 "ADDTIME" 18 "ADDSECTION" 19 "ADDDISTANCE" 20 "ADDWEIGHT" 21 "ADDEXITL" 22 "ADDEXITR" 23 "ADDLANES" 24 "ADDRADAR" 25 "ADDRAPPEL" 26 "ADDPRIOTURN" 27 "ADDLORRY_EXCEPT" 28 "ADDTRACTOR_OVER" 29 "ADDTEXT" 30 "ADDSIGN" 31 "ADDRAINSNOW" 32 "ADDHUMP" 33 "VADDLORRYBUSTRAILER_DEPRECATED" 34 "VADDLORRYBUS_DEPRECATED" 35 "VADDLORRYTRAILER_DEPRECATED" 36 "ADDLORRYTRAILER_DEPRECATED" 37 "ADDCAMPER" 38 "ADDZONE" 39 "ADDCRASHRISK" 40 "ADDACCIDENT" 41 "ADDJAM" 42 "ADDSMOKE" 43 "ADDOILTRAIL" 44 "ADDGRAVEL" 45 "ADDDIRT" 46 "ADDRWORKSEXIT" 47 "ADDROADDAMAGE" 48 "ADDRWORKSENTRY" 49 "ADDLOWTREE" 50 "ADDRWORKSACCESS" 51 "ADDRUTS" 52 "ADDSOFTSHOULDERCAR" 53 "ADDSOFTSHOULDERLORRY" 54 "VADDSIGN" 55 "VADDCAR" 56 "VADDLORRY" 57 "VADDTRAILER" 58 "VADDCARAVAN" 59 "VADDBUS" 60 "VADDWET" 61 "VADDFOG" 62 "VADDRAIN" 63 "VADDSNOW" 64 "VADDRAINSNOW" 65 "VADDTEXT" 66 "VADDSECTION" 67 "VADDDISTANCE" 68 "VADDWEIGHT" 69 "VADDZONE" 70 "VADDCRASHRISK" 71 "VADDACCIDENT" 72 "VADDJAM" 73 "VADDOILTRAIL" 74 "VADDGRAVEL" 75 "VADDDIRT" 76 "VADDROADDAMAGE" 77 "VADDRUTS" 78 "ADDNOSTOPSHOULDER" 79 "ADDTOWING" 80 "ADDSCHOOL" 81 "ADDNIGHT" 82 "ADDEND" 83 "ADDBEGINS" 84 "ADDWITHIN" 85 "ADDDISTANCEBARS" 86 "ADDMINIMUM" 87 "ADDADVICE" 88 "ADDACCESS" 89 "ADDALLWAY" 90 "ADDBUS_EXCEPT" 91 "ADDEXCEPTDELIVERY" 92 "ADDEXCEPTLOCAL" 93 "ADDFROG" 94 "ADDPRIOTURNL" 95 "ADDPRIOTURNR" 96 "ADDSTART" 97 "ADDSTOPIN" 98 "ADDEXIT" 99 "ADDHAZWATER" 100 "ADDDAY" 101 "ADDSL" 102 "ADDLORRYTRAILER" 103 "ADDLORRYSEMI" 104 "VADDLORRYTRAILER" 105 "VADDLORRYSEMI" 106 "ADDSLOW" 107 "ADDSL5" 108 "ADDSL10" 109 "ADDSL15" 110 "ADDSL20" 111 "ADDSL25" 112 "ADDSL30" 113 "ADDSL35" 114 "ADDSL40" 115 "ADDSL45" 116 "ADDSL50" 117 "ADDSL55" 118 "ADDSL60" 119 "ADDSL65" 120 "ADDSL70" 121 "ADDSL75" 122 "ADDSL80" 123 "ADDSL85" 124 "ADDSL90" 125 "ADDSL95" 126 "ADDSL100" 127 "ADDSL105" 128 "ADDSL110" 129 "ADDSL115" 130 "ADDSL120" 131 "ADDSL125" 132 "ADDSL130" 133 "ADDSL135" 134 "ADDSL140" 135 "ADDSL145" 136 "ADDSL150" 137 "ADDSL155" 138 "ADDSL160" 139 "ADDBIKEROAD" 140 "ADDLORRYTRAILER_EXCEPT" 141 "ADDLORRYSEMI_EXCEPT" 142 "Reserved142" 143 "Reserved143" 144 "Reserved144" 145 "Reserved145" 146 "Reserved146" 147 "Reserved147" 148 "Reserved148" 149 "Reserved149" 150 "Reserved150" 151 "Reserved151" 152 "Reserved152" 153 "Reserved153" 154 "Reserved154" 155 "Reserved155" 156 "Reserved156" 157 "Reserved157" 158 "Reserved158" 159 "Reserved159" 160 "Reserved160" 161 "Reserved161" 162 "Reserved162" 163 "Reserved163" 164 "Reserved164" 165 "Reserved165" 166 "Reserved166" 167 "Reserved167" 168 "Reserved168" 169 "Reserved169" ;
VAL_ 245 VFC_TS15_SupSign3Type 0 "UNKNOWN" 1 "ADDCAR" 2 "ADDLORRY" 3 "ADDTRAILER" 4 "ADDCARAVAN" 5 "ADDBUS" 6 "ADDTRACTOR" 7 "ADDMCYCLE" 8 "ADDLORRYBUSTRAILER_DEPRECATED" 9 "ADDLORRYBUS_DEPRECATED" 10 "ADDHAZMAT" 11 "ADDTANK" 12 "ADDTRAM" 13 "ADDWET" 14 "ADDFOG" 15 "ADDRAIN" 16 "ADDSNOW" 17 "ADDTIME" 18 "ADDSECTION" 19 "ADDDISTANCE" 20 "ADDWEIGHT" 21 "ADDEXITL" 22 "ADDEXITR" 23 "ADDLANES" 24 "ADDRADAR" 25 "ADDRAPPEL" 26 "ADDPRIOTURN" 27 "ADDLORRY_EXCEPT" 28 "ADDTRACTOR_OVER" 29 "ADDTEXT" 30 "ADDSIGN" 31 "ADDRAINSNOW" 32 "ADDHUMP" 33 "VADDLORRYBUSTRAILER_DEPRECATED" 34 "VADDLORRYBUS_DEPRECATED" 35 "VADDLORRYTRAILER_DEPRECATED" 36 "ADDLORRYTRAILER_DEPRECATED" 37 "ADDCAMPER" 38 "ADDZONE" 39 "ADDCRASHRISK" 40 "ADDACCIDENT" 41 "ADDJAM" 42 "ADDSMOKE" 43 "ADDOILTRAIL" 44 "ADDGRAVEL" 45 "ADDDIRT" 46 "ADDRWORKSEXIT" 47 "ADDROADDAMAGE" 48 "ADDRWORKSENTRY" 49 "ADDLOWTREE" 50 "ADDRWORKSACCESS" 51 "ADDRUTS" 52 "ADDSOFTSHOULDERCAR" 53 "ADDSOFTSHOULDERLORRY" 54 "VADDSIGN" 55 "VADDCAR" 56 "VADDLORRY" 57 "VADDTRAILER" 58 "VADDCARAVAN" 59 "VADDBUS" 60 "VADDWET" 61 "VADDFOG" 62 "VADDRAIN" 63 "VADDSNOW" 64 "VADDRAINSNOW" 65 "VADDTEXT" 66 "VADDSECTION" 67 "VADDDISTANCE" 68 "VADDWEIGHT" 69 "VADDZONE" 70 "VADDCRASHRISK" 71 "VADDACCIDENT" 72 "VADDJAM" 73 "VADDOILTRAIL" 74 "VADDGRAVEL" 75 "VADDDIRT" 76 "VADDROADDAMAGE" 77 "VADDRUTS" 78 "ADDNOSTOPSHOULDER" 79 "ADDTOWING" 80 "ADDSCHOOL" 81 "ADDNIGHT" 82 "ADDEND" 83 "ADDBEGINS" 84 "ADDWITHIN" 85 "ADDDISTANCEBARS" 86 "ADDMINIMUM" 87 "ADDADVICE" 88 "ADDACCESS" 89 "ADDALLWAY" 90 "ADDBUS_EXCEPT" 91 "ADDEXCEPTDELIVERY" 92 "ADDEXCEPTLOCAL" 93 "ADDFROG" 94 "ADDPRIOTURNL" 95 "ADDPRIOTURNR" 96 "ADDSTART" 97 "ADDSTOPIN" 98 "ADDEXIT" 99 "ADDHAZWATER" 100 "ADDDAY" 101 "ADDSL" 102 "ADDLORRYTRAILER" 103 "ADDLORRYSEMI" 104 "VADDLORRYTRAILER" 105 "VADDLORRYSEMI" 106 "ADDSLOW" 107 "ADDSL5" 108 "ADDSL10" 109 "ADDSL15" 110 "ADDSL20" 111 "ADDSL25" 112 "ADDSL30" 113 "ADDSL35" 114 "ADDSL40" 115 "ADDSL45" 116 "ADDSL50" 117 "ADDSL55" 118 "ADDSL60" 119 "ADDSL65" 120 "ADDSL70" 121 "ADDSL75" 122 "ADDSL80" 123 "ADDSL85" 124 "ADDSL90" 125 "ADDSL95" 126 "ADDSL100" 127 "ADDSL105" 128 "ADDSL110" 129 "ADDSL115" 130 "ADDSL120" 131 "ADDSL125" 132 "ADDSL130" 133 "ADDSL135" 134 "ADDSL140" 135 "ADDSL145" 136 "ADDSL150" 137 "ADDSL155" 138 "ADDSL160" 139 "ADDBIKEROAD" 140 "ADDLORRYTRAILER_EXCEPT" 141 "ADDLORRYSEMI_EXCEPT" 142 "Reserved142" 143 "Reserved143" 144 "Reserved144" 145 "Reserved145" 146 "Reserved146" 147 "Reserved147" 148 "Reserved148" 149 "Reserved149" 150 "Reserved150" 151 "Reserved151" 152 "Reserved152" 153 "Reserved153" 154 "Reserved154" 155 "Reserved155" 156 "Reserved156" 157 "Reserved157" 158 "Reserved158" 159 "Reserved159" 160 "Reserved160" 161 "Reserved161" 162 "Reserved162" 163 "Reserved163" 164 "Reserved164" 165 "Reserved165" 166 "Reserved166" 167 "Reserved167" 168 "Reserved168" 169 "Reserved169" ;
VAL_ 245 VFC_TS15_SupSign4Type 0 "UNKNOWN" 1 "ADDCAR" 2 "ADDLORRY" 3 "ADDTRAILER" 4 "ADDCARAVAN" 5 "ADDBUS" 6 "ADDTRACTOR" 7 "ADDMCYCLE" 8 "ADDLORRYBUSTRAILER_DEPRECATED" 9 "ADDLORRYBUS_DEPRECATED" 10 "ADDHAZMAT" 11 "ADDTANK" 12 "ADDTRAM" 13 "ADDWET" 14 "ADDFOG" 15 "ADDRAIN" 16 "ADDSNOW" 17 "ADDTIME" 18 "ADDSECTION" 19 "ADDDISTANCE" 20 "ADDWEIGHT" 21 "ADDEXITL" 22 "ADDEXITR" 23 "ADDLANES" 24 "ADDRADAR" 25 "ADDRAPPEL" 26 "ADDPRIOTURN" 27 "ADDLORRY_EXCEPT" 28 "ADDTRACTOR_OVER" 29 "ADDTEXT" 30 "ADDSIGN" 31 "ADDRAINSNOW" 32 "ADDHUMP" 33 "VADDLORRYBUSTRAILER_DEPRECATED" 34 "VADDLORRYBUS_DEPRECATED" 35 "VADDLORRYTRAILER_DEPRECATED" 36 "ADDLORRYTRAILER_DEPRECATED" 37 "ADDCAMPER" 38 "ADDZONE" 39 "ADDCRASHRISK" 40 "ADDACCIDENT" 41 "ADDJAM" 42 "ADDSMOKE" 43 "ADDOILTRAIL" 44 "ADDGRAVEL" 45 "ADDDIRT" 46 "ADDRWORKSEXIT" 47 "ADDROADDAMAGE" 48 "ADDRWORKSENTRY" 49 "ADDLOWTREE" 50 "ADDRWORKSACCESS" 51 "ADDRUTS" 52 "ADDSOFTSHOULDERCAR" 53 "ADDSOFTSHOULDERLORRY" 54 "VADDSIGN" 55 "VADDCAR" 56 "VADDLORRY" 57 "VADDTRAILER" 58 "VADDCARAVAN" 59 "VADDBUS" 60 "VADDWET" 61 "VADDFOG" 62 "VADDRAIN" 63 "VADDSNOW" 64 "VADDRAINSNOW" 65 "VADDTEXT" 66 "VADDSECTION" 67 "VADDDISTANCE" 68 "VADDWEIGHT" 69 "VADDZONE" 70 "VADDCRASHRISK" 71 "VADDACCIDENT" 72 "VADDJAM" 73 "VADDOILTRAIL" 74 "VADDGRAVEL" 75 "VADDDIRT" 76 "VADDROADDAMAGE" 77 "VADDRUTS" 78 "ADDNOSTOPSHOULDER" 79 "ADDTOWING" 80 "ADDSCHOOL" 81 "ADDNIGHT" 82 "ADDEND" 83 "ADDBEGINS" 84 "ADDWITHIN" 85 "ADDDISTANCEBARS" 86 "ADDMINIMUM" 87 "ADDADVICE" 88 "ADDACCESS" 89 "ADDALLWAY" 90 "ADDBUS_EXCEPT" 91 "ADDEXCEPTDELIVERY" 92 "ADDEXCEPTLOCAL" 93 "ADDFROG" 94 "ADDPRIOTURNL" 95 "ADDPRIOTURNR" 96 "ADDSTART" 97 "ADDSTOPIN" 98 "ADDEXIT" 99 "ADDHAZWATER" 100 "ADDDAY" 101 "ADDSL" 102 "ADDLORRYTRAILER" 103 "ADDLORRYSEMI" 104 "VADDLORRYTRAILER" 105 "VADDLORRYSEMI" 106 "ADDSLOW" 107 "ADDSL5" 108 "ADDSL10" 109 "ADDSL15" 110 "ADDSL20" 111 "ADDSL25" 112 "ADDSL30" 113 "ADDSL35" 114 "ADDSL40" 115 "ADDSL45" 116 "ADDSL50" 117 "ADDSL55" 118 "ADDSL60" 119 "ADDSL65" 120 "ADDSL70" 121 "ADDSL75" 122 "ADDSL80" 123 "ADDSL85" 124 "ADDSL90" 125 "ADDSL95" 126 "ADDSL100" 127 "ADDSL105" 128 "ADDSL110" 129 "ADDSL115" 130 "ADDSL120" 131 "ADDSL125" 132 "ADDSL130" 133 "ADDSL135" 134 "ADDSL140" 135 "ADDSL145" 136 "ADDSL150" 137 "ADDSL155" 138 "ADDSL160" 139 "ADDBIKEROAD" 140 "ADDLORRYTRAILER_EXCEPT" 141 "ADDLORRYSEMI_EXCEPT" 142 "Reserved142" 143 "Reserved143" 144 "Reserved144" 145 "Reserved145" 146 "Reserved146" 147 "Reserved147" 148 "Reserved148" 149 "Reserved149" 150 "Reserved150" 151 "Reserved151" 152 "Reserved152" 153 "Reserved153" 154 "Reserved154" 155 "Reserved155" 156 "Reserved156" 157 "Reserved157" 158 "Reserved158" 159 "Reserved159" 160 "Reserved160" 161 "Reserved161" 162 "Reserved162" 163 "Reserved163" 164 "Reserved164" 165 "Reserved165" 166 "Reserved166" 167 "Reserved167" 168 "Reserved168" 169 "Reserved169" ;
VAL_ 245 VFC_TS15_SupSign5Type 0 "UNKNOWN" 1 "ADDCAR" 2 "ADDLORRY" 3 "ADDTRAILER" 4 "ADDCARAVAN" 5 "ADDBUS" 6 "ADDTRACTOR" 7 "ADDMCYCLE" 8 "ADDLORRYBUSTRAILER_DEPRECATED" 9 "ADDLORRYBUS_DEPRECATED" 10 "ADDHAZMAT" 11 "ADDTANK" 12 "ADDTRAM" 13 "ADDWET" 14 "ADDFOG" 15 "ADDRAIN" 16 "ADDSNOW" 17 "ADDTIME" 18 "ADDSECTION" 19 "ADDDISTANCE" 20 "ADDWEIGHT" 21 "ADDEXITL" 22 "ADDEXITR" 23 "ADDLANES" 24 "ADDRADAR" 25 "ADDRAPPEL" 26 "ADDPRIOTURN" 27 "ADDLORRY_EXCEPT" 28 "ADDTRACTOR_OVER" 29 "ADDTEXT" 30 "ADDSIGN" 31 "ADDRAINSNOW" 32 "ADDHUMP" 33 "VADDLORRYBUSTRAILER_DEPRECATED" 34 "VADDLORRYBUS_DEPRECATED" 35 "VADDLORRYTRAILER_DEPRECATED" 36 "ADDLORRYTRAILER_DEPRECATED" 37 "ADDCAMPER" 38 "ADDZONE" 39 "ADDCRASHRISK" 40 "ADDACCIDENT" 41 "ADDJAM" 42 "ADDSMOKE" 43 "ADDOILTRAIL" 44 "ADDGRAVEL" 45 "ADDDIRT" 46 "ADDRWORKSEXIT" 47 "ADDROADDAMAGE" 48 "ADDRWORKSENTRY" 49 "ADDLOWTREE" 50 "ADDRWORKSACCESS" 51 "ADDRUTS" 52 "ADDSOFTSHOULDERCAR" 53 "ADDSOFTSHOULDERLORRY" 54 "VADDSIGN" 55 "VADDCAR" 56 "VADDLORRY" 57 "VADDTRAILER" 58 "VADDCARAVAN" 59 "VADDBUS" 60 "VADDWET" 61 "VADDFOG" 62 "VADDRAIN" 63 "VADDSNOW" 64 "VADDRAINSNOW" 65 "VADDTEXT" 66 "VADDSECTION" 67 "VADDDISTANCE" 68 "VADDWEIGHT" 69 "VADDZONE" 70 "VADDCRASHRISK" 71 "VADDACCIDENT" 72 "VADDJAM" 73 "VADDOILTRAIL" 74 "VADDGRAVEL" 75 "VADDDIRT" 76 "VADDROADDAMAGE" 77 "VADDRUTS" 78 "ADDNOSTOPSHOULDER" 79 "ADDTOWING" 80 "ADDSCHOOL" 81 "ADDNIGHT" 82 "ADDEND" 83 "ADDBEGINS" 84 "ADDWITHIN" 85 "ADDDISTANCEBARS" 86 "ADDMINIMUM" 87 "ADDADVICE" 88 "ADDACCESS" 89 "ADDALLWAY" 90 "ADDBUS_EXCEPT" 91 "ADDEXCEPTDELIVERY" 92 "ADDEXCEPTLOCAL" 93 "ADDFROG" 94 "ADDPRIOTURNL" 95 "ADDPRIOTURNR" 96 "ADDSTART" 97 "ADDSTOPIN" 98 "ADDEXIT" 99 "ADDHAZWATER" 100 "ADDDAY" 101 "ADDSL" 102 "ADDLORRYTRAILER" 103 "ADDLORRYSEMI" 104 "VADDLORRYTRAILER" 105 "VADDLORRYSEMI" 106 "ADDSLOW" 107 "ADDSL5" 108 "ADDSL10" 109 "ADDSL15" 110 "ADDSL20" 111 "ADDSL25" 112 "ADDSL30" 113 "ADDSL35" 114 "ADDSL40" 115 "ADDSL45" 116 "ADDSL50" 117 "ADDSL55" 118 "ADDSL60" 119 "ADDSL65" 120 "ADDSL70" 121 "ADDSL75" 122 "ADDSL80" 123 "ADDSL85" 124 "ADDSL90" 125 "ADDSL95" 126 "ADDSL100" 127 "ADDSL105" 128 "ADDSL110" 129 "ADDSL115" 130 "ADDSL120" 131 "ADDSL125" 132 "ADDSL130" 133 "ADDSL135" 134 "ADDSL140" 135 "ADDSL145" 136 "ADDSL150" 137 "ADDSL155" 138 "ADDSL160" 139 "ADDBIKEROAD" 140 "ADDLORRYTRAILER_EXCEPT" 141 "ADDLORRYSEMI_EXCEPT" 142 "Reserved142" 143 "Reserved143" 144 "Reserved144" 145 "Reserved145" 146 "Reserved146" 147 "Reserved147" 148 "Reserved148" 149 "Reserved149" 150 "Reserved150" 151 "Reserved151" 152 "Reserved152" 153 "Reserved153" 154 "Reserved154" 155 "Reserved155" 156 "Reserved156" 157 "Reserved157" 158 "Reserved158" 159 "Reserved159" 160 "Reserved160" 161 "Reserved161" 162 "Reserved162" 163 "Reserved163" 164 "Reserved164" 165 "Reserved165" 166 "Reserved166" 167 "Reserved167" 168 "Reserved168" 169 "Reserved169" ;
VAL_ 260 RFC_LocHdr_LocDownSel 0 "no downselection" 1 "downselected" ;
SIG_GROUP_ 244 SG_VFC_TrafficSign_12_13 1 : VFC_TS_12_13_CRC VFC_TS_12_13_AliveCtr VFC_TS_12_13_ProtBlockCtr VFC_TS12_ObjId VFC_TS12_Type VFC_TS12_ExistProb VFC_TS12_Px VFC_TS12_Py VFC_TS12_Pz VFC_TS12_PxStdDev VFC_TS12_Width VFC_TS12_Height VFC_TS12_EmbeddedInfo VFC_TS12_ValidLane VFC_TS12_ValidDay VFC_TS12_ValidTimeRange1Start VFC_TS12_ValidTimeRange1End VFC_TS12_ValidTimeRange2Start VFC_TS12_ValidTimeRange2End VFC_TS12_ValidInDist VFC_TS12_ValidInDistUnit VFC_TS12_ValidSection VFC_TS12_ValidSectionUnit VFC_TS12_NumValidSupSigns VFC_TS12_SupSign0ExistProb VFC_TS12_SupSign1ExistProb VFC_TS12_SupSign2ExistProb VFC_TS12_SupSign3ExistProb VFC_TS12_SupSign4ExistProb VFC_TS12_SupSign5ExistProb VFC_TS12_SupSign0Type VFC_TS12_SupSign1Type VFC_TS12_SupSign2Type VFC_TS12_SupSign3Type VFC_TS12_SupSign4Type VFC_TS12_SupSign5Type VFC_TS13_ObjId VFC_TS13_Type VFC_TS13_ExistProb VFC_TS13_Px VFC_TS13_Py VFC_TS13_Pz VFC_TS13_PxStdDev VFC_TS13_Width VFC_TS13_Height VFC_TS13_EmbeddedInfo VFC_TS13_ValidLane VFC_TS13_ValidDay VFC_TS13_ValidTimeRange1Start VFC_TS13_ValidTimeRange1End VFC_TS13_ValidTimeRange2Start VFC_TS13_ValidTimeRange2End VFC_TS13_ValidInDist VFC_TS13_ValidInDistUnit VFC_TS13_ValidSection VFC_TS13_ValidSectionUnit VFC_TS13_NumValidSupSigns VFC_TS13_SupSign0ExistProb VFC_TS13_SupSign1ExistProb VFC_TS13_SupSign2ExistProb VFC_TS13_SupSign3ExistProb VFC_TS13_SupSign4ExistProb VFC_TS13_SupSign5ExistProb VFC_TS13_SupSign0Type VFC_TS13_SupSign1Type VFC_TS13_SupSign2Type VFC_TS13_SupSign3Type VFC_TS13_SupSign4Type VFC_TS13_SupSign5Type;
SIG_GROUP_ 245 SG_VFC_TrafficSign_14_15 1 : VFC_TS_14_15_CRC VFC_TS_14_15_AliveCtr VFC_TS_14_15_ProtBlockCtr VFC_TS14_ObjId VFC_TS14_Type VFC_TS14_ExistProb VFC_TS14_Px VFC_TS14_Py VFC_TS14_Pz VFC_TS14_PxStdDev VFC_TS14_Width VFC_TS14_Height VFC_TS14_EmbeddedInfo VFC_TS14_ValidLane VFC_TS14_ValidDay VFC_TS14_ValidTimeRange1Start VFC_TS14_ValidTimeRange1End VFC_TS14_ValidTimeRange2Start VFC_TS14_ValidTimeRange2End VFC_TS14_ValidInDist VFC_TS14_ValidInDistUnit VFC_TS14_ValidSection VFC_TS14_ValidSectionUnit VFC_TS14_NumValidSupSigns VFC_TS14_SupSign0ExistProb VFC_TS14_SupSign1ExistProb VFC_TS14_SupSign2ExistProb VFC_TS14_SupSign3ExistProb VFC_TS14_SupSign4ExistProb VFC_TS14_SupSign5ExistProb VFC_TS14_SupSign0Type VFC_TS14_SupSign1Type VFC_TS14_SupSign2Type VFC_TS14_SupSign3Type VFC_TS14_SupSign4Type VFC_TS14_SupSign5Type VFC_TS15_ObjId VFC_TS15_Type VFC_TS15_ExistProb VFC_TS15_Px VFC_TS15_Py VFC_TS15_Pz VFC_TS15_PxStdDev VFC_TS15_Width VFC_TS15_Height VFC_TS15_EmbeddedInfo VFC_TS15_ValidLane VFC_TS15_ValidDay VFC_TS15_ValidTimeRange1Start VFC_TS15_ValidTimeRange1End VFC_TS15_ValidTimeRange2Start VFC_TS15_ValidTimeRange2End VFC_TS15_ValidInDist VFC_TS15_ValidInDistUnit VFC_TS15_ValidSection VFC_TS15_ValidSectionUnit VFC_TS15_NumValidSupSigns VFC_TS15_SupSign0ExistProb VFC_TS15_SupSign1ExistProb VFC_TS15_SupSign2ExistProb VFC_TS15_SupSign3ExistProb VFC_TS15_SupSign4ExistProb VFC_TS15_SupSign5ExistProb VFC_TS15_SupSign0Type VFC_TS15_SupSign1Type VFC_TS15_SupSign2Type VFC_TS15_SupSign3Type VFC_TS15_SupSign4Type VFC_TS15_SupSign5Type;
SIG_GROUP_ 260 SG_RFC_LocationHdrA 1 : RFC_LocHdrA_CRC RFC_LocHdrA_AliveCtr RFC_LocHdrA_ProtBlockCtr RFC_LocHdr_IfVersionIdMajor RFC_LocHdr_IfVersionIdMinor RFC_LocHdr_NumValidDetections RFC_LocHdr_TimeStamp RFC_LocHdr_SensorStatus RFC_LocHdr_SensorStatusExt RFC_LocHdr_LocDownSel RFC_LocHdr_TimeStampStatus RFC_LocHdr_BlindnessEvent RFC_LocHdr_SwVersion RFC_LocHdr_SensorOriginPointY RFC_LocHdr_SensorOriginPointX RFC_LocHdr_SensorOriginPointZ RFC_LocHdr_SensorOrientCorrYaw RFC_LocHdr_SensorOrientCorrPitch RFC_LocHdr_SensorOrientYaw RFC_LocHdr_SensorOrientPitch RFC_LocHdr_ModPerfDistanceMax RFC_LocHdr_FovElev00RangeGain RFC_LocHdr_FovElev01RangeGain RFC_LocHdr_FovElev02RangeGain RFC_LocHdr_FovElev03RangeGain RFC_LocHdr_FovElev04RangeGain RFC_LocHdr_FovElev05RangeGain RFC_LocHdr_FovElev06RangeGain RFC_LocHdr_FovElev07RangeGain RFC_LocHdr_FovElev08RangeGain RFC_LocHdr_FovElev09RangeGain RFC_LocHdr_FovElev10RangeGain RFC_LocHdr_FovElevation00 RFC_LocHdr_FovElevation01 RFC_LocHdr_FovElevation02 RFC_LocHdr_FovElevation03 RFC_LocHdr_FovElevation04 RFC_LocHdr_FovElevation05 RFC_LocHdr_FovElevation06 RFC_LocHdr_FovElevation07 RFC_LocHdr_FovElevation08 RFC_LocHdr_FovElevation09 RFC_LocHdr_FovElevation10;
SIG_GROUP_ 261 SG_RFC_LocationHdrB 1 : RFC_LocHdrB_CRC RFC_LocHdrB_AliveCtr RFC_LocHdrB_ProtBlockCtr RFC_LocHdr_FovAzimuth00Range RFC_LocHdr_FovAzimuth01Range RFC_LocHdr_FovAzimuth02Range RFC_LocHdr_FovAzimuth03Range RFC_LocHdr_FovAzimuth04Range RFC_LocHdr_FovAzimuth05Range RFC_LocHdr_FovAzimuth06Range RFC_LocHdr_FovAzimuth07Range RFC_LocHdr_FovAzimuth08Range RFC_LocHdr_FovAzimuth09Range RFC_LocHdr_FovAzimuth10Range RFC_LocHdr_FovAzimuth11Range RFC_LocHdr_FovAzimuth12Range RFC_LocHdr_FovAzimuth13Range RFC_LocHdr_FovAzimuth14Range RFC_LocHdr_FovAzimuth15Range RFC_LocHdr_FovAzimuth16Range RFC_LocHdr_FovAzimuth17Range RFC_LocHdr_FovAzimuth18Range RFC_LocHdr_FovAzimuth19Range RFC_LocHdr_FovAzimuth20Range RFC_LocHdr_FovAzimuth21Range RFC_LocHdr_FovAzimuth22Range RFC_LocHdr_FovAzimuth23Range RFC_LocHdr_FovAzimuth24Range RFC_LocHdr_FovAzimuth00 RFC_LocHdr_FovAzimuth01 RFC_LocHdr_FovAzimuth02 RFC_LocHdr_FovAzimuth03 RFC_LocHdr_FovAzimuth04 RFC_LocHdr_FovAzimuth05 RFC_LocHdr_FovAzimuth06 RFC_LocHdr_FovAzimuth07 RFC_LocHdr_FovAzimuth08 RFC_LocHdr_FovAzimuth09 RFC_LocHdr_FovAzimuth10 RFC_LocHdr_FovAzimuth11 RFC_LocHdr_FovAzimuth12 RFC_LocHdr_FovAzimuth13 RFC_LocHdr_FovAzimuth14 RFC_LocHdr_FovAzimuth15 RFC_LocHdr_FovAzimuth16 RFC_LocHdr_FovAzimuth17 RFC_LocHdr_FovAzimuth18 RFC_LocHdr_FovAzimuth19 RFC_LocHdr_FovAzimuth20 RFC_LocHdr_FovAzimuth21 RFC_LocHdr_FovAzimuth22 RFC_LocHdr_FovAzimuth23 RFC_LocHdr_FovAzimuth24;
SIG_GROUP_ 264 SG_RFC_Location_000_002 1 : RFC_Loc000_002_CRC RFC_Loc000_002_AliveCtr RFC_Loc000_002_ProtBlockCtr RFC_Loc000_RadialDistance RFC_Loc000_RadialVelocity RFC_Loc000_Elevation RFC_Loc000_Azimuth RFC_Loc000_DistVelocityCoVnce RFC_Loc000_RadialDistanceVnce RFC_Loc000_RadialVelocityVnce RFC_Loc000_ElevationVnce RFC_Loc000_AzimuthVnce RFC_Loc000_RadarCrossSection RFC_Loc000_DistVelocityQuality RFC_Loc000_ElevationQuality RFC_Loc000_AzimuthQuality RFC_Loc000_RSSI RFC_Loc000_AzimuthalPartnerId RFC_Loc001_RadialDistance RFC_Loc001_RadialVelocity RFC_Loc001_Elevation RFC_Loc001_Azimuth RFC_Loc001_DistVelocityCoVnce RFC_Loc001_RadialDistanceVnce RFC_Loc001_RadialVelocityVnce RFC_Loc001_ElevationVnce RFC_Loc001_AzimuthVnce RFC_Loc001_RadarCrossSection RFC_Loc001_DistVelocityQuality RFC_Loc001_ElevationQuality RFC_Loc001_AzimuthQuality RFC_Loc001_RSSI RFC_Loc001_AzimuthalPartnerId RFC_Loc002_RadialDistance RFC_Loc002_RadialVelocity RFC_Loc002_Elevation RFC_Loc002_Azimuth RFC_Loc002_DistVelocityCoVnce RFC_Loc002_RadialDistanceVnce RFC_Loc002_RadialVelocityVnce RFC_Loc002_ElevationVnce RFC_Loc002_AzimuthVnce RFC_Loc002_RadarCrossSection RFC_Loc002_DistVelocityQuality RFC_Loc002_ElevationQuality RFC_Loc002_AzimuthQuality RFC_Loc002_RSSI RFC_Loc002_AzimuthalPartnerId;
SIG_GROUP_ 265 SG_RFC_Location_003_005 1 : RFC_Loc003_005_CRC RFC_Loc003_005_AliveCtr RFC_Loc003_005_ProtBlockCtr RFC_Loc003_RadialDistance RFC_Loc003_RadialVelocity RFC_Loc003_Elevation RFC_Loc003_Azimuth RFC_Loc003_DistVelocityCoVnce RFC_Loc003_RadialDistanceVnce RFC_Loc003_RadialVelocityVnce RFC_Loc003_ElevationVnce RFC_Loc003_AzimuthVnce RFC_Loc003_RadarCrossSection RFC_Loc003_DistVelocityQuality RFC_Loc003_ElevationQuality RFC_Loc003_AzimuthQuality RFC_Loc003_RSSI RFC_Loc003_AzimuthalPartnerId RFC_Loc004_RadialDistance RFC_Loc004_RadialVelocity RFC_Loc004_Elevation RFC_Loc004_Azimuth RFC_Loc004_DistVelocityCoVnce RFC_Loc004_RadialDistanceVnce RFC_Loc004_RadialVelocityVnce RFC_Loc004_ElevationVnce RFC_Loc004_AzimuthVnce RFC_Loc004_RadarCrossSection RFC_Loc004_DistVelocityQuality RFC_Loc004_ElevationQuality RFC_Loc004_AzimuthQuality RFC_Loc004_RSSI RFC_Loc004_AzimuthalPartnerId RFC_Loc005_RadialDistance RFC_Loc005_RadialVelocity RFC_Loc005_Elevation RFC_Loc005_Azimuth RFC_Loc005_DistVelocityCoVnce RFC_Loc005_RadialDistanceVnce RFC_Loc005_RadialVelocityVnce RFC_Loc005_ElevationVnce RFC_Loc005_AzimuthVnce RFC_Loc005_RadarCrossSection RFC_Loc005_DistVelocityQuality RFC_Loc005_ElevationQuality RFC_Loc005_AzimuthQuality RFC_Loc005_RSSI RFC_Loc005_AzimuthalPartnerId;
