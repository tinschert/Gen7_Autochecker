VERSION "created by canmatrix"

NS_ :

BS_:

BU_: RadarFrontCenter VideoFrontCenter DASy ReceiveECU

BO_ 64 VFC_Object10: 64 VideoFrontCenter
 SG_ VFC_Obj10_CRC : 0|16@1+ (1,0) [0|65535] ""  DASy
 SG_ VFC_Obj10_AliveCtr : 16|8@1+ (1,0) [0|255] ""  DASy
 SG_ VFC_Obj10_ProtBlockCtr : 24|4@1+ (1,0) [0|15] ""  DASy
 SG_ VFC_Obj10_ExistProb : 32|6@1+ (2,0) [0|100] "%"  DASy
 SG_ VFC_Obj10_MeasurementStatus : 38|2@1+ (1,0) [0|3] ""  DASy
 SG_ VFC_Obj10_ObjId : 40|6@1+ (1,0) [1|63] ""  DASy
 SG_ VFC_Obj10_Type : 46|4@1+ (1,0) [0|15] ""  DASy
 SG_ VFC_Obj10_TypeConf : 50|6@1+ (2,0) [0|100] "%"  DASy
 SG_ VFC_Obj10_VisibleView : 56|3@1+ (1,0) [0|7] ""  DASy
 SG_ VFC_Obj10_ClassifiedView : 59|3@1+ (1,0) [0|7] ""  DASy
 SG_ VFC_Obj10_Px : 62|12@1+ (0.05,0) [0|204.75] "m"  DASy
 SG_ VFC_Obj10_Py : 74|14@1+ (0.01,-81.92) [-81.92|81.91] "m"  DASy
 SG_ VFC_Obj10_PxStdDev : 88|10@1+ (0.05,0) [0|51.15] "m"  DASy
 SG_ VFC_Obj10_PyStdDev : 98|10@1+ (0.02,0) [0|20.46] "m"  DASy
 SG_ VFC_Obj10_OrientationYaw : 108|9@1+ (0.01,-2.56) [-1.57|1.57] "rad"  DASy
 SG_ VFC_Obj10_OrientationYawStdDev : 117|6@1+ (0.01,0) [0|0.63] "rad"  DASy
 SG_ VFC_Obj10_Length : 123|9@1+ (0.05,0) [0|25.55] "m"  DASy
 SG_ VFC_Obj10_Width : 132|10@1+ (0.01,0) [0|10.23] "m"  DASy
 SG_ VFC_Obj10_Height : 142|9@1+ (0.01,0) [0|5.11] "m"  DASy
 SG_ VFC_Obj10_LengthStdDev : 151|7@1+ (0.05,0) [0|6.35] "m"  DASy
 SG_ VFC_Obj10_WidthStdDev : 158|7@1+ (0.01,0) [0|1.27] "m"  DASy
 SG_ VFC_Obj10_HeightStdDev : 165|7@1+ (0.01,0) [0|1.27] "m"  DASy
 SG_ VFC_Obj10_Vx : 172|11@1+ (0.1,-154) [-154|50.7] "m/s"  DASy
 SG_ VFC_Obj10_Vy : 183|10@1+ (0.1,-51.2) [-51.2|51.1] "m/s"  DASy
 SG_ VFC_Obj10_VxStdDev : 193|10@1+ (0.1,0) [0|102.3] "m/s"  DASy
 SG_ VFC_Obj10_VyStdDev : 203|9@1+ (0.1,0) [0|51.1] "m/s"  DASy
 SG_ VFC_Obj10_Ax : 212|9@1+ (0.1,-25.6) [-25.6|25.5] "m/s^2"  DASy
 SG_ VFC_Obj10_LightStatTurnIndicator : 221|3@1+ (1,0) [0|7] ""  DASy
 SG_ VFC_Obj10_Ay : 224|8@1+ (0.1,-12.8) [-12.8|12.7] "m/s^2"  DASy
 SG_ VFC_Obj10_AxStdDev : 232|8@1+ (0.1,0) [0|25.5] "m/s^2"  DASy
 SG_ VFC_Obj10_AyStdDev : 240|8@1+ (0.1,0) [0|25.5] "m/s^2"  DASy
 SG_ VFC_Obj10_MovementProbLat : 248|6@1+ (2,0) [0|100] "%"  DASy
 SG_ VFC_Obj10_MovementProbLong : 254|6@1+ (2,0) [0|100] "%"  DASy
 SG_ VFC_Obj10_2DAngPosEdgeLeft : 260|13@1+ (0.00025,-1.024) [-1.024|1.02375] "unitless"  DASy
 SG_ VFC_Obj10_2DAngPosEdgeRight : 273|13@1+ (0.00025,-1.024) [-1.024|1.02375] "unitless"  DASy
 SG_ VFC_Obj10_2DAngPosEdgeFar : 286|13@1+ (0.00025,-1.024) [-1.024|1.02375] "unitless"  DASy
 SG_ VFC_Obj10_2DAngPosEdgeBot : 299|12@1+ (0.00025,-0.512) [-0.512|0.51175] "unitless"  DASy
 SG_ VFC_Obj10_OutsideRoad : 311|1@1+ (1,0) [0|1] "unitless"  DASy
 SG_ VFC_Obj10_2DAngPosEdgeLeftStdDev : 312|8@1+ (0.0002,0) [0|0.051] "unitless"  DASy
 SG_ VFC_Obj10_2DAngPosEdgeRightStdDe : 320|8@1+ (0.0002,0) [0|0.051] "unitless"  DASy
 SG_ VFC_Obj10_2DAngPosEdgeFarStdDev : 328|8@1+ (0.0002,0) [0|0.051] "unitless"  DASy
 SG_ VFC_Obj10_2DAngPosEdgeBotStdDev : 336|8@1+ (0.0002,0) [0|0.051] "unitless"  DASy
 SG_ VFC_Obj10_2DNormVx : 344|16@1+ (0.001,-40) [-40|25.535] "1/s"  DASy
 SG_ VFC_Obj10_2DNormVy : 360|13@1+ (0.001,-4.096) [-4.096|4.095] "1/s"  DASy
 SG_ VFC_Obj10_2DNormAx : 373|13@1+ (0.002,-10) [-10|6.382] "1/s^2"  DASy
 SG_ VFC_Obj10_2DNormVxStdDev : 386|10@1+ (0.001,0) [0|1.023] "1/s"  DASy
 SG_ VFC_Obj10_MeasurementSource : 396|4@1+ (1,0) [0|15] ""  DASy
 SG_ VFC_Obj10_2DNormVyStdDev : 400|8@1+ (0.001,0) [0|0.255] "1/s"  DASy
 SG_ VFC_Obj10_2DNormAxStdDev : 408|10@1+ (0.0025,0) [0|2.5575] "1/s^2"  DASy
 SG_ VFC_Obj10_2DScaleChange : 418|14@1+ (0.0001,0.5) [0.5|2.1383] "unitless"  DASy
 SG_ VFC_Obj10_2DScaleChangeStdDev : 432|10@1+ (0.0001,0) [0|0.1023] "unitless"  DASy
 SG_ VFC_Obj10_Reliability : 442|6@1+ (1,0) [0|63] ""  DASy
 SG_ VFC_Obj10_LightStatBrakeLight : 448|3@1+ (1,0) [0|7] ""  DASy
 SG_ VFC_Obj10_OutsideRoadMeasStatus : 451|2@1+ (1,0) [0|3] ""  DASy
 SG_ VFC_Obj10_Oncoming : 453|1@1+ (1,0) [0|1] "unitless"  DASy
 SG_ VFC_Obj10_OncomingMeasStatus : 454|2@1+ (1,0) [0|3] ""  DASy
 SG_ VFC_Obj10_MovementStanding : 456|1@1+ (1,0) [0|1] "unitless"  DASy
 SG_ VFC_Obj10_MovementStandingMeasSt : 457|2@1+ (1,0) [0|3] ""  DASy
 SG_ VFC_Obj10_MovementObserved : 459|1@1+ (1,0) [0|1] "unitless"  DASy
 SG_ VFC_Obj10_MovementObservedMeasSt : 460|1@1+ (1,0) [0|1] ""  DASy
 SG_ VFC_Obj10_TargetObjTypeAcc : 461|3@1+ (1,0) [0|7] ""  DASy
 SG_ VFC_Obj10_TargetObjTypeAccConf : 464|6@1+ (2,0) [0|100] "%"  DASy

BO_ 65 VFC_Object11: 64 VideoFrontCenter
 SG_ VFC_Obj11_CRC : 0|16@1+ (1,0) [0|65535] ""  DASy
 SG_ VFC_Obj11_AliveCtr : 16|8@1+ (1,0) [0|255] ""  DASy
 SG_ VFC_Obj11_ProtBlockCtr : 24|4@1+ (1,0) [0|15] ""  DASy
 SG_ VFC_Obj11_ExistProb : 32|6@1+ (2,0) [0|100] "%"  DASy
 SG_ VFC_Obj11_MeasurementStatus : 38|2@1+ (1,0) [0|3] ""  DASy
 SG_ VFC_Obj11_ObjId : 40|6@1+ (1,0) [1|63] ""  DASy
 SG_ VFC_Obj11_Type : 46|4@1+ (1,0) [0|15] ""  DASy
 SG_ VFC_Obj11_TypeConf : 50|6@1+ (2,0) [0|100] "%"  DASy
 SG_ VFC_Obj11_VisibleView : 56|3@1+ (1,0) [0|7] ""  DASy
 SG_ VFC_Obj11_ClassifiedView : 59|3@1+ (1,0) [0|7] ""  DASy
 SG_ VFC_Obj11_Px : 62|12@1+ (0.05,0) [0|204.75] "m"  DASy
 SG_ VFC_Obj11_Py : 74|14@1+ (0.01,-81.92) [-81.92|81.91] "m"  DASy
 SG_ VFC_Obj11_PxStdDev : 88|10@1+ (0.05,0) [0|51.15] "m"  DASy
 SG_ VFC_Obj11_PyStdDev : 98|10@1+ (0.02,0) [0|20.46] "m"  DASy
 SG_ VFC_Obj11_OrientationYaw : 108|9@1+ (0.01,-2.56) [-1.57|1.57] "rad"  DASy
 SG_ VFC_Obj11_OrientationYawStdDev : 117|6@1+ (0.01,0) [0|0.63] "rad"  DASy
 SG_ VFC_Obj11_Length : 123|9@1+ (0.05,0) [0|25.55] "m"  DASy
 SG_ VFC_Obj11_Width : 132|10@1+ (0.01,0) [0|10.23] "m"  DASy
 SG_ VFC_Obj11_Height : 142|9@1+ (0.01,0) [0|5.11] "m"  DASy
 SG_ VFC_Obj11_LengthStdDev : 151|7@1+ (0.05,0) [0|6.35] "m"  DASy
 SG_ VFC_Obj11_WidthStdDev : 158|7@1+ (0.01,0) [0|1.27] "m"  DASy
 SG_ VFC_Obj11_HeightStdDev : 165|7@1+ (0.01,0) [0|1.27] "m"  DASy
 SG_ VFC_Obj11_Vx : 172|11@1+ (0.1,-154) [-154|50.7] "m/s"  DASy
 SG_ VFC_Obj11_Vy : 183|10@1+ (0.1,-51.2) [-51.2|51.1] "m/s"  DASy
 SG_ VFC_Obj11_VxStdDev : 193|10@1+ (0.1,0) [0|102.3] "m/s"  DASy
 SG_ VFC_Obj11_VyStdDev : 203|9@1+ (0.1,0) [0|51.1] "m/s"  DASy
 SG_ VFC_Obj11_Ax : 212|9@1+ (0.1,-25.6) [-25.6|25.5] "m/s^2"  DASy
 SG_ VFC_Obj11_LightStatTurnIndicator : 221|3@1+ (1,0) [0|7] ""  DASy
 SG_ VFC_Obj11_Ay : 224|8@1+ (0.1,-12.8) [-12.8|12.7] "m/s^2"  DASy
 SG_ VFC_Obj11_AxStdDev : 232|8@1+ (0.1,0) [0|25.5] "m/s^2"  DASy
 SG_ VFC_Obj11_AyStdDev : 240|8@1+ (0.1,0) [0|25.5] "m/s^2"  DASy
 SG_ VFC_Obj11_MovementProbLat : 248|6@1+ (2,0) [0|100] "%"  DASy
 SG_ VFC_Obj11_MovementProbLong : 254|6@1+ (2,0) [0|100] "%"  DASy
 SG_ VFC_Obj11_2DAngPosEdgeLeft : 260|13@1+ (0.00025,-1.024) [-1.024|1.02375] "unitless"  DASy
 SG_ VFC_Obj11_2DAngPosEdgeRight : 273|13@1+ (0.00025,-1.024) [-1.024|1.02375] "unitless"  DASy
 SG_ VFC_Obj11_2DAngPosEdgeFar : 286|13@1+ (0.00025,-1.024) [-1.024|1.02375] "unitless"  DASy
 SG_ VFC_Obj11_2DAngPosEdgeBot : 299|12@1+ (0.00025,-0.512) [-0.512|0.51175] "unitless"  DASy
 SG_ VFC_Obj11_OutsideRoad : 311|1@1+ (1,0) [0|1] "unitless"  DASy
 SG_ VFC_Obj11_2DAngPosEdgeLeftStdDev : 312|8@1+ (0.0002,0) [0|0.051] "unitless"  DASy
 SG_ VFC_Obj11_2DAngPosEdgeRightStdDe : 320|8@1+ (0.0002,0) [0|0.051] "unitless"  DASy
 SG_ VFC_Obj11_2DAngPosEdgeFarStdDev : 328|8@1+ (0.0002,0) [0|0.051] "unitless"  DASy
 SG_ VFC_Obj11_2DAngPosEdgeBotStdDev : 336|8@1+ (0.0002,0) [0|0.051] "unitless"  DASy
 SG_ VFC_Obj11_2DNormVx : 344|16@1+ (0.001,-40) [-40|25.535] "1/s"  DASy
 SG_ VFC_Obj11_2DNormVy : 360|13@1+ (0.001,-4.096) [-4.096|4.095] "1/s"  DASy
 SG_ VFC_Obj11_2DNormAx : 373|13@1+ (0.002,-10) [-10|6.382] "1/s^2"  DASy
 SG_ VFC_Obj11_2DNormVxStdDev : 386|10@1+ (0.001,0) [0|1.023] "1/s"  DASy
 SG_ VFC_Obj11_MeasurementSource : 396|4@1+ (1,0) [0|15] ""  DASy
 SG_ VFC_Obj11_2DNormVyStdDev : 400|8@1+ (0.001,0) [0|0.255] "1/s"  DASy
 SG_ VFC_Obj11_2DNormAxStdDev : 408|10@1+ (0.0025,0) [0|2.5575] "1/s^2"  DASy
 SG_ VFC_Obj11_2DScaleChange : 418|14@1+ (0.0001,0.5) [0.5|2.1383] "unitless"  DASy
 SG_ VFC_Obj11_2DScaleChangeStdDev : 432|10@1+ (0.0001,0) [0|0.1023] "unitless"  DASy
 SG_ VFC_Obj11_Reliability : 442|6@1+ (1,0) [0|63] ""  DASy
 SG_ VFC_Obj11_LightStatBrakeLight : 448|3@1+ (1,0) [0|7] ""  DASy
 SG_ VFC_Obj11_OutsideRoadMeasStatus : 451|2@1+ (1,0) [0|3] ""  DASy
 SG_ VFC_Obj11_Oncoming : 453|1@1+ (1,0) [0|1] "unitless"  DASy
 SG_ VFC_Obj11_OncomingMeasStatus : 454|2@1+ (1,0) [0|3] ""  DASy
 SG_ VFC_Obj11_MovementStanding : 456|1@1+ (1,0) [0|1] "unitless"  DASy
 SG_ VFC_Obj11_MovementStandingMeasSt : 457|2@1+ (1,0) [0|3] ""  DASy
 SG_ VFC_Obj11_MovementObserved : 459|1@1+ (1,0) [0|1] "unitless"  DASy
 SG_ VFC_Obj11_MovementObservedMeasSt : 460|1@1+ (1,0) [0|1] ""  DASy
 SG_ VFC_Obj11_TargetObjTypeAcc : 461|3@1+ (1,0) [0|7] ""  DASy
 SG_ VFC_Obj11_TargetObjTypeAccConf : 464|6@1+ (2,0) [0|100] "%"  DASy

BO_ 66 VFC_Object12: 64 VideoFrontCenter
 SG_ VFC_Obj12_CRC : 0|16@1+ (1,0) [0|65535] ""  DASy
 SG_ VFC_Obj12_AliveCtr : 16|8@1+ (1,0) [0|255] ""  DASy
 SG_ VFC_Obj12_ProtBlockCtr : 24|4@1+ (1,0) [0|15] ""  DASy
 SG_ VFC_Obj12_ExistProb : 32|6@1+ (2,0) [0|100] "%"  DASy
 SG_ VFC_Obj12_MeasurementStatus : 38|2@1+ (1,0) [0|3] ""  DASy
 SG_ VFC_Obj12_ObjId : 40|6@1+ (1,0) [1|63] ""  DASy
 SG_ VFC_Obj12_Type : 46|4@1+ (1,0) [0|15] ""  DASy
 SG_ VFC_Obj12_TypeConf : 50|6@1+ (2,0) [0|100] "%"  DASy
 SG_ VFC_Obj12_VisibleView : 56|3@1+ (1,0) [0|7] ""  DASy
 SG_ VFC_Obj12_ClassifiedView : 59|3@1+ (1,0) [0|7] ""  DASy
 SG_ VFC_Obj12_Px : 62|12@1+ (0.05,0) [0|204.75] "m"  DASy
 SG_ VFC_Obj12_Py : 74|14@1+ (0.01,-81.92) [-81.92|81.91] "m"  DASy
 SG_ VFC_Obj12_PxStdDev : 88|10@1+ (0.05,0) [0|51.15] "m"  DASy
 SG_ VFC_Obj12_PyStdDev : 98|10@1+ (0.02,0) [0|20.46] "m"  DASy
 SG_ VFC_Obj12_OrientationYaw : 108|9@1+ (0.01,-2.56) [-1.57|1.57] "rad"  DASy
 SG_ VFC_Obj12_OrientationYawStdDev : 117|6@1+ (0.01,0) [0|0.63] "rad"  DASy
 SG_ VFC_Obj12_Length : 123|9@1+ (0.05,0) [0|25.55] "m"  DASy
 SG_ VFC_Obj12_Width : 132|10@1+ (0.01,0) [0|10.23] "m"  DASy
 SG_ VFC_Obj12_Height : 142|9@1+ (0.01,0) [0|5.11] "m"  DASy
 SG_ VFC_Obj12_LengthStdDev : 151|7@1+ (0.05,0) [0|6.35] "m"  DASy
 SG_ VFC_Obj12_WidthStdDev : 158|7@1+ (0.01,0) [0|1.27] "m"  DASy
 SG_ VFC_Obj12_HeightStdDev : 165|7@1+ (0.01,0) [0|1.27] "m"  DASy
 SG_ VFC_Obj12_Vx : 172|11@1+ (0.1,-154) [-154|50.7] "m/s"  DASy
 SG_ VFC_Obj12_Vy : 183|10@1+ (0.1,-51.2) [-51.2|51.1] "m/s"  DASy
 SG_ VFC_Obj12_VxStdDev : 193|10@1+ (0.1,0) [0|102.3] "m/s"  DASy
 SG_ VFC_Obj12_VyStdDev : 203|9@1+ (0.1,0) [0|51.1] "m/s"  DASy
 SG_ VFC_Obj12_Ax : 212|9@1+ (0.1,-25.6) [-25.6|25.5] "m/s^2"  DASy
 SG_ VFC_Obj12_LightStatTurnIndicator : 221|3@1+ (1,0) [0|7] ""  DASy
 SG_ VFC_Obj12_Ay : 224|8@1+ (0.1,-12.8) [-12.8|12.7] "m/s^2"  DASy
 SG_ VFC_Obj12_AxStdDev : 232|8@1+ (0.1,0) [0|25.5] "m/s^2"  DASy
 SG_ VFC_Obj12_AyStdDev : 240|8@1+ (0.1,0) [0|25.5] "m/s^2"  DASy
 SG_ VFC_Obj12_MovementProbLat : 248|6@1+ (2,0) [0|100] "%"  DASy
 SG_ VFC_Obj12_MovementProbLong : 254|6@1+ (2,0) [0|100] "%"  DASy
 SG_ VFC_Obj12_2DAngPosEdgeLeft : 260|13@1+ (0.00025,-1.024) [-1.024|1.02375] "unitless"  DASy
 SG_ VFC_Obj12_2DAngPosEdgeRight : 273|13@1+ (0.00025,-1.024) [-1.024|1.02375] "unitless"  DASy
 SG_ VFC_Obj12_2DAngPosEdgeFar : 286|13@1+ (0.00025,-1.024) [-1.024|1.02375] "unitless"  DASy
 SG_ VFC_Obj12_2DAngPosEdgeBot : 299|12@1+ (0.00025,-0.512) [-0.512|0.51175] "unitless"  DASy
 SG_ VFC_Obj12_OutsideRoad : 311|1@1+ (1,0) [0|1] "unitless"  DASy
 SG_ VFC_Obj12_2DAngPosEdgeLeftStdDev : 312|8@1+ (0.0002,0) [0|0.051] "unitless"  DASy
 SG_ VFC_Obj12_2DAngPosEdgeRightStdDe : 320|8@1+ (0.0002,0) [0|0.051] "unitless"  DASy
 SG_ VFC_Obj12_2DAngPosEdgeFarStdDev : 328|8@1+ (0.0002,0) [0|0.051] "unitless"  DASy
 SG_ VFC_Obj12_2DAngPosEdgeBotStdDev : 336|8@1+ (0.0002,0) [0|0.051] "unitless"  DASy
 SG_ VFC_Obj12_2DNormVx : 344|16@1+ (0.001,-40) [-40|25.535] "1/s"  DASy
 SG_ VFC_Obj12_2DNormVy : 360|13@1+ (0.001,-4.096) [-4.096|4.095] "1/s"  DASy
 SG_ VFC_Obj12_2DNormAx : 373|13@1+ (0.002,-10) [-10|6.382] "1/s^2"  DASy
 SG_ VFC_Obj12_2DNormVxStdDev : 386|10@1+ (0.001,0) [0|1.023] "1/s"  DASy
 SG_ VFC_Obj12_MeasurementSource : 396|4@1+ (1,0) [0|15] ""  DASy
 SG_ VFC_Obj12_2DNormVyStdDev : 400|8@1+ (0.001,0) [0|0.255] "1/s"  DASy
 SG_ VFC_Obj12_2DNormAxStdDev : 408|10@1+ (0.0025,0) [0|2.5575] "1/s^2"  DASy
 SG_ VFC_Obj12_2DScaleChange : 418|14@1+ (0.0001,0.5) [0.5|2.1383] "unitless"  DASy
 SG_ VFC_Obj12_2DScaleChangeStdDev : 432|10@1+ (0.0001,0) [0|0.1023] "unitless"  DASy
 SG_ VFC_Obj12_Reliability : 442|6@1+ (1,0) [0|63] ""  DASy
 SG_ VFC_Obj12_LightStatBrakeLight : 448|3@1+ (1,0) [0|7] ""  DASy
 SG_ VFC_Obj12_OutsideRoadMeasStatus : 451|2@1+ (1,0) [0|3] ""  DASy
 SG_ VFC_Obj12_Oncoming : 453|1@1+ (1,0) [0|1] "unitless"  DASy
 SG_ VFC_Obj12_OncomingMeasStatus : 454|2@1+ (1,0) [0|3] ""  DASy
 SG_ VFC_Obj12_MovementStanding : 456|1@1+ (1,0) [0|1] "unitless"  DASy
 SG_ VFC_Obj12_MovementStandingMeasSt : 457|2@1+ (1,0) [0|3] ""  DASy
 SG_ VFC_Obj12_MovementObserved : 459|1@1+ (1,0) [0|1] "unitless"  DASy
 SG_ VFC_Obj12_MovementObservedMeasSt : 460|1@1+ (1,0) [0|1] ""  DASy
 SG_ VFC_Obj12_TargetObjTypeAcc : 461|3@1+ (1,0) [0|7] ""  DASy
 SG_ VFC_Obj12_TargetObjTypeAccConf : 464|6@1+ (2,0) [0|100] "%"  DASy

BO_ 67 VFC_Object13: 64 VideoFrontCenter
 SG_ VFC_Obj13_CRC : 0|16@1+ (1,0) [0|65535] ""  DASy
 SG_ VFC_Obj13_AliveCtr : 16|8@1+ (1,0) [0|255] ""  DASy
 SG_ VFC_Obj13_ProtBlockCtr : 24|4@1+ (1,0) [0|15] ""  DASy
 SG_ VFC_Obj13_ExistProb : 32|6@1+ (2,0) [0|100] "%"  DASy
 SG_ VFC_Obj13_MeasurementStatus : 38|2@1+ (1,0) [0|3] ""  DASy
 SG_ VFC_Obj13_ObjId : 40|6@1+ (1,0) [1|63] ""  DASy
 SG_ VFC_Obj13_Type : 46|4@1+ (1,0) [0|15] ""  DASy
 SG_ VFC_Obj13_TypeConf : 50|6@1+ (2,0) [0|100] "%"  DASy
 SG_ VFC_Obj13_VisibleView : 56|3@1+ (1,0) [0|7] ""  DASy
 SG_ VFC_Obj13_ClassifiedView : 59|3@1+ (1,0) [0|7] ""  DASy
 SG_ VFC_Obj13_Px : 62|12@1+ (0.05,0) [0|204.75] "m"  DASy
 SG_ VFC_Obj13_Py : 74|14@1+ (0.01,-81.92) [-81.92|81.91] "m"  DASy
 SG_ VFC_Obj13_PxStdDev : 88|10@1+ (0.05,0) [0|51.15] "m"  DASy
 SG_ VFC_Obj13_PyStdDev : 98|10@1+ (0.02,0) [0|20.46] "m"  DASy
 SG_ VFC_Obj13_OrientationYaw : 108|9@1+ (0.01,-2.56) [-1.57|1.57] "rad"  DASy
 SG_ VFC_Obj13_OrientationYawStdDev : 117|6@1+ (0.01,0) [0|0.63] "rad"  DASy
 SG_ VFC_Obj13_Length : 123|9@1+ (0.05,0) [0|25.55] "m"  DASy
 SG_ VFC_Obj13_Width : 132|10@1+ (0.01,0) [0|10.23] "m"  DASy
 SG_ VFC_Obj13_Height : 142|9@1+ (0.01,0) [0|5.11] "m"  DASy
 SG_ VFC_Obj13_LengthStdDev : 151|7@1+ (0.05,0) [0|6.35] "m"  DASy
 SG_ VFC_Obj13_WidthStdDev : 158|7@1+ (0.01,0) [0|1.27] "m"  DASy
 SG_ VFC_Obj13_HeightStdDev : 165|7@1+ (0.01,0) [0|1.27] "m"  DASy
 SG_ VFC_Obj13_Vx : 172|11@1+ (0.1,-154) [-154|50.7] "m/s"  DASy
 SG_ VFC_Obj13_Vy : 183|10@1+ (0.1,-51.2) [-51.2|51.1] "m/s"  DASy
 SG_ VFC_Obj13_VxStdDev : 193|10@1+ (0.1,0) [0|102.3] "m/s"  DASy
 SG_ VFC_Obj13_VyStdDev : 203|9@1+ (0.1,0) [0|51.1] "m/s"  DASy
 SG_ VFC_Obj13_Ax : 212|9@1+ (0.1,-25.6) [-25.6|25.5] "m/s^2"  DASy
 SG_ VFC_Obj13_LightStatTurnIndicator : 221|3@1+ (1,0) [0|7] ""  DASy
 SG_ VFC_Obj13_Ay : 224|8@1+ (0.1,-12.8) [-12.8|12.7] "m/s^2"  DASy
 SG_ VFC_Obj13_AxStdDev : 232|8@1+ (0.1,0) [0|25.5] "m/s^2"  DASy
 SG_ VFC_Obj13_AyStdDev : 240|8@1+ (0.1,0) [0|25.5] "m/s^2"  DASy
 SG_ VFC_Obj13_MovementProbLat : 248|6@1+ (2,0) [0|100] "%"  DASy
 SG_ VFC_Obj13_MovementProbLong : 254|6@1+ (2,0) [0|100] "%"  DASy
 SG_ VFC_Obj13_2DAngPosEdgeLeft : 260|13@1+ (0.00025,-1.024) [-1.024|1.02375] "unitless"  DASy
 SG_ VFC_Obj13_2DAngPosEdgeRight : 273|13@1+ (0.00025,-1.024) [-1.024|1.02375] "unitless"  DASy
 SG_ VFC_Obj13_2DAngPosEdgeFar : 286|13@1+ (0.00025,-1.024) [-1.024|1.02375] "unitless"  DASy
 SG_ VFC_Obj13_2DAngPosEdgeBot : 299|12@1+ (0.00025,-0.512) [-0.512|0.51175] "unitless"  DASy
 SG_ VFC_Obj13_OutsideRoad : 311|1@1+ (1,0) [0|1] "unitless"  DASy
 SG_ VFC_Obj13_2DAngPosEdgeLeftStdDev : 312|8@1+ (0.0002,0) [0|0.051] "unitless"  DASy
 SG_ VFC_Obj13_2DAngPosEdgeRightStdDe : 320|8@1+ (0.0002,0) [0|0.051] "unitless"  DASy
 SG_ VFC_Obj13_2DAngPosEdgeFarStdDev : 328|8@1+ (0.0002,0) [0|0.051] "unitless"  DASy
 SG_ VFC_Obj13_2DAngPosEdgeBotStdDev : 336|8@1+ (0.0002,0) [0|0.051] "unitless"  DASy
 SG_ VFC_Obj13_2DNormVx : 344|16@1+ (0.001,-40) [-40|25.535] "1/s"  DASy
 SG_ VFC_Obj13_2DNormVy : 360|13@1+ (0.001,-4.096) [-4.096|4.095] "1/s"  DASy
 SG_ VFC_Obj13_2DNormAx : 373|13@1+ (0.002,-10) [-10|6.382] "1/s^2"  DASy
 SG_ VFC_Obj13_2DNormVxStdDev : 386|10@1+ (0.001,0) [0|1.023] "1/s"  DASy
 SG_ VFC_Obj13_MeasurementSource : 396|4@1+ (1,0) [0|15] ""  DASy
 SG_ VFC_Obj13_2DNormVyStdDev : 400|8@1+ (0.001,0) [0|0.255] "1/s"  DASy
 SG_ VFC_Obj13_2DNormAxStdDev : 408|10@1+ (0.0025,0) [0|2.5575] "1/s^2"  DASy
 SG_ VFC_Obj13_2DScaleChange : 418|14@1+ (0.0001,0.5) [0.5|2.1383] "unitless"  DASy
 SG_ VFC_Obj13_2DScaleChangeStdDev : 432|10@1+ (0.0001,0) [0|0.1023] "unitless"  DASy
 SG_ VFC_Obj13_Reliability : 442|6@1+ (1,0) [0|63] ""  DASy
 SG_ VFC_Obj13_LightStatBrakeLight : 448|3@1+ (1,0) [0|7] ""  DASy
 SG_ VFC_Obj13_OutsideRoadMeasStatus : 451|2@1+ (1,0) [0|3] ""  DASy
 SG_ VFC_Obj13_Oncoming : 453|1@1+ (1,0) [0|1] "unitless"  DASy
 SG_ VFC_Obj13_OncomingMeasStatus : 454|2@1+ (1,0) [0|3] ""  DASy
 SG_ VFC_Obj13_MovementStanding : 456|1@1+ (1,0) [0|1] "unitless"  DASy
 SG_ VFC_Obj13_MovementStandingMeasSt : 457|2@1+ (1,0) [0|3] ""  DASy
 SG_ VFC_Obj13_MovementObserved : 459|1@1+ (1,0) [0|1] "unitless"  DASy
 SG_ VFC_Obj13_MovementObservedMeasSt : 460|1@1+ (1,0) [0|1] ""  DASy
 SG_ VFC_Obj13_TargetObjTypeAcc : 461|3@1+ (1,0) [0|7] ""  DASy
 SG_ VFC_Obj13_TargetObjTypeAccConf : 464|6@1+ (2,0) [0|100] "%"  DASy

BO_ 68 VFC_Object14: 64 VideoFrontCenter
 SG_ VFC_Obj14_CRC : 0|16@1+ (1,0) [0|65535] ""  DASy
 SG_ VFC_Obj14_AliveCtr : 16|8@1+ (1,0) [0|255] ""  DASy
 SG_ VFC_Obj14_ProtBlockCtr : 24|4@1+ (1,0) [0|15] ""  DASy
 SG_ VFC_Obj14_ExistProb : 32|6@1+ (2,0) [0|100] "%"  DASy
 SG_ VFC_Obj14_MeasurementStatus : 38|2@1+ (1,0) [0|3] ""  DASy
 SG_ VFC_Obj14_ObjId : 40|6@1+ (1,0) [1|63] ""  DASy
 SG_ VFC_Obj14_Type : 46|4@1+ (1,0) [0|15] ""  DASy
 SG_ VFC_Obj14_TypeConf : 50|6@1+ (2,0) [0|100] "%"  DASy
 SG_ VFC_Obj14_VisibleView : 56|3@1+ (1,0) [0|7] ""  DASy
 SG_ VFC_Obj14_ClassifiedView : 59|3@1+ (1,0) [0|7] ""  DASy
 SG_ VFC_Obj14_Px : 62|12@1+ (0.05,0) [0|204.75] "m"  DASy
 SG_ VFC_Obj14_Py : 74|14@1+ (0.01,-81.92) [-81.92|81.91] "m"  DASy
 SG_ VFC_Obj14_PxStdDev : 88|10@1+ (0.05,0) [0|51.15] "m"  DASy
 SG_ VFC_Obj14_PyStdDev : 98|10@1+ (0.02,0) [0|20.46] "m"  DASy
 SG_ VFC_Obj14_OrientationYaw : 108|9@1+ (0.01,-2.56) [-1.57|1.57] "rad"  DASy
 SG_ VFC_Obj14_OrientationYawStdDev : 117|6@1+ (0.01,0) [0|0.63] "rad"  DASy
 SG_ VFC_Obj14_Length : 123|9@1+ (0.05,0) [0|25.55] "m"  DASy
 SG_ VFC_Obj14_Width : 132|10@1+ (0.01,0) [0|10.23] "m"  DASy
 SG_ VFC_Obj14_Height : 142|9@1+ (0.01,0) [0|5.11] "m"  DASy
 SG_ VFC_Obj14_LengthStdDev : 151|7@1+ (0.05,0) [0|6.35] "m"  DASy
 SG_ VFC_Obj14_WidthStdDev : 158|7@1+ (0.01,0) [0|1.27] "m"  DASy
 SG_ VFC_Obj14_HeightStdDev : 165|7@1+ (0.01,0) [0|1.27] "m"  DASy
 SG_ VFC_Obj14_Vx : 172|11@1+ (0.1,-154) [-154|50.7] "m/s"  DASy
 SG_ VFC_Obj14_Vy : 183|10@1+ (0.1,-51.2) [-51.2|51.1] "m/s"  DASy
 SG_ VFC_Obj14_VxStdDev : 193|10@1+ (0.1,0) [0|102.3] "m/s"  DASy
 SG_ VFC_Obj14_VyStdDev : 203|9@1+ (0.1,0) [0|51.1] "m/s"  DASy
 SG_ VFC_Obj14_Ax : 212|9@1+ (0.1,-25.6) [-25.6|25.5] "m/s^2"  DASy
 SG_ VFC_Obj14_LightStatTurnIndicator : 221|3@1+ (1,0) [0|7] ""  DASy
 SG_ VFC_Obj14_Ay : 224|8@1+ (0.1,-12.8) [-12.8|12.7] "m/s^2"  DASy
 SG_ VFC_Obj14_AxStdDev : 232|8@1+ (0.1,0) [0|25.5] "m/s^2"  DASy
 SG_ VFC_Obj14_AyStdDev : 240|8@1+ (0.1,0) [0|25.5] "m/s^2"  DASy
 SG_ VFC_Obj14_MovementProbLat : 248|6@1+ (2,0) [0|100] "%"  DASy
 SG_ VFC_Obj14_MovementProbLong : 254|6@1+ (2,0) [0|100] "%"  DASy
 SG_ VFC_Obj14_2DAngPosEdgeLeft : 260|13@1+ (0.00025,-1.024) [-1.024|1.02375] "unitless"  DASy
 SG_ VFC_Obj14_2DAngPosEdgeRight : 273|13@1+ (0.00025,-1.024) [-1.024|1.02375] "unitless"  DASy
 SG_ VFC_Obj14_2DAngPosEdgeFar : 286|13@1+ (0.00025,-1.024) [-1.024|1.02375] "unitless"  DASy
 SG_ VFC_Obj14_2DAngPosEdgeBot : 299|12@1+ (0.00025,-0.512) [-0.512|0.51175] "unitless"  DASy
 SG_ VFC_Obj14_OutsideRoad : 311|1@1+ (1,0) [0|1] "unitless"  DASy
 SG_ VFC_Obj14_2DAngPosEdgeLeftStdDev : 312|8@1+ (0.0002,0) [0|0.051] "unitless"  DASy
 SG_ VFC_Obj14_2DAngPosEdgeRightStdDe : 320|8@1+ (0.0002,0) [0|0.051] "unitless"  DASy
 SG_ VFC_Obj14_2DAngPosEdgeFarStdDev : 328|8@1+ (0.0002,0) [0|0.051] "unitless"  DASy
 SG_ VFC_Obj14_2DAngPosEdgeBotStdDev : 336|8@1+ (0.0002,0) [0|0.051] "unitless"  DASy
 SG_ VFC_Obj14_2DNormVx : 344|16@1+ (0.001,-40) [-40|25.535] "1/s"  DASy
 SG_ VFC_Obj14_2DNormVy : 360|13@1+ (0.001,-4.096) [-4.096|4.095] "1/s"  DASy
 SG_ VFC_Obj14_2DNormAx : 373|13@1+ (0.002,-10) [-10|6.382] "1/s^2"  DASy
 SG_ VFC_Obj14_2DNormVxStdDev : 386|10@1+ (0.001,0) [0|1.023] "1/s"  DASy
 SG_ VFC_Obj14_MeasurementSource : 396|4@1+ (1,0) [0|15] ""  DASy
 SG_ VFC_Obj14_2DNormVyStdDev : 400|8@1+ (0.001,0) [0|0.255] "1/s"  DASy
 SG_ VFC_Obj14_2DNormAxStdDev : 408|10@1+ (0.0025,0) [0|2.5575] "1/s^2"  DASy
 SG_ VFC_Obj14_2DScaleChange : 418|14@1+ (0.0001,0.5) [0.5|2.1383] "unitless"  DASy
 SG_ VFC_Obj14_2DScaleChangeStdDev : 432|10@1+ (0.0001,0) [0|0.1023] "unitless"  DASy
 SG_ VFC_Obj14_Reliability : 442|6@1+ (1,0) [0|63] ""  DASy
 SG_ VFC_Obj14_LightStatBrakeLight : 448|3@1+ (1,0) [0|7] ""  DASy
 SG_ VFC_Obj14_OutsideRoadMeasStatus : 451|2@1+ (1,0) [0|3] ""  DASy
 SG_ VFC_Obj14_Oncoming : 453|1@1+ (1,0) [0|1] "unitless"  DASy
 SG_ VFC_Obj14_OncomingMeasStatus : 454|2@1+ (1,0) [0|3] ""  DASy
 SG_ VFC_Obj14_MovementStanding : 456|1@1+ (1,0) [0|1] "unitless"  DASy
 SG_ VFC_Obj14_MovementStandingMeasSt : 457|2@1+ (1,0) [0|3] ""  DASy
 SG_ VFC_Obj14_MovementObserved : 459|1@1+ (1,0) [0|1] "unitless"  DASy
 SG_ VFC_Obj14_MovementObservedMeasSt : 460|1@1+ (1,0) [0|1] ""  DASy
 SG_ VFC_Obj14_TargetObjTypeAcc : 461|3@1+ (1,0) [0|7] ""  DASy
 SG_ VFC_Obj14_TargetObjTypeAccConf : 464|6@1+ (2,0) [0|100] "%"  DASy

BO_ 69 VFC_Object15: 64 VideoFrontCenter
 SG_ VFC_Obj15_CRC : 0|16@1+ (1,0) [0|65535] ""  DASy
 SG_ VFC_Obj15_AliveCtr : 16|8@1+ (1,0) [0|255] ""  DASy
 SG_ VFC_Obj15_ProtBlockCtr : 24|4@1+ (1,0) [0|15] ""  DASy
 SG_ VFC_Obj15_ExistProb : 32|6@1+ (2,0) [0|100] "%"  DASy
 SG_ VFC_Obj15_MeasurementStatus : 38|2@1+ (1,0) [0|3] ""  DASy
 SG_ VFC_Obj15_ObjId : 40|6@1+ (1,0) [1|63] ""  DASy
 SG_ VFC_Obj15_Type : 46|4@1+ (1,0) [0|15] ""  DASy
 SG_ VFC_Obj15_TypeConf : 50|6@1+ (2,0) [0|100] "%"  DASy
 SG_ VFC_Obj15_VisibleView : 56|3@1+ (1,0) [0|7] ""  DASy
 SG_ VFC_Obj15_ClassifiedView : 59|3@1+ (1,0) [0|7] ""  DASy
 SG_ VFC_Obj15_Px : 62|12@1+ (0.05,0) [0|204.75] "m"  DASy
 SG_ VFC_Obj15_Py : 74|14@1+ (0.01,-81.92) [-81.92|81.91] "m"  DASy
 SG_ VFC_Obj15_PxStdDev : 88|10@1+ (0.05,0) [0|51.15] "m"  DASy
 SG_ VFC_Obj15_PyStdDev : 98|10@1+ (0.02,0) [0|20.46] "m"  DASy
 SG_ VFC_Obj15_OrientationYaw : 108|9@1+ (0.01,-2.56) [-1.57|1.57] "rad"  DASy
 SG_ VFC_Obj15_OrientationYawStdDev : 117|6@1+ (0.01,0) [0|0.63] "rad"  DASy
 SG_ VFC_Obj15_Length : 123|9@1+ (0.05,0) [0|25.55] "m"  DASy
 SG_ VFC_Obj15_Width : 132|10@1+ (0.01,0) [0|10.23] "m"  DASy
 SG_ VFC_Obj15_Height : 142|9@1+ (0.01,0) [0|5.11] "m"  DASy
 SG_ VFC_Obj15_LengthStdDev : 151|7@1+ (0.05,0) [0|6.35] "m"  DASy
 SG_ VFC_Obj15_WidthStdDev : 158|7@1+ (0.01,0) [0|1.27] "m"  DASy
 SG_ VFC_Obj15_HeightStdDev : 165|7@1+ (0.01,0) [0|1.27] "m"  DASy
 SG_ VFC_Obj15_Vx : 172|11@1+ (0.1,-154) [-154|50.7] "m/s"  DASy
 SG_ VFC_Obj15_Vy : 183|10@1+ (0.1,-51.2) [-51.2|51.1] "m/s"  DASy
 SG_ VFC_Obj15_VxStdDev : 193|10@1+ (0.1,0) [0|102.3] "m/s"  DASy
 SG_ VFC_Obj15_VyStdDev : 203|9@1+ (0.1,0) [0|51.1] "m/s"  DASy
 SG_ VFC_Obj15_Ax : 212|9@1+ (0.1,-25.6) [-25.6|25.5] "m/s^2"  DASy
 SG_ VFC_Obj15_LightStatTurnIndicator : 221|3@1+ (1,0) [0|7] ""  DASy
 SG_ VFC_Obj15_Ay : 224|8@1+ (0.1,-12.8) [-12.8|12.7] "m/s^2"  DASy
 SG_ VFC_Obj15_AxStdDev : 232|8@1+ (0.1,0) [0|25.5] "m/s^2"  DASy
 SG_ VFC_Obj15_AyStdDev : 240|8@1+ (0.1,0) [0|25.5] "m/s^2"  DASy
 SG_ VFC_Obj15_MovementProbLat : 248|6@1+ (2,0) [0|100] "%"  DASy
 SG_ VFC_Obj15_MovementProbLong : 254|6@1+ (2,0) [0|100] "%"  DASy
 SG_ VFC_Obj15_2DAngPosEdgeLeft : 260|13@1+ (0.00025,-1.024) [-1.024|1.02375] "unitless"  DASy
 SG_ VFC_Obj15_2DAngPosEdgeRight : 273|13@1+ (0.00025,-1.024) [-1.024|1.02375] "unitless"  DASy
 SG_ VFC_Obj15_2DAngPosEdgeFar : 286|13@1+ (0.00025,-1.024) [-1.024|1.02375] "unitless"  DASy
 SG_ VFC_Obj15_2DAngPosEdgeBot : 299|12@1+ (0.00025,-0.512) [-0.512|0.51175] "unitless"  DASy
 SG_ VFC_Obj15_OutsideRoad : 311|1@1+ (1,0) [0|1] "unitless"  DASy
 SG_ VFC_Obj15_2DAngPosEdgeLeftStdDev : 312|8@1+ (0.0002,0) [0|0.051] "unitless"  DASy
 SG_ VFC_Obj15_2DAngPosEdgeRightStdDe : 320|8@1+ (0.0002,0) [0|0.051] "unitless"  DASy
 SG_ VFC_Obj15_2DAngPosEdgeFarStdDev : 328|8@1+ (0.0002,0) [0|0.051] "unitless"  DASy
 SG_ VFC_Obj15_2DAngPosEdgeBotStdDev : 336|8@1+ (0.0002,0) [0|0.051] "unitless"  DASy
 SG_ VFC_Obj15_2DNormVx : 344|16@1+ (0.001,-40) [-40|25.535] "1/s"  DASy
 SG_ VFC_Obj15_2DNormVy : 360|13@1+ (0.001,-4.096) [-4.096|4.095] "1/s"  DASy
 SG_ VFC_Obj15_2DNormAx : 373|13@1+ (0.002,-10) [-10|6.382] "1/s^2"  DASy
 SG_ VFC_Obj15_2DNormVxStdDev : 386|10@1+ (0.001,0) [0|1.023] "1/s"  DASy
 SG_ VFC_Obj15_MeasurementSource : 396|4@1+ (1,0) [0|15] ""  DASy
 SG_ VFC_Obj15_2DNormVyStdDev : 400|8@1+ (0.001,0) [0|0.255] "1/s"  DASy
 SG_ VFC_Obj15_2DNormAxStdDev : 408|10@1+ (0.0025,0) [0|2.5575] "1/s^2"  DASy
 SG_ VFC_Obj15_2DScaleChange : 418|14@1+ (0.0001,0.5) [0.5|2.1383] "unitless"  DASy
 SG_ VFC_Obj15_2DScaleChangeStdDev : 432|10@1+ (0.0001,0) [0|0.1023] "unitless"  DASy
 SG_ VFC_Obj15_Reliability : 442|6@1+ (1,0) [0|63] ""  DASy
 SG_ VFC_Obj15_LightStatBrakeLight : 448|3@1+ (1,0) [0|7] ""  DASy
 SG_ VFC_Obj15_OutsideRoadMeasStatus : 451|2@1+ (1,0) [0|3] ""  DASy
 SG_ VFC_Obj15_Oncoming : 453|1@1+ (1,0) [0|1] "unitless"  DASy
 SG_ VFC_Obj15_OncomingMeasStatus : 454|2@1+ (1,0) [0|3] ""  DASy
 SG_ VFC_Obj15_MovementStanding : 456|1@1+ (1,0) [0|1] "unitless"  DASy
 SG_ VFC_Obj15_MovementStandingMeasSt : 457|2@1+ (1,0) [0|3] ""  DASy
 SG_ VFC_Obj15_MovementObserved : 459|1@1+ (1,0) [0|1] "unitless"  DASy
 SG_ VFC_Obj15_MovementObservedMeasSt : 460|1@1+ (1,0) [0|1] ""  DASy
 SG_ VFC_Obj15_TargetObjTypeAcc : 461|3@1+ (1,0) [0|7] ""  DASy
 SG_ VFC_Obj15_TargetObjTypeAccConf : 464|6@1+ (2,0) [0|100] "%"  DASy

BO_ 70 VFC_Object16: 64 VideoFrontCenter
 SG_ VFC_Obj16_CRC : 0|16@1+ (1,0) [0|65535] ""  DASy
 SG_ VFC_Obj16_AliveCtr : 16|8@1+ (1,0) [0|255] ""  DASy
 SG_ VFC_Obj16_ProtBlockCtr : 24|4@1+ (1,0) [0|15] ""  DASy
 SG_ VFC_Obj16_ExistProb : 32|6@1+ (2,0) [0|100] "%"  DASy
 SG_ VFC_Obj16_MeasurementStatus : 38|2@1+ (1,0) [0|3] ""  DASy
 SG_ VFC_Obj16_ObjId : 40|6@1+ (1,0) [1|63] ""  DASy
 SG_ VFC_Obj16_Type : 46|4@1+ (1,0) [0|15] ""  DASy
 SG_ VFC_Obj16_TypeConf : 50|6@1+ (2,0) [0|100] "%"  DASy
 SG_ VFC_Obj16_VisibleView : 56|3@1+ (1,0) [0|7] ""  DASy
 SG_ VFC_Obj16_ClassifiedView : 59|3@1+ (1,0) [0|7] ""  DASy
 SG_ VFC_Obj16_Px : 62|12@1+ (0.05,0) [0|204.75] "m"  DASy
 SG_ VFC_Obj16_Py : 74|14@1+ (0.01,-81.92) [-81.92|81.91] "m"  DASy
 SG_ VFC_Obj16_PxStdDev : 88|10@1+ (0.05,0) [0|51.15] "m"  DASy
 SG_ VFC_Obj16_PyStdDev : 98|10@1+ (0.02,0) [0|20.46] "m"  DASy
 SG_ VFC_Obj16_OrientationYaw : 108|9@1+ (0.01,-2.56) [-1.57|1.57] "rad"  DASy
 SG_ VFC_Obj16_OrientationYawStdDev : 117|6@1+ (0.01,0) [0|0.63] "rad"  DASy
 SG_ VFC_Obj16_Length : 123|9@1+ (0.05,0) [0|25.55] "m"  DASy
 SG_ VFC_Obj16_Width : 132|10@1+ (0.01,0) [0|10.23] "m"  DASy
 SG_ VFC_Obj16_Height : 142|9@1+ (0.01,0) [0|5.11] "m"  DASy
 SG_ VFC_Obj16_LengthStdDev : 151|7@1+ (0.05,0) [0|6.35] "m"  DASy
 SG_ VFC_Obj16_WidthStdDev : 158|7@1+ (0.01,0) [0|1.27] "m"  DASy
 SG_ VFC_Obj16_HeightStdDev : 165|7@1+ (0.01,0) [0|1.27] "m"  DASy
 SG_ VFC_Obj16_Vx : 172|11@1+ (0.1,-154) [-154|50.7] "m/s"  DASy
 SG_ VFC_Obj16_Vy : 183|10@1+ (0.1,-51.2) [-51.2|51.1] "m/s"  DASy
 SG_ VFC_Obj16_VxStdDev : 193|10@1+ (0.1,0) [0|102.3] "m/s"  DASy
 SG_ VFC_Obj16_VyStdDev : 203|9@1+ (0.1,0) [0|51.1] "m/s"  DASy
 SG_ VFC_Obj16_Ax : 212|9@1+ (0.1,-25.6) [-25.6|25.5] "m/s^2"  DASy
 SG_ VFC_Obj16_LightStatTurnIndicator : 221|3@1+ (1,0) [0|7] ""  DASy
 SG_ VFC_Obj16_Ay : 224|8@1+ (0.1,-12.8) [-12.8|12.7] "m/s^2"  DASy
 SG_ VFC_Obj16_AxStdDev : 232|8@1+ (0.1,0) [0|25.5] "m/s^2"  DASy
 SG_ VFC_Obj16_AyStdDev : 240|8@1+ (0.1,0) [0|25.5] "m/s^2"  DASy
 SG_ VFC_Obj16_MovementProbLat : 248|6@1+ (2,0) [0|100] "%"  DASy
 SG_ VFC_Obj16_MovementProbLong : 254|6@1+ (2,0) [0|100] "%"  DASy
 SG_ VFC_Obj16_2DAngPosEdgeLeft : 260|13@1+ (0.00025,-1.024) [-1.024|1.02375] "unitless"  DASy
 SG_ VFC_Obj16_2DAngPosEdgeRight : 273|13@1+ (0.00025,-1.024) [-1.024|1.02375] "unitless"  DASy
 SG_ VFC_Obj16_2DAngPosEdgeFar : 286|13@1+ (0.00025,-1.024) [-1.024|1.02375] "unitless"  DASy
 SG_ VFC_Obj16_2DAngPosEdgeBot : 299|12@1+ (0.00025,-0.512) [-0.512|0.51175] "unitless"  DASy
 SG_ VFC_Obj16_OutsideRoad : 311|1@1+ (1,0) [0|1] "unitless"  DASy
 SG_ VFC_Obj16_2DAngPosEdgeLeftStdDev : 312|8@1+ (0.0002,0) [0|0.051] "unitless"  DASy
 SG_ VFC_Obj16_2DAngPosEdgeRightStdDe : 320|8@1+ (0.0002,0) [0|0.051] "unitless"  DASy
 SG_ VFC_Obj16_2DAngPosEdgeFarStdDev : 328|8@1+ (0.0002,0) [0|0.051] "unitless"  DASy
 SG_ VFC_Obj16_2DAngPosEdgeBotStdDev : 336|8@1+ (0.0002,0) [0|0.051] "unitless"  DASy
 SG_ VFC_Obj16_2DNormVx : 344|16@1+ (0.001,-40) [-40|25.535] "1/s"  DASy
 SG_ VFC_Obj16_2DNormVy : 360|13@1+ (0.001,-4.096) [-4.096|4.095] "1/s"  DASy
 SG_ VFC_Obj16_2DNormAx : 373|13@1+ (0.002,-10) [-10|6.382] "1/s^2"  DASy
 SG_ VFC_Obj16_2DNormVxStdDev : 386|10@1+ (0.001,0) [0|1.023] "1/s"  DASy
 SG_ VFC_Obj16_MeasurementSource : 396|4@1+ (1,0) [0|15] ""  DASy
 SG_ VFC_Obj16_2DNormVyStdDev : 400|8@1+ (0.001,0) [0|0.255] "1/s"  DASy
 SG_ VFC_Obj16_2DNormAxStdDev : 408|10@1+ (0.0025,0) [0|2.5575] "1/s^2"  DASy
 SG_ VFC_Obj16_2DScaleChange : 418|14@1+ (0.0001,0.5) [0.5|2.1383] "unitless"  DASy
 SG_ VFC_Obj16_2DScaleChangeStdDev : 432|10@1+ (0.0001,0) [0|0.1023] "unitless"  DASy
 SG_ VFC_Obj16_Reliability : 442|6@1+ (1,0) [0|63] ""  DASy
 SG_ VFC_Obj16_LightStatBrakeLight : 448|3@1+ (1,0) [0|7] ""  DASy
 SG_ VFC_Obj16_OutsideRoadMeasStatus : 451|2@1+ (1,0) [0|3] ""  DASy
 SG_ VFC_Obj16_Oncoming : 453|1@1+ (1,0) [0|1] "unitless"  DASy
 SG_ VFC_Obj16_OncomingMeasStatus : 454|2@1+ (1,0) [0|3] ""  DASy
 SG_ VFC_Obj16_MovementStanding : 456|1@1+ (1,0) [0|1] "unitless"  DASy
 SG_ VFC_Obj16_MovementStandingMeasSt : 457|2@1+ (1,0) [0|3] ""  DASy
 SG_ VFC_Obj16_MovementObserved : 459|1@1+ (1,0) [0|1] "unitless"  DASy
 SG_ VFC_Obj16_MovementObservedMeasSt : 460|1@1+ (1,0) [0|1] ""  DASy
 SG_ VFC_Obj16_TargetObjTypeAcc : 461|3@1+ (1,0) [0|7] ""  DASy
 SG_ VFC_Obj16_TargetObjTypeAccConf : 464|6@1+ (2,0) [0|100] "%"  DASy

BO_ 71 VFC_Object17: 64 VideoFrontCenter
 SG_ VFC_Obj17_CRC : 0|16@1+ (1,0) [0|65535] ""  DASy
 SG_ VFC_Obj17_AliveCtr : 16|8@1+ (1,0) [0|255] ""  DASy
 SG_ VFC_Obj17_ProtBlockCtr : 24|4@1+ (1,0) [0|15] ""  DASy
 SG_ VFC_Obj17_ExistProb : 32|6@1+ (2,0) [0|100] "%"  DASy
 SG_ VFC_Obj17_MeasurementStatus : 38|2@1+ (1,0) [0|3] ""  DASy
 SG_ VFC_Obj17_ObjId : 40|6@1+ (1,0) [1|63] ""  DASy
 SG_ VFC_Obj17_Type : 46|4@1+ (1,0) [0|15] ""  DASy
 SG_ VFC_Obj17_TypeConf : 50|6@1+ (2,0) [0|100] "%"  DASy
 SG_ VFC_Obj17_VisibleView : 56|3@1+ (1,0) [0|7] ""  DASy
 SG_ VFC_Obj17_ClassifiedView : 59|3@1+ (1,0) [0|7] ""  DASy
 SG_ VFC_Obj17_Px : 62|12@1+ (0.05,0) [0|204.75] "m"  DASy
 SG_ VFC_Obj17_Py : 74|14@1+ (0.01,-81.92) [-81.92|81.91] "m"  DASy
 SG_ VFC_Obj17_PxStdDev : 88|10@1+ (0.05,0) [0|51.15] "m"  DASy
 SG_ VFC_Obj17_PyStdDev : 98|10@1+ (0.02,0) [0|20.46] "m"  DASy
 SG_ VFC_Obj17_OrientationYaw : 108|9@1+ (0.01,-2.56) [-1.57|1.57] "rad"  DASy
 SG_ VFC_Obj17_OrientationYawStdDev : 117|6@1+ (0.01,0) [0|0.63] "rad"  DASy
 SG_ VFC_Obj17_Length : 123|9@1+ (0.05,0) [0|25.55] "m"  DASy
 SG_ VFC_Obj17_Width : 132|10@1+ (0.01,0) [0|10.23] "m"  DASy
 SG_ VFC_Obj17_Height : 142|9@1+ (0.01,0) [0|5.11] "m"  DASy
 SG_ VFC_Obj17_LengthStdDev : 151|7@1+ (0.05,0) [0|6.35] "m"  DASy
 SG_ VFC_Obj17_WidthStdDev : 158|7@1+ (0.01,0) [0|1.27] "m"  DASy
 SG_ VFC_Obj17_HeightStdDev : 165|7@1+ (0.01,0) [0|1.27] "m"  DASy
 SG_ VFC_Obj17_Vx : 172|11@1+ (0.1,-154) [-154|50.7] "m/s"  DASy
 SG_ VFC_Obj17_Vy : 183|10@1+ (0.1,-51.2) [-51.2|51.1] "m/s"  DASy
 SG_ VFC_Obj17_VxStdDev : 193|10@1+ (0.1,0) [0|102.3] "m/s"  DASy
 SG_ VFC_Obj17_VyStdDev : 203|9@1+ (0.1,0) [0|51.1] "m/s"  DASy
 SG_ VFC_Obj17_Ax : 212|9@1+ (0.1,-25.6) [-25.6|25.5] "m/s^2"  DASy
 SG_ VFC_Obj17_LightStatTurnIndicator : 221|3@1+ (1,0) [0|7] ""  DASy
 SG_ VFC_Obj17_Ay : 224|8@1+ (0.1,-12.8) [-12.8|12.7] "m/s^2"  DASy
 SG_ VFC_Obj17_AxStdDev : 232|8@1+ (0.1,0) [0|25.5] "m/s^2"  DASy
 SG_ VFC_Obj17_AyStdDev : 240|8@1+ (0.1,0) [0|25.5] "m/s^2"  DASy
 SG_ VFC_Obj17_MovementProbLat : 248|6@1+ (2,0) [0|100] "%"  DASy
 SG_ VFC_Obj17_MovementProbLong : 254|6@1+ (2,0) [0|100] "%"  DASy
 SG_ VFC_Obj17_2DAngPosEdgeLeft : 260|13@1+ (0.00025,-1.024) [-1.024|1.02375] "unitless"  DASy
 SG_ VFC_Obj17_2DAngPosEdgeRight : 273|13@1+ (0.00025,-1.024) [-1.024|1.02375] "unitless"  DASy
 SG_ VFC_Obj17_2DAngPosEdgeFar : 286|13@1+ (0.00025,-1.024) [-1.024|1.02375] "unitless"  DASy
 SG_ VFC_Obj17_2DAngPosEdgeBot : 299|12@1+ (0.00025,-0.512) [-0.512|0.51175] "unitless"  DASy
 SG_ VFC_Obj17_OutsideRoad : 311|1@1+ (1,0) [0|1] "unitless"  DASy
 SG_ VFC_Obj17_2DAngPosEdgeLeftStdDev : 312|8@1+ (0.0002,0) [0|0.051] "unitless"  DASy
 SG_ VFC_Obj17_2DAngPosEdgeRightStdDe : 320|8@1+ (0.0002,0) [0|0.051] "unitless"  DASy
 SG_ VFC_Obj17_2DAngPosEdgeFarStdDev : 328|8@1+ (0.0002,0) [0|0.051] "unitless"  DASy
 SG_ VFC_Obj17_2DAngPosEdgeBotStdDev : 336|8@1+ (0.0002,0) [0|0.051] "unitless"  DASy
 SG_ VFC_Obj17_2DNormVx : 344|16@1+ (0.001,-40) [-40|25.535] "1/s"  DASy
 SG_ VFC_Obj17_2DNormVy : 360|13@1+ (0.001,-4.096) [-4.096|4.095] "1/s"  DASy
 SG_ VFC_Obj17_2DNormAx : 373|13@1+ (0.002,-10) [-10|6.382] "1/s^2"  DASy
 SG_ VFC_Obj17_2DNormVxStdDev : 386|10@1+ (0.001,0) [0|1.023] "1/s"  DASy
 SG_ VFC_Obj17_MeasurementSource : 396|4@1+ (1,0) [0|15] ""  DASy
 SG_ VFC_Obj17_2DNormVyStdDev : 400|8@1+ (0.001,0) [0|0.255] "1/s"  DASy
 SG_ VFC_Obj17_2DNormAxStdDev : 408|10@1+ (0.0025,0) [0|2.5575] "1/s^2"  DASy
 SG_ VFC_Obj17_2DScaleChange : 418|14@1+ (0.0001,0.5) [0.5|2.1383] "unitless"  DASy
 SG_ VFC_Obj17_2DScaleChangeStdDev : 432|10@1+ (0.0001,0) [0|0.1023] "unitless"  DASy
 SG_ VFC_Obj17_Reliability : 442|6@1+ (1,0) [0|63] ""  DASy
 SG_ VFC_Obj17_LightStatBrakeLight : 448|3@1+ (1,0) [0|7] ""  DASy
 SG_ VFC_Obj17_OutsideRoadMeasStatus : 451|2@1+ (1,0) [0|3] ""  DASy
 SG_ VFC_Obj17_Oncoming : 453|1@1+ (1,0) [0|1] "unitless"  DASy
 SG_ VFC_Obj17_OncomingMeasStatus : 454|2@1+ (1,0) [0|3] ""  DASy
 SG_ VFC_Obj17_MovementStanding : 456|1@1+ (1,0) [0|1] "unitless"  DASy
 SG_ VFC_Obj17_MovementStandingMeasSt : 457|2@1+ (1,0) [0|3] ""  DASy
 SG_ VFC_Obj17_MovementObserved : 459|1@1+ (1,0) [0|1] "unitless"  DASy
 SG_ VFC_Obj17_MovementObservedMeasSt : 460|1@1+ (1,0) [0|1] ""  DASy
 SG_ VFC_Obj17_TargetObjTypeAcc : 461|3@1+ (1,0) [0|7] ""  DASy
 SG_ VFC_Obj17_TargetObjTypeAccConf : 464|6@1+ (2,0) [0|100] "%"  DASy

BO_ 72 VFC_Object18: 64 VideoFrontCenter
 SG_ VFC_Obj18_CRC : 0|16@1+ (1,0) [0|65535] ""  DASy
 SG_ VFC_Obj18_AliveCtr : 16|8@1+ (1,0) [0|255] ""  DASy
 SG_ VFC_Obj18_ProtBlockCtr : 24|4@1+ (1,0) [0|15] ""  DASy
 SG_ VFC_Obj18_ExistProb : 32|6@1+ (2,0) [0|100] "%"  DASy
 SG_ VFC_Obj18_MeasurementStatus : 38|2@1+ (1,0) [0|3] ""  DASy
 SG_ VFC_Obj18_ObjId : 40|6@1+ (1,0) [1|63] ""  DASy
 SG_ VFC_Obj18_Type : 46|4@1+ (1,0) [0|15] ""  DASy
 SG_ VFC_Obj18_TypeConf : 50|6@1+ (2,0) [0|100] "%"  DASy
 SG_ VFC_Obj18_VisibleView : 56|3@1+ (1,0) [0|7] ""  DASy
 SG_ VFC_Obj18_ClassifiedView : 59|3@1+ (1,0) [0|7] ""  DASy
 SG_ VFC_Obj18_Px : 62|12@1+ (0.05,0) [0|204.75] "m"  DASy
 SG_ VFC_Obj18_Py : 74|14@1+ (0.01,-81.92) [-81.92|81.91] "m"  DASy
 SG_ VFC_Obj18_PxStdDev : 88|10@1+ (0.05,0) [0|51.15] "m"  DASy
 SG_ VFC_Obj18_PyStdDev : 98|10@1+ (0.02,0) [0|20.46] "m"  DASy
 SG_ VFC_Obj18_OrientationYaw : 108|9@1+ (0.01,-2.56) [-1.57|1.57] "rad"  DASy
 SG_ VFC_Obj18_OrientationYawStdDev : 117|6@1+ (0.01,0) [0|0.63] "rad"  DASy
 SG_ VFC_Obj18_Length : 123|9@1+ (0.05,0) [0|25.55] "m"  DASy
 SG_ VFC_Obj18_Width : 132|10@1+ (0.01,0) [0|10.23] "m"  DASy
 SG_ VFC_Obj18_Height : 142|9@1+ (0.01,0) [0|5.11] "m"  DASy
 SG_ VFC_Obj18_LengthStdDev : 151|7@1+ (0.05,0) [0|6.35] "m"  DASy
 SG_ VFC_Obj18_WidthStdDev : 158|7@1+ (0.01,0) [0|1.27] "m"  DASy
 SG_ VFC_Obj18_HeightStdDev : 165|7@1+ (0.01,0) [0|1.27] "m"  DASy
 SG_ VFC_Obj18_Vx : 172|11@1+ (0.1,-154) [-154|50.7] "m/s"  DASy
 SG_ VFC_Obj18_Vy : 183|10@1+ (0.1,-51.2) [-51.2|51.1] "m/s"  DASy
 SG_ VFC_Obj18_VxStdDev : 193|10@1+ (0.1,0) [0|102.3] "m/s"  DASy
 SG_ VFC_Obj18_VyStdDev : 203|9@1+ (0.1,0) [0|51.1] "m/s"  DASy
 SG_ VFC_Obj18_Ax : 212|9@1+ (0.1,-25.6) [-25.6|25.5] "m/s^2"  DASy
 SG_ VFC_Obj18_LightStatTurnIndicator : 221|3@1+ (1,0) [0|7] ""  DASy
 SG_ VFC_Obj18_Ay : 224|8@1+ (0.1,-12.8) [-12.8|12.7] "m/s^2"  DASy
 SG_ VFC_Obj18_AxStdDev : 232|8@1+ (0.1,0) [0|25.5] "m/s^2"  DASy
 SG_ VFC_Obj18_AyStdDev : 240|8@1+ (0.1,0) [0|25.5] "m/s^2"  DASy
 SG_ VFC_Obj18_MovementProbLat : 248|6@1+ (2,0) [0|100] "%"  DASy
 SG_ VFC_Obj18_MovementProbLong : 254|6@1+ (2,0) [0|100] "%"  DASy
 SG_ VFC_Obj18_2DAngPosEdgeLeft : 260|13@1+ (0.00025,-1.024) [-1.024|1.02375] "unitless"  DASy
 SG_ VFC_Obj18_2DAngPosEdgeRight : 273|13@1+ (0.00025,-1.024) [-1.024|1.02375] "unitless"  DASy
 SG_ VFC_Obj18_2DAngPosEdgeFar : 286|13@1+ (0.00025,-1.024) [-1.024|1.02375] "unitless"  DASy
 SG_ VFC_Obj18_2DAngPosEdgeBot : 299|12@1+ (0.00025,-0.512) [-0.512|0.51175] "unitless"  DASy
 SG_ VFC_Obj18_OutsideRoad : 311|1@1+ (1,0) [0|1] "unitless"  DASy
 SG_ VFC_Obj18_2DAngPosEdgeLeftStdDev : 312|8@1+ (0.0002,0) [0|0.051] "unitless"  DASy
 SG_ VFC_Obj18_2DAngPosEdgeRightStdDe : 320|8@1+ (0.0002,0) [0|0.051] "unitless"  DASy
 SG_ VFC_Obj18_2DAngPosEdgeFarStdDev : 328|8@1+ (0.0002,0) [0|0.051] "unitless"  DASy
 SG_ VFC_Obj18_2DAngPosEdgeBotStdDev : 336|8@1+ (0.0002,0) [0|0.051] "unitless"  DASy
 SG_ VFC_Obj18_2DNormVx : 344|16@1+ (0.001,-40) [-40|25.535] "1/s"  DASy
 SG_ VFC_Obj18_2DNormVy : 360|13@1+ (0.001,-4.096) [-4.096|4.095] "1/s"  DASy
 SG_ VFC_Obj18_2DNormAx : 373|13@1+ (0.002,-10) [-10|6.382] "1/s^2"  DASy
 SG_ VFC_Obj18_2DNormVxStdDev : 386|10@1+ (0.001,0) [0|1.023] "1/s"  DASy
 SG_ VFC_Obj18_MeasurementSource : 396|4@1+ (1,0) [0|15] ""  DASy
 SG_ VFC_Obj18_2DNormVyStdDev : 400|8@1+ (0.001,0) [0|0.255] "1/s"  DASy
 SG_ VFC_Obj18_2DNormAxStdDev : 408|10@1+ (0.0025,0) [0|2.5575] "1/s^2"  DASy
 SG_ VFC_Obj18_2DScaleChange : 418|14@1+ (0.0001,0.5) [0.5|2.1383] "unitless"  DASy
 SG_ VFC_Obj18_2DScaleChangeStdDev : 432|10@1+ (0.0001,0) [0|0.1023] "unitless"  DASy
 SG_ VFC_Obj18_Reliability : 442|6@1+ (1,0) [0|63] ""  DASy
 SG_ VFC_Obj18_LightStatBrakeLight : 448|3@1+ (1,0) [0|7] ""  DASy
 SG_ VFC_Obj18_OutsideRoadMeasStatus : 451|2@1+ (1,0) [0|3] ""  DASy
 SG_ VFC_Obj18_Oncoming : 453|1@1+ (1,0) [0|1] "unitless"  DASy
 SG_ VFC_Obj18_OncomingMeasStatus : 454|2@1+ (1,0) [0|3] ""  DASy
 SG_ VFC_Obj18_MovementStanding : 456|1@1+ (1,0) [0|1] "unitless"  DASy
 SG_ VFC_Obj18_MovementStandingMeasSt : 457|2@1+ (1,0) [0|3] ""  DASy
 SG_ VFC_Obj18_MovementObserved : 459|1@1+ (1,0) [0|1] "unitless"  DASy
 SG_ VFC_Obj18_MovementObservedMeasSt : 460|1@1+ (1,0) [0|1] ""  DASy
 SG_ VFC_Obj18_TargetObjTypeAcc : 461|3@1+ (1,0) [0|7] ""  DASy
 SG_ VFC_Obj18_TargetObjTypeAccConf : 464|6@1+ (2,0) [0|100] "%"  DASy

BO_ 73 VFC_Object19: 64 VideoFrontCenter
 SG_ VFC_Obj19_CRC : 0|16@1+ (1,0) [0|65535] ""  DASy
 SG_ VFC_Obj19_AliveCtr : 16|8@1+ (1,0) [0|255] ""  DASy
 SG_ VFC_Obj19_ProtBlockCtr : 24|4@1+ (1,0) [0|15] ""  DASy
 SG_ VFC_Obj19_ExistProb : 32|6@1+ (2,0) [0|100] "%"  DASy
 SG_ VFC_Obj19_MeasurementStatus : 38|2@1+ (1,0) [0|3] ""  DASy
 SG_ VFC_Obj19_ObjId : 40|6@1+ (1,0) [1|63] ""  DASy
 SG_ VFC_Obj19_Type : 46|4@1+ (1,0) [0|15] ""  DASy
 SG_ VFC_Obj19_TypeConf : 50|6@1+ (2,0) [0|100] "%"  DASy
 SG_ VFC_Obj19_VisibleView : 56|3@1+ (1,0) [0|7] ""  DASy
 SG_ VFC_Obj19_ClassifiedView : 59|3@1+ (1,0) [0|7] ""  DASy
 SG_ VFC_Obj19_Px : 62|12@1+ (0.05,0) [0|204.75] "m"  DASy
 SG_ VFC_Obj19_Py : 74|14@1+ (0.01,-81.92) [-81.92|81.91] "m"  DASy
 SG_ VFC_Obj19_PxStdDev : 88|10@1+ (0.05,0) [0|51.15] "m"  DASy
 SG_ VFC_Obj19_PyStdDev : 98|10@1+ (0.02,0) [0|20.46] "m"  DASy
 SG_ VFC_Obj19_OrientationYaw : 108|9@1+ (0.01,-2.56) [-1.57|1.57] "rad"  DASy
 SG_ VFC_Obj19_OrientationYawStdDev : 117|6@1+ (0.01,0) [0|0.63] "rad"  DASy
 SG_ VFC_Obj19_Length : 123|9@1+ (0.05,0) [0|25.55] "m"  DASy
 SG_ VFC_Obj19_Width : 132|10@1+ (0.01,0) [0|10.23] "m"  DASy
 SG_ VFC_Obj19_Height : 142|9@1+ (0.01,0) [0|5.11] "m"  DASy
 SG_ VFC_Obj19_LengthStdDev : 151|7@1+ (0.05,0) [0|6.35] "m"  DASy
 SG_ VFC_Obj19_WidthStdDev : 158|7@1+ (0.01,0) [0|1.27] "m"  DASy
 SG_ VFC_Obj19_HeightStdDev : 165|7@1+ (0.01,0) [0|1.27] "m"  DASy
 SG_ VFC_Obj19_Vx : 172|11@1+ (0.1,-154) [-154|50.7] "m/s"  DASy
 SG_ VFC_Obj19_Vy : 183|10@1+ (0.1,-51.2) [-51.2|51.1] "m/s"  DASy
 SG_ VFC_Obj19_VxStdDev : 193|10@1+ (0.1,0) [0|102.3] "m/s"  DASy
 SG_ VFC_Obj19_VyStdDev : 203|9@1+ (0.1,0) [0|51.1] "m/s"  DASy
 SG_ VFC_Obj19_Ax : 212|9@1+ (0.1,-25.6) [-25.6|25.5] "m/s^2"  DASy
 SG_ VFC_Obj19_LightStatTurnIndicator : 221|3@1+ (1,0) [0|7] ""  DASy
 SG_ VFC_Obj19_Ay : 224|8@1+ (0.1,-12.8) [-12.8|12.7] "m/s^2"  DASy
 SG_ VFC_Obj19_AxStdDev : 232|8@1+ (0.1,0) [0|25.5] "m/s^2"  DASy
 SG_ VFC_Obj19_AyStdDev : 240|8@1+ (0.1,0) [0|25.5] "m/s^2"  DASy
 SG_ VFC_Obj19_MovementProbLat : 248|6@1+ (2,0) [0|100] "%"  DASy
 SG_ VFC_Obj19_MovementProbLong : 254|6@1+ (2,0) [0|100] "%"  DASy
 SG_ VFC_Obj19_2DAngPosEdgeLeft : 260|13@1+ (0.00025,-1.024) [-1.024|1.02375] "unitless"  DASy
 SG_ VFC_Obj19_2DAngPosEdgeRight : 273|13@1+ (0.00025,-1.024) [-1.024|1.02375] "unitless"  DASy
 SG_ VFC_Obj19_2DAngPosEdgeFar : 286|13@1+ (0.00025,-1.024) [-1.024|1.02375] "unitless"  DASy
 SG_ VFC_Obj19_2DAngPosEdgeBot : 299|12@1+ (0.00025,-0.512) [-0.512|0.51175] "unitless"  DASy
 SG_ VFC_Obj19_OutsideRoad : 311|1@1+ (1,0) [0|1] "unitless"  DASy
 SG_ VFC_Obj19_2DAngPosEdgeLeftStdDev : 312|8@1+ (0.0002,0) [0|0.051] "unitless"  DASy
 SG_ VFC_Obj19_2DAngPosEdgeRightStdDe : 320|8@1+ (0.0002,0) [0|0.051] "unitless"  DASy
 SG_ VFC_Obj19_2DAngPosEdgeFarStdDev : 328|8@1+ (0.0002,0) [0|0.051] "unitless"  DASy
 SG_ VFC_Obj19_2DAngPosEdgeBotStdDev : 336|8@1+ (0.0002,0) [0|0.051] "unitless"  DASy
 SG_ VFC_Obj19_2DNormVx : 344|16@1+ (0.001,-40) [-40|25.535] "1/s"  DASy
 SG_ VFC_Obj19_2DNormVy : 360|13@1+ (0.001,-4.096) [-4.096|4.095] "1/s"  DASy
 SG_ VFC_Obj19_2DNormAx : 373|13@1+ (0.002,-10) [-10|6.382] "1/s^2"  DASy
 SG_ VFC_Obj19_2DNormVxStdDev : 386|10@1+ (0.001,0) [0|1.023] "1/s"  DASy
 SG_ VFC_Obj19_MeasurementSource : 396|4@1+ (1,0) [0|15] ""  DASy
 SG_ VFC_Obj19_2DNormVyStdDev : 400|8@1+ (0.001,0) [0|0.255] "1/s"  DASy
 SG_ VFC_Obj19_2DNormAxStdDev : 408|10@1+ (0.0025,0) [0|2.5575] "1/s^2"  DASy
 SG_ VFC_Obj19_2DScaleChange : 418|14@1+ (0.0001,0.5) [0.5|2.1383] "unitless"  DASy
 SG_ VFC_Obj19_2DScaleChangeStdDev : 432|10@1+ (0.0001,0) [0|0.1023] "unitless"  DASy
 SG_ VFC_Obj19_Reliability : 442|6@1+ (1,0) [0|63] ""  DASy
 SG_ VFC_Obj19_LightStatBrakeLight : 448|3@1+ (1,0) [0|7] ""  DASy
 SG_ VFC_Obj19_OutsideRoadMeasStatus : 451|2@1+ (1,0) [0|3] ""  DASy
 SG_ VFC_Obj19_Oncoming : 453|1@1+ (1,0) [0|1] "unitless"  DASy
 SG_ VFC_Obj19_OncomingMeasStatus : 454|2@1+ (1,0) [0|3] ""  DASy
 SG_ VFC_Obj19_MovementStanding : 456|1@1+ (1,0) [0|1] "unitless"  DASy
 SG_ VFC_Obj19_MovementStandingMeasSt : 457|2@1+ (1,0) [0|3] ""  DASy
 SG_ VFC_Obj19_MovementObserved : 459|1@1+ (1,0) [0|1] "unitless"  DASy
 SG_ VFC_Obj19_MovementObservedMeasSt : 460|1@1+ (1,0) [0|1] ""  DASy
 SG_ VFC_Obj19_TargetObjTypeAcc : 461|3@1+ (1,0) [0|7] ""  DASy
 SG_ VFC_Obj19_TargetObjTypeAccConf : 464|6@1+ (2,0) [0|100] "%"  DASy

BO_ 74 VFC_Object20: 64 VideoFrontCenter
 SG_ VFC_Obj20_CRC : 0|16@1+ (1,0) [0|65535] ""  DASy
 SG_ VFC_Obj20_AliveCtr : 16|8@1+ (1,0) [0|255] ""  DASy
 SG_ VFC_Obj20_ProtBlockCtr : 24|4@1+ (1,0) [0|15] ""  DASy
 SG_ VFC_Obj20_ExistProb : 32|6@1+ (2,0) [0|100] "%"  DASy
 SG_ VFC_Obj20_MeasurementStatus : 38|2@1+ (1,0) [0|3] ""  DASy
 SG_ VFC_Obj20_ObjId : 40|6@1+ (1,0) [1|63] ""  DASy
 SG_ VFC_Obj20_Type : 46|4@1+ (1,0) [0|15] ""  DASy
 SG_ VFC_Obj20_TypeConf : 50|6@1+ (2,0) [0|100] "%"  DASy
 SG_ VFC_Obj20_VisibleView : 56|3@1+ (1,0) [0|7] ""  DASy
 SG_ VFC_Obj20_ClassifiedView : 59|3@1+ (1,0) [0|7] ""  DASy
 SG_ VFC_Obj20_Px : 62|12@1+ (0.05,0) [0|204.75] "m"  DASy
 SG_ VFC_Obj20_Py : 74|14@1+ (0.01,-81.92) [-81.92|81.91] "m"  DASy
 SG_ VFC_Obj20_PxStdDev : 88|10@1+ (0.05,0) [0|51.15] "m"  DASy
 SG_ VFC_Obj20_PyStdDev : 98|10@1+ (0.02,0) [0|20.46] "m"  DASy
 SG_ VFC_Obj20_OrientationYaw : 108|9@1+ (0.01,-2.56) [-1.57|1.57] "rad"  DASy
 SG_ VFC_Obj20_OrientationYawStdDev : 117|6@1+ (0.01,0) [0|0.63] "rad"  DASy
 SG_ VFC_Obj20_Length : 123|9@1+ (0.05,0) [0|25.55] "m"  DASy
 SG_ VFC_Obj20_Width : 132|10@1+ (0.01,0) [0|10.23] "m"  DASy
 SG_ VFC_Obj20_Height : 142|9@1+ (0.01,0) [0|5.11] "m"  DASy
 SG_ VFC_Obj20_LengthStdDev : 151|7@1+ (0.05,0) [0|6.35] "m"  DASy
 SG_ VFC_Obj20_WidthStdDev : 158|7@1+ (0.01,0) [0|1.27] "m"  DASy
 SG_ VFC_Obj20_HeightStdDev : 165|7@1+ (0.01,0) [0|1.27] "m"  DASy
 SG_ VFC_Obj20_Vx : 172|11@1+ (0.1,-154) [-154|50.7] "m/s"  DASy
 SG_ VFC_Obj20_Vy : 183|10@1+ (0.1,-51.2) [-51.2|51.1] "m/s"  DASy
 SG_ VFC_Obj20_VxStdDev : 193|10@1+ (0.1,0) [0|102.3] "m/s"  DASy
 SG_ VFC_Obj20_VyStdDev : 203|9@1+ (0.1,0) [0|51.1] "m/s"  DASy
 SG_ VFC_Obj20_Ax : 212|9@1+ (0.1,-25.6) [-25.6|25.5] "m/s^2"  DASy
 SG_ VFC_Obj20_LightStatTurnIndicator : 221|3@1+ (1,0) [0|7] ""  DASy
 SG_ VFC_Obj20_Ay : 224|8@1+ (0.1,-12.8) [-12.8|12.7] "m/s^2"  DASy
 SG_ VFC_Obj20_AxStdDev : 232|8@1+ (0.1,0) [0|25.5] "m/s^2"  DASy
 SG_ VFC_Obj20_AyStdDev : 240|8@1+ (0.1,0) [0|25.5] "m/s^2"  DASy
 SG_ VFC_Obj20_MovementProbLat : 248|6@1+ (2,0) [0|100] "%"  DASy
 SG_ VFC_Obj20_MovementProbLong : 254|6@1+ (2,0) [0|100] "%"  DASy
 SG_ VFC_Obj20_2DAngPosEdgeLeft : 260|13@1+ (0.00025,-1.024) [-1.024|1.02375] "unitless"  DASy
 SG_ VFC_Obj20_2DAngPosEdgeRight : 273|13@1+ (0.00025,-1.024) [-1.024|1.02375] "unitless"  DASy
 SG_ VFC_Obj20_2DAngPosEdgeFar : 286|13@1+ (0.00025,-1.024) [-1.024|1.02375] "unitless"  DASy
 SG_ VFC_Obj20_2DAngPosEdgeBot : 299|12@1+ (0.00025,-0.512) [-0.512|0.51175] "unitless"  DASy
 SG_ VFC_Obj20_OutsideRoad : 311|1@1+ (1,0) [0|1] "unitless"  DASy
 SG_ VFC_Obj20_2DAngPosEdgeLeftStdDev : 312|8@1+ (0.0002,0) [0|0.051] "unitless"  DASy
 SG_ VFC_Obj20_2DAngPosEdgeRightStdDe : 320|8@1+ (0.0002,0) [0|0.051] "unitless"  DASy
 SG_ VFC_Obj20_2DAngPosEdgeFarStdDev : 328|8@1+ (0.0002,0) [0|0.051] "unitless"  DASy
 SG_ VFC_Obj20_2DAngPosEdgeBotStdDev : 336|8@1+ (0.0002,0) [0|0.051] "unitless"  DASy
 SG_ VFC_Obj20_2DNormVx : 344|16@1+ (0.001,-40) [-40|25.535] "1/s"  DASy
 SG_ VFC_Obj20_2DNormVy : 360|13@1+ (0.001,-4.096) [-4.096|4.095] "1/s"  DASy
 SG_ VFC_Obj20_2DNormAx : 373|13@1+ (0.002,-10) [-10|6.382] "1/s^2"  DASy
 SG_ VFC_Obj20_2DNormVxStdDev : 386|10@1+ (0.001,0) [0|1.023] "1/s"  DASy
 SG_ VFC_Obj20_MeasurementSource : 396|4@1+ (1,0) [0|15] ""  DASy
 SG_ VFC_Obj20_2DNormVyStdDev : 400|8@1+ (0.001,0) [0|0.255] "1/s"  DASy
 SG_ VFC_Obj20_2DNormAxStdDev : 408|10@1+ (0.0025,0) [0|2.5575] "1/s^2"  DASy
 SG_ VFC_Obj20_2DScaleChange : 418|14@1+ (0.0001,0.5) [0.5|2.1383] "unitless"  DASy
 SG_ VFC_Obj20_2DScaleChangeStdDev : 432|10@1+ (0.0001,0) [0|0.1023] "unitless"  DASy
 SG_ VFC_Obj20_Reliability : 442|6@1+ (1,0) [0|63] ""  DASy
 SG_ VFC_Obj20_LightStatBrakeLight : 448|3@1+ (1,0) [0|7] ""  DASy
 SG_ VFC_Obj20_OutsideRoadMeasStatus : 451|2@1+ (1,0) [0|3] ""  DASy
 SG_ VFC_Obj20_Oncoming : 453|1@1+ (1,0) [0|1] "unitless"  DASy
 SG_ VFC_Obj20_OncomingMeasStatus : 454|2@1+ (1,0) [0|3] ""  DASy
 SG_ VFC_Obj20_MovementStanding : 456|1@1+ (1,0) [0|1] "unitless"  DASy
 SG_ VFC_Obj20_MovementStandingMeasSt : 457|2@1+ (1,0) [0|3] ""  DASy
 SG_ VFC_Obj20_MovementObserved : 459|1@1+ (1,0) [0|1] "unitless"  DASy
 SG_ VFC_Obj20_MovementObservedMeasSt : 460|1@1+ (1,0) [0|1] ""  DASy
 SG_ VFC_Obj20_TargetObjTypeAcc : 461|3@1+ (1,0) [0|7] ""  DASy
 SG_ VFC_Obj20_TargetObjTypeAccConf : 464|6@1+ (2,0) [0|100] "%"  DASy

CM_ SG_ 64 VFC_Obj10_CRC "CRC - Autosar E2E Profile 5";
CM_ SG_ 64 VFC_Obj10_AliveCtr "Alive counter - Autosar E2E Profile 5";
CM_ SG_ 64 VFC_Obj10_ProtBlockCtr "Protocol-Signal: Block-Counter";
CM_ SG_ 64 VFC_Obj10_ExistProb "Object existence probability. ISO 23150:2023: Existence probability - object level (A.2.1)";
CM_ SG_ 64 VFC_Obj10_MeasurementStatus "Indicator if the object detected is measured or predicted. ISO 23150:2023: Measurement status - object level (A.2.9)";
CM_ SG_ 64 VFC_Obj10_ObjId "Unique Object ID. ISO 23150:2023: Object ID (A.2.2)";
CM_ SG_ 64 VFC_Obj10_Type "Classification of the object. ISO 23150:2023: Potentially moving object classification type (A.2.12)";
CM_ SG_ 64 VFC_Obj10_TypeConf "Confidence of the classified object type. ISO 23150:2023: Potentially moving object classification type - confidence (A.2.13)";
CM_ SG_ 64 VFC_Obj10_VisibleView "The visible view of the detected object. Reference point is in the middle of CLASSIC (front/rear) or SIDE (left/right). Related to ISO 23150:2023: Reference point (A.2.14)";
CM_ SG_ 64 VFC_Obj10_ClassifiedView "The classified view of object to be used in connection with VisibleView and Heading angle. Related to ISO 23150:2023: Reference point (A.2.14)";
CM_ SG_ 64 VFC_Obj10_Px "Object distance in longitudinal direction. ISO 23150:2023: Position - object level {x, y, z} (A.2.15)";
CM_ SG_ 64 VFC_Obj10_Py "Object distance in lateral direction. ISO 23150:2023: Position - object level {x, y, z} (A.2.15)";
CM_ SG_ 64 VFC_Obj10_PxStdDev "Standard deviation of Object distance in longitudinal direction. ISO 23150:2023: Position - object level {x, y, z} - error (A.2.16)";
CM_ SG_ 64 VFC_Obj10_PyStdDev "Standard deviation of Object distance in lateral direction. ISO 23150:2023: Position - object level {x, y, z} - error (A.2.16)";
CM_ SG_ 64 VFC_Obj10_OrientationYaw "Heading angle of the object. ISO 23150:2023: Orientation {yaw, pitch, roll} (A.2.17)";
CM_ SG_ 64 VFC_Obj10_OrientationYawStdDev "Standard deviation of object Heading angle. ISO 23150:2023: Orientation {yaw, pitch, roll} - error (A.2.18)";
CM_ SG_ 64 VFC_Obj10_Length "Length of the object. ISO 23150:2023: Bounding box extent {length, width, height} (A.2.20)";
CM_ SG_ 64 VFC_Obj10_Width "Width of the object. ISO 23150:2023: Bounding box extent {length, width, height} (A.2.20)";
CM_ SG_ 64 VFC_Obj10_Height "Height of the object. ISO 23150:2023: Bounding box extent {length, width, height} (A.2.20)";
CM_ SG_ 64 VFC_Obj10_LengthStdDev "Standard deviation of object length. ISO 23150:2023: Bounding box extent {length, width, height} - error (A.2.21)";
CM_ SG_ 64 VFC_Obj10_WidthStdDev "Standard deviation of object width. ISO 23150:2023: Bounding box extent {length, width, height} - error (A.2.21)";
CM_ SG_ 64 VFC_Obj10_HeightStdDev "Standard deviation of object height. ISO 23150:2023: Bounding box extent {length, width, height} - error (A.2.21)";
CM_ SG_ 64 VFC_Obj10_Vx "Object velocity in longitudinal direction. ISO 23150:2023: Velocity {x, y, z} - object level (A.2.24)";
CM_ SG_ 64 VFC_Obj10_Vy "Object velocity in lateral direction. ISO 23150:2023: Velocity {x, y, z} - object level (A.2.24)";
CM_ SG_ 64 VFC_Obj10_VxStdDev "Standard deviation of Object velocity in longitudinal direction. ISO 23150:2023: Velocity {x, y, z} - object level - error (A.2.25)";
CM_ SG_ 64 VFC_Obj10_VyStdDev "Standard deviation of Object velocity in lateral direction. ISO 23150:2023: Velocity {x, y, z} - object level - error (A.2.25)";
CM_ SG_ 64 VFC_Obj10_Ax "Object acceleration in longitudinal direction. ISO 23150:2023: Acceleration {x, y, z} (A.2.26)";
CM_ SG_ 64 VFC_Obj10_LightStatTurnIndicator "The detected direction indicator lights. Similar to ISO 23150:2023: Light status (A.2.35)";
CM_ SG_ 64 VFC_Obj10_Ay "Object acceleration in lateral direction. ISO 23150:2023: Acceleration {x, y, z} (A.2.26)";
CM_ SG_ 64 VFC_Obj10_AxStdDev "Standard deviation of Object acceleration in longitudinal direction. ISO 23150:2023: Acceleration {x, y, z} - error (A.2.27)";
CM_ SG_ 64 VFC_Obj10_AyStdDev "Standard deviation of Object acceleration in lateral direction. ISO 23150:2023: Acceleration {x, y, z} - error (A.2.27)";
CM_ SG_ 64 VFC_Obj10_MovementProbLat "Probability of object moving laterally (current state, not if moved at all in object history). Related to ISO 23150:2023: Movement status (A.2.32)";
CM_ SG_ 64 VFC_Obj10_MovementProbLong "Probability of object moving longitudinally (current state, not if moved at all in object history). Related to ISO 23150:2023: Movement status (A.2.32)";
CM_ SG_ 64 VFC_Obj10_2DAngPosEdgeLeft "Bounding box left edge in sensor coordinate system in ACCS coordinates; corresponds to tan(viewing angle of  object edge). ISO 23150:2023: Angular position {azimuth} (A.2.68)";
CM_ SG_ 64 VFC_Obj10_2DAngPosEdgeRight "Bounding box right edge in sensor coordinate system in ACCS coordinates; corresponds to tan(viewing angle of  object edge). ISO 23150:2023: Angular position {azimuth} (A.2.68)";
CM_ SG_ 64 VFC_Obj10_2DAngPosEdgeFar "Bounding box far edge in sensor coordinate system in ACCS coordinates; corresponds to tan(viewing angle of  object edge). ISO 23150:2023: Angular position {azimuth} (A.2.68)";
CM_ SG_ 64 VFC_Obj10_2DAngPosEdgeBot "Bounding box bottom edge in sensor coordinate system in ACCS coordinates; corresponds to tan(viewing angle of  object edge). Sign: upward direction negative value. ISO 23150:2023: Angular position {azimuth} (A.2.68)";
CM_ SG_ 64 VFC_Obj10_OutsideRoad "2D object is located outside road boundary (if signal is available)";
CM_ SG_ 64 VFC_Obj10_2DAngPosEdgeLeftStdDev "Standard deviation of the bounding box left edge";
CM_ SG_ 64 VFC_Obj10_2DAngPosEdgeRightStdDe "Standard deviation of the bounding box right edge";
CM_ SG_ 64 VFC_Obj10_2DAngPosEdgeFarStdDev "Standard deviation of the bounding box far edge";
CM_ SG_ 64 VFC_Obj10_2DAngPosEdgeBotStdDev "Standard deviation of the bounding box bottom edge";
CM_ SG_ 64 VFC_Obj10_2DNormVx "Normalised Object velocity in longitudinal direction (vx/dx_cam). Related to ISO 23150:2023: Angular velocity {azimuth} (A.2.69)";
CM_ SG_ 64 VFC_Obj10_2DNormVy "Normalised Object velocity in lateral direction (vy/dx_cam)";
CM_ SG_ 64 VFC_Obj10_2DNormAx "Normalised Object acceleration in longitudinal direction (ax/dx_cam)";
CM_ SG_ 64 VFC_Obj10_2DNormVxStdDev "Standard deviation of Normalised Object velocity in longitudinal direction";
CM_ SG_ 64 VFC_Obj10_MeasurementSource "Bitfield for the measurement programs from which this object originates
Bit 0: MOD
Bit 1: PDET
Bit 2: OFT
Bit 3: INVALID";
CM_ SG_ 64 VFC_Obj10_2DNormVyStdDev "Standard deviation of Normalised Object velocity in lateral direction";
CM_ SG_ 64 VFC_Obj10_2DNormAxStdDev "Standard deviation of Normalised Object acceleration in longitudinal direction";
CM_ SG_ 64 VFC_Obj10_2DScaleChange "Change in scale of the object in sensor's projection plane. ISO 23150:2023: Scale change - object level (A.2.70)";
CM_ SG_ 64 VFC_Obj10_2DScaleChangeStdDev "Standard deviation of object scale change";
CM_ SG_ 64 VFC_Obj10_Reliability "The bitfield shows if the signal quality is assumed to be sufficient for functions with safety target -no false positives-
Bit 0: DYNAMIC
Bit 1: SEMSEG_SURFACE
Bit 2: WDD_CRITICAL
Bit 3: GOD_CONFIRMED
Bit 4: RESTRICTED
Bit 5: ISO26262_SAFE";
CM_ SG_ 64 VFC_Obj10_LightStatBrakeLight "The number of detected lights. More confident if more lights are detected. Similar to ISO 23150:2023: Light status (A.2.35)";
CM_ SG_ 64 VFC_Obj10_OutsideRoadMeasStatus "2D object outside road boundary measurement status, indicator if it is measured or predicted (if signal is available)";
CM_ SG_ 64 VFC_Obj10_Oncoming "Object is oncoming (if signal is available)";
CM_ SG_ 64 VFC_Obj10_OncomingMeasStatus "Object oncoming measurement status, indicator if it is measured or predicted (if signal is available)";
CM_ SG_ 64 VFC_Obj10_MovementStanding "Object is standing (if signal is available). Related to ISO 23150:2023: Movement status (A.2.32)";
CM_ SG_ 64 VFC_Obj10_MovementStandingMeasSt "Object standing measurement status, indicator if it is measured or predicted (if signal is available)";
CM_ SG_ 64 VFC_Obj10_MovementObserved "Object has been observed moving over the ground since it was first detected (if signal is available). Related to ISO 23150:2023: Movement status (A.2.32)";
CM_ SG_ 64 VFC_Obj10_MovementObservedMeasSt "Measurement status for object has been observed moving (if signal is available)";
CM_ SG_ 64 VFC_Obj10_TargetObjTypeAcc "2D target object type for ACC (if signal is available)";
CM_ SG_ 64 VFC_Obj10_TargetObjTypeAccConf "Confidence of 2D target object type detection for ACC (if signal is available)";
CM_ SG_ 65 VFC_Obj11_CRC "CRC - Autosar E2E Profile 5";
CM_ SG_ 65 VFC_Obj11_AliveCtr "Alive counter - Autosar E2E Profile 5";
CM_ SG_ 65 VFC_Obj11_ProtBlockCtr "Protocol-Signal: Block-Counter";
CM_ SG_ 65 VFC_Obj11_ExistProb "Object existence probability. ISO 23150:2023: Existence probability - object level (A.2.1)";
CM_ SG_ 65 VFC_Obj11_MeasurementStatus "Indicator if the object detected is measured or predicted. ISO 23150:2023: Measurement status - object level (A.2.9)";
CM_ SG_ 65 VFC_Obj11_ObjId "Unique Object ID. ISO 23150:2023: Object ID (A.2.2)";
CM_ SG_ 65 VFC_Obj11_Type "Classification of the object. ISO 23150:2023: Potentially moving object classification type (A.2.12)";
CM_ SG_ 65 VFC_Obj11_TypeConf "Confidence of the classified object type. ISO 23150:2023: Potentially moving object classification type - confidence (A.2.13)";
CM_ SG_ 65 VFC_Obj11_VisibleView "The visible view of the detected object. Reference point is in the middle of CLASSIC (front/rear) or SIDE (left/right). Related to ISO 23150:2023: Reference point (A.2.14)";
CM_ SG_ 65 VFC_Obj11_ClassifiedView "The classified view of object to be used in connection with VisibleView and Heading angle. Related to ISO 23150:2023: Reference point (A.2.14)";
CM_ SG_ 65 VFC_Obj11_Px "Object distance in longitudinal direction. ISO 23150:2023: Position - object level {x, y, z} (A.2.15)";
CM_ SG_ 65 VFC_Obj11_Py "Object distance in lateral direction. ISO 23150:2023: Position - object level {x, y, z} (A.2.15)";
CM_ SG_ 65 VFC_Obj11_PxStdDev "Standard deviation of Object distance in longitudinal direction. ISO 23150:2023: Position - object level {x, y, z} - error (A.2.16)";
CM_ SG_ 65 VFC_Obj11_PyStdDev "Standard deviation of Object distance in lateral direction. ISO 23150:2023: Position - object level {x, y, z} - error (A.2.16)";
CM_ SG_ 65 VFC_Obj11_OrientationYaw "Heading angle of the object. ISO 23150:2023: Orientation {yaw, pitch, roll} (A.2.17)";
CM_ SG_ 65 VFC_Obj11_OrientationYawStdDev "Standard deviation of object Heading angle. ISO 23150:2023: Orientation {yaw, pitch, roll} - error (A.2.18)";
CM_ SG_ 65 VFC_Obj11_Length "Length of the object. ISO 23150:2023: Bounding box extent {length, width, height} (A.2.20)";
CM_ SG_ 65 VFC_Obj11_Width "Width of the object. ISO 23150:2023: Bounding box extent {length, width, height} (A.2.20)";
CM_ SG_ 65 VFC_Obj11_Height "Height of the object. ISO 23150:2023: Bounding box extent {length, width, height} (A.2.20)";
CM_ SG_ 65 VFC_Obj11_LengthStdDev "Standard deviation of object length. ISO 23150:2023: Bounding box extent {length, width, height} - error (A.2.21)";
CM_ SG_ 65 VFC_Obj11_WidthStdDev "Standard deviation of object width. ISO 23150:2023: Bounding box extent {length, width, height} - error (A.2.21)";
CM_ SG_ 65 VFC_Obj11_HeightStdDev "Standard deviation of object height. ISO 23150:2023: Bounding box extent {length, width, height} - error (A.2.21)";
CM_ SG_ 65 VFC_Obj11_Vx "Object velocity in longitudinal direction. ISO 23150:2023: Velocity {x, y, z} - object level (A.2.24)";
CM_ SG_ 65 VFC_Obj11_Vy "Object velocity in lateral direction. ISO 23150:2023: Velocity {x, y, z} - object level (A.2.24)";
CM_ SG_ 65 VFC_Obj11_VxStdDev "Standard deviation of Object velocity in longitudinal direction. ISO 23150:2023: Velocity {x, y, z} - object level - error (A.2.25)";
CM_ SG_ 65 VFC_Obj11_VyStdDev "Standard deviation of Object velocity in lateral direction. ISO 23150:2023: Velocity {x, y, z} - object level - error (A.2.25)";
CM_ SG_ 65 VFC_Obj11_Ax "Object acceleration in longitudinal direction. ISO 23150:2023: Acceleration {x, y, z} (A.2.26)";
CM_ SG_ 65 VFC_Obj11_LightStatTurnIndicator "The detected direction indicator lights. Similar to ISO 23150:2023: Light status (A.2.35)";
CM_ SG_ 65 VFC_Obj11_Ay "Object acceleration in lateral direction. ISO 23150:2023: Acceleration {x, y, z} (A.2.26)";
CM_ SG_ 65 VFC_Obj11_AxStdDev "Standard deviation of Object acceleration in longitudinal direction. ISO 23150:2023: Acceleration {x, y, z} - error (A.2.27)";
CM_ SG_ 65 VFC_Obj11_AyStdDev "Standard deviation of Object acceleration in lateral direction. ISO 23150:2023: Acceleration {x, y, z} - error (A.2.27)";
CM_ SG_ 65 VFC_Obj11_MovementProbLat "Probability of object moving laterally (current state, not if moved at all in object history). Related to ISO 23150:2023: Movement status (A.2.32)";
CM_ SG_ 65 VFC_Obj11_MovementProbLong "Probability of object moving longitudinally (current state, not if moved at all in object history). Related to ISO 23150:2023: Movement status (A.2.32)";
CM_ SG_ 65 VFC_Obj11_2DAngPosEdgeLeft "Bounding box left edge in sensor coordinate system in ACCS coordinates; corresponds to tan(viewing angle of  object edge). ISO 23150:2023: Angular position {azimuth} (A.2.68)";
CM_ SG_ 65 VFC_Obj11_2DAngPosEdgeRight "Bounding box right edge in sensor coordinate system in ACCS coordinates; corresponds to tan(viewing angle of  object edge). ISO 23150:2023: Angular position {azimuth} (A.2.68)";
CM_ SG_ 65 VFC_Obj11_2DAngPosEdgeFar "Bounding box far edge in sensor coordinate system in ACCS coordinates; corresponds to tan(viewing angle of  object edge). ISO 23150:2023: Angular position {azimuth} (A.2.68)";
CM_ SG_ 65 VFC_Obj11_2DAngPosEdgeBot "Bounding box bottom edge in sensor coordinate system in ACCS coordinates; corresponds to tan(viewing angle of  object edge). Sign: upward direction negative value. ISO 23150:2023: Angular position {azimuth} (A.2.68)";
CM_ SG_ 65 VFC_Obj11_OutsideRoad "2D object is located outside road boundary (if signal is available)";
CM_ SG_ 65 VFC_Obj11_2DAngPosEdgeLeftStdDev "Standard deviation of the bounding box left edge";
CM_ SG_ 65 VFC_Obj11_2DAngPosEdgeRightStdDe "Standard deviation of the bounding box right edge";
CM_ SG_ 65 VFC_Obj11_2DAngPosEdgeFarStdDev "Standard deviation of the bounding box far edge";
CM_ SG_ 65 VFC_Obj11_2DAngPosEdgeBotStdDev "Standard deviation of the bounding box bottom edge";
CM_ SG_ 65 VFC_Obj11_2DNormVx "Normalised Object velocity in longitudinal direction (vx/dx_cam). Related to ISO 23150:2023: Angular velocity {azimuth} (A.2.69)";
CM_ SG_ 65 VFC_Obj11_2DNormVy "Normalised Object velocity in lateral direction (vy/dx_cam)";
CM_ SG_ 65 VFC_Obj11_2DNormAx "Normalised Object acceleration in longitudinal direction (ax/dx_cam)";
CM_ SG_ 65 VFC_Obj11_2DNormVxStdDev "Standard deviation of Normalised Object velocity in longitudinal direction";
CM_ SG_ 65 VFC_Obj11_MeasurementSource "Bitfield for the measurement programs from which this object originates
Bit 0: MOD
Bit 1: PDET
Bit 2: OFT
Bit 3: INVALID";
CM_ SG_ 65 VFC_Obj11_2DNormVyStdDev "Standard deviation of Normalised Object velocity in lateral direction";
CM_ SG_ 65 VFC_Obj11_2DNormAxStdDev "Standard deviation of Normalised Object acceleration in longitudinal direction";
CM_ SG_ 65 VFC_Obj11_2DScaleChange "Change in scale of the object in sensor's projection plane. ISO 23150:2023: Scale change - object level (A.2.70)";
CM_ SG_ 65 VFC_Obj11_2DScaleChangeStdDev "Standard deviation of object scale change";
CM_ SG_ 65 VFC_Obj11_Reliability "The bitfield shows if the signal quality is assumed to be sufficient for functions with safety target -no false positives-
Bit 0: DYNAMIC
Bit 1: SEMSEG_SURFACE
Bit 2: WDD_CRITICAL
Bit 3: GOD_CONFIRMED
Bit 4: RESTRICTED
Bit 5: ISO26262_SAFE";
CM_ SG_ 65 VFC_Obj11_LightStatBrakeLight "The number of detected lights. More confident if more lights are detected. Similar to ISO 23150:2023: Light status (A.2.35)";
CM_ SG_ 65 VFC_Obj11_OutsideRoadMeasStatus "2D object outside road boundary measurement status, indicator if it is measured or predicted (if signal is available)";
CM_ SG_ 65 VFC_Obj11_Oncoming "Object is oncoming (if signal is available)";
CM_ SG_ 65 VFC_Obj11_OncomingMeasStatus "Object oncoming measurement status, indicator if it is measured or predicted (if signal is available)";
CM_ SG_ 65 VFC_Obj11_MovementStanding "Object is standing (if signal is available). Related to ISO 23150:2023: Movement status (A.2.32)";
CM_ SG_ 65 VFC_Obj11_MovementStandingMeasSt "Object standing measurement status, indicator if it is measured or predicted (if signal is available)";
CM_ SG_ 65 VFC_Obj11_MovementObserved "Object has been observed moving over the ground since it was first detected (if signal is available). Related to ISO 23150:2023: Movement status (A.2.32)";
CM_ SG_ 65 VFC_Obj11_MovementObservedMeasSt "Measurement status for object has been observed moving (if signal is available)";
CM_ SG_ 65 VFC_Obj11_TargetObjTypeAcc "2D target object type for ACC (if signal is available)";
CM_ SG_ 65 VFC_Obj11_TargetObjTypeAccConf "Confidence of 2D target object type detection for ACC (if signal is available)";
CM_ SG_ 66 VFC_Obj12_CRC "CRC - Autosar E2E Profile 5";
CM_ SG_ 66 VFC_Obj12_AliveCtr "Alive counter - Autosar E2E Profile 5";
CM_ SG_ 66 VFC_Obj12_ProtBlockCtr "Protocol-Signal: Block-Counter";
CM_ SG_ 66 VFC_Obj12_ExistProb "Object existence probability. ISO 23150:2023: Existence probability - object level (A.2.1)";
CM_ SG_ 66 VFC_Obj12_MeasurementStatus "Indicator if the object detected is measured or predicted. ISO 23150:2023: Measurement status - object level (A.2.9)";
CM_ SG_ 66 VFC_Obj12_ObjId "Unique Object ID. ISO 23150:2023: Object ID (A.2.2)";
CM_ SG_ 66 VFC_Obj12_Type "Classification of the object. ISO 23150:2023: Potentially moving object classification type (A.2.12)";
CM_ SG_ 66 VFC_Obj12_TypeConf "Confidence of the classified object type. ISO 23150:2023: Potentially moving object classification type - confidence (A.2.13)";
CM_ SG_ 66 VFC_Obj12_VisibleView "The visible view of the detected object. Reference point is in the middle of CLASSIC (front/rear) or SIDE (left/right). Related to ISO 23150:2023: Reference point (A.2.14)";
CM_ SG_ 66 VFC_Obj12_ClassifiedView "The classified view of object to be used in connection with VisibleView and Heading angle. Related to ISO 23150:2023: Reference point (A.2.14)";
CM_ SG_ 66 VFC_Obj12_Px "Object distance in longitudinal direction. ISO 23150:2023: Position - object level {x, y, z} (A.2.15)";
CM_ SG_ 66 VFC_Obj12_Py "Object distance in lateral direction. ISO 23150:2023: Position - object level {x, y, z} (A.2.15)";
CM_ SG_ 66 VFC_Obj12_PxStdDev "Standard deviation of Object distance in longitudinal direction. ISO 23150:2023: Position - object level {x, y, z} - error (A.2.16)";
CM_ SG_ 66 VFC_Obj12_PyStdDev "Standard deviation of Object distance in lateral direction. ISO 23150:2023: Position - object level {x, y, z} - error (A.2.16)";
CM_ SG_ 66 VFC_Obj12_OrientationYaw "Heading angle of the object. ISO 23150:2023: Orientation {yaw, pitch, roll} (A.2.17)";
CM_ SG_ 66 VFC_Obj12_OrientationYawStdDev "Standard deviation of object Heading angle. ISO 23150:2023: Orientation {yaw, pitch, roll} - error (A.2.18)";
CM_ SG_ 66 VFC_Obj12_Length "Length of the object. ISO 23150:2023: Bounding box extent {length, width, height} (A.2.20)";
CM_ SG_ 66 VFC_Obj12_Width "Width of the object. ISO 23150:2023: Bounding box extent {length, width, height} (A.2.20)";
CM_ SG_ 66 VFC_Obj12_Height "Height of the object. ISO 23150:2023: Bounding box extent {length, width, height} (A.2.20)";
CM_ SG_ 66 VFC_Obj12_LengthStdDev "Standard deviation of object length. ISO 23150:2023: Bounding box extent {length, width, height} - error (A.2.21)";
CM_ SG_ 66 VFC_Obj12_WidthStdDev "Standard deviation of object width. ISO 23150:2023: Bounding box extent {length, width, height} - error (A.2.21)";
CM_ SG_ 66 VFC_Obj12_HeightStdDev "Standard deviation of object height. ISO 23150:2023: Bounding box extent {length, width, height} - error (A.2.21)";
CM_ SG_ 66 VFC_Obj12_Vx "Object velocity in longitudinal direction. ISO 23150:2023: Velocity {x, y, z} - object level (A.2.24)";
CM_ SG_ 66 VFC_Obj12_Vy "Object velocity in lateral direction. ISO 23150:2023: Velocity {x, y, z} - object level (A.2.24)";
CM_ SG_ 66 VFC_Obj12_VxStdDev "Standard deviation of Object velocity in longitudinal direction. ISO 23150:2023: Velocity {x, y, z} - object level - error (A.2.25)";
CM_ SG_ 66 VFC_Obj12_VyStdDev "Standard deviation of Object velocity in lateral direction. ISO 23150:2023: Velocity {x, y, z} - object level - error (A.2.25)";
CM_ SG_ 66 VFC_Obj12_Ax "Object acceleration in longitudinal direction. ISO 23150:2023: Acceleration {x, y, z} (A.2.26)";
CM_ SG_ 66 VFC_Obj12_LightStatTurnIndicator "The detected direction indicator lights. Similar to ISO 23150:2023: Light status (A.2.35)";
CM_ SG_ 66 VFC_Obj12_Ay "Object acceleration in lateral direction. ISO 23150:2023: Acceleration {x, y, z} (A.2.26)";
CM_ SG_ 66 VFC_Obj12_AxStdDev "Standard deviation of Object acceleration in longitudinal direction. ISO 23150:2023: Acceleration {x, y, z} - error (A.2.27)";
CM_ SG_ 66 VFC_Obj12_AyStdDev "Standard deviation of Object acceleration in lateral direction. ISO 23150:2023: Acceleration {x, y, z} - error (A.2.27)";
CM_ SG_ 66 VFC_Obj12_MovementProbLat "Probability of object moving laterally (current state, not if moved at all in object history). Related to ISO 23150:2023: Movement status (A.2.32)";
CM_ SG_ 66 VFC_Obj12_MovementProbLong "Probability of object moving longitudinally (current state, not if moved at all in object history). Related to ISO 23150:2023: Movement status (A.2.32)";
CM_ SG_ 66 VFC_Obj12_2DAngPosEdgeLeft "Bounding box left edge in sensor coordinate system in ACCS coordinates; corresponds to tan(viewing angle of  object edge). ISO 23150:2023: Angular position {azimuth} (A.2.68)";
CM_ SG_ 66 VFC_Obj12_2DAngPosEdgeRight "Bounding box right edge in sensor coordinate system in ACCS coordinates; corresponds to tan(viewing angle of  object edge). ISO 23150:2023: Angular position {azimuth} (A.2.68)";
CM_ SG_ 66 VFC_Obj12_2DAngPosEdgeFar "Bounding box far edge in sensor coordinate system in ACCS coordinates; corresponds to tan(viewing angle of  object edge). ISO 23150:2023: Angular position {azimuth} (A.2.68)";
CM_ SG_ 66 VFC_Obj12_2DAngPosEdgeBot "Bounding box bottom edge in sensor coordinate system in ACCS coordinates; corresponds to tan(viewing angle of  object edge). Sign: upward direction negative value. ISO 23150:2023: Angular position {azimuth} (A.2.68)";
CM_ SG_ 66 VFC_Obj12_OutsideRoad "2D object is located outside road boundary (if signal is available)";
CM_ SG_ 66 VFC_Obj12_2DAngPosEdgeLeftStdDev "Standard deviation of the bounding box left edge";
CM_ SG_ 66 VFC_Obj12_2DAngPosEdgeRightStdDe "Standard deviation of the bounding box right edge";
CM_ SG_ 66 VFC_Obj12_2DAngPosEdgeFarStdDev "Standard deviation of the bounding box far edge";
CM_ SG_ 66 VFC_Obj12_2DAngPosEdgeBotStdDev "Standard deviation of the bounding box bottom edge";
CM_ SG_ 66 VFC_Obj12_2DNormVx "Normalised Object velocity in longitudinal direction (vx/dx_cam). Related to ISO 23150:2023: Angular velocity {azimuth} (A.2.69)";
CM_ SG_ 66 VFC_Obj12_2DNormVy "Normalised Object velocity in lateral direction (vy/dx_cam)";
CM_ SG_ 66 VFC_Obj12_2DNormAx "Normalised Object acceleration in longitudinal direction (ax/dx_cam)";
CM_ SG_ 66 VFC_Obj12_2DNormVxStdDev "Standard deviation of Normalised Object velocity in longitudinal direction";
CM_ SG_ 66 VFC_Obj12_MeasurementSource "Bitfield for the measurement programs from which this object originates
Bit 0: MOD
Bit 1: PDET
Bit 2: OFT
Bit 3: INVALID";
CM_ SG_ 66 VFC_Obj12_2DNormVyStdDev "Standard deviation of Normalised Object velocity in lateral direction";
CM_ SG_ 66 VFC_Obj12_2DNormAxStdDev "Standard deviation of Normalised Object acceleration in longitudinal direction";
CM_ SG_ 66 VFC_Obj12_2DScaleChange "Change in scale of the object in sensor's projection plane. ISO 23150:2023: Scale change - object level (A.2.70)";
CM_ SG_ 66 VFC_Obj12_2DScaleChangeStdDev "Standard deviation of object scale change";
CM_ SG_ 66 VFC_Obj12_Reliability "The bitfield shows if the signal quality is assumed to be sufficient for functions with safety target -no false positives-
Bit 0: DYNAMIC
Bit 1: SEMSEG_SURFACE
Bit 2: WDD_CRITICAL
Bit 3: GOD_CONFIRMED
Bit 4: RESTRICTED
Bit 5: ISO26262_SAFE";
CM_ SG_ 66 VFC_Obj12_LightStatBrakeLight "The number of detected lights. More confident if more lights are detected. Similar to ISO 23150:2023: Light status (A.2.35)";
CM_ SG_ 66 VFC_Obj12_OutsideRoadMeasStatus "2D object outside road boundary measurement status, indicator if it is measured or predicted (if signal is available)";
CM_ SG_ 66 VFC_Obj12_Oncoming "Object is oncoming (if signal is available)";
CM_ SG_ 66 VFC_Obj12_OncomingMeasStatus "Object oncoming measurement status, indicator if it is measured or predicted (if signal is available)";
CM_ SG_ 66 VFC_Obj12_MovementStanding "Object is standing (if signal is available). Related to ISO 23150:2023: Movement status (A.2.32)";
CM_ SG_ 66 VFC_Obj12_MovementStandingMeasSt "Object standing measurement status, indicator if it is measured or predicted (if signal is available)";
CM_ SG_ 66 VFC_Obj12_MovementObserved "Object has been observed moving over the ground since it was first detected (if signal is available). Related to ISO 23150:2023: Movement status (A.2.32)";
CM_ SG_ 66 VFC_Obj12_MovementObservedMeasSt "Measurement status for object has been observed moving (if signal is available)";
CM_ SG_ 66 VFC_Obj12_TargetObjTypeAcc "2D target object type for ACC (if signal is available)";
CM_ SG_ 66 VFC_Obj12_TargetObjTypeAccConf "Confidence of 2D target object type detection for ACC (if signal is available)";
CM_ SG_ 67 VFC_Obj13_CRC "CRC - Autosar E2E Profile 5";
CM_ SG_ 67 VFC_Obj13_AliveCtr "Alive counter - Autosar E2E Profile 5";
CM_ SG_ 67 VFC_Obj13_ProtBlockCtr "Protocol-Signal: Block-Counter";
CM_ SG_ 67 VFC_Obj13_ExistProb "Object existence probability. ISO 23150:2023: Existence probability - object level (A.2.1)";
CM_ SG_ 67 VFC_Obj13_MeasurementStatus "Indicator if the object detected is measured or predicted. ISO 23150:2023: Measurement status - object level (A.2.9)";
CM_ SG_ 67 VFC_Obj13_ObjId "Unique Object ID. ISO 23150:2023: Object ID (A.2.2)";
CM_ SG_ 67 VFC_Obj13_Type "Classification of the object. ISO 23150:2023: Potentially moving object classification type (A.2.12)";
CM_ SG_ 67 VFC_Obj13_TypeConf "Confidence of the classified object type. ISO 23150:2023: Potentially moving object classification type - confidence (A.2.13)";
CM_ SG_ 67 VFC_Obj13_VisibleView "The visible view of the detected object. Reference point is in the middle of CLASSIC (front/rear) or SIDE (left/right). Related to ISO 23150:2023: Reference point (A.2.14)";
CM_ SG_ 67 VFC_Obj13_ClassifiedView "The classified view of object to be used in connection with VisibleView and Heading angle. Related to ISO 23150:2023: Reference point (A.2.14)";
CM_ SG_ 67 VFC_Obj13_Px "Object distance in longitudinal direction. ISO 23150:2023: Position - object level {x, y, z} (A.2.15)";
CM_ SG_ 67 VFC_Obj13_Py "Object distance in lateral direction. ISO 23150:2023: Position - object level {x, y, z} (A.2.15)";
CM_ SG_ 67 VFC_Obj13_PxStdDev "Standard deviation of Object distance in longitudinal direction. ISO 23150:2023: Position - object level {x, y, z} - error (A.2.16)";
CM_ SG_ 67 VFC_Obj13_PyStdDev "Standard deviation of Object distance in lateral direction. ISO 23150:2023: Position - object level {x, y, z} - error (A.2.16)";
CM_ SG_ 67 VFC_Obj13_OrientationYaw "Heading angle of the object. ISO 23150:2023: Orientation {yaw, pitch, roll} (A.2.17)";
CM_ SG_ 67 VFC_Obj13_OrientationYawStdDev "Standard deviation of object Heading angle. ISO 23150:2023: Orientation {yaw, pitch, roll} - error (A.2.18)";
CM_ SG_ 67 VFC_Obj13_Length "Length of the object. ISO 23150:2023: Bounding box extent {length, width, height} (A.2.20)";
CM_ SG_ 67 VFC_Obj13_Width "Width of the object. ISO 23150:2023: Bounding box extent {length, width, height} (A.2.20)";
CM_ SG_ 67 VFC_Obj13_Height "Height of the object. ISO 23150:2023: Bounding box extent {length, width, height} (A.2.20)";
CM_ SG_ 67 VFC_Obj13_LengthStdDev "Standard deviation of object length. ISO 23150:2023: Bounding box extent {length, width, height} - error (A.2.21)";
CM_ SG_ 67 VFC_Obj13_WidthStdDev "Standard deviation of object width. ISO 23150:2023: Bounding box extent {length, width, height} - error (A.2.21)";
CM_ SG_ 67 VFC_Obj13_HeightStdDev "Standard deviation of object height. ISO 23150:2023: Bounding box extent {length, width, height} - error (A.2.21)";
CM_ SG_ 67 VFC_Obj13_Vx "Object velocity in longitudinal direction. ISO 23150:2023: Velocity {x, y, z} - object level (A.2.24)";
CM_ SG_ 67 VFC_Obj13_Vy "Object velocity in lateral direction. ISO 23150:2023: Velocity {x, y, z} - object level (A.2.24)";
CM_ SG_ 67 VFC_Obj13_VxStdDev "Standard deviation of Object velocity in longitudinal direction. ISO 23150:2023: Velocity {x, y, z} - object level - error (A.2.25)";
CM_ SG_ 67 VFC_Obj13_VyStdDev "Standard deviation of Object velocity in lateral direction. ISO 23150:2023: Velocity {x, y, z} - object level - error (A.2.25)";
CM_ SG_ 67 VFC_Obj13_Ax "Object acceleration in longitudinal direction. ISO 23150:2023: Acceleration {x, y, z} (A.2.26)";
CM_ SG_ 67 VFC_Obj13_LightStatTurnIndicator "The detected direction indicator lights. Similar to ISO 23150:2023: Light status (A.2.35)";
CM_ SG_ 67 VFC_Obj13_Ay "Object acceleration in lateral direction. ISO 23150:2023: Acceleration {x, y, z} (A.2.26)";
CM_ SG_ 67 VFC_Obj13_AxStdDev "Standard deviation of Object acceleration in longitudinal direction. ISO 23150:2023: Acceleration {x, y, z} - error (A.2.27)";
CM_ SG_ 67 VFC_Obj13_AyStdDev "Standard deviation of Object acceleration in lateral direction. ISO 23150:2023: Acceleration {x, y, z} - error (A.2.27)";
CM_ SG_ 67 VFC_Obj13_MovementProbLat "Probability of object moving laterally (current state, not if moved at all in object history). Related to ISO 23150:2023: Movement status (A.2.32)";
CM_ SG_ 67 VFC_Obj13_MovementProbLong "Probability of object moving longitudinally (current state, not if moved at all in object history). Related to ISO 23150:2023: Movement status (A.2.32)";
CM_ SG_ 67 VFC_Obj13_2DAngPosEdgeLeft "Bounding box left edge in sensor coordinate system in ACCS coordinates; corresponds to tan(viewing angle of  object edge). ISO 23150:2023: Angular position {azimuth} (A.2.68)";
CM_ SG_ 67 VFC_Obj13_2DAngPosEdgeRight "Bounding box right edge in sensor coordinate system in ACCS coordinates; corresponds to tan(viewing angle of  object edge). ISO 23150:2023: Angular position {azimuth} (A.2.68)";
CM_ SG_ 67 VFC_Obj13_2DAngPosEdgeFar "Bounding box far edge in sensor coordinate system in ACCS coordinates; corresponds to tan(viewing angle of  object edge). ISO 23150:2023: Angular position {azimuth} (A.2.68)";
CM_ SG_ 67 VFC_Obj13_2DAngPosEdgeBot "Bounding box bottom edge in sensor coordinate system in ACCS coordinates; corresponds to tan(viewing angle of  object edge). Sign: upward direction negative value. ISO 23150:2023: Angular position {azimuth} (A.2.68)";
CM_ SG_ 67 VFC_Obj13_OutsideRoad "2D object is located outside road boundary (if signal is available)";
CM_ SG_ 67 VFC_Obj13_2DAngPosEdgeLeftStdDev "Standard deviation of the bounding box left edge";
CM_ SG_ 67 VFC_Obj13_2DAngPosEdgeRightStdDe "Standard deviation of the bounding box right edge";
CM_ SG_ 67 VFC_Obj13_2DAngPosEdgeFarStdDev "Standard deviation of the bounding box far edge";
CM_ SG_ 67 VFC_Obj13_2DAngPosEdgeBotStdDev "Standard deviation of the bounding box bottom edge";
CM_ SG_ 67 VFC_Obj13_2DNormVx "Normalised Object velocity in longitudinal direction (vx/dx_cam). Related to ISO 23150:2023: Angular velocity {azimuth} (A.2.69)";
CM_ SG_ 67 VFC_Obj13_2DNormVy "Normalised Object velocity in lateral direction (vy/dx_cam)";
CM_ SG_ 67 VFC_Obj13_2DNormAx "Normalised Object acceleration in longitudinal direction (ax/dx_cam)";
CM_ SG_ 67 VFC_Obj13_2DNormVxStdDev "Standard deviation of Normalised Object velocity in longitudinal direction";
CM_ SG_ 67 VFC_Obj13_MeasurementSource "Bitfield for the measurement programs from which this object originates
Bit 0: MOD
Bit 1: PDET
Bit 2: OFT
Bit 3: INVALID";
CM_ SG_ 67 VFC_Obj13_2DNormVyStdDev "Standard deviation of Normalised Object velocity in lateral direction";
CM_ SG_ 67 VFC_Obj13_2DNormAxStdDev "Standard deviation of Normalised Object acceleration in longitudinal direction";
CM_ SG_ 67 VFC_Obj13_2DScaleChange "Change in scale of the object in sensor's projection plane. ISO 23150:2023: Scale change - object level (A.2.70)";
CM_ SG_ 67 VFC_Obj13_2DScaleChangeStdDev "Standard deviation of object scale change";
CM_ SG_ 67 VFC_Obj13_Reliability "The bitfield shows if the signal quality is assumed to be sufficient for functions with safety target -no false positives-
Bit 0: DYNAMIC
Bit 1: SEMSEG_SURFACE
Bit 2: WDD_CRITICAL
Bit 3: GOD_CONFIRMED
Bit 4: RESTRICTED
Bit 5: ISO26262_SAFE";
CM_ SG_ 67 VFC_Obj13_LightStatBrakeLight "The number of detected lights. More confident if more lights are detected. Similar to ISO 23150:2023: Light status (A.2.35)";
CM_ SG_ 67 VFC_Obj13_OutsideRoadMeasStatus "2D object outside road boundary measurement status, indicator if it is measured or predicted (if signal is available)";
CM_ SG_ 67 VFC_Obj13_Oncoming "Object is oncoming (if signal is available)";
CM_ SG_ 67 VFC_Obj13_OncomingMeasStatus "Object oncoming measurement status, indicator if it is measured or predicted (if signal is available)";
CM_ SG_ 67 VFC_Obj13_MovementStanding "Object is standing (if signal is available). Related to ISO 23150:2023: Movement status (A.2.32)";
CM_ SG_ 67 VFC_Obj13_MovementStandingMeasSt "Object standing measurement status, indicator if it is measured or predicted (if signal is available)";
CM_ SG_ 67 VFC_Obj13_MovementObserved "Object has been observed moving over the ground since it was first detected (if signal is available). Related to ISO 23150:2023: Movement status (A.2.32)";
CM_ SG_ 67 VFC_Obj13_MovementObservedMeasSt "Measurement status for object has been observed moving (if signal is available)";
CM_ SG_ 67 VFC_Obj13_TargetObjTypeAcc "2D target object type for ACC (if signal is available)";
CM_ SG_ 67 VFC_Obj13_TargetObjTypeAccConf "Confidence of 2D target object type detection for ACC (if signal is available)";
CM_ SG_ 68 VFC_Obj14_CRC "CRC - Autosar E2E Profile 5";
CM_ SG_ 68 VFC_Obj14_AliveCtr "Alive counter - Autosar E2E Profile 5";
CM_ SG_ 68 VFC_Obj14_ProtBlockCtr "Protocol-Signal: Block-Counter";
CM_ SG_ 68 VFC_Obj14_ExistProb "Object existence probability. ISO 23150:2023: Existence probability - object level (A.2.1)";
CM_ SG_ 68 VFC_Obj14_MeasurementStatus "Indicator if the object detected is measured or predicted. ISO 23150:2023: Measurement status - object level (A.2.9)";
CM_ SG_ 68 VFC_Obj14_ObjId "Unique Object ID. ISO 23150:2023: Object ID (A.2.2)";
CM_ SG_ 68 VFC_Obj14_Type "Classification of the object. ISO 23150:2023: Potentially moving object classification type (A.2.12)";
CM_ SG_ 68 VFC_Obj14_TypeConf "Confidence of the classified object type. ISO 23150:2023: Potentially moving object classification type - confidence (A.2.13)";
CM_ SG_ 68 VFC_Obj14_VisibleView "The visible view of the detected object. Reference point is in the middle of CLASSIC (front/rear) or SIDE (left/right). Related to ISO 23150:2023: Reference point (A.2.14)";
CM_ SG_ 68 VFC_Obj14_ClassifiedView "The classified view of object to be used in connection with VisibleView and Heading angle. Related to ISO 23150:2023: Reference point (A.2.14)";
CM_ SG_ 68 VFC_Obj14_Px "Object distance in longitudinal direction. ISO 23150:2023: Position - object level {x, y, z} (A.2.15)";
CM_ SG_ 68 VFC_Obj14_Py "Object distance in lateral direction. ISO 23150:2023: Position - object level {x, y, z} (A.2.15)";
CM_ SG_ 68 VFC_Obj14_PxStdDev "Standard deviation of Object distance in longitudinal direction. ISO 23150:2023: Position - object level {x, y, z} - error (A.2.16)";
CM_ SG_ 68 VFC_Obj14_PyStdDev "Standard deviation of Object distance in lateral direction. ISO 23150:2023: Position - object level {x, y, z} - error (A.2.16)";
CM_ SG_ 68 VFC_Obj14_OrientationYaw "Heading angle of the object. ISO 23150:2023: Orientation {yaw, pitch, roll} (A.2.17)";
CM_ SG_ 68 VFC_Obj14_OrientationYawStdDev "Standard deviation of object Heading angle. ISO 23150:2023: Orientation {yaw, pitch, roll} - error (A.2.18)";
CM_ SG_ 68 VFC_Obj14_Length "Length of the object. ISO 23150:2023: Bounding box extent {length, width, height} (A.2.20)";
CM_ SG_ 68 VFC_Obj14_Width "Width of the object. ISO 23150:2023: Bounding box extent {length, width, height} (A.2.20)";
CM_ SG_ 68 VFC_Obj14_Height "Height of the object. ISO 23150:2023: Bounding box extent {length, width, height} (A.2.20)";
CM_ SG_ 68 VFC_Obj14_LengthStdDev "Standard deviation of object length. ISO 23150:2023: Bounding box extent {length, width, height} - error (A.2.21)";
CM_ SG_ 68 VFC_Obj14_WidthStdDev "Standard deviation of object width. ISO 23150:2023: Bounding box extent {length, width, height} - error (A.2.21)";
CM_ SG_ 68 VFC_Obj14_HeightStdDev "Standard deviation of object height. ISO 23150:2023: Bounding box extent {length, width, height} - error (A.2.21)";
CM_ SG_ 68 VFC_Obj14_Vx "Object velocity in longitudinal direction. ISO 23150:2023: Velocity {x, y, z} - object level (A.2.24)";
CM_ SG_ 68 VFC_Obj14_Vy "Object velocity in lateral direction. ISO 23150:2023: Velocity {x, y, z} - object level (A.2.24)";
CM_ SG_ 68 VFC_Obj14_VxStdDev "Standard deviation of Object velocity in longitudinal direction. ISO 23150:2023: Velocity {x, y, z} - object level - error (A.2.25)";
CM_ SG_ 68 VFC_Obj14_VyStdDev "Standard deviation of Object velocity in lateral direction. ISO 23150:2023: Velocity {x, y, z} - object level - error (A.2.25)";
CM_ SG_ 68 VFC_Obj14_Ax "Object acceleration in longitudinal direction. ISO 23150:2023: Acceleration {x, y, z} (A.2.26)";
CM_ SG_ 68 VFC_Obj14_LightStatTurnIndicator "The detected direction indicator lights. Similar to ISO 23150:2023: Light status (A.2.35)";
CM_ SG_ 68 VFC_Obj14_Ay "Object acceleration in lateral direction. ISO 23150:2023: Acceleration {x, y, z} (A.2.26)";
CM_ SG_ 68 VFC_Obj14_AxStdDev "Standard deviation of Object acceleration in longitudinal direction. ISO 23150:2023: Acceleration {x, y, z} - error (A.2.27)";
CM_ SG_ 68 VFC_Obj14_AyStdDev "Standard deviation of Object acceleration in lateral direction. ISO 23150:2023: Acceleration {x, y, z} - error (A.2.27)";
CM_ SG_ 68 VFC_Obj14_MovementProbLat "Probability of object moving laterally (current state, not if moved at all in object history). Related to ISO 23150:2023: Movement status (A.2.32)";
CM_ SG_ 68 VFC_Obj14_MovementProbLong "Probability of object moving longitudinally (current state, not if moved at all in object history). Related to ISO 23150:2023: Movement status (A.2.32)";
CM_ SG_ 68 VFC_Obj14_2DAngPosEdgeLeft "Bounding box left edge in sensor coordinate system in ACCS coordinates; corresponds to tan(viewing angle of  object edge). ISO 23150:2023: Angular position {azimuth} (A.2.68)";
CM_ SG_ 68 VFC_Obj14_2DAngPosEdgeRight "Bounding box right edge in sensor coordinate system in ACCS coordinates; corresponds to tan(viewing angle of  object edge). ISO 23150:2023: Angular position {azimuth} (A.2.68)";
CM_ SG_ 68 VFC_Obj14_2DAngPosEdgeFar "Bounding box far edge in sensor coordinate system in ACCS coordinates; corresponds to tan(viewing angle of  object edge). ISO 23150:2023: Angular position {azimuth} (A.2.68)";
CM_ SG_ 68 VFC_Obj14_2DAngPosEdgeBot "Bounding box bottom edge in sensor coordinate system in ACCS coordinates; corresponds to tan(viewing angle of  object edge). Sign: upward direction negative value. ISO 23150:2023: Angular position {azimuth} (A.2.68)";
CM_ SG_ 68 VFC_Obj14_OutsideRoad "2D object is located outside road boundary (if signal is available)";
CM_ SG_ 68 VFC_Obj14_2DAngPosEdgeLeftStdDev "Standard deviation of the bounding box left edge";
CM_ SG_ 68 VFC_Obj14_2DAngPosEdgeRightStdDe "Standard deviation of the bounding box right edge";
CM_ SG_ 68 VFC_Obj14_2DAngPosEdgeFarStdDev "Standard deviation of the bounding box far edge";
CM_ SG_ 68 VFC_Obj14_2DAngPosEdgeBotStdDev "Standard deviation of the bounding box bottom edge";
CM_ SG_ 68 VFC_Obj14_2DNormVx "Normalised Object velocity in longitudinal direction (vx/dx_cam). Related to ISO 23150:2023: Angular velocity {azimuth} (A.2.69)";
CM_ SG_ 68 VFC_Obj14_2DNormVy "Normalised Object velocity in lateral direction (vy/dx_cam)";
CM_ SG_ 68 VFC_Obj14_2DNormAx "Normalised Object acceleration in longitudinal direction (ax/dx_cam)";
CM_ SG_ 68 VFC_Obj14_2DNormVxStdDev "Standard deviation of Normalised Object velocity in longitudinal direction";
CM_ SG_ 68 VFC_Obj14_MeasurementSource "Bitfield for the measurement programs from which this object originates
Bit 0: MOD
Bit 1: PDET
Bit 2: OFT
Bit 3: INVALID";
CM_ SG_ 68 VFC_Obj14_2DNormVyStdDev "Standard deviation of Normalised Object velocity in lateral direction";
CM_ SG_ 68 VFC_Obj14_2DNormAxStdDev "Standard deviation of Normalised Object acceleration in longitudinal direction";
CM_ SG_ 68 VFC_Obj14_2DScaleChange "Change in scale of the object in sensor's projection plane. ISO 23150:2023: Scale change - object level (A.2.70)";
CM_ SG_ 68 VFC_Obj14_2DScaleChangeStdDev "Standard deviation of object scale change";
CM_ SG_ 68 VFC_Obj14_Reliability "The bitfield shows if the signal quality is assumed to be sufficient for functions with safety target -no false positives-
Bit 0: DYNAMIC
Bit 1: SEMSEG_SURFACE
Bit 2: WDD_CRITICAL
Bit 3: GOD_CONFIRMED
Bit 4: RESTRICTED
Bit 5: ISO26262_SAFE";
CM_ SG_ 68 VFC_Obj14_LightStatBrakeLight "The number of detected lights. More confident if more lights are detected. Similar to ISO 23150:2023: Light status (A.2.35)";
CM_ SG_ 68 VFC_Obj14_OutsideRoadMeasStatus "2D object outside road boundary measurement status, indicator if it is measured or predicted (if signal is available)";
CM_ SG_ 68 VFC_Obj14_Oncoming "Object is oncoming (if signal is available)";
CM_ SG_ 68 VFC_Obj14_OncomingMeasStatus "Object oncoming measurement status, indicator if it is measured or predicted (if signal is available)";
CM_ SG_ 68 VFC_Obj14_MovementStanding "Object is standing (if signal is available). Related to ISO 23150:2023: Movement status (A.2.32)";
CM_ SG_ 68 VFC_Obj14_MovementStandingMeasSt "Object standing measurement status, indicator if it is measured or predicted (if signal is available)";
CM_ SG_ 68 VFC_Obj14_MovementObserved "Object has been observed moving over the ground since it was first detected (if signal is available). Related to ISO 23150:2023: Movement status (A.2.32)";
CM_ SG_ 68 VFC_Obj14_MovementObservedMeasSt "Measurement status for object has been observed moving (if signal is available)";
CM_ SG_ 68 VFC_Obj14_TargetObjTypeAcc "2D target object type for ACC (if signal is available)";
CM_ SG_ 68 VFC_Obj14_TargetObjTypeAccConf "Confidence of 2D target object type detection for ACC (if signal is available)";
CM_ SG_ 69 VFC_Obj15_CRC "CRC - Autosar E2E Profile 5";
CM_ SG_ 69 VFC_Obj15_AliveCtr "Alive counter - Autosar E2E Profile 5";
CM_ SG_ 69 VFC_Obj15_ProtBlockCtr "Protocol-Signal: Block-Counter";
CM_ SG_ 69 VFC_Obj15_ExistProb "Object existence probability. ISO 23150:2023: Existence probability - object level (A.2.1)";
CM_ SG_ 69 VFC_Obj15_MeasurementStatus "Indicator if the object detected is measured or predicted. ISO 23150:2023: Measurement status - object level (A.2.9)";
CM_ SG_ 69 VFC_Obj15_ObjId "Unique Object ID. ISO 23150:2023: Object ID (A.2.2)";
CM_ SG_ 69 VFC_Obj15_Type "Classification of the object. ISO 23150:2023: Potentially moving object classification type (A.2.12)";
CM_ SG_ 69 VFC_Obj15_TypeConf "Confidence of the classified object type. ISO 23150:2023: Potentially moving object classification type - confidence (A.2.13)";
CM_ SG_ 69 VFC_Obj15_VisibleView "The visible view of the detected object. Reference point is in the middle of CLASSIC (front/rear) or SIDE (left/right). Related to ISO 23150:2023: Reference point (A.2.14)";
CM_ SG_ 69 VFC_Obj15_ClassifiedView "The classified view of object to be used in connection with VisibleView and Heading angle. Related to ISO 23150:2023: Reference point (A.2.14)";
CM_ SG_ 69 VFC_Obj15_Px "Object distance in longitudinal direction. ISO 23150:2023: Position - object level {x, y, z} (A.2.15)";
CM_ SG_ 69 VFC_Obj15_Py "Object distance in lateral direction. ISO 23150:2023: Position - object level {x, y, z} (A.2.15)";
CM_ SG_ 69 VFC_Obj15_PxStdDev "Standard deviation of Object distance in longitudinal direction. ISO 23150:2023: Position - object level {x, y, z} - error (A.2.16)";
CM_ SG_ 69 VFC_Obj15_PyStdDev "Standard deviation of Object distance in lateral direction. ISO 23150:2023: Position - object level {x, y, z} - error (A.2.16)";
CM_ SG_ 69 VFC_Obj15_OrientationYaw "Heading angle of the object. ISO 23150:2023: Orientation {yaw, pitch, roll} (A.2.17)";
CM_ SG_ 69 VFC_Obj15_OrientationYawStdDev "Standard deviation of object Heading angle. ISO 23150:2023: Orientation {yaw, pitch, roll} - error (A.2.18)";
CM_ SG_ 69 VFC_Obj15_Length "Length of the object. ISO 23150:2023: Bounding box extent {length, width, height} (A.2.20)";
CM_ SG_ 69 VFC_Obj15_Width "Width of the object. ISO 23150:2023: Bounding box extent {length, width, height} (A.2.20)";
CM_ SG_ 69 VFC_Obj15_Height "Height of the object. ISO 23150:2023: Bounding box extent {length, width, height} (A.2.20)";
CM_ SG_ 69 VFC_Obj15_LengthStdDev "Standard deviation of object length. ISO 23150:2023: Bounding box extent {length, width, height} - error (A.2.21)";
CM_ SG_ 69 VFC_Obj15_WidthStdDev "Standard deviation of object width. ISO 23150:2023: Bounding box extent {length, width, height} - error (A.2.21)";
CM_ SG_ 69 VFC_Obj15_HeightStdDev "Standard deviation of object height. ISO 23150:2023: Bounding box extent {length, width, height} - error (A.2.21)";
CM_ SG_ 69 VFC_Obj15_Vx "Object velocity in longitudinal direction. ISO 23150:2023: Velocity {x, y, z} - object level (A.2.24)";
CM_ SG_ 69 VFC_Obj15_Vy "Object velocity in lateral direction. ISO 23150:2023: Velocity {x, y, z} - object level (A.2.24)";
CM_ SG_ 69 VFC_Obj15_VxStdDev "Standard deviation of Object velocity in longitudinal direction. ISO 23150:2023: Velocity {x, y, z} - object level - error (A.2.25)";
CM_ SG_ 69 VFC_Obj15_VyStdDev "Standard deviation of Object velocity in lateral direction. ISO 23150:2023: Velocity {x, y, z} - object level - error (A.2.25)";
CM_ SG_ 69 VFC_Obj15_Ax "Object acceleration in longitudinal direction. ISO 23150:2023: Acceleration {x, y, z} (A.2.26)";
CM_ SG_ 69 VFC_Obj15_LightStatTurnIndicator "The detected direction indicator lights. Similar to ISO 23150:2023: Light status (A.2.35)";
CM_ SG_ 69 VFC_Obj15_Ay "Object acceleration in lateral direction. ISO 23150:2023: Acceleration {x, y, z} (A.2.26)";
CM_ SG_ 69 VFC_Obj15_AxStdDev "Standard deviation of Object acceleration in longitudinal direction. ISO 23150:2023: Acceleration {x, y, z} - error (A.2.27)";
CM_ SG_ 69 VFC_Obj15_AyStdDev "Standard deviation of Object acceleration in lateral direction. ISO 23150:2023: Acceleration {x, y, z} - error (A.2.27)";
CM_ SG_ 69 VFC_Obj15_MovementProbLat "Probability of object moving laterally (current state, not if moved at all in object history). Related to ISO 23150:2023: Movement status (A.2.32)";
CM_ SG_ 69 VFC_Obj15_MovementProbLong "Probability of object moving longitudinally (current state, not if moved at all in object history). Related to ISO 23150:2023: Movement status (A.2.32)";
CM_ SG_ 69 VFC_Obj15_2DAngPosEdgeLeft "Bounding box left edge in sensor coordinate system in ACCS coordinates; corresponds to tan(viewing angle of  object edge). ISO 23150:2023: Angular position {azimuth} (A.2.68)";
CM_ SG_ 69 VFC_Obj15_2DAngPosEdgeRight "Bounding box right edge in sensor coordinate system in ACCS coordinates; corresponds to tan(viewing angle of  object edge). ISO 23150:2023: Angular position {azimuth} (A.2.68)";
CM_ SG_ 69 VFC_Obj15_2DAngPosEdgeFar "Bounding box far edge in sensor coordinate system in ACCS coordinates; corresponds to tan(viewing angle of  object edge). ISO 23150:2023: Angular position {azimuth} (A.2.68)";
CM_ SG_ 69 VFC_Obj15_2DAngPosEdgeBot "Bounding box bottom edge in sensor coordinate system in ACCS coordinates; corresponds to tan(viewing angle of  object edge). Sign: upward direction negative value. ISO 23150:2023: Angular position {azimuth} (A.2.68)";
CM_ SG_ 69 VFC_Obj15_OutsideRoad "2D object is located outside road boundary (if signal is available)";
CM_ SG_ 69 VFC_Obj15_2DAngPosEdgeLeftStdDev "Standard deviation of the bounding box left edge";
CM_ SG_ 69 VFC_Obj15_2DAngPosEdgeRightStdDe "Standard deviation of the bounding box right edge";
CM_ SG_ 69 VFC_Obj15_2DAngPosEdgeFarStdDev "Standard deviation of the bounding box far edge";
CM_ SG_ 69 VFC_Obj15_2DAngPosEdgeBotStdDev "Standard deviation of the bounding box bottom edge";
CM_ SG_ 69 VFC_Obj15_2DNormVx "Normalised Object velocity in longitudinal direction (vx/dx_cam). Related to ISO 23150:2023: Angular velocity {azimuth} (A.2.69)";
CM_ SG_ 69 VFC_Obj15_2DNormVy "Normalised Object velocity in lateral direction (vy/dx_cam)";
CM_ SG_ 69 VFC_Obj15_2DNormAx "Normalised Object acceleration in longitudinal direction (ax/dx_cam)";
CM_ SG_ 69 VFC_Obj15_2DNormVxStdDev "Standard deviation of Normalised Object velocity in longitudinal direction";
CM_ SG_ 69 VFC_Obj15_MeasurementSource "Bitfield for the measurement programs from which this object originates
Bit 0: MOD
Bit 1: PDET
Bit 2: OFT
Bit 3: INVALID";
CM_ SG_ 69 VFC_Obj15_2DNormVyStdDev "Standard deviation of Normalised Object velocity in lateral direction";
CM_ SG_ 69 VFC_Obj15_2DNormAxStdDev "Standard deviation of Normalised Object acceleration in longitudinal direction";
CM_ SG_ 69 VFC_Obj15_2DScaleChange "Change in scale of the object in sensor's projection plane. ISO 23150:2023: Scale change - object level (A.2.70)";
CM_ SG_ 69 VFC_Obj15_2DScaleChangeStdDev "Standard deviation of object scale change";
CM_ SG_ 69 VFC_Obj15_Reliability "The bitfield shows if the signal quality is assumed to be sufficient for functions with safety target -no false positives-
Bit 0: DYNAMIC
Bit 1: SEMSEG_SURFACE
Bit 2: WDD_CRITICAL
Bit 3: GOD_CONFIRMED
Bit 4: RESTRICTED
Bit 5: ISO26262_SAFE";
CM_ SG_ 69 VFC_Obj15_LightStatBrakeLight "The number of detected lights. More confident if more lights are detected. Similar to ISO 23150:2023: Light status (A.2.35)";
CM_ SG_ 69 VFC_Obj15_OutsideRoadMeasStatus "2D object outside road boundary measurement status, indicator if it is measured or predicted (if signal is available)";
CM_ SG_ 69 VFC_Obj15_Oncoming "Object is oncoming (if signal is available)";
CM_ SG_ 69 VFC_Obj15_OncomingMeasStatus "Object oncoming measurement status, indicator if it is measured or predicted (if signal is available)";
CM_ SG_ 69 VFC_Obj15_MovementStanding "Object is standing (if signal is available). Related to ISO 23150:2023: Movement status (A.2.32)";
CM_ SG_ 69 VFC_Obj15_MovementStandingMeasSt "Object standing measurement status, indicator if it is measured or predicted (if signal is available)";
CM_ SG_ 69 VFC_Obj15_MovementObserved "Object has been observed moving over the ground since it was first detected (if signal is available). Related to ISO 23150:2023: Movement status (A.2.32)";
CM_ SG_ 69 VFC_Obj15_MovementObservedMeasSt "Measurement status for object has been observed moving (if signal is available)";
CM_ SG_ 69 VFC_Obj15_TargetObjTypeAcc "2D target object type for ACC (if signal is available)";
CM_ SG_ 69 VFC_Obj15_TargetObjTypeAccConf "Confidence of 2D target object type detection for ACC (if signal is available)";
CM_ SG_ 70 VFC_Obj16_CRC "CRC - Autosar E2E Profile 5";
CM_ SG_ 70 VFC_Obj16_AliveCtr "Alive counter - Autosar E2E Profile 5";
CM_ SG_ 70 VFC_Obj16_ProtBlockCtr "Protocol-Signal: Block-Counter";
CM_ SG_ 70 VFC_Obj16_ExistProb "Object existence probability. ISO 23150:2023: Existence probability - object level (A.2.1)";
CM_ SG_ 70 VFC_Obj16_MeasurementStatus "Indicator if the object detected is measured or predicted. ISO 23150:2023: Measurement status - object level (A.2.9)";
CM_ SG_ 70 VFC_Obj16_ObjId "Unique Object ID. ISO 23150:2023: Object ID (A.2.2)";
CM_ SG_ 70 VFC_Obj16_Type "Classification of the object. ISO 23150:2023: Potentially moving object classification type (A.2.12)";
CM_ SG_ 70 VFC_Obj16_TypeConf "Confidence of the classified object type. ISO 23150:2023: Potentially moving object classification type - confidence (A.2.13)";
CM_ SG_ 70 VFC_Obj16_VisibleView "The visible view of the detected object. Reference point is in the middle of CLASSIC (front/rear) or SIDE (left/right). Related to ISO 23150:2023: Reference point (A.2.14)";
CM_ SG_ 70 VFC_Obj16_ClassifiedView "The classified view of object to be used in connection with VisibleView and Heading angle. Related to ISO 23150:2023: Reference point (A.2.14)";
CM_ SG_ 70 VFC_Obj16_Px "Object distance in longitudinal direction. ISO 23150:2023: Position - object level {x, y, z} (A.2.15)";
CM_ SG_ 70 VFC_Obj16_Py "Object distance in lateral direction. ISO 23150:2023: Position - object level {x, y, z} (A.2.15)";
CM_ SG_ 70 VFC_Obj16_PxStdDev "Standard deviation of Object distance in longitudinal direction. ISO 23150:2023: Position - object level {x, y, z} - error (A.2.16)";
CM_ SG_ 70 VFC_Obj16_PyStdDev "Standard deviation of Object distance in lateral direction. ISO 23150:2023: Position - object level {x, y, z} - error (A.2.16)";
CM_ SG_ 70 VFC_Obj16_OrientationYaw "Heading angle of the object. ISO 23150:2023: Orientation {yaw, pitch, roll} (A.2.17)";
CM_ SG_ 70 VFC_Obj16_OrientationYawStdDev "Standard deviation of object Heading angle. ISO 23150:2023: Orientation {yaw, pitch, roll} - error (A.2.18)";
CM_ SG_ 70 VFC_Obj16_Length "Length of the object. ISO 23150:2023: Bounding box extent {length, width, height} (A.2.20)";
CM_ SG_ 70 VFC_Obj16_Width "Width of the object. ISO 23150:2023: Bounding box extent {length, width, height} (A.2.20)";
CM_ SG_ 70 VFC_Obj16_Height "Height of the object. ISO 23150:2023: Bounding box extent {length, width, height} (A.2.20)";
CM_ SG_ 70 VFC_Obj16_LengthStdDev "Standard deviation of object length. ISO 23150:2023: Bounding box extent {length, width, height} - error (A.2.21)";
CM_ SG_ 70 VFC_Obj16_WidthStdDev "Standard deviation of object width. ISO 23150:2023: Bounding box extent {length, width, height} - error (A.2.21)";
CM_ SG_ 70 VFC_Obj16_HeightStdDev "Standard deviation of object height. ISO 23150:2023: Bounding box extent {length, width, height} - error (A.2.21)";
CM_ SG_ 70 VFC_Obj16_Vx "Object velocity in longitudinal direction. ISO 23150:2023: Velocity {x, y, z} - object level (A.2.24)";
CM_ SG_ 70 VFC_Obj16_Vy "Object velocity in lateral direction. ISO 23150:2023: Velocity {x, y, z} - object level (A.2.24)";
CM_ SG_ 70 VFC_Obj16_VxStdDev "Standard deviation of Object velocity in longitudinal direction. ISO 23150:2023: Velocity {x, y, z} - object level - error (A.2.25)";
CM_ SG_ 70 VFC_Obj16_VyStdDev "Standard deviation of Object velocity in lateral direction. ISO 23150:2023: Velocity {x, y, z} - object level - error (A.2.25)";
CM_ SG_ 70 VFC_Obj16_Ax "Object acceleration in longitudinal direction. ISO 23150:2023: Acceleration {x, y, z} (A.2.26)";
CM_ SG_ 70 VFC_Obj16_LightStatTurnIndicator "The detected direction indicator lights. Similar to ISO 23150:2023: Light status (A.2.35)";
CM_ SG_ 70 VFC_Obj16_Ay "Object acceleration in lateral direction. ISO 23150:2023: Acceleration {x, y, z} (A.2.26)";
CM_ SG_ 70 VFC_Obj16_AxStdDev "Standard deviation of Object acceleration in longitudinal direction. ISO 23150:2023: Acceleration {x, y, z} - error (A.2.27)";
CM_ SG_ 70 VFC_Obj16_AyStdDev "Standard deviation of Object acceleration in lateral direction. ISO 23150:2023: Acceleration {x, y, z} - error (A.2.27)";
CM_ SG_ 70 VFC_Obj16_MovementProbLat "Probability of object moving laterally (current state, not if moved at all in object history). Related to ISO 23150:2023: Movement status (A.2.32)";
CM_ SG_ 70 VFC_Obj16_MovementProbLong "Probability of object moving longitudinally (current state, not if moved at all in object history). Related to ISO 23150:2023: Movement status (A.2.32)";
CM_ SG_ 70 VFC_Obj16_2DAngPosEdgeLeft "Bounding box left edge in sensor coordinate system in ACCS coordinates; corresponds to tan(viewing angle of  object edge). ISO 23150:2023: Angular position {azimuth} (A.2.68)";
CM_ SG_ 70 VFC_Obj16_2DAngPosEdgeRight "Bounding box right edge in sensor coordinate system in ACCS coordinates; corresponds to tan(viewing angle of  object edge). ISO 23150:2023: Angular position {azimuth} (A.2.68)";
CM_ SG_ 70 VFC_Obj16_2DAngPosEdgeFar "Bounding box far edge in sensor coordinate system in ACCS coordinates; corresponds to tan(viewing angle of  object edge). ISO 23150:2023: Angular position {azimuth} (A.2.68)";
CM_ SG_ 70 VFC_Obj16_2DAngPosEdgeBot "Bounding box bottom edge in sensor coordinate system in ACCS coordinates; corresponds to tan(viewing angle of  object edge). Sign: upward direction negative value. ISO 23150:2023: Angular position {azimuth} (A.2.68)";
CM_ SG_ 70 VFC_Obj16_OutsideRoad "2D object is located outside road boundary (if signal is available)";
CM_ SG_ 70 VFC_Obj16_2DAngPosEdgeLeftStdDev "Standard deviation of the bounding box left edge";
CM_ SG_ 70 VFC_Obj16_2DAngPosEdgeRightStdDe "Standard deviation of the bounding box right edge";
CM_ SG_ 70 VFC_Obj16_2DAngPosEdgeFarStdDev "Standard deviation of the bounding box far edge";
CM_ SG_ 70 VFC_Obj16_2DAngPosEdgeBotStdDev "Standard deviation of the bounding box bottom edge";
CM_ SG_ 70 VFC_Obj16_2DNormVx "Normalised Object velocity in longitudinal direction (vx/dx_cam). Related to ISO 23150:2023: Angular velocity {azimuth} (A.2.69)";
CM_ SG_ 70 VFC_Obj16_2DNormVy "Normalised Object velocity in lateral direction (vy/dx_cam)";
CM_ SG_ 70 VFC_Obj16_2DNormAx "Normalised Object acceleration in longitudinal direction (ax/dx_cam)";
CM_ SG_ 70 VFC_Obj16_2DNormVxStdDev "Standard deviation of Normalised Object velocity in longitudinal direction";
CM_ SG_ 70 VFC_Obj16_MeasurementSource "Bitfield for the measurement programs from which this object originates
Bit 0: MOD
Bit 1: PDET
Bit 2: OFT
Bit 3: INVALID";
CM_ SG_ 70 VFC_Obj16_2DNormVyStdDev "Standard deviation of Normalised Object velocity in lateral direction";
CM_ SG_ 70 VFC_Obj16_2DNormAxStdDev "Standard deviation of Normalised Object acceleration in longitudinal direction";
CM_ SG_ 70 VFC_Obj16_2DScaleChange "Change in scale of the object in sensor's projection plane. ISO 23150:2023: Scale change - object level (A.2.70)";
CM_ SG_ 70 VFC_Obj16_2DScaleChangeStdDev "Standard deviation of object scale change";
CM_ SG_ 70 VFC_Obj16_Reliability "The bitfield shows if the signal quality is assumed to be sufficient for functions with safety target -no false positives-
Bit 0: DYNAMIC
Bit 1: SEMSEG_SURFACE
Bit 2: WDD_CRITICAL
Bit 3: GOD_CONFIRMED
Bit 4: RESTRICTED
Bit 5: ISO26262_SAFE";
CM_ SG_ 70 VFC_Obj16_LightStatBrakeLight "The number of detected lights. More confident if more lights are detected. Similar to ISO 23150:2023: Light status (A.2.35)";
CM_ SG_ 70 VFC_Obj16_OutsideRoadMeasStatus "2D object outside road boundary measurement status, indicator if it is measured or predicted (if signal is available)";
CM_ SG_ 70 VFC_Obj16_Oncoming "Object is oncoming (if signal is available)";
CM_ SG_ 70 VFC_Obj16_OncomingMeasStatus "Object oncoming measurement status, indicator if it is measured or predicted (if signal is available)";
CM_ SG_ 70 VFC_Obj16_MovementStanding "Object is standing (if signal is available). Related to ISO 23150:2023: Movement status (A.2.32)";
CM_ SG_ 70 VFC_Obj16_MovementStandingMeasSt "Object standing measurement status, indicator if it is measured or predicted (if signal is available)";
CM_ SG_ 70 VFC_Obj16_MovementObserved "Object has been observed moving over the ground since it was first detected (if signal is available). Related to ISO 23150:2023: Movement status (A.2.32)";
CM_ SG_ 70 VFC_Obj16_MovementObservedMeasSt "Measurement status for object has been observed moving (if signal is available)";
CM_ SG_ 70 VFC_Obj16_TargetObjTypeAcc "2D target object type for ACC (if signal is available)";
CM_ SG_ 70 VFC_Obj16_TargetObjTypeAccConf "Confidence of 2D target object type detection for ACC (if signal is available)";
CM_ SG_ 71 VFC_Obj17_CRC "CRC - Autosar E2E Profile 5";
CM_ SG_ 71 VFC_Obj17_AliveCtr "Alive counter - Autosar E2E Profile 5";
CM_ SG_ 71 VFC_Obj17_ProtBlockCtr "Protocol-Signal: Block-Counter";
CM_ SG_ 71 VFC_Obj17_ExistProb "Object existence probability. ISO 23150:2023: Existence probability - object level (A.2.1)";
CM_ SG_ 71 VFC_Obj17_MeasurementStatus "Indicator if the object detected is measured or predicted. ISO 23150:2023: Measurement status - object level (A.2.9)";
CM_ SG_ 71 VFC_Obj17_ObjId "Unique Object ID. ISO 23150:2023: Object ID (A.2.2)";
CM_ SG_ 71 VFC_Obj17_Type "Classification of the object. ISO 23150:2023: Potentially moving object classification type (A.2.12)";
CM_ SG_ 71 VFC_Obj17_TypeConf "Confidence of the classified object type. ISO 23150:2023: Potentially moving object classification type - confidence (A.2.13)";
CM_ SG_ 71 VFC_Obj17_VisibleView "The visible view of the detected object. Reference point is in the middle of CLASSIC (front/rear) or SIDE (left/right). Related to ISO 23150:2023: Reference point (A.2.14)";
CM_ SG_ 71 VFC_Obj17_ClassifiedView "The classified view of object to be used in connection with VisibleView and Heading angle. Related to ISO 23150:2023: Reference point (A.2.14)";
CM_ SG_ 71 VFC_Obj17_Px "Object distance in longitudinal direction. ISO 23150:2023: Position - object level {x, y, z} (A.2.15)";
CM_ SG_ 71 VFC_Obj17_Py "Object distance in lateral direction. ISO 23150:2023: Position - object level {x, y, z} (A.2.15)";
CM_ SG_ 71 VFC_Obj17_PxStdDev "Standard deviation of Object distance in longitudinal direction. ISO 23150:2023: Position - object level {x, y, z} - error (A.2.16)";
CM_ SG_ 71 VFC_Obj17_PyStdDev "Standard deviation of Object distance in lateral direction. ISO 23150:2023: Position - object level {x, y, z} - error (A.2.16)";
CM_ SG_ 71 VFC_Obj17_OrientationYaw "Heading angle of the object. ISO 23150:2023: Orientation {yaw, pitch, roll} (A.2.17)";
CM_ SG_ 71 VFC_Obj17_OrientationYawStdDev "Standard deviation of object Heading angle. ISO 23150:2023: Orientation {yaw, pitch, roll} - error (A.2.18)";
CM_ SG_ 71 VFC_Obj17_Length "Length of the object. ISO 23150:2023: Bounding box extent {length, width, height} (A.2.20)";
CM_ SG_ 71 VFC_Obj17_Width "Width of the object. ISO 23150:2023: Bounding box extent {length, width, height} (A.2.20)";
CM_ SG_ 71 VFC_Obj17_Height "Height of the object. ISO 23150:2023: Bounding box extent {length, width, height} (A.2.20)";
CM_ SG_ 71 VFC_Obj17_LengthStdDev "Standard deviation of object length. ISO 23150:2023: Bounding box extent {length, width, height} - error (A.2.21)";
CM_ SG_ 71 VFC_Obj17_WidthStdDev "Standard deviation of object width. ISO 23150:2023: Bounding box extent {length, width, height} - error (A.2.21)";
CM_ SG_ 71 VFC_Obj17_HeightStdDev "Standard deviation of object height. ISO 23150:2023: Bounding box extent {length, width, height} - error (A.2.21)";
CM_ SG_ 71 VFC_Obj17_Vx "Object velocity in longitudinal direction. ISO 23150:2023: Velocity {x, y, z} - object level (A.2.24)";
CM_ SG_ 71 VFC_Obj17_Vy "Object velocity in lateral direction. ISO 23150:2023: Velocity {x, y, z} - object level (A.2.24)";
CM_ SG_ 71 VFC_Obj17_VxStdDev "Standard deviation of Object velocity in longitudinal direction. ISO 23150:2023: Velocity {x, y, z} - object level - error (A.2.25)";
CM_ SG_ 71 VFC_Obj17_VyStdDev "Standard deviation of Object velocity in lateral direction. ISO 23150:2023: Velocity {x, y, z} - object level - error (A.2.25)";
CM_ SG_ 71 VFC_Obj17_Ax "Object acceleration in longitudinal direction. ISO 23150:2023: Acceleration {x, y, z} (A.2.26)";
CM_ SG_ 71 VFC_Obj17_LightStatTurnIndicator "The detected direction indicator lights. Similar to ISO 23150:2023: Light status (A.2.35)";
CM_ SG_ 71 VFC_Obj17_Ay "Object acceleration in lateral direction. ISO 23150:2023: Acceleration {x, y, z} (A.2.26)";
CM_ SG_ 71 VFC_Obj17_AxStdDev "Standard deviation of Object acceleration in longitudinal direction. ISO 23150:2023: Acceleration {x, y, z} - error (A.2.27)";
CM_ SG_ 71 VFC_Obj17_AyStdDev "Standard deviation of Object acceleration in lateral direction. ISO 23150:2023: Acceleration {x, y, z} - error (A.2.27)";
CM_ SG_ 71 VFC_Obj17_MovementProbLat "Probability of object moving laterally (current state, not if moved at all in object history). Related to ISO 23150:2023: Movement status (A.2.32)";
CM_ SG_ 71 VFC_Obj17_MovementProbLong "Probability of object moving longitudinally (current state, not if moved at all in object history). Related to ISO 23150:2023: Movement status (A.2.32)";
CM_ SG_ 71 VFC_Obj17_2DAngPosEdgeLeft "Bounding box left edge in sensor coordinate system in ACCS coordinates; corresponds to tan(viewing angle of  object edge). ISO 23150:2023: Angular position {azimuth} (A.2.68)";
CM_ SG_ 71 VFC_Obj17_2DAngPosEdgeRight "Bounding box right edge in sensor coordinate system in ACCS coordinates; corresponds to tan(viewing angle of  object edge). ISO 23150:2023: Angular position {azimuth} (A.2.68)";
CM_ SG_ 71 VFC_Obj17_2DAngPosEdgeFar "Bounding box far edge in sensor coordinate system in ACCS coordinates; corresponds to tan(viewing angle of  object edge). ISO 23150:2023: Angular position {azimuth} (A.2.68)";
CM_ SG_ 71 VFC_Obj17_2DAngPosEdgeBot "Bounding box bottom edge in sensor coordinate system in ACCS coordinates; corresponds to tan(viewing angle of  object edge). Sign: upward direction negative value. ISO 23150:2023: Angular position {azimuth} (A.2.68)";
CM_ SG_ 71 VFC_Obj17_OutsideRoad "2D object is located outside road boundary (if signal is available)";
CM_ SG_ 71 VFC_Obj17_2DAngPosEdgeLeftStdDev "Standard deviation of the bounding box left edge";
CM_ SG_ 71 VFC_Obj17_2DAngPosEdgeRightStdDe "Standard deviation of the bounding box right edge";
CM_ SG_ 71 VFC_Obj17_2DAngPosEdgeFarStdDev "Standard deviation of the bounding box far edge";
CM_ SG_ 71 VFC_Obj17_2DAngPosEdgeBotStdDev "Standard deviation of the bounding box bottom edge";
CM_ SG_ 71 VFC_Obj17_2DNormVx "Normalised Object velocity in longitudinal direction (vx/dx_cam). Related to ISO 23150:2023: Angular velocity {azimuth} (A.2.69)";
CM_ SG_ 71 VFC_Obj17_2DNormVy "Normalised Object velocity in lateral direction (vy/dx_cam)";
CM_ SG_ 71 VFC_Obj17_2DNormAx "Normalised Object acceleration in longitudinal direction (ax/dx_cam)";
CM_ SG_ 71 VFC_Obj17_2DNormVxStdDev "Standard deviation of Normalised Object velocity in longitudinal direction";
CM_ SG_ 71 VFC_Obj17_MeasurementSource "Bitfield for the measurement programs from which this object originates
Bit 0: MOD
Bit 1: PDET
Bit 2: OFT
Bit 3: INVALID";
CM_ SG_ 71 VFC_Obj17_2DNormVyStdDev "Standard deviation of Normalised Object velocity in lateral direction";
CM_ SG_ 71 VFC_Obj17_2DNormAxStdDev "Standard deviation of Normalised Object acceleration in longitudinal direction";
CM_ SG_ 71 VFC_Obj17_2DScaleChange "Change in scale of the object in sensor's projection plane. ISO 23150:2023: Scale change - object level (A.2.70)";
CM_ SG_ 71 VFC_Obj17_2DScaleChangeStdDev "Standard deviation of object scale change";
CM_ SG_ 71 VFC_Obj17_Reliability "The bitfield shows if the signal quality is assumed to be sufficient for functions with safety target -no false positives-
Bit 0: DYNAMIC
Bit 1: SEMSEG_SURFACE
Bit 2: WDD_CRITICAL
Bit 3: GOD_CONFIRMED
Bit 4: RESTRICTED
Bit 5: ISO26262_SAFE";
CM_ SG_ 71 VFC_Obj17_LightStatBrakeLight "The number of detected lights. More confident if more lights are detected. Similar to ISO 23150:2023: Light status (A.2.35)";
CM_ SG_ 71 VFC_Obj17_OutsideRoadMeasStatus "2D object outside road boundary measurement status, indicator if it is measured or predicted (if signal is available)";
CM_ SG_ 71 VFC_Obj17_Oncoming "Object is oncoming (if signal is available)";
CM_ SG_ 71 VFC_Obj17_OncomingMeasStatus "Object oncoming measurement status, indicator if it is measured or predicted (if signal is available)";
CM_ SG_ 71 VFC_Obj17_MovementStanding "Object is standing (if signal is available). Related to ISO 23150:2023: Movement status (A.2.32)";
CM_ SG_ 71 VFC_Obj17_MovementStandingMeasSt "Object standing measurement status, indicator if it is measured or predicted (if signal is available)";
CM_ SG_ 71 VFC_Obj17_MovementObserved "Object has been observed moving over the ground since it was first detected (if signal is available). Related to ISO 23150:2023: Movement status (A.2.32)";
CM_ SG_ 71 VFC_Obj17_MovementObservedMeasSt "Measurement status for object has been observed moving (if signal is available)";
CM_ SG_ 71 VFC_Obj17_TargetObjTypeAcc "2D target object type for ACC (if signal is available)";
CM_ SG_ 71 VFC_Obj17_TargetObjTypeAccConf "Confidence of 2D target object type detection for ACC (if signal is available)";
CM_ SG_ 72 VFC_Obj18_CRC "CRC - Autosar E2E Profile 5";
CM_ SG_ 72 VFC_Obj18_AliveCtr "Alive counter - Autosar E2E Profile 5";
CM_ SG_ 72 VFC_Obj18_ProtBlockCtr "Protocol-Signal: Block-Counter";
CM_ SG_ 72 VFC_Obj18_ExistProb "Object existence probability. ISO 23150:2023: Existence probability - object level (A.2.1)";
CM_ SG_ 72 VFC_Obj18_MeasurementStatus "Indicator if the object detected is measured or predicted. ISO 23150:2023: Measurement status - object level (A.2.9)";
CM_ SG_ 72 VFC_Obj18_ObjId "Unique Object ID. ISO 23150:2023: Object ID (A.2.2)";
CM_ SG_ 72 VFC_Obj18_Type "Classification of the object. ISO 23150:2023: Potentially moving object classification type (A.2.12)";
CM_ SG_ 72 VFC_Obj18_TypeConf "Confidence of the classified object type. ISO 23150:2023: Potentially moving object classification type - confidence (A.2.13)";
CM_ SG_ 72 VFC_Obj18_VisibleView "The visible view of the detected object. Reference point is in the middle of CLASSIC (front/rear) or SIDE (left/right). Related to ISO 23150:2023: Reference point (A.2.14)";
CM_ SG_ 72 VFC_Obj18_ClassifiedView "The classified view of object to be used in connection with VisibleView and Heading angle. Related to ISO 23150:2023: Reference point (A.2.14)";
CM_ SG_ 72 VFC_Obj18_Px "Object distance in longitudinal direction. ISO 23150:2023: Position - object level {x, y, z} (A.2.15)";
CM_ SG_ 72 VFC_Obj18_Py "Object distance in lateral direction. ISO 23150:2023: Position - object level {x, y, z} (A.2.15)";
CM_ SG_ 72 VFC_Obj18_PxStdDev "Standard deviation of Object distance in longitudinal direction. ISO 23150:2023: Position - object level {x, y, z} - error (A.2.16)";
CM_ SG_ 72 VFC_Obj18_PyStdDev "Standard deviation of Object distance in lateral direction. ISO 23150:2023: Position - object level {x, y, z} - error (A.2.16)";
CM_ SG_ 72 VFC_Obj18_OrientationYaw "Heading angle of the object. ISO 23150:2023: Orientation {yaw, pitch, roll} (A.2.17)";
CM_ SG_ 72 VFC_Obj18_OrientationYawStdDev "Standard deviation of object Heading angle. ISO 23150:2023: Orientation {yaw, pitch, roll} - error (A.2.18)";
CM_ SG_ 72 VFC_Obj18_Length "Length of the object. ISO 23150:2023: Bounding box extent {length, width, height} (A.2.20)";
CM_ SG_ 72 VFC_Obj18_Width "Width of the object. ISO 23150:2023: Bounding box extent {length, width, height} (A.2.20)";
CM_ SG_ 72 VFC_Obj18_Height "Height of the object. ISO 23150:2023: Bounding box extent {length, width, height} (A.2.20)";
CM_ SG_ 72 VFC_Obj18_LengthStdDev "Standard deviation of object length. ISO 23150:2023: Bounding box extent {length, width, height} - error (A.2.21)";
CM_ SG_ 72 VFC_Obj18_WidthStdDev "Standard deviation of object width. ISO 23150:2023: Bounding box extent {length, width, height} - error (A.2.21)";
CM_ SG_ 72 VFC_Obj18_HeightStdDev "Standard deviation of object height. ISO 23150:2023: Bounding box extent {length, width, height} - error (A.2.21)";
CM_ SG_ 72 VFC_Obj18_Vx "Object velocity in longitudinal direction. ISO 23150:2023: Velocity {x, y, z} - object level (A.2.24)";
CM_ SG_ 72 VFC_Obj18_Vy "Object velocity in lateral direction. ISO 23150:2023: Velocity {x, y, z} - object level (A.2.24)";
CM_ SG_ 72 VFC_Obj18_VxStdDev "Standard deviation of Object velocity in longitudinal direction. ISO 23150:2023: Velocity {x, y, z} - object level - error (A.2.25)";
CM_ SG_ 72 VFC_Obj18_VyStdDev "Standard deviation of Object velocity in lateral direction. ISO 23150:2023: Velocity {x, y, z} - object level - error (A.2.25)";
CM_ SG_ 72 VFC_Obj18_Ax "Object acceleration in longitudinal direction. ISO 23150:2023: Acceleration {x, y, z} (A.2.26)";
CM_ SG_ 72 VFC_Obj18_LightStatTurnIndicator "The detected direction indicator lights. Similar to ISO 23150:2023: Light status (A.2.35)";
CM_ SG_ 72 VFC_Obj18_Ay "Object acceleration in lateral direction. ISO 23150:2023: Acceleration {x, y, z} (A.2.26)";
CM_ SG_ 72 VFC_Obj18_AxStdDev "Standard deviation of Object acceleration in longitudinal direction. ISO 23150:2023: Acceleration {x, y, z} - error (A.2.27)";
CM_ SG_ 72 VFC_Obj18_AyStdDev "Standard deviation of Object acceleration in lateral direction. ISO 23150:2023: Acceleration {x, y, z} - error (A.2.27)";
CM_ SG_ 72 VFC_Obj18_MovementProbLat "Probability of object moving laterally (current state, not if moved at all in object history). Related to ISO 23150:2023: Movement status (A.2.32)";
CM_ SG_ 72 VFC_Obj18_MovementProbLong "Probability of object moving longitudinally (current state, not if moved at all in object history). Related to ISO 23150:2023: Movement status (A.2.32)";
CM_ SG_ 72 VFC_Obj18_2DAngPosEdgeLeft "Bounding box left edge in sensor coordinate system in ACCS coordinates; corresponds to tan(viewing angle of  object edge). ISO 23150:2023: Angular position {azimuth} (A.2.68)";
CM_ SG_ 72 VFC_Obj18_2DAngPosEdgeRight "Bounding box right edge in sensor coordinate system in ACCS coordinates; corresponds to tan(viewing angle of  object edge). ISO 23150:2023: Angular position {azimuth} (A.2.68)";
CM_ SG_ 72 VFC_Obj18_2DAngPosEdgeFar "Bounding box far edge in sensor coordinate system in ACCS coordinates; corresponds to tan(viewing angle of  object edge). ISO 23150:2023: Angular position {azimuth} (A.2.68)";
CM_ SG_ 72 VFC_Obj18_2DAngPosEdgeBot "Bounding box bottom edge in sensor coordinate system in ACCS coordinates; corresponds to tan(viewing angle of  object edge). Sign: upward direction negative value. ISO 23150:2023: Angular position {azimuth} (A.2.68)";
CM_ SG_ 72 VFC_Obj18_OutsideRoad "2D object is located outside road boundary (if signal is available)";
CM_ SG_ 72 VFC_Obj18_2DAngPosEdgeLeftStdDev "Standard deviation of the bounding box left edge";
CM_ SG_ 72 VFC_Obj18_2DAngPosEdgeRightStdDe "Standard deviation of the bounding box right edge";
CM_ SG_ 72 VFC_Obj18_2DAngPosEdgeFarStdDev "Standard deviation of the bounding box far edge";
CM_ SG_ 72 VFC_Obj18_2DAngPosEdgeBotStdDev "Standard deviation of the bounding box bottom edge";
CM_ SG_ 72 VFC_Obj18_2DNormVx "Normalised Object velocity in longitudinal direction (vx/dx_cam). Related to ISO 23150:2023: Angular velocity {azimuth} (A.2.69)";
CM_ SG_ 72 VFC_Obj18_2DNormVy "Normalised Object velocity in lateral direction (vy/dx_cam)";
CM_ SG_ 72 VFC_Obj18_2DNormAx "Normalised Object acceleration in longitudinal direction (ax/dx_cam)";
CM_ SG_ 72 VFC_Obj18_2DNormVxStdDev "Standard deviation of Normalised Object velocity in longitudinal direction";
CM_ SG_ 72 VFC_Obj18_MeasurementSource "Bitfield for the measurement programs from which this object originates
Bit 0: MOD
Bit 1: PDET
Bit 2: OFT
Bit 3: INVALID";
CM_ SG_ 72 VFC_Obj18_2DNormVyStdDev "Standard deviation of Normalised Object velocity in lateral direction";
CM_ SG_ 72 VFC_Obj18_2DNormAxStdDev "Standard deviation of Normalised Object acceleration in longitudinal direction";
CM_ SG_ 72 VFC_Obj18_2DScaleChange "Change in scale of the object in sensor's projection plane. ISO 23150:2023: Scale change - object level (A.2.70)";
CM_ SG_ 72 VFC_Obj18_2DScaleChangeStdDev "Standard deviation of object scale change";
CM_ SG_ 72 VFC_Obj18_Reliability "The bitfield shows if the signal quality is assumed to be sufficient for functions with safety target -no false positives-
Bit 0: DYNAMIC
Bit 1: SEMSEG_SURFACE
Bit 2: WDD_CRITICAL
Bit 3: GOD_CONFIRMED
Bit 4: RESTRICTED
Bit 5: ISO26262_SAFE";
CM_ SG_ 72 VFC_Obj18_LightStatBrakeLight "The number of detected lights. More confident if more lights are detected. Similar to ISO 23150:2023: Light status (A.2.35)";
CM_ SG_ 72 VFC_Obj18_OutsideRoadMeasStatus "2D object outside road boundary measurement status, indicator if it is measured or predicted (if signal is available)";
CM_ SG_ 72 VFC_Obj18_Oncoming "Object is oncoming (if signal is available)";
CM_ SG_ 72 VFC_Obj18_OncomingMeasStatus "Object oncoming measurement status, indicator if it is measured or predicted (if signal is available)";
CM_ SG_ 72 VFC_Obj18_MovementStanding "Object is standing (if signal is available). Related to ISO 23150:2023: Movement status (A.2.32)";
CM_ SG_ 72 VFC_Obj18_MovementStandingMeasSt "Object standing measurement status, indicator if it is measured or predicted (if signal is available)";
CM_ SG_ 72 VFC_Obj18_MovementObserved "Object has been observed moving over the ground since it was first detected (if signal is available). Related to ISO 23150:2023: Movement status (A.2.32)";
CM_ SG_ 72 VFC_Obj18_MovementObservedMeasSt "Measurement status for object has been observed moving (if signal is available)";
CM_ SG_ 72 VFC_Obj18_TargetObjTypeAcc "2D target object type for ACC (if signal is available)";
CM_ SG_ 72 VFC_Obj18_TargetObjTypeAccConf "Confidence of 2D target object type detection for ACC (if signal is available)";
CM_ SG_ 73 VFC_Obj19_CRC "CRC - Autosar E2E Profile 5";
CM_ SG_ 73 VFC_Obj19_AliveCtr "Alive counter - Autosar E2E Profile 5";
CM_ SG_ 73 VFC_Obj19_ProtBlockCtr "Protocol-Signal: Block-Counter";
CM_ SG_ 73 VFC_Obj19_ExistProb "Object existence probability. ISO 23150:2023: Existence probability - object level (A.2.1)";
CM_ SG_ 73 VFC_Obj19_MeasurementStatus "Indicator if the object detected is measured or predicted. ISO 23150:2023: Measurement status - object level (A.2.9)";
CM_ SG_ 73 VFC_Obj19_ObjId "Unique Object ID. ISO 23150:2023: Object ID (A.2.2)";
CM_ SG_ 73 VFC_Obj19_Type "Classification of the object. ISO 23150:2023: Potentially moving object classification type (A.2.12)";
CM_ SG_ 73 VFC_Obj19_TypeConf "Confidence of the classified object type. ISO 23150:2023: Potentially moving object classification type - confidence (A.2.13)";
CM_ SG_ 73 VFC_Obj19_VisibleView "The visible view of the detected object. Reference point is in the middle of CLASSIC (front/rear) or SIDE (left/right). Related to ISO 23150:2023: Reference point (A.2.14)";
CM_ SG_ 73 VFC_Obj19_ClassifiedView "The classified view of object to be used in connection with VisibleView and Heading angle. Related to ISO 23150:2023: Reference point (A.2.14)";
CM_ SG_ 73 VFC_Obj19_Px "Object distance in longitudinal direction. ISO 23150:2023: Position - object level {x, y, z} (A.2.15)";
CM_ SG_ 73 VFC_Obj19_Py "Object distance in lateral direction. ISO 23150:2023: Position - object level {x, y, z} (A.2.15)";
CM_ SG_ 73 VFC_Obj19_PxStdDev "Standard deviation of Object distance in longitudinal direction. ISO 23150:2023: Position - object level {x, y, z} - error (A.2.16)";
CM_ SG_ 73 VFC_Obj19_PyStdDev "Standard deviation of Object distance in lateral direction. ISO 23150:2023: Position - object level {x, y, z} - error (A.2.16)";
CM_ SG_ 73 VFC_Obj19_OrientationYaw "Heading angle of the object. ISO 23150:2023: Orientation {yaw, pitch, roll} (A.2.17)";
CM_ SG_ 73 VFC_Obj19_OrientationYawStdDev "Standard deviation of object Heading angle. ISO 23150:2023: Orientation {yaw, pitch, roll} - error (A.2.18)";
CM_ SG_ 73 VFC_Obj19_Length "Length of the object. ISO 23150:2023: Bounding box extent {length, width, height} (A.2.20)";
CM_ SG_ 73 VFC_Obj19_Width "Width of the object. ISO 23150:2023: Bounding box extent {length, width, height} (A.2.20)";
CM_ SG_ 73 VFC_Obj19_Height "Height of the object. ISO 23150:2023: Bounding box extent {length, width, height} (A.2.20)";
CM_ SG_ 73 VFC_Obj19_LengthStdDev "Standard deviation of object length. ISO 23150:2023: Bounding box extent {length, width, height} - error (A.2.21)";
CM_ SG_ 73 VFC_Obj19_WidthStdDev "Standard deviation of object width. ISO 23150:2023: Bounding box extent {length, width, height} - error (A.2.21)";
CM_ SG_ 73 VFC_Obj19_HeightStdDev "Standard deviation of object height. ISO 23150:2023: Bounding box extent {length, width, height} - error (A.2.21)";
CM_ SG_ 73 VFC_Obj19_Vx "Object velocity in longitudinal direction. ISO 23150:2023: Velocity {x, y, z} - object level (A.2.24)";
CM_ SG_ 73 VFC_Obj19_Vy "Object velocity in lateral direction. ISO 23150:2023: Velocity {x, y, z} - object level (A.2.24)";
CM_ SG_ 73 VFC_Obj19_VxStdDev "Standard deviation of Object velocity in longitudinal direction. ISO 23150:2023: Velocity {x, y, z} - object level - error (A.2.25)";
CM_ SG_ 73 VFC_Obj19_VyStdDev "Standard deviation of Object velocity in lateral direction. ISO 23150:2023: Velocity {x, y, z} - object level - error (A.2.25)";
CM_ SG_ 73 VFC_Obj19_Ax "Object acceleration in longitudinal direction. ISO 23150:2023: Acceleration {x, y, z} (A.2.26)";
CM_ SG_ 73 VFC_Obj19_LightStatTurnIndicator "The detected direction indicator lights. Similar to ISO 23150:2023: Light status (A.2.35)";
CM_ SG_ 73 VFC_Obj19_Ay "Object acceleration in lateral direction. ISO 23150:2023: Acceleration {x, y, z} (A.2.26)";
CM_ SG_ 73 VFC_Obj19_AxStdDev "Standard deviation of Object acceleration in longitudinal direction. ISO 23150:2023: Acceleration {x, y, z} - error (A.2.27)";
CM_ SG_ 73 VFC_Obj19_AyStdDev "Standard deviation of Object acceleration in lateral direction. ISO 23150:2023: Acceleration {x, y, z} - error (A.2.27)";
CM_ SG_ 73 VFC_Obj19_MovementProbLat "Probability of object moving laterally (current state, not if moved at all in object history). Related to ISO 23150:2023: Movement status (A.2.32)";
CM_ SG_ 73 VFC_Obj19_MovementProbLong "Probability of object moving longitudinally (current state, not if moved at all in object history). Related to ISO 23150:2023: Movement status (A.2.32)";
CM_ SG_ 73 VFC_Obj19_2DAngPosEdgeLeft "Bounding box left edge in sensor coordinate system in ACCS coordinates; corresponds to tan(viewing angle of  object edge). ISO 23150:2023: Angular position {azimuth} (A.2.68)";
CM_ SG_ 73 VFC_Obj19_2DAngPosEdgeRight "Bounding box right edge in sensor coordinate system in ACCS coordinates; corresponds to tan(viewing angle of  object edge). ISO 23150:2023: Angular position {azimuth} (A.2.68)";
CM_ SG_ 73 VFC_Obj19_2DAngPosEdgeFar "Bounding box far edge in sensor coordinate system in ACCS coordinates; corresponds to tan(viewing angle of  object edge). ISO 23150:2023: Angular position {azimuth} (A.2.68)";
CM_ SG_ 73 VFC_Obj19_2DAngPosEdgeBot "Bounding box bottom edge in sensor coordinate system in ACCS coordinates; corresponds to tan(viewing angle of  object edge). Sign: upward direction negative value. ISO 23150:2023: Angular position {azimuth} (A.2.68)";
CM_ SG_ 73 VFC_Obj19_OutsideRoad "2D object is located outside road boundary (if signal is available)";
CM_ SG_ 73 VFC_Obj19_2DAngPosEdgeLeftStdDev "Standard deviation of the bounding box left edge";
CM_ SG_ 73 VFC_Obj19_2DAngPosEdgeRightStdDe "Standard deviation of the bounding box right edge";
CM_ SG_ 73 VFC_Obj19_2DAngPosEdgeFarStdDev "Standard deviation of the bounding box far edge";
CM_ SG_ 73 VFC_Obj19_2DAngPosEdgeBotStdDev "Standard deviation of the bounding box bottom edge";
CM_ SG_ 73 VFC_Obj19_2DNormVx "Normalised Object velocity in longitudinal direction (vx/dx_cam). Related to ISO 23150:2023: Angular velocity {azimuth} (A.2.69)";
CM_ SG_ 73 VFC_Obj19_2DNormVy "Normalised Object velocity in lateral direction (vy/dx_cam)";
CM_ SG_ 73 VFC_Obj19_2DNormAx "Normalised Object acceleration in longitudinal direction (ax/dx_cam)";
CM_ SG_ 73 VFC_Obj19_2DNormVxStdDev "Standard deviation of Normalised Object velocity in longitudinal direction";
CM_ SG_ 73 VFC_Obj19_MeasurementSource "Bitfield for the measurement programs from which this object originates
Bit 0: MOD
Bit 1: PDET
Bit 2: OFT
Bit 3: INVALID";
CM_ SG_ 73 VFC_Obj19_2DNormVyStdDev "Standard deviation of Normalised Object velocity in lateral direction";
CM_ SG_ 73 VFC_Obj19_2DNormAxStdDev "Standard deviation of Normalised Object acceleration in longitudinal direction";
CM_ SG_ 73 VFC_Obj19_2DScaleChange "Change in scale of the object in sensor's projection plane. ISO 23150:2023: Scale change - object level (A.2.70)";
CM_ SG_ 73 VFC_Obj19_2DScaleChangeStdDev "Standard deviation of object scale change";
CM_ SG_ 73 VFC_Obj19_Reliability "The bitfield shows if the signal quality is assumed to be sufficient for functions with safety target -no false positives-
Bit 0: DYNAMIC
Bit 1: SEMSEG_SURFACE
Bit 2: WDD_CRITICAL
Bit 3: GOD_CONFIRMED
Bit 4: RESTRICTED
Bit 5: ISO26262_SAFE";
CM_ SG_ 73 VFC_Obj19_LightStatBrakeLight "The number of detected lights. More confident if more lights are detected. Similar to ISO 23150:2023: Light status (A.2.35)";
CM_ SG_ 73 VFC_Obj19_OutsideRoadMeasStatus "2D object outside road boundary measurement status, indicator if it is measured or predicted (if signal is available)";
CM_ SG_ 73 VFC_Obj19_Oncoming "Object is oncoming (if signal is available)";
CM_ SG_ 73 VFC_Obj19_OncomingMeasStatus "Object oncoming measurement status, indicator if it is measured or predicted (if signal is available)";
CM_ SG_ 73 VFC_Obj19_MovementStanding "Object is standing (if signal is available). Related to ISO 23150:2023: Movement status (A.2.32)";
CM_ SG_ 73 VFC_Obj19_MovementStandingMeasSt "Object standing measurement status, indicator if it is measured or predicted (if signal is available)";
CM_ SG_ 73 VFC_Obj19_MovementObserved "Object has been observed moving over the ground since it was first detected (if signal is available). Related to ISO 23150:2023: Movement status (A.2.32)";
CM_ SG_ 73 VFC_Obj19_MovementObservedMeasSt "Measurement status for object has been observed moving (if signal is available)";
CM_ SG_ 73 VFC_Obj19_TargetObjTypeAcc "2D target object type for ACC (if signal is available)";
CM_ SG_ 73 VFC_Obj19_TargetObjTypeAccConf "Confidence of 2D target object type detection for ACC (if signal is available)";
CM_ SG_ 74 VFC_Obj20_CRC "CRC - Autosar E2E Profile 5";
CM_ SG_ 74 VFC_Obj20_AliveCtr "Alive counter - Autosar E2E Profile 5";
CM_ SG_ 74 VFC_Obj20_ProtBlockCtr "Protocol-Signal: Block-Counter";
CM_ SG_ 74 VFC_Obj20_ExistProb "Object existence probability. ISO 23150:2023: Existence probability - object level (A.2.1)";
CM_ SG_ 74 VFC_Obj20_MeasurementStatus "Indicator if the object detected is measured or predicted. ISO 23150:2023: Measurement status - object level (A.2.9)";
CM_ SG_ 74 VFC_Obj20_ObjId "Unique Object ID. ISO 23150:2023: Object ID (A.2.2)";
CM_ SG_ 74 VFC_Obj20_Type "Classification of the object. ISO 23150:2023: Potentially moving object classification type (A.2.12)";
CM_ SG_ 74 VFC_Obj20_TypeConf "Confidence of the classified object type. ISO 23150:2023: Potentially moving object classification type - confidence (A.2.13)";
CM_ SG_ 74 VFC_Obj20_VisibleView "The visible view of the detected object. Reference point is in the middle of CLASSIC (front/rear) or SIDE (left/right). Related to ISO 23150:2023: Reference point (A.2.14)";
CM_ SG_ 74 VFC_Obj20_ClassifiedView "The classified view of object to be used in connection with VisibleView and Heading angle. Related to ISO 23150:2023: Reference point (A.2.14)";
CM_ SG_ 74 VFC_Obj20_Px "Object distance in longitudinal direction. ISO 23150:2023: Position - object level {x, y, z} (A.2.15)";
CM_ SG_ 74 VFC_Obj20_Py "Object distance in lateral direction. ISO 23150:2023: Position - object level {x, y, z} (A.2.15)";
CM_ SG_ 74 VFC_Obj20_PxStdDev "Standard deviation of Object distance in longitudinal direction. ISO 23150:2023: Position - object level {x, y, z} - error (A.2.16)";
CM_ SG_ 74 VFC_Obj20_PyStdDev "Standard deviation of Object distance in lateral direction. ISO 23150:2023: Position - object level {x, y, z} - error (A.2.16)";
CM_ SG_ 74 VFC_Obj20_OrientationYaw "Heading angle of the object. ISO 23150:2023: Orientation {yaw, pitch, roll} (A.2.17)";
CM_ SG_ 74 VFC_Obj20_OrientationYawStdDev "Standard deviation of object Heading angle. ISO 23150:2023: Orientation {yaw, pitch, roll} - error (A.2.18)";
CM_ SG_ 74 VFC_Obj20_Length "Length of the object. ISO 23150:2023: Bounding box extent {length, width, height} (A.2.20)";
CM_ SG_ 74 VFC_Obj20_Width "Width of the object. ISO 23150:2023: Bounding box extent {length, width, height} (A.2.20)";
CM_ SG_ 74 VFC_Obj20_Height "Height of the object. ISO 23150:2023: Bounding box extent {length, width, height} (A.2.20)";
CM_ SG_ 74 VFC_Obj20_LengthStdDev "Standard deviation of object length. ISO 23150:2023: Bounding box extent {length, width, height} - error (A.2.21)";
CM_ SG_ 74 VFC_Obj20_WidthStdDev "Standard deviation of object width. ISO 23150:2023: Bounding box extent {length, width, height} - error (A.2.21)";
CM_ SG_ 74 VFC_Obj20_HeightStdDev "Standard deviation of object height. ISO 23150:2023: Bounding box extent {length, width, height} - error (A.2.21)";
CM_ SG_ 74 VFC_Obj20_Vx "Object velocity in longitudinal direction. ISO 23150:2023: Velocity {x, y, z} - object level (A.2.24)";
CM_ SG_ 74 VFC_Obj20_Vy "Object velocity in lateral direction. ISO 23150:2023: Velocity {x, y, z} - object level (A.2.24)";
CM_ SG_ 74 VFC_Obj20_VxStdDev "Standard deviation of Object velocity in longitudinal direction. ISO 23150:2023: Velocity {x, y, z} - object level - error (A.2.25)";
CM_ SG_ 74 VFC_Obj20_VyStdDev "Standard deviation of Object velocity in lateral direction. ISO 23150:2023: Velocity {x, y, z} - object level - error (A.2.25)";
CM_ SG_ 74 VFC_Obj20_Ax "Object acceleration in longitudinal direction. ISO 23150:2023: Acceleration {x, y, z} (A.2.26)";
CM_ SG_ 74 VFC_Obj20_LightStatTurnIndicator "The detected direction indicator lights. Similar to ISO 23150:2023: Light status (A.2.35)";
CM_ SG_ 74 VFC_Obj20_Ay "Object acceleration in lateral direction. ISO 23150:2023: Acceleration {x, y, z} (A.2.26)";
CM_ SG_ 74 VFC_Obj20_AxStdDev "Standard deviation of Object acceleration in longitudinal direction. ISO 23150:2023: Acceleration {x, y, z} - error (A.2.27)";
CM_ SG_ 74 VFC_Obj20_AyStdDev "Standard deviation of Object acceleration in lateral direction. ISO 23150:2023: Acceleration {x, y, z} - error (A.2.27)";
CM_ SG_ 74 VFC_Obj20_MovementProbLat "Probability of object moving laterally (current state, not if moved at all in object history). Related to ISO 23150:2023: Movement status (A.2.32)";
CM_ SG_ 74 VFC_Obj20_MovementProbLong "Probability of object moving longitudinally (current state, not if moved at all in object history). Related to ISO 23150:2023: Movement status (A.2.32)";
CM_ SG_ 74 VFC_Obj20_2DAngPosEdgeLeft "Bounding box left edge in sensor coordinate system in ACCS coordinates; corresponds to tan(viewing angle of  object edge). ISO 23150:2023: Angular position {azimuth} (A.2.68)";
CM_ SG_ 74 VFC_Obj20_2DAngPosEdgeRight "Bounding box right edge in sensor coordinate system in ACCS coordinates; corresponds to tan(viewing angle of  object edge). ISO 23150:2023: Angular position {azimuth} (A.2.68)";
CM_ SG_ 74 VFC_Obj20_2DAngPosEdgeFar "Bounding box far edge in sensor coordinate system in ACCS coordinates; corresponds to tan(viewing angle of  object edge). ISO 23150:2023: Angular position {azimuth} (A.2.68)";
CM_ SG_ 74 VFC_Obj20_2DAngPosEdgeBot "Bounding box bottom edge in sensor coordinate system in ACCS coordinates; corresponds to tan(viewing angle of  object edge). Sign: upward direction negative value. ISO 23150:2023: Angular position {azimuth} (A.2.68)";
CM_ SG_ 74 VFC_Obj20_OutsideRoad "2D object is located outside road boundary (if signal is available)";
CM_ SG_ 74 VFC_Obj20_2DAngPosEdgeLeftStdDev "Standard deviation of the bounding box left edge";
CM_ SG_ 74 VFC_Obj20_2DAngPosEdgeRightStdDe "Standard deviation of the bounding box right edge";
CM_ SG_ 74 VFC_Obj20_2DAngPosEdgeFarStdDev "Standard deviation of the bounding box far edge";
CM_ SG_ 74 VFC_Obj20_2DAngPosEdgeBotStdDev "Standard deviation of the bounding box bottom edge";
CM_ SG_ 74 VFC_Obj20_2DNormVx "Normalised Object velocity in longitudinal direction (vx/dx_cam). Related to ISO 23150:2023: Angular velocity {azimuth} (A.2.69)";
CM_ SG_ 74 VFC_Obj20_2DNormVy "Normalised Object velocity in lateral direction (vy/dx_cam)";
CM_ SG_ 74 VFC_Obj20_2DNormAx "Normalised Object acceleration in longitudinal direction (ax/dx_cam)";
CM_ SG_ 74 VFC_Obj20_2DNormVxStdDev "Standard deviation of Normalised Object velocity in longitudinal direction";
CM_ SG_ 74 VFC_Obj20_MeasurementSource "Bitfield for the measurement programs from which this object originates
Bit 0: MOD
Bit 1: PDET
Bit 2: OFT
Bit 3: INVALID";
CM_ SG_ 74 VFC_Obj20_2DNormVyStdDev "Standard deviation of Normalised Object velocity in lateral direction";
CM_ SG_ 74 VFC_Obj20_2DNormAxStdDev "Standard deviation of Normalised Object acceleration in longitudinal direction";
CM_ SG_ 74 VFC_Obj20_2DScaleChange "Change in scale of the object in sensor's projection plane. ISO 23150:2023: Scale change - object level (A.2.70)";
CM_ SG_ 74 VFC_Obj20_2DScaleChangeStdDev "Standard deviation of object scale change";
CM_ SG_ 74 VFC_Obj20_Reliability "The bitfield shows if the signal quality is assumed to be sufficient for functions with safety target -no false positives-
Bit 0: DYNAMIC
Bit 1: SEMSEG_SURFACE
Bit 2: WDD_CRITICAL
Bit 3: GOD_CONFIRMED
Bit 4: RESTRICTED
Bit 5: ISO26262_SAFE";
CM_ SG_ 74 VFC_Obj20_LightStatBrakeLight "The number of detected lights. More confident if more lights are detected. Similar to ISO 23150:2023: Light status (A.2.35)";
CM_ SG_ 74 VFC_Obj20_OutsideRoadMeasStatus "2D object outside road boundary measurement status, indicator if it is measured or predicted (if signal is available)";
CM_ SG_ 74 VFC_Obj20_Oncoming "Object is oncoming (if signal is available)";
CM_ SG_ 74 VFC_Obj20_OncomingMeasStatus "Object oncoming measurement status, indicator if it is measured or predicted (if signal is available)";
CM_ SG_ 74 VFC_Obj20_MovementStanding "Object is standing (if signal is available). Related to ISO 23150:2023: Movement status (A.2.32)";
CM_ SG_ 74 VFC_Obj20_MovementStandingMeasSt "Object standing measurement status, indicator if it is measured or predicted (if signal is available)";
CM_ SG_ 74 VFC_Obj20_MovementObserved "Object has been observed moving over the ground since it was first detected (if signal is available). Related to ISO 23150:2023: Movement status (A.2.32)";
CM_ SG_ 74 VFC_Obj20_MovementObservedMeasSt "Measurement status for object has been observed moving (if signal is available)";
CM_ SG_ 74 VFC_Obj20_TargetObjTypeAcc "2D target object type for ACC (if signal is available)";
CM_ SG_ 74 VFC_Obj20_TargetObjTypeAccConf "Confidence of 2D target object type detection for ACC (if signal is available)";
BA_DEF_ BO_  "CANFD_BRS" ENUM  "0","1";
BA_DEF_ BO_  "GenMsgCycleTime" INT 0 65535;
BA_DEF_ BO_  "GenMsgILSupport" ENUM  "No","Yes";
BA_DEF_ BO_  "GenMsgSendType" ENUM  "Cyclic","Event","reserved","reserved","reserved","reserved","reserved","IfActive","NoMsgSendType","reserved","reserved","reserved";
BA_DEF_ BO_  "VFrameFormat" ENUM  "StandardCAN","ExtendedCAN","reserved","reserved","reserved","reserved","reserved","reserved","reserved","reserved","reserved","reserved","reserved","reserved","StandardCAN_FD","ExtendedCAN_FD";
BA_DEF_ BO_  "E2Eprofile" STRING ;
BA_DEF_ BO_  "DataID" HEX 0 655535;
BA_DEF_ SG_  "GenSigSendType" ENUM  "Cyclic","OnWrite","OnWriteWithRepetition","OnChange","OnChangeWithRepetition","IfActive","IfActiveWithRepetition","NoSigSendType","OnChangeAndIfActive","OnChangeAndIfActiveWithRepetition";
BA_DEF_ SG_  "GenSigStartValue" HEX 0 2147483648;
BA_DEF_DEF_  "CANFD_BRS" "1";
BA_DEF_DEF_  "GenMsgCycleTime" 0;
BA_DEF_DEF_  "GenMsgILSupport" "Yes";
BA_DEF_DEF_  "GenMsgSendType" "Cyclic";
BA_DEF_DEF_  "VFrameFormat" "";
BA_DEF_DEF_  "E2Eprofile" "None";
BA_DEF_DEF_  "DataID" 0;
BA_DEF_DEF_  "GenSigSendType" "NoSigSendType";
BA_DEF_DEF_  "GenSigStartValue" 0;
BA_ "GenMsgSendType" BO_ 64 1;
BA_ "E2Eprofile" BO_ 64 "AUTOSAR Profile 5";
BA_ "DataID" BO_ 64 8256;
BA_ "VFrameFormat" BO_ 64 14;
BA_ "GenMsgSendType" BO_ 65 1;
BA_ "E2Eprofile" BO_ 65 "AUTOSAR Profile 5";
BA_ "DataID" BO_ 65 8257;
BA_ "VFrameFormat" BO_ 65 14;
BA_ "GenMsgSendType" BO_ 66 1;
BA_ "E2Eprofile" BO_ 66 "AUTOSAR Profile 5";
BA_ "DataID" BO_ 66 8258;
BA_ "VFrameFormat" BO_ 66 14;
BA_ "GenMsgSendType" BO_ 67 1;
BA_ "E2Eprofile" BO_ 67 "AUTOSAR Profile 5";
BA_ "DataID" BO_ 67 8259;
BA_ "VFrameFormat" BO_ 67 14;
BA_ "GenMsgSendType" BO_ 68 1;
BA_ "E2Eprofile" BO_ 68 "AUTOSAR Profile 5";
BA_ "DataID" BO_ 68 8260;
BA_ "VFrameFormat" BO_ 68 14;
BA_ "GenMsgSendType" BO_ 69 1;
BA_ "E2Eprofile" BO_ 69 "AUTOSAR Profile 5";
BA_ "DataID" BO_ 69 8261;
BA_ "VFrameFormat" BO_ 69 14;
BA_ "GenMsgSendType" BO_ 70 1;
BA_ "E2Eprofile" BO_ 70 "AUTOSAR Profile 5";
BA_ "DataID" BO_ 70 8262;
BA_ "VFrameFormat" BO_ 70 14;
BA_ "GenMsgSendType" BO_ 71 1;
BA_ "E2Eprofile" BO_ 71 "AUTOSAR Profile 5";
BA_ "DataID" BO_ 71 8263;
BA_ "VFrameFormat" BO_ 71 14;
BA_ "GenMsgSendType" BO_ 72 1;
BA_ "E2Eprofile" BO_ 72 "AUTOSAR Profile 5";
BA_ "DataID" BO_ 72 8264;
BA_ "VFrameFormat" BO_ 72 14;
BA_ "GenMsgSendType" BO_ 73 1;
BA_ "E2Eprofile" BO_ 73 "AUTOSAR Profile 5";
BA_ "DataID" BO_ 73 8265;
BA_ "VFrameFormat" BO_ 73 14;
BA_ "GenMsgSendType" BO_ 74 1;
BA_ "E2Eprofile" BO_ 74 "AUTOSAR Profile 5";
BA_ "DataID" BO_ 74 8266;
BA_ "VFrameFormat" BO_ 74 14;
BA_ "GenSigStartValue" SG_ 64 VFC_Obj10_Py 8192;
BA_ "GenSigStartValue" SG_ 64 VFC_Obj10_OrientationYaw 256;
BA_ "GenSigStartValue" SG_ 64 VFC_Obj10_Vx 1540;
BA_ "GenSigStartValue" SG_ 64 VFC_Obj10_Vy 512;
BA_ "GenSigStartValue" SG_ 64 VFC_Obj10_Ax 256;
BA_ "GenSigStartValue" SG_ 64 VFC_Obj10_Ay 128;
BA_ "GenSigStartValue" SG_ 64 VFC_Obj10_2DAngPosEdgeLeft 4096;
BA_ "GenSigStartValue" SG_ 64 VFC_Obj10_2DAngPosEdgeRight 4096;
BA_ "GenSigStartValue" SG_ 64 VFC_Obj10_2DAngPosEdgeFar 4096;
BA_ "GenSigStartValue" SG_ 64 VFC_Obj10_2DAngPosEdgeBot 2048;
BA_ "GenSigStartValue" SG_ 64 VFC_Obj10_2DNormVx 40000;
BA_ "GenSigStartValue" SG_ 64 VFC_Obj10_2DNormVy 4096;
BA_ "GenSigStartValue" SG_ 64 VFC_Obj10_2DNormAx 5000;
BA_ "GenSigStartValue" SG_ 65 VFC_Obj11_Py 8192;
BA_ "GenSigStartValue" SG_ 65 VFC_Obj11_OrientationYaw 256;
BA_ "GenSigStartValue" SG_ 65 VFC_Obj11_Vx 1540;
BA_ "GenSigStartValue" SG_ 65 VFC_Obj11_Vy 512;
BA_ "GenSigStartValue" SG_ 65 VFC_Obj11_Ax 256;
BA_ "GenSigStartValue" SG_ 65 VFC_Obj11_Ay 128;
BA_ "GenSigStartValue" SG_ 65 VFC_Obj11_2DAngPosEdgeLeft 4096;
BA_ "GenSigStartValue" SG_ 65 VFC_Obj11_2DAngPosEdgeRight 4096;
BA_ "GenSigStartValue" SG_ 65 VFC_Obj11_2DAngPosEdgeFar 4096;
BA_ "GenSigStartValue" SG_ 65 VFC_Obj11_2DAngPosEdgeBot 2048;
BA_ "GenSigStartValue" SG_ 65 VFC_Obj11_2DNormVx 40000;
BA_ "GenSigStartValue" SG_ 65 VFC_Obj11_2DNormVy 4096;
BA_ "GenSigStartValue" SG_ 65 VFC_Obj11_2DNormAx 5000;
BA_ "GenSigStartValue" SG_ 66 VFC_Obj12_Py 8192;
BA_ "GenSigStartValue" SG_ 66 VFC_Obj12_OrientationYaw 256;
BA_ "GenSigStartValue" SG_ 66 VFC_Obj12_Vx 1540;
BA_ "GenSigStartValue" SG_ 66 VFC_Obj12_Vy 512;
BA_ "GenSigStartValue" SG_ 66 VFC_Obj12_Ax 256;
BA_ "GenSigStartValue" SG_ 66 VFC_Obj12_Ay 128;
BA_ "GenSigStartValue" SG_ 66 VFC_Obj12_2DAngPosEdgeLeft 4096;
BA_ "GenSigStartValue" SG_ 66 VFC_Obj12_2DAngPosEdgeRight 4096;
BA_ "GenSigStartValue" SG_ 66 VFC_Obj12_2DAngPosEdgeFar 4096;
BA_ "GenSigStartValue" SG_ 66 VFC_Obj12_2DAngPosEdgeBot 2048;
BA_ "GenSigStartValue" SG_ 66 VFC_Obj12_2DNormVx 40000;
BA_ "GenSigStartValue" SG_ 66 VFC_Obj12_2DNormVy 4096;
BA_ "GenSigStartValue" SG_ 66 VFC_Obj12_2DNormAx 5000;
BA_ "GenSigStartValue" SG_ 67 VFC_Obj13_Py 8192;
BA_ "GenSigStartValue" SG_ 67 VFC_Obj13_OrientationYaw 256;
BA_ "GenSigStartValue" SG_ 67 VFC_Obj13_Vx 1540;
BA_ "GenSigStartValue" SG_ 67 VFC_Obj13_Vy 512;
BA_ "GenSigStartValue" SG_ 67 VFC_Obj13_Ax 256;
BA_ "GenSigStartValue" SG_ 67 VFC_Obj13_Ay 128;
BA_ "GenSigStartValue" SG_ 67 VFC_Obj13_2DAngPosEdgeLeft 4096;
BA_ "GenSigStartValue" SG_ 67 VFC_Obj13_2DAngPosEdgeRight 4096;
BA_ "GenSigStartValue" SG_ 67 VFC_Obj13_2DAngPosEdgeFar 4096;
BA_ "GenSigStartValue" SG_ 67 VFC_Obj13_2DAngPosEdgeBot 2048;
BA_ "GenSigStartValue" SG_ 67 VFC_Obj13_2DNormVx 40000;
BA_ "GenSigStartValue" SG_ 67 VFC_Obj13_2DNormVy 4096;
BA_ "GenSigStartValue" SG_ 67 VFC_Obj13_2DNormAx 5000;
BA_ "GenSigStartValue" SG_ 68 VFC_Obj14_Py 8192;
BA_ "GenSigStartValue" SG_ 68 VFC_Obj14_OrientationYaw 256;
BA_ "GenSigStartValue" SG_ 68 VFC_Obj14_Vx 1540;
BA_ "GenSigStartValue" SG_ 68 VFC_Obj14_Vy 512;
BA_ "GenSigStartValue" SG_ 68 VFC_Obj14_Ax 256;
BA_ "GenSigStartValue" SG_ 68 VFC_Obj14_Ay 128;
BA_ "GenSigStartValue" SG_ 68 VFC_Obj14_2DAngPosEdgeLeft 4096;
BA_ "GenSigStartValue" SG_ 68 VFC_Obj14_2DAngPosEdgeRight 4096;
BA_ "GenSigStartValue" SG_ 68 VFC_Obj14_2DAngPosEdgeFar 4096;
BA_ "GenSigStartValue" SG_ 68 VFC_Obj14_2DAngPosEdgeBot 2048;
BA_ "GenSigStartValue" SG_ 68 VFC_Obj14_2DNormVx 40000;
BA_ "GenSigStartValue" SG_ 68 VFC_Obj14_2DNormVy 4096;
BA_ "GenSigStartValue" SG_ 68 VFC_Obj14_2DNormAx 5000;
BA_ "GenSigStartValue" SG_ 69 VFC_Obj15_Py 8192;
BA_ "GenSigStartValue" SG_ 69 VFC_Obj15_OrientationYaw 256;
BA_ "GenSigStartValue" SG_ 69 VFC_Obj15_Vx 1540;
BA_ "GenSigStartValue" SG_ 69 VFC_Obj15_Vy 512;
BA_ "GenSigStartValue" SG_ 69 VFC_Obj15_Ax 256;
BA_ "GenSigStartValue" SG_ 69 VFC_Obj15_Ay 128;
BA_ "GenSigStartValue" SG_ 69 VFC_Obj15_2DAngPosEdgeLeft 4096;
BA_ "GenSigStartValue" SG_ 69 VFC_Obj15_2DAngPosEdgeRight 4096;
BA_ "GenSigStartValue" SG_ 69 VFC_Obj15_2DAngPosEdgeFar 4096;
BA_ "GenSigStartValue" SG_ 69 VFC_Obj15_2DAngPosEdgeBot 2048;
BA_ "GenSigStartValue" SG_ 69 VFC_Obj15_2DNormVx 40000;
BA_ "GenSigStartValue" SG_ 69 VFC_Obj15_2DNormVy 4096;
BA_ "GenSigStartValue" SG_ 69 VFC_Obj15_2DNormAx 5000;
BA_ "GenSigStartValue" SG_ 70 VFC_Obj16_Py 8192;
BA_ "GenSigStartValue" SG_ 70 VFC_Obj16_OrientationYaw 256;
BA_ "GenSigStartValue" SG_ 70 VFC_Obj16_Vx 1540;
BA_ "GenSigStartValue" SG_ 70 VFC_Obj16_Vy 512;
BA_ "GenSigStartValue" SG_ 70 VFC_Obj16_Ax 256;
BA_ "GenSigStartValue" SG_ 70 VFC_Obj16_Ay 128;
BA_ "GenSigStartValue" SG_ 70 VFC_Obj16_2DAngPosEdgeLeft 4096;
BA_ "GenSigStartValue" SG_ 70 VFC_Obj16_2DAngPosEdgeRight 4096;
BA_ "GenSigStartValue" SG_ 70 VFC_Obj16_2DAngPosEdgeFar 4096;
BA_ "GenSigStartValue" SG_ 70 VFC_Obj16_2DAngPosEdgeBot 2048;
BA_ "GenSigStartValue" SG_ 70 VFC_Obj16_2DNormVx 40000;
BA_ "GenSigStartValue" SG_ 70 VFC_Obj16_2DNormVy 4096;
BA_ "GenSigStartValue" SG_ 70 VFC_Obj16_2DNormAx 5000;
BA_ "GenSigStartValue" SG_ 71 VFC_Obj17_Py 8192;
BA_ "GenSigStartValue" SG_ 71 VFC_Obj17_OrientationYaw 256;
BA_ "GenSigStartValue" SG_ 71 VFC_Obj17_Vx 1540;
BA_ "GenSigStartValue" SG_ 71 VFC_Obj17_Vy 512;
BA_ "GenSigStartValue" SG_ 71 VFC_Obj17_Ax 256;
BA_ "GenSigStartValue" SG_ 71 VFC_Obj17_Ay 128;
BA_ "GenSigStartValue" SG_ 71 VFC_Obj17_2DAngPosEdgeLeft 4096;
BA_ "GenSigStartValue" SG_ 71 VFC_Obj17_2DAngPosEdgeRight 4096;
BA_ "GenSigStartValue" SG_ 71 VFC_Obj17_2DAngPosEdgeFar 4096;
BA_ "GenSigStartValue" SG_ 71 VFC_Obj17_2DAngPosEdgeBot 2048;
BA_ "GenSigStartValue" SG_ 71 VFC_Obj17_2DNormVx 40000;
BA_ "GenSigStartValue" SG_ 71 VFC_Obj17_2DNormVy 4096;
BA_ "GenSigStartValue" SG_ 71 VFC_Obj17_2DNormAx 5000;
BA_ "GenSigStartValue" SG_ 72 VFC_Obj18_Py 8192;
BA_ "GenSigStartValue" SG_ 72 VFC_Obj18_OrientationYaw 256;
BA_ "GenSigStartValue" SG_ 72 VFC_Obj18_Vx 1540;
BA_ "GenSigStartValue" SG_ 72 VFC_Obj18_Vy 512;
BA_ "GenSigStartValue" SG_ 72 VFC_Obj18_Ax 256;
BA_ "GenSigStartValue" SG_ 72 VFC_Obj18_Ay 128;
BA_ "GenSigStartValue" SG_ 72 VFC_Obj18_2DAngPosEdgeLeft 4096;
BA_ "GenSigStartValue" SG_ 72 VFC_Obj18_2DAngPosEdgeRight 4096;
BA_ "GenSigStartValue" SG_ 72 VFC_Obj18_2DAngPosEdgeFar 4096;
BA_ "GenSigStartValue" SG_ 72 VFC_Obj18_2DAngPosEdgeBot 2048;
BA_ "GenSigStartValue" SG_ 72 VFC_Obj18_2DNormVx 40000;
BA_ "GenSigStartValue" SG_ 72 VFC_Obj18_2DNormVy 4096;
BA_ "GenSigStartValue" SG_ 72 VFC_Obj18_2DNormAx 5000;
BA_ "GenSigStartValue" SG_ 73 VFC_Obj19_Py 8192;
BA_ "GenSigStartValue" SG_ 73 VFC_Obj19_OrientationYaw 256;
BA_ "GenSigStartValue" SG_ 73 VFC_Obj19_Vx 1540;
BA_ "GenSigStartValue" SG_ 73 VFC_Obj19_Vy 512;
BA_ "GenSigStartValue" SG_ 73 VFC_Obj19_Ax 256;
BA_ "GenSigStartValue" SG_ 73 VFC_Obj19_Ay 128;
BA_ "GenSigStartValue" SG_ 73 VFC_Obj19_2DAngPosEdgeLeft 4096;
BA_ "GenSigStartValue" SG_ 73 VFC_Obj19_2DAngPosEdgeRight 4096;
BA_ "GenSigStartValue" SG_ 73 VFC_Obj19_2DAngPosEdgeFar 4096;
BA_ "GenSigStartValue" SG_ 73 VFC_Obj19_2DAngPosEdgeBot 2048;
BA_ "GenSigStartValue" SG_ 73 VFC_Obj19_2DNormVx 40000;
BA_ "GenSigStartValue" SG_ 73 VFC_Obj19_2DNormVy 4096;
BA_ "GenSigStartValue" SG_ 73 VFC_Obj19_2DNormAx 5000;
BA_ "GenSigStartValue" SG_ 74 VFC_Obj20_Py 8192;
BA_ "GenSigStartValue" SG_ 74 VFC_Obj20_OrientationYaw 256;
BA_ "GenSigStartValue" SG_ 74 VFC_Obj20_Vx 1540;
BA_ "GenSigStartValue" SG_ 74 VFC_Obj20_Vy 512;
BA_ "GenSigStartValue" SG_ 74 VFC_Obj20_Ax 256;
BA_ "GenSigStartValue" SG_ 74 VFC_Obj20_Ay 128;
BA_ "GenSigStartValue" SG_ 74 VFC_Obj20_2DAngPosEdgeLeft 4096;
BA_ "GenSigStartValue" SG_ 74 VFC_Obj20_2DAngPosEdgeRight 4096;
BA_ "GenSigStartValue" SG_ 74 VFC_Obj20_2DAngPosEdgeFar 4096;
BA_ "GenSigStartValue" SG_ 74 VFC_Obj20_2DAngPosEdgeBot 2048;
BA_ "GenSigStartValue" SG_ 74 VFC_Obj20_2DNormVx 40000;
BA_ "GenSigStartValue" SG_ 74 VFC_Obj20_2DNormVy 4096;
BA_ "GenSigStartValue" SG_ 74 VFC_Obj20_2DNormAx 5000;
VAL_ 64 VFC_Obj10_MeasurementStatus 0 "Invalid" 1 "Measured" 2 "Predicted" 3 "Reserved3" ;
VAL_ 64 VFC_Obj10_ObjId 0 "INVALID" ;
VAL_ 64 VFC_Obj10_Type 0 "NOTYPE" 1 "CAR" 2 "RESERVED02" 3 "TRUCK" 4 "RESERVED04" 5 "RESERVED05" 6 "MOTORCYCLIST" 7 "PEDESTRIAN" 8 "CYCLIST" 9 "BOLLARD" 10 "ROADPOST" 11 "ARROWPOST" 12 "RESERVED12" 13 "RESERVED13" 14 "RESERVED14" 15 "RESERVED15" ;
VAL_ 64 VFC_Obj10_VisibleView 0 "UNKNOWN" 1 "CLASSIC" 2 "SIDE" 3 "CLASSIC_LSHAPE" 4 "SIDE_LSHAPE" 5 "Reserved5" 6 "Reserved6" 7 "Reserved7" ;
VAL_ 64 VFC_Obj10_ClassifiedView 0 "Unknown" 1 "Front" 2 "Rear" 3 "Left" 4 "Right" 5 "Reserved5" 6 "Reserved6" 7 "Reserved7" ;
VAL_ 64 VFC_Obj10_LightStatTurnIndicator 0 "Unknown" 1 "No direction indicator" 2 "Left indicator" 3 "Right indicator" 4 "Warning Lights" 5 "Reserved5" 6 "Reserved6" 7 "Reserved7" ;
VAL_ 64 VFC_Obj10_LightStatBrakeLight 0 "Unknown" 1 "No light detected" 2 "One light detected" 3 "Two lights detected" 4 "Three lights detected" 5 "Reserved5" 6 "Reserved6" 7 "Reserved7" ;
VAL_ 64 VFC_Obj10_OutsideRoadMeasStatus 0 "Invalid" 1 "Measured" 2 "Predicted" 3 "Reserved3" ;
VAL_ 64 VFC_Obj10_OncomingMeasStatus 0 "Invalid" 1 "Measured" 2 "Predicted" 3 "Reserved3" ;
VAL_ 64 VFC_Obj10_MovementStandingMeasSt 0 "Invalid" 1 "Measured" 2 "Predicted" 3 "Reserved3" ;
VAL_ 64 VFC_Obj10_MovementObservedMeasSt 0 "Invalid" 1 "Valid" ;
VAL_ 64 VFC_Obj10_TargetObjTypeAcc 0 "No_target_object" 1 "Ego_0" 2 "Ego_1" 3 "Left_0" 4 "Left_1" 5 "Right_0" 6 "Right_1" 7 "Reserved7" ;
VAL_ 65 VFC_Obj11_MeasurementStatus 0 "Invalid" 1 "Measured" 2 "Predicted" 3 "Reserved3" ;
VAL_ 65 VFC_Obj11_ObjId 0 "INVALID" ;
VAL_ 65 VFC_Obj11_Type 0 "NOTYPE" 1 "CAR" 2 "RESERVED02" 3 "TRUCK" 4 "RESERVED04" 5 "RESERVED05" 6 "MOTORCYCLIST" 7 "PEDESTRIAN" 8 "CYCLIST" 9 "BOLLARD" 10 "ROADPOST" 11 "ARROWPOST" 12 "RESERVED12" 13 "RESERVED13" 14 "RESERVED14" 15 "RESERVED15" ;
VAL_ 65 VFC_Obj11_VisibleView 0 "UNKNOWN" 1 "CLASSIC" 2 "SIDE" 3 "CLASSIC_LSHAPE" 4 "SIDE_LSHAPE" 5 "Reserved5" 6 "Reserved6" 7 "Reserved7" ;
VAL_ 65 VFC_Obj11_ClassifiedView 0 "Unknown" 1 "Front" 2 "Rear" 3 "Left" 4 "Right" 5 "Reserved5" 6 "Reserved6" 7 "Reserved7" ;
VAL_ 65 VFC_Obj11_LightStatTurnIndicator 0 "Unknown" 1 "No direction indicator" 2 "Left indicator" 3 "Right indicator" 4 "Warning Lights" 5 "Reserved5" 6 "Reserved6" 7 "Reserved7" ;
VAL_ 65 VFC_Obj11_LightStatBrakeLight 0 "Unknown" 1 "No light detected" 2 "One light detected" 3 "Two lights detected" 4 "Three lights detected" 5 "Reserved5" 6 "Reserved6" 7 "Reserved7" ;
VAL_ 65 VFC_Obj11_OutsideRoadMeasStatus 0 "Invalid" 1 "Measured" 2 "Predicted" 3 "Reserved3" ;
VAL_ 65 VFC_Obj11_OncomingMeasStatus 0 "Invalid" 1 "Measured" 2 "Predicted" 3 "Reserved3" ;
VAL_ 65 VFC_Obj11_MovementStandingMeasSt 0 "Invalid" 1 "Measured" 2 "Predicted" 3 "Reserved3" ;
VAL_ 65 VFC_Obj11_MovementObservedMeasSt 0 "Invalid" 1 "Valid" ;
VAL_ 65 VFC_Obj11_TargetObjTypeAcc 0 "No_target_object" 1 "Ego_0" 2 "Ego_1" 3 "Left_0" 4 "Left_1" 5 "Right_0" 6 "Right_1" 7 "Reserved7" ;
VAL_ 66 VFC_Obj12_MeasurementStatus 0 "Invalid" 1 "Measured" 2 "Predicted" 3 "Reserved3" ;
VAL_ 66 VFC_Obj12_ObjId 0 "INVALID" ;
VAL_ 66 VFC_Obj12_Type 0 "NOTYPE" 1 "CAR" 2 "RESERVED02" 3 "TRUCK" 4 "RESERVED04" 5 "RESERVED05" 6 "MOTORCYCLIST" 7 "PEDESTRIAN" 8 "CYCLIST" 9 "BOLLARD" 10 "ROADPOST" 11 "ARROWPOST" 12 "RESERVED12" 13 "RESERVED13" 14 "RESERVED14" 15 "RESERVED15" ;
VAL_ 66 VFC_Obj12_VisibleView 0 "UNKNOWN" 1 "CLASSIC" 2 "SIDE" 3 "CLASSIC_LSHAPE" 4 "SIDE_LSHAPE" 5 "Reserved5" 6 "Reserved6" 7 "Reserved7" ;
VAL_ 66 VFC_Obj12_ClassifiedView 0 "Unknown" 1 "Front" 2 "Rear" 3 "Left" 4 "Right" 5 "Reserved5" 6 "Reserved6" 7 "Reserved7" ;
VAL_ 66 VFC_Obj12_LightStatTurnIndicator 0 "Unknown" 1 "No direction indicator" 2 "Left indicator" 3 "Right indicator" 4 "Warning Lights" 5 "Reserved5" 6 "Reserved6" 7 "Reserved7" ;
VAL_ 66 VFC_Obj12_LightStatBrakeLight 0 "Unknown" 1 "No light detected" 2 "One light detected" 3 "Two lights detected" 4 "Three lights detected" 5 "Reserved5" 6 "Reserved6" 7 "Reserved7" ;
VAL_ 66 VFC_Obj12_OutsideRoadMeasStatus 0 "Invalid" 1 "Measured" 2 "Predicted" 3 "Reserved3" ;
VAL_ 66 VFC_Obj12_OncomingMeasStatus 0 "Invalid" 1 "Measured" 2 "Predicted" 3 "Reserved3" ;
VAL_ 66 VFC_Obj12_MovementStandingMeasSt 0 "Invalid" 1 "Measured" 2 "Predicted" 3 "Reserved3" ;
VAL_ 66 VFC_Obj12_MovementObservedMeasSt 0 "Invalid" 1 "Valid" ;
VAL_ 66 VFC_Obj12_TargetObjTypeAcc 0 "No_target_object" 1 "Ego_0" 2 "Ego_1" 3 "Left_0" 4 "Left_1" 5 "Right_0" 6 "Right_1" 7 "Reserved7" ;
VAL_ 67 VFC_Obj13_MeasurementStatus 0 "Invalid" 1 "Measured" 2 "Predicted" 3 "Reserved3" ;
VAL_ 67 VFC_Obj13_ObjId 0 "INVALID" ;
VAL_ 67 VFC_Obj13_Type 0 "NOTYPE" 1 "CAR" 2 "RESERVED02" 3 "TRUCK" 4 "RESERVED04" 5 "RESERVED05" 6 "MOTORCYCLIST" 7 "PEDESTRIAN" 8 "CYCLIST" 9 "BOLLARD" 10 "ROADPOST" 11 "ARROWPOST" 12 "RESERVED12" 13 "RESERVED13" 14 "RESERVED14" 15 "RESERVED15" ;
VAL_ 67 VFC_Obj13_VisibleView 0 "UNKNOWN" 1 "CLASSIC" 2 "SIDE" 3 "CLASSIC_LSHAPE" 4 "SIDE_LSHAPE" 5 "Reserved5" 6 "Reserved6" 7 "Reserved7" ;
VAL_ 67 VFC_Obj13_ClassifiedView 0 "Unknown" 1 "Front" 2 "Rear" 3 "Left" 4 "Right" 5 "Reserved5" 6 "Reserved6" 7 "Reserved7" ;
VAL_ 67 VFC_Obj13_LightStatTurnIndicator 0 "Unknown" 1 "No direction indicator" 2 "Left indicator" 3 "Right indicator" 4 "Warning Lights" 5 "Reserved5" 6 "Reserved6" 7 "Reserved7" ;
VAL_ 67 VFC_Obj13_LightStatBrakeLight 0 "Unknown" 1 "No light detected" 2 "One light detected" 3 "Two lights detected" 4 "Three lights detected" 5 "Reserved5" 6 "Reserved6" 7 "Reserved7" ;
VAL_ 67 VFC_Obj13_OutsideRoadMeasStatus 0 "Invalid" 1 "Measured" 2 "Predicted" 3 "Reserved3" ;
VAL_ 67 VFC_Obj13_OncomingMeasStatus 0 "Invalid" 1 "Measured" 2 "Predicted" 3 "Reserved3" ;
VAL_ 67 VFC_Obj13_MovementStandingMeasSt 0 "Invalid" 1 "Measured" 2 "Predicted" 3 "Reserved3" ;
VAL_ 67 VFC_Obj13_MovementObservedMeasSt 0 "Invalid" 1 "Valid" ;
VAL_ 67 VFC_Obj13_TargetObjTypeAcc 0 "No_target_object" 1 "Ego_0" 2 "Ego_1" 3 "Left_0" 4 "Left_1" 5 "Right_0" 6 "Right_1" 7 "Reserved7" ;
VAL_ 68 VFC_Obj14_MeasurementStatus 0 "Invalid" 1 "Measured" 2 "Predicted" 3 "Reserved3" ;
VAL_ 68 VFC_Obj14_ObjId 0 "INVALID" ;
VAL_ 68 VFC_Obj14_Type 0 "NOTYPE" 1 "CAR" 2 "RESERVED02" 3 "TRUCK" 4 "RESERVED04" 5 "RESERVED05" 6 "MOTORCYCLIST" 7 "PEDESTRIAN" 8 "CYCLIST" 9 "BOLLARD" 10 "ROADPOST" 11 "ARROWPOST" 12 "RESERVED12" 13 "RESERVED13" 14 "RESERVED14" 15 "RESERVED15" ;
VAL_ 68 VFC_Obj14_VisibleView 0 "UNKNOWN" 1 "CLASSIC" 2 "SIDE" 3 "CLASSIC_LSHAPE" 4 "SIDE_LSHAPE" 5 "Reserved5" 6 "Reserved6" 7 "Reserved7" ;
VAL_ 68 VFC_Obj14_ClassifiedView 0 "Unknown" 1 "Front" 2 "Rear" 3 "Left" 4 "Right" 5 "Reserved5" 6 "Reserved6" 7 "Reserved7" ;
VAL_ 68 VFC_Obj14_LightStatTurnIndicator 0 "Unknown" 1 "No direction indicator" 2 "Left indicator" 3 "Right indicator" 4 "Warning Lights" 5 "Reserved5" 6 "Reserved6" 7 "Reserved7" ;
VAL_ 68 VFC_Obj14_LightStatBrakeLight 0 "Unknown" 1 "No light detected" 2 "One light detected" 3 "Two lights detected" 4 "Three lights detected" 5 "Reserved5" 6 "Reserved6" 7 "Reserved7" ;
VAL_ 68 VFC_Obj14_OutsideRoadMeasStatus 0 "Invalid" 1 "Measured" 2 "Predicted" 3 "Reserved3" ;
VAL_ 68 VFC_Obj14_OncomingMeasStatus 0 "Invalid" 1 "Measured" 2 "Predicted" 3 "Reserved3" ;
VAL_ 68 VFC_Obj14_MovementStandingMeasSt 0 "Invalid" 1 "Measured" 2 "Predicted" 3 "Reserved3" ;
VAL_ 68 VFC_Obj14_MovementObservedMeasSt 0 "Invalid" 1 "Valid" ;
VAL_ 68 VFC_Obj14_TargetObjTypeAcc 0 "No_target_object" 1 "Ego_0" 2 "Ego_1" 3 "Left_0" 4 "Left_1" 5 "Right_0" 6 "Right_1" 7 "Reserved7" ;
VAL_ 69 VFC_Obj15_MeasurementStatus 0 "Invalid" 1 "Measured" 2 "Predicted" 3 "Reserved3" ;
VAL_ 69 VFC_Obj15_ObjId 0 "INVALID" ;
VAL_ 69 VFC_Obj15_Type 0 "NOTYPE" 1 "CAR" 2 "RESERVED02" 3 "TRUCK" 4 "RESERVED04" 5 "RESERVED05" 6 "MOTORCYCLIST" 7 "PEDESTRIAN" 8 "CYCLIST" 9 "BOLLARD" 10 "ROADPOST" 11 "ARROWPOST" 12 "RESERVED12" 13 "RESERVED13" 14 "RESERVED14" 15 "RESERVED15" ;
VAL_ 69 VFC_Obj15_VisibleView 0 "UNKNOWN" 1 "CLASSIC" 2 "SIDE" 3 "CLASSIC_LSHAPE" 4 "SIDE_LSHAPE" 5 "Reserved5" 6 "Reserved6" 7 "Reserved7" ;
VAL_ 69 VFC_Obj15_ClassifiedView 0 "Unknown" 1 "Front" 2 "Rear" 3 "Left" 4 "Right" 5 "Reserved5" 6 "Reserved6" 7 "Reserved7" ;
VAL_ 69 VFC_Obj15_LightStatTurnIndicator 0 "Unknown" 1 "No direction indicator" 2 "Left indicator" 3 "Right indicator" 4 "Warning Lights" 5 "Reserved5" 6 "Reserved6" 7 "Reserved7" ;
VAL_ 69 VFC_Obj15_LightStatBrakeLight 0 "Unknown" 1 "No light detected" 2 "One light detected" 3 "Two lights detected" 4 "Three lights detected" 5 "Reserved5" 6 "Reserved6" 7 "Reserved7" ;
VAL_ 69 VFC_Obj15_OutsideRoadMeasStatus 0 "Invalid" 1 "Measured" 2 "Predicted" 3 "Reserved3" ;
VAL_ 69 VFC_Obj15_OncomingMeasStatus 0 "Invalid" 1 "Measured" 2 "Predicted" 3 "Reserved3" ;
VAL_ 69 VFC_Obj15_MovementStandingMeasSt 0 "Invalid" 1 "Measured" 2 "Predicted" 3 "Reserved3" ;
VAL_ 69 VFC_Obj15_MovementObservedMeasSt 0 "Invalid" 1 "Valid" ;
VAL_ 69 VFC_Obj15_TargetObjTypeAcc 0 "No_target_object" 1 "Ego_0" 2 "Ego_1" 3 "Left_0" 4 "Left_1" 5 "Right_0" 6 "Right_1" 7 "Reserved7" ;
VAL_ 70 VFC_Obj16_MeasurementStatus 0 "Invalid" 1 "Measured" 2 "Predicted" 3 "Reserved3" ;
VAL_ 70 VFC_Obj16_ObjId 0 "INVALID" ;
VAL_ 70 VFC_Obj16_Type 0 "NOTYPE" 1 "CAR" 2 "RESERVED02" 3 "TRUCK" 4 "RESERVED04" 5 "RESERVED05" 6 "MOTORCYCLIST" 7 "PEDESTRIAN" 8 "CYCLIST" 9 "BOLLARD" 10 "ROADPOST" 11 "ARROWPOST" 12 "RESERVED12" 13 "RESERVED13" 14 "RESERVED14" 15 "RESERVED15" ;
VAL_ 70 VFC_Obj16_VisibleView 0 "UNKNOWN" 1 "CLASSIC" 2 "SIDE" 3 "CLASSIC_LSHAPE" 4 "SIDE_LSHAPE" 5 "Reserved5" 6 "Reserved6" 7 "Reserved7" ;
VAL_ 70 VFC_Obj16_ClassifiedView 0 "Unknown" 1 "Front" 2 "Rear" 3 "Left" 4 "Right" 5 "Reserved5" 6 "Reserved6" 7 "Reserved7" ;
VAL_ 70 VFC_Obj16_LightStatTurnIndicator 0 "Unknown" 1 "No direction indicator" 2 "Left indicator" 3 "Right indicator" 4 "Warning Lights" 5 "Reserved5" 6 "Reserved6" 7 "Reserved7" ;
VAL_ 70 VFC_Obj16_LightStatBrakeLight 0 "Unknown" 1 "No light detected" 2 "One light detected" 3 "Two lights detected" 4 "Three lights detected" 5 "Reserved5" 6 "Reserved6" 7 "Reserved7" ;
VAL_ 70 VFC_Obj16_OutsideRoadMeasStatus 0 "Invalid" 1 "Measured" 2 "Predicted" 3 "Reserved3" ;
VAL_ 70 VFC_Obj16_OncomingMeasStatus 0 "Invalid" 1 "Measured" 2 "Predicted" 3 "Reserved3" ;
VAL_ 70 VFC_Obj16_MovementStandingMeasSt 0 "Invalid" 1 "Measured" 2 "Predicted" 3 "Reserved3" ;
VAL_ 70 VFC_Obj16_MovementObservedMeasSt 0 "Invalid" 1 "Valid" ;
VAL_ 70 VFC_Obj16_TargetObjTypeAcc 0 "No_target_object" 1 "Ego_0" 2 "Ego_1" 3 "Left_0" 4 "Left_1" 5 "Right_0" 6 "Right_1" 7 "Reserved7" ;
VAL_ 71 VFC_Obj17_MeasurementStatus 0 "Invalid" 1 "Measured" 2 "Predicted" 3 "Reserved3" ;
VAL_ 71 VFC_Obj17_ObjId 0 "INVALID" ;
VAL_ 71 VFC_Obj17_Type 0 "NOTYPE" 1 "CAR" 2 "RESERVED02" 3 "TRUCK" 4 "RESERVED04" 5 "RESERVED05" 6 "MOTORCYCLIST" 7 "PEDESTRIAN" 8 "CYCLIST" 9 "BOLLARD" 10 "ROADPOST" 11 "ARROWPOST" 12 "RESERVED12" 13 "RESERVED13" 14 "RESERVED14" 15 "RESERVED15" ;
VAL_ 71 VFC_Obj17_VisibleView 0 "UNKNOWN" 1 "CLASSIC" 2 "SIDE" 3 "CLASSIC_LSHAPE" 4 "SIDE_LSHAPE" 5 "Reserved5" 6 "Reserved6" 7 "Reserved7" ;
VAL_ 71 VFC_Obj17_ClassifiedView 0 "Unknown" 1 "Front" 2 "Rear" 3 "Left" 4 "Right" 5 "Reserved5" 6 "Reserved6" 7 "Reserved7" ;
VAL_ 71 VFC_Obj17_LightStatTurnIndicator 0 "Unknown" 1 "No direction indicator" 2 "Left indicator" 3 "Right indicator" 4 "Warning Lights" 5 "Reserved5" 6 "Reserved6" 7 "Reserved7" ;
VAL_ 71 VFC_Obj17_LightStatBrakeLight 0 "Unknown" 1 "No light detected" 2 "One light detected" 3 "Two lights detected" 4 "Three lights detected" 5 "Reserved5" 6 "Reserved6" 7 "Reserved7" ;
VAL_ 71 VFC_Obj17_OutsideRoadMeasStatus 0 "Invalid" 1 "Measured" 2 "Predicted" 3 "Reserved3" ;
VAL_ 71 VFC_Obj17_OncomingMeasStatus 0 "Invalid" 1 "Measured" 2 "Predicted" 3 "Reserved3" ;
VAL_ 71 VFC_Obj17_MovementStandingMeasSt 0 "Invalid" 1 "Measured" 2 "Predicted" 3 "Reserved3" ;
VAL_ 71 VFC_Obj17_MovementObservedMeasSt 0 "Invalid" 1 "Valid" ;
VAL_ 71 VFC_Obj17_TargetObjTypeAcc 0 "No_target_object" 1 "Ego_0" 2 "Ego_1" 3 "Left_0" 4 "Left_1" 5 "Right_0" 6 "Right_1" 7 "Reserved7" ;
VAL_ 72 VFC_Obj18_MeasurementStatus 0 "Invalid" 1 "Measured" 2 "Predicted" 3 "Reserved3" ;
VAL_ 72 VFC_Obj18_ObjId 0 "INVALID" ;
VAL_ 72 VFC_Obj18_Type 0 "NOTYPE" 1 "CAR" 2 "RESERVED02" 3 "TRUCK" 4 "RESERVED04" 5 "RESERVED05" 6 "MOTORCYCLIST" 7 "PEDESTRIAN" 8 "CYCLIST" 9 "BOLLARD" 10 "ROADPOST" 11 "ARROWPOST" 12 "RESERVED12" 13 "RESERVED13" 14 "RESERVED14" 15 "RESERVED15" ;
VAL_ 72 VFC_Obj18_VisibleView 0 "UNKNOWN" 1 "CLASSIC" 2 "SIDE" 3 "CLASSIC_LSHAPE" 4 "SIDE_LSHAPE" 5 "Reserved5" 6 "Reserved6" 7 "Reserved7" ;
VAL_ 72 VFC_Obj18_ClassifiedView 0 "Unknown" 1 "Front" 2 "Rear" 3 "Left" 4 "Right" 5 "Reserved5" 6 "Reserved6" 7 "Reserved7" ;
VAL_ 72 VFC_Obj18_LightStatTurnIndicator 0 "Unknown" 1 "No direction indicator" 2 "Left indicator" 3 "Right indicator" 4 "Warning Lights" 5 "Reserved5" 6 "Reserved6" 7 "Reserved7" ;
VAL_ 72 VFC_Obj18_LightStatBrakeLight 0 "Unknown" 1 "No light detected" 2 "One light detected" 3 "Two lights detected" 4 "Three lights detected" 5 "Reserved5" 6 "Reserved6" 7 "Reserved7" ;
VAL_ 72 VFC_Obj18_OutsideRoadMeasStatus 0 "Invalid" 1 "Measured" 2 "Predicted" 3 "Reserved3" ;
VAL_ 72 VFC_Obj18_OncomingMeasStatus 0 "Invalid" 1 "Measured" 2 "Predicted" 3 "Reserved3" ;
VAL_ 72 VFC_Obj18_MovementStandingMeasSt 0 "Invalid" 1 "Measured" 2 "Predicted" 3 "Reserved3" ;
VAL_ 72 VFC_Obj18_MovementObservedMeasSt 0 "Invalid" 1 "Valid" ;
VAL_ 72 VFC_Obj18_TargetObjTypeAcc 0 "No_target_object" 1 "Ego_0" 2 "Ego_1" 3 "Left_0" 4 "Left_1" 5 "Right_0" 6 "Right_1" 7 "Reserved7" ;
VAL_ 73 VFC_Obj19_MeasurementStatus 0 "Invalid" 1 "Measured" 2 "Predicted" 3 "Reserved3" ;
VAL_ 73 VFC_Obj19_ObjId 0 "INVALID" ;
VAL_ 73 VFC_Obj19_Type 0 "NOTYPE" 1 "CAR" 2 "RESERVED02" 3 "TRUCK" 4 "RESERVED04" 5 "RESERVED05" 6 "MOTORCYCLIST" 7 "PEDESTRIAN" 8 "CYCLIST" 9 "BOLLARD" 10 "ROADPOST" 11 "ARROWPOST" 12 "RESERVED12" 13 "RESERVED13" 14 "RESERVED14" 15 "RESERVED15" ;
VAL_ 73 VFC_Obj19_VisibleView 0 "UNKNOWN" 1 "CLASSIC" 2 "SIDE" 3 "CLASSIC_LSHAPE" 4 "SIDE_LSHAPE" 5 "Reserved5" 6 "Reserved6" 7 "Reserved7" ;
VAL_ 73 VFC_Obj19_ClassifiedView 0 "Unknown" 1 "Front" 2 "Rear" 3 "Left" 4 "Right" 5 "Reserved5" 6 "Reserved6" 7 "Reserved7" ;
VAL_ 73 VFC_Obj19_LightStatTurnIndicator 0 "Unknown" 1 "No direction indicator" 2 "Left indicator" 3 "Right indicator" 4 "Warning Lights" 5 "Reserved5" 6 "Reserved6" 7 "Reserved7" ;
VAL_ 73 VFC_Obj19_LightStatBrakeLight 0 "Unknown" 1 "No light detected" 2 "One light detected" 3 "Two lights detected" 4 "Three lights detected" 5 "Reserved5" 6 "Reserved6" 7 "Reserved7" ;
VAL_ 73 VFC_Obj19_OutsideRoadMeasStatus 0 "Invalid" 1 "Measured" 2 "Predicted" 3 "Reserved3" ;
VAL_ 73 VFC_Obj19_OncomingMeasStatus 0 "Invalid" 1 "Measured" 2 "Predicted" 3 "Reserved3" ;
VAL_ 73 VFC_Obj19_MovementStandingMeasSt 0 "Invalid" 1 "Measured" 2 "Predicted" 3 "Reserved3" ;
VAL_ 73 VFC_Obj19_MovementObservedMeasSt 0 "Invalid" 1 "Valid" ;
VAL_ 73 VFC_Obj19_TargetObjTypeAcc 0 "No_target_object" 1 "Ego_0" 2 "Ego_1" 3 "Left_0" 4 "Left_1" 5 "Right_0" 6 "Right_1" 7 "Reserved7" ;
VAL_ 74 VFC_Obj20_MeasurementStatus 0 "Invalid" 1 "Measured" 2 "Predicted" 3 "Reserved3" ;
VAL_ 74 VFC_Obj20_ObjId 0 "INVALID" ;
VAL_ 74 VFC_Obj20_Type 0 "NOTYPE" 1 "CAR" 2 "RESERVED02" 3 "TRUCK" 4 "RESERVED04" 5 "RESERVED05" 6 "MOTORCYCLIST" 7 "PEDESTRIAN" 8 "CYCLIST" 9 "BOLLARD" 10 "ROADPOST" 11 "ARROWPOST" 12 "RESERVED12" 13 "RESERVED13" 14 "RESERVED14" 15 "RESERVED15" ;
VAL_ 74 VFC_Obj20_VisibleView 0 "UNKNOWN" 1 "CLASSIC" 2 "SIDE" 3 "CLASSIC_LSHAPE" 4 "SIDE_LSHAPE" 5 "Reserved5" 6 "Reserved6" 7 "Reserved7" ;
VAL_ 74 VFC_Obj20_ClassifiedView 0 "Unknown" 1 "Front" 2 "Rear" 3 "Left" 4 "Right" 5 "Reserved5" 6 "Reserved6" 7 "Reserved7" ;
VAL_ 74 VFC_Obj20_LightStatTurnIndicator 0 "Unknown" 1 "No direction indicator" 2 "Left indicator" 3 "Right indicator" 4 "Warning Lights" 5 "Reserved5" 6 "Reserved6" 7 "Reserved7" ;
VAL_ 74 VFC_Obj20_LightStatBrakeLight 0 "Unknown" 1 "No light detected" 2 "One light detected" 3 "Two lights detected" 4 "Three lights detected" 5 "Reserved5" 6 "Reserved6" 7 "Reserved7" ;
VAL_ 74 VFC_Obj20_OutsideRoadMeasStatus 0 "Invalid" 1 "Measured" 2 "Predicted" 3 "Reserved3" ;
VAL_ 74 VFC_Obj20_OncomingMeasStatus 0 "Invalid" 1 "Measured" 2 "Predicted" 3 "Reserved3" ;
VAL_ 74 VFC_Obj20_MovementStandingMeasSt 0 "Invalid" 1 "Measured" 2 "Predicted" 3 "Reserved3" ;
VAL_ 74 VFC_Obj20_MovementObservedMeasSt 0 "Invalid" 1 "Valid" ;
VAL_ 74 VFC_Obj20_TargetObjTypeAcc 0 "No_target_object" 1 "Ego_0" 2 "Ego_1" 3 "Left_0" 4 "Left_1" 5 "Right_0" 6 "Right_1" 7 "Reserved7" ;
SIG_GROUP_ 64 SG_VFC_Object10 1 : VFC_Obj10_CRC VFC_Obj10_AliveCtr VFC_Obj10_ProtBlockCtr VFC_Obj10_ExistProb VFC_Obj10_MeasurementStatus VFC_Obj10_ObjId VFC_Obj10_Type VFC_Obj10_TypeConf VFC_Obj10_VisibleView VFC_Obj10_ClassifiedView VFC_Obj10_Px VFC_Obj10_Py VFC_Obj10_PxStdDev VFC_Obj10_PyStdDev VFC_Obj10_OrientationYaw VFC_Obj10_OrientationYawStdDev VFC_Obj10_Length VFC_Obj10_Width VFC_Obj10_Height VFC_Obj10_LengthStdDev VFC_Obj10_WidthStdDev VFC_Obj10_HeightStdDev VFC_Obj10_Vx VFC_Obj10_Vy VFC_Obj10_VxStdDev VFC_Obj10_VyStdDev VFC_Obj10_Ax VFC_Obj10_LightStatTurnIndicator VFC_Obj10_Ay VFC_Obj10_AxStdDev VFC_Obj10_AyStdDev VFC_Obj10_MovementProbLat VFC_Obj10_MovementProbLong VFC_Obj10_2DAngPosEdgeLeft VFC_Obj10_2DAngPosEdgeRight VFC_Obj10_2DAngPosEdgeFar VFC_Obj10_2DAngPosEdgeBot VFC_Obj10_OutsideRoad VFC_Obj10_2DAngPosEdgeLeftStdDev VFC_Obj10_2DAngPosEdgeRightStdDe VFC_Obj10_2DAngPosEdgeFarStdDev VFC_Obj10_2DAngPosEdgeBotStdDev VFC_Obj10_2DNormVx VFC_Obj10_2DNormVy VFC_Obj10_2DNormAx VFC_Obj10_2DNormVxStdDev VFC_Obj10_MeasurementSource VFC_Obj10_2DNormVyStdDev VFC_Obj10_2DNormAxStdDev VFC_Obj10_2DScaleChange VFC_Obj10_2DScaleChangeStdDev VFC_Obj10_Reliability VFC_Obj10_LightStatBrakeLight VFC_Obj10_OutsideRoadMeasStatus VFC_Obj10_Oncoming VFC_Obj10_OncomingMeasStatus VFC_Obj10_MovementStanding VFC_Obj10_MovementStandingMeasSt VFC_Obj10_MovementObserved VFC_Obj10_MovementObservedMeasSt VFC_Obj10_TargetObjTypeAcc VFC_Obj10_TargetObjTypeAccConf;
SIG_GROUP_ 65 SG_VFC_Object11 1 : VFC_Obj11_CRC VFC_Obj11_AliveCtr VFC_Obj11_ProtBlockCtr VFC_Obj11_ExistProb VFC_Obj11_MeasurementStatus VFC_Obj11_ObjId VFC_Obj11_Type VFC_Obj11_TypeConf VFC_Obj11_VisibleView VFC_Obj11_ClassifiedView VFC_Obj11_Px VFC_Obj11_Py VFC_Obj11_PxStdDev VFC_Obj11_PyStdDev VFC_Obj11_OrientationYaw VFC_Obj11_OrientationYawStdDev VFC_Obj11_Length VFC_Obj11_Width VFC_Obj11_Height VFC_Obj11_LengthStdDev VFC_Obj11_WidthStdDev VFC_Obj11_HeightStdDev VFC_Obj11_Vx VFC_Obj11_Vy VFC_Obj11_VxStdDev VFC_Obj11_VyStdDev VFC_Obj11_Ax VFC_Obj11_LightStatTurnIndicator VFC_Obj11_Ay VFC_Obj11_AxStdDev VFC_Obj11_AyStdDev VFC_Obj11_MovementProbLat VFC_Obj11_MovementProbLong VFC_Obj11_2DAngPosEdgeLeft VFC_Obj11_2DAngPosEdgeRight VFC_Obj11_2DAngPosEdgeFar VFC_Obj11_2DAngPosEdgeBot VFC_Obj11_OutsideRoad VFC_Obj11_2DAngPosEdgeLeftStdDev VFC_Obj11_2DAngPosEdgeRightStdDe VFC_Obj11_2DAngPosEdgeFarStdDev VFC_Obj11_2DAngPosEdgeBotStdDev VFC_Obj11_2DNormVx VFC_Obj11_2DNormVy VFC_Obj11_2DNormAx VFC_Obj11_2DNormVxStdDev VFC_Obj11_MeasurementSource VFC_Obj11_2DNormVyStdDev VFC_Obj11_2DNormAxStdDev VFC_Obj11_2DScaleChange VFC_Obj11_2DScaleChangeStdDev VFC_Obj11_Reliability VFC_Obj11_LightStatBrakeLight VFC_Obj11_OutsideRoadMeasStatus VFC_Obj11_Oncoming VFC_Obj11_OncomingMeasStatus VFC_Obj11_MovementStanding VFC_Obj11_MovementStandingMeasSt VFC_Obj11_MovementObserved VFC_Obj11_MovementObservedMeasSt VFC_Obj11_TargetObjTypeAcc VFC_Obj11_TargetObjTypeAccConf;
SIG_GROUP_ 66 SG_VFC_Object12 1 : VFC_Obj12_CRC VFC_Obj12_AliveCtr VFC_Obj12_ProtBlockCtr VFC_Obj12_ExistProb VFC_Obj12_MeasurementStatus VFC_Obj12_ObjId VFC_Obj12_Type VFC_Obj12_TypeConf VFC_Obj12_VisibleView VFC_Obj12_ClassifiedView VFC_Obj12_Px VFC_Obj12_Py VFC_Obj12_PxStdDev VFC_Obj12_PyStdDev VFC_Obj12_OrientationYaw VFC_Obj12_OrientationYawStdDev VFC_Obj12_Length VFC_Obj12_Width VFC_Obj12_Height VFC_Obj12_LengthStdDev VFC_Obj12_WidthStdDev VFC_Obj12_HeightStdDev VFC_Obj12_Vx VFC_Obj12_Vy VFC_Obj12_VxStdDev VFC_Obj12_VyStdDev VFC_Obj12_Ax VFC_Obj12_LightStatTurnIndicator VFC_Obj12_Ay VFC_Obj12_AxStdDev VFC_Obj12_AyStdDev VFC_Obj12_MovementProbLat VFC_Obj12_MovementProbLong VFC_Obj12_2DAngPosEdgeLeft VFC_Obj12_2DAngPosEdgeRight VFC_Obj12_2DAngPosEdgeFar VFC_Obj12_2DAngPosEdgeBot VFC_Obj12_OutsideRoad VFC_Obj12_2DAngPosEdgeLeftStdDev VFC_Obj12_2DAngPosEdgeRightStdDe VFC_Obj12_2DAngPosEdgeFarStdDev VFC_Obj12_2DAngPosEdgeBotStdDev VFC_Obj12_2DNormVx VFC_Obj12_2DNormVy VFC_Obj12_2DNormAx VFC_Obj12_2DNormVxStdDev VFC_Obj12_MeasurementSource VFC_Obj12_2DNormVyStdDev VFC_Obj12_2DNormAxStdDev VFC_Obj12_2DScaleChange VFC_Obj12_2DScaleChangeStdDev VFC_Obj12_Reliability VFC_Obj12_LightStatBrakeLight VFC_Obj12_OutsideRoadMeasStatus VFC_Obj12_Oncoming VFC_Obj12_OncomingMeasStatus VFC_Obj12_MovementStanding VFC_Obj12_MovementStandingMeasSt VFC_Obj12_MovementObserved VFC_Obj12_MovementObservedMeasSt VFC_Obj12_TargetObjTypeAcc VFC_Obj12_TargetObjTypeAccConf;
SIG_GROUP_ 67 SG_VFC_Object13 1 : VFC_Obj13_CRC VFC_Obj13_AliveCtr VFC_Obj13_ProtBlockCtr VFC_Obj13_ExistProb VFC_Obj13_MeasurementStatus VFC_Obj13_ObjId VFC_Obj13_Type VFC_Obj13_TypeConf VFC_Obj13_VisibleView VFC_Obj13_ClassifiedView VFC_Obj13_Px VFC_Obj13_Py VFC_Obj13_PxStdDev VFC_Obj13_PyStdDev VFC_Obj13_OrientationYaw VFC_Obj13_OrientationYawStdDev VFC_Obj13_Length VFC_Obj13_Width VFC_Obj13_Height VFC_Obj13_LengthStdDev VFC_Obj13_WidthStdDev VFC_Obj13_HeightStdDev VFC_Obj13_Vx VFC_Obj13_Vy VFC_Obj13_VxStdDev VFC_Obj13_VyStdDev VFC_Obj13_Ax VFC_Obj13_LightStatTurnIndicator VFC_Obj13_Ay VFC_Obj13_AxStdDev VFC_Obj13_AyStdDev VFC_Obj13_MovementProbLat VFC_Obj13_MovementProbLong VFC_Obj13_2DAngPosEdgeLeft VFC_Obj13_2DAngPosEdgeRight VFC_Obj13_2DAngPosEdgeFar VFC_Obj13_2DAngPosEdgeBot VFC_Obj13_OutsideRoad VFC_Obj13_2DAngPosEdgeLeftStdDev VFC_Obj13_2DAngPosEdgeRightStdDe VFC_Obj13_2DAngPosEdgeFarStdDev VFC_Obj13_2DAngPosEdgeBotStdDev VFC_Obj13_2DNormVx VFC_Obj13_2DNormVy VFC_Obj13_2DNormAx VFC_Obj13_2DNormVxStdDev VFC_Obj13_MeasurementSource VFC_Obj13_2DNormVyStdDev VFC_Obj13_2DNormAxStdDev VFC_Obj13_2DScaleChange VFC_Obj13_2DScaleChangeStdDev VFC_Obj13_Reliability VFC_Obj13_LightStatBrakeLight VFC_Obj13_OutsideRoadMeasStatus VFC_Obj13_Oncoming VFC_Obj13_OncomingMeasStatus VFC_Obj13_MovementStanding VFC_Obj13_MovementStandingMeasSt VFC_Obj13_MovementObserved VFC_Obj13_MovementObservedMeasSt VFC_Obj13_TargetObjTypeAcc VFC_Obj13_TargetObjTypeAccConf;
SIG_GROUP_ 68 SG_VFC_Object14 1 : VFC_Obj14_CRC VFC_Obj14_AliveCtr VFC_Obj14_ProtBlockCtr VFC_Obj14_ExistProb VFC_Obj14_MeasurementStatus VFC_Obj14_ObjId VFC_Obj14_Type VFC_Obj14_TypeConf VFC_Obj14_VisibleView VFC_Obj14_ClassifiedView VFC_Obj14_Px VFC_Obj14_Py VFC_Obj14_PxStdDev VFC_Obj14_PyStdDev VFC_Obj14_OrientationYaw VFC_Obj14_OrientationYawStdDev VFC_Obj14_Length VFC_Obj14_Width VFC_Obj14_Height VFC_Obj14_LengthStdDev VFC_Obj14_WidthStdDev VFC_Obj14_HeightStdDev VFC_Obj14_Vx VFC_Obj14_Vy VFC_Obj14_VxStdDev VFC_Obj14_VyStdDev VFC_Obj14_Ax VFC_Obj14_LightStatTurnIndicator VFC_Obj14_Ay VFC_Obj14_AxStdDev VFC_Obj14_AyStdDev VFC_Obj14_MovementProbLat VFC_Obj14_MovementProbLong VFC_Obj14_2DAngPosEdgeLeft VFC_Obj14_2DAngPosEdgeRight VFC_Obj14_2DAngPosEdgeFar VFC_Obj14_2DAngPosEdgeBot VFC_Obj14_OutsideRoad VFC_Obj14_2DAngPosEdgeLeftStdDev VFC_Obj14_2DAngPosEdgeRightStdDe VFC_Obj14_2DAngPosEdgeFarStdDev VFC_Obj14_2DAngPosEdgeBotStdDev VFC_Obj14_2DNormVx VFC_Obj14_2DNormVy VFC_Obj14_2DNormAx VFC_Obj14_2DNormVxStdDev VFC_Obj14_MeasurementSource VFC_Obj14_2DNormVyStdDev VFC_Obj14_2DNormAxStdDev VFC_Obj14_2DScaleChange VFC_Obj14_2DScaleChangeStdDev VFC_Obj14_Reliability VFC_Obj14_LightStatBrakeLight VFC_Obj14_OutsideRoadMeasStatus VFC_Obj14_Oncoming VFC_Obj14_OncomingMeasStatus VFC_Obj14_MovementStanding VFC_Obj14_MovementStandingMeasSt VFC_Obj14_MovementObserved VFC_Obj14_MovementObservedMeasSt VFC_Obj14_TargetObjTypeAcc VFC_Obj14_TargetObjTypeAccConf;
SIG_GROUP_ 69 SG_VFC_Object15 1 : VFC_Obj15_CRC VFC_Obj15_AliveCtr VFC_Obj15_ProtBlockCtr VFC_Obj15_ExistProb VFC_Obj15_MeasurementStatus VFC_Obj15_ObjId VFC_Obj15_Type VFC_Obj15_TypeConf VFC_Obj15_VisibleView VFC_Obj15_ClassifiedView VFC_Obj15_Px VFC_Obj15_Py VFC_Obj15_PxStdDev VFC_Obj15_PyStdDev VFC_Obj15_OrientationYaw VFC_Obj15_OrientationYawStdDev VFC_Obj15_Length VFC_Obj15_Width VFC_Obj15_Height VFC_Obj15_LengthStdDev VFC_Obj15_WidthStdDev VFC_Obj15_HeightStdDev VFC_Obj15_Vx VFC_Obj15_Vy VFC_Obj15_VxStdDev VFC_Obj15_VyStdDev VFC_Obj15_Ax VFC_Obj15_LightStatTurnIndicator VFC_Obj15_Ay VFC_Obj15_AxStdDev VFC_Obj15_AyStdDev VFC_Obj15_MovementProbLat VFC_Obj15_MovementProbLong VFC_Obj15_2DAngPosEdgeLeft VFC_Obj15_2DAngPosEdgeRight VFC_Obj15_2DAngPosEdgeFar VFC_Obj15_2DAngPosEdgeBot VFC_Obj15_OutsideRoad VFC_Obj15_2DAngPosEdgeLeftStdDev VFC_Obj15_2DAngPosEdgeRightStdDe VFC_Obj15_2DAngPosEdgeFarStdDev VFC_Obj15_2DAngPosEdgeBotStdDev VFC_Obj15_2DNormVx VFC_Obj15_2DNormVy VFC_Obj15_2DNormAx VFC_Obj15_2DNormVxStdDev VFC_Obj15_MeasurementSource VFC_Obj15_2DNormVyStdDev VFC_Obj15_2DNormAxStdDev VFC_Obj15_2DScaleChange VFC_Obj15_2DScaleChangeStdDev VFC_Obj15_Reliability VFC_Obj15_LightStatBrakeLight VFC_Obj15_OutsideRoadMeasStatus VFC_Obj15_Oncoming VFC_Obj15_OncomingMeasStatus VFC_Obj15_MovementStanding VFC_Obj15_MovementStandingMeasSt VFC_Obj15_MovementObserved VFC_Obj15_MovementObservedMeasSt VFC_Obj15_TargetObjTypeAcc VFC_Obj15_TargetObjTypeAccConf;
SIG_GROUP_ 70 SG_VFC_Object16 1 : VFC_Obj16_CRC VFC_Obj16_AliveCtr VFC_Obj16_ProtBlockCtr VFC_Obj16_ExistProb VFC_Obj16_MeasurementStatus VFC_Obj16_ObjId VFC_Obj16_Type VFC_Obj16_TypeConf VFC_Obj16_VisibleView VFC_Obj16_ClassifiedView VFC_Obj16_Px VFC_Obj16_Py VFC_Obj16_PxStdDev VFC_Obj16_PyStdDev VFC_Obj16_OrientationYaw VFC_Obj16_OrientationYawStdDev VFC_Obj16_Length VFC_Obj16_Width VFC_Obj16_Height VFC_Obj16_LengthStdDev VFC_Obj16_WidthStdDev VFC_Obj16_HeightStdDev VFC_Obj16_Vx VFC_Obj16_Vy VFC_Obj16_VxStdDev VFC_Obj16_VyStdDev VFC_Obj16_Ax VFC_Obj16_LightStatTurnIndicator VFC_Obj16_Ay VFC_Obj16_AxStdDev VFC_Obj16_AyStdDev VFC_Obj16_MovementProbLat VFC_Obj16_MovementProbLong VFC_Obj16_2DAngPosEdgeLeft VFC_Obj16_2DAngPosEdgeRight VFC_Obj16_2DAngPosEdgeFar VFC_Obj16_2DAngPosEdgeBot VFC_Obj16_OutsideRoad VFC_Obj16_2DAngPosEdgeLeftStdDev VFC_Obj16_2DAngPosEdgeRightStdDe VFC_Obj16_2DAngPosEdgeFarStdDev VFC_Obj16_2DAngPosEdgeBotStdDev VFC_Obj16_2DNormVx VFC_Obj16_2DNormVy VFC_Obj16_2DNormAx VFC_Obj16_2DNormVxStdDev VFC_Obj16_MeasurementSource VFC_Obj16_2DNormVyStdDev VFC_Obj16_2DNormAxStdDev VFC_Obj16_2DScaleChange VFC_Obj16_2DScaleChangeStdDev VFC_Obj16_Reliability VFC_Obj16_LightStatBrakeLight VFC_Obj16_OutsideRoadMeasStatus VFC_Obj16_Oncoming VFC_Obj16_OncomingMeasStatus VFC_Obj16_MovementStanding VFC_Obj16_MovementStandingMeasSt VFC_Obj16_MovementObserved VFC_Obj16_MovementObservedMeasSt VFC_Obj16_TargetObjTypeAcc VFC_Obj16_TargetObjTypeAccConf;
SIG_GROUP_ 71 SG_VFC_Object17 1 : VFC_Obj17_CRC VFC_Obj17_AliveCtr VFC_Obj17_ProtBlockCtr VFC_Obj17_ExistProb VFC_Obj17_MeasurementStatus VFC_Obj17_ObjId VFC_Obj17_Type VFC_Obj17_TypeConf VFC_Obj17_VisibleView VFC_Obj17_ClassifiedView VFC_Obj17_Px VFC_Obj17_Py VFC_Obj17_PxStdDev VFC_Obj17_PyStdDev VFC_Obj17_OrientationYaw VFC_Obj17_OrientationYawStdDev VFC_Obj17_Length VFC_Obj17_Width VFC_Obj17_Height VFC_Obj17_LengthStdDev VFC_Obj17_WidthStdDev VFC_Obj17_HeightStdDev VFC_Obj17_Vx VFC_Obj17_Vy VFC_Obj17_VxStdDev VFC_Obj17_VyStdDev VFC_Obj17_Ax VFC_Obj17_LightStatTurnIndicator VFC_Obj17_Ay VFC_Obj17_AxStdDev VFC_Obj17_AyStdDev VFC_Obj17_MovementProbLat VFC_Obj17_MovementProbLong VFC_Obj17_2DAngPosEdgeLeft VFC_Obj17_2DAngPosEdgeRight VFC_Obj17_2DAngPosEdgeFar VFC_Obj17_2DAngPosEdgeBot VFC_Obj17_OutsideRoad VFC_Obj17_2DAngPosEdgeLeftStdDev VFC_Obj17_2DAngPosEdgeRightStdDe VFC_Obj17_2DAngPosEdgeFarStdDev VFC_Obj17_2DAngPosEdgeBotStdDev VFC_Obj17_2DNormVx VFC_Obj17_2DNormVy VFC_Obj17_2DNormAx VFC_Obj17_2DNormVxStdDev VFC_Obj17_MeasurementSource VFC_Obj17_2DNormVyStdDev VFC_Obj17_2DNormAxStdDev VFC_Obj17_2DScaleChange VFC_Obj17_2DScaleChangeStdDev VFC_Obj17_Reliability VFC_Obj17_LightStatBrakeLight VFC_Obj17_OutsideRoadMeasStatus VFC_Obj17_Oncoming VFC_Obj17_OncomingMeasStatus VFC_Obj17_MovementStanding VFC_Obj17_MovementStandingMeasSt VFC_Obj17_MovementObserved VFC_Obj17_MovementObservedMeasSt VFC_Obj17_TargetObjTypeAcc VFC_Obj17_TargetObjTypeAccConf;
SIG_GROUP_ 72 SG_VFC_Object18 1 : VFC_Obj18_CRC VFC_Obj18_AliveCtr VFC_Obj18_ProtBlockCtr VFC_Obj18_ExistProb VFC_Obj18_MeasurementStatus VFC_Obj18_ObjId VFC_Obj18_Type VFC_Obj18_TypeConf VFC_Obj18_VisibleView VFC_Obj18_ClassifiedView VFC_Obj18_Px VFC_Obj18_Py VFC_Obj18_PxStdDev VFC_Obj18_PyStdDev VFC_Obj18_OrientationYaw VFC_Obj18_OrientationYawStdDev VFC_Obj18_Length VFC_Obj18_Width VFC_Obj18_Height VFC_Obj18_LengthStdDev VFC_Obj18_WidthStdDev VFC_Obj18_HeightStdDev VFC_Obj18_Vx VFC_Obj18_Vy VFC_Obj18_VxStdDev VFC_Obj18_VyStdDev VFC_Obj18_Ax VFC_Obj18_LightStatTurnIndicator VFC_Obj18_Ay VFC_Obj18_AxStdDev VFC_Obj18_AyStdDev VFC_Obj18_MovementProbLat VFC_Obj18_MovementProbLong VFC_Obj18_2DAngPosEdgeLeft VFC_Obj18_2DAngPosEdgeRight VFC_Obj18_2DAngPosEdgeFar VFC_Obj18_2DAngPosEdgeBot VFC_Obj18_OutsideRoad VFC_Obj18_2DAngPosEdgeLeftStdDev VFC_Obj18_2DAngPosEdgeRightStdDe VFC_Obj18_2DAngPosEdgeFarStdDev VFC_Obj18_2DAngPosEdgeBotStdDev VFC_Obj18_2DNormVx VFC_Obj18_2DNormVy VFC_Obj18_2DNormAx VFC_Obj18_2DNormVxStdDev VFC_Obj18_MeasurementSource VFC_Obj18_2DNormVyStdDev VFC_Obj18_2DNormAxStdDev VFC_Obj18_2DScaleChange VFC_Obj18_2DScaleChangeStdDev VFC_Obj18_Reliability VFC_Obj18_LightStatBrakeLight VFC_Obj18_OutsideRoadMeasStatus VFC_Obj18_Oncoming VFC_Obj18_OncomingMeasStatus VFC_Obj18_MovementStanding VFC_Obj18_MovementStandingMeasSt VFC_Obj18_MovementObserved VFC_Obj18_MovementObservedMeasSt VFC_Obj18_TargetObjTypeAcc VFC_Obj18_TargetObjTypeAccConf;
SIG_GROUP_ 73 SG_VFC_Object19 1 : VFC_Obj19_CRC VFC_Obj19_AliveCtr VFC_Obj19_ProtBlockCtr VFC_Obj19_ExistProb VFC_Obj19_MeasurementStatus VFC_Obj19_ObjId VFC_Obj19_Type VFC_Obj19_TypeConf VFC_Obj19_VisibleView VFC_Obj19_ClassifiedView VFC_Obj19_Px VFC_Obj19_Py VFC_Obj19_PxStdDev VFC_Obj19_PyStdDev VFC_Obj19_OrientationYaw VFC_Obj19_OrientationYawStdDev VFC_Obj19_Length VFC_Obj19_Width VFC_Obj19_Height VFC_Obj19_LengthStdDev VFC_Obj19_WidthStdDev VFC_Obj19_HeightStdDev VFC_Obj19_Vx VFC_Obj19_Vy VFC_Obj19_VxStdDev VFC_Obj19_VyStdDev VFC_Obj19_Ax VFC_Obj19_LightStatTurnIndicator VFC_Obj19_Ay VFC_Obj19_AxStdDev VFC_Obj19_AyStdDev VFC_Obj19_MovementProbLat VFC_Obj19_MovementProbLong VFC_Obj19_2DAngPosEdgeLeft VFC_Obj19_2DAngPosEdgeRight VFC_Obj19_2DAngPosEdgeFar VFC_Obj19_2DAngPosEdgeBot VFC_Obj19_OutsideRoad VFC_Obj19_2DAngPosEdgeLeftStdDev VFC_Obj19_2DAngPosEdgeRightStdDe VFC_Obj19_2DAngPosEdgeFarStdDev VFC_Obj19_2DAngPosEdgeBotStdDev VFC_Obj19_2DNormVx VFC_Obj19_2DNormVy VFC_Obj19_2DNormAx VFC_Obj19_2DNormVxStdDev VFC_Obj19_MeasurementSource VFC_Obj19_2DNormVyStdDev VFC_Obj19_2DNormAxStdDev VFC_Obj19_2DScaleChange VFC_Obj19_2DScaleChangeStdDev VFC_Obj19_Reliability VFC_Obj19_LightStatBrakeLight VFC_Obj19_OutsideRoadMeasStatus VFC_Obj19_Oncoming VFC_Obj19_OncomingMeasStatus VFC_Obj19_MovementStanding VFC_Obj19_MovementStandingMeasSt VFC_Obj19_MovementObserved VFC_Obj19_MovementObservedMeasSt VFC_Obj19_TargetObjTypeAcc VFC_Obj19_TargetObjTypeAccConf;
SIG_GROUP_ 74 SG_VFC_Object20 1 : VFC_Obj20_CRC VFC_Obj20_AliveCtr VFC_Obj20_ProtBlockCtr VFC_Obj20_ExistProb VFC_Obj20_MeasurementStatus VFC_Obj20_ObjId VFC_Obj20_Type VFC_Obj20_TypeConf VFC_Obj20_VisibleView VFC_Obj20_ClassifiedView VFC_Obj20_Px VFC_Obj20_Py VFC_Obj20_PxStdDev VFC_Obj20_PyStdDev VFC_Obj20_OrientationYaw VFC_Obj20_OrientationYawStdDev VFC_Obj20_Length VFC_Obj20_Width VFC_Obj20_Height VFC_Obj20_LengthStdDev VFC_Obj20_WidthStdDev VFC_Obj20_HeightStdDev VFC_Obj20_Vx VFC_Obj20_Vy VFC_Obj20_VxStdDev VFC_Obj20_VyStdDev VFC_Obj20_Ax VFC_Obj20_LightStatTurnIndicator VFC_Obj20_Ay VFC_Obj20_AxStdDev VFC_Obj20_AyStdDev VFC_Obj20_MovementProbLat VFC_Obj20_MovementProbLong VFC_Obj20_2DAngPosEdgeLeft VFC_Obj20_2DAngPosEdgeRight VFC_Obj20_2DAngPosEdgeFar VFC_Obj20_2DAngPosEdgeBot VFC_Obj20_OutsideRoad VFC_Obj20_2DAngPosEdgeLeftStdDev VFC_Obj20_2DAngPosEdgeRightStdDe VFC_Obj20_2DAngPosEdgeFarStdDev VFC_Obj20_2DAngPosEdgeBotStdDev VFC_Obj20_2DNormVx VFC_Obj20_2DNormVy VFC_Obj20_2DNormAx VFC_Obj20_2DNormVxStdDev VFC_Obj20_MeasurementSource VFC_Obj20_2DNormVyStdDev VFC_Obj20_2DNormAxStdDev VFC_Obj20_2DScaleChange VFC_Obj20_2DScaleChangeStdDev VFC_Obj20_Reliability VFC_Obj20_LightStatBrakeLight VFC_Obj20_OutsideRoadMeasStatus VFC_Obj20_Oncoming VFC_Obj20_OncomingMeasStatus VFC_Obj20_MovementStanding VFC_Obj20_MovementStandingMeasSt VFC_Obj20_MovementObserved VFC_Obj20_MovementObservedMeasSt VFC_Obj20_TargetObjTypeAcc VFC_Obj20_TargetObjTypeAccConf;
