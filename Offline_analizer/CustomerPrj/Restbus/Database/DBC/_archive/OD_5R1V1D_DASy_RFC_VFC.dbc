VERSION "created by canmatrix"

NS_ :

BS_:

BU_: RadarFrontCenter VideoFrontCenter DASy ReceiveECU

BO_ 178 VFC_RoadMarking_00_06: 64 VideoFrontCenter
 SG_ VFC_RM_00_06_CRC : 0|16@1+ (1,0) [0|65535] ""  DASy
 SG_ VFC_RM_00_06_AliveCtr : 16|8@1+ (1,0) [0|255] ""  DASy
 SG_ VFC_RM_00_06_ProtBlockCtr : 24|4@1+ (1,0) [0|15] ""  DASy
 SG_ VFC_RM00_ExistProb : 32|6@1+ (2,0) [0|100] "%"  DASy
 SG_ VFC_RM00_Type : 38|5@1+ (1,0) [0|31] ""  DASy
 SG_ VFC_RM00_VertexPoint00x : 43|11@1+ (0.1,0) [0|204.7] "m"  DASy
 SG_ VFC_RM00_VertexPoint00y : 54|9@1+ (0.1,-25.6) [-25.6|25.5] "m"  DASy
 SG_ VFC_RM00_VertexPoint01x : 63|11@1+ (0.1,0) [0|204.7] "m"  DASy
 SG_ VFC_RM00_VertexPoint01y : 74|9@1+ (0.1,-25.6) [-25.6|25.5] "m"  DASy
 SG_ VFC_RM01_ExistProb : 96|6@1+ (2,0) [0|100] "%"  DASy
 SG_ VFC_RM01_Type : 102|5@1+ (1,0) [0|31] ""  DASy
 SG_ VFC_RM01_VertexPoint00x : 107|11@1+ (0.1,0) [0|204.7] "m"  DASy
 SG_ VFC_RM01_VertexPoint00y : 118|9@1+ (0.1,-25.6) [-25.6|25.5] "m"  DASy
 SG_ VFC_RM01_VertexPoint01x : 127|11@1+ (0.1,0) [0|204.7] "m"  DASy
 SG_ VFC_RM01_VertexPoint01y : 138|9@1+ (0.1,-25.6) [-25.6|25.5] "m"  DASy
 SG_ VFC_RM02_ExistProb : 160|6@1+ (2,0) [0|100] "%"  DASy
 SG_ VFC_RM02_Type : 166|5@1+ (1,0) [0|31] ""  DASy
 SG_ VFC_RM02_VertexPoint00x : 171|11@1+ (0.1,0) [0|204.7] "m"  DASy
 SG_ VFC_RM02_VertexPoint00y : 182|9@1+ (0.1,-25.6) [-25.6|25.5] "m"  DASy
 SG_ VFC_RM02_VertexPoint01x : 191|11@1+ (0.1,0) [0|204.7] "m"  DASy
 SG_ VFC_RM02_VertexPoint01y : 202|9@1+ (0.1,-25.6) [-25.6|25.5] "m"  DASy
 SG_ VFC_RM03_ExistProb : 224|6@1+ (2,0) [0|100] "%"  DASy
 SG_ VFC_RM03_Type : 230|5@1+ (1,0) [0|31] ""  DASy
 SG_ VFC_RM03_VertexPoint00x : 235|11@1+ (0.1,0) [0|204.7] "m"  DASy
 SG_ VFC_RM03_VertexPoint00y : 246|9@1+ (0.1,-25.6) [-25.6|25.5] "m"  DASy
 SG_ VFC_RM03_VertexPoint01x : 255|11@1+ (0.1,0) [0|204.7] "m"  DASy
 SG_ VFC_RM03_VertexPoint01y : 266|9@1+ (0.1,-25.6) [-25.6|25.5] "m"  DASy
 SG_ VFC_RM04_ExistProb : 288|6@1+ (2,0) [0|100] "%"  DASy
 SG_ VFC_RM04_Type : 294|5@1+ (1,0) [0|31] ""  DASy
 SG_ VFC_RM04_VertexPoint00x : 299|11@1+ (0.1,0) [0|204.7] "m"  DASy
 SG_ VFC_RM04_VertexPoint00y : 310|9@1+ (0.1,-25.6) [-25.6|25.5] "m"  DASy
 SG_ VFC_RM04_VertexPoint01x : 319|11@1+ (0.1,0) [0|204.7] "m"  DASy
 SG_ VFC_RM04_VertexPoint01y : 330|9@1+ (0.1,-25.6) [-25.6|25.5] "m"  DASy
 SG_ VFC_RM05_ExistProb : 352|6@1+ (2,0) [0|100] "%"  DASy
 SG_ VFC_RM05_Type : 358|5@1+ (1,0) [0|31] ""  DASy
 SG_ VFC_RM05_VertexPoint00x : 363|11@1+ (0.1,0) [0|204.7] "m"  DASy
 SG_ VFC_RM05_VertexPoint00y : 374|9@1+ (0.1,-25.6) [-25.6|25.5] "m"  DASy
 SG_ VFC_RM05_VertexPoint01x : 383|11@1+ (0.1,0) [0|204.7] "m"  DASy
 SG_ VFC_RM05_VertexPoint01y : 394|9@1+ (0.1,-25.6) [-25.6|25.5] "m"  DASy
 SG_ VFC_RM06_ExistProb : 416|6@1+ (2,0) [0|100] "%"  DASy
 SG_ VFC_RM06_Type : 422|5@1+ (1,0) [0|31] ""  DASy
 SG_ VFC_RM06_VertexPoint00x : 427|11@1+ (0.1,0) [0|204.7] "m"  DASy
 SG_ VFC_RM06_VertexPoint00y : 438|9@1+ (0.1,-25.6) [-25.6|25.5] "m"  DASy
 SG_ VFC_RM06_VertexPoint01x : 447|11@1+ (0.1,0) [0|204.7] "m"  DASy
 SG_ VFC_RM06_VertexPoint01y : 458|9@1+ (0.1,-25.6) [-25.6|25.5] "m"  DASy

BO_ 224 VFC_TrafficLightHdr: 20 VideoFrontCenter
 SG_ VFC_TLHdr_CRC : 0|16@1+ (1,0) [0|65535] ""  DASy
 SG_ VFC_TLHdr_AliveCtr : 16|8@1+ (1,0) [0|255] ""  DASy
 SG_ VFC_TLHdr_ProtBlockCtr : 24|4@1+ (1,0) [0|15] ""  DASy
 SG_ VFC_TLHdr_IfVersionIdMajor : 32|8@1+ (1,0) [0|255] ""  DASy
 SG_ VFC_TLHdr_IfVersionIdMinor : 40|8@1+ (1,0) [0|255] ""  DASy
 SG_ VFC_TLHdr_NumTrafficLights : 48|5@1+ (1,0) [0|31] ""  DASy
 SG_ VFC_TLHdr_TimeStampStatus : 56|8@1+ (1,0) [0|255] ""  DASy
 SG_ VFC_TLHdr_TimeStamp : 64|26@1+ (1,0) [0|67108863] "ms"  DASy
 SG_ VFC_TLHdr_State : 96|3@1+ (1,0) [0|7] ""  DASy
 SG_ VFC_TLHdr_MostRelevantTLId : 104|5@1+ (1,0) [0|31] ""  DASy
 SG_ VFC_TLHdr_Reserved0 : 112|8@1+ (1,0) [0|255] ""  DASy
 SG_ VFC_TLHdr_Reserved1 : 120|8@1+ (1,0) [0|255] ""  DASy

BO_ 226 VFC_TrafficLight_00_04: 64 VideoFrontCenter
 SG_ VFC_TL00_04_CRC : 0|16@1+ (1,0) [0|65535] ""  DASy
 SG_ VFC_TL00_04_AliveCtr : 16|8@1+ (1,0) [0|255] ""  DASy
 SG_ VFC_TL00_04_ProtBlockCtr : 24|4@1+ (1,0) [0|15] ""  DASy
 SG_ VFC_TL00_Colour : 32|2@1+ (1,0) [0|3] ""  DASy
 SG_ VFC_TL00_LightShapeType : 34|4@1+ (1,0) [0|15] ""  DASy
 SG_ VFC_TL00_LightModeType : 38|2@1+ (1,0) [0|3] ""  DASy
 SG_ VFC_TL00_Py : 40|10@1+ (0.1,-51.2) [-51.2|51.1] "m"  DASy
 SG_ VFC_TL00_ExistProb : 50|6@1+ (2,0) [0|100] "%"  DASy
 SG_ VFC_TL00_Pz : 56|8@1+ (0.1,0) [0|25.5] "m"  DASy
 SG_ VFC_TL00_2DWidth : 64|8@1+ (0.03,0) [0|7.65] "degree"  DASy
 SG_ VFC_TL00_2DHeight : 72|8@1+ (0.03,0) [0|7.65] "degree"  DASy
 SG_ VFC_TL00_2DLeftEdge : 80|12@1+ (0.03,-61.44) [-61.44|61.41] "degree"  DASy
 SG_ VFC_TL00_2DTopEdge : 92|11@1+ (0.03,-30.72) [-30.72|30.69] "degree"  DASy
 SG_ VFC_TL00_Px : 104|11@1+ (0.1,0) [0|204.7] "m"  DASy
 SG_ VFC_TL01_Colour : 120|2@1+ (1,0) [0|3] ""  DASy
 SG_ VFC_TL01_LightShapeType : 122|4@1+ (1,0) [0|15] ""  DASy
 SG_ VFC_TL01_LightModeType : 126|2@1+ (1,0) [0|3] ""  DASy
 SG_ VFC_TL01_Py : 128|10@1+ (0.1,-51.2) [-51.2|51.1] "m"  DASy
 SG_ VFC_TL01_ExistProb : 138|6@1+ (2,0) [0|100] "%"  DASy
 SG_ VFC_TL01_Pz : 144|8@1+ (0.1,0) [0|25.5] "m"  DASy
 SG_ VFC_TL01_2DWidth : 152|8@1+ (0.03,0) [0|7.65] "degree"  DASy
 SG_ VFC_TL01_2DHeight : 160|8@1+ (0.03,0) [0|7.65] "degree"  DASy
 SG_ VFC_TL01_2DLeftEdge : 168|12@1+ (0.03,-61.44) [-61.44|61.41] "degree"  DASy
 SG_ VFC_TL01_2DTopEdge : 180|11@1+ (0.03,-30.72) [-30.72|30.69] "degree"  DASy
 SG_ VFC_TL01_Px : 192|11@1+ (0.1,0) [0|204.7] "m"  DASy
 SG_ VFC_TL02_Colour : 208|2@1+ (1,0) [0|3] ""  DASy
 SG_ VFC_TL02_LightShapeType : 210|4@1+ (1,0) [0|15] ""  DASy
 SG_ VFC_TL02_LightModeType : 214|2@1+ (1,0) [0|3] ""  DASy
 SG_ VFC_TL02_Py : 216|10@1+ (0.1,-51.2) [-51.2|51.1] "m"  DASy
 SG_ VFC_TL02_ExistProb : 226|6@1+ (2,0) [0|100] "%"  DASy
 SG_ VFC_TL02_Pz : 232|8@1+ (0.1,0) [0|25.5] "m"  DASy
 SG_ VFC_TL02_2DWidth : 240|8@1+ (0.03,0) [0|7.65] "degree"  DASy
 SG_ VFC_TL02_2DHeight : 248|8@1+ (0.03,0) [0|7.65] "degree"  DASy
 SG_ VFC_TL02_2DLeftEdge : 256|12@1+ (0.03,-61.44) [-61.44|61.41] "degree"  DASy
 SG_ VFC_TL02_2DTopEdge : 268|11@1+ (0.03,-30.72) [-30.72|30.69] "degree"  DASy
 SG_ VFC_TL02_Px : 280|11@1+ (0.1,0) [0|204.7] "m"  DASy
 SG_ VFC_TL03_Colour : 296|2@1+ (1,0) [0|3] ""  DASy
 SG_ VFC_TL03_LightShapeType : 298|4@1+ (1,0) [0|15] ""  DASy
 SG_ VFC_TL03_LightModeType : 302|2@1+ (1,0) [0|3] ""  DASy
 SG_ VFC_TL03_Py : 304|10@1+ (0.1,-51.2) [-51.2|51.1] "m"  DASy
 SG_ VFC_TL03_ExistProb : 314|6@1+ (2,0) [0|100] "%"  DASy
 SG_ VFC_TL03_Pz : 320|8@1+ (0.1,0) [0|25.5] "m"  DASy
 SG_ VFC_TL03_2DWidth : 328|8@1+ (0.03,0) [0|7.65] "degree"  DASy
 SG_ VFC_TL03_2DHeight : 336|8@1+ (0.03,0) [0|7.65] "degree"  DASy
 SG_ VFC_TL03_2DLeftEdge : 344|12@1+ (0.03,-61.44) [-61.44|61.41] "degree"  DASy
 SG_ VFC_TL03_2DTopEdge : 356|11@1+ (0.03,-30.72) [-30.72|30.69] "degree"  DASy
 SG_ VFC_TL03_Px : 368|11@1+ (0.1,0) [0|204.7] "m"  DASy
 SG_ VFC_TL04_Colour : 384|2@1+ (1,0) [0|3] ""  DASy
 SG_ VFC_TL04_LightShapeType : 386|4@1+ (1,0) [0|15] ""  DASy
 SG_ VFC_TL04_LightModeType : 390|2@1+ (1,0) [0|3] ""  DASy
 SG_ VFC_TL04_Py : 392|10@1+ (0.1,-51.2) [-51.2|51.1] "m"  DASy
 SG_ VFC_TL04_ExistProb : 402|6@1+ (2,0) [0|100] "%"  DASy
 SG_ VFC_TL04_Pz : 408|8@1+ (0.1,0) [0|25.5] "m"  DASy
 SG_ VFC_TL04_2DWidth : 416|8@1+ (0.03,0) [0|7.65] "degree"  DASy
 SG_ VFC_TL04_2DHeight : 424|8@1+ (0.03,0) [0|7.65] "degree"  DASy
 SG_ VFC_TL04_2DLeftEdge : 432|12@1+ (0.03,-61.44) [-61.44|61.41] "degree"  DASy
 SG_ VFC_TL04_2DTopEdge : 444|11@1+ (0.03,-30.72) [-30.72|30.69] "degree"  DASy
 SG_ VFC_TL04_Px : 456|11@1+ (0.1,0) [0|204.7] "m"  DASy

BO_ 227 VFC_TrafficLight_05_09: 64 VideoFrontCenter
 SG_ VFC_TL05_09_CRC : 0|16@1+ (1,0) [0|65535] ""  DASy
 SG_ VFC_TL05_09_AliveCtr : 16|8@1+ (1,0) [0|255] ""  DASy
 SG_ VFC_TL05_09_ProtBlockCtr : 24|4@1+ (1,0) [0|15] ""  DASy
 SG_ VFC_TL05_Colour : 32|2@1+ (1,0) [0|3] ""  DASy
 SG_ VFC_TL05_LightShapeType : 34|4@1+ (1,0) [0|15] ""  DASy
 SG_ VFC_TL05_LightModeType : 38|2@1+ (1,0) [0|3] ""  DASy
 SG_ VFC_TL05_Py : 40|10@1+ (0.1,-51.2) [-51.2|51.1] "m"  DASy
 SG_ VFC_TL05_ExistProb : 50|6@1+ (2,0) [0|100] "%"  DASy
 SG_ VFC_TL05_Pz : 56|8@1+ (0.1,0) [0|25.5] "m"  DASy
 SG_ VFC_TL05_2DWidth : 64|8@1+ (0.03,0) [0|7.65] "degree"  DASy
 SG_ VFC_TL05_2DHeight : 72|8@1+ (0.03,0) [0|7.65] "degree"  DASy
 SG_ VFC_TL05_2DLeftEdge : 80|12@1+ (0.03,-61.44) [-61.44|61.41] "degree"  DASy
 SG_ VFC_TL05_2DTopEdge : 92|11@1+ (0.03,-30.72) [-30.72|30.69] "degree"  DASy
 SG_ VFC_TL05_Px : 104|11@1+ (0.1,0) [0|204.7] "m"  DASy
 SG_ VFC_TL06_Colour : 120|2@1+ (1,0) [0|3] ""  DASy
 SG_ VFC_TL06_LightShapeType : 122|4@1+ (1,0) [0|15] ""  DASy
 SG_ VFC_TL06_LightModeType : 126|2@1+ (1,0) [0|3] ""  DASy
 SG_ VFC_TL06_Py : 128|10@1+ (0.1,-51.2) [-51.2|51.1] "m"  DASy
 SG_ VFC_TL06_ExistProb : 138|6@1+ (2,0) [0|100] "%"  DASy
 SG_ VFC_TL06_Pz : 144|8@1+ (0.1,0) [0|25.5] "m"  DASy
 SG_ VFC_TL06_2DWidth : 152|8@1+ (0.03,0) [0|7.65] "degree"  DASy
 SG_ VFC_TL06_2DHeight : 160|8@1+ (0.03,0) [0|7.65] "degree"  DASy
 SG_ VFC_TL06_2DLeftEdge : 168|12@1+ (0.03,-61.44) [-61.44|61.41] "degree"  DASy
 SG_ VFC_TL06_2DTopEdge : 180|11@1+ (0.03,-30.72) [-30.72|30.69] "degree"  DASy
 SG_ VFC_TL06_Px : 192|11@1+ (0.1,0) [0|204.7] "m"  DASy
 SG_ VFC_TL07_Colour : 208|2@1+ (1,0) [0|3] ""  DASy
 SG_ VFC_TL07_LightShapeType : 210|4@1+ (1,0) [0|15] ""  DASy
 SG_ VFC_TL07_LightModeType : 214|2@1+ (1,0) [0|3] ""  DASy
 SG_ VFC_TL07_Py : 216|10@1+ (0.1,-51.2) [-51.2|51.1] "m"  DASy
 SG_ VFC_TL07_ExistProb : 226|6@1+ (2,0) [0|100] "%"  DASy
 SG_ VFC_TL07_Pz : 232|8@1+ (0.1,0) [0|25.5] "m"  DASy
 SG_ VFC_TL07_2DWidth : 240|8@1+ (0.03,0) [0|7.65] "degree"  DASy
 SG_ VFC_TL07_2DHeight : 248|8@1+ (0.03,0) [0|7.65] "degree"  DASy
 SG_ VFC_TL07_2DLeftEdge : 256|12@1+ (0.03,-61.44) [-61.44|61.41] "degree"  DASy
 SG_ VFC_TL07_2DTopEdge : 268|11@1+ (0.03,-30.72) [-30.72|30.69] "degree"  DASy
 SG_ VFC_TL07_Px : 280|11@1+ (0.1,0) [0|204.7] "m"  DASy
 SG_ VFC_TL08_Colour : 296|2@1+ (1,0) [0|3] ""  DASy
 SG_ VFC_TL08_LightShapeType : 298|4@1+ (1,0) [0|15] ""  DASy
 SG_ VFC_TL08_LightModeType : 302|2@1+ (1,0) [0|3] ""  DASy
 SG_ VFC_TL08_Py : 304|10@1+ (0.1,-51.2) [-51.2|51.1] "m"  DASy
 SG_ VFC_TL08_ExistProb : 314|6@1+ (2,0) [0|100] "%"  DASy
 SG_ VFC_TL08_Pz : 320|8@1+ (0.1,0) [0|25.5] "m"  DASy
 SG_ VFC_TL08_2DWidth : 328|8@1+ (0.03,0) [0|7.65] "degree"  DASy
 SG_ VFC_TL08_2DHeight : 336|8@1+ (0.03,0) [0|7.65] "degree"  DASy
 SG_ VFC_TL08_2DLeftEdge : 344|12@1+ (0.03,-61.44) [-61.44|61.41] "degree"  DASy
 SG_ VFC_TL08_2DTopEdge : 356|11@1+ (0.03,-30.72) [-30.72|30.69] "degree"  DASy
 SG_ VFC_TL08_Px : 368|11@1+ (0.1,0) [0|204.7] "m"  DASy
 SG_ VFC_TL09_Colour : 384|2@1+ (1,0) [0|3] ""  DASy
 SG_ VFC_TL09_LightShapeType : 386|4@1+ (1,0) [0|15] ""  DASy
 SG_ VFC_TL09_LightModeType : 390|2@1+ (1,0) [0|3] ""  DASy
 SG_ VFC_TL09_Py : 392|10@1+ (0.1,-51.2) [-51.2|51.1] "m"  DASy
 SG_ VFC_TL09_ExistProb : 402|6@1+ (2,0) [0|100] "%"  DASy
 SG_ VFC_TL09_Pz : 408|8@1+ (0.1,0) [0|25.5] "m"  DASy
 SG_ VFC_TL09_2DWidth : 416|8@1+ (0.03,0) [0|7.65] "degree"  DASy
 SG_ VFC_TL09_2DHeight : 424|8@1+ (0.03,0) [0|7.65] "degree"  DASy
 SG_ VFC_TL09_2DLeftEdge : 432|12@1+ (0.03,-61.44) [-61.44|61.41] "degree"  DASy
 SG_ VFC_TL09_2DTopEdge : 444|11@1+ (0.03,-30.72) [-30.72|30.69] "degree"  DASy
 SG_ VFC_TL09_Px : 456|11@1+ (0.1,0) [0|204.7] "m"  DASy

BO_ 236 VFC_TrafficSignHdr: 20 VideoFrontCenter
 SG_ VFC_TSHdr_CRC : 0|16@1+ (1,0) [0|65535] ""  DASy
 SG_ VFC_TSHdr_AliveCtr : 16|8@1+ (1,0) [0|255] ""  DASy
 SG_ VFC_TSHdr_ProtBlockCtr : 24|4@1+ (1,0) [0|15] ""  DASy
 SG_ VFC_TSHdr_IfVersionIdMajor : 32|8@1+ (1,0) [0|255] ""  DASy
 SG_ VFC_TSHdr_IfVersionIdMinor : 40|8@1+ (1,0) [0|255] ""  DASy
 SG_ VFC_TSHdr_NumValidTrafficSigns : 48|5@1+ (1,0) [0|31] ""  DASy
 SG_ VFC_TSHdr_TimeStampStatus : 56|8@1+ (1,0) [0|255] ""  DASy
 SG_ VFC_TSHdr_TimeStamp : 64|26@1+ (1,0) [0|67108863] "ms"  DASy
 SG_ VFC_TSHdr_SensorStatus : 96|3@1+ (1,0) [0|7] ""  DASy
 SG_ VFC_TSHdr_SensorStatusExt : 104|8@1+ (1,0) [0|255] ""  DASy
 SG_ VFC_TSHdr_CurrentRegion : 112|10@1+ (1,0) [0|999] ""  DASy

BO_ 238 VFC_TrafficSign_00_01: 64 VideoFrontCenter
 SG_ VFC_TS_00_01_CRC : 0|16@1+ (1,0) [0|65535] ""  DASy
 SG_ VFC_TS_00_01_AliveCtr : 16|8@1+ (1,0) [0|255] ""  DASy
 SG_ VFC_TS_00_01_ProtBlockCtr : 24|4@1+ (1,0) [0|15] ""  DASy
 SG_ VFC_TS00_ObjId : 32|8@1+ (1,0) [0|255] ""  DASy
 SG_ VFC_TS00_Type : 40|10@1+ (1,0) [0|1023] ""  DASy
 SG_ VFC_TS00_ExistProb : 50|5@1+ (5,0) [0|100] "%"  DASy
 SG_ VFC_TS00_Px : 55|9@1+ (0.25,0) [0|127.75] "m"  DASy
 SG_ VFC_TS00_Py : 64|8@1+ (0.2,-25.6) [-25.6|25.4] "m"  DASy
 SG_ VFC_TS00_Pz : 72|6@1+ (0.2,0) [0|12.6] "m"  DASy
 SG_ VFC_TS00_PxStdDev : 78|9@1+ (0.25,0) [0|127.75] "m"  DASy
 SG_ VFC_TS00_Width : 87|4@1+ (0.2,0) [0|3] "m"  DASy
 SG_ VFC_TS00_Height : 91|4@1+ (0.2,0) [0|3] "m"  DASy
 SG_ VFC_TS00_EmbeddedInfo : 95|4@1+ (1,0) [0|15] ""  DASy
 SG_ VFC_TS00_ValidLane : 99|5@1+ (1,0) [0|31] ""  DASy
 SG_ VFC_TS00_ValidDay : 104|7@1+ (1,0) [0|127] ""  DASy
 SG_ VFC_TS00_ValidTimeRange1Start : 111|7@1+ (15,0) [0|1440] "min"  DASy
 SG_ VFC_TS00_ValidTimeRange1End : 118|7@1+ (15,0) [0|1440] "min"  DASy
 SG_ VFC_TS00_ValidTimeRange2Start : 125|7@1+ (15,0) [0|1440] "min"  DASy
 SG_ VFC_TS00_ValidTimeRange2End : 132|7@1+ (15,0) [0|1440] "min"  DASy
 SG_ VFC_TS00_ValidInDist : 139|15@1+ (0.1,0) [0|3276.7] ""  DASy
 SG_ VFC_TS00_ValidInDistUnit : 154|3@1+ (1,0) [0|7] ""  DASy
 SG_ VFC_TS00_ValidSection : 157|15@1+ (0.1,0) [0|3276.7] ""  DASy
 SG_ VFC_TS00_ValidSectionUnit : 172|3@1+ (1,0) [0|7] ""  DASy
 SG_ VFC_TS00_NumValidSupSigns : 175|3@1+ (1,0) [0|6] ""  DASy
 SG_ VFC_TS00_SupSign0ExistProb : 178|5@1+ (5,0) [0|100] "%"  DASy
 SG_ VFC_TS00_SupSign1ExistProb : 183|5@1+ (5,0) [0|100] "%"  DASy
 SG_ VFC_TS00_SupSign2ExistProb : 188|5@1+ (5,0) [0|100] "%"  DASy
 SG_ VFC_TS00_SupSign3ExistProb : 193|5@1+ (5,0) [0|100] "%"  DASy
 SG_ VFC_TS00_SupSign4ExistProb : 198|5@1+ (5,0) [0|100] "%"  DASy
 SG_ VFC_TS00_SupSign5ExistProb : 203|5@1+ (5,0) [0|100] "%"  DASy
 SG_ VFC_TS00_SupSign0Type : 208|8@1+ (1,0) [0|255] ""  DASy
 SG_ VFC_TS00_SupSign1Type : 216|8@1+ (1,0) [0|255] ""  DASy
 SG_ VFC_TS00_SupSign2Type : 224|8@1+ (1,0) [0|255] ""  DASy
 SG_ VFC_TS00_SupSign3Type : 232|8@1+ (1,0) [0|255] ""  DASy
 SG_ VFC_TS00_SupSign4Type : 240|8@1+ (1,0) [0|255] ""  DASy
 SG_ VFC_TS00_SupSign5Type : 248|8@1+ (1,0) [0|255] ""  DASy
 SG_ VFC_TS01_ObjId : 272|8@1+ (1,0) [0|255] ""  DASy
 SG_ VFC_TS01_Type : 280|10@1+ (1,0) [0|1023] ""  DASy
 SG_ VFC_TS01_ExistProb : 290|5@1+ (5,0) [0|100] "%"  DASy
 SG_ VFC_TS01_Px : 295|9@1+ (0.25,0) [0|127.75] "m"  DASy
 SG_ VFC_TS01_Py : 304|8@1+ (0.2,-25.6) [-25.6|25.4] "m"  DASy
 SG_ VFC_TS01_Pz : 312|6@1+ (0.2,0) [0|12.6] "m"  DASy
 SG_ VFC_TS01_PxStdDev : 318|9@1+ (0.25,0) [0|127.75] "m"  DASy
 SG_ VFC_TS01_Width : 327|4@1+ (0.2,0) [0|3] "m"  DASy
 SG_ VFC_TS01_Height : 331|4@1+ (0.2,0) [0|3] "m"  DASy
 SG_ VFC_TS01_EmbeddedInfo : 335|4@1+ (1,0) [0|15] ""  DASy
 SG_ VFC_TS01_ValidLane : 339|5@1+ (1,0) [0|31] ""  DASy
 SG_ VFC_TS01_ValidDay : 344|7@1+ (1,0) [0|127] ""  DASy
 SG_ VFC_TS01_ValidTimeRange1Start : 351|7@1+ (15,0) [0|1440] "min"  DASy
 SG_ VFC_TS01_ValidTimeRange1End : 358|7@1+ (15,0) [0|1440] "min"  DASy
 SG_ VFC_TS01_ValidTimeRange2Start : 365|7@1+ (15,0) [0|1440] "min"  DASy
 SG_ VFC_TS01_ValidTimeRange2End : 372|7@1+ (15,0) [0|1440] "min"  DASy
 SG_ VFC_TS01_ValidInDist : 379|15@1+ (0.1,0) [0|3276.7] ""  DASy
 SG_ VFC_TS01_ValidInDistUnit : 394|3@1+ (1,0) [0|7] ""  DASy
 SG_ VFC_TS01_ValidSection : 397|15@1+ (0.1,0) [0|3276.7] ""  DASy
 SG_ VFC_TS01_ValidSectionUnit : 412|3@1+ (1,0) [0|7] ""  DASy
 SG_ VFC_TS01_NumValidSupSigns : 415|3@1+ (1,0) [0|6] ""  DASy
 SG_ VFC_TS01_SupSign0ExistProb : 418|5@1+ (5,0) [0|100] "%"  DASy
 SG_ VFC_TS01_SupSign1ExistProb : 423|5@1+ (5,0) [0|100] "%"  DASy
 SG_ VFC_TS01_SupSign2ExistProb : 428|5@1+ (5,0) [0|100] "%"  DASy
 SG_ VFC_TS01_SupSign3ExistProb : 433|5@1+ (5,0) [0|100] "%"  DASy
 SG_ VFC_TS01_SupSign4ExistProb : 438|5@1+ (5,0) [0|100] "%"  DASy
 SG_ VFC_TS01_SupSign5ExistProb : 443|5@1+ (5,0) [0|100] "%"  DASy
 SG_ VFC_TS01_SupSign0Type : 448|8@1+ (1,0) [0|255] ""  DASy
 SG_ VFC_TS01_SupSign1Type : 456|8@1+ (1,0) [0|255] ""  DASy
 SG_ VFC_TS01_SupSign2Type : 464|8@1+ (1,0) [0|255] ""  DASy
 SG_ VFC_TS01_SupSign3Type : 472|8@1+ (1,0) [0|255] ""  DASy
 SG_ VFC_TS01_SupSign4Type : 480|8@1+ (1,0) [0|255] ""  DASy
 SG_ VFC_TS01_SupSign5Type : 488|8@1+ (1,0) [0|255] ""  DASy

BO_ 239 VFC_TrafficSign_02_03: 64 VideoFrontCenter
 SG_ VFC_TS_02_03_CRC : 0|16@1+ (1,0) [0|65535] ""  DASy
 SG_ VFC_TS_02_03_AliveCtr : 16|8@1+ (1,0) [0|255] ""  DASy
 SG_ VFC_TS_02_03_ProtBlockCtr : 24|4@1+ (1,0) [0|15] ""  DASy
 SG_ VFC_TS02_ObjId : 32|8@1+ (1,0) [0|255] ""  DASy
 SG_ VFC_TS02_Type : 40|10@1+ (1,0) [0|1023] ""  DASy
 SG_ VFC_TS02_ExistProb : 50|5@1+ (5,0) [0|100] "%"  DASy
 SG_ VFC_TS02_Px : 55|9@1+ (0.25,0) [0|127.75] "m"  DASy
 SG_ VFC_TS02_Py : 64|8@1+ (0.2,-25.6) [-25.6|25.4] "m"  DASy
 SG_ VFC_TS02_Pz : 72|6@1+ (0.2,0) [0|12.6] "m"  DASy
 SG_ VFC_TS02_PxStdDev : 78|9@1+ (0.25,0) [0|127.75] "m"  DASy
 SG_ VFC_TS02_Width : 87|4@1+ (0.2,0) [0|3] "m"  DASy
 SG_ VFC_TS02_Height : 91|4@1+ (0.2,0) [0|3] "m"  DASy
 SG_ VFC_TS02_EmbeddedInfo : 95|4@1+ (1,0) [0|15] ""  DASy
 SG_ VFC_TS02_ValidLane : 99|5@1+ (1,0) [0|31] ""  DASy
 SG_ VFC_TS02_ValidDay : 104|7@1+ (1,0) [0|127] ""  DASy
 SG_ VFC_TS02_ValidTimeRange1Start : 111|7@1+ (15,0) [0|1440] "min"  DASy
 SG_ VFC_TS02_ValidTimeRange1End : 118|7@1+ (15,0) [0|1440] "min"  DASy
 SG_ VFC_TS02_ValidTimeRange2Start : 125|7@1+ (15,0) [0|1440] "min"  DASy
 SG_ VFC_TS02_ValidTimeRange2End : 132|7@1+ (15,0) [0|1440] "min"  DASy
 SG_ VFC_TS02_ValidInDist : 139|15@1+ (0.1,0) [0|3276.7] ""  DASy
 SG_ VFC_TS02_ValidInDistUnit : 154|3@1+ (1,0) [0|7] ""  DASy
 SG_ VFC_TS02_ValidSection : 157|15@1+ (0.1,0) [0|3276.7] ""  DASy
 SG_ VFC_TS02_ValidSectionUnit : 172|3@1+ (1,0) [0|7] ""  DASy
 SG_ VFC_TS02_NumValidSupSigns : 175|3@1+ (1,0) [0|6] ""  DASy
 SG_ VFC_TS02_SupSign0ExistProb : 178|5@1+ (5,0) [0|100] "%"  DASy
 SG_ VFC_TS02_SupSign1ExistProb : 183|5@1+ (5,0) [0|100] "%"  DASy
 SG_ VFC_TS02_SupSign2ExistProb : 188|5@1+ (5,0) [0|100] "%"  DASy
 SG_ VFC_TS02_SupSign3ExistProb : 193|5@1+ (5,0) [0|100] "%"  DASy
 SG_ VFC_TS02_SupSign4ExistProb : 198|5@1+ (5,0) [0|100] "%"  DASy
 SG_ VFC_TS02_SupSign5ExistProb : 203|5@1+ (5,0) [0|100] "%"  DASy
 SG_ VFC_TS02_SupSign0Type : 208|8@1+ (1,0) [0|255] ""  DASy
 SG_ VFC_TS02_SupSign1Type : 216|8@1+ (1,0) [0|255] ""  DASy
 SG_ VFC_TS02_SupSign2Type : 224|8@1+ (1,0) [0|255] ""  DASy
 SG_ VFC_TS02_SupSign3Type : 232|8@1+ (1,0) [0|255] ""  DASy
 SG_ VFC_TS02_SupSign4Type : 240|8@1+ (1,0) [0|255] ""  DASy
 SG_ VFC_TS02_SupSign5Type : 248|8@1+ (1,0) [0|255] ""  DASy
 SG_ VFC_TS03_ObjId : 272|8@1+ (1,0) [0|255] ""  DASy
 SG_ VFC_TS03_Type : 280|10@1+ (1,0) [0|1023] ""  DASy
 SG_ VFC_TS03_ExistProb : 290|5@1+ (5,0) [0|100] "%"  DASy
 SG_ VFC_TS03_Px : 295|9@1+ (0.25,0) [0|127.75] "m"  DASy
 SG_ VFC_TS03_Py : 304|8@1+ (0.2,-25.6) [-25.6|25.4] "m"  DASy
 SG_ VFC_TS03_Pz : 312|6@1+ (0.2,0) [0|12.6] "m"  DASy
 SG_ VFC_TS03_PxStdDev : 318|9@1+ (0.25,0) [0|127.75] "m"  DASy
 SG_ VFC_TS03_Width : 327|4@1+ (0.2,0) [0|3] "m"  DASy
 SG_ VFC_TS03_Height : 331|4@1+ (0.2,0) [0|3] "m"  DASy
 SG_ VFC_TS03_EmbeddedInfo : 335|4@1+ (1,0) [0|15] ""  DASy
 SG_ VFC_TS03_ValidLane : 339|5@1+ (1,0) [0|31] ""  DASy
 SG_ VFC_TS03_ValidDay : 344|7@1+ (1,0) [0|127] ""  DASy
 SG_ VFC_TS03_ValidTimeRange1Start : 351|7@1+ (15,0) [0|1440] "min"  DASy
 SG_ VFC_TS03_ValidTimeRange1End : 358|7@1+ (15,0) [0|1440] "min"  DASy
 SG_ VFC_TS03_ValidTimeRange2Start : 365|7@1+ (15,0) [0|1440] "min"  DASy
 SG_ VFC_TS03_ValidTimeRange2End : 372|7@1+ (15,0) [0|1440] "min"  DASy
 SG_ VFC_TS03_ValidInDist : 379|15@1+ (0.1,0) [0|3276.7] ""  DASy
 SG_ VFC_TS03_ValidInDistUnit : 394|3@1+ (1,0) [0|7] ""  DASy
 SG_ VFC_TS03_ValidSection : 397|15@1+ (0.1,0) [0|3276.7] ""  DASy
 SG_ VFC_TS03_ValidSectionUnit : 412|3@1+ (1,0) [0|7] ""  DASy
 SG_ VFC_TS03_NumValidSupSigns : 415|3@1+ (1,0) [0|6] ""  DASy
 SG_ VFC_TS03_SupSign0ExistProb : 418|5@1+ (5,0) [0|100] "%"  DASy
 SG_ VFC_TS03_SupSign1ExistProb : 423|5@1+ (5,0) [0|100] "%"  DASy
 SG_ VFC_TS03_SupSign2ExistProb : 428|5@1+ (5,0) [0|100] "%"  DASy
 SG_ VFC_TS03_SupSign3ExistProb : 433|5@1+ (5,0) [0|100] "%"  DASy
 SG_ VFC_TS03_SupSign4ExistProb : 438|5@1+ (5,0) [0|100] "%"  DASy
 SG_ VFC_TS03_SupSign5ExistProb : 443|5@1+ (5,0) [0|100] "%"  DASy
 SG_ VFC_TS03_SupSign0Type : 448|8@1+ (1,0) [0|255] ""  DASy
 SG_ VFC_TS03_SupSign1Type : 456|8@1+ (1,0) [0|255] ""  DASy
 SG_ VFC_TS03_SupSign2Type : 464|8@1+ (1,0) [0|255] ""  DASy
 SG_ VFC_TS03_SupSign3Type : 472|8@1+ (1,0) [0|255] ""  DASy
 SG_ VFC_TS03_SupSign4Type : 480|8@1+ (1,0) [0|255] ""  DASy
 SG_ VFC_TS03_SupSign5Type : 488|8@1+ (1,0) [0|255] ""  DASy

CM_ SG_ 178 VFC_RM_00_06_CRC "CRC - Autosar E2E Profile 5";
CM_ SG_ 178 VFC_RM_00_06_AliveCtr "Alive counter - Autosar E2E Profile 5";
CM_ SG_ 178 VFC_RM_00_06_ProtBlockCtr "Protocol-Signal: Block-Counter";
CM_ SG_ 178 VFC_RM00_ExistProb "ISO 23150:2022(E): Existence probability - object level (A.2.1)";
CM_ SG_ 178 VFC_RM00_Type "ISO 23150:2022(E): Road marking type (A.2.91)";
CM_ SG_ 178 VFC_RM00_VertexPoint00x "Point00 connected to Point01 results in straight line. ISO 23150:2022(E): Vertex point {x, y, z} (A.2.112)";
CM_ SG_ 178 VFC_RM00_VertexPoint00y "Point00 connected to Point01 results in straight line. ISO 23150:2022(E): Vertex point {x, y, z} (A.2.112)";
CM_ SG_ 178 VFC_RM00_VertexPoint01x "Point00 connected to Point01 results in straight line. ISO 23150:2022(E): Vertex point {x, y, z} (A.2.112)";
CM_ SG_ 178 VFC_RM00_VertexPoint01y "Point00 connected to Point01 results in straight line. ISO 23150:2022(E): Vertex point {x, y, z} (A.2.112)";
CM_ SG_ 178 VFC_RM01_ExistProb "ISO 23150:2022(E): Existence probability - object level (A.2.1)";
CM_ SG_ 178 VFC_RM01_Type "ISO 23150:2022(E): Road marking type (A.2.91)";
CM_ SG_ 178 VFC_RM01_VertexPoint00x "Point00 connected to Point01 results in straight line. ISO 23150:2022(E): Vertex point {x, y, z} (A.2.112)";
CM_ SG_ 178 VFC_RM01_VertexPoint00y "Point00 connected to Point01 results in straight line. ISO 23150:2022(E): Vertex point {x, y, z} (A.2.112)";
CM_ SG_ 178 VFC_RM01_VertexPoint01x "Point00 connected to Point01 results in straight line. ISO 23150:2022(E): Vertex point {x, y, z} (A.2.112)";
CM_ SG_ 178 VFC_RM01_VertexPoint01y "Point00 connected to Point01 results in straight line. ISO 23150:2022(E): Vertex point {x, y, z} (A.2.112)";
CM_ SG_ 178 VFC_RM02_ExistProb "ISO 23150:2022(E): Existence probability - object level (A.2.1)";
CM_ SG_ 178 VFC_RM02_Type "ISO 23150:2022(E): Road marking type (A.2.91)";
CM_ SG_ 178 VFC_RM02_VertexPoint00x "Point00 connected to Point01 results in straight line. ISO 23150:2022(E): Vertex point {x, y, z} (A.2.112)";
CM_ SG_ 178 VFC_RM02_VertexPoint00y "Point00 connected to Point01 results in straight line. ISO 23150:2022(E): Vertex point {x, y, z} (A.2.112)";
CM_ SG_ 178 VFC_RM02_VertexPoint01x "Point00 connected to Point01 results in straight line. ISO 23150:2022(E): Vertex point {x, y, z} (A.2.112)";
CM_ SG_ 178 VFC_RM02_VertexPoint01y "Point00 connected to Point01 results in straight line. ISO 23150:2022(E): Vertex point {x, y, z} (A.2.112)";
CM_ SG_ 178 VFC_RM03_ExistProb "ISO 23150:2022(E): Existence probability - object level (A.2.1)";
CM_ SG_ 178 VFC_RM03_Type "ISO 23150:2022(E): Road marking type (A.2.91)";
CM_ SG_ 178 VFC_RM03_VertexPoint00x "Point00 connected to Point01 results in straight line. ISO 23150:2022(E): Vertex point {x, y, z} (A.2.112)";
CM_ SG_ 178 VFC_RM03_VertexPoint00y "Point00 connected to Point01 results in straight line. ISO 23150:2022(E): Vertex point {x, y, z} (A.2.112)";
CM_ SG_ 178 VFC_RM03_VertexPoint01x "Point00 connected to Point01 results in straight line. ISO 23150:2022(E): Vertex point {x, y, z} (A.2.112)";
CM_ SG_ 178 VFC_RM03_VertexPoint01y "Point00 connected to Point01 results in straight line. ISO 23150:2022(E): Vertex point {x, y, z} (A.2.112)";
CM_ SG_ 178 VFC_RM04_ExistProb "ISO 23150:2022(E): Existence probability - object level (A.2.1)";
CM_ SG_ 178 VFC_RM04_Type "ISO 23150:2022(E): Road marking type (A.2.91)";
CM_ SG_ 178 VFC_RM04_VertexPoint00x "Point00 connected to Point01 results in straight line. ISO 23150:2022(E): Vertex point {x, y, z} (A.2.112)";
CM_ SG_ 178 VFC_RM04_VertexPoint00y "Point00 connected to Point01 results in straight line. ISO 23150:2022(E): Vertex point {x, y, z} (A.2.112)";
CM_ SG_ 178 VFC_RM04_VertexPoint01x "Point00 connected to Point01 results in straight line. ISO 23150:2022(E): Vertex point {x, y, z} (A.2.112)";
CM_ SG_ 178 VFC_RM04_VertexPoint01y "Point00 connected to Point01 results in straight line. ISO 23150:2022(E): Vertex point {x, y, z} (A.2.112)";
CM_ SG_ 178 VFC_RM05_ExistProb "ISO 23150:2022(E): Existence probability - object level (A.2.1)";
CM_ SG_ 178 VFC_RM05_Type "ISO 23150:2022(E): Road marking type (A.2.91)";
CM_ SG_ 178 VFC_RM05_VertexPoint00x "Point00 connected to Point01 results in straight line. ISO 23150:2022(E): Vertex point {x, y, z} (A.2.112)";
CM_ SG_ 178 VFC_RM05_VertexPoint00y "Point00 connected to Point01 results in straight line. ISO 23150:2022(E): Vertex point {x, y, z} (A.2.112)";
CM_ SG_ 178 VFC_RM05_VertexPoint01x "Point00 connected to Point01 results in straight line. ISO 23150:2022(E): Vertex point {x, y, z} (A.2.112)";
CM_ SG_ 178 VFC_RM05_VertexPoint01y "Point00 connected to Point01 results in straight line. ISO 23150:2022(E): Vertex point {x, y, z} (A.2.112)";
CM_ SG_ 178 VFC_RM06_ExistProb "ISO 23150:2022(E): Existence probability - object level (A.2.1)";
CM_ SG_ 178 VFC_RM06_Type "ISO 23150:2022(E): Road marking type (A.2.91)";
CM_ SG_ 178 VFC_RM06_VertexPoint00x "Point00 connected to Point01 results in straight line. ISO 23150:2022(E): Vertex point {x, y, z} (A.2.112)";
CM_ SG_ 178 VFC_RM06_VertexPoint00y "Point00 connected to Point01 results in straight line. ISO 23150:2022(E): Vertex point {x, y, z} (A.2.112)";
CM_ SG_ 178 VFC_RM06_VertexPoint01x "Point00 connected to Point01 results in straight line. ISO 23150:2022(E): Vertex point {x, y, z} (A.2.112)";
CM_ SG_ 178 VFC_RM06_VertexPoint01y "Point00 connected to Point01 results in straight line. ISO 23150:2022(E): Vertex point {x, y, z} (A.2.112)";
CM_ SG_ 224 VFC_TLHdr_CRC "CRC - Autosar E2E Profile 5";
CM_ SG_ 224 VFC_TLHdr_AliveCtr "Alive counter - Autosar E2E Profile 5";
CM_ SG_ 224 VFC_TLHdr_ProtBlockCtr "Protocol-Signal: Block-Counter";
CM_ SG_ 224 VFC_TLHdr_IfVersionIdMajor "Version information of the interface. e. g. version 1.0: Major = 1. ISO 23150:2022(E): Interface version ID {major, minor, patch} (A.1.1)";
CM_ SG_ 224 VFC_TLHdr_IfVersionIdMinor "Version information of the interface. e. g. version 1.0: Minor = 0. ISO 23150:2022(E): Interface version ID {major, minor, patch} (A.1.1)";
CM_ SG_ 224 VFC_TLHdr_NumTrafficLights "Protocol-Signal: count of all traffic lights ISO 23150:2022(E): Number of valid traffic lights (A.1.12.7)";
CM_ SG_ 224 VFC_TLHdr_TimeStampStatus "Autosar StbM_TimeBaseStatusType bitfield with extension:
Bit 0: TIMEOUT
Bit 1: Reserved1
Bit 2: SYNC_TO_GATEWAY
Bit 3: GLOBAL_TIME_BASE
Bit 4: TIMELEAP_FUTURE
Bit 5: TIMELEAP_PAST
Bit 6: Reserved6
Bit 7: Extension: GENERAL_ERROR";
CM_ SG_ 224 VFC_TLHdr_TimeStamp "TimeStamp of Objects ISO 23150:2022(E) Time stamp �prediction (A.1.5.1)";
CM_ SG_ 224 VFC_TLHdr_State "Traffic light function and degradation state";
CM_ SG_ 224 VFC_TLHdr_MostRelevantTLId "Index of traffic light object which is most relevant";
CM_ SG_ 224 VFC_TLHdr_Reserved0 "Reserved for future usage";
CM_ SG_ 224 VFC_TLHdr_Reserved1 "Reserved for future usage";
CM_ SG_ 226 VFC_TL00_04_CRC "CRC - Autosar E2E Profile 5";
CM_ SG_ 226 VFC_TL00_04_AliveCtr "Alive counter - Autosar E2E Profile 5";
CM_ SG_ 226 VFC_TL00_04_ProtBlockCtr "Protocol-Signal: Block-Counter";
CM_ SG_ 226 VFC_TL00_Colour "Colour of the traffic light spot - defined in ISO 23150:2022(E) A.2.209";
CM_ SG_ 226 VFC_TL00_LightShapeType "Type of traffic light, which indicates the direction of the traffic light (e.g. left/right turn) �- defined in ISO 23150:2022(E) A.2.205";
CM_ SG_ 226 VFC_TL00_LightModeType "Behavior mode of the traffic light spot �- defined in ISO 23150:2022(E) A.2.212";
CM_ SG_ 226 VFC_TL00_Py "Lateral position of traffic light �- defined in ISO 23150:2022(E) A.2.15";
CM_ SG_ 226 VFC_TL00_ExistProb "Existence probability - defined in ISO 23150:2022(E): Existence probability - object level (A.2.1)";
CM_ SG_ 226 VFC_TL00_Pz "Vertical position of traffic light �- defined in ISO 23150:2022(E) A.2.15";
CM_ SG_ 226 VFC_TL00_2DWidth "Width of traffic light in angle of view - additional information over ISO 23150:2022(E)";
CM_ SG_ 226 VFC_TL00_2DHeight "Height of traffic light in angle of view - additional information over ISO 23150:2022(E)";
CM_ SG_ 226 VFC_TL00_2DLeftEdge "Angle of view of the left border of traffic light spot bounding box - additional information over ISO 23150:2022(E)";
CM_ SG_ 226 VFC_TL00_2DTopEdge "Angle of view of the top border of traffic light spot bounding box - additional information over ISO 23150:2022(E)";
CM_ SG_ 226 VFC_TL00_Px "Longitudinal position of traffic light - defined in ISO 23150:2022(E) A.2.15";
CM_ SG_ 226 VFC_TL01_Colour "Colour of the traffic light spot - defined in ISO 23150:2022(E) A.2.209";
CM_ SG_ 226 VFC_TL01_LightShapeType "Type of traffic light, which indicates the direction of the traffic light (e.g. left/right turn) �- defined in ISO 23150:2022(E) A.2.205";
CM_ SG_ 226 VFC_TL01_LightModeType "Behavior mode of the traffic light spot �- defined in ISO 23150:2022(E) A.2.212";
CM_ SG_ 226 VFC_TL01_Py "Lateral position of traffic light �- defined in ISO 23150:2022(E) A.2.15";
CM_ SG_ 226 VFC_TL01_ExistProb "Existence probability - defined in ISO 23150:2022(E): Existence probability - object level (A.2.1)";
CM_ SG_ 226 VFC_TL01_Pz "Vertical position of traffic light �- defined in ISO 23150:2022(E) A.2.15";
CM_ SG_ 226 VFC_TL01_2DWidth "Width of traffic light in angle of view - additional information over ISO 23150:2022(E)";
CM_ SG_ 226 VFC_TL01_2DHeight "Height of traffic light in angle of view - additional information over ISO 23150:2022(E)";
CM_ SG_ 226 VFC_TL01_2DLeftEdge "Angle of view of the left border of traffic light spot bounding box - additional information over ISO 23150:2022(E)";
CM_ SG_ 226 VFC_TL01_2DTopEdge "Angle of view of the top border of traffic light spot bounding box - additional information over ISO 23150:2022(E)";
CM_ SG_ 226 VFC_TL01_Px "Longitudinal position of traffic light - defined in ISO 23150:2022(E) A.2.15";
CM_ SG_ 226 VFC_TL02_Colour "Colour of the traffic light spot - defined in ISO 23150:2022(E) A.2.209";
CM_ SG_ 226 VFC_TL02_LightShapeType "Type of traffic light, which indicates the direction of the traffic light (e.g. left/right turn) �- defined in ISO 23150:2022(E) A.2.205";
CM_ SG_ 226 VFC_TL02_LightModeType "Behavior mode of the traffic light spot �- defined in ISO 23150:2022(E) A.2.212";
CM_ SG_ 226 VFC_TL02_Py "Lateral position of traffic light �- defined in ISO 23150:2022(E) A.2.15";
CM_ SG_ 226 VFC_TL02_ExistProb "Existence probability - defined in ISO 23150:2022(E): Existence probability - object level (A.2.1)";
CM_ SG_ 226 VFC_TL02_Pz "Vertical position of traffic light �- defined in ISO 23150:2022(E) A.2.15";
CM_ SG_ 226 VFC_TL02_2DWidth "Width of traffic light in angle of view - additional information over ISO 23150:2022(E)";
CM_ SG_ 226 VFC_TL02_2DHeight "Height of traffic light in angle of view - additional information over ISO 23150:2022(E)";
CM_ SG_ 226 VFC_TL02_2DLeftEdge "Angle of view of the left border of traffic light spot bounding box - additional information over ISO 23150:2022(E)";
CM_ SG_ 226 VFC_TL02_2DTopEdge "Angle of view of the top border of traffic light spot bounding box - additional information over ISO 23150:2022(E)";
CM_ SG_ 226 VFC_TL02_Px "Longitudinal position of traffic light - defined in ISO 23150:2022(E) A.2.15";
CM_ SG_ 226 VFC_TL03_Colour "Colour of the traffic light spot - defined in ISO 23150:2022(E) A.2.209";
CM_ SG_ 226 VFC_TL03_LightShapeType "Type of traffic light, which indicates the direction of the traffic light (e.g. left/right turn) �- defined in ISO 23150:2022(E) A.2.205";
CM_ SG_ 226 VFC_TL03_LightModeType "Behavior mode of the traffic light spot �- defined in ISO 23150:2022(E) A.2.212";
CM_ SG_ 226 VFC_TL03_Py "Lateral position of traffic light �- defined in ISO 23150:2022(E) A.2.15";
CM_ SG_ 226 VFC_TL03_ExistProb "Existence probability - defined in ISO 23150:2022(E): Existence probability - object level (A.2.1)";
CM_ SG_ 226 VFC_TL03_Pz "Vertical position of traffic light �- defined in ISO 23150:2022(E) A.2.15";
CM_ SG_ 226 VFC_TL03_2DWidth "Width of traffic light in angle of view - additional information over ISO 23150:2022(E)";
CM_ SG_ 226 VFC_TL03_2DHeight "Height of traffic light in angle of view - additional information over ISO 23150:2022(E)";
CM_ SG_ 226 VFC_TL03_2DLeftEdge "Angle of view of the left border of traffic light spot bounding box - additional information over ISO 23150:2022(E)";
CM_ SG_ 226 VFC_TL03_2DTopEdge "Angle of view of the top border of traffic light spot bounding box - additional information over ISO 23150:2022(E)";
CM_ SG_ 226 VFC_TL03_Px "Longitudinal position of traffic light - defined in ISO 23150:2022(E) A.2.15";
CM_ SG_ 226 VFC_TL04_Colour "Colour of the traffic light spot - defined in ISO 23150:2022(E) A.2.209";
CM_ SG_ 226 VFC_TL04_LightShapeType "Type of traffic light, which indicates the direction of the traffic light (e.g. left/right turn) �- defined in ISO 23150:2022(E) A.2.205";
CM_ SG_ 226 VFC_TL04_LightModeType "Behavior mode of the traffic light spot �- defined in ISO 23150:2022(E) A.2.212";
CM_ SG_ 226 VFC_TL04_Py "Lateral position of traffic light �- defined in ISO 23150:2022(E) A.2.15";
CM_ SG_ 226 VFC_TL04_ExistProb "Existence probability - defined in ISO 23150:2022(E): Existence probability - object level (A.2.1)";
CM_ SG_ 226 VFC_TL04_Pz "Vertical position of traffic light �- defined in ISO 23150:2022(E) A.2.15";
CM_ SG_ 226 VFC_TL04_2DWidth "Width of traffic light in angle of view - additional information over ISO 23150:2022(E)";
CM_ SG_ 226 VFC_TL04_2DHeight "Height of traffic light in angle of view - additional information over ISO 23150:2022(E)";
CM_ SG_ 226 VFC_TL04_2DLeftEdge "Angle of view of the left border of traffic light spot bounding box - additional information over ISO 23150:2022(E)";
CM_ SG_ 226 VFC_TL04_2DTopEdge "Angle of view of the top border of traffic light spot bounding box - additional information over ISO 23150:2022(E)";
CM_ SG_ 226 VFC_TL04_Px "Longitudinal position of traffic light - defined in ISO 23150:2022(E) A.2.15";
CM_ SG_ 227 VFC_TL05_09_CRC "CRC - Autosar E2E Profile 5";
CM_ SG_ 227 VFC_TL05_09_AliveCtr "Alive counter - Autosar E2E Profile 5";
CM_ SG_ 227 VFC_TL05_09_ProtBlockCtr "Protocol-Signal: Block-Counter";
CM_ SG_ 227 VFC_TL05_Colour "Colour of the traffic light spot - defined in ISO 23150:2022(E) A.2.209";
CM_ SG_ 227 VFC_TL05_LightShapeType "Type of traffic light, which indicates the direction of the traffic light (e.g. left/right turn) �- defined in ISO 23150:2022(E) A.2.205";
CM_ SG_ 227 VFC_TL05_LightModeType "Behavior mode of the traffic light spot �- defined in ISO 23150:2022(E) A.2.212";
CM_ SG_ 227 VFC_TL05_Py "Lateral position of traffic light �- defined in ISO 23150:2022(E) A.2.15";
CM_ SG_ 227 VFC_TL05_ExistProb "Existence probability - defined in ISO 23150:2022(E): Existence probability - object level (A.2.1)";
CM_ SG_ 227 VFC_TL05_Pz "Vertical position of traffic light �- defined in ISO 23150:2022(E) A.2.15";
CM_ SG_ 227 VFC_TL05_2DWidth "Width of traffic light in angle of view - additional information over ISO 23150:2022(E)";
CM_ SG_ 227 VFC_TL05_2DHeight "Height of traffic light in angle of view - additional information over ISO 23150:2022(E)";
CM_ SG_ 227 VFC_TL05_2DLeftEdge "Angle of view of the left border of traffic light spot bounding box - additional information over ISO 23150:2022(E)";
CM_ SG_ 227 VFC_TL05_2DTopEdge "Angle of view of the top border of traffic light spot bounding box - additional information over ISO 23150:2022(E)";
CM_ SG_ 227 VFC_TL05_Px "Longitudinal position of traffic light - defined in ISO 23150:2022(E) A.2.15";
CM_ SG_ 227 VFC_TL06_Colour "Colour of the traffic light spot - defined in ISO 23150:2022(E) A.2.209";
CM_ SG_ 227 VFC_TL06_LightShapeType "Type of traffic light, which indicates the direction of the traffic light (e.g. left/right turn) �- defined in ISO 23150:2022(E) A.2.205";
CM_ SG_ 227 VFC_TL06_LightModeType "Behavior mode of the traffic light spot �- defined in ISO 23150:2022(E) A.2.212";
CM_ SG_ 227 VFC_TL06_Py "Lateral position of traffic light �- defined in ISO 23150:2022(E) A.2.15";
CM_ SG_ 227 VFC_TL06_ExistProb "Existence probability - defined in ISO 23150:2022(E): Existence probability - object level (A.2.1)";
CM_ SG_ 227 VFC_TL06_Pz "Vertical position of traffic light �- defined in ISO 23150:2022(E) A.2.15";
CM_ SG_ 227 VFC_TL06_2DWidth "Width of traffic light in angle of view - additional information over ISO 23150:2022(E)";
CM_ SG_ 227 VFC_TL06_2DHeight "Height of traffic light in angle of view - additional information over ISO 23150:2022(E)";
CM_ SG_ 227 VFC_TL06_2DLeftEdge "Angle of view of the left border of traffic light spot bounding box - additional information over ISO 23150:2022(E)";
CM_ SG_ 227 VFC_TL06_2DTopEdge "Angle of view of the top border of traffic light spot bounding box - additional information over ISO 23150:2022(E)";
CM_ SG_ 227 VFC_TL06_Px "Longitudinal position of traffic light - defined in ISO 23150:2022(E) A.2.15";
CM_ SG_ 227 VFC_TL07_Colour "Colour of the traffic light spot - defined in ISO 23150:2022(E) A.2.209";
CM_ SG_ 227 VFC_TL07_LightShapeType "Type of traffic light, which indicates the direction of the traffic light (e.g. left/right turn) �- defined in ISO 23150:2022(E) A.2.205";
CM_ SG_ 227 VFC_TL07_LightModeType "Behavior mode of the traffic light spot �- defined in ISO 23150:2022(E) A.2.212";
CM_ SG_ 227 VFC_TL07_Py "Lateral position of traffic light �- defined in ISO 23150:2022(E) A.2.15";
CM_ SG_ 227 VFC_TL07_ExistProb "Existence probability - defined in ISO 23150:2022(E): Existence probability - object level (A.2.1)";
CM_ SG_ 227 VFC_TL07_Pz "Vertical position of traffic light �- defined in ISO 23150:2022(E) A.2.15";
CM_ SG_ 227 VFC_TL07_2DWidth "Width of traffic light in angle of view - additional information over ISO 23150:2022(E)";
CM_ SG_ 227 VFC_TL07_2DHeight "Height of traffic light in angle of view - additional information over ISO 23150:2022(E)";
CM_ SG_ 227 VFC_TL07_2DLeftEdge "Angle of view of the left border of traffic light spot bounding box - additional information over ISO 23150:2022(E)";
CM_ SG_ 227 VFC_TL07_2DTopEdge "Angle of view of the top border of traffic light spot bounding box - additional information over ISO 23150:2022(E)";
CM_ SG_ 227 VFC_TL07_Px "Longitudinal position of traffic light - defined in ISO 23150:2022(E) A.2.15";
CM_ SG_ 227 VFC_TL08_Colour "Colour of the traffic light spot - defined in ISO 23150:2022(E) A.2.209";
CM_ SG_ 227 VFC_TL08_LightShapeType "Type of traffic light, which indicates the direction of the traffic light (e.g. left/right turn) �- defined in ISO 23150:2022(E) A.2.205";
CM_ SG_ 227 VFC_TL08_LightModeType "Behavior mode of the traffic light spot �- defined in ISO 23150:2022(E) A.2.212";
CM_ SG_ 227 VFC_TL08_Py "Lateral position of traffic light �- defined in ISO 23150:2022(E) A.2.15";
CM_ SG_ 227 VFC_TL08_ExistProb "Existence probability - defined in ISO 23150:2022(E): Existence probability - object level (A.2.1)";
CM_ SG_ 227 VFC_TL08_Pz "Vertical position of traffic light �- defined in ISO 23150:2022(E) A.2.15";
CM_ SG_ 227 VFC_TL08_2DWidth "Width of traffic light in angle of view - additional information over ISO 23150:2022(E)";
CM_ SG_ 227 VFC_TL08_2DHeight "Height of traffic light in angle of view - additional information over ISO 23150:2022(E)";
CM_ SG_ 227 VFC_TL08_2DLeftEdge "Angle of view of the left border of traffic light spot bounding box - additional information over ISO 23150:2022(E)";
CM_ SG_ 227 VFC_TL08_2DTopEdge "Angle of view of the top border of traffic light spot bounding box - additional information over ISO 23150:2022(E)";
CM_ SG_ 227 VFC_TL08_Px "Longitudinal position of traffic light - defined in ISO 23150:2022(E) A.2.15";
CM_ SG_ 227 VFC_TL09_Colour "Colour of the traffic light spot - defined in ISO 23150:2022(E) A.2.209";
CM_ SG_ 227 VFC_TL09_LightShapeType "Type of traffic light, which indicates the direction of the traffic light (e.g. left/right turn) �- defined in ISO 23150:2022(E) A.2.205";
CM_ SG_ 227 VFC_TL09_LightModeType "Behavior mode of the traffic light spot �- defined in ISO 23150:2022(E) A.2.212";
CM_ SG_ 227 VFC_TL09_Py "Lateral position of traffic light �- defined in ISO 23150:2022(E) A.2.15";
CM_ SG_ 227 VFC_TL09_ExistProb "Existence probability - defined in ISO 23150:2022(E): Existence probability - object level (A.2.1)";
CM_ SG_ 227 VFC_TL09_Pz "Vertical position of traffic light �- defined in ISO 23150:2022(E) A.2.15";
CM_ SG_ 227 VFC_TL09_2DWidth "Width of traffic light in angle of view - additional information over ISO 23150:2022(E)";
CM_ SG_ 227 VFC_TL09_2DHeight "Height of traffic light in angle of view - additional information over ISO 23150:2022(E)";
CM_ SG_ 227 VFC_TL09_2DLeftEdge "Angle of view of the left border of traffic light spot bounding box - additional information over ISO 23150:2022(E)";
CM_ SG_ 227 VFC_TL09_2DTopEdge "Angle of view of the top border of traffic light spot bounding box - additional information over ISO 23150:2022(E)";
CM_ SG_ 227 VFC_TL09_Px "Longitudinal position of traffic light - defined in ISO 23150:2022(E) A.2.15";
CM_ SG_ 236 VFC_TSHdr_CRC "CRC - Autosar E2E Profile 5";
CM_ SG_ 236 VFC_TSHdr_AliveCtr "Alive counter - Autosar E2E Profile 5";
CM_ SG_ 236 VFC_TSHdr_ProtBlockCtr "Protocol-Signal: Block-Counter";
CM_ SG_ 236 VFC_TSHdr_IfVersionIdMajor "Version information of the interface. e. g. version 1.0: Major = 1. ISO 23150:2022(E): Interface version ID {major, minor, patch} (A.1.1)";
CM_ SG_ 236 VFC_TSHdr_IfVersionIdMinor "Version information of the interface. e. g. version 1.0: Minor = 0. ISO 23150:2022(E): Interface version ID {major, minor, patch} (A.1.1)";
CM_ SG_ 236 VFC_TSHdr_NumValidTrafficSigns "Number of valid Traffic Signs. ISO 23150:2022(E): Number of valid traffic signs (A.1.12.5)";
CM_ SG_ 236 VFC_TSHdr_TimeStampStatus "Autosar StbM_TimeBaseStatusType bitfield with extension:
Bit 0: TIMEOUT
Bit 1: Reserved1
Bit 2: SYNC_TO_GATEWAY
Bit 3: GLOBAL_TIME_BASE
Bit 4: TIMELEAP_FUTURE
Bit 5: TIMELEAP_PAST
Bit 6: Reserved6
Bit 7: Extension: GENERAL_ERROR";
CM_ SG_ 236 VFC_TSHdr_TimeStamp "ISO 23150:2022(E): Time stamp - prediction (A.1.5.1)";
CM_ SG_ 236 VFC_TSHdr_SensorStatus "The current status of the camera system";
CM_ SG_ 236 VFC_TSHdr_SensorStatusExt "The current status bitfield of the traffic sign detection system:
Bit 0: OFF_Intentionally
Bit 1: OFF_Error
Bit 2: ON_Country_Not_Supported
Bit 3: ON_Country_Info_Outdated
Bit 4: ON_Reduced_Performance
Bit 5: ON_Reduced_Performance_Temporary
Bit 6: Reserved6
Bit 7: Reserved7
Value 0: no event
Value 1: event occured";
CM_ SG_ 236 VFC_TSHdr_CurrentRegion "The current country that is used as ISO 3166 Code: Range from 0-899 is set in ISO 3166, 900-999 is the reserved area for user defined codes. ISO 23150:2022(E): Current region (A.6.48)";
CM_ SG_ 238 VFC_TS_00_01_CRC "CRC - Autosar E2E Profile 5";
CM_ SG_ 238 VFC_TS_00_01_AliveCtr "Alive counter - Autosar E2E Profile 5";
CM_ SG_ 238 VFC_TS_00_01_ProtBlockCtr "Protocol-Signal: Block-Counter";
CM_ SG_ 238 VFC_TS00_ObjId "Unique Traffic Sign ID. ISO 23150:2022(E): Object ID (A.2.2)";
CM_ SG_ 238 VFC_TS00_Type "The type of main sign. ISO 23150:2022(E): Sign classification type (A.2.98)";
CM_ SG_ 238 VFC_TS00_ExistProb "Probability that the sign is a traffic sign. ISO 23150:2022(E): Existence probability - object level (A.2.1)";
CM_ SG_ 238 VFC_TS00_Px "Traffic sign position in longitudinal direction. ISO 23150:2022(E): Position - object level {x, y, z} (A.2.15)";
CM_ SG_ 238 VFC_TS00_Py "Traffic sign position in lateral direction. ISO 23150:2022(E): Position - object level {x, y, z} (A.2.15)";
CM_ SG_ 238 VFC_TS00_Pz "Traffic sign position in vertical direction. ISO 23150:2022(E): Position - object level {x, y, z} (A.2.15)";
CM_ SG_ 238 VFC_TS00_PxStdDev "Standard deviation of Traffic sign position in longitudinal direction. ISO 23150:2022(E): Position - object level {x, y, z} - error (A.2.16)";
CM_ SG_ 238 VFC_TS00_Width "Width of the traffic sign. ISO 23150:2022(E): Bounding box extent {length, width, height} (A.2.20)";
CM_ SG_ 238 VFC_TS00_Height "Height of the traffic sign. ISO 23150:2022(E): Bounding box extent {length, width, height} (A.2.20)";
CM_ SG_ 238 VFC_TS00_EmbeddedInfo "Information how the sign is embedded or not";
CM_ SG_ 238 VFC_TS00_ValidLane "Indicates on which lane the detected sign is valid. If traffic sign is generally valid, all bits shall be set. No relevance to ego lane, signal related to ISO 23150:2022(E): Lane relevance classification type (A.2.147)
Bitfield:
Bit 0: valid on first right hand lane
Bit 1: valid on second right hand lane
Bit 2: valid on third right hand lane
Bit 3: valid on fourth right hand lane
Bit 4: valid on fifth right hand lane";
CM_ SG_ 238 VFC_TS00_ValidDay "The week days for which the main traffic sign is valid. If traffic sign is generally valid, all bits shall be set. Related to ISO 23150:2022(E): Sign text (A.2.102)
Bitfield:
Bit 0: MONDAY
Bit 1: TUESDAY
Bit 2: WEDNESDAY
Bit 3: THURSDAY
Bit 4: FRIDAY
Bit 5: SATURDAY
Bit 6: SUNDAY";
CM_ SG_ 238 VFC_TS00_ValidTimeRange1Start "Start time for the first time range in which the main traffic sign is valid. Minutes since midnight. Related to ISO 23150:2022(E): Sign text (A.2.102)";
CM_ SG_ 238 VFC_TS00_ValidTimeRange1End "End time for the first time range in which the main traffic sign is valid. Minutes since midnight. Related to ISO 23150:2022(E): Sign text (A.2.102)";
CM_ SG_ 238 VFC_TS00_ValidTimeRange2Start "Start time for the second time range in which the main traffic sign is valid. Minutes since midnight. Related to ISO 23150:2022(E): Sign text (A.2.102)";
CM_ SG_ 238 VFC_TS00_ValidTimeRange2End "End time for the second time range in which the main traffic sign is valid. Minutes since midnight. Related to ISO 23150:2022(E): Sign text (A.2.102)";
CM_ SG_ 238 VFC_TS00_ValidInDist "Indicates the longitudinal distance in which the validity of the main traffic sign starts. Unit is set in signal ValidInDistUnit. Related to ISO 23150:2022(E): Sign text (A.2.102)";
CM_ SG_ 238 VFC_TS00_ValidInDistUnit "Unit for signal ValidInDist. ISO 23150:2022(E): Sign value unit (A.2.101)";
CM_ SG_ 238 VFC_TS00_ValidSection "Indicates the longitudinal section for which the main traffic sign is valid. Unit is set in signal ValidSectionUnit. Related to ISO 23150:2022(E): Sign text (A.2.102)";
CM_ SG_ 238 VFC_TS00_ValidSectionUnit "Unit for signal ValidSection. ISO 23150:2022(E): Sign value unit (A.2.101)";
CM_ SG_ 238 VFC_TS00_NumValidSupSigns "Number of valid supplementary signs attached to the main sign. ISO 23150:2022(E): Number of valid traffic supplementary signs (A.2.149)";
CM_ SG_ 238 VFC_TS00_SupSign0ExistProb "Probability that the sign is a supplementary traffic sign. ISO 23150:2022(E): Existence probability - object level (A.2.1)";
CM_ SG_ 238 VFC_TS00_SupSign1ExistProb "Probability that the sign is a supplementary traffic sign. ISO 23150:2022(E): Existence probability - object level (A.2.1)";
CM_ SG_ 238 VFC_TS00_SupSign2ExistProb "Probability that the sign is a supplementary traffic sign. ISO 23150:2022(E): Existence probability - object level (A.2.1)";
CM_ SG_ 238 VFC_TS00_SupSign3ExistProb "Probability that the sign is a supplementary traffic sign. ISO 23150:2022(E): Existence probability - object level (A.2.1)";
CM_ SG_ 238 VFC_TS00_SupSign4ExistProb "Probability that the sign is a supplementary traffic sign. ISO 23150:2022(E): Existence probability - object level (A.2.1)";
CM_ SG_ 238 VFC_TS00_SupSign5ExistProb "Probability that the sign is a supplementary traffic sign. ISO 23150:2022(E): Existence probability - object level (A.2.1)";
CM_ SG_ 238 VFC_TS00_SupSign0Type "The type of supplementary sign. ISO 23150:2022(E): Supplementary sign classification type (A.2.151)";
CM_ SG_ 238 VFC_TS00_SupSign1Type "The type of supplementary sign. ISO 23150:2022(E): Supplementary sign classification type (A.2.151)";
CM_ SG_ 238 VFC_TS00_SupSign2Type "The type of supplementary sign. ISO 23150:2022(E): Supplementary sign classification type (A.2.151)";
CM_ SG_ 238 VFC_TS00_SupSign3Type "The type of supplementary sign. ISO 23150:2022(E): Supplementary sign classification type (A.2.151)";
CM_ SG_ 238 VFC_TS00_SupSign4Type "The type of supplementary sign. ISO 23150:2022(E): Supplementary sign classification type (A.2.151)";
CM_ SG_ 238 VFC_TS00_SupSign5Type "The type of supplementary sign. ISO 23150:2022(E): Supplementary sign classification type (A.2.151)";
CM_ SG_ 238 VFC_TS01_ObjId "Unique Traffic Sign ID. ISO 23150:2022(E): Object ID (A.2.2)";
CM_ SG_ 238 VFC_TS01_Type "The type of main sign. ISO 23150:2022(E): Sign classification type (A.2.98)";
CM_ SG_ 238 VFC_TS01_ExistProb "Probability that the sign is a traffic sign. ISO 23150:2022(E): Existence probability - object level (A.2.1)";
CM_ SG_ 238 VFC_TS01_Px "Traffic sign position in longitudinal direction. ISO 23150:2022(E): Position - object level {x, y, z} (A.2.15)";
CM_ SG_ 238 VFC_TS01_Py "Traffic sign position in lateral direction. ISO 23150:2022(E): Position - object level {x, y, z} (A.2.15)";
CM_ SG_ 238 VFC_TS01_Pz "Traffic sign position in vertical direction. ISO 23150:2022(E): Position - object level {x, y, z} (A.2.15)";
CM_ SG_ 238 VFC_TS01_PxStdDev "Standard deviation of Traffic sign position in longitudinal direction. ISO 23150:2022(E): Position - object level {x, y, z} - error (A.2.16)";
CM_ SG_ 238 VFC_TS01_Width "Width of the traffic sign. ISO 23150:2022(E): Bounding box extent {length, width, height} (A.2.20)";
CM_ SG_ 238 VFC_TS01_Height "Height of the traffic sign. ISO 23150:2022(E): Bounding box extent {length, width, height} (A.2.20)";
CM_ SG_ 238 VFC_TS01_EmbeddedInfo "Information how the sign is embedded or not";
CM_ SG_ 238 VFC_TS01_ValidLane "Indicates on which lane the detected sign is valid. If traffic sign is generally valid, all bits shall be set. No relevance to ego lane, signal related to ISO 23150:2022(E): Lane relevance classification type (A.2.147)
Bitfield:
Bit 0: valid on first right hand lane
Bit 1: valid on second right hand lane
Bit 2: valid on third right hand lane
Bit 3: valid on fourth right hand lane
Bit 4: valid on fifth right hand lane";
CM_ SG_ 238 VFC_TS01_ValidDay "The week days for which the main traffic sign is valid. If traffic sign is generally valid, all bits shall be set. Related to ISO 23150:2022(E): Sign text (A.2.102)
Bitfield:
Bit 0: MONDAY
Bit 1: TUESDAY
Bit 2: WEDNESDAY
Bit 3: THURSDAY
Bit 4: FRIDAY
Bit 5: SATURDAY
Bit 6: SUNDAY";
CM_ SG_ 238 VFC_TS01_ValidTimeRange1Start "Start time for the first time range in which the main traffic sign is valid. Minutes since midnight. Related to ISO 23150:2022(E): Sign text (A.2.102)";
CM_ SG_ 238 VFC_TS01_ValidTimeRange1End "End time for the first time range in which the main traffic sign is valid. Minutes since midnight. Related to ISO 23150:2022(E): Sign text (A.2.102)";
CM_ SG_ 238 VFC_TS01_ValidTimeRange2Start "Start time for the second time range in which the main traffic sign is valid. Minutes since midnight. Related to ISO 23150:2022(E): Sign text (A.2.102)";
CM_ SG_ 238 VFC_TS01_ValidTimeRange2End "End time for the second time range in which the main traffic sign is valid. Minutes since midnight. Related to ISO 23150:2022(E): Sign text (A.2.102)";
CM_ SG_ 238 VFC_TS01_ValidInDist "Indicates the longitudinal distance in which the validity of the main traffic sign starts. Unit is set in signal ValidInDistUnit. Related to ISO 23150:2022(E): Sign text (A.2.102)";
CM_ SG_ 238 VFC_TS01_ValidInDistUnit "Unit for signal ValidInDist. ISO 23150:2022(E): Sign value unit (A.2.101)";
CM_ SG_ 238 VFC_TS01_ValidSection "Indicates the longitudinal section for which the main traffic sign is valid. Unit is set in signal ValidSectionUnit. Related to ISO 23150:2022(E): Sign text (A.2.102)";
CM_ SG_ 238 VFC_TS01_ValidSectionUnit "Unit for signal ValidSection. ISO 23150:2022(E): Sign value unit (A.2.101)";
CM_ SG_ 238 VFC_TS01_NumValidSupSigns "Number of valid supplementary signs attached to the main sign. ISO 23150:2022(E): Number of valid traffic supplementary signs (A.2.149)";
CM_ SG_ 238 VFC_TS01_SupSign0ExistProb "Probability that the sign is a supplementary traffic sign. ISO 23150:2022(E): Existence probability - object level (A.2.1)";
CM_ SG_ 238 VFC_TS01_SupSign1ExistProb "Probability that the sign is a supplementary traffic sign. ISO 23150:2022(E): Existence probability - object level (A.2.1)";
CM_ SG_ 238 VFC_TS01_SupSign2ExistProb "Probability that the sign is a supplementary traffic sign. ISO 23150:2022(E): Existence probability - object level (A.2.1)";
CM_ SG_ 238 VFC_TS01_SupSign3ExistProb "Probability that the sign is a supplementary traffic sign. ISO 23150:2022(E): Existence probability - object level (A.2.1)";
CM_ SG_ 238 VFC_TS01_SupSign4ExistProb "Probability that the sign is a supplementary traffic sign. ISO 23150:2022(E): Existence probability - object level (A.2.1)";
CM_ SG_ 238 VFC_TS01_SupSign5ExistProb "Probability that the sign is a supplementary traffic sign. ISO 23150:2022(E): Existence probability - object level (A.2.1)";
CM_ SG_ 238 VFC_TS01_SupSign0Type "The type of supplementary sign. ISO 23150:2022(E): Supplementary sign classification type (A.2.151)";
CM_ SG_ 238 VFC_TS01_SupSign1Type "The type of supplementary sign. ISO 23150:2022(E): Supplementary sign classification type (A.2.151)";
CM_ SG_ 238 VFC_TS01_SupSign2Type "The type of supplementary sign. ISO 23150:2022(E): Supplementary sign classification type (A.2.151)";
CM_ SG_ 238 VFC_TS01_SupSign3Type "The type of supplementary sign. ISO 23150:2022(E): Supplementary sign classification type (A.2.151)";
CM_ SG_ 238 VFC_TS01_SupSign4Type "The type of supplementary sign. ISO 23150:2022(E): Supplementary sign classification type (A.2.151)";
CM_ SG_ 238 VFC_TS01_SupSign5Type "The type of supplementary sign. ISO 23150:2022(E): Supplementary sign classification type (A.2.151)";
CM_ SG_ 239 VFC_TS_02_03_CRC "CRC - Autosar E2E Profile 5";
CM_ SG_ 239 VFC_TS_02_03_AliveCtr "Alive counter - Autosar E2E Profile 5";
CM_ SG_ 239 VFC_TS_02_03_ProtBlockCtr "Protocol-Signal: Block-Counter";
CM_ SG_ 239 VFC_TS02_ObjId "Unique Traffic Sign ID. ISO 23150:2022(E): Object ID (A.2.2)";
CM_ SG_ 239 VFC_TS02_Type "The type of main sign. ISO 23150:2022(E): Sign classification type (A.2.98)";
CM_ SG_ 239 VFC_TS02_ExistProb "Probability that the sign is a traffic sign. ISO 23150:2022(E): Existence probability - object level (A.2.1)";
CM_ SG_ 239 VFC_TS02_Px "Traffic sign position in longitudinal direction. ISO 23150:2022(E): Position - object level {x, y, z} (A.2.15)";
CM_ SG_ 239 VFC_TS02_Py "Traffic sign position in lateral direction. ISO 23150:2022(E): Position - object level {x, y, z} (A.2.15)";
CM_ SG_ 239 VFC_TS02_Pz "Traffic sign position in vertical direction. ISO 23150:2022(E): Position - object level {x, y, z} (A.2.15)";
CM_ SG_ 239 VFC_TS02_PxStdDev "Standard deviation of Traffic sign position in longitudinal direction. ISO 23150:2022(E): Position - object level {x, y, z} - error (A.2.16)";
CM_ SG_ 239 VFC_TS02_Width "Width of the traffic sign. ISO 23150:2022(E): Bounding box extent {length, width, height} (A.2.20)";
CM_ SG_ 239 VFC_TS02_Height "Height of the traffic sign. ISO 23150:2022(E): Bounding box extent {length, width, height} (A.2.20)";
CM_ SG_ 239 VFC_TS02_EmbeddedInfo "Information how the sign is embedded or not";
CM_ SG_ 239 VFC_TS02_ValidLane "Indicates on which lane the detected sign is valid. If traffic sign is generally valid, all bits shall be set. No relevance to ego lane, signal related to ISO 23150:2022(E): Lane relevance classification type (A.2.147)
Bitfield:
Bit 0: valid on first right hand lane
Bit 1: valid on second right hand lane
Bit 2: valid on third right hand lane
Bit 3: valid on fourth right hand lane
Bit 4: valid on fifth right hand lane";
CM_ SG_ 239 VFC_TS02_ValidDay "The week days for which the main traffic sign is valid. If traffic sign is generally valid, all bits shall be set. Related to ISO 23150:2022(E): Sign text (A.2.102)
Bitfield:
Bit 0: MONDAY
Bit 1: TUESDAY
Bit 2: WEDNESDAY
Bit 3: THURSDAY
Bit 4: FRIDAY
Bit 5: SATURDAY
Bit 6: SUNDAY";
CM_ SG_ 239 VFC_TS02_ValidTimeRange1Start "Start time for the first time range in which the main traffic sign is valid. Minutes since midnight. Related to ISO 23150:2022(E): Sign text (A.2.102)";
CM_ SG_ 239 VFC_TS02_ValidTimeRange1End "End time for the first time range in which the main traffic sign is valid. Minutes since midnight. Related to ISO 23150:2022(E): Sign text (A.2.102)";
CM_ SG_ 239 VFC_TS02_ValidTimeRange2Start "Start time for the second time range in which the main traffic sign is valid. Minutes since midnight. Related to ISO 23150:2022(E): Sign text (A.2.102)";
CM_ SG_ 239 VFC_TS02_ValidTimeRange2End "End time for the second time range in which the main traffic sign is valid. Minutes since midnight. Related to ISO 23150:2022(E): Sign text (A.2.102)";
CM_ SG_ 239 VFC_TS02_ValidInDist "Indicates the longitudinal distance in which the validity of the main traffic sign starts. Unit is set in signal ValidInDistUnit. Related to ISO 23150:2022(E): Sign text (A.2.102)";
CM_ SG_ 239 VFC_TS02_ValidInDistUnit "Unit for signal ValidInDist. ISO 23150:2022(E): Sign value unit (A.2.101)";
CM_ SG_ 239 VFC_TS02_ValidSection "Indicates the longitudinal section for which the main traffic sign is valid. Unit is set in signal ValidSectionUnit. Related to ISO 23150:2022(E): Sign text (A.2.102)";
CM_ SG_ 239 VFC_TS02_ValidSectionUnit "Unit for signal ValidSection. ISO 23150:2022(E): Sign value unit (A.2.101)";
CM_ SG_ 239 VFC_TS02_NumValidSupSigns "Number of valid supplementary signs attached to the main sign. ISO 23150:2022(E): Number of valid traffic supplementary signs (A.2.149)";
CM_ SG_ 239 VFC_TS02_SupSign0ExistProb "Probability that the sign is a supplementary traffic sign. ISO 23150:2022(E): Existence probability - object level (A.2.1)";
CM_ SG_ 239 VFC_TS02_SupSign1ExistProb "Probability that the sign is a supplementary traffic sign. ISO 23150:2022(E): Existence probability - object level (A.2.1)";
CM_ SG_ 239 VFC_TS02_SupSign2ExistProb "Probability that the sign is a supplementary traffic sign. ISO 23150:2022(E): Existence probability - object level (A.2.1)";
CM_ SG_ 239 VFC_TS02_SupSign3ExistProb "Probability that the sign is a supplementary traffic sign. ISO 23150:2022(E): Existence probability - object level (A.2.1)";
CM_ SG_ 239 VFC_TS02_SupSign4ExistProb "Probability that the sign is a supplementary traffic sign. ISO 23150:2022(E): Existence probability - object level (A.2.1)";
CM_ SG_ 239 VFC_TS02_SupSign5ExistProb "Probability that the sign is a supplementary traffic sign. ISO 23150:2022(E): Existence probability - object level (A.2.1)";
CM_ SG_ 239 VFC_TS02_SupSign0Type "The type of supplementary sign. ISO 23150:2022(E): Supplementary sign classification type (A.2.151)";
CM_ SG_ 239 VFC_TS02_SupSign1Type "The type of supplementary sign. ISO 23150:2022(E): Supplementary sign classification type (A.2.151)";
CM_ SG_ 239 VFC_TS02_SupSign2Type "The type of supplementary sign. ISO 23150:2022(E): Supplementary sign classification type (A.2.151)";
CM_ SG_ 239 VFC_TS02_SupSign3Type "The type of supplementary sign. ISO 23150:2022(E): Supplementary sign classification type (A.2.151)";
CM_ SG_ 239 VFC_TS02_SupSign4Type "The type of supplementary sign. ISO 23150:2022(E): Supplementary sign classification type (A.2.151)";
CM_ SG_ 239 VFC_TS02_SupSign5Type "The type of supplementary sign. ISO 23150:2022(E): Supplementary sign classification type (A.2.151)";
CM_ SG_ 239 VFC_TS03_ObjId "Unique Traffic Sign ID. ISO 23150:2022(E): Object ID (A.2.2)";
CM_ SG_ 239 VFC_TS03_Type "The type of main sign. ISO 23150:2022(E): Sign classification type (A.2.98)";
CM_ SG_ 239 VFC_TS03_ExistProb "Probability that the sign is a traffic sign. ISO 23150:2022(E): Existence probability - object level (A.2.1)";
CM_ SG_ 239 VFC_TS03_Px "Traffic sign position in longitudinal direction. ISO 23150:2022(E): Position - object level {x, y, z} (A.2.15)";
CM_ SG_ 239 VFC_TS03_Py "Traffic sign position in lateral direction. ISO 23150:2022(E): Position - object level {x, y, z} (A.2.15)";
CM_ SG_ 239 VFC_TS03_Pz "Traffic sign position in vertical direction. ISO 23150:2022(E): Position - object level {x, y, z} (A.2.15)";
CM_ SG_ 239 VFC_TS03_PxStdDev "Standard deviation of Traffic sign position in longitudinal direction. ISO 23150:2022(E): Position - object level {x, y, z} - error (A.2.16)";
CM_ SG_ 239 VFC_TS03_Width "Width of the traffic sign. ISO 23150:2022(E): Bounding box extent {length, width, height} (A.2.20)";
CM_ SG_ 239 VFC_TS03_Height "Height of the traffic sign. ISO 23150:2022(E): Bounding box extent {length, width, height} (A.2.20)";
CM_ SG_ 239 VFC_TS03_EmbeddedInfo "Information how the sign is embedded or not";
CM_ SG_ 239 VFC_TS03_ValidLane "Indicates on which lane the detected sign is valid. If traffic sign is generally valid, all bits shall be set. No relevance to ego lane, signal related to ISO 23150:2022(E): Lane relevance classification type (A.2.147)
Bitfield:
Bit 0: valid on first right hand lane
Bit 1: valid on second right hand lane
Bit 2: valid on third right hand lane
Bit 3: valid on fourth right hand lane
Bit 4: valid on fifth right hand lane";
CM_ SG_ 239 VFC_TS03_ValidDay "The week days for which the main traffic sign is valid. If traffic sign is generally valid, all bits shall be set. Related to ISO 23150:2022(E): Sign text (A.2.102)
Bitfield:
Bit 0: MONDAY
Bit 1: TUESDAY
Bit 2: WEDNESDAY
Bit 3: THURSDAY
Bit 4: FRIDAY
Bit 5: SATURDAY
Bit 6: SUNDAY";
CM_ SG_ 239 VFC_TS03_ValidTimeRange1Start "Start time for the first time range in which the main traffic sign is valid. Minutes since midnight. Related to ISO 23150:2022(E): Sign text (A.2.102)";
CM_ SG_ 239 VFC_TS03_ValidTimeRange1End "End time for the first time range in which the main traffic sign is valid. Minutes since midnight. Related to ISO 23150:2022(E): Sign text (A.2.102)";
CM_ SG_ 239 VFC_TS03_ValidTimeRange2Start "Start time for the second time range in which the main traffic sign is valid. Minutes since midnight. Related to ISO 23150:2022(E): Sign text (A.2.102)";
CM_ SG_ 239 VFC_TS03_ValidTimeRange2End "End time for the second time range in which the main traffic sign is valid. Minutes since midnight. Related to ISO 23150:2022(E): Sign text (A.2.102)";
CM_ SG_ 239 VFC_TS03_ValidInDist "Indicates the longitudinal distance in which the validity of the main traffic sign starts. Unit is set in signal ValidInDistUnit. Related to ISO 23150:2022(E): Sign text (A.2.102)";
CM_ SG_ 239 VFC_TS03_ValidInDistUnit "Unit for signal ValidInDist. ISO 23150:2022(E): Sign value unit (A.2.101)";
CM_ SG_ 239 VFC_TS03_ValidSection "Indicates the longitudinal section for which the main traffic sign is valid. Unit is set in signal ValidSectionUnit. Related to ISO 23150:2022(E): Sign text (A.2.102)";
CM_ SG_ 239 VFC_TS03_ValidSectionUnit "Unit for signal ValidSection. ISO 23150:2022(E): Sign value unit (A.2.101)";
CM_ SG_ 239 VFC_TS03_NumValidSupSigns "Number of valid supplementary signs attached to the main sign. ISO 23150:2022(E): Number of valid traffic supplementary signs (A.2.149)";
CM_ SG_ 239 VFC_TS03_SupSign0ExistProb "Probability that the sign is a supplementary traffic sign. ISO 23150:2022(E): Existence probability - object level (A.2.1)";
CM_ SG_ 239 VFC_TS03_SupSign1ExistProb "Probability that the sign is a supplementary traffic sign. ISO 23150:2022(E): Existence probability - object level (A.2.1)";
CM_ SG_ 239 VFC_TS03_SupSign2ExistProb "Probability that the sign is a supplementary traffic sign. ISO 23150:2022(E): Existence probability - object level (A.2.1)";
CM_ SG_ 239 VFC_TS03_SupSign3ExistProb "Probability that the sign is a supplementary traffic sign. ISO 23150:2022(E): Existence probability - object level (A.2.1)";
CM_ SG_ 239 VFC_TS03_SupSign4ExistProb "Probability that the sign is a supplementary traffic sign. ISO 23150:2022(E): Existence probability - object level (A.2.1)";
CM_ SG_ 239 VFC_TS03_SupSign5ExistProb "Probability that the sign is a supplementary traffic sign. ISO 23150:2022(E): Existence probability - object level (A.2.1)";
CM_ SG_ 239 VFC_TS03_SupSign0Type "The type of supplementary sign. ISO 23150:2022(E): Supplementary sign classification type (A.2.151)";
CM_ SG_ 239 VFC_TS03_SupSign1Type "The type of supplementary sign. ISO 23150:2022(E): Supplementary sign classification type (A.2.151)";
CM_ SG_ 239 VFC_TS03_SupSign2Type "The type of supplementary sign. ISO 23150:2022(E): Supplementary sign classification type (A.2.151)";
CM_ SG_ 239 VFC_TS03_SupSign3Type "The type of supplementary sign. ISO 23150:2022(E): Supplementary sign classification type (A.2.151)";
CM_ SG_ 239 VFC_TS03_SupSign4Type "The type of supplementary sign. ISO 23150:2022(E): Supplementary sign classification type (A.2.151)";
CM_ SG_ 239 VFC_TS03_SupSign5Type "The type of supplementary sign. ISO 23150:2022(E): Supplementary sign classification type (A.2.151)";
BA_DEF_ BO_  "CANFD_BRS" ENUM  "0","1";
BA_DEF_ BO_  "GenMsgCycleTime" INT 0 65535;
BA_DEF_ BO_  "GenMsgILSupport" ENUM  "No","Yes";
BA_DEF_ BO_  "GenMsgSendType" ENUM  "Cyclic","Event","reserved","reserved","reserved","reserved","reserved","IfActive","NoMsgSendType","reserved","reserved","reserved";
BA_DEF_ BO_  "VFrameFormat" ENUM  "StandardCAN","ExtendedCAN","reserved","reserved","reserved","reserved","reserved","reserved","reserved","reserved","reserved","reserved","reserved","reserved","StandardCAN_FD","ExtendedCAN_FD";
BA_DEF_ BO_  "E2Eprofile" STRING ;
BA_DEF_ BO_  "DataID" HEX 0 655535;
BA_DEF_ SG_  "GenSigSendType" ENUM  "Cyclic","OnWrite","OnWriteWithRepetition","OnChange","OnChangeWithRepetition","IfActive","IfActiveWithRepetition","NoSigSendType","OnChangeAndIfActive","OnChangeAndIfActiveWithRepetition";
BA_DEF_ SG_  "GenSigStartValue" HEX 0 2147483648;
BA_DEF_DEF_  "CANFD_BRS" "1";
BA_DEF_DEF_  "GenMsgCycleTime" 0;
BA_DEF_DEF_  "GenMsgILSupport" "Yes";
BA_DEF_DEF_  "GenMsgSendType" "Cyclic";
BA_DEF_DEF_  "VFrameFormat" "";
BA_DEF_DEF_  "E2Eprofile" "None";
BA_DEF_DEF_  "DataID" 0;
BA_DEF_DEF_  "GenSigSendType" "NoSigSendType";
BA_DEF_DEF_  "GenSigStartValue" 0;
BA_ "GenMsgSendType" BO_ 178 1;
BA_ "E2Eprofile" BO_ 178 "AUTOSAR Profile 5";
BA_ "DataID" BO_ 178 8370;
BA_ "VFrameFormat" BO_ 178 14;
BA_ "GenMsgSendType" BO_ 224 1;
BA_ "E2Eprofile" BO_ 224 "AUTOSAR Profile 5";
BA_ "DataID" BO_ 224 8416;
BA_ "VFrameFormat" BO_ 224 14;
BA_ "GenMsgSendType" BO_ 226 1;
BA_ "E2Eprofile" BO_ 226 "AUTOSAR Profile 5";
BA_ "DataID" BO_ 226 8418;
BA_ "VFrameFormat" BO_ 226 14;
BA_ "GenMsgSendType" BO_ 227 1;
BA_ "E2Eprofile" BO_ 227 "AUTOSAR Profile 5";
BA_ "DataID" BO_ 227 8419;
BA_ "VFrameFormat" BO_ 227 14;
BA_ "GenMsgSendType" BO_ 236 1;
BA_ "E2Eprofile" BO_ 236 "AUTOSAR Profile 5";
BA_ "DataID" BO_ 236 8428;
BA_ "VFrameFormat" BO_ 236 14;
BA_ "GenMsgSendType" BO_ 238 1;
BA_ "E2Eprofile" BO_ 238 "AUTOSAR Profile 5";
BA_ "DataID" BO_ 238 8430;
BA_ "VFrameFormat" BO_ 238 14;
BA_ "GenMsgSendType" BO_ 239 1;
BA_ "E2Eprofile" BO_ 239 "AUTOSAR Profile 5";
BA_ "DataID" BO_ 239 8431;
BA_ "VFrameFormat" BO_ 239 14;
BA_ "GenSigStartValue" SG_ 178 VFC_RM00_VertexPoint00y 256;
BA_ "GenSigStartValue" SG_ 178 VFC_RM00_VertexPoint01y 256;
BA_ "GenSigStartValue" SG_ 178 VFC_RM01_VertexPoint00y 256;
BA_ "GenSigStartValue" SG_ 178 VFC_RM01_VertexPoint01y 256;
BA_ "GenSigStartValue" SG_ 178 VFC_RM02_VertexPoint00y 256;
BA_ "GenSigStartValue" SG_ 178 VFC_RM02_VertexPoint01y 256;
BA_ "GenSigStartValue" SG_ 178 VFC_RM03_VertexPoint00y 256;
BA_ "GenSigStartValue" SG_ 178 VFC_RM03_VertexPoint01y 256;
BA_ "GenSigStartValue" SG_ 178 VFC_RM04_VertexPoint00y 256;
BA_ "GenSigStartValue" SG_ 178 VFC_RM04_VertexPoint01y 256;
BA_ "GenSigStartValue" SG_ 178 VFC_RM05_VertexPoint00y 256;
BA_ "GenSigStartValue" SG_ 178 VFC_RM05_VertexPoint01y 256;
BA_ "GenSigStartValue" SG_ 178 VFC_RM06_VertexPoint00y 256;
BA_ "GenSigStartValue" SG_ 178 VFC_RM06_VertexPoint01y 256;
BA_ "GenSigStartValue" SG_ 224 VFC_TLHdr_IfVersionIdMajor 1;
BA_ "GenSigStartValue" SG_ 224 VFC_TLHdr_IfVersionIdMinor 3;
BA_ "GenSigStartValue" SG_ 226 VFC_TL00_Py 512;
BA_ "GenSigStartValue" SG_ 226 VFC_TL00_2DLeftEdge 2048;
BA_ "GenSigStartValue" SG_ 226 VFC_TL00_2DTopEdge 1024;
BA_ "GenSigStartValue" SG_ 226 VFC_TL01_Py 512;
BA_ "GenSigStartValue" SG_ 226 VFC_TL01_2DLeftEdge 2048;
BA_ "GenSigStartValue" SG_ 226 VFC_TL01_2DTopEdge 1024;
BA_ "GenSigStartValue" SG_ 226 VFC_TL02_Py 512;
BA_ "GenSigStartValue" SG_ 226 VFC_TL02_2DLeftEdge 2048;
BA_ "GenSigStartValue" SG_ 226 VFC_TL02_2DTopEdge 1024;
BA_ "GenSigStartValue" SG_ 226 VFC_TL03_Py 512;
BA_ "GenSigStartValue" SG_ 226 VFC_TL03_2DLeftEdge 2048;
BA_ "GenSigStartValue" SG_ 226 VFC_TL03_2DTopEdge 1024;
BA_ "GenSigStartValue" SG_ 226 VFC_TL04_Py 512;
BA_ "GenSigStartValue" SG_ 226 VFC_TL04_2DLeftEdge 2048;
BA_ "GenSigStartValue" SG_ 226 VFC_TL04_2DTopEdge 1024;
BA_ "GenSigStartValue" SG_ 227 VFC_TL05_Py 512;
BA_ "GenSigStartValue" SG_ 227 VFC_TL05_2DLeftEdge 2048;
BA_ "GenSigStartValue" SG_ 227 VFC_TL05_2DTopEdge 1024;
BA_ "GenSigStartValue" SG_ 227 VFC_TL06_Py 512;
BA_ "GenSigStartValue" SG_ 227 VFC_TL06_2DLeftEdge 2048;
BA_ "GenSigStartValue" SG_ 227 VFC_TL06_2DTopEdge 1024;
BA_ "GenSigStartValue" SG_ 227 VFC_TL07_Py 512;
BA_ "GenSigStartValue" SG_ 227 VFC_TL07_2DLeftEdge 2048;
BA_ "GenSigStartValue" SG_ 227 VFC_TL07_2DTopEdge 1024;
BA_ "GenSigStartValue" SG_ 227 VFC_TL08_Py 512;
BA_ "GenSigStartValue" SG_ 227 VFC_TL08_2DLeftEdge 2048;
BA_ "GenSigStartValue" SG_ 227 VFC_TL08_2DTopEdge 1024;
BA_ "GenSigStartValue" SG_ 227 VFC_TL09_Py 512;
BA_ "GenSigStartValue" SG_ 227 VFC_TL09_2DLeftEdge 2048;
BA_ "GenSigStartValue" SG_ 227 VFC_TL09_2DTopEdge 1024;
BA_ "GenSigStartValue" SG_ 236 VFC_TSHdr_IfVersionIdMajor 1;
BA_ "GenSigStartValue" SG_ 236 VFC_TSHdr_IfVersionIdMinor 1;
BA_ "GenSigStartValue" SG_ 238 VFC_TS00_Py 128;
BA_ "GenSigStartValue" SG_ 238 VFC_TS01_Py 128;
BA_ "GenSigStartValue" SG_ 239 VFC_TS02_Py 128;
BA_ "GenSigStartValue" SG_ 239 VFC_TS03_Py 128;
VAL_ 178 VFC_RM00_Type 0 "Stop_Line" 1 "Zebra_Crossing_Start" 2 "Zebra_Crossing_End" 3 "Arrow_Forward" 4 "Arrow_Left" 5 "Arrow_Right" 6 "Arrow_Straight_Left" 7 "Arrow_Straight_Right" 8 "Arrow_Turning_Point_Left" 9 "Arrow_Turning_Point_Right" 10 "Arrow_45_Deg_Left" 11 "Arrow_45_Deg_Right" 12 "Virtual_Stop_Area_Begin" 13 "Virtual_Stop_Area_End" 14 "Virtual_Braking_Area_Begin" 15 "Virtual_Braking_Area_End" 16 "Reserved16" 17 "Reserved17" 18 "Reserved18" 19 "Reserved19" 20 "Reserved20" 21 "Reserved21" 22 "Reserved22" 23 "Reserved23" 24 "Reserved24" 25 "Reserved25" 26 "Reserved26" 27 "Reserved27" 28 "Reserved28" 29 "Reserved29" 30 "Reserved30" 31 "Reserved31" ;
VAL_ 178 VFC_RM01_Type 0 "Stop_Line" 1 "Zebra_Crossing_Start" 2 "Zebra_Crossing_End" 3 "Arrow_Forward" 4 "Arrow_Left" 5 "Arrow_Right" 6 "Arrow_Straight_Left" 7 "Arrow_Straight_Right" 8 "Arrow_Turning_Point_Left" 9 "Arrow_Turning_Point_Right" 10 "Arrow_45_Deg_Left" 11 "Arrow_45_Deg_Right" 12 "Virtual_Stop_Area_Begin" 13 "Virtual_Stop_Area_End" 14 "Virtual_Braking_Area_Begin" 15 "Virtual_Braking_Area_End" 16 "Reserved16" 17 "Reserved17" 18 "Reserved18" 19 "Reserved19" 20 "Reserved20" 21 "Reserved21" 22 "Reserved22" 23 "Reserved23" 24 "Reserved24" 25 "Reserved25" 26 "Reserved26" 27 "Reserved27" 28 "Reserved28" 29 "Reserved29" 30 "Reserved30" 31 "Reserved31" ;
VAL_ 178 VFC_RM02_Type 0 "Stop_Line" 1 "Zebra_Crossing_Start" 2 "Zebra_Crossing_End" 3 "Arrow_Forward" 4 "Arrow_Left" 5 "Arrow_Right" 6 "Arrow_Straight_Left" 7 "Arrow_Straight_Right" 8 "Arrow_Turning_Point_Left" 9 "Arrow_Turning_Point_Right" 10 "Arrow_45_Deg_Left" 11 "Arrow_45_Deg_Right" 12 "Virtual_Stop_Area_Begin" 13 "Virtual_Stop_Area_End" 14 "Virtual_Braking_Area_Begin" 15 "Virtual_Braking_Area_End" 16 "Reserved16" 17 "Reserved17" 18 "Reserved18" 19 "Reserved19" 20 "Reserved20" 21 "Reserved21" 22 "Reserved22" 23 "Reserved23" 24 "Reserved24" 25 "Reserved25" 26 "Reserved26" 27 "Reserved27" 28 "Reserved28" 29 "Reserved29" 30 "Reserved30" 31 "Reserved31" ;
VAL_ 178 VFC_RM03_Type 0 "Stop_Line" 1 "Zebra_Crossing_Start" 2 "Zebra_Crossing_End" 3 "Arrow_Forward" 4 "Arrow_Left" 5 "Arrow_Right" 6 "Arrow_Straight_Left" 7 "Arrow_Straight_Right" 8 "Arrow_Turning_Point_Left" 9 "Arrow_Turning_Point_Right" 10 "Arrow_45_Deg_Left" 11 "Arrow_45_Deg_Right" 12 "Virtual_Stop_Area_Begin" 13 "Virtual_Stop_Area_End" 14 "Virtual_Braking_Area_Begin" 15 "Virtual_Braking_Area_End" 16 "Reserved16" 17 "Reserved17" 18 "Reserved18" 19 "Reserved19" 20 "Reserved20" 21 "Reserved21" 22 "Reserved22" 23 "Reserved23" 24 "Reserved24" 25 "Reserved25" 26 "Reserved26" 27 "Reserved27" 28 "Reserved28" 29 "Reserved29" 30 "Reserved30" 31 "Reserved31" ;
VAL_ 178 VFC_RM04_Type 0 "Stop_Line" 1 "Zebra_Crossing_Start" 2 "Zebra_Crossing_End" 3 "Arrow_Forward" 4 "Arrow_Left" 5 "Arrow_Right" 6 "Arrow_Straight_Left" 7 "Arrow_Straight_Right" 8 "Arrow_Turning_Point_Left" 9 "Arrow_Turning_Point_Right" 10 "Arrow_45_Deg_Left" 11 "Arrow_45_Deg_Right" 12 "Virtual_Stop_Area_Begin" 13 "Virtual_Stop_Area_End" 14 "Virtual_Braking_Area_Begin" 15 "Virtual_Braking_Area_End" 16 "Reserved16" 17 "Reserved17" 18 "Reserved18" 19 "Reserved19" 20 "Reserved20" 21 "Reserved21" 22 "Reserved22" 23 "Reserved23" 24 "Reserved24" 25 "Reserved25" 26 "Reserved26" 27 "Reserved27" 28 "Reserved28" 29 "Reserved29" 30 "Reserved30" 31 "Reserved31" ;
VAL_ 178 VFC_RM05_Type 0 "Stop_Line" 1 "Zebra_Crossing_Start" 2 "Zebra_Crossing_End" 3 "Arrow_Forward" 4 "Arrow_Left" 5 "Arrow_Right" 6 "Arrow_Straight_Left" 7 "Arrow_Straight_Right" 8 "Arrow_Turning_Point_Left" 9 "Arrow_Turning_Point_Right" 10 "Arrow_45_Deg_Left" 11 "Arrow_45_Deg_Right" 12 "Virtual_Stop_Area_Begin" 13 "Virtual_Stop_Area_End" 14 "Virtual_Braking_Area_Begin" 15 "Virtual_Braking_Area_End" 16 "Reserved16" 17 "Reserved17" 18 "Reserved18" 19 "Reserved19" 20 "Reserved20" 21 "Reserved21" 22 "Reserved22" 23 "Reserved23" 24 "Reserved24" 25 "Reserved25" 26 "Reserved26" 27 "Reserved27" 28 "Reserved28" 29 "Reserved29" 30 "Reserved30" 31 "Reserved31" ;
VAL_ 178 VFC_RM06_Type 0 "Stop_Line" 1 "Zebra_Crossing_Start" 2 "Zebra_Crossing_End" 3 "Arrow_Forward" 4 "Arrow_Left" 5 "Arrow_Right" 6 "Arrow_Straight_Left" 7 "Arrow_Straight_Right" 8 "Arrow_Turning_Point_Left" 9 "Arrow_Turning_Point_Right" 10 "Arrow_45_Deg_Left" 11 "Arrow_45_Deg_Right" 12 "Virtual_Stop_Area_Begin" 13 "Virtual_Stop_Area_End" 14 "Virtual_Braking_Area_Begin" 15 "Virtual_Braking_Area_End" 16 "Reserved16" 17 "Reserved17" 18 "Reserved18" 19 "Reserved19" 20 "Reserved20" 21 "Reserved21" 22 "Reserved22" 23 "Reserved23" 24 "Reserved24" 25 "Reserved25" 26 "Reserved26" 27 "Reserved27" 28 "Reserved28" 29 "Reserved29" 30 "Reserved30" 31 "Reserved31" ;
VAL_ 224 VFC_TLHdr_State 0 "Off" 1 "On" 2 "Error" 3 "Reduced sight" 4 "Reserved4" 5 "Reserved5" 6 "Reserved6" 7 "Reserved7" ;
VAL_ 226 VFC_TL00_Colour 0 "unknown" 1 "red" 2 "green" 3 "yellow" ;
VAL_ 226 VFC_TL00_LightShapeType 0 "unknown" 1 "round" 2 "straightArrow" 3 "straightLeftArrow" 4 "straightRightArrow" 5 "leftArrow" 6 "rightArrow" 7 "downArrow" 8 "Counter" 9 "Reserved9" 10 "Reserved10" 11 "Reserved11" 12 "Reserved12" 13 "Reserved13" 14 "Reserved14" 15 "Reserved15" ;
VAL_ 226 VFC_TL00_LightModeType 0 "Continous" 1 "Blinking" 2 "Counting" 3 "Reserved" ;
VAL_ 226 VFC_TL01_Colour 0 "unknown" 1 "red" 2 "green" 3 "yellow" ;
VAL_ 226 VFC_TL01_LightShapeType 0 "unknown" 1 "round" 2 "straightArrow" 3 "straightLeftArrow" 4 "straightRightArrow" 5 "leftArrow" 6 "rightArrow" 7 "downArrow" 8 "Counter" 9 "Reserved9" 10 "Reserved10" 11 "Reserved11" 12 "Reserved12" 13 "Reserved13" 14 "Reserved14" 15 "Reserved15" ;
VAL_ 226 VFC_TL01_LightModeType 0 "Continous" 1 "Blinking" 2 "Counting" 3 "Reserved" ;
VAL_ 226 VFC_TL02_Colour 0 "unknown" 1 "red" 2 "green" 3 "yellow" ;
VAL_ 226 VFC_TL02_LightShapeType 0 "unknown" 1 "round" 2 "straightArrow" 3 "straightLeftArrow" 4 "straightRightArrow" 5 "leftArrow" 6 "rightArrow" 7 "downArrow" 8 "Counter" 9 "Reserved9" 10 "Reserved10" 11 "Reserved11" 12 "Reserved12" 13 "Reserved13" 14 "Reserved14" 15 "Reserved15" ;
VAL_ 226 VFC_TL02_LightModeType 0 "Continous" 1 "Blinking" 2 "Counting" 3 "Reserved" ;
VAL_ 226 VFC_TL03_Colour 0 "unknown" 1 "red" 2 "green" 3 "yellow" ;
VAL_ 226 VFC_TL03_LightShapeType 0 "unknown" 1 "round" 2 "straightArrow" 3 "straightLeftArrow" 4 "straightRightArrow" 5 "leftArrow" 6 "rightArrow" 7 "downArrow" 8 "Counter" 9 "Reserved9" 10 "Reserved10" 11 "Reserved11" 12 "Reserved12" 13 "Reserved13" 14 "Reserved14" 15 "Reserved15" ;
VAL_ 226 VFC_TL03_LightModeType 0 "Continous" 1 "Blinking" 2 "Counting" 3 "Reserved" ;
VAL_ 226 VFC_TL04_Colour 0 "unknown" 1 "red" 2 "green" 3 "yellow" ;
VAL_ 226 VFC_TL04_LightShapeType 0 "unknown" 1 "round" 2 "straightArrow" 3 "straightLeftArrow" 4 "straightRightArrow" 5 "leftArrow" 6 "rightArrow" 7 "downArrow" 8 "Counter" 9 "Reserved9" 10 "Reserved10" 11 "Reserved11" 12 "Reserved12" 13 "Reserved13" 14 "Reserved14" 15 "Reserved15" ;
VAL_ 226 VFC_TL04_LightModeType 0 "Continous" 1 "Blinking" 2 "Counting" 3 "Reserved" ;
VAL_ 227 VFC_TL05_Colour 0 "unknown" 1 "red" 2 "green" 3 "yellow" ;
VAL_ 227 VFC_TL05_LightShapeType 0 "unknown" 1 "round" 2 "straightArrow" 3 "straightLeftArrow" 4 "straightRightArrow" 5 "leftArrow" 6 "rightArrow" 7 "downArrow" 8 "Counter" 9 "Reserved9" 10 "Reserved10" 11 "Reserved11" 12 "Reserved12" 13 "Reserved13" 14 "Reserved14" 15 "Reserved15" ;
VAL_ 227 VFC_TL05_LightModeType 0 "Continous" 1 "Blinking" 2 "Counting" 3 "Reserved" ;
VAL_ 227 VFC_TL06_Colour 0 "unknown" 1 "red" 2 "green" 3 "yellow" ;
VAL_ 227 VFC_TL06_LightShapeType 0 "unknown" 1 "round" 2 "straightArrow" 3 "straightLeftArrow" 4 "straightRightArrow" 5 "leftArrow" 6 "rightArrow" 7 "downArrow" 8 "Counter" 9 "Reserved9" 10 "Reserved10" 11 "Reserved11" 12 "Reserved12" 13 "Reserved13" 14 "Reserved14" 15 "Reserved15" ;
VAL_ 227 VFC_TL06_LightModeType 0 "Continous" 1 "Blinking" 2 "Counting" 3 "Reserved" ;
VAL_ 227 VFC_TL07_Colour 0 "unknown" 1 "red" 2 "green" 3 "yellow" ;
VAL_ 227 VFC_TL07_LightShapeType 0 "unknown" 1 "round" 2 "straightArrow" 3 "straightLeftArrow" 4 "straightRightArrow" 5 "leftArrow" 6 "rightArrow" 7 "downArrow" 8 "Counter" 9 "Reserved9" 10 "Reserved10" 11 "Reserved11" 12 "Reserved12" 13 "Reserved13" 14 "Reserved14" 15 "Reserved15" ;
VAL_ 227 VFC_TL07_LightModeType 0 "Continous" 1 "Blinking" 2 "Counting" 3 "Reserved" ;
VAL_ 227 VFC_TL08_Colour 0 "unknown" 1 "red" 2 "green" 3 "yellow" ;
VAL_ 227 VFC_TL08_LightShapeType 0 "unknown" 1 "round" 2 "straightArrow" 3 "straightLeftArrow" 4 "straightRightArrow" 5 "leftArrow" 6 "rightArrow" 7 "downArrow" 8 "Counter" 9 "Reserved9" 10 "Reserved10" 11 "Reserved11" 12 "Reserved12" 13 "Reserved13" 14 "Reserved14" 15 "Reserved15" ;
VAL_ 227 VFC_TL08_LightModeType 0 "Continous" 1 "Blinking" 2 "Counting" 3 "Reserved" ;
VAL_ 227 VFC_TL09_Colour 0 "unknown" 1 "red" 2 "green" 3 "yellow" ;
VAL_ 227 VFC_TL09_LightShapeType 0 "unknown" 1 "round" 2 "straightArrow" 3 "straightLeftArrow" 4 "straightRightArrow" 5 "leftArrow" 6 "rightArrow" 7 "downArrow" 8 "Counter" 9 "Reserved9" 10 "Reserved10" 11 "Reserved11" 12 "Reserved12" 13 "Reserved13" 14 "Reserved14" 15 "Reserved15" ;
VAL_ 227 VFC_TL09_LightModeType 0 "Continous" 1 "Blinking" 2 "Counting" 3 "Reserved" ;
VAL_ 236 VFC_TSHdr_SensorStatus 0 "Off" 1 "On" 2 "Reduced" 3 "HW_Error" 4 "SW_Error" 5 "FID_Active" 6 "Reserved6" 7 "Reserved7" ;
VAL_ 236 VFC_TSHdr_CurrentRegion 0 "0 Unknown" 4 "Afghanistan" 8 "Albania" 10 "Antarctica" 12 "Algeria" 16 "American Samoa" 20 "Andorra" 24 "Angola" 28 "Antigua and Barbuda" 31 "Azerbaijan" 32 "Argentina" 36 "Australia" 40 "Austria" 44 "Bahamas (the)" 48 "Bahrain" 50 "Bangladesh" 51 "Armenia" 52 "Barbados" 56 "Belgium" 60 "Bermuda" 64 "Bhutan" 68 "Bolivia (Plurinational State of)" 70 "Bosnia and Herzegovina" 72 "Botswana" 74 "Bouvet Island" 76 "Brazil" 84 "Belize" 86 "British Indian Ocean Territory (the)" 90 "Solomon Islands" 92 "Virgin Islands (British)" 96 "Brunei Darussalam" 100 "Bulgaria" 104 "Myanmar" 108 "Burundi" 112 "Belarus" 116 "Cambodia" 120 "Cameroon" 124 "Canada" 132 "Cabo Verde" 136 "Cayman Islands (the)" 140 "Central African Republic (the)" 144 "Sri Lanka" 148 "Chad" 152 "Chile" 156 "China" 158 "Taiwan (Province of China)" 162 "Christmas Island" 166 "Cocos (Keeling) Islands (the)" 170 "Colombia" 174 "Comoros (the)" 175 "Mayotte" 178 "Congo (the)" 180 "Congo (the Democratic Republic of the)" 184 "Cook Islands (the)" 188 "Costa Rica" 191 "Croatia" 192 "Cuba" 196 "Cyprus" 203 "Czechia" 204 "Benin" 208 "Denmark" 212 "Dominica" 214 "Dominican Republic (the)" 218 "Ecuador" 222 "El Salvador" 226 "Equatorial Guinea" 231 "Ethiopia" 232 "Eritrea" 233 "Estonia" 234 "Faroe Islands (the)" 238 "Falkland Islands (the) [Malvinas]" 239 "South Georgia and the South Sandwich Islands" 242 "Fiji" 246 "Finland" 248 "Aland Islands" 250 "France" 254 "French Guiana" 258 "French Polynesia" 260 "French Southern Territories (the)" 262 "Djibouti" 266 "Gabon" 268 "Georgia" 270 "Gambia (the)" 275 "Palestine, State of" 276 "Germany" 288 "Ghana" 292 "Gibraltar" 296 "Kiribati" 300 "Greece" 304 "Greenland" 308 "Grenada" 312 "Guadeloupe" 316 "Guam" 320 "Guatemala" 324 "Guinea" 328 "Guyana" 332 "Haiti" 334 "Heard Island and McDonald Islands" 336 "Holy See (the)" 340 "Honduras" 344 "Hong Kong" 348 "Hungary" 352 "Iceland" 356 "India" 360 "Indonesia" 364 "Iran (Islamic Republic of)" 368 "Iraq" 372 "Ireland" 376 "Israel" 380 "Italy" 384 "Cote d'Ivoire" 388 "Jamaica" 392 "Japan" 398 "Kazakhstan" 400 "Jordan" 404 "Kenya" 408 "Korea (the Democratic People's Republic of)" 410 "Korea (the Republic of)" 414 "Kuwait" 417 "Kyrgyzstan" 418 "Lao People's Democratic Republic (the)" 422 "Lebanon" 426 "Lesotho" 428 "Latvia" 430 "Liberia" 434 "Libya" 438 "Liechtenstein" 440 "Lithuania" 442 "Luxembourg" 446 "Macao" 450 "Madagascar" 454 "Malawi" 458 "Malaysia" 462 "Maldives" 466 "Mali" 470 "Malta" 474 "Martinique" 478 "Mauritania" 480 "Mauritius" 484 "Mexico" 492 "Monaco" 496 "Mongolia" 498 "Moldova (the Republic of)" 499 "Montenegro" 500 "Montserrat" 504 "Morocco" 508 "Mozambique" 512 "Oman" 516 "Namibia" 520 "Nauru" 524 "Nepal" 528 "Netherlands (the)" 531 "Curacao" 533 "Aruba" 534 "Sint Maarten (Dutch part)" 535 "Bonaire, Sint Eustatius and Saba" 540 "New Caledonia" 548 "Vanuatu" 554 "New Zealand" 558 "Nicaragua" 562 "Niger (the)" 566 "Nigeria" 570 "Niue" 574 "Norfolk Island" 578 "Norway" 580 "Northern Mariana Islands (the)" 581 "United States Minor Outlying Islands (the)" 583 "Micronesia (Federated States of)" 584 "Marshall Islands (the)" 585 "Palau" 586 "Pakistan" 591 "Panama" 598 "Papua New Guinea" 600 "Paraguay" 604 "Peru" 608 "Philippines (the)" 612 "Pitcairn" 616 "Poland" 620 "Portugal" 624 "Guinea-Bissau" 626 "Timor-Leste" 630 "Puerto Rico" 634 "Qatar" 638 "Reunion" 642 "Romania" 643 "Russian Federation (the)" 646 "Rwanda" 652 "Saint Barthelemy" 654 "Saint Helena, Ascension and Tristan da Cunha" 659 "Saint Kitts and Nevis" 660 "Anguilla" 662 "Saint Lucia" 663 "Saint Martin (French part)" 666 "Saint Pierre and Miquelon" 670 "Saint Vincent and the Grenadines" 674 "San Marino" 678 "Sao Tome and Principe" 682 "Saudi Arabia" 686 "Senegal" 688 "Serbia" 690 "Seychelles" 694 "Sierra Leone" 702 "Singapore" 703 "Slovakia" 704 "Viet Nam" 705 "Slovenia" 706 "Somalia" 710 "South Africa" 716 "Zimbabwe" 724 "Spain" 728 "South Sudan" 729 "Sudan (the)" 732 "Western Sahara*" 740 "Suriname" 744 "Svalbard and Jan Mayen" 748 "Eswatini" 752 "Sweden" 756 "Switzerland" 760 "Syrian Arab Republic" 762 "Tajikistan" 764 "Thailand" 768 "Togo" 772 "Tokelau" 776 "Tonga" 780 "Trinidad and Tobago" 784 "United Arab Emirates (the)" 788 "Tunisia" 792 "Turkey" 795 "Turkmenistan" 796 "Turks and Caicos Islands (the)" 798 "Tuvalu" 800 "Uganda" 804 "Ukraine" 807 "Macedonia (the former Yugoslav Republic of)" 818 "Egypt" 826 "United Kingdom of Great Britain and Northern Ireland (the)" 831 "Guernsey" 832 "Jersey" 833 "Isle of Man" 834 "Tanzania, United Republic of" 840 "United States of America (the)" 850 "Virgin Islands (U.S.)" 854 "Burkina Faso" 858 "Uruguay" 860 "Uzbekistan" 862 "Venezuela(Bolivarian Republic of)" 876 "Wallis and Futuna" 882 "Samoa" 887 "Yemen" 894 "Zambia" ;
VAL_ 238 VFC_TS00_Type 0 "UNKNOWN" 1 "SL5" 2 "SL10" 3 "SL15" 4 "SL20" 5 "SL25" 6 "SL30" 7 "SL35" 8 "SL40" 9 "SL45" 10 "SL50" 11 "SL55" 12 "SL60" 13 "SL65" 14 "SL70" 15 "SL75" 16 "SL80" 17 "SL85" 18 "SL90" 19 "SL95" 20 "SL100" 21 "SL105" 22 "SL110" 23 "SL115" 24 "SL120" 25 "SL125" 26 "SL130" 27 "SL135" 28 "SL140" 29 "SL145" 30 "SL150" 31 "SL155" 32 "SL160" 33 "OP" 34 "OL" 35 "ESL" 36 "EOP" 37 "EOL" 38 "EA" 39 "VSL5" 40 "VSL10" 41 "VSL15" 42 "VSL20" 43 "VSL25" 44 "VSL30" 45 "VSL35" 46 "VSL40" 47 "VSL45" 48 "VSL50" 49 "VSL55" 50 "VSL60" 51 "VSL65" 52 "VSL70" 53 "VSL75" 54 "VSL80" 55 "VSL85" 56 "VSL90" 57 "VSL95" 58 "VSL100" 59 "VSL105" 60 "VSL110" 61 "VSL115" 62 "VSL120" 63 "VSL125" 64 "VSL130" 65 "VSL135" 66 "VSL140" 67 "VSL145" 68 "VSL150" 69 "VSL155" 70 "VSL160" 71 "VOP" 72 "VOL" 73 "VESL" 74 "VEOP" 75 "VEOL" 76 "VEA" 77 "NOENTRY" 78 "NOALL" 79 "NOCAR" 80 "NOLORRY" 81 "NOHAZMAT" 82 "NOBIKE" 83 "NOPED" 84 "NOCARBIKE" 85 "NOTWOWAY" 86 "WEIGHT" 87 "HEIGHT" 88 "WIDTH" 89 "LENGTH" 90 "PRIOCROSS" 91 "GIVEWAY" 92 "PRIOCROSSYIELDTORIGHT" 93 "WARNDANGER" 94 "WARNCURVEL" 95 "WARNCURVER" 96 "WARNDCURVEL" 97 "WARNDCURVER" 98 "WARNTRAIN" 99 "WARNJAM" 100 "WARNANIMAL_DEPRECATED" 101 "WARNRWORKS" 102 "WARNSLOPED" 103 "WARNSLOPEU" 104 "PRIOSTREET" 105 "EPRIOSTREET" 106 "STOP" 107 "ASL" 108 "EASL" 109 "MSL" 110 "EMSL" 111 "MLC" 112 "WBDIAGL" 113 "WBDIAGR" 114 "WBROUND" 115 "NOLTURN" 116 "NORTURN" 117 "NOUTURN" 118 "NOPARK" 119 "NOSTOP" 120 "SMOG" 121 "UMWELT" 122 "EUMWELT" 123 "DOUANE" 124 "FWAY" 125 "EFWAY" 126 "HWAY" 127 "EHWAY" 128 "NORIDER" 129 "WARNCONST" 130 "WARNCONSTL" 131 "WARNCONSTR" 132 "WARNPED" 133 "WARNKIDS" 134 "WARNBIKE" 135 "WARNSKID" 136 "ZEBRA" 137 "ONEWAYS" 138 "ONEWAYU" 139 "SLOWDOWN" 140 "NOCARRIAGE" 141 "NOLORRYTRAILER" 142 "NOBUS" 143 "NOTRACTOR" 144 "LORRYDIST" 145 "CARDIST" 146 "WARNROUND" 147 "WARNWILDANIMAL" 148 "WARNCATTLE" 149 "WARNFROG" 150 "WARNBUS" 151 "WARNWIND" 152 "WARNSNOW" 153 "WARNPCROSS" 154 "WARNHUMP" 155 "WARNROCK" 156 "WARNLOWTREE" 157 "WARNGRAVEL" 158 "WARNTWOWAY" 159 "WARNLIGHTS" 160 "WARNPLANE" 161 "VNOENTRY" 162 "VNOALL" 163 "VNOCAR" 164 "VNOLORRY" 165 "VNOCARBIKE" 166 "VWEIGHT" 167 "VHEIGHT" 168 "VWIDTH" 169 "VLENGTH" 170 "VWARNDANGER" 171 "VWARNJAM" 172 "VWARNRWORKS" 173 "VWARNSKID" 174 "VASL" 175 "VEASL" 176 "VNOLORRYTRAILER" 177 "VNOBUS" 178 "VLORRYDIST" 179 "VCARDIST" 180 "VWARNSNOW" 181 "VWARNHUMP" 182 "VWARNGRAVEL" 183 "CALM" 184 "ECALM" 185 "TWN" 186 "ETWN" 187 "DEADEND" 188 "AXLEWEIGHT" 189 "WARNRIDER" 190 "WARNDRAWBRIDGE" 191 "WARNPIER" 192 "TRINATURE" 193 "VWARNCONST" 194 "VWARNCONSTL" 195 "VWARNCONSTR" 196 "VWARNCURVEL" 197 "VWARNCURVER" 198 "VWARNDCURVEL" 199 "VWARNDCURVER" 200 "VWARNLIGHTS" 201 "WBBENTLEFT" 202 "WBBENTLEFTRIGHT" 203 "WBBENTRIGHT" 204 "WBDIAGLR" 205 "WBLEFT" 206 "WBRIGHT" 207 "WBUP" 208 "WBUPLEFT" 209 "WBUPRIGHT" 210 "WBHAZWATER" 211 "NOHAZWATER" 212 "SCHOOL" 213 "ESCHOOL" 214 "HAZMAT" 215 "EMERGENCYBAY" 216 "ENDOFLANEL" 217 "ENDOFLANER" 218 "ENOPARK" 219 "EONEWAY" 220 "EPARK" 221 "ETOLL" 222 "NOPARKL" 223 "NOPARKLR" 224 "NOPARKR" 225 "NOSTOPL" 226 "NOSTOPLR" 227 "NOSTOPR" 228 "NOTURNONRED" 229 "ONEWAYL" 230 "ONEWAYR" 231 "PARK" 232 "PRIOCROSSL" 233 "PRIOCROSSR" 234 "TOLL" 235 "TUNNEL" 236 "TWOWAY" 237 "WARNCROSS" 238 "WARNCROSSL" 239 "WARNCROSSLR" 240 "WARNCROSSR" 241 "WARNCROSSRL" 242 "WARNCROSST" 243 "WARNGIVEWAYAHEAD" 244 "WARNSLAHEAD" 245 "WARNSTOPAHEAD" 246 "WBBUS" 247 "WRONGWAY" 248 "HAZWATER" 249 "GIVEWAYROUND" 250 "WARNWINDINGL" 251 "WARNWINDINGR" 252 "WARNHAIRPINL" 253 "WARNHAIRPINR" 254 "WARNPEDBIKE" 255 "WARNCROSSY" 256 "WARNBRANCHL" 257 "WARNBRANCHR" 258 "WARNAXLEWEIGHT" 259 "WARNWEIGHT" 260 "WARNHEIGHT" 261 "WARNLENGTH" 262 "WARNWIDTH" 263 "WARNBLACKSPOT" 264 "WARNMERGEL" 265 "WARNMERGER" 266 "WARNTUNNEL" 267 "WARNTRACTOR" 268 "WARNRWORKSVEHICLE" 269 "WARNNARROWBRIDGE" 270 "WARNFLAGGER" 271 "LANES" 272 "LANESHIFTL" 273 "LANESHIFTR" 274 "NEWLANEL" 275 "NEWLANER" 276 "RIGHTTURNONRED" 277 "BORDERLIMIT" 278 "EMBEDDEDRAIN" 279 "VWARNWEIGHT" 280 "VWARNHEIGHT" 281 "VWARNLENGTH" 282 "VWARNWIDTH" 283 "VENDOFLANEL" 284 "VENDOFLANER" 285 "VLANES" 286 "VLANESHIFTL" 287 "VLANESHIFTR" 288 "VNEWLANEL" 289 "VNEWLANER" 290 "NOUP" 291 "VOFF" 292 "ASL5" 293 "ASL10" 294 "ASL15" 295 "ASL20" 296 "ASL25" 297 "ASL30" 298 "ASL35" 299 "ASL40" 300 "ASL45" 301 "ASL50" 302 "ASL55" 303 "ASL60" 304 "ASL65" 305 "ASL70" 306 "ASL75" 307 "ASL80" 308 "ASL85" 309 "ASL90" 310 "ASL95" 311 "ASL100" 312 "ASL105" 313 "ASL110" 314 "ASL115" 315 "ASL120" 316 "ASL125" 317 "ASL130" 318 "ASL135" 319 "ASL140" 320 "ASL145" 321 "ASL150" 322 "ASL155" 323 "ASL160" 324 "VASL5" 325 "VASL10" 326 "VASL15" 327 "VASL20" 328 "VASL25" 329 "VASL30" 330 "VASL35" 331 "VASL40" 332 "VASL45" 333 "VASL50" 334 "VASL55" 335 "VASL60" 336 "VASL65" 337 "VASL70" 338 "VASL75" 339 "VASL80" 340 "VASL85" 341 "VASL90" 342 "VASL95" 343 "VASL100" 344 "VASL105" 345 "VASL110" 346 "VASL115" 347 "VASL120" 348 "VASL125" 349 "VASL130" 350 "VASL135" 351 "VASL140" 352 "VASL145" 353 "VASL150" 354 "VASL155" 355 "VASL160" 356 "WARNTRAINGATED" 357 "KEEPRIGHTCAR" 358 "ASLCURVE5" 359 "ASLCURVE10" 360 "ASLCURVE15" 361 "ASLCURVE20" 362 "ASLCURVE25" 363 "ASLCURVE30" 364 "ASLCURVE35" 365 "ASLCURVE40" 366 "ASLCURVE45" 367 "ASLCURVE50" 368 "ASLCURVE55" 369 "ASLCURVE60" 370 "ASLCURVE65" 371 "ASLCURVE70" 372 "ASLCURVE75" 373 "ASLCURVE80" 374 "ASLCURVE85" 375 "ASLCURVE90" 376 "ASLCURVE95" 377 "ASLCURVE100" 378 "ASLCURVE105" 379 "ASLCURVE110" 380 "ASLCURVE115" 381 "ASLCURVE120" 382 "ASLCURVE125" 383 "ASLCURVE130" 384 "ASLCURVE135" 385 "ASLCURVE140" 386 "ASLCURVE145" 387 "ASLCURVE150" 388 "ASLCURVE155" 389 "ASLCURVE160" 390 "KIDS" 391 "EKIDS" 392 "BIKEROAD" 393 "EBIKEROAD" 394 "PEDSTREET" 395 "EPEDSTREET" 396 "PEDBIKESTREET" 397 "EPEDBIKESTREET" 398 "EWARNKIDS" 399 "CALM20" 400 "CALM30" 401 "ECALM20" 402 "ECALM30" 403 "FWAYGREEN" 404 "TWN40" 405 "TWN50" 406 "TWN60" 407 "TWN70" 408 "ETWN40" 409 "ETWN50" 410 "ETWN60" 411 "ETWN70" 412 "WBBIKE" 413 "EWBBIKE" 414 "WBPED" 415 "EWBPED" 416 "WBPEDBIKESEP" 417 "EWBPEDBIKESEP" 418 "WBPEDBIKESHARED" 419 "EWBPEDBIKESHARED" 420 "EFWAYGREEN" 421 "Reserved0421" 422 "Reserved0422" 423 "Reserved0423" 424 "Reserved0424" 425 "Reserved0425" 426 "Reserved0426" 427 "Reserved0427" 428 "Reserved0428" 429 "Reserved0429" 430 "Reserved0430" 431 "Reserved0431" 432 "Reserved0432" 433 "Reserved0433" 434 "Reserved0434" 435 "Reserved0435" 436 "Reserved0436" 437 "Reserved0437" 438 "Reserved0438" 439 "Reserved0439" 440 "Reserved0440" 441 "Reserved0441" 442 "Reserved0442" 443 "Reserved0443" 444 "Reserved0444" 445 "Reserved0445" 446 "Reserved0446" 447 "Reserved0447" 448 "Reserved0448" 449 "Reserved0449" ;
VAL_ 238 VFC_TS00_EmbeddedInfo 0 "Unknown" 1 "Not Embedded" 2 "Border Limit" 3 "Multi Lane" 4 "Rain" 5 "Vehicle Type" 6 "Plate" 7 "Error Value" 8 "Vehicle Sticker" 9 "Reserved09" 10 "Reserved10" 11 "Reserved11" 12 "Reserved12" 13 "Reserved13" 14 "Reserved14" 15 "Reserved15" ;
VAL_ 238 VFC_TS00_ValidTimeRange1Start 127 "Unknown" ;
VAL_ 238 VFC_TS00_ValidTimeRange1End 127 "Unknown" ;
VAL_ 238 VFC_TS00_ValidTimeRange2Start 127 "Unknown" ;
VAL_ 238 VFC_TS00_ValidTimeRange2End 127 "Unknown" ;
VAL_ 238 VFC_TS00_ValidInDistUnit 0 "Unknown" ;
VAL_ 238 VFC_TS00_ValidSectionUnit 0 "Unknown" 1 "Meter" 2 "Kilometer" 3 "Foot" 4 "Yard" 5 "Mile" 6 "Reserved6" 7 "Reserved7" ;
VAL_ 238 VFC_TS00_SupSign0Type 0 "UNKNOWN" 1 "ADDCAR" 2 "ADDLORRY" 3 "ADDTRAILER" 4 "ADDCARAVAN" 5 "ADDBUS" 6 "ADDTRACTOR" 7 "ADDMCYCLE" 8 "ADDLORRYBUSTRAILER_DEPRECATED" 9 "ADDLORRYBUS_DEPRECATED" 10 "ADDHAZMAT" 11 "ADDTANK" 12 "ADDTRAM" 13 "ADDWET" 14 "ADDFOG" 15 "ADDRAIN" 16 "ADDSNOW" 17 "ADDTIME" 18 "ADDSECTION" 19 "ADDDISTANCE" 20 "ADDWEIGHT" 21 "ADDEXITL" 22 "ADDEXITR" 23 "ADDLANES" 24 "ADDRADAR" 25 "ADDRAPPEL" 26 "ADDPRIOTURN" 27 "ADDLORRY_EXCEPT" 28 "ADDTRACTOR_OVER" 29 "ADDTEXT" 30 "ADDSIGN" 31 "ADDRAINSNOW" 32 "ADDHUMP" 33 "VADDLORRYBUSTRAILER_DEPRECATED" 34 "VADDLORRYBUS_DEPRECATED" 35 "VADDLORRYTRAILER_DEPRECATED" 36 "ADDLORRYTRAILER_DEPRECATED" 37 "ADDCAMPER" 38 "ADDZONE" 39 "ADDCRASHRISK" 40 "ADDACCIDENT" 41 "ADDJAM" 42 "ADDSMOKE" 43 "ADDOILTRAIL" 44 "ADDGRAVEL" 45 "ADDDIRT" 46 "ADDRWORKSEXIT" 47 "ADDROADDAMAGE" 48 "ADDRWORKSENTRY" 49 "ADDLOWTREE" 50 "ADDRWORKSACCESS" 51 "ADDRUTS" 52 "ADDSOFTSHOULDERCAR" 53 "ADDSOFTSHOULDERLORRY" 54 "VADDSIGN" 55 "VADDCAR" 56 "VADDLORRY" 57 "VADDTRAILER" 58 "VADDCARAVAN" 59 "VADDBUS" 60 "VADDWET" 61 "VADDFOG" 62 "VADDRAIN" 63 "VADDSNOW" 64 "VADDRAINSNOW" 65 "VADDTEXT" 66 "VADDSECTION" 67 "VADDDISTANCE" 68 "VADDWEIGHT" 69 "VADDZONE" 70 "VADDCRASHRISK" 71 "VADDACCIDENT" 72 "VADDJAM" 73 "VADDOILTRAIL" 74 "VADDGRAVEL" 75 "VADDDIRT" 76 "VADDROADDAMAGE" 77 "VADDRUTS" 78 "ADDNOSTOPSHOULDER" 79 "ADDTOWING" 80 "ADDSCHOOL" 81 "ADDNIGHT" 82 "ADDEND" 83 "ADDBEGINS" 84 "ADDWITHIN" 85 "ADDDISTANCEBARS" 86 "ADDMINIMUM" 87 "ADDADVICE" 88 "ADDACCESS" 89 "ADDALLWAY" 90 "ADDBUS_EXCEPT" 91 "ADDEXCEPTDELIVERY" 92 "ADDEXCEPTLOCAL" 93 "ADDFROG" 94 "ADDPRIOTURNL" 95 "ADDPRIOTURNR" 96 "ADDSTART" 97 "ADDSTOPIN" 98 "ADDEXIT" 99 "ADDHAZWATER" 100 "ADDDAY" 101 "ADDSL" 102 "ADDLORRYTRAILER" 103 "ADDLORRYSEMI" 104 "VADDLORRYTRAILER" 105 "VADDLORRYSEMI" 106 "ADDSLOW" 107 "ADDSL5" 108 "ADDSL10" 109 "ADDSL15" 110 "ADDSL20" 111 "ADDSL25" 112 "ADDSL30" 113 "ADDSL35" 114 "ADDSL40" 115 "ADDSL45" 116 "ADDSL50" 117 "ADDSL55" 118 "ADDSL60" 119 "ADDSL65" 120 "ADDSL70" 121 "ADDSL75" 122 "ADDSL80" 123 "ADDSL85" 124 "ADDSL90" 125 "ADDSL95" 126 "ADDSL100" 127 "ADDSL105" 128 "ADDSL110" 129 "ADDSL115" 130 "ADDSL120" 131 "ADDSL125" 132 "ADDSL130" 133 "ADDSL135" 134 "ADDSL140" 135 "ADDSL145" 136 "ADDSL150" 137 "ADDSL155" 138 "ADDSL160" 139 "ADDBIKEROAD" 140 "ADDLORRYTRAILER_EXCEPT" 141 "ADDLORRYSEMI_EXCEPT" 142 "Reserved142" 143 "Reserved143" 144 "Reserved144" 145 "Reserved145" 146 "Reserved146" 147 "Reserved147" 148 "Reserved148" 149 "Reserved149" 150 "Reserved150" 151 "Reserved151" 152 "Reserved152" 153 "Reserved153" 154 "Reserved154" 155 "Reserved155" 156 "Reserved156" 157 "Reserved157" 158 "Reserved158" 159 "Reserved159" 160 "Reserved160" 161 "Reserved161" 162 "Reserved162" 163 "Reserved163" 164 "Reserved164" 165 "Reserved165" 166 "Reserved166" 167 "Reserved167" 168 "Reserved168" 169 "Reserved169" ;
VAL_ 238 VFC_TS00_SupSign1Type 0 "UNKNOWN" 1 "ADDCAR" 2 "ADDLORRY" 3 "ADDTRAILER" 4 "ADDCARAVAN" 5 "ADDBUS" 6 "ADDTRACTOR" 7 "ADDMCYCLE" 8 "ADDLORRYBUSTRAILER_DEPRECATED" 9 "ADDLORRYBUS_DEPRECATED" 10 "ADDHAZMAT" 11 "ADDTANK" 12 "ADDTRAM" 13 "ADDWET" 14 "ADDFOG" 15 "ADDRAIN" 16 "ADDSNOW" 17 "ADDTIME" 18 "ADDSECTION" 19 "ADDDISTANCE" 20 "ADDWEIGHT" 21 "ADDEXITL" 22 "ADDEXITR" 23 "ADDLANES" 24 "ADDRADAR" 25 "ADDRAPPEL" 26 "ADDPRIOTURN" 27 "ADDLORRY_EXCEPT" 28 "ADDTRACTOR_OVER" 29 "ADDTEXT" 30 "ADDSIGN" 31 "ADDRAINSNOW" 32 "ADDHUMP" 33 "VADDLORRYBUSTRAILER_DEPRECATED" 34 "VADDLORRYBUS_DEPRECATED" 35 "VADDLORRYTRAILER_DEPRECATED" 36 "ADDLORRYTRAILER_DEPRECATED" 37 "ADDCAMPER" 38 "ADDZONE" 39 "ADDCRASHRISK" 40 "ADDACCIDENT" 41 "ADDJAM" 42 "ADDSMOKE" 43 "ADDOILTRAIL" 44 "ADDGRAVEL" 45 "ADDDIRT" 46 "ADDRWORKSEXIT" 47 "ADDROADDAMAGE" 48 "ADDRWORKSENTRY" 49 "ADDLOWTREE" 50 "ADDRWORKSACCESS" 51 "ADDRUTS" 52 "ADDSOFTSHOULDERCAR" 53 "ADDSOFTSHOULDERLORRY" 54 "VADDSIGN" 55 "VADDCAR" 56 "VADDLORRY" 57 "VADDTRAILER" 58 "VADDCARAVAN" 59 "VADDBUS" 60 "VADDWET" 61 "VADDFOG" 62 "VADDRAIN" 63 "VADDSNOW" 64 "VADDRAINSNOW" 65 "VADDTEXT" 66 "VADDSECTION" 67 "VADDDISTANCE" 68 "VADDWEIGHT" 69 "VADDZONE" 70 "VADDCRASHRISK" 71 "VADDACCIDENT" 72 "VADDJAM" 73 "VADDOILTRAIL" 74 "VADDGRAVEL" 75 "VADDDIRT" 76 "VADDROADDAMAGE" 77 "VADDRUTS" 78 "ADDNOSTOPSHOULDER" 79 "ADDTOWING" 80 "ADDSCHOOL" 81 "ADDNIGHT" 82 "ADDEND" 83 "ADDBEGINS" 84 "ADDWITHIN" 85 "ADDDISTANCEBARS" 86 "ADDMINIMUM" 87 "ADDADVICE" 88 "ADDACCESS" 89 "ADDALLWAY" 90 "ADDBUS_EXCEPT" 91 "ADDEXCEPTDELIVERY" 92 "ADDEXCEPTLOCAL" 93 "ADDFROG" 94 "ADDPRIOTURNL" 95 "ADDPRIOTURNR" 96 "ADDSTART" 97 "ADDSTOPIN" 98 "ADDEXIT" 99 "ADDHAZWATER" 100 "ADDDAY" 101 "ADDSL" 102 "ADDLORRYTRAILER" 103 "ADDLORRYSEMI" 104 "VADDLORRYTRAILER" 105 "VADDLORRYSEMI" 106 "ADDSLOW" 107 "ADDSL5" 108 "ADDSL10" 109 "ADDSL15" 110 "ADDSL20" 111 "ADDSL25" 112 "ADDSL30" 113 "ADDSL35" 114 "ADDSL40" 115 "ADDSL45" 116 "ADDSL50" 117 "ADDSL55" 118 "ADDSL60" 119 "ADDSL65" 120 "ADDSL70" 121 "ADDSL75" 122 "ADDSL80" 123 "ADDSL85" 124 "ADDSL90" 125 "ADDSL95" 126 "ADDSL100" 127 "ADDSL105" 128 "ADDSL110" 129 "ADDSL115" 130 "ADDSL120" 131 "ADDSL125" 132 "ADDSL130" 133 "ADDSL135" 134 "ADDSL140" 135 "ADDSL145" 136 "ADDSL150" 137 "ADDSL155" 138 "ADDSL160" 139 "ADDBIKEROAD" 140 "ADDLORRYTRAILER_EXCEPT" 141 "ADDLORRYSEMI_EXCEPT" 142 "Reserved142" 143 "Reserved143" 144 "Reserved144" 145 "Reserved145" 146 "Reserved146" 147 "Reserved147" 148 "Reserved148" 149 "Reserved149" 150 "Reserved150" 151 "Reserved151" 152 "Reserved152" 153 "Reserved153" 154 "Reserved154" 155 "Reserved155" 156 "Reserved156" 157 "Reserved157" 158 "Reserved158" 159 "Reserved159" 160 "Reserved160" 161 "Reserved161" 162 "Reserved162" 163 "Reserved163" 164 "Reserved164" 165 "Reserved165" 166 "Reserved166" 167 "Reserved167" 168 "Reserved168" 169 "Reserved169" ;
VAL_ 238 VFC_TS00_SupSign2Type 0 "UNKNOWN" 1 "ADDCAR" 2 "ADDLORRY" 3 "ADDTRAILER" 4 "ADDCARAVAN" 5 "ADDBUS" 6 "ADDTRACTOR" 7 "ADDMCYCLE" 8 "ADDLORRYBUSTRAILER_DEPRECATED" 9 "ADDLORRYBUS_DEPRECATED" 10 "ADDHAZMAT" 11 "ADDTANK" 12 "ADDTRAM" 13 "ADDWET" 14 "ADDFOG" 15 "ADDRAIN" 16 "ADDSNOW" 17 "ADDTIME" 18 "ADDSECTION" 19 "ADDDISTANCE" 20 "ADDWEIGHT" 21 "ADDEXITL" 22 "ADDEXITR" 23 "ADDLANES" 24 "ADDRADAR" 25 "ADDRAPPEL" 26 "ADDPRIOTURN" 27 "ADDLORRY_EXCEPT" 28 "ADDTRACTOR_OVER" 29 "ADDTEXT" 30 "ADDSIGN" 31 "ADDRAINSNOW" 32 "ADDHUMP" 33 "VADDLORRYBUSTRAILER_DEPRECATED" 34 "VADDLORRYBUS_DEPRECATED" 35 "VADDLORRYTRAILER_DEPRECATED" 36 "ADDLORRYTRAILER_DEPRECATED" 37 "ADDCAMPER" 38 "ADDZONE" 39 "ADDCRASHRISK" 40 "ADDACCIDENT" 41 "ADDJAM" 42 "ADDSMOKE" 43 "ADDOILTRAIL" 44 "ADDGRAVEL" 45 "ADDDIRT" 46 "ADDRWORKSEXIT" 47 "ADDROADDAMAGE" 48 "ADDRWORKSENTRY" 49 "ADDLOWTREE" 50 "ADDRWORKSACCESS" 51 "ADDRUTS" 52 "ADDSOFTSHOULDERCAR" 53 "ADDSOFTSHOULDERLORRY" 54 "VADDSIGN" 55 "VADDCAR" 56 "VADDLORRY" 57 "VADDTRAILER" 58 "VADDCARAVAN" 59 "VADDBUS" 60 "VADDWET" 61 "VADDFOG" 62 "VADDRAIN" 63 "VADDSNOW" 64 "VADDRAINSNOW" 65 "VADDTEXT" 66 "VADDSECTION" 67 "VADDDISTANCE" 68 "VADDWEIGHT" 69 "VADDZONE" 70 "VADDCRASHRISK" 71 "VADDACCIDENT" 72 "VADDJAM" 73 "VADDOILTRAIL" 74 "VADDGRAVEL" 75 "VADDDIRT" 76 "VADDROADDAMAGE" 77 "VADDRUTS" 78 "ADDNOSTOPSHOULDER" 79 "ADDTOWING" 80 "ADDSCHOOL" 81 "ADDNIGHT" 82 "ADDEND" 83 "ADDBEGINS" 84 "ADDWITHIN" 85 "ADDDISTANCEBARS" 86 "ADDMINIMUM" 87 "ADDADVICE" 88 "ADDACCESS" 89 "ADDALLWAY" 90 "ADDBUS_EXCEPT" 91 "ADDEXCEPTDELIVERY" 92 "ADDEXCEPTLOCAL" 93 "ADDFROG" 94 "ADDPRIOTURNL" 95 "ADDPRIOTURNR" 96 "ADDSTART" 97 "ADDSTOPIN" 98 "ADDEXIT" 99 "ADDHAZWATER" 100 "ADDDAY" 101 "ADDSL" 102 "ADDLORRYTRAILER" 103 "ADDLORRYSEMI" 104 "VADDLORRYTRAILER" 105 "VADDLORRYSEMI" 106 "ADDSLOW" 107 "ADDSL5" 108 "ADDSL10" 109 "ADDSL15" 110 "ADDSL20" 111 "ADDSL25" 112 "ADDSL30" 113 "ADDSL35" 114 "ADDSL40" 115 "ADDSL45" 116 "ADDSL50" 117 "ADDSL55" 118 "ADDSL60" 119 "ADDSL65" 120 "ADDSL70" 121 "ADDSL75" 122 "ADDSL80" 123 "ADDSL85" 124 "ADDSL90" 125 "ADDSL95" 126 "ADDSL100" 127 "ADDSL105" 128 "ADDSL110" 129 "ADDSL115" 130 "ADDSL120" 131 "ADDSL125" 132 "ADDSL130" 133 "ADDSL135" 134 "ADDSL140" 135 "ADDSL145" 136 "ADDSL150" 137 "ADDSL155" 138 "ADDSL160" 139 "ADDBIKEROAD" 140 "ADDLORRYTRAILER_EXCEPT" 141 "ADDLORRYSEMI_EXCEPT" 142 "Reserved142" 143 "Reserved143" 144 "Reserved144" 145 "Reserved145" 146 "Reserved146" 147 "Reserved147" 148 "Reserved148" 149 "Reserved149" 150 "Reserved150" 151 "Reserved151" 152 "Reserved152" 153 "Reserved153" 154 "Reserved154" 155 "Reserved155" 156 "Reserved156" 157 "Reserved157" 158 "Reserved158" 159 "Reserved159" 160 "Reserved160" 161 "Reserved161" 162 "Reserved162" 163 "Reserved163" 164 "Reserved164" 165 "Reserved165" 166 "Reserved166" 167 "Reserved167" 168 "Reserved168" 169 "Reserved169" ;
VAL_ 238 VFC_TS00_SupSign3Type 0 "UNKNOWN" 1 "ADDCAR" 2 "ADDLORRY" 3 "ADDTRAILER" 4 "ADDCARAVAN" 5 "ADDBUS" 6 "ADDTRACTOR" 7 "ADDMCYCLE" 8 "ADDLORRYBUSTRAILER_DEPRECATED" 9 "ADDLORRYBUS_DEPRECATED" 10 "ADDHAZMAT" 11 "ADDTANK" 12 "ADDTRAM" 13 "ADDWET" 14 "ADDFOG" 15 "ADDRAIN" 16 "ADDSNOW" 17 "ADDTIME" 18 "ADDSECTION" 19 "ADDDISTANCE" 20 "ADDWEIGHT" 21 "ADDEXITL" 22 "ADDEXITR" 23 "ADDLANES" 24 "ADDRADAR" 25 "ADDRAPPEL" 26 "ADDPRIOTURN" 27 "ADDLORRY_EXCEPT" 28 "ADDTRACTOR_OVER" 29 "ADDTEXT" 30 "ADDSIGN" 31 "ADDRAINSNOW" 32 "ADDHUMP" 33 "VADDLORRYBUSTRAILER_DEPRECATED" 34 "VADDLORRYBUS_DEPRECATED" 35 "VADDLORRYTRAILER_DEPRECATED" 36 "ADDLORRYTRAILER_DEPRECATED" 37 "ADDCAMPER" 38 "ADDZONE" 39 "ADDCRASHRISK" 40 "ADDACCIDENT" 41 "ADDJAM" 42 "ADDSMOKE" 43 "ADDOILTRAIL" 44 "ADDGRAVEL" 45 "ADDDIRT" 46 "ADDRWORKSEXIT" 47 "ADDROADDAMAGE" 48 "ADDRWORKSENTRY" 49 "ADDLOWTREE" 50 "ADDRWORKSACCESS" 51 "ADDRUTS" 52 "ADDSOFTSHOULDERCAR" 53 "ADDSOFTSHOULDERLORRY" 54 "VADDSIGN" 55 "VADDCAR" 56 "VADDLORRY" 57 "VADDTRAILER" 58 "VADDCARAVAN" 59 "VADDBUS" 60 "VADDWET" 61 "VADDFOG" 62 "VADDRAIN" 63 "VADDSNOW" 64 "VADDRAINSNOW" 65 "VADDTEXT" 66 "VADDSECTION" 67 "VADDDISTANCE" 68 "VADDWEIGHT" 69 "VADDZONE" 70 "VADDCRASHRISK" 71 "VADDACCIDENT" 72 "VADDJAM" 73 "VADDOILTRAIL" 74 "VADDGRAVEL" 75 "VADDDIRT" 76 "VADDROADDAMAGE" 77 "VADDRUTS" 78 "ADDNOSTOPSHOULDER" 79 "ADDTOWING" 80 "ADDSCHOOL" 81 "ADDNIGHT" 82 "ADDEND" 83 "ADDBEGINS" 84 "ADDWITHIN" 85 "ADDDISTANCEBARS" 86 "ADDMINIMUM" 87 "ADDADVICE" 88 "ADDACCESS" 89 "ADDALLWAY" 90 "ADDBUS_EXCEPT" 91 "ADDEXCEPTDELIVERY" 92 "ADDEXCEPTLOCAL" 93 "ADDFROG" 94 "ADDPRIOTURNL" 95 "ADDPRIOTURNR" 96 "ADDSTART" 97 "ADDSTOPIN" 98 "ADDEXIT" 99 "ADDHAZWATER" 100 "ADDDAY" 101 "ADDSL" 102 "ADDLORRYTRAILER" 103 "ADDLORRYSEMI" 104 "VADDLORRYTRAILER" 105 "VADDLORRYSEMI" 106 "ADDSLOW" 107 "ADDSL5" 108 "ADDSL10" 109 "ADDSL15" 110 "ADDSL20" 111 "ADDSL25" 112 "ADDSL30" 113 "ADDSL35" 114 "ADDSL40" 115 "ADDSL45" 116 "ADDSL50" 117 "ADDSL55" 118 "ADDSL60" 119 "ADDSL65" 120 "ADDSL70" 121 "ADDSL75" 122 "ADDSL80" 123 "ADDSL85" 124 "ADDSL90" 125 "ADDSL95" 126 "ADDSL100" 127 "ADDSL105" 128 "ADDSL110" 129 "ADDSL115" 130 "ADDSL120" 131 "ADDSL125" 132 "ADDSL130" 133 "ADDSL135" 134 "ADDSL140" 135 "ADDSL145" 136 "ADDSL150" 137 "ADDSL155" 138 "ADDSL160" 139 "ADDBIKEROAD" 140 "ADDLORRYTRAILER_EXCEPT" 141 "ADDLORRYSEMI_EXCEPT" 142 "Reserved142" 143 "Reserved143" 144 "Reserved144" 145 "Reserved145" 146 "Reserved146" 147 "Reserved147" 148 "Reserved148" 149 "Reserved149" 150 "Reserved150" 151 "Reserved151" 152 "Reserved152" 153 "Reserved153" 154 "Reserved154" 155 "Reserved155" 156 "Reserved156" 157 "Reserved157" 158 "Reserved158" 159 "Reserved159" 160 "Reserved160" 161 "Reserved161" 162 "Reserved162" 163 "Reserved163" 164 "Reserved164" 165 "Reserved165" 166 "Reserved166" 167 "Reserved167" 168 "Reserved168" 169 "Reserved169" ;
VAL_ 238 VFC_TS00_SupSign4Type 0 "UNKNOWN" 1 "ADDCAR" 2 "ADDLORRY" 3 "ADDTRAILER" 4 "ADDCARAVAN" 5 "ADDBUS" 6 "ADDTRACTOR" 7 "ADDMCYCLE" 8 "ADDLORRYBUSTRAILER_DEPRECATED" 9 "ADDLORRYBUS_DEPRECATED" 10 "ADDHAZMAT" 11 "ADDTANK" 12 "ADDTRAM" 13 "ADDWET" 14 "ADDFOG" 15 "ADDRAIN" 16 "ADDSNOW" 17 "ADDTIME" 18 "ADDSECTION" 19 "ADDDISTANCE" 20 "ADDWEIGHT" 21 "ADDEXITL" 22 "ADDEXITR" 23 "ADDLANES" 24 "ADDRADAR" 25 "ADDRAPPEL" 26 "ADDPRIOTURN" 27 "ADDLORRY_EXCEPT" 28 "ADDTRACTOR_OVER" 29 "ADDTEXT" 30 "ADDSIGN" 31 "ADDRAINSNOW" 32 "ADDHUMP" 33 "VADDLORRYBUSTRAILER_DEPRECATED" 34 "VADDLORRYBUS_DEPRECATED" 35 "VADDLORRYTRAILER_DEPRECATED" 36 "ADDLORRYTRAILER_DEPRECATED" 37 "ADDCAMPER" 38 "ADDZONE" 39 "ADDCRASHRISK" 40 "ADDACCIDENT" 41 "ADDJAM" 42 "ADDSMOKE" 43 "ADDOILTRAIL" 44 "ADDGRAVEL" 45 "ADDDIRT" 46 "ADDRWORKSEXIT" 47 "ADDROADDAMAGE" 48 "ADDRWORKSENTRY" 49 "ADDLOWTREE" 50 "ADDRWORKSACCESS" 51 "ADDRUTS" 52 "ADDSOFTSHOULDERCAR" 53 "ADDSOFTSHOULDERLORRY" 54 "VADDSIGN" 55 "VADDCAR" 56 "VADDLORRY" 57 "VADDTRAILER" 58 "VADDCARAVAN" 59 "VADDBUS" 60 "VADDWET" 61 "VADDFOG" 62 "VADDRAIN" 63 "VADDSNOW" 64 "VADDRAINSNOW" 65 "VADDTEXT" 66 "VADDSECTION" 67 "VADDDISTANCE" 68 "VADDWEIGHT" 69 "VADDZONE" 70 "VADDCRASHRISK" 71 "VADDACCIDENT" 72 "VADDJAM" 73 "VADDOILTRAIL" 74 "VADDGRAVEL" 75 "VADDDIRT" 76 "VADDROADDAMAGE" 77 "VADDRUTS" 78 "ADDNOSTOPSHOULDER" 79 "ADDTOWING" 80 "ADDSCHOOL" 81 "ADDNIGHT" 82 "ADDEND" 83 "ADDBEGINS" 84 "ADDWITHIN" 85 "ADDDISTANCEBARS" 86 "ADDMINIMUM" 87 "ADDADVICE" 88 "ADDACCESS" 89 "ADDALLWAY" 90 "ADDBUS_EXCEPT" 91 "ADDEXCEPTDELIVERY" 92 "ADDEXCEPTLOCAL" 93 "ADDFROG" 94 "ADDPRIOTURNL" 95 "ADDPRIOTURNR" 96 "ADDSTART" 97 "ADDSTOPIN" 98 "ADDEXIT" 99 "ADDHAZWATER" 100 "ADDDAY" 101 "ADDSL" 102 "ADDLORRYTRAILER" 103 "ADDLORRYSEMI" 104 "VADDLORRYTRAILER" 105 "VADDLORRYSEMI" 106 "ADDSLOW" 107 "ADDSL5" 108 "ADDSL10" 109 "ADDSL15" 110 "ADDSL20" 111 "ADDSL25" 112 "ADDSL30" 113 "ADDSL35" 114 "ADDSL40" 115 "ADDSL45" 116 "ADDSL50" 117 "ADDSL55" 118 "ADDSL60" 119 "ADDSL65" 120 "ADDSL70" 121 "ADDSL75" 122 "ADDSL80" 123 "ADDSL85" 124 "ADDSL90" 125 "ADDSL95" 126 "ADDSL100" 127 "ADDSL105" 128 "ADDSL110" 129 "ADDSL115" 130 "ADDSL120" 131 "ADDSL125" 132 "ADDSL130" 133 "ADDSL135" 134 "ADDSL140" 135 "ADDSL145" 136 "ADDSL150" 137 "ADDSL155" 138 "ADDSL160" 139 "ADDBIKEROAD" 140 "ADDLORRYTRAILER_EXCEPT" 141 "ADDLORRYSEMI_EXCEPT" 142 "Reserved142" 143 "Reserved143" 144 "Reserved144" 145 "Reserved145" 146 "Reserved146" 147 "Reserved147" 148 "Reserved148" 149 "Reserved149" 150 "Reserved150" 151 "Reserved151" 152 "Reserved152" 153 "Reserved153" 154 "Reserved154" 155 "Reserved155" 156 "Reserved156" 157 "Reserved157" 158 "Reserved158" 159 "Reserved159" 160 "Reserved160" 161 "Reserved161" 162 "Reserved162" 163 "Reserved163" 164 "Reserved164" 165 "Reserved165" 166 "Reserved166" 167 "Reserved167" 168 "Reserved168" 169 "Reserved169" ;
VAL_ 238 VFC_TS00_SupSign5Type 0 "UNKNOWN" 1 "ADDCAR" 2 "ADDLORRY" 3 "ADDTRAILER" 4 "ADDCARAVAN" 5 "ADDBUS" 6 "ADDTRACTOR" 7 "ADDMCYCLE" 8 "ADDLORRYBUSTRAILER_DEPRECATED" 9 "ADDLORRYBUS_DEPRECATED" 10 "ADDHAZMAT" 11 "ADDTANK" 12 "ADDTRAM" 13 "ADDWET" 14 "ADDFOG" 15 "ADDRAIN" 16 "ADDSNOW" 17 "ADDTIME" 18 "ADDSECTION" 19 "ADDDISTANCE" 20 "ADDWEIGHT" 21 "ADDEXITL" 22 "ADDEXITR" 23 "ADDLANES" 24 "ADDRADAR" 25 "ADDRAPPEL" 26 "ADDPRIOTURN" 27 "ADDLORRY_EXCEPT" 28 "ADDTRACTOR_OVER" 29 "ADDTEXT" 30 "ADDSIGN" 31 "ADDRAINSNOW" 32 "ADDHUMP" 33 "VADDLORRYBUSTRAILER_DEPRECATED" 34 "VADDLORRYBUS_DEPRECATED" 35 "VADDLORRYTRAILER_DEPRECATED" 36 "ADDLORRYTRAILER_DEPRECATED" 37 "ADDCAMPER" 38 "ADDZONE" 39 "ADDCRASHRISK" 40 "ADDACCIDENT" 41 "ADDJAM" 42 "ADDSMOKE" 43 "ADDOILTRAIL" 44 "ADDGRAVEL" 45 "ADDDIRT" 46 "ADDRWORKSEXIT" 47 "ADDROADDAMAGE" 48 "ADDRWORKSENTRY" 49 "ADDLOWTREE" 50 "ADDRWORKSACCESS" 51 "ADDRUTS" 52 "ADDSOFTSHOULDERCAR" 53 "ADDSOFTSHOULDERLORRY" 54 "VADDSIGN" 55 "VADDCAR" 56 "VADDLORRY" 57 "VADDTRAILER" 58 "VADDCARAVAN" 59 "VADDBUS" 60 "VADDWET" 61 "VADDFOG" 62 "VADDRAIN" 63 "VADDSNOW" 64 "VADDRAINSNOW" 65 "VADDTEXT" 66 "VADDSECTION" 67 "VADDDISTANCE" 68 "VADDWEIGHT" 69 "VADDZONE" 70 "VADDCRASHRISK" 71 "VADDACCIDENT" 72 "VADDJAM" 73 "VADDOILTRAIL" 74 "VADDGRAVEL" 75 "VADDDIRT" 76 "VADDROADDAMAGE" 77 "VADDRUTS" 78 "ADDNOSTOPSHOULDER" 79 "ADDTOWING" 80 "ADDSCHOOL" 81 "ADDNIGHT" 82 "ADDEND" 83 "ADDBEGINS" 84 "ADDWITHIN" 85 "ADDDISTANCEBARS" 86 "ADDMINIMUM" 87 "ADDADVICE" 88 "ADDACCESS" 89 "ADDALLWAY" 90 "ADDBUS_EXCEPT" 91 "ADDEXCEPTDELIVERY" 92 "ADDEXCEPTLOCAL" 93 "ADDFROG" 94 "ADDPRIOTURNL" 95 "ADDPRIOTURNR" 96 "ADDSTART" 97 "ADDSTOPIN" 98 "ADDEXIT" 99 "ADDHAZWATER" 100 "ADDDAY" 101 "ADDSL" 102 "ADDLORRYTRAILER" 103 "ADDLORRYSEMI" 104 "VADDLORRYTRAILER" 105 "VADDLORRYSEMI" 106 "ADDSLOW" 107 "ADDSL5" 108 "ADDSL10" 109 "ADDSL15" 110 "ADDSL20" 111 "ADDSL25" 112 "ADDSL30" 113 "ADDSL35" 114 "ADDSL40" 115 "ADDSL45" 116 "ADDSL50" 117 "ADDSL55" 118 "ADDSL60" 119 "ADDSL65" 120 "ADDSL70" 121 "ADDSL75" 122 "ADDSL80" 123 "ADDSL85" 124 "ADDSL90" 125 "ADDSL95" 126 "ADDSL100" 127 "ADDSL105" 128 "ADDSL110" 129 "ADDSL115" 130 "ADDSL120" 131 "ADDSL125" 132 "ADDSL130" 133 "ADDSL135" 134 "ADDSL140" 135 "ADDSL145" 136 "ADDSL150" 137 "ADDSL155" 138 "ADDSL160" 139 "ADDBIKEROAD" 140 "ADDLORRYTRAILER_EXCEPT" 141 "ADDLORRYSEMI_EXCEPT" 142 "Reserved142" 143 "Reserved143" 144 "Reserved144" 145 "Reserved145" 146 "Reserved146" 147 "Reserved147" 148 "Reserved148" 149 "Reserved149" 150 "Reserved150" 151 "Reserved151" 152 "Reserved152" 153 "Reserved153" 154 "Reserved154" 155 "Reserved155" 156 "Reserved156" 157 "Reserved157" 158 "Reserved158" 159 "Reserved159" 160 "Reserved160" 161 "Reserved161" 162 "Reserved162" 163 "Reserved163" 164 "Reserved164" 165 "Reserved165" 166 "Reserved166" 167 "Reserved167" 168 "Reserved168" 169 "Reserved169" ;
VAL_ 238 VFC_TS01_Type 0 "UNKNOWN" 1 "SL5" 2 "SL10" 3 "SL15" 4 "SL20" 5 "SL25" 6 "SL30" 7 "SL35" 8 "SL40" 9 "SL45" 10 "SL50" 11 "SL55" 12 "SL60" 13 "SL65" 14 "SL70" 15 "SL75" 16 "SL80" 17 "SL85" 18 "SL90" 19 "SL95" 20 "SL100" 21 "SL105" 22 "SL110" 23 "SL115" 24 "SL120" 25 "SL125" 26 "SL130" 27 "SL135" 28 "SL140" 29 "SL145" 30 "SL150" 31 "SL155" 32 "SL160" 33 "OP" 34 "OL" 35 "ESL" 36 "EOP" 37 "EOL" 38 "EA" 39 "VSL5" 40 "VSL10" 41 "VSL15" 42 "VSL20" 43 "VSL25" 44 "VSL30" 45 "VSL35" 46 "VSL40" 47 "VSL45" 48 "VSL50" 49 "VSL55" 50 "VSL60" 51 "VSL65" 52 "VSL70" 53 "VSL75" 54 "VSL80" 55 "VSL85" 56 "VSL90" 57 "VSL95" 58 "VSL100" 59 "VSL105" 60 "VSL110" 61 "VSL115" 62 "VSL120" 63 "VSL125" 64 "VSL130" 65 "VSL135" 66 "VSL140" 67 "VSL145" 68 "VSL150" 69 "VSL155" 70 "VSL160" 71 "VOP" 72 "VOL" 73 "VESL" 74 "VEOP" 75 "VEOL" 76 "VEA" 77 "NOENTRY" 78 "NOALL" 79 "NOCAR" 80 "NOLORRY" 81 "NOHAZMAT" 82 "NOBIKE" 83 "NOPED" 84 "NOCARBIKE" 85 "NOTWOWAY" 86 "WEIGHT" 87 "HEIGHT" 88 "WIDTH" 89 "LENGTH" 90 "PRIOCROSS" 91 "GIVEWAY" 92 "PRIOCROSSYIELDTORIGHT" 93 "WARNDANGER" 94 "WARNCURVEL" 95 "WARNCURVER" 96 "WARNDCURVEL" 97 "WARNDCURVER" 98 "WARNTRAIN" 99 "WARNJAM" 100 "WARNANIMAL_DEPRECATED" 101 "WARNRWORKS" 102 "WARNSLOPED" 103 "WARNSLOPEU" 104 "PRIOSTREET" 105 "EPRIOSTREET" 106 "STOP" 107 "ASL" 108 "EASL" 109 "MSL" 110 "EMSL" 111 "MLC" 112 "WBDIAGL" 113 "WBDIAGR" 114 "WBROUND" 115 "NOLTURN" 116 "NORTURN" 117 "NOUTURN" 118 "NOPARK" 119 "NOSTOP" 120 "SMOG" 121 "UMWELT" 122 "EUMWELT" 123 "DOUANE" 124 "FWAY" 125 "EFWAY" 126 "HWAY" 127 "EHWAY" 128 "NORIDER" 129 "WARNCONST" 130 "WARNCONSTL" 131 "WARNCONSTR" 132 "WARNPED" 133 "WARNKIDS" 134 "WARNBIKE" 135 "WARNSKID" 136 "ZEBRA" 137 "ONEWAYS" 138 "ONEWAYU" 139 "SLOWDOWN" 140 "NOCARRIAGE" 141 "NOLORRYTRAILER" 142 "NOBUS" 143 "NOTRACTOR" 144 "LORRYDIST" 145 "CARDIST" 146 "WARNROUND" 147 "WARNWILDANIMAL" 148 "WARNCATTLE" 149 "WARNFROG" 150 "WARNBUS" 151 "WARNWIND" 152 "WARNSNOW" 153 "WARNPCROSS" 154 "WARNHUMP" 155 "WARNROCK" 156 "WARNLOWTREE" 157 "WARNGRAVEL" 158 "WARNTWOWAY" 159 "WARNLIGHTS" 160 "WARNPLANE" 161 "VNOENTRY" 162 "VNOALL" 163 "VNOCAR" 164 "VNOLORRY" 165 "VNOCARBIKE" 166 "VWEIGHT" 167 "VHEIGHT" 168 "VWIDTH" 169 "VLENGTH" 170 "VWARNDANGER" 171 "VWARNJAM" 172 "VWARNRWORKS" 173 "VWARNSKID" 174 "VASL" 175 "VEASL" 176 "VNOLORRYTRAILER" 177 "VNOBUS" 178 "VLORRYDIST" 179 "VCARDIST" 180 "VWARNSNOW" 181 "VWARNHUMP" 182 "VWARNGRAVEL" 183 "CALM" 184 "ECALM" 185 "TWN" 186 "ETWN" 187 "DEADEND" 188 "AXLEWEIGHT" 189 "WARNRIDER" 190 "WARNDRAWBRIDGE" 191 "WARNPIER" 192 "TRINATURE" 193 "VWARNCONST" 194 "VWARNCONSTL" 195 "VWARNCONSTR" 196 "VWARNCURVEL" 197 "VWARNCURVER" 198 "VWARNDCURVEL" 199 "VWARNDCURVER" 200 "VWARNLIGHTS" 201 "WBBENTLEFT" 202 "WBBENTLEFTRIGHT" 203 "WBBENTRIGHT" 204 "WBDIAGLR" 205 "WBLEFT" 206 "WBRIGHT" 207 "WBUP" 208 "WBUPLEFT" 209 "WBUPRIGHT" 210 "WBHAZWATER" 211 "NOHAZWATER" 212 "SCHOOL" 213 "ESCHOOL" 214 "HAZMAT" 215 "EMERGENCYBAY" 216 "ENDOFLANEL" 217 "ENDOFLANER" 218 "ENOPARK" 219 "EONEWAY" 220 "EPARK" 221 "ETOLL" 222 "NOPARKL" 223 "NOPARKLR" 224 "NOPARKR" 225 "NOSTOPL" 226 "NOSTOPLR" 227 "NOSTOPR" 228 "NOTURNONRED" 229 "ONEWAYL" 230 "ONEWAYR" 231 "PARK" 232 "PRIOCROSSL" 233 "PRIOCROSSR" 234 "TOLL" 235 "TUNNEL" 236 "TWOWAY" 237 "WARNCROSS" 238 "WARNCROSSL" 239 "WARNCROSSLR" 240 "WARNCROSSR" 241 "WARNCROSSRL" 242 "WARNCROSST" 243 "WARNGIVEWAYAHEAD" 244 "WARNSLAHEAD" 245 "WARNSTOPAHEAD" 246 "WBBUS" 247 "WRONGWAY" 248 "HAZWATER" 249 "GIVEWAYROUND" 250 "WARNWINDINGL" 251 "WARNWINDINGR" 252 "WARNHAIRPINL" 253 "WARNHAIRPINR" 254 "WARNPEDBIKE" 255 "WARNCROSSY" 256 "WARNBRANCHL" 257 "WARNBRANCHR" 258 "WARNAXLEWEIGHT" 259 "WARNWEIGHT" 260 "WARNHEIGHT" 261 "WARNLENGTH" 262 "WARNWIDTH" 263 "WARNBLACKSPOT" 264 "WARNMERGEL" 265 "WARNMERGER" 266 "WARNTUNNEL" 267 "WARNTRACTOR" 268 "WARNRWORKSVEHICLE" 269 "WARNNARROWBRIDGE" 270 "WARNFLAGGER" 271 "LANES" 272 "LANESHIFTL" 273 "LANESHIFTR" 274 "NEWLANEL" 275 "NEWLANER" 276 "RIGHTTURNONRED" 277 "BORDERLIMIT" 278 "EMBEDDEDRAIN" 279 "VWARNWEIGHT" 280 "VWARNHEIGHT" 281 "VWARNLENGTH" 282 "VWARNWIDTH" 283 "VENDOFLANEL" 284 "VENDOFLANER" 285 "VLANES" 286 "VLANESHIFTL" 287 "VLANESHIFTR" 288 "VNEWLANEL" 289 "VNEWLANER" 290 "NOUP" 291 "VOFF" 292 "ASL5" 293 "ASL10" 294 "ASL15" 295 "ASL20" 296 "ASL25" 297 "ASL30" 298 "ASL35" 299 "ASL40" 300 "ASL45" 301 "ASL50" 302 "ASL55" 303 "ASL60" 304 "ASL65" 305 "ASL70" 306 "ASL75" 307 "ASL80" 308 "ASL85" 309 "ASL90" 310 "ASL95" 311 "ASL100" 312 "ASL105" 313 "ASL110" 314 "ASL115" 315 "ASL120" 316 "ASL125" 317 "ASL130" 318 "ASL135" 319 "ASL140" 320 "ASL145" 321 "ASL150" 322 "ASL155" 323 "ASL160" 324 "VASL5" 325 "VASL10" 326 "VASL15" 327 "VASL20" 328 "VASL25" 329 "VASL30" 330 "VASL35" 331 "VASL40" 332 "VASL45" 333 "VASL50" 334 "VASL55" 335 "VASL60" 336 "VASL65" 337 "VASL70" 338 "VASL75" 339 "VASL80" 340 "VASL85" 341 "VASL90" 342 "VASL95" 343 "VASL100" 344 "VASL105" 345 "VASL110" 346 "VASL115" 347 "VASL120" 348 "VASL125" 349 "VASL130" 350 "VASL135" 351 "VASL140" 352 "VASL145" 353 "VASL150" 354 "VASL155" 355 "VASL160" 356 "WARNTRAINGATED" 357 "KEEPRIGHTCAR" 358 "ASLCURVE5" 359 "ASLCURVE10" 360 "ASLCURVE15" 361 "ASLCURVE20" 362 "ASLCURVE25" 363 "ASLCURVE30" 364 "ASLCURVE35" 365 "ASLCURVE40" 366 "ASLCURVE45" 367 "ASLCURVE50" 368 "ASLCURVE55" 369 "ASLCURVE60" 370 "ASLCURVE65" 371 "ASLCURVE70" 372 "ASLCURVE75" 373 "ASLCURVE80" 374 "ASLCURVE85" 375 "ASLCURVE90" 376 "ASLCURVE95" 377 "ASLCURVE100" 378 "ASLCURVE105" 379 "ASLCURVE110" 380 "ASLCURVE115" 381 "ASLCURVE120" 382 "ASLCURVE125" 383 "ASLCURVE130" 384 "ASLCURVE135" 385 "ASLCURVE140" 386 "ASLCURVE145" 387 "ASLCURVE150" 388 "ASLCURVE155" 389 "ASLCURVE160" 390 "KIDS" 391 "EKIDS" 392 "BIKEROAD" 393 "EBIKEROAD" 394 "PEDSTREET" 395 "EPEDSTREET" 396 "PEDBIKESTREET" 397 "EPEDBIKESTREET" 398 "EWARNKIDS" 399 "CALM20" 400 "CALM30" 401 "ECALM20" 402 "ECALM30" 403 "FWAYGREEN" 404 "TWN40" 405 "TWN50" 406 "TWN60" 407 "TWN70" 408 "ETWN40" 409 "ETWN50" 410 "ETWN60" 411 "ETWN70" 412 "WBBIKE" 413 "EWBBIKE" 414 "WBPED" 415 "EWBPED" 416 "WBPEDBIKESEP" 417 "EWBPEDBIKESEP" 418 "WBPEDBIKESHARED" 419 "EWBPEDBIKESHARED" 420 "EFWAYGREEN" 421 "Reserved0421" 422 "Reserved0422" 423 "Reserved0423" 424 "Reserved0424" 425 "Reserved0425" 426 "Reserved0426" 427 "Reserved0427" 428 "Reserved0428" 429 "Reserved0429" 430 "Reserved0430" 431 "Reserved0431" 432 "Reserved0432" 433 "Reserved0433" 434 "Reserved0434" 435 "Reserved0435" 436 "Reserved0436" 437 "Reserved0437" 438 "Reserved0438" 439 "Reserved0439" 440 "Reserved0440" 441 "Reserved0441" 442 "Reserved0442" 443 "Reserved0443" 444 "Reserved0444" 445 "Reserved0445" 446 "Reserved0446" 447 "Reserved0447" 448 "Reserved0448" 449 "Reserved0449" ;
VAL_ 238 VFC_TS01_EmbeddedInfo 0 "Unknown" 1 "Not Embedded" 2 "Border Limit" 3 "Multi Lane" 4 "Rain" 5 "Vehicle Type" 6 "Plate" 7 "Error Value" 8 "Vehicle Sticker" 9 "Reserved09" 10 "Reserved10" 11 "Reserved11" 12 "Reserved12" 13 "Reserved13" 14 "Reserved14" 15 "Reserved15" ;
VAL_ 238 VFC_TS01_ValidTimeRange1Start 127 "Unknown" ;
VAL_ 238 VFC_TS01_ValidTimeRange1End 127 "Unknown" ;
VAL_ 238 VFC_TS01_ValidTimeRange2Start 127 "Unknown" ;
VAL_ 238 VFC_TS01_ValidTimeRange2End 127 "Unknown" ;
VAL_ 238 VFC_TS01_ValidInDistUnit 0 "Unknown" ;
VAL_ 238 VFC_TS01_ValidSectionUnit 0 "Unknown" 1 "Meter" 2 "Kilometer" 3 "Foot" 4 "Yard" 5 "Mile" 6 "Reserved6" 7 "Reserved7" ;
VAL_ 238 VFC_TS01_SupSign0Type 0 "UNKNOWN" 1 "ADDCAR" 2 "ADDLORRY" 3 "ADDTRAILER" 4 "ADDCARAVAN" 5 "ADDBUS" 6 "ADDTRACTOR" 7 "ADDMCYCLE" 8 "ADDLORRYBUSTRAILER_DEPRECATED" 9 "ADDLORRYBUS_DEPRECATED" 10 "ADDHAZMAT" 11 "ADDTANK" 12 "ADDTRAM" 13 "ADDWET" 14 "ADDFOG" 15 "ADDRAIN" 16 "ADDSNOW" 17 "ADDTIME" 18 "ADDSECTION" 19 "ADDDISTANCE" 20 "ADDWEIGHT" 21 "ADDEXITL" 22 "ADDEXITR" 23 "ADDLANES" 24 "ADDRADAR" 25 "ADDRAPPEL" 26 "ADDPRIOTURN" 27 "ADDLORRY_EXCEPT" 28 "ADDTRACTOR_OVER" 29 "ADDTEXT" 30 "ADDSIGN" 31 "ADDRAINSNOW" 32 "ADDHUMP" 33 "VADDLORRYBUSTRAILER_DEPRECATED" 34 "VADDLORRYBUS_DEPRECATED" 35 "VADDLORRYTRAILER_DEPRECATED" 36 "ADDLORRYTRAILER_DEPRECATED" 37 "ADDCAMPER" 38 "ADDZONE" 39 "ADDCRASHRISK" 40 "ADDACCIDENT" 41 "ADDJAM" 42 "ADDSMOKE" 43 "ADDOILTRAIL" 44 "ADDGRAVEL" 45 "ADDDIRT" 46 "ADDRWORKSEXIT" 47 "ADDROADDAMAGE" 48 "ADDRWORKSENTRY" 49 "ADDLOWTREE" 50 "ADDRWORKSACCESS" 51 "ADDRUTS" 52 "ADDSOFTSHOULDERCAR" 53 "ADDSOFTSHOULDERLORRY" 54 "VADDSIGN" 55 "VADDCAR" 56 "VADDLORRY" 57 "VADDTRAILER" 58 "VADDCARAVAN" 59 "VADDBUS" 60 "VADDWET" 61 "VADDFOG" 62 "VADDRAIN" 63 "VADDSNOW" 64 "VADDRAINSNOW" 65 "VADDTEXT" 66 "VADDSECTION" 67 "VADDDISTANCE" 68 "VADDWEIGHT" 69 "VADDZONE" 70 "VADDCRASHRISK" 71 "VADDACCIDENT" 72 "VADDJAM" 73 "VADDOILTRAIL" 74 "VADDGRAVEL" 75 "VADDDIRT" 76 "VADDROADDAMAGE" 77 "VADDRUTS" 78 "ADDNOSTOPSHOULDER" 79 "ADDTOWING" 80 "ADDSCHOOL" 81 "ADDNIGHT" 82 "ADDEND" 83 "ADDBEGINS" 84 "ADDWITHIN" 85 "ADDDISTANCEBARS" 86 "ADDMINIMUM" 87 "ADDADVICE" 88 "ADDACCESS" 89 "ADDALLWAY" 90 "ADDBUS_EXCEPT" 91 "ADDEXCEPTDELIVERY" 92 "ADDEXCEPTLOCAL" 93 "ADDFROG" 94 "ADDPRIOTURNL" 95 "ADDPRIOTURNR" 96 "ADDSTART" 97 "ADDSTOPIN" 98 "ADDEXIT" 99 "ADDHAZWATER" 100 "ADDDAY" 101 "ADDSL" 102 "ADDLORRYTRAILER" 103 "ADDLORRYSEMI" 104 "VADDLORRYTRAILER" 105 "VADDLORRYSEMI" 106 "ADDSLOW" 107 "ADDSL5" 108 "ADDSL10" 109 "ADDSL15" 110 "ADDSL20" 111 "ADDSL25" 112 "ADDSL30" 113 "ADDSL35" 114 "ADDSL40" 115 "ADDSL45" 116 "ADDSL50" 117 "ADDSL55" 118 "ADDSL60" 119 "ADDSL65" 120 "ADDSL70" 121 "ADDSL75" 122 "ADDSL80" 123 "ADDSL85" 124 "ADDSL90" 125 "ADDSL95" 126 "ADDSL100" 127 "ADDSL105" 128 "ADDSL110" 129 "ADDSL115" 130 "ADDSL120" 131 "ADDSL125" 132 "ADDSL130" 133 "ADDSL135" 134 "ADDSL140" 135 "ADDSL145" 136 "ADDSL150" 137 "ADDSL155" 138 "ADDSL160" 139 "ADDBIKEROAD" 140 "ADDLORRYTRAILER_EXCEPT" 141 "ADDLORRYSEMI_EXCEPT" 142 "Reserved142" 143 "Reserved143" 144 "Reserved144" 145 "Reserved145" 146 "Reserved146" 147 "Reserved147" 148 "Reserved148" 149 "Reserved149" 150 "Reserved150" 151 "Reserved151" 152 "Reserved152" 153 "Reserved153" 154 "Reserved154" 155 "Reserved155" 156 "Reserved156" 157 "Reserved157" 158 "Reserved158" 159 "Reserved159" 160 "Reserved160" 161 "Reserved161" 162 "Reserved162" 163 "Reserved163" 164 "Reserved164" 165 "Reserved165" 166 "Reserved166" 167 "Reserved167" 168 "Reserved168" 169 "Reserved169" ;
VAL_ 238 VFC_TS01_SupSign1Type 0 "UNKNOWN" 1 "ADDCAR" 2 "ADDLORRY" 3 "ADDTRAILER" 4 "ADDCARAVAN" 5 "ADDBUS" 6 "ADDTRACTOR" 7 "ADDMCYCLE" 8 "ADDLORRYBUSTRAILER_DEPRECATED" 9 "ADDLORRYBUS_DEPRECATED" 10 "ADDHAZMAT" 11 "ADDTANK" 12 "ADDTRAM" 13 "ADDWET" 14 "ADDFOG" 15 "ADDRAIN" 16 "ADDSNOW" 17 "ADDTIME" 18 "ADDSECTION" 19 "ADDDISTANCE" 20 "ADDWEIGHT" 21 "ADDEXITL" 22 "ADDEXITR" 23 "ADDLANES" 24 "ADDRADAR" 25 "ADDRAPPEL" 26 "ADDPRIOTURN" 27 "ADDLORRY_EXCEPT" 28 "ADDTRACTOR_OVER" 29 "ADDTEXT" 30 "ADDSIGN" 31 "ADDRAINSNOW" 32 "ADDHUMP" 33 "VADDLORRYBUSTRAILER_DEPRECATED" 34 "VADDLORRYBUS_DEPRECATED" 35 "VADDLORRYTRAILER_DEPRECATED" 36 "ADDLORRYTRAILER_DEPRECATED" 37 "ADDCAMPER" 38 "ADDZONE" 39 "ADDCRASHRISK" 40 "ADDACCIDENT" 41 "ADDJAM" 42 "ADDSMOKE" 43 "ADDOILTRAIL" 44 "ADDGRAVEL" 45 "ADDDIRT" 46 "ADDRWORKSEXIT" 47 "ADDROADDAMAGE" 48 "ADDRWORKSENTRY" 49 "ADDLOWTREE" 50 "ADDRWORKSACCESS" 51 "ADDRUTS" 52 "ADDSOFTSHOULDERCAR" 53 "ADDSOFTSHOULDERLORRY" 54 "VADDSIGN" 55 "VADDCAR" 56 "VADDLORRY" 57 "VADDTRAILER" 58 "VADDCARAVAN" 59 "VADDBUS" 60 "VADDWET" 61 "VADDFOG" 62 "VADDRAIN" 63 "VADDSNOW" 64 "VADDRAINSNOW" 65 "VADDTEXT" 66 "VADDSECTION" 67 "VADDDISTANCE" 68 "VADDWEIGHT" 69 "VADDZONE" 70 "VADDCRASHRISK" 71 "VADDACCIDENT" 72 "VADDJAM" 73 "VADDOILTRAIL" 74 "VADDGRAVEL" 75 "VADDDIRT" 76 "VADDROADDAMAGE" 77 "VADDRUTS" 78 "ADDNOSTOPSHOULDER" 79 "ADDTOWING" 80 "ADDSCHOOL" 81 "ADDNIGHT" 82 "ADDEND" 83 "ADDBEGINS" 84 "ADDWITHIN" 85 "ADDDISTANCEBARS" 86 "ADDMINIMUM" 87 "ADDADVICE" 88 "ADDACCESS" 89 "ADDALLWAY" 90 "ADDBUS_EXCEPT" 91 "ADDEXCEPTDELIVERY" 92 "ADDEXCEPTLOCAL" 93 "ADDFROG" 94 "ADDPRIOTURNL" 95 "ADDPRIOTURNR" 96 "ADDSTART" 97 "ADDSTOPIN" 98 "ADDEXIT" 99 "ADDHAZWATER" 100 "ADDDAY" 101 "ADDSL" 102 "ADDLORRYTRAILER" 103 "ADDLORRYSEMI" 104 "VADDLORRYTRAILER" 105 "VADDLORRYSEMI" 106 "ADDSLOW" 107 "ADDSL5" 108 "ADDSL10" 109 "ADDSL15" 110 "ADDSL20" 111 "ADDSL25" 112 "ADDSL30" 113 "ADDSL35" 114 "ADDSL40" 115 "ADDSL45" 116 "ADDSL50" 117 "ADDSL55" 118 "ADDSL60" 119 "ADDSL65" 120 "ADDSL70" 121 "ADDSL75" 122 "ADDSL80" 123 "ADDSL85" 124 "ADDSL90" 125 "ADDSL95" 126 "ADDSL100" 127 "ADDSL105" 128 "ADDSL110" 129 "ADDSL115" 130 "ADDSL120" 131 "ADDSL125" 132 "ADDSL130" 133 "ADDSL135" 134 "ADDSL140" 135 "ADDSL145" 136 "ADDSL150" 137 "ADDSL155" 138 "ADDSL160" 139 "ADDBIKEROAD" 140 "ADDLORRYTRAILER_EXCEPT" 141 "ADDLORRYSEMI_EXCEPT" 142 "Reserved142" 143 "Reserved143" 144 "Reserved144" 145 "Reserved145" 146 "Reserved146" 147 "Reserved147" 148 "Reserved148" 149 "Reserved149" 150 "Reserved150" 151 "Reserved151" 152 "Reserved152" 153 "Reserved153" 154 "Reserved154" 155 "Reserved155" 156 "Reserved156" 157 "Reserved157" 158 "Reserved158" 159 "Reserved159" 160 "Reserved160" 161 "Reserved161" 162 "Reserved162" 163 "Reserved163" 164 "Reserved164" 165 "Reserved165" 166 "Reserved166" 167 "Reserved167" 168 "Reserved168" 169 "Reserved169" ;
VAL_ 238 VFC_TS01_SupSign2Type 0 "UNKNOWN" 1 "ADDCAR" 2 "ADDLORRY" 3 "ADDTRAILER" 4 "ADDCARAVAN" 5 "ADDBUS" 6 "ADDTRACTOR" 7 "ADDMCYCLE" 8 "ADDLORRYBUSTRAILER_DEPRECATED" 9 "ADDLORRYBUS_DEPRECATED" 10 "ADDHAZMAT" 11 "ADDTANK" 12 "ADDTRAM" 13 "ADDWET" 14 "ADDFOG" 15 "ADDRAIN" 16 "ADDSNOW" 17 "ADDTIME" 18 "ADDSECTION" 19 "ADDDISTANCE" 20 "ADDWEIGHT" 21 "ADDEXITL" 22 "ADDEXITR" 23 "ADDLANES" 24 "ADDRADAR" 25 "ADDRAPPEL" 26 "ADDPRIOTURN" 27 "ADDLORRY_EXCEPT" 28 "ADDTRACTOR_OVER" 29 "ADDTEXT" 30 "ADDSIGN" 31 "ADDRAINSNOW" 32 "ADDHUMP" 33 "VADDLORRYBUSTRAILER_DEPRECATED" 34 "VADDLORRYBUS_DEPRECATED" 35 "VADDLORRYTRAILER_DEPRECATED" 36 "ADDLORRYTRAILER_DEPRECATED" 37 "ADDCAMPER" 38 "ADDZONE" 39 "ADDCRASHRISK" 40 "ADDACCIDENT" 41 "ADDJAM" 42 "ADDSMOKE" 43 "ADDOILTRAIL" 44 "ADDGRAVEL" 45 "ADDDIRT" 46 "ADDRWORKSEXIT" 47 "ADDROADDAMAGE" 48 "ADDRWORKSENTRY" 49 "ADDLOWTREE" 50 "ADDRWORKSACCESS" 51 "ADDRUTS" 52 "ADDSOFTSHOULDERCAR" 53 "ADDSOFTSHOULDERLORRY" 54 "VADDSIGN" 55 "VADDCAR" 56 "VADDLORRY" 57 "VADDTRAILER" 58 "VADDCARAVAN" 59 "VADDBUS" 60 "VADDWET" 61 "VADDFOG" 62 "VADDRAIN" 63 "VADDSNOW" 64 "VADDRAINSNOW" 65 "VADDTEXT" 66 "VADDSECTION" 67 "VADDDISTANCE" 68 "VADDWEIGHT" 69 "VADDZONE" 70 "VADDCRASHRISK" 71 "VADDACCIDENT" 72 "VADDJAM" 73 "VADDOILTRAIL" 74 "VADDGRAVEL" 75 "VADDDIRT" 76 "VADDROADDAMAGE" 77 "VADDRUTS" 78 "ADDNOSTOPSHOULDER" 79 "ADDTOWING" 80 "ADDSCHOOL" 81 "ADDNIGHT" 82 "ADDEND" 83 "ADDBEGINS" 84 "ADDWITHIN" 85 "ADDDISTANCEBARS" 86 "ADDMINIMUM" 87 "ADDADVICE" 88 "ADDACCESS" 89 "ADDALLWAY" 90 "ADDBUS_EXCEPT" 91 "ADDEXCEPTDELIVERY" 92 "ADDEXCEPTLOCAL" 93 "ADDFROG" 94 "ADDPRIOTURNL" 95 "ADDPRIOTURNR" 96 "ADDSTART" 97 "ADDSTOPIN" 98 "ADDEXIT" 99 "ADDHAZWATER" 100 "ADDDAY" 101 "ADDSL" 102 "ADDLORRYTRAILER" 103 "ADDLORRYSEMI" 104 "VADDLORRYTRAILER" 105 "VADDLORRYSEMI" 106 "ADDSLOW" 107 "ADDSL5" 108 "ADDSL10" 109 "ADDSL15" 110 "ADDSL20" 111 "ADDSL25" 112 "ADDSL30" 113 "ADDSL35" 114 "ADDSL40" 115 "ADDSL45" 116 "ADDSL50" 117 "ADDSL55" 118 "ADDSL60" 119 "ADDSL65" 120 "ADDSL70" 121 "ADDSL75" 122 "ADDSL80" 123 "ADDSL85" 124 "ADDSL90" 125 "ADDSL95" 126 "ADDSL100" 127 "ADDSL105" 128 "ADDSL110" 129 "ADDSL115" 130 "ADDSL120" 131 "ADDSL125" 132 "ADDSL130" 133 "ADDSL135" 134 "ADDSL140" 135 "ADDSL145" 136 "ADDSL150" 137 "ADDSL155" 138 "ADDSL160" 139 "ADDBIKEROAD" 140 "ADDLORRYTRAILER_EXCEPT" 141 "ADDLORRYSEMI_EXCEPT" 142 "Reserved142" 143 "Reserved143" 144 "Reserved144" 145 "Reserved145" 146 "Reserved146" 147 "Reserved147" 148 "Reserved148" 149 "Reserved149" 150 "Reserved150" 151 "Reserved151" 152 "Reserved152" 153 "Reserved153" 154 "Reserved154" 155 "Reserved155" 156 "Reserved156" 157 "Reserved157" 158 "Reserved158" 159 "Reserved159" 160 "Reserved160" 161 "Reserved161" 162 "Reserved162" 163 "Reserved163" 164 "Reserved164" 165 "Reserved165" 166 "Reserved166" 167 "Reserved167" 168 "Reserved168" 169 "Reserved169" ;
VAL_ 238 VFC_TS01_SupSign3Type 0 "UNKNOWN" 1 "ADDCAR" 2 "ADDLORRY" 3 "ADDTRAILER" 4 "ADDCARAVAN" 5 "ADDBUS" 6 "ADDTRACTOR" 7 "ADDMCYCLE" 8 "ADDLORRYBUSTRAILER_DEPRECATED" 9 "ADDLORRYBUS_DEPRECATED" 10 "ADDHAZMAT" 11 "ADDTANK" 12 "ADDTRAM" 13 "ADDWET" 14 "ADDFOG" 15 "ADDRAIN" 16 "ADDSNOW" 17 "ADDTIME" 18 "ADDSECTION" 19 "ADDDISTANCE" 20 "ADDWEIGHT" 21 "ADDEXITL" 22 "ADDEXITR" 23 "ADDLANES" 24 "ADDRADAR" 25 "ADDRAPPEL" 26 "ADDPRIOTURN" 27 "ADDLORRY_EXCEPT" 28 "ADDTRACTOR_OVER" 29 "ADDTEXT" 30 "ADDSIGN" 31 "ADDRAINSNOW" 32 "ADDHUMP" 33 "VADDLORRYBUSTRAILER_DEPRECATED" 34 "VADDLORRYBUS_DEPRECATED" 35 "VADDLORRYTRAILER_DEPRECATED" 36 "ADDLORRYTRAILER_DEPRECATED" 37 "ADDCAMPER" 38 "ADDZONE" 39 "ADDCRASHRISK" 40 "ADDACCIDENT" 41 "ADDJAM" 42 "ADDSMOKE" 43 "ADDOILTRAIL" 44 "ADDGRAVEL" 45 "ADDDIRT" 46 "ADDRWORKSEXIT" 47 "ADDROADDAMAGE" 48 "ADDRWORKSENTRY" 49 "ADDLOWTREE" 50 "ADDRWORKSACCESS" 51 "ADDRUTS" 52 "ADDSOFTSHOULDERCAR" 53 "ADDSOFTSHOULDERLORRY" 54 "VADDSIGN" 55 "VADDCAR" 56 "VADDLORRY" 57 "VADDTRAILER" 58 "VADDCARAVAN" 59 "VADDBUS" 60 "VADDWET" 61 "VADDFOG" 62 "VADDRAIN" 63 "VADDSNOW" 64 "VADDRAINSNOW" 65 "VADDTEXT" 66 "VADDSECTION" 67 "VADDDISTANCE" 68 "VADDWEIGHT" 69 "VADDZONE" 70 "VADDCRASHRISK" 71 "VADDACCIDENT" 72 "VADDJAM" 73 "VADDOILTRAIL" 74 "VADDGRAVEL" 75 "VADDDIRT" 76 "VADDROADDAMAGE" 77 "VADDRUTS" 78 "ADDNOSTOPSHOULDER" 79 "ADDTOWING" 80 "ADDSCHOOL" 81 "ADDNIGHT" 82 "ADDEND" 83 "ADDBEGINS" 84 "ADDWITHIN" 85 "ADDDISTANCEBARS" 86 "ADDMINIMUM" 87 "ADDADVICE" 88 "ADDACCESS" 89 "ADDALLWAY" 90 "ADDBUS_EXCEPT" 91 "ADDEXCEPTDELIVERY" 92 "ADDEXCEPTLOCAL" 93 "ADDFROG" 94 "ADDPRIOTURNL" 95 "ADDPRIOTURNR" 96 "ADDSTART" 97 "ADDSTOPIN" 98 "ADDEXIT" 99 "ADDHAZWATER" 100 "ADDDAY" 101 "ADDSL" 102 "ADDLORRYTRAILER" 103 "ADDLORRYSEMI" 104 "VADDLORRYTRAILER" 105 "VADDLORRYSEMI" 106 "ADDSLOW" 107 "ADDSL5" 108 "ADDSL10" 109 "ADDSL15" 110 "ADDSL20" 111 "ADDSL25" 112 "ADDSL30" 113 "ADDSL35" 114 "ADDSL40" 115 "ADDSL45" 116 "ADDSL50" 117 "ADDSL55" 118 "ADDSL60" 119 "ADDSL65" 120 "ADDSL70" 121 "ADDSL75" 122 "ADDSL80" 123 "ADDSL85" 124 "ADDSL90" 125 "ADDSL95" 126 "ADDSL100" 127 "ADDSL105" 128 "ADDSL110" 129 "ADDSL115" 130 "ADDSL120" 131 "ADDSL125" 132 "ADDSL130" 133 "ADDSL135" 134 "ADDSL140" 135 "ADDSL145" 136 "ADDSL150" 137 "ADDSL155" 138 "ADDSL160" 139 "ADDBIKEROAD" 140 "ADDLORRYTRAILER_EXCEPT" 141 "ADDLORRYSEMI_EXCEPT" 142 "Reserved142" 143 "Reserved143" 144 "Reserved144" 145 "Reserved145" 146 "Reserved146" 147 "Reserved147" 148 "Reserved148" 149 "Reserved149" 150 "Reserved150" 151 "Reserved151" 152 "Reserved152" 153 "Reserved153" 154 "Reserved154" 155 "Reserved155" 156 "Reserved156" 157 "Reserved157" 158 "Reserved158" 159 "Reserved159" 160 "Reserved160" 161 "Reserved161" 162 "Reserved162" 163 "Reserved163" 164 "Reserved164" 165 "Reserved165" 166 "Reserved166" 167 "Reserved167" 168 "Reserved168" 169 "Reserved169" ;
VAL_ 238 VFC_TS01_SupSign4Type 0 "UNKNOWN" 1 "ADDCAR" 2 "ADDLORRY" 3 "ADDTRAILER" 4 "ADDCARAVAN" 5 "ADDBUS" 6 "ADDTRACTOR" 7 "ADDMCYCLE" 8 "ADDLORRYBUSTRAILER_DEPRECATED" 9 "ADDLORRYBUS_DEPRECATED" 10 "ADDHAZMAT" 11 "ADDTANK" 12 "ADDTRAM" 13 "ADDWET" 14 "ADDFOG" 15 "ADDRAIN" 16 "ADDSNOW" 17 "ADDTIME" 18 "ADDSECTION" 19 "ADDDISTANCE" 20 "ADDWEIGHT" 21 "ADDEXITL" 22 "ADDEXITR" 23 "ADDLANES" 24 "ADDRADAR" 25 "ADDRAPPEL" 26 "ADDPRIOTURN" 27 "ADDLORRY_EXCEPT" 28 "ADDTRACTOR_OVER" 29 "ADDTEXT" 30 "ADDSIGN" 31 "ADDRAINSNOW" 32 "ADDHUMP" 33 "VADDLORRYBUSTRAILER_DEPRECATED" 34 "VADDLORRYBUS_DEPRECATED" 35 "VADDLORRYTRAILER_DEPRECATED" 36 "ADDLORRYTRAILER_DEPRECATED" 37 "ADDCAMPER" 38 "ADDZONE" 39 "ADDCRASHRISK" 40 "ADDACCIDENT" 41 "ADDJAM" 42 "ADDSMOKE" 43 "ADDOILTRAIL" 44 "ADDGRAVEL" 45 "ADDDIRT" 46 "ADDRWORKSEXIT" 47 "ADDROADDAMAGE" 48 "ADDRWORKSENTRY" 49 "ADDLOWTREE" 50 "ADDRWORKSACCESS" 51 "ADDRUTS" 52 "ADDSOFTSHOULDERCAR" 53 "ADDSOFTSHOULDERLORRY" 54 "VADDSIGN" 55 "VADDCAR" 56 "VADDLORRY" 57 "VADDTRAILER" 58 "VADDCARAVAN" 59 "VADDBUS" 60 "VADDWET" 61 "VADDFOG" 62 "VADDRAIN" 63 "VADDSNOW" 64 "VADDRAINSNOW" 65 "VADDTEXT" 66 "VADDSECTION" 67 "VADDDISTANCE" 68 "VADDWEIGHT" 69 "VADDZONE" 70 "VADDCRASHRISK" 71 "VADDACCIDENT" 72 "VADDJAM" 73 "VADDOILTRAIL" 74 "VADDGRAVEL" 75 "VADDDIRT" 76 "VADDROADDAMAGE" 77 "VADDRUTS" 78 "ADDNOSTOPSHOULDER" 79 "ADDTOWING" 80 "ADDSCHOOL" 81 "ADDNIGHT" 82 "ADDEND" 83 "ADDBEGINS" 84 "ADDWITHIN" 85 "ADDDISTANCEBARS" 86 "ADDMINIMUM" 87 "ADDADVICE" 88 "ADDACCESS" 89 "ADDALLWAY" 90 "ADDBUS_EXCEPT" 91 "ADDEXCEPTDELIVERY" 92 "ADDEXCEPTLOCAL" 93 "ADDFROG" 94 "ADDPRIOTURNL" 95 "ADDPRIOTURNR" 96 "ADDSTART" 97 "ADDSTOPIN" 98 "ADDEXIT" 99 "ADDHAZWATER" 100 "ADDDAY" 101 "ADDSL" 102 "ADDLORRYTRAILER" 103 "ADDLORRYSEMI" 104 "VADDLORRYTRAILER" 105 "VADDLORRYSEMI" 106 "ADDSLOW" 107 "ADDSL5" 108 "ADDSL10" 109 "ADDSL15" 110 "ADDSL20" 111 "ADDSL25" 112 "ADDSL30" 113 "ADDSL35" 114 "ADDSL40" 115 "ADDSL45" 116 "ADDSL50" 117 "ADDSL55" 118 "ADDSL60" 119 "ADDSL65" 120 "ADDSL70" 121 "ADDSL75" 122 "ADDSL80" 123 "ADDSL85" 124 "ADDSL90" 125 "ADDSL95" 126 "ADDSL100" 127 "ADDSL105" 128 "ADDSL110" 129 "ADDSL115" 130 "ADDSL120" 131 "ADDSL125" 132 "ADDSL130" 133 "ADDSL135" 134 "ADDSL140" 135 "ADDSL145" 136 "ADDSL150" 137 "ADDSL155" 138 "ADDSL160" 139 "ADDBIKEROAD" 140 "ADDLORRYTRAILER_EXCEPT" 141 "ADDLORRYSEMI_EXCEPT" 142 "Reserved142" 143 "Reserved143" 144 "Reserved144" 145 "Reserved145" 146 "Reserved146" 147 "Reserved147" 148 "Reserved148" 149 "Reserved149" 150 "Reserved150" 151 "Reserved151" 152 "Reserved152" 153 "Reserved153" 154 "Reserved154" 155 "Reserved155" 156 "Reserved156" 157 "Reserved157" 158 "Reserved158" 159 "Reserved159" 160 "Reserved160" 161 "Reserved161" 162 "Reserved162" 163 "Reserved163" 164 "Reserved164" 165 "Reserved165" 166 "Reserved166" 167 "Reserved167" 168 "Reserved168" 169 "Reserved169" ;
VAL_ 238 VFC_TS01_SupSign5Type 0 "UNKNOWN" 1 "ADDCAR" 2 "ADDLORRY" 3 "ADDTRAILER" 4 "ADDCARAVAN" 5 "ADDBUS" 6 "ADDTRACTOR" 7 "ADDMCYCLE" 8 "ADDLORRYBUSTRAILER_DEPRECATED" 9 "ADDLORRYBUS_DEPRECATED" 10 "ADDHAZMAT" 11 "ADDTANK" 12 "ADDTRAM" 13 "ADDWET" 14 "ADDFOG" 15 "ADDRAIN" 16 "ADDSNOW" 17 "ADDTIME" 18 "ADDSECTION" 19 "ADDDISTANCE" 20 "ADDWEIGHT" 21 "ADDEXITL" 22 "ADDEXITR" 23 "ADDLANES" 24 "ADDRADAR" 25 "ADDRAPPEL" 26 "ADDPRIOTURN" 27 "ADDLORRY_EXCEPT" 28 "ADDTRACTOR_OVER" 29 "ADDTEXT" 30 "ADDSIGN" 31 "ADDRAINSNOW" 32 "ADDHUMP" 33 "VADDLORRYBUSTRAILER_DEPRECATED" 34 "VADDLORRYBUS_DEPRECATED" 35 "VADDLORRYTRAILER_DEPRECATED" 36 "ADDLORRYTRAILER_DEPRECATED" 37 "ADDCAMPER" 38 "ADDZONE" 39 "ADDCRASHRISK" 40 "ADDACCIDENT" 41 "ADDJAM" 42 "ADDSMOKE" 43 "ADDOILTRAIL" 44 "ADDGRAVEL" 45 "ADDDIRT" 46 "ADDRWORKSEXIT" 47 "ADDROADDAMAGE" 48 "ADDRWORKSENTRY" 49 "ADDLOWTREE" 50 "ADDRWORKSACCESS" 51 "ADDRUTS" 52 "ADDSOFTSHOULDERCAR" 53 "ADDSOFTSHOULDERLORRY" 54 "VADDSIGN" 55 "VADDCAR" 56 "VADDLORRY" 57 "VADDTRAILER" 58 "VADDCARAVAN" 59 "VADDBUS" 60 "VADDWET" 61 "VADDFOG" 62 "VADDRAIN" 63 "VADDSNOW" 64 "VADDRAINSNOW" 65 "VADDTEXT" 66 "VADDSECTION" 67 "VADDDISTANCE" 68 "VADDWEIGHT" 69 "VADDZONE" 70 "VADDCRASHRISK" 71 "VADDACCIDENT" 72 "VADDJAM" 73 "VADDOILTRAIL" 74 "VADDGRAVEL" 75 "VADDDIRT" 76 "VADDROADDAMAGE" 77 "VADDRUTS" 78 "ADDNOSTOPSHOULDER" 79 "ADDTOWING" 80 "ADDSCHOOL" 81 "ADDNIGHT" 82 "ADDEND" 83 "ADDBEGINS" 84 "ADDWITHIN" 85 "ADDDISTANCEBARS" 86 "ADDMINIMUM" 87 "ADDADVICE" 88 "ADDACCESS" 89 "ADDALLWAY" 90 "ADDBUS_EXCEPT" 91 "ADDEXCEPTDELIVERY" 92 "ADDEXCEPTLOCAL" 93 "ADDFROG" 94 "ADDPRIOTURNL" 95 "ADDPRIOTURNR" 96 "ADDSTART" 97 "ADDSTOPIN" 98 "ADDEXIT" 99 "ADDHAZWATER" 100 "ADDDAY" 101 "ADDSL" 102 "ADDLORRYTRAILER" 103 "ADDLORRYSEMI" 104 "VADDLORRYTRAILER" 105 "VADDLORRYSEMI" 106 "ADDSLOW" 107 "ADDSL5" 108 "ADDSL10" 109 "ADDSL15" 110 "ADDSL20" 111 "ADDSL25" 112 "ADDSL30" 113 "ADDSL35" 114 "ADDSL40" 115 "ADDSL45" 116 "ADDSL50" 117 "ADDSL55" 118 "ADDSL60" 119 "ADDSL65" 120 "ADDSL70" 121 "ADDSL75" 122 "ADDSL80" 123 "ADDSL85" 124 "ADDSL90" 125 "ADDSL95" 126 "ADDSL100" 127 "ADDSL105" 128 "ADDSL110" 129 "ADDSL115" 130 "ADDSL120" 131 "ADDSL125" 132 "ADDSL130" 133 "ADDSL135" 134 "ADDSL140" 135 "ADDSL145" 136 "ADDSL150" 137 "ADDSL155" 138 "ADDSL160" 139 "ADDBIKEROAD" 140 "ADDLORRYTRAILER_EXCEPT" 141 "ADDLORRYSEMI_EXCEPT" 142 "Reserved142" 143 "Reserved143" 144 "Reserved144" 145 "Reserved145" 146 "Reserved146" 147 "Reserved147" 148 "Reserved148" 149 "Reserved149" 150 "Reserved150" 151 "Reserved151" 152 "Reserved152" 153 "Reserved153" 154 "Reserved154" 155 "Reserved155" 156 "Reserved156" 157 "Reserved157" 158 "Reserved158" 159 "Reserved159" 160 "Reserved160" 161 "Reserved161" 162 "Reserved162" 163 "Reserved163" 164 "Reserved164" 165 "Reserved165" 166 "Reserved166" 167 "Reserved167" 168 "Reserved168" 169 "Reserved169" ;
VAL_ 239 VFC_TS02_Type 0 "UNKNOWN" 1 "SL5" 2 "SL10" 3 "SL15" 4 "SL20" 5 "SL25" 6 "SL30" 7 "SL35" 8 "SL40" 9 "SL45" 10 "SL50" 11 "SL55" 12 "SL60" 13 "SL65" 14 "SL70" 15 "SL75" 16 "SL80" 17 "SL85" 18 "SL90" 19 "SL95" 20 "SL100" 21 "SL105" 22 "SL110" 23 "SL115" 24 "SL120" 25 "SL125" 26 "SL130" 27 "SL135" 28 "SL140" 29 "SL145" 30 "SL150" 31 "SL155" 32 "SL160" 33 "OP" 34 "OL" 35 "ESL" 36 "EOP" 37 "EOL" 38 "EA" 39 "VSL5" 40 "VSL10" 41 "VSL15" 42 "VSL20" 43 "VSL25" 44 "VSL30" 45 "VSL35" 46 "VSL40" 47 "VSL45" 48 "VSL50" 49 "VSL55" 50 "VSL60" 51 "VSL65" 52 "VSL70" 53 "VSL75" 54 "VSL80" 55 "VSL85" 56 "VSL90" 57 "VSL95" 58 "VSL100" 59 "VSL105" 60 "VSL110" 61 "VSL115" 62 "VSL120" 63 "VSL125" 64 "VSL130" 65 "VSL135" 66 "VSL140" 67 "VSL145" 68 "VSL150" 69 "VSL155" 70 "VSL160" 71 "VOP" 72 "VOL" 73 "VESL" 74 "VEOP" 75 "VEOL" 76 "VEA" 77 "NOENTRY" 78 "NOALL" 79 "NOCAR" 80 "NOLORRY" 81 "NOHAZMAT" 82 "NOBIKE" 83 "NOPED" 84 "NOCARBIKE" 85 "NOTWOWAY" 86 "WEIGHT" 87 "HEIGHT" 88 "WIDTH" 89 "LENGTH" 90 "PRIOCROSS" 91 "GIVEWAY" 92 "PRIOCROSSYIELDTORIGHT" 93 "WARNDANGER" 94 "WARNCURVEL" 95 "WARNCURVER" 96 "WARNDCURVEL" 97 "WARNDCURVER" 98 "WARNTRAIN" 99 "WARNJAM" 100 "WARNANIMAL_DEPRECATED" 101 "WARNRWORKS" 102 "WARNSLOPED" 103 "WARNSLOPEU" 104 "PRIOSTREET" 105 "EPRIOSTREET" 106 "STOP" 107 "ASL" 108 "EASL" 109 "MSL" 110 "EMSL" 111 "MLC" 112 "WBDIAGL" 113 "WBDIAGR" 114 "WBROUND" 115 "NOLTURN" 116 "NORTURN" 117 "NOUTURN" 118 "NOPARK" 119 "NOSTOP" 120 "SMOG" 121 "UMWELT" 122 "EUMWELT" 123 "DOUANE" 124 "FWAY" 125 "EFWAY" 126 "HWAY" 127 "EHWAY" 128 "NORIDER" 129 "WARNCONST" 130 "WARNCONSTL" 131 "WARNCONSTR" 132 "WARNPED" 133 "WARNKIDS" 134 "WARNBIKE" 135 "WARNSKID" 136 "ZEBRA" 137 "ONEWAYS" 138 "ONEWAYU" 139 "SLOWDOWN" 140 "NOCARRIAGE" 141 "NOLORRYTRAILER" 142 "NOBUS" 143 "NOTRACTOR" 144 "LORRYDIST" 145 "CARDIST" 146 "WARNROUND" 147 "WARNWILDANIMAL" 148 "WARNCATTLE" 149 "WARNFROG" 150 "WARNBUS" 151 "WARNWIND" 152 "WARNSNOW" 153 "WARNPCROSS" 154 "WARNHUMP" 155 "WARNROCK" 156 "WARNLOWTREE" 157 "WARNGRAVEL" 158 "WARNTWOWAY" 159 "WARNLIGHTS" 160 "WARNPLANE" 161 "VNOENTRY" 162 "VNOALL" 163 "VNOCAR" 164 "VNOLORRY" 165 "VNOCARBIKE" 166 "VWEIGHT" 167 "VHEIGHT" 168 "VWIDTH" 169 "VLENGTH" 170 "VWARNDANGER" 171 "VWARNJAM" 172 "VWARNRWORKS" 173 "VWARNSKID" 174 "VASL" 175 "VEASL" 176 "VNOLORRYTRAILER" 177 "VNOBUS" 178 "VLORRYDIST" 179 "VCARDIST" 180 "VWARNSNOW" 181 "VWARNHUMP" 182 "VWARNGRAVEL" 183 "CALM" 184 "ECALM" 185 "TWN" 186 "ETWN" 187 "DEADEND" 188 "AXLEWEIGHT" 189 "WARNRIDER" 190 "WARNDRAWBRIDGE" 191 "WARNPIER" 192 "TRINATURE" 193 "VWARNCONST" 194 "VWARNCONSTL" 195 "VWARNCONSTR" 196 "VWARNCURVEL" 197 "VWARNCURVER" 198 "VWARNDCURVEL" 199 "VWARNDCURVER" 200 "VWARNLIGHTS" 201 "WBBENTLEFT" 202 "WBBENTLEFTRIGHT" 203 "WBBENTRIGHT" 204 "WBDIAGLR" 205 "WBLEFT" 206 "WBRIGHT" 207 "WBUP" 208 "WBUPLEFT" 209 "WBUPRIGHT" 210 "WBHAZWATER" 211 "NOHAZWATER" 212 "SCHOOL" 213 "ESCHOOL" 214 "HAZMAT" 215 "EMERGENCYBAY" 216 "ENDOFLANEL" 217 "ENDOFLANER" 218 "ENOPARK" 219 "EONEWAY" 220 "EPARK" 221 "ETOLL" 222 "NOPARKL" 223 "NOPARKLR" 224 "NOPARKR" 225 "NOSTOPL" 226 "NOSTOPLR" 227 "NOSTOPR" 228 "NOTURNONRED" 229 "ONEWAYL" 230 "ONEWAYR" 231 "PARK" 232 "PRIOCROSSL" 233 "PRIOCROSSR" 234 "TOLL" 235 "TUNNEL" 236 "TWOWAY" 237 "WARNCROSS" 238 "WARNCROSSL" 239 "WARNCROSSLR" 240 "WARNCROSSR" 241 "WARNCROSSRL" 242 "WARNCROSST" 243 "WARNGIVEWAYAHEAD" 244 "WARNSLAHEAD" 245 "WARNSTOPAHEAD" 246 "WBBUS" 247 "WRONGWAY" 248 "HAZWATER" 249 "GIVEWAYROUND" 250 "WARNWINDINGL" 251 "WARNWINDINGR" 252 "WARNHAIRPINL" 253 "WARNHAIRPINR" 254 "WARNPEDBIKE" 255 "WARNCROSSY" 256 "WARNBRANCHL" 257 "WARNBRANCHR" 258 "WARNAXLEWEIGHT" 259 "WARNWEIGHT" 260 "WARNHEIGHT" 261 "WARNLENGTH" 262 "WARNWIDTH" 263 "WARNBLACKSPOT" 264 "WARNMERGEL" 265 "WARNMERGER" 266 "WARNTUNNEL" 267 "WARNTRACTOR" 268 "WARNRWORKSVEHICLE" 269 "WARNNARROWBRIDGE" 270 "WARNFLAGGER" 271 "LANES" 272 "LANESHIFTL" 273 "LANESHIFTR" 274 "NEWLANEL" 275 "NEWLANER" 276 "RIGHTTURNONRED" 277 "BORDERLIMIT" 278 "EMBEDDEDRAIN" 279 "VWARNWEIGHT" 280 "VWARNHEIGHT" 281 "VWARNLENGTH" 282 "VWARNWIDTH" 283 "VENDOFLANEL" 284 "VENDOFLANER" 285 "VLANES" 286 "VLANESHIFTL" 287 "VLANESHIFTR" 288 "VNEWLANEL" 289 "VNEWLANER" 290 "NOUP" 291 "VOFF" 292 "ASL5" 293 "ASL10" 294 "ASL15" 295 "ASL20" 296 "ASL25" 297 "ASL30" 298 "ASL35" 299 "ASL40" 300 "ASL45" 301 "ASL50" 302 "ASL55" 303 "ASL60" 304 "ASL65" 305 "ASL70" 306 "ASL75" 307 "ASL80" 308 "ASL85" 309 "ASL90" 310 "ASL95" 311 "ASL100" 312 "ASL105" 313 "ASL110" 314 "ASL115" 315 "ASL120" 316 "ASL125" 317 "ASL130" 318 "ASL135" 319 "ASL140" 320 "ASL145" 321 "ASL150" 322 "ASL155" 323 "ASL160" 324 "VASL5" 325 "VASL10" 326 "VASL15" 327 "VASL20" 328 "VASL25" 329 "VASL30" 330 "VASL35" 331 "VASL40" 332 "VASL45" 333 "VASL50" 334 "VASL55" 335 "VASL60" 336 "VASL65" 337 "VASL70" 338 "VASL75" 339 "VASL80" 340 "VASL85" 341 "VASL90" 342 "VASL95" 343 "VASL100" 344 "VASL105" 345 "VASL110" 346 "VASL115" 347 "VASL120" 348 "VASL125" 349 "VASL130" 350 "VASL135" 351 "VASL140" 352 "VASL145" 353 "VASL150" 354 "VASL155" 355 "VASL160" 356 "WARNTRAINGATED" 357 "KEEPRIGHTCAR" 358 "ASLCURVE5" 359 "ASLCURVE10" 360 "ASLCURVE15" 361 "ASLCURVE20" 362 "ASLCURVE25" 363 "ASLCURVE30" 364 "ASLCURVE35" 365 "ASLCURVE40" 366 "ASLCURVE45" 367 "ASLCURVE50" 368 "ASLCURVE55" 369 "ASLCURVE60" 370 "ASLCURVE65" 371 "ASLCURVE70" 372 "ASLCURVE75" 373 "ASLCURVE80" 374 "ASLCURVE85" 375 "ASLCURVE90" 376 "ASLCURVE95" 377 "ASLCURVE100" 378 "ASLCURVE105" 379 "ASLCURVE110" 380 "ASLCURVE115" 381 "ASLCURVE120" 382 "ASLCURVE125" 383 "ASLCURVE130" 384 "ASLCURVE135" 385 "ASLCURVE140" 386 "ASLCURVE145" 387 "ASLCURVE150" 388 "ASLCURVE155" 389 "ASLCURVE160" 390 "KIDS" 391 "EKIDS" 392 "BIKEROAD" 393 "EBIKEROAD" 394 "PEDSTREET" 395 "EPEDSTREET" 396 "PEDBIKESTREET" 397 "EPEDBIKESTREET" 398 "EWARNKIDS" 399 "CALM20" 400 "CALM30" 401 "ECALM20" 402 "ECALM30" 403 "FWAYGREEN" 404 "TWN40" 405 "TWN50" 406 "TWN60" 407 "TWN70" 408 "ETWN40" 409 "ETWN50" 410 "ETWN60" 411 "ETWN70" 412 "WBBIKE" 413 "EWBBIKE" 414 "WBPED" 415 "EWBPED" 416 "WBPEDBIKESEP" 417 "EWBPEDBIKESEP" 418 "WBPEDBIKESHARED" 419 "EWBPEDBIKESHARED" 420 "EFWAYGREEN" 421 "Reserved0421" 422 "Reserved0422" 423 "Reserved0423" 424 "Reserved0424" 425 "Reserved0425" 426 "Reserved0426" 427 "Reserved0427" 428 "Reserved0428" 429 "Reserved0429" 430 "Reserved0430" 431 "Reserved0431" 432 "Reserved0432" 433 "Reserved0433" 434 "Reserved0434" 435 "Reserved0435" 436 "Reserved0436" 437 "Reserved0437" 438 "Reserved0438" 439 "Reserved0439" 440 "Reserved0440" 441 "Reserved0441" 442 "Reserved0442" 443 "Reserved0443" 444 "Reserved0444" 445 "Reserved0445" 446 "Reserved0446" 447 "Reserved0447" 448 "Reserved0448" 449 "Reserved0449" ;
VAL_ 239 VFC_TS02_EmbeddedInfo 0 "Unknown" 1 "Not Embedded" 2 "Border Limit" 3 "Multi Lane" 4 "Rain" 5 "Vehicle Type" 6 "Plate" 7 "Error Value" 8 "Vehicle Sticker" 9 "Reserved09" 10 "Reserved10" 11 "Reserved11" 12 "Reserved12" 13 "Reserved13" 14 "Reserved14" 15 "Reserved15" ;
VAL_ 239 VFC_TS02_ValidTimeRange1Start 127 "Unknown" ;
VAL_ 239 VFC_TS02_ValidTimeRange1End 127 "Unknown" ;
VAL_ 239 VFC_TS02_ValidTimeRange2Start 127 "Unknown" ;
VAL_ 239 VFC_TS02_ValidTimeRange2End 127 "Unknown" ;
VAL_ 239 VFC_TS02_ValidInDistUnit 0 "Unknown" ;
VAL_ 239 VFC_TS02_ValidSectionUnit 0 "Unknown" 1 "Meter" 2 "Kilometer" 3 "Foot" 4 "Yard" 5 "Mile" 6 "Reserved6" 7 "Reserved7" ;
VAL_ 239 VFC_TS02_SupSign0Type 0 "UNKNOWN" 1 "ADDCAR" 2 "ADDLORRY" 3 "ADDTRAILER" 4 "ADDCARAVAN" 5 "ADDBUS" 6 "ADDTRACTOR" 7 "ADDMCYCLE" 8 "ADDLORRYBUSTRAILER_DEPRECATED" 9 "ADDLORRYBUS_DEPRECATED" 10 "ADDHAZMAT" 11 "ADDTANK" 12 "ADDTRAM" 13 "ADDWET" 14 "ADDFOG" 15 "ADDRAIN" 16 "ADDSNOW" 17 "ADDTIME" 18 "ADDSECTION" 19 "ADDDISTANCE" 20 "ADDWEIGHT" 21 "ADDEXITL" 22 "ADDEXITR" 23 "ADDLANES" 24 "ADDRADAR" 25 "ADDRAPPEL" 26 "ADDPRIOTURN" 27 "ADDLORRY_EXCEPT" 28 "ADDTRACTOR_OVER" 29 "ADDTEXT" 30 "ADDSIGN" 31 "ADDRAINSNOW" 32 "ADDHUMP" 33 "VADDLORRYBUSTRAILER_DEPRECATED" 34 "VADDLORRYBUS_DEPRECATED" 35 "VADDLORRYTRAILER_DEPRECATED" 36 "ADDLORRYTRAILER_DEPRECATED" 37 "ADDCAMPER" 38 "ADDZONE" 39 "ADDCRASHRISK" 40 "ADDACCIDENT" 41 "ADDJAM" 42 "ADDSMOKE" 43 "ADDOILTRAIL" 44 "ADDGRAVEL" 45 "ADDDIRT" 46 "ADDRWORKSEXIT" 47 "ADDROADDAMAGE" 48 "ADDRWORKSENTRY" 49 "ADDLOWTREE" 50 "ADDRWORKSACCESS" 51 "ADDRUTS" 52 "ADDSOFTSHOULDERCAR" 53 "ADDSOFTSHOULDERLORRY" 54 "VADDSIGN" 55 "VADDCAR" 56 "VADDLORRY" 57 "VADDTRAILER" 58 "VADDCARAVAN" 59 "VADDBUS" 60 "VADDWET" 61 "VADDFOG" 62 "VADDRAIN" 63 "VADDSNOW" 64 "VADDRAINSNOW" 65 "VADDTEXT" 66 "VADDSECTION" 67 "VADDDISTANCE" 68 "VADDWEIGHT" 69 "VADDZONE" 70 "VADDCRASHRISK" 71 "VADDACCIDENT" 72 "VADDJAM" 73 "VADDOILTRAIL" 74 "VADDGRAVEL" 75 "VADDDIRT" 76 "VADDROADDAMAGE" 77 "VADDRUTS" 78 "ADDNOSTOPSHOULDER" 79 "ADDTOWING" 80 "ADDSCHOOL" 81 "ADDNIGHT" 82 "ADDEND" 83 "ADDBEGINS" 84 "ADDWITHIN" 85 "ADDDISTANCEBARS" 86 "ADDMINIMUM" 87 "ADDADVICE" 88 "ADDACCESS" 89 "ADDALLWAY" 90 "ADDBUS_EXCEPT" 91 "ADDEXCEPTDELIVERY" 92 "ADDEXCEPTLOCAL" 93 "ADDFROG" 94 "ADDPRIOTURNL" 95 "ADDPRIOTURNR" 96 "ADDSTART" 97 "ADDSTOPIN" 98 "ADDEXIT" 99 "ADDHAZWATER" 100 "ADDDAY" 101 "ADDSL" 102 "ADDLORRYTRAILER" 103 "ADDLORRYSEMI" 104 "VADDLORRYTRAILER" 105 "VADDLORRYSEMI" 106 "ADDSLOW" 107 "ADDSL5" 108 "ADDSL10" 109 "ADDSL15" 110 "ADDSL20" 111 "ADDSL25" 112 "ADDSL30" 113 "ADDSL35" 114 "ADDSL40" 115 "ADDSL45" 116 "ADDSL50" 117 "ADDSL55" 118 "ADDSL60" 119 "ADDSL65" 120 "ADDSL70" 121 "ADDSL75" 122 "ADDSL80" 123 "ADDSL85" 124 "ADDSL90" 125 "ADDSL95" 126 "ADDSL100" 127 "ADDSL105" 128 "ADDSL110" 129 "ADDSL115" 130 "ADDSL120" 131 "ADDSL125" 132 "ADDSL130" 133 "ADDSL135" 134 "ADDSL140" 135 "ADDSL145" 136 "ADDSL150" 137 "ADDSL155" 138 "ADDSL160" 139 "ADDBIKEROAD" 140 "ADDLORRYTRAILER_EXCEPT" 141 "ADDLORRYSEMI_EXCEPT" 142 "Reserved142" 143 "Reserved143" 144 "Reserved144" 145 "Reserved145" 146 "Reserved146" 147 "Reserved147" 148 "Reserved148" 149 "Reserved149" 150 "Reserved150" 151 "Reserved151" 152 "Reserved152" 153 "Reserved153" 154 "Reserved154" 155 "Reserved155" 156 "Reserved156" 157 "Reserved157" 158 "Reserved158" 159 "Reserved159" 160 "Reserved160" 161 "Reserved161" 162 "Reserved162" 163 "Reserved163" 164 "Reserved164" 165 "Reserved165" 166 "Reserved166" 167 "Reserved167" 168 "Reserved168" 169 "Reserved169" ;
VAL_ 239 VFC_TS02_SupSign1Type 0 "UNKNOWN" 1 "ADDCAR" 2 "ADDLORRY" 3 "ADDTRAILER" 4 "ADDCARAVAN" 5 "ADDBUS" 6 "ADDTRACTOR" 7 "ADDMCYCLE" 8 "ADDLORRYBUSTRAILER_DEPRECATED" 9 "ADDLORRYBUS_DEPRECATED" 10 "ADDHAZMAT" 11 "ADDTANK" 12 "ADDTRAM" 13 "ADDWET" 14 "ADDFOG" 15 "ADDRAIN" 16 "ADDSNOW" 17 "ADDTIME" 18 "ADDSECTION" 19 "ADDDISTANCE" 20 "ADDWEIGHT" 21 "ADDEXITL" 22 "ADDEXITR" 23 "ADDLANES" 24 "ADDRADAR" 25 "ADDRAPPEL" 26 "ADDPRIOTURN" 27 "ADDLORRY_EXCEPT" 28 "ADDTRACTOR_OVER" 29 "ADDTEXT" 30 "ADDSIGN" 31 "ADDRAINSNOW" 32 "ADDHUMP" 33 "VADDLORRYBUSTRAILER_DEPRECATED" 34 "VADDLORRYBUS_DEPRECATED" 35 "VADDLORRYTRAILER_DEPRECATED" 36 "ADDLORRYTRAILER_DEPRECATED" 37 "ADDCAMPER" 38 "ADDZONE" 39 "ADDCRASHRISK" 40 "ADDACCIDENT" 41 "ADDJAM" 42 "ADDSMOKE" 43 "ADDOILTRAIL" 44 "ADDGRAVEL" 45 "ADDDIRT" 46 "ADDRWORKSEXIT" 47 "ADDROADDAMAGE" 48 "ADDRWORKSENTRY" 49 "ADDLOWTREE" 50 "ADDRWORKSACCESS" 51 "ADDRUTS" 52 "ADDSOFTSHOULDERCAR" 53 "ADDSOFTSHOULDERLORRY" 54 "VADDSIGN" 55 "VADDCAR" 56 "VADDLORRY" 57 "VADDTRAILER" 58 "VADDCARAVAN" 59 "VADDBUS" 60 "VADDWET" 61 "VADDFOG" 62 "VADDRAIN" 63 "VADDSNOW" 64 "VADDRAINSNOW" 65 "VADDTEXT" 66 "VADDSECTION" 67 "VADDDISTANCE" 68 "VADDWEIGHT" 69 "VADDZONE" 70 "VADDCRASHRISK" 71 "VADDACCIDENT" 72 "VADDJAM" 73 "VADDOILTRAIL" 74 "VADDGRAVEL" 75 "VADDDIRT" 76 "VADDROADDAMAGE" 77 "VADDRUTS" 78 "ADDNOSTOPSHOULDER" 79 "ADDTOWING" 80 "ADDSCHOOL" 81 "ADDNIGHT" 82 "ADDEND" 83 "ADDBEGINS" 84 "ADDWITHIN" 85 "ADDDISTANCEBARS" 86 "ADDMINIMUM" 87 "ADDADVICE" 88 "ADDACCESS" 89 "ADDALLWAY" 90 "ADDBUS_EXCEPT" 91 "ADDEXCEPTDELIVERY" 92 "ADDEXCEPTLOCAL" 93 "ADDFROG" 94 "ADDPRIOTURNL" 95 "ADDPRIOTURNR" 96 "ADDSTART" 97 "ADDSTOPIN" 98 "ADDEXIT" 99 "ADDHAZWATER" 100 "ADDDAY" 101 "ADDSL" 102 "ADDLORRYTRAILER" 103 "ADDLORRYSEMI" 104 "VADDLORRYTRAILER" 105 "VADDLORRYSEMI" 106 "ADDSLOW" 107 "ADDSL5" 108 "ADDSL10" 109 "ADDSL15" 110 "ADDSL20" 111 "ADDSL25" 112 "ADDSL30" 113 "ADDSL35" 114 "ADDSL40" 115 "ADDSL45" 116 "ADDSL50" 117 "ADDSL55" 118 "ADDSL60" 119 "ADDSL65" 120 "ADDSL70" 121 "ADDSL75" 122 "ADDSL80" 123 "ADDSL85" 124 "ADDSL90" 125 "ADDSL95" 126 "ADDSL100" 127 "ADDSL105" 128 "ADDSL110" 129 "ADDSL115" 130 "ADDSL120" 131 "ADDSL125" 132 "ADDSL130" 133 "ADDSL135" 134 "ADDSL140" 135 "ADDSL145" 136 "ADDSL150" 137 "ADDSL155" 138 "ADDSL160" 139 "ADDBIKEROAD" 140 "ADDLORRYTRAILER_EXCEPT" 141 "ADDLORRYSEMI_EXCEPT" 142 "Reserved142" 143 "Reserved143" 144 "Reserved144" 145 "Reserved145" 146 "Reserved146" 147 "Reserved147" 148 "Reserved148" 149 "Reserved149" 150 "Reserved150" 151 "Reserved151" 152 "Reserved152" 153 "Reserved153" 154 "Reserved154" 155 "Reserved155" 156 "Reserved156" 157 "Reserved157" 158 "Reserved158" 159 "Reserved159" 160 "Reserved160" 161 "Reserved161" 162 "Reserved162" 163 "Reserved163" 164 "Reserved164" 165 "Reserved165" 166 "Reserved166" 167 "Reserved167" 168 "Reserved168" 169 "Reserved169" ;
VAL_ 239 VFC_TS02_SupSign2Type 0 "UNKNOWN" 1 "ADDCAR" 2 "ADDLORRY" 3 "ADDTRAILER" 4 "ADDCARAVAN" 5 "ADDBUS" 6 "ADDTRACTOR" 7 "ADDMCYCLE" 8 "ADDLORRYBUSTRAILER_DEPRECATED" 9 "ADDLORRYBUS_DEPRECATED" 10 "ADDHAZMAT" 11 "ADDTANK" 12 "ADDTRAM" 13 "ADDWET" 14 "ADDFOG" 15 "ADDRAIN" 16 "ADDSNOW" 17 "ADDTIME" 18 "ADDSECTION" 19 "ADDDISTANCE" 20 "ADDWEIGHT" 21 "ADDEXITL" 22 "ADDEXITR" 23 "ADDLANES" 24 "ADDRADAR" 25 "ADDRAPPEL" 26 "ADDPRIOTURN" 27 "ADDLORRY_EXCEPT" 28 "ADDTRACTOR_OVER" 29 "ADDTEXT" 30 "ADDSIGN" 31 "ADDRAINSNOW" 32 "ADDHUMP" 33 "VADDLORRYBUSTRAILER_DEPRECATED" 34 "VADDLORRYBUS_DEPRECATED" 35 "VADDLORRYTRAILER_DEPRECATED" 36 "ADDLORRYTRAILER_DEPRECATED" 37 "ADDCAMPER" 38 "ADDZONE" 39 "ADDCRASHRISK" 40 "ADDACCIDENT" 41 "ADDJAM" 42 "ADDSMOKE" 43 "ADDOILTRAIL" 44 "ADDGRAVEL" 45 "ADDDIRT" 46 "ADDRWORKSEXIT" 47 "ADDROADDAMAGE" 48 "ADDRWORKSENTRY" 49 "ADDLOWTREE" 50 "ADDRWORKSACCESS" 51 "ADDRUTS" 52 "ADDSOFTSHOULDERCAR" 53 "ADDSOFTSHOULDERLORRY" 54 "VADDSIGN" 55 "VADDCAR" 56 "VADDLORRY" 57 "VADDTRAILER" 58 "VADDCARAVAN" 59 "VADDBUS" 60 "VADDWET" 61 "VADDFOG" 62 "VADDRAIN" 63 "VADDSNOW" 64 "VADDRAINSNOW" 65 "VADDTEXT" 66 "VADDSECTION" 67 "VADDDISTANCE" 68 "VADDWEIGHT" 69 "VADDZONE" 70 "VADDCRASHRISK" 71 "VADDACCIDENT" 72 "VADDJAM" 73 "VADDOILTRAIL" 74 "VADDGRAVEL" 75 "VADDDIRT" 76 "VADDROADDAMAGE" 77 "VADDRUTS" 78 "ADDNOSTOPSHOULDER" 79 "ADDTOWING" 80 "ADDSCHOOL" 81 "ADDNIGHT" 82 "ADDEND" 83 "ADDBEGINS" 84 "ADDWITHIN" 85 "ADDDISTANCEBARS" 86 "ADDMINIMUM" 87 "ADDADVICE" 88 "ADDACCESS" 89 "ADDALLWAY" 90 "ADDBUS_EXCEPT" 91 "ADDEXCEPTDELIVERY" 92 "ADDEXCEPTLOCAL" 93 "ADDFROG" 94 "ADDPRIOTURNL" 95 "ADDPRIOTURNR" 96 "ADDSTART" 97 "ADDSTOPIN" 98 "ADDEXIT" 99 "ADDHAZWATER" 100 "ADDDAY" 101 "ADDSL" 102 "ADDLORRYTRAILER" 103 "ADDLORRYSEMI" 104 "VADDLORRYTRAILER" 105 "VADDLORRYSEMI" 106 "ADDSLOW" 107 "ADDSL5" 108 "ADDSL10" 109 "ADDSL15" 110 "ADDSL20" 111 "ADDSL25" 112 "ADDSL30" 113 "ADDSL35" 114 "ADDSL40" 115 "ADDSL45" 116 "ADDSL50" 117 "ADDSL55" 118 "ADDSL60" 119 "ADDSL65" 120 "ADDSL70" 121 "ADDSL75" 122 "ADDSL80" 123 "ADDSL85" 124 "ADDSL90" 125 "ADDSL95" 126 "ADDSL100" 127 "ADDSL105" 128 "ADDSL110" 129 "ADDSL115" 130 "ADDSL120" 131 "ADDSL125" 132 "ADDSL130" 133 "ADDSL135" 134 "ADDSL140" 135 "ADDSL145" 136 "ADDSL150" 137 "ADDSL155" 138 "ADDSL160" 139 "ADDBIKEROAD" 140 "ADDLORRYTRAILER_EXCEPT" 141 "ADDLORRYSEMI_EXCEPT" 142 "Reserved142" 143 "Reserved143" 144 "Reserved144" 145 "Reserved145" 146 "Reserved146" 147 "Reserved147" 148 "Reserved148" 149 "Reserved149" 150 "Reserved150" 151 "Reserved151" 152 "Reserved152" 153 "Reserved153" 154 "Reserved154" 155 "Reserved155" 156 "Reserved156" 157 "Reserved157" 158 "Reserved158" 159 "Reserved159" 160 "Reserved160" 161 "Reserved161" 162 "Reserved162" 163 "Reserved163" 164 "Reserved164" 165 "Reserved165" 166 "Reserved166" 167 "Reserved167" 168 "Reserved168" 169 "Reserved169" ;
VAL_ 239 VFC_TS02_SupSign3Type 0 "UNKNOWN" 1 "ADDCAR" 2 "ADDLORRY" 3 "ADDTRAILER" 4 "ADDCARAVAN" 5 "ADDBUS" 6 "ADDTRACTOR" 7 "ADDMCYCLE" 8 "ADDLORRYBUSTRAILER_DEPRECATED" 9 "ADDLORRYBUS_DEPRECATED" 10 "ADDHAZMAT" 11 "ADDTANK" 12 "ADDTRAM" 13 "ADDWET" 14 "ADDFOG" 15 "ADDRAIN" 16 "ADDSNOW" 17 "ADDTIME" 18 "ADDSECTION" 19 "ADDDISTANCE" 20 "ADDWEIGHT" 21 "ADDEXITL" 22 "ADDEXITR" 23 "ADDLANES" 24 "ADDRADAR" 25 "ADDRAPPEL" 26 "ADDPRIOTURN" 27 "ADDLORRY_EXCEPT" 28 "ADDTRACTOR_OVER" 29 "ADDTEXT" 30 "ADDSIGN" 31 "ADDRAINSNOW" 32 "ADDHUMP" 33 "VADDLORRYBUSTRAILER_DEPRECATED" 34 "VADDLORRYBUS_DEPRECATED" 35 "VADDLORRYTRAILER_DEPRECATED" 36 "ADDLORRYTRAILER_DEPRECATED" 37 "ADDCAMPER" 38 "ADDZONE" 39 "ADDCRASHRISK" 40 "ADDACCIDENT" 41 "ADDJAM" 42 "ADDSMOKE" 43 "ADDOILTRAIL" 44 "ADDGRAVEL" 45 "ADDDIRT" 46 "ADDRWORKSEXIT" 47 "ADDROADDAMAGE" 48 "ADDRWORKSENTRY" 49 "ADDLOWTREE" 50 "ADDRWORKSACCESS" 51 "ADDRUTS" 52 "ADDSOFTSHOULDERCAR" 53 "ADDSOFTSHOULDERLORRY" 54 "VADDSIGN" 55 "VADDCAR" 56 "VADDLORRY" 57 "VADDTRAILER" 58 "VADDCARAVAN" 59 "VADDBUS" 60 "VADDWET" 61 "VADDFOG" 62 "VADDRAIN" 63 "VADDSNOW" 64 "VADDRAINSNOW" 65 "VADDTEXT" 66 "VADDSECTION" 67 "VADDDISTANCE" 68 "VADDWEIGHT" 69 "VADDZONE" 70 "VADDCRASHRISK" 71 "VADDACCIDENT" 72 "VADDJAM" 73 "VADDOILTRAIL" 74 "VADDGRAVEL" 75 "VADDDIRT" 76 "VADDROADDAMAGE" 77 "VADDRUTS" 78 "ADDNOSTOPSHOULDER" 79 "ADDTOWING" 80 "ADDSCHOOL" 81 "ADDNIGHT" 82 "ADDEND" 83 "ADDBEGINS" 84 "ADDWITHIN" 85 "ADDDISTANCEBARS" 86 "ADDMINIMUM" 87 "ADDADVICE" 88 "ADDACCESS" 89 "ADDALLWAY" 90 "ADDBUS_EXCEPT" 91 "ADDEXCEPTDELIVERY" 92 "ADDEXCEPTLOCAL" 93 "ADDFROG" 94 "ADDPRIOTURNL" 95 "ADDPRIOTURNR" 96 "ADDSTART" 97 "ADDSTOPIN" 98 "ADDEXIT" 99 "ADDHAZWATER" 100 "ADDDAY" 101 "ADDSL" 102 "ADDLORRYTRAILER" 103 "ADDLORRYSEMI" 104 "VADDLORRYTRAILER" 105 "VADDLORRYSEMI" 106 "ADDSLOW" 107 "ADDSL5" 108 "ADDSL10" 109 "ADDSL15" 110 "ADDSL20" 111 "ADDSL25" 112 "ADDSL30" 113 "ADDSL35" 114 "ADDSL40" 115 "ADDSL45" 116 "ADDSL50" 117 "ADDSL55" 118 "ADDSL60" 119 "ADDSL65" 120 "ADDSL70" 121 "ADDSL75" 122 "ADDSL80" 123 "ADDSL85" 124 "ADDSL90" 125 "ADDSL95" 126 "ADDSL100" 127 "ADDSL105" 128 "ADDSL110" 129 "ADDSL115" 130 "ADDSL120" 131 "ADDSL125" 132 "ADDSL130" 133 "ADDSL135" 134 "ADDSL140" 135 "ADDSL145" 136 "ADDSL150" 137 "ADDSL155" 138 "ADDSL160" 139 "ADDBIKEROAD" 140 "ADDLORRYTRAILER_EXCEPT" 141 "ADDLORRYSEMI_EXCEPT" 142 "Reserved142" 143 "Reserved143" 144 "Reserved144" 145 "Reserved145" 146 "Reserved146" 147 "Reserved147" 148 "Reserved148" 149 "Reserved149" 150 "Reserved150" 151 "Reserved151" 152 "Reserved152" 153 "Reserved153" 154 "Reserved154" 155 "Reserved155" 156 "Reserved156" 157 "Reserved157" 158 "Reserved158" 159 "Reserved159" 160 "Reserved160" 161 "Reserved161" 162 "Reserved162" 163 "Reserved163" 164 "Reserved164" 165 "Reserved165" 166 "Reserved166" 167 "Reserved167" 168 "Reserved168" 169 "Reserved169" ;
VAL_ 239 VFC_TS02_SupSign4Type 0 "UNKNOWN" 1 "ADDCAR" 2 "ADDLORRY" 3 "ADDTRAILER" 4 "ADDCARAVAN" 5 "ADDBUS" 6 "ADDTRACTOR" 7 "ADDMCYCLE" 8 "ADDLORRYBUSTRAILER_DEPRECATED" 9 "ADDLORRYBUS_DEPRECATED" 10 "ADDHAZMAT" 11 "ADDTANK" 12 "ADDTRAM" 13 "ADDWET" 14 "ADDFOG" 15 "ADDRAIN" 16 "ADDSNOW" 17 "ADDTIME" 18 "ADDSECTION" 19 "ADDDISTANCE" 20 "ADDWEIGHT" 21 "ADDEXITL" 22 "ADDEXITR" 23 "ADDLANES" 24 "ADDRADAR" 25 "ADDRAPPEL" 26 "ADDPRIOTURN" 27 "ADDLORRY_EXCEPT" 28 "ADDTRACTOR_OVER" 29 "ADDTEXT" 30 "ADDSIGN" 31 "ADDRAINSNOW" 32 "ADDHUMP" 33 "VADDLORRYBUSTRAILER_DEPRECATED" 34 "VADDLORRYBUS_DEPRECATED" 35 "VADDLORRYTRAILER_DEPRECATED" 36 "ADDLORRYTRAILER_DEPRECATED" 37 "ADDCAMPER" 38 "ADDZONE" 39 "ADDCRASHRISK" 40 "ADDACCIDENT" 41 "ADDJAM" 42 "ADDSMOKE" 43 "ADDOILTRAIL" 44 "ADDGRAVEL" 45 "ADDDIRT" 46 "ADDRWORKSEXIT" 47 "ADDROADDAMAGE" 48 "ADDRWORKSENTRY" 49 "ADDLOWTREE" 50 "ADDRWORKSACCESS" 51 "ADDRUTS" 52 "ADDSOFTSHOULDERCAR" 53 "ADDSOFTSHOULDERLORRY" 54 "VADDSIGN" 55 "VADDCAR" 56 "VADDLORRY" 57 "VADDTRAILER" 58 "VADDCARAVAN" 59 "VADDBUS" 60 "VADDWET" 61 "VADDFOG" 62 "VADDRAIN" 63 "VADDSNOW" 64 "VADDRAINSNOW" 65 "VADDTEXT" 66 "VADDSECTION" 67 "VADDDISTANCE" 68 "VADDWEIGHT" 69 "VADDZONE" 70 "VADDCRASHRISK" 71 "VADDACCIDENT" 72 "VADDJAM" 73 "VADDOILTRAIL" 74 "VADDGRAVEL" 75 "VADDDIRT" 76 "VADDROADDAMAGE" 77 "VADDRUTS" 78 "ADDNOSTOPSHOULDER" 79 "ADDTOWING" 80 "ADDSCHOOL" 81 "ADDNIGHT" 82 "ADDEND" 83 "ADDBEGINS" 84 "ADDWITHIN" 85 "ADDDISTANCEBARS" 86 "ADDMINIMUM" 87 "ADDADVICE" 88 "ADDACCESS" 89 "ADDALLWAY" 90 "ADDBUS_EXCEPT" 91 "ADDEXCEPTDELIVERY" 92 "ADDEXCEPTLOCAL" 93 "ADDFROG" 94 "ADDPRIOTURNL" 95 "ADDPRIOTURNR" 96 "ADDSTART" 97 "ADDSTOPIN" 98 "ADDEXIT" 99 "ADDHAZWATER" 100 "ADDDAY" 101 "ADDSL" 102 "ADDLORRYTRAILER" 103 "ADDLORRYSEMI" 104 "VADDLORRYTRAILER" 105 "VADDLORRYSEMI" 106 "ADDSLOW" 107 "ADDSL5" 108 "ADDSL10" 109 "ADDSL15" 110 "ADDSL20" 111 "ADDSL25" 112 "ADDSL30" 113 "ADDSL35" 114 "ADDSL40" 115 "ADDSL45" 116 "ADDSL50" 117 "ADDSL55" 118 "ADDSL60" 119 "ADDSL65" 120 "ADDSL70" 121 "ADDSL75" 122 "ADDSL80" 123 "ADDSL85" 124 "ADDSL90" 125 "ADDSL95" 126 "ADDSL100" 127 "ADDSL105" 128 "ADDSL110" 129 "ADDSL115" 130 "ADDSL120" 131 "ADDSL125" 132 "ADDSL130" 133 "ADDSL135" 134 "ADDSL140" 135 "ADDSL145" 136 "ADDSL150" 137 "ADDSL155" 138 "ADDSL160" 139 "ADDBIKEROAD" 140 "ADDLORRYTRAILER_EXCEPT" 141 "ADDLORRYSEMI_EXCEPT" 142 "Reserved142" 143 "Reserved143" 144 "Reserved144" 145 "Reserved145" 146 "Reserved146" 147 "Reserved147" 148 "Reserved148" 149 "Reserved149" 150 "Reserved150" 151 "Reserved151" 152 "Reserved152" 153 "Reserved153" 154 "Reserved154" 155 "Reserved155" 156 "Reserved156" 157 "Reserved157" 158 "Reserved158" 159 "Reserved159" 160 "Reserved160" 161 "Reserved161" 162 "Reserved162" 163 "Reserved163" 164 "Reserved164" 165 "Reserved165" 166 "Reserved166" 167 "Reserved167" 168 "Reserved168" 169 "Reserved169" ;
VAL_ 239 VFC_TS02_SupSign5Type 0 "UNKNOWN" 1 "ADDCAR" 2 "ADDLORRY" 3 "ADDTRAILER" 4 "ADDCARAVAN" 5 "ADDBUS" 6 "ADDTRACTOR" 7 "ADDMCYCLE" 8 "ADDLORRYBUSTRAILER_DEPRECATED" 9 "ADDLORRYBUS_DEPRECATED" 10 "ADDHAZMAT" 11 "ADDTANK" 12 "ADDTRAM" 13 "ADDWET" 14 "ADDFOG" 15 "ADDRAIN" 16 "ADDSNOW" 17 "ADDTIME" 18 "ADDSECTION" 19 "ADDDISTANCE" 20 "ADDWEIGHT" 21 "ADDEXITL" 22 "ADDEXITR" 23 "ADDLANES" 24 "ADDRADAR" 25 "ADDRAPPEL" 26 "ADDPRIOTURN" 27 "ADDLORRY_EXCEPT" 28 "ADDTRACTOR_OVER" 29 "ADDTEXT" 30 "ADDSIGN" 31 "ADDRAINSNOW" 32 "ADDHUMP" 33 "VADDLORRYBUSTRAILER_DEPRECATED" 34 "VADDLORRYBUS_DEPRECATED" 35 "VADDLORRYTRAILER_DEPRECATED" 36 "ADDLORRYTRAILER_DEPRECATED" 37 "ADDCAMPER" 38 "ADDZONE" 39 "ADDCRASHRISK" 40 "ADDACCIDENT" 41 "ADDJAM" 42 "ADDSMOKE" 43 "ADDOILTRAIL" 44 "ADDGRAVEL" 45 "ADDDIRT" 46 "ADDRWORKSEXIT" 47 "ADDROADDAMAGE" 48 "ADDRWORKSENTRY" 49 "ADDLOWTREE" 50 "ADDRWORKSACCESS" 51 "ADDRUTS" 52 "ADDSOFTSHOULDERCAR" 53 "ADDSOFTSHOULDERLORRY" 54 "VADDSIGN" 55 "VADDCAR" 56 "VADDLORRY" 57 "VADDTRAILER" 58 "VADDCARAVAN" 59 "VADDBUS" 60 "VADDWET" 61 "VADDFOG" 62 "VADDRAIN" 63 "VADDSNOW" 64 "VADDRAINSNOW" 65 "VADDTEXT" 66 "VADDSECTION" 67 "VADDDISTANCE" 68 "VADDWEIGHT" 69 "VADDZONE" 70 "VADDCRASHRISK" 71 "VADDACCIDENT" 72 "VADDJAM" 73 "VADDOILTRAIL" 74 "VADDGRAVEL" 75 "VADDDIRT" 76 "VADDROADDAMAGE" 77 "VADDRUTS" 78 "ADDNOSTOPSHOULDER" 79 "ADDTOWING" 80 "ADDSCHOOL" 81 "ADDNIGHT" 82 "ADDEND" 83 "ADDBEGINS" 84 "ADDWITHIN" 85 "ADDDISTANCEBARS" 86 "ADDMINIMUM" 87 "ADDADVICE" 88 "ADDACCESS" 89 "ADDALLWAY" 90 "ADDBUS_EXCEPT" 91 "ADDEXCEPTDELIVERY" 92 "ADDEXCEPTLOCAL" 93 "ADDFROG" 94 "ADDPRIOTURNL" 95 "ADDPRIOTURNR" 96 "ADDSTART" 97 "ADDSTOPIN" 98 "ADDEXIT" 99 "ADDHAZWATER" 100 "ADDDAY" 101 "ADDSL" 102 "ADDLORRYTRAILER" 103 "ADDLORRYSEMI" 104 "VADDLORRYTRAILER" 105 "VADDLORRYSEMI" 106 "ADDSLOW" 107 "ADDSL5" 108 "ADDSL10" 109 "ADDSL15" 110 "ADDSL20" 111 "ADDSL25" 112 "ADDSL30" 113 "ADDSL35" 114 "ADDSL40" 115 "ADDSL45" 116 "ADDSL50" 117 "ADDSL55" 118 "ADDSL60" 119 "ADDSL65" 120 "ADDSL70" 121 "ADDSL75" 122 "ADDSL80" 123 "ADDSL85" 124 "ADDSL90" 125 "ADDSL95" 126 "ADDSL100" 127 "ADDSL105" 128 "ADDSL110" 129 "ADDSL115" 130 "ADDSL120" 131 "ADDSL125" 132 "ADDSL130" 133 "ADDSL135" 134 "ADDSL140" 135 "ADDSL145" 136 "ADDSL150" 137 "ADDSL155" 138 "ADDSL160" 139 "ADDBIKEROAD" 140 "ADDLORRYTRAILER_EXCEPT" 141 "ADDLORRYSEMI_EXCEPT" 142 "Reserved142" 143 "Reserved143" 144 "Reserved144" 145 "Reserved145" 146 "Reserved146" 147 "Reserved147" 148 "Reserved148" 149 "Reserved149" 150 "Reserved150" 151 "Reserved151" 152 "Reserved152" 153 "Reserved153" 154 "Reserved154" 155 "Reserved155" 156 "Reserved156" 157 "Reserved157" 158 "Reserved158" 159 "Reserved159" 160 "Reserved160" 161 "Reserved161" 162 "Reserved162" 163 "Reserved163" 164 "Reserved164" 165 "Reserved165" 166 "Reserved166" 167 "Reserved167" 168 "Reserved168" 169 "Reserved169" ;
VAL_ 239 VFC_TS03_Type 0 "UNKNOWN" 1 "SL5" 2 "SL10" 3 "SL15" 4 "SL20" 5 "SL25" 6 "SL30" 7 "SL35" 8 "SL40" 9 "SL45" 10 "SL50" 11 "SL55" 12 "SL60" 13 "SL65" 14 "SL70" 15 "SL75" 16 "SL80" 17 "SL85" 18 "SL90" 19 "SL95" 20 "SL100" 21 "SL105" 22 "SL110" 23 "SL115" 24 "SL120" 25 "SL125" 26 "SL130" 27 "SL135" 28 "SL140" 29 "SL145" 30 "SL150" 31 "SL155" 32 "SL160" 33 "OP" 34 "OL" 35 "ESL" 36 "EOP" 37 "EOL" 38 "EA" 39 "VSL5" 40 "VSL10" 41 "VSL15" 42 "VSL20" 43 "VSL25" 44 "VSL30" 45 "VSL35" 46 "VSL40" 47 "VSL45" 48 "VSL50" 49 "VSL55" 50 "VSL60" 51 "VSL65" 52 "VSL70" 53 "VSL75" 54 "VSL80" 55 "VSL85" 56 "VSL90" 57 "VSL95" 58 "VSL100" 59 "VSL105" 60 "VSL110" 61 "VSL115" 62 "VSL120" 63 "VSL125" 64 "VSL130" 65 "VSL135" 66 "VSL140" 67 "VSL145" 68 "VSL150" 69 "VSL155" 70 "VSL160" 71 "VOP" 72 "VOL" 73 "VESL" 74 "VEOP" 75 "VEOL" 76 "VEA" 77 "NOENTRY" 78 "NOALL" 79 "NOCAR" 80 "NOLORRY" 81 "NOHAZMAT" 82 "NOBIKE" 83 "NOPED" 84 "NOCARBIKE" 85 "NOTWOWAY" 86 "WEIGHT" 87 "HEIGHT" 88 "WIDTH" 89 "LENGTH" 90 "PRIOCROSS" 91 "GIVEWAY" 92 "PRIOCROSSYIELDTORIGHT" 93 "WARNDANGER" 94 "WARNCURVEL" 95 "WARNCURVER" 96 "WARNDCURVEL" 97 "WARNDCURVER" 98 "WARNTRAIN" 99 "WARNJAM" 100 "WARNANIMAL_DEPRECATED" 101 "WARNRWORKS" 102 "WARNSLOPED" 103 "WARNSLOPEU" 104 "PRIOSTREET" 105 "EPRIOSTREET" 106 "STOP" 107 "ASL" 108 "EASL" 109 "MSL" 110 "EMSL" 111 "MLC" 112 "WBDIAGL" 113 "WBDIAGR" 114 "WBROUND" 115 "NOLTURN" 116 "NORTURN" 117 "NOUTURN" 118 "NOPARK" 119 "NOSTOP" 120 "SMOG" 121 "UMWELT" 122 "EUMWELT" 123 "DOUANE" 124 "FWAY" 125 "EFWAY" 126 "HWAY" 127 "EHWAY" 128 "NORIDER" 129 "WARNCONST" 130 "WARNCONSTL" 131 "WARNCONSTR" 132 "WARNPED" 133 "WARNKIDS" 134 "WARNBIKE" 135 "WARNSKID" 136 "ZEBRA" 137 "ONEWAYS" 138 "ONEWAYU" 139 "SLOWDOWN" 140 "NOCARRIAGE" 141 "NOLORRYTRAILER" 142 "NOBUS" 143 "NOTRACTOR" 144 "LORRYDIST" 145 "CARDIST" 146 "WARNROUND" 147 "WARNWILDANIMAL" 148 "WARNCATTLE" 149 "WARNFROG" 150 "WARNBUS" 151 "WARNWIND" 152 "WARNSNOW" 153 "WARNPCROSS" 154 "WARNHUMP" 155 "WARNROCK" 156 "WARNLOWTREE" 157 "WARNGRAVEL" 158 "WARNTWOWAY" 159 "WARNLIGHTS" 160 "WARNPLANE" 161 "VNOENTRY" 162 "VNOALL" 163 "VNOCAR" 164 "VNOLORRY" 165 "VNOCARBIKE" 166 "VWEIGHT" 167 "VHEIGHT" 168 "VWIDTH" 169 "VLENGTH" 170 "VWARNDANGER" 171 "VWARNJAM" 172 "VWARNRWORKS" 173 "VWARNSKID" 174 "VASL" 175 "VEASL" 176 "VNOLORRYTRAILER" 177 "VNOBUS" 178 "VLORRYDIST" 179 "VCARDIST" 180 "VWARNSNOW" 181 "VWARNHUMP" 182 "VWARNGRAVEL" 183 "CALM" 184 "ECALM" 185 "TWN" 186 "ETWN" 187 "DEADEND" 188 "AXLEWEIGHT" 189 "WARNRIDER" 190 "WARNDRAWBRIDGE" 191 "WARNPIER" 192 "TRINATURE" 193 "VWARNCONST" 194 "VWARNCONSTL" 195 "VWARNCONSTR" 196 "VWARNCURVEL" 197 "VWARNCURVER" 198 "VWARNDCURVEL" 199 "VWARNDCURVER" 200 "VWARNLIGHTS" 201 "WBBENTLEFT" 202 "WBBENTLEFTRIGHT" 203 "WBBENTRIGHT" 204 "WBDIAGLR" 205 "WBLEFT" 206 "WBRIGHT" 207 "WBUP" 208 "WBUPLEFT" 209 "WBUPRIGHT" 210 "WBHAZWATER" 211 "NOHAZWATER" 212 "SCHOOL" 213 "ESCHOOL" 214 "HAZMAT" 215 "EMERGENCYBAY" 216 "ENDOFLANEL" 217 "ENDOFLANER" 218 "ENOPARK" 219 "EONEWAY" 220 "EPARK" 221 "ETOLL" 222 "NOPARKL" 223 "NOPARKLR" 224 "NOPARKR" 225 "NOSTOPL" 226 "NOSTOPLR" 227 "NOSTOPR" 228 "NOTURNONRED" 229 "ONEWAYL" 230 "ONEWAYR" 231 "PARK" 232 "PRIOCROSSL" 233 "PRIOCROSSR" 234 "TOLL" 235 "TUNNEL" 236 "TWOWAY" 237 "WARNCROSS" 238 "WARNCROSSL" 239 "WARNCROSSLR" 240 "WARNCROSSR" 241 "WARNCROSSRL" 242 "WARNCROSST" 243 "WARNGIVEWAYAHEAD" 244 "WARNSLAHEAD" 245 "WARNSTOPAHEAD" 246 "WBBUS" 247 "WRONGWAY" 248 "HAZWATER" 249 "GIVEWAYROUND" 250 "WARNWINDINGL" 251 "WARNWINDINGR" 252 "WARNHAIRPINL" 253 "WARNHAIRPINR" 254 "WARNPEDBIKE" 255 "WARNCROSSY" 256 "WARNBRANCHL" 257 "WARNBRANCHR" 258 "WARNAXLEWEIGHT" 259 "WARNWEIGHT" 260 "WARNHEIGHT" 261 "WARNLENGTH" 262 "WARNWIDTH" 263 "WARNBLACKSPOT" 264 "WARNMERGEL" 265 "WARNMERGER" 266 "WARNTUNNEL" 267 "WARNTRACTOR" 268 "WARNRWORKSVEHICLE" 269 "WARNNARROWBRIDGE" 270 "WARNFLAGGER" 271 "LANES" 272 "LANESHIFTL" 273 "LANESHIFTR" 274 "NEWLANEL" 275 "NEWLANER" 276 "RIGHTTURNONRED" 277 "BORDERLIMIT" 278 "EMBEDDEDRAIN" 279 "VWARNWEIGHT" 280 "VWARNHEIGHT" 281 "VWARNLENGTH" 282 "VWARNWIDTH" 283 "VENDOFLANEL" 284 "VENDOFLANER" 285 "VLANES" 286 "VLANESHIFTL" 287 "VLANESHIFTR" 288 "VNEWLANEL" 289 "VNEWLANER" 290 "NOUP" 291 "VOFF" 292 "ASL5" 293 "ASL10" 294 "ASL15" 295 "ASL20" 296 "ASL25" 297 "ASL30" 298 "ASL35" 299 "ASL40" 300 "ASL45" 301 "ASL50" 302 "ASL55" 303 "ASL60" 304 "ASL65" 305 "ASL70" 306 "ASL75" 307 "ASL80" 308 "ASL85" 309 "ASL90" 310 "ASL95" 311 "ASL100" 312 "ASL105" 313 "ASL110" 314 "ASL115" 315 "ASL120" 316 "ASL125" 317 "ASL130" 318 "ASL135" 319 "ASL140" 320 "ASL145" 321 "ASL150" 322 "ASL155" 323 "ASL160" 324 "VASL5" 325 "VASL10" 326 "VASL15" 327 "VASL20" 328 "VASL25" 329 "VASL30" 330 "VASL35" 331 "VASL40" 332 "VASL45" 333 "VASL50" 334 "VASL55" 335 "VASL60" 336 "VASL65" 337 "VASL70" 338 "VASL75" 339 "VASL80" 340 "VASL85" 341 "VASL90" 342 "VASL95" 343 "VASL100" 344 "VASL105" 345 "VASL110" 346 "VASL115" 347 "VASL120" 348 "VASL125" 349 "VASL130" 350 "VASL135" 351 "VASL140" 352 "VASL145" 353 "VASL150" 354 "VASL155" 355 "VASL160" 356 "WARNTRAINGATED" 357 "KEEPRIGHTCAR" 358 "ASLCURVE5" 359 "ASLCURVE10" 360 "ASLCURVE15" 361 "ASLCURVE20" 362 "ASLCURVE25" 363 "ASLCURVE30" 364 "ASLCURVE35" 365 "ASLCURVE40" 366 "ASLCURVE45" 367 "ASLCURVE50" 368 "ASLCURVE55" 369 "ASLCURVE60" 370 "ASLCURVE65" 371 "ASLCURVE70" 372 "ASLCURVE75" 373 "ASLCURVE80" 374 "ASLCURVE85" 375 "ASLCURVE90" 376 "ASLCURVE95" 377 "ASLCURVE100" 378 "ASLCURVE105" 379 "ASLCURVE110" 380 "ASLCURVE115" 381 "ASLCURVE120" 382 "ASLCURVE125" 383 "ASLCURVE130" 384 "ASLCURVE135" 385 "ASLCURVE140" 386 "ASLCURVE145" 387 "ASLCURVE150" 388 "ASLCURVE155" 389 "ASLCURVE160" 390 "KIDS" 391 "EKIDS" 392 "BIKEROAD" 393 "EBIKEROAD" 394 "PEDSTREET" 395 "EPEDSTREET" 396 "PEDBIKESTREET" 397 "EPEDBIKESTREET" 398 "EWARNKIDS" 399 "CALM20" 400 "CALM30" 401 "ECALM20" 402 "ECALM30" 403 "FWAYGREEN" 404 "TWN40" 405 "TWN50" 406 "TWN60" 407 "TWN70" 408 "ETWN40" 409 "ETWN50" 410 "ETWN60" 411 "ETWN70" 412 "WBBIKE" 413 "EWBBIKE" 414 "WBPED" 415 "EWBPED" 416 "WBPEDBIKESEP" 417 "EWBPEDBIKESEP" 418 "WBPEDBIKESHARED" 419 "EWBPEDBIKESHARED" 420 "EFWAYGREEN" 421 "Reserved0421" 422 "Reserved0422" 423 "Reserved0423" 424 "Reserved0424" 425 "Reserved0425" 426 "Reserved0426" 427 "Reserved0427" 428 "Reserved0428" 429 "Reserved0429" 430 "Reserved0430" 431 "Reserved0431" 432 "Reserved0432" 433 "Reserved0433" 434 "Reserved0434" 435 "Reserved0435" 436 "Reserved0436" 437 "Reserved0437" 438 "Reserved0438" 439 "Reserved0439" 440 "Reserved0440" 441 "Reserved0441" 442 "Reserved0442" 443 "Reserved0443" 444 "Reserved0444" 445 "Reserved0445" 446 "Reserved0446" 447 "Reserved0447" 448 "Reserved0448" 449 "Reserved0449" ;
VAL_ 239 VFC_TS03_EmbeddedInfo 0 "Unknown" 1 "Not Embedded" 2 "Border Limit" 3 "Multi Lane" 4 "Rain" 5 "Vehicle Type" 6 "Plate" 7 "Error Value" 8 "Vehicle Sticker" 9 "Reserved09" 10 "Reserved10" 11 "Reserved11" 12 "Reserved12" 13 "Reserved13" 14 "Reserved14" 15 "Reserved15" ;
VAL_ 239 VFC_TS03_ValidTimeRange1Start 127 "Unknown" ;
VAL_ 239 VFC_TS03_ValidTimeRange1End 127 "Unknown" ;
VAL_ 239 VFC_TS03_ValidTimeRange2Start 127 "Unknown" ;
VAL_ 239 VFC_TS03_ValidTimeRange2End 127 "Unknown" ;
VAL_ 239 VFC_TS03_ValidInDistUnit 0 "Unknown" ;
VAL_ 239 VFC_TS03_ValidSectionUnit 0 "Unknown" 1 "Meter" 2 "Kilometer" 3 "Foot" 4 "Yard" 5 "Mile" 6 "Reserved6" 7 "Reserved7" ;
VAL_ 239 VFC_TS03_SupSign0Type 0 "UNKNOWN" 1 "ADDCAR" 2 "ADDLORRY" 3 "ADDTRAILER" 4 "ADDCARAVAN" 5 "ADDBUS" 6 "ADDTRACTOR" 7 "ADDMCYCLE" 8 "ADDLORRYBUSTRAILER_DEPRECATED" 9 "ADDLORRYBUS_DEPRECATED" 10 "ADDHAZMAT" 11 "ADDTANK" 12 "ADDTRAM" 13 "ADDWET" 14 "ADDFOG" 15 "ADDRAIN" 16 "ADDSNOW" 17 "ADDTIME" 18 "ADDSECTION" 19 "ADDDISTANCE" 20 "ADDWEIGHT" 21 "ADDEXITL" 22 "ADDEXITR" 23 "ADDLANES" 24 "ADDRADAR" 25 "ADDRAPPEL" 26 "ADDPRIOTURN" 27 "ADDLORRY_EXCEPT" 28 "ADDTRACTOR_OVER" 29 "ADDTEXT" 30 "ADDSIGN" 31 "ADDRAINSNOW" 32 "ADDHUMP" 33 "VADDLORRYBUSTRAILER_DEPRECATED" 34 "VADDLORRYBUS_DEPRECATED" 35 "VADDLORRYTRAILER_DEPRECATED" 36 "ADDLORRYTRAILER_DEPRECATED" 37 "ADDCAMPER" 38 "ADDZONE" 39 "ADDCRASHRISK" 40 "ADDACCIDENT" 41 "ADDJAM" 42 "ADDSMOKE" 43 "ADDOILTRAIL" 44 "ADDGRAVEL" 45 "ADDDIRT" 46 "ADDRWORKSEXIT" 47 "ADDROADDAMAGE" 48 "ADDRWORKSENTRY" 49 "ADDLOWTREE" 50 "ADDRWORKSACCESS" 51 "ADDRUTS" 52 "ADDSOFTSHOULDERCAR" 53 "ADDSOFTSHOULDERLORRY" 54 "VADDSIGN" 55 "VADDCAR" 56 "VADDLORRY" 57 "VADDTRAILER" 58 "VADDCARAVAN" 59 "VADDBUS" 60 "VADDWET" 61 "VADDFOG" 62 "VADDRAIN" 63 "VADDSNOW" 64 "VADDRAINSNOW" 65 "VADDTEXT" 66 "VADDSECTION" 67 "VADDDISTANCE" 68 "VADDWEIGHT" 69 "VADDZONE" 70 "VADDCRASHRISK" 71 "VADDACCIDENT" 72 "VADDJAM" 73 "VADDOILTRAIL" 74 "VADDGRAVEL" 75 "VADDDIRT" 76 "VADDROADDAMAGE" 77 "VADDRUTS" 78 "ADDNOSTOPSHOULDER" 79 "ADDTOWING" 80 "ADDSCHOOL" 81 "ADDNIGHT" 82 "ADDEND" 83 "ADDBEGINS" 84 "ADDWITHIN" 85 "ADDDISTANCEBARS" 86 "ADDMINIMUM" 87 "ADDADVICE" 88 "ADDACCESS" 89 "ADDALLWAY" 90 "ADDBUS_EXCEPT" 91 "ADDEXCEPTDELIVERY" 92 "ADDEXCEPTLOCAL" 93 "ADDFROG" 94 "ADDPRIOTURNL" 95 "ADDPRIOTURNR" 96 "ADDSTART" 97 "ADDSTOPIN" 98 "ADDEXIT" 99 "ADDHAZWATER" 100 "ADDDAY" 101 "ADDSL" 102 "ADDLORRYTRAILER" 103 "ADDLORRYSEMI" 104 "VADDLORRYTRAILER" 105 "VADDLORRYSEMI" 106 "ADDSLOW" 107 "ADDSL5" 108 "ADDSL10" 109 "ADDSL15" 110 "ADDSL20" 111 "ADDSL25" 112 "ADDSL30" 113 "ADDSL35" 114 "ADDSL40" 115 "ADDSL45" 116 "ADDSL50" 117 "ADDSL55" 118 "ADDSL60" 119 "ADDSL65" 120 "ADDSL70" 121 "ADDSL75" 122 "ADDSL80" 123 "ADDSL85" 124 "ADDSL90" 125 "ADDSL95" 126 "ADDSL100" 127 "ADDSL105" 128 "ADDSL110" 129 "ADDSL115" 130 "ADDSL120" 131 "ADDSL125" 132 "ADDSL130" 133 "ADDSL135" 134 "ADDSL140" 135 "ADDSL145" 136 "ADDSL150" 137 "ADDSL155" 138 "ADDSL160" 139 "ADDBIKEROAD" 140 "ADDLORRYTRAILER_EXCEPT" 141 "ADDLORRYSEMI_EXCEPT" 142 "Reserved142" 143 "Reserved143" 144 "Reserved144" 145 "Reserved145" 146 "Reserved146" 147 "Reserved147" 148 "Reserved148" 149 "Reserved149" 150 "Reserved150" 151 "Reserved151" 152 "Reserved152" 153 "Reserved153" 154 "Reserved154" 155 "Reserved155" 156 "Reserved156" 157 "Reserved157" 158 "Reserved158" 159 "Reserved159" 160 "Reserved160" 161 "Reserved161" 162 "Reserved162" 163 "Reserved163" 164 "Reserved164" 165 "Reserved165" 166 "Reserved166" 167 "Reserved167" 168 "Reserved168" 169 "Reserved169" ;
VAL_ 239 VFC_TS03_SupSign1Type 0 "UNKNOWN" 1 "ADDCAR" 2 "ADDLORRY" 3 "ADDTRAILER" 4 "ADDCARAVAN" 5 "ADDBUS" 6 "ADDTRACTOR" 7 "ADDMCYCLE" 8 "ADDLORRYBUSTRAILER_DEPRECATED" 9 "ADDLORRYBUS_DEPRECATED" 10 "ADDHAZMAT" 11 "ADDTANK" 12 "ADDTRAM" 13 "ADDWET" 14 "ADDFOG" 15 "ADDRAIN" 16 "ADDSNOW" 17 "ADDTIME" 18 "ADDSECTION" 19 "ADDDISTANCE" 20 "ADDWEIGHT" 21 "ADDEXITL" 22 "ADDEXITR" 23 "ADDLANES" 24 "ADDRADAR" 25 "ADDRAPPEL" 26 "ADDPRIOTURN" 27 "ADDLORRY_EXCEPT" 28 "ADDTRACTOR_OVER" 29 "ADDTEXT" 30 "ADDSIGN" 31 "ADDRAINSNOW" 32 "ADDHUMP" 33 "VADDLORRYBUSTRAILER_DEPRECATED" 34 "VADDLORRYBUS_DEPRECATED" 35 "VADDLORRYTRAILER_DEPRECATED" 36 "ADDLORRYTRAILER_DEPRECATED" 37 "ADDCAMPER" 38 "ADDZONE" 39 "ADDCRASHRISK" 40 "ADDACCIDENT" 41 "ADDJAM" 42 "ADDSMOKE" 43 "ADDOILTRAIL" 44 "ADDGRAVEL" 45 "ADDDIRT" 46 "ADDRWORKSEXIT" 47 "ADDROADDAMAGE" 48 "ADDRWORKSENTRY" 49 "ADDLOWTREE" 50 "ADDRWORKSACCESS" 51 "ADDRUTS" 52 "ADDSOFTSHOULDERCAR" 53 "ADDSOFTSHOULDERLORRY" 54 "VADDSIGN" 55 "VADDCAR" 56 "VADDLORRY" 57 "VADDTRAILER" 58 "VADDCARAVAN" 59 "VADDBUS" 60 "VADDWET" 61 "VADDFOG" 62 "VADDRAIN" 63 "VADDSNOW" 64 "VADDRAINSNOW" 65 "VADDTEXT" 66 "VADDSECTION" 67 "VADDDISTANCE" 68 "VADDWEIGHT" 69 "VADDZONE" 70 "VADDCRASHRISK" 71 "VADDACCIDENT" 72 "VADDJAM" 73 "VADDOILTRAIL" 74 "VADDGRAVEL" 75 "VADDDIRT" 76 "VADDROADDAMAGE" 77 "VADDRUTS" 78 "ADDNOSTOPSHOULDER" 79 "ADDTOWING" 80 "ADDSCHOOL" 81 "ADDNIGHT" 82 "ADDEND" 83 "ADDBEGINS" 84 "ADDWITHIN" 85 "ADDDISTANCEBARS" 86 "ADDMINIMUM" 87 "ADDADVICE" 88 "ADDACCESS" 89 "ADDALLWAY" 90 "ADDBUS_EXCEPT" 91 "ADDEXCEPTDELIVERY" 92 "ADDEXCEPTLOCAL" 93 "ADDFROG" 94 "ADDPRIOTURNL" 95 "ADDPRIOTURNR" 96 "ADDSTART" 97 "ADDSTOPIN" 98 "ADDEXIT" 99 "ADDHAZWATER" 100 "ADDDAY" 101 "ADDSL" 102 "ADDLORRYTRAILER" 103 "ADDLORRYSEMI" 104 "VADDLORRYTRAILER" 105 "VADDLORRYSEMI" 106 "ADDSLOW" 107 "ADDSL5" 108 "ADDSL10" 109 "ADDSL15" 110 "ADDSL20" 111 "ADDSL25" 112 "ADDSL30" 113 "ADDSL35" 114 "ADDSL40" 115 "ADDSL45" 116 "ADDSL50" 117 "ADDSL55" 118 "ADDSL60" 119 "ADDSL65" 120 "ADDSL70" 121 "ADDSL75" 122 "ADDSL80" 123 "ADDSL85" 124 "ADDSL90" 125 "ADDSL95" 126 "ADDSL100" 127 "ADDSL105" 128 "ADDSL110" 129 "ADDSL115" 130 "ADDSL120" 131 "ADDSL125" 132 "ADDSL130" 133 "ADDSL135" 134 "ADDSL140" 135 "ADDSL145" 136 "ADDSL150" 137 "ADDSL155" 138 "ADDSL160" 139 "ADDBIKEROAD" 140 "ADDLORRYTRAILER_EXCEPT" 141 "ADDLORRYSEMI_EXCEPT" 142 "Reserved142" 143 "Reserved143" 144 "Reserved144" 145 "Reserved145" 146 "Reserved146" 147 "Reserved147" 148 "Reserved148" 149 "Reserved149" 150 "Reserved150" 151 "Reserved151" 152 "Reserved152" 153 "Reserved153" 154 "Reserved154" 155 "Reserved155" 156 "Reserved156" 157 "Reserved157" 158 "Reserved158" 159 "Reserved159" 160 "Reserved160" 161 "Reserved161" 162 "Reserved162" 163 "Reserved163" 164 "Reserved164" 165 "Reserved165" 166 "Reserved166" 167 "Reserved167" 168 "Reserved168" 169 "Reserved169" ;
VAL_ 239 VFC_TS03_SupSign2Type 0 "UNKNOWN" 1 "ADDCAR" 2 "ADDLORRY" 3 "ADDTRAILER" 4 "ADDCARAVAN" 5 "ADDBUS" 6 "ADDTRACTOR" 7 "ADDMCYCLE" 8 "ADDLORRYBUSTRAILER_DEPRECATED" 9 "ADDLORRYBUS_DEPRECATED" 10 "ADDHAZMAT" 11 "ADDTANK" 12 "ADDTRAM" 13 "ADDWET" 14 "ADDFOG" 15 "ADDRAIN" 16 "ADDSNOW" 17 "ADDTIME" 18 "ADDSECTION" 19 "ADDDISTANCE" 20 "ADDWEIGHT" 21 "ADDEXITL" 22 "ADDEXITR" 23 "ADDLANES" 24 "ADDRADAR" 25 "ADDRAPPEL" 26 "ADDPRIOTURN" 27 "ADDLORRY_EXCEPT" 28 "ADDTRACTOR_OVER" 29 "ADDTEXT" 30 "ADDSIGN" 31 "ADDRAINSNOW" 32 "ADDHUMP" 33 "VADDLORRYBUSTRAILER_DEPRECATED" 34 "VADDLORRYBUS_DEPRECATED" 35 "VADDLORRYTRAILER_DEPRECATED" 36 "ADDLORRYTRAILER_DEPRECATED" 37 "ADDCAMPER" 38 "ADDZONE" 39 "ADDCRASHRISK" 40 "ADDACCIDENT" 41 "ADDJAM" 42 "ADDSMOKE" 43 "ADDOILTRAIL" 44 "ADDGRAVEL" 45 "ADDDIRT" 46 "ADDRWORKSEXIT" 47 "ADDROADDAMAGE" 48 "ADDRWORKSENTRY" 49 "ADDLOWTREE" 50 "ADDRWORKSACCESS" 51 "ADDRUTS" 52 "ADDSOFTSHOULDERCAR" 53 "ADDSOFTSHOULDERLORRY" 54 "VADDSIGN" 55 "VADDCAR" 56 "VADDLORRY" 57 "VADDTRAILER" 58 "VADDCARAVAN" 59 "VADDBUS" 60 "VADDWET" 61 "VADDFOG" 62 "VADDRAIN" 63 "VADDSNOW" 64 "VADDRAINSNOW" 65 "VADDTEXT" 66 "VADDSECTION" 67 "VADDDISTANCE" 68 "VADDWEIGHT" 69 "VADDZONE" 70 "VADDCRASHRISK" 71 "VADDACCIDENT" 72 "VADDJAM" 73 "VADDOILTRAIL" 74 "VADDGRAVEL" 75 "VADDDIRT" 76 "VADDROADDAMAGE" 77 "VADDRUTS" 78 "ADDNOSTOPSHOULDER" 79 "ADDTOWING" 80 "ADDSCHOOL" 81 "ADDNIGHT" 82 "ADDEND" 83 "ADDBEGINS" 84 "ADDWITHIN" 85 "ADDDISTANCEBARS" 86 "ADDMINIMUM" 87 "ADDADVICE" 88 "ADDACCESS" 89 "ADDALLWAY" 90 "ADDBUS_EXCEPT" 91 "ADDEXCEPTDELIVERY" 92 "ADDEXCEPTLOCAL" 93 "ADDFROG" 94 "ADDPRIOTURNL" 95 "ADDPRIOTURNR" 96 "ADDSTART" 97 "ADDSTOPIN" 98 "ADDEXIT" 99 "ADDHAZWATER" 100 "ADDDAY" 101 "ADDSL" 102 "ADDLORRYTRAILER" 103 "ADDLORRYSEMI" 104 "VADDLORRYTRAILER" 105 "VADDLORRYSEMI" 106 "ADDSLOW" 107 "ADDSL5" 108 "ADDSL10" 109 "ADDSL15" 110 "ADDSL20" 111 "ADDSL25" 112 "ADDSL30" 113 "ADDSL35" 114 "ADDSL40" 115 "ADDSL45" 116 "ADDSL50" 117 "ADDSL55" 118 "ADDSL60" 119 "ADDSL65" 120 "ADDSL70" 121 "ADDSL75" 122 "ADDSL80" 123 "ADDSL85" 124 "ADDSL90" 125 "ADDSL95" 126 "ADDSL100" 127 "ADDSL105" 128 "ADDSL110" 129 "ADDSL115" 130 "ADDSL120" 131 "ADDSL125" 132 "ADDSL130" 133 "ADDSL135" 134 "ADDSL140" 135 "ADDSL145" 136 "ADDSL150" 137 "ADDSL155" 138 "ADDSL160" 139 "ADDBIKEROAD" 140 "ADDLORRYTRAILER_EXCEPT" 141 "ADDLORRYSEMI_EXCEPT" 142 "Reserved142" 143 "Reserved143" 144 "Reserved144" 145 "Reserved145" 146 "Reserved146" 147 "Reserved147" 148 "Reserved148" 149 "Reserved149" 150 "Reserved150" 151 "Reserved151" 152 "Reserved152" 153 "Reserved153" 154 "Reserved154" 155 "Reserved155" 156 "Reserved156" 157 "Reserved157" 158 "Reserved158" 159 "Reserved159" 160 "Reserved160" 161 "Reserved161" 162 "Reserved162" 163 "Reserved163" 164 "Reserved164" 165 "Reserved165" 166 "Reserved166" 167 "Reserved167" 168 "Reserved168" 169 "Reserved169" ;
VAL_ 239 VFC_TS03_SupSign3Type 0 "UNKNOWN" 1 "ADDCAR" 2 "ADDLORRY" 3 "ADDTRAILER" 4 "ADDCARAVAN" 5 "ADDBUS" 6 "ADDTRACTOR" 7 "ADDMCYCLE" 8 "ADDLORRYBUSTRAILER_DEPRECATED" 9 "ADDLORRYBUS_DEPRECATED" 10 "ADDHAZMAT" 11 "ADDTANK" 12 "ADDTRAM" 13 "ADDWET" 14 "ADDFOG" 15 "ADDRAIN" 16 "ADDSNOW" 17 "ADDTIME" 18 "ADDSECTION" 19 "ADDDISTANCE" 20 "ADDWEIGHT" 21 "ADDEXITL" 22 "ADDEXITR" 23 "ADDLANES" 24 "ADDRADAR" 25 "ADDRAPPEL" 26 "ADDPRIOTURN" 27 "ADDLORRY_EXCEPT" 28 "ADDTRACTOR_OVER" 29 "ADDTEXT" 30 "ADDSIGN" 31 "ADDRAINSNOW" 32 "ADDHUMP" 33 "VADDLORRYBUSTRAILER_DEPRECATED" 34 "VADDLORRYBUS_DEPRECATED" 35 "VADDLORRYTRAILER_DEPRECATED" 36 "ADDLORRYTRAILER_DEPRECATED" 37 "ADDCAMPER" 38 "ADDZONE" 39 "ADDCRASHRISK" 40 "ADDACCIDENT" 41 "ADDJAM" 42 "ADDSMOKE" 43 "ADDOILTRAIL" 44 "ADDGRAVEL" 45 "ADDDIRT" 46 "ADDRWORKSEXIT" 47 "ADDROADDAMAGE" 48 "ADDRWORKSENTRY" 49 "ADDLOWTREE" 50 "ADDRWORKSACCESS" 51 "ADDRUTS" 52 "ADDSOFTSHOULDERCAR" 53 "ADDSOFTSHOULDERLORRY" 54 "VADDSIGN" 55 "VADDCAR" 56 "VADDLORRY" 57 "VADDTRAILER" 58 "VADDCARAVAN" 59 "VADDBUS" 60 "VADDWET" 61 "VADDFOG" 62 "VADDRAIN" 63 "VADDSNOW" 64 "VADDRAINSNOW" 65 "VADDTEXT" 66 "VADDSECTION" 67 "VADDDISTANCE" 68 "VADDWEIGHT" 69 "VADDZONE" 70 "VADDCRASHRISK" 71 "VADDACCIDENT" 72 "VADDJAM" 73 "VADDOILTRAIL" 74 "VADDGRAVEL" 75 "VADDDIRT" 76 "VADDROADDAMAGE" 77 "VADDRUTS" 78 "ADDNOSTOPSHOULDER" 79 "ADDTOWING" 80 "ADDSCHOOL" 81 "ADDNIGHT" 82 "ADDEND" 83 "ADDBEGINS" 84 "ADDWITHIN" 85 "ADDDISTANCEBARS" 86 "ADDMINIMUM" 87 "ADDADVICE" 88 "ADDACCESS" 89 "ADDALLWAY" 90 "ADDBUS_EXCEPT" 91 "ADDEXCEPTDELIVERY" 92 "ADDEXCEPTLOCAL" 93 "ADDFROG" 94 "ADDPRIOTURNL" 95 "ADDPRIOTURNR" 96 "ADDSTART" 97 "ADDSTOPIN" 98 "ADDEXIT" 99 "ADDHAZWATER" 100 "ADDDAY" 101 "ADDSL" 102 "ADDLORRYTRAILER" 103 "ADDLORRYSEMI" 104 "VADDLORRYTRAILER" 105 "VADDLORRYSEMI" 106 "ADDSLOW" 107 "ADDSL5" 108 "ADDSL10" 109 "ADDSL15" 110 "ADDSL20" 111 "ADDSL25" 112 "ADDSL30" 113 "ADDSL35" 114 "ADDSL40" 115 "ADDSL45" 116 "ADDSL50" 117 "ADDSL55" 118 "ADDSL60" 119 "ADDSL65" 120 "ADDSL70" 121 "ADDSL75" 122 "ADDSL80" 123 "ADDSL85" 124 "ADDSL90" 125 "ADDSL95" 126 "ADDSL100" 127 "ADDSL105" 128 "ADDSL110" 129 "ADDSL115" 130 "ADDSL120" 131 "ADDSL125" 132 "ADDSL130" 133 "ADDSL135" 134 "ADDSL140" 135 "ADDSL145" 136 "ADDSL150" 137 "ADDSL155" 138 "ADDSL160" 139 "ADDBIKEROAD" 140 "ADDLORRYTRAILER_EXCEPT" 141 "ADDLORRYSEMI_EXCEPT" 142 "Reserved142" 143 "Reserved143" 144 "Reserved144" 145 "Reserved145" 146 "Reserved146" 147 "Reserved147" 148 "Reserved148" 149 "Reserved149" 150 "Reserved150" 151 "Reserved151" 152 "Reserved152" 153 "Reserved153" 154 "Reserved154" 155 "Reserved155" 156 "Reserved156" 157 "Reserved157" 158 "Reserved158" 159 "Reserved159" 160 "Reserved160" 161 "Reserved161" 162 "Reserved162" 163 "Reserved163" 164 "Reserved164" 165 "Reserved165" 166 "Reserved166" 167 "Reserved167" 168 "Reserved168" 169 "Reserved169" ;
VAL_ 239 VFC_TS03_SupSign4Type 0 "UNKNOWN" 1 "ADDCAR" 2 "ADDLORRY" 3 "ADDTRAILER" 4 "ADDCARAVAN" 5 "ADDBUS" 6 "ADDTRACTOR" 7 "ADDMCYCLE" 8 "ADDLORRYBUSTRAILER_DEPRECATED" 9 "ADDLORRYBUS_DEPRECATED" 10 "ADDHAZMAT" 11 "ADDTANK" 12 "ADDTRAM" 13 "ADDWET" 14 "ADDFOG" 15 "ADDRAIN" 16 "ADDSNOW" 17 "ADDTIME" 18 "ADDSECTION" 19 "ADDDISTANCE" 20 "ADDWEIGHT" 21 "ADDEXITL" 22 "ADDEXITR" 23 "ADDLANES" 24 "ADDRADAR" 25 "ADDRAPPEL" 26 "ADDPRIOTURN" 27 "ADDLORRY_EXCEPT" 28 "ADDTRACTOR_OVER" 29 "ADDTEXT" 30 "ADDSIGN" 31 "ADDRAINSNOW" 32 "ADDHUMP" 33 "VADDLORRYBUSTRAILER_DEPRECATED" 34 "VADDLORRYBUS_DEPRECATED" 35 "VADDLORRYTRAILER_DEPRECATED" 36 "ADDLORRYTRAILER_DEPRECATED" 37 "ADDCAMPER" 38 "ADDZONE" 39 "ADDCRASHRISK" 40 "ADDACCIDENT" 41 "ADDJAM" 42 "ADDSMOKE" 43 "ADDOILTRAIL" 44 "ADDGRAVEL" 45 "ADDDIRT" 46 "ADDRWORKSEXIT" 47 "ADDROADDAMAGE" 48 "ADDRWORKSENTRY" 49 "ADDLOWTREE" 50 "ADDRWORKSACCESS" 51 "ADDRUTS" 52 "ADDSOFTSHOULDERCAR" 53 "ADDSOFTSHOULDERLORRY" 54 "VADDSIGN" 55 "VADDCAR" 56 "VADDLORRY" 57 "VADDTRAILER" 58 "VADDCARAVAN" 59 "VADDBUS" 60 "VADDWET" 61 "VADDFOG" 62 "VADDRAIN" 63 "VADDSNOW" 64 "VADDRAINSNOW" 65 "VADDTEXT" 66 "VADDSECTION" 67 "VADDDISTANCE" 68 "VADDWEIGHT" 69 "VADDZONE" 70 "VADDCRASHRISK" 71 "VADDACCIDENT" 72 "VADDJAM" 73 "VADDOILTRAIL" 74 "VADDGRAVEL" 75 "VADDDIRT" 76 "VADDROADDAMAGE" 77 "VADDRUTS" 78 "ADDNOSTOPSHOULDER" 79 "ADDTOWING" 80 "ADDSCHOOL" 81 "ADDNIGHT" 82 "ADDEND" 83 "ADDBEGINS" 84 "ADDWITHIN" 85 "ADDDISTANCEBARS" 86 "ADDMINIMUM" 87 "ADDADVICE" 88 "ADDACCESS" 89 "ADDALLWAY" 90 "ADDBUS_EXCEPT" 91 "ADDEXCEPTDELIVERY" 92 "ADDEXCEPTLOCAL" 93 "ADDFROG" 94 "ADDPRIOTURNL" 95 "ADDPRIOTURNR" 96 "ADDSTART" 97 "ADDSTOPIN" 98 "ADDEXIT" 99 "ADDHAZWATER" 100 "ADDDAY" 101 "ADDSL" 102 "ADDLORRYTRAILER" 103 "ADDLORRYSEMI" 104 "VADDLORRYTRAILER" 105 "VADDLORRYSEMI" 106 "ADDSLOW" 107 "ADDSL5" 108 "ADDSL10" 109 "ADDSL15" 110 "ADDSL20" 111 "ADDSL25" 112 "ADDSL30" 113 "ADDSL35" 114 "ADDSL40" 115 "ADDSL45" 116 "ADDSL50" 117 "ADDSL55" 118 "ADDSL60" 119 "ADDSL65" 120 "ADDSL70" 121 "ADDSL75" 122 "ADDSL80" 123 "ADDSL85" 124 "ADDSL90" 125 "ADDSL95" 126 "ADDSL100" 127 "ADDSL105" 128 "ADDSL110" 129 "ADDSL115" 130 "ADDSL120" 131 "ADDSL125" 132 "ADDSL130" 133 "ADDSL135" 134 "ADDSL140" 135 "ADDSL145" 136 "ADDSL150" 137 "ADDSL155" 138 "ADDSL160" 139 "ADDBIKEROAD" 140 "ADDLORRYTRAILER_EXCEPT" 141 "ADDLORRYSEMI_EXCEPT" 142 "Reserved142" 143 "Reserved143" 144 "Reserved144" 145 "Reserved145" 146 "Reserved146" 147 "Reserved147" 148 "Reserved148" 149 "Reserved149" 150 "Reserved150" 151 "Reserved151" 152 "Reserved152" 153 "Reserved153" 154 "Reserved154" 155 "Reserved155" 156 "Reserved156" 157 "Reserved157" 158 "Reserved158" 159 "Reserved159" 160 "Reserved160" 161 "Reserved161" 162 "Reserved162" 163 "Reserved163" 164 "Reserved164" 165 "Reserved165" 166 "Reserved166" 167 "Reserved167" 168 "Reserved168" 169 "Reserved169" ;
VAL_ 239 VFC_TS03_SupSign5Type 0 "UNKNOWN" 1 "ADDCAR" 2 "ADDLORRY" 3 "ADDTRAILER" 4 "ADDCARAVAN" 5 "ADDBUS" 6 "ADDTRACTOR" 7 "ADDMCYCLE" 8 "ADDLORRYBUSTRAILER_DEPRECATED" 9 "ADDLORRYBUS_DEPRECATED" 10 "ADDHAZMAT" 11 "ADDTANK" 12 "ADDTRAM" 13 "ADDWET" 14 "ADDFOG" 15 "ADDRAIN" 16 "ADDSNOW" 17 "ADDTIME" 18 "ADDSECTION" 19 "ADDDISTANCE" 20 "ADDWEIGHT" 21 "ADDEXITL" 22 "ADDEXITR" 23 "ADDLANES" 24 "ADDRADAR" 25 "ADDRAPPEL" 26 "ADDPRIOTURN" 27 "ADDLORRY_EXCEPT" 28 "ADDTRACTOR_OVER" 29 "ADDTEXT" 30 "ADDSIGN" 31 "ADDRAINSNOW" 32 "ADDHUMP" 33 "VADDLORRYBUSTRAILER_DEPRECATED" 34 "VADDLORRYBUS_DEPRECATED" 35 "VADDLORRYTRAILER_DEPRECATED" 36 "ADDLORRYTRAILER_DEPRECATED" 37 "ADDCAMPER" 38 "ADDZONE" 39 "ADDCRASHRISK" 40 "ADDACCIDENT" 41 "ADDJAM" 42 "ADDSMOKE" 43 "ADDOILTRAIL" 44 "ADDGRAVEL" 45 "ADDDIRT" 46 "ADDRWORKSEXIT" 47 "ADDROADDAMAGE" 48 "ADDRWORKSENTRY" 49 "ADDLOWTREE" 50 "ADDRWORKSACCESS" 51 "ADDRUTS" 52 "ADDSOFTSHOULDERCAR" 53 "ADDSOFTSHOULDERLORRY" 54 "VADDSIGN" 55 "VADDCAR" 56 "VADDLORRY" 57 "VADDTRAILER" 58 "VADDCARAVAN" 59 "VADDBUS" 60 "VADDWET" 61 "VADDFOG" 62 "VADDRAIN" 63 "VADDSNOW" 64 "VADDRAINSNOW" 65 "VADDTEXT" 66 "VADDSECTION" 67 "VADDDISTANCE" 68 "VADDWEIGHT" 69 "VADDZONE" 70 "VADDCRASHRISK" 71 "VADDACCIDENT" 72 "VADDJAM" 73 "VADDOILTRAIL" 74 "VADDGRAVEL" 75 "VADDDIRT" 76 "VADDROADDAMAGE" 77 "VADDRUTS" 78 "ADDNOSTOPSHOULDER" 79 "ADDTOWING" 80 "ADDSCHOOL" 81 "ADDNIGHT" 82 "ADDEND" 83 "ADDBEGINS" 84 "ADDWITHIN" 85 "ADDDISTANCEBARS" 86 "ADDMINIMUM" 87 "ADDADVICE" 88 "ADDACCESS" 89 "ADDALLWAY" 90 "ADDBUS_EXCEPT" 91 "ADDEXCEPTDELIVERY" 92 "ADDEXCEPTLOCAL" 93 "ADDFROG" 94 "ADDPRIOTURNL" 95 "ADDPRIOTURNR" 96 "ADDSTART" 97 "ADDSTOPIN" 98 "ADDEXIT" 99 "ADDHAZWATER" 100 "ADDDAY" 101 "ADDSL" 102 "ADDLORRYTRAILER" 103 "ADDLORRYSEMI" 104 "VADDLORRYTRAILER" 105 "VADDLORRYSEMI" 106 "ADDSLOW" 107 "ADDSL5" 108 "ADDSL10" 109 "ADDSL15" 110 "ADDSL20" 111 "ADDSL25" 112 "ADDSL30" 113 "ADDSL35" 114 "ADDSL40" 115 "ADDSL45" 116 "ADDSL50" 117 "ADDSL55" 118 "ADDSL60" 119 "ADDSL65" 120 "ADDSL70" 121 "ADDSL75" 122 "ADDSL80" 123 "ADDSL85" 124 "ADDSL90" 125 "ADDSL95" 126 "ADDSL100" 127 "ADDSL105" 128 "ADDSL110" 129 "ADDSL115" 130 "ADDSL120" 131 "ADDSL125" 132 "ADDSL130" 133 "ADDSL135" 134 "ADDSL140" 135 "ADDSL145" 136 "ADDSL150" 137 "ADDSL155" 138 "ADDSL160" 139 "ADDBIKEROAD" 140 "ADDLORRYTRAILER_EXCEPT" 141 "ADDLORRYSEMI_EXCEPT" 142 "Reserved142" 143 "Reserved143" 144 "Reserved144" 145 "Reserved145" 146 "Reserved146" 147 "Reserved147" 148 "Reserved148" 149 "Reserved149" 150 "Reserved150" 151 "Reserved151" 152 "Reserved152" 153 "Reserved153" 154 "Reserved154" 155 "Reserved155" 156 "Reserved156" 157 "Reserved157" 158 "Reserved158" 159 "Reserved159" 160 "Reserved160" 161 "Reserved161" 162 "Reserved162" 163 "Reserved163" 164 "Reserved164" 165 "Reserved165" 166 "Reserved166" 167 "Reserved167" 168 "Reserved168" 169 "Reserved169" ;
SIG_GROUP_ 178 SG_VFC_RoadMarking_00_06 1 : VFC_RM_00_06_CRC VFC_RM_00_06_AliveCtr VFC_RM_00_06_ProtBlockCtr VFC_RM00_ExistProb VFC_RM00_Type VFC_RM00_VertexPoint00x VFC_RM00_VertexPoint00y VFC_RM00_VertexPoint01x VFC_RM00_VertexPoint01y VFC_RM01_ExistProb VFC_RM01_Type VFC_RM01_VertexPoint00x VFC_RM01_VertexPoint00y VFC_RM01_VertexPoint01x VFC_RM01_VertexPoint01y VFC_RM02_ExistProb VFC_RM02_Type VFC_RM02_VertexPoint00x VFC_RM02_VertexPoint00y VFC_RM02_VertexPoint01x VFC_RM02_VertexPoint01y VFC_RM03_ExistProb VFC_RM03_Type VFC_RM03_VertexPoint00x VFC_RM03_VertexPoint00y VFC_RM03_VertexPoint01x VFC_RM03_VertexPoint01y VFC_RM04_ExistProb VFC_RM04_Type VFC_RM04_VertexPoint00x VFC_RM04_VertexPoint00y VFC_RM04_VertexPoint01x VFC_RM04_VertexPoint01y VFC_RM05_ExistProb VFC_RM05_Type VFC_RM05_VertexPoint00x VFC_RM05_VertexPoint00y VFC_RM05_VertexPoint01x VFC_RM05_VertexPoint01y VFC_RM06_ExistProb VFC_RM06_Type VFC_RM06_VertexPoint00x VFC_RM06_VertexPoint00y VFC_RM06_VertexPoint01x VFC_RM06_VertexPoint01y;
SIG_GROUP_ 224 SG_VFC_TrafficLightHdr 1 : VFC_TLHdr_CRC VFC_TLHdr_AliveCtr VFC_TLHdr_ProtBlockCtr VFC_TLHdr_IfVersionIdMajor VFC_TLHdr_IfVersionIdMinor VFC_TLHdr_NumTrafficLights VFC_TLHdr_TimeStampStatus VFC_TLHdr_TimeStamp VFC_TLHdr_State VFC_TLHdr_MostRelevantTLId VFC_TLHdr_Reserved0 VFC_TLHdr_Reserved1;
SIG_GROUP_ 226 SG_VFC_TrafficLight_00_04 1 : VFC_TL00_04_CRC VFC_TL00_04_AliveCtr VFC_TL00_04_ProtBlockCtr VFC_TL00_Colour VFC_TL00_LightShapeType VFC_TL00_LightModeType VFC_TL00_Py VFC_TL00_ExistProb VFC_TL00_Pz VFC_TL00_2DWidth VFC_TL00_2DHeight VFC_TL00_2DLeftEdge VFC_TL00_2DTopEdge VFC_TL00_Px VFC_TL01_Colour VFC_TL01_LightShapeType VFC_TL01_LightModeType VFC_TL01_Py VFC_TL01_ExistProb VFC_TL01_Pz VFC_TL01_2DWidth VFC_TL01_2DHeight VFC_TL01_2DLeftEdge VFC_TL01_2DTopEdge VFC_TL01_Px VFC_TL02_Colour VFC_TL02_LightShapeType VFC_TL02_LightModeType VFC_TL02_Py VFC_TL02_ExistProb VFC_TL02_Pz VFC_TL02_2DWidth VFC_TL02_2DHeight VFC_TL02_2DLeftEdge VFC_TL02_2DTopEdge VFC_TL02_Px VFC_TL03_Colour VFC_TL03_LightShapeType VFC_TL03_LightModeType VFC_TL03_Py VFC_TL03_ExistProb VFC_TL03_Pz VFC_TL03_2DWidth VFC_TL03_2DHeight VFC_TL03_2DLeftEdge VFC_TL03_2DTopEdge VFC_TL03_Px VFC_TL04_Colour VFC_TL04_LightShapeType VFC_TL04_LightModeType VFC_TL04_Py VFC_TL04_ExistProb VFC_TL04_Pz VFC_TL04_2DWidth VFC_TL04_2DHeight VFC_TL04_2DLeftEdge VFC_TL04_2DTopEdge VFC_TL04_Px;
SIG_GROUP_ 227 SG_VFC_TrafficLight_05_09 1 : VFC_TL05_09_CRC VFC_TL05_09_AliveCtr VFC_TL05_09_ProtBlockCtr VFC_TL05_Colour VFC_TL05_LightShapeType VFC_TL05_LightModeType VFC_TL05_Py VFC_TL05_ExistProb VFC_TL05_Pz VFC_TL05_2DWidth VFC_TL05_2DHeight VFC_TL05_2DLeftEdge VFC_TL05_2DTopEdge VFC_TL05_Px VFC_TL06_Colour VFC_TL06_LightShapeType VFC_TL06_LightModeType VFC_TL06_Py VFC_TL06_ExistProb VFC_TL06_Pz VFC_TL06_2DWidth VFC_TL06_2DHeight VFC_TL06_2DLeftEdge VFC_TL06_2DTopEdge VFC_TL06_Px VFC_TL07_Colour VFC_TL07_LightShapeType VFC_TL07_LightModeType VFC_TL07_Py VFC_TL07_ExistProb VFC_TL07_Pz VFC_TL07_2DWidth VFC_TL07_2DHeight VFC_TL07_2DLeftEdge VFC_TL07_2DTopEdge VFC_TL07_Px VFC_TL08_Colour VFC_TL08_LightShapeType VFC_TL08_LightModeType VFC_TL08_Py VFC_TL08_ExistProb VFC_TL08_Pz VFC_TL08_2DWidth VFC_TL08_2DHeight VFC_TL08_2DLeftEdge VFC_TL08_2DTopEdge VFC_TL08_Px VFC_TL09_Colour VFC_TL09_LightShapeType VFC_TL09_LightModeType VFC_TL09_Py VFC_TL09_ExistProb VFC_TL09_Pz VFC_TL09_2DWidth VFC_TL09_2DHeight VFC_TL09_2DLeftEdge VFC_TL09_2DTopEdge VFC_TL09_Px;
SIG_GROUP_ 236 SG_VFC_TrafficSignHdr 1 : VFC_TSHdr_CRC VFC_TSHdr_AliveCtr VFC_TSHdr_ProtBlockCtr VFC_TSHdr_IfVersionIdMajor VFC_TSHdr_IfVersionIdMinor VFC_TSHdr_NumValidTrafficSigns VFC_TSHdr_TimeStampStatus VFC_TSHdr_TimeStamp VFC_TSHdr_SensorStatus VFC_TSHdr_SensorStatusExt VFC_TSHdr_CurrentRegion;
SIG_GROUP_ 238 SG_VFC_TrafficSign_00_01 1 : VFC_TS_00_01_CRC VFC_TS_00_01_AliveCtr VFC_TS_00_01_ProtBlockCtr VFC_TS00_ObjId VFC_TS00_Type VFC_TS00_ExistProb VFC_TS00_Px VFC_TS00_Py VFC_TS00_Pz VFC_TS00_PxStdDev VFC_TS00_Width VFC_TS00_Height VFC_TS00_EmbeddedInfo VFC_TS00_ValidLane VFC_TS00_ValidDay VFC_TS00_ValidTimeRange1Start VFC_TS00_ValidTimeRange1End VFC_TS00_ValidTimeRange2Start VFC_TS00_ValidTimeRange2End VFC_TS00_ValidInDist VFC_TS00_ValidInDistUnit VFC_TS00_ValidSection VFC_TS00_ValidSectionUnit VFC_TS00_NumValidSupSigns VFC_TS00_SupSign0ExistProb VFC_TS00_SupSign1ExistProb VFC_TS00_SupSign2ExistProb VFC_TS00_SupSign3ExistProb VFC_TS00_SupSign4ExistProb VFC_TS00_SupSign5ExistProb VFC_TS00_SupSign0Type VFC_TS00_SupSign1Type VFC_TS00_SupSign2Type VFC_TS00_SupSign3Type VFC_TS00_SupSign4Type VFC_TS00_SupSign5Type VFC_TS01_ObjId VFC_TS01_Type VFC_TS01_ExistProb VFC_TS01_Px VFC_TS01_Py VFC_TS01_Pz VFC_TS01_PxStdDev VFC_TS01_Width VFC_TS01_Height VFC_TS01_EmbeddedInfo VFC_TS01_ValidLane VFC_TS01_ValidDay VFC_TS01_ValidTimeRange1Start VFC_TS01_ValidTimeRange1End VFC_TS01_ValidTimeRange2Start VFC_TS01_ValidTimeRange2End VFC_TS01_ValidInDist VFC_TS01_ValidInDistUnit VFC_TS01_ValidSection VFC_TS01_ValidSectionUnit VFC_TS01_NumValidSupSigns VFC_TS01_SupSign0ExistProb VFC_TS01_SupSign1ExistProb VFC_TS01_SupSign2ExistProb VFC_TS01_SupSign3ExistProb VFC_TS01_SupSign4ExistProb VFC_TS01_SupSign5ExistProb VFC_TS01_SupSign0Type VFC_TS01_SupSign1Type VFC_TS01_SupSign2Type VFC_TS01_SupSign3Type VFC_TS01_SupSign4Type VFC_TS01_SupSign5Type;
SIG_GROUP_ 239 SG_VFC_TrafficSign_02_03 1 : VFC_TS_02_03_CRC VFC_TS_02_03_AliveCtr VFC_TS_02_03_ProtBlockCtr VFC_TS02_ObjId VFC_TS02_Type VFC_TS02_ExistProb VFC_TS02_Px VFC_TS02_Py VFC_TS02_Pz VFC_TS02_PxStdDev VFC_TS02_Width VFC_TS02_Height VFC_TS02_EmbeddedInfo VFC_TS02_ValidLane VFC_TS02_ValidDay VFC_TS02_ValidTimeRange1Start VFC_TS02_ValidTimeRange1End VFC_TS02_ValidTimeRange2Start VFC_TS02_ValidTimeRange2End VFC_TS02_ValidInDist VFC_TS02_ValidInDistUnit VFC_TS02_ValidSection VFC_TS02_ValidSectionUnit VFC_TS02_NumValidSupSigns VFC_TS02_SupSign0ExistProb VFC_TS02_SupSign1ExistProb VFC_TS02_SupSign2ExistProb VFC_TS02_SupSign3ExistProb VFC_TS02_SupSign4ExistProb VFC_TS02_SupSign5ExistProb VFC_TS02_SupSign0Type VFC_TS02_SupSign1Type VFC_TS02_SupSign2Type VFC_TS02_SupSign3Type VFC_TS02_SupSign4Type VFC_TS02_SupSign5Type VFC_TS03_ObjId VFC_TS03_Type VFC_TS03_ExistProb VFC_TS03_Px VFC_TS03_Py VFC_TS03_Pz VFC_TS03_PxStdDev VFC_TS03_Width VFC_TS03_Height VFC_TS03_EmbeddedInfo VFC_TS03_ValidLane VFC_TS03_ValidDay VFC_TS03_ValidTimeRange1Start VFC_TS03_ValidTimeRange1End VFC_TS03_ValidTimeRange2Start VFC_TS03_ValidTimeRange2End VFC_TS03_ValidInDist VFC_TS03_ValidInDistUnit VFC_TS03_ValidSection VFC_TS03_ValidSectionUnit VFC_TS03_NumValidSupSigns VFC_TS03_SupSign0ExistProb VFC_TS03_SupSign1ExistProb VFC_TS03_SupSign2ExistProb VFC_TS03_SupSign3ExistProb VFC_TS03_SupSign4ExistProb VFC_TS03_SupSign5ExistProb VFC_TS03_SupSign0Type VFC_TS03_SupSign1Type VFC_TS03_SupSign2Type VFC_TS03_SupSign3Type VFC_TS03_SupSign4Type VFC_TS03_SupSign5Type;
