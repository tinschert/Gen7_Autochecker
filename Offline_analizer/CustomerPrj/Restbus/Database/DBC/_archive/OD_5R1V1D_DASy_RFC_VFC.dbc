VERSION "created by canmatrix"

NS_ :

BS_:

BU_: RadarFrontCenter VideoFrontCenter DASy ReceiveECU

BO_ 296 RFC_Location_096_098: 64 RadarFrontCenter
 SG_ RFC_Loc096_098_CRC : 0|16@1+ (1,0) [0|65535] ""  DASy
 SG_ RFC_Loc096_098_AliveCtr : 16|8@1+ (1,0) [0|255] ""  DASy
 SG_ RFC_Loc096_098_ProtBlockCtr : 24|4@1+ (1,0) [0|15] ""  DASy
 SG_ RFC_Loc096_RadialDistance : 32|15@1+ (0.01,0) [0|327.67] "m"  DASy
 SG_ RFC_Loc096_RadialVelocity : 47|15@1+ (0.01,-163.84) [-110|55] "m/s"  DASy
 SG_ RFC_Loc096_Elevation : 62|10@1+ (0.1,-51.2) [-45|45] "deg"  DASy
 SG_ RFC_Loc096_Azimuth : 72|11@1+ (0.1,-102.4) [-90|90] "deg"  DASy
 SG_ RFC_Loc096_DistVelocityCoVnce : 83|11@1+ (0.0001,-0.1024) [-0.1024|0.1023] "m^2/s"  DASy
 SG_ RFC_Loc096_RadialDistanceVnce : 94|10@1+ (5E-005,0) [0|0.05115] "m^2"  DASy
 SG_ RFC_Loc096_RadialVelocityVnce : 104|10@1+ (0.0001,0) [0|0.1023] "m^2/s^2"  DASy
 SG_ RFC_Loc096_ElevationVnce : 114|10@1+ (0.001,0) [0|1.023] "deg^2"  DASy
 SG_ RFC_Loc096_AzimuthVnce : 124|10@1+ (0.001,0) [0|1.023] "deg^2"  DASy
 SG_ RFC_Loc096_RadarCrossSection : 134|10@1+ (0.2,-102.4) [-50|70] "dBsm"  DASy
 SG_ RFC_Loc096_DistVelocityQuality : 144|8@1+ (1,0) [0|255] "unitless"  DASy
 SG_ RFC_Loc096_ElevationQuality : 152|8@1+ (1,0) [0|255] "unitless"  DASy
 SG_ RFC_Loc096_AzimuthQuality : 160|8@1+ (1,0) [0|255] "unitless"  DASy
 SG_ RFC_Loc096_RSSI : 168|10@1+ (0.1,0) [0|100] "unitless"  DASy
 SG_ RFC_Loc096_AzimuthalPartnerId : 178|10@1+ (1,0) [0|1023] "unitless"  DASy
 SG_ RFC_Loc097_RadialDistance : 192|15@1+ (0.01,0) [0|327.67] "m"  DASy
 SG_ RFC_Loc097_RadialVelocity : 207|15@1+ (0.01,-163.84) [-110|55] "m/s"  DASy
 SG_ RFC_Loc097_Elevation : 222|10@1+ (0.1,-51.2) [-45|45] "deg"  DASy
 SG_ RFC_Loc097_Azimuth : 232|11@1+ (0.1,-102.4) [-90|90] "deg"  DASy
 SG_ RFC_Loc097_DistVelocityCoVnce : 243|11@1+ (0.0001,-0.1024) [-0.1024|0.1023] "m^2/s"  DASy
 SG_ RFC_Loc097_RadialDistanceVnce : 254|10@1+ (5E-005,0) [0|0.05115] "m^2"  DASy
 SG_ RFC_Loc097_RadialVelocityVnce : 264|10@1+ (0.0001,0) [0|0.1023] "m^2/s^2"  DASy
 SG_ RFC_Loc097_ElevationVnce : 274|10@1+ (0.001,0) [0|1.023] "deg^2"  DASy
 SG_ RFC_Loc097_AzimuthVnce : 284|10@1+ (0.001,0) [0|1.023] "deg^2"  DASy
 SG_ RFC_Loc097_RadarCrossSection : 294|10@1+ (0.2,-102.4) [-50|70] "dBsm"  DASy
 SG_ RFC_Loc097_DistVelocityQuality : 304|8@1+ (1,0) [0|255] "unitless"  DASy
 SG_ RFC_Loc097_ElevationQuality : 312|8@1+ (1,0) [0|255] "unitless"  DASy
 SG_ RFC_Loc097_AzimuthQuality : 320|8@1+ (1,0) [0|255] "unitless"  DASy
 SG_ RFC_Loc097_RSSI : 328|10@1+ (0.1,0) [0|100] "unitless"  DASy
 SG_ RFC_Loc097_AzimuthalPartnerId : 338|10@1+ (1,0) [0|1023] "unitless"  DASy
 SG_ RFC_Loc098_RadialDistance : 352|15@1+ (0.01,0) [0|327.67] "m"  DASy
 SG_ RFC_Loc098_RadialVelocity : 367|15@1+ (0.01,-163.84) [-110|55] "m/s"  DASy
 SG_ RFC_Loc098_Elevation : 382|10@1+ (0.1,-51.2) [-45|45] "deg"  DASy
 SG_ RFC_Loc098_Azimuth : 392|11@1+ (0.1,-102.4) [-90|90] "deg"  DASy
 SG_ RFC_Loc098_DistVelocityCoVnce : 403|11@1+ (0.0001,-0.1024) [-0.1024|0.1023] "m^2/s"  DASy
 SG_ RFC_Loc098_RadialDistanceVnce : 414|10@1+ (5E-005,0) [0|0.05115] "m^2"  DASy
 SG_ RFC_Loc098_RadialVelocityVnce : 424|10@1+ (0.0001,0) [0|0.1023] "m^2/s^2"  DASy
 SG_ RFC_Loc098_ElevationVnce : 434|10@1+ (0.001,0) [0|1.023] "deg^2"  DASy
 SG_ RFC_Loc098_AzimuthVnce : 444|10@1+ (0.001,0) [0|1.023] "deg^2"  DASy
 SG_ RFC_Loc098_RadarCrossSection : 454|10@1+ (0.2,-102.4) [-50|70] "dBsm"  DASy
 SG_ RFC_Loc098_DistVelocityQuality : 464|8@1+ (1,0) [0|255] "unitless"  DASy
 SG_ RFC_Loc098_ElevationQuality : 472|8@1+ (1,0) [0|255] "unitless"  DASy
 SG_ RFC_Loc098_AzimuthQuality : 480|8@1+ (1,0) [0|255] "unitless"  DASy
 SG_ RFC_Loc098_RSSI : 488|10@1+ (0.1,0) [0|100] "unitless"  DASy
 SG_ RFC_Loc098_AzimuthalPartnerId : 498|10@1+ (1,0) [0|1023] "unitless"  DASy

BO_ 297 RFC_Location_099_101: 64 RadarFrontCenter
 SG_ RFC_Loc099_101_CRC : 0|16@1+ (1,0) [0|65535] ""  DASy
 SG_ RFC_Loc099_101_AliveCtr : 16|8@1+ (1,0) [0|255] ""  DASy
 SG_ RFC_Loc099_101_ProtBlockCtr : 24|4@1+ (1,0) [0|15] ""  DASy
 SG_ RFC_Loc099_RadialDistance : 32|15@1+ (0.01,0) [0|327.67] "m"  DASy
 SG_ RFC_Loc099_RadialVelocity : 47|15@1+ (0.01,-163.84) [-110|55] "m/s"  DASy
 SG_ RFC_Loc099_Elevation : 62|10@1+ (0.1,-51.2) [-45|45] "deg"  DASy
 SG_ RFC_Loc099_Azimuth : 72|11@1+ (0.1,-102.4) [-90|90] "deg"  DASy
 SG_ RFC_Loc099_DistVelocityCoVnce : 83|11@1+ (0.0001,-0.1024) [-0.1024|0.1023] "m^2/s"  DASy
 SG_ RFC_Loc099_RadialDistanceVnce : 94|10@1+ (5E-005,0) [0|0.05115] "m^2"  DASy
 SG_ RFC_Loc099_RadialVelocityVnce : 104|10@1+ (0.0001,0) [0|0.1023] "m^2/s^2"  DASy
 SG_ RFC_Loc099_ElevationVnce : 114|10@1+ (0.001,0) [0|1.023] "deg^2"  DASy
 SG_ RFC_Loc099_AzimuthVnce : 124|10@1+ (0.001,0) [0|1.023] "deg^2"  DASy
 SG_ RFC_Loc099_RadarCrossSection : 134|10@1+ (0.2,-102.4) [-50|70] "dBsm"  DASy
 SG_ RFC_Loc099_DistVelocityQuality : 144|8@1+ (1,0) [0|255] "unitless"  DASy
 SG_ RFC_Loc099_ElevationQuality : 152|8@1+ (1,0) [0|255] "unitless"  DASy
 SG_ RFC_Loc099_AzimuthQuality : 160|8@1+ (1,0) [0|255] "unitless"  DASy
 SG_ RFC_Loc099_RSSI : 168|10@1+ (0.1,0) [0|100] "unitless"  DASy
 SG_ RFC_Loc099_AzimuthalPartnerId : 178|10@1+ (1,0) [0|1023] "unitless"  DASy
 SG_ RFC_Loc100_RadialDistance : 192|15@1+ (0.01,0) [0|327.67] "m"  DASy
 SG_ RFC_Loc100_RadialVelocity : 207|15@1+ (0.01,-163.84) [-110|55] "m/s"  DASy
 SG_ RFC_Loc100_Elevation : 222|10@1+ (0.1,-51.2) [-45|45] "deg"  DASy
 SG_ RFC_Loc100_Azimuth : 232|11@1+ (0.1,-102.4) [-90|90] "deg"  DASy
 SG_ RFC_Loc100_DistVelocityCoVnce : 243|11@1+ (0.0001,-0.1024) [-0.1024|0.1023] "m^2/s"  DASy
 SG_ RFC_Loc100_RadialDistanceVnce : 254|10@1+ (5E-005,0) [0|0.05115] "m^2"  DASy
 SG_ RFC_Loc100_RadialVelocityVnce : 264|10@1+ (0.0001,0) [0|0.1023] "m^2/s^2"  DASy
 SG_ RFC_Loc100_ElevationVnce : 274|10@1+ (0.001,0) [0|1.023] "deg^2"  DASy
 SG_ RFC_Loc100_AzimuthVnce : 284|10@1+ (0.001,0) [0|1.023] "deg^2"  DASy
 SG_ RFC_Loc100_RadarCrossSection : 294|10@1+ (0.2,-102.4) [-50|70] "dBsm"  DASy
 SG_ RFC_Loc100_DistVelocityQuality : 304|8@1+ (1,0) [0|255] "unitless"  DASy
 SG_ RFC_Loc100_ElevationQuality : 312|8@1+ (1,0) [0|255] "unitless"  DASy
 SG_ RFC_Loc100_AzimuthQuality : 320|8@1+ (1,0) [0|255] "unitless"  DASy
 SG_ RFC_Loc100_RSSI : 328|10@1+ (0.1,0) [0|100] "unitless"  DASy
 SG_ RFC_Loc100_AzimuthalPartnerId : 338|10@1+ (1,0) [0|1023] "unitless"  DASy
 SG_ RFC_Loc101_RadialDistance : 352|15@1+ (0.01,0) [0|327.67] "m"  DASy
 SG_ RFC_Loc101_RadialVelocity : 367|15@1+ (0.01,-163.84) [-110|55] "m/s"  DASy
 SG_ RFC_Loc101_Elevation : 382|10@1+ (0.1,-51.2) [-45|45] "deg"  DASy
 SG_ RFC_Loc101_Azimuth : 392|11@1+ (0.1,-102.4) [-90|90] "deg"  DASy
 SG_ RFC_Loc101_DistVelocityCoVnce : 403|11@1+ (0.0001,-0.1024) [-0.1024|0.1023] "m^2/s"  DASy
 SG_ RFC_Loc101_RadialDistanceVnce : 414|10@1+ (5E-005,0) [0|0.05115] "m^2"  DASy
 SG_ RFC_Loc101_RadialVelocityVnce : 424|10@1+ (0.0001,0) [0|0.1023] "m^2/s^2"  DASy
 SG_ RFC_Loc101_ElevationVnce : 434|10@1+ (0.001,0) [0|1.023] "deg^2"  DASy
 SG_ RFC_Loc101_AzimuthVnce : 444|10@1+ (0.001,0) [0|1.023] "deg^2"  DASy
 SG_ RFC_Loc101_RadarCrossSection : 454|10@1+ (0.2,-102.4) [-50|70] "dBsm"  DASy
 SG_ RFC_Loc101_DistVelocityQuality : 464|8@1+ (1,0) [0|255] "unitless"  DASy
 SG_ RFC_Loc101_ElevationQuality : 472|8@1+ (1,0) [0|255] "unitless"  DASy
 SG_ RFC_Loc101_AzimuthQuality : 480|8@1+ (1,0) [0|255] "unitless"  DASy
 SG_ RFC_Loc101_RSSI : 488|10@1+ (0.1,0) [0|100] "unitless"  DASy
 SG_ RFC_Loc101_AzimuthalPartnerId : 498|10@1+ (1,0) [0|1023] "unitless"  DASy

BO_ 298 RFC_Location_102_104: 64 RadarFrontCenter
 SG_ RFC_Loc102_104_CRC : 0|16@1+ (1,0) [0|65535] ""  DASy
 SG_ RFC_Loc102_104_AliveCtr : 16|8@1+ (1,0) [0|255] ""  DASy
 SG_ RFC_Loc102_104_ProtBlockCtr : 24|4@1+ (1,0) [0|15] ""  DASy
 SG_ RFC_Loc102_RadialDistance : 32|15@1+ (0.01,0) [0|327.67] "m"  DASy
 SG_ RFC_Loc102_RadialVelocity : 47|15@1+ (0.01,-163.84) [-110|55] "m/s"  DASy
 SG_ RFC_Loc102_Elevation : 62|10@1+ (0.1,-51.2) [-45|45] "deg"  DASy
 SG_ RFC_Loc102_Azimuth : 72|11@1+ (0.1,-102.4) [-90|90] "deg"  DASy
 SG_ RFC_Loc102_DistVelocityCoVnce : 83|11@1+ (0.0001,-0.1024) [-0.1024|0.1023] "m^2/s"  DASy
 SG_ RFC_Loc102_RadialDistanceVnce : 94|10@1+ (5E-005,0) [0|0.05115] "m^2"  DASy
 SG_ RFC_Loc102_RadialVelocityVnce : 104|10@1+ (0.0001,0) [0|0.1023] "m^2/s^2"  DASy
 SG_ RFC_Loc102_ElevationVnce : 114|10@1+ (0.001,0) [0|1.023] "deg^2"  DASy
 SG_ RFC_Loc102_AzimuthVnce : 124|10@1+ (0.001,0) [0|1.023] "deg^2"  DASy
 SG_ RFC_Loc102_RadarCrossSection : 134|10@1+ (0.2,-102.4) [-50|70] "dBsm"  DASy
 SG_ RFC_Loc102_DistVelocityQuality : 144|8@1+ (1,0) [0|255] "unitless"  DASy
 SG_ RFC_Loc102_ElevationQuality : 152|8@1+ (1,0) [0|255] "unitless"  DASy
 SG_ RFC_Loc102_AzimuthQuality : 160|8@1+ (1,0) [0|255] "unitless"  DASy
 SG_ RFC_Loc102_RSSI : 168|10@1+ (0.1,0) [0|100] "unitless"  DASy
 SG_ RFC_Loc102_AzimuthalPartnerId : 178|10@1+ (1,0) [0|1023] "unitless"  DASy
 SG_ RFC_Loc103_RadialDistance : 192|15@1+ (0.01,0) [0|327.67] "m"  DASy
 SG_ RFC_Loc103_RadialVelocity : 207|15@1+ (0.01,-163.84) [-110|55] "m/s"  DASy
 SG_ RFC_Loc103_Elevation : 222|10@1+ (0.1,-51.2) [-45|45] "deg"  DASy
 SG_ RFC_Loc103_Azimuth : 232|11@1+ (0.1,-102.4) [-90|90] "deg"  DASy
 SG_ RFC_Loc103_DistVelocityCoVnce : 243|11@1+ (0.0001,-0.1024) [-0.1024|0.1023] "m^2/s"  DASy
 SG_ RFC_Loc103_RadialDistanceVnce : 254|10@1+ (5E-005,0) [0|0.05115] "m^2"  DASy
 SG_ RFC_Loc103_RadialVelocityVnce : 264|10@1+ (0.0001,0) [0|0.1023] "m^2/s^2"  DASy
 SG_ RFC_Loc103_ElevationVnce : 274|10@1+ (0.001,0) [0|1.023] "deg^2"  DASy
 SG_ RFC_Loc103_AzimuthVnce : 284|10@1+ (0.001,0) [0|1.023] "deg^2"  DASy
 SG_ RFC_Loc103_RadarCrossSection : 294|10@1+ (0.2,-102.4) [-50|70] "dBsm"  DASy
 SG_ RFC_Loc103_DistVelocityQuality : 304|8@1+ (1,0) [0|255] "unitless"  DASy
 SG_ RFC_Loc103_ElevationQuality : 312|8@1+ (1,0) [0|255] "unitless"  DASy
 SG_ RFC_Loc103_AzimuthQuality : 320|8@1+ (1,0) [0|255] "unitless"  DASy
 SG_ RFC_Loc103_RSSI : 328|10@1+ (0.1,0) [0|100] "unitless"  DASy
 SG_ RFC_Loc103_AzimuthalPartnerId : 338|10@1+ (1,0) [0|1023] "unitless"  DASy
 SG_ RFC_Loc104_RadialDistance : 352|15@1+ (0.01,0) [0|327.67] "m"  DASy
 SG_ RFC_Loc104_RadialVelocity : 367|15@1+ (0.01,-163.84) [-110|55] "m/s"  DASy
 SG_ RFC_Loc104_Elevation : 382|10@1+ (0.1,-51.2) [-45|45] "deg"  DASy
 SG_ RFC_Loc104_Azimuth : 392|11@1+ (0.1,-102.4) [-90|90] "deg"  DASy
 SG_ RFC_Loc104_DistVelocityCoVnce : 403|11@1+ (0.0001,-0.1024) [-0.1024|0.1023] "m^2/s"  DASy
 SG_ RFC_Loc104_RadialDistanceVnce : 414|10@1+ (5E-005,0) [0|0.05115] "m^2"  DASy
 SG_ RFC_Loc104_RadialVelocityVnce : 424|10@1+ (0.0001,0) [0|0.1023] "m^2/s^2"  DASy
 SG_ RFC_Loc104_ElevationVnce : 434|10@1+ (0.001,0) [0|1.023] "deg^2"  DASy
 SG_ RFC_Loc104_AzimuthVnce : 444|10@1+ (0.001,0) [0|1.023] "deg^2"  DASy
 SG_ RFC_Loc104_RadarCrossSection : 454|10@1+ (0.2,-102.4) [-50|70] "dBsm"  DASy
 SG_ RFC_Loc104_DistVelocityQuality : 464|8@1+ (1,0) [0|255] "unitless"  DASy
 SG_ RFC_Loc104_ElevationQuality : 472|8@1+ (1,0) [0|255] "unitless"  DASy
 SG_ RFC_Loc104_AzimuthQuality : 480|8@1+ (1,0) [0|255] "unitless"  DASy
 SG_ RFC_Loc104_RSSI : 488|10@1+ (0.1,0) [0|100] "unitless"  DASy
 SG_ RFC_Loc104_AzimuthalPartnerId : 498|10@1+ (1,0) [0|1023] "unitless"  DASy

BO_ 299 RFC_Location_105_107: 64 RadarFrontCenter
 SG_ RFC_Loc105_107_CRC : 0|16@1+ (1,0) [0|65535] ""  DASy
 SG_ RFC_Loc105_107_AliveCtr : 16|8@1+ (1,0) [0|255] ""  DASy
 SG_ RFC_Loc105_107_ProtBlockCtr : 24|4@1+ (1,0) [0|15] ""  DASy
 SG_ RFC_Loc105_RadialDistance : 32|15@1+ (0.01,0) [0|327.67] "m"  DASy
 SG_ RFC_Loc105_RadialVelocity : 47|15@1+ (0.01,-163.84) [-110|55] "m/s"  DASy
 SG_ RFC_Loc105_Elevation : 62|10@1+ (0.1,-51.2) [-45|45] "deg"  DASy
 SG_ RFC_Loc105_Azimuth : 72|11@1+ (0.1,-102.4) [-90|90] "deg"  DASy
 SG_ RFC_Loc105_DistVelocityCoVnce : 83|11@1+ (0.0001,-0.1024) [-0.1024|0.1023] "m^2/s"  DASy
 SG_ RFC_Loc105_RadialDistanceVnce : 94|10@1+ (5E-005,0) [0|0.05115] "m^2"  DASy
 SG_ RFC_Loc105_RadialVelocityVnce : 104|10@1+ (0.0001,0) [0|0.1023] "m^2/s^2"  DASy
 SG_ RFC_Loc105_ElevationVnce : 114|10@1+ (0.001,0) [0|1.023] "deg^2"  DASy
 SG_ RFC_Loc105_AzimuthVnce : 124|10@1+ (0.001,0) [0|1.023] "deg^2"  DASy
 SG_ RFC_Loc105_RadarCrossSection : 134|10@1+ (0.2,-102.4) [-50|70] "dBsm"  DASy
 SG_ RFC_Loc105_DistVelocityQuality : 144|8@1+ (1,0) [0|255] "unitless"  DASy
 SG_ RFC_Loc105_ElevationQuality : 152|8@1+ (1,0) [0|255] "unitless"  DASy
 SG_ RFC_Loc105_AzimuthQuality : 160|8@1+ (1,0) [0|255] "unitless"  DASy
 SG_ RFC_Loc105_RSSI : 168|10@1+ (0.1,0) [0|100] "unitless"  DASy
 SG_ RFC_Loc105_AzimuthalPartnerId : 178|10@1+ (1,0) [0|1023] "unitless"  DASy
 SG_ RFC_Loc106_RadialDistance : 192|15@1+ (0.01,0) [0|327.67] "m"  DASy
 SG_ RFC_Loc106_RadialVelocity : 207|15@1+ (0.01,-163.84) [-110|55] "m/s"  DASy
 SG_ RFC_Loc106_Elevation : 222|10@1+ (0.1,-51.2) [-45|45] "deg"  DASy
 SG_ RFC_Loc106_Azimuth : 232|11@1+ (0.1,-102.4) [-90|90] "deg"  DASy
 SG_ RFC_Loc106_DistVelocityCoVnce : 243|11@1+ (0.0001,-0.1024) [-0.1024|0.1023] "m^2/s"  DASy
 SG_ RFC_Loc106_RadialDistanceVnce : 254|10@1+ (5E-005,0) [0|0.05115] "m^2"  DASy
 SG_ RFC_Loc106_RadialVelocityVnce : 264|10@1+ (0.0001,0) [0|0.1023] "m^2/s^2"  DASy
 SG_ RFC_Loc106_ElevationVnce : 274|10@1+ (0.001,0) [0|1.023] "deg^2"  DASy
 SG_ RFC_Loc106_AzimuthVnce : 284|10@1+ (0.001,0) [0|1.023] "deg^2"  DASy
 SG_ RFC_Loc106_RadarCrossSection : 294|10@1+ (0.2,-102.4) [-50|70] "dBsm"  DASy
 SG_ RFC_Loc106_DistVelocityQuality : 304|8@1+ (1,0) [0|255] "unitless"  DASy
 SG_ RFC_Loc106_ElevationQuality : 312|8@1+ (1,0) [0|255] "unitless"  DASy
 SG_ RFC_Loc106_AzimuthQuality : 320|8@1+ (1,0) [0|255] "unitless"  DASy
 SG_ RFC_Loc106_RSSI : 328|10@1+ (0.1,0) [0|100] "unitless"  DASy
 SG_ RFC_Loc106_AzimuthalPartnerId : 338|10@1+ (1,0) [0|1023] "unitless"  DASy
 SG_ RFC_Loc107_RadialDistance : 352|15@1+ (0.01,0) [0|327.67] "m"  DASy
 SG_ RFC_Loc107_RadialVelocity : 367|15@1+ (0.01,-163.84) [-110|55] "m/s"  DASy
 SG_ RFC_Loc107_Elevation : 382|10@1+ (0.1,-51.2) [-45|45] "deg"  DASy
 SG_ RFC_Loc107_Azimuth : 392|11@1+ (0.1,-102.4) [-90|90] "deg"  DASy
 SG_ RFC_Loc107_DistVelocityCoVnce : 403|11@1+ (0.0001,-0.1024) [-0.1024|0.1023] "m^2/s"  DASy
 SG_ RFC_Loc107_RadialDistanceVnce : 414|10@1+ (5E-005,0) [0|0.05115] "m^2"  DASy
 SG_ RFC_Loc107_RadialVelocityVnce : 424|10@1+ (0.0001,0) [0|0.1023] "m^2/s^2"  DASy
 SG_ RFC_Loc107_ElevationVnce : 434|10@1+ (0.001,0) [0|1.023] "deg^2"  DASy
 SG_ RFC_Loc107_AzimuthVnce : 444|10@1+ (0.001,0) [0|1.023] "deg^2"  DASy
 SG_ RFC_Loc107_RadarCrossSection : 454|10@1+ (0.2,-102.4) [-50|70] "dBsm"  DASy
 SG_ RFC_Loc107_DistVelocityQuality : 464|8@1+ (1,0) [0|255] "unitless"  DASy
 SG_ RFC_Loc107_ElevationQuality : 472|8@1+ (1,0) [0|255] "unitless"  DASy
 SG_ RFC_Loc107_AzimuthQuality : 480|8@1+ (1,0) [0|255] "unitless"  DASy
 SG_ RFC_Loc107_RSSI : 488|10@1+ (0.1,0) [0|100] "unitless"  DASy
 SG_ RFC_Loc107_AzimuthalPartnerId : 498|10@1+ (1,0) [0|1023] "unitless"  DASy

BO_ 300 RFC_Location_108_110: 64 RadarFrontCenter
 SG_ RFC_Loc108_110_CRC : 0|16@1+ (1,0) [0|65535] ""  DASy
 SG_ RFC_Loc108_110_AliveCtr : 16|8@1+ (1,0) [0|255] ""  DASy
 SG_ RFC_Loc108_110_ProtBlockCtr : 24|4@1+ (1,0) [0|15] ""  DASy
 SG_ RFC_Loc108_RadialDistance : 32|15@1+ (0.01,0) [0|327.67] "m"  DASy
 SG_ RFC_Loc108_RadialVelocity : 47|15@1+ (0.01,-163.84) [-110|55] "m/s"  DASy
 SG_ RFC_Loc108_Elevation : 62|10@1+ (0.1,-51.2) [-45|45] "deg"  DASy
 SG_ RFC_Loc108_Azimuth : 72|11@1+ (0.1,-102.4) [-90|90] "deg"  DASy
 SG_ RFC_Loc108_DistVelocityCoVnce : 83|11@1+ (0.0001,-0.1024) [-0.1024|0.1023] "m^2/s"  DASy
 SG_ RFC_Loc108_RadialDistanceVnce : 94|10@1+ (5E-005,0) [0|0.05115] "m^2"  DASy
 SG_ RFC_Loc108_RadialVelocityVnce : 104|10@1+ (0.0001,0) [0|0.1023] "m^2/s^2"  DASy
 SG_ RFC_Loc108_ElevationVnce : 114|10@1+ (0.001,0) [0|1.023] "deg^2"  DASy
 SG_ RFC_Loc108_AzimuthVnce : 124|10@1+ (0.001,0) [0|1.023] "deg^2"  DASy
 SG_ RFC_Loc108_RadarCrossSection : 134|10@1+ (0.2,-102.4) [-50|70] "dBsm"  DASy
 SG_ RFC_Loc108_DistVelocityQuality : 144|8@1+ (1,0) [0|255] "unitless"  DASy
 SG_ RFC_Loc108_ElevationQuality : 152|8@1+ (1,0) [0|255] "unitless"  DASy
 SG_ RFC_Loc108_AzimuthQuality : 160|8@1+ (1,0) [0|255] "unitless"  DASy
 SG_ RFC_Loc108_RSSI : 168|10@1+ (0.1,0) [0|100] "unitless"  DASy
 SG_ RFC_Loc108_AzimuthalPartnerId : 178|10@1+ (1,0) [0|1023] "unitless"  DASy
 SG_ RFC_Loc109_RadialDistance : 192|15@1+ (0.01,0) [0|327.67] "m"  DASy
 SG_ RFC_Loc109_RadialVelocity : 207|15@1+ (0.01,-163.84) [-110|55] "m/s"  DASy
 SG_ RFC_Loc109_Elevation : 222|10@1+ (0.1,-51.2) [-45|45] "deg"  DASy
 SG_ RFC_Loc109_Azimuth : 232|11@1+ (0.1,-102.4) [-90|90] "deg"  DASy
 SG_ RFC_Loc109_DistVelocityCoVnce : 243|11@1+ (0.0001,-0.1024) [-0.1024|0.1023] "m^2/s"  DASy
 SG_ RFC_Loc109_RadialDistanceVnce : 254|10@1+ (5E-005,0) [0|0.05115] "m^2"  DASy
 SG_ RFC_Loc109_RadialVelocityVnce : 264|10@1+ (0.0001,0) [0|0.1023] "m^2/s^2"  DASy
 SG_ RFC_Loc109_ElevationVnce : 274|10@1+ (0.001,0) [0|1.023] "deg^2"  DASy
 SG_ RFC_Loc109_AzimuthVnce : 284|10@1+ (0.001,0) [0|1.023] "deg^2"  DASy
 SG_ RFC_Loc109_RadarCrossSection : 294|10@1+ (0.2,-102.4) [-50|70] "dBsm"  DASy
 SG_ RFC_Loc109_DistVelocityQuality : 304|8@1+ (1,0) [0|255] "unitless"  DASy
 SG_ RFC_Loc109_ElevationQuality : 312|8@1+ (1,0) [0|255] "unitless"  DASy
 SG_ RFC_Loc109_AzimuthQuality : 320|8@1+ (1,0) [0|255] "unitless"  DASy
 SG_ RFC_Loc109_RSSI : 328|10@1+ (0.1,0) [0|100] "unitless"  DASy
 SG_ RFC_Loc109_AzimuthalPartnerId : 338|10@1+ (1,0) [0|1023] "unitless"  DASy
 SG_ RFC_Loc110_RadialDistance : 352|15@1+ (0.01,0) [0|327.67] "m"  DASy
 SG_ RFC_Loc110_RadialVelocity : 367|15@1+ (0.01,-163.84) [-110|55] "m/s"  DASy
 SG_ RFC_Loc110_Elevation : 382|10@1+ (0.1,-51.2) [-45|45] "deg"  DASy
 SG_ RFC_Loc110_Azimuth : 392|11@1+ (0.1,-102.4) [-90|90] "deg"  DASy
 SG_ RFC_Loc110_DistVelocityCoVnce : 403|11@1+ (0.0001,-0.1024) [-0.1024|0.1023] "m^2/s"  DASy
 SG_ RFC_Loc110_RadialDistanceVnce : 414|10@1+ (5E-005,0) [0|0.05115] "m^2"  DASy
 SG_ RFC_Loc110_RadialVelocityVnce : 424|10@1+ (0.0001,0) [0|0.1023] "m^2/s^2"  DASy
 SG_ RFC_Loc110_ElevationVnce : 434|10@1+ (0.001,0) [0|1.023] "deg^2"  DASy
 SG_ RFC_Loc110_AzimuthVnce : 444|10@1+ (0.001,0) [0|1.023] "deg^2"  DASy
 SG_ RFC_Loc110_RadarCrossSection : 454|10@1+ (0.2,-102.4) [-50|70] "dBsm"  DASy
 SG_ RFC_Loc110_DistVelocityQuality : 464|8@1+ (1,0) [0|255] "unitless"  DASy
 SG_ RFC_Loc110_ElevationQuality : 472|8@1+ (1,0) [0|255] "unitless"  DASy
 SG_ RFC_Loc110_AzimuthQuality : 480|8@1+ (1,0) [0|255] "unitless"  DASy
 SG_ RFC_Loc110_RSSI : 488|10@1+ (0.1,0) [0|100] "unitless"  DASy
 SG_ RFC_Loc110_AzimuthalPartnerId : 498|10@1+ (1,0) [0|1023] "unitless"  DASy

BO_ 301 RFC_Location_111_113: 64 RadarFrontCenter
 SG_ RFC_Loc111_113_CRC : 0|16@1+ (1,0) [0|65535] ""  DASy
 SG_ RFC_Loc111_113_AliveCtr : 16|8@1+ (1,0) [0|255] ""  DASy
 SG_ RFC_Loc111_113_ProtBlockCtr : 24|4@1+ (1,0) [0|15] ""  DASy
 SG_ RFC_Loc111_RadialDistance : 32|15@1+ (0.01,0) [0|327.67] "m"  DASy
 SG_ RFC_Loc111_RadialVelocity : 47|15@1+ (0.01,-163.84) [-110|55] "m/s"  DASy
 SG_ RFC_Loc111_Elevation : 62|10@1+ (0.1,-51.2) [-45|45] "deg"  DASy
 SG_ RFC_Loc111_Azimuth : 72|11@1+ (0.1,-102.4) [-90|90] "deg"  DASy
 SG_ RFC_Loc111_DistVelocityCoVnce : 83|11@1+ (0.0001,-0.1024) [-0.1024|0.1023] "m^2/s"  DASy
 SG_ RFC_Loc111_RadialDistanceVnce : 94|10@1+ (5E-005,0) [0|0.05115] "m^2"  DASy
 SG_ RFC_Loc111_RadialVelocityVnce : 104|10@1+ (0.0001,0) [0|0.1023] "m^2/s^2"  DASy
 SG_ RFC_Loc111_ElevationVnce : 114|10@1+ (0.001,0) [0|1.023] "deg^2"  DASy
 SG_ RFC_Loc111_AzimuthVnce : 124|10@1+ (0.001,0) [0|1.023] "deg^2"  DASy
 SG_ RFC_Loc111_RadarCrossSection : 134|10@1+ (0.2,-102.4) [-50|70] "dBsm"  DASy
 SG_ RFC_Loc111_DistVelocityQuality : 144|8@1+ (1,0) [0|255] "unitless"  DASy
 SG_ RFC_Loc111_ElevationQuality : 152|8@1+ (1,0) [0|255] "unitless"  DASy
 SG_ RFC_Loc111_AzimuthQuality : 160|8@1+ (1,0) [0|255] "unitless"  DASy
 SG_ RFC_Loc111_RSSI : 168|10@1+ (0.1,0) [0|100] "unitless"  DASy
 SG_ RFC_Loc111_AzimuthalPartnerId : 178|10@1+ (1,0) [0|1023] "unitless"  DASy
 SG_ RFC_Loc112_RadialDistance : 192|15@1+ (0.01,0) [0|327.67] "m"  DASy
 SG_ RFC_Loc112_RadialVelocity : 207|15@1+ (0.01,-163.84) [-110|55] "m/s"  DASy
 SG_ RFC_Loc112_Elevation : 222|10@1+ (0.1,-51.2) [-45|45] "deg"  DASy
 SG_ RFC_Loc112_Azimuth : 232|11@1+ (0.1,-102.4) [-90|90] "deg"  DASy
 SG_ RFC_Loc112_DistVelocityCoVnce : 243|11@1+ (0.0001,-0.1024) [-0.1024|0.1023] "m^2/s"  DASy
 SG_ RFC_Loc112_RadialDistanceVnce : 254|10@1+ (5E-005,0) [0|0.05115] "m^2"  DASy
 SG_ RFC_Loc112_RadialVelocityVnce : 264|10@1+ (0.0001,0) [0|0.1023] "m^2/s^2"  DASy
 SG_ RFC_Loc112_ElevationVnce : 274|10@1+ (0.001,0) [0|1.023] "deg^2"  DASy
 SG_ RFC_Loc112_AzimuthVnce : 284|10@1+ (0.001,0) [0|1.023] "deg^2"  DASy
 SG_ RFC_Loc112_RadarCrossSection : 294|10@1+ (0.2,-102.4) [-50|70] "dBsm"  DASy
 SG_ RFC_Loc112_DistVelocityQuality : 304|8@1+ (1,0) [0|255] "unitless"  DASy
 SG_ RFC_Loc112_ElevationQuality : 312|8@1+ (1,0) [0|255] "unitless"  DASy
 SG_ RFC_Loc112_AzimuthQuality : 320|8@1+ (1,0) [0|255] "unitless"  DASy
 SG_ RFC_Loc112_RSSI : 328|10@1+ (0.1,0) [0|100] "unitless"  DASy
 SG_ RFC_Loc112_AzimuthalPartnerId : 338|10@1+ (1,0) [0|1023] "unitless"  DASy
 SG_ RFC_Loc113_RadialDistance : 352|15@1+ (0.01,0) [0|327.67] "m"  DASy
 SG_ RFC_Loc113_RadialVelocity : 367|15@1+ (0.01,-163.84) [-110|55] "m/s"  DASy
 SG_ RFC_Loc113_Elevation : 382|10@1+ (0.1,-51.2) [-45|45] "deg"  DASy
 SG_ RFC_Loc113_Azimuth : 392|11@1+ (0.1,-102.4) [-90|90] "deg"  DASy
 SG_ RFC_Loc113_DistVelocityCoVnce : 403|11@1+ (0.0001,-0.1024) [-0.1024|0.1023] "m^2/s"  DASy
 SG_ RFC_Loc113_RadialDistanceVnce : 414|10@1+ (5E-005,0) [0|0.05115] "m^2"  DASy
 SG_ RFC_Loc113_RadialVelocityVnce : 424|10@1+ (0.0001,0) [0|0.1023] "m^2/s^2"  DASy
 SG_ RFC_Loc113_ElevationVnce : 434|10@1+ (0.001,0) [0|1.023] "deg^2"  DASy
 SG_ RFC_Loc113_AzimuthVnce : 444|10@1+ (0.001,0) [0|1.023] "deg^2"  DASy
 SG_ RFC_Loc113_RadarCrossSection : 454|10@1+ (0.2,-102.4) [-50|70] "dBsm"  DASy
 SG_ RFC_Loc113_DistVelocityQuality : 464|8@1+ (1,0) [0|255] "unitless"  DASy
 SG_ RFC_Loc113_ElevationQuality : 472|8@1+ (1,0) [0|255] "unitless"  DASy
 SG_ RFC_Loc113_AzimuthQuality : 480|8@1+ (1,0) [0|255] "unitless"  DASy
 SG_ RFC_Loc113_RSSI : 488|10@1+ (0.1,0) [0|100] "unitless"  DASy
 SG_ RFC_Loc113_AzimuthalPartnerId : 498|10@1+ (1,0) [0|1023] "unitless"  DASy

BO_ 302 RFC_Location_114_116: 64 RadarFrontCenter
 SG_ RFC_Loc114_116_CRC : 0|16@1+ (1,0) [0|65535] ""  DASy
 SG_ RFC_Loc114_116_AliveCtr : 16|8@1+ (1,0) [0|255] ""  DASy
 SG_ RFC_Loc114_116_ProtBlockCtr : 24|4@1+ (1,0) [0|15] ""  DASy
 SG_ RFC_Loc114_RadialDistance : 32|15@1+ (0.01,0) [0|327.67] "m"  DASy
 SG_ RFC_Loc114_RadialVelocity : 47|15@1+ (0.01,-163.84) [-110|55] "m/s"  DASy
 SG_ RFC_Loc114_Elevation : 62|10@1+ (0.1,-51.2) [-45|45] "deg"  DASy
 SG_ RFC_Loc114_Azimuth : 72|11@1+ (0.1,-102.4) [-90|90] "deg"  DASy
 SG_ RFC_Loc114_DistVelocityCoVnce : 83|11@1+ (0.0001,-0.1024) [-0.1024|0.1023] "m^2/s"  DASy
 SG_ RFC_Loc114_RadialDistanceVnce : 94|10@1+ (5E-005,0) [0|0.05115] "m^2"  DASy
 SG_ RFC_Loc114_RadialVelocityVnce : 104|10@1+ (0.0001,0) [0|0.1023] "m^2/s^2"  DASy
 SG_ RFC_Loc114_ElevationVnce : 114|10@1+ (0.001,0) [0|1.023] "deg^2"  DASy
 SG_ RFC_Loc114_AzimuthVnce : 124|10@1+ (0.001,0) [0|1.023] "deg^2"  DASy
 SG_ RFC_Loc114_RadarCrossSection : 134|10@1+ (0.2,-102.4) [-50|70] "dBsm"  DASy
 SG_ RFC_Loc114_DistVelocityQuality : 144|8@1+ (1,0) [0|255] "unitless"  DASy
 SG_ RFC_Loc114_ElevationQuality : 152|8@1+ (1,0) [0|255] "unitless"  DASy
 SG_ RFC_Loc114_AzimuthQuality : 160|8@1+ (1,0) [0|255] "unitless"  DASy
 SG_ RFC_Loc114_RSSI : 168|10@1+ (0.1,0) [0|100] "unitless"  DASy
 SG_ RFC_Loc114_AzimuthalPartnerId : 178|10@1+ (1,0) [0|1023] "unitless"  DASy
 SG_ RFC_Loc115_RadialDistance : 192|15@1+ (0.01,0) [0|327.67] "m"  DASy
 SG_ RFC_Loc115_RadialVelocity : 207|15@1+ (0.01,-163.84) [-110|55] "m/s"  DASy
 SG_ RFC_Loc115_Elevation : 222|10@1+ (0.1,-51.2) [-45|45] "deg"  DASy
 SG_ RFC_Loc115_Azimuth : 232|11@1+ (0.1,-102.4) [-90|90] "deg"  DASy
 SG_ RFC_Loc115_DistVelocityCoVnce : 243|11@1+ (0.0001,-0.1024) [-0.1024|0.1023] "m^2/s"  DASy
 SG_ RFC_Loc115_RadialDistanceVnce : 254|10@1+ (5E-005,0) [0|0.05115] "m^2"  DASy
 SG_ RFC_Loc115_RadialVelocityVnce : 264|10@1+ (0.0001,0) [0|0.1023] "m^2/s^2"  DASy
 SG_ RFC_Loc115_ElevationVnce : 274|10@1+ (0.001,0) [0|1.023] "deg^2"  DASy
 SG_ RFC_Loc115_AzimuthVnce : 284|10@1+ (0.001,0) [0|1.023] "deg^2"  DASy
 SG_ RFC_Loc115_RadarCrossSection : 294|10@1+ (0.2,-102.4) [-50|70] "dBsm"  DASy
 SG_ RFC_Loc115_DistVelocityQuality : 304|8@1+ (1,0) [0|255] "unitless"  DASy
 SG_ RFC_Loc115_ElevationQuality : 312|8@1+ (1,0) [0|255] "unitless"  DASy
 SG_ RFC_Loc115_AzimuthQuality : 320|8@1+ (1,0) [0|255] "unitless"  DASy
 SG_ RFC_Loc115_RSSI : 328|10@1+ (0.1,0) [0|100] "unitless"  DASy
 SG_ RFC_Loc115_AzimuthalPartnerId : 338|10@1+ (1,0) [0|1023] "unitless"  DASy
 SG_ RFC_Loc116_RadialDistance : 352|15@1+ (0.01,0) [0|327.67] "m"  DASy
 SG_ RFC_Loc116_RadialVelocity : 367|15@1+ (0.01,-163.84) [-110|55] "m/s"  DASy
 SG_ RFC_Loc116_Elevation : 382|10@1+ (0.1,-51.2) [-45|45] "deg"  DASy
 SG_ RFC_Loc116_Azimuth : 392|11@1+ (0.1,-102.4) [-90|90] "deg"  DASy
 SG_ RFC_Loc116_DistVelocityCoVnce : 403|11@1+ (0.0001,-0.1024) [-0.1024|0.1023] "m^2/s"  DASy
 SG_ RFC_Loc116_RadialDistanceVnce : 414|10@1+ (5E-005,0) [0|0.05115] "m^2"  DASy
 SG_ RFC_Loc116_RadialVelocityVnce : 424|10@1+ (0.0001,0) [0|0.1023] "m^2/s^2"  DASy
 SG_ RFC_Loc116_ElevationVnce : 434|10@1+ (0.001,0) [0|1.023] "deg^2"  DASy
 SG_ RFC_Loc116_AzimuthVnce : 444|10@1+ (0.001,0) [0|1.023] "deg^2"  DASy
 SG_ RFC_Loc116_RadarCrossSection : 454|10@1+ (0.2,-102.4) [-50|70] "dBsm"  DASy
 SG_ RFC_Loc116_DistVelocityQuality : 464|8@1+ (1,0) [0|255] "unitless"  DASy
 SG_ RFC_Loc116_ElevationQuality : 472|8@1+ (1,0) [0|255] "unitless"  DASy
 SG_ RFC_Loc116_AzimuthQuality : 480|8@1+ (1,0) [0|255] "unitless"  DASy
 SG_ RFC_Loc116_RSSI : 488|10@1+ (0.1,0) [0|100] "unitless"  DASy
 SG_ RFC_Loc116_AzimuthalPartnerId : 498|10@1+ (1,0) [0|1023] "unitless"  DASy

BO_ 303 RFC_Location_117_119: 64 RadarFrontCenter
 SG_ RFC_Loc117_119_CRC : 0|16@1+ (1,0) [0|65535] ""  DASy
 SG_ RFC_Loc117_119_AliveCtr : 16|8@1+ (1,0) [0|255] ""  DASy
 SG_ RFC_Loc117_119_ProtBlockCtr : 24|4@1+ (1,0) [0|15] ""  DASy
 SG_ RFC_Loc117_RadialDistance : 32|15@1+ (0.01,0) [0|327.67] "m"  DASy
 SG_ RFC_Loc117_RadialVelocity : 47|15@1+ (0.01,-163.84) [-110|55] "m/s"  DASy
 SG_ RFC_Loc117_Elevation : 62|10@1+ (0.1,-51.2) [-45|45] "deg"  DASy
 SG_ RFC_Loc117_Azimuth : 72|11@1+ (0.1,-102.4) [-90|90] "deg"  DASy
 SG_ RFC_Loc117_DistVelocityCoVnce : 83|11@1+ (0.0001,-0.1024) [-0.1024|0.1023] "m^2/s"  DASy
 SG_ RFC_Loc117_RadialDistanceVnce : 94|10@1+ (5E-005,0) [0|0.05115] "m^2"  DASy
 SG_ RFC_Loc117_RadialVelocityVnce : 104|10@1+ (0.0001,0) [0|0.1023] "m^2/s^2"  DASy
 SG_ RFC_Loc117_ElevationVnce : 114|10@1+ (0.001,0) [0|1.023] "deg^2"  DASy
 SG_ RFC_Loc117_AzimuthVnce : 124|10@1+ (0.001,0) [0|1.023] "deg^2"  DASy
 SG_ RFC_Loc117_RadarCrossSection : 134|10@1+ (0.2,-102.4) [-50|70] "dBsm"  DASy
 SG_ RFC_Loc117_DistVelocityQuality : 144|8@1+ (1,0) [0|255] "unitless"  DASy
 SG_ RFC_Loc117_ElevationQuality : 152|8@1+ (1,0) [0|255] "unitless"  DASy
 SG_ RFC_Loc117_AzimuthQuality : 160|8@1+ (1,0) [0|255] "unitless"  DASy
 SG_ RFC_Loc117_RSSI : 168|10@1+ (0.1,0) [0|100] "unitless"  DASy
 SG_ RFC_Loc117_AzimuthalPartnerId : 178|10@1+ (1,0) [0|1023] "unitless"  DASy
 SG_ RFC_Loc118_RadialDistance : 192|15@1+ (0.01,0) [0|327.67] "m"  DASy
 SG_ RFC_Loc118_RadialVelocity : 207|15@1+ (0.01,-163.84) [-110|55] "m/s"  DASy
 SG_ RFC_Loc118_Elevation : 222|10@1+ (0.1,-51.2) [-45|45] "deg"  DASy
 SG_ RFC_Loc118_Azimuth : 232|11@1+ (0.1,-102.4) [-90|90] "deg"  DASy
 SG_ RFC_Loc118_DistVelocityCoVnce : 243|11@1+ (0.0001,-0.1024) [-0.1024|0.1023] "m^2/s"  DASy
 SG_ RFC_Loc118_RadialDistanceVnce : 254|10@1+ (5E-005,0) [0|0.05115] "m^2"  DASy
 SG_ RFC_Loc118_RadialVelocityVnce : 264|10@1+ (0.0001,0) [0|0.1023] "m^2/s^2"  DASy
 SG_ RFC_Loc118_ElevationVnce : 274|10@1+ (0.001,0) [0|1.023] "deg^2"  DASy
 SG_ RFC_Loc118_AzimuthVnce : 284|10@1+ (0.001,0) [0|1.023] "deg^2"  DASy
 SG_ RFC_Loc118_RadarCrossSection : 294|10@1+ (0.2,-102.4) [-50|70] "dBsm"  DASy
 SG_ RFC_Loc118_DistVelocityQuality : 304|8@1+ (1,0) [0|255] "unitless"  DASy
 SG_ RFC_Loc118_ElevationQuality : 312|8@1+ (1,0) [0|255] "unitless"  DASy
 SG_ RFC_Loc118_AzimuthQuality : 320|8@1+ (1,0) [0|255] "unitless"  DASy
 SG_ RFC_Loc118_RSSI : 328|10@1+ (0.1,0) [0|100] "unitless"  DASy
 SG_ RFC_Loc118_AzimuthalPartnerId : 338|10@1+ (1,0) [0|1023] "unitless"  DASy
 SG_ RFC_Loc119_RadialDistance : 352|15@1+ (0.01,0) [0|327.67] "m"  DASy
 SG_ RFC_Loc119_RadialVelocity : 367|15@1+ (0.01,-163.84) [-110|55] "m/s"  DASy
 SG_ RFC_Loc119_Elevation : 382|10@1+ (0.1,-51.2) [-45|45] "deg"  DASy
 SG_ RFC_Loc119_Azimuth : 392|11@1+ (0.1,-102.4) [-90|90] "deg"  DASy
 SG_ RFC_Loc119_DistVelocityCoVnce : 403|11@1+ (0.0001,-0.1024) [-0.1024|0.1023] "m^2/s"  DASy
 SG_ RFC_Loc119_RadialDistanceVnce : 414|10@1+ (5E-005,0) [0|0.05115] "m^2"  DASy
 SG_ RFC_Loc119_RadialVelocityVnce : 424|10@1+ (0.0001,0) [0|0.1023] "m^2/s^2"  DASy
 SG_ RFC_Loc119_ElevationVnce : 434|10@1+ (0.001,0) [0|1.023] "deg^2"  DASy
 SG_ RFC_Loc119_AzimuthVnce : 444|10@1+ (0.001,0) [0|1.023] "deg^2"  DASy
 SG_ RFC_Loc119_RadarCrossSection : 454|10@1+ (0.2,-102.4) [-50|70] "dBsm"  DASy
 SG_ RFC_Loc119_DistVelocityQuality : 464|8@1+ (1,0) [0|255] "unitless"  DASy
 SG_ RFC_Loc119_ElevationQuality : 472|8@1+ (1,0) [0|255] "unitless"  DASy
 SG_ RFC_Loc119_AzimuthQuality : 480|8@1+ (1,0) [0|255] "unitless"  DASy
 SG_ RFC_Loc119_RSSI : 488|10@1+ (0.1,0) [0|100] "unitless"  DASy
 SG_ RFC_Loc119_AzimuthalPartnerId : 498|10@1+ (1,0) [0|1023] "unitless"  DASy

BO_ 304 RFC_Location_120_122: 64 RadarFrontCenter
 SG_ RFC_Loc120_122_CRC : 0|16@1+ (1,0) [0|65535] ""  DASy
 SG_ RFC_Loc120_122_AliveCtr : 16|8@1+ (1,0) [0|255] ""  DASy
 SG_ RFC_Loc120_122_ProtBlockCtr : 24|4@1+ (1,0) [0|15] ""  DASy
 SG_ RFC_Loc120_RadialDistance : 32|15@1+ (0.01,0) [0|327.67] "m"  DASy
 SG_ RFC_Loc120_RadialVelocity : 47|15@1+ (0.01,-163.84) [-110|55] "m/s"  DASy
 SG_ RFC_Loc120_Elevation : 62|10@1+ (0.1,-51.2) [-45|45] "deg"  DASy
 SG_ RFC_Loc120_Azimuth : 72|11@1+ (0.1,-102.4) [-90|90] "deg"  DASy
 SG_ RFC_Loc120_DistVelocityCoVnce : 83|11@1+ (0.0001,-0.1024) [-0.1024|0.1023] "m^2/s"  DASy
 SG_ RFC_Loc120_RadialDistanceVnce : 94|10@1+ (5E-005,0) [0|0.05115] "m^2"  DASy
 SG_ RFC_Loc120_RadialVelocityVnce : 104|10@1+ (0.0001,0) [0|0.1023] "m^2/s^2"  DASy
 SG_ RFC_Loc120_ElevationVnce : 114|10@1+ (0.001,0) [0|1.023] "deg^2"  DASy
 SG_ RFC_Loc120_AzimuthVnce : 124|10@1+ (0.001,0) [0|1.023] "deg^2"  DASy
 SG_ RFC_Loc120_RadarCrossSection : 134|10@1+ (0.2,-102.4) [-50|70] "dBsm"  DASy
 SG_ RFC_Loc120_DistVelocityQuality : 144|8@1+ (1,0) [0|255] "unitless"  DASy
 SG_ RFC_Loc120_ElevationQuality : 152|8@1+ (1,0) [0|255] "unitless"  DASy
 SG_ RFC_Loc120_AzimuthQuality : 160|8@1+ (1,0) [0|255] "unitless"  DASy
 SG_ RFC_Loc120_RSSI : 168|10@1+ (0.1,0) [0|100] "unitless"  DASy
 SG_ RFC_Loc120_AzimuthalPartnerId : 178|10@1+ (1,0) [0|1023] "unitless"  DASy
 SG_ RFC_Loc121_RadialDistance : 192|15@1+ (0.01,0) [0|327.67] "m"  DASy
 SG_ RFC_Loc121_RadialVelocity : 207|15@1+ (0.01,-163.84) [-110|55] "m/s"  DASy
 SG_ RFC_Loc121_Elevation : 222|10@1+ (0.1,-51.2) [-45|45] "deg"  DASy
 SG_ RFC_Loc121_Azimuth : 232|11@1+ (0.1,-102.4) [-90|90] "deg"  DASy
 SG_ RFC_Loc121_DistVelocityCoVnce : 243|11@1+ (0.0001,-0.1024) [-0.1024|0.1023] "m^2/s"  DASy
 SG_ RFC_Loc121_RadialDistanceVnce : 254|10@1+ (5E-005,0) [0|0.05115] "m^2"  DASy
 SG_ RFC_Loc121_RadialVelocityVnce : 264|10@1+ (0.0001,0) [0|0.1023] "m^2/s^2"  DASy
 SG_ RFC_Loc121_ElevationVnce : 274|10@1+ (0.001,0) [0|1.023] "deg^2"  DASy
 SG_ RFC_Loc121_AzimuthVnce : 284|10@1+ (0.001,0) [0|1.023] "deg^2"  DASy
 SG_ RFC_Loc121_RadarCrossSection : 294|10@1+ (0.2,-102.4) [-50|70] "dBsm"  DASy
 SG_ RFC_Loc121_DistVelocityQuality : 304|8@1+ (1,0) [0|255] "unitless"  DASy
 SG_ RFC_Loc121_ElevationQuality : 312|8@1+ (1,0) [0|255] "unitless"  DASy
 SG_ RFC_Loc121_AzimuthQuality : 320|8@1+ (1,0) [0|255] "unitless"  DASy
 SG_ RFC_Loc121_RSSI : 328|10@1+ (0.1,0) [0|100] "unitless"  DASy
 SG_ RFC_Loc121_AzimuthalPartnerId : 338|10@1+ (1,0) [0|1023] "unitless"  DASy
 SG_ RFC_Loc122_RadialDistance : 352|15@1+ (0.01,0) [0|327.67] "m"  DASy
 SG_ RFC_Loc122_RadialVelocity : 367|15@1+ (0.01,-163.84) [-110|55] "m/s"  DASy
 SG_ RFC_Loc122_Elevation : 382|10@1+ (0.1,-51.2) [-45|45] "deg"  DASy
 SG_ RFC_Loc122_Azimuth : 392|11@1+ (0.1,-102.4) [-90|90] "deg"  DASy
 SG_ RFC_Loc122_DistVelocityCoVnce : 403|11@1+ (0.0001,-0.1024) [-0.1024|0.1023] "m^2/s"  DASy
 SG_ RFC_Loc122_RadialDistanceVnce : 414|10@1+ (5E-005,0) [0|0.05115] "m^2"  DASy
 SG_ RFC_Loc122_RadialVelocityVnce : 424|10@1+ (0.0001,0) [0|0.1023] "m^2/s^2"  DASy
 SG_ RFC_Loc122_ElevationVnce : 434|10@1+ (0.001,0) [0|1.023] "deg^2"  DASy
 SG_ RFC_Loc122_AzimuthVnce : 444|10@1+ (0.001,0) [0|1.023] "deg^2"  DASy
 SG_ RFC_Loc122_RadarCrossSection : 454|10@1+ (0.2,-102.4) [-50|70] "dBsm"  DASy
 SG_ RFC_Loc122_DistVelocityQuality : 464|8@1+ (1,0) [0|255] "unitless"  DASy
 SG_ RFC_Loc122_ElevationQuality : 472|8@1+ (1,0) [0|255] "unitless"  DASy
 SG_ RFC_Loc122_AzimuthQuality : 480|8@1+ (1,0) [0|255] "unitless"  DASy
 SG_ RFC_Loc122_RSSI : 488|10@1+ (0.1,0) [0|100] "unitless"  DASy
 SG_ RFC_Loc122_AzimuthalPartnerId : 498|10@1+ (1,0) [0|1023] "unitless"  DASy

BO_ 305 RFC_Location_123_125: 64 RadarFrontCenter
 SG_ RFC_Loc123_125_CRC : 0|16@1+ (1,0) [0|65535] ""  DASy
 SG_ RFC_Loc123_125_AliveCtr : 16|8@1+ (1,0) [0|255] ""  DASy
 SG_ RFC_Loc123_125_ProtBlockCtr : 24|4@1+ (1,0) [0|15] ""  DASy
 SG_ RFC_Loc123_RadialDistance : 32|15@1+ (0.01,0) [0|327.67] "m"  DASy
 SG_ RFC_Loc123_RadialVelocity : 47|15@1+ (0.01,-163.84) [-110|55] "m/s"  DASy
 SG_ RFC_Loc123_Elevation : 62|10@1+ (0.1,-51.2) [-45|45] "deg"  DASy
 SG_ RFC_Loc123_Azimuth : 72|11@1+ (0.1,-102.4) [-90|90] "deg"  DASy
 SG_ RFC_Loc123_DistVelocityCoVnce : 83|11@1+ (0.0001,-0.1024) [-0.1024|0.1023] "m^2/s"  DASy
 SG_ RFC_Loc123_RadialDistanceVnce : 94|10@1+ (5E-005,0) [0|0.05115] "m^2"  DASy
 SG_ RFC_Loc123_RadialVelocityVnce : 104|10@1+ (0.0001,0) [0|0.1023] "m^2/s^2"  DASy
 SG_ RFC_Loc123_ElevationVnce : 114|10@1+ (0.001,0) [0|1.023] "deg^2"  DASy
 SG_ RFC_Loc123_AzimuthVnce : 124|10@1+ (0.001,0) [0|1.023] "deg^2"  DASy
 SG_ RFC_Loc123_RadarCrossSection : 134|10@1+ (0.2,-102.4) [-50|70] "dBsm"  DASy
 SG_ RFC_Loc123_DistVelocityQuality : 144|8@1+ (1,0) [0|255] "unitless"  DASy
 SG_ RFC_Loc123_ElevationQuality : 152|8@1+ (1,0) [0|255] "unitless"  DASy
 SG_ RFC_Loc123_AzimuthQuality : 160|8@1+ (1,0) [0|255] "unitless"  DASy
 SG_ RFC_Loc123_RSSI : 168|10@1+ (0.1,0) [0|100] "unitless"  DASy
 SG_ RFC_Loc123_AzimuthalPartnerId : 178|10@1+ (1,0) [0|1023] "unitless"  DASy
 SG_ RFC_Loc124_RadialDistance : 192|15@1+ (0.01,0) [0|327.67] "m"  DASy
 SG_ RFC_Loc124_RadialVelocity : 207|15@1+ (0.01,-163.84) [-110|55] "m/s"  DASy
 SG_ RFC_Loc124_Elevation : 222|10@1+ (0.1,-51.2) [-45|45] "deg"  DASy
 SG_ RFC_Loc124_Azimuth : 232|11@1+ (0.1,-102.4) [-90|90] "deg"  DASy
 SG_ RFC_Loc124_DistVelocityCoVnce : 243|11@1+ (0.0001,-0.1024) [-0.1024|0.1023] "m^2/s"  DASy
 SG_ RFC_Loc124_RadialDistanceVnce : 254|10@1+ (5E-005,0) [0|0.05115] "m^2"  DASy
 SG_ RFC_Loc124_RadialVelocityVnce : 264|10@1+ (0.0001,0) [0|0.1023] "m^2/s^2"  DASy
 SG_ RFC_Loc124_ElevationVnce : 274|10@1+ (0.001,0) [0|1.023] "deg^2"  DASy
 SG_ RFC_Loc124_AzimuthVnce : 284|10@1+ (0.001,0) [0|1.023] "deg^2"  DASy
 SG_ RFC_Loc124_RadarCrossSection : 294|10@1+ (0.2,-102.4) [-50|70] "dBsm"  DASy
 SG_ RFC_Loc124_DistVelocityQuality : 304|8@1+ (1,0) [0|255] "unitless"  DASy
 SG_ RFC_Loc124_ElevationQuality : 312|8@1+ (1,0) [0|255] "unitless"  DASy
 SG_ RFC_Loc124_AzimuthQuality : 320|8@1+ (1,0) [0|255] "unitless"  DASy
 SG_ RFC_Loc124_RSSI : 328|10@1+ (0.1,0) [0|100] "unitless"  DASy
 SG_ RFC_Loc124_AzimuthalPartnerId : 338|10@1+ (1,0) [0|1023] "unitless"  DASy
 SG_ RFC_Loc125_RadialDistance : 352|15@1+ (0.01,0) [0|327.67] "m"  DASy
 SG_ RFC_Loc125_RadialVelocity : 367|15@1+ (0.01,-163.84) [-110|55] "m/s"  DASy
 SG_ RFC_Loc125_Elevation : 382|10@1+ (0.1,-51.2) [-45|45] "deg"  DASy
 SG_ RFC_Loc125_Azimuth : 392|11@1+ (0.1,-102.4) [-90|90] "deg"  DASy
 SG_ RFC_Loc125_DistVelocityCoVnce : 403|11@1+ (0.0001,-0.1024) [-0.1024|0.1023] "m^2/s"  DASy
 SG_ RFC_Loc125_RadialDistanceVnce : 414|10@1+ (5E-005,0) [0|0.05115] "m^2"  DASy
 SG_ RFC_Loc125_RadialVelocityVnce : 424|10@1+ (0.0001,0) [0|0.1023] "m^2/s^2"  DASy
 SG_ RFC_Loc125_ElevationVnce : 434|10@1+ (0.001,0) [0|1.023] "deg^2"  DASy
 SG_ RFC_Loc125_AzimuthVnce : 444|10@1+ (0.001,0) [0|1.023] "deg^2"  DASy
 SG_ RFC_Loc125_RadarCrossSection : 454|10@1+ (0.2,-102.4) [-50|70] "dBsm"  DASy
 SG_ RFC_Loc125_DistVelocityQuality : 464|8@1+ (1,0) [0|255] "unitless"  DASy
 SG_ RFC_Loc125_ElevationQuality : 472|8@1+ (1,0) [0|255] "unitless"  DASy
 SG_ RFC_Loc125_AzimuthQuality : 480|8@1+ (1,0) [0|255] "unitless"  DASy
 SG_ RFC_Loc125_RSSI : 488|10@1+ (0.1,0) [0|100] "unitless"  DASy
 SG_ RFC_Loc125_AzimuthalPartnerId : 498|10@1+ (1,0) [0|1023] "unitless"  DASy

BO_ 306 RFC_Location_126_128: 64 RadarFrontCenter
 SG_ RFC_Loc126_128_CRC : 0|16@1+ (1,0) [0|65535] ""  DASy
 SG_ RFC_Loc126_128_AliveCtr : 16|8@1+ (1,0) [0|255] ""  DASy
 SG_ RFC_Loc126_128_ProtBlockCtr : 24|4@1+ (1,0) [0|15] ""  DASy
 SG_ RFC_Loc126_RadialDistance : 32|15@1+ (0.01,0) [0|327.67] "m"  DASy
 SG_ RFC_Loc126_RadialVelocity : 47|15@1+ (0.01,-163.84) [-110|55] "m/s"  DASy
 SG_ RFC_Loc126_Elevation : 62|10@1+ (0.1,-51.2) [-45|45] "deg"  DASy
 SG_ RFC_Loc126_Azimuth : 72|11@1+ (0.1,-102.4) [-90|90] "deg"  DASy
 SG_ RFC_Loc126_DistVelocityCoVnce : 83|11@1+ (0.0001,-0.1024) [-0.1024|0.1023] "m^2/s"  DASy
 SG_ RFC_Loc126_RadialDistanceVnce : 94|10@1+ (5E-005,0) [0|0.05115] "m^2"  DASy
 SG_ RFC_Loc126_RadialVelocityVnce : 104|10@1+ (0.0001,0) [0|0.1023] "m^2/s^2"  DASy
 SG_ RFC_Loc126_ElevationVnce : 114|10@1+ (0.001,0) [0|1.023] "deg^2"  DASy
 SG_ RFC_Loc126_AzimuthVnce : 124|10@1+ (0.001,0) [0|1.023] "deg^2"  DASy
 SG_ RFC_Loc126_RadarCrossSection : 134|10@1+ (0.2,-102.4) [-50|70] "dBsm"  DASy
 SG_ RFC_Loc126_DistVelocityQuality : 144|8@1+ (1,0) [0|255] "unitless"  DASy
 SG_ RFC_Loc126_ElevationQuality : 152|8@1+ (1,0) [0|255] "unitless"  DASy
 SG_ RFC_Loc126_AzimuthQuality : 160|8@1+ (1,0) [0|255] "unitless"  DASy
 SG_ RFC_Loc126_RSSI : 168|10@1+ (0.1,0) [0|100] "unitless"  DASy
 SG_ RFC_Loc126_AzimuthalPartnerId : 178|10@1+ (1,0) [0|1023] "unitless"  DASy
 SG_ RFC_Loc127_RadialDistance : 192|15@1+ (0.01,0) [0|327.67] "m"  DASy
 SG_ RFC_Loc127_RadialVelocity : 207|15@1+ (0.01,-163.84) [-110|55] "m/s"  DASy
 SG_ RFC_Loc127_Elevation : 222|10@1+ (0.1,-51.2) [-45|45] "deg"  DASy
 SG_ RFC_Loc127_Azimuth : 232|11@1+ (0.1,-102.4) [-90|90] "deg"  DASy
 SG_ RFC_Loc127_DistVelocityCoVnce : 243|11@1+ (0.0001,-0.1024) [-0.1024|0.1023] "m^2/s"  DASy
 SG_ RFC_Loc127_RadialDistanceVnce : 254|10@1+ (5E-005,0) [0|0.05115] "m^2"  DASy
 SG_ RFC_Loc127_RadialVelocityVnce : 264|10@1+ (0.0001,0) [0|0.1023] "m^2/s^2"  DASy
 SG_ RFC_Loc127_ElevationVnce : 274|10@1+ (0.001,0) [0|1.023] "deg^2"  DASy
 SG_ RFC_Loc127_AzimuthVnce : 284|10@1+ (0.001,0) [0|1.023] "deg^2"  DASy
 SG_ RFC_Loc127_RadarCrossSection : 294|10@1+ (0.2,-102.4) [-50|70] "dBsm"  DASy
 SG_ RFC_Loc127_DistVelocityQuality : 304|8@1+ (1,0) [0|255] "unitless"  DASy
 SG_ RFC_Loc127_ElevationQuality : 312|8@1+ (1,0) [0|255] "unitless"  DASy
 SG_ RFC_Loc127_AzimuthQuality : 320|8@1+ (1,0) [0|255] "unitless"  DASy
 SG_ RFC_Loc127_RSSI : 328|10@1+ (0.1,0) [0|100] "unitless"  DASy
 SG_ RFC_Loc127_AzimuthalPartnerId : 338|10@1+ (1,0) [0|1023] "unitless"  DASy
 SG_ RFC_Loc128_RadialDistance : 352|15@1+ (0.01,0) [0|327.67] "m"  DASy
 SG_ RFC_Loc128_RadialVelocity : 367|15@1+ (0.01,-163.84) [-110|55] "m/s"  DASy
 SG_ RFC_Loc128_Elevation : 382|10@1+ (0.1,-51.2) [-45|45] "deg"  DASy
 SG_ RFC_Loc128_Azimuth : 392|11@1+ (0.1,-102.4) [-90|90] "deg"  DASy
 SG_ RFC_Loc128_DistVelocityCoVnce : 403|11@1+ (0.0001,-0.1024) [-0.1024|0.1023] "m^2/s"  DASy
 SG_ RFC_Loc128_RadialDistanceVnce : 414|10@1+ (5E-005,0) [0|0.05115] "m^2"  DASy
 SG_ RFC_Loc128_RadialVelocityVnce : 424|10@1+ (0.0001,0) [0|0.1023] "m^2/s^2"  DASy
 SG_ RFC_Loc128_ElevationVnce : 434|10@1+ (0.001,0) [0|1.023] "deg^2"  DASy
 SG_ RFC_Loc128_AzimuthVnce : 444|10@1+ (0.001,0) [0|1.023] "deg^2"  DASy
 SG_ RFC_Loc128_RadarCrossSection : 454|10@1+ (0.2,-102.4) [-50|70] "dBsm"  DASy
 SG_ RFC_Loc128_DistVelocityQuality : 464|8@1+ (1,0) [0|255] "unitless"  DASy
 SG_ RFC_Loc128_ElevationQuality : 472|8@1+ (1,0) [0|255] "unitless"  DASy
 SG_ RFC_Loc128_AzimuthQuality : 480|8@1+ (1,0) [0|255] "unitless"  DASy
 SG_ RFC_Loc128_RSSI : 488|10@1+ (0.1,0) [0|100] "unitless"  DASy
 SG_ RFC_Loc128_AzimuthalPartnerId : 498|10@1+ (1,0) [0|1023] "unitless"  DASy

BO_ 307 RFC_Location_129_131: 64 RadarFrontCenter
 SG_ RFC_Loc129_131_CRC : 0|16@1+ (1,0) [0|65535] ""  DASy
 SG_ RFC_Loc129_131_AliveCtr : 16|8@1+ (1,0) [0|255] ""  DASy
 SG_ RFC_Loc129_131_ProtBlockCtr : 24|4@1+ (1,0) [0|15] ""  DASy
 SG_ RFC_Loc129_RadialDistance : 32|15@1+ (0.01,0) [0|327.67] "m"  DASy
 SG_ RFC_Loc129_RadialVelocity : 47|15@1+ (0.01,-163.84) [-110|55] "m/s"  DASy
 SG_ RFC_Loc129_Elevation : 62|10@1+ (0.1,-51.2) [-45|45] "deg"  DASy
 SG_ RFC_Loc129_Azimuth : 72|11@1+ (0.1,-102.4) [-90|90] "deg"  DASy
 SG_ RFC_Loc129_DistVelocityCoVnce : 83|11@1+ (0.0001,-0.1024) [-0.1024|0.1023] "m^2/s"  DASy
 SG_ RFC_Loc129_RadialDistanceVnce : 94|10@1+ (5E-005,0) [0|0.05115] "m^2"  DASy
 SG_ RFC_Loc129_RadialVelocityVnce : 104|10@1+ (0.0001,0) [0|0.1023] "m^2/s^2"  DASy
 SG_ RFC_Loc129_ElevationVnce : 114|10@1+ (0.001,0) [0|1.023] "deg^2"  DASy
 SG_ RFC_Loc129_AzimuthVnce : 124|10@1+ (0.001,0) [0|1.023] "deg^2"  DASy
 SG_ RFC_Loc129_RadarCrossSection : 134|10@1+ (0.2,-102.4) [-50|70] "dBsm"  DASy
 SG_ RFC_Loc129_DistVelocityQuality : 144|8@1+ (1,0) [0|255] "unitless"  DASy
 SG_ RFC_Loc129_ElevationQuality : 152|8@1+ (1,0) [0|255] "unitless"  DASy
 SG_ RFC_Loc129_AzimuthQuality : 160|8@1+ (1,0) [0|255] "unitless"  DASy
 SG_ RFC_Loc129_RSSI : 168|10@1+ (0.1,0) [0|100] "unitless"  DASy
 SG_ RFC_Loc129_AzimuthalPartnerId : 178|10@1+ (1,0) [0|1023] "unitless"  DASy
 SG_ RFC_Loc130_RadialDistance : 192|15@1+ (0.01,0) [0|327.67] "m"  DASy
 SG_ RFC_Loc130_RadialVelocity : 207|15@1+ (0.01,-163.84) [-110|55] "m/s"  DASy
 SG_ RFC_Loc130_Elevation : 222|10@1+ (0.1,-51.2) [-45|45] "deg"  DASy
 SG_ RFC_Loc130_Azimuth : 232|11@1+ (0.1,-102.4) [-90|90] "deg"  DASy
 SG_ RFC_Loc130_DistVelocityCoVnce : 243|11@1+ (0.0001,-0.1024) [-0.1024|0.1023] "m^2/s"  DASy
 SG_ RFC_Loc130_RadialDistanceVnce : 254|10@1+ (5E-005,0) [0|0.05115] "m^2"  DASy
 SG_ RFC_Loc130_RadialVelocityVnce : 264|10@1+ (0.0001,0) [0|0.1023] "m^2/s^2"  DASy
 SG_ RFC_Loc130_ElevationVnce : 274|10@1+ (0.001,0) [0|1.023] "deg^2"  DASy
 SG_ RFC_Loc130_AzimuthVnce : 284|10@1+ (0.001,0) [0|1.023] "deg^2"  DASy
 SG_ RFC_Loc130_RadarCrossSection : 294|10@1+ (0.2,-102.4) [-50|70] "dBsm"  DASy
 SG_ RFC_Loc130_DistVelocityQuality : 304|8@1+ (1,0) [0|255] "unitless"  DASy
 SG_ RFC_Loc130_ElevationQuality : 312|8@1+ (1,0) [0|255] "unitless"  DASy
 SG_ RFC_Loc130_AzimuthQuality : 320|8@1+ (1,0) [0|255] "unitless"  DASy
 SG_ RFC_Loc130_RSSI : 328|10@1+ (0.1,0) [0|100] "unitless"  DASy
 SG_ RFC_Loc130_AzimuthalPartnerId : 338|10@1+ (1,0) [0|1023] "unitless"  DASy
 SG_ RFC_Loc131_RadialDistance : 352|15@1+ (0.01,0) [0|327.67] "m"  DASy
 SG_ RFC_Loc131_RadialVelocity : 367|15@1+ (0.01,-163.84) [-110|55] "m/s"  DASy
 SG_ RFC_Loc131_Elevation : 382|10@1+ (0.1,-51.2) [-45|45] "deg"  DASy
 SG_ RFC_Loc131_Azimuth : 392|11@1+ (0.1,-102.4) [-90|90] "deg"  DASy
 SG_ RFC_Loc131_DistVelocityCoVnce : 403|11@1+ (0.0001,-0.1024) [-0.1024|0.1023] "m^2/s"  DASy
 SG_ RFC_Loc131_RadialDistanceVnce : 414|10@1+ (5E-005,0) [0|0.05115] "m^2"  DASy
 SG_ RFC_Loc131_RadialVelocityVnce : 424|10@1+ (0.0001,0) [0|0.1023] "m^2/s^2"  DASy
 SG_ RFC_Loc131_ElevationVnce : 434|10@1+ (0.001,0) [0|1.023] "deg^2"  DASy
 SG_ RFC_Loc131_AzimuthVnce : 444|10@1+ (0.001,0) [0|1.023] "deg^2"  DASy
 SG_ RFC_Loc131_RadarCrossSection : 454|10@1+ (0.2,-102.4) [-50|70] "dBsm"  DASy
 SG_ RFC_Loc131_DistVelocityQuality : 464|8@1+ (1,0) [0|255] "unitless"  DASy
 SG_ RFC_Loc131_ElevationQuality : 472|8@1+ (1,0) [0|255] "unitless"  DASy
 SG_ RFC_Loc131_AzimuthQuality : 480|8@1+ (1,0) [0|255] "unitless"  DASy
 SG_ RFC_Loc131_RSSI : 488|10@1+ (0.1,0) [0|100] "unitless"  DASy
 SG_ RFC_Loc131_AzimuthalPartnerId : 498|10@1+ (1,0) [0|1023] "unitless"  DASy

BO_ 308 RFC_Location_132_134: 64 RadarFrontCenter
 SG_ RFC_Loc132_134_CRC : 0|16@1+ (1,0) [0|65535] ""  DASy
 SG_ RFC_Loc132_134_AliveCtr : 16|8@1+ (1,0) [0|255] ""  DASy
 SG_ RFC_Loc132_134_ProtBlockCtr : 24|4@1+ (1,0) [0|15] ""  DASy
 SG_ RFC_Loc132_RadialDistance : 32|15@1+ (0.01,0) [0|327.67] "m"  DASy
 SG_ RFC_Loc132_RadialVelocity : 47|15@1+ (0.01,-163.84) [-110|55] "m/s"  DASy
 SG_ RFC_Loc132_Elevation : 62|10@1+ (0.1,-51.2) [-45|45] "deg"  DASy
 SG_ RFC_Loc132_Azimuth : 72|11@1+ (0.1,-102.4) [-90|90] "deg"  DASy
 SG_ RFC_Loc132_DistVelocityCoVnce : 83|11@1+ (0.0001,-0.1024) [-0.1024|0.1023] "m^2/s"  DASy
 SG_ RFC_Loc132_RadialDistanceVnce : 94|10@1+ (5E-005,0) [0|0.05115] "m^2"  DASy
 SG_ RFC_Loc132_RadialVelocityVnce : 104|10@1+ (0.0001,0) [0|0.1023] "m^2/s^2"  DASy
 SG_ RFC_Loc132_ElevationVnce : 114|10@1+ (0.001,0) [0|1.023] "deg^2"  DASy
 SG_ RFC_Loc132_AzimuthVnce : 124|10@1+ (0.001,0) [0|1.023] "deg^2"  DASy
 SG_ RFC_Loc132_RadarCrossSection : 134|10@1+ (0.2,-102.4) [-50|70] "dBsm"  DASy
 SG_ RFC_Loc132_DistVelocityQuality : 144|8@1+ (1,0) [0|255] "unitless"  DASy
 SG_ RFC_Loc132_ElevationQuality : 152|8@1+ (1,0) [0|255] "unitless"  DASy
 SG_ RFC_Loc132_AzimuthQuality : 160|8@1+ (1,0) [0|255] "unitless"  DASy
 SG_ RFC_Loc132_RSSI : 168|10@1+ (0.1,0) [0|100] "unitless"  DASy
 SG_ RFC_Loc132_AzimuthalPartnerId : 178|10@1+ (1,0) [0|1023] "unitless"  DASy
 SG_ RFC_Loc133_RadialDistance : 192|15@1+ (0.01,0) [0|327.67] "m"  DASy
 SG_ RFC_Loc133_RadialVelocity : 207|15@1+ (0.01,-163.84) [-110|55] "m/s"  DASy
 SG_ RFC_Loc133_Elevation : 222|10@1+ (0.1,-51.2) [-45|45] "deg"  DASy
 SG_ RFC_Loc133_Azimuth : 232|11@1+ (0.1,-102.4) [-90|90] "deg"  DASy
 SG_ RFC_Loc133_DistVelocityCoVnce : 243|11@1+ (0.0001,-0.1024) [-0.1024|0.1023] "m^2/s"  DASy
 SG_ RFC_Loc133_RadialDistanceVnce : 254|10@1+ (5E-005,0) [0|0.05115] "m^2"  DASy
 SG_ RFC_Loc133_RadialVelocityVnce : 264|10@1+ (0.0001,0) [0|0.1023] "m^2/s^2"  DASy
 SG_ RFC_Loc133_ElevationVnce : 274|10@1+ (0.001,0) [0|1.023] "deg^2"  DASy
 SG_ RFC_Loc133_AzimuthVnce : 284|10@1+ (0.001,0) [0|1.023] "deg^2"  DASy
 SG_ RFC_Loc133_RadarCrossSection : 294|10@1+ (0.2,-102.4) [-50|70] "dBsm"  DASy
 SG_ RFC_Loc133_DistVelocityQuality : 304|8@1+ (1,0) [0|255] "unitless"  DASy
 SG_ RFC_Loc133_ElevationQuality : 312|8@1+ (1,0) [0|255] "unitless"  DASy
 SG_ RFC_Loc133_AzimuthQuality : 320|8@1+ (1,0) [0|255] "unitless"  DASy
 SG_ RFC_Loc133_RSSI : 328|10@1+ (0.1,0) [0|100] "unitless"  DASy
 SG_ RFC_Loc133_AzimuthalPartnerId : 338|10@1+ (1,0) [0|1023] "unitless"  DASy
 SG_ RFC_Loc134_RadialDistance : 352|15@1+ (0.01,0) [0|327.67] "m"  DASy
 SG_ RFC_Loc134_RadialVelocity : 367|15@1+ (0.01,-163.84) [-110|55] "m/s"  DASy
 SG_ RFC_Loc134_Elevation : 382|10@1+ (0.1,-51.2) [-45|45] "deg"  DASy
 SG_ RFC_Loc134_Azimuth : 392|11@1+ (0.1,-102.4) [-90|90] "deg"  DASy
 SG_ RFC_Loc134_DistVelocityCoVnce : 403|11@1+ (0.0001,-0.1024) [-0.1024|0.1023] "m^2/s"  DASy
 SG_ RFC_Loc134_RadialDistanceVnce : 414|10@1+ (5E-005,0) [0|0.05115] "m^2"  DASy
 SG_ RFC_Loc134_RadialVelocityVnce : 424|10@1+ (0.0001,0) [0|0.1023] "m^2/s^2"  DASy
 SG_ RFC_Loc134_ElevationVnce : 434|10@1+ (0.001,0) [0|1.023] "deg^2"  DASy
 SG_ RFC_Loc134_AzimuthVnce : 444|10@1+ (0.001,0) [0|1.023] "deg^2"  DASy
 SG_ RFC_Loc134_RadarCrossSection : 454|10@1+ (0.2,-102.4) [-50|70] "dBsm"  DASy
 SG_ RFC_Loc134_DistVelocityQuality : 464|8@1+ (1,0) [0|255] "unitless"  DASy
 SG_ RFC_Loc134_ElevationQuality : 472|8@1+ (1,0) [0|255] "unitless"  DASy
 SG_ RFC_Loc134_AzimuthQuality : 480|8@1+ (1,0) [0|255] "unitless"  DASy
 SG_ RFC_Loc134_RSSI : 488|10@1+ (0.1,0) [0|100] "unitless"  DASy
 SG_ RFC_Loc134_AzimuthalPartnerId : 498|10@1+ (1,0) [0|1023] "unitless"  DASy

BO_ 309 RFC_Location_135_137: 64 RadarFrontCenter
 SG_ RFC_Loc135_137_CRC : 0|16@1+ (1,0) [0|65535] ""  DASy
 SG_ RFC_Loc135_137_AliveCtr : 16|8@1+ (1,0) [0|255] ""  DASy
 SG_ RFC_Loc135_137_ProtBlockCtr : 24|4@1+ (1,0) [0|15] ""  DASy
 SG_ RFC_Loc135_RadialDistance : 32|15@1+ (0.01,0) [0|327.67] "m"  DASy
 SG_ RFC_Loc135_RadialVelocity : 47|15@1+ (0.01,-163.84) [-110|55] "m/s"  DASy
 SG_ RFC_Loc135_Elevation : 62|10@1+ (0.1,-51.2) [-45|45] "deg"  DASy
 SG_ RFC_Loc135_Azimuth : 72|11@1+ (0.1,-102.4) [-90|90] "deg"  DASy
 SG_ RFC_Loc135_DistVelocityCoVnce : 83|11@1+ (0.0001,-0.1024) [-0.1024|0.1023] "m^2/s"  DASy
 SG_ RFC_Loc135_RadialDistanceVnce : 94|10@1+ (5E-005,0) [0|0.05115] "m^2"  DASy
 SG_ RFC_Loc135_RadialVelocityVnce : 104|10@1+ (0.0001,0) [0|0.1023] "m^2/s^2"  DASy
 SG_ RFC_Loc135_ElevationVnce : 114|10@1+ (0.001,0) [0|1.023] "deg^2"  DASy
 SG_ RFC_Loc135_AzimuthVnce : 124|10@1+ (0.001,0) [0|1.023] "deg^2"  DASy
 SG_ RFC_Loc135_RadarCrossSection : 134|10@1+ (0.2,-102.4) [-50|70] "dBsm"  DASy
 SG_ RFC_Loc135_DistVelocityQuality : 144|8@1+ (1,0) [0|255] "unitless"  DASy
 SG_ RFC_Loc135_ElevationQuality : 152|8@1+ (1,0) [0|255] "unitless"  DASy
 SG_ RFC_Loc135_AzimuthQuality : 160|8@1+ (1,0) [0|255] "unitless"  DASy
 SG_ RFC_Loc135_RSSI : 168|10@1+ (0.1,0) [0|100] "unitless"  DASy
 SG_ RFC_Loc135_AzimuthalPartnerId : 178|10@1+ (1,0) [0|1023] "unitless"  DASy
 SG_ RFC_Loc136_RadialDistance : 192|15@1+ (0.01,0) [0|327.67] "m"  DASy
 SG_ RFC_Loc136_RadialVelocity : 207|15@1+ (0.01,-163.84) [-110|55] "m/s"  DASy
 SG_ RFC_Loc136_Elevation : 222|10@1+ (0.1,-51.2) [-45|45] "deg"  DASy
 SG_ RFC_Loc136_Azimuth : 232|11@1+ (0.1,-102.4) [-90|90] "deg"  DASy
 SG_ RFC_Loc136_DistVelocityCoVnce : 243|11@1+ (0.0001,-0.1024) [-0.1024|0.1023] "m^2/s"  DASy
 SG_ RFC_Loc136_RadialDistanceVnce : 254|10@1+ (5E-005,0) [0|0.05115] "m^2"  DASy
 SG_ RFC_Loc136_RadialVelocityVnce : 264|10@1+ (0.0001,0) [0|0.1023] "m^2/s^2"  DASy
 SG_ RFC_Loc136_ElevationVnce : 274|10@1+ (0.001,0) [0|1.023] "deg^2"  DASy
 SG_ RFC_Loc136_AzimuthVnce : 284|10@1+ (0.001,0) [0|1.023] "deg^2"  DASy
 SG_ RFC_Loc136_RadarCrossSection : 294|10@1+ (0.2,-102.4) [-50|70] "dBsm"  DASy
 SG_ RFC_Loc136_DistVelocityQuality : 304|8@1+ (1,0) [0|255] "unitless"  DASy
 SG_ RFC_Loc136_ElevationQuality : 312|8@1+ (1,0) [0|255] "unitless"  DASy
 SG_ RFC_Loc136_AzimuthQuality : 320|8@1+ (1,0) [0|255] "unitless"  DASy
 SG_ RFC_Loc136_RSSI : 328|10@1+ (0.1,0) [0|100] "unitless"  DASy
 SG_ RFC_Loc136_AzimuthalPartnerId : 338|10@1+ (1,0) [0|1023] "unitless"  DASy
 SG_ RFC_Loc137_RadialDistance : 352|15@1+ (0.01,0) [0|327.67] "m"  DASy
 SG_ RFC_Loc137_RadialVelocity : 367|15@1+ (0.01,-163.84) [-110|55] "m/s"  DASy
 SG_ RFC_Loc137_Elevation : 382|10@1+ (0.1,-51.2) [-45|45] "deg"  DASy
 SG_ RFC_Loc137_Azimuth : 392|11@1+ (0.1,-102.4) [-90|90] "deg"  DASy
 SG_ RFC_Loc137_DistVelocityCoVnce : 403|11@1+ (0.0001,-0.1024) [-0.1024|0.1023] "m^2/s"  DASy
 SG_ RFC_Loc137_RadialDistanceVnce : 414|10@1+ (5E-005,0) [0|0.05115] "m^2"  DASy
 SG_ RFC_Loc137_RadialVelocityVnce : 424|10@1+ (0.0001,0) [0|0.1023] "m^2/s^2"  DASy
 SG_ RFC_Loc137_ElevationVnce : 434|10@1+ (0.001,0) [0|1.023] "deg^2"  DASy
 SG_ RFC_Loc137_AzimuthVnce : 444|10@1+ (0.001,0) [0|1.023] "deg^2"  DASy
 SG_ RFC_Loc137_RadarCrossSection : 454|10@1+ (0.2,-102.4) [-50|70] "dBsm"  DASy
 SG_ RFC_Loc137_DistVelocityQuality : 464|8@1+ (1,0) [0|255] "unitless"  DASy
 SG_ RFC_Loc137_ElevationQuality : 472|8@1+ (1,0) [0|255] "unitless"  DASy
 SG_ RFC_Loc137_AzimuthQuality : 480|8@1+ (1,0) [0|255] "unitless"  DASy
 SG_ RFC_Loc137_RSSI : 488|10@1+ (0.1,0) [0|100] "unitless"  DASy
 SG_ RFC_Loc137_AzimuthalPartnerId : 498|10@1+ (1,0) [0|1023] "unitless"  DASy

BO_ 310 RFC_Location_138_140: 64 RadarFrontCenter
 SG_ RFC_Loc138_140_CRC : 0|16@1+ (1,0) [0|65535] ""  DASy
 SG_ RFC_Loc138_140_AliveCtr : 16|8@1+ (1,0) [0|255] ""  DASy
 SG_ RFC_Loc138_140_ProtBlockCtr : 24|4@1+ (1,0) [0|15] ""  DASy
 SG_ RFC_Loc138_RadialDistance : 32|15@1+ (0.01,0) [0|327.67] "m"  DASy
 SG_ RFC_Loc138_RadialVelocity : 47|15@1+ (0.01,-163.84) [-110|55] "m/s"  DASy
 SG_ RFC_Loc138_Elevation : 62|10@1+ (0.1,-51.2) [-45|45] "deg"  DASy
 SG_ RFC_Loc138_Azimuth : 72|11@1+ (0.1,-102.4) [-90|90] "deg"  DASy
 SG_ RFC_Loc138_DistVelocityCoVnce : 83|11@1+ (0.0001,-0.1024) [-0.1024|0.1023] "m^2/s"  DASy
 SG_ RFC_Loc138_RadialDistanceVnce : 94|10@1+ (5E-005,0) [0|0.05115] "m^2"  DASy
 SG_ RFC_Loc138_RadialVelocityVnce : 104|10@1+ (0.0001,0) [0|0.1023] "m^2/s^2"  DASy
 SG_ RFC_Loc138_ElevationVnce : 114|10@1+ (0.001,0) [0|1.023] "deg^2"  DASy
 SG_ RFC_Loc138_AzimuthVnce : 124|10@1+ (0.001,0) [0|1.023] "deg^2"  DASy
 SG_ RFC_Loc138_RadarCrossSection : 134|10@1+ (0.2,-102.4) [-50|70] "dBsm"  DASy
 SG_ RFC_Loc138_DistVelocityQuality : 144|8@1+ (1,0) [0|255] "unitless"  DASy
 SG_ RFC_Loc138_ElevationQuality : 152|8@1+ (1,0) [0|255] "unitless"  DASy
 SG_ RFC_Loc138_AzimuthQuality : 160|8@1+ (1,0) [0|255] "unitless"  DASy
 SG_ RFC_Loc138_RSSI : 168|10@1+ (0.1,0) [0|100] "unitless"  DASy
 SG_ RFC_Loc138_AzimuthalPartnerId : 178|10@1+ (1,0) [0|1023] "unitless"  DASy
 SG_ RFC_Loc139_RadialDistance : 192|15@1+ (0.01,0) [0|327.67] "m"  DASy
 SG_ RFC_Loc139_RadialVelocity : 207|15@1+ (0.01,-163.84) [-110|55] "m/s"  DASy
 SG_ RFC_Loc139_Elevation : 222|10@1+ (0.1,-51.2) [-45|45] "deg"  DASy
 SG_ RFC_Loc139_Azimuth : 232|11@1+ (0.1,-102.4) [-90|90] "deg"  DASy
 SG_ RFC_Loc139_DistVelocityCoVnce : 243|11@1+ (0.0001,-0.1024) [-0.1024|0.1023] "m^2/s"  DASy
 SG_ RFC_Loc139_RadialDistanceVnce : 254|10@1+ (5E-005,0) [0|0.05115] "m^2"  DASy
 SG_ RFC_Loc139_RadialVelocityVnce : 264|10@1+ (0.0001,0) [0|0.1023] "m^2/s^2"  DASy
 SG_ RFC_Loc139_ElevationVnce : 274|10@1+ (0.001,0) [0|1.023] "deg^2"  DASy
 SG_ RFC_Loc139_AzimuthVnce : 284|10@1+ (0.001,0) [0|1.023] "deg^2"  DASy
 SG_ RFC_Loc139_RadarCrossSection : 294|10@1+ (0.2,-102.4) [-50|70] "dBsm"  DASy
 SG_ RFC_Loc139_DistVelocityQuality : 304|8@1+ (1,0) [0|255] "unitless"  DASy
 SG_ RFC_Loc139_ElevationQuality : 312|8@1+ (1,0) [0|255] "unitless"  DASy
 SG_ RFC_Loc139_AzimuthQuality : 320|8@1+ (1,0) [0|255] "unitless"  DASy
 SG_ RFC_Loc139_RSSI : 328|10@1+ (0.1,0) [0|100] "unitless"  DASy
 SG_ RFC_Loc139_AzimuthalPartnerId : 338|10@1+ (1,0) [0|1023] "unitless"  DASy
 SG_ RFC_Loc140_RadialDistance : 352|15@1+ (0.01,0) [0|327.67] "m"  DASy
 SG_ RFC_Loc140_RadialVelocity : 367|15@1+ (0.01,-163.84) [-110|55] "m/s"  DASy
 SG_ RFC_Loc140_Elevation : 382|10@1+ (0.1,-51.2) [-45|45] "deg"  DASy
 SG_ RFC_Loc140_Azimuth : 392|11@1+ (0.1,-102.4) [-90|90] "deg"  DASy
 SG_ RFC_Loc140_DistVelocityCoVnce : 403|11@1+ (0.0001,-0.1024) [-0.1024|0.1023] "m^2/s"  DASy
 SG_ RFC_Loc140_RadialDistanceVnce : 414|10@1+ (5E-005,0) [0|0.05115] "m^2"  DASy
 SG_ RFC_Loc140_RadialVelocityVnce : 424|10@1+ (0.0001,0) [0|0.1023] "m^2/s^2"  DASy
 SG_ RFC_Loc140_ElevationVnce : 434|10@1+ (0.001,0) [0|1.023] "deg^2"  DASy
 SG_ RFC_Loc140_AzimuthVnce : 444|10@1+ (0.001,0) [0|1.023] "deg^2"  DASy
 SG_ RFC_Loc140_RadarCrossSection : 454|10@1+ (0.2,-102.4) [-50|70] "dBsm"  DASy
 SG_ RFC_Loc140_DistVelocityQuality : 464|8@1+ (1,0) [0|255] "unitless"  DASy
 SG_ RFC_Loc140_ElevationQuality : 472|8@1+ (1,0) [0|255] "unitless"  DASy
 SG_ RFC_Loc140_AzimuthQuality : 480|8@1+ (1,0) [0|255] "unitless"  DASy
 SG_ RFC_Loc140_RSSI : 488|10@1+ (0.1,0) [0|100] "unitless"  DASy
 SG_ RFC_Loc140_AzimuthalPartnerId : 498|10@1+ (1,0) [0|1023] "unitless"  DASy

CM_ SG_ 296 RFC_Loc096_098_CRC "CRC - Autosar E2E Profile 5";
CM_ SG_ 296 RFC_Loc096_098_AliveCtr "Alive counter - Autosar E2E Profile 5";
CM_ SG_ 296 RFC_Loc096_098_ProtBlockCtr "Protocol-Signal: Block-Counter";
CM_ SG_ 296 RFC_Loc096_RadialDistance "Location radial distance. Represented in conical coordinate system. Same as ISO 23150:2021(E): Position radial distance (A.4.16)";
CM_ SG_ 296 RFC_Loc096_RadialVelocity "Location radial relative velocity ISO 23150:2021(E): Relative velocity {radial distance} (A.4.18)";
CM_ SG_ 296 RFC_Loc096_Elevation "Location elevation angle. Represented in conical coordinate system. Same as ISO 23150:2021(E): Position elevation (A.4.16)";
CM_ SG_ 296 RFC_Loc096_Azimuth "Location azimuth angle. Represented in conical coordinate system. Deviation from ISO 23150:2021(E): Position azimuth (A.4.16). Further details refers to DSP Location Interface definition";
CM_ SG_ 296 RFC_Loc096_DistVelocityCoVnce "Covariance of radial distance and radial velocity";
CM_ SG_ 296 RFC_Loc096_RadialDistanceVnce "Variance of Location radial distance ISO 23150:2021(E): Position radial distance - error (A.4.17)";
CM_ SG_ 296 RFC_Loc096_RadialVelocityVnce "Variance of Location radial relative velocity ISO 23150:2021(E): Relative velocity {radial distance} - error (A.4.19)";
CM_ SG_ 296 RFC_Loc096_ElevationVnce "Variance of Location elevation angle ISO 23150:2021(E): Position elevation - error (A.4.17)";
CM_ SG_ 296 RFC_Loc096_AzimuthVnce "Variance of Location azimuth angle ISO 23150:2021(E): Position azimuth - error (A.4.17)";
CM_ SG_ 296 RFC_Loc096_RadarCrossSection "Radar Cross Section (RCS) estimation ISO 23150:2021(E): Radar cross section (A.4.5)";
CM_ SG_ 296 RFC_Loc096_DistVelocityQuality "Quality of radial distance and velocity resolution processing. Physical range [0..1]";
CM_ SG_ 296 RFC_Loc096_ElevationQuality "Probability for correct signal model (elevation angle). Physical range [0..1]";
CM_ SG_ 296 RFC_Loc096_AzimuthQuality "Probability for correct signal model (azimuth angle). Physical range [0..1]";
CM_ SG_ 296 RFC_Loc096_RSSI "Received Signal Strength Indication (RSSI). This signal is not exactly ISO 23150:2021(E): Signal to noise ratio - detection level (A.4.7), but SNR can be calculated from this signal. Further detail please refer to the DSP Location Interface definition";
CM_ SG_ 296 RFC_Loc096_AzimuthalPartnerId "Id of the azimuthal partner location";
CM_ SG_ 296 RFC_Loc097_RadialDistance "Location radial distance. Represented in conical coordinate system. Same as ISO 23150:2021(E): Position radial distance (A.4.16)";
CM_ SG_ 296 RFC_Loc097_RadialVelocity "Location radial relative velocity ISO 23150:2021(E): Relative velocity {radial distance} (A.4.18)";
CM_ SG_ 296 RFC_Loc097_Elevation "Location elevation angle. Represented in conical coordinate system. Same as ISO 23150:2021(E): Position elevation (A.4.16)";
CM_ SG_ 296 RFC_Loc097_Azimuth "Location azimuth angle. Represented in conical coordinate system. Deviation from ISO 23150:2021(E): Position azimuth (A.4.16). Further details refers to DSP Location Interface definition";
CM_ SG_ 296 RFC_Loc097_DistVelocityCoVnce "Covariance of radial distance and radial velocity";
CM_ SG_ 296 RFC_Loc097_RadialDistanceVnce "Variance of Location radial distance ISO 23150:2021(E): Position radial distance - error (A.4.17)";
CM_ SG_ 296 RFC_Loc097_RadialVelocityVnce "Variance of Location radial relative velocity ISO 23150:2021(E): Relative velocity {radial distance} - error (A.4.19)";
CM_ SG_ 296 RFC_Loc097_ElevationVnce "Variance of Location elevation angle ISO 23150:2021(E): Position elevation - error (A.4.17)";
CM_ SG_ 296 RFC_Loc097_AzimuthVnce "Variance of Location azimuth angle ISO 23150:2021(E): Position azimuth - error (A.4.17)";
CM_ SG_ 296 RFC_Loc097_RadarCrossSection "Radar Cross Section (RCS) estimation ISO 23150:2021(E): Radar cross section (A.4.5)";
CM_ SG_ 296 RFC_Loc097_DistVelocityQuality "Quality of radial distance and velocity resolution processing. Physical range [0..1]";
CM_ SG_ 296 RFC_Loc097_ElevationQuality "Probability for correct signal model (elevation angle). Physical range [0..1]";
CM_ SG_ 296 RFC_Loc097_AzimuthQuality "Probability for correct signal model (azimuth angle). Physical range [0..1]";
CM_ SG_ 296 RFC_Loc097_RSSI "Received Signal Strength Indication (RSSI). This signal is not exactly ISO 23150:2021(E): Signal to noise ratio - detection level (A.4.7), but SNR can be calculated from this signal. Further detail please refer to the DSP Location Interface definition";
CM_ SG_ 296 RFC_Loc097_AzimuthalPartnerId "Id of the azimuthal partner location";
CM_ SG_ 296 RFC_Loc098_RadialDistance "Location radial distance. Represented in conical coordinate system. Same as ISO 23150:2021(E): Position radial distance (A.4.16)";
CM_ SG_ 296 RFC_Loc098_RadialVelocity "Location radial relative velocity ISO 23150:2021(E): Relative velocity {radial distance} (A.4.18)";
CM_ SG_ 296 RFC_Loc098_Elevation "Location elevation angle. Represented in conical coordinate system. Same as ISO 23150:2021(E): Position elevation (A.4.16)";
CM_ SG_ 296 RFC_Loc098_Azimuth "Location azimuth angle. Represented in conical coordinate system. Deviation from ISO 23150:2021(E): Position azimuth (A.4.16). Further details refers to DSP Location Interface definition";
CM_ SG_ 296 RFC_Loc098_DistVelocityCoVnce "Covariance of radial distance and radial velocity";
CM_ SG_ 296 RFC_Loc098_RadialDistanceVnce "Variance of Location radial distance ISO 23150:2021(E): Position radial distance - error (A.4.17)";
CM_ SG_ 296 RFC_Loc098_RadialVelocityVnce "Variance of Location radial relative velocity ISO 23150:2021(E): Relative velocity {radial distance} - error (A.4.19)";
CM_ SG_ 296 RFC_Loc098_ElevationVnce "Variance of Location elevation angle ISO 23150:2021(E): Position elevation - error (A.4.17)";
CM_ SG_ 296 RFC_Loc098_AzimuthVnce "Variance of Location azimuth angle ISO 23150:2021(E): Position azimuth - error (A.4.17)";
CM_ SG_ 296 RFC_Loc098_RadarCrossSection "Radar Cross Section (RCS) estimation ISO 23150:2021(E): Radar cross section (A.4.5)";
CM_ SG_ 296 RFC_Loc098_DistVelocityQuality "Quality of radial distance and velocity resolution processing. Physical range [0..1]";
CM_ SG_ 296 RFC_Loc098_ElevationQuality "Probability for correct signal model (elevation angle). Physical range [0..1]";
CM_ SG_ 296 RFC_Loc098_AzimuthQuality "Probability for correct signal model (azimuth angle). Physical range [0..1]";
CM_ SG_ 296 RFC_Loc098_RSSI "Received Signal Strength Indication (RSSI). This signal is not exactly ISO 23150:2021(E): Signal to noise ratio - detection level (A.4.7), but SNR can be calculated from this signal. Further detail please refer to the DSP Location Interface definition";
CM_ SG_ 296 RFC_Loc098_AzimuthalPartnerId "Id of the azimuthal partner location";
CM_ SG_ 297 RFC_Loc099_101_CRC "CRC - Autosar E2E Profile 5";
CM_ SG_ 297 RFC_Loc099_101_AliveCtr "Alive counter - Autosar E2E Profile 5";
CM_ SG_ 297 RFC_Loc099_101_ProtBlockCtr "Protocol-Signal: Block-Counter";
CM_ SG_ 297 RFC_Loc099_RadialDistance "Location radial distance. Represented in conical coordinate system. Same as ISO 23150:2021(E): Position radial distance (A.4.16)";
CM_ SG_ 297 RFC_Loc099_RadialVelocity "Location radial relative velocity ISO 23150:2021(E): Relative velocity {radial distance} (A.4.18)";
CM_ SG_ 297 RFC_Loc099_Elevation "Location elevation angle. Represented in conical coordinate system. Same as ISO 23150:2021(E): Position elevation (A.4.16)";
CM_ SG_ 297 RFC_Loc099_Azimuth "Location azimuth angle. Represented in conical coordinate system. Deviation from ISO 23150:2021(E): Position azimuth (A.4.16). Further details refers to DSP Location Interface definition";
CM_ SG_ 297 RFC_Loc099_DistVelocityCoVnce "Covariance of radial distance and radial velocity";
CM_ SG_ 297 RFC_Loc099_RadialDistanceVnce "Variance of Location radial distance ISO 23150:2021(E): Position radial distance - error (A.4.17)";
CM_ SG_ 297 RFC_Loc099_RadialVelocityVnce "Variance of Location radial relative velocity ISO 23150:2021(E): Relative velocity {radial distance} - error (A.4.19)";
CM_ SG_ 297 RFC_Loc099_ElevationVnce "Variance of Location elevation angle ISO 23150:2021(E): Position elevation - error (A.4.17)";
CM_ SG_ 297 RFC_Loc099_AzimuthVnce "Variance of Location azimuth angle ISO 23150:2021(E): Position azimuth - error (A.4.17)";
CM_ SG_ 297 RFC_Loc099_RadarCrossSection "Radar Cross Section (RCS) estimation ISO 23150:2021(E): Radar cross section (A.4.5)";
CM_ SG_ 297 RFC_Loc099_DistVelocityQuality "Quality of radial distance and velocity resolution processing. Physical range [0..1]";
CM_ SG_ 297 RFC_Loc099_ElevationQuality "Probability for correct signal model (elevation angle). Physical range [0..1]";
CM_ SG_ 297 RFC_Loc099_AzimuthQuality "Probability for correct signal model (azimuth angle). Physical range [0..1]";
CM_ SG_ 297 RFC_Loc099_RSSI "Received Signal Strength Indication (RSSI). This signal is not exactly ISO 23150:2021(E): Signal to noise ratio - detection level (A.4.7), but SNR can be calculated from this signal. Further detail please refer to the DSP Location Interface definition";
CM_ SG_ 297 RFC_Loc099_AzimuthalPartnerId "Id of the azimuthal partner location";
CM_ SG_ 297 RFC_Loc100_RadialDistance "Location radial distance. Represented in conical coordinate system. Same as ISO 23150:2021(E): Position radial distance (A.4.16)";
CM_ SG_ 297 RFC_Loc100_RadialVelocity "Location radial relative velocity ISO 23150:2021(E): Relative velocity {radial distance} (A.4.18)";
CM_ SG_ 297 RFC_Loc100_Elevation "Location elevation angle. Represented in conical coordinate system. Same as ISO 23150:2021(E): Position elevation (A.4.16)";
CM_ SG_ 297 RFC_Loc100_Azimuth "Location azimuth angle. Represented in conical coordinate system. Deviation from ISO 23150:2021(E): Position azimuth (A.4.16). Further details refers to DSP Location Interface definition";
CM_ SG_ 297 RFC_Loc100_DistVelocityCoVnce "Covariance of radial distance and radial velocity";
CM_ SG_ 297 RFC_Loc100_RadialDistanceVnce "Variance of Location radial distance ISO 23150:2021(E): Position radial distance - error (A.4.17)";
CM_ SG_ 297 RFC_Loc100_RadialVelocityVnce "Variance of Location radial relative velocity ISO 23150:2021(E): Relative velocity {radial distance} - error (A.4.19)";
CM_ SG_ 297 RFC_Loc100_ElevationVnce "Variance of Location elevation angle ISO 23150:2021(E): Position elevation - error (A.4.17)";
CM_ SG_ 297 RFC_Loc100_AzimuthVnce "Variance of Location azimuth angle ISO 23150:2021(E): Position azimuth - error (A.4.17)";
CM_ SG_ 297 RFC_Loc100_RadarCrossSection "Radar Cross Section (RCS) estimation ISO 23150:2021(E): Radar cross section (A.4.5)";
CM_ SG_ 297 RFC_Loc100_DistVelocityQuality "Quality of radial distance and velocity resolution processing. Physical range [0..1]";
CM_ SG_ 297 RFC_Loc100_ElevationQuality "Probability for correct signal model (elevation angle). Physical range [0..1]";
CM_ SG_ 297 RFC_Loc100_AzimuthQuality "Probability for correct signal model (azimuth angle). Physical range [0..1]";
CM_ SG_ 297 RFC_Loc100_RSSI "Received Signal Strength Indication (RSSI). This signal is not exactly ISO 23150:2021(E): Signal to noise ratio - detection level (A.4.7), but SNR can be calculated from this signal. Further detail please refer to the DSP Location Interface definition";
CM_ SG_ 297 RFC_Loc100_AzimuthalPartnerId "Id of the azimuthal partner location";
CM_ SG_ 297 RFC_Loc101_RadialDistance "Location radial distance. Represented in conical coordinate system. Same as ISO 23150:2021(E): Position radial distance (A.4.16)";
CM_ SG_ 297 RFC_Loc101_RadialVelocity "Location radial relative velocity ISO 23150:2021(E): Relative velocity {radial distance} (A.4.18)";
CM_ SG_ 297 RFC_Loc101_Elevation "Location elevation angle. Represented in conical coordinate system. Same as ISO 23150:2021(E): Position elevation (A.4.16)";
CM_ SG_ 297 RFC_Loc101_Azimuth "Location azimuth angle. Represented in conical coordinate system. Deviation from ISO 23150:2021(E): Position azimuth (A.4.16). Further details refers to DSP Location Interface definition";
CM_ SG_ 297 RFC_Loc101_DistVelocityCoVnce "Covariance of radial distance and radial velocity";
CM_ SG_ 297 RFC_Loc101_RadialDistanceVnce "Variance of Location radial distance ISO 23150:2021(E): Position radial distance - error (A.4.17)";
CM_ SG_ 297 RFC_Loc101_RadialVelocityVnce "Variance of Location radial relative velocity ISO 23150:2021(E): Relative velocity {radial distance} - error (A.4.19)";
CM_ SG_ 297 RFC_Loc101_ElevationVnce "Variance of Location elevation angle ISO 23150:2021(E): Position elevation - error (A.4.17)";
CM_ SG_ 297 RFC_Loc101_AzimuthVnce "Variance of Location azimuth angle ISO 23150:2021(E): Position azimuth - error (A.4.17)";
CM_ SG_ 297 RFC_Loc101_RadarCrossSection "Radar Cross Section (RCS) estimation ISO 23150:2021(E): Radar cross section (A.4.5)";
CM_ SG_ 297 RFC_Loc101_DistVelocityQuality "Quality of radial distance and velocity resolution processing. Physical range [0..1]";
CM_ SG_ 297 RFC_Loc101_ElevationQuality "Probability for correct signal model (elevation angle). Physical range [0..1]";
CM_ SG_ 297 RFC_Loc101_AzimuthQuality "Probability for correct signal model (azimuth angle). Physical range [0..1]";
CM_ SG_ 297 RFC_Loc101_RSSI "Received Signal Strength Indication (RSSI). This signal is not exactly ISO 23150:2021(E): Signal to noise ratio - detection level (A.4.7), but SNR can be calculated from this signal. Further detail please refer to the DSP Location Interface definition";
CM_ SG_ 297 RFC_Loc101_AzimuthalPartnerId "Id of the azimuthal partner location";
CM_ SG_ 298 RFC_Loc102_104_CRC "CRC - Autosar E2E Profile 5";
CM_ SG_ 298 RFC_Loc102_104_AliveCtr "Alive counter - Autosar E2E Profile 5";
CM_ SG_ 298 RFC_Loc102_104_ProtBlockCtr "Protocol-Signal: Block-Counter";
CM_ SG_ 298 RFC_Loc102_RadialDistance "Location radial distance. Represented in conical coordinate system. Same as ISO 23150:2021(E): Position radial distance (A.4.16)";
CM_ SG_ 298 RFC_Loc102_RadialVelocity "Location radial relative velocity ISO 23150:2021(E): Relative velocity {radial distance} (A.4.18)";
CM_ SG_ 298 RFC_Loc102_Elevation "Location elevation angle. Represented in conical coordinate system. Same as ISO 23150:2021(E): Position elevation (A.4.16)";
CM_ SG_ 298 RFC_Loc102_Azimuth "Location azimuth angle. Represented in conical coordinate system. Deviation from ISO 23150:2021(E): Position azimuth (A.4.16). Further details refers to DSP Location Interface definition";
CM_ SG_ 298 RFC_Loc102_DistVelocityCoVnce "Covariance of radial distance and radial velocity";
CM_ SG_ 298 RFC_Loc102_RadialDistanceVnce "Variance of Location radial distance ISO 23150:2021(E): Position radial distance - error (A.4.17)";
CM_ SG_ 298 RFC_Loc102_RadialVelocityVnce "Variance of Location radial relative velocity ISO 23150:2021(E): Relative velocity {radial distance} - error (A.4.19)";
CM_ SG_ 298 RFC_Loc102_ElevationVnce "Variance of Location elevation angle ISO 23150:2021(E): Position elevation - error (A.4.17)";
CM_ SG_ 298 RFC_Loc102_AzimuthVnce "Variance of Location azimuth angle ISO 23150:2021(E): Position azimuth - error (A.4.17)";
CM_ SG_ 298 RFC_Loc102_RadarCrossSection "Radar Cross Section (RCS) estimation ISO 23150:2021(E): Radar cross section (A.4.5)";
CM_ SG_ 298 RFC_Loc102_DistVelocityQuality "Quality of radial distance and velocity resolution processing. Physical range [0..1]";
CM_ SG_ 298 RFC_Loc102_ElevationQuality "Probability for correct signal model (elevation angle). Physical range [0..1]";
CM_ SG_ 298 RFC_Loc102_AzimuthQuality "Probability for correct signal model (azimuth angle). Physical range [0..1]";
CM_ SG_ 298 RFC_Loc102_RSSI "Received Signal Strength Indication (RSSI). This signal is not exactly ISO 23150:2021(E): Signal to noise ratio - detection level (A.4.7), but SNR can be calculated from this signal. Further detail please refer to the DSP Location Interface definition";
CM_ SG_ 298 RFC_Loc102_AzimuthalPartnerId "Id of the azimuthal partner location";
CM_ SG_ 298 RFC_Loc103_RadialDistance "Location radial distance. Represented in conical coordinate system. Same as ISO 23150:2021(E): Position radial distance (A.4.16)";
CM_ SG_ 298 RFC_Loc103_RadialVelocity "Location radial relative velocity ISO 23150:2021(E): Relative velocity {radial distance} (A.4.18)";
CM_ SG_ 298 RFC_Loc103_Elevation "Location elevation angle. Represented in conical coordinate system. Same as ISO 23150:2021(E): Position elevation (A.4.16)";
CM_ SG_ 298 RFC_Loc103_Azimuth "Location azimuth angle. Represented in conical coordinate system. Deviation from ISO 23150:2021(E): Position azimuth (A.4.16). Further details refers to DSP Location Interface definition";
CM_ SG_ 298 RFC_Loc103_DistVelocityCoVnce "Covariance of radial distance and radial velocity";
CM_ SG_ 298 RFC_Loc103_RadialDistanceVnce "Variance of Location radial distance ISO 23150:2021(E): Position radial distance - error (A.4.17)";
CM_ SG_ 298 RFC_Loc103_RadialVelocityVnce "Variance of Location radial relative velocity ISO 23150:2021(E): Relative velocity {radial distance} - error (A.4.19)";
CM_ SG_ 298 RFC_Loc103_ElevationVnce "Variance of Location elevation angle ISO 23150:2021(E): Position elevation - error (A.4.17)";
CM_ SG_ 298 RFC_Loc103_AzimuthVnce "Variance of Location azimuth angle ISO 23150:2021(E): Position azimuth - error (A.4.17)";
CM_ SG_ 298 RFC_Loc103_RadarCrossSection "Radar Cross Section (RCS) estimation ISO 23150:2021(E): Radar cross section (A.4.5)";
CM_ SG_ 298 RFC_Loc103_DistVelocityQuality "Quality of radial distance and velocity resolution processing. Physical range [0..1]";
CM_ SG_ 298 RFC_Loc103_ElevationQuality "Probability for correct signal model (elevation angle). Physical range [0..1]";
CM_ SG_ 298 RFC_Loc103_AzimuthQuality "Probability for correct signal model (azimuth angle). Physical range [0..1]";
CM_ SG_ 298 RFC_Loc103_RSSI "Received Signal Strength Indication (RSSI). This signal is not exactly ISO 23150:2021(E): Signal to noise ratio - detection level (A.4.7), but SNR can be calculated from this signal. Further detail please refer to the DSP Location Interface definition";
CM_ SG_ 298 RFC_Loc103_AzimuthalPartnerId "Id of the azimuthal partner location";
CM_ SG_ 298 RFC_Loc104_RadialDistance "Location radial distance. Represented in conical coordinate system. Same as ISO 23150:2021(E): Position radial distance (A.4.16)";
CM_ SG_ 298 RFC_Loc104_RadialVelocity "Location radial relative velocity ISO 23150:2021(E): Relative velocity {radial distance} (A.4.18)";
CM_ SG_ 298 RFC_Loc104_Elevation "Location elevation angle. Represented in conical coordinate system. Same as ISO 23150:2021(E): Position elevation (A.4.16)";
CM_ SG_ 298 RFC_Loc104_Azimuth "Location azimuth angle. Represented in conical coordinate system. Deviation from ISO 23150:2021(E): Position azimuth (A.4.16). Further details refers to DSP Location Interface definition";
CM_ SG_ 298 RFC_Loc104_DistVelocityCoVnce "Covariance of radial distance and radial velocity";
CM_ SG_ 298 RFC_Loc104_RadialDistanceVnce "Variance of Location radial distance ISO 23150:2021(E): Position radial distance - error (A.4.17)";
CM_ SG_ 298 RFC_Loc104_RadialVelocityVnce "Variance of Location radial relative velocity ISO 23150:2021(E): Relative velocity {radial distance} - error (A.4.19)";
CM_ SG_ 298 RFC_Loc104_ElevationVnce "Variance of Location elevation angle ISO 23150:2021(E): Position elevation - error (A.4.17)";
CM_ SG_ 298 RFC_Loc104_AzimuthVnce "Variance of Location azimuth angle ISO 23150:2021(E): Position azimuth - error (A.4.17)";
CM_ SG_ 298 RFC_Loc104_RadarCrossSection "Radar Cross Section (RCS) estimation ISO 23150:2021(E): Radar cross section (A.4.5)";
CM_ SG_ 298 RFC_Loc104_DistVelocityQuality "Quality of radial distance and velocity resolution processing. Physical range [0..1]";
CM_ SG_ 298 RFC_Loc104_ElevationQuality "Probability for correct signal model (elevation angle). Physical range [0..1]";
CM_ SG_ 298 RFC_Loc104_AzimuthQuality "Probability for correct signal model (azimuth angle). Physical range [0..1]";
CM_ SG_ 298 RFC_Loc104_RSSI "Received Signal Strength Indication (RSSI). This signal is not exactly ISO 23150:2021(E): Signal to noise ratio - detection level (A.4.7), but SNR can be calculated from this signal. Further detail please refer to the DSP Location Interface definition";
CM_ SG_ 298 RFC_Loc104_AzimuthalPartnerId "Id of the azimuthal partner location";
CM_ SG_ 299 RFC_Loc105_107_CRC "CRC - Autosar E2E Profile 5";
CM_ SG_ 299 RFC_Loc105_107_AliveCtr "Alive counter - Autosar E2E Profile 5";
CM_ SG_ 299 RFC_Loc105_107_ProtBlockCtr "Protocol-Signal: Block-Counter";
CM_ SG_ 299 RFC_Loc105_RadialDistance "Location radial distance. Represented in conical coordinate system. Same as ISO 23150:2021(E): Position radial distance (A.4.16)";
CM_ SG_ 299 RFC_Loc105_RadialVelocity "Location radial relative velocity ISO 23150:2021(E): Relative velocity {radial distance} (A.4.18)";
CM_ SG_ 299 RFC_Loc105_Elevation "Location elevation angle. Represented in conical coordinate system. Same as ISO 23150:2021(E): Position elevation (A.4.16)";
CM_ SG_ 299 RFC_Loc105_Azimuth "Location azimuth angle. Represented in conical coordinate system. Deviation from ISO 23150:2021(E): Position azimuth (A.4.16). Further details refers to DSP Location Interface definition";
CM_ SG_ 299 RFC_Loc105_DistVelocityCoVnce "Covariance of radial distance and radial velocity";
CM_ SG_ 299 RFC_Loc105_RadialDistanceVnce "Variance of Location radial distance ISO 23150:2021(E): Position radial distance - error (A.4.17)";
CM_ SG_ 299 RFC_Loc105_RadialVelocityVnce "Variance of Location radial relative velocity ISO 23150:2021(E): Relative velocity {radial distance} - error (A.4.19)";
CM_ SG_ 299 RFC_Loc105_ElevationVnce "Variance of Location elevation angle ISO 23150:2021(E): Position elevation - error (A.4.17)";
CM_ SG_ 299 RFC_Loc105_AzimuthVnce "Variance of Location azimuth angle ISO 23150:2021(E): Position azimuth - error (A.4.17)";
CM_ SG_ 299 RFC_Loc105_RadarCrossSection "Radar Cross Section (RCS) estimation ISO 23150:2021(E): Radar cross section (A.4.5)";
CM_ SG_ 299 RFC_Loc105_DistVelocityQuality "Quality of radial distance and velocity resolution processing. Physical range [0..1]";
CM_ SG_ 299 RFC_Loc105_ElevationQuality "Probability for correct signal model (elevation angle). Physical range [0..1]";
CM_ SG_ 299 RFC_Loc105_AzimuthQuality "Probability for correct signal model (azimuth angle). Physical range [0..1]";
CM_ SG_ 299 RFC_Loc105_RSSI "Received Signal Strength Indication (RSSI). This signal is not exactly ISO 23150:2021(E): Signal to noise ratio - detection level (A.4.7), but SNR can be calculated from this signal. Further detail please refer to the DSP Location Interface definition";
CM_ SG_ 299 RFC_Loc105_AzimuthalPartnerId "Id of the azimuthal partner location";
CM_ SG_ 299 RFC_Loc106_RadialDistance "Location radial distance. Represented in conical coordinate system. Same as ISO 23150:2021(E): Position radial distance (A.4.16)";
CM_ SG_ 299 RFC_Loc106_RadialVelocity "Location radial relative velocity ISO 23150:2021(E): Relative velocity {radial distance} (A.4.18)";
CM_ SG_ 299 RFC_Loc106_Elevation "Location elevation angle. Represented in conical coordinate system. Same as ISO 23150:2021(E): Position elevation (A.4.16)";
CM_ SG_ 299 RFC_Loc106_Azimuth "Location azimuth angle. Represented in conical coordinate system. Deviation from ISO 23150:2021(E): Position azimuth (A.4.16). Further details refers to DSP Location Interface definition";
CM_ SG_ 299 RFC_Loc106_DistVelocityCoVnce "Covariance of radial distance and radial velocity";
CM_ SG_ 299 RFC_Loc106_RadialDistanceVnce "Variance of Location radial distance ISO 23150:2021(E): Position radial distance - error (A.4.17)";
CM_ SG_ 299 RFC_Loc106_RadialVelocityVnce "Variance of Location radial relative velocity ISO 23150:2021(E): Relative velocity {radial distance} - error (A.4.19)";
CM_ SG_ 299 RFC_Loc106_ElevationVnce "Variance of Location elevation angle ISO 23150:2021(E): Position elevation - error (A.4.17)";
CM_ SG_ 299 RFC_Loc106_AzimuthVnce "Variance of Location azimuth angle ISO 23150:2021(E): Position azimuth - error (A.4.17)";
CM_ SG_ 299 RFC_Loc106_RadarCrossSection "Radar Cross Section (RCS) estimation ISO 23150:2021(E): Radar cross section (A.4.5)";
CM_ SG_ 299 RFC_Loc106_DistVelocityQuality "Quality of radial distance and velocity resolution processing. Physical range [0..1]";
CM_ SG_ 299 RFC_Loc106_ElevationQuality "Probability for correct signal model (elevation angle). Physical range [0..1]";
CM_ SG_ 299 RFC_Loc106_AzimuthQuality "Probability for correct signal model (azimuth angle). Physical range [0..1]";
CM_ SG_ 299 RFC_Loc106_RSSI "Received Signal Strength Indication (RSSI). This signal is not exactly ISO 23150:2021(E): Signal to noise ratio - detection level (A.4.7), but SNR can be calculated from this signal. Further detail please refer to the DSP Location Interface definition";
CM_ SG_ 299 RFC_Loc106_AzimuthalPartnerId "Id of the azimuthal partner location";
CM_ SG_ 299 RFC_Loc107_RadialDistance "Location radial distance. Represented in conical coordinate system. Same as ISO 23150:2021(E): Position radial distance (A.4.16)";
CM_ SG_ 299 RFC_Loc107_RadialVelocity "Location radial relative velocity ISO 23150:2021(E): Relative velocity {radial distance} (A.4.18)";
CM_ SG_ 299 RFC_Loc107_Elevation "Location elevation angle. Represented in conical coordinate system. Same as ISO 23150:2021(E): Position elevation (A.4.16)";
CM_ SG_ 299 RFC_Loc107_Azimuth "Location azimuth angle. Represented in conical coordinate system. Deviation from ISO 23150:2021(E): Position azimuth (A.4.16). Further details refers to DSP Location Interface definition";
CM_ SG_ 299 RFC_Loc107_DistVelocityCoVnce "Covariance of radial distance and radial velocity";
CM_ SG_ 299 RFC_Loc107_RadialDistanceVnce "Variance of Location radial distance ISO 23150:2021(E): Position radial distance - error (A.4.17)";
CM_ SG_ 299 RFC_Loc107_RadialVelocityVnce "Variance of Location radial relative velocity ISO 23150:2021(E): Relative velocity {radial distance} - error (A.4.19)";
CM_ SG_ 299 RFC_Loc107_ElevationVnce "Variance of Location elevation angle ISO 23150:2021(E): Position elevation - error (A.4.17)";
CM_ SG_ 299 RFC_Loc107_AzimuthVnce "Variance of Location azimuth angle ISO 23150:2021(E): Position azimuth - error (A.4.17)";
CM_ SG_ 299 RFC_Loc107_RadarCrossSection "Radar Cross Section (RCS) estimation ISO 23150:2021(E): Radar cross section (A.4.5)";
CM_ SG_ 299 RFC_Loc107_DistVelocityQuality "Quality of radial distance and velocity resolution processing. Physical range [0..1]";
CM_ SG_ 299 RFC_Loc107_ElevationQuality "Probability for correct signal model (elevation angle). Physical range [0..1]";
CM_ SG_ 299 RFC_Loc107_AzimuthQuality "Probability for correct signal model (azimuth angle). Physical range [0..1]";
CM_ SG_ 299 RFC_Loc107_RSSI "Received Signal Strength Indication (RSSI). This signal is not exactly ISO 23150:2021(E): Signal to noise ratio - detection level (A.4.7), but SNR can be calculated from this signal. Further detail please refer to the DSP Location Interface definition";
CM_ SG_ 299 RFC_Loc107_AzimuthalPartnerId "Id of the azimuthal partner location";
CM_ SG_ 300 RFC_Loc108_110_CRC "CRC - Autosar E2E Profile 5";
CM_ SG_ 300 RFC_Loc108_110_AliveCtr "Alive counter - Autosar E2E Profile 5";
CM_ SG_ 300 RFC_Loc108_110_ProtBlockCtr "Protocol-Signal: Block-Counter";
CM_ SG_ 300 RFC_Loc108_RadialDistance "Location radial distance. Represented in conical coordinate system. Same as ISO 23150:2021(E): Position radial distance (A.4.16)";
CM_ SG_ 300 RFC_Loc108_RadialVelocity "Location radial relative velocity ISO 23150:2021(E): Relative velocity {radial distance} (A.4.18)";
CM_ SG_ 300 RFC_Loc108_Elevation "Location elevation angle. Represented in conical coordinate system. Same as ISO 23150:2021(E): Position elevation (A.4.16)";
CM_ SG_ 300 RFC_Loc108_Azimuth "Location azimuth angle. Represented in conical coordinate system. Deviation from ISO 23150:2021(E): Position azimuth (A.4.16). Further details refers to DSP Location Interface definition";
CM_ SG_ 300 RFC_Loc108_DistVelocityCoVnce "Covariance of radial distance and radial velocity";
CM_ SG_ 300 RFC_Loc108_RadialDistanceVnce "Variance of Location radial distance ISO 23150:2021(E): Position radial distance - error (A.4.17)";
CM_ SG_ 300 RFC_Loc108_RadialVelocityVnce "Variance of Location radial relative velocity ISO 23150:2021(E): Relative velocity {radial distance} - error (A.4.19)";
CM_ SG_ 300 RFC_Loc108_ElevationVnce "Variance of Location elevation angle ISO 23150:2021(E): Position elevation - error (A.4.17)";
CM_ SG_ 300 RFC_Loc108_AzimuthVnce "Variance of Location azimuth angle ISO 23150:2021(E): Position azimuth - error (A.4.17)";
CM_ SG_ 300 RFC_Loc108_RadarCrossSection "Radar Cross Section (RCS) estimation ISO 23150:2021(E): Radar cross section (A.4.5)";
CM_ SG_ 300 RFC_Loc108_DistVelocityQuality "Quality of radial distance and velocity resolution processing. Physical range [0..1]";
CM_ SG_ 300 RFC_Loc108_ElevationQuality "Probability for correct signal model (elevation angle). Physical range [0..1]";
CM_ SG_ 300 RFC_Loc108_AzimuthQuality "Probability for correct signal model (azimuth angle). Physical range [0..1]";
CM_ SG_ 300 RFC_Loc108_RSSI "Received Signal Strength Indication (RSSI). This signal is not exactly ISO 23150:2021(E): Signal to noise ratio - detection level (A.4.7), but SNR can be calculated from this signal. Further detail please refer to the DSP Location Interface definition";
CM_ SG_ 300 RFC_Loc108_AzimuthalPartnerId "Id of the azimuthal partner location";
CM_ SG_ 300 RFC_Loc109_RadialDistance "Location radial distance. Represented in conical coordinate system. Same as ISO 23150:2021(E): Position radial distance (A.4.16)";
CM_ SG_ 300 RFC_Loc109_RadialVelocity "Location radial relative velocity ISO 23150:2021(E): Relative velocity {radial distance} (A.4.18)";
CM_ SG_ 300 RFC_Loc109_Elevation "Location elevation angle. Represented in conical coordinate system. Same as ISO 23150:2021(E): Position elevation (A.4.16)";
CM_ SG_ 300 RFC_Loc109_Azimuth "Location azimuth angle. Represented in conical coordinate system. Deviation from ISO 23150:2021(E): Position azimuth (A.4.16). Further details refers to DSP Location Interface definition";
CM_ SG_ 300 RFC_Loc109_DistVelocityCoVnce "Covariance of radial distance and radial velocity";
CM_ SG_ 300 RFC_Loc109_RadialDistanceVnce "Variance of Location radial distance ISO 23150:2021(E): Position radial distance - error (A.4.17)";
CM_ SG_ 300 RFC_Loc109_RadialVelocityVnce "Variance of Location radial relative velocity ISO 23150:2021(E): Relative velocity {radial distance} - error (A.4.19)";
CM_ SG_ 300 RFC_Loc109_ElevationVnce "Variance of Location elevation angle ISO 23150:2021(E): Position elevation - error (A.4.17)";
CM_ SG_ 300 RFC_Loc109_AzimuthVnce "Variance of Location azimuth angle ISO 23150:2021(E): Position azimuth - error (A.4.17)";
CM_ SG_ 300 RFC_Loc109_RadarCrossSection "Radar Cross Section (RCS) estimation ISO 23150:2021(E): Radar cross section (A.4.5)";
CM_ SG_ 300 RFC_Loc109_DistVelocityQuality "Quality of radial distance and velocity resolution processing. Physical range [0..1]";
CM_ SG_ 300 RFC_Loc109_ElevationQuality "Probability for correct signal model (elevation angle). Physical range [0..1]";
CM_ SG_ 300 RFC_Loc109_AzimuthQuality "Probability for correct signal model (azimuth angle). Physical range [0..1]";
CM_ SG_ 300 RFC_Loc109_RSSI "Received Signal Strength Indication (RSSI). This signal is not exactly ISO 23150:2021(E): Signal to noise ratio - detection level (A.4.7), but SNR can be calculated from this signal. Further detail please refer to the DSP Location Interface definition";
CM_ SG_ 300 RFC_Loc109_AzimuthalPartnerId "Id of the azimuthal partner location";
CM_ SG_ 300 RFC_Loc110_RadialDistance "Location radial distance. Represented in conical coordinate system. Same as ISO 23150:2021(E): Position radial distance (A.4.16)";
CM_ SG_ 300 RFC_Loc110_RadialVelocity "Location radial relative velocity ISO 23150:2021(E): Relative velocity {radial distance} (A.4.18)";
CM_ SG_ 300 RFC_Loc110_Elevation "Location elevation angle. Represented in conical coordinate system. Same as ISO 23150:2021(E): Position elevation (A.4.16)";
CM_ SG_ 300 RFC_Loc110_Azimuth "Location azimuth angle. Represented in conical coordinate system. Deviation from ISO 23150:2021(E): Position azimuth (A.4.16). Further details refers to DSP Location Interface definition";
CM_ SG_ 300 RFC_Loc110_DistVelocityCoVnce "Covariance of radial distance and radial velocity";
CM_ SG_ 300 RFC_Loc110_RadialDistanceVnce "Variance of Location radial distance ISO 23150:2021(E): Position radial distance - error (A.4.17)";
CM_ SG_ 300 RFC_Loc110_RadialVelocityVnce "Variance of Location radial relative velocity ISO 23150:2021(E): Relative velocity {radial distance} - error (A.4.19)";
CM_ SG_ 300 RFC_Loc110_ElevationVnce "Variance of Location elevation angle ISO 23150:2021(E): Position elevation - error (A.4.17)";
CM_ SG_ 300 RFC_Loc110_AzimuthVnce "Variance of Location azimuth angle ISO 23150:2021(E): Position azimuth - error (A.4.17)";
CM_ SG_ 300 RFC_Loc110_RadarCrossSection "Radar Cross Section (RCS) estimation ISO 23150:2021(E): Radar cross section (A.4.5)";
CM_ SG_ 300 RFC_Loc110_DistVelocityQuality "Quality of radial distance and velocity resolution processing. Physical range [0..1]";
CM_ SG_ 300 RFC_Loc110_ElevationQuality "Probability for correct signal model (elevation angle). Physical range [0..1]";
CM_ SG_ 300 RFC_Loc110_AzimuthQuality "Probability for correct signal model (azimuth angle). Physical range [0..1]";
CM_ SG_ 300 RFC_Loc110_RSSI "Received Signal Strength Indication (RSSI). This signal is not exactly ISO 23150:2021(E): Signal to noise ratio - detection level (A.4.7), but SNR can be calculated from this signal. Further detail please refer to the DSP Location Interface definition";
CM_ SG_ 300 RFC_Loc110_AzimuthalPartnerId "Id of the azimuthal partner location";
CM_ SG_ 301 RFC_Loc111_113_CRC "CRC - Autosar E2E Profile 5";
CM_ SG_ 301 RFC_Loc111_113_AliveCtr "Alive counter - Autosar E2E Profile 5";
CM_ SG_ 301 RFC_Loc111_113_ProtBlockCtr "Protocol-Signal: Block-Counter";
CM_ SG_ 301 RFC_Loc111_RadialDistance "Location radial distance. Represented in conical coordinate system. Same as ISO 23150:2021(E): Position radial distance (A.4.16)";
CM_ SG_ 301 RFC_Loc111_RadialVelocity "Location radial relative velocity ISO 23150:2021(E): Relative velocity {radial distance} (A.4.18)";
CM_ SG_ 301 RFC_Loc111_Elevation "Location elevation angle. Represented in conical coordinate system. Same as ISO 23150:2021(E): Position elevation (A.4.16)";
CM_ SG_ 301 RFC_Loc111_Azimuth "Location azimuth angle. Represented in conical coordinate system. Deviation from ISO 23150:2021(E): Position azimuth (A.4.16). Further details refers to DSP Location Interface definition";
CM_ SG_ 301 RFC_Loc111_DistVelocityCoVnce "Covariance of radial distance and radial velocity";
CM_ SG_ 301 RFC_Loc111_RadialDistanceVnce "Variance of Location radial distance ISO 23150:2021(E): Position radial distance - error (A.4.17)";
CM_ SG_ 301 RFC_Loc111_RadialVelocityVnce "Variance of Location radial relative velocity ISO 23150:2021(E): Relative velocity {radial distance} - error (A.4.19)";
CM_ SG_ 301 RFC_Loc111_ElevationVnce "Variance of Location elevation angle ISO 23150:2021(E): Position elevation - error (A.4.17)";
CM_ SG_ 301 RFC_Loc111_AzimuthVnce "Variance of Location azimuth angle ISO 23150:2021(E): Position azimuth - error (A.4.17)";
CM_ SG_ 301 RFC_Loc111_RadarCrossSection "Radar Cross Section (RCS) estimation ISO 23150:2021(E): Radar cross section (A.4.5)";
CM_ SG_ 301 RFC_Loc111_DistVelocityQuality "Quality of radial distance and velocity resolution processing. Physical range [0..1]";
CM_ SG_ 301 RFC_Loc111_ElevationQuality "Probability for correct signal model (elevation angle). Physical range [0..1]";
CM_ SG_ 301 RFC_Loc111_AzimuthQuality "Probability for correct signal model (azimuth angle). Physical range [0..1]";
CM_ SG_ 301 RFC_Loc111_RSSI "Received Signal Strength Indication (RSSI). This signal is not exactly ISO 23150:2021(E): Signal to noise ratio - detection level (A.4.7), but SNR can be calculated from this signal. Further detail please refer to the DSP Location Interface definition";
CM_ SG_ 301 RFC_Loc111_AzimuthalPartnerId "Id of the azimuthal partner location";
CM_ SG_ 301 RFC_Loc112_RadialDistance "Location radial distance. Represented in conical coordinate system. Same as ISO 23150:2021(E): Position radial distance (A.4.16)";
CM_ SG_ 301 RFC_Loc112_RadialVelocity "Location radial relative velocity ISO 23150:2021(E): Relative velocity {radial distance} (A.4.18)";
CM_ SG_ 301 RFC_Loc112_Elevation "Location elevation angle. Represented in conical coordinate system. Same as ISO 23150:2021(E): Position elevation (A.4.16)";
CM_ SG_ 301 RFC_Loc112_Azimuth "Location azimuth angle. Represented in conical coordinate system. Deviation from ISO 23150:2021(E): Position azimuth (A.4.16). Further details refers to DSP Location Interface definition";
CM_ SG_ 301 RFC_Loc112_DistVelocityCoVnce "Covariance of radial distance and radial velocity";
CM_ SG_ 301 RFC_Loc112_RadialDistanceVnce "Variance of Location radial distance ISO 23150:2021(E): Position radial distance - error (A.4.17)";
CM_ SG_ 301 RFC_Loc112_RadialVelocityVnce "Variance of Location radial relative velocity ISO 23150:2021(E): Relative velocity {radial distance} - error (A.4.19)";
CM_ SG_ 301 RFC_Loc112_ElevationVnce "Variance of Location elevation angle ISO 23150:2021(E): Position elevation - error (A.4.17)";
CM_ SG_ 301 RFC_Loc112_AzimuthVnce "Variance of Location azimuth angle ISO 23150:2021(E): Position azimuth - error (A.4.17)";
CM_ SG_ 301 RFC_Loc112_RadarCrossSection "Radar Cross Section (RCS) estimation ISO 23150:2021(E): Radar cross section (A.4.5)";
CM_ SG_ 301 RFC_Loc112_DistVelocityQuality "Quality of radial distance and velocity resolution processing. Physical range [0..1]";
CM_ SG_ 301 RFC_Loc112_ElevationQuality "Probability for correct signal model (elevation angle). Physical range [0..1]";
CM_ SG_ 301 RFC_Loc112_AzimuthQuality "Probability for correct signal model (azimuth angle). Physical range [0..1]";
CM_ SG_ 301 RFC_Loc112_RSSI "Received Signal Strength Indication (RSSI). This signal is not exactly ISO 23150:2021(E): Signal to noise ratio - detection level (A.4.7), but SNR can be calculated from this signal. Further detail please refer to the DSP Location Interface definition";
CM_ SG_ 301 RFC_Loc112_AzimuthalPartnerId "Id of the azimuthal partner location";
CM_ SG_ 301 RFC_Loc113_RadialDistance "Location radial distance. Represented in conical coordinate system. Same as ISO 23150:2021(E): Position radial distance (A.4.16)";
CM_ SG_ 301 RFC_Loc113_RadialVelocity "Location radial relative velocity ISO 23150:2021(E): Relative velocity {radial distance} (A.4.18)";
CM_ SG_ 301 RFC_Loc113_Elevation "Location elevation angle. Represented in conical coordinate system. Same as ISO 23150:2021(E): Position elevation (A.4.16)";
CM_ SG_ 301 RFC_Loc113_Azimuth "Location azimuth angle. Represented in conical coordinate system. Deviation from ISO 23150:2021(E): Position azimuth (A.4.16). Further details refers to DSP Location Interface definition";
CM_ SG_ 301 RFC_Loc113_DistVelocityCoVnce "Covariance of radial distance and radial velocity";
CM_ SG_ 301 RFC_Loc113_RadialDistanceVnce "Variance of Location radial distance ISO 23150:2021(E): Position radial distance - error (A.4.17)";
CM_ SG_ 301 RFC_Loc113_RadialVelocityVnce "Variance of Location radial relative velocity ISO 23150:2021(E): Relative velocity {radial distance} - error (A.4.19)";
CM_ SG_ 301 RFC_Loc113_ElevationVnce "Variance of Location elevation angle ISO 23150:2021(E): Position elevation - error (A.4.17)";
CM_ SG_ 301 RFC_Loc113_AzimuthVnce "Variance of Location azimuth angle ISO 23150:2021(E): Position azimuth - error (A.4.17)";
CM_ SG_ 301 RFC_Loc113_RadarCrossSection "Radar Cross Section (RCS) estimation ISO 23150:2021(E): Radar cross section (A.4.5)";
CM_ SG_ 301 RFC_Loc113_DistVelocityQuality "Quality of radial distance and velocity resolution processing. Physical range [0..1]";
CM_ SG_ 301 RFC_Loc113_ElevationQuality "Probability for correct signal model (elevation angle). Physical range [0..1]";
CM_ SG_ 301 RFC_Loc113_AzimuthQuality "Probability for correct signal model (azimuth angle). Physical range [0..1]";
CM_ SG_ 301 RFC_Loc113_RSSI "Received Signal Strength Indication (RSSI). This signal is not exactly ISO 23150:2021(E): Signal to noise ratio - detection level (A.4.7), but SNR can be calculated from this signal. Further detail please refer to the DSP Location Interface definition";
CM_ SG_ 301 RFC_Loc113_AzimuthalPartnerId "Id of the azimuthal partner location";
CM_ SG_ 302 RFC_Loc114_116_CRC "CRC - Autosar E2E Profile 5";
CM_ SG_ 302 RFC_Loc114_116_AliveCtr "Alive counter - Autosar E2E Profile 5";
CM_ SG_ 302 RFC_Loc114_116_ProtBlockCtr "Protocol-Signal: Block-Counter";
CM_ SG_ 302 RFC_Loc114_RadialDistance "Location radial distance. Represented in conical coordinate system. Same as ISO 23150:2021(E): Position radial distance (A.4.16)";
CM_ SG_ 302 RFC_Loc114_RadialVelocity "Location radial relative velocity ISO 23150:2021(E): Relative velocity {radial distance} (A.4.18)";
CM_ SG_ 302 RFC_Loc114_Elevation "Location elevation angle. Represented in conical coordinate system. Same as ISO 23150:2021(E): Position elevation (A.4.16)";
CM_ SG_ 302 RFC_Loc114_Azimuth "Location azimuth angle. Represented in conical coordinate system. Deviation from ISO 23150:2021(E): Position azimuth (A.4.16). Further details refers to DSP Location Interface definition";
CM_ SG_ 302 RFC_Loc114_DistVelocityCoVnce "Covariance of radial distance and radial velocity";
CM_ SG_ 302 RFC_Loc114_RadialDistanceVnce "Variance of Location radial distance ISO 23150:2021(E): Position radial distance - error (A.4.17)";
CM_ SG_ 302 RFC_Loc114_RadialVelocityVnce "Variance of Location radial relative velocity ISO 23150:2021(E): Relative velocity {radial distance} - error (A.4.19)";
CM_ SG_ 302 RFC_Loc114_ElevationVnce "Variance of Location elevation angle ISO 23150:2021(E): Position elevation - error (A.4.17)";
CM_ SG_ 302 RFC_Loc114_AzimuthVnce "Variance of Location azimuth angle ISO 23150:2021(E): Position azimuth - error (A.4.17)";
CM_ SG_ 302 RFC_Loc114_RadarCrossSection "Radar Cross Section (RCS) estimation ISO 23150:2021(E): Radar cross section (A.4.5)";
CM_ SG_ 302 RFC_Loc114_DistVelocityQuality "Quality of radial distance and velocity resolution processing. Physical range [0..1]";
CM_ SG_ 302 RFC_Loc114_ElevationQuality "Probability for correct signal model (elevation angle). Physical range [0..1]";
CM_ SG_ 302 RFC_Loc114_AzimuthQuality "Probability for correct signal model (azimuth angle). Physical range [0..1]";
CM_ SG_ 302 RFC_Loc114_RSSI "Received Signal Strength Indication (RSSI). This signal is not exactly ISO 23150:2021(E): Signal to noise ratio - detection level (A.4.7), but SNR can be calculated from this signal. Further detail please refer to the DSP Location Interface definition";
CM_ SG_ 302 RFC_Loc114_AzimuthalPartnerId "Id of the azimuthal partner location";
CM_ SG_ 302 RFC_Loc115_RadialDistance "Location radial distance. Represented in conical coordinate system. Same as ISO 23150:2021(E): Position radial distance (A.4.16)";
CM_ SG_ 302 RFC_Loc115_RadialVelocity "Location radial relative velocity ISO 23150:2021(E): Relative velocity {radial distance} (A.4.18)";
CM_ SG_ 302 RFC_Loc115_Elevation "Location elevation angle. Represented in conical coordinate system. Same as ISO 23150:2021(E): Position elevation (A.4.16)";
CM_ SG_ 302 RFC_Loc115_Azimuth "Location azimuth angle. Represented in conical coordinate system. Deviation from ISO 23150:2021(E): Position azimuth (A.4.16). Further details refers to DSP Location Interface definition";
CM_ SG_ 302 RFC_Loc115_DistVelocityCoVnce "Covariance of radial distance and radial velocity";
CM_ SG_ 302 RFC_Loc115_RadialDistanceVnce "Variance of Location radial distance ISO 23150:2021(E): Position radial distance - error (A.4.17)";
CM_ SG_ 302 RFC_Loc115_RadialVelocityVnce "Variance of Location radial relative velocity ISO 23150:2021(E): Relative velocity {radial distance} - error (A.4.19)";
CM_ SG_ 302 RFC_Loc115_ElevationVnce "Variance of Location elevation angle ISO 23150:2021(E): Position elevation - error (A.4.17)";
CM_ SG_ 302 RFC_Loc115_AzimuthVnce "Variance of Location azimuth angle ISO 23150:2021(E): Position azimuth - error (A.4.17)";
CM_ SG_ 302 RFC_Loc115_RadarCrossSection "Radar Cross Section (RCS) estimation ISO 23150:2021(E): Radar cross section (A.4.5)";
CM_ SG_ 302 RFC_Loc115_DistVelocityQuality "Quality of radial distance and velocity resolution processing. Physical range [0..1]";
CM_ SG_ 302 RFC_Loc115_ElevationQuality "Probability for correct signal model (elevation angle). Physical range [0..1]";
CM_ SG_ 302 RFC_Loc115_AzimuthQuality "Probability for correct signal model (azimuth angle). Physical range [0..1]";
CM_ SG_ 302 RFC_Loc115_RSSI "Received Signal Strength Indication (RSSI). This signal is not exactly ISO 23150:2021(E): Signal to noise ratio - detection level (A.4.7), but SNR can be calculated from this signal. Further detail please refer to the DSP Location Interface definition";
CM_ SG_ 302 RFC_Loc115_AzimuthalPartnerId "Id of the azimuthal partner location";
CM_ SG_ 302 RFC_Loc116_RadialDistance "Location radial distance. Represented in conical coordinate system. Same as ISO 23150:2021(E): Position radial distance (A.4.16)";
CM_ SG_ 302 RFC_Loc116_RadialVelocity "Location radial relative velocity ISO 23150:2021(E): Relative velocity {radial distance} (A.4.18)";
CM_ SG_ 302 RFC_Loc116_Elevation "Location elevation angle. Represented in conical coordinate system. Same as ISO 23150:2021(E): Position elevation (A.4.16)";
CM_ SG_ 302 RFC_Loc116_Azimuth "Location azimuth angle. Represented in conical coordinate system. Deviation from ISO 23150:2021(E): Position azimuth (A.4.16). Further details refers to DSP Location Interface definition";
CM_ SG_ 302 RFC_Loc116_DistVelocityCoVnce "Covariance of radial distance and radial velocity";
CM_ SG_ 302 RFC_Loc116_RadialDistanceVnce "Variance of Location radial distance ISO 23150:2021(E): Position radial distance - error (A.4.17)";
CM_ SG_ 302 RFC_Loc116_RadialVelocityVnce "Variance of Location radial relative velocity ISO 23150:2021(E): Relative velocity {radial distance} - error (A.4.19)";
CM_ SG_ 302 RFC_Loc116_ElevationVnce "Variance of Location elevation angle ISO 23150:2021(E): Position elevation - error (A.4.17)";
CM_ SG_ 302 RFC_Loc116_AzimuthVnce "Variance of Location azimuth angle ISO 23150:2021(E): Position azimuth - error (A.4.17)";
CM_ SG_ 302 RFC_Loc116_RadarCrossSection "Radar Cross Section (RCS) estimation ISO 23150:2021(E): Radar cross section (A.4.5)";
CM_ SG_ 302 RFC_Loc116_DistVelocityQuality "Quality of radial distance and velocity resolution processing. Physical range [0..1]";
CM_ SG_ 302 RFC_Loc116_ElevationQuality "Probability for correct signal model (elevation angle). Physical range [0..1]";
CM_ SG_ 302 RFC_Loc116_AzimuthQuality "Probability for correct signal model (azimuth angle). Physical range [0..1]";
CM_ SG_ 302 RFC_Loc116_RSSI "Received Signal Strength Indication (RSSI). This signal is not exactly ISO 23150:2021(E): Signal to noise ratio - detection level (A.4.7), but SNR can be calculated from this signal. Further detail please refer to the DSP Location Interface definition";
CM_ SG_ 302 RFC_Loc116_AzimuthalPartnerId "Id of the azimuthal partner location";
CM_ SG_ 303 RFC_Loc117_119_CRC "CRC - Autosar E2E Profile 5";
CM_ SG_ 303 RFC_Loc117_119_AliveCtr "Alive counter - Autosar E2E Profile 5";
CM_ SG_ 303 RFC_Loc117_119_ProtBlockCtr "Protocol-Signal: Block-Counter";
CM_ SG_ 303 RFC_Loc117_RadialDistance "Location radial distance. Represented in conical coordinate system. Same as ISO 23150:2021(E): Position radial distance (A.4.16)";
CM_ SG_ 303 RFC_Loc117_RadialVelocity "Location radial relative velocity ISO 23150:2021(E): Relative velocity {radial distance} (A.4.18)";
CM_ SG_ 303 RFC_Loc117_Elevation "Location elevation angle. Represented in conical coordinate system. Same as ISO 23150:2021(E): Position elevation (A.4.16)";
CM_ SG_ 303 RFC_Loc117_Azimuth "Location azimuth angle. Represented in conical coordinate system. Deviation from ISO 23150:2021(E): Position azimuth (A.4.16). Further details refers to DSP Location Interface definition";
CM_ SG_ 303 RFC_Loc117_DistVelocityCoVnce "Covariance of radial distance and radial velocity";
CM_ SG_ 303 RFC_Loc117_RadialDistanceVnce "Variance of Location radial distance ISO 23150:2021(E): Position radial distance - error (A.4.17)";
CM_ SG_ 303 RFC_Loc117_RadialVelocityVnce "Variance of Location radial relative velocity ISO 23150:2021(E): Relative velocity {radial distance} - error (A.4.19)";
CM_ SG_ 303 RFC_Loc117_ElevationVnce "Variance of Location elevation angle ISO 23150:2021(E): Position elevation - error (A.4.17)";
CM_ SG_ 303 RFC_Loc117_AzimuthVnce "Variance of Location azimuth angle ISO 23150:2021(E): Position azimuth - error (A.4.17)";
CM_ SG_ 303 RFC_Loc117_RadarCrossSection "Radar Cross Section (RCS) estimation ISO 23150:2021(E): Radar cross section (A.4.5)";
CM_ SG_ 303 RFC_Loc117_DistVelocityQuality "Quality of radial distance and velocity resolution processing. Physical range [0..1]";
CM_ SG_ 303 RFC_Loc117_ElevationQuality "Probability for correct signal model (elevation angle). Physical range [0..1]";
CM_ SG_ 303 RFC_Loc117_AzimuthQuality "Probability for correct signal model (azimuth angle). Physical range [0..1]";
CM_ SG_ 303 RFC_Loc117_RSSI "Received Signal Strength Indication (RSSI). This signal is not exactly ISO 23150:2021(E): Signal to noise ratio - detection level (A.4.7), but SNR can be calculated from this signal. Further detail please refer to the DSP Location Interface definition";
CM_ SG_ 303 RFC_Loc117_AzimuthalPartnerId "Id of the azimuthal partner location";
CM_ SG_ 303 RFC_Loc118_RadialDistance "Location radial distance. Represented in conical coordinate system. Same as ISO 23150:2021(E): Position radial distance (A.4.16)";
CM_ SG_ 303 RFC_Loc118_RadialVelocity "Location radial relative velocity ISO 23150:2021(E): Relative velocity {radial distance} (A.4.18)";
CM_ SG_ 303 RFC_Loc118_Elevation "Location elevation angle. Represented in conical coordinate system. Same as ISO 23150:2021(E): Position elevation (A.4.16)";
CM_ SG_ 303 RFC_Loc118_Azimuth "Location azimuth angle. Represented in conical coordinate system. Deviation from ISO 23150:2021(E): Position azimuth (A.4.16). Further details refers to DSP Location Interface definition";
CM_ SG_ 303 RFC_Loc118_DistVelocityCoVnce "Covariance of radial distance and radial velocity";
CM_ SG_ 303 RFC_Loc118_RadialDistanceVnce "Variance of Location radial distance ISO 23150:2021(E): Position radial distance - error (A.4.17)";
CM_ SG_ 303 RFC_Loc118_RadialVelocityVnce "Variance of Location radial relative velocity ISO 23150:2021(E): Relative velocity {radial distance} - error (A.4.19)";
CM_ SG_ 303 RFC_Loc118_ElevationVnce "Variance of Location elevation angle ISO 23150:2021(E): Position elevation - error (A.4.17)";
CM_ SG_ 303 RFC_Loc118_AzimuthVnce "Variance of Location azimuth angle ISO 23150:2021(E): Position azimuth - error (A.4.17)";
CM_ SG_ 303 RFC_Loc118_RadarCrossSection "Radar Cross Section (RCS) estimation ISO 23150:2021(E): Radar cross section (A.4.5)";
CM_ SG_ 303 RFC_Loc118_DistVelocityQuality "Quality of radial distance and velocity resolution processing. Physical range [0..1]";
CM_ SG_ 303 RFC_Loc118_ElevationQuality "Probability for correct signal model (elevation angle). Physical range [0..1]";
CM_ SG_ 303 RFC_Loc118_AzimuthQuality "Probability for correct signal model (azimuth angle). Physical range [0..1]";
CM_ SG_ 303 RFC_Loc118_RSSI "Received Signal Strength Indication (RSSI). This signal is not exactly ISO 23150:2021(E): Signal to noise ratio - detection level (A.4.7), but SNR can be calculated from this signal. Further detail please refer to the DSP Location Interface definition";
CM_ SG_ 303 RFC_Loc118_AzimuthalPartnerId "Id of the azimuthal partner location";
CM_ SG_ 303 RFC_Loc119_RadialDistance "Location radial distance. Represented in conical coordinate system. Same as ISO 23150:2021(E): Position radial distance (A.4.16)";
CM_ SG_ 303 RFC_Loc119_RadialVelocity "Location radial relative velocity ISO 23150:2021(E): Relative velocity {radial distance} (A.4.18)";
CM_ SG_ 303 RFC_Loc119_Elevation "Location elevation angle. Represented in conical coordinate system. Same as ISO 23150:2021(E): Position elevation (A.4.16)";
CM_ SG_ 303 RFC_Loc119_Azimuth "Location azimuth angle. Represented in conical coordinate system. Deviation from ISO 23150:2021(E): Position azimuth (A.4.16). Further details refers to DSP Location Interface definition";
CM_ SG_ 303 RFC_Loc119_DistVelocityCoVnce "Covariance of radial distance and radial velocity";
CM_ SG_ 303 RFC_Loc119_RadialDistanceVnce "Variance of Location radial distance ISO 23150:2021(E): Position radial distance - error (A.4.17)";
CM_ SG_ 303 RFC_Loc119_RadialVelocityVnce "Variance of Location radial relative velocity ISO 23150:2021(E): Relative velocity {radial distance} - error (A.4.19)";
CM_ SG_ 303 RFC_Loc119_ElevationVnce "Variance of Location elevation angle ISO 23150:2021(E): Position elevation - error (A.4.17)";
CM_ SG_ 303 RFC_Loc119_AzimuthVnce "Variance of Location azimuth angle ISO 23150:2021(E): Position azimuth - error (A.4.17)";
CM_ SG_ 303 RFC_Loc119_RadarCrossSection "Radar Cross Section (RCS) estimation ISO 23150:2021(E): Radar cross section (A.4.5)";
CM_ SG_ 303 RFC_Loc119_DistVelocityQuality "Quality of radial distance and velocity resolution processing. Physical range [0..1]";
CM_ SG_ 303 RFC_Loc119_ElevationQuality "Probability for correct signal model (elevation angle). Physical range [0..1]";
CM_ SG_ 303 RFC_Loc119_AzimuthQuality "Probability for correct signal model (azimuth angle). Physical range [0..1]";
CM_ SG_ 303 RFC_Loc119_RSSI "Received Signal Strength Indication (RSSI). This signal is not exactly ISO 23150:2021(E): Signal to noise ratio - detection level (A.4.7), but SNR can be calculated from this signal. Further detail please refer to the DSP Location Interface definition";
CM_ SG_ 303 RFC_Loc119_AzimuthalPartnerId "Id of the azimuthal partner location";
CM_ SG_ 304 RFC_Loc120_122_CRC "CRC - Autosar E2E Profile 5";
CM_ SG_ 304 RFC_Loc120_122_AliveCtr "Alive counter - Autosar E2E Profile 5";
CM_ SG_ 304 RFC_Loc120_122_ProtBlockCtr "Protocol-Signal: Block-Counter";
CM_ SG_ 304 RFC_Loc120_RadialDistance "Location radial distance. Represented in conical coordinate system. Same as ISO 23150:2021(E): Position radial distance (A.4.16)";
CM_ SG_ 304 RFC_Loc120_RadialVelocity "Location radial relative velocity ISO 23150:2021(E): Relative velocity {radial distance} (A.4.18)";
CM_ SG_ 304 RFC_Loc120_Elevation "Location elevation angle. Represented in conical coordinate system. Same as ISO 23150:2021(E): Position elevation (A.4.16)";
CM_ SG_ 304 RFC_Loc120_Azimuth "Location azimuth angle. Represented in conical coordinate system. Deviation from ISO 23150:2021(E): Position azimuth (A.4.16). Further details refers to DSP Location Interface definition";
CM_ SG_ 304 RFC_Loc120_DistVelocityCoVnce "Covariance of radial distance and radial velocity";
CM_ SG_ 304 RFC_Loc120_RadialDistanceVnce "Variance of Location radial distance ISO 23150:2021(E): Position radial distance - error (A.4.17)";
CM_ SG_ 304 RFC_Loc120_RadialVelocityVnce "Variance of Location radial relative velocity ISO 23150:2021(E): Relative velocity {radial distance} - error (A.4.19)";
CM_ SG_ 304 RFC_Loc120_ElevationVnce "Variance of Location elevation angle ISO 23150:2021(E): Position elevation - error (A.4.17)";
CM_ SG_ 304 RFC_Loc120_AzimuthVnce "Variance of Location azimuth angle ISO 23150:2021(E): Position azimuth - error (A.4.17)";
CM_ SG_ 304 RFC_Loc120_RadarCrossSection "Radar Cross Section (RCS) estimation ISO 23150:2021(E): Radar cross section (A.4.5)";
CM_ SG_ 304 RFC_Loc120_DistVelocityQuality "Quality of radial distance and velocity resolution processing. Physical range [0..1]";
CM_ SG_ 304 RFC_Loc120_ElevationQuality "Probability for correct signal model (elevation angle). Physical range [0..1]";
CM_ SG_ 304 RFC_Loc120_AzimuthQuality "Probability for correct signal model (azimuth angle). Physical range [0..1]";
CM_ SG_ 304 RFC_Loc120_RSSI "Received Signal Strength Indication (RSSI). This signal is not exactly ISO 23150:2021(E): Signal to noise ratio - detection level (A.4.7), but SNR can be calculated from this signal. Further detail please refer to the DSP Location Interface definition";
CM_ SG_ 304 RFC_Loc120_AzimuthalPartnerId "Id of the azimuthal partner location";
CM_ SG_ 304 RFC_Loc121_RadialDistance "Location radial distance. Represented in conical coordinate system. Same as ISO 23150:2021(E): Position radial distance (A.4.16)";
CM_ SG_ 304 RFC_Loc121_RadialVelocity "Location radial relative velocity ISO 23150:2021(E): Relative velocity {radial distance} (A.4.18)";
CM_ SG_ 304 RFC_Loc121_Elevation "Location elevation angle. Represented in conical coordinate system. Same as ISO 23150:2021(E): Position elevation (A.4.16)";
CM_ SG_ 304 RFC_Loc121_Azimuth "Location azimuth angle. Represented in conical coordinate system. Deviation from ISO 23150:2021(E): Position azimuth (A.4.16). Further details refers to DSP Location Interface definition";
CM_ SG_ 304 RFC_Loc121_DistVelocityCoVnce "Covariance of radial distance and radial velocity";
CM_ SG_ 304 RFC_Loc121_RadialDistanceVnce "Variance of Location radial distance ISO 23150:2021(E): Position radial distance - error (A.4.17)";
CM_ SG_ 304 RFC_Loc121_RadialVelocityVnce "Variance of Location radial relative velocity ISO 23150:2021(E): Relative velocity {radial distance} - error (A.4.19)";
CM_ SG_ 304 RFC_Loc121_ElevationVnce "Variance of Location elevation angle ISO 23150:2021(E): Position elevation - error (A.4.17)";
CM_ SG_ 304 RFC_Loc121_AzimuthVnce "Variance of Location azimuth angle ISO 23150:2021(E): Position azimuth - error (A.4.17)";
CM_ SG_ 304 RFC_Loc121_RadarCrossSection "Radar Cross Section (RCS) estimation ISO 23150:2021(E): Radar cross section (A.4.5)";
CM_ SG_ 304 RFC_Loc121_DistVelocityQuality "Quality of radial distance and velocity resolution processing. Physical range [0..1]";
CM_ SG_ 304 RFC_Loc121_ElevationQuality "Probability for correct signal model (elevation angle). Physical range [0..1]";
CM_ SG_ 304 RFC_Loc121_AzimuthQuality "Probability for correct signal model (azimuth angle). Physical range [0..1]";
CM_ SG_ 304 RFC_Loc121_RSSI "Received Signal Strength Indication (RSSI). This signal is not exactly ISO 23150:2021(E): Signal to noise ratio - detection level (A.4.7), but SNR can be calculated from this signal. Further detail please refer to the DSP Location Interface definition";
CM_ SG_ 304 RFC_Loc121_AzimuthalPartnerId "Id of the azimuthal partner location";
CM_ SG_ 304 RFC_Loc122_RadialDistance "Location radial distance. Represented in conical coordinate system. Same as ISO 23150:2021(E): Position radial distance (A.4.16)";
CM_ SG_ 304 RFC_Loc122_RadialVelocity "Location radial relative velocity ISO 23150:2021(E): Relative velocity {radial distance} (A.4.18)";
CM_ SG_ 304 RFC_Loc122_Elevation "Location elevation angle. Represented in conical coordinate system. Same as ISO 23150:2021(E): Position elevation (A.4.16)";
CM_ SG_ 304 RFC_Loc122_Azimuth "Location azimuth angle. Represented in conical coordinate system. Deviation from ISO 23150:2021(E): Position azimuth (A.4.16). Further details refers to DSP Location Interface definition";
CM_ SG_ 304 RFC_Loc122_DistVelocityCoVnce "Covariance of radial distance and radial velocity";
CM_ SG_ 304 RFC_Loc122_RadialDistanceVnce "Variance of Location radial distance ISO 23150:2021(E): Position radial distance - error (A.4.17)";
CM_ SG_ 304 RFC_Loc122_RadialVelocityVnce "Variance of Location radial relative velocity ISO 23150:2021(E): Relative velocity {radial distance} - error (A.4.19)";
CM_ SG_ 304 RFC_Loc122_ElevationVnce "Variance of Location elevation angle ISO 23150:2021(E): Position elevation - error (A.4.17)";
CM_ SG_ 304 RFC_Loc122_AzimuthVnce "Variance of Location azimuth angle ISO 23150:2021(E): Position azimuth - error (A.4.17)";
CM_ SG_ 304 RFC_Loc122_RadarCrossSection "Radar Cross Section (RCS) estimation ISO 23150:2021(E): Radar cross section (A.4.5)";
CM_ SG_ 304 RFC_Loc122_DistVelocityQuality "Quality of radial distance and velocity resolution processing. Physical range [0..1]";
CM_ SG_ 304 RFC_Loc122_ElevationQuality "Probability for correct signal model (elevation angle). Physical range [0..1]";
CM_ SG_ 304 RFC_Loc122_AzimuthQuality "Probability for correct signal model (azimuth angle). Physical range [0..1]";
CM_ SG_ 304 RFC_Loc122_RSSI "Received Signal Strength Indication (RSSI). This signal is not exactly ISO 23150:2021(E): Signal to noise ratio - detection level (A.4.7), but SNR can be calculated from this signal. Further detail please refer to the DSP Location Interface definition";
CM_ SG_ 304 RFC_Loc122_AzimuthalPartnerId "Id of the azimuthal partner location";
CM_ SG_ 305 RFC_Loc123_125_CRC "CRC - Autosar E2E Profile 5";
CM_ SG_ 305 RFC_Loc123_125_AliveCtr "Alive counter - Autosar E2E Profile 5";
CM_ SG_ 305 RFC_Loc123_125_ProtBlockCtr "Protocol-Signal: Block-Counter";
CM_ SG_ 305 RFC_Loc123_RadialDistance "Location radial distance. Represented in conical coordinate system. Same as ISO 23150:2021(E): Position radial distance (A.4.16)";
CM_ SG_ 305 RFC_Loc123_RadialVelocity "Location radial relative velocity ISO 23150:2021(E): Relative velocity {radial distance} (A.4.18)";
CM_ SG_ 305 RFC_Loc123_Elevation "Location elevation angle. Represented in conical coordinate system. Same as ISO 23150:2021(E): Position elevation (A.4.16)";
CM_ SG_ 305 RFC_Loc123_Azimuth "Location azimuth angle. Represented in conical coordinate system. Deviation from ISO 23150:2021(E): Position azimuth (A.4.16). Further details refers to DSP Location Interface definition";
CM_ SG_ 305 RFC_Loc123_DistVelocityCoVnce "Covariance of radial distance and radial velocity";
CM_ SG_ 305 RFC_Loc123_RadialDistanceVnce "Variance of Location radial distance ISO 23150:2021(E): Position radial distance - error (A.4.17)";
CM_ SG_ 305 RFC_Loc123_RadialVelocityVnce "Variance of Location radial relative velocity ISO 23150:2021(E): Relative velocity {radial distance} - error (A.4.19)";
CM_ SG_ 305 RFC_Loc123_ElevationVnce "Variance of Location elevation angle ISO 23150:2021(E): Position elevation - error (A.4.17)";
CM_ SG_ 305 RFC_Loc123_AzimuthVnce "Variance of Location azimuth angle ISO 23150:2021(E): Position azimuth - error (A.4.17)";
CM_ SG_ 305 RFC_Loc123_RadarCrossSection "Radar Cross Section (RCS) estimation ISO 23150:2021(E): Radar cross section (A.4.5)";
CM_ SG_ 305 RFC_Loc123_DistVelocityQuality "Quality of radial distance and velocity resolution processing. Physical range [0..1]";
CM_ SG_ 305 RFC_Loc123_ElevationQuality "Probability for correct signal model (elevation angle). Physical range [0..1]";
CM_ SG_ 305 RFC_Loc123_AzimuthQuality "Probability for correct signal model (azimuth angle). Physical range [0..1]";
CM_ SG_ 305 RFC_Loc123_RSSI "Received Signal Strength Indication (RSSI). This signal is not exactly ISO 23150:2021(E): Signal to noise ratio - detection level (A.4.7), but SNR can be calculated from this signal. Further detail please refer to the DSP Location Interface definition";
CM_ SG_ 305 RFC_Loc123_AzimuthalPartnerId "Id of the azimuthal partner location";
CM_ SG_ 305 RFC_Loc124_RadialDistance "Location radial distance. Represented in conical coordinate system. Same as ISO 23150:2021(E): Position radial distance (A.4.16)";
CM_ SG_ 305 RFC_Loc124_RadialVelocity "Location radial relative velocity ISO 23150:2021(E): Relative velocity {radial distance} (A.4.18)";
CM_ SG_ 305 RFC_Loc124_Elevation "Location elevation angle. Represented in conical coordinate system. Same as ISO 23150:2021(E): Position elevation (A.4.16)";
CM_ SG_ 305 RFC_Loc124_Azimuth "Location azimuth angle. Represented in conical coordinate system. Deviation from ISO 23150:2021(E): Position azimuth (A.4.16). Further details refers to DSP Location Interface definition";
CM_ SG_ 305 RFC_Loc124_DistVelocityCoVnce "Covariance of radial distance and radial velocity";
CM_ SG_ 305 RFC_Loc124_RadialDistanceVnce "Variance of Location radial distance ISO 23150:2021(E): Position radial distance - error (A.4.17)";
CM_ SG_ 305 RFC_Loc124_RadialVelocityVnce "Variance of Location radial relative velocity ISO 23150:2021(E): Relative velocity {radial distance} - error (A.4.19)";
CM_ SG_ 305 RFC_Loc124_ElevationVnce "Variance of Location elevation angle ISO 23150:2021(E): Position elevation - error (A.4.17)";
CM_ SG_ 305 RFC_Loc124_AzimuthVnce "Variance of Location azimuth angle ISO 23150:2021(E): Position azimuth - error (A.4.17)";
CM_ SG_ 305 RFC_Loc124_RadarCrossSection "Radar Cross Section (RCS) estimation ISO 23150:2021(E): Radar cross section (A.4.5)";
CM_ SG_ 305 RFC_Loc124_DistVelocityQuality "Quality of radial distance and velocity resolution processing. Physical range [0..1]";
CM_ SG_ 305 RFC_Loc124_ElevationQuality "Probability for correct signal model (elevation angle). Physical range [0..1]";
CM_ SG_ 305 RFC_Loc124_AzimuthQuality "Probability for correct signal model (azimuth angle). Physical range [0..1]";
CM_ SG_ 305 RFC_Loc124_RSSI "Received Signal Strength Indication (RSSI). This signal is not exactly ISO 23150:2021(E): Signal to noise ratio - detection level (A.4.7), but SNR can be calculated from this signal. Further detail please refer to the DSP Location Interface definition";
CM_ SG_ 305 RFC_Loc124_AzimuthalPartnerId "Id of the azimuthal partner location";
CM_ SG_ 305 RFC_Loc125_RadialDistance "Location radial distance. Represented in conical coordinate system. Same as ISO 23150:2021(E): Position radial distance (A.4.16)";
CM_ SG_ 305 RFC_Loc125_RadialVelocity "Location radial relative velocity ISO 23150:2021(E): Relative velocity {radial distance} (A.4.18)";
CM_ SG_ 305 RFC_Loc125_Elevation "Location elevation angle. Represented in conical coordinate system. Same as ISO 23150:2021(E): Position elevation (A.4.16)";
CM_ SG_ 305 RFC_Loc125_Azimuth "Location azimuth angle. Represented in conical coordinate system. Deviation from ISO 23150:2021(E): Position azimuth (A.4.16). Further details refers to DSP Location Interface definition";
CM_ SG_ 305 RFC_Loc125_DistVelocityCoVnce "Covariance of radial distance and radial velocity";
CM_ SG_ 305 RFC_Loc125_RadialDistanceVnce "Variance of Location radial distance ISO 23150:2021(E): Position radial distance - error (A.4.17)";
CM_ SG_ 305 RFC_Loc125_RadialVelocityVnce "Variance of Location radial relative velocity ISO 23150:2021(E): Relative velocity {radial distance} - error (A.4.19)";
CM_ SG_ 305 RFC_Loc125_ElevationVnce "Variance of Location elevation angle ISO 23150:2021(E): Position elevation - error (A.4.17)";
CM_ SG_ 305 RFC_Loc125_AzimuthVnce "Variance of Location azimuth angle ISO 23150:2021(E): Position azimuth - error (A.4.17)";
CM_ SG_ 305 RFC_Loc125_RadarCrossSection "Radar Cross Section (RCS) estimation ISO 23150:2021(E): Radar cross section (A.4.5)";
CM_ SG_ 305 RFC_Loc125_DistVelocityQuality "Quality of radial distance and velocity resolution processing. Physical range [0..1]";
CM_ SG_ 305 RFC_Loc125_ElevationQuality "Probability for correct signal model (elevation angle). Physical range [0..1]";
CM_ SG_ 305 RFC_Loc125_AzimuthQuality "Probability for correct signal model (azimuth angle). Physical range [0..1]";
CM_ SG_ 305 RFC_Loc125_RSSI "Received Signal Strength Indication (RSSI). This signal is not exactly ISO 23150:2021(E): Signal to noise ratio - detection level (A.4.7), but SNR can be calculated from this signal. Further detail please refer to the DSP Location Interface definition";
CM_ SG_ 305 RFC_Loc125_AzimuthalPartnerId "Id of the azimuthal partner location";
CM_ SG_ 306 RFC_Loc126_128_CRC "CRC - Autosar E2E Profile 5";
CM_ SG_ 306 RFC_Loc126_128_AliveCtr "Alive counter - Autosar E2E Profile 5";
CM_ SG_ 306 RFC_Loc126_128_ProtBlockCtr "Protocol-Signal: Block-Counter";
CM_ SG_ 306 RFC_Loc126_RadialDistance "Location radial distance. Represented in conical coordinate system. Same as ISO 23150:2021(E): Position radial distance (A.4.16)";
CM_ SG_ 306 RFC_Loc126_RadialVelocity "Location radial relative velocity ISO 23150:2021(E): Relative velocity {radial distance} (A.4.18)";
CM_ SG_ 306 RFC_Loc126_Elevation "Location elevation angle. Represented in conical coordinate system. Same as ISO 23150:2021(E): Position elevation (A.4.16)";
CM_ SG_ 306 RFC_Loc126_Azimuth "Location azimuth angle. Represented in conical coordinate system. Deviation from ISO 23150:2021(E): Position azimuth (A.4.16). Further details refers to DSP Location Interface definition";
CM_ SG_ 306 RFC_Loc126_DistVelocityCoVnce "Covariance of radial distance and radial velocity";
CM_ SG_ 306 RFC_Loc126_RadialDistanceVnce "Variance of Location radial distance ISO 23150:2021(E): Position radial distance - error (A.4.17)";
CM_ SG_ 306 RFC_Loc126_RadialVelocityVnce "Variance of Location radial relative velocity ISO 23150:2021(E): Relative velocity {radial distance} - error (A.4.19)";
CM_ SG_ 306 RFC_Loc126_ElevationVnce "Variance of Location elevation angle ISO 23150:2021(E): Position elevation - error (A.4.17)";
CM_ SG_ 306 RFC_Loc126_AzimuthVnce "Variance of Location azimuth angle ISO 23150:2021(E): Position azimuth - error (A.4.17)";
CM_ SG_ 306 RFC_Loc126_RadarCrossSection "Radar Cross Section (RCS) estimation ISO 23150:2021(E): Radar cross section (A.4.5)";
CM_ SG_ 306 RFC_Loc126_DistVelocityQuality "Quality of radial distance and velocity resolution processing. Physical range [0..1]";
CM_ SG_ 306 RFC_Loc126_ElevationQuality "Probability for correct signal model (elevation angle). Physical range [0..1]";
CM_ SG_ 306 RFC_Loc126_AzimuthQuality "Probability for correct signal model (azimuth angle). Physical range [0..1]";
CM_ SG_ 306 RFC_Loc126_RSSI "Received Signal Strength Indication (RSSI). This signal is not exactly ISO 23150:2021(E): Signal to noise ratio - detection level (A.4.7), but SNR can be calculated from this signal. Further detail please refer to the DSP Location Interface definition";
CM_ SG_ 306 RFC_Loc126_AzimuthalPartnerId "Id of the azimuthal partner location";
CM_ SG_ 306 RFC_Loc127_RadialDistance "Location radial distance. Represented in conical coordinate system. Same as ISO 23150:2021(E): Position radial distance (A.4.16)";
CM_ SG_ 306 RFC_Loc127_RadialVelocity "Location radial relative velocity ISO 23150:2021(E): Relative velocity {radial distance} (A.4.18)";
CM_ SG_ 306 RFC_Loc127_Elevation "Location elevation angle. Represented in conical coordinate system. Same as ISO 23150:2021(E): Position elevation (A.4.16)";
CM_ SG_ 306 RFC_Loc127_Azimuth "Location azimuth angle. Represented in conical coordinate system. Deviation from ISO 23150:2021(E): Position azimuth (A.4.16). Further details refers to DSP Location Interface definition";
CM_ SG_ 306 RFC_Loc127_DistVelocityCoVnce "Covariance of radial distance and radial velocity";
CM_ SG_ 306 RFC_Loc127_RadialDistanceVnce "Variance of Location radial distance ISO 23150:2021(E): Position radial distance - error (A.4.17)";
CM_ SG_ 306 RFC_Loc127_RadialVelocityVnce "Variance of Location radial relative velocity ISO 23150:2021(E): Relative velocity {radial distance} - error (A.4.19)";
CM_ SG_ 306 RFC_Loc127_ElevationVnce "Variance of Location elevation angle ISO 23150:2021(E): Position elevation - error (A.4.17)";
CM_ SG_ 306 RFC_Loc127_AzimuthVnce "Variance of Location azimuth angle ISO 23150:2021(E): Position azimuth - error (A.4.17)";
CM_ SG_ 306 RFC_Loc127_RadarCrossSection "Radar Cross Section (RCS) estimation ISO 23150:2021(E): Radar cross section (A.4.5)";
CM_ SG_ 306 RFC_Loc127_DistVelocityQuality "Quality of radial distance and velocity resolution processing. Physical range [0..1]";
CM_ SG_ 306 RFC_Loc127_ElevationQuality "Probability for correct signal model (elevation angle). Physical range [0..1]";
CM_ SG_ 306 RFC_Loc127_AzimuthQuality "Probability for correct signal model (azimuth angle). Physical range [0..1]";
CM_ SG_ 306 RFC_Loc127_RSSI "Received Signal Strength Indication (RSSI). This signal is not exactly ISO 23150:2021(E): Signal to noise ratio - detection level (A.4.7), but SNR can be calculated from this signal. Further detail please refer to the DSP Location Interface definition";
CM_ SG_ 306 RFC_Loc127_AzimuthalPartnerId "Id of the azimuthal partner location";
CM_ SG_ 306 RFC_Loc128_RadialDistance "Location radial distance. Represented in conical coordinate system. Same as ISO 23150:2021(E): Position radial distance (A.4.16)";
CM_ SG_ 306 RFC_Loc128_RadialVelocity "Location radial relative velocity ISO 23150:2021(E): Relative velocity {radial distance} (A.4.18)";
CM_ SG_ 306 RFC_Loc128_Elevation "Location elevation angle. Represented in conical coordinate system. Same as ISO 23150:2021(E): Position elevation (A.4.16)";
CM_ SG_ 306 RFC_Loc128_Azimuth "Location azimuth angle. Represented in conical coordinate system. Deviation from ISO 23150:2021(E): Position azimuth (A.4.16). Further details refers to DSP Location Interface definition";
CM_ SG_ 306 RFC_Loc128_DistVelocityCoVnce "Covariance of radial distance and radial velocity";
CM_ SG_ 306 RFC_Loc128_RadialDistanceVnce "Variance of Location radial distance ISO 23150:2021(E): Position radial distance - error (A.4.17)";
CM_ SG_ 306 RFC_Loc128_RadialVelocityVnce "Variance of Location radial relative velocity ISO 23150:2021(E): Relative velocity {radial distance} - error (A.4.19)";
CM_ SG_ 306 RFC_Loc128_ElevationVnce "Variance of Location elevation angle ISO 23150:2021(E): Position elevation - error (A.4.17)";
CM_ SG_ 306 RFC_Loc128_AzimuthVnce "Variance of Location azimuth angle ISO 23150:2021(E): Position azimuth - error (A.4.17)";
CM_ SG_ 306 RFC_Loc128_RadarCrossSection "Radar Cross Section (RCS) estimation ISO 23150:2021(E): Radar cross section (A.4.5)";
CM_ SG_ 306 RFC_Loc128_DistVelocityQuality "Quality of radial distance and velocity resolution processing. Physical range [0..1]";
CM_ SG_ 306 RFC_Loc128_ElevationQuality "Probability for correct signal model (elevation angle). Physical range [0..1]";
CM_ SG_ 306 RFC_Loc128_AzimuthQuality "Probability for correct signal model (azimuth angle). Physical range [0..1]";
CM_ SG_ 306 RFC_Loc128_RSSI "Received Signal Strength Indication (RSSI). This signal is not exactly ISO 23150:2021(E): Signal to noise ratio - detection level (A.4.7), but SNR can be calculated from this signal. Further detail please refer to the DSP Location Interface definition";
CM_ SG_ 306 RFC_Loc128_AzimuthalPartnerId "Id of the azimuthal partner location";
CM_ SG_ 307 RFC_Loc129_131_CRC "CRC - Autosar E2E Profile 5";
CM_ SG_ 307 RFC_Loc129_131_AliveCtr "Alive counter - Autosar E2E Profile 5";
CM_ SG_ 307 RFC_Loc129_131_ProtBlockCtr "Protocol-Signal: Block-Counter";
CM_ SG_ 307 RFC_Loc129_RadialDistance "Location radial distance. Represented in conical coordinate system. Same as ISO 23150:2021(E): Position radial distance (A.4.16)";
CM_ SG_ 307 RFC_Loc129_RadialVelocity "Location radial relative velocity ISO 23150:2021(E): Relative velocity {radial distance} (A.4.18)";
CM_ SG_ 307 RFC_Loc129_Elevation "Location elevation angle. Represented in conical coordinate system. Same as ISO 23150:2021(E): Position elevation (A.4.16)";
CM_ SG_ 307 RFC_Loc129_Azimuth "Location azimuth angle. Represented in conical coordinate system. Deviation from ISO 23150:2021(E): Position azimuth (A.4.16). Further details refers to DSP Location Interface definition";
CM_ SG_ 307 RFC_Loc129_DistVelocityCoVnce "Covariance of radial distance and radial velocity";
CM_ SG_ 307 RFC_Loc129_RadialDistanceVnce "Variance of Location radial distance ISO 23150:2021(E): Position radial distance - error (A.4.17)";
CM_ SG_ 307 RFC_Loc129_RadialVelocityVnce "Variance of Location radial relative velocity ISO 23150:2021(E): Relative velocity {radial distance} - error (A.4.19)";
CM_ SG_ 307 RFC_Loc129_ElevationVnce "Variance of Location elevation angle ISO 23150:2021(E): Position elevation - error (A.4.17)";
CM_ SG_ 307 RFC_Loc129_AzimuthVnce "Variance of Location azimuth angle ISO 23150:2021(E): Position azimuth - error (A.4.17)";
CM_ SG_ 307 RFC_Loc129_RadarCrossSection "Radar Cross Section (RCS) estimation ISO 23150:2021(E): Radar cross section (A.4.5)";
CM_ SG_ 307 RFC_Loc129_DistVelocityQuality "Quality of radial distance and velocity resolution processing. Physical range [0..1]";
CM_ SG_ 307 RFC_Loc129_ElevationQuality "Probability for correct signal model (elevation angle). Physical range [0..1]";
CM_ SG_ 307 RFC_Loc129_AzimuthQuality "Probability for correct signal model (azimuth angle). Physical range [0..1]";
CM_ SG_ 307 RFC_Loc129_RSSI "Received Signal Strength Indication (RSSI). This signal is not exactly ISO 23150:2021(E): Signal to noise ratio - detection level (A.4.7), but SNR can be calculated from this signal. Further detail please refer to the DSP Location Interface definition";
CM_ SG_ 307 RFC_Loc129_AzimuthalPartnerId "Id of the azimuthal partner location";
CM_ SG_ 307 RFC_Loc130_RadialDistance "Location radial distance. Represented in conical coordinate system. Same as ISO 23150:2021(E): Position radial distance (A.4.16)";
CM_ SG_ 307 RFC_Loc130_RadialVelocity "Location radial relative velocity ISO 23150:2021(E): Relative velocity {radial distance} (A.4.18)";
CM_ SG_ 307 RFC_Loc130_Elevation "Location elevation angle. Represented in conical coordinate system. Same as ISO 23150:2021(E): Position elevation (A.4.16)";
CM_ SG_ 307 RFC_Loc130_Azimuth "Location azimuth angle. Represented in conical coordinate system. Deviation from ISO 23150:2021(E): Position azimuth (A.4.16). Further details refers to DSP Location Interface definition";
CM_ SG_ 307 RFC_Loc130_DistVelocityCoVnce "Covariance of radial distance and radial velocity";
CM_ SG_ 307 RFC_Loc130_RadialDistanceVnce "Variance of Location radial distance ISO 23150:2021(E): Position radial distance - error (A.4.17)";
CM_ SG_ 307 RFC_Loc130_RadialVelocityVnce "Variance of Location radial relative velocity ISO 23150:2021(E): Relative velocity {radial distance} - error (A.4.19)";
CM_ SG_ 307 RFC_Loc130_ElevationVnce "Variance of Location elevation angle ISO 23150:2021(E): Position elevation - error (A.4.17)";
CM_ SG_ 307 RFC_Loc130_AzimuthVnce "Variance of Location azimuth angle ISO 23150:2021(E): Position azimuth - error (A.4.17)";
CM_ SG_ 307 RFC_Loc130_RadarCrossSection "Radar Cross Section (RCS) estimation ISO 23150:2021(E): Radar cross section (A.4.5)";
CM_ SG_ 307 RFC_Loc130_DistVelocityQuality "Quality of radial distance and velocity resolution processing. Physical range [0..1]";
CM_ SG_ 307 RFC_Loc130_ElevationQuality "Probability for correct signal model (elevation angle). Physical range [0..1]";
CM_ SG_ 307 RFC_Loc130_AzimuthQuality "Probability for correct signal model (azimuth angle). Physical range [0..1]";
CM_ SG_ 307 RFC_Loc130_RSSI "Received Signal Strength Indication (RSSI). This signal is not exactly ISO 23150:2021(E): Signal to noise ratio - detection level (A.4.7), but SNR can be calculated from this signal. Further detail please refer to the DSP Location Interface definition";
CM_ SG_ 307 RFC_Loc130_AzimuthalPartnerId "Id of the azimuthal partner location";
CM_ SG_ 307 RFC_Loc131_RadialDistance "Location radial distance. Represented in conical coordinate system. Same as ISO 23150:2021(E): Position radial distance (A.4.16)";
CM_ SG_ 307 RFC_Loc131_RadialVelocity "Location radial relative velocity ISO 23150:2021(E): Relative velocity {radial distance} (A.4.18)";
CM_ SG_ 307 RFC_Loc131_Elevation "Location elevation angle. Represented in conical coordinate system. Same as ISO 23150:2021(E): Position elevation (A.4.16)";
CM_ SG_ 307 RFC_Loc131_Azimuth "Location azimuth angle. Represented in conical coordinate system. Deviation from ISO 23150:2021(E): Position azimuth (A.4.16). Further details refers to DSP Location Interface definition";
CM_ SG_ 307 RFC_Loc131_DistVelocityCoVnce "Covariance of radial distance and radial velocity";
CM_ SG_ 307 RFC_Loc131_RadialDistanceVnce "Variance of Location radial distance ISO 23150:2021(E): Position radial distance - error (A.4.17)";
CM_ SG_ 307 RFC_Loc131_RadialVelocityVnce "Variance of Location radial relative velocity ISO 23150:2021(E): Relative velocity {radial distance} - error (A.4.19)";
CM_ SG_ 307 RFC_Loc131_ElevationVnce "Variance of Location elevation angle ISO 23150:2021(E): Position elevation - error (A.4.17)";
CM_ SG_ 307 RFC_Loc131_AzimuthVnce "Variance of Location azimuth angle ISO 23150:2021(E): Position azimuth - error (A.4.17)";
CM_ SG_ 307 RFC_Loc131_RadarCrossSection "Radar Cross Section (RCS) estimation ISO 23150:2021(E): Radar cross section (A.4.5)";
CM_ SG_ 307 RFC_Loc131_DistVelocityQuality "Quality of radial distance and velocity resolution processing. Physical range [0..1]";
CM_ SG_ 307 RFC_Loc131_ElevationQuality "Probability for correct signal model (elevation angle). Physical range [0..1]";
CM_ SG_ 307 RFC_Loc131_AzimuthQuality "Probability for correct signal model (azimuth angle). Physical range [0..1]";
CM_ SG_ 307 RFC_Loc131_RSSI "Received Signal Strength Indication (RSSI). This signal is not exactly ISO 23150:2021(E): Signal to noise ratio - detection level (A.4.7), but SNR can be calculated from this signal. Further detail please refer to the DSP Location Interface definition";
CM_ SG_ 307 RFC_Loc131_AzimuthalPartnerId "Id of the azimuthal partner location";
CM_ SG_ 308 RFC_Loc132_134_CRC "CRC - Autosar E2E Profile 5";
CM_ SG_ 308 RFC_Loc132_134_AliveCtr "Alive counter - Autosar E2E Profile 5";
CM_ SG_ 308 RFC_Loc132_134_ProtBlockCtr "Protocol-Signal: Block-Counter";
CM_ SG_ 308 RFC_Loc132_RadialDistance "Location radial distance. Represented in conical coordinate system. Same as ISO 23150:2021(E): Position radial distance (A.4.16)";
CM_ SG_ 308 RFC_Loc132_RadialVelocity "Location radial relative velocity ISO 23150:2021(E): Relative velocity {radial distance} (A.4.18)";
CM_ SG_ 308 RFC_Loc132_Elevation "Location elevation angle. Represented in conical coordinate system. Same as ISO 23150:2021(E): Position elevation (A.4.16)";
CM_ SG_ 308 RFC_Loc132_Azimuth "Location azimuth angle. Represented in conical coordinate system. Deviation from ISO 23150:2021(E): Position azimuth (A.4.16). Further details refers to DSP Location Interface definition";
CM_ SG_ 308 RFC_Loc132_DistVelocityCoVnce "Covariance of radial distance and radial velocity";
CM_ SG_ 308 RFC_Loc132_RadialDistanceVnce "Variance of Location radial distance ISO 23150:2021(E): Position radial distance - error (A.4.17)";
CM_ SG_ 308 RFC_Loc132_RadialVelocityVnce "Variance of Location radial relative velocity ISO 23150:2021(E): Relative velocity {radial distance} - error (A.4.19)";
CM_ SG_ 308 RFC_Loc132_ElevationVnce "Variance of Location elevation angle ISO 23150:2021(E): Position elevation - error (A.4.17)";
CM_ SG_ 308 RFC_Loc132_AzimuthVnce "Variance of Location azimuth angle ISO 23150:2021(E): Position azimuth - error (A.4.17)";
CM_ SG_ 308 RFC_Loc132_RadarCrossSection "Radar Cross Section (RCS) estimation ISO 23150:2021(E): Radar cross section (A.4.5)";
CM_ SG_ 308 RFC_Loc132_DistVelocityQuality "Quality of radial distance and velocity resolution processing. Physical range [0..1]";
CM_ SG_ 308 RFC_Loc132_ElevationQuality "Probability for correct signal model (elevation angle). Physical range [0..1]";
CM_ SG_ 308 RFC_Loc132_AzimuthQuality "Probability for correct signal model (azimuth angle). Physical range [0..1]";
CM_ SG_ 308 RFC_Loc132_RSSI "Received Signal Strength Indication (RSSI). This signal is not exactly ISO 23150:2021(E): Signal to noise ratio - detection level (A.4.7), but SNR can be calculated from this signal. Further detail please refer to the DSP Location Interface definition";
CM_ SG_ 308 RFC_Loc132_AzimuthalPartnerId "Id of the azimuthal partner location";
CM_ SG_ 308 RFC_Loc133_RadialDistance "Location radial distance. Represented in conical coordinate system. Same as ISO 23150:2021(E): Position radial distance (A.4.16)";
CM_ SG_ 308 RFC_Loc133_RadialVelocity "Location radial relative velocity ISO 23150:2021(E): Relative velocity {radial distance} (A.4.18)";
CM_ SG_ 308 RFC_Loc133_Elevation "Location elevation angle. Represented in conical coordinate system. Same as ISO 23150:2021(E): Position elevation (A.4.16)";
CM_ SG_ 308 RFC_Loc133_Azimuth "Location azimuth angle. Represented in conical coordinate system. Deviation from ISO 23150:2021(E): Position azimuth (A.4.16). Further details refers to DSP Location Interface definition";
CM_ SG_ 308 RFC_Loc133_DistVelocityCoVnce "Covariance of radial distance and radial velocity";
CM_ SG_ 308 RFC_Loc133_RadialDistanceVnce "Variance of Location radial distance ISO 23150:2021(E): Position radial distance - error (A.4.17)";
CM_ SG_ 308 RFC_Loc133_RadialVelocityVnce "Variance of Location radial relative velocity ISO 23150:2021(E): Relative velocity {radial distance} - error (A.4.19)";
CM_ SG_ 308 RFC_Loc133_ElevationVnce "Variance of Location elevation angle ISO 23150:2021(E): Position elevation - error (A.4.17)";
CM_ SG_ 308 RFC_Loc133_AzimuthVnce "Variance of Location azimuth angle ISO 23150:2021(E): Position azimuth - error (A.4.17)";
CM_ SG_ 308 RFC_Loc133_RadarCrossSection "Radar Cross Section (RCS) estimation ISO 23150:2021(E): Radar cross section (A.4.5)";
CM_ SG_ 308 RFC_Loc133_DistVelocityQuality "Quality of radial distance and velocity resolution processing. Physical range [0..1]";
CM_ SG_ 308 RFC_Loc133_ElevationQuality "Probability for correct signal model (elevation angle). Physical range [0..1]";
CM_ SG_ 308 RFC_Loc133_AzimuthQuality "Probability for correct signal model (azimuth angle). Physical range [0..1]";
CM_ SG_ 308 RFC_Loc133_RSSI "Received Signal Strength Indication (RSSI). This signal is not exactly ISO 23150:2021(E): Signal to noise ratio - detection level (A.4.7), but SNR can be calculated from this signal. Further detail please refer to the DSP Location Interface definition";
CM_ SG_ 308 RFC_Loc133_AzimuthalPartnerId "Id of the azimuthal partner location";
CM_ SG_ 308 RFC_Loc134_RadialDistance "Location radial distance. Represented in conical coordinate system. Same as ISO 23150:2021(E): Position radial distance (A.4.16)";
CM_ SG_ 308 RFC_Loc134_RadialVelocity "Location radial relative velocity ISO 23150:2021(E): Relative velocity {radial distance} (A.4.18)";
CM_ SG_ 308 RFC_Loc134_Elevation "Location elevation angle. Represented in conical coordinate system. Same as ISO 23150:2021(E): Position elevation (A.4.16)";
CM_ SG_ 308 RFC_Loc134_Azimuth "Location azimuth angle. Represented in conical coordinate system. Deviation from ISO 23150:2021(E): Position azimuth (A.4.16). Further details refers to DSP Location Interface definition";
CM_ SG_ 308 RFC_Loc134_DistVelocityCoVnce "Covariance of radial distance and radial velocity";
CM_ SG_ 308 RFC_Loc134_RadialDistanceVnce "Variance of Location radial distance ISO 23150:2021(E): Position radial distance - error (A.4.17)";
CM_ SG_ 308 RFC_Loc134_RadialVelocityVnce "Variance of Location radial relative velocity ISO 23150:2021(E): Relative velocity {radial distance} - error (A.4.19)";
CM_ SG_ 308 RFC_Loc134_ElevationVnce "Variance of Location elevation angle ISO 23150:2021(E): Position elevation - error (A.4.17)";
CM_ SG_ 308 RFC_Loc134_AzimuthVnce "Variance of Location azimuth angle ISO 23150:2021(E): Position azimuth - error (A.4.17)";
CM_ SG_ 308 RFC_Loc134_RadarCrossSection "Radar Cross Section (RCS) estimation ISO 23150:2021(E): Radar cross section (A.4.5)";
CM_ SG_ 308 RFC_Loc134_DistVelocityQuality "Quality of radial distance and velocity resolution processing. Physical range [0..1]";
CM_ SG_ 308 RFC_Loc134_ElevationQuality "Probability for correct signal model (elevation angle). Physical range [0..1]";
CM_ SG_ 308 RFC_Loc134_AzimuthQuality "Probability for correct signal model (azimuth angle). Physical range [0..1]";
CM_ SG_ 308 RFC_Loc134_RSSI "Received Signal Strength Indication (RSSI). This signal is not exactly ISO 23150:2021(E): Signal to noise ratio - detection level (A.4.7), but SNR can be calculated from this signal. Further detail please refer to the DSP Location Interface definition";
CM_ SG_ 308 RFC_Loc134_AzimuthalPartnerId "Id of the azimuthal partner location";
CM_ SG_ 309 RFC_Loc135_137_CRC "CRC - Autosar E2E Profile 5";
CM_ SG_ 309 RFC_Loc135_137_AliveCtr "Alive counter - Autosar E2E Profile 5";
CM_ SG_ 309 RFC_Loc135_137_ProtBlockCtr "Protocol-Signal: Block-Counter";
CM_ SG_ 309 RFC_Loc135_RadialDistance "Location radial distance. Represented in conical coordinate system. Same as ISO 23150:2021(E): Position radial distance (A.4.16)";
CM_ SG_ 309 RFC_Loc135_RadialVelocity "Location radial relative velocity ISO 23150:2021(E): Relative velocity {radial distance} (A.4.18)";
CM_ SG_ 309 RFC_Loc135_Elevation "Location elevation angle. Represented in conical coordinate system. Same as ISO 23150:2021(E): Position elevation (A.4.16)";
CM_ SG_ 309 RFC_Loc135_Azimuth "Location azimuth angle. Represented in conical coordinate system. Deviation from ISO 23150:2021(E): Position azimuth (A.4.16). Further details refers to DSP Location Interface definition";
CM_ SG_ 309 RFC_Loc135_DistVelocityCoVnce "Covariance of radial distance and radial velocity";
CM_ SG_ 309 RFC_Loc135_RadialDistanceVnce "Variance of Location radial distance ISO 23150:2021(E): Position radial distance - error (A.4.17)";
CM_ SG_ 309 RFC_Loc135_RadialVelocityVnce "Variance of Location radial relative velocity ISO 23150:2021(E): Relative velocity {radial distance} - error (A.4.19)";
CM_ SG_ 309 RFC_Loc135_ElevationVnce "Variance of Location elevation angle ISO 23150:2021(E): Position elevation - error (A.4.17)";
CM_ SG_ 309 RFC_Loc135_AzimuthVnce "Variance of Location azimuth angle ISO 23150:2021(E): Position azimuth - error (A.4.17)";
CM_ SG_ 309 RFC_Loc135_RadarCrossSection "Radar Cross Section (RCS) estimation ISO 23150:2021(E): Radar cross section (A.4.5)";
CM_ SG_ 309 RFC_Loc135_DistVelocityQuality "Quality of radial distance and velocity resolution processing. Physical range [0..1]";
CM_ SG_ 309 RFC_Loc135_ElevationQuality "Probability for correct signal model (elevation angle). Physical range [0..1]";
CM_ SG_ 309 RFC_Loc135_AzimuthQuality "Probability for correct signal model (azimuth angle). Physical range [0..1]";
CM_ SG_ 309 RFC_Loc135_RSSI "Received Signal Strength Indication (RSSI). This signal is not exactly ISO 23150:2021(E): Signal to noise ratio - detection level (A.4.7), but SNR can be calculated from this signal. Further detail please refer to the DSP Location Interface definition";
CM_ SG_ 309 RFC_Loc135_AzimuthalPartnerId "Id of the azimuthal partner location";
CM_ SG_ 309 RFC_Loc136_RadialDistance "Location radial distance. Represented in conical coordinate system. Same as ISO 23150:2021(E): Position radial distance (A.4.16)";
CM_ SG_ 309 RFC_Loc136_RadialVelocity "Location radial relative velocity ISO 23150:2021(E): Relative velocity {radial distance} (A.4.18)";
CM_ SG_ 309 RFC_Loc136_Elevation "Location elevation angle. Represented in conical coordinate system. Same as ISO 23150:2021(E): Position elevation (A.4.16)";
CM_ SG_ 309 RFC_Loc136_Azimuth "Location azimuth angle. Represented in conical coordinate system. Deviation from ISO 23150:2021(E): Position azimuth (A.4.16). Further details refers to DSP Location Interface definition";
CM_ SG_ 309 RFC_Loc136_DistVelocityCoVnce "Covariance of radial distance and radial velocity";
CM_ SG_ 309 RFC_Loc136_RadialDistanceVnce "Variance of Location radial distance ISO 23150:2021(E): Position radial distance - error (A.4.17)";
CM_ SG_ 309 RFC_Loc136_RadialVelocityVnce "Variance of Location radial relative velocity ISO 23150:2021(E): Relative velocity {radial distance} - error (A.4.19)";
CM_ SG_ 309 RFC_Loc136_ElevationVnce "Variance of Location elevation angle ISO 23150:2021(E): Position elevation - error (A.4.17)";
CM_ SG_ 309 RFC_Loc136_AzimuthVnce "Variance of Location azimuth angle ISO 23150:2021(E): Position azimuth - error (A.4.17)";
CM_ SG_ 309 RFC_Loc136_RadarCrossSection "Radar Cross Section (RCS) estimation ISO 23150:2021(E): Radar cross section (A.4.5)";
CM_ SG_ 309 RFC_Loc136_DistVelocityQuality "Quality of radial distance and velocity resolution processing. Physical range [0..1]";
CM_ SG_ 309 RFC_Loc136_ElevationQuality "Probability for correct signal model (elevation angle). Physical range [0..1]";
CM_ SG_ 309 RFC_Loc136_AzimuthQuality "Probability for correct signal model (azimuth angle). Physical range [0..1]";
CM_ SG_ 309 RFC_Loc136_RSSI "Received Signal Strength Indication (RSSI). This signal is not exactly ISO 23150:2021(E): Signal to noise ratio - detection level (A.4.7), but SNR can be calculated from this signal. Further detail please refer to the DSP Location Interface definition";
CM_ SG_ 309 RFC_Loc136_AzimuthalPartnerId "Id of the azimuthal partner location";
CM_ SG_ 309 RFC_Loc137_RadialDistance "Location radial distance. Represented in conical coordinate system. Same as ISO 23150:2021(E): Position radial distance (A.4.16)";
CM_ SG_ 309 RFC_Loc137_RadialVelocity "Location radial relative velocity ISO 23150:2021(E): Relative velocity {radial distance} (A.4.18)";
CM_ SG_ 309 RFC_Loc137_Elevation "Location elevation angle. Represented in conical coordinate system. Same as ISO 23150:2021(E): Position elevation (A.4.16)";
CM_ SG_ 309 RFC_Loc137_Azimuth "Location azimuth angle. Represented in conical coordinate system. Deviation from ISO 23150:2021(E): Position azimuth (A.4.16). Further details refers to DSP Location Interface definition";
CM_ SG_ 309 RFC_Loc137_DistVelocityCoVnce "Covariance of radial distance and radial velocity";
CM_ SG_ 309 RFC_Loc137_RadialDistanceVnce "Variance of Location radial distance ISO 23150:2021(E): Position radial distance - error (A.4.17)";
CM_ SG_ 309 RFC_Loc137_RadialVelocityVnce "Variance of Location radial relative velocity ISO 23150:2021(E): Relative velocity {radial distance} - error (A.4.19)";
CM_ SG_ 309 RFC_Loc137_ElevationVnce "Variance of Location elevation angle ISO 23150:2021(E): Position elevation - error (A.4.17)";
CM_ SG_ 309 RFC_Loc137_AzimuthVnce "Variance of Location azimuth angle ISO 23150:2021(E): Position azimuth - error (A.4.17)";
CM_ SG_ 309 RFC_Loc137_RadarCrossSection "Radar Cross Section (RCS) estimation ISO 23150:2021(E): Radar cross section (A.4.5)";
CM_ SG_ 309 RFC_Loc137_DistVelocityQuality "Quality of radial distance and velocity resolution processing. Physical range [0..1]";
CM_ SG_ 309 RFC_Loc137_ElevationQuality "Probability for correct signal model (elevation angle). Physical range [0..1]";
CM_ SG_ 309 RFC_Loc137_AzimuthQuality "Probability for correct signal model (azimuth angle). Physical range [0..1]";
CM_ SG_ 309 RFC_Loc137_RSSI "Received Signal Strength Indication (RSSI). This signal is not exactly ISO 23150:2021(E): Signal to noise ratio - detection level (A.4.7), but SNR can be calculated from this signal. Further detail please refer to the DSP Location Interface definition";
CM_ SG_ 309 RFC_Loc137_AzimuthalPartnerId "Id of the azimuthal partner location";
CM_ SG_ 310 RFC_Loc138_140_CRC "CRC - Autosar E2E Profile 5";
CM_ SG_ 310 RFC_Loc138_140_AliveCtr "Alive counter - Autosar E2E Profile 5";
CM_ SG_ 310 RFC_Loc138_140_ProtBlockCtr "Protocol-Signal: Block-Counter";
CM_ SG_ 310 RFC_Loc138_RadialDistance "Location radial distance. Represented in conical coordinate system. Same as ISO 23150:2021(E): Position radial distance (A.4.16)";
CM_ SG_ 310 RFC_Loc138_RadialVelocity "Location radial relative velocity ISO 23150:2021(E): Relative velocity {radial distance} (A.4.18)";
CM_ SG_ 310 RFC_Loc138_Elevation "Location elevation angle. Represented in conical coordinate system. Same as ISO 23150:2021(E): Position elevation (A.4.16)";
CM_ SG_ 310 RFC_Loc138_Azimuth "Location azimuth angle. Represented in conical coordinate system. Deviation from ISO 23150:2021(E): Position azimuth (A.4.16). Further details refers to DSP Location Interface definition";
CM_ SG_ 310 RFC_Loc138_DistVelocityCoVnce "Covariance of radial distance and radial velocity";
CM_ SG_ 310 RFC_Loc138_RadialDistanceVnce "Variance of Location radial distance ISO 23150:2021(E): Position radial distance - error (A.4.17)";
CM_ SG_ 310 RFC_Loc138_RadialVelocityVnce "Variance of Location radial relative velocity ISO 23150:2021(E): Relative velocity {radial distance} - error (A.4.19)";
CM_ SG_ 310 RFC_Loc138_ElevationVnce "Variance of Location elevation angle ISO 23150:2021(E): Position elevation - error (A.4.17)";
CM_ SG_ 310 RFC_Loc138_AzimuthVnce "Variance of Location azimuth angle ISO 23150:2021(E): Position azimuth - error (A.4.17)";
CM_ SG_ 310 RFC_Loc138_RadarCrossSection "Radar Cross Section (RCS) estimation ISO 23150:2021(E): Radar cross section (A.4.5)";
CM_ SG_ 310 RFC_Loc138_DistVelocityQuality "Quality of radial distance and velocity resolution processing. Physical range [0..1]";
CM_ SG_ 310 RFC_Loc138_ElevationQuality "Probability for correct signal model (elevation angle). Physical range [0..1]";
CM_ SG_ 310 RFC_Loc138_AzimuthQuality "Probability for correct signal model (azimuth angle). Physical range [0..1]";
CM_ SG_ 310 RFC_Loc138_RSSI "Received Signal Strength Indication (RSSI). This signal is not exactly ISO 23150:2021(E): Signal to noise ratio - detection level (A.4.7), but SNR can be calculated from this signal. Further detail please refer to the DSP Location Interface definition";
CM_ SG_ 310 RFC_Loc138_AzimuthalPartnerId "Id of the azimuthal partner location";
CM_ SG_ 310 RFC_Loc139_RadialDistance "Location radial distance. Represented in conical coordinate system. Same as ISO 23150:2021(E): Position radial distance (A.4.16)";
CM_ SG_ 310 RFC_Loc139_RadialVelocity "Location radial relative velocity ISO 23150:2021(E): Relative velocity {radial distance} (A.4.18)";
CM_ SG_ 310 RFC_Loc139_Elevation "Location elevation angle. Represented in conical coordinate system. Same as ISO 23150:2021(E): Position elevation (A.4.16)";
CM_ SG_ 310 RFC_Loc139_Azimuth "Location azimuth angle. Represented in conical coordinate system. Deviation from ISO 23150:2021(E): Position azimuth (A.4.16). Further details refers to DSP Location Interface definition";
CM_ SG_ 310 RFC_Loc139_DistVelocityCoVnce "Covariance of radial distance and radial velocity";
CM_ SG_ 310 RFC_Loc139_RadialDistanceVnce "Variance of Location radial distance ISO 23150:2021(E): Position radial distance - error (A.4.17)";
CM_ SG_ 310 RFC_Loc139_RadialVelocityVnce "Variance of Location radial relative velocity ISO 23150:2021(E): Relative velocity {radial distance} - error (A.4.19)";
CM_ SG_ 310 RFC_Loc139_ElevationVnce "Variance of Location elevation angle ISO 23150:2021(E): Position elevation - error (A.4.17)";
CM_ SG_ 310 RFC_Loc139_AzimuthVnce "Variance of Location azimuth angle ISO 23150:2021(E): Position azimuth - error (A.4.17)";
CM_ SG_ 310 RFC_Loc139_RadarCrossSection "Radar Cross Section (RCS) estimation ISO 23150:2021(E): Radar cross section (A.4.5)";
CM_ SG_ 310 RFC_Loc139_DistVelocityQuality "Quality of radial distance and velocity resolution processing. Physical range [0..1]";
CM_ SG_ 310 RFC_Loc139_ElevationQuality "Probability for correct signal model (elevation angle). Physical range [0..1]";
CM_ SG_ 310 RFC_Loc139_AzimuthQuality "Probability for correct signal model (azimuth angle). Physical range [0..1]";
CM_ SG_ 310 RFC_Loc139_RSSI "Received Signal Strength Indication (RSSI). This signal is not exactly ISO 23150:2021(E): Signal to noise ratio - detection level (A.4.7), but SNR can be calculated from this signal. Further detail please refer to the DSP Location Interface definition";
CM_ SG_ 310 RFC_Loc139_AzimuthalPartnerId "Id of the azimuthal partner location";
CM_ SG_ 310 RFC_Loc140_RadialDistance "Location radial distance. Represented in conical coordinate system. Same as ISO 23150:2021(E): Position radial distance (A.4.16)";
CM_ SG_ 310 RFC_Loc140_RadialVelocity "Location radial relative velocity ISO 23150:2021(E): Relative velocity {radial distance} (A.4.18)";
CM_ SG_ 310 RFC_Loc140_Elevation "Location elevation angle. Represented in conical coordinate system. Same as ISO 23150:2021(E): Position elevation (A.4.16)";
CM_ SG_ 310 RFC_Loc140_Azimuth "Location azimuth angle. Represented in conical coordinate system. Deviation from ISO 23150:2021(E): Position azimuth (A.4.16). Further details refers to DSP Location Interface definition";
CM_ SG_ 310 RFC_Loc140_DistVelocityCoVnce "Covariance of radial distance and radial velocity";
CM_ SG_ 310 RFC_Loc140_RadialDistanceVnce "Variance of Location radial distance ISO 23150:2021(E): Position radial distance - error (A.4.17)";
CM_ SG_ 310 RFC_Loc140_RadialVelocityVnce "Variance of Location radial relative velocity ISO 23150:2021(E): Relative velocity {radial distance} - error (A.4.19)";
CM_ SG_ 310 RFC_Loc140_ElevationVnce "Variance of Location elevation angle ISO 23150:2021(E): Position elevation - error (A.4.17)";
CM_ SG_ 310 RFC_Loc140_AzimuthVnce "Variance of Location azimuth angle ISO 23150:2021(E): Position azimuth - error (A.4.17)";
CM_ SG_ 310 RFC_Loc140_RadarCrossSection "Radar Cross Section (RCS) estimation ISO 23150:2021(E): Radar cross section (A.4.5)";
CM_ SG_ 310 RFC_Loc140_DistVelocityQuality "Quality of radial distance and velocity resolution processing. Physical range [0..1]";
CM_ SG_ 310 RFC_Loc140_ElevationQuality "Probability for correct signal model (elevation angle). Physical range [0..1]";
CM_ SG_ 310 RFC_Loc140_AzimuthQuality "Probability for correct signal model (azimuth angle). Physical range [0..1]";
CM_ SG_ 310 RFC_Loc140_RSSI "Received Signal Strength Indication (RSSI). This signal is not exactly ISO 23150:2021(E): Signal to noise ratio - detection level (A.4.7), but SNR can be calculated from this signal. Further detail please refer to the DSP Location Interface definition";
CM_ SG_ 310 RFC_Loc140_AzimuthalPartnerId "Id of the azimuthal partner location";
BA_DEF_ BO_  "CANFD_BRS" ENUM  "0","1";
BA_DEF_ BO_  "GenMsgCycleTime" INT 0 65535;
BA_DEF_ BO_  "GenMsgILSupport" ENUM  "No","Yes";
BA_DEF_ BO_  "GenMsgSendType" ENUM  "Cyclic","Event","reserved","reserved","reserved","reserved","reserved","IfActive","NoMsgSendType","reserved","reserved","reserved";
BA_DEF_ BO_  "VFrameFormat" ENUM  "StandardCAN","ExtendedCAN","reserved","reserved","reserved","reserved","reserved","reserved","reserved","reserved","reserved","reserved","reserved","reserved","StandardCAN_FD","ExtendedCAN_FD";
BA_DEF_ BO_  "E2Eprofile" STRING ;
BA_DEF_ BO_  "DataID" HEX 0 655535;
BA_DEF_ SG_  "GenSigSendType" ENUM  "Cyclic","OnWrite","OnWriteWithRepetition","OnChange","OnChangeWithRepetition","IfActive","IfActiveWithRepetition","NoSigSendType","OnChangeAndIfActive","OnChangeAndIfActiveWithRepetition";
BA_DEF_ SG_  "GenSigStartValue" HEX 0 2147483648;
BA_DEF_DEF_  "CANFD_BRS" "1";
BA_DEF_DEF_  "GenMsgCycleTime" 0;
BA_DEF_DEF_  "GenMsgILSupport" "Yes";
BA_DEF_DEF_  "GenMsgSendType" "Cyclic";
BA_DEF_DEF_  "VFrameFormat" "";
BA_DEF_DEF_  "E2Eprofile" "None";
BA_DEF_DEF_  "DataID" 0;
BA_DEF_DEF_  "GenSigSendType" "NoSigSendType";
BA_DEF_DEF_  "GenSigStartValue" 0;
BA_ "GenMsgSendType" BO_ 296 1;
BA_ "E2Eprofile" BO_ 296 "AUTOSAR Profile 5";
BA_ "DataID" BO_ 296 8488;
BA_ "VFrameFormat" BO_ 296 14;
BA_ "GenMsgSendType" BO_ 297 1;
BA_ "E2Eprofile" BO_ 297 "AUTOSAR Profile 5";
BA_ "DataID" BO_ 297 8489;
BA_ "VFrameFormat" BO_ 297 14;
BA_ "GenMsgSendType" BO_ 298 1;
BA_ "E2Eprofile" BO_ 298 "AUTOSAR Profile 5";
BA_ "DataID" BO_ 298 8490;
BA_ "VFrameFormat" BO_ 298 14;
BA_ "GenMsgSendType" BO_ 299 1;
BA_ "E2Eprofile" BO_ 299 "AUTOSAR Profile 5";
BA_ "DataID" BO_ 299 8491;
BA_ "VFrameFormat" BO_ 299 14;
BA_ "GenMsgSendType" BO_ 300 1;
BA_ "E2Eprofile" BO_ 300 "AUTOSAR Profile 5";
BA_ "DataID" BO_ 300 8492;
BA_ "VFrameFormat" BO_ 300 14;
BA_ "GenMsgSendType" BO_ 301 1;
BA_ "E2Eprofile" BO_ 301 "AUTOSAR Profile 5";
BA_ "DataID" BO_ 301 8493;
BA_ "VFrameFormat" BO_ 301 14;
BA_ "GenMsgSendType" BO_ 302 1;
BA_ "E2Eprofile" BO_ 302 "AUTOSAR Profile 5";
BA_ "DataID" BO_ 302 8494;
BA_ "VFrameFormat" BO_ 302 14;
BA_ "GenMsgSendType" BO_ 303 1;
BA_ "E2Eprofile" BO_ 303 "AUTOSAR Profile 5";
BA_ "DataID" BO_ 303 8495;
BA_ "VFrameFormat" BO_ 303 14;
BA_ "GenMsgSendType" BO_ 304 1;
BA_ "E2Eprofile" BO_ 304 "AUTOSAR Profile 5";
BA_ "DataID" BO_ 304 8496;
BA_ "VFrameFormat" BO_ 304 14;
BA_ "GenMsgSendType" BO_ 305 1;
BA_ "E2Eprofile" BO_ 305 "AUTOSAR Profile 5";
BA_ "DataID" BO_ 305 8497;
BA_ "VFrameFormat" BO_ 305 14;
BA_ "GenMsgSendType" BO_ 306 1;
BA_ "E2Eprofile" BO_ 306 "AUTOSAR Profile 5";
BA_ "DataID" BO_ 306 8498;
BA_ "VFrameFormat" BO_ 306 14;
BA_ "GenMsgSendType" BO_ 307 1;
BA_ "E2Eprofile" BO_ 307 "AUTOSAR Profile 5";
BA_ "DataID" BO_ 307 8499;
BA_ "VFrameFormat" BO_ 307 14;
BA_ "GenMsgSendType" BO_ 308 1;
BA_ "E2Eprofile" BO_ 308 "AUTOSAR Profile 5";
BA_ "DataID" BO_ 308 8500;
BA_ "VFrameFormat" BO_ 308 14;
BA_ "GenMsgSendType" BO_ 309 1;
BA_ "E2Eprofile" BO_ 309 "AUTOSAR Profile 5";
BA_ "DataID" BO_ 309 8501;
BA_ "VFrameFormat" BO_ 309 14;
BA_ "GenMsgSendType" BO_ 310 1;
BA_ "E2Eprofile" BO_ 310 "AUTOSAR Profile 5";
BA_ "DataID" BO_ 310 8502;
BA_ "VFrameFormat" BO_ 310 14;
BA_ "GenSigStartValue" SG_ 296 RFC_Loc096_RadialVelocity 16384;
BA_ "GenSigStartValue" SG_ 296 RFC_Loc096_Elevation 512;
BA_ "GenSigStartValue" SG_ 296 RFC_Loc096_Azimuth 1024;
BA_ "GenSigStartValue" SG_ 296 RFC_Loc096_DistVelocityCoVnce 1024;
BA_ "GenSigStartValue" SG_ 296 RFC_Loc096_RadarCrossSection 512;
BA_ "GenSigStartValue" SG_ 296 RFC_Loc097_RadialVelocity 16384;
BA_ "GenSigStartValue" SG_ 296 RFC_Loc097_Elevation 512;
BA_ "GenSigStartValue" SG_ 296 RFC_Loc097_Azimuth 1024;
BA_ "GenSigStartValue" SG_ 296 RFC_Loc097_DistVelocityCoVnce 1024;
BA_ "GenSigStartValue" SG_ 296 RFC_Loc097_RadarCrossSection 512;
BA_ "GenSigStartValue" SG_ 296 RFC_Loc098_RadialVelocity 16384;
BA_ "GenSigStartValue" SG_ 296 RFC_Loc098_Elevation 512;
BA_ "GenSigStartValue" SG_ 296 RFC_Loc098_Azimuth 1024;
BA_ "GenSigStartValue" SG_ 296 RFC_Loc098_DistVelocityCoVnce 1024;
BA_ "GenSigStartValue" SG_ 296 RFC_Loc098_RadarCrossSection 512;
BA_ "GenSigStartValue" SG_ 297 RFC_Loc099_RadialVelocity 16384;
BA_ "GenSigStartValue" SG_ 297 RFC_Loc099_Elevation 512;
BA_ "GenSigStartValue" SG_ 297 RFC_Loc099_Azimuth 1024;
BA_ "GenSigStartValue" SG_ 297 RFC_Loc099_DistVelocityCoVnce 1024;
BA_ "GenSigStartValue" SG_ 297 RFC_Loc099_RadarCrossSection 512;
BA_ "GenSigStartValue" SG_ 297 RFC_Loc100_RadialVelocity 16384;
BA_ "GenSigStartValue" SG_ 297 RFC_Loc100_Elevation 512;
BA_ "GenSigStartValue" SG_ 297 RFC_Loc100_Azimuth 1024;
BA_ "GenSigStartValue" SG_ 297 RFC_Loc100_DistVelocityCoVnce 1024;
BA_ "GenSigStartValue" SG_ 297 RFC_Loc100_RadarCrossSection 512;
BA_ "GenSigStartValue" SG_ 297 RFC_Loc101_RadialVelocity 16384;
BA_ "GenSigStartValue" SG_ 297 RFC_Loc101_Elevation 512;
BA_ "GenSigStartValue" SG_ 297 RFC_Loc101_Azimuth 1024;
BA_ "GenSigStartValue" SG_ 297 RFC_Loc101_DistVelocityCoVnce 1024;
BA_ "GenSigStartValue" SG_ 297 RFC_Loc101_RadarCrossSection 512;
BA_ "GenSigStartValue" SG_ 298 RFC_Loc102_RadialVelocity 16384;
BA_ "GenSigStartValue" SG_ 298 RFC_Loc102_Elevation 512;
BA_ "GenSigStartValue" SG_ 298 RFC_Loc102_Azimuth 1024;
BA_ "GenSigStartValue" SG_ 298 RFC_Loc102_DistVelocityCoVnce 1024;
BA_ "GenSigStartValue" SG_ 298 RFC_Loc102_RadarCrossSection 512;
BA_ "GenSigStartValue" SG_ 298 RFC_Loc103_RadialVelocity 16384;
BA_ "GenSigStartValue" SG_ 298 RFC_Loc103_Elevation 512;
BA_ "GenSigStartValue" SG_ 298 RFC_Loc103_Azimuth 1024;
BA_ "GenSigStartValue" SG_ 298 RFC_Loc103_DistVelocityCoVnce 1024;
BA_ "GenSigStartValue" SG_ 298 RFC_Loc103_RadarCrossSection 512;
BA_ "GenSigStartValue" SG_ 298 RFC_Loc104_RadialVelocity 16384;
BA_ "GenSigStartValue" SG_ 298 RFC_Loc104_Elevation 512;
BA_ "GenSigStartValue" SG_ 298 RFC_Loc104_Azimuth 1024;
BA_ "GenSigStartValue" SG_ 298 RFC_Loc104_DistVelocityCoVnce 1024;
BA_ "GenSigStartValue" SG_ 298 RFC_Loc104_RadarCrossSection 512;
BA_ "GenSigStartValue" SG_ 299 RFC_Loc105_RadialVelocity 16384;
BA_ "GenSigStartValue" SG_ 299 RFC_Loc105_Elevation 512;
BA_ "GenSigStartValue" SG_ 299 RFC_Loc105_Azimuth 1024;
BA_ "GenSigStartValue" SG_ 299 RFC_Loc105_DistVelocityCoVnce 1024;
BA_ "GenSigStartValue" SG_ 299 RFC_Loc105_RadarCrossSection 512;
BA_ "GenSigStartValue" SG_ 299 RFC_Loc106_RadialVelocity 16384;
BA_ "GenSigStartValue" SG_ 299 RFC_Loc106_Elevation 512;
BA_ "GenSigStartValue" SG_ 299 RFC_Loc106_Azimuth 1024;
BA_ "GenSigStartValue" SG_ 299 RFC_Loc106_DistVelocityCoVnce 1024;
BA_ "GenSigStartValue" SG_ 299 RFC_Loc106_RadarCrossSection 512;
BA_ "GenSigStartValue" SG_ 299 RFC_Loc107_RadialVelocity 16384;
BA_ "GenSigStartValue" SG_ 299 RFC_Loc107_Elevation 512;
BA_ "GenSigStartValue" SG_ 299 RFC_Loc107_Azimuth 1024;
BA_ "GenSigStartValue" SG_ 299 RFC_Loc107_DistVelocityCoVnce 1024;
BA_ "GenSigStartValue" SG_ 299 RFC_Loc107_RadarCrossSection 512;
BA_ "GenSigStartValue" SG_ 300 RFC_Loc108_RadialVelocity 16384;
BA_ "GenSigStartValue" SG_ 300 RFC_Loc108_Elevation 512;
BA_ "GenSigStartValue" SG_ 300 RFC_Loc108_Azimuth 1024;
BA_ "GenSigStartValue" SG_ 300 RFC_Loc108_DistVelocityCoVnce 1024;
BA_ "GenSigStartValue" SG_ 300 RFC_Loc108_RadarCrossSection 512;
BA_ "GenSigStartValue" SG_ 300 RFC_Loc109_RadialVelocity 16384;
BA_ "GenSigStartValue" SG_ 300 RFC_Loc109_Elevation 512;
BA_ "GenSigStartValue" SG_ 300 RFC_Loc109_Azimuth 1024;
BA_ "GenSigStartValue" SG_ 300 RFC_Loc109_DistVelocityCoVnce 1024;
BA_ "GenSigStartValue" SG_ 300 RFC_Loc109_RadarCrossSection 512;
BA_ "GenSigStartValue" SG_ 300 RFC_Loc110_RadialVelocity 16384;
BA_ "GenSigStartValue" SG_ 300 RFC_Loc110_Elevation 512;
BA_ "GenSigStartValue" SG_ 300 RFC_Loc110_Azimuth 1024;
BA_ "GenSigStartValue" SG_ 300 RFC_Loc110_DistVelocityCoVnce 1024;
BA_ "GenSigStartValue" SG_ 300 RFC_Loc110_RadarCrossSection 512;
BA_ "GenSigStartValue" SG_ 301 RFC_Loc111_RadialVelocity 16384;
BA_ "GenSigStartValue" SG_ 301 RFC_Loc111_Elevation 512;
BA_ "GenSigStartValue" SG_ 301 RFC_Loc111_Azimuth 1024;
BA_ "GenSigStartValue" SG_ 301 RFC_Loc111_DistVelocityCoVnce 1024;
BA_ "GenSigStartValue" SG_ 301 RFC_Loc111_RadarCrossSection 512;
BA_ "GenSigStartValue" SG_ 301 RFC_Loc112_RadialVelocity 16384;
BA_ "GenSigStartValue" SG_ 301 RFC_Loc112_Elevation 512;
BA_ "GenSigStartValue" SG_ 301 RFC_Loc112_Azimuth 1024;
BA_ "GenSigStartValue" SG_ 301 RFC_Loc112_DistVelocityCoVnce 1024;
BA_ "GenSigStartValue" SG_ 301 RFC_Loc112_RadarCrossSection 512;
BA_ "GenSigStartValue" SG_ 301 RFC_Loc113_RadialVelocity 16384;
BA_ "GenSigStartValue" SG_ 301 RFC_Loc113_Elevation 512;
BA_ "GenSigStartValue" SG_ 301 RFC_Loc113_Azimuth 1024;
BA_ "GenSigStartValue" SG_ 301 RFC_Loc113_DistVelocityCoVnce 1024;
BA_ "GenSigStartValue" SG_ 301 RFC_Loc113_RadarCrossSection 512;
BA_ "GenSigStartValue" SG_ 302 RFC_Loc114_RadialVelocity 16384;
BA_ "GenSigStartValue" SG_ 302 RFC_Loc114_Elevation 512;
BA_ "GenSigStartValue" SG_ 302 RFC_Loc114_Azimuth 1024;
BA_ "GenSigStartValue" SG_ 302 RFC_Loc114_DistVelocityCoVnce 1024;
BA_ "GenSigStartValue" SG_ 302 RFC_Loc114_RadarCrossSection 512;
BA_ "GenSigStartValue" SG_ 302 RFC_Loc115_RadialVelocity 16384;
BA_ "GenSigStartValue" SG_ 302 RFC_Loc115_Elevation 512;
BA_ "GenSigStartValue" SG_ 302 RFC_Loc115_Azimuth 1024;
BA_ "GenSigStartValue" SG_ 302 RFC_Loc115_DistVelocityCoVnce 1024;
BA_ "GenSigStartValue" SG_ 302 RFC_Loc115_RadarCrossSection 512;
BA_ "GenSigStartValue" SG_ 302 RFC_Loc116_RadialVelocity 16384;
BA_ "GenSigStartValue" SG_ 302 RFC_Loc116_Elevation 512;
BA_ "GenSigStartValue" SG_ 302 RFC_Loc116_Azimuth 1024;
BA_ "GenSigStartValue" SG_ 302 RFC_Loc116_DistVelocityCoVnce 1024;
BA_ "GenSigStartValue" SG_ 302 RFC_Loc116_RadarCrossSection 512;
BA_ "GenSigStartValue" SG_ 303 RFC_Loc117_RadialVelocity 16384;
BA_ "GenSigStartValue" SG_ 303 RFC_Loc117_Elevation 512;
BA_ "GenSigStartValue" SG_ 303 RFC_Loc117_Azimuth 1024;
BA_ "GenSigStartValue" SG_ 303 RFC_Loc117_DistVelocityCoVnce 1024;
BA_ "GenSigStartValue" SG_ 303 RFC_Loc117_RadarCrossSection 512;
BA_ "GenSigStartValue" SG_ 303 RFC_Loc118_RadialVelocity 16384;
BA_ "GenSigStartValue" SG_ 303 RFC_Loc118_Elevation 512;
BA_ "GenSigStartValue" SG_ 303 RFC_Loc118_Azimuth 1024;
BA_ "GenSigStartValue" SG_ 303 RFC_Loc118_DistVelocityCoVnce 1024;
BA_ "GenSigStartValue" SG_ 303 RFC_Loc118_RadarCrossSection 512;
BA_ "GenSigStartValue" SG_ 303 RFC_Loc119_RadialVelocity 16384;
BA_ "GenSigStartValue" SG_ 303 RFC_Loc119_Elevation 512;
BA_ "GenSigStartValue" SG_ 303 RFC_Loc119_Azimuth 1024;
BA_ "GenSigStartValue" SG_ 303 RFC_Loc119_DistVelocityCoVnce 1024;
BA_ "GenSigStartValue" SG_ 303 RFC_Loc119_RadarCrossSection 512;
BA_ "GenSigStartValue" SG_ 304 RFC_Loc120_RadialVelocity 16384;
BA_ "GenSigStartValue" SG_ 304 RFC_Loc120_Elevation 512;
BA_ "GenSigStartValue" SG_ 304 RFC_Loc120_Azimuth 1024;
BA_ "GenSigStartValue" SG_ 304 RFC_Loc120_DistVelocityCoVnce 1024;
BA_ "GenSigStartValue" SG_ 304 RFC_Loc120_RadarCrossSection 512;
BA_ "GenSigStartValue" SG_ 304 RFC_Loc121_RadialVelocity 16384;
BA_ "GenSigStartValue" SG_ 304 RFC_Loc121_Elevation 512;
BA_ "GenSigStartValue" SG_ 304 RFC_Loc121_Azimuth 1024;
BA_ "GenSigStartValue" SG_ 304 RFC_Loc121_DistVelocityCoVnce 1024;
BA_ "GenSigStartValue" SG_ 304 RFC_Loc121_RadarCrossSection 512;
BA_ "GenSigStartValue" SG_ 304 RFC_Loc122_RadialVelocity 16384;
BA_ "GenSigStartValue" SG_ 304 RFC_Loc122_Elevation 512;
BA_ "GenSigStartValue" SG_ 304 RFC_Loc122_Azimuth 1024;
BA_ "GenSigStartValue" SG_ 304 RFC_Loc122_DistVelocityCoVnce 1024;
BA_ "GenSigStartValue" SG_ 304 RFC_Loc122_RadarCrossSection 512;
BA_ "GenSigStartValue" SG_ 305 RFC_Loc123_RadialVelocity 16384;
BA_ "GenSigStartValue" SG_ 305 RFC_Loc123_Elevation 512;
BA_ "GenSigStartValue" SG_ 305 RFC_Loc123_Azimuth 1024;
BA_ "GenSigStartValue" SG_ 305 RFC_Loc123_DistVelocityCoVnce 1024;
BA_ "GenSigStartValue" SG_ 305 RFC_Loc123_RadarCrossSection 512;
BA_ "GenSigStartValue" SG_ 305 RFC_Loc124_RadialVelocity 16384;
BA_ "GenSigStartValue" SG_ 305 RFC_Loc124_Elevation 512;
BA_ "GenSigStartValue" SG_ 305 RFC_Loc124_Azimuth 1024;
BA_ "GenSigStartValue" SG_ 305 RFC_Loc124_DistVelocityCoVnce 1024;
BA_ "GenSigStartValue" SG_ 305 RFC_Loc124_RadarCrossSection 512;
BA_ "GenSigStartValue" SG_ 305 RFC_Loc125_RadialVelocity 16384;
BA_ "GenSigStartValue" SG_ 305 RFC_Loc125_Elevation 512;
BA_ "GenSigStartValue" SG_ 305 RFC_Loc125_Azimuth 1024;
BA_ "GenSigStartValue" SG_ 305 RFC_Loc125_DistVelocityCoVnce 1024;
BA_ "GenSigStartValue" SG_ 305 RFC_Loc125_RadarCrossSection 512;
BA_ "GenSigStartValue" SG_ 306 RFC_Loc126_RadialVelocity 16384;
BA_ "GenSigStartValue" SG_ 306 RFC_Loc126_Elevation 512;
BA_ "GenSigStartValue" SG_ 306 RFC_Loc126_Azimuth 1024;
BA_ "GenSigStartValue" SG_ 306 RFC_Loc126_DistVelocityCoVnce 1024;
BA_ "GenSigStartValue" SG_ 306 RFC_Loc126_RadarCrossSection 512;
BA_ "GenSigStartValue" SG_ 306 RFC_Loc127_RadialVelocity 16384;
BA_ "GenSigStartValue" SG_ 306 RFC_Loc127_Elevation 512;
BA_ "GenSigStartValue" SG_ 306 RFC_Loc127_Azimuth 1024;
BA_ "GenSigStartValue" SG_ 306 RFC_Loc127_DistVelocityCoVnce 1024;
BA_ "GenSigStartValue" SG_ 306 RFC_Loc127_RadarCrossSection 512;
BA_ "GenSigStartValue" SG_ 306 RFC_Loc128_RadialVelocity 16384;
BA_ "GenSigStartValue" SG_ 306 RFC_Loc128_Elevation 512;
BA_ "GenSigStartValue" SG_ 306 RFC_Loc128_Azimuth 1024;
BA_ "GenSigStartValue" SG_ 306 RFC_Loc128_DistVelocityCoVnce 1024;
BA_ "GenSigStartValue" SG_ 306 RFC_Loc128_RadarCrossSection 512;
BA_ "GenSigStartValue" SG_ 307 RFC_Loc129_RadialVelocity 16384;
BA_ "GenSigStartValue" SG_ 307 RFC_Loc129_Elevation 512;
BA_ "GenSigStartValue" SG_ 307 RFC_Loc129_Azimuth 1024;
BA_ "GenSigStartValue" SG_ 307 RFC_Loc129_DistVelocityCoVnce 1024;
BA_ "GenSigStartValue" SG_ 307 RFC_Loc129_RadarCrossSection 512;
BA_ "GenSigStartValue" SG_ 307 RFC_Loc130_RadialVelocity 16384;
BA_ "GenSigStartValue" SG_ 307 RFC_Loc130_Elevation 512;
BA_ "GenSigStartValue" SG_ 307 RFC_Loc130_Azimuth 1024;
BA_ "GenSigStartValue" SG_ 307 RFC_Loc130_DistVelocityCoVnce 1024;
BA_ "GenSigStartValue" SG_ 307 RFC_Loc130_RadarCrossSection 512;
BA_ "GenSigStartValue" SG_ 307 RFC_Loc131_RadialVelocity 16384;
BA_ "GenSigStartValue" SG_ 307 RFC_Loc131_Elevation 512;
BA_ "GenSigStartValue" SG_ 307 RFC_Loc131_Azimuth 1024;
BA_ "GenSigStartValue" SG_ 307 RFC_Loc131_DistVelocityCoVnce 1024;
BA_ "GenSigStartValue" SG_ 307 RFC_Loc131_RadarCrossSection 512;
BA_ "GenSigStartValue" SG_ 308 RFC_Loc132_RadialVelocity 16384;
BA_ "GenSigStartValue" SG_ 308 RFC_Loc132_Elevation 512;
BA_ "GenSigStartValue" SG_ 308 RFC_Loc132_Azimuth 1024;
BA_ "GenSigStartValue" SG_ 308 RFC_Loc132_DistVelocityCoVnce 1024;
BA_ "GenSigStartValue" SG_ 308 RFC_Loc132_RadarCrossSection 512;
BA_ "GenSigStartValue" SG_ 308 RFC_Loc133_RadialVelocity 16384;
BA_ "GenSigStartValue" SG_ 308 RFC_Loc133_Elevation 512;
BA_ "GenSigStartValue" SG_ 308 RFC_Loc133_Azimuth 1024;
BA_ "GenSigStartValue" SG_ 308 RFC_Loc133_DistVelocityCoVnce 1024;
BA_ "GenSigStartValue" SG_ 308 RFC_Loc133_RadarCrossSection 512;
BA_ "GenSigStartValue" SG_ 308 RFC_Loc134_RadialVelocity 16384;
BA_ "GenSigStartValue" SG_ 308 RFC_Loc134_Elevation 512;
BA_ "GenSigStartValue" SG_ 308 RFC_Loc134_Azimuth 1024;
BA_ "GenSigStartValue" SG_ 308 RFC_Loc134_DistVelocityCoVnce 1024;
BA_ "GenSigStartValue" SG_ 308 RFC_Loc134_RadarCrossSection 512;
BA_ "GenSigStartValue" SG_ 309 RFC_Loc135_RadialVelocity 16384;
BA_ "GenSigStartValue" SG_ 309 RFC_Loc135_Elevation 512;
BA_ "GenSigStartValue" SG_ 309 RFC_Loc135_Azimuth 1024;
BA_ "GenSigStartValue" SG_ 309 RFC_Loc135_DistVelocityCoVnce 1024;
BA_ "GenSigStartValue" SG_ 309 RFC_Loc135_RadarCrossSection 512;
BA_ "GenSigStartValue" SG_ 309 RFC_Loc136_RadialVelocity 16384;
BA_ "GenSigStartValue" SG_ 309 RFC_Loc136_Elevation 512;
BA_ "GenSigStartValue" SG_ 309 RFC_Loc136_Azimuth 1024;
BA_ "GenSigStartValue" SG_ 309 RFC_Loc136_DistVelocityCoVnce 1024;
BA_ "GenSigStartValue" SG_ 309 RFC_Loc136_RadarCrossSection 512;
BA_ "GenSigStartValue" SG_ 309 RFC_Loc137_RadialVelocity 16384;
BA_ "GenSigStartValue" SG_ 309 RFC_Loc137_Elevation 512;
BA_ "GenSigStartValue" SG_ 309 RFC_Loc137_Azimuth 1024;
BA_ "GenSigStartValue" SG_ 309 RFC_Loc137_DistVelocityCoVnce 1024;
BA_ "GenSigStartValue" SG_ 309 RFC_Loc137_RadarCrossSection 512;
BA_ "GenSigStartValue" SG_ 310 RFC_Loc138_RadialVelocity 16384;
BA_ "GenSigStartValue" SG_ 310 RFC_Loc138_Elevation 512;
BA_ "GenSigStartValue" SG_ 310 RFC_Loc138_Azimuth 1024;
BA_ "GenSigStartValue" SG_ 310 RFC_Loc138_DistVelocityCoVnce 1024;
BA_ "GenSigStartValue" SG_ 310 RFC_Loc138_RadarCrossSection 512;
BA_ "GenSigStartValue" SG_ 310 RFC_Loc139_RadialVelocity 16384;
BA_ "GenSigStartValue" SG_ 310 RFC_Loc139_Elevation 512;
BA_ "GenSigStartValue" SG_ 310 RFC_Loc139_Azimuth 1024;
BA_ "GenSigStartValue" SG_ 310 RFC_Loc139_DistVelocityCoVnce 1024;
BA_ "GenSigStartValue" SG_ 310 RFC_Loc139_RadarCrossSection 512;
BA_ "GenSigStartValue" SG_ 310 RFC_Loc140_RadialVelocity 16384;
BA_ "GenSigStartValue" SG_ 310 RFC_Loc140_Elevation 512;
BA_ "GenSigStartValue" SG_ 310 RFC_Loc140_Azimuth 1024;
BA_ "GenSigStartValue" SG_ 310 RFC_Loc140_DistVelocityCoVnce 1024;
BA_ "GenSigStartValue" SG_ 310 RFC_Loc140_RadarCrossSection 512;
SIG_GROUP_ 296 SG_RFC_Location_096_098 1 : RFC_Loc096_098_CRC RFC_Loc096_098_AliveCtr RFC_Loc096_098_ProtBlockCtr RFC_Loc096_RadialDistance RFC_Loc096_RadialVelocity RFC_Loc096_Elevation RFC_Loc096_Azimuth RFC_Loc096_DistVelocityCoVnce RFC_Loc096_RadialDistanceVnce RFC_Loc096_RadialVelocityVnce RFC_Loc096_ElevationVnce RFC_Loc096_AzimuthVnce RFC_Loc096_RadarCrossSection RFC_Loc096_DistVelocityQuality RFC_Loc096_ElevationQuality RFC_Loc096_AzimuthQuality RFC_Loc096_RSSI RFC_Loc096_AzimuthalPartnerId RFC_Loc097_RadialDistance RFC_Loc097_RadialVelocity RFC_Loc097_Elevation RFC_Loc097_Azimuth RFC_Loc097_DistVelocityCoVnce RFC_Loc097_RadialDistanceVnce RFC_Loc097_RadialVelocityVnce RFC_Loc097_ElevationVnce RFC_Loc097_AzimuthVnce RFC_Loc097_RadarCrossSection RFC_Loc097_DistVelocityQuality RFC_Loc097_ElevationQuality RFC_Loc097_AzimuthQuality RFC_Loc097_RSSI RFC_Loc097_AzimuthalPartnerId RFC_Loc098_RadialDistance RFC_Loc098_RadialVelocity RFC_Loc098_Elevation RFC_Loc098_Azimuth RFC_Loc098_DistVelocityCoVnce RFC_Loc098_RadialDistanceVnce RFC_Loc098_RadialVelocityVnce RFC_Loc098_ElevationVnce RFC_Loc098_AzimuthVnce RFC_Loc098_RadarCrossSection RFC_Loc098_DistVelocityQuality RFC_Loc098_ElevationQuality RFC_Loc098_AzimuthQuality RFC_Loc098_RSSI RFC_Loc098_AzimuthalPartnerId;
SIG_GROUP_ 297 SG_RFC_Location_099_101 1 : RFC_Loc099_101_CRC RFC_Loc099_101_AliveCtr RFC_Loc099_101_ProtBlockCtr RFC_Loc099_RadialDistance RFC_Loc099_RadialVelocity RFC_Loc099_Elevation RFC_Loc099_Azimuth RFC_Loc099_DistVelocityCoVnce RFC_Loc099_RadialDistanceVnce RFC_Loc099_RadialVelocityVnce RFC_Loc099_ElevationVnce RFC_Loc099_AzimuthVnce RFC_Loc099_RadarCrossSection RFC_Loc099_DistVelocityQuality RFC_Loc099_ElevationQuality RFC_Loc099_AzimuthQuality RFC_Loc099_RSSI RFC_Loc099_AzimuthalPartnerId RFC_Loc100_RadialDistance RFC_Loc100_RadialVelocity RFC_Loc100_Elevation RFC_Loc100_Azimuth RFC_Loc100_DistVelocityCoVnce RFC_Loc100_RadialDistanceVnce RFC_Loc100_RadialVelocityVnce RFC_Loc100_ElevationVnce RFC_Loc100_AzimuthVnce RFC_Loc100_RadarCrossSection RFC_Loc100_DistVelocityQuality RFC_Loc100_ElevationQuality RFC_Loc100_AzimuthQuality RFC_Loc100_RSSI RFC_Loc100_AzimuthalPartnerId RFC_Loc101_RadialDistance RFC_Loc101_RadialVelocity RFC_Loc101_Elevation RFC_Loc101_Azimuth RFC_Loc101_DistVelocityCoVnce RFC_Loc101_RadialDistanceVnce RFC_Loc101_RadialVelocityVnce RFC_Loc101_ElevationVnce RFC_Loc101_AzimuthVnce RFC_Loc101_RadarCrossSection RFC_Loc101_DistVelocityQuality RFC_Loc101_ElevationQuality RFC_Loc101_AzimuthQuality RFC_Loc101_RSSI RFC_Loc101_AzimuthalPartnerId;
SIG_GROUP_ 298 SG_RFC_Location_102_104 1 : RFC_Loc102_104_CRC RFC_Loc102_104_AliveCtr RFC_Loc102_104_ProtBlockCtr RFC_Loc102_RadialDistance RFC_Loc102_RadialVelocity RFC_Loc102_Elevation RFC_Loc102_Azimuth RFC_Loc102_DistVelocityCoVnce RFC_Loc102_RadialDistanceVnce RFC_Loc102_RadialVelocityVnce RFC_Loc102_ElevationVnce RFC_Loc102_AzimuthVnce RFC_Loc102_RadarCrossSection RFC_Loc102_DistVelocityQuality RFC_Loc102_ElevationQuality RFC_Loc102_AzimuthQuality RFC_Loc102_RSSI RFC_Loc102_AzimuthalPartnerId RFC_Loc103_RadialDistance RFC_Loc103_RadialVelocity RFC_Loc103_Elevation RFC_Loc103_Azimuth RFC_Loc103_DistVelocityCoVnce RFC_Loc103_RadialDistanceVnce RFC_Loc103_RadialVelocityVnce RFC_Loc103_ElevationVnce RFC_Loc103_AzimuthVnce RFC_Loc103_RadarCrossSection RFC_Loc103_DistVelocityQuality RFC_Loc103_ElevationQuality RFC_Loc103_AzimuthQuality RFC_Loc103_RSSI RFC_Loc103_AzimuthalPartnerId RFC_Loc104_RadialDistance RFC_Loc104_RadialVelocity RFC_Loc104_Elevation RFC_Loc104_Azimuth RFC_Loc104_DistVelocityCoVnce RFC_Loc104_RadialDistanceVnce RFC_Loc104_RadialVelocityVnce RFC_Loc104_ElevationVnce RFC_Loc104_AzimuthVnce RFC_Loc104_RadarCrossSection RFC_Loc104_DistVelocityQuality RFC_Loc104_ElevationQuality RFC_Loc104_AzimuthQuality RFC_Loc104_RSSI RFC_Loc104_AzimuthalPartnerId;
SIG_GROUP_ 299 SG_RFC_Location_105_107 1 : RFC_Loc105_107_CRC RFC_Loc105_107_AliveCtr RFC_Loc105_107_ProtBlockCtr RFC_Loc105_RadialDistance RFC_Loc105_RadialVelocity RFC_Loc105_Elevation RFC_Loc105_Azimuth RFC_Loc105_DistVelocityCoVnce RFC_Loc105_RadialDistanceVnce RFC_Loc105_RadialVelocityVnce RFC_Loc105_ElevationVnce RFC_Loc105_AzimuthVnce RFC_Loc105_RadarCrossSection RFC_Loc105_DistVelocityQuality RFC_Loc105_ElevationQuality RFC_Loc105_AzimuthQuality RFC_Loc105_RSSI RFC_Loc105_AzimuthalPartnerId RFC_Loc106_RadialDistance RFC_Loc106_RadialVelocity RFC_Loc106_Elevation RFC_Loc106_Azimuth RFC_Loc106_DistVelocityCoVnce RFC_Loc106_RadialDistanceVnce RFC_Loc106_RadialVelocityVnce RFC_Loc106_ElevationVnce RFC_Loc106_AzimuthVnce RFC_Loc106_RadarCrossSection RFC_Loc106_DistVelocityQuality RFC_Loc106_ElevationQuality RFC_Loc106_AzimuthQuality RFC_Loc106_RSSI RFC_Loc106_AzimuthalPartnerId RFC_Loc107_RadialDistance RFC_Loc107_RadialVelocity RFC_Loc107_Elevation RFC_Loc107_Azimuth RFC_Loc107_DistVelocityCoVnce RFC_Loc107_RadialDistanceVnce RFC_Loc107_RadialVelocityVnce RFC_Loc107_ElevationVnce RFC_Loc107_AzimuthVnce RFC_Loc107_RadarCrossSection RFC_Loc107_DistVelocityQuality RFC_Loc107_ElevationQuality RFC_Loc107_AzimuthQuality RFC_Loc107_RSSI RFC_Loc107_AzimuthalPartnerId;
SIG_GROUP_ 300 SG_RFC_Location_108_110 1 : RFC_Loc108_110_CRC RFC_Loc108_110_AliveCtr RFC_Loc108_110_ProtBlockCtr RFC_Loc108_RadialDistance RFC_Loc108_RadialVelocity RFC_Loc108_Elevation RFC_Loc108_Azimuth RFC_Loc108_DistVelocityCoVnce RFC_Loc108_RadialDistanceVnce RFC_Loc108_RadialVelocityVnce RFC_Loc108_ElevationVnce RFC_Loc108_AzimuthVnce RFC_Loc108_RadarCrossSection RFC_Loc108_DistVelocityQuality RFC_Loc108_ElevationQuality RFC_Loc108_AzimuthQuality RFC_Loc108_RSSI RFC_Loc108_AzimuthalPartnerId RFC_Loc109_RadialDistance RFC_Loc109_RadialVelocity RFC_Loc109_Elevation RFC_Loc109_Azimuth RFC_Loc109_DistVelocityCoVnce RFC_Loc109_RadialDistanceVnce RFC_Loc109_RadialVelocityVnce RFC_Loc109_ElevationVnce RFC_Loc109_AzimuthVnce RFC_Loc109_RadarCrossSection RFC_Loc109_DistVelocityQuality RFC_Loc109_ElevationQuality RFC_Loc109_AzimuthQuality RFC_Loc109_RSSI RFC_Loc109_AzimuthalPartnerId RFC_Loc110_RadialDistance RFC_Loc110_RadialVelocity RFC_Loc110_Elevation RFC_Loc110_Azimuth RFC_Loc110_DistVelocityCoVnce RFC_Loc110_RadialDistanceVnce RFC_Loc110_RadialVelocityVnce RFC_Loc110_ElevationVnce RFC_Loc110_AzimuthVnce RFC_Loc110_RadarCrossSection RFC_Loc110_DistVelocityQuality RFC_Loc110_ElevationQuality RFC_Loc110_AzimuthQuality RFC_Loc110_RSSI RFC_Loc110_AzimuthalPartnerId;
SIG_GROUP_ 301 SG_RFC_Location_111_113 1 : RFC_Loc111_113_CRC RFC_Loc111_113_AliveCtr RFC_Loc111_113_ProtBlockCtr RFC_Loc111_RadialDistance RFC_Loc111_RadialVelocity RFC_Loc111_Elevation RFC_Loc111_Azimuth RFC_Loc111_DistVelocityCoVnce RFC_Loc111_RadialDistanceVnce RFC_Loc111_RadialVelocityVnce RFC_Loc111_ElevationVnce RFC_Loc111_AzimuthVnce RFC_Loc111_RadarCrossSection RFC_Loc111_DistVelocityQuality RFC_Loc111_ElevationQuality RFC_Loc111_AzimuthQuality RFC_Loc111_RSSI RFC_Loc111_AzimuthalPartnerId RFC_Loc112_RadialDistance RFC_Loc112_RadialVelocity RFC_Loc112_Elevation RFC_Loc112_Azimuth RFC_Loc112_DistVelocityCoVnce RFC_Loc112_RadialDistanceVnce RFC_Loc112_RadialVelocityVnce RFC_Loc112_ElevationVnce RFC_Loc112_AzimuthVnce RFC_Loc112_RadarCrossSection RFC_Loc112_DistVelocityQuality RFC_Loc112_ElevationQuality RFC_Loc112_AzimuthQuality RFC_Loc112_RSSI RFC_Loc112_AzimuthalPartnerId RFC_Loc113_RadialDistance RFC_Loc113_RadialVelocity RFC_Loc113_Elevation RFC_Loc113_Azimuth RFC_Loc113_DistVelocityCoVnce RFC_Loc113_RadialDistanceVnce RFC_Loc113_RadialVelocityVnce RFC_Loc113_ElevationVnce RFC_Loc113_AzimuthVnce RFC_Loc113_RadarCrossSection RFC_Loc113_DistVelocityQuality RFC_Loc113_ElevationQuality RFC_Loc113_AzimuthQuality RFC_Loc113_RSSI RFC_Loc113_AzimuthalPartnerId;
SIG_GROUP_ 302 SG_RFC_Location_114_116 1 : RFC_Loc114_116_CRC RFC_Loc114_116_AliveCtr RFC_Loc114_116_ProtBlockCtr RFC_Loc114_RadialDistance RFC_Loc114_RadialVelocity RFC_Loc114_Elevation RFC_Loc114_Azimuth RFC_Loc114_DistVelocityCoVnce RFC_Loc114_RadialDistanceVnce RFC_Loc114_RadialVelocityVnce RFC_Loc114_ElevationVnce RFC_Loc114_AzimuthVnce RFC_Loc114_RadarCrossSection RFC_Loc114_DistVelocityQuality RFC_Loc114_ElevationQuality RFC_Loc114_AzimuthQuality RFC_Loc114_RSSI RFC_Loc114_AzimuthalPartnerId RFC_Loc115_RadialDistance RFC_Loc115_RadialVelocity RFC_Loc115_Elevation RFC_Loc115_Azimuth RFC_Loc115_DistVelocityCoVnce RFC_Loc115_RadialDistanceVnce RFC_Loc115_RadialVelocityVnce RFC_Loc115_ElevationVnce RFC_Loc115_AzimuthVnce RFC_Loc115_RadarCrossSection RFC_Loc115_DistVelocityQuality RFC_Loc115_ElevationQuality RFC_Loc115_AzimuthQuality RFC_Loc115_RSSI RFC_Loc115_AzimuthalPartnerId RFC_Loc116_RadialDistance RFC_Loc116_RadialVelocity RFC_Loc116_Elevation RFC_Loc116_Azimuth RFC_Loc116_DistVelocityCoVnce RFC_Loc116_RadialDistanceVnce RFC_Loc116_RadialVelocityVnce RFC_Loc116_ElevationVnce RFC_Loc116_AzimuthVnce RFC_Loc116_RadarCrossSection RFC_Loc116_DistVelocityQuality RFC_Loc116_ElevationQuality RFC_Loc116_AzimuthQuality RFC_Loc116_RSSI RFC_Loc116_AzimuthalPartnerId;
SIG_GROUP_ 303 SG_RFC_Location_117_119 1 : RFC_Loc117_119_CRC RFC_Loc117_119_AliveCtr RFC_Loc117_119_ProtBlockCtr RFC_Loc117_RadialDistance RFC_Loc117_RadialVelocity RFC_Loc117_Elevation RFC_Loc117_Azimuth RFC_Loc117_DistVelocityCoVnce RFC_Loc117_RadialDistanceVnce RFC_Loc117_RadialVelocityVnce RFC_Loc117_ElevationVnce RFC_Loc117_AzimuthVnce RFC_Loc117_RadarCrossSection RFC_Loc117_DistVelocityQuality RFC_Loc117_ElevationQuality RFC_Loc117_AzimuthQuality RFC_Loc117_RSSI RFC_Loc117_AzimuthalPartnerId RFC_Loc118_RadialDistance RFC_Loc118_RadialVelocity RFC_Loc118_Elevation RFC_Loc118_Azimuth RFC_Loc118_DistVelocityCoVnce RFC_Loc118_RadialDistanceVnce RFC_Loc118_RadialVelocityVnce RFC_Loc118_ElevationVnce RFC_Loc118_AzimuthVnce RFC_Loc118_RadarCrossSection RFC_Loc118_DistVelocityQuality RFC_Loc118_ElevationQuality RFC_Loc118_AzimuthQuality RFC_Loc118_RSSI RFC_Loc118_AzimuthalPartnerId RFC_Loc119_RadialDistance RFC_Loc119_RadialVelocity RFC_Loc119_Elevation RFC_Loc119_Azimuth RFC_Loc119_DistVelocityCoVnce RFC_Loc119_RadialDistanceVnce RFC_Loc119_RadialVelocityVnce RFC_Loc119_ElevationVnce RFC_Loc119_AzimuthVnce RFC_Loc119_RadarCrossSection RFC_Loc119_DistVelocityQuality RFC_Loc119_ElevationQuality RFC_Loc119_AzimuthQuality RFC_Loc119_RSSI RFC_Loc119_AzimuthalPartnerId;
SIG_GROUP_ 304 SG_RFC_Location_120_122 1 : RFC_Loc120_122_CRC RFC_Loc120_122_AliveCtr RFC_Loc120_122_ProtBlockCtr RFC_Loc120_RadialDistance RFC_Loc120_RadialVelocity RFC_Loc120_Elevation RFC_Loc120_Azimuth RFC_Loc120_DistVelocityCoVnce RFC_Loc120_RadialDistanceVnce RFC_Loc120_RadialVelocityVnce RFC_Loc120_ElevationVnce RFC_Loc120_AzimuthVnce RFC_Loc120_RadarCrossSection RFC_Loc120_DistVelocityQuality RFC_Loc120_ElevationQuality RFC_Loc120_AzimuthQuality RFC_Loc120_RSSI RFC_Loc120_AzimuthalPartnerId RFC_Loc121_RadialDistance RFC_Loc121_RadialVelocity RFC_Loc121_Elevation RFC_Loc121_Azimuth RFC_Loc121_DistVelocityCoVnce RFC_Loc121_RadialDistanceVnce RFC_Loc121_RadialVelocityVnce RFC_Loc121_ElevationVnce RFC_Loc121_AzimuthVnce RFC_Loc121_RadarCrossSection RFC_Loc121_DistVelocityQuality RFC_Loc121_ElevationQuality RFC_Loc121_AzimuthQuality RFC_Loc121_RSSI RFC_Loc121_AzimuthalPartnerId RFC_Loc122_RadialDistance RFC_Loc122_RadialVelocity RFC_Loc122_Elevation RFC_Loc122_Azimuth RFC_Loc122_DistVelocityCoVnce RFC_Loc122_RadialDistanceVnce RFC_Loc122_RadialVelocityVnce RFC_Loc122_ElevationVnce RFC_Loc122_AzimuthVnce RFC_Loc122_RadarCrossSection RFC_Loc122_DistVelocityQuality RFC_Loc122_ElevationQuality RFC_Loc122_AzimuthQuality RFC_Loc122_RSSI RFC_Loc122_AzimuthalPartnerId;
SIG_GROUP_ 305 SG_RFC_Location_123_125 1 : RFC_Loc123_125_CRC RFC_Loc123_125_AliveCtr RFC_Loc123_125_ProtBlockCtr RFC_Loc123_RadialDistance RFC_Loc123_RadialVelocity RFC_Loc123_Elevation RFC_Loc123_Azimuth RFC_Loc123_DistVelocityCoVnce RFC_Loc123_RadialDistanceVnce RFC_Loc123_RadialVelocityVnce RFC_Loc123_ElevationVnce RFC_Loc123_AzimuthVnce RFC_Loc123_RadarCrossSection RFC_Loc123_DistVelocityQuality RFC_Loc123_ElevationQuality RFC_Loc123_AzimuthQuality RFC_Loc123_RSSI RFC_Loc123_AzimuthalPartnerId RFC_Loc124_RadialDistance RFC_Loc124_RadialVelocity RFC_Loc124_Elevation RFC_Loc124_Azimuth RFC_Loc124_DistVelocityCoVnce RFC_Loc124_RadialDistanceVnce RFC_Loc124_RadialVelocityVnce RFC_Loc124_ElevationVnce RFC_Loc124_AzimuthVnce RFC_Loc124_RadarCrossSection RFC_Loc124_DistVelocityQuality RFC_Loc124_ElevationQuality RFC_Loc124_AzimuthQuality RFC_Loc124_RSSI RFC_Loc124_AzimuthalPartnerId RFC_Loc125_RadialDistance RFC_Loc125_RadialVelocity RFC_Loc125_Elevation RFC_Loc125_Azimuth RFC_Loc125_DistVelocityCoVnce RFC_Loc125_RadialDistanceVnce RFC_Loc125_RadialVelocityVnce RFC_Loc125_ElevationVnce RFC_Loc125_AzimuthVnce RFC_Loc125_RadarCrossSection RFC_Loc125_DistVelocityQuality RFC_Loc125_ElevationQuality RFC_Loc125_AzimuthQuality RFC_Loc125_RSSI RFC_Loc125_AzimuthalPartnerId;
SIG_GROUP_ 306 SG_RFC_Location_126_128 1 : RFC_Loc126_128_CRC RFC_Loc126_128_AliveCtr RFC_Loc126_128_ProtBlockCtr RFC_Loc126_RadialDistance RFC_Loc126_RadialVelocity RFC_Loc126_Elevation RFC_Loc126_Azimuth RFC_Loc126_DistVelocityCoVnce RFC_Loc126_RadialDistanceVnce RFC_Loc126_RadialVelocityVnce RFC_Loc126_ElevationVnce RFC_Loc126_AzimuthVnce RFC_Loc126_RadarCrossSection RFC_Loc126_DistVelocityQuality RFC_Loc126_ElevationQuality RFC_Loc126_AzimuthQuality RFC_Loc126_RSSI RFC_Loc126_AzimuthalPartnerId RFC_Loc127_RadialDistance RFC_Loc127_RadialVelocity RFC_Loc127_Elevation RFC_Loc127_Azimuth RFC_Loc127_DistVelocityCoVnce RFC_Loc127_RadialDistanceVnce RFC_Loc127_RadialVelocityVnce RFC_Loc127_ElevationVnce RFC_Loc127_AzimuthVnce RFC_Loc127_RadarCrossSection RFC_Loc127_DistVelocityQuality RFC_Loc127_ElevationQuality RFC_Loc127_AzimuthQuality RFC_Loc127_RSSI RFC_Loc127_AzimuthalPartnerId RFC_Loc128_RadialDistance RFC_Loc128_RadialVelocity RFC_Loc128_Elevation RFC_Loc128_Azimuth RFC_Loc128_DistVelocityCoVnce RFC_Loc128_RadialDistanceVnce RFC_Loc128_RadialVelocityVnce RFC_Loc128_ElevationVnce RFC_Loc128_AzimuthVnce RFC_Loc128_RadarCrossSection RFC_Loc128_DistVelocityQuality RFC_Loc128_ElevationQuality RFC_Loc128_AzimuthQuality RFC_Loc128_RSSI RFC_Loc128_AzimuthalPartnerId;
SIG_GROUP_ 307 SG_RFC_Location_129_131 1 : RFC_Loc129_131_CRC RFC_Loc129_131_AliveCtr RFC_Loc129_131_ProtBlockCtr RFC_Loc129_RadialDistance RFC_Loc129_RadialVelocity RFC_Loc129_Elevation RFC_Loc129_Azimuth RFC_Loc129_DistVelocityCoVnce RFC_Loc129_RadialDistanceVnce RFC_Loc129_RadialVelocityVnce RFC_Loc129_ElevationVnce RFC_Loc129_AzimuthVnce RFC_Loc129_RadarCrossSection RFC_Loc129_DistVelocityQuality RFC_Loc129_ElevationQuality RFC_Loc129_AzimuthQuality RFC_Loc129_RSSI RFC_Loc129_AzimuthalPartnerId RFC_Loc130_RadialDistance RFC_Loc130_RadialVelocity RFC_Loc130_Elevation RFC_Loc130_Azimuth RFC_Loc130_DistVelocityCoVnce RFC_Loc130_RadialDistanceVnce RFC_Loc130_RadialVelocityVnce RFC_Loc130_ElevationVnce RFC_Loc130_AzimuthVnce RFC_Loc130_RadarCrossSection RFC_Loc130_DistVelocityQuality RFC_Loc130_ElevationQuality RFC_Loc130_AzimuthQuality RFC_Loc130_RSSI RFC_Loc130_AzimuthalPartnerId RFC_Loc131_RadialDistance RFC_Loc131_RadialVelocity RFC_Loc131_Elevation RFC_Loc131_Azimuth RFC_Loc131_DistVelocityCoVnce RFC_Loc131_RadialDistanceVnce RFC_Loc131_RadialVelocityVnce RFC_Loc131_ElevationVnce RFC_Loc131_AzimuthVnce RFC_Loc131_RadarCrossSection RFC_Loc131_DistVelocityQuality RFC_Loc131_ElevationQuality RFC_Loc131_AzimuthQuality RFC_Loc131_RSSI RFC_Loc131_AzimuthalPartnerId;
SIG_GROUP_ 308 SG_RFC_Location_132_134 1 : RFC_Loc132_134_CRC RFC_Loc132_134_AliveCtr RFC_Loc132_134_ProtBlockCtr RFC_Loc132_RadialDistance RFC_Loc132_RadialVelocity RFC_Loc132_Elevation RFC_Loc132_Azimuth RFC_Loc132_DistVelocityCoVnce RFC_Loc132_RadialDistanceVnce RFC_Loc132_RadialVelocityVnce RFC_Loc132_ElevationVnce RFC_Loc132_AzimuthVnce RFC_Loc132_RadarCrossSection RFC_Loc132_DistVelocityQuality RFC_Loc132_ElevationQuality RFC_Loc132_AzimuthQuality RFC_Loc132_RSSI RFC_Loc132_AzimuthalPartnerId RFC_Loc133_RadialDistance RFC_Loc133_RadialVelocity RFC_Loc133_Elevation RFC_Loc133_Azimuth RFC_Loc133_DistVelocityCoVnce RFC_Loc133_RadialDistanceVnce RFC_Loc133_RadialVelocityVnce RFC_Loc133_ElevationVnce RFC_Loc133_AzimuthVnce RFC_Loc133_RadarCrossSection RFC_Loc133_DistVelocityQuality RFC_Loc133_ElevationQuality RFC_Loc133_AzimuthQuality RFC_Loc133_RSSI RFC_Loc133_AzimuthalPartnerId RFC_Loc134_RadialDistance RFC_Loc134_RadialVelocity RFC_Loc134_Elevation RFC_Loc134_Azimuth RFC_Loc134_DistVelocityCoVnce RFC_Loc134_RadialDistanceVnce RFC_Loc134_RadialVelocityVnce RFC_Loc134_ElevationVnce RFC_Loc134_AzimuthVnce RFC_Loc134_RadarCrossSection RFC_Loc134_DistVelocityQuality RFC_Loc134_ElevationQuality RFC_Loc134_AzimuthQuality RFC_Loc134_RSSI RFC_Loc134_AzimuthalPartnerId;
SIG_GROUP_ 309 SG_RFC_Location_135_137 1 : RFC_Loc135_137_CRC RFC_Loc135_137_AliveCtr RFC_Loc135_137_ProtBlockCtr RFC_Loc135_RadialDistance RFC_Loc135_RadialVelocity RFC_Loc135_Elevation RFC_Loc135_Azimuth RFC_Loc135_DistVelocityCoVnce RFC_Loc135_RadialDistanceVnce RFC_Loc135_RadialVelocityVnce RFC_Loc135_ElevationVnce RFC_Loc135_AzimuthVnce RFC_Loc135_RadarCrossSection RFC_Loc135_DistVelocityQuality RFC_Loc135_ElevationQuality RFC_Loc135_AzimuthQuality RFC_Loc135_RSSI RFC_Loc135_AzimuthalPartnerId RFC_Loc136_RadialDistance RFC_Loc136_RadialVelocity RFC_Loc136_Elevation RFC_Loc136_Azimuth RFC_Loc136_DistVelocityCoVnce RFC_Loc136_RadialDistanceVnce RFC_Loc136_RadialVelocityVnce RFC_Loc136_ElevationVnce RFC_Loc136_AzimuthVnce RFC_Loc136_RadarCrossSection RFC_Loc136_DistVelocityQuality RFC_Loc136_ElevationQuality RFC_Loc136_AzimuthQuality RFC_Loc136_RSSI RFC_Loc136_AzimuthalPartnerId RFC_Loc137_RadialDistance RFC_Loc137_RadialVelocity RFC_Loc137_Elevation RFC_Loc137_Azimuth RFC_Loc137_DistVelocityCoVnce RFC_Loc137_RadialDistanceVnce RFC_Loc137_RadialVelocityVnce RFC_Loc137_ElevationVnce RFC_Loc137_AzimuthVnce RFC_Loc137_RadarCrossSection RFC_Loc137_DistVelocityQuality RFC_Loc137_ElevationQuality RFC_Loc137_AzimuthQuality RFC_Loc137_RSSI RFC_Loc137_AzimuthalPartnerId;
SIG_GROUP_ 310 SG_RFC_Location_138_140 1 : RFC_Loc138_140_CRC RFC_Loc138_140_AliveCtr RFC_Loc138_140_ProtBlockCtr RFC_Loc138_RadialDistance RFC_Loc138_RadialVelocity RFC_Loc138_Elevation RFC_Loc138_Azimuth RFC_Loc138_DistVelocityCoVnce RFC_Loc138_RadialDistanceVnce RFC_Loc138_RadialVelocityVnce RFC_Loc138_ElevationVnce RFC_Loc138_AzimuthVnce RFC_Loc138_RadarCrossSection RFC_Loc138_DistVelocityQuality RFC_Loc138_ElevationQuality RFC_Loc138_AzimuthQuality RFC_Loc138_RSSI RFC_Loc138_AzimuthalPartnerId RFC_Loc139_RadialDistance RFC_Loc139_RadialVelocity RFC_Loc139_Elevation RFC_Loc139_Azimuth RFC_Loc139_DistVelocityCoVnce RFC_Loc139_RadialDistanceVnce RFC_Loc139_RadialVelocityVnce RFC_Loc139_ElevationVnce RFC_Loc139_AzimuthVnce RFC_Loc139_RadarCrossSection RFC_Loc139_DistVelocityQuality RFC_Loc139_ElevationQuality RFC_Loc139_AzimuthQuality RFC_Loc139_RSSI RFC_Loc139_AzimuthalPartnerId RFC_Loc140_RadialDistance RFC_Loc140_RadialVelocity RFC_Loc140_Elevation RFC_Loc140_Azimuth RFC_Loc140_DistVelocityCoVnce RFC_Loc140_RadialDistanceVnce RFC_Loc140_RadialVelocityVnce RFC_Loc140_ElevationVnce RFC_Loc140_AzimuthVnce RFC_Loc140_RadarCrossSection RFC_Loc140_DistVelocityQuality RFC_Loc140_ElevationQuality RFC_Loc140_AzimuthQuality RFC_Loc140_RSSI RFC_Loc140_AzimuthalPartnerId;
