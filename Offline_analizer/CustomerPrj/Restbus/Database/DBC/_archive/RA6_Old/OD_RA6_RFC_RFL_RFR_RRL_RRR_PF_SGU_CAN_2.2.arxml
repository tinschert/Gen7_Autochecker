AUTOSAR XML (schema 00051)
standard types defined: boolean, uint16, uint32, uint8
package /RA6/BaseTypes
  base type uint8_n: category=FIXED_LENGTH, base-type-size=8, base-type-encoding=UTF-8
package /RA6/Pkg_CanTp
  can tp config CanTPConfig_RA6: communication-cluster=PF_RA6_SGU, can-tp-ecu=RA6_RRR
    45 x can tp address:
      TA_RFC_DiagRA6: tp-address=2
      TA_RFC_DiagTester_Func: tp-address=1
      TA_RFC_DiagTester_Phys: tp-address=0
      TA_RFC_FieldDataCollection_CentralEcu: tp-address=6
      TA_RFC_FieldDataCollection_RA6: tp-address=5
      TA_RFC_Object_CentralEcu: tp-address=4
      TA_RFC_Object_RA6: tp-address=3
      TA_RFC_RoadSideBoundaries_CentralEcu: tp-address=8
      TA_RFC_RoadSideBoundaries_RA6: tp-address=7
      TA_RFL_DiagRA6: tp-address=2
      TA_RFL_DiagTester_Func: tp-address=1
      TA_RFL_DiagTester_Phys: tp-address=0
      TA_RFL_FieldDataCollection_CentralEcu: tp-address=6
      TA_RFL_FieldDataCollection_RA6: tp-address=5
      TA_RFL_Object_CentralEcu: tp-address=4
      TA_RFL_Object_RA6: tp-address=3
      TA_RFL_RoadSideBoundaries_CentralEcu: tp-address=8
      TA_RFL_RoadSideBoundaries_RA6: tp-address=7
      TA_RFR_DiagRA6: tp-address=2
      TA_RFR_DiagTester_Func: tp-address=1
      TA_RFR_DiagTester_Phys: tp-address=0
      TA_RFR_FieldDataCollection_CentralEcu: tp-address=6
      TA_RFR_FieldDataCollection_RA6: tp-address=5
      TA_RFR_Object_CentralEcu: tp-address=4
      TA_RFR_Object_RA6: tp-address=3
      TA_RFR_RoadSideBoundaries_CentralEcu: tp-address=8
      TA_RFR_RoadSideBoundaries_RA6: tp-address=7
      TA_RRL_DiagRA6: tp-address=2
      TA_RRL_DiagTester_Func: tp-address=1
      TA_RRL_DiagTester_Phys: tp-address=0
      TA_RRL_FieldDataCollection_CentralEcu: tp-address=6
      TA_RRL_FieldDataCollection_RA6: tp-address=5
      TA_RRL_Object_CentralEcu: tp-address=4
      TA_RRL_Object_RA6: tp-address=3
      TA_RRL_RoadSideBoundaries_CentralEcu: tp-address=8
      TA_RRL_RoadSideBoundaries_RA6: tp-address=7
      TA_RRR_DiagRA6: tp-address=2
      TA_RRR_DiagTester_Func: tp-address=1
      TA_RRR_DiagTester_Phys: tp-address=0
      TA_RRR_FieldDataCollection_CentralEcu: tp-address=6
      TA_RRR_FieldDataCollection_RA6: tp-address=5
      TA_RRR_Object_CentralEcu: tp-address=4
      TA_RRR_Object_RA6: tp-address=3
      TA_RRR_RoadSideBoundaries_CentralEcu: tp-address=8
      TA_RRR_RoadSideBoundaries_RA6: tp-address=7
    25 x can tp channel:
      TPC_RFC_Diag_Func: channel-id=1
      TPC_RFC_Diag_Phy: channel-id=0
      TPC_RFC_FieldDataCollection: channel-id=3
      TPC_RFC_Object: channel-id=2
      TPC_RFC_RoadSideBoundaries: channel-id=4
      TPC_RFL_Diag_Func: channel-id=1
      TPC_RFL_Diag_Phy: channel-id=0
      TPC_RFL_FieldDataCollection: channel-id=3
      TPC_RFL_Object: channel-id=2
      TPC_RFL_RoadSideBoundaries: channel-id=4
      TPC_RFR_Diag_Func: channel-id=1
      TPC_RFR_Diag_Phy: channel-id=0
      TPC_RFR_FieldDataCollection: channel-id=3
      TPC_RFR_Object: channel-id=2
      TPC_RFR_RoadSideBoundaries: channel-id=4
      TPC_RRL_Diag_Func: channel-id=1
      TPC_RRL_Diag_Phy: channel-id=0
      TPC_RRL_FieldDataCollection: channel-id=3
      TPC_RRL_Object: channel-id=2
      TPC_RRL_RoadSideBoundaries: channel-id=4
      TPC_RRR_Diag_Func: channel-id=1
      TPC_RRR_Diag_Phy: channel-id=0
      TPC_RRR_FieldDataCollection: channel-id=3
      TPC_RRR_Object: channel-id=2
      TPC_RRR_RoadSideBoundaries: channel-id=4
    can-tp-connection addressing-format=STANDARD, can-tp-channel=TPC_RFC_Diag_Phy, cancellation=true, data-pdu=Diag_RFC_TesterPhysicalReqResp_TpRx, flow-control-pdu=Diag_RFC_TesterPhysicalReqResp_TpTx, max-block-size=0, padding-activation=true, receiver=TPN_RFC_DiagRA6, ta-type=PHYSICAL, timeout-br=0.1, timeout-bs=1.4, timeout-cr=1.4, timeout-cs=0.2, tp-sdu=Diag_RFC_TesterPhysicalReq_Dcm, transmitter=TPN_RFC_DiagTesterPhys:
      ident TPCN_Diag_Phy_Req
    can-tp-connection addressing-format=STANDARD, can-tp-channel=TPC_RFC_Diag_Func, cancellation=true, data-pdu=Diag_RFC_TesterFunctionalReq_Tp, max-block-size=0, multicast=TA_RFC_DiagTester_Func, padding-activation=true, receiver=TPN_RFC_DiagRA6, ta-type=FUNCTIONAL, timeout-br=0.1, timeout-bs=1.4, timeout-cr=1.4, timeout-cs=0.2, tp-sdu=Diag_RFC_TesterFunctionalReq_Dcm, transmitter=TPN_RFC_DiagTesterFunc:
      ident TPCN_Diag_Func
    can-tp-connection addressing-format=STANDARD, can-tp-channel=TPC_RFC_Diag_Phy, cancellation=true, data-pdu=Diag_RFC_TesterPhysicalReqResp_TpTx, flow-control-pdu=Diag_RFC_TesterPhysicalReqResp_TpRx, max-block-size=0, padding-activation=true, receiver=TPN_RFC_DiagTesterPhys, ta-type=PHYSICAL, timeout-br=0.1, timeout-bs=1.4, timeout-cr=1.4, timeout-cs=0.2, tp-sdu=Diag_RFC_TesterPhysicalResp_Dcm, transmitter=TPN_RFC_DiagRA6:
      ident TPCN_Diag_Phy_Resp
    can-tp-connection addressing-format=STANDARD, can-tp-channel=TPC_RFC_Object, cancellation=true, data-pdu=RFC_Object_TpData, flow-control-pdu=RFC_Object_TpFC, max-block-size=0, padding-activation=true, receiver=TPN_RFC_Object_CentralEcu, ta-type=PHYSICAL, timeout-br=0.1, timeout-bs=1.0, timeout-cr=1.0, timeout-cs=0.2, tp-sdu=RFC_Object, transmitter=TPN_RFC_Object_RA6:
      ident TPCN_RFC_Object
    can-tp-connection addressing-format=STANDARD, can-tp-channel=TPC_RFC_FieldDataCollection, cancellation=true, data-pdu=RFC_FieldDataCollection_TpData, flow-control-pdu=RFC_FieldDataCollection_TpFC, max-block-size=8, padding-activation=true, receiver=TPN_RFC_FieldDataCollection_CentralEcu, ta-type=PHYSICAL, timeout-br=0.1, timeout-bs=1.0, timeout-cr=1.0, timeout-cs=0.2, tp-sdu=RFC_FieldDataCollection, transmitter=TPN_RFC_FieldDataCollection_RA6:
      ident TPCN_RFC_FieldDataCollection
    can-tp-connection addressing-format=STANDARD, can-tp-channel=TPC_RFC_RoadSideBoundaries, cancellation=true, data-pdu=RFC_RoadSideBoundaries_TpData, flow-control-pdu=RFC_RoadSideBoundaries_TpFC, max-block-size=0, padding-activation=true, receiver=TPN_RFC_RoadSideBoundaries_CentralEcu, ta-type=PHYSICAL, timeout-br=0.1, timeout-bs=1.0, timeout-cr=1.0, timeout-cs=0.2, tp-sdu=RFC_RoadSideBoundaries, transmitter=TPN_RFC_RoadSideBoundaries_RA6:
      ident TPCN_RFC_RoadSideBoundaries
    can-tp-connection addressing-format=STANDARD, can-tp-channel=TPC_RFL_Diag_Phy, cancellation=true, data-pdu=Diag_RFL_TesterPhysicalReqResp_TpRx, flow-control-pdu=Diag_RFL_TesterPhysicalReqResp_TpTx, max-block-size=0, padding-activation=true, receiver=TPN_RFL_DiagRA6, ta-type=PHYSICAL, timeout-br=0.1, timeout-bs=1.4, timeout-cr=1.4, timeout-cs=0.2, tp-sdu=Diag_RFL_TesterPhysicalReq_Dcm, transmitter=TPN_RFL_DiagTesterPhys:
      ident TPCN_Diag_Phy_Req
    can-tp-connection addressing-format=STANDARD, can-tp-channel=TPC_RFL_Diag_Func, cancellation=true, data-pdu=Diag_RFL_TesterFunctionalReq_Tp, max-block-size=0, multicast=TA_RFL_DiagTester_Func, padding-activation=true, receiver=TPN_RFL_DiagRA6, ta-type=FUNCTIONAL, timeout-br=0.1, timeout-bs=1.4, timeout-cr=1.4, timeout-cs=0.2, tp-sdu=Diag_RFL_TesterFunctionalReq_Dcm, transmitter=TPN_RFL_DiagTesterFunc:
      ident TPCN_Diag_Func
    can-tp-connection addressing-format=STANDARD, can-tp-channel=TPC_RFL_Diag_Phy, cancellation=true, data-pdu=Diag_RFL_TesterPhysicalReqResp_TpTx, flow-control-pdu=Diag_RFL_TesterPhysicalReqResp_TpRx, max-block-size=0, padding-activation=true, receiver=TPN_RFL_DiagTesterPhys, ta-type=PHYSICAL, timeout-br=0.1, timeout-bs=1.4, timeout-cr=1.4, timeout-cs=0.2, tp-sdu=Diag_RFL_TesterPhysicalResp_Dcm, transmitter=TPN_RFL_DiagRA6:
      ident TPCN_Diag_Phy_Resp
    can-tp-connection addressing-format=STANDARD, can-tp-channel=TPC_RFL_Object, cancellation=true, data-pdu=RFL_Object_TpData, flow-control-pdu=RFL_Object_TpFC, max-block-size=0, padding-activation=true, receiver=TPN_RFL_Object_CentralEcu, ta-type=PHYSICAL, timeout-br=0.1, timeout-bs=1.0, timeout-cr=1.0, timeout-cs=0.2, tp-sdu=RFL_Object, transmitter=TPN_RFL_Object_RA6:
      ident TPCN_RFL_Object
    can-tp-connection addressing-format=STANDARD, can-tp-channel=TPC_RFL_FieldDataCollection, cancellation=true, data-pdu=RFL_FieldDataCollection_TpData, flow-control-pdu=RFL_FieldDataCollection_TpFC, max-block-size=8, padding-activation=true, receiver=TPN_RFL_FieldDataCollection_CentralEcu, ta-type=PHYSICAL, timeout-br=0.1, timeout-bs=1.0, timeout-cr=1.0, timeout-cs=0.2, tp-sdu=RFL_FieldDataCollection, transmitter=TPN_RFL_FieldDataCollection_RA6:
      ident TPCN_RFL_FieldDataCollection
    can-tp-connection addressing-format=STANDARD, can-tp-channel=TPC_RFL_RoadSideBoundaries, cancellation=true, data-pdu=RFL_RoadSideBoundaries_TpData, flow-control-pdu=RFL_RoadSideBoundaries_TpFC, max-block-size=0, padding-activation=true, receiver=TPN_RFL_RoadSideBoundaries_CentralEcu, ta-type=PHYSICAL, timeout-br=0.1, timeout-bs=1.0, timeout-cr=1.0, timeout-cs=0.2, tp-sdu=RFL_RoadSideBoundaries, transmitter=TPN_RFL_RoadSideBoundaries_RA6:
      ident TPCN_RFL_RoadSideBoundaries
    can-tp-connection addressing-format=STANDARD, can-tp-channel=TPC_RFR_Diag_Phy, cancellation=true, data-pdu=Diag_RFR_TesterPhysicalReqResp_TpRx, flow-control-pdu=Diag_RFR_TesterPhysicalReqResp_TpTx, max-block-size=0, padding-activation=true, receiver=TPN_RFR_DiagRA6, ta-type=PHYSICAL, timeout-br=0.1, timeout-bs=1.4, timeout-cr=1.4, timeout-cs=0.2, tp-sdu=Diag_RFR_TesterPhysicalReq_Dcm, transmitter=TPN_RFR_DiagTesterPhys:
      ident TPCN_Diag_Phy_Req
    can-tp-connection addressing-format=STANDARD, can-tp-channel=TPC_RFR_Diag_Func, cancellation=true, data-pdu=Diag_RFR_TesterFunctionalReq_Tp, max-block-size=0, multicast=TA_RFR_DiagTester_Func, padding-activation=true, receiver=TPN_RFR_DiagRA6, ta-type=FUNCTIONAL, timeout-br=0.1, timeout-bs=1.4, timeout-cr=1.4, timeout-cs=0.2, tp-sdu=Diag_RFR_TesterFunctionalReq_Dcm, transmitter=TPN_RFR_DiagTesterFunc:
      ident TPCN_Diag_Func
    can-tp-connection addressing-format=STANDARD, can-tp-channel=TPC_RFR_Diag_Phy, cancellation=true, data-pdu=Diag_RFR_TesterPhysicalReqResp_TpTx, flow-control-pdu=Diag_RFR_TesterPhysicalReqResp_TpRx, max-block-size=0, padding-activation=true, receiver=TPN_RFR_DiagTesterPhys, ta-type=PHYSICAL, timeout-br=0.1, timeout-bs=1.4, timeout-cr=1.4, timeout-cs=0.2, tp-sdu=Diag_RFR_TesterPhysicalResp_Dcm, transmitter=TPN_RFR_DiagRA6:
      ident TPCN_Diag_Phy_Resp
    can-tp-connection addressing-format=STANDARD, can-tp-channel=TPC_RFR_Object, cancellation=true, data-pdu=RFR_Object_TpData, flow-control-pdu=RFR_Object_TpFC, max-block-size=0, padding-activation=true, receiver=TPN_RFR_Object_CentralEcu, ta-type=PHYSICAL, timeout-br=0.1, timeout-bs=1.0, timeout-cr=1.0, timeout-cs=0.2, tp-sdu=RFR_Object, transmitter=TPN_RFR_Object_RA6:
      ident TPCN_RFR_Object
    can-tp-connection addressing-format=STANDARD, can-tp-channel=TPC_RFR_FieldDataCollection, cancellation=true, data-pdu=RFR_FieldDataCollection_TpData, flow-control-pdu=RFR_FieldDataCollection_TpFC, max-block-size=8, padding-activation=true, receiver=TPN_RFR_FieldDataCollection_CentralEcu, ta-type=PHYSICAL, timeout-br=0.1, timeout-bs=1.0, timeout-cr=1.0, timeout-cs=0.2, tp-sdu=RFR_FieldDataCollection, transmitter=TPN_RFR_FieldDataCollection_RA6:
      ident TPCN_RFR_FieldDataCollection
    can-tp-connection addressing-format=STANDARD, can-tp-channel=TPC_RFR_RoadSideBoundaries, cancellation=true, data-pdu=RFR_RoadSideBoundaries_TpData, flow-control-pdu=RFR_RoadSideBoundaries_TpFC, max-block-size=0, padding-activation=true, receiver=TPN_RFR_RoadSideBoundaries_CentralEcu, ta-type=PHYSICAL, timeout-br=0.1, timeout-bs=1.0, timeout-cr=1.0, timeout-cs=0.2, tp-sdu=RFR_RoadSideBoundaries, transmitter=TPN_RFR_RoadSideBoundaries_RA6:
      ident TPCN_RFR_RoadSideBoundaries
    can-tp-connection addressing-format=STANDARD, can-tp-channel=TPC_RRL_Diag_Phy, cancellation=true, data-pdu=Diag_RRL_TesterPhysicalReqResp_TpRx, flow-control-pdu=Diag_RRL_TesterPhysicalReqResp_TpTx, max-block-size=0, padding-activation=true, receiver=TPN_RRL_DiagRA6, ta-type=PHYSICAL, timeout-br=0.1, timeout-bs=1.4, timeout-cr=1.4, timeout-cs=0.2, tp-sdu=Diag_RRL_TesterPhysicalReq_Dcm, transmitter=TPN_RRL_DiagTesterPhys:
      ident TPCN_Diag_Phy_Req
    can-tp-connection addressing-format=STANDARD, can-tp-channel=TPC_RRL_Diag_Func, cancellation=true, data-pdu=Diag_RRL_TesterFunctionalReq_Tp, max-block-size=0, multicast=TA_RRL_DiagTester_Func, padding-activation=true, receiver=TPN_RRL_DiagRA6, ta-type=FUNCTIONAL, timeout-br=0.1, timeout-bs=1.4, timeout-cr=1.4, timeout-cs=0.2, tp-sdu=Diag_RRL_TesterFunctionalReq_Dcm, transmitter=TPN_RRL_DiagTesterFunc:
      ident TPCN_Diag_Func
    can-tp-connection addressing-format=STANDARD, can-tp-channel=TPC_RRL_Diag_Phy, cancellation=true, data-pdu=Diag_RRL_TesterPhysicalReqResp_TpTx, flow-control-pdu=Diag_RRL_TesterPhysicalReqResp_TpRx, max-block-size=0, padding-activation=true, receiver=TPN_RRL_DiagTesterPhys, ta-type=PHYSICAL, timeout-br=0.1, timeout-bs=1.4, timeout-cr=1.4, timeout-cs=0.2, tp-sdu=Diag_RRL_TesterPhysicalResp_Dcm, transmitter=TPN_RRL_DiagRA6:
      ident TPCN_Diag_Phy_Resp
    can-tp-connection addressing-format=STANDARD, can-tp-channel=TPC_RRL_Object, cancellation=true, data-pdu=RRL_Object_TpData, flow-control-pdu=RRL_Object_TpFC, max-block-size=0, padding-activation=true, receiver=TPN_RRL_Object_CentralEcu, ta-type=PHYSICAL, timeout-br=0.1, timeout-bs=1.0, timeout-cr=1.0, timeout-cs=0.2, tp-sdu=RRL_Object, transmitter=TPN_RRL_Object_RA6:
      ident TPCN_RRL_Object
    can-tp-connection addressing-format=STANDARD, can-tp-channel=TPC_RRL_FieldDataCollection, cancellation=true, data-pdu=RRL_FieldDataCollection_TpData, flow-control-pdu=RRL_FieldDataCollection_TpFC, max-block-size=8, padding-activation=true, receiver=TPN_RRL_FieldDataCollection_CentralEcu, ta-type=PHYSICAL, timeout-br=0.1, timeout-bs=1.0, timeout-cr=1.0, timeout-cs=0.2, tp-sdu=RRL_FieldDataCollection, transmitter=TPN_RRL_FieldDataCollection_RA6:
      ident TPCN_RRL_FieldDataCollection
    can-tp-connection addressing-format=STANDARD, can-tp-channel=TPC_RRL_RoadSideBoundaries, cancellation=true, data-pdu=RRL_RoadSideBoundaries_TpData, flow-control-pdu=RRL_RoadSideBoundaries_TpFC, max-block-size=0, padding-activation=true, receiver=TPN_RRL_RoadSideBoundaries_CentralEcu, ta-type=PHYSICAL, timeout-br=0.1, timeout-bs=1.0, timeout-cr=1.0, timeout-cs=0.2, tp-sdu=RRL_RoadSideBoundaries, transmitter=TPN_RRL_RoadSideBoundaries_RA6:
      ident TPCN_RRL_RoadSideBoundaries
    can-tp-connection addressing-format=STANDARD, can-tp-channel=TPC_RRR_Diag_Phy, cancellation=true, data-pdu=Diag_RRR_TesterPhysicalReqResp_TpRx, flow-control-pdu=Diag_RRR_TesterPhysicalReqResp_TpTx, max-block-size=0, padding-activation=true, receiver=TPN_RRR_DiagRA6, ta-type=PHYSICAL, timeout-br=0.1, timeout-bs=1.4, timeout-cr=1.4, timeout-cs=0.2, tp-sdu=Diag_RRR_TesterPhysicalReq_Dcm, transmitter=TPN_RRR_DiagTesterPhys:
      ident TPCN_Diag_Phy_Req
    can-tp-connection addressing-format=STANDARD, can-tp-channel=TPC_RRR_Diag_Func, cancellation=true, data-pdu=Diag_RRR_TesterFunctionalReq_Tp, max-block-size=0, multicast=TA_RRR_DiagTester_Func, padding-activation=true, receiver=TPN_RRR_DiagRA6, ta-type=FUNCTIONAL, timeout-br=0.1, timeout-bs=1.4, timeout-cr=1.4, timeout-cs=0.2, tp-sdu=Diag_RRR_TesterFunctionalReq_Dcm, transmitter=TPN_RRR_DiagTesterFunc:
      ident TPCN_Diag_Func
    can-tp-connection addressing-format=STANDARD, can-tp-channel=TPC_RRR_Diag_Phy, cancellation=true, data-pdu=Diag_RRR_TesterPhysicalReqResp_TpTx, flow-control-pdu=Diag_RRR_TesterPhysicalReqResp_TpRx, max-block-size=0, padding-activation=true, receiver=TPN_RRR_DiagTesterPhys, ta-type=PHYSICAL, timeout-br=0.1, timeout-bs=1.4, timeout-cr=1.4, timeout-cs=0.2, tp-sdu=Diag_RRR_TesterPhysicalResp_Dcm, transmitter=TPN_RRR_DiagRA6:
      ident TPCN_Diag_Phy_Resp
    can-tp-connection addressing-format=STANDARD, can-tp-channel=TPC_RRR_Object, cancellation=true, data-pdu=RRR_Object_TpData, flow-control-pdu=RRR_Object_TpFC, max-block-size=0, padding-activation=true, receiver=TPN_RRR_Object_CentralEcu, ta-type=PHYSICAL, timeout-br=0.1, timeout-bs=1.0, timeout-cr=1.0, timeout-cs=0.2, tp-sdu=RRR_Object, transmitter=TPN_RRR_Object_RA6:
      ident TPCN_RRR_Object
    can-tp-connection addressing-format=STANDARD, can-tp-channel=TPC_RRR_FieldDataCollection, cancellation=true, data-pdu=RRR_FieldDataCollection_TpData, flow-control-pdu=RRR_FieldDataCollection_TpFC, max-block-size=8, padding-activation=true, receiver=TPN_RRR_FieldDataCollection_CentralEcu, ta-type=PHYSICAL, timeout-br=0.1, timeout-bs=1.0, timeout-cr=1.0, timeout-cs=0.2, tp-sdu=RRR_FieldDataCollection, transmitter=TPN_RRR_FieldDataCollection_RA6:
      ident TPCN_RRR_FieldDataCollection
    can-tp-connection addressing-format=STANDARD, can-tp-channel=TPC_RRR_RoadSideBoundaries, cancellation=true, data-pdu=RRR_RoadSideBoundaries_TpData, flow-control-pdu=RRR_RoadSideBoundaries_TpFC, max-block-size=0, padding-activation=true, receiver=TPN_RRR_RoadSideBoundaries_CentralEcu, ta-type=PHYSICAL, timeout-br=0.1, timeout-bs=1.0, timeout-cr=1.0, timeout-cs=0.2, tp-sdu=RRR_RoadSideBoundaries, transmitter=TPN_RRR_RoadSideBoundaries_RA6:
      ident TPCN_RRR_RoadSideBoundaries
    45 x can tp node:
      TPN_RFC_DiagRA6: connector=RA6_RFC/PF_RA6_CAN_Conn, max-fc-wait=0, st-min=0.01, timeout-ar=1.4, timeout-as=1.4, tp-address=TA_RFC_DiagRA6
      TPN_RFC_DiagTesterFunc: max-fc-wait=0, st-min=0.01, timeout-ar=1.4, timeout-as=1.4, tp-address=TA_RFC_DiagTester_Func
      TPN_RFC_DiagTesterPhys: max-fc-wait=0, st-min=0.01, timeout-ar=1.4, timeout-as=1.4, tp-address=TA_RFC_DiagTester_Phys
      TPN_RFC_FieldDataCollection_CentralEcu: max-fc-wait=15, st-min=0.05, timeout-ar=1.0, timeout-as=1.0, tp-address=TA_RFC_FieldDataCollection_CentralEcu
      TPN_RFC_FieldDataCollection_RA6: connector=RA6_RFC/PF_RA6_CAN_Conn, max-fc-wait=15, st-min=0.05, timeout-ar=1.0, timeout-as=1.0, tp-address=TA_RFC_FieldDataCollection_RA6
      TPN_RFC_Object_CentralEcu: max-fc-wait=15, st-min=0.0, timeout-ar=1.0, timeout-as=1.0, tp-address=TA_RFC_Object_CentralEcu
      TPN_RFC_Object_RA6: connector=RA6_RFC/PF_RA6_CAN_Conn, max-fc-wait=15, st-min=0.0, timeout-ar=1.0, timeout-as=1.0, tp-address=TA_RFC_Object_RA6
      TPN_RFC_RoadSideBoundaries_CentralEcu: max-fc-wait=15, st-min=0.0, timeout-ar=1.0, timeout-as=1.0, tp-address=TA_RFC_RoadSideBoundaries_CentralEcu
      TPN_RFC_RoadSideBoundaries_RA6: connector=RA6_RFC/PF_RA6_CAN_Conn, max-fc-wait=15, st-min=0.0, timeout-ar=1.0, timeout-as=1.0, tp-address=TA_RFC_RoadSideBoundaries_RA6
      TPN_RFL_DiagRA6: connector=RA6_RFL/PF_RA6_CAN_Conn, max-fc-wait=0, st-min=0.01, timeout-ar=1.4, timeout-as=1.4, tp-address=TA_RFL_DiagRA6
      TPN_RFL_DiagTesterFunc: max-fc-wait=0, st-min=0.01, timeout-ar=1.4, timeout-as=1.4, tp-address=TA_RFL_DiagTester_Func
      TPN_RFL_DiagTesterPhys: max-fc-wait=0, st-min=0.01, timeout-ar=1.4, timeout-as=1.4, tp-address=TA_RFL_DiagTester_Phys
      TPN_RFL_FieldDataCollection_CentralEcu: max-fc-wait=15, st-min=0.05, timeout-ar=1.0, timeout-as=1.0, tp-address=TA_RFL_FieldDataCollection_CentralEcu
      TPN_RFL_FieldDataCollection_RA6: connector=RA6_RFL/PF_RA6_CAN_Conn, max-fc-wait=15, st-min=0.05, timeout-ar=1.0, timeout-as=1.0, tp-address=TA_RFL_FieldDataCollection_RA6
      TPN_RFL_Object_CentralEcu: max-fc-wait=15, st-min=0.0, timeout-ar=1.0, timeout-as=1.0, tp-address=TA_RFL_Object_CentralEcu
      TPN_RFL_Object_RA6: connector=RA6_RFL/PF_RA6_CAN_Conn, max-fc-wait=15, st-min=0.0, timeout-ar=1.0, timeout-as=1.0, tp-address=TA_RFL_Object_RA6
      TPN_RFL_RoadSideBoundaries_CentralEcu: max-fc-wait=15, st-min=0.0, timeout-ar=1.0, timeout-as=1.0, tp-address=TA_RFL_RoadSideBoundaries_CentralEcu
      TPN_RFL_RoadSideBoundaries_RA6: connector=RA6_RFL/PF_RA6_CAN_Conn, max-fc-wait=15, st-min=0.0, timeout-ar=1.0, timeout-as=1.0, tp-address=TA_RFL_RoadSideBoundaries_RA6
      TPN_RFR_DiagRA6: connector=RA6_RFR/PF_RA6_CAN_Conn, max-fc-wait=0, st-min=0.01, timeout-ar=1.4, timeout-as=1.4, tp-address=TA_RFR_DiagRA6
      TPN_RFR_DiagTesterFunc: max-fc-wait=0, st-min=0.01, timeout-ar=1.4, timeout-as=1.4, tp-address=TA_RFR_DiagTester_Func
      TPN_RFR_DiagTesterPhys: max-fc-wait=0, st-min=0.01, timeout-ar=1.4, timeout-as=1.4, tp-address=TA_RFR_DiagTester_Phys
      TPN_RFR_FieldDataCollection_CentralEcu: max-fc-wait=15, st-min=0.05, timeout-ar=1.0, timeout-as=1.0, tp-address=TA_RFR_FieldDataCollection_CentralEcu
      TPN_RFR_FieldDataCollection_RA6: connector=RA6_RFR/PF_RA6_CAN_Conn, max-fc-wait=15, st-min=0.05, timeout-ar=1.0, timeout-as=1.0, tp-address=TA_RFR_FieldDataCollection_RA6
      TPN_RFR_Object_CentralEcu: max-fc-wait=15, st-min=0.0, timeout-ar=1.0, timeout-as=1.0, tp-address=TA_RFR_Object_CentralEcu
      TPN_RFR_Object_RA6: connector=RA6_RFR/PF_RA6_CAN_Conn, max-fc-wait=15, st-min=0.0, timeout-ar=1.0, timeout-as=1.0, tp-address=TA_RFR_Object_RA6
      TPN_RFR_RoadSideBoundaries_CentralEcu: max-fc-wait=15, st-min=0.0, timeout-ar=1.0, timeout-as=1.0, tp-address=TA_RFR_RoadSideBoundaries_CentralEcu
      TPN_RFR_RoadSideBoundaries_RA6: connector=RA6_RFR/PF_RA6_CAN_Conn, max-fc-wait=15, st-min=0.0, timeout-ar=1.0, timeout-as=1.0, tp-address=TA_RFR_RoadSideBoundaries_RA6
      TPN_RRL_DiagRA6: connector=RA6_RRL/PF_RA6_CAN_Conn, max-fc-wait=0, st-min=0.01, timeout-ar=1.4, timeout-as=1.4, tp-address=TA_RRL_DiagRA6
      TPN_RRL_DiagTesterFunc: max-fc-wait=0, st-min=0.01, timeout-ar=1.4, timeout-as=1.4, tp-address=TA_RRL_DiagTester_Func
      TPN_RRL_DiagTesterPhys: max-fc-wait=0, st-min=0.01, timeout-ar=1.4, timeout-as=1.4, tp-address=TA_RRL_DiagTester_Phys
      TPN_RRL_FieldDataCollection_CentralEcu: max-fc-wait=15, st-min=0.05, timeout-ar=1.0, timeout-as=1.0, tp-address=TA_RRL_FieldDataCollection_CentralEcu
      TPN_RRL_FieldDataCollection_RA6: connector=RA6_RRL/PF_RA6_CAN_Conn, max-fc-wait=15, st-min=0.05, timeout-ar=1.0, timeout-as=1.0, tp-address=TA_RRL_FieldDataCollection_RA6
      TPN_RRL_Object_CentralEcu: max-fc-wait=15, st-min=0.0, timeout-ar=1.0, timeout-as=1.0, tp-address=TA_RRL_Object_CentralEcu
      TPN_RRL_Object_RA6: connector=RA6_RRL/PF_RA6_CAN_Conn, max-fc-wait=15, st-min=0.0, timeout-ar=1.0, timeout-as=1.0, tp-address=TA_RRL_Object_RA6
      TPN_RRL_RoadSideBoundaries_CentralEcu: max-fc-wait=15, st-min=0.0, timeout-ar=1.0, timeout-as=1.0, tp-address=TA_RRL_RoadSideBoundaries_CentralEcu
      TPN_RRL_RoadSideBoundaries_RA6: connector=RA6_RRL/PF_RA6_CAN_Conn, max-fc-wait=15, st-min=0.0, timeout-ar=1.0, timeout-as=1.0, tp-address=TA_RRL_RoadSideBoundaries_RA6
      TPN_RRR_DiagRA6: connector=RA6_RRR/PF_RA6_CAN_Conn, max-fc-wait=0, st-min=0.01, timeout-ar=1.4, timeout-as=1.4, tp-address=TA_RRR_DiagRA6
      TPN_RRR_DiagTesterFunc: max-fc-wait=0, st-min=0.01, timeout-ar=1.4, timeout-as=1.4, tp-address=TA_RRR_DiagTester_Func
      TPN_RRR_DiagTesterPhys: max-fc-wait=0, st-min=0.01, timeout-ar=1.4, timeout-as=1.4, tp-address=TA_RRR_DiagTester_Phys
      TPN_RRR_FieldDataCollection_CentralEcu: max-fc-wait=15, st-min=0.05, timeout-ar=1.0, timeout-as=1.0, tp-address=TA_RRR_FieldDataCollection_CentralEcu
      TPN_RRR_FieldDataCollection_RA6: connector=RA6_RRR/PF_RA6_CAN_Conn, max-fc-wait=15, st-min=0.05, timeout-ar=1.0, timeout-as=1.0, tp-address=TA_RRR_FieldDataCollection_RA6
      TPN_RRR_Object_CentralEcu: max-fc-wait=15, st-min=0.0, timeout-ar=1.0, timeout-as=1.0, tp-address=TA_RRR_Object_CentralEcu
      TPN_RRR_Object_RA6: connector=RA6_RRR/PF_RA6_CAN_Conn, max-fc-wait=15, st-min=0.0, timeout-ar=1.0, timeout-as=1.0, tp-address=TA_RRR_Object_RA6
      TPN_RRR_RoadSideBoundaries_CentralEcu: max-fc-wait=15, st-min=0.0, timeout-ar=1.0, timeout-as=1.0, tp-address=TA_RRR_RoadSideBoundaries_CentralEcu
      TPN_RRR_RoadSideBoundaries_RA6: connector=RA6_RRR/PF_RA6_CAN_Conn, max-fc-wait=15, st-min=0.0, timeout-ar=1.0, timeout-as=1.0, tp-address=TA_RRR_RoadSideBoundaries_RA6
package /RA6/Pkg_Cluster
  can cluster PF_RA6_SGU: baudrate=500000, protocol-name=CAN, protocol-version=2.0, can-fd-baudrate=2000000
    can physical channel PF_RA6
      comm-connectors:
        RA6_RFC/PF_RA6_CAN_Conn
        RA6_RFL/PF_RA6_CAN_Conn
        RA6_RFR/PF_RA6_CAN_Conn
        RA6_RRL/PF_RA6_CAN_Conn
        RA6_RRR/PF_RA6_CAN_Conn
      frame Diag_RFC_TesterFunctionalReq_Tp: id 0x78A, to RA6_RFC, frame-length=64, can-addressing-mode=STANDARD, can-fd-frame-support=true, can-frame-rx-behavior=CAN-FD, can-frame-tx-behavior=CAN-FD  # Transport Frame for Diagnostic Functional Request
        n pdu Diag_RFC_TesterFunctionalReq_Tp: length=64  # Transport Pdu (N-Pdu) for Functional Request
      frame Diag_RFC_TesterPhysicalReqResp_TpRx: id 0x788, to RA6_RFC, frame-length=64, can-addressing-mode=STANDARD, can-fd-frame-support=true, can-frame-rx-behavior=CAN-FD, can-frame-tx-behavior=CAN-FD  # Transport Frame for Physical Request and Response in RX direction
        n pdu Diag_RFC_TesterPhysicalReqResp_TpRx: length=64  # Transport Pdu (N-Pdu) for Physical Request and Response in RX direction
      frame Diag_RFC_TesterPhysicalReqResp_TpTx: id 0x789, from RA6_RFC, frame-length=64, can-addressing-mode=STANDARD, can-fd-frame-support=true, can-frame-rx-behavior=CAN-FD, can-frame-tx-behavior=CAN-FD  # Transport Frame for Physical Request and Response in TX direction
        n pdu Diag_RFC_TesterPhysicalReqResp_TpTx: length=64  # Transport Pdu (N-Pdu) for Physical Request and Response in TX direction
      frame Diag_RFL_TesterFunctionalReq_Tp: id 0x78D, to RA6_RFL, frame-length=64, can-addressing-mode=STANDARD, can-fd-frame-support=true, can-frame-rx-behavior=CAN-FD, can-frame-tx-behavior=CAN-FD  # Transport Frame for Diagnostic Functional Request
        n pdu Diag_RFL_TesterFunctionalReq_Tp: length=64  # Transport Pdu (N-Pdu) for Functional Request
      frame Diag_RFL_TesterPhysicalReqResp_TpRx: id 0x78B, to RA6_RFL, frame-length=64, can-addressing-mode=STANDARD, can-fd-frame-support=true, can-frame-rx-behavior=CAN-FD, can-frame-tx-behavior=CAN-FD  # Transport Frame for Physical Request and Response in RX direction
        n pdu Diag_RFL_TesterPhysicalReqResp_TpRx: length=64  # Transport Pdu (N-Pdu) for Physical Request and Response in RX direction
      frame Diag_RFL_TesterPhysicalReqResp_TpTx: id 0x78C, from RA6_RFL, frame-length=64, can-addressing-mode=STANDARD, can-fd-frame-support=true, can-frame-rx-behavior=CAN-FD, can-frame-tx-behavior=CAN-FD  # Transport Frame for Physical Request and Response in TX direction
        n pdu Diag_RFL_TesterPhysicalReqResp_TpTx: length=64  # Transport Pdu (N-Pdu) for Physical Request and Response in TX direction
      frame Diag_RFR_TesterFunctionalReq_Tp: id 0x790, to RA6_RFR, frame-length=64, can-addressing-mode=STANDARD, can-fd-frame-support=true, can-frame-rx-behavior=CAN-FD, can-frame-tx-behavior=CAN-FD  # Transport Frame for Diagnostic Functional Request
        n pdu Diag_RFR_TesterFunctionalReq_Tp: length=64  # Transport Pdu (N-Pdu) for Functional Request
      frame Diag_RFR_TesterPhysicalReqResp_TpRx: id 0x78E, to RA6_RFR, frame-length=64, can-addressing-mode=STANDARD, can-fd-frame-support=true, can-frame-rx-behavior=CAN-FD, can-frame-tx-behavior=CAN-FD  # Transport Frame for Physical Request and Response in RX direction
        n pdu Diag_RFR_TesterPhysicalReqResp_TpRx: length=64  # Transport Pdu (N-Pdu) for Physical Request and Response in RX direction
      frame Diag_RFR_TesterPhysicalReqResp_TpTx: id 0x78F, from RA6_RFR, frame-length=64, can-addressing-mode=STANDARD, can-fd-frame-support=true, can-frame-rx-behavior=CAN-FD, can-frame-tx-behavior=CAN-FD  # Transport Frame for Physical Request and Response in TX direction
        n pdu Diag_RFR_TesterPhysicalReqResp_TpTx: length=64  # Transport Pdu (N-Pdu) for Physical Request and Response in TX direction
      frame Diag_RRL_TesterFunctionalReq_Tp: id 0x793, to RA6_RRL, frame-length=64, can-addressing-mode=STANDARD, can-fd-frame-support=true, can-frame-rx-behavior=CAN-FD, can-frame-tx-behavior=CAN-FD  # Transport Frame for Diagnostic Functional Request
        n pdu Diag_RRL_TesterFunctionalReq_Tp: length=64  # Transport Pdu (N-Pdu) for Functional Request
      frame Diag_RRL_TesterPhysicalReqResp_TpRx: id 0x791, to RA6_RRL, frame-length=64, can-addressing-mode=STANDARD, can-fd-frame-support=true, can-frame-rx-behavior=CAN-FD, can-frame-tx-behavior=CAN-FD  # Transport Frame for Physical Request and Response in RX direction
        n pdu Diag_RRL_TesterPhysicalReqResp_TpRx: length=64  # Transport Pdu (N-Pdu) for Physical Request and Response in RX direction
      frame Diag_RRL_TesterPhysicalReqResp_TpTx: id 0x792, from RA6_RRL, frame-length=64, can-addressing-mode=STANDARD, can-fd-frame-support=true, can-frame-rx-behavior=CAN-FD, can-frame-tx-behavior=CAN-FD  # Transport Frame for Physical Request and Response in TX direction
        n pdu Diag_RRL_TesterPhysicalReqResp_TpTx: length=64  # Transport Pdu (N-Pdu) for Physical Request and Response in TX direction
      frame Diag_RRR_TesterFunctionalReq_Tp: id 0x796, to RA6_RRR, frame-length=64, can-addressing-mode=STANDARD, can-fd-frame-support=true, can-frame-rx-behavior=CAN-FD, can-frame-tx-behavior=CAN-FD  # Transport Frame for Diagnostic Functional Request
        n pdu Diag_RRR_TesterFunctionalReq_Tp: length=64  # Transport Pdu (N-Pdu) for Functional Request
      frame Diag_RRR_TesterPhysicalReqResp_TpRx: id 0x794, to RA6_RRR, frame-length=64, can-addressing-mode=STANDARD, can-fd-frame-support=true, can-frame-rx-behavior=CAN-FD, can-frame-tx-behavior=CAN-FD  # Transport Frame for Physical Request and Response in RX direction
        n pdu Diag_RRR_TesterPhysicalReqResp_TpRx: length=64  # Transport Pdu (N-Pdu) for Physical Request and Response in RX direction
      frame Diag_RRR_TesterPhysicalReqResp_TpTx: id 0x795, from RA6_RRR, frame-length=64, can-addressing-mode=STANDARD, can-fd-frame-support=true, can-frame-rx-behavior=CAN-FD, can-frame-tx-behavior=CAN-FD  # Transport Frame for Physical Request and Response in TX direction
        n pdu Diag_RRR_TesterPhysicalReqResp_TpTx: length=64  # Transport Pdu (N-Pdu) for Physical Request and Response in TX direction
      frame RFC_CornerFunctions: id 0x18, from RA6_RFC, frame-length=12, can-addressing-mode=STANDARD, can-fd-frame-support=true, can-frame-rx-behavior=CAN-FD, can-frame-tx-behavior=CAN-FD  # Radar Corner Functions Message
        pdu RFC_CornerFunctions: length=12, transmission-mode-true-timing=cyclic-timing={time-offset=0.0, time-period=0.05}, unused-bit-pattern=0  # Radar Corner Functions Message
          signal RFC_CF_AEx_revEgoBrakingStatus: start 68, 3 bit, little-endian, data-type-policy=OVERRIDE, i-signal-type=PRIMITIVE, base-type=uint8, compu {0=PASSIVE, 1=ACTIVE, 2=DISABLED, 3=FAILURE, 4=RESERVED, 5=RESERVED, 6=RESERVED, 7=SNA}  # #l_AEx_revEgoBraking_Status: AEx revEgoLongTgtCross braking subfunction's status output of rear corner radar. enumeration value: * 0 - passive * 1 - active * 2 - disabled * 3 - failure * 4,5,6 - reserved * 7 - SNA (signal not available).
          signal RFC_CF_AEx_revEgoWarnStatus: start 60, 3 bit, little-endian, data-type-policy=OVERRIDE, i-signal-type=PRIMITIVE, base-type=uint8, compu {0=PASSIVE, 1=ACTIVE, 2=DISABLED, 3=FAILURE, 4=RESERVED, 5=RESERVED, 6=RESERVED, 7=SNA}  # #l_AEx_revEgoWarning_Status: AEx revEgoLongTgtCross warning subfunction's status output of rear corner radar. enumeration value: * 0 - passive * 1 - active * 2 - disabled * 3 - failure * 4,5,6 - reserved * 7 - SNA (signal not available).
          signal RFC_CF_AEx_revEgo_BrakeRequest: start 76, 2 bit, little-endian, data-type-policy=OVERRIDE, i-signal-type=PRIMITIVE, base-type=uint8, compu {0=NO_BRAKE, 1=BRAKE, 2=RESERVED, 3=SNA}  # #l_AEx_revEgo_BrakeRequest: AEx revEgoLongTgtCross brake output of rear corner radar. enumeration value: * 0 - no brake * 1 - brake * 2 - reserved * 3 - SNA (signal not available).
          signal RFC_CF_AEx_revEgo_TargetDec: start 78, 5 bit, little-endian, data-type-policy=OVERRIDE, i-signal-type=PRIMITIVE, init-value=NumericalValueSpecification:31, base-type=uint8, compu {phys=raw*0.5 for raw 0..2; unit meter_per_squareseconds}  # #l_AEx_revEgo_TargetDeceleration: AEx revEgoLongTgtCross target deceleration output of rear corner radar.
          signal RFC_CF_AEx_revEgo_WarningLevel: start 58, 2 bit, little-endian, data-type-policy=OVERRIDE, i-signal-type=PRIMITIVE, base-type=uint8, compu {0=NO_WARN, 1=VISUAL_WARNING, 2=INCREASED_WARNING, 3=SNA}  # #l_AEx_revEgo_WarningLevel: AEx revEgoLongTgtCross warning level of rear corner sensor. enumeration value: * 0 - no warn * 1 - visual warning * 2 - increased warning (blinking, or audio) * 3 - SNA (signal not available).
          signal RFC_CF_BsdLca_Status: start 26, 3 bit, little-endian, data-type-policy=OVERRIDE, i-signal-type=PRIMITIVE, base-type=uint8, compu {0=PASSIVE, 1=ACTIVE, 2=DEACTIVATED, 3=FAILURE, 4=RESERVED, 5=RESERVED, 6=RESERVED, 7=SNA}  # #l_BSD_LCA_Status: BSD/LCA function status of rear right corner sensor. enumeration value: * 0 - passive * 1 - active * 2 - disabled * 3 - failure * 4,5,6 - reserved * 7 - SNA (signal not available)
          signal RFC_CF_BsdLca_WarningLevel: start 24, 2 bit, little-endian, data-type-policy=OVERRIDE, i-signal-type=PRIMITIVE, base-type=uint8, compu {0=NO_WARN, 1=VISUAL_WARNING, 2=INCREASED_WARNING, 3=SNA}  # #l_BSD_LCA_WarningLevel: BSD/LCA warning level of rear corner sensor. enumeration value: * 0 - no warn * 1 - visual warning * 2 - increased warning (blinking, or audio) * 3 - SNA (signal not available)
          signal RFC_CF_CRC: start 0, 16 bit, little-endian, data-type-policy=OVERRIDE, i-signal-type=PRIMITIVE, base-type=uint16, compu {identical}  # CRC - Autosar E2E Profile 5 - Data ID : 0x2202"
          signal RFC_CF_DOx_PrevStatus: start 50, 3 bit, little-endian, data-type-policy=OVERRIDE, i-signal-type=PRIMITIVE, base-type=uint8, compu {0=PASSIVE, 1=ACTIVE, 2=DEACTIVATED, 3=FAILURE, 4=RESERVED, 5=RESERVED, 6=RESERVED, 7=SNA}  # #l_DOx_Prevention_Status: DOx prevention subfunction status of rear right corner sensor. enumeration value: * 0 - passive * 1 - active * 2 - disabled * 3 - failure.
          signal RFC_CF_DOx_WarnStatus: start 42, 3 bit, little-endian, data-type-policy=OVERRIDE, i-signal-type=PRIMITIVE, base-type=uint8, compu {0=PASSIVE, 1=ACTIVE, 2=DEACTIVATED, 3=FAILURE, 4=RESERVED, 5=RESERVED, 6=RESERVED, 7=SNA}  # #l_DOx_Warning_Status: DOx warning subfunction status of rear corner sensor. enumeration value: * 0 - passive * 1 - active * 2 - disabled * 3 - failure.
          signal RFC_CF_DOx_WarningLevel: start 34, 3 bit, little-endian, data-type-policy=OVERRIDE, i-signal-type=PRIMITIVE, base-type=uint8, compu {0=NO_WARN, 1=VISUAL_WARNING, 2=INCREASED_WARNING, 3=DOORLOCK_REQUEST, 4=RESERVED, 5=RESERVED, 6=RESERVED, 7=SNA}  # #l_DOx_WarningLevel: DOx warning level of rear corner sensor. enumeration value: * 0 - no warn * 1 - visual warning * 2 - increased warning (blinking, or audio) * 3 - door lock request.
          signal RFC_CF_SQC: start 16, 8 bit, little-endian, data-type-policy=OVERRIDE, i-signal-type=PRIMITIVE, base-type=uint8, compu {identical}  # Alive counter - Autosar E2E Profile 5"
          mapping RFC_CornerFunctions: i-signal-group=RFC_CornerFunctions
      frame RFC_FieldDataCollection_TpData: id 0x770, from RA6_RFC, frame-length=64, can-addressing-mode=STANDARD, can-fd-frame-support=true, can-frame-rx-behavior=CAN-FD, can-frame-tx-behavior=CAN-FD  # Frame for Data transmission of FieldData
        n pdu RFC_FieldDataCollection_TpData: length=64  # NPdu for Data transmission of FieldData
      frame RFC_FieldDataCollection_TpFC: id 0x771, to RA6_RFC, frame-length=64, can-addressing-mode=STANDARD, can-fd-frame-support=true, can-frame-rx-behavior=CAN-FD, can-frame-tx-behavior=CAN-FD  # Frame for FlowControl transmission of FieldData
        n pdu RFC_FieldDataCollection_TpFC: length=64  # NPdu for FlowControl transmission of FieldData
      frame RFC_Object_TpData: id 0x18A, from RA6_RFC, frame-length=64, can-addressing-mode=STANDARD, can-fd-frame-support=true, can-frame-rx-behavior=CAN-FD, can-frame-tx-behavior=CAN-FD  # Frame for Data transmission of ObjectData
        n pdu RFC_Object_TpData: length=64  # NPdu for Data transmission of Objects
      frame RFC_Object_TpFC: id 0x18B, to RA6_RFC, frame-length=64, can-addressing-mode=STANDARD, can-fd-frame-support=true, can-frame-rx-behavior=CAN-FD, can-frame-tx-behavior=CAN-FD  # Frame for FlowControl transmission of ObjectData
        n pdu RFC_Object_TpFC: length=64  # NPdu for FlowControl transmission of Objects
      frame RFC_RoadSideBoundaries_TpData: id 0x18E, from RA6_RFC, frame-length=64, can-addressing-mode=STANDARD, can-fd-frame-support=true, can-frame-rx-behavior=CAN-FD, can-frame-tx-behavior=CAN-FD  # Frame for Data transmission of Roadside Boundaries
        n pdu RFC_RoadSideBoundaries_TpData: length=64  # NPdu for Data transmission of RoadSideBoundaries
      frame RFC_RoadSideBoundaries_TpFC: id 0x18F, to RA6_RFC, frame-length=64, can-addressing-mode=STANDARD, can-fd-frame-support=true, can-frame-rx-behavior=CAN-FD, can-frame-tx-behavior=CAN-FD  # Frame for FlowControl transmission of RoadSideBoundaries
        n pdu RFC_RoadSideBoundaries_TpFC: length=64  # NPdu for FlowControl transmission of RoadSideBoundaries
      frame RFC_SensorOutput: id 0x182, from RA6_RFC, frame-length=1, can-addressing-mode=STANDARD, can-fd-frame-support=true, can-frame-rx-behavior=CAN-FD, can-frame-tx-behavior=CAN-FD  # Radar Vehicle Output Message - Currently only used for Parameter status
        pdu RFC_SensorOutput: length=1, transmission-mode-true-timing=cyclic-timing={time-offset=0.0, time-period=0.02}, unused-bit-pattern=0  # Radar Vehicle Output Message - Currently only used for Parameter status
          signal RFC_Veh_SenOut_VehConfParamStatus: start 0, 2 bit, little-endian, data-type-policy=OVERRIDE, i-signal-type=PRIMITIVE, base-type=uint8, compu {0=NOT_AVAILABLE, 1=UPDATE_INPROGRESS, 2=AVAILABLE, 3=UPDATE_FAILED}  # #I_CCP_VehicleConfigParamStatus: Status of the availability of the vehicle configuration parameters.
      frame RFL_CornerFunctions: id 0x19, from RA6_RFL, frame-length=12, can-addressing-mode=STANDARD, can-fd-frame-support=true, can-frame-rx-behavior=CAN-FD, can-frame-tx-behavior=CAN-FD  # Radar Corner Functions Message
        pdu RFL_CornerFunctions: length=12, transmission-mode-true-timing=cyclic-timing={time-offset=0.0, time-period=0.05}, unused-bit-pattern=0  # Radar Corner Functions Message
          signal RFL_CF_AEx_revEgoBrakingStatus: start 68, 3 bit, little-endian, data-type-policy=OVERRIDE, i-signal-type=PRIMITIVE, base-type=uint8, compu {0=PASSIVE, 1=ACTIVE, 2=DISABLED, 3=FAILURE, 4=RESERVED, 5=RESERVED, 6=RESERVED, 7=SNA}  # #l_AEx_revEgoBraking_Status: AEx revEgoLongTgtCross braking subfunction's status output of rear corner radar. enumeration value: * 0 - passive * 1 - active * 2 - disabled * 3 - failure * 4,5,6 - reserved * 7 - SNA (signal not available).
          signal RFL_CF_AEx_revEgoWarnStatus: start 60, 3 bit, little-endian, data-type-policy=OVERRIDE, i-signal-type=PRIMITIVE, base-type=uint8, compu {0=PASSIVE, 1=ACTIVE, 2=DISABLED, 3=FAILURE, 4=RESERVED, 5=RESERVED, 6=RESERVED, 7=SNA}  # #l_AEx_revEgoWarning_Status: AEx revEgoLongTgtCross warning subfunction's status output of rear corner radar. enumeration value: * 0 - passive * 1 - active * 2 - disabled * 3 - failure * 4,5,6 - reserved * 7 - SNA (signal not available).
          signal RFL_CF_AEx_revEgo_BrakeRequest: start 76, 2 bit, little-endian, data-type-policy=OVERRIDE, i-signal-type=PRIMITIVE, base-type=uint8, compu {0=NO_BRAKE, 1=BRAKE, 2=RESERVED, 3=SNA}  # #l_AEx_revEgo_BrakeRequest: AEx revEgoLongTgtCross brake output of rear corner radar. enumeration value: * 0 - no brake * 1 - brake * 2 - reserved * 3 - SNA (signal not available).
          signal RFL_CF_AEx_revEgo_TargetDec: start 78, 5 bit, little-endian, data-type-policy=OVERRIDE, i-signal-type=PRIMITIVE, init-value=NumericalValueSpecification:31, base-type=uint8, compu {phys=raw*0.5 for raw 0..2; unit meter_per_squareseconds}  # #l_AEx_revEgo_TargetDeceleration: AEx revEgoLongTgtCross target deceleration output of rear corner radar.
          signal RFL_CF_AEx_revEgo_WarningLevel: start 58, 2 bit, little-endian, data-type-policy=OVERRIDE, i-signal-type=PRIMITIVE, base-type=uint8, compu {0=NO_WARN, 1=VISUAL_WARNING, 2=INCREASED_WARNING, 3=SNA}  # #l_AEx_revEgo_WarningLevel: AEx revEgoLongTgtCross warning level of rear corner sensor. enumeration value: * 0 - no warn * 1 - visual warning * 2 - increased warning (blinking, or audio) * 3 - SNA (signal not available).
          signal RFL_CF_BsdLca_Status: start 26, 3 bit, little-endian, data-type-policy=OVERRIDE, i-signal-type=PRIMITIVE, base-type=uint8, compu {0=PASSIVE, 1=ACTIVE, 2=DEACTIVATED, 3=FAILURE, 4=RESERVED, 5=RESERVED, 6=RESERVED, 7=SNA}  # #l_BSD_LCA_Status: BSD/LCA function status of rear right corner sensor. enumeration value: * 0 - passive * 1 - active * 2 - disabled * 3 - failure * 4,5,6 - reserved * 7 - SNA (signal not available)
          signal RFL_CF_BsdLca_WarningLevel: start 24, 2 bit, little-endian, data-type-policy=OVERRIDE, i-signal-type=PRIMITIVE, base-type=uint8, compu {0=NO_WARN, 1=VISUAL_WARNING, 2=INCREASED_WARNING, 3=SNA}  # #l_BSD_LCA_WarningLevel: BSD/LCA warning level of rear corner sensor. enumeration value: * 0 - no warn * 1 - visual warning * 2 - increased warning (blinking, or audio) * 3 - SNA (signal not available)
          signal RFL_CF_CRC: start 0, 16 bit, little-endian, data-type-policy=OVERRIDE, i-signal-type=PRIMITIVE, base-type=uint16, compu {identical}  # CRC - Autosar E2E Profile 5 - Data ID : 0x2202"
          signal RFL_CF_DOx_PrevStatus: start 50, 3 bit, little-endian, data-type-policy=OVERRIDE, i-signal-type=PRIMITIVE, base-type=uint8, compu {0=PASSIVE, 1=ACTIVE, 2=DEACTIVATED, 3=FAILURE, 4=RESERVED, 5=RESERVED, 6=RESERVED, 7=SNA}  # #l_DOx_Prevention_Status: DOx prevention subfunction status of rear right corner sensor. enumeration value: * 0 - passive * 1 - active * 2 - disabled * 3 - failure.
          signal RFL_CF_DOx_WarnStatus: start 42, 3 bit, little-endian, data-type-policy=OVERRIDE, i-signal-type=PRIMITIVE, base-type=uint8, compu {0=PASSIVE, 1=ACTIVE, 2=DEACTIVATED, 3=FAILURE, 4=RESERVED, 5=RESERVED, 6=RESERVED, 7=SNA}  # #l_DOx_Warning_Status: DOx warning subfunction status of rear corner sensor. enumeration value: * 0 - passive * 1 - active * 2 - disabled * 3 - failure.
          signal RFL_CF_DOx_WarningLevel: start 34, 3 bit, little-endian, data-type-policy=OVERRIDE, i-signal-type=PRIMITIVE, base-type=uint8, compu {0=NO_WARN, 1=VISUAL_WARNING, 2=INCREASED_WARNING, 3=DOORLOCK_REQUEST, 4=RESERVED, 5=RESERVED, 6=RESERVED, 7=SNA}  # #l_DOx_WarningLevel: DOx warning level of rear corner sensor. enumeration value: * 0 - no warn * 1 - visual warning * 2 - increased warning (blinking, or audio) * 3 - door lock request.
          signal RFL_CF_SQC: start 16, 8 bit, little-endian, data-type-policy=OVERRIDE, i-signal-type=PRIMITIVE, base-type=uint8, compu {identical}  # Alive counter - Autosar E2E Profile 5"
          mapping RFL_CornerFunctions: i-signal-group=RFL_CornerFunctions
      frame RFL_FieldDataCollection_TpData: id 0x772, from RA6_RFL, frame-length=64, can-addressing-mode=STANDARD, can-fd-frame-support=true, can-frame-rx-behavior=CAN-FD, can-frame-tx-behavior=CAN-FD  # Frame for Data transmission of FieldData
        n pdu RFL_FieldDataCollection_TpData: length=64  # NPdu for Data transmission of FieldData
      frame RFL_FieldDataCollection_TpFC: id 0x773, to RA6_RFL, frame-length=64, can-addressing-mode=STANDARD, can-fd-frame-support=true, can-frame-rx-behavior=CAN-FD, can-frame-tx-behavior=CAN-FD  # Frame for FlowControl transmission of FieldData
        n pdu RFL_FieldDataCollection_TpFC: length=64  # NPdu for FlowControl transmission of FieldData
      frame RFL_Object_TpData: id 0x38A, from RA6_RFL, frame-length=64, can-addressing-mode=STANDARD, can-fd-frame-support=true, can-frame-rx-behavior=CAN-FD, can-frame-tx-behavior=CAN-FD  # Frame for Data transmission of ObjectData
        n pdu RFL_Object_TpData: length=64  # NPdu for Data transmission of Objects
      frame RFL_Object_TpFC: id 0x38B, to RA6_RFL, frame-length=64, can-addressing-mode=STANDARD, can-fd-frame-support=true, can-frame-rx-behavior=CAN-FD, can-frame-tx-behavior=CAN-FD  # Frame for FlowControl transmission of ObjectData
        n pdu RFL_Object_TpFC: length=64  # NPdu for FlowControl transmission of Objects
      frame RFL_RoadSideBoundaries_TpData: id 0x38E, from RA6_RFL, frame-length=64, can-addressing-mode=STANDARD, can-fd-frame-support=true, can-frame-rx-behavior=CAN-FD, can-frame-tx-behavior=CAN-FD  # Frame for Data transmission of Roadside Boundaries
        n pdu RFL_RoadSideBoundaries_TpData: length=64  # NPdu for Data transmission of RoadSideBoundaries
      frame RFL_RoadSideBoundaries_TpFC: id 0x38F, to RA6_RFL, frame-length=64, can-addressing-mode=STANDARD, can-fd-frame-support=true, can-frame-rx-behavior=CAN-FD, can-frame-tx-behavior=CAN-FD  # Frame for FlowControl transmission of RoadSideBoundaries
        n pdu RFL_RoadSideBoundaries_TpFC: length=64  # NPdu for FlowControl transmission of RoadSideBoundaries
      frame RFL_SensorOutput: id 0x382, from RA6_RFL, frame-length=1, can-addressing-mode=STANDARD, can-fd-frame-support=true, can-frame-rx-behavior=CAN-FD, can-frame-tx-behavior=CAN-FD  # Radar Vehicle Output Message - Currently only used for Parameter status
        pdu RFL_SensorOutput: length=1, transmission-mode-true-timing=cyclic-timing={time-offset=0.0, time-period=0.02}, unused-bit-pattern=0  # Radar Vehicle Output Message - Currently only used for Parameter status
          signal RFL_Veh_SenOut_VehConfParamStatus: start 0, 2 bit, little-endian, data-type-policy=OVERRIDE, i-signal-type=PRIMITIVE, base-type=uint8, compu {0=NOT_AVAILABLE, 1=UPDATE_INPROGRESS, 2=AVAILABLE, 3=UPDATE_FAILED}  # #I_CCP_VehicleConfigParamStatus: Status of the availability of the vehicle configuration parameters.
      frame RFR_CornerFunctions: id 0x1A, from RA6_RFR, frame-length=12, can-addressing-mode=STANDARD, can-fd-frame-support=true, can-frame-rx-behavior=CAN-FD, can-frame-tx-behavior=CAN-FD  # Radar Corner Functions Message
        pdu RFR_CornerFunctions: length=12, transmission-mode-true-timing=cyclic-timing={time-offset=0.0, time-period=0.05}, unused-bit-pattern=0  # Radar Corner Functions Message
          signal RFR_CF_AEx_revEgoBrakingStatus: start 68, 3 bit, little-endian, data-type-policy=OVERRIDE, i-signal-type=PRIMITIVE, base-type=uint8, compu {0=PASSIVE, 1=ACTIVE, 2=DISABLED, 3=FAILURE, 4=RESERVED, 5=RESERVED, 6=RESERVED, 7=SNA}  # #l_AEx_revEgoBraking_Status: AEx revEgoLongTgtCross braking subfunction's status output of rear corner radar. enumeration value: * 0 - passive * 1 - active * 2 - disabled * 3 - failure * 4,5,6 - reserved * 7 - SNA (signal not available).
          signal RFR_CF_AEx_revEgoWarnStatus: start 60, 3 bit, little-endian, data-type-policy=OVERRIDE, i-signal-type=PRIMITIVE, base-type=uint8, compu {0=PASSIVE, 1=ACTIVE, 2=DISABLED, 3=FAILURE, 4=RESERVED, 5=RESERVED, 6=RESERVED, 7=SNA}  # #l_AEx_revEgoWarning_Status: AEx revEgoLongTgtCross warning subfunction's status output of rear corner radar. enumeration value: * 0 - passive * 1 - active * 2 - disabled * 3 - failure * 4,5,6 - reserved * 7 - SNA (signal not available).
          signal RFR_CF_AEx_revEgo_BrakeRequest: start 76, 2 bit, little-endian, data-type-policy=OVERRIDE, i-signal-type=PRIMITIVE, base-type=uint8, compu {0=NO_BRAKE, 1=BRAKE, 2=RESERVED, 3=SNA}  # #l_AEx_revEgo_BrakeRequest: AEx revEgoLongTgtCross brake output of rear corner radar. enumeration value: * 0 - no brake * 1 - brake * 2 - reserved * 3 - SNA (signal not available).
          signal RFR_CF_AEx_revEgo_TargetDec: start 78, 5 bit, little-endian, data-type-policy=OVERRIDE, i-signal-type=PRIMITIVE, init-value=NumericalValueSpecification:31, base-type=uint8, compu {phys=raw*0.5 for raw 0..2; unit meter_per_squareseconds}  # #l_AEx_revEgo_TargetDeceleration: AEx revEgoLongTgtCross target deceleration output of rear corner radar.
          signal RFR_CF_AEx_revEgo_WarningLevel: start 58, 2 bit, little-endian, data-type-policy=OVERRIDE, i-signal-type=PRIMITIVE, base-type=uint8, compu {0=NO_WARN, 1=VISUAL_WARNING, 2=INCREASED_WARNING, 3=SNA}  # #l_AEx_revEgo_WarningLevel: AEx revEgoLongTgtCross warning level of rear corner sensor. enumeration value: * 0 - no warn * 1 - visual warning * 2 - increased warning (blinking, or audio) * 3 - SNA (signal not available).
          signal RFR_CF_BsdLca_Status: start 26, 3 bit, little-endian, data-type-policy=OVERRIDE, i-signal-type=PRIMITIVE, base-type=uint8, compu {0=PASSIVE, 1=ACTIVE, 2=DEACTIVATED, 3=FAILURE, 4=RESERVED, 5=RESERVED, 6=RESERVED, 7=SNA}  # #l_BSD_LCA_Status: BSD/LCA function status of rear right corner sensor. enumeration value: * 0 - passive * 1 - active * 2 - disabled * 3 - failure * 4,5,6 - reserved * 7 - SNA (signal not available)
          signal RFR_CF_BsdLca_WarningLevel: start 24, 2 bit, little-endian, data-type-policy=OVERRIDE, i-signal-type=PRIMITIVE, base-type=uint8, compu {0=NO_WARN, 1=VISUAL_WARNING, 2=INCREASED_WARNING, 3=SNA}  # #l_BSD_LCA_WarningLevel: BSD/LCA warning level of rear corner sensor. enumeration value: * 0 - no warn * 1 - visual warning * 2 - increased warning (blinking, or audio) * 3 - SNA (signal not available)
          signal RFR_CF_CRC: start 0, 16 bit, little-endian, data-type-policy=OVERRIDE, i-signal-type=PRIMITIVE, base-type=uint16, compu {identical}  # CRC - Autosar E2E Profile 5 - Data ID : 0x2202"
          signal RFR_CF_DOx_PrevStatus: start 50, 3 bit, little-endian, data-type-policy=OVERRIDE, i-signal-type=PRIMITIVE, base-type=uint8, compu {0=PASSIVE, 1=ACTIVE, 2=DEACTIVATED, 3=FAILURE, 4=RESERVED, 5=RESERVED, 6=RESERVED, 7=SNA}  # #l_DOx_Prevention_Status: DOx prevention subfunction status of rear right corner sensor. enumeration value: * 0 - passive * 1 - active * 2 - disabled * 3 - failure.
          signal RFR_CF_DOx_WarnStatus: start 42, 3 bit, little-endian, data-type-policy=OVERRIDE, i-signal-type=PRIMITIVE, base-type=uint8, compu {0=PASSIVE, 1=ACTIVE, 2=DEACTIVATED, 3=FAILURE, 4=RESERVED, 5=RESERVED, 6=RESERVED, 7=SNA}  # #l_DOx_Warning_Status: DOx warning subfunction status of rear corner sensor. enumeration value: * 0 - passive * 1 - active * 2 - disabled * 3 - failure.
          signal RFR_CF_DOx_WarningLevel: start 34, 3 bit, little-endian, data-type-policy=OVERRIDE, i-signal-type=PRIMITIVE, base-type=uint8, compu {0=NO_WARN, 1=VISUAL_WARNING, 2=INCREASED_WARNING, 3=DOORLOCK_REQUEST, 4=RESERVED, 5=RESERVED, 6=RESERVED, 7=SNA}  # #l_DOx_WarningLevel: DOx warning level of rear corner sensor. enumeration value: * 0 - no warn * 1 - visual warning * 2 - increased warning (blinking, or audio) * 3 - door lock request.
          signal RFR_CF_SQC: start 16, 8 bit, little-endian, data-type-policy=OVERRIDE, i-signal-type=PRIMITIVE, base-type=uint8, compu {identical}  # Alive counter - Autosar E2E Profile 5"
          mapping RFR_CornerFunctions: i-signal-group=RFR_CornerFunctions
      frame RFR_FieldDataCollection_TpData: id 0x774, from RA6_RFR, frame-length=64, can-addressing-mode=STANDARD, can-fd-frame-support=true, can-frame-rx-behavior=CAN-FD, can-frame-tx-behavior=CAN-FD  # Frame for Data transmission of FieldData
        n pdu RFR_FieldDataCollection_TpData: length=64  # NPdu for Data transmission of FieldData
      frame RFR_FieldDataCollection_TpFC: id 0x775, to RA6_RFR, frame-length=64, can-addressing-mode=STANDARD, can-fd-frame-support=true, can-frame-rx-behavior=CAN-FD, can-frame-tx-behavior=CAN-FD  # Frame for FlowControl transmission of FieldData
        n pdu RFR_FieldDataCollection_TpFC: length=64  # NPdu for FlowControl transmission of FieldData
      frame RFR_Object_TpData: id 0x48A, from RA6_RFR, frame-length=64, can-addressing-mode=STANDARD, can-fd-frame-support=true, can-frame-rx-behavior=CAN-FD, can-frame-tx-behavior=CAN-FD  # Frame for Data transmission of ObjectData
        n pdu RFR_Object_TpData: length=64  # NPdu for Data transmission of Objects
      frame RFR_Object_TpFC: id 0x48B, to RA6_RFR, frame-length=64, can-addressing-mode=STANDARD, can-fd-frame-support=true, can-frame-rx-behavior=CAN-FD, can-frame-tx-behavior=CAN-FD  # Frame for FlowControl transmission of ObjectData
        n pdu RFR_Object_TpFC: length=64  # NPdu for FlowControl transmission of Objects
      frame RFR_RoadSideBoundaries_TpData: id 0x48E, from RA6_RFR, frame-length=64, can-addressing-mode=STANDARD, can-fd-frame-support=true, can-frame-rx-behavior=CAN-FD, can-frame-tx-behavior=CAN-FD  # Frame for Data transmission of Roadside Boundaries
        n pdu RFR_RoadSideBoundaries_TpData: length=64  # NPdu for Data transmission of RoadSideBoundaries
      frame RFR_RoadSideBoundaries_TpFC: id 0x48F, to RA6_RFR, frame-length=64, can-addressing-mode=STANDARD, can-fd-frame-support=true, can-frame-rx-behavior=CAN-FD, can-frame-tx-behavior=CAN-FD  # Frame for FlowControl transmission of RoadSideBoundaries
        n pdu RFR_RoadSideBoundaries_TpFC: length=64  # NPdu for FlowControl transmission of RoadSideBoundaries
      frame RFR_SensorOutput: id 0x482, from RA6_RFR, frame-length=1, can-addressing-mode=STANDARD, can-fd-frame-support=true, can-frame-rx-behavior=CAN-FD, can-frame-tx-behavior=CAN-FD  # Radar Vehicle Output Message - Currently only used for Parameter status
        pdu RFR_SensorOutput: length=1, transmission-mode-true-timing=cyclic-timing={time-offset=0.0, time-period=0.02}, unused-bit-pattern=0  # Radar Vehicle Output Message - Currently only used for Parameter status
          signal RFR_Veh_SenOut_VehConfParamStatus: start 0, 2 bit, little-endian, data-type-policy=OVERRIDE, i-signal-type=PRIMITIVE, base-type=uint8, compu {0=NOT_AVAILABLE, 1=UPDATE_INPROGRESS, 2=AVAILABLE, 3=UPDATE_FAILED}  # #I_CCP_VehicleConfigParamStatus: Status of the availability of the vehicle configuration parameters.
      frame RRL_CornerFunctions: id 0x1B, from RA6_RRL, frame-length=12, can-addressing-mode=STANDARD, can-fd-frame-support=true, can-frame-rx-behavior=CAN-FD, can-frame-tx-behavior=CAN-FD  # Radar Corner Functions Message
        pdu RRL_CornerFunctions: length=12, transmission-mode-true-timing=cyclic-timing={time-offset=0.0, time-period=0.05}, unused-bit-pattern=0  # Radar Corner Functions Message
          signal RRL_CF_AEx_revEgoBrakingStatus: start 68, 3 bit, little-endian, data-type-policy=OVERRIDE, i-signal-type=PRIMITIVE, base-type=uint8, compu {0=PASSIVE, 1=ACTIVE, 2=DISABLED, 3=FAILURE, 4=RESERVED, 5=RESERVED, 6=RESERVED, 7=SNA}  # #l_AEx_revEgoBraking_Status: AEx revEgoLongTgtCross braking subfunction's status output of rear corner radar. enumeration value: * 0 - passive * 1 - active * 2 - disabled * 3 - failure * 4,5,6 - reserved * 7 - SNA (signal not available).
          signal RRL_CF_AEx_revEgoWarnStatus: start 60, 3 bit, little-endian, data-type-policy=OVERRIDE, i-signal-type=PRIMITIVE, base-type=uint8, compu {0=PASSIVE, 1=ACTIVE, 2=DISABLED, 3=FAILURE, 4=RESERVED, 5=RESERVED, 6=RESERVED, 7=SNA}  # #l_AEx_revEgoWarning_Status: AEx revEgoLongTgtCross warning subfunction's status output of rear corner radar. enumeration value: * 0 - passive * 1 - active * 2 - disabled * 3 - failure * 4,5,6 - reserved * 7 - SNA (signal not available).
          signal RRL_CF_AEx_revEgo_BrakeRequest: start 76, 2 bit, little-endian, data-type-policy=OVERRIDE, i-signal-type=PRIMITIVE, base-type=uint8, compu {0=NO_BRAKE, 1=BRAKE, 2=RESERVED, 3=SNA}  # #l_AEx_revEgo_BrakeRequest: AEx revEgoLongTgtCross brake output of rear corner radar. enumeration value: * 0 - no brake * 1 - brake * 2 - reserved * 3 - SNA (signal not available).
          signal RRL_CF_AEx_revEgo_TargetDec: start 78, 5 bit, little-endian, data-type-policy=OVERRIDE, i-signal-type=PRIMITIVE, init-value=NumericalValueSpecification:31, base-type=uint8, compu {phys=raw*0.5 for raw 0..2; unit meter_per_squareseconds}  # #l_AEx_revEgo_TargetDeceleration: AEx revEgoLongTgtCross target deceleration output of rear corner radar.
          signal RRL_CF_AEx_revEgo_WarningLevel: start 58, 2 bit, little-endian, data-type-policy=OVERRIDE, i-signal-type=PRIMITIVE, base-type=uint8, compu {0=NO_WARN, 1=VISUAL_WARNING, 2=INCREASED_WARNING, 3=SNA}  # #l_AEx_revEgo_WarningLevel: AEx revEgoLongTgtCross warning level of rear corner sensor. enumeration value: * 0 - no warn * 1 - visual warning * 2 - increased warning (blinking, or audio) * 3 - SNA (signal not available).
          signal RRL_CF_BsdLca_Status: start 26, 3 bit, little-endian, data-type-policy=OVERRIDE, i-signal-type=PRIMITIVE, base-type=uint8, compu {0=PASSIVE, 1=ACTIVE, 2=DEACTIVATED, 3=FAILURE, 4=RESERVED, 5=RESERVED, 6=RESERVED, 7=SNA}  # #l_BSD_LCA_Status: BSD/LCA function status of rear right corner sensor. enumeration value: * 0 - passive * 1 - active * 2 - disabled * 3 - failure * 4,5,6 - reserved * 7 - SNA (signal not available)
          signal RRL_CF_BsdLca_WarningLevel: start 24, 2 bit, little-endian, data-type-policy=OVERRIDE, i-signal-type=PRIMITIVE, base-type=uint8, compu {0=NO_WARN, 1=VISUAL_WARNING, 2=INCREASED_WARNING, 3=SNA}  # #l_BSD_LCA_WarningLevel: BSD/LCA warning level of rear corner sensor. enumeration value: * 0 - no warn * 1 - visual warning * 2 - increased warning (blinking, or audio) * 3 - SNA (signal not available)
          signal RRL_CF_CRC: start 0, 16 bit, little-endian, data-type-policy=OVERRIDE, i-signal-type=PRIMITIVE, base-type=uint16, compu {identical}  # CRC - Autosar E2E Profile 5 - Data ID : 0x2202"
          signal RRL_CF_DOx_PrevStatus: start 50, 3 bit, little-endian, data-type-policy=OVERRIDE, i-signal-type=PRIMITIVE, base-type=uint8, compu {0=PASSIVE, 1=ACTIVE, 2=DEACTIVATED, 3=FAILURE, 4=RESERVED, 5=RESERVED, 6=RESERVED, 7=SNA}  # #l_DOx_Prevention_Status: DOx prevention subfunction status of rear right corner sensor. enumeration value: * 0 - passive * 1 - active * 2 - disabled * 3 - failure.
          signal RRL_CF_DOx_WarnStatus: start 42, 3 bit, little-endian, data-type-policy=OVERRIDE, i-signal-type=PRIMITIVE, base-type=uint8, compu {0=PASSIVE, 1=ACTIVE, 2=DEACTIVATED, 3=FAILURE, 4=RESERVED, 5=RESERVED, 6=RESERVED, 7=SNA}  # #l_DOx_Warning_Status: DOx warning subfunction status of rear corner sensor. enumeration value: * 0 - passive * 1 - active * 2 - disabled * 3 - failure.
          signal RRL_CF_DOx_WarningLevel: start 34, 3 bit, little-endian, data-type-policy=OVERRIDE, i-signal-type=PRIMITIVE, base-type=uint8, compu {0=NO_WARN, 1=VISUAL_WARNING, 2=INCREASED_WARNING, 3=DOORLOCK_REQUEST, 4=RESERVED, 5=RESERVED, 6=RESERVED, 7=SNA}  # #l_DOx_WarningLevel: DOx warning level of rear corner sensor. enumeration value: * 0 - no warn * 1 - visual warning * 2 - increased warning (blinking, or audio) * 3 - door lock request.
          signal RRL_CF_SQC: start 16, 8 bit, little-endian, data-type-policy=OVERRIDE, i-signal-type=PRIMITIVE, base-type=uint8, compu {identical}  # Alive counter - Autosar E2E Profile 5"
          mapping RRL_CornerFunctions: i-signal-group=RRL_CornerFunctions
      frame RRL_FieldDataCollection_TpData: id 0x776, from RA6_RRL, frame-length=64, can-addressing-mode=STANDARD, can-fd-frame-support=true, can-frame-rx-behavior=CAN-FD, can-frame-tx-behavior=CAN-FD  # Frame for Data transmission of FieldData
        n pdu RRL_FieldDataCollection_TpData: length=64  # NPdu for Data transmission of FieldData
      frame RRL_FieldDataCollection_TpFC: id 0x777, to RA6_RRL, frame-length=64, can-addressing-mode=STANDARD, can-fd-frame-support=true, can-frame-rx-behavior=CAN-FD, can-frame-tx-behavior=CAN-FD  # Frame for FlowControl transmission of FieldData
        n pdu RRL_FieldDataCollection_TpFC: length=64  # NPdu for FlowControl transmission of FieldData
      frame RRL_Object_TpData: id 0x58A, from RA6_RRL, frame-length=64, can-addressing-mode=STANDARD, can-fd-frame-support=true, can-frame-rx-behavior=CAN-FD, can-frame-tx-behavior=CAN-FD  # Frame for Data transmission of ObjectData
        n pdu RRL_Object_TpData: length=64  # NPdu for Data transmission of Objects
      frame RRL_Object_TpFC: id 0x58B, to RA6_RRL, frame-length=64, can-addressing-mode=STANDARD, can-fd-frame-support=true, can-frame-rx-behavior=CAN-FD, can-frame-tx-behavior=CAN-FD  # Frame for FlowControl transmission of ObjectData
        n pdu RRL_Object_TpFC: length=64  # NPdu for FlowControl transmission of Objects
      frame RRL_RoadSideBoundaries_TpData: id 0x58E, from RA6_RRL, frame-length=64, can-addressing-mode=STANDARD, can-fd-frame-support=true, can-frame-rx-behavior=CAN-FD, can-frame-tx-behavior=CAN-FD  # Frame for Data transmission of Roadside Boundaries
        n pdu RRL_RoadSideBoundaries_TpData: length=64  # NPdu for Data transmission of RoadSideBoundaries
      frame RRL_RoadSideBoundaries_TpFC: id 0x58F, to RA6_RRL, frame-length=64, can-addressing-mode=STANDARD, can-fd-frame-support=true, can-frame-rx-behavior=CAN-FD, can-frame-tx-behavior=CAN-FD  # Frame for FlowControl transmission of RoadSideBoundaries
        n pdu RRL_RoadSideBoundaries_TpFC: length=64  # NPdu for FlowControl transmission of RoadSideBoundaries
      frame RRL_SensorOutput: id 0x582, from RA6_RRL, frame-length=1, can-addressing-mode=STANDARD, can-fd-frame-support=true, can-frame-rx-behavior=CAN-FD, can-frame-tx-behavior=CAN-FD  # Radar Vehicle Output Message - Currently only used for Parameter status
        pdu RRL_SensorOutput: length=1, transmission-mode-true-timing=cyclic-timing={time-offset=0.0, time-period=0.02}, unused-bit-pattern=0  # Radar Vehicle Output Message - Currently only used for Parameter status
          signal RRL_Veh_SenOut_VehConfParamStatus: start 0, 2 bit, little-endian, data-type-policy=OVERRIDE, i-signal-type=PRIMITIVE, base-type=uint8, compu {0=NOT_AVAILABLE, 1=UPDATE_INPROGRESS, 2=AVAILABLE, 3=UPDATE_FAILED}  # #I_CCP_VehicleConfigParamStatus: Status of the availability of the vehicle configuration parameters.
      frame RRR_CornerFunctions: id 0x1C, from RA6_RRR, frame-length=12, can-addressing-mode=STANDARD, can-fd-frame-support=true, can-frame-rx-behavior=CAN-FD, can-frame-tx-behavior=CAN-FD  # Radar Corner Functions Message
        pdu RRR_CornerFunctions: length=12, transmission-mode-true-timing=cyclic-timing={time-offset=0.0, time-period=0.05}, unused-bit-pattern=0  # Radar Corner Functions Message
          signal RRR_CF_AEx_revEgoBrakingStatus: start 68, 3 bit, little-endian, data-type-policy=OVERRIDE, i-signal-type=PRIMITIVE, base-type=uint8, compu {0=PASSIVE, 1=ACTIVE, 2=DISABLED, 3=FAILURE, 4=RESERVED, 5=RESERVED, 6=RESERVED, 7=SNA}  # #l_AEx_revEgoBraking_Status: AEx revEgoLongTgtCross braking subfunction's status output of rear corner radar. enumeration value: * 0 - passive * 1 - active * 2 - disabled * 3 - failure * 4,5,6 - reserved * 7 - SNA (signal not available).
          signal RRR_CF_AEx_revEgoWarnStatus: start 60, 3 bit, little-endian, data-type-policy=OVERRIDE, i-signal-type=PRIMITIVE, base-type=uint8, compu {0=PASSIVE, 1=ACTIVE, 2=DISABLED, 3=FAILURE, 4=RESERVED, 5=RESERVED, 6=RESERVED, 7=SNA}  # #l_AEx_revEgoWarning_Status: AEx revEgoLongTgtCross warning subfunction's status output of rear corner radar. enumeration value: * 0 - passive * 1 - active * 2 - disabled * 3 - failure * 4,5,6 - reserved * 7 - SNA (signal not available).
          signal RRR_CF_AEx_revEgo_BrakeRequest: start 76, 2 bit, little-endian, data-type-policy=OVERRIDE, i-signal-type=PRIMITIVE, base-type=uint8, compu {0=NO_BRAKE, 1=BRAKE, 2=RESERVED, 3=SNA}  # #l_AEx_revEgo_BrakeRequest: AEx revEgoLongTgtCross brake output of rear corner radar. enumeration value: * 0 - no brake * 1 - brake * 2 - reserved * 3 - SNA (signal not available).
          signal RRR_CF_AEx_revEgo_TargetDec: start 78, 5 bit, little-endian, data-type-policy=OVERRIDE, i-signal-type=PRIMITIVE, init-value=NumericalValueSpecification:31, base-type=uint8, compu {phys=raw*0.5 for raw 0..2; unit meter_per_squareseconds}  # #l_AEx_revEgo_TargetDeceleration: AEx revEgoLongTgtCross target deceleration output of rear corner radar.
          signal RRR_CF_AEx_revEgo_WarningLevel: start 58, 2 bit, little-endian, data-type-policy=OVERRIDE, i-signal-type=PRIMITIVE, base-type=uint8, compu {0=NO_WARN, 1=VISUAL_WARNING, 2=INCREASED_WARNING, 3=SNA}  # #l_AEx_revEgo_WarningLevel: AEx revEgoLongTgtCross warning level of rear corner sensor. enumeration value: * 0 - no warn * 1 - visual warning * 2 - increased warning (blinking, or audio) * 3 - SNA (signal not available).
          signal RRR_CF_BsdLca_Status: start 26, 3 bit, little-endian, data-type-policy=OVERRIDE, i-signal-type=PRIMITIVE, base-type=uint8, compu {0=PASSIVE, 1=ACTIVE, 2=DEACTIVATED, 3=FAILURE, 4=RESERVED, 5=RESERVED, 6=RESERVED, 7=SNA}  # #l_BSD_LCA_Status: BSD/LCA function status of rear right corner sensor. enumeration value: * 0 - passive * 1 - active * 2 - disabled * 3 - failure * 4,5,6 - reserved * 7 - SNA (signal not available)
          signal RRR_CF_BsdLca_WarningLevel: start 24, 2 bit, little-endian, data-type-policy=OVERRIDE, i-signal-type=PRIMITIVE, base-type=uint8, compu {0=NO_WARN, 1=VISUAL_WARNING, 2=INCREASED_WARNING, 3=SNA}  # #l_BSD_LCA_WarningLevel: BSD/LCA warning level of rear corner sensor. enumeration value: * 0 - no warn * 1 - visual warning * 2 - increased warning (blinking, or audio) * 3 - SNA (signal not available)
          signal RRR_CF_CRC: start 0, 16 bit, little-endian, data-type-policy=OVERRIDE, i-signal-type=PRIMITIVE, base-type=uint16, compu {identical}  # CRC - Autosar E2E Profile 5 - Data ID : 0x2202"
          signal RRR_CF_DOx_PrevStatus: start 50, 3 bit, little-endian, data-type-policy=OVERRIDE, i-signal-type=PRIMITIVE, base-type=uint8, compu {0=PASSIVE, 1=ACTIVE, 2=DEACTIVATED, 3=FAILURE, 4=RESERVED, 5=RESERVED, 6=RESERVED, 7=SNA}  # #l_DOx_Prevention_Status: DOx prevention subfunction status of rear right corner sensor. enumeration value: * 0 - passive * 1 - active * 2 - disabled * 3 - failure.
          signal RRR_CF_DOx_WarnStatus: start 42, 3 bit, little-endian, data-type-policy=OVERRIDE, i-signal-type=PRIMITIVE, base-type=uint8, compu {0=PASSIVE, 1=ACTIVE, 2=DEACTIVATED, 3=FAILURE, 4=RESERVED, 5=RESERVED, 6=RESERVED, 7=SNA}  # #l_DOx_Warning_Status: DOx warning subfunction status of rear corner sensor. enumeration value: * 0 - passive * 1 - active * 2 - disabled * 3 - failure.
          signal RRR_CF_DOx_WarningLevel: start 34, 3 bit, little-endian, data-type-policy=OVERRIDE, i-signal-type=PRIMITIVE, base-type=uint8, compu {0=NO_WARN, 1=VISUAL_WARNING, 2=INCREASED_WARNING, 3=DOORLOCK_REQUEST, 4=RESERVED, 5=RESERVED, 6=RESERVED, 7=SNA}  # #l_DOx_WarningLevel: DOx warning level of rear corner sensor. enumeration value: * 0 - no warn * 1 - visual warning * 2 - increased warning (blinking, or audio) * 3 - door lock request.
          signal RRR_CF_SQC: start 16, 8 bit, little-endian, data-type-policy=OVERRIDE, i-signal-type=PRIMITIVE, base-type=uint8, compu {identical}  # Alive counter - Autosar E2E Profile 5"
          mapping RRR_CornerFunctions: i-signal-group=RRR_CornerFunctions
      frame RRR_FieldDataCollection_TpData: id 0x778, from RA6_RRR, frame-length=64, can-addressing-mode=STANDARD, can-fd-frame-support=true, can-frame-rx-behavior=CAN-FD, can-frame-tx-behavior=CAN-FD  # Frame for Data transmission of FieldData
        n pdu RRR_FieldDataCollection_TpData: length=64  # NPdu for Data transmission of FieldData
      frame RRR_FieldDataCollection_TpFC: id 0x779, to RA6_RRR, frame-length=64, can-addressing-mode=STANDARD, can-fd-frame-support=true, can-frame-rx-behavior=CAN-FD, can-frame-tx-behavior=CAN-FD  # Frame for FlowControl transmission of FieldData
        n pdu RRR_FieldDataCollection_TpFC: length=64  # NPdu for FlowControl transmission of FieldData
      frame RRR_Object_TpData: id 0x68A, from RA6_RRR, frame-length=64, can-addressing-mode=STANDARD, can-fd-frame-support=true, can-frame-rx-behavior=CAN-FD, can-frame-tx-behavior=CAN-FD  # Frame for Data transmission of ObjectData
        n pdu RRR_Object_TpData: length=64  # NPdu for Data transmission of Objects
      frame RRR_Object_TpFC: id 0x68B, to RA6_RRR, frame-length=64, can-addressing-mode=STANDARD, can-fd-frame-support=true, can-frame-rx-behavior=CAN-FD, can-frame-tx-behavior=CAN-FD  # Frame for FlowControl transmission of ObjectData
        n pdu RRR_Object_TpFC: length=64  # NPdu for FlowControl transmission of Objects
      frame RRR_RoadSideBoundaries_TpData: id 0x68E, from RA6_RRR, frame-length=64, can-addressing-mode=STANDARD, can-fd-frame-support=true, can-frame-rx-behavior=CAN-FD, can-frame-tx-behavior=CAN-FD  # Frame for Data transmission of Roadside Boundaries
        n pdu RRR_RoadSideBoundaries_TpData: length=64  # NPdu for Data transmission of RoadSideBoundaries
      frame RRR_RoadSideBoundaries_TpFC: id 0x68F, to RA6_RRR, frame-length=64, can-addressing-mode=STANDARD, can-fd-frame-support=true, can-frame-rx-behavior=CAN-FD, can-frame-tx-behavior=CAN-FD  # Frame for FlowControl transmission of RoadSideBoundaries
        n pdu RRR_RoadSideBoundaries_TpFC: length=64  # NPdu for FlowControl transmission of RoadSideBoundaries
      frame RRR_SensorOutput: id 0x682, from RA6_RRR, frame-length=1, can-addressing-mode=STANDARD, can-fd-frame-support=true, can-frame-rx-behavior=CAN-FD, can-frame-tx-behavior=CAN-FD  # Radar Vehicle Output Message - Currently only used for Parameter status
        pdu RRR_SensorOutput: length=1, transmission-mode-true-timing=cyclic-timing={time-offset=0.0, time-period=0.02}, unused-bit-pattern=0  # Radar Vehicle Output Message - Currently only used for Parameter status
          signal RRR_Veh_SenOut_VehConfParamStatus: start 0, 2 bit, little-endian, data-type-policy=OVERRIDE, i-signal-type=PRIMITIVE, base-type=uint8, compu {0=NOT_AVAILABLE, 1=UPDATE_INPROGRESS, 2=AVAILABLE, 3=UPDATE_FAILED}  # #I_CCP_VehicleConfigParamStatus: Status of the availability of the vehicle configuration parameters.
      frame TimeSync: id 0x1E, to RA6_RFC RA6_RFL RA6_RFR RA6_RRL RA6_RRR, frame-length=8, can-addressing-mode=STANDARD, can-fd-frame-support=true, can-frame-rx-behavior=CAN-FD, can-frame-tx-behavior=CAN-FD  # Time Synchronisation
        general purpose pdu TimeSync: category=GLOBAL_TIME, length=8  # Time Synchronisation
      frame Veh_ConfigMgmt: id 0xC, to RA6_RFC RA6_RFL RA6_RFR RA6_RRL RA6_RRR, frame-length=20, can-addressing-mode=STANDARD, can-fd-frame-support=true, can-frame-rx-behavior=CAN-FD, can-frame-tx-behavior=CAN-FD  # Config Management
        pdu Veh_ConfigMgmt: length=20, transmission-mode-true-timing=cyclic-timing={time-offset=0.0, time-period=0.02}, unused-bit-pattern=0  # Config Management
          signal Veh_ConfigMgmt: start 0, 160 bit, opaque, data-type-policy=OVERRIDE, i-signal-type=ARRAY, base-type=uint8_n, dynamic-length=true, compu {identical}, transfer-property=TRIGGERED, to RA6_RFR
      frame Veh_SensorConfig_RFC: id 0x180, to RA6_RFC, frame-length=48, can-addressing-mode=STANDARD, can-frame-rx-behavior=CAN-FD, can-frame-tx-behavior=CAN-FD  # Radar VehicleConfig Information - Data is usually not changing during power cycle
        pdu Veh_SensorConfig_RFC: length=48, transmission-mode-true-timing=event-controlled-timing=number-of-repetitions=0, unused-bit-pattern=0  # Radar VehicleConfig Information - Data is usually not changing during power cycle
          signal Veh_SenConfig_RFC_AccLongSensPos: start 136, 8 bit, little-endian, data-type-policy=OVERRIDE, i-signal-type=PRIMITIVE, base-type=uint8, compu {phys=raw*0.02 for raw 0..255; unit meter}, to RA6_RFC  # Longitudinal mounting position of the longitudinal acceleration sensor in vehicle coordinate system with origin middle of the rear axis."  # Longitudinal mounting position of the longitudinal acceleration sensor in vehicle coordinate system with origin middle of the rear axis.”
          signal Veh_SenConfig_RFC_CRC: start 0, 16 bit, little-endian, data-type-policy=OVERRIDE, i-signal-type=PRIMITIVE, base-type=uint16, compu {identical}, to RA6_RFC  # CRC - Autosar E2E Profile 5 - Data ID : 0x2202 "  # CRC - Autosar E2E Profile 11A - Data ID : 0x2202 "
          signal Veh_SenConfig_RFC_ConfigData: start 40, 3 bit, little-endian, data-type-policy=OVERRIDE, i-signal-type=PRIMITIVE, base-type=uint8, compu {0=SIGNAL_NOT_AVAILABLE, 1=FRONT_CENTER, 2=FRONT_LEFT, 3=FRONT_RIGHT, 4=REAR_LEFT, 5=REAR_RIGHT, 6=RESERVED6, 7=RESERVED7}, to RA6_RFC  # #I_ConfigurationData Provide the information with regards of the VehicleConfiging position.
          signal Veh_SenConfig_RFC_CountryCode: start 280, 24 bit, little-endian, data-type-policy=OVERRIDE, i-signal-type=PRIMITIVE, base-type=uint32, compu {phys=raw for raw 0..16777215}, to RA6_RFC  # #I_CountryCode: Signal for providing information regarding the intended market of the vehicle.The information regarding country code is based on ISO 3166-1 alpha-3 code.
          signal Veh_SenConfig_RFC_GradSideSlipAng: start 192, 5 bit, little-endian, data-type-policy=OVERRIDE, i-signal-type=PRIMITIVE, base-type=uint8, compu {phys=raw*0.0005 for raw 0..16; unit radian_times_squaresconds_per_meter}, to RA6_RFC  # #I_GradSideSlipAngle: Ego Gradient Side Slip angle
          signal Veh_SenConfig_RFC_PosX: start 72, 9 bit, little-endian, data-type-policy=OVERRIDE, i-signal-type=PRIMITIVE, base-type=uint16, compu {phys=raw*0.02-5.12 for raw 0..511; unit meter}, to RA6_RFC  # Nominal VehicleConfiging position in the longitudinal direction in vehicle road-level coordinate system."
          signal Veh_SenConfig_RFC_PosY: start 64, 8 bit, little-endian, data-type-policy=OVERRIDE, i-signal-type=PRIMITIVE, base-type=uint8, compu {phys=raw*0.01-1.28 for raw 0..255; unit meter}, to RA6_RFC  # Nominal VehicleConfiging position in the lateral direction in vehicle road-level coordinate system."
          signal Veh_SenConfig_RFC_PosZ: start 88, 5 bit, little-endian, data-type-policy=OVERRIDE, i-signal-type=PRIMITIVE, base-type=uint8, compu {phys=raw*0.05 for raw 0..31; unit meter}, to RA6_RFC  # Nominal VehicleConfiging position in the vertical direction in vehicle road-level coordinate system."
          signal Veh_SenConfig_RFC_SQC: start 16, 8 bit, little-endian, data-type-policy=OVERRIDE, i-signal-type=PRIMITIVE, base-type=uint8, compu {identical}, to RA6_RFC  # #I_COM_SequenceCtr Sequence Counter - Autosar E2E Profile 5."  # Alive counter - Autosar E2E Profile 11A"
          signal Veh_SenConfig_RFC_SnsTimeOffset: start 152, 7 bit, little-endian, data-type-policy=OVERRIDE, i-signal-type=PRIMITIVE, base-type=uint8, compu {phys=raw*0.5 for raw 0..100; unit milliseconds}, to RA6_RFC  # #I_SensorTimeOffset Time offset between overall start of the current cycle and start of modulation for the sensor. In order to reduce the interferences each sensor in a vehicle will received a different starting point for its modulation. This information is to be pre-defined in dependency of the sensor vehicle configuation and needs to be available at the sender side of this message. Important information: changes during runtime not allowed.
          signal Veh_SenConfig_RFC_SnsrOrientNomPitch: start 48, 14 bit, little-endian, data-type-policy=OVERRIDE, i-signal-type=PRIMITIVE, base-type=uint16, compu {phys=raw*0.00017-0.34816 for raw 0..4095; unit radian}, to RA6_RFC  # #I_ElevationMountAngle: Nominal Sensor mounting elevation (pitch) angle.Also known as Sensor Orientation Nominal Pitch.
          signal Veh_SenConfig_RFC_SnsrOrientNomYaw: start 24, 16 bit, little-endian, data-type-policy=OVERRIDE, i-signal-type=PRIMITIVE, base-type=uint16, compu {phys=raw*0.00017-5.57056 for raw 13944..51592; unit radian}, to RA6_RFC  # #I_AzimuthMountAngle: Nominal Sensor mounting azimuth (yaw) angle.Also known as Sensor Orientation Nominal Yaw.
          signal Veh_SenConfig_RFC_SnsrOrientation: start 176, 1 bit, little-endian, data-type-policy=OVERRIDE, i-signal-type=PRIMITIVE, base-type=boolean, compu {0=NORMAL_ORIENTATION, 1=FLIPPED_ORIENTATION}, to RA6_RFC  # #I_SensorOrientation: Orientation of the sensor. Whether it is flipped or normal mounted.Normal orientation - Connector on right or back-right side. Flipped orientation - Connector on left or back-left side
          signal Veh_SenConfig_RFC_StrRackRatio: start 200, 12 bit, little-endian, data-type-policy=OVERRIDE, i-signal-type=PRIMITIVE, base-type=uint16, compu {phys=raw*0.01 for raw 0..3000}, to RA6_RFC  # #I_SteeringRackRatioVehicle: Steering Rack Ratio
          signal Veh_SenConfig_RFC_SyncType: start 184, 2 bit, little-endian, data-type-policy=OVERRIDE, i-signal-type=PRIMITIVE, init-value=NumericalValueSpecification:1, base-type=uint8, compu {0=NO_SYNC, 1=MOD_INTERLEAVING, 2=CHIRP_INTERLEAVING, 3=RESERVED}, to RA6_RFC  # #I_SyncType: Enumeration values : see value table Note 1: There are two types of interleaving : modualtion or chirp interleaving. Note 2 : The Reserved value may be used for backwards compatibility to previous Generation 5 syncronization method "timeslot"
          signal Veh_SenConfig_RFC_VehicleWidthMax: start 104, 7 bit, little-endian, data-type-policy=OVERRIDE, i-signal-type=PRIMITIVE, base-type=uint8, compu {phys=raw*0.05 for raw 0..127; unit meter}, to RA6_RFC  # Maximum width of the vehicle"
          signal Veh_SenConfig_RFC_VehicleWidthMin: start 96, 7 bit, little-endian, data-type-policy=OVERRIDE, i-signal-type=PRIMITIVE, base-type=uint8, compu {phys=raw*0.05 for raw 0..127; unit meter}, to RA6_RFC  # Minimum width of the vehicle"
          signal Veh_SenConfig_RFC_WheelBase: start 144, 7 bit, little-endian, data-type-policy=OVERRIDE, i-signal-type=PRIMITIVE, base-type=uint8, compu {phys=raw*0.05 for raw 0..127; unit meter}, to RA6_RFC  # Longitudinal distance between front and rear axles"
          signal Veh_SenConfig_RFC_WheelCircFL: start 216, 9 bit, little-endian, data-type-policy=OVERRIDE, i-signal-type=PRIMITIVE, base-type=uint16, compu {phys=raw*0.01 for raw 0..500; unit meter}, to RA6_RFC  # #I_WheelCircumferenceFrontLeft: Front Left Wheel Circumference for the Ford Vehicle
          signal Veh_SenConfig_RFC_WheelCircFR: start 232, 9 bit, little-endian, data-type-policy=OVERRIDE, i-signal-type=PRIMITIVE, base-type=uint16, compu {phys=raw*0.01 for raw 0..500; unit meter}, to RA6_RFC  # #I_WheelCircumferenceFrontRight: Front Right Wheel Circumference for the Ford Vehicle
          signal Veh_SenConfig_RFC_WheelCircRL: start 248, 9 bit, little-endian, data-type-policy=OVERRIDE, i-signal-type=PRIMITIVE, base-type=uint16, compu {phys=raw*0.01 for raw 0..500; unit meter}, to RA6_RFC  # #I_WheelCircumferenceRearLeft: Rear Left Wheel Circumference for the Ford Vehicle
          signal Veh_SenConfig_RFC_WheelCircRR: start 264, 9 bit, little-endian, data-type-policy=OVERRIDE, i-signal-type=PRIMITIVE, base-type=uint16, compu {phys=raw*0.01 for raw 0..500; unit meter}, to RA6_RFC  # #I_WheelCircumferenceRearRight: Rear Right Wheel Circumference for the Ford Vehicle
          signal Veh_SenConfig_RFC_WheelTrack: start 128, 6 bit, little-endian, data-type-policy=OVERRIDE, i-signal-type=PRIMITIVE, base-type=uint8, compu {phys=raw*0.05 for raw 0..63; unit meter}, to RA6_RFC  # Distance between the centerline of two wheels on the same axle"
          signal Veh_SenConfig_RFC_dxvFrontBumper: start 112, 7 bit, little-endian, data-type-policy=OVERRIDE, i-signal-type=PRIMITIVE, base-type=uint8, compu {phys=raw*0.05 for raw 0..127; unit meter}, to RA6_RFC  # Longitudinal distance to the front bumper in the vehicle coordinate system with origin at center of the rear axle"
          signal Veh_SenConfig_RFC_dxvRearBumper: start 120, 6 bit, little-endian, data-type-policy=OVERRIDE, i-signal-type=PRIMITIVE, base-type=uint8, compu {phys=raw*0.05-3.15 for raw 0..63; unit meter}, to RA6_RFC  # Longitudinal distance to the rear bumper in the vehicle coordinate system with origin at center of the rear axle"
          signal Veh_SenConfig_RFC_vCh: start 160, 14 bit, little-endian, data-type-policy=OVERRIDE, i-signal-type=PRIMITIVE, base-type=uint16, compu {phys=raw*0.01 for raw 0..16383; unit meter_per_second}, to RA6_RFC  # Vehicle characteristic velocity: velocity at which the steering sensitivity of the vehicle is at maximum"
          mapping Veh_SensorConfig_RFC: i-signal-group=Veh_SensorConfig_RFC, transfer-property=TRIGGERED
      frame Veh_SensorConfig_RFL: id 0x380, to RA6_RFL, frame-length=48, can-addressing-mode=STANDARD, can-frame-rx-behavior=CAN-FD, can-frame-tx-behavior=CAN-FD  # Radar VehicleConfig Information - Data is usually not changing during power cycle
        pdu Veh_SensorConfig_RFL: length=48, transmission-mode-true-timing=event-controlled-timing=number-of-repetitions=0, unused-bit-pattern=0  # Radar VehicleConfig Information - Data is usually not changing during power cycle
          signal Veh_SenConfig_RFL_AccLongSensPos: start 136, 8 bit, little-endian, data-type-policy=OVERRIDE, i-signal-type=PRIMITIVE, base-type=uint8, compu {phys=raw*0.02 for raw 0..255; unit meter}, to RA6_RFL  # Longitudinal mounting position of the longitudinal acceleration sensor in vehicle coordinate system with origin middle of the rear axis."  # Longitudinal mounting position of the longitudinal acceleration sensor in vehicle coordinate system with origin middle of the rear axis.”
          signal Veh_SenConfig_RFL_CRC: start 0, 16 bit, little-endian, data-type-policy=OVERRIDE, i-signal-type=PRIMITIVE, base-type=uint16, compu {identical}, to RA6_RFL  # CRC - Autosar E2E Profile 5 - Data ID : 0x2202 "  # CRC - Autosar E2E Profile 11A - Data ID : 0x2202 "
          signal Veh_SenConfig_RFL_ConfigData: start 40, 3 bit, little-endian, data-type-policy=OVERRIDE, i-signal-type=PRIMITIVE, base-type=uint8, compu {0=SIGNAL_NOT_AVAILABLE, 1=FRONT_CENTER, 2=FRONT_LEFT, 3=FRONT_RIGHT, 4=REAR_LEFT, 5=REAR_RIGHT, 6=RESERVED6, 7=RESERVED7}, to RA6_RFL  # #I_ConfigurationData Provide the information with regards of the VehicleConfiging position.
          signal Veh_SenConfig_RFL_CountryCode: start 280, 24 bit, little-endian, data-type-policy=OVERRIDE, i-signal-type=PRIMITIVE, base-type=uint32, compu {phys=raw for raw 0..16777215}, to RA6_RFL  # #I_CountryCode: Signal for providing information regarding the intended market of the vehicle.The information regarding country code is based on ISO 3166-1 alpha-3 code.
          signal Veh_SenConfig_RFL_GradSideSlipAng: start 192, 5 bit, little-endian, data-type-policy=OVERRIDE, i-signal-type=PRIMITIVE, base-type=uint8, compu {phys=raw*0.0005 for raw 0..16; unit radian_times_squaresconds_per_meter}, to RA6_RFL  # #I_GradSideSlipAngle: Ego Gradient Side Slip angle
          signal Veh_SenConfig_RFL_PosX: start 72, 9 bit, little-endian, data-type-policy=OVERRIDE, i-signal-type=PRIMITIVE, base-type=uint16, compu {phys=raw*0.02-5.12 for raw 0..511; unit meter}, to RA6_RFL  # Nominal VehicleConfiging position in the longitudinal direction in vehicle road-level coordinate system."
          signal Veh_SenConfig_RFL_PosY: start 64, 8 bit, little-endian, data-type-policy=OVERRIDE, i-signal-type=PRIMITIVE, base-type=uint8, compu {phys=raw*0.01-1.28 for raw 0..255; unit meter}, to RA6_RFL  # Nominal VehicleConfiging position in the lateral direction in vehicle road-level coordinate system."
          signal Veh_SenConfig_RFL_PosZ: start 88, 5 bit, little-endian, data-type-policy=OVERRIDE, i-signal-type=PRIMITIVE, base-type=uint8, compu {phys=raw*0.05 for raw 0..31; unit meter}, to RA6_RFL  # Nominal VehicleConfiging position in the vertical direction in vehicle road-level coordinate system."
          signal Veh_SenConfig_RFL_SQC: start 16, 8 bit, little-endian, data-type-policy=OVERRIDE, i-signal-type=PRIMITIVE, base-type=uint8, compu {identical}, to RA6_RFL  # #I_COM_SequenceCtr Sequence Counter - Autosar E2E Profile 5."  # Alive counter - Autosar E2E Profile 11A"
          signal Veh_SenConfig_RFL_SnsTimeOffset: start 152, 7 bit, little-endian, data-type-policy=OVERRIDE, i-signal-type=PRIMITIVE, base-type=uint8, compu {phys=raw*0.5 for raw 0..100; unit milliseconds}, to RA6_RFL  # #I_SensorTimeOffset Time offset between overall start of the current cycle and start of modulation for the sensor. In order to reduce the interferences each sensor in a vehicle will received a different starting point for its modulation. This information is to be pre-defined in dependency of the sensor vehicle configuation and needs to be available at the sender side of this message. Important information: changes during runtime not allowed.
          signal Veh_SenConfig_RFL_SnsrOrientNomPitch: start 48, 14 bit, little-endian, data-type-policy=OVERRIDE, i-signal-type=PRIMITIVE, base-type=uint16, compu {phys=raw*0.00017-0.34816 for raw 0..4095; unit radian}, to RA6_RFL  # #I_ElevationMountAngle: Nominal Sensor mounting elevation (pitch) angle.Also known as Sensor Orientation Nominal Pitch.
          signal Veh_SenConfig_RFL_SnsrOrientNomYaw: start 24, 16 bit, little-endian, data-type-policy=OVERRIDE, i-signal-type=PRIMITIVE, base-type=uint16, compu {phys=raw*0.00017-5.57056 for raw 13944..51592; unit radian}, to RA6_RFL  # #I_AzimuthMountAngle: Nominal Sensor mounting azimuth (yaw) angle.Also known as Sensor Orientation Nominal Yaw.
          signal Veh_SenConfig_RFL_SnsrOrientation: start 176, 1 bit, little-endian, data-type-policy=OVERRIDE, i-signal-type=PRIMITIVE, base-type=boolean, compu {0=NORMAL_ORIENTATION, 1=FLIPPED_ORIENTATION}, to RA6_RFL  # #I_SensorOrientation: Orientation of the sensor. Whether it is flipped or normal mounted.Normal orientation - Connector on right or back-right side. Flipped orientation - Connector on left or back-left side
          signal Veh_SenConfig_RFL_StrRackRatio: start 200, 12 bit, little-endian, data-type-policy=OVERRIDE, i-signal-type=PRIMITIVE, base-type=uint16, compu {phys=raw*0.01 for raw 0..3000}, to RA6_RFL  # #I_SteeringRackRatioVehicle: Steering Rack Ratio
          signal Veh_SenConfig_RFL_SyncType: start 184, 2 bit, little-endian, data-type-policy=OVERRIDE, i-signal-type=PRIMITIVE, init-value=NumericalValueSpecification:1, base-type=uint8, compu {0=NO_SYNC, 1=MOD_INTERLEAVING, 2=CHIRP_INTERLEAVING, 3=RESERVED}, to RA6_RFL  # #I_SyncType: Enumeration values : see value table Note 1: There are two types of interleaving : modualtion or chirp interleaving. Note 2 : The Reserved value may be used for backwards compatibility to previous Generation 5 syncronization method "timeslot"
          signal Veh_SenConfig_RFL_VehicleWidthMax: start 104, 7 bit, little-endian, data-type-policy=OVERRIDE, i-signal-type=PRIMITIVE, base-type=uint8, compu {phys=raw*0.05 for raw 0..127; unit meter}, to RA6_RFL  # Maximum width of the vehicle"
          signal Veh_SenConfig_RFL_VehicleWidthMin: start 96, 7 bit, little-endian, data-type-policy=OVERRIDE, i-signal-type=PRIMITIVE, base-type=uint8, compu {phys=raw*0.05 for raw 0..127; unit meter}, to RA6_RFL  # Minimum width of the vehicle"
          signal Veh_SenConfig_RFL_WheelBase: start 144, 7 bit, little-endian, data-type-policy=OVERRIDE, i-signal-type=PRIMITIVE, base-type=uint8, compu {phys=raw*0.05 for raw 0..127; unit meter}, to RA6_RFL  # Longitudinal distance between front and rear axles"
          signal Veh_SenConfig_RFL_WheelCircFL: start 216, 9 bit, little-endian, data-type-policy=OVERRIDE, i-signal-type=PRIMITIVE, base-type=uint16, compu {phys=raw*0.01 for raw 0..500; unit meter}, to RA6_RFL  # #I_WheelCircumferenceFrontLeft: Front Left Wheel Circumference for the Ford Vehicle
          signal Veh_SenConfig_RFL_WheelCircFR: start 232, 9 bit, little-endian, data-type-policy=OVERRIDE, i-signal-type=PRIMITIVE, base-type=uint16, compu {phys=raw*0.01 for raw 0..500; unit meter}, to RA6_RFL  # #I_WheelCircumferenceFrontRight: Front Right Wheel Circumference for the Ford Vehicle
          signal Veh_SenConfig_RFL_WheelCircRL: start 248, 9 bit, little-endian, data-type-policy=OVERRIDE, i-signal-type=PRIMITIVE, base-type=uint16, compu {phys=raw*0.01 for raw 0..500; unit meter}, to RA6_RFL  # #I_WheelCircumferenceRearLeft: Rear Left Wheel Circumference for the Ford Vehicle
          signal Veh_SenConfig_RFL_WheelCircRR: start 264, 9 bit, little-endian, data-type-policy=OVERRIDE, i-signal-type=PRIMITIVE, base-type=uint16, compu {phys=raw*0.01 for raw 0..500; unit meter}, to RA6_RFL  # #I_WheelCircumferenceRearRight: Rear Right Wheel Circumference for the Ford Vehicle
          signal Veh_SenConfig_RFL_WheelTrack: start 128, 6 bit, little-endian, data-type-policy=OVERRIDE, i-signal-type=PRIMITIVE, base-type=uint8, compu {phys=raw*0.05 for raw 0..63; unit meter}, to RA6_RFL  # Distance between the centerline of two wheels on the same axle"
          signal Veh_SenConfig_RFL_dxvFrontBumper: start 112, 7 bit, little-endian, data-type-policy=OVERRIDE, i-signal-type=PRIMITIVE, base-type=uint8, compu {phys=raw*0.05 for raw 0..127; unit meter}, to RA6_RFL  # Longitudinal distance to the front bumper in the vehicle coordinate system with origin at center of the rear axle"
          signal Veh_SenConfig_RFL_dxvRearBumper: start 120, 6 bit, little-endian, data-type-policy=OVERRIDE, i-signal-type=PRIMITIVE, base-type=uint8, compu {phys=raw*0.05-3.15 for raw 0..63; unit meter}, to RA6_RFL  # Longitudinal distance to the rear bumper in the vehicle coordinate system with origin at center of the rear axle"
          signal Veh_SenConfig_RFL_vCh: start 160, 14 bit, little-endian, data-type-policy=OVERRIDE, i-signal-type=PRIMITIVE, base-type=uint16, compu {phys=raw*0.01 for raw 0..16383; unit meter_per_second}, to RA6_RFL  # Vehicle characteristic velocity: velocity at which the steering sensitivity of the vehicle is at maximum"
          mapping Veh_SensorConfig_RFL: i-signal-group=Veh_SensorConfig_RFL, transfer-property=TRIGGERED
      frame Veh_SensorConfig_RFR: id 0x480, to RA6_RFR, frame-length=48, can-addressing-mode=STANDARD, can-frame-rx-behavior=CAN-FD, can-frame-tx-behavior=CAN-FD  # Radar VehicleConfig Information - Data is usually not changing during power cycle
        pdu Veh_SensorConfig_RFR: length=48, transmission-mode-true-timing=event-controlled-timing=number-of-repetitions=0, unused-bit-pattern=0  # Radar VehicleConfig Information - Data is usually not changing during power cycle
          signal Veh_SenConfig_RFR_AccLongSensPos: start 136, 8 bit, little-endian, data-type-policy=OVERRIDE, i-signal-type=PRIMITIVE, base-type=uint8, compu {phys=raw*0.02 for raw 0..255; unit meter}, to RA6_RFR  # Longitudinal mounting position of the longitudinal acceleration sensor in vehicle coordinate system with origin middle of the rear axis."  # Longitudinal mounting position of the longitudinal acceleration sensor in vehicle coordinate system with origin middle of the rear axis.”
          signal Veh_SenConfig_RFR_CRC: start 0, 16 bit, little-endian, data-type-policy=OVERRIDE, i-signal-type=PRIMITIVE, base-type=uint16, compu {identical}, to RA6_RFR  # CRC - Autosar E2E Profile 5 - Data ID : 0x2202 "  # CRC - Autosar E2E Profile 11A - Data ID : 0x2202 "
          signal Veh_SenConfig_RFR_ConfigData: start 40, 3 bit, little-endian, data-type-policy=OVERRIDE, i-signal-type=PRIMITIVE, base-type=uint8, compu {0=SIGNAL_NOT_AVAILABLE, 1=FRONT_CENTER, 2=FRONT_LEFT, 3=FRONT_RIGHT, 4=REAR_LEFT, 5=REAR_RIGHT, 6=RESERVED6, 7=RESERVED7}, to RA6_RFR  # #I_ConfigurationData Provide the information with regards of the VehicleConfiging position.
          signal Veh_SenConfig_RFR_CountryCode: start 280, 24 bit, little-endian, data-type-policy=OVERRIDE, i-signal-type=PRIMITIVE, base-type=uint32, compu {phys=raw for raw 0..16777215}, to RA6_RFR  # #I_CountryCode: Signal for providing information regarding the intended market of the vehicle.The information regarding country code is based on ISO 3166-1 alpha-3 code.
          signal Veh_SenConfig_RFR_GradSideSlipAng: start 192, 5 bit, little-endian, data-type-policy=OVERRIDE, i-signal-type=PRIMITIVE, base-type=uint8, compu {phys=raw*0.0005 for raw 0..16; unit radian_times_squaresconds_per_meter}, to RA6_RFR  # #I_GradSideSlipAngle: Ego Gradient Side Slip angle
          signal Veh_SenConfig_RFR_PosX: start 72, 9 bit, little-endian, data-type-policy=OVERRIDE, i-signal-type=PRIMITIVE, base-type=uint16, compu {phys=raw*0.02-5.12 for raw 0..511; unit meter}, to RA6_RFR  # Nominal VehicleConfiging position in the longitudinal direction in vehicle road-level coordinate system."
          signal Veh_SenConfig_RFR_PosY: start 64, 8 bit, little-endian, data-type-policy=OVERRIDE, i-signal-type=PRIMITIVE, base-type=uint8, compu {phys=raw*0.01-1.28 for raw 0..255; unit meter}, to RA6_RFR  # Nominal VehicleConfiging position in the lateral direction in vehicle road-level coordinate system."
          signal Veh_SenConfig_RFR_PosZ: start 88, 5 bit, little-endian, data-type-policy=OVERRIDE, i-signal-type=PRIMITIVE, base-type=uint8, compu {phys=raw*0.05 for raw 0..31; unit meter}, to RA6_RFR  # Nominal VehicleConfiging position in the vertical direction in vehicle road-level coordinate system."
          signal Veh_SenConfig_RFR_SQC: start 16, 8 bit, little-endian, data-type-policy=OVERRIDE, i-signal-type=PRIMITIVE, base-type=uint8, compu {identical}, to RA6_RFR  # #I_COM_SequenceCtr Sequence Counter - Autosar E2E Profile 5."  # Alive counter - Autosar E2E Profile 11A"
          signal Veh_SenConfig_RFR_SnsTimeOffset: start 152, 7 bit, little-endian, data-type-policy=OVERRIDE, i-signal-type=PRIMITIVE, base-type=uint8, compu {phys=raw*0.5 for raw 0..100; unit milliseconds}, to RA6_RFR  # #I_SensorTimeOffset Time offset between overall start of the current cycle and start of modulation for the sensor. In order to reduce the interferences each sensor in a vehicle will received a different starting point for its modulation. This information is to be pre-defined in dependency of the sensor vehicle configuation and needs to be available at the sender side of this message. Important information: changes during runtime not allowed.
          signal Veh_SenConfig_RFR_SnsrOrientNomPitch: start 48, 14 bit, little-endian, data-type-policy=OVERRIDE, i-signal-type=PRIMITIVE, base-type=uint16, compu {phys=raw*0.00017-0.34816 for raw 0..4095; unit radian}, to RA6_RFR  # #I_ElevationMountAngle: Nominal Sensor mounting elevation (pitch) angle.Also known as Sensor Orientation Nominal Pitch.
          signal Veh_SenConfig_RFR_SnsrOrientNomYaw: start 24, 16 bit, little-endian, data-type-policy=OVERRIDE, i-signal-type=PRIMITIVE, base-type=uint16, compu {phys=raw*0.00017-5.57056 for raw 13944..51592; unit radian}, to RA6_RFR  # #I_AzimuthMountAngle: Nominal Sensor mounting azimuth (yaw) angle.Also known as Sensor Orientation Nominal Yaw.
          signal Veh_SenConfig_RFR_SnsrOrientation: start 176, 1 bit, little-endian, data-type-policy=OVERRIDE, i-signal-type=PRIMITIVE, base-type=boolean, compu {0=NORMAL_ORIENTATION, 1=FLIPPED_ORIENTATION}, to RA6_RFR  # #I_SensorOrientation: Orientation of the sensor. Whether it is flipped or normal mounted.Normal orientation - Connector on right or back-right side. Flipped orientation - Connector on left or back-left side
          signal Veh_SenConfig_RFR_StrRackRatio: start 200, 12 bit, little-endian, data-type-policy=OVERRIDE, i-signal-type=PRIMITIVE, base-type=uint16, compu {phys=raw*0.01 for raw 0..3000}, to RA6_RFR  # #I_SteeringRackRatioVehicle: Steering Rack Ratio
          signal Veh_SenConfig_RFR_SyncType: start 184, 2 bit, little-endian, data-type-policy=OVERRIDE, i-signal-type=PRIMITIVE, init-value=NumericalValueSpecification:1, base-type=uint8, compu {0=NO_SYNC, 1=MOD_INTERLEAVING, 2=CHIRP_INTERLEAVING, 3=RESERVED}, to RA6_RFR  # #I_SyncType: Enumeration values : see value table Note 1: There are two types of interleaving : modualtion or chirp interleaving. Note 2 : The Reserved value may be used for backwards compatibility to previous Generation 5 syncronization method "timeslot"
          signal Veh_SenConfig_RFR_VehicleWidthMax: start 104, 7 bit, little-endian, data-type-policy=OVERRIDE, i-signal-type=PRIMITIVE, base-type=uint8, compu {phys=raw*0.05 for raw 0..127; unit meter}, to RA6_RFR  # Maximum width of the vehicle"
          signal Veh_SenConfig_RFR_VehicleWidthMin: start 96, 7 bit, little-endian, data-type-policy=OVERRIDE, i-signal-type=PRIMITIVE, base-type=uint8, compu {phys=raw*0.05 for raw 0..127; unit meter}, to RA6_RFR  # Minimum width of the vehicle"
          signal Veh_SenConfig_RFR_WheelBase: start 144, 7 bit, little-endian, data-type-policy=OVERRIDE, i-signal-type=PRIMITIVE, base-type=uint8, compu {phys=raw*0.05 for raw 0..127; unit meter}, to RA6_RFR  # Longitudinal distance between front and rear axles"
          signal Veh_SenConfig_RFR_WheelCircFL: start 216, 9 bit, little-endian, data-type-policy=OVERRIDE, i-signal-type=PRIMITIVE, base-type=uint16, compu {phys=raw*0.01 for raw 0..500; unit meter}, to RA6_RFR  # #I_WheelCircumferenceFrontLeft: Front Left Wheel Circumference for the Ford Vehicle
          signal Veh_SenConfig_RFR_WheelCircFR: start 232, 9 bit, little-endian, data-type-policy=OVERRIDE, i-signal-type=PRIMITIVE, base-type=uint16, compu {phys=raw*0.01 for raw 0..500; unit meter}, to RA6_RFR  # #I_WheelCircumferenceFrontRight: Front Right Wheel Circumference for the Ford Vehicle
          signal Veh_SenConfig_RFR_WheelCircRL: start 248, 9 bit, little-endian, data-type-policy=OVERRIDE, i-signal-type=PRIMITIVE, base-type=uint16, compu {phys=raw*0.01 for raw 0..500; unit meter}, to RA6_RFR  # #I_WheelCircumferenceRearLeft: Rear Left Wheel Circumference for the Ford Vehicle
          signal Veh_SenConfig_RFR_WheelCircRR: start 264, 9 bit, little-endian, data-type-policy=OVERRIDE, i-signal-type=PRIMITIVE, base-type=uint16, compu {phys=raw*0.01 for raw 0..500; unit meter}, to RA6_RFR  # #I_WheelCircumferenceRearRight: Rear Right Wheel Circumference for the Ford Vehicle
          signal Veh_SenConfig_RFR_WheelTrack: start 128, 6 bit, little-endian, data-type-policy=OVERRIDE, i-signal-type=PRIMITIVE, base-type=uint8, compu {phys=raw*0.05 for raw 0..63; unit meter}, to RA6_RFR  # Distance between the centerline of two wheels on the same axle"
          signal Veh_SenConfig_RFR_dxvFrontBumper: start 112, 7 bit, little-endian, data-type-policy=OVERRIDE, i-signal-type=PRIMITIVE, base-type=uint8, compu {phys=raw*0.05 for raw 0..127; unit meter}, to RA6_RFR  # Longitudinal distance to the front bumper in the vehicle coordinate system with origin at center of the rear axle"
          signal Veh_SenConfig_RFR_dxvRearBumper: start 120, 6 bit, little-endian, data-type-policy=OVERRIDE, i-signal-type=PRIMITIVE, base-type=uint8, compu {phys=raw*0.05-3.15 for raw 0..63; unit meter}, to RA6_RFR  # Longitudinal distance to the rear bumper in the vehicle coordinate system with origin at center of the rear axle"
          signal Veh_SenConfig_RFR_vCh: start 160, 14 bit, little-endian, data-type-policy=OVERRIDE, i-signal-type=PRIMITIVE, base-type=uint16, compu {phys=raw*0.01 for raw 0..16383; unit meter_per_second}, to RA6_RFR  # Vehicle characteristic velocity: velocity at which the steering sensitivity of the vehicle is at maximum"
          mapping Veh_SensorConfig_RFR: i-signal-group=Veh_SensorConfig_RFR, transfer-property=TRIGGERED
      frame Veh_SensorConfig_RRL: id 0x580, to RA6_RRL, frame-length=48, can-addressing-mode=STANDARD, can-frame-rx-behavior=CAN-FD, can-frame-tx-behavior=CAN-FD  # Radar VehicleConfig Information - Data is usually not changing during power cycle
        pdu Veh_SensorConfig_RRL: length=48, transmission-mode-true-timing=event-controlled-timing=number-of-repetitions=0, unused-bit-pattern=0  # Radar VehicleConfig Information - Data is usually not changing during power cycle
          signal Veh_SenConfig_RRL_AccLongSensPos: start 136, 8 bit, little-endian, data-type-policy=OVERRIDE, i-signal-type=PRIMITIVE, base-type=uint8, compu {phys=raw*0.02 for raw 0..255; unit meter}, to RA6_RRL  # Longitudinal mounting position of the longitudinal acceleration sensor in vehicle coordinate system with origin middle of the rear axis."  # Longitudinal mounting position of the longitudinal acceleration sensor in vehicle coordinate system with origin middle of the rear axis.”
          signal Veh_SenConfig_RRL_CRC: start 0, 16 bit, little-endian, data-type-policy=OVERRIDE, i-signal-type=PRIMITIVE, base-type=uint16, compu {identical}, to RA6_RRL  # CRC - Autosar E2E Profile 5 - Data ID : 0x2202 "  # CRC - Autosar E2E Profile 11A - Data ID : 0x2202 "
          signal Veh_SenConfig_RRL_ConfigData: start 40, 3 bit, little-endian, data-type-policy=OVERRIDE, i-signal-type=PRIMITIVE, base-type=uint8, compu {0=SIGNAL_NOT_AVAILABLE, 1=FRONT_CENTER, 2=FRONT_LEFT, 3=FRONT_RIGHT, 4=REAR_LEFT, 5=REAR_RIGHT, 6=RESERVED6, 7=RESERVED7}, to RA6_RRL  # #I_ConfigurationData Provide the information with regards of the VehicleConfiging position.
          signal Veh_SenConfig_RRL_CountryCode: start 280, 24 bit, little-endian, data-type-policy=OVERRIDE, i-signal-type=PRIMITIVE, base-type=uint32, compu {phys=raw for raw 0..16777215}, to RA6_RRL  # #I_CountryCode: Signal for providing information regarding the intended market of the vehicle.The information regarding country code is based on ISO 3166-1 alpha-3 code.
          signal Veh_SenConfig_RRL_GradSideSlipAng: start 192, 5 bit, little-endian, data-type-policy=OVERRIDE, i-signal-type=PRIMITIVE, base-type=uint8, compu {phys=raw*0.0005 for raw 0..16; unit radian_times_squaresconds_per_meter}, to RA6_RRL  # #I_GradSideSlipAngle: Ego Gradient Side Slip angle
          signal Veh_SenConfig_RRL_PosX: start 72, 9 bit, little-endian, data-type-policy=OVERRIDE, i-signal-type=PRIMITIVE, base-type=uint16, compu {phys=raw*0.02-5.12 for raw 0..511; unit meter}, to RA6_RRL  # Nominal VehicleConfiging position in the longitudinal direction in vehicle road-level coordinate system."
          signal Veh_SenConfig_RRL_PosY: start 64, 8 bit, little-endian, data-type-policy=OVERRIDE, i-signal-type=PRIMITIVE, base-type=uint8, compu {phys=raw*0.01-1.28 for raw 0..255; unit meter}, to RA6_RRL  # Nominal VehicleConfiging position in the lateral direction in vehicle road-level coordinate system."
          signal Veh_SenConfig_RRL_PosZ: start 88, 5 bit, little-endian, data-type-policy=OVERRIDE, i-signal-type=PRIMITIVE, base-type=uint8, compu {phys=raw*0.05 for raw 0..31; unit meter}, to RA6_RRL  # Nominal VehicleConfiging position in the vertical direction in vehicle road-level coordinate system."
          signal Veh_SenConfig_RRL_SQC: start 16, 8 bit, little-endian, data-type-policy=OVERRIDE, i-signal-type=PRIMITIVE, base-type=uint8, compu {identical}, to RA6_RRL  # #I_COM_SequenceCtr Sequence Counter - Autosar E2E Profile 5."  # Alive counter - Autosar E2E Profile 11A"
          signal Veh_SenConfig_RRL_SnsTimeOffset: start 152, 7 bit, little-endian, data-type-policy=OVERRIDE, i-signal-type=PRIMITIVE, base-type=uint8, compu {phys=raw*0.5 for raw 0..100; unit milliseconds}, to RA6_RRL  # #I_SensorTimeOffset Time offset between overall start of the current cycle and start of modulation for the sensor. In order to reduce the interferences each sensor in a vehicle will received a different starting point for its modulation. This information is to be pre-defined in dependency of the sensor vehicle configuation and needs to be available at the sender side of this message. Important information: changes during runtime not allowed.
          signal Veh_SenConfig_RRL_SnsrOrientNomPitch: start 48, 14 bit, little-endian, data-type-policy=OVERRIDE, i-signal-type=PRIMITIVE, base-type=uint16, compu {phys=raw*0.00017-0.34816 for raw 0..4095; unit radian}, to RA6_RRL  # #I_ElevationMountAngle: Nominal Sensor mounting elevation (pitch) angle.Also known as Sensor Orientation Nominal Pitch.
          signal Veh_SenConfig_RRL_SnsrOrientNomYaw: start 24, 16 bit, little-endian, data-type-policy=OVERRIDE, i-signal-type=PRIMITIVE, base-type=uint16, compu {phys=raw*0.00017-5.57056 for raw 13944..51592; unit radian}, to RA6_RRL  # #I_AzimuthMountAngle: Nominal Sensor mounting azimuth (yaw) angle.Also known as Sensor Orientation Nominal Yaw.
          signal Veh_SenConfig_RRL_SnsrOrientation: start 176, 1 bit, little-endian, data-type-policy=OVERRIDE, i-signal-type=PRIMITIVE, base-type=boolean, compu {0=NORMAL_ORIENTATION, 1=FLIPPED_ORIENTATION}, to RA6_RRL  # #I_SensorOrientation: Orientation of the sensor. Whether it is flipped or normal mounted.Normal orientation - Connector on right or back-right side. Flipped orientation - Connector on left or back-left side
          signal Veh_SenConfig_RRL_StrRackRatio: start 200, 12 bit, little-endian, data-type-policy=OVERRIDE, i-signal-type=PRIMITIVE, base-type=uint16, compu {phys=raw*0.01 for raw 0..3000}, to RA6_RRL  # #I_SteeringRackRatioVehicle: Steering Rack Ratio
          signal Veh_SenConfig_RRL_SyncType: start 184, 2 bit, little-endian, data-type-policy=OVERRIDE, i-signal-type=PRIMITIVE, init-value=NumericalValueSpecification:1, base-type=uint8, compu {0=NO_SYNC, 1=MOD_INTERLEAVING, 2=CHIRP_INTERLEAVING, 3=RESERVED}, to RA6_RRL  # #I_SyncType: Enumeration values : see value table Note 1: There are two types of interleaving : modualtion or chirp interleaving. Note 2 : The Reserved value may be used for backwards compatibility to previous Generation 5 syncronization method "timeslot"
          signal Veh_SenConfig_RRL_VehicleWidthMax: start 104, 7 bit, little-endian, data-type-policy=OVERRIDE, i-signal-type=PRIMITIVE, base-type=uint8, compu {phys=raw*0.05 for raw 0..127; unit meter}, to RA6_RRL  # Maximum width of the vehicle"
          signal Veh_SenConfig_RRL_VehicleWidthMin: start 96, 7 bit, little-endian, data-type-policy=OVERRIDE, i-signal-type=PRIMITIVE, base-type=uint8, compu {phys=raw*0.05 for raw 0..127; unit meter}, to RA6_RRL  # Minimum width of the vehicle"
          signal Veh_SenConfig_RRL_WheelBase: start 144, 7 bit, little-endian, data-type-policy=OVERRIDE, i-signal-type=PRIMITIVE, base-type=uint8, compu {phys=raw*0.05 for raw 0..127; unit meter}, to RA6_RRL  # Longitudinal distance between front and rear axles"
          signal Veh_SenConfig_RRL_WheelCircFL: start 216, 9 bit, little-endian, data-type-policy=OVERRIDE, i-signal-type=PRIMITIVE, base-type=uint16, compu {phys=raw*0.01 for raw 0..500; unit meter}, to RA6_RRL  # #I_WheelCircumferenceFrontLeft: Front Left Wheel Circumference for the Ford Vehicle
          signal Veh_SenConfig_RRL_WheelCircFR: start 232, 9 bit, little-endian, data-type-policy=OVERRIDE, i-signal-type=PRIMITIVE, base-type=uint16, compu {phys=raw*0.01 for raw 0..500; unit meter}, to RA6_RRL  # #I_WheelCircumferenceFrontRight: Front Right Wheel Circumference for the Ford Vehicle
          signal Veh_SenConfig_RRL_WheelCircRL: start 248, 9 bit, little-endian, data-type-policy=OVERRIDE, i-signal-type=PRIMITIVE, base-type=uint16, compu {phys=raw*0.01 for raw 0..500; unit meter}, to RA6_RRL  # #I_WheelCircumferenceRearLeft: Rear Left Wheel Circumference for the Ford Vehicle
          signal Veh_SenConfig_RRL_WheelCircRR: start 264, 9 bit, little-endian, data-type-policy=OVERRIDE, i-signal-type=PRIMITIVE, base-type=uint16, compu {phys=raw*0.01 for raw 0..500; unit meter}, to RA6_RRL  # #I_WheelCircumferenceRearRight: Rear Right Wheel Circumference for the Ford Vehicle
          signal Veh_SenConfig_RRL_WheelTrack: start 128, 6 bit, little-endian, data-type-policy=OVERRIDE, i-signal-type=PRIMITIVE, base-type=uint8, compu {phys=raw*0.05 for raw 0..63; unit meter}, to RA6_RRL  # Distance between the centerline of two wheels on the same axle"
          signal Veh_SenConfig_RRL_dxvFrontBumper: start 112, 7 bit, little-endian, data-type-policy=OVERRIDE, i-signal-type=PRIMITIVE, base-type=uint8, compu {phys=raw*0.05 for raw 0..127; unit meter}, to RA6_RRL  # Longitudinal distance to the front bumper in the vehicle coordinate system with origin at center of the rear axle"
          signal Veh_SenConfig_RRL_dxvRearBumper: start 120, 6 bit, little-endian, data-type-policy=OVERRIDE, i-signal-type=PRIMITIVE, base-type=uint8, compu {phys=raw*0.05-3.15 for raw 0..63; unit meter}, to RA6_RRL  # Longitudinal distance to the rear bumper in the vehicle coordinate system with origin at center of the rear axle"
          signal Veh_SenConfig_RRL_vCh: start 160, 14 bit, little-endian, data-type-policy=OVERRIDE, i-signal-type=PRIMITIVE, base-type=uint16, compu {phys=raw*0.01 for raw 0..16383; unit meter_per_second}, to RA6_RRL  # Vehicle characteristic velocity: velocity at which the steering sensitivity of the vehicle is at maximum"
          mapping Veh_SensorConfig_RRL: i-signal-group=Veh_SensorConfig_RRL, transfer-property=TRIGGERED
      frame Veh_SensorConfig_RRR: id 0x680, to RA6_RRR, frame-length=48, can-addressing-mode=STANDARD, can-frame-rx-behavior=CAN-FD, can-frame-tx-behavior=CAN-FD  # Radar VehicleConfig Information - Data is usually not changing during power cycle
        pdu Veh_SensorConfig_RRR: length=48, transmission-mode-true-timing=event-controlled-timing=number-of-repetitions=0, unused-bit-pattern=0  # Radar VehicleConfig Information - Data is usually not changing during power cycle
          signal Veh_SenConfig_RRR_AccLongSensPos: start 136, 8 bit, little-endian, data-type-policy=OVERRIDE, i-signal-type=PRIMITIVE, base-type=uint8, compu {phys=raw*0.02 for raw 0..255; unit meter}, to RA6_RRR  # Longitudinal mounting position of the longitudinal acceleration sensor in vehicle coordinate system with origin middle of the rear axis."  # Longitudinal mounting position of the longitudinal acceleration sensor in vehicle coordinate system with origin middle of the rear axis.”
          signal Veh_SenConfig_RRR_CRC: start 0, 16 bit, little-endian, data-type-policy=OVERRIDE, i-signal-type=PRIMITIVE, base-type=uint16, compu {identical}, to RA6_RRR  # CRC - Autosar E2E Profile 5 - Data ID : 0x2202 "  # CRC - Autosar E2E Profile 11A - Data ID : 0x2202 "
          signal Veh_SenConfig_RRR_ConfigData: start 40, 3 bit, little-endian, data-type-policy=OVERRIDE, i-signal-type=PRIMITIVE, base-type=uint8, compu {0=SIGNAL_NOT_AVAILABLE, 1=FRONT_CENTER, 2=FRONT_LEFT, 3=FRONT_RIGHT, 4=REAR_LEFT, 5=REAR_RIGHT, 6=RESERVED6, 7=RESERVED7}, to RA6_RRR  # #I_ConfigurationData Provide the information with regards of the VehicleConfiging position.
          signal Veh_SenConfig_RRR_CountryCode: start 280, 24 bit, little-endian, data-type-policy=OVERRIDE, i-signal-type=PRIMITIVE, base-type=uint32, compu {phys=raw for raw 0..16777215}, to RA6_RRR  # #I_CountryCode: Signal for providing information regarding the intended market of the vehicle.The information regarding country code is based on ISO 3166-1 alpha-3 code.
          signal Veh_SenConfig_RRR_GradSideSlipAng: start 192, 5 bit, little-endian, data-type-policy=OVERRIDE, i-signal-type=PRIMITIVE, base-type=uint8, compu {phys=raw*0.0005 for raw 0..16; unit radian_times_squaresconds_per_meter}, to RA6_RRR  # #I_GradSideSlipAngle: Ego Gradient Side Slip angle
          signal Veh_SenConfig_RRR_PosX: start 72, 9 bit, little-endian, data-type-policy=OVERRIDE, i-signal-type=PRIMITIVE, base-type=uint16, compu {phys=raw*0.02-5.12 for raw 0..511; unit meter}, to RA6_RRR  # Nominal VehicleConfiging position in the longitudinal direction in vehicle road-level coordinate system."
          signal Veh_SenConfig_RRR_PosY: start 64, 8 bit, little-endian, data-type-policy=OVERRIDE, i-signal-type=PRIMITIVE, base-type=uint8, compu {phys=raw*0.01-1.28 for raw 0..255; unit meter}, to RA6_RRR  # Nominal VehicleConfiging position in the lateral direction in vehicle road-level coordinate system."
          signal Veh_SenConfig_RRR_PosZ: start 88, 5 bit, little-endian, data-type-policy=OVERRIDE, i-signal-type=PRIMITIVE, base-type=uint8, compu {phys=raw*0.05 for raw 0..31; unit meter}, to RA6_RRR  # Nominal VehicleConfiging position in the vertical direction in vehicle road-level coordinate system."
          signal Veh_SenConfig_RRR_SQC: start 16, 8 bit, little-endian, data-type-policy=OVERRIDE, i-signal-type=PRIMITIVE, base-type=uint8, compu {identical}, to RA6_RRR  # #I_COM_SequenceCtr Sequence Counter - Autosar E2E Profile 5."  # Alive counter - Autosar E2E Profile 11A"
          signal Veh_SenConfig_RRR_SnsTimeOffset: start 152, 7 bit, little-endian, data-type-policy=OVERRIDE, i-signal-type=PRIMITIVE, base-type=uint8, compu {phys=raw*0.5 for raw 0..100; unit milliseconds}, to RA6_RRR  # #I_SensorTimeOffset Time offset between overall start of the current cycle and start of modulation for the sensor. In order to reduce the interferences each sensor in a vehicle will received a different starting point for its modulation. This information is to be pre-defined in dependency of the sensor vehicle configuation and needs to be available at the sender side of this message. Important information: changes during runtime not allowed.
          signal Veh_SenConfig_RRR_SnsrOrientNomPitch: start 48, 14 bit, little-endian, data-type-policy=OVERRIDE, i-signal-type=PRIMITIVE, base-type=uint16, compu {phys=raw*0.00017-0.34816 for raw 0..4095; unit radian}, to RA6_RRR  # #I_ElevationMountAngle: Nominal Sensor mounting elevation (pitch) angle.Also known as Sensor Orientation Nominal Pitch.
          signal Veh_SenConfig_RRR_SnsrOrientNomYaw: start 24, 16 bit, little-endian, data-type-policy=OVERRIDE, i-signal-type=PRIMITIVE, base-type=uint16, compu {phys=raw*0.00017-5.57056 for raw 13944..51592; unit radian}, to RA6_RRR  # #I_AzimuthMountAngle: Nominal Sensor mounting azimuth (yaw) angle.Also known as Sensor Orientation Nominal Yaw.
          signal Veh_SenConfig_RRR_SnsrOrientation: start 176, 1 bit, little-endian, data-type-policy=OVERRIDE, i-signal-type=PRIMITIVE, base-type=boolean, compu {0=NORMAL_ORIENTATION, 1=FLIPPED_ORIENTATION}, to RA6_RRR  # #I_SensorOrientation: Orientation of the sensor. Whether it is flipped or normal mounted.Normal orientation - Connector on right or back-right side. Flipped orientation - Connector on left or back-left side
          signal Veh_SenConfig_RRR_StrRackRatio: start 200, 12 bit, little-endian, data-type-policy=OVERRIDE, i-signal-type=PRIMITIVE, base-type=uint16, compu {phys=raw*0.01 for raw 0..3000}, to RA6_RRR  # #I_SteeringRackRatioVehicle: Steering Rack Ratio
          signal Veh_SenConfig_RRR_SyncType: start 184, 2 bit, little-endian, data-type-policy=OVERRIDE, i-signal-type=PRIMITIVE, init-value=NumericalValueSpecification:1, base-type=uint8, compu {0=NO_SYNC, 1=MOD_INTERLEAVING, 2=CHIRP_INTERLEAVING, 3=RESERVED}, to RA6_RRR  # #I_SyncType: Enumeration values : see value table Note 1: There are two types of interleaving : modualtion or chirp interleaving. Note 2 : The Reserved value may be used for backwards compatibility to previous Generation 5 syncronization method "timeslot"
          signal Veh_SenConfig_RRR_VehicleWidthMax: start 104, 7 bit, little-endian, data-type-policy=OVERRIDE, i-signal-type=PRIMITIVE, base-type=uint8, compu {phys=raw*0.05 for raw 0..127; unit meter}, to RA6_RRR  # Maximum width of the vehicle"
          signal Veh_SenConfig_RRR_VehicleWidthMin: start 96, 7 bit, little-endian, data-type-policy=OVERRIDE, i-signal-type=PRIMITIVE, base-type=uint8, compu {phys=raw*0.05 for raw 0..127; unit meter}, to RA6_RRR  # Minimum width of the vehicle"
          signal Veh_SenConfig_RRR_WheelBase: start 144, 7 bit, little-endian, data-type-policy=OVERRIDE, i-signal-type=PRIMITIVE, base-type=uint8, compu {phys=raw*0.05 for raw 0..127; unit meter}, to RA6_RRR  # Longitudinal distance between front and rear axles"
          signal Veh_SenConfig_RRR_WheelCircFL: start 216, 9 bit, little-endian, data-type-policy=OVERRIDE, i-signal-type=PRIMITIVE, base-type=uint16, compu {phys=raw*0.01 for raw 0..500; unit meter}, to RA6_RRR  # #I_WheelCircumferenceFrontLeft: Front Left Wheel Circumference for the Ford Vehicle
          signal Veh_SenConfig_RRR_WheelCircFR: start 232, 9 bit, little-endian, data-type-policy=OVERRIDE, i-signal-type=PRIMITIVE, base-type=uint16, compu {phys=raw*0.01 for raw 0..500; unit meter}, to RA6_RRR  # #I_WheelCircumferenceFrontRight: Front Right Wheel Circumference for the Ford Vehicle
          signal Veh_SenConfig_RRR_WheelCircRL: start 248, 9 bit, little-endian, data-type-policy=OVERRIDE, i-signal-type=PRIMITIVE, base-type=uint16, compu {phys=raw*0.01 for raw 0..500; unit meter}, to RA6_RRR  # #I_WheelCircumferenceRearLeft: Rear Left Wheel Circumference for the Ford Vehicle
          signal Veh_SenConfig_RRR_WheelCircRR: start 264, 9 bit, little-endian, data-type-policy=OVERRIDE, i-signal-type=PRIMITIVE, base-type=uint16, compu {phys=raw*0.01 for raw 0..500; unit meter}, to RA6_RRR  # #I_WheelCircumferenceRearRight: Rear Right Wheel Circumference for the Ford Vehicle
          signal Veh_SenConfig_RRR_WheelTrack: start 128, 6 bit, little-endian, data-type-policy=OVERRIDE, i-signal-type=PRIMITIVE, base-type=uint8, compu {phys=raw*0.05 for raw 0..63; unit meter}, to RA6_RRR  # Distance between the centerline of two wheels on the same axle"
          signal Veh_SenConfig_RRR_dxvFrontBumper: start 112, 7 bit, little-endian, data-type-policy=OVERRIDE, i-signal-type=PRIMITIVE, base-type=uint8, compu {phys=raw*0.05 for raw 0..127; unit meter}, to RA6_RRR  # Longitudinal distance to the front bumper in the vehicle coordinate system with origin at center of the rear axle"
          signal Veh_SenConfig_RRR_dxvRearBumper: start 120, 6 bit, little-endian, data-type-policy=OVERRIDE, i-signal-type=PRIMITIVE, base-type=uint8, compu {phys=raw*0.05-3.15 for raw 0..63; unit meter}, to RA6_RRR  # Longitudinal distance to the rear bumper in the vehicle coordinate system with origin at center of the rear axle"
          signal Veh_SenConfig_RRR_vCh: start 160, 14 bit, little-endian, data-type-policy=OVERRIDE, i-signal-type=PRIMITIVE, base-type=uint16, compu {phys=raw*0.01 for raw 0..16383; unit meter_per_second}, to RA6_RRR  # Vehicle characteristic velocity: velocity at which the steering sensitivity of the vehicle is at maximum"
          mapping Veh_SensorConfig_RRR: i-signal-group=Veh_SensorConfig_RRR, transfer-property=TRIGGERED
      frame Veh_SensorInput: id 0xA, to RA6_RFC RA6_RFL RA6_RFR RA6_RRL RA6_RRR, frame-length=64, can-addressing-mode=STANDARD, can-fd-frame-support=true, can-frame-rx-behavior=CAN-FD, can-frame-tx-behavior=CAN-FD  # Radar VehicleInput Information - Data is usually changing during power cycle
        pdu Veh_SensorInput: length=64, transmission-mode-true-timing=cyclic-timing={time-offset=0.0, time-period=0.02}, unused-bit-pattern=0  # Radar VehicleInput Information - Data is usually changing during power cycle
          signal Veh_SenIn_ABSActive: start 24, 1 bit, little-endian, data-type-policy=OVERRIDE, i-signal-type=PRIMITIVE, base-type=boolean, compu {identical}, to RA6_RFR  # Anti-Lock Braking System Intervention Active"
          signal Veh_SenIn_ASRActive: start 25, 1 bit, little-endian, data-type-policy=OVERRIDE, i-signal-type=PRIMITIVE, base-type=boolean, compu {identical}, to RA6_RFR  # Traction Control System Intervention Active"
          signal Veh_SenIn_AirAmb_Temp: start 450, 8 bit, little-endian, data-type-policy=OVERRIDE, i-signal-type=PRIMITIVE, init-value=NumericalValueSpecification:80, base-type=uint8, compu {phys=raw*0.5-40 for raw 0..253, 254=UNKNOWN, 255=SNA; unit degrees_celsius}, to RA6_RFR  # #I_AirAmb_Temp: Ambient Air Temperature interface.Note: Values between 0 and 253 reflect the actual ambient temperature.
          signal Veh_SenIn_AngleStrWhlQf: start 56, 2 bit, little-endian, data-type-policy=OVERRIDE, i-signal-type=PRIMITIVE, base-type=uint8, compu {0=QF_FAULTY, 1=QF_NODATAEXISTS, 2=QF_NOTWITHINSPECIFICATION, 3=QF_OK}, to RA6_RFR  # #I_AngleSteeringWheelQualification: Qualifier Signal for Steering Wheel Angle
          signal Veh_SenIn_CRC: start 0, 16 bit, little-endian, data-type-policy=OVERRIDE, i-signal-type=PRIMITIVE, base-type=uint16, compu {identical}, to RA6_RFR  # CRC - Autosar E2E Profile 5 - Data ID : 0x2200"
          signal Veh_SenIn_ECU_Input_Vltg: start 74, 8 bit, little-endian, data-type-policy=OVERRIDE, i-signal-type=PRIMITIVE, base-type=uint8, compu {phys=raw*0.1 for raw 0..250; unit volt}, to RA6_RFR  # #I_ADAS_ECU_Input_Vltg: Input Voltage to the ADAS ECU (main ECU voltage supply)
          signal Veh_SenIn_ESPActive: start 26, 1 bit, little-endian, data-type-policy=OVERRIDE, i-signal-type=PRIMITIVE, base-type=boolean, compu {identical}, to RA6_RFR  # Vehicle Dynamics Control Intervention Active"
          signal Veh_SenIn_ESPEnabled: start 484, 1 bit, little-endian, data-type-policy=OVERRIDE, i-signal-type=PRIMITIVE, base-type=boolean, compu {0=ESP_DISABLED, 1=ESP_ENABLED}, to RA6_RFR  # #I_ESPEnabled:ESC Enabled Flag -The state (turned on or off) of Traction Control System is considered in the wheel slip detection under wheel sliping situations.
          signal Veh_SenIn_GearLvr_D_ActlDrv: start 28, 4 bit, little-endian, data-type-policy=OVERRIDE, i-signal-type=PRIMITIVE, init-value=14, base-type=uint8, compu {0=PARK, 1=REVERSE, 2=NEUTRAL, 3=DRIVE, 4=SPORT_DRIVESPORT_MPOSITION, 5=LOW, 6=RANGE1_M1_L1, 7=RANGE2_M2_L2, 8=RANGE3_M3_L3, 9=RANGE4, 10=RANGE5, 11=RANGE6, 12=NOTUSED_1, 13=NOTUSED_2, 14=UNKNOWN_POSITION, 15=FAULT}, to RA6_RFC  # shift lever position as commanded by the driver."
          signal Veh_SenIn_HmiAExRevEgo_Cust: start 458, 2 bit, little-endian, data-type-policy=OVERRIDE, i-signal-type=PRIMITIVE, base-type=uint8, compu {0=DEFAULT, 1=EARLY_WARNING, 2=LATE_WARNING, 3=SNA}, to RA6_RFR  # #I_HMI_AEx_revEgo_Customization: TTC customization option for AEx revEgoLongTgtCross function
          signal Veh_SenIn_HmiAExRevEgo_Switch: start 460, 2 bit, little-endian, data-type-policy=OVERRIDE, i-signal-type=PRIMITIVE, base-type=uint8, compu {0=BOTH_WARNING_AND_BRAKING_ENABLED, 1=ONLY_WARNING_ENABLED, 2=BOTH_WARNING_AND_BRAKING_DISABLED, 3=SNA}, to RA6_RFR  # #I_HMI_AEx_revEgo_Switch: AEx revEgoLongTgtCross function is enabled/disabled on HMI
          signal Veh_SenIn_HmiBsdLca_Cust: start 462, 2 bit, little-endian, data-type-policy=OVERRIDE, i-signal-type=PRIMITIVE, base-type=uint8, compu {0=DEFAULT, 1=EARLY_WARNING, 2=LATE_WARNING, 3=SNA}, to RA6_RFR  # #I_HMI_BSD_LCA_Customization: TTC customization option for BSD/LCA function.
          signal Veh_SenIn_HmiBsdLca_Switch: start 464, 2 bit, little-endian, data-type-policy=OVERRIDE, i-signal-type=PRIMITIVE, base-type=uint8, compu {0=ENABLED, 1=DISABLED, 2=RESERVED, 3=SNA}, to RA6_RFR  # #I_HMI_BSD_LCA_Switch: BSD/LCA function is enabled/disabled on HMI
          signal Veh_SenIn_HmiDOx_Cust: start 466, 2 bit, little-endian, data-type-policy=OVERRIDE, i-signal-type=PRIMITIVE, base-type=uint8, compu {0=DEFAULT, 1=EARLY_WARNING, 2=LATE_WARNING, 3=SNA}, to RA6_RFR  # #I_HMI_DOx_Customization: TTC customization option for DOx function
          signal Veh_SenIn_HmiDOx_Switch: start 468, 2 bit, little-endian, data-type-policy=OVERRIDE, i-signal-type=PRIMITIVE, base-type=uint8, compu {0=BOTH_WARNING_AND_PREVENTION_ENABLED, 1=ONLY_WARNING_ENABLED, 2=BOTH_WARNING_AND_PREVENTION_DISABLED, 3=SNA}, to RA6_RFR  # #I_HMI_DOx_Switch: DOx function is enabled/disabled on HMI
          signal Veh_SenIn_LatAccel: start 82, 10 bit, little-endian, data-type-policy=OVERRIDE, i-signal-type=PRIMITIVE, init-value=511, base-type=uint16, compu {phys=raw*0.035-17.9 for raw 0..1023; unit meter_per_squareseconds}, to RA6_RFR  # Vehicle Lateral Acceleration"
          signal Veh_SenIn_LatAccelQf: start 178, 2 bit, little-endian, data-type-policy=OVERRIDE, i-signal-type=PRIMITIVE, base-type=uint8, compu {0=QF_FAULTY, 1=QF_NODATAEXISTS, 2=QF_NOTWITHINSPECIFICATIONS, 3=QF_OK}, to RA6_RRR  # Qualifier status for lateral accelreration 0: QF_FAULTY 1: QF_NODATAEXISTS 2: QF_NOTWITHINSPECIFICATIONS 3: QF_OK"
          signal Veh_SenIn_LeFrntDoorStatus: start 470, 2 bit, little-endian, data-type-policy=OVERRIDE, i-signal-type=PRIMITIVE, base-type=uint8, compu {0=CLOSED, 1=OPEN, 2=RESERVED, 3=SNA}, to RA6_RFR  # #I_LeftFrontDoor_Status:Status of the front left door
          signal Veh_SenIn_LeReDoorStatus: start 472, 2 bit, little-endian, data-type-policy=OVERRIDE, i-signal-type=PRIMITIVE, base-type=uint8, compu {0=CLOSED, 1=OPEN, 2=RESERVED, 3=SNA}, to RA6_RFR  # #I_LeftRearDoor_Status: Status of the rear left door
          signal Veh_SenIn_LongAccel: start 92, 10 bit, little-endian, data-type-policy=OVERRIDE, i-signal-type=PRIMITIVE, init-value=511, base-type=uint16, compu {phys=raw*0.035-17.9 for raw 0..1023; unit meter_per_squareseconds}, to RA6_RFR  # Vehicle Longitudinal Acceleration"
          signal Veh_SenIn_LongAccelQf: start 180, 2 bit, little-endian, data-type-policy=OVERRIDE, i-signal-type=PRIMITIVE, base-type=uint8, compu {0=QF_FAULTY, 1=QF_NODATAEXISTS, 2=QF_NOTWITHINSPECIFICATIONS, 3=QF_OK}, to RA6_RFR  # Qualifier status for longitudinal accelreration 0: QF_FAULTY 1: QF_NODATAEXISTS 2: QF_NOTWITHINSPECIFICATIONS 3: QF_OK"
          signal Veh_SenIn_Odometer_ET: start 210, 24 bit, little-endian, data-type-policy=OVERRIDE, i-signal-type=PRIMITIVE, base-type=uint32, compu {phys=raw for raw 0..16777214, 16777215=INVALID; unit kilometer}, to RA6_RFR  # Total Distance Driven"
          signal Veh_SenIn_RadioAstronomy: start 482, 1 bit, little-endian, data-type-policy=OVERRIDE, i-signal-type=PRIMITIVE, base-type=boolean, compu {0=RADIO_PROTECTION_DISABLED, 1=RADIO_PROTECTION_ENABLED}, to RA6_RRR  # #I_RadioAstronomyProtection: Flag to indicate whether the vehicle is located in the vecinity of a Radio Astronomy Protected site
          signal Veh_SenIn_RiFrntDoorStatus: start 474, 2 bit, little-endian, data-type-policy=OVERRIDE, i-signal-type=PRIMITIVE, base-type=uint8, compu {0=CLOSED, 1=OPEN, 2=RESERVED, 3=SNA}, to RA6_RFR  # #I_RightFrontDoor_Status: Status of the front right door
          signal Veh_SenIn_RiReDoorStatus: start 476, 2 bit, little-endian, data-type-policy=OVERRIDE, i-signal-type=PRIMITIVE, base-type=uint8, compu {0=CLOSED, 1=OPEN, 2=RESERVED, 3=SNA}, to RA6_RFR  # #I_RightRearDoor_Status: Status of the rear right door
          signal Veh_SenIn_SQC: start 16, 8 bit, little-endian, data-type-policy=OVERRIDE, i-signal-type=PRIMITIVE, base-type=uint8, compu {identical}, to RA6_RFR  # Alive counter - Autosar E2E Profile 5"
          signal Veh_SenIn_StrWhlAngSpd: start 58, 16 bit, little-endian, data-type-policy=OVERRIDE, i-signal-type=PRIMITIVE, base-type=uint16, compu {phys=raw*0.2-3600 for raw 0..36000; unit arcdegree_per_s}, to RA6_RFR  # #I_AngleSpeedSteeringWheel: Steering Wheel Angle Speed Interface.
          signal Veh_SenIn_StrWhlAngle: start 40, 15 bit, little-endian, data-type-policy=OVERRIDE, i-signal-type=PRIMITIVE, base-type=uint16, compu {phys=raw*0.1-1600 for raw 0..32767; unit arcdegree}, to RA6_RFR  # #I_AngleSteeringWheel: Vehicle Steering Wheel Angle.
          signal Veh_SenIn_TrailerConnSt: start 478, 2 bit, little-endian, data-type-policy=OVERRIDE, i-signal-type=PRIMITIVE, base-type=uint8, compu {0=NOT_CONNECTED, 1=CONNECTED, 2=RESERVED, 3=SNA}, to RA6_RFR  # #I_TrailerConnection_Status: Trailer connection status
          signal Veh_SenIn_TurnIndrSt: start 480, 2 bit, little-endian, data-type-policy=OVERRIDE, i-signal-type=PRIMITIVE, base-type=uint8, compu {0=DEFAULT, 1=LEFT, 2=RIGHT, 3=SNA}, to RA6_RFR  # #I_TurnIndicator_Status: Turn indication lever status
          signal Veh_SenIn_VSUActvtyStat: start 437, 3 bit, little-endian, data-type-policy=OVERRIDE, i-signal-type=PRIMITIVE, base-type=uint8, compu {0=IDLE, 1=SYNCING, 2=VEHICLE_PACKAGE_TRANSFERRING, 3=SOFTWARE_PACKAGE_TRANSFERRING, 4=PROCESSING, 5=ACTIVATION_PENDING, 6=ACTIVATING, 7=UNKNOWN}, to RA6_RFR  # #I_SW_UpdateStatus: Status of the software update
          signal Veh_SenIn_VSUInhbtStat: start 440, 1 bit, little-endian, data-type-policy=OVERRIDE, i-signal-type=PRIMITIVE, base-type=boolean, compu {0=NO_INHIBIT, 1=INHIBIT}, to RA6_RFR  # #I_SW_InhibitStatus: Inhibition status of the software update
          signal Veh_SenIn_VehCfgParamLearnReq: start 436, 1 bit, little-endian, data-type-policy=OVERRIDE, i-signal-type=PRIMITIVE, base-type=boolean, compu {0=NO_UPDATE_AVAILABLE, 1=UPDATE_AVAILABLE}, to RA6_RFL  # #I_VehicleConfigParamLearnRequest: Status of the learn request for vehicle configuration parameters
          signal Veh_SenIn_VehOverGnd_Est: start 192, 16 bit, little-endian, data-type-policy=OVERRIDE, i-signal-type=PRIMITIVE, base-type=uint16, compu {phys=raw*0.01 for raw 0..65533, 65534=UNKNOWN, 65535=INVALID; unit kilometer_per_hour}, to RA6_RFR  # Estimated vehicle speed over ground."
          signal Veh_SenIn_VehOverGnd_EstQf: start 208, 2 bit, little-endian, data-type-policy=OVERRIDE, i-signal-type=PRIMITIVE, base-type=uint8, compu {0=QF_FAULTY, 1=QF_NODATAEXISTS, 2=QF_NOTWITHINSPECIFICATIONS, 3=QF_OK}, to RA6_RFR  # Qualifier status for estimated vehicle speed over ground. 0: QF_FAULTY 1: QF_NODATAEXISTS 2: QF_NOTWITHINSPECIFICATIONS 3: QF_OK"
          signal Veh_SenIn_VehPwrModStat: start 426, 8 bit, little-endian, data-type-policy=OVERRIDE, i-signal-type=PRIMITIVE, base-type=uint8, compu {identical}, to RA6_RFR  # #I_VehiclePowerModeStatus: Vehicle Power Mode Status * Value 0x00 - NOT_USED_0 * Value 0x10 - VEHICLE_OFF_LOW_12V_CAPACITY * Value 0x20 - VEHICLE_OFF_NORMAL_12V_CAPACITY * Value 0x30 - NOT_USED_3 * Value 0x40 - VEHICLE_OFF_12V_SYSTEM_ACTIVATION_STATE_WITH_SUPPORT_FROM_HV_SYSTEM * Value 0x50 - VEHICLE_ON_ALL_MODULES_ACTIVATED_PROPULSION_SYSTEM_CAPABLE_PRE_DRIVE_FULL_ACCESSORY * Value 0x60 - VEHICLE_ON_POST_DRIVING_CUSTOMER_ACTIVATED_POST_DRIVE * Value 0x70 - VEHICLE_ON_VEHICLE_PROPULSION_SYSTEM_ACTIVATED_DRIVE
          signal Veh_SenIn_VehPwrModStatQf: start 434, 2 bit, little-endian, data-type-policy=OVERRIDE, i-signal-type=PRIMITIVE, base-type=uint8, compu {0=QF_FAULTY, 1=QF_NODATAEXISTS, 2=QF_NOTWITHINSPECIFICATIONS, 3=QF_OK}, to RA6_RFR  # #I_VehiclePowerModeStatusQualification: Vehicle Power Mode Status Qualification
          signal Veh_SenIn_WheelDirFL: start 442, 2 bit, little-endian, data-type-policy=OVERRIDE, i-signal-type=PRIMITIVE, base-type=uint8, compu {0=FORWARD, 1=BACKWARD, 2=INIT, 3=INVALID}, to RA6_RFR  # Front Left Wheel Direction 0  Forward 1  Backward 2  No Data Exists 3  Faulty"
          signal Veh_SenIn_WheelDirFR: start 444, 2 bit, little-endian, data-type-policy=OVERRIDE, i-signal-type=PRIMITIVE, base-type=uint8, compu {0=FORWARD, 1=BACKWARD, 2=INIT, 3=INVALID}, to RA6_RFR  # Front Right Wheel Direction 0  Forward 1  Backward 2  No Data Exists 3  Faulty"
          signal Veh_SenIn_WheelDirRL: start 446, 2 bit, little-endian, data-type-policy=OVERRIDE, i-signal-type=PRIMITIVE, base-type=uint8, compu {0=FORWARD, 1=BACKWARD, 2=INIT, 3=INVALID}, to RA6_RFR  # Rear Left Wheel Direction 0  Forward 1  Backward 2  No Data Exists 3  Faulty"
          signal Veh_SenIn_WheelDirRR: start 448, 2 bit, little-endian, data-type-policy=OVERRIDE, i-signal-type=PRIMITIVE, base-type=uint8, compu {0=FORWARD, 1=BACKWARD, 2=INIT, 3=INVALID}, to RA6_RFR  # Rear Right Wheel Direction 0  Forward 1  Backward 2  No Data Exists 3  Faulty"
          signal Veh_SenIn_WheelSpeedFL: start 102, 15 bit, little-endian, data-type-policy=OVERRIDE, i-signal-type=PRIMITIVE, base-type=uint16, compu {phys=raw*0.01 for raw 0..32767; unit radian_per_second}, to RA6_RFL  # Front Left Wheel Speed"
          signal Veh_SenIn_WheelSpeedFLQf: start 182, 2 bit, little-endian, data-type-policy=OVERRIDE, i-signal-type=PRIMITIVE, base-type=uint8, compu {0=QF_FAULTY, 1=QF_NODATAEXISTS, 2=QF_NOTWITHINSPECIFICATIONS, 3=QF_OK}, to RA6_RFR  # Qualifier status for Front Left Wheel Speed 0: QF_FAULTY 1: QF_NODATAEXISTS 2: QF_NOTWITHINSPECIFICATIONS 3: QF_OK"
          signal Veh_SenIn_WheelSpeedFR: start 118, 15 bit, little-endian, data-type-policy=OVERRIDE, i-signal-type=PRIMITIVE, base-type=uint16, compu {phys=raw*0.01 for raw 0..32767; unit radian_per_second}, to RA6_RRR  # Front Right Wheel Speed"
          signal Veh_SenIn_WheelSpeedFRQf: start 184, 2 bit, little-endian, data-type-policy=OVERRIDE, i-signal-type=PRIMITIVE, base-type=uint8, compu {0=QF_FAULTY, 1=QF_NODATAEXISTS, 2=QF_NOTWITHINSPECIFICATIONS, 3=QF_OK}, to RA6_RFR  # Qualifier status for Front Right Wheel Speed 0: QF_FAULTY 1: QF_NODATAEXISTS 2: QF_NOTWITHINSPECIFICATIONS 3: QF_OK"
          signal Veh_SenIn_WheelSpeedRL: start 134, 15 bit, little-endian, data-type-policy=OVERRIDE, i-signal-type=PRIMITIVE, base-type=uint16, compu {phys=raw*0.01 for raw 0..32767; unit radian_per_second}, to RA6_RRR  # Rear Left Wheel Speed"
          signal Veh_SenIn_WheelSpeedRLQf: start 186, 2 bit, little-endian, data-type-policy=OVERRIDE, i-signal-type=PRIMITIVE, base-type=uint8, compu {0=QF_FAULTY, 1=QF_NODATAEXISTS, 2=QF_NOTWITHINSPECIFICATIONS, 3=QF_OK}, to RA6_RFR  # Qualifier Status for Rear Left Wheel Speed 0: QF_FAULTY 1: QF_NODATAEXISTS 2: QF_NOTWITHINSPECIFICATIONS 3: QF_OK"
          signal Veh_SenIn_WheelSpeedRR: start 150, 15 bit, little-endian, data-type-policy=OVERRIDE, i-signal-type=PRIMITIVE, base-type=uint16, compu {phys=raw*0.01 for raw 0..32767; unit radian_per_second}, to RA6_RFR  # Rear Right Wheel Speed"
          signal Veh_SenIn_WheelSpeedRRQf: start 188, 2 bit, little-endian, data-type-policy=OVERRIDE, i-signal-type=PRIMITIVE, base-type=uint8, compu {0=QF_FAULTY, 1=QF_NODATAEXISTS, 2=QF_NOTWITHINSPECIFICATIONS, 3=QF_OK}, to RA6_RFR  # Qualifier Status for Rear Right Wheel Speed 0: QF_FAULTY 1: QF_NODATAEXISTS 2: QF_NOTWITHINSPECIFICATIONS 3: QF_OK"
          signal Veh_SenIn_WheelTicksFL: start 234, 8 bit, little-endian, data-type-policy=OVERRIDE, i-signal-type=PRIMITIVE, base-type=uint8, compu {identical}, to RA6_RFR  # #I_WheelTicksFrontLeft: Wheel Ticks information for Front Left Wheel the Ford Vehicle
          signal Veh_SenIn_WheelTicksFR: start 242, 8 bit, little-endian, data-type-policy=OVERRIDE, i-signal-type=PRIMITIVE, base-type=uint8, compu {identical}, to RA6_RFR  # #I_WheelTicksFrontRight: Wheel Ticks information for Front Right Wheel the Ford Vehicle
          signal Veh_SenIn_WheelTicksRL: start 250, 8 bit, little-endian, data-type-policy=OVERRIDE, i-signal-type=PRIMITIVE, base-type=uint8, compu {identical}, to RA6_RFR  # #I_WheelTicksRearLeft: Wheel Ticks information for Rear Left Wheel the Ford Vehicle
          signal Veh_SenIn_WheelTicksRR: start 258, 8 bit, little-endian, data-type-policy=OVERRIDE, i-signal-type=PRIMITIVE, base-type=uint8, compu {identical}, to RA6_RFR  # #I_WheelTicksRearRight: Wheel Ticks information for Rear Right Wheel the Ford Vehicle
          signal Veh_SenIn_WhlSpdTimestmpCmpFL: start 266, 32 bit, little-endian, data-type-policy=OVERRIDE, i-signal-type=PRIMITIVE, base-type=uint32, compu {identical; unit milliseconds}, to RA6_RFR  # #I_WheelSpeedTimestampCompensateFL: Timestamp value based on radar location timebase taken at the measurement of the wheelspeed signal or when wheelspeed signal is first seen on an ECU that can provide the timestamp. Time compensation shall be added if timestamp is not placed by the measuring ECU of the referenced signal.
          signal Veh_SenIn_WhlSpdTimestmpCmpFR: start 298, 32 bit, little-endian, data-type-policy=OVERRIDE, i-signal-type=PRIMITIVE, base-type=uint32, compu {identical; unit milliseconds}, to RA6_RFR  # #I_WheelSpeedTimestampCompensateFR: Timestamp value based on radar location timebase taken at the measurement of the wheelspeed signal or when wheelspeed signal is first seen on an ECU that can provide the timestamp. Time compensation shall be added if timestamp is not placed by the measuring ECU of the referenced signal.
          signal Veh_SenIn_WhlSpdTimestmpCmpRL: start 330, 32 bit, little-endian, data-type-policy=OVERRIDE, i-signal-type=PRIMITIVE, base-type=uint32, compu {identical; unit milliseconds}, to RA6_RFR  # #I_WheelSpeedTimestampCompensateRL: Timestamp value based on radar location timebase taken at the measurement of the wheelspeed signal or when wheelspeed signal is first seen on an ECU that can provide the timestamp. Time compensation shall be added if timestamp is not placed by the measuring ECU of the referenced signal.
          signal Veh_SenIn_WhlSpdTimestmpCmpRR: start 362, 32 bit, little-endian, data-type-policy=OVERRIDE, i-signal-type=PRIMITIVE, base-type=uint32, compu {identical; unit milliseconds}, to RA6_RRR  # #I_WheelSpeedTimestampCompensateRR: Timestamp value based on radar location timebase taken at the measurement of the wheelspeed signal or when wheelspeed signal is first seen on an ECU that can provide the timestamp. Time compensation shall be added if timestamp is not placed by the measuring ECU of the referenced signal.
          signal Veh_SenIn_WiperFrontSt: start 32, 4 bit, little-endian, data-type-policy=OVERRIDE, i-signal-type=PRIMITIVE, base-type=uint8, compu {0=WIPRFRNTD_OFF, 1=WIPRFRNTD_AUTO_OFF, 2=WIPRFRNTD_OFF_MOVING, 3=WIPRFRNTD_MAN_INT_OFF, 4=WIPRFRNTD_MAN_INT_ON, 5=WIPRFRNTD_MAN_LOW, 6=WIPRFRNTD_MAN_HIGH, 7=WIPRFRNTD_MIST_FLICK, 8=WIPRFRNTD_WASH, 9=WIPRFRNTD_AUTO_LOW, 10=WIPRFRNTD_AUTO_HIGH, 11=WIPRFRNTD_COURTESYWIPE, 12=WIPRFRNTD_AUTO_ADJUST, 13=WIPRFRNTD_NOT_USED, 14=WIPRFRNTD_STALLED, 15=WIPRFRNTD_NO_DATA_EXISTS}, to RA6_RFR  # #I_FrontWiperStatus: Front Wiper Status for the Ford Vehicles
          signal Veh_SenIn_WiperRearSt: start 36, 3 bit, little-endian, data-type-policy=OVERRIDE, i-signal-type=PRIMITIVE, base-type=uint8, compu {0=OFF, 1=MIST, 2=AUTO, 3=LOWSPEED, 4=HIGHSPEED, 5=RESERVED1, 6=RESERVED2, 7=INVALID}, to RA6_RFR  # 0x0 -- OFF 0x1 -- MIST 0x2 -- Auto 0x3 -- Low Speed 0x4 -- High Speed 0x5 -- Reserved 0x6 -- Reserved 0x7 -- Invalid. "
          signal Veh_SenIn_YawRate: start 166, 12 bit, little-endian, data-type-policy=OVERRIDE, i-signal-type=PRIMITIVE, init-value=2047, base-type=uint16, compu {phys=raw*0.03663-75 for raw 0..4095; unit arcdegree_per_s}, to RA6_RFR  # Vehicle Yaw Rate Positive Yaw - Left of the direction of motion Negative Yaw - Right of the direction of motion "
          signal Veh_SenIn_YawRateQf: start 190, 2 bit, little-endian, data-type-policy=OVERRIDE, i-signal-type=PRIMITIVE, base-type=uint8, compu {0=QF_FAULTY, 1=QF_NODATAEXISTS, 2=QF_NOTWITHINSPECIFICATIONS, 3=QF_OK}, to RA6_RFR  # Qualifier status for Vehicle Yaw Rate 0: QF_FAULTY 1: QF_NODATAEXISTS 2: QF_NOTWITHINSPECIFICATIONS 3: QF_OK"
          signal Veh_SenIn_YawRateTimestmpCmp: start 394, 32 bit, little-endian, data-type-policy=OVERRIDE, i-signal-type=PRIMITIVE, base-type=uint32, compu {identical; unit milliseconds}, to RA6_RFR  # #I_YawTimestampCompensate: Timestamp value based on radar location timebase taken at the measurement of the signal or when signal is first seen on an ECU that can provide the timestamp.
          mapping Veh_SensorInput: i-signal-group=Veh_SensorInput
      frame XCP_RFC_Req: id 0x77C, to RA6_RFC, frame-length=64, can-addressing-mode=STANDARD, can-fd-frame-support=true, can-frame-rx-behavior=CAN-FD, can-frame-tx-behavior=CAN-FD  # XCP protocol data request
        general purpose i pdu XCP_RFC_Req: category=XCP, length=64  # XCP protocol data request
      frame XCP_RFC_Resp: id 0x77D, from RA6_RFC, frame-length=64, can-addressing-mode=STANDARD, can-fd-frame-support=true, can-frame-rx-behavior=CAN-FD, can-frame-tx-behavior=CAN-FD  # XCP protocol data response
        general purpose i pdu XCP_RFC_Resp: category=XCP, length=64  # XCP protocol data response
      frame XCP_RFL_Req: id 0x77E, to RA6_RFL, frame-length=64, can-addressing-mode=STANDARD, can-fd-frame-support=true, can-frame-rx-behavior=CAN-FD, can-frame-tx-behavior=CAN-FD  # XCP protocol data request
        general purpose i pdu XCP_RFL_Req: category=XCP, length=64  # XCP protocol data request
      frame XCP_RFL_Resp: id 0x77F, from RA6_RFL, frame-length=64, can-addressing-mode=STANDARD, can-fd-frame-support=true, can-frame-rx-behavior=CAN-FD, can-frame-tx-behavior=CAN-FD  # XCP protocol data response
        general purpose i pdu XCP_RFL_Resp: category=XCP, length=64  # XCP protocol data response
      frame XCP_RFR_Req: id 0x780, to RA6_RFR, frame-length=64, can-addressing-mode=STANDARD, can-fd-frame-support=true, can-frame-rx-behavior=CAN-FD, can-frame-tx-behavior=CAN-FD  # XCP protocol data request
        general purpose i pdu XCP_RFR_Req: category=XCP, length=64  # XCP protocol data request
      frame XCP_RFR_Resp: id 0x781, from RA6_RFR, frame-length=64, can-addressing-mode=STANDARD, can-fd-frame-support=true, can-frame-rx-behavior=CAN-FD, can-frame-tx-behavior=CAN-FD  # XCP protocol data response
        general purpose i pdu XCP_RFR_Resp: category=XCP, length=64  # XCP protocol data response
      frame XCP_RRL_Req: id 0x782, to RA6_RRL, frame-length=64, can-addressing-mode=STANDARD, can-fd-frame-support=true, can-frame-rx-behavior=CAN-FD, can-frame-tx-behavior=CAN-FD  # XCP protocol data request
        general purpose i pdu XCP_RRL_Req: category=XCP, length=64  # XCP protocol data request
      frame XCP_RRL_Resp: id 0x783, from RA6_RRL, frame-length=64, can-addressing-mode=STANDARD, can-fd-frame-support=true, can-frame-rx-behavior=CAN-FD, can-frame-tx-behavior=CAN-FD  # XCP protocol data response
        general purpose i pdu XCP_RRL_Resp: category=XCP, length=64  # XCP protocol data response
      frame XCP_RRR_Req: id 0x784, to RA6_RRR, frame-length=64, can-addressing-mode=STANDARD, can-fd-frame-support=true, can-frame-rx-behavior=CAN-FD, can-frame-tx-behavior=CAN-FD  # XCP protocol data request
        general purpose i pdu XCP_RRR_Req: category=XCP, length=64  # XCP protocol data request
      frame XCP_RRR_Resp: id 0x785, from RA6_RRR, frame-length=64, can-addressing-mode=STANDARD, can-fd-frame-support=true, can-frame-rx-behavior=CAN-FD, can-frame-tx-behavior=CAN-FD  # XCP protocol data response
        general purpose i pdu XCP_RRR_Resp: category=XCP, length=64  # XCP protocol data response
      pdu triggering PduTrig_Diag_RFC_TesterFunctionalReq_Dcm: pdu=Diag_RFC_TesterFunctionalReq_Dcm, to RA6_RFC
      pdu triggering PduTrig_Diag_RFC_TesterPhysicalReq_Dcm: pdu=Diag_RFC_TesterPhysicalReq_Dcm, to RA6_RFC
      pdu triggering PduTrig_Diag_RFC_TesterPhysicalResp_Dcm: pdu=Diag_RFC_TesterPhysicalResp_Dcm, from RA6_RFC
      pdu triggering PduTrig_Diag_RFL_TesterFunctionalReq_Dcm: pdu=Diag_RFL_TesterFunctionalReq_Dcm, to RA6_RFL
      pdu triggering PduTrig_Diag_RFL_TesterPhysicalReq_Dcm: pdu=Diag_RFL_TesterPhysicalReq_Dcm, to RA6_RFL
      pdu triggering PduTrig_Diag_RFL_TesterPhysicalResp_Dcm: pdu=Diag_RFL_TesterPhysicalResp_Dcm, from RA6_RFL
      pdu triggering PduTrig_Diag_RFR_TesterFunctionalReq_Dcm: pdu=Diag_RFR_TesterFunctionalReq_Dcm, to RA6_RFR
      pdu triggering PduTrig_Diag_RFR_TesterPhysicalReq_Dcm: pdu=Diag_RFR_TesterPhysicalReq_Dcm, to RA6_RFR
      pdu triggering PduTrig_Diag_RFR_TesterPhysicalResp_Dcm: pdu=Diag_RFR_TesterPhysicalResp_Dcm, from RA6_RFR
      pdu triggering PduTrig_Diag_RRL_TesterFunctionalReq_Dcm: pdu=Diag_RRL_TesterFunctionalReq_Dcm, to RA6_RRL
      pdu triggering PduTrig_Diag_RRL_TesterPhysicalReq_Dcm: pdu=Diag_RRL_TesterPhysicalReq_Dcm, to RA6_RRL
      pdu triggering PduTrig_Diag_RRL_TesterPhysicalResp_Dcm: pdu=Diag_RRL_TesterPhysicalResp_Dcm, from RA6_RRL
      pdu triggering PduTrig_Diag_RRR_TesterFunctionalReq_Dcm: pdu=Diag_RRR_TesterFunctionalReq_Dcm, to RA6_RRR
      pdu triggering PduTrig_Diag_RRR_TesterPhysicalReq_Dcm: pdu=Diag_RRR_TesterPhysicalReq_Dcm, to RA6_RRR
      pdu triggering PduTrig_Diag_RRR_TesterPhysicalResp_Dcm: pdu=Diag_RRR_TesterPhysicalResp_Dcm, from RA6_RRR
      pdu triggering PduTrig_RFC_FieldDataCollection: pdu=RFC_FieldDataCollection, from RA6_RFC
      pdu triggering PduTrig_RFC_Object: pdu=RFC_Object, from RA6_RFC
      pdu triggering PduTrig_RFC_RoadSideBoundaries: pdu=RFC_RoadSideBoundaries, from RA6_RFC
      pdu triggering PduTrig_RFL_FieldDataCollection: pdu=RFL_FieldDataCollection, from RA6_RFL
      pdu triggering PduTrig_RFL_Object: pdu=RFL_Object, from RA6_RFL
      pdu triggering PduTrig_RFL_RoadSideBoundaries: pdu=RFL_RoadSideBoundaries, from RA6_RFL
      pdu triggering PduTrig_RFR_FieldDataCollection: pdu=RFR_FieldDataCollection, from RA6_RFR
      pdu triggering PduTrig_RFR_Object: pdu=RFR_Object, from RA6_RFR
      pdu triggering PduTrig_RFR_RoadSideBoundaries: pdu=RFR_RoadSideBoundaries, from RA6_RFR
      pdu triggering PduTrig_RRL_FieldDataCollection: pdu=RRL_FieldDataCollection, from RA6_RRL
      pdu triggering PduTrig_RRL_Object: pdu=RRL_Object, from RA6_RRL
      pdu triggering PduTrig_RRL_RoadSideBoundaries: pdu=RRL_RoadSideBoundaries, from RA6_RRL
      pdu triggering PduTrig_RRR_FieldDataCollection: pdu=RRR_FieldDataCollection, from RA6_RRR
      pdu triggering PduTrig_RRR_Object: pdu=RRR_Object, from RA6_RRR
      pdu triggering PduTrig_RRR_RoadSideBoundaries: pdu=RRR_RoadSideBoundaries, from RA6_RRR
package /RA6/Pkg_E2E
  end to end protection set E2E_ProtectionSet
    11 x end to end protection:
      E2E_Prot_RFC_CornerFunctions: end-to-end-profile={category=PROFILE_05, data-ids=2202, data-length=96, max-delta-counter-init=3, crc-offset=0, counter-offset=16}, end-to-end-protection-i-signal-i-pdu{data-offset=0, i-signal-group=RFC_CornerFunctions, i-signal-i-pdu=RFC_CornerFunctions}
      E2E_Prot_RFL_CornerFunctions: end-to-end-profile={category=PROFILE_05, data-ids=2202, data-length=96, max-delta-counter-init=3, crc-offset=0, counter-offset=16}, end-to-end-protection-i-signal-i-pdu{data-offset=0, i-signal-group=RFL_CornerFunctions, i-signal-i-pdu=RFL_CornerFunctions}
      E2E_Prot_RFR_CornerFunctions: end-to-end-profile={category=PROFILE_05, data-ids=2202, data-length=96, max-delta-counter-init=3, crc-offset=0, counter-offset=16}, end-to-end-protection-i-signal-i-pdu{data-offset=0, i-signal-group=RFR_CornerFunctions, i-signal-i-pdu=RFR_CornerFunctions}
      E2E_Prot_RRL_CornerFunctions: end-to-end-profile={category=PROFILE_05, data-ids=2202, data-length=96, max-delta-counter-init=3, crc-offset=0, counter-offset=16}, end-to-end-protection-i-signal-i-pdu{data-offset=0, i-signal-group=RRL_CornerFunctions, i-signal-i-pdu=RRL_CornerFunctions}
      E2E_Prot_RRR_CornerFunctions: end-to-end-profile={category=PROFILE_05, data-ids=2202, data-length=96, max-delta-counter-init=3, crc-offset=0, counter-offset=16}, end-to-end-protection-i-signal-i-pdu{data-offset=0, i-signal-group=RRR_CornerFunctions, i-signal-i-pdu=RRR_CornerFunctions}
      E2E_Prot_Veh_SensorConfig_RFC: end-to-end-profile={category=PROFILE_05, data-ids=2201, data-length=384, max-delta-counter-init=3, crc-offset=0, counter-offset=16}, end-to-end-protection-i-signal-i-pdu{data-offset=0, i-signal-group=Veh_SensorConfig_RFC, i-signal-i-pdu=Veh_SensorConfig_RFC}
      E2E_Prot_Veh_SensorConfig_RFL: end-to-end-profile={category=PROFILE_05, data-ids=2201, data-length=384, max-delta-counter-init=3, crc-offset=0, counter-offset=16}, end-to-end-protection-i-signal-i-pdu{data-offset=0, i-signal-group=Veh_SensorConfig_RFL, i-signal-i-pdu=Veh_SensorConfig_RFL}
      E2E_Prot_Veh_SensorConfig_RFR: end-to-end-profile={category=PROFILE_05, data-ids=2201, data-length=384, max-delta-counter-init=3, crc-offset=0, counter-offset=16}, end-to-end-protection-i-signal-i-pdu{data-offset=0, i-signal-group=Veh_SensorConfig_RFR, i-signal-i-pdu=Veh_SensorConfig_RFR}
      E2E_Prot_Veh_SensorConfig_RRL: end-to-end-profile={category=PROFILE_05, data-ids=2201, data-length=384, max-delta-counter-init=3, crc-offset=0, counter-offset=16}, end-to-end-protection-i-signal-i-pdu{data-offset=0, i-signal-group=Veh_SensorConfig_RRL, i-signal-i-pdu=Veh_SensorConfig_RRL}
      E2E_Prot_Veh_SensorConfig_RRR: end-to-end-profile={category=PROFILE_05, data-ids=2201, data-length=384, max-delta-counter-init=3, crc-offset=0, counter-offset=16}, end-to-end-protection-i-signal-i-pdu{data-offset=0, i-signal-group=Veh_SensorConfig_RRR, i-signal-i-pdu=Veh_SensorConfig_RRR}
      E2E_Prot_Veh_SensorInput: end-to-end-profile={category=PROFILE_05, data-ids=[2200, 2200, 2200, 2200, 2200], data-length=512, max-delta-counter-init=3, crc-offset=0, counter-offset=16}, end-to-end-protection-i-signal-i-pdu{data-offset=0, i-signal-group=Veh_SensorInput, i-signal-i-pdu=Veh_SensorInput}
package /RA6/Pkg_Ecu
  5 x ecu instance, all with diagnostic-address=80, sleep-mode-supported=false, wake-up-over-bus-supported=false:
    RA6_RFC: associated-com-i-pdu-group=RFC_IPG_Rx
      can communication controller PF_RA6_CAN_Ctrl: wake-up-by-controller-supported=false, can-controller-attributes=can-controller-configuration-requirements=can-controller-fd-requirements=tx-bit-rate-switch=true
      can communication connector PF_RA6_CAN_Conn: comm-controller=RA6_RFC/PF_RA6_CAN_Ctrl
    RA6_RFL: associated-com-i-pdu-group=RFL_IPG_Rx
      can communication controller PF_RA6_CAN_Ctrl: wake-up-by-controller-supported=false, can-controller-attributes=can-controller-configuration-requirements=can-controller-fd-requirements=tx-bit-rate-switch=true
      can communication connector PF_RA6_CAN_Conn: comm-controller=RA6_RFL/PF_RA6_CAN_Ctrl
    RA6_RFR: associated-com-i-pdu-group=RFR_IPG_Rx
      can communication controller PF_RA6_CAN_Ctrl: wake-up-by-controller-supported=false, can-controller-attributes=can-controller-configuration-requirements=can-controller-fd-requirements=tx-bit-rate-switch=true
      can communication connector PF_RA6_CAN_Conn: comm-controller=RA6_RFR/PF_RA6_CAN_Ctrl
    RA6_RRL: associated-com-i-pdu-group=RRL_IPG_Rx
      can communication controller PF_RA6_CAN_Ctrl: wake-up-by-controller-supported=false, can-controller-attributes=can-controller-configuration-requirements=can-controller-fd-requirements=tx-bit-rate-switch=true
      can communication connector PF_RA6_CAN_Conn: comm-controller=RA6_RRL/PF_RA6_CAN_Ctrl
    RA6_RRR: associated-com-i-pdu-group=RRR_IPG_Rx
      can communication controller PF_RA6_CAN_Ctrl: wake-up-by-controller-supported=false, can-controller-attributes=can-controller-configuration-requirements=can-controller-fd-requirements=tx-bit-rate-switch=true
      can communication connector PF_RA6_CAN_Conn: comm-controller=RA6_RRR/PF_RA6_CAN_Ctrl
package /RA6/Pkg_IPduGroup
  5 x i signal i pdu group, all with communication-direction=IN, communication-mode=CAN_RxAll:
    RFC_IPG_Rx: i-signal-i-pdus=[Veh_SensorConfig_RFC, Veh_SensorInput]
    RFL_IPG_Rx: i-signal-i-pdus=[Veh_SensorConfig_RFL, Veh_SensorInput]
    RFR_IPG_Rx: i-signal-i-pdus=[Veh_SensorConfig_RFR, Veh_SensorInput]
    RRL_IPG_Rx: i-signal-i-pdus=[Veh_SensorConfig_RRL, Veh_SensorInput]
    RRR_IPG_Rx: i-signal-i-pdus=[Veh_SensorConfig_RRR, Veh_SensorInput]
package /RA6/Pkg_ISignal
  i signal group RFC_CornerFunctions: i-signal=[RFC_CF_AEx_revEgoBrakingStatus, RFC_CF_AEx_revEgoWarnStatus, RFC_CF_AEx_revEgo_BrakeRequest, RFC_CF_AEx_revEgo_TargetDec, RFC_CF_AEx_revEgo_WarningLevel, RFC_CF_BsdLca_Status, RFC_CF_BsdLca_WarningLevel, RFC_CF_CRC, RFC_CF_DOx_PrevStatus, RFC_CF_DOx_WarnStatus, RFC_CF_DOx_WarningLevel, RFC_CF_SQC], system-signal-group=SysSigGrp_RFC_CornerFunctions
  i signal group RFL_CornerFunctions: i-signal=[RFL_CF_AEx_revEgoBrakingStatus, RFL_CF_AEx_revEgoWarnStatus, RFL_CF_AEx_revEgo_BrakeRequest, RFL_CF_AEx_revEgo_TargetDec, RFL_CF_AEx_revEgo_WarningLevel, RFL_CF_BsdLca_Status, RFL_CF_BsdLca_WarningLevel, RFL_CF_CRC, RFL_CF_DOx_PrevStatus, RFL_CF_DOx_WarnStatus, RFL_CF_DOx_WarningLevel, RFL_CF_SQC], system-signal-group=SysSigGrp_RFL_CornerFunctions
  i signal group RFR_CornerFunctions: i-signal=[RFR_CF_AEx_revEgoBrakingStatus, RFR_CF_AEx_revEgoWarnStatus, RFR_CF_AEx_revEgo_BrakeRequest, RFR_CF_AEx_revEgo_TargetDec, RFR_CF_AEx_revEgo_WarningLevel, RFR_CF_BsdLca_Status, RFR_CF_BsdLca_WarningLevel, RFR_CF_CRC, RFR_CF_DOx_PrevStatus, RFR_CF_DOx_WarnStatus, RFR_CF_DOx_WarningLevel, RFR_CF_SQC], system-signal-group=SysSigGrp_RFR_CornerFunctions
  i signal group RRL_CornerFunctions: i-signal=[RRL_CF_AEx_revEgoBrakingStatus, RRL_CF_AEx_revEgoWarnStatus, RRL_CF_AEx_revEgo_BrakeRequest, RRL_CF_AEx_revEgo_TargetDec, RRL_CF_AEx_revEgo_WarningLevel, RRL_CF_BsdLca_Status, RRL_CF_BsdLca_WarningLevel, RRL_CF_CRC, RRL_CF_DOx_PrevStatus, RRL_CF_DOx_WarnStatus, RRL_CF_DOx_WarningLevel, RRL_CF_SQC], system-signal-group=SysSigGrp_RRL_CornerFunctions
  i signal group RRR_CornerFunctions: i-signal=[RRR_CF_AEx_revEgoBrakingStatus, RRR_CF_AEx_revEgoWarnStatus, RRR_CF_AEx_revEgo_BrakeRequest, RRR_CF_AEx_revEgo_TargetDec, RRR_CF_AEx_revEgo_WarningLevel, RRR_CF_BsdLca_Status, RRR_CF_BsdLca_WarningLevel, RRR_CF_CRC, RRR_CF_DOx_PrevStatus, RRR_CF_DOx_WarnStatus, RRR_CF_DOx_WarningLevel, RRR_CF_SQC], system-signal-group=SysSigGrp_RRR_CornerFunctions
  6 x i signal group:
    Veh_SensorConfig_RFC: i-signal=[Veh_SenConfig_RFC_AccLongSensPos, Veh_SenConfig_RFC_CRC, Veh_SenConfig_RFC_ConfigData, Veh_SenConfig_RFC_CountryCode, Veh_SenConfig_RFC_GradSideSlipAng, Veh_SenConfig_RFC_PosX, Veh_SenConfig_RFC_PosY, Veh_SenConfig_RFC_PosZ, Veh_SenConfig_RFC_SQC, Veh_SenConfig_RFC_SnsTimeOffset, Veh_SenConfig_RFC_SnsrOrientNomPitch, Veh_SenConfig_RFC_SnsrOrientNomYaw, Veh_SenConfig_RFC_SnsrOrientation, Veh_SenConfig_RFC_StrRackRatio, Veh_SenConfig_RFC_SyncType, Veh_SenConfig_RFC_VehicleWidthMax, Veh_SenConfig_RFC_VehicleWidthMin, Veh_SenConfig_RFC_WheelBase, Veh_SenConfig_RFC_WheelCircFL, Veh_SenConfig_RFC_WheelCircFR, Veh_SenConfig_RFC_WheelCircRL, Veh_SenConfig_RFC_WheelCircRR, Veh_SenConfig_RFC_WheelTrack, Veh_SenConfig_RFC_dxvFrontBumper, Veh_SenConfig_RFC_dxvRearBumper, Veh_SenConfig_RFC_vCh], system-signal-group=SysSigGrp_Veh_SensorConfig_RFC
    Veh_SensorConfig_RFL: i-signal=[Veh_SenConfig_RFL_AccLongSensPos, Veh_SenConfig_RFL_CRC, Veh_SenConfig_RFL_ConfigData, Veh_SenConfig_RFL_CountryCode, Veh_SenConfig_RFL_GradSideSlipAng, Veh_SenConfig_RFL_PosX, Veh_SenConfig_RFL_PosY, Veh_SenConfig_RFL_PosZ, Veh_SenConfig_RFL_SQC, Veh_SenConfig_RFL_SnsTimeOffset, Veh_SenConfig_RFL_SnsrOrientNomPitch, Veh_SenConfig_RFL_SnsrOrientNomYaw, Veh_SenConfig_RFL_SnsrOrientation, Veh_SenConfig_RFL_StrRackRatio, Veh_SenConfig_RFL_SyncType, Veh_SenConfig_RFL_VehicleWidthMax, Veh_SenConfig_RFL_VehicleWidthMin, Veh_SenConfig_RFL_WheelBase, Veh_SenConfig_RFL_WheelCircFL, Veh_SenConfig_RFL_WheelCircFR, Veh_SenConfig_RFL_WheelCircRL, Veh_SenConfig_RFL_WheelCircRR, Veh_SenConfig_RFL_WheelTrack, Veh_SenConfig_RFL_dxvFrontBumper, Veh_SenConfig_RFL_dxvRearBumper, Veh_SenConfig_RFL_vCh], system-signal-group=SysSigGrp_Veh_SensorConfig_RFL
    Veh_SensorConfig_RFR: i-signal=[Veh_SenConfig_RFR_AccLongSensPos, Veh_SenConfig_RFR_CRC, Veh_SenConfig_RFR_ConfigData, Veh_SenConfig_RFR_CountryCode, Veh_SenConfig_RFR_GradSideSlipAng, Veh_SenConfig_RFR_PosX, Veh_SenConfig_RFR_PosY, Veh_SenConfig_RFR_PosZ, Veh_SenConfig_RFR_SQC, Veh_SenConfig_RFR_SnsTimeOffset, Veh_SenConfig_RFR_SnsrOrientNomPitch, Veh_SenConfig_RFR_SnsrOrientNomYaw, Veh_SenConfig_RFR_SnsrOrientation, Veh_SenConfig_RFR_StrRackRatio, Veh_SenConfig_RFR_SyncType, Veh_SenConfig_RFR_VehicleWidthMax, Veh_SenConfig_RFR_VehicleWidthMin, Veh_SenConfig_RFR_WheelBase, Veh_SenConfig_RFR_WheelCircFL, Veh_SenConfig_RFR_WheelCircFR, Veh_SenConfig_RFR_WheelCircRL, Veh_SenConfig_RFR_WheelCircRR, Veh_SenConfig_RFR_WheelTrack, Veh_SenConfig_RFR_dxvFrontBumper, Veh_SenConfig_RFR_dxvRearBumper, Veh_SenConfig_RFR_vCh], system-signal-group=SysSigGrp_Veh_SensorConfig_RFR
    Veh_SensorConfig_RRL: i-signal=[Veh_SenConfig_RRL_AccLongSensPos, Veh_SenConfig_RRL_CRC, Veh_SenConfig_RRL_ConfigData, Veh_SenConfig_RRL_CountryCode, Veh_SenConfig_RRL_GradSideSlipAng, Veh_SenConfig_RRL_PosX, Veh_SenConfig_RRL_PosY, Veh_SenConfig_RRL_PosZ, Veh_SenConfig_RRL_SQC, Veh_SenConfig_RRL_SnsTimeOffset, Veh_SenConfig_RRL_SnsrOrientNomPitch, Veh_SenConfig_RRL_SnsrOrientNomYaw, Veh_SenConfig_RRL_SnsrOrientation, Veh_SenConfig_RRL_StrRackRatio, Veh_SenConfig_RRL_SyncType, Veh_SenConfig_RRL_VehicleWidthMax, Veh_SenConfig_RRL_VehicleWidthMin, Veh_SenConfig_RRL_WheelBase, Veh_SenConfig_RRL_WheelCircFL, Veh_SenConfig_RRL_WheelCircFR, Veh_SenConfig_RRL_WheelCircRL, Veh_SenConfig_RRL_WheelCircRR, Veh_SenConfig_RRL_WheelTrack, Veh_SenConfig_RRL_dxvFrontBumper, Veh_SenConfig_RRL_dxvRearBumper, Veh_SenConfig_RRL_vCh], system-signal-group=SysSigGrp_Veh_SensorConfig_RRL
    Veh_SensorConfig_RRR: i-signal=[Veh_SenConfig_RRR_AccLongSensPos, Veh_SenConfig_RRR_CRC, Veh_SenConfig_RRR_ConfigData, Veh_SenConfig_RRR_CountryCode, Veh_SenConfig_RRR_GradSideSlipAng, Veh_SenConfig_RRR_PosX, Veh_SenConfig_RRR_PosY, Veh_SenConfig_RRR_PosZ, Veh_SenConfig_RRR_SQC, Veh_SenConfig_RRR_SnsTimeOffset, Veh_SenConfig_RRR_SnsrOrientNomPitch, Veh_SenConfig_RRR_SnsrOrientNomYaw, Veh_SenConfig_RRR_SnsrOrientation, Veh_SenConfig_RRR_StrRackRatio, Veh_SenConfig_RRR_SyncType, Veh_SenConfig_RRR_VehicleWidthMax, Veh_SenConfig_RRR_VehicleWidthMin, Veh_SenConfig_RRR_WheelBase, Veh_SenConfig_RRR_WheelCircFL, Veh_SenConfig_RRR_WheelCircFR, Veh_SenConfig_RRR_WheelCircRL, Veh_SenConfig_RRR_WheelCircRR, Veh_SenConfig_RRR_WheelTrack, Veh_SenConfig_RRR_dxvFrontBumper, Veh_SenConfig_RRR_dxvRearBumper, Veh_SenConfig_RRR_vCh], system-signal-group=SysSigGrp_Veh_SensorConfig_RRR
    Veh_SensorInput: i-signal=[Veh_SenIn_ABSActive, Veh_SenIn_ASRActive, Veh_SenIn_AirAmb_Temp, Veh_SenIn_AngleStrWhlQf, Veh_SenIn_CRC, Veh_SenIn_ECU_Input_Vltg, Veh_SenIn_ESPActive, Veh_SenIn_ESPEnabled, Veh_SenIn_GearLvr_D_ActlDrv, Veh_SenIn_HmiAExRevEgo_Cust, Veh_SenIn_HmiAExRevEgo_Switch, Veh_SenIn_HmiBsdLca_Cust, Veh_SenIn_HmiBsdLca_Switch, Veh_SenIn_HmiDOx_Cust, Veh_SenIn_HmiDOx_Switch, Veh_SenIn_LatAccel, Veh_SenIn_LatAccelQf, Veh_SenIn_LeFrntDoorStatus, Veh_SenIn_LeReDoorStatus, Veh_SenIn_LongAccel, Veh_SenIn_LongAccelQf, Veh_SenIn_Odometer_ET, Veh_SenIn_RadioAstronomy, Veh_SenIn_RiFrntDoorStatus, Veh_SenIn_RiReDoorStatus, Veh_SenIn_SQC, Veh_SenIn_StrWhlAngSpd, Veh_SenIn_StrWhlAngle, Veh_SenIn_TrailerConnSt, Veh_SenIn_TurnIndrSt, Veh_SenIn_VSUActvtyStat, Veh_SenIn_VSUInhbtStat, Veh_SenIn_VehCfgParamLearnReq, Veh_SenIn_VehOverGnd_Est, Veh_SenIn_VehOverGnd_EstQf, Veh_SenIn_VehPwrModStat, Veh_SenIn_VehPwrModStatQf, Veh_SenIn_WheelDirFL, Veh_SenIn_WheelDirFR, Veh_SenIn_WheelDirRL, Veh_SenIn_WheelDirRR, Veh_SenIn_WheelSpeedFL, Veh_SenIn_WheelSpeedFLQf, Veh_SenIn_WheelSpeedFR, Veh_SenIn_WheelSpeedFRQf, Veh_SenIn_WheelSpeedRL, Veh_SenIn_WheelSpeedRLQf, Veh_SenIn_WheelSpeedRR, Veh_SenIn_WheelSpeedRRQf, Veh_SenIn_WheelTicksFL, Veh_SenIn_WheelTicksFR, Veh_SenIn_WheelTicksRL, Veh_SenIn_WheelTicksRR, Veh_SenIn_WhlSpdTimestmpCmpFL, Veh_SenIn_WhlSpdTimestmpCmpFR, Veh_SenIn_WhlSpdTimestmpCmpRL, Veh_SenIn_WhlSpdTimestmpCmpRR, Veh_SenIn_WiperFrontSt, Veh_SenIn_WiperRearSt, Veh_SenIn_YawRate, Veh_SenIn_YawRateQf, Veh_SenIn_YawRateTimestmpCmp], system-signal-group=SysSigGrp_Veh_SensorInput
package /RA6/Pkg_Pdus
  dcm i pdu Diag_RFC_TesterFunctionalReq_Dcm: length=512  # Diagnostic Functional Request - DCM Interface
  dcm i pdu Diag_RFC_TesterPhysicalReq_Dcm: length=512, diag-pdu-type=DIAG-REQUEST  # Diagnostic Physical Request - DCM Interface
  dcm i pdu Diag_RFC_TesterPhysicalResp_Dcm: length=512, diag-pdu-type=DIAG-RESPONSE  # Diagnostic Functional Response - DCM Interface
  dcm i pdu Diag_RFL_TesterFunctionalReq_Dcm: length=512  # Diagnostic Functional Request - DCM Interface
  dcm i pdu Diag_RFL_TesterPhysicalReq_Dcm: length=512, diag-pdu-type=DIAG-REQUEST  # Diagnostic Physical Request - DCM Interface
  dcm i pdu Diag_RFL_TesterPhysicalResp_Dcm: length=512, diag-pdu-type=DIAG-RESPONSE  # Diagnostic Functional Response - DCM Interface
  dcm i pdu Diag_RFR_TesterFunctionalReq_Dcm: length=512  # Diagnostic Functional Request - DCM Interface
  dcm i pdu Diag_RFR_TesterPhysicalReq_Dcm: length=512, diag-pdu-type=DIAG-REQUEST  # Diagnostic Physical Request - DCM Interface
  dcm i pdu Diag_RFR_TesterPhysicalResp_Dcm: length=512, diag-pdu-type=DIAG-RESPONSE  # Diagnostic Functional Response - DCM Interface
  dcm i pdu Diag_RRL_TesterFunctionalReq_Dcm: length=512  # Diagnostic Functional Request - DCM Interface
  dcm i pdu Diag_RRL_TesterPhysicalReq_Dcm: length=512, diag-pdu-type=DIAG-REQUEST  # Diagnostic Physical Request - DCM Interface
  dcm i pdu Diag_RRL_TesterPhysicalResp_Dcm: length=512, diag-pdu-type=DIAG-RESPONSE  # Diagnostic Functional Response - DCM Interface
  dcm i pdu Diag_RRR_TesterFunctionalReq_Dcm: length=512  # Diagnostic Functional Request - DCM Interface
  dcm i pdu Diag_RRR_TesterPhysicalReq_Dcm: length=512, diag-pdu-type=DIAG-REQUEST  # Diagnostic Physical Request - DCM Interface
  dcm i pdu Diag_RRR_TesterPhysicalResp_Dcm: length=512, diag-pdu-type=DIAG-RESPONSE  # Diagnostic Functional Response - DCM Interface
  pdu RFC_FieldDataCollection: length=5000, transmission-mode-true-timing=event-controlled-timing=number-of-repetitions=0, unused-bit-pattern=0  # Field Data
    signal RFC_FieldDataCollection: start 0, 40000 bit, opaque, data-type-policy=OVERRIDE, i-signal-type=ARRAY, base-type=uint8_n, dynamic-length=true, compu {identical}, transfer-property=TRIGGERED
  pdu RFC_Object: length=12500, transmission-mode-true-timing=event-controlled-timing=number-of-repetitions=0, unused-bit-pattern=0  # Object Data
    signal RFC_Object: start 0, 96000 bit, opaque, system signal RFC_Object_Dummy, data-type-policy=OVERRIDE, i-signal-type=ARRAY, base-type=uint8_n, dynamic-length=true, compu {identical}, transfer-property=TRIGGERED
  pdu RFC_RoadSideBoundaries: length=1000, transmission-mode-true-timing=event-controlled-timing=number-of-repetitions=0, unused-bit-pattern=0  # RoadSideBoundaries Data
    signal RFC_RoadSideBoundaries: start 0, 8000 bit, opaque, data-type-policy=OVERRIDE, i-signal-type=ARRAY, base-type=uint8_n, dynamic-length=true, compu {identical}, transfer-property=TRIGGERED
  pdu RFL_FieldDataCollection: length=5000, transmission-mode-true-timing=event-controlled-timing=number-of-repetitions=0, unused-bit-pattern=0  # Field Data
    signal RFL_FieldDataCollection: start 0, 40000 bit, opaque, data-type-policy=OVERRIDE, i-signal-type=ARRAY, base-type=uint8_n, dynamic-length=true, compu {identical}, transfer-property=TRIGGERED
  pdu RFL_Object: length=12500, transmission-mode-true-timing=event-controlled-timing=number-of-repetitions=0, unused-bit-pattern=0  # Object Data
    signal RFL_Object: start 0, 96000 bit, opaque, system signal RFL_Object_Dummy, data-type-policy=OVERRIDE, i-signal-type=ARRAY, base-type=uint8_n, dynamic-length=true, compu {identical}, transfer-property=TRIGGERED
  pdu RFL_RoadSideBoundaries: length=1000, transmission-mode-true-timing=event-controlled-timing=number-of-repetitions=0, unused-bit-pattern=0  # RoadSideBoundaries Data
    signal RFL_RoadSideBoundaries: start 0, 8000 bit, opaque, data-type-policy=OVERRIDE, i-signal-type=ARRAY, base-type=uint8_n, dynamic-length=true, compu {identical}, transfer-property=TRIGGERED
  pdu RFR_FieldDataCollection: length=5000, transmission-mode-true-timing=event-controlled-timing=number-of-repetitions=0, unused-bit-pattern=0  # Field Data
    signal RFR_FieldDataCollection: start 0, 40000 bit, opaque, data-type-policy=OVERRIDE, i-signal-type=ARRAY, base-type=uint8_n, dynamic-length=true, compu {identical}, transfer-property=TRIGGERED
  pdu RFR_Object: length=12500, transmission-mode-true-timing=event-controlled-timing=number-of-repetitions=0, unused-bit-pattern=0  # Object Data
    signal RFR_Object: start 0, 96000 bit, opaque, system signal RFR_Object_Dummy, data-type-policy=OVERRIDE, i-signal-type=ARRAY, base-type=uint8_n, dynamic-length=true, compu {identical}, transfer-property=TRIGGERED
  pdu RFR_RoadSideBoundaries: length=1000, transmission-mode-true-timing=event-controlled-timing=number-of-repetitions=0, unused-bit-pattern=0  # RoadSideBoundaries Data
    signal RFR_RoadSideBoundaries: start 0, 8000 bit, opaque, data-type-policy=OVERRIDE, i-signal-type=ARRAY, base-type=uint8_n, dynamic-length=true, compu {identical}, transfer-property=TRIGGERED
  pdu RRL_FieldDataCollection: length=5000, transmission-mode-true-timing=event-controlled-timing=number-of-repetitions=0, unused-bit-pattern=0  # Field Data
    signal RRL_FieldDataCollection: start 0, 40000 bit, opaque, data-type-policy=OVERRIDE, i-signal-type=ARRAY, base-type=uint8_n, dynamic-length=true, compu {identical}, transfer-property=TRIGGERED
  pdu RRL_Object: length=12500, transmission-mode-true-timing=event-controlled-timing=number-of-repetitions=0, unused-bit-pattern=0  # Object Data
    signal RRL_Object: start 0, 96000 bit, opaque, system signal RRL_Object_Dummy, data-type-policy=OVERRIDE, i-signal-type=ARRAY, base-type=uint8_n, dynamic-length=true, compu {identical}, transfer-property=TRIGGERED
  pdu RRL_RoadSideBoundaries: length=1000, transmission-mode-true-timing=event-controlled-timing=number-of-repetitions=0, unused-bit-pattern=0  # RoadSideBoundaries Data
    signal RRL_RoadSideBoundaries: start 0, 8000 bit, opaque, data-type-policy=OVERRIDE, i-signal-type=ARRAY, base-type=uint8_n, dynamic-length=true, compu {identical}, transfer-property=TRIGGERED
  pdu RRR_FieldDataCollection: length=5000, transmission-mode-true-timing=event-controlled-timing=number-of-repetitions=0, unused-bit-pattern=0  # Field Data
    signal RRR_FieldDataCollection: start 0, 40000 bit, opaque, data-type-policy=OVERRIDE, i-signal-type=ARRAY, base-type=uint8_n, dynamic-length=true, compu {identical}, transfer-property=TRIGGERED
  pdu RRR_Object: length=12500, transmission-mode-true-timing=event-controlled-timing=number-of-repetitions=0, unused-bit-pattern=0  # Object Data
    signal RRR_Object: start 0, 96000 bit, opaque, system signal RRR_Object_Dummy, data-type-policy=OVERRIDE, i-signal-type=ARRAY, base-type=uint8_n, dynamic-length=true, compu {identical}, transfer-property=TRIGGERED
  pdu RRR_RoadSideBoundaries: length=1000, transmission-mode-true-timing=event-controlled-timing=number-of-repetitions=0, unused-bit-pattern=0  # RoadSideBoundaries Data
    signal RRR_RoadSideBoundaries: start 0, 8000 bit, opaque, data-type-policy=OVERRIDE, i-signal-type=ARRAY, base-type=uint8_n, dynamic-length=true, compu {identical}, transfer-property=TRIGGERED
package /RA6/Pkg_System
  system RA6: category=SYSTEM_EXTRACT, ecu-extract-version=2.0.0, system-version=2.0.0
    system mapping SystemMapping_Dummy
      ecu-resource-mappings:
        5 x ecu mapping:
          ECUMapping_RFC: ecu-instance=RA6_RFC
          ECUMapping_RFL: ecu-instance=RA6_RFL
          ECUMapping_RFR: ecu-instance=RA6_RFR
          ECUMapping_RRL: ecu-instance=RA6_RRL
          ECUMapping_RRR: ecu-instance=RA6_RRR
package /RA6/Pkg_Units
  13 x unit:
    arcdegree
    arcdegree_per_s
    degrees_celsius
    kilometer
    kilometer_per_hour
    meter
    meter_per_second
    meter_per_squareseconds
    milliseconds
    radian
    radian_per_second
    radian_times_squaresconds_per_meter
    volt
package /RA6/Pkg_GlobalTimeDomain
  global time domain GTD_RA6: category=SYNCHRONIZED, domain-id=1, global-time-domain-props=can-global-time-domain-props={fup-data-id-lists=[74, 205, 180, 22, 232, 113, 36, 223, 153, 248, 90, 13, 89, 243, 139, 59], sync-data-id-lists=[10, 90, 149, 154, 192, 228, 12, 92, 225, 93, 230, 6, 173, 5, 236, 55]}, global-time-pdu-triggering=PduTrig_TimeSync, sync-loss-timeout=1.6  # Sub-Zeitdomaene fuer die CAN-Zeitsynchronisation auf FASCANFD1
    5 x global time can slave, all with follow-up-timeout-value=0.1, time-leap-future-threshold=0.001, time-leap-healing-counter=3, time-leap-past-threshold=0.001, crc-validated=CRC-VALIDATED, sequence-counter-jump-width=3:
      GTCS_RA6_RFC: communication-connector=RA6_RFC/PF_RA6_CAN_Conn
      GTCS_RA6_RFL: communication-connector=RA6_RFL/PF_RA6_CAN_Conn
      GTCS_RA6_RFR: communication-connector=RA6_RFR/PF_RA6_CAN_Conn
      GTCS_RA6_RRL: communication-connector=RA6_RRL/PF_RA6_CAN_Conn
      GTCS_RA6_RRR: communication-connector=RA6_RRR/PF_RA6_CAN_Conn
