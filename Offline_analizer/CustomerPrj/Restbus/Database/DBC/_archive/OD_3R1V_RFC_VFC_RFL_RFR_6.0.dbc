VERSION "created by canmatrix"

NS_ :

BS_:

BU_: RadarFrontCenter VideoFrontCenter RadarFrontLeft RadarFrontRight ReceiveECU

BO_ 244 VFC_TrafficSign_12_13: 64 VideoFrontCenter
 SG_ VFC_TS_12_13_CRC : 0|16@1+ (1,0) [0|65535] ""  RadarFrontCenter
 SG_ VFC_TS_12_13_AliveCtr : 16|8@1+ (1,0) [0|255] ""  RadarFrontCenter
 SG_ VFC_TS_12_13_ProtBlockCtr : 24|4@1+ (1,0) [0|15] ""  RadarFrontCenter
 SG_ VFC_TS12_ObjId : 32|8@1+ (1,0) [0|255] ""  RadarFrontCenter
 SG_ VFC_TS12_Type : 40|10@1+ (1,0) [0|1023] ""  RadarFrontCenter
 SG_ VFC_TS12_ExistProb : 50|5@1+ (5,0) [0|100] "%"  RadarFrontCenter
 SG_ VFC_TS12_Px : 55|9@1+ (0.25,0) [0|127.75] "m"  RadarFrontCenter
 SG_ VFC_TS12_Py : 64|8@1+ (0.2,-25.6) [-25.6|25.4] "m"  RadarFrontCenter
 SG_ VFC_TS12_Pz : 72|6@1+ (0.2,0) [0|12.6] "m"  RadarFrontCenter
 SG_ VFC_TS12_PxStdDev : 78|9@1+ (0.25,0) [0|127.75] "m"  RadarFrontCenter
 SG_ VFC_TS12_Width : 87|4@1+ (0.2,0) [0|3] "m"  RadarFrontCenter
 SG_ VFC_TS12_Height : 91|4@1+ (0.2,0) [0|3] "m"  RadarFrontCenter
 SG_ VFC_TS12_EmbeddedInfo : 95|4@1+ (1,0) [0|15] ""  RadarFrontCenter
 SG_ VFC_TS12_ValidLane : 99|5@1+ (1,0) [0|31] ""  RadarFrontCenter
 SG_ VFC_TS12_ValidDay : 104|7@1+ (1,0) [0|127] ""  RadarFrontCenter
 SG_ VFC_TS12_ValidTimeRange1Start : 111|7@1+ (15,0) [0|1440] "min"  RadarFrontCenter
 SG_ VFC_TS12_ValidTimeRange1End : 118|7@1+ (15,0) [0|1440] "min"  RadarFrontCenter
 SG_ VFC_TS12_ValidTimeRange2Start : 125|7@1+ (15,0) [0|1440] "min"  RadarFrontCenter
 SG_ VFC_TS12_ValidTimeRange2End : 132|7@1+ (15,0) [0|1440] "min"  RadarFrontCenter
 SG_ VFC_TS12_ValidInDist : 139|15@1+ (0.1,0) [0|3276.7] ""  RadarFrontCenter
 SG_ VFC_TS12_ValidInDistUnit : 154|3@1+ (1,0) [0|7] ""  RadarFrontCenter
 SG_ VFC_TS12_ValidSection : 157|15@1+ (0.1,0) [0|3276.7] ""  RadarFrontCenter
 SG_ VFC_TS12_ValidSectionUnit : 172|3@1+ (1,0) [0|7] ""  RadarFrontCenter
 SG_ VFC_TS12_NumValidSupSigns : 175|3@1+ (1,0) [0|6] ""  RadarFrontCenter
 SG_ VFC_TS12_SupSign0ExistProb : 178|5@1+ (5,0) [0|100] "%"  RadarFrontCenter
 SG_ VFC_TS12_SupSign1ExistProb : 183|5@1+ (5,0) [0|100] "%"  RadarFrontCenter
 SG_ VFC_TS12_SupSign2ExistProb : 188|5@1+ (5,0) [0|100] "%"  RadarFrontCenter
 SG_ VFC_TS12_SupSign3ExistProb : 193|5@1+ (5,0) [0|100] "%"  RadarFrontCenter
 SG_ VFC_TS12_SupSign4ExistProb : 198|5@1+ (5,0) [0|100] "%"  RadarFrontCenter
 SG_ VFC_TS12_SupSign5ExistProb : 203|5@1+ (5,0) [0|100] "%"  RadarFrontCenter
 SG_ VFC_TS12_SupSign0Type : 208|8@1+ (1,0) [0|255] ""  RadarFrontCenter
 SG_ VFC_TS12_SupSign1Type : 216|8@1+ (1,0) [0|255] ""  RadarFrontCenter
 SG_ VFC_TS12_SupSign2Type : 224|8@1+ (1,0) [0|255] ""  RadarFrontCenter
 SG_ VFC_TS12_SupSign3Type : 232|8@1+ (1,0) [0|255] ""  RadarFrontCenter
 SG_ VFC_TS12_SupSign4Type : 240|8@1+ (1,0) [0|255] ""  RadarFrontCenter
 SG_ VFC_TS12_SupSign5Type : 248|8@1+ (1,0) [0|255] ""  RadarFrontCenter
 SG_ VFC_TS13_ObjId : 272|8@1+ (1,0) [0|255] ""  RadarFrontCenter
 SG_ VFC_TS13_Type : 280|10@1+ (1,0) [0|1023] ""  RadarFrontCenter
 SG_ VFC_TS13_ExistProb : 290|5@1+ (5,0) [0|100] "%"  RadarFrontCenter
 SG_ VFC_TS13_Px : 295|9@1+ (0.25,0) [0|127.75] "m"  RadarFrontCenter
 SG_ VFC_TS13_Py : 304|8@1+ (0.2,-25.6) [-25.6|25.4] "m"  RadarFrontCenter
 SG_ VFC_TS13_Pz : 312|6@1+ (0.2,0) [0|12.6] "m"  RadarFrontCenter
 SG_ VFC_TS13_PxStdDev : 318|9@1+ (0.25,0) [0|127.75] "m"  RadarFrontCenter
 SG_ VFC_TS13_Width : 327|4@1+ (0.2,0) [0|3] "m"  RadarFrontCenter
 SG_ VFC_TS13_Height : 331|4@1+ (0.2,0) [0|3] "m"  RadarFrontCenter
 SG_ VFC_TS13_EmbeddedInfo : 335|4@1+ (1,0) [0|15] ""  RadarFrontCenter
 SG_ VFC_TS13_ValidLane : 339|5@1+ (1,0) [0|31] ""  RadarFrontCenter
 SG_ VFC_TS13_ValidDay : 344|7@1+ (1,0) [0|127] ""  RadarFrontCenter
 SG_ VFC_TS13_ValidTimeRange1Start : 351|7@1+ (15,0) [0|1440] "min"  RadarFrontCenter
 SG_ VFC_TS13_ValidTimeRange1End : 358|7@1+ (15,0) [0|1440] "min"  RadarFrontCenter
 SG_ VFC_TS13_ValidTimeRange2Start : 365|7@1+ (15,0) [0|1440] "min"  RadarFrontCenter
 SG_ VFC_TS13_ValidTimeRange2End : 372|7@1+ (15,0) [0|1440] "min"  RadarFrontCenter
 SG_ VFC_TS13_ValidInDist : 379|15@1+ (0.1,0) [0|3276.7] ""  RadarFrontCenter
 SG_ VFC_TS13_ValidInDistUnit : 394|3@1+ (1,0) [0|7] ""  RadarFrontCenter
 SG_ VFC_TS13_ValidSection : 397|15@1+ (0.1,0) [0|3276.7] ""  RadarFrontCenter
 SG_ VFC_TS13_ValidSectionUnit : 412|3@1+ (1,0) [0|7] ""  RadarFrontCenter
 SG_ VFC_TS13_NumValidSupSigns : 415|3@1+ (1,0) [0|6] ""  RadarFrontCenter
 SG_ VFC_TS13_SupSign0ExistProb : 418|5@1+ (5,0) [0|100] "%"  RadarFrontCenter
 SG_ VFC_TS13_SupSign1ExistProb : 423|5@1+ (5,0) [0|100] "%"  RadarFrontCenter
 SG_ VFC_TS13_SupSign2ExistProb : 428|5@1+ (5,0) [0|100] "%"  RadarFrontCenter
 SG_ VFC_TS13_SupSign3ExistProb : 433|5@1+ (5,0) [0|100] "%"  RadarFrontCenter
 SG_ VFC_TS13_SupSign4ExistProb : 438|5@1+ (5,0) [0|100] "%"  RadarFrontCenter
 SG_ VFC_TS13_SupSign5ExistProb : 443|5@1+ (5,0) [0|100] "%"  RadarFrontCenter
 SG_ VFC_TS13_SupSign0Type : 448|8@1+ (1,0) [0|255] ""  RadarFrontCenter
 SG_ VFC_TS13_SupSign1Type : 456|8@1+ (1,0) [0|255] ""  RadarFrontCenter
 SG_ VFC_TS13_SupSign2Type : 464|8@1+ (1,0) [0|255] ""  RadarFrontCenter
 SG_ VFC_TS13_SupSign3Type : 472|8@1+ (1,0) [0|255] ""  RadarFrontCenter
 SG_ VFC_TS13_SupSign4Type : 480|8@1+ (1,0) [0|255] ""  RadarFrontCenter
 SG_ VFC_TS13_SupSign5Type : 488|8@1+ (1,0) [0|255] ""  RadarFrontCenter

BO_ 245 VFC_TrafficSign_14_15: 64 VideoFrontCenter
 SG_ VFC_TS_14_15_CRC : 0|16@1+ (1,0) [0|65535] ""  RadarFrontCenter
 SG_ VFC_TS_14_15_AliveCtr : 16|8@1+ (1,0) [0|255] ""  RadarFrontCenter
 SG_ VFC_TS_14_15_ProtBlockCtr : 24|4@1+ (1,0) [0|15] ""  RadarFrontCenter
 SG_ VFC_TS14_ObjId : 32|8@1+ (1,0) [0|255] ""  RadarFrontCenter
 SG_ VFC_TS14_Type : 40|10@1+ (1,0) [0|1023] ""  RadarFrontCenter
 SG_ VFC_TS14_ExistProb : 50|5@1+ (5,0) [0|100] "%"  RadarFrontCenter
 SG_ VFC_TS14_Px : 55|9@1+ (0.25,0) [0|127.75] "m"  RadarFrontCenter
 SG_ VFC_TS14_Py : 64|8@1+ (0.2,-25.6) [-25.6|25.4] "m"  RadarFrontCenter
 SG_ VFC_TS14_Pz : 72|6@1+ (0.2,0) [0|12.6] "m"  RadarFrontCenter
 SG_ VFC_TS14_PxStdDev : 78|9@1+ (0.25,0) [0|127.75] "m"  RadarFrontCenter
 SG_ VFC_TS14_Width : 87|4@1+ (0.2,0) [0|3] "m"  RadarFrontCenter
 SG_ VFC_TS14_Height : 91|4@1+ (0.2,0) [0|3] "m"  RadarFrontCenter
 SG_ VFC_TS14_EmbeddedInfo : 95|4@1+ (1,0) [0|15] ""  RadarFrontCenter
 SG_ VFC_TS14_ValidLane : 99|5@1+ (1,0) [0|31] ""  RadarFrontCenter
 SG_ VFC_TS14_ValidDay : 104|7@1+ (1,0) [0|127] ""  RadarFrontCenter
 SG_ VFC_TS14_ValidTimeRange1Start : 111|7@1+ (15,0) [0|1440] "min"  RadarFrontCenter
 SG_ VFC_TS14_ValidTimeRange1End : 118|7@1+ (15,0) [0|1440] "min"  RadarFrontCenter
 SG_ VFC_TS14_ValidTimeRange2Start : 125|7@1+ (15,0) [0|1440] "min"  RadarFrontCenter
 SG_ VFC_TS14_ValidTimeRange2End : 132|7@1+ (15,0) [0|1440] "min"  RadarFrontCenter
 SG_ VFC_TS14_ValidInDist : 139|15@1+ (0.1,0) [0|3276.7] ""  RadarFrontCenter
 SG_ VFC_TS14_ValidInDistUnit : 154|3@1+ (1,0) [0|7] ""  RadarFrontCenter
 SG_ VFC_TS14_ValidSection : 157|15@1+ (0.1,0) [0|3276.7] ""  RadarFrontCenter
 SG_ VFC_TS14_ValidSectionUnit : 172|3@1+ (1,0) [0|7] ""  RadarFrontCenter
 SG_ VFC_TS14_NumValidSupSigns : 175|3@1+ (1,0) [0|6] ""  RadarFrontCenter
 SG_ VFC_TS14_SupSign0ExistProb : 178|5@1+ (5,0) [0|100] "%"  RadarFrontCenter
 SG_ VFC_TS14_SupSign1ExistProb : 183|5@1+ (5,0) [0|100] "%"  RadarFrontCenter
 SG_ VFC_TS14_SupSign2ExistProb : 188|5@1+ (5,0) [0|100] "%"  RadarFrontCenter
 SG_ VFC_TS14_SupSign3ExistProb : 193|5@1+ (5,0) [0|100] "%"  RadarFrontCenter
 SG_ VFC_TS14_SupSign4ExistProb : 198|5@1+ (5,0) [0|100] "%"  RadarFrontCenter
 SG_ VFC_TS14_SupSign5ExistProb : 203|5@1+ (5,0) [0|100] "%"  RadarFrontCenter
 SG_ VFC_TS14_SupSign0Type : 208|8@1+ (1,0) [0|255] ""  RadarFrontCenter
 SG_ VFC_TS14_SupSign1Type : 216|8@1+ (1,0) [0|255] ""  RadarFrontCenter
 SG_ VFC_TS14_SupSign2Type : 224|8@1+ (1,0) [0|255] ""  RadarFrontCenter
 SG_ VFC_TS14_SupSign3Type : 232|8@1+ (1,0) [0|255] ""  RadarFrontCenter
 SG_ VFC_TS14_SupSign4Type : 240|8@1+ (1,0) [0|255] ""  RadarFrontCenter
 SG_ VFC_TS14_SupSign5Type : 248|8@1+ (1,0) [0|255] ""  RadarFrontCenter
 SG_ VFC_TS15_ObjId : 272|8@1+ (1,0) [0|255] ""  RadarFrontCenter
 SG_ VFC_TS15_Type : 280|10@1+ (1,0) [0|1023] ""  RadarFrontCenter
 SG_ VFC_TS15_ExistProb : 290|5@1+ (5,0) [0|100] "%"  RadarFrontCenter
 SG_ VFC_TS15_Px : 295|9@1+ (0.25,0) [0|127.75] "m"  RadarFrontCenter
 SG_ VFC_TS15_Py : 304|8@1+ (0.2,-25.6) [-25.6|25.4] "m"  RadarFrontCenter
 SG_ VFC_TS15_Pz : 312|6@1+ (0.2,0) [0|12.6] "m"  RadarFrontCenter
 SG_ VFC_TS15_PxStdDev : 318|9@1+ (0.25,0) [0|127.75] "m"  RadarFrontCenter
 SG_ VFC_TS15_Width : 327|4@1+ (0.2,0) [0|3] "m"  RadarFrontCenter
 SG_ VFC_TS15_Height : 331|4@1+ (0.2,0) [0|3] "m"  RadarFrontCenter
 SG_ VFC_TS15_EmbeddedInfo : 335|4@1+ (1,0) [0|15] ""  RadarFrontCenter
 SG_ VFC_TS15_ValidLane : 339|5@1+ (1,0) [0|31] ""  RadarFrontCenter
 SG_ VFC_TS15_ValidDay : 344|7@1+ (1,0) [0|127] ""  RadarFrontCenter
 SG_ VFC_TS15_ValidTimeRange1Start : 351|7@1+ (15,0) [0|1440] "min"  RadarFrontCenter
 SG_ VFC_TS15_ValidTimeRange1End : 358|7@1+ (15,0) [0|1440] "min"  RadarFrontCenter
 SG_ VFC_TS15_ValidTimeRange2Start : 365|7@1+ (15,0) [0|1440] "min"  RadarFrontCenter
 SG_ VFC_TS15_ValidTimeRange2End : 372|7@1+ (15,0) [0|1440] "min"  RadarFrontCenter
 SG_ VFC_TS15_ValidInDist : 379|15@1+ (0.1,0) [0|3276.7] ""  RadarFrontCenter
 SG_ VFC_TS15_ValidInDistUnit : 394|3@1+ (1,0) [0|7] ""  RadarFrontCenter
 SG_ VFC_TS15_ValidSection : 397|15@1+ (0.1,0) [0|3276.7] ""  RadarFrontCenter
 SG_ VFC_TS15_ValidSectionUnit : 412|3@1+ (1,0) [0|7] ""  RadarFrontCenter
 SG_ VFC_TS15_NumValidSupSigns : 415|3@1+ (1,0) [0|6] ""  RadarFrontCenter
 SG_ VFC_TS15_SupSign0ExistProb : 418|5@1+ (5,0) [0|100] "%"  RadarFrontCenter
 SG_ VFC_TS15_SupSign1ExistProb : 423|5@1+ (5,0) [0|100] "%"  RadarFrontCenter
 SG_ VFC_TS15_SupSign2ExistProb : 428|5@1+ (5,0) [0|100] "%"  RadarFrontCenter
 SG_ VFC_TS15_SupSign3ExistProb : 433|5@1+ (5,0) [0|100] "%"  RadarFrontCenter
 SG_ VFC_TS15_SupSign4ExistProb : 438|5@1+ (5,0) [0|100] "%"  RadarFrontCenter
 SG_ VFC_TS15_SupSign5ExistProb : 443|5@1+ (5,0) [0|100] "%"  RadarFrontCenter
 SG_ VFC_TS15_SupSign0Type : 448|8@1+ (1,0) [0|255] ""  RadarFrontCenter
 SG_ VFC_TS15_SupSign1Type : 456|8@1+ (1,0) [0|255] ""  RadarFrontCenter
 SG_ VFC_TS15_SupSign2Type : 464|8@1+ (1,0) [0|255] ""  RadarFrontCenter
 SG_ VFC_TS15_SupSign3Type : 472|8@1+ (1,0) [0|255] ""  RadarFrontCenter
 SG_ VFC_TS15_SupSign4Type : 480|8@1+ (1,0) [0|255] ""  RadarFrontCenter
 SG_ VFC_TS15_SupSign5Type : 488|8@1+ (1,0) [0|255] ""  RadarFrontCenter

BO_ 517 RFL_ObjHdr: 48 RadarFrontLeft
 SG_ RFL_ObjHdr_CRC : 0|16@1+ (1,0) [0|65535] ""  RadarFrontCenter
 SG_ RFL_ObjHdr_AliveCtr : 16|8@1+ (1,0) [0|255] ""  RadarFrontCenter
 SG_ RFL_ObjHdr_ProtBlockCtr : 24|4@1+ (1,0) [0|15] ""  RadarFrontCenter
 SG_ RFL_ObjHdr_SensorState : 28|4@1+ (1,0) [0|15] ""  RadarFrontCenter
 SG_ RFL_ObjHdr_ProtocolVersion : 32|16@1+ (1,0) [0|65535] ""  RadarFrontCenter
 SG_ RFL_ObjHdr_ProtObjectCount : 48|6@1+ (1,0) [0|40] ""  RadarFrontCenter
 SG_ RFL_ObjHdr_ProtRSBSegmentCount : 56|4@1+ (1,0) [0|4] ""  RadarFrontCenter
 SG_ RFL_ObjHdr_ProtRSBPointCount : 64|6@1+ (1,0) [0|32] ""  RadarFrontCenter
 SG_ RFL_ObjHdr_TimeStampStatus : 88|8@1+ (1,0) [0|255] ""  RadarFrontCenter
 SG_ RFL_ObjHdr_TimeStamp : 96|26@1+ (1,0) [0|67108863] "ms"  RadarFrontCenter
 SG_ RFL_ObjHdr_MountPosY : 128|8@1+ (0.01,-1.28) [-1.28|1.27] "m"  RadarFrontCenter
 SG_ RFL_ObjHdr_MountPosX : 136|9@1+ (0.02,-5.12) [-5.12|5.1] "m"  RadarFrontCenter
 SG_ RFL_ObjHdr_MountPosZ : 145|5@1+ (0.05,0) [0|1.55] "m"  RadarFrontCenter
 SG_ RFL_ObjHdr_ObjectDownSel : 151|1@1+ (1,0) [0|1] ""  RadarFrontCenter
 SG_ RFL_ObjHdr_YawMountAngle : 152|16@1+ (0.00017,-5.57056) [-3.2|3.2] "rad"  RadarFrontCenter
 SG_ RFL_ObjHdr_YawAngleLower : 168|15@1+ (0.00017,-2.78528) [-1.6|1.6] "rad"  RadarFrontCenter
 SG_ RFL_ObjHdr_AziOutOfSpec : 183|1@1+ (1,0) [0|1] ""  RadarFrontCenter
 SG_ RFL_ObjHdr_YawAngleUpper : 184|15@1+ (0.00017,-2.78528) [-1.6|1.6] "rad"  RadarFrontCenter
 SG_ RFL_ObjHdr_ElevOutOfSpec : 199|1@1+ (1,0) [0|1] ""  RadarFrontCenter
 SG_ RFL_ObjHdr_PitchMountAngle : 200|12@1+ (0.00017,-0.34816) [-0.34816|0.34799] "rad"  RadarFrontCenter
 SG_ RFL_ObjHdr_PitchAngleLower : 212|12@1+ (0.00017,-0.34816) [-0.34816|0.34799] "rad"  RadarFrontCenter
 SG_ RFL_ObjHdr_PitchAngleUpper : 224|12@1+ (0.00017,-0.34816) [-0.34816|0.34799] "rad"  RadarFrontCenter
 SG_ RFL_ObjHdr_RollMountAngle : 236|12@1+ (0.00017,-0.34816) [-0.2|0.2] "rad"  RadarFrontCenter
 SG_ RFL_ObjHdr_DetectionRange : 248|9@1+ (1,0) [0|511] "m"  RadarFrontCenter
 SG_ RFL_ObjHdr_TimeStampLocal : 264|26@1+ (1,0) [0|67108863] "ms"  RadarFrontCenter

BO_ 528 RFL_Obj00A: 64 RadarFrontLeft
 SG_ RFL_Obj00A_CRC : 0|16@1+ (1,0) [0|65535] ""  RadarFrontCenter
 SG_ RFL_Obj00A_AliveCtr : 16|8@1+ (1,0) [0|255] ""  RadarFrontCenter
 SG_ RFL_Obj00A_ProtBlockCtr : 24|4@1+ (1,0) [0|15] ""  RadarFrontCenter
 SG_ RFL_Obj00A_ID : 32|7@1+ (1,0) [0|127] ""  RadarFrontCenter
 SG_ RFL_Obj00A_Measured : 39|1@1+ (1,0) [0|1] ""  RadarFrontCenter
 SG_ RFL_Obj00A_Dx : 40|13@1+ (0.0625,-256) [-256|255.9375] "m"  RadarFrontCenter
 SG_ RFL_Obj00A_Dz : 53|6@1+ (0.25,-5) [-5|10.75] "m"  RadarFrontCenter
 SG_ RFL_Obj00A_Dy : 59|11@1+ (0.125,-128) [-128|127.875] "m"  RadarFrontCenter
 SG_ RFL_Obj00A_Valid : 70|1@1+ (1,0) [0|1] ""  RadarFrontCenter
 SG_ RFL_Obj00A_Vx : 71|12@1+ (0.0625,-128) [-128|127.9375] "m/s"  RadarFrontCenter
 SG_ RFL_Obj00A_Vy : 83|10@1+ (0.125,-64) [-64|63.875] "m/s"  RadarFrontCenter
 SG_ RFL_Obj00A_Ax : 93|10@1+ (0.03125,-16) [-16|15.96875] "m/s^2"  RadarFrontCenter
 SG_ RFL_Obj00A_Ay : 103|9@1+ (0.0625,-16) [-16|15.9375] "m/s^2"  RadarFrontCenter
 SG_ RFL_Obj00A_HeadingYawAngle : 112|9@1+ (0.0175,-4.48) [-3.15|3.15] "rad"  RadarFrontCenter
 SG_ RFL_Obj00A_Length : 121|7@1+ (0.125,0) [0|15.875] "m"  RadarFrontCenter
 SG_ RFL_Obj00A_Width : 128|7@1+ (0.125,0) [0|15.875] "m"  RadarFrontCenter
 SG_ RFL_Obj00A_Height : 135|7@1+ (0.125,0) [0|15.875] "m"  RadarFrontCenter
 SG_ RFL_Obj00A_DxVnce : 142|12@1+ (0.01,0) [0|30] "m^2"  RadarFrontCenter
 SG_ RFL_Obj00A_DyVnce : 154|12@1+ (0.01,0) [0|30] "m^2"  RadarFrontCenter
 SG_ RFL_Obj00A_DzVnce : 166|10@1+ (0.01,0) [0|10] "m^2"  RadarFrontCenter
 SG_ RFL_Obj00A_VxVnce : 176|12@1+ (0.01,0) [0|30] "m^2/s^2"  RadarFrontCenter
 SG_ RFL_Obj00A_VyVnce : 188|12@1+ (0.01,0) [0|30] "m^2/s^2"  RadarFrontCenter
 SG_ RFL_Obj00A_AxVnce : 200|12@1+ (0.01,0) [0|30] "m^2/s^4"  RadarFrontCenter
 SG_ RFL_Obj00A_AyVnce : 212|12@1+ (0.01,0) [0|30] "m^2/s^4"  RadarFrontCenter
 SG_ RFL_Obj00A_RefPosIndex : 224|4@1+ (1,0) [0|15] ""  RadarFrontCenter
 SG_ RFL_Obj00A_DxDyCoVnce : 228|12@1+ (0.01,0) [0|30] "m^2"  RadarFrontCenter
 SG_ RFL_Obj00A_DxVxCoVnce : 240|12@1+ (0.01,0) [0|30] "m^2/s"  RadarFrontCenter
 SG_ RFL_Obj00A_DyVxCoVnce : 252|12@1+ (0.01,0) [0|30] "m^2/s"  RadarFrontCenter
 SG_ RFL_Obj00A_DxVyCoVnce : 264|12@1+ (0.01,0) [0|30] "m^2/s"  RadarFrontCenter
 SG_ RFL_Obj00A_DyVyCoVnce : 276|12@1+ (0.01,0) [0|30] "m^2/s"  RadarFrontCenter
 SG_ RFL_Obj00A_VxVyCoVnce : 288|12@1+ (0.01,0) [0|30] "m^2/s^2"  RadarFrontCenter
 SG_ RFL_Obj00A_DxAxCoVnce : 300|12@1+ (0.01,0) [0|30] "m^2/s^2"  RadarFrontCenter
 SG_ RFL_Obj00A_DyAxCoVnce : 312|12@1+ (0.01,0) [0|30] "m^2/s^2"  RadarFrontCenter
 SG_ RFL_Obj00A_VxAxCoVnce : 324|12@1+ (0.01,0) [0|30] "m^2/s^3"  RadarFrontCenter
 SG_ RFL_Obj00A_VyAxCoVnce : 336|12@1+ (0.01,0) [0|30] "m^2/s^3"  RadarFrontCenter
 SG_ RFL_Obj00A_DxAyCoVnce : 348|12@1+ (0.01,0) [0|30] "m^2/s^2"  RadarFrontCenter
 SG_ RFL_Obj00A_DyAyCoVnce : 360|12@1+ (0.01,0) [0|30] "m^2/s^2"  RadarFrontCenter
 SG_ RFL_Obj00A_VxAyCoVnce : 372|12@1+ (0.01,0) [0|30] "m^2/s^3"  RadarFrontCenter
 SG_ RFL_Obj00A_VyAyCoVnce : 384|12@1+ (0.01,0) [0|30] "m^2/s^3"  RadarFrontCenter
 SG_ RFL_Obj00A_AxAyCoVnce : 396|12@1+ (0.01,0) [0|30] "m^2/s^4"  RadarFrontCenter
 SG_ RFL_Obj00A_HeadingYawAngleVnce : 408|12@1+ (0.0003,0) [0|1] "rad^2"  RadarFrontCenter
 SG_ RFL_Obj00A_LengthVnce : 420|12@1+ (0.01,0) [0|30] "m^2"  RadarFrontCenter
 SG_ RFL_Obj00A_WidthVnce : 432|12@1+ (0.01,0) [0|30] "m^2"  RadarFrontCenter
 SG_ RFL_Obj00A_HeightVnce : 444|12@1+ (0.01,0) [0|30] "m^2"  RadarFrontCenter
 SG_ RFL_Obj00A_ProbExist : 456|6@1+ (2,0) [0|100] "%"  RadarFrontCenter
 SG_ RFL_Obj00A_ProbObstacle : 462|6@1+ (2,0) [0|100] "%"  RadarFrontCenter
 SG_ RFL_Obj00A_ProbNonObstacle : 468|6@1+ (2,0) [0|100] "%"  RadarFrontCenter
 SG_ RFL_Obj00A_ProbMobileObst : 474|6@1+ (2,0) [0|100] "%"  RadarFrontCenter

BO_ 529 RFL_Obj00B: 16 RadarFrontLeft
 SG_ RFL_Obj00B_CRC : 0|16@1+ (1,0) [0|65535] ""  RadarFrontCenter
 SG_ RFL_Obj00B_AliveCtr : 16|8@1+ (1,0) [0|255] ""  RadarFrontCenter
 SG_ RFL_Obj00B_ProtBlockCtr : 24|4@1+ (1,0) [0|15] ""  RadarFrontCenter
 SG_ RFL_Obj00B_ProbMob4PlusWhl : 28|6@1+ (2,0) [0|100] "%"  RadarFrontCenter
 SG_ RFL_Obj00B_ProbMob2Whl : 34|6@1+ (2,0) [0|100] "%"  RadarFrontCenter
 SG_ RFL_Obj00B_ProbMobPed : 40|6@1+ (2,0) [0|100] "%"  RadarFrontCenter
 SG_ RFL_Obj00B_Prob4PlusWhlCAR : 46|6@1+ (2,0) [0|100] "%"  RadarFrontCenter
 SG_ RFL_Obj00B_Prob4PlusWhlbHGV : 52|6@1+ (2,0) [0|100] "%"  RadarFrontCenter
 SG_ RFL_Obj00B_ProbGNDReflex : 58|6@1+ (2,0) [0|100] "%"  RadarFrontCenter
 SG_ RFL_Obj00B_ProbStatBarrier : 64|6@1+ (2,0) [0|100] "%"  RadarFrontCenter
 SG_ RFL_Obj00B_ProbStatObst : 70|6@1+ (2,0) [0|100] "%"  RadarFrontCenter
 SG_ RFL_Obj00B_MovingProbability : 76|6@1+ (2,0) [0|100] "%"  RadarFrontCenter
 SG_ RFL_Obj00B_MovingObserved : 82|6@1+ (2,0) [0|100] "%"  RadarFrontCenter
 SG_ RFL_Obj00B_BehaviorType : 88|3@1+ (1,0) [0|7] ""  RadarFrontCenter

BO_ 530 RFL_Obj01A: 64 RadarFrontLeft
 SG_ RFL_Obj01A_CRC : 0|16@1+ (1,0) [0|65535] ""  RadarFrontCenter
 SG_ RFL_Obj01A_AliveCtr : 16|8@1+ (1,0) [0|255] ""  RadarFrontCenter
 SG_ RFL_Obj01A_ProtBlockCtr : 24|4@1+ (1,0) [0|15] ""  RadarFrontCenter
 SG_ RFL_Obj01A_ID : 32|7@1+ (1,0) [0|127] ""  RadarFrontCenter
 SG_ RFL_Obj01A_Measured : 39|1@1+ (1,0) [0|1] ""  RadarFrontCenter
 SG_ RFL_Obj01A_Dx : 40|13@1+ (0.0625,-256) [-256|255.9375] "m"  RadarFrontCenter
 SG_ RFL_Obj01A_Dz : 53|6@1+ (0.25,-5) [-5|10.75] "m"  RadarFrontCenter
 SG_ RFL_Obj01A_Dy : 59|11@1+ (0.125,-128) [-128|127.875] "m"  RadarFrontCenter
 SG_ RFL_Obj01A_Valid : 70|1@1+ (1,0) [0|1] ""  RadarFrontCenter
 SG_ RFL_Obj01A_Vx : 71|12@1+ (0.0625,-128) [-128|127.9375] "m/s"  RadarFrontCenter
 SG_ RFL_Obj01A_Vy : 83|10@1+ (0.125,-64) [-64|63.875] "m/s"  RadarFrontCenter
 SG_ RFL_Obj01A_Ax : 93|10@1+ (0.03125,-16) [-16|15.96875] "m/s^2"  RadarFrontCenter
 SG_ RFL_Obj01A_Ay : 103|9@1+ (0.0625,-16) [-16|15.9375] "m/s^2"  RadarFrontCenter
 SG_ RFL_Obj01A_HeadingYawAngle : 112|9@1+ (0.0175,-4.48) [-3.15|3.15] "rad"  RadarFrontCenter
 SG_ RFL_Obj01A_Length : 121|7@1+ (0.125,0) [0|15.875] "m"  RadarFrontCenter
 SG_ RFL_Obj01A_Width : 128|7@1+ (0.125,0) [0|15.875] "m"  RadarFrontCenter
 SG_ RFL_Obj01A_Height : 135|7@1+ (0.125,0) [0|15.875] "m"  RadarFrontCenter
 SG_ RFL_Obj01A_DxVnce : 142|12@1+ (0.01,0) [0|30] "m^2"  RadarFrontCenter
 SG_ RFL_Obj01A_DyVnce : 154|12@1+ (0.01,0) [0|30] "m^2"  RadarFrontCenter
 SG_ RFL_Obj01A_DzVnce : 166|10@1+ (0.01,0) [0|10] "m^2"  RadarFrontCenter
 SG_ RFL_Obj01A_VxVnce : 176|12@1+ (0.01,0) [0|30] "m^2/s^2"  RadarFrontCenter
 SG_ RFL_Obj01A_VyVnce : 188|12@1+ (0.01,0) [0|30] "m^2/s^2"  RadarFrontCenter
 SG_ RFL_Obj01A_AxVnce : 200|12@1+ (0.01,0) [0|30] "m^2/s^4"  RadarFrontCenter
 SG_ RFL_Obj01A_AyVnce : 212|12@1+ (0.01,0) [0|30] "m^2/s^4"  RadarFrontCenter
 SG_ RFL_Obj01A_RefPosIndex : 224|4@1+ (1,0) [0|15] ""  RadarFrontCenter
 SG_ RFL_Obj01A_DxDyCoVnce : 228|12@1+ (0.01,0) [0|30] "m^2"  RadarFrontCenter
 SG_ RFL_Obj01A_DxVxCoVnce : 240|12@1+ (0.01,0) [0|30] "m^2/s"  RadarFrontCenter
 SG_ RFL_Obj01A_DyVxCoVnce : 252|12@1+ (0.01,0) [0|30] "m^2/s"  RadarFrontCenter
 SG_ RFL_Obj01A_DxVyCoVnce : 264|12@1+ (0.01,0) [0|30] "m^2/s"  RadarFrontCenter
 SG_ RFL_Obj01A_DyVyCoVnce : 276|12@1+ (0.01,0) [0|30] "m^2/s"  RadarFrontCenter
 SG_ RFL_Obj01A_VxVyCoVnce : 288|12@1+ (0.01,0) [0|30] "m^2/s^2"  RadarFrontCenter
 SG_ RFL_Obj01A_DxAxCoVnce : 300|12@1+ (0.01,0) [0|30] "m^2/s^2"  RadarFrontCenter
 SG_ RFL_Obj01A_DyAxCoVnce : 312|12@1+ (0.01,0) [0|30] "m^2/s^2"  RadarFrontCenter
 SG_ RFL_Obj01A_VxAxCoVnce : 324|12@1+ (0.01,0) [0|30] "m^2/s^3"  RadarFrontCenter
 SG_ RFL_Obj01A_VyAxCoVnce : 336|12@1+ (0.01,0) [0|30] "m^2/s^3"  RadarFrontCenter
 SG_ RFL_Obj01A_DxAyCoVnce : 348|12@1+ (0.01,0) [0|30] "m^2/s^2"  RadarFrontCenter
 SG_ RFL_Obj01A_DyAyCoVnce : 360|12@1+ (0.01,0) [0|30] "m^2/s^2"  RadarFrontCenter
 SG_ RFL_Obj01A_VxAyCoVnce : 372|12@1+ (0.01,0) [0|30] "m^2/s^3"  RadarFrontCenter
 SG_ RFL_Obj01A_VyAyCoVnce : 384|12@1+ (0.01,0) [0|30] "m^2/s^3"  RadarFrontCenter
 SG_ RFL_Obj01A_AxAyCoVnce : 396|12@1+ (0.01,0) [0|30] "m^2/s^4"  RadarFrontCenter
 SG_ RFL_Obj01A_HeadingYawAngleVnce : 408|12@1+ (0.0003,0) [0|1] "rad^2"  RadarFrontCenter
 SG_ RFL_Obj01A_LengthVnce : 420|12@1+ (0.01,0) [0|30] "m^2"  RadarFrontCenter
 SG_ RFL_Obj01A_WidthVnce : 432|12@1+ (0.01,0) [0|30] "m^2"  RadarFrontCenter
 SG_ RFL_Obj01A_HeightVnce : 444|12@1+ (0.01,0) [0|30] "m^2"  RadarFrontCenter
 SG_ RFL_Obj01A_ProbExist : 456|6@1+ (2,0) [0|100] "%"  RadarFrontCenter
 SG_ RFL_Obj01A_ProbObstacle : 462|6@1+ (2,0) [0|100] "%"  RadarFrontCenter
 SG_ RFL_Obj01A_ProbNonObstacle : 468|6@1+ (2,0) [0|100] "%"  RadarFrontCenter
 SG_ RFL_Obj01A_ProbMobileObst : 474|6@1+ (2,0) [0|100] "%"  RadarFrontCenter

BO_ 531 RFL_Obj01B: 16 RadarFrontLeft
 SG_ RFL_Obj01B_CRC : 0|16@1+ (1,0) [0|65535] ""  RadarFrontCenter
 SG_ RFL_Obj01B_AliveCtr : 16|8@1+ (1,0) [0|255] ""  RadarFrontCenter
 SG_ RFL_Obj01B_ProtBlockCtr : 24|4@1+ (1,0) [0|15] ""  RadarFrontCenter
 SG_ RFL_Obj01B_ProbMob4PlusWhl : 28|6@1+ (2,0) [0|100] "%"  RadarFrontCenter
 SG_ RFL_Obj01B_ProbMob2Whl : 34|6@1+ (2,0) [0|100] "%"  RadarFrontCenter
 SG_ RFL_Obj01B_ProbMobPed : 40|6@1+ (2,0) [0|100] "%"  RadarFrontCenter
 SG_ RFL_Obj01B_Prob4PlusWhlCAR : 46|6@1+ (2,0) [0|100] "%"  RadarFrontCenter
 SG_ RFL_Obj01B_Prob4PlusWhlbHGV : 52|6@1+ (2,0) [0|100] "%"  RadarFrontCenter
 SG_ RFL_Obj01B_ProbGNDReflex : 58|6@1+ (2,0) [0|100] "%"  RadarFrontCenter
 SG_ RFL_Obj01B_ProbStatBarrier : 64|6@1+ (2,0) [0|100] "%"  RadarFrontCenter
 SG_ RFL_Obj01B_ProbStatObst : 70|6@1+ (2,0) [0|100] "%"  RadarFrontCenter
 SG_ RFL_Obj01B_MovingProbability : 76|6@1+ (2,0) [0|100] "%"  RadarFrontCenter
 SG_ RFL_Obj01B_MovingObserved : 82|6@1+ (2,0) [0|100] "%"  RadarFrontCenter
 SG_ RFL_Obj01B_BehaviorType : 88|3@1+ (1,0) [0|7] ""  RadarFrontCenter

BO_ 532 RFL_Obj02A: 64 RadarFrontLeft
 SG_ RFL_Obj02A_CRC : 0|16@1+ (1,0) [0|65535] ""  RadarFrontCenter
 SG_ RFL_Obj02A_AliveCtr : 16|8@1+ (1,0) [0|255] ""  RadarFrontCenter
 SG_ RFL_Obj02A_ProtBlockCtr : 24|4@1+ (1,0) [0|15] ""  RadarFrontCenter
 SG_ RFL_Obj02A_ID : 32|7@1+ (1,0) [0|127] ""  RadarFrontCenter
 SG_ RFL_Obj02A_Measured : 39|1@1+ (1,0) [0|1] ""  RadarFrontCenter
 SG_ RFL_Obj02A_Dx : 40|13@1+ (0.0625,-256) [-256|255.9375] "m"  RadarFrontCenter
 SG_ RFL_Obj02A_Dz : 53|6@1+ (0.25,-5) [-5|10.75] "m"  RadarFrontCenter
 SG_ RFL_Obj02A_Dy : 59|11@1+ (0.125,-128) [-128|127.875] "m"  RadarFrontCenter
 SG_ RFL_Obj02A_Valid : 70|1@1+ (1,0) [0|1] ""  RadarFrontCenter
 SG_ RFL_Obj02A_Vx : 71|12@1+ (0.0625,-128) [-128|127.9375] "m/s"  RadarFrontCenter
 SG_ RFL_Obj02A_Vy : 83|10@1+ (0.125,-64) [-64|63.875] "m/s"  RadarFrontCenter
 SG_ RFL_Obj02A_Ax : 93|10@1+ (0.03125,-16) [-16|15.96875] "m/s^2"  RadarFrontCenter
 SG_ RFL_Obj02A_Ay : 103|9@1+ (0.0625,-16) [-16|15.9375] "m/s^2"  RadarFrontCenter
 SG_ RFL_Obj02A_HeadingYawAngle : 112|9@1+ (0.0175,-4.48) [-3.15|3.15] "rad"  RadarFrontCenter
 SG_ RFL_Obj02A_Length : 121|7@1+ (0.125,0) [0|15.875] "m"  RadarFrontCenter
 SG_ RFL_Obj02A_Width : 128|7@1+ (0.125,0) [0|15.875] "m"  RadarFrontCenter
 SG_ RFL_Obj02A_Height : 135|7@1+ (0.125,0) [0|15.875] "m"  RadarFrontCenter
 SG_ RFL_Obj02A_DxVnce : 142|12@1+ (0.01,0) [0|30] "m^2"  RadarFrontCenter
 SG_ RFL_Obj02A_DyVnce : 154|12@1+ (0.01,0) [0|30] "m^2"  RadarFrontCenter
 SG_ RFL_Obj02A_DzVnce : 166|10@1+ (0.01,0) [0|10] "m^2"  RadarFrontCenter
 SG_ RFL_Obj02A_VxVnce : 176|12@1+ (0.01,0) [0|30] "m^2/s^2"  RadarFrontCenter
 SG_ RFL_Obj02A_VyVnce : 188|12@1+ (0.01,0) [0|30] "m^2/s^2"  RadarFrontCenter
 SG_ RFL_Obj02A_AxVnce : 200|12@1+ (0.01,0) [0|30] "m^2/s^4"  RadarFrontCenter
 SG_ RFL_Obj02A_AyVnce : 212|12@1+ (0.01,0) [0|30] "m^2/s^4"  RadarFrontCenter
 SG_ RFL_Obj02A_RefPosIndex : 224|4@1+ (1,0) [0|15] ""  RadarFrontCenter
 SG_ RFL_Obj02A_DxDyCoVnce : 228|12@1+ (0.01,0) [0|30] "m^2"  RadarFrontCenter
 SG_ RFL_Obj02A_DxVxCoVnce : 240|12@1+ (0.01,0) [0|30] "m^2/s"  RadarFrontCenter
 SG_ RFL_Obj02A_DyVxCoVnce : 252|12@1+ (0.01,0) [0|30] "m^2/s"  RadarFrontCenter
 SG_ RFL_Obj02A_DxVyCoVnce : 264|12@1+ (0.01,0) [0|30] "m^2/s"  RadarFrontCenter
 SG_ RFL_Obj02A_DyVyCoVnce : 276|12@1+ (0.01,0) [0|30] "m^2/s"  RadarFrontCenter
 SG_ RFL_Obj02A_VxVyCoVnce : 288|12@1+ (0.01,0) [0|30] "m^2/s^2"  RadarFrontCenter
 SG_ RFL_Obj02A_DxAxCoVnce : 300|12@1+ (0.01,0) [0|30] "m^2/s^2"  RadarFrontCenter
 SG_ RFL_Obj02A_DyAxCoVnce : 312|12@1+ (0.01,0) [0|30] "m^2/s^2"  RadarFrontCenter
 SG_ RFL_Obj02A_VxAxCoVnce : 324|12@1+ (0.01,0) [0|30] "m^2/s^3"  RadarFrontCenter
 SG_ RFL_Obj02A_VyAxCoVnce : 336|12@1+ (0.01,0) [0|30] "m^2/s^3"  RadarFrontCenter
 SG_ RFL_Obj02A_DxAyCoVnce : 348|12@1+ (0.01,0) [0|30] "m^2/s^2"  RadarFrontCenter
 SG_ RFL_Obj02A_DyAyCoVnce : 360|12@1+ (0.01,0) [0|30] "m^2/s^2"  RadarFrontCenter
 SG_ RFL_Obj02A_VxAyCoVnce : 372|12@1+ (0.01,0) [0|30] "m^2/s^3"  RadarFrontCenter
 SG_ RFL_Obj02A_VyAyCoVnce : 384|12@1+ (0.01,0) [0|30] "m^2/s^3"  RadarFrontCenter
 SG_ RFL_Obj02A_AxAyCoVnce : 396|12@1+ (0.01,0) [0|30] "m^2/s^4"  RadarFrontCenter
 SG_ RFL_Obj02A_HeadingYawAngleVnce : 408|12@1+ (0.0003,0) [0|1] "rad^2"  RadarFrontCenter
 SG_ RFL_Obj02A_LengthVnce : 420|12@1+ (0.01,0) [0|30] "m^2"  RadarFrontCenter
 SG_ RFL_Obj02A_WidthVnce : 432|12@1+ (0.01,0) [0|30] "m^2"  RadarFrontCenter
 SG_ RFL_Obj02A_HeightVnce : 444|12@1+ (0.01,0) [0|30] "m^2"  RadarFrontCenter
 SG_ RFL_Obj02A_ProbExist : 456|6@1+ (2,0) [0|100] "%"  RadarFrontCenter
 SG_ RFL_Obj02A_ProbObstacle : 462|6@1+ (2,0) [0|100] "%"  RadarFrontCenter
 SG_ RFL_Obj02A_ProbNonObstacle : 468|6@1+ (2,0) [0|100] "%"  RadarFrontCenter
 SG_ RFL_Obj02A_ProbMobileObst : 474|6@1+ (2,0) [0|100] "%"  RadarFrontCenter

BO_ 533 RFL_Obj02B: 16 RadarFrontLeft
 SG_ RFL_Obj02B_CRC : 0|16@1+ (1,0) [0|65535] ""  RadarFrontCenter
 SG_ RFL_Obj02B_AliveCtr : 16|8@1+ (1,0) [0|255] ""  RadarFrontCenter
 SG_ RFL_Obj02B_ProtBlockCtr : 24|4@1+ (1,0) [0|15] ""  RadarFrontCenter
 SG_ RFL_Obj02B_ProbMob4PlusWhl : 28|6@1+ (2,0) [0|100] "%"  RadarFrontCenter
 SG_ RFL_Obj02B_ProbMob2Whl : 34|6@1+ (2,0) [0|100] "%"  RadarFrontCenter
 SG_ RFL_Obj02B_ProbMobPed : 40|6@1+ (2,0) [0|100] "%"  RadarFrontCenter
 SG_ RFL_Obj02B_Prob4PlusWhlCAR : 46|6@1+ (2,0) [0|100] "%"  RadarFrontCenter
 SG_ RFL_Obj02B_Prob4PlusWhlbHGV : 52|6@1+ (2,0) [0|100] "%"  RadarFrontCenter
 SG_ RFL_Obj02B_ProbGNDReflex : 58|6@1+ (2,0) [0|100] "%"  RadarFrontCenter
 SG_ RFL_Obj02B_ProbStatBarrier : 64|6@1+ (2,0) [0|100] "%"  RadarFrontCenter
 SG_ RFL_Obj02B_ProbStatObst : 70|6@1+ (2,0) [0|100] "%"  RadarFrontCenter
 SG_ RFL_Obj02B_MovingProbability : 76|6@1+ (2,0) [0|100] "%"  RadarFrontCenter
 SG_ RFL_Obj02B_MovingObserved : 82|6@1+ (2,0) [0|100] "%"  RadarFrontCenter
 SG_ RFL_Obj02B_BehaviorType : 88|3@1+ (1,0) [0|7] ""  RadarFrontCenter

BO_ 534 RFL_Obj03A: 64 RadarFrontLeft
 SG_ RFL_Obj03A_CRC : 0|16@1+ (1,0) [0|65535] ""  RadarFrontCenter
 SG_ RFL_Obj03A_AliveCtr : 16|8@1+ (1,0) [0|255] ""  RadarFrontCenter
 SG_ RFL_Obj03A_ProtBlockCtr : 24|4@1+ (1,0) [0|15] ""  RadarFrontCenter
 SG_ RFL_Obj03A_ID : 32|7@1+ (1,0) [0|127] ""  RadarFrontCenter
 SG_ RFL_Obj03A_Measured : 39|1@1+ (1,0) [0|1] ""  RadarFrontCenter
 SG_ RFL_Obj03A_Dx : 40|13@1+ (0.0625,-256) [-256|255.9375] "m"  RadarFrontCenter
 SG_ RFL_Obj03A_Dz : 53|6@1+ (0.25,-5) [-5|10.75] "m"  RadarFrontCenter
 SG_ RFL_Obj03A_Dy : 59|11@1+ (0.125,-128) [-128|127.875] "m"  RadarFrontCenter
 SG_ RFL_Obj03A_Valid : 70|1@1+ (1,0) [0|1] ""  RadarFrontCenter
 SG_ RFL_Obj03A_Vx : 71|12@1+ (0.0625,-128) [-128|127.9375] "m/s"  RadarFrontCenter
 SG_ RFL_Obj03A_Vy : 83|10@1+ (0.125,-64) [-64|63.875] "m/s"  RadarFrontCenter
 SG_ RFL_Obj03A_Ax : 93|10@1+ (0.03125,-16) [-16|15.96875] "m/s^2"  RadarFrontCenter
 SG_ RFL_Obj03A_Ay : 103|9@1+ (0.0625,-16) [-16|15.9375] "m/s^2"  RadarFrontCenter
 SG_ RFL_Obj03A_HeadingYawAngle : 112|9@1+ (0.0175,-4.48) [-3.15|3.15] "rad"  RadarFrontCenter
 SG_ RFL_Obj03A_Length : 121|7@1+ (0.125,0) [0|15.875] "m"  RadarFrontCenter
 SG_ RFL_Obj03A_Width : 128|7@1+ (0.125,0) [0|15.875] "m"  RadarFrontCenter
 SG_ RFL_Obj03A_Height : 135|7@1+ (0.125,0) [0|15.875] "m"  RadarFrontCenter
 SG_ RFL_Obj03A_DxVnce : 142|12@1+ (0.01,0) [0|30] "m^2"  RadarFrontCenter
 SG_ RFL_Obj03A_DyVnce : 154|12@1+ (0.01,0) [0|30] "m^2"  RadarFrontCenter
 SG_ RFL_Obj03A_DzVnce : 166|10@1+ (0.01,0) [0|10] "m^2"  RadarFrontCenter
 SG_ RFL_Obj03A_VxVnce : 176|12@1+ (0.01,0) [0|30] "m^2/s^2"  RadarFrontCenter
 SG_ RFL_Obj03A_VyVnce : 188|12@1+ (0.01,0) [0|30] "m^2/s^2"  RadarFrontCenter
 SG_ RFL_Obj03A_AxVnce : 200|12@1+ (0.01,0) [0|30] "m^2/s^4"  RadarFrontCenter
 SG_ RFL_Obj03A_AyVnce : 212|12@1+ (0.01,0) [0|30] "m^2/s^4"  RadarFrontCenter
 SG_ RFL_Obj03A_RefPosIndex : 224|4@1+ (1,0) [0|15] ""  RadarFrontCenter
 SG_ RFL_Obj03A_DxDyCoVnce : 228|12@1+ (0.01,0) [0|30] "m^2"  RadarFrontCenter
 SG_ RFL_Obj03A_DxVxCoVnce : 240|12@1+ (0.01,0) [0|30] "m^2/s"  RadarFrontCenter
 SG_ RFL_Obj03A_DyVxCoVnce : 252|12@1+ (0.01,0) [0|30] "m^2/s"  RadarFrontCenter
 SG_ RFL_Obj03A_DxVyCoVnce : 264|12@1+ (0.01,0) [0|30] "m^2/s"  RadarFrontCenter
 SG_ RFL_Obj03A_DyVyCoVnce : 276|12@1+ (0.01,0) [0|30] "m^2/s"  RadarFrontCenter
 SG_ RFL_Obj03A_VxVyCoVnce : 288|12@1+ (0.01,0) [0|30] "m^2/s^2"  RadarFrontCenter
 SG_ RFL_Obj03A_DxAxCoVnce : 300|12@1+ (0.01,0) [0|30] "m^2/s^2"  RadarFrontCenter
 SG_ RFL_Obj03A_DyAxCoVnce : 312|12@1+ (0.01,0) [0|30] "m^2/s^2"  RadarFrontCenter
 SG_ RFL_Obj03A_VxAxCoVnce : 324|12@1+ (0.01,0) [0|30] "m^2/s^3"  RadarFrontCenter
 SG_ RFL_Obj03A_VyAxCoVnce : 336|12@1+ (0.01,0) [0|30] "m^2/s^3"  RadarFrontCenter
 SG_ RFL_Obj03A_DxAyCoVnce : 348|12@1+ (0.01,0) [0|30] "m^2/s^2"  RadarFrontCenter
 SG_ RFL_Obj03A_DyAyCoVnce : 360|12@1+ (0.01,0) [0|30] "m^2/s^2"  RadarFrontCenter
 SG_ RFL_Obj03A_VxAyCoVnce : 372|12@1+ (0.01,0) [0|30] "m^2/s^3"  RadarFrontCenter
 SG_ RFL_Obj03A_VyAyCoVnce : 384|12@1+ (0.01,0) [0|30] "m^2/s^3"  RadarFrontCenter
 SG_ RFL_Obj03A_AxAyCoVnce : 396|12@1+ (0.01,0) [0|30] "m^2/s^4"  RadarFrontCenter
 SG_ RFL_Obj03A_HeadingYawAngleVnce : 408|12@1+ (0.0003,0) [0|1] "rad^2"  RadarFrontCenter
 SG_ RFL_Obj03A_LengthVnce : 420|12@1+ (0.01,0) [0|30] "m^2"  RadarFrontCenter
 SG_ RFL_Obj03A_WidthVnce : 432|12@1+ (0.01,0) [0|30] "m^2"  RadarFrontCenter
 SG_ RFL_Obj03A_HeightVnce : 444|12@1+ (0.01,0) [0|30] "m^2"  RadarFrontCenter
 SG_ RFL_Obj03A_ProbExist : 456|6@1+ (2,0) [0|100] "%"  RadarFrontCenter
 SG_ RFL_Obj03A_ProbObstacle : 462|6@1+ (2,0) [0|100] "%"  RadarFrontCenter
 SG_ RFL_Obj03A_ProbNonObstacle : 468|6@1+ (2,0) [0|100] "%"  RadarFrontCenter
 SG_ RFL_Obj03A_ProbMobileObst : 474|6@1+ (2,0) [0|100] "%"  RadarFrontCenter

BO_ 535 RFL_Obj03B: 16 RadarFrontLeft
 SG_ RFL_Obj03B_CRC : 0|16@1+ (1,0) [0|65535] ""  RadarFrontCenter
 SG_ RFL_Obj03B_AliveCtr : 16|8@1+ (1,0) [0|255] ""  RadarFrontCenter
 SG_ RFL_Obj03B_ProtBlockCtr : 24|4@1+ (1,0) [0|15] ""  RadarFrontCenter
 SG_ RFL_Obj03B_ProbMob4PlusWhl : 28|6@1+ (2,0) [0|100] "%"  RadarFrontCenter
 SG_ RFL_Obj03B_ProbMob2Whl : 34|6@1+ (2,0) [0|100] "%"  RadarFrontCenter
 SG_ RFL_Obj03B_ProbMobPed : 40|6@1+ (2,0) [0|100] "%"  RadarFrontCenter
 SG_ RFL_Obj03B_Prob4PlusWhlCAR : 46|6@1+ (2,0) [0|100] "%"  RadarFrontCenter
 SG_ RFL_Obj03B_Prob4PlusWhlbHGV : 52|6@1+ (2,0) [0|100] "%"  RadarFrontCenter
 SG_ RFL_Obj03B_ProbGNDReflex : 58|6@1+ (2,0) [0|100] "%"  RadarFrontCenter
 SG_ RFL_Obj03B_ProbStatBarrier : 64|6@1+ (2,0) [0|100] "%"  RadarFrontCenter
 SG_ RFL_Obj03B_ProbStatObst : 70|6@1+ (2,0) [0|100] "%"  RadarFrontCenter
 SG_ RFL_Obj03B_MovingProbability : 76|6@1+ (2,0) [0|100] "%"  RadarFrontCenter
 SG_ RFL_Obj03B_MovingObserved : 82|6@1+ (2,0) [0|100] "%"  RadarFrontCenter
 SG_ RFL_Obj03B_BehaviorType : 88|3@1+ (1,0) [0|7] ""  RadarFrontCenter

CM_ SG_ 244 VFC_TS_12_13_CRC "CRC - Autosar E2E Profile 5";
CM_ SG_ 244 VFC_TS_12_13_AliveCtr "Alive counter - Autosar E2E Profile 5";
CM_ SG_ 244 VFC_TS_12_13_ProtBlockCtr "Protocol-Signal: Block-Counter";
CM_ SG_ 244 VFC_TS12_ObjId "Unique Traffic Sign ID. ISO 23150:2022(E): Object ID (A.2.2)";
CM_ SG_ 244 VFC_TS12_Type "The type of main sign. ISO 23150:2022(E): Sign classification type (A.2.98)";
CM_ SG_ 244 VFC_TS12_ExistProb "Probability that the sign is a traffic sign. ISO 23150:2022(E): Existence probability - object level (A.2.1)";
CM_ SG_ 244 VFC_TS12_Px "Traffic sign position in longitudinal direction. ISO 23150:2022(E): Position - object level {x, y, z} (A.2.15)";
CM_ SG_ 244 VFC_TS12_Py "Traffic sign position in lateral direction. ISO 23150:2022(E): Position - object level {x, y, z} (A.2.15)";
CM_ SG_ 244 VFC_TS12_Pz "Traffic sign position in vertical direction. ISO 23150:2022(E): Position - object level {x, y, z} (A.2.15)";
CM_ SG_ 244 VFC_TS12_PxStdDev "Standard deviation of Traffic sign position in longitudinal direction. ISO 23150:2022(E): Position - object level {x, y, z} - error (A.2.16)";
CM_ SG_ 244 VFC_TS12_Width "Width of the traffic sign. ISO 23150:2022(E): Bounding box extent {length, width, height} (A.2.20)";
CM_ SG_ 244 VFC_TS12_Height "Height of the traffic sign. ISO 23150:2022(E): Bounding box extent {length, width, height} (A.2.20)";
CM_ SG_ 244 VFC_TS12_EmbeddedInfo "Information how the sign is embedded or not";
CM_ SG_ 244 VFC_TS12_ValidLane "Indicates on which lane the detected sign is valid. If traffic sign is generally valid, all bits shall be set. No relevance to ego lane, signal related to ISO 23150:2022(E): Lane relevance classification type (A.2.147)
Bitfield:
Bit 0: valid on first right hand lane
Bit 1: valid on second right hand lane
Bit 2: valid on third right hand lane
Bit 3: valid on fourth right hand lane
Bit 4: valid on fifth right hand lane";
CM_ SG_ 244 VFC_TS12_ValidDay "The week days for which the main traffic sign is valid. If traffic sign is generally valid, all bits shall be set. Related to ISO 23150:2022(E): Sign text (A.2.102)
Bitfield:
Bit 0: MONDAY
Bit 1: TUESDAY
Bit 2: WEDNESDAY
Bit 3: THURSDAY
Bit 4: FRIDAY
Bit 5: SATURDAY
Bit 6: SUNDAY";
CM_ SG_ 244 VFC_TS12_ValidTimeRange1Start "Start time for the first time range in which the main traffic sign is valid. Minutes since midnight. Related to ISO 23150:2022(E): Sign text (A.2.102)";
CM_ SG_ 244 VFC_TS12_ValidTimeRange1End "End time for the first time range in which the main traffic sign is valid. Minutes since midnight. Related to ISO 23150:2022(E): Sign text (A.2.102)";
CM_ SG_ 244 VFC_TS12_ValidTimeRange2Start "Start time for the second time range in which the main traffic sign is valid. Minutes since midnight. Related to ISO 23150:2022(E): Sign text (A.2.102)";
CM_ SG_ 244 VFC_TS12_ValidTimeRange2End "End time for the second time range in which the main traffic sign is valid. Minutes since midnight. Related to ISO 23150:2022(E): Sign text (A.2.102)";
CM_ SG_ 244 VFC_TS12_ValidInDist "Indicates the longitudinal distance in which the validity of the main traffic sign starts. Unit is set in signal ValidInDistUnit. Related to ISO 23150:2022(E): Sign text (A.2.102)";
CM_ SG_ 244 VFC_TS12_ValidInDistUnit "Unit for signal ValidInDist. ISO 23150:2022(E): Sign value unit (A.2.101)";
CM_ SG_ 244 VFC_TS12_ValidSection "Indicates the longitudinal section for which the main traffic sign is valid. Unit is set in signal ValidSectionUnit. Related to ISO 23150:2022(E): Sign text (A.2.102)";
CM_ SG_ 244 VFC_TS12_ValidSectionUnit "Unit for signal ValidSection. ISO 23150:2022(E): Sign value unit (A.2.101)";
CM_ SG_ 244 VFC_TS12_NumValidSupSigns "Number of valid supplementary signs attached to the main sign. ISO 23150:2022(E): Number of valid traffic supplementary signs (A.2.149)";
CM_ SG_ 244 VFC_TS12_SupSign0ExistProb "Probability that the sign is a supplementary traffic sign. ISO 23150:2022(E): Existence probability - object level (A.2.1)";
CM_ SG_ 244 VFC_TS12_SupSign1ExistProb "Probability that the sign is a supplementary traffic sign. ISO 23150:2022(E): Existence probability - object level (A.2.1)";
CM_ SG_ 244 VFC_TS12_SupSign2ExistProb "Probability that the sign is a supplementary traffic sign. ISO 23150:2022(E): Existence probability - object level (A.2.1)";
CM_ SG_ 244 VFC_TS12_SupSign3ExistProb "Probability that the sign is a supplementary traffic sign. ISO 23150:2022(E): Existence probability - object level (A.2.1)";
CM_ SG_ 244 VFC_TS12_SupSign4ExistProb "Probability that the sign is a supplementary traffic sign. ISO 23150:2022(E): Existence probability - object level (A.2.1)";
CM_ SG_ 244 VFC_TS12_SupSign5ExistProb "Probability that the sign is a supplementary traffic sign. ISO 23150:2022(E): Existence probability - object level (A.2.1)";
CM_ SG_ 244 VFC_TS12_SupSign0Type "The type of supplementary sign. ISO 23150:2022(E): Supplementary sign classification type (A.2.151)";
CM_ SG_ 244 VFC_TS12_SupSign1Type "The type of supplementary sign. ISO 23150:2022(E): Supplementary sign classification type (A.2.151)";
CM_ SG_ 244 VFC_TS12_SupSign2Type "The type of supplementary sign. ISO 23150:2022(E): Supplementary sign classification type (A.2.151)";
CM_ SG_ 244 VFC_TS12_SupSign3Type "The type of supplementary sign. ISO 23150:2022(E): Supplementary sign classification type (A.2.151)";
CM_ SG_ 244 VFC_TS12_SupSign4Type "The type of supplementary sign. ISO 23150:2022(E): Supplementary sign classification type (A.2.151)";
CM_ SG_ 244 VFC_TS12_SupSign5Type "The type of supplementary sign. ISO 23150:2022(E): Supplementary sign classification type (A.2.151)";
CM_ SG_ 244 VFC_TS13_ObjId "Unique Traffic Sign ID. ISO 23150:2022(E): Object ID (A.2.2)";
CM_ SG_ 244 VFC_TS13_Type "The type of main sign. ISO 23150:2022(E): Sign classification type (A.2.98)";
CM_ SG_ 244 VFC_TS13_ExistProb "Probability that the sign is a traffic sign. ISO 23150:2022(E): Existence probability - object level (A.2.1)";
CM_ SG_ 244 VFC_TS13_Px "Traffic sign position in longitudinal direction. ISO 23150:2022(E): Position - object level {x, y, z} (A.2.15)";
CM_ SG_ 244 VFC_TS13_Py "Traffic sign position in lateral direction. ISO 23150:2022(E): Position - object level {x, y, z} (A.2.15)";
CM_ SG_ 244 VFC_TS13_Pz "Traffic sign position in vertical direction. ISO 23150:2022(E): Position - object level {x, y, z} (A.2.15)";
CM_ SG_ 244 VFC_TS13_PxStdDev "Standard deviation of Traffic sign position in longitudinal direction. ISO 23150:2022(E): Position - object level {x, y, z} - error (A.2.16)";
CM_ SG_ 244 VFC_TS13_Width "Width of the traffic sign. ISO 23150:2022(E): Bounding box extent {length, width, height} (A.2.20)";
CM_ SG_ 244 VFC_TS13_Height "Height of the traffic sign. ISO 23150:2022(E): Bounding box extent {length, width, height} (A.2.20)";
CM_ SG_ 244 VFC_TS13_EmbeddedInfo "Information how the sign is embedded or not";
CM_ SG_ 244 VFC_TS13_ValidLane "Indicates on which lane the detected sign is valid. If traffic sign is generally valid, all bits shall be set. No relevance to ego lane, signal related to ISO 23150:2022(E): Lane relevance classification type (A.2.147)
Bitfield:
Bit 0: valid on first right hand lane
Bit 1: valid on second right hand lane
Bit 2: valid on third right hand lane
Bit 3: valid on fourth right hand lane
Bit 4: valid on fifth right hand lane";
CM_ SG_ 244 VFC_TS13_ValidDay "The week days for which the main traffic sign is valid. If traffic sign is generally valid, all bits shall be set. Related to ISO 23150:2022(E): Sign text (A.2.102)
Bitfield:
Bit 0: MONDAY
Bit 1: TUESDAY
Bit 2: WEDNESDAY
Bit 3: THURSDAY
Bit 4: FRIDAY
Bit 5: SATURDAY
Bit 6: SUNDAY";
CM_ SG_ 244 VFC_TS13_ValidTimeRange1Start "Start time for the first time range in which the main traffic sign is valid. Minutes since midnight. Related to ISO 23150:2022(E): Sign text (A.2.102)";
CM_ SG_ 244 VFC_TS13_ValidTimeRange1End "End time for the first time range in which the main traffic sign is valid. Minutes since midnight. Related to ISO 23150:2022(E): Sign text (A.2.102)";
CM_ SG_ 244 VFC_TS13_ValidTimeRange2Start "Start time for the second time range in which the main traffic sign is valid. Minutes since midnight. Related to ISO 23150:2022(E): Sign text (A.2.102)";
CM_ SG_ 244 VFC_TS13_ValidTimeRange2End "End time for the second time range in which the main traffic sign is valid. Minutes since midnight. Related to ISO 23150:2022(E): Sign text (A.2.102)";
CM_ SG_ 244 VFC_TS13_ValidInDist "Indicates the longitudinal distance in which the validity of the main traffic sign starts. Unit is set in signal ValidInDistUnit. Related to ISO 23150:2022(E): Sign text (A.2.102)";
CM_ SG_ 244 VFC_TS13_ValidInDistUnit "Unit for signal ValidInDist. ISO 23150:2022(E): Sign value unit (A.2.101)";
CM_ SG_ 244 VFC_TS13_ValidSection "Indicates the longitudinal section for which the main traffic sign is valid. Unit is set in signal ValidSectionUnit. Related to ISO 23150:2022(E): Sign text (A.2.102)";
CM_ SG_ 244 VFC_TS13_ValidSectionUnit "Unit for signal ValidSection. ISO 23150:2022(E): Sign value unit (A.2.101)";
CM_ SG_ 244 VFC_TS13_NumValidSupSigns "Number of valid supplementary signs attached to the main sign. ISO 23150:2022(E): Number of valid traffic supplementary signs (A.2.149)";
CM_ SG_ 244 VFC_TS13_SupSign0ExistProb "Probability that the sign is a supplementary traffic sign. ISO 23150:2022(E): Existence probability - object level (A.2.1)";
CM_ SG_ 244 VFC_TS13_SupSign1ExistProb "Probability that the sign is a supplementary traffic sign. ISO 23150:2022(E): Existence probability - object level (A.2.1)";
CM_ SG_ 244 VFC_TS13_SupSign2ExistProb "Probability that the sign is a supplementary traffic sign. ISO 23150:2022(E): Existence probability - object level (A.2.1)";
CM_ SG_ 244 VFC_TS13_SupSign3ExistProb "Probability that the sign is a supplementary traffic sign. ISO 23150:2022(E): Existence probability - object level (A.2.1)";
CM_ SG_ 244 VFC_TS13_SupSign4ExistProb "Probability that the sign is a supplementary traffic sign. ISO 23150:2022(E): Existence probability - object level (A.2.1)";
CM_ SG_ 244 VFC_TS13_SupSign5ExistProb "Probability that the sign is a supplementary traffic sign. ISO 23150:2022(E): Existence probability - object level (A.2.1)";
CM_ SG_ 244 VFC_TS13_SupSign0Type "The type of supplementary sign. ISO 23150:2022(E): Supplementary sign classification type (A.2.151)";
CM_ SG_ 244 VFC_TS13_SupSign1Type "The type of supplementary sign. ISO 23150:2022(E): Supplementary sign classification type (A.2.151)";
CM_ SG_ 244 VFC_TS13_SupSign2Type "The type of supplementary sign. ISO 23150:2022(E): Supplementary sign classification type (A.2.151)";
CM_ SG_ 244 VFC_TS13_SupSign3Type "The type of supplementary sign. ISO 23150:2022(E): Supplementary sign classification type (A.2.151)";
CM_ SG_ 244 VFC_TS13_SupSign4Type "The type of supplementary sign. ISO 23150:2022(E): Supplementary sign classification type (A.2.151)";
CM_ SG_ 244 VFC_TS13_SupSign5Type "The type of supplementary sign. ISO 23150:2022(E): Supplementary sign classification type (A.2.151)";
CM_ SG_ 245 VFC_TS_14_15_CRC "CRC - Autosar E2E Profile 5";
CM_ SG_ 245 VFC_TS_14_15_AliveCtr "Alive counter - Autosar E2E Profile 5";
CM_ SG_ 245 VFC_TS_14_15_ProtBlockCtr "Protocol-Signal: Block-Counter";
CM_ SG_ 245 VFC_TS14_ObjId "Unique Traffic Sign ID. ISO 23150:2022(E): Object ID (A.2.2)";
CM_ SG_ 245 VFC_TS14_Type "The type of main sign. ISO 23150:2022(E): Sign classification type (A.2.98)";
CM_ SG_ 245 VFC_TS14_ExistProb "Probability that the sign is a traffic sign. ISO 23150:2022(E): Existence probability - object level (A.2.1)";
CM_ SG_ 245 VFC_TS14_Px "Traffic sign position in longitudinal direction. ISO 23150:2022(E): Position - object level {x, y, z} (A.2.15)";
CM_ SG_ 245 VFC_TS14_Py "Traffic sign position in lateral direction. ISO 23150:2022(E): Position - object level {x, y, z} (A.2.15)";
CM_ SG_ 245 VFC_TS14_Pz "Traffic sign position in vertical direction. ISO 23150:2022(E): Position - object level {x, y, z} (A.2.15)";
CM_ SG_ 245 VFC_TS14_PxStdDev "Standard deviation of Traffic sign position in longitudinal direction. ISO 23150:2022(E): Position - object level {x, y, z} - error (A.2.16)";
CM_ SG_ 245 VFC_TS14_Width "Width of the traffic sign. ISO 23150:2022(E): Bounding box extent {length, width, height} (A.2.20)";
CM_ SG_ 245 VFC_TS14_Height "Height of the traffic sign. ISO 23150:2022(E): Bounding box extent {length, width, height} (A.2.20)";
CM_ SG_ 245 VFC_TS14_EmbeddedInfo "Information how the sign is embedded or not";
CM_ SG_ 245 VFC_TS14_ValidLane "Indicates on which lane the detected sign is valid. If traffic sign is generally valid, all bits shall be set. No relevance to ego lane, signal related to ISO 23150:2022(E): Lane relevance classification type (A.2.147)
Bitfield:
Bit 0: valid on first right hand lane
Bit 1: valid on second right hand lane
Bit 2: valid on third right hand lane
Bit 3: valid on fourth right hand lane
Bit 4: valid on fifth right hand lane";
CM_ SG_ 245 VFC_TS14_ValidDay "The week days for which the main traffic sign is valid. If traffic sign is generally valid, all bits shall be set. Related to ISO 23150:2022(E): Sign text (A.2.102)
Bitfield:
Bit 0: MONDAY
Bit 1: TUESDAY
Bit 2: WEDNESDAY
Bit 3: THURSDAY
Bit 4: FRIDAY
Bit 5: SATURDAY
Bit 6: SUNDAY";
CM_ SG_ 245 VFC_TS14_ValidTimeRange1Start "Start time for the first time range in which the main traffic sign is valid. Minutes since midnight. Related to ISO 23150:2022(E): Sign text (A.2.102)";
CM_ SG_ 245 VFC_TS14_ValidTimeRange1End "End time for the first time range in which the main traffic sign is valid. Minutes since midnight. Related to ISO 23150:2022(E): Sign text (A.2.102)";
CM_ SG_ 245 VFC_TS14_ValidTimeRange2Start "Start time for the second time range in which the main traffic sign is valid. Minutes since midnight. Related to ISO 23150:2022(E): Sign text (A.2.102)";
CM_ SG_ 245 VFC_TS14_ValidTimeRange2End "End time for the second time range in which the main traffic sign is valid. Minutes since midnight. Related to ISO 23150:2022(E): Sign text (A.2.102)";
CM_ SG_ 245 VFC_TS14_ValidInDist "Indicates the longitudinal distance in which the validity of the main traffic sign starts. Unit is set in signal ValidInDistUnit. Related to ISO 23150:2022(E): Sign text (A.2.102)";
CM_ SG_ 245 VFC_TS14_ValidInDistUnit "Unit for signal ValidInDist. ISO 23150:2022(E): Sign value unit (A.2.101)";
CM_ SG_ 245 VFC_TS14_ValidSection "Indicates the longitudinal section for which the main traffic sign is valid. Unit is set in signal ValidSectionUnit. Related to ISO 23150:2022(E): Sign text (A.2.102)";
CM_ SG_ 245 VFC_TS14_ValidSectionUnit "Unit for signal ValidSection. ISO 23150:2022(E): Sign value unit (A.2.101)";
CM_ SG_ 245 VFC_TS14_NumValidSupSigns "Number of valid supplementary signs attached to the main sign. ISO 23150:2022(E): Number of valid traffic supplementary signs (A.2.149)";
CM_ SG_ 245 VFC_TS14_SupSign0ExistProb "Probability that the sign is a supplementary traffic sign. ISO 23150:2022(E): Existence probability - object level (A.2.1)";
CM_ SG_ 245 VFC_TS14_SupSign1ExistProb "Probability that the sign is a supplementary traffic sign. ISO 23150:2022(E): Existence probability - object level (A.2.1)";
CM_ SG_ 245 VFC_TS14_SupSign2ExistProb "Probability that the sign is a supplementary traffic sign. ISO 23150:2022(E): Existence probability - object level (A.2.1)";
CM_ SG_ 245 VFC_TS14_SupSign3ExistProb "Probability that the sign is a supplementary traffic sign. ISO 23150:2022(E): Existence probability - object level (A.2.1)";
CM_ SG_ 245 VFC_TS14_SupSign4ExistProb "Probability that the sign is a supplementary traffic sign. ISO 23150:2022(E): Existence probability - object level (A.2.1)";
CM_ SG_ 245 VFC_TS14_SupSign5ExistProb "Probability that the sign is a supplementary traffic sign. ISO 23150:2022(E): Existence probability - object level (A.2.1)";
CM_ SG_ 245 VFC_TS14_SupSign0Type "The type of supplementary sign. ISO 23150:2022(E): Supplementary sign classification type (A.2.151)";
CM_ SG_ 245 VFC_TS14_SupSign1Type "The type of supplementary sign. ISO 23150:2022(E): Supplementary sign classification type (A.2.151)";
CM_ SG_ 245 VFC_TS14_SupSign2Type "The type of supplementary sign. ISO 23150:2022(E): Supplementary sign classification type (A.2.151)";
CM_ SG_ 245 VFC_TS14_SupSign3Type "The type of supplementary sign. ISO 23150:2022(E): Supplementary sign classification type (A.2.151)";
CM_ SG_ 245 VFC_TS14_SupSign4Type "The type of supplementary sign. ISO 23150:2022(E): Supplementary sign classification type (A.2.151)";
CM_ SG_ 245 VFC_TS14_SupSign5Type "The type of supplementary sign. ISO 23150:2022(E): Supplementary sign classification type (A.2.151)";
CM_ SG_ 245 VFC_TS15_ObjId "Unique Traffic Sign ID. ISO 23150:2022(E): Object ID (A.2.2)";
CM_ SG_ 245 VFC_TS15_Type "The type of main sign. ISO 23150:2022(E): Sign classification type (A.2.98)";
CM_ SG_ 245 VFC_TS15_ExistProb "Probability that the sign is a traffic sign. ISO 23150:2022(E): Existence probability - object level (A.2.1)";
CM_ SG_ 245 VFC_TS15_Px "Traffic sign position in longitudinal direction. ISO 23150:2022(E): Position - object level {x, y, z} (A.2.15)";
CM_ SG_ 245 VFC_TS15_Py "Traffic sign position in lateral direction. ISO 23150:2022(E): Position - object level {x, y, z} (A.2.15)";
CM_ SG_ 245 VFC_TS15_Pz "Traffic sign position in vertical direction. ISO 23150:2022(E): Position - object level {x, y, z} (A.2.15)";
CM_ SG_ 245 VFC_TS15_PxStdDev "Standard deviation of Traffic sign position in longitudinal direction. ISO 23150:2022(E): Position - object level {x, y, z} - error (A.2.16)";
CM_ SG_ 245 VFC_TS15_Width "Width of the traffic sign. ISO 23150:2022(E): Bounding box extent {length, width, height} (A.2.20)";
CM_ SG_ 245 VFC_TS15_Height "Height of the traffic sign. ISO 23150:2022(E): Bounding box extent {length, width, height} (A.2.20)";
CM_ SG_ 245 VFC_TS15_EmbeddedInfo "Information how the sign is embedded or not";
CM_ SG_ 245 VFC_TS15_ValidLane "Indicates on which lane the detected sign is valid. If traffic sign is generally valid, all bits shall be set. No relevance to ego lane, signal related to ISO 23150:2022(E): Lane relevance classification type (A.2.147)
Bitfield:
Bit 0: valid on first right hand lane
Bit 1: valid on second right hand lane
Bit 2: valid on third right hand lane
Bit 3: valid on fourth right hand lane
Bit 4: valid on fifth right hand lane";
CM_ SG_ 245 VFC_TS15_ValidDay "The week days for which the main traffic sign is valid. If traffic sign is generally valid, all bits shall be set. Related to ISO 23150:2022(E): Sign text (A.2.102)
Bitfield:
Bit 0: MONDAY
Bit 1: TUESDAY
Bit 2: WEDNESDAY
Bit 3: THURSDAY
Bit 4: FRIDAY
Bit 5: SATURDAY
Bit 6: SUNDAY";
CM_ SG_ 245 VFC_TS15_ValidTimeRange1Start "Start time for the first time range in which the main traffic sign is valid. Minutes since midnight. Related to ISO 23150:2022(E): Sign text (A.2.102)";
CM_ SG_ 245 VFC_TS15_ValidTimeRange1End "End time for the first time range in which the main traffic sign is valid. Minutes since midnight. Related to ISO 23150:2022(E): Sign text (A.2.102)";
CM_ SG_ 245 VFC_TS15_ValidTimeRange2Start "Start time for the second time range in which the main traffic sign is valid. Minutes since midnight. Related to ISO 23150:2022(E): Sign text (A.2.102)";
CM_ SG_ 245 VFC_TS15_ValidTimeRange2End "End time for the second time range in which the main traffic sign is valid. Minutes since midnight. Related to ISO 23150:2022(E): Sign text (A.2.102)";
CM_ SG_ 245 VFC_TS15_ValidInDist "Indicates the longitudinal distance in which the validity of the main traffic sign starts. Unit is set in signal ValidInDistUnit. Related to ISO 23150:2022(E): Sign text (A.2.102)";
CM_ SG_ 245 VFC_TS15_ValidInDistUnit "Unit for signal ValidInDist. ISO 23150:2022(E): Sign value unit (A.2.101)";
CM_ SG_ 245 VFC_TS15_ValidSection "Indicates the longitudinal section for which the main traffic sign is valid. Unit is set in signal ValidSectionUnit. Related to ISO 23150:2022(E): Sign text (A.2.102)";
CM_ SG_ 245 VFC_TS15_ValidSectionUnit "Unit for signal ValidSection. ISO 23150:2022(E): Sign value unit (A.2.101)";
CM_ SG_ 245 VFC_TS15_NumValidSupSigns "Number of valid supplementary signs attached to the main sign. ISO 23150:2022(E): Number of valid traffic supplementary signs (A.2.149)";
CM_ SG_ 245 VFC_TS15_SupSign0ExistProb "Probability that the sign is a supplementary traffic sign. ISO 23150:2022(E): Existence probability - object level (A.2.1)";
CM_ SG_ 245 VFC_TS15_SupSign1ExistProb "Probability that the sign is a supplementary traffic sign. ISO 23150:2022(E): Existence probability - object level (A.2.1)";
CM_ SG_ 245 VFC_TS15_SupSign2ExistProb "Probability that the sign is a supplementary traffic sign. ISO 23150:2022(E): Existence probability - object level (A.2.1)";
CM_ SG_ 245 VFC_TS15_SupSign3ExistProb "Probability that the sign is a supplementary traffic sign. ISO 23150:2022(E): Existence probability - object level (A.2.1)";
CM_ SG_ 245 VFC_TS15_SupSign4ExistProb "Probability that the sign is a supplementary traffic sign. ISO 23150:2022(E): Existence probability - object level (A.2.1)";
CM_ SG_ 245 VFC_TS15_SupSign5ExistProb "Probability that the sign is a supplementary traffic sign. ISO 23150:2022(E): Existence probability - object level (A.2.1)";
CM_ SG_ 245 VFC_TS15_SupSign0Type "The type of supplementary sign. ISO 23150:2022(E): Supplementary sign classification type (A.2.151)";
CM_ SG_ 245 VFC_TS15_SupSign1Type "The type of supplementary sign. ISO 23150:2022(E): Supplementary sign classification type (A.2.151)";
CM_ SG_ 245 VFC_TS15_SupSign2Type "The type of supplementary sign. ISO 23150:2022(E): Supplementary sign classification type (A.2.151)";
CM_ SG_ 245 VFC_TS15_SupSign3Type "The type of supplementary sign. ISO 23150:2022(E): Supplementary sign classification type (A.2.151)";
CM_ SG_ 245 VFC_TS15_SupSign4Type "The type of supplementary sign. ISO 23150:2022(E): Supplementary sign classification type (A.2.151)";
CM_ SG_ 245 VFC_TS15_SupSign5Type "The type of supplementary sign. ISO 23150:2022(E): Supplementary sign classification type (A.2.151)";
CM_ SG_ 517 RFL_ObjHdr_CRC "CRC - Autosar E2E Profile 5";
CM_ SG_ 517 RFL_ObjHdr_AliveCtr "Alive counter - Autosar E2E Profile 5";
CM_ SG_ 517 RFL_ObjHdr_ProtBlockCtr "Protocol-Signal: Block-Counter";
CM_ SG_ 517 RFL_ObjHdr_SensorState "The sensor shall provide its operation state.
In case of multiple errors the most severe state shall be sent.";
CM_ SG_ 517 RFL_ObjHdr_ProtocolVersion "Protocol version to be send: 0x0107 = V1.7";
CM_ SG_ 517 RFL_ObjHdr_ProtObjectCount "number of detected VALID Objects that have been sent to the bus";
CM_ SG_ 517 RFL_ObjHdr_ProtRSBSegmentCount "number of detected segments that have been sent to the bus (only available in RadarFrontCenter, must be set to 0)";
CM_ SG_ 517 RFL_ObjHdr_ProtRSBPointCount "number of detected points that have been sent to the bus (only available in RadarFrontCenter, must be set to 0)";
CM_ SG_ 517 RFL_ObjHdr_TimeStampStatus "Autosar StbM_TimeBaseStatusType bitfield with extension:
Bit 0: TIMEOUT
Bit 1: Reserved1
Bit 2: SYNC_TO_GATEWAY
Bit 3: GLOBAL_TIME_BASE
Bit 4: TIMELEAP_FUTURE
Bit 5: TIMELEAP_PAST
Bit 6: Reserved6
Bit 7: Extension: GENERAL_ERROR";
CM_ SG_ 517 RFL_ObjHdr_TimeStamp "Time Stamp";
CM_ SG_ 517 RFL_ObjHdr_MountPosY "mount offset of sensor in lateral direction relative to mid axis of vehicle";
CM_ SG_ 517 RFL_ObjHdr_MountPosX "mount offset of sensor in longitudinal direction relative to rear axis of vehicle";
CM_ SG_ 517 RFL_ObjHdr_MountPosZ "mount offset of sensor in elevation direction relative to GROUND";
CM_ SG_ 517 RFL_ObjHdr_ObjectDownSel "the detected number of objects exceeded the number of max. objects that can be transmitted";
CM_ SG_ 517 RFL_ObjHdr_YawMountAngle "angle between sensor mounting direction and vehicle longitudinal axis, Azimuth";
CM_ SG_ 517 RFL_ObjHdr_YawAngleLower "Lower angle of the fied of view Azimuth";
CM_ SG_ 517 RFL_ObjHdr_AziOutOfSpec "The sensor was detected to be out-of-spec due to misalignment in azimuth";
CM_ SG_ 517 RFL_ObjHdr_YawAngleUpper "Upper angle of the field of view Azimuth";
CM_ SG_ 517 RFL_ObjHdr_ElevOutOfSpec "The sensor was detected to be out-of-spec due to misalignment in elevation";
CM_ SG_ 517 RFL_ObjHdr_PitchMountAngle "angle between sensor mounting direction and vehicle longitudinal axis, Elevation";
CM_ SG_ 517 RFL_ObjHdr_PitchAngleLower "Lower angle of the fied of view Elevation";
CM_ SG_ 517 RFL_ObjHdr_PitchAngleUpper "Upper angle of the field of view Elevation";
CM_ SG_ 517 RFL_ObjHdr_RollMountAngle "Tilt of the mounting sensor";
CM_ SG_ 517 RFL_ObjHdr_DetectionRange "Estimated detection range of the sensor";
CM_ SG_ 517 RFL_ObjHdr_TimeStampLocal "Local Time Stamp";
CM_ SG_ 528 RFL_Obj00A_CRC "CRC - Autosar E2E Profile 5";
CM_ SG_ 528 RFL_Obj00A_AliveCtr "Alive counter - Autosar E2E Profile 5";
CM_ SG_ 528 RFL_Obj00A_ProtBlockCtr "Protocol-Signal: Block-Counter";
CM_ SG_ 528 RFL_Obj00A_ID "Unique Object ID";
CM_ SG_ 528 RFL_Obj00A_Measured "Object is measured or not";
CM_ SG_ 528 RFL_Obj00A_Dx "Object position in X direction";
CM_ SG_ 528 RFL_Obj00A_Dz "Object position in Z direction";
CM_ SG_ 528 RFL_Obj00A_Dy "Object position in Y direction";
CM_ SG_ 528 RFL_Obj00A_Valid "Object is valid or not";
CM_ SG_ 528 RFL_Obj00A_Vx "Object relative velocity in X direction";
CM_ SG_ 528 RFL_Obj00A_Vy "Object relative velocity in Y direction";
CM_ SG_ 528 RFL_Obj00A_Ax "Object relative acceleration in X direction";
CM_ SG_ 528 RFL_Obj00A_Ay "Object relative acceleration in Y direction";
CM_ SG_ 528 RFL_Obj00A_HeadingYawAngle "Object heading yaw angle";
CM_ SG_ 528 RFL_Obj00A_Length "Object Length";
CM_ SG_ 528 RFL_Obj00A_Width "Object Width";
CM_ SG_ 528 RFL_Obj00A_Height "Object Height";
CM_ SG_ 528 RFL_Obj00A_DxVnce "Variance of object position in X direction";
CM_ SG_ 528 RFL_Obj00A_DyVnce "Variance of object position in Y direction";
CM_ SG_ 528 RFL_Obj00A_DzVnce "Variance of object position in Z direction";
CM_ SG_ 528 RFL_Obj00A_VxVnce "Variance of object relative velocity in X direction";
CM_ SG_ 528 RFL_Obj00A_VyVnce "Variance of object relative velocity in Y direction";
CM_ SG_ 528 RFL_Obj00A_AxVnce "Variance of object relative acceleration in X direction";
CM_ SG_ 528 RFL_Obj00A_AyVnce "Variance of object relative acceleration in Y direction";
CM_ SG_ 528 RFL_Obj00A_RefPosIndex "Reference Position of the detected objects";
CM_ SG_ 528 RFL_Obj00A_DxDyCoVnce "Covariance of Dx and Dy";
CM_ SG_ 528 RFL_Obj00A_DxVxCoVnce "Covariance of Dx and Vx";
CM_ SG_ 528 RFL_Obj00A_DyVxCoVnce "Covariance of Dy and Ax";
CM_ SG_ 528 RFL_Obj00A_DxVyCoVnce "Covariance of Dx and Vy";
CM_ SG_ 528 RFL_Obj00A_DyVyCoVnce "Covariance of Dy and Vy";
CM_ SG_ 528 RFL_Obj00A_VxVyCoVnce "Covariance of Vx and Vy";
CM_ SG_ 528 RFL_Obj00A_DxAxCoVnce "Covariance of Dx and Ax";
CM_ SG_ 528 RFL_Obj00A_DyAxCoVnce "Covariance of Dy and Ax";
CM_ SG_ 528 RFL_Obj00A_VxAxCoVnce "Covariance of Vx and Ax";
CM_ SG_ 528 RFL_Obj00A_VyAxCoVnce "Covariance of Vy and Ax";
CM_ SG_ 528 RFL_Obj00A_DxAyCoVnce "Covariance of Dx and Ay";
CM_ SG_ 528 RFL_Obj00A_DyAyCoVnce "Covariance of Dy and Ay";
CM_ SG_ 528 RFL_Obj00A_VxAyCoVnce "Covariance of Vx and Ay";
CM_ SG_ 528 RFL_Obj00A_VyAyCoVnce "Covariance of Vy and Ay";
CM_ SG_ 528 RFL_Obj00A_AxAyCoVnce "Covariance of Ax and Ay";
CM_ SG_ 528 RFL_Obj00A_HeadingYawAngleVnce "Variance of object heading yaw angle";
CM_ SG_ 528 RFL_Obj00A_LengthVnce "Variance of object Length";
CM_ SG_ 528 RFL_Obj00A_WidthVnce "Variance of object Width";
CM_ SG_ 528 RFL_Obj00A_HeightVnce "Variance of object Height";
CM_ SG_ 528 RFL_Obj00A_ProbExist "Existence probability of object";
CM_ SG_ 528 RFL_Obj00A_ProbObstacle "Probability of the object being an Obstacle";
CM_ SG_ 528 RFL_Obj00A_ProbNonObstacle "Probability of the object being a Non-Obstacle";
CM_ SG_ 528 RFL_Obj00A_ProbMobileObst "Probability of the object being a mobile obstacle";
CM_ SG_ 529 RFL_Obj00B_CRC "CRC - Autosar E2E Profile 5";
CM_ SG_ 529 RFL_Obj00B_AliveCtr "Alive counter - Autosar E2E Profile 5";
CM_ SG_ 529 RFL_Obj00B_ProtBlockCtr "Protocol-Signal: Block-Counter";
CM_ SG_ 529 RFL_Obj00B_ProbMob4PlusWhl "Probability of a mobile object which has 4 or more wheels";
CM_ SG_ 529 RFL_Obj00B_ProbMob2Whl "Probability of a mobile object being 2-wheels vehicle";
CM_ SG_ 529 RFL_Obj00B_ProbMobPed "Probability of a mobile object being a pedestrian";
CM_ SG_ 529 RFL_Obj00B_Prob4PlusWhlCAR "Probability of a mobile object which has 4 or more wheels--passenger car";
CM_ SG_ 529 RFL_Obj00B_Prob4PlusWhlbHGV "Probability of a mobile object which has 4 or more wheels--commercial vehicle (Truck)";
CM_ SG_ 529 RFL_Obj00B_ProbGNDReflex "Probability of the object being a ground reflex";
CM_ SG_ 529 RFL_Obj00B_ProbStatBarrier "Probability of the object being a stationary road barrier";
CM_ SG_ 529 RFL_Obj00B_ProbStatObst "Probability of the object being a stationary obstacle";
CM_ SG_ 529 RFL_Obj00B_MovingProbability "Object has been observed moving over the ground";
CM_ SG_ 529 RFL_Obj00B_MovingObserved "Object has been observed moving over the ground since it was first detected";
CM_ SG_ 529 RFL_Obj00B_BehaviorType "Indicates that which behavior the object associated for";
CM_ SG_ 530 RFL_Obj01A_CRC "CRC - Autosar E2E Profile 5";
CM_ SG_ 530 RFL_Obj01A_AliveCtr "Alive counter - Autosar E2E Profile 5";
CM_ SG_ 530 RFL_Obj01A_ProtBlockCtr "Protocol-Signal: Block-Counter";
CM_ SG_ 530 RFL_Obj01A_ID "Unique Object ID";
CM_ SG_ 530 RFL_Obj01A_Measured "Object is measured or not";
CM_ SG_ 530 RFL_Obj01A_Dx "Object position in X direction";
CM_ SG_ 530 RFL_Obj01A_Dz "Object position in Z direction";
CM_ SG_ 530 RFL_Obj01A_Dy "Object position in Y direction";
CM_ SG_ 530 RFL_Obj01A_Valid "Object is valid or not";
CM_ SG_ 530 RFL_Obj01A_Vx "Object relative velocity in X direction";
CM_ SG_ 530 RFL_Obj01A_Vy "Object relative velocity in Y direction";
CM_ SG_ 530 RFL_Obj01A_Ax "Object relative acceleration in X direction";
CM_ SG_ 530 RFL_Obj01A_Ay "Object relative acceleration in Y direction";
CM_ SG_ 530 RFL_Obj01A_HeadingYawAngle "Object heading yaw angle";
CM_ SG_ 530 RFL_Obj01A_Length "Object Length";
CM_ SG_ 530 RFL_Obj01A_Width "Object Width";
CM_ SG_ 530 RFL_Obj01A_Height "Object Height";
CM_ SG_ 530 RFL_Obj01A_DxVnce "Variance of object position in X direction";
CM_ SG_ 530 RFL_Obj01A_DyVnce "Variance of object position in Y direction";
CM_ SG_ 530 RFL_Obj01A_DzVnce "Variance of object position in Z direction";
CM_ SG_ 530 RFL_Obj01A_VxVnce "Variance of object relative velocity in X direction";
CM_ SG_ 530 RFL_Obj01A_VyVnce "Variance of object relative velocity in Y direction";
CM_ SG_ 530 RFL_Obj01A_AxVnce "Variance of object relative acceleration in X direction";
CM_ SG_ 530 RFL_Obj01A_AyVnce "Variance of object relative acceleration in Y direction";
CM_ SG_ 530 RFL_Obj01A_RefPosIndex "Reference Position of the detected objects";
CM_ SG_ 530 RFL_Obj01A_DxDyCoVnce "Covariance of Dx and Dy";
CM_ SG_ 530 RFL_Obj01A_DxVxCoVnce "Covariance of Dx and Vx";
CM_ SG_ 530 RFL_Obj01A_DyVxCoVnce "Covariance of Dy and Ax";
CM_ SG_ 530 RFL_Obj01A_DxVyCoVnce "Covariance of Dx and Vy";
CM_ SG_ 530 RFL_Obj01A_DyVyCoVnce "Covariance of Dy and Vy";
CM_ SG_ 530 RFL_Obj01A_VxVyCoVnce "Covariance of Vx and Vy";
CM_ SG_ 530 RFL_Obj01A_DxAxCoVnce "Covariance of Dx and Ax";
CM_ SG_ 530 RFL_Obj01A_DyAxCoVnce "Covariance of Dy and Ax";
CM_ SG_ 530 RFL_Obj01A_VxAxCoVnce "Covariance of Vx and Ax";
CM_ SG_ 530 RFL_Obj01A_VyAxCoVnce "Covariance of Vy and Ax";
CM_ SG_ 530 RFL_Obj01A_DxAyCoVnce "Covariance of Dx and Ay";
CM_ SG_ 530 RFL_Obj01A_DyAyCoVnce "Covariance of Dy and Ay";
CM_ SG_ 530 RFL_Obj01A_VxAyCoVnce "Covariance of Vx and Ay";
CM_ SG_ 530 RFL_Obj01A_VyAyCoVnce "Covariance of Vy and Ay";
CM_ SG_ 530 RFL_Obj01A_AxAyCoVnce "Covariance of Ax and Ay";
CM_ SG_ 530 RFL_Obj01A_HeadingYawAngleVnce "Variance of object heading yaw angle";
CM_ SG_ 530 RFL_Obj01A_LengthVnce "Variance of object Length";
CM_ SG_ 530 RFL_Obj01A_WidthVnce "Variance of object Width";
CM_ SG_ 530 RFL_Obj01A_HeightVnce "Variance of object Height";
CM_ SG_ 530 RFL_Obj01A_ProbExist "Existence probability of object";
CM_ SG_ 530 RFL_Obj01A_ProbObstacle "Probability of the object being an Obstacle";
CM_ SG_ 530 RFL_Obj01A_ProbNonObstacle "Probability of the object being a Non-Obstacle";
CM_ SG_ 530 RFL_Obj01A_ProbMobileObst "Probability of the object being a mobile obstacle";
CM_ SG_ 531 RFL_Obj01B_CRC "CRC - Autosar E2E Profile 5";
CM_ SG_ 531 RFL_Obj01B_AliveCtr "Alive counter - Autosar E2E Profile 5";
CM_ SG_ 531 RFL_Obj01B_ProtBlockCtr "Protocol-Signal: Block-Counter";
CM_ SG_ 531 RFL_Obj01B_ProbMob4PlusWhl "Probability of a mobile object which has 4 or more wheels";
CM_ SG_ 531 RFL_Obj01B_ProbMob2Whl "Probability of a mobile object being 2-wheels vehicle";
CM_ SG_ 531 RFL_Obj01B_ProbMobPed "Probability of a mobile object being a pedestrian";
CM_ SG_ 531 RFL_Obj01B_Prob4PlusWhlCAR "Probability of a mobile object which has 4 or more wheels--passenger car";
CM_ SG_ 531 RFL_Obj01B_Prob4PlusWhlbHGV "Probability of a mobile object which has 4 or more wheels--commercial vehicle (Truck)";
CM_ SG_ 531 RFL_Obj01B_ProbGNDReflex "Probability of the object being a ground reflex";
CM_ SG_ 531 RFL_Obj01B_ProbStatBarrier "Probability of the object being a stationary road barrier";
CM_ SG_ 531 RFL_Obj01B_ProbStatObst "Probability of the object being a stationary obstacle";
CM_ SG_ 531 RFL_Obj01B_MovingProbability "Object has been observed moving over the ground";
CM_ SG_ 531 RFL_Obj01B_MovingObserved "Object has been observed moving over the ground since it was first detected";
CM_ SG_ 531 RFL_Obj01B_BehaviorType "Indicates that which behavior the object associated for";
CM_ SG_ 532 RFL_Obj02A_CRC "CRC - Autosar E2E Profile 5";
CM_ SG_ 532 RFL_Obj02A_AliveCtr "Alive counter - Autosar E2E Profile 5";
CM_ SG_ 532 RFL_Obj02A_ProtBlockCtr "Protocol-Signal: Block-Counter";
CM_ SG_ 532 RFL_Obj02A_ID "Unique Object ID";
CM_ SG_ 532 RFL_Obj02A_Measured "Object is measured or not";
CM_ SG_ 532 RFL_Obj02A_Dx "Object position in X direction";
CM_ SG_ 532 RFL_Obj02A_Dz "Object position in Z direction";
CM_ SG_ 532 RFL_Obj02A_Dy "Object position in Y direction";
CM_ SG_ 532 RFL_Obj02A_Valid "Object is valid or not";
CM_ SG_ 532 RFL_Obj02A_Vx "Object relative velocity in X direction";
CM_ SG_ 532 RFL_Obj02A_Vy "Object relative velocity in Y direction";
CM_ SG_ 532 RFL_Obj02A_Ax "Object relative acceleration in X direction";
CM_ SG_ 532 RFL_Obj02A_Ay "Object relative acceleration in Y direction";
CM_ SG_ 532 RFL_Obj02A_HeadingYawAngle "Object heading yaw angle";
CM_ SG_ 532 RFL_Obj02A_Length "Object Length";
CM_ SG_ 532 RFL_Obj02A_Width "Object Width";
CM_ SG_ 532 RFL_Obj02A_Height "Object Height";
CM_ SG_ 532 RFL_Obj02A_DxVnce "Variance of object position in X direction";
CM_ SG_ 532 RFL_Obj02A_DyVnce "Variance of object position in Y direction";
CM_ SG_ 532 RFL_Obj02A_DzVnce "Variance of object position in Z direction";
CM_ SG_ 532 RFL_Obj02A_VxVnce "Variance of object relative velocity in X direction";
CM_ SG_ 532 RFL_Obj02A_VyVnce "Variance of object relative velocity in Y direction";
CM_ SG_ 532 RFL_Obj02A_AxVnce "Variance of object relative acceleration in X direction";
CM_ SG_ 532 RFL_Obj02A_AyVnce "Variance of object relative acceleration in Y direction";
CM_ SG_ 532 RFL_Obj02A_RefPosIndex "Reference Position of the detected objects";
CM_ SG_ 532 RFL_Obj02A_DxDyCoVnce "Covariance of Dx and Dy";
CM_ SG_ 532 RFL_Obj02A_DxVxCoVnce "Covariance of Dx and Vx";
CM_ SG_ 532 RFL_Obj02A_DyVxCoVnce "Covariance of Dy and Ax";
CM_ SG_ 532 RFL_Obj02A_DxVyCoVnce "Covariance of Dx and Vy";
CM_ SG_ 532 RFL_Obj02A_DyVyCoVnce "Covariance of Dy and Vy";
CM_ SG_ 532 RFL_Obj02A_VxVyCoVnce "Covariance of Vx and Vy";
CM_ SG_ 532 RFL_Obj02A_DxAxCoVnce "Covariance of Dx and Ax";
CM_ SG_ 532 RFL_Obj02A_DyAxCoVnce "Covariance of Dy and Ax";
CM_ SG_ 532 RFL_Obj02A_VxAxCoVnce "Covariance of Vx and Ax";
CM_ SG_ 532 RFL_Obj02A_VyAxCoVnce "Covariance of Vy and Ax";
CM_ SG_ 532 RFL_Obj02A_DxAyCoVnce "Covariance of Dx and Ay";
CM_ SG_ 532 RFL_Obj02A_DyAyCoVnce "Covariance of Dy and Ay";
CM_ SG_ 532 RFL_Obj02A_VxAyCoVnce "Covariance of Vx and Ay";
CM_ SG_ 532 RFL_Obj02A_VyAyCoVnce "Covariance of Vy and Ay";
CM_ SG_ 532 RFL_Obj02A_AxAyCoVnce "Covariance of Ax and Ay";
CM_ SG_ 532 RFL_Obj02A_HeadingYawAngleVnce "Variance of object heading yaw angle";
CM_ SG_ 532 RFL_Obj02A_LengthVnce "Variance of object Length";
CM_ SG_ 532 RFL_Obj02A_WidthVnce "Variance of object Width";
CM_ SG_ 532 RFL_Obj02A_HeightVnce "Variance of object Height";
CM_ SG_ 532 RFL_Obj02A_ProbExist "Existence probability of object";
CM_ SG_ 532 RFL_Obj02A_ProbObstacle "Probability of the object being an Obstacle";
CM_ SG_ 532 RFL_Obj02A_ProbNonObstacle "Probability of the object being a Non-Obstacle";
CM_ SG_ 532 RFL_Obj02A_ProbMobileObst "Probability of the object being a mobile obstacle";
CM_ SG_ 533 RFL_Obj02B_CRC "CRC - Autosar E2E Profile 5";
CM_ SG_ 533 RFL_Obj02B_AliveCtr "Alive counter - Autosar E2E Profile 5";
CM_ SG_ 533 RFL_Obj02B_ProtBlockCtr "Protocol-Signal: Block-Counter";
CM_ SG_ 533 RFL_Obj02B_ProbMob4PlusWhl "Probability of a mobile object which has 4 or more wheels";
CM_ SG_ 533 RFL_Obj02B_ProbMob2Whl "Probability of a mobile object being 2-wheels vehicle";
CM_ SG_ 533 RFL_Obj02B_ProbMobPed "Probability of a mobile object being a pedestrian";
CM_ SG_ 533 RFL_Obj02B_Prob4PlusWhlCAR "Probability of a mobile object which has 4 or more wheels--passenger car";
CM_ SG_ 533 RFL_Obj02B_Prob4PlusWhlbHGV "Probability of a mobile object which has 4 or more wheels--commercial vehicle (Truck)";
CM_ SG_ 533 RFL_Obj02B_ProbGNDReflex "Probability of the object being a ground reflex";
CM_ SG_ 533 RFL_Obj02B_ProbStatBarrier "Probability of the object being a stationary road barrier";
CM_ SG_ 533 RFL_Obj02B_ProbStatObst "Probability of the object being a stationary obstacle";
CM_ SG_ 533 RFL_Obj02B_MovingProbability "Object has been observed moving over the ground";
CM_ SG_ 533 RFL_Obj02B_MovingObserved "Object has been observed moving over the ground since it was first detected";
CM_ SG_ 533 RFL_Obj02B_BehaviorType "Indicates that which behavior the object associated for";
CM_ SG_ 534 RFL_Obj03A_CRC "CRC - Autosar E2E Profile 5";
CM_ SG_ 534 RFL_Obj03A_AliveCtr "Alive counter - Autosar E2E Profile 5";
CM_ SG_ 534 RFL_Obj03A_ProtBlockCtr "Protocol-Signal: Block-Counter";
CM_ SG_ 534 RFL_Obj03A_ID "Unique Object ID";
CM_ SG_ 534 RFL_Obj03A_Measured "Object is measured or not";
CM_ SG_ 534 RFL_Obj03A_Dx "Object position in X direction";
CM_ SG_ 534 RFL_Obj03A_Dz "Object position in Z direction";
CM_ SG_ 534 RFL_Obj03A_Dy "Object position in Y direction";
CM_ SG_ 534 RFL_Obj03A_Valid "Object is valid or not";
CM_ SG_ 534 RFL_Obj03A_Vx "Object relative velocity in X direction";
CM_ SG_ 534 RFL_Obj03A_Vy "Object relative velocity in Y direction";
CM_ SG_ 534 RFL_Obj03A_Ax "Object relative acceleration in X direction";
CM_ SG_ 534 RFL_Obj03A_Ay "Object relative acceleration in Y direction";
CM_ SG_ 534 RFL_Obj03A_HeadingYawAngle "Object heading yaw angle";
CM_ SG_ 534 RFL_Obj03A_Length "Object Length";
CM_ SG_ 534 RFL_Obj03A_Width "Object Width";
CM_ SG_ 534 RFL_Obj03A_Height "Object Height";
CM_ SG_ 534 RFL_Obj03A_DxVnce "Variance of object position in X direction";
CM_ SG_ 534 RFL_Obj03A_DyVnce "Variance of object position in Y direction";
CM_ SG_ 534 RFL_Obj03A_DzVnce "Variance of object position in Z direction";
CM_ SG_ 534 RFL_Obj03A_VxVnce "Variance of object relative velocity in X direction";
CM_ SG_ 534 RFL_Obj03A_VyVnce "Variance of object relative velocity in Y direction";
CM_ SG_ 534 RFL_Obj03A_AxVnce "Variance of object relative acceleration in X direction";
CM_ SG_ 534 RFL_Obj03A_AyVnce "Variance of object relative acceleration in Y direction";
CM_ SG_ 534 RFL_Obj03A_RefPosIndex "Reference Position of the detected objects";
CM_ SG_ 534 RFL_Obj03A_DxDyCoVnce "Covariance of Dx and Dy";
CM_ SG_ 534 RFL_Obj03A_DxVxCoVnce "Covariance of Dx and Vx";
CM_ SG_ 534 RFL_Obj03A_DyVxCoVnce "Covariance of Dy and Ax";
CM_ SG_ 534 RFL_Obj03A_DxVyCoVnce "Covariance of Dx and Vy";
CM_ SG_ 534 RFL_Obj03A_DyVyCoVnce "Covariance of Dy and Vy";
CM_ SG_ 534 RFL_Obj03A_VxVyCoVnce "Covariance of Vx and Vy";
CM_ SG_ 534 RFL_Obj03A_DxAxCoVnce "Covariance of Dx and Ax";
CM_ SG_ 534 RFL_Obj03A_DyAxCoVnce "Covariance of Dy and Ax";
CM_ SG_ 534 RFL_Obj03A_VxAxCoVnce "Covariance of Vx and Ax";
CM_ SG_ 534 RFL_Obj03A_VyAxCoVnce "Covariance of Vy and Ax";
CM_ SG_ 534 RFL_Obj03A_DxAyCoVnce "Covariance of Dx and Ay";
CM_ SG_ 534 RFL_Obj03A_DyAyCoVnce "Covariance of Dy and Ay";
CM_ SG_ 534 RFL_Obj03A_VxAyCoVnce "Covariance of Vx and Ay";
CM_ SG_ 534 RFL_Obj03A_VyAyCoVnce "Covariance of Vy and Ay";
CM_ SG_ 534 RFL_Obj03A_AxAyCoVnce "Covariance of Ax and Ay";
CM_ SG_ 534 RFL_Obj03A_HeadingYawAngleVnce "Variance of object heading yaw angle";
CM_ SG_ 534 RFL_Obj03A_LengthVnce "Variance of object Length";
CM_ SG_ 534 RFL_Obj03A_WidthVnce "Variance of object Width";
CM_ SG_ 534 RFL_Obj03A_HeightVnce "Variance of object Height";
CM_ SG_ 534 RFL_Obj03A_ProbExist "Existence probability of object";
CM_ SG_ 534 RFL_Obj03A_ProbObstacle "Probability of the object being an Obstacle";
CM_ SG_ 534 RFL_Obj03A_ProbNonObstacle "Probability of the object being a Non-Obstacle";
CM_ SG_ 534 RFL_Obj03A_ProbMobileObst "Probability of the object being a mobile obstacle";
CM_ SG_ 535 RFL_Obj03B_CRC "CRC - Autosar E2E Profile 5";
CM_ SG_ 535 RFL_Obj03B_AliveCtr "Alive counter - Autosar E2E Profile 5";
CM_ SG_ 535 RFL_Obj03B_ProtBlockCtr "Protocol-Signal: Block-Counter";
CM_ SG_ 535 RFL_Obj03B_ProbMob4PlusWhl "Probability of a mobile object which has 4 or more wheels";
CM_ SG_ 535 RFL_Obj03B_ProbMob2Whl "Probability of a mobile object being 2-wheels vehicle";
CM_ SG_ 535 RFL_Obj03B_ProbMobPed "Probability of a mobile object being a pedestrian";
CM_ SG_ 535 RFL_Obj03B_Prob4PlusWhlCAR "Probability of a mobile object which has 4 or more wheels--passenger car";
CM_ SG_ 535 RFL_Obj03B_Prob4PlusWhlbHGV "Probability of a mobile object which has 4 or more wheels--commercial vehicle (Truck)";
CM_ SG_ 535 RFL_Obj03B_ProbGNDReflex "Probability of the object being a ground reflex";
CM_ SG_ 535 RFL_Obj03B_ProbStatBarrier "Probability of the object being a stationary road barrier";
CM_ SG_ 535 RFL_Obj03B_ProbStatObst "Probability of the object being a stationary obstacle";
CM_ SG_ 535 RFL_Obj03B_MovingProbability "Object has been observed moving over the ground";
CM_ SG_ 535 RFL_Obj03B_MovingObserved "Object has been observed moving over the ground since it was first detected";
CM_ SG_ 535 RFL_Obj03B_BehaviorType "Indicates that which behavior the object associated for";
BA_DEF_ SG_  "GenSigSendType" ENUM  "Cyclic","OnWrite","OnWriteWithRepetition","OnChange","OnChangeWithRepetition","IfActive","IfActiveWithRepetition";
BA_DEF_ BO_  "GenMsgCycleTimeFast" INT 2 50000;
BA_DEF_ BO_  "GenMsgILSupport" ENUM  "No","Yes";
BA_DEF_ BO_  "CANFD_BRS" ENUM  "0","1";
BA_DEF_ BO_  "GenMsgCycleTime" INT 0 65535;
BA_DEF_ BO_  "GenMsgSendType" ENUM  "Event","cyclic";
BA_DEF_ BO_  "VFrameFormat" ENUM  "StandardCAN","ExtendedCAN","reserved","reserved","reserved","reserved","reserved","reserved","reserved","reserved","reserved","reserved","reserved","reserved","StandardCAN_FD","ExtendedCAN_FD";
BA_DEF_ SG_  "GenSigStartValue" FLOAT 0 100000000000;
BA_DEF_DEF_  "GenSigSendType" "Cyclic";
BA_DEF_DEF_  "GenMsgCycleTimeFast" 100;
BA_DEF_DEF_  "GenMsgILSupport" "Yes";
BA_DEF_DEF_  "CANFD_BRS" "1";
BA_DEF_DEF_  "GenMsgCycleTime" 0;
BA_DEF_DEF_  "GenMsgSendType" "";
BA_DEF_DEF_  "VFrameFormat" "";
BA_DEF_DEF_  "GenSigStartValue" 0;
BA_ "GenMsgSendType" BO_ 244 0;
BA_ "VFrameFormat" BO_ 244 14;
BA_ "GenMsgSendType" BO_ 245 0;
BA_ "VFrameFormat" BO_ 245 14;
BA_ "GenMsgSendType" BO_ 517 0;
BA_ "VFrameFormat" BO_ 517 14;
BA_ "GenMsgSendType" BO_ 528 0;
BA_ "VFrameFormat" BO_ 528 14;
BA_ "GenMsgSendType" BO_ 529 0;
BA_ "VFrameFormat" BO_ 529 14;
BA_ "GenMsgSendType" BO_ 530 0;
BA_ "VFrameFormat" BO_ 530 14;
BA_ "GenMsgSendType" BO_ 531 0;
BA_ "VFrameFormat" BO_ 531 14;
BA_ "GenMsgSendType" BO_ 532 0;
BA_ "VFrameFormat" BO_ 532 14;
BA_ "GenMsgSendType" BO_ 533 0;
BA_ "VFrameFormat" BO_ 533 14;
BA_ "GenMsgSendType" BO_ 534 0;
BA_ "VFrameFormat" BO_ 534 14;
BA_ "GenMsgSendType" BO_ 535 0;
BA_ "VFrameFormat" BO_ 535 14;
BA_ "GenSigStartValue" SG_ 244 VFC_TS12_Py 128;
BA_ "GenSigStartValue" SG_ 244 VFC_TS13_Py 128;
BA_ "GenSigStartValue" SG_ 245 VFC_TS14_Py 128;
BA_ "GenSigStartValue" SG_ 245 VFC_TS15_Py 128;
BA_ "GenSigStartValue" SG_ 517 RFL_ObjHdr_ProtocolVersion 263;
BA_ "GenSigStartValue" SG_ 517 RFL_ObjHdr_MountPosY 128;
BA_ "GenSigStartValue" SG_ 517 RFL_ObjHdr_MountPosX 256;
BA_ "GenSigStartValue" SG_ 517 RFL_ObjHdr_YawMountAngle 32768;
BA_ "GenSigStartValue" SG_ 517 RFL_ObjHdr_YawAngleLower 16384;
BA_ "GenSigStartValue" SG_ 517 RFL_ObjHdr_YawAngleUpper 16384;
BA_ "GenSigStartValue" SG_ 517 RFL_ObjHdr_PitchMountAngle 2048;
BA_ "GenSigStartValue" SG_ 517 RFL_ObjHdr_PitchAngleLower 2048;
BA_ "GenSigStartValue" SG_ 517 RFL_ObjHdr_PitchAngleUpper 2048;
BA_ "GenSigStartValue" SG_ 517 RFL_ObjHdr_RollMountAngle 2048;
BA_ "GenSigStartValue" SG_ 528 RFL_Obj00A_Dx 4096;
BA_ "GenSigStartValue" SG_ 528 RFL_Obj00A_Dz 20;
BA_ "GenSigStartValue" SG_ 528 RFL_Obj00A_Dy 1024;
BA_ "GenSigStartValue" SG_ 528 RFL_Obj00A_Vx 2048;
BA_ "GenSigStartValue" SG_ 528 RFL_Obj00A_Vy 512;
BA_ "GenSigStartValue" SG_ 528 RFL_Obj00A_Ax 512;
BA_ "GenSigStartValue" SG_ 528 RFL_Obj00A_Ay 256;
BA_ "GenSigStartValue" SG_ 528 RFL_Obj00A_HeadingYawAngle 256;
BA_ "GenSigStartValue" SG_ 530 RFL_Obj01A_Dx 4096;
BA_ "GenSigStartValue" SG_ 530 RFL_Obj01A_Dz 20;
BA_ "GenSigStartValue" SG_ 530 RFL_Obj01A_Dy 1024;
BA_ "GenSigStartValue" SG_ 530 RFL_Obj01A_Vx 2048;
BA_ "GenSigStartValue" SG_ 530 RFL_Obj01A_Vy 512;
BA_ "GenSigStartValue" SG_ 530 RFL_Obj01A_Ax 512;
BA_ "GenSigStartValue" SG_ 530 RFL_Obj01A_Ay 256;
BA_ "GenSigStartValue" SG_ 530 RFL_Obj01A_HeadingYawAngle 256;
BA_ "GenSigStartValue" SG_ 532 RFL_Obj02A_Dx 4096;
BA_ "GenSigStartValue" SG_ 532 RFL_Obj02A_Dz 20;
BA_ "GenSigStartValue" SG_ 532 RFL_Obj02A_Dy 1024;
BA_ "GenSigStartValue" SG_ 532 RFL_Obj02A_Vx 2048;
BA_ "GenSigStartValue" SG_ 532 RFL_Obj02A_Vy 512;
BA_ "GenSigStartValue" SG_ 532 RFL_Obj02A_Ax 512;
BA_ "GenSigStartValue" SG_ 532 RFL_Obj02A_Ay 256;
BA_ "GenSigStartValue" SG_ 532 RFL_Obj02A_HeadingYawAngle 256;
BA_ "GenSigStartValue" SG_ 534 RFL_Obj03A_Dx 4096;
BA_ "GenSigStartValue" SG_ 534 RFL_Obj03A_Dz 20;
BA_ "GenSigStartValue" SG_ 534 RFL_Obj03A_Dy 1024;
BA_ "GenSigStartValue" SG_ 534 RFL_Obj03A_Vx 2048;
BA_ "GenSigStartValue" SG_ 534 RFL_Obj03A_Vy 512;
BA_ "GenSigStartValue" SG_ 534 RFL_Obj03A_Ax 512;
BA_ "GenSigStartValue" SG_ 534 RFL_Obj03A_Ay 256;
BA_ "GenSigStartValue" SG_ 534 RFL_Obj03A_HeadingYawAngle 256;
VAL_ 244 VFC_TS12_Type 0 "UNKNOWN" 1 "SL5" 2 "SL10" 3 "SL15" 4 "SL20" 5 "SL25" 6 "SL30" 7 "SL35" 8 "SL40" 9 "SL45" 10 "SL50" 11 "SL55" 12 "SL60" 13 "SL65" 14 "SL70" 15 "SL75" 16 "SL80" 17 "SL85" 18 "SL90" 19 "SL95" 20 "SL100" 21 "SL105" 22 "SL110" 23 "SL115" 24 "SL120" 25 "SL125" 26 "SL130" 27 "SL135" 28 "SL140" 29 "SL145" 30 "SL150" 31 "SL155" 32 "SL160" 33 "OP" 34 "OL" 35 "ESL" 36 "EOP" 37 "EOL" 38 "EA" 39 "VSL5" 40 "VSL10" 41 "VSL15" 42 "VSL20" 43 "VSL25" 44 "VSL30" 45 "VSL35" 46 "VSL40" 47 "VSL45" 48 "VSL50" 49 "VSL55" 50 "VSL60" 51 "VSL65" 52 "VSL70" 53 "VSL75" 54 "VSL80" 55 "VSL85" 56 "VSL90" 57 "VSL95" 58 "VSL100" 59 "VSL105" 60 "VSL110" 61 "VSL115" 62 "VSL120" 63 "VSL125" 64 "VSL130" 65 "VSL135" 66 "VSL140" 67 "VSL145" 68 "VSL150" 69 "VSL155" 70 "VSL160" 71 "VOP" 72 "VOL" 73 "VESL" 74 "VEOP" 75 "VEOL" 76 "VEA" 77 "NOENTRY" 78 "NOALL" 79 "NOCAR" 80 "NOLORRY" 81 "NOHAZMAT" 82 "NOBIKE" 83 "NOPED" 84 "NOCARBIKE" 85 "NOTWOWAY" 86 "WEIGHT" 87 "HEIGHT" 88 "WIDTH" 89 "LENGTH" 90 "PRIOCROSS" 91 "GIVEWAY" 92 "PRIOCROSSYIELDTORIGHT" 93 "WARNDANGER" 94 "WARNCURVEL" 95 "WARNCURVER" 96 "WARNDCURVEL" 97 "WARNDCURVER" 98 "WARNTRAIN" 99 "WARNJAM" 100 "WARNANIMAL_DEPRECATED" 101 "WARNRWORKS" 102 "WARNSLOPED" 103 "WARNSLOPEU" 104 "PRIOSTREET" 105 "EPRIOSTREET" 106 "STOP" 107 "ASL" 108 "EASL" 109 "MSL" 110 "EMSL" 111 "MLC" 112 "WBDIAGL" 113 "WBDIAGR" 114 "WBROUND" 115 "NOLTURN" 116 "NORTURN" 117 "NOUTURN" 118 "NOPARK" 119 "NOSTOP" 120 "SMOG" 121 "UMWELT" 122 "EUMWELT" 123 "DOUANE" 124 "FWAY" 125 "EFWAY" 126 "HWAY" 127 "EHWAY" 128 "NORIDER" 129 "WARNCONST" 130 "WARNCONSTL" 131 "WARNCONSTR" 132 "WARNPED" 133 "WARNKIDS" 134 "WARNBIKE" 135 "WARNSKID" 136 "ZEBRA" 137 "ONEWAYS" 138 "ONEWAYU" 139 "SLOWDOWN" 140 "NOCARRIAGE" 141 "NOLORRYTRAILER" 142 "NOBUS" 143 "NOTRACTOR" 144 "LORRYDIST" 145 "CARDIST" 146 "WARNROUND" 147 "WARNWILDANIMAL" 148 "WARNCATTLE" 149 "WARNFROG" 150 "WARNBUS" 151 "WARNWIND" 152 "WARNSNOW" 153 "WARNPCROSS" 154 "WARNHUMP" 155 "WARNROCK" 156 "WARNLOWTREE" 157 "WARNGRAVEL" 158 "WARNTWOWAY" 159 "WARNLIGHTS" 160 "WARNPLANE" 161 "VNOENTRY" 162 "VNOALL" 163 "VNOCAR" 164 "VNOLORRY" 165 "VNOCARBIKE" 166 "VWEIGHT" 167 "VHEIGHT" 168 "VWIDTH" 169 "VLENGTH" 170 "VWARNDANGER" 171 "VWARNJAM" 172 "VWARNRWORKS" 173 "VWARNSKID" 174 "VASL" 175 "VEASL" 176 "VNOLORRYTRAILER" 177 "VNOBUS" 178 "VLORRYDIST" 179 "VCARDIST" 180 "VWARNSNOW" 181 "VWARNHUMP" 182 "VWARNGRAVEL" 183 "CALM" 184 "ECALM" 185 "TWN" 186 "ETWN" 187 "DEADEND" 188 "AXLEWEIGHT" 189 "WARNRIDER" 190 "WARNDRAWBRIDGE" 191 "WARNPIER" 192 "TRINATURE" 193 "VWARNCONST" 194 "VWARNCONSTL" 195 "VWARNCONSTR" 196 "VWARNCURVEL" 197 "VWARNCURVER" 198 "VWARNDCURVEL" 199 "VWARNDCURVER" 200 "VWARNLIGHTS" 201 "WBBENTLEFT" 202 "WBBENTLEFTRIGHT" 203 "WBBENTRIGHT" 204 "WBDIAGLR" 205 "WBLEFT" 206 "WBRIGHT" 207 "WBUP" 208 "WBUPLEFT" 209 "WBUPRIGHT" 210 "WBHAZWATER" 211 "NOHAZWATER" 212 "SCHOOL" 213 "ESCHOOL" 214 "HAZMAT" 215 "EMERGENCYBAY" 216 "ENDOFLANEL" 217 "ENDOFLANER" 218 "ENOPARK" 219 "EONEWAY" 220 "EPARK" 221 "ETOLL" 222 "NOPARKL" 223 "NOPARKLR" 224 "NOPARKR" 225 "NOSTOPL" 226 "NOSTOPLR" 227 "NOSTOPR" 228 "NOTURNONRED" 229 "ONEWAYL" 230 "ONEWAYR" 231 "PARK" 232 "PRIOCROSSL" 233 "PRIOCROSSR" 234 "TOLL" 235 "TUNNEL" 236 "TWOWAY" 237 "WARNCROSS" 238 "WARNCROSSL" 239 "WARNCROSSLR" 240 "WARNCROSSR" 241 "WARNCROSSRL" 242 "WARNCROSST" 243 "WARNGIVEWAYAHEAD" 244 "WARNSLAHEAD" 245 "WARNSTOPAHEAD" 246 "WBBUS" 247 "WRONGWAY" 248 "HAZWATER" 249 "GIVEWAYROUND" 250 "WARNWINDINGL" 251 "WARNWINDINGR" 252 "WARNHAIRPINL" 253 "WARNHAIRPINR" 254 "WARNPEDBIKE" 255 "WARNCROSSY" 256 "WARNBRANCHL" 257 "WARNBRANCHR" 258 "WARNAXLEWEIGHT" 259 "WARNWEIGHT" 260 "WARNHEIGHT" 261 "WARNLENGTH" 262 "WARNWIDTH" 263 "WARNBLACKSPOT" 264 "WARNMERGEL" 265 "WARNMERGER" 266 "WARNTUNNEL" 267 "WARNTRACTOR" 268 "WARNRWORKSVEHICLE" 269 "WARNNARROWBRIDGE" 270 "WARNFLAGGER" 271 "LANES" 272 "LANESHIFTL" 273 "LANESHIFTR" 274 "NEWLANEL" 275 "NEWLANER" 276 "RIGHTTURNONRED" 277 "BORDERLIMIT" 278 "EMBEDDEDRAIN" 279 "VWARNWEIGHT" 280 "VWARNHEIGHT" 281 "VWARNLENGTH" 282 "VWARNWIDTH" 283 "VENDOFLANEL" 284 "VENDOFLANER" 285 "VLANES" 286 "VLANESHIFTL" 287 "VLANESHIFTR" 288 "VNEWLANEL" 289 "VNEWLANER" 290 "NOUP" 291 "VOFF" 292 "ASL5" 293 "ASL10" 294 "ASL15" 295 "ASL20" 296 "ASL25" 297 "ASL30" 298 "ASL35" 299 "ASL40" 300 "ASL45" 301 "ASL50" 302 "ASL55" 303 "ASL60" 304 "ASL65" 305 "ASL70" 306 "ASL75" 307 "ASL80" 308 "ASL85" 309 "ASL90" 310 "ASL95" 311 "ASL100" 312 "ASL105" 313 "ASL110" 314 "ASL115" 315 "ASL120" 316 "ASL125" 317 "ASL130" 318 "ASL135" 319 "ASL140" 320 "ASL145" 321 "ASL150" 322 "ASL155" 323 "ASL160" 324 "VASL5" 325 "VASL10" 326 "VASL15" 327 "VASL20" 328 "VASL25" 329 "VASL30" 330 "VASL35" 331 "VASL40" 332 "VASL45" 333 "VASL50" 334 "VASL55" 335 "VASL60" 336 "VASL65" 337 "VASL70" 338 "VASL75" 339 "VASL80" 340 "VASL85" 341 "VASL90" 342 "VASL95" 343 "VASL100" 344 "VASL105" 345 "VASL110" 346 "VASL115" 347 "VASL120" 348 "VASL125" 349 "VASL130" 350 "VASL135" 351 "VASL140" 352 "VASL145" 353 "VASL150" 354 "VASL155" 355 "VASL160" 356 "WARNTRAINGATED" 357 "KEEPRIGHTCAR" 358 "ASLCURVE5" 359 "ASLCURVE10" 360 "ASLCURVE15" 361 "ASLCURVE20" 362 "ASLCURVE25" 363 "ASLCURVE30" 364 "ASLCURVE35" 365 "ASLCURVE40" 366 "ASLCURVE45" 367 "ASLCURVE50" 368 "ASLCURVE55" 369 "ASLCURVE60" 370 "ASLCURVE65" 371 "ASLCURVE70" 372 "ASLCURVE75" 373 "ASLCURVE80" 374 "ASLCURVE85" 375 "ASLCURVE90" 376 "ASLCURVE95" 377 "ASLCURVE100" 378 "ASLCURVE105" 379 "ASLCURVE110" 380 "ASLCURVE115" 381 "ASLCURVE120" 382 "ASLCURVE125" 383 "ASLCURVE130" 384 "ASLCURVE135" 385 "ASLCURVE140" 386 "ASLCURVE145" 387 "ASLCURVE150" 388 "ASLCURVE155" 389 "ASLCURVE160" 390 "KIDS" 391 "EKIDS" 392 "BIKEROAD" 393 "EBIKEROAD" 394 "PEDSTREET" 395 "EPEDSTREET" 396 "PEDBIKESTREET" 397 "EPEDBIKESTREET" 398 "EWARNKIDS" 399 "CALM20" 400 "CALM30" 401 "ECALM20" 402 "ECALM30" 403 "FWAYGREEN" 404 "TWN40" 405 "TWN50" 406 "TWN60" 407 "TWN70" 408 "ETWN40" 409 "ETWN50" 410 "ETWN60" 411 "ETWN70" 412 "WBBIKE" 413 "EWBBIKE" 414 "WBPED" 415 "EWBPED" 416 "WBPEDBIKESEP" 417 "EWBPEDBIKESEP" 418 "WBPEDBIKESHARED" 419 "EWBPEDBIKESHARED" 420 "EFWAYGREEN" 421 "Reserved0421" 422 "Reserved0422" 423 "Reserved0423" 424 "Reserved0424" 425 "Reserved0425" 426 "Reserved0426" 427 "Reserved0427" 428 "Reserved0428" 429 "Reserved0429" 430 "Reserved0430" 431 "Reserved0431" 432 "Reserved0432" 433 "Reserved0433" 434 "Reserved0434" 435 "Reserved0435" 436 "Reserved0436" 437 "Reserved0437" 438 "Reserved0438" 439 "Reserved0439" 440 "Reserved0440" 441 "Reserved0441" 442 "Reserved0442" 443 "Reserved0443" 444 "Reserved0444" 445 "Reserved0445" 446 "Reserved0446" 447 "Reserved0447" 448 "Reserved0448" 449 "Reserved0449" ;
VAL_ 244 VFC_TS12_EmbeddedInfo 0 "Unknown" 1 "Not Embedded" 2 "Border Limit" 3 "Multi Lane" 4 "Rain" 5 "Vehicle Type" 6 "Plate" 7 "Error Value" 8 "Vehicle Sticker" 9 "Reserved09" 10 "Reserved10" 11 "Reserved11" 12 "Reserved12" 13 "Reserved13" 14 "Reserved14" 15 "Reserved15" ;
VAL_ 244 VFC_TS12_ValidTimeRange1Start 127 "Unknown" ;
VAL_ 244 VFC_TS12_ValidTimeRange1End 127 "Unknown" ;
VAL_ 244 VFC_TS12_ValidTimeRange2Start 127 "Unknown" ;
VAL_ 244 VFC_TS12_ValidTimeRange2End 127 "Unknown" ;
VAL_ 244 VFC_TS12_ValidInDistUnit 0 "Unknown" ;
VAL_ 244 VFC_TS12_ValidSectionUnit 0 "Unknown" 1 "Meter" 2 "Kilometer" 3 "Foot" 4 "Yard" 5 "Mile" 6 "Reserved6" 7 "Reserved7" ;
VAL_ 244 VFC_TS12_SupSign0Type 0 "UNKNOWN" 1 "ADDCAR" 2 "ADDLORRY" 3 "ADDTRAILER" 4 "ADDCARAVAN" 5 "ADDBUS" 6 "ADDTRACTOR" 7 "ADDMCYCLE" 8 "ADDLORRYBUSTRAILER_DEPRECATED" 9 "ADDLORRYBUS_DEPRECATED" 10 "ADDHAZMAT" 11 "ADDTANK" 12 "ADDTRAM" 13 "ADDWET" 14 "ADDFOG" 15 "ADDRAIN" 16 "ADDSNOW" 17 "ADDTIME" 18 "ADDSECTION" 19 "ADDDISTANCE" 20 "ADDWEIGHT" 21 "ADDEXITL" 22 "ADDEXITR" 23 "ADDLANES" 24 "ADDRADAR" 25 "ADDRAPPEL" 26 "ADDPRIOTURN" 27 "ADDLORRY_EXCEPT" 28 "ADDTRACTOR_OVER" 29 "ADDTEXT" 30 "ADDSIGN" 31 "ADDRAINSNOW" 32 "ADDHUMP" 33 "VADDLORRYBUSTRAILER_DEPRECATED" 34 "VADDLORRYBUS_DEPRECATED" 35 "VADDLORRYTRAILER_DEPRECATED" 36 "ADDLORRYTRAILER_DEPRECATED" 37 "ADDCAMPER" 38 "ADDZONE" 39 "ADDCRASHRISK" 40 "ADDACCIDENT" 41 "ADDJAM" 42 "ADDSMOKE" 43 "ADDOILTRAIL" 44 "ADDGRAVEL" 45 "ADDDIRT" 46 "ADDRWORKSEXIT" 47 "ADDROADDAMAGE" 48 "ADDRWORKSENTRY" 49 "ADDLOWTREE" 50 "ADDRWORKSACCESS" 51 "ADDRUTS" 52 "ADDSOFTSHOULDERCAR" 53 "ADDSOFTSHOULDERLORRY" 54 "VADDSIGN" 55 "VADDCAR" 56 "VADDLORRY" 57 "VADDTRAILER" 58 "VADDCARAVAN" 59 "VADDBUS" 60 "VADDWET" 61 "VADDFOG" 62 "VADDRAIN" 63 "VADDSNOW" 64 "VADDRAINSNOW" 65 "VADDTEXT" 66 "VADDSECTION" 67 "VADDDISTANCE" 68 "VADDWEIGHT" 69 "VADDZONE" 70 "VADDCRASHRISK" 71 "VADDACCIDENT" 72 "VADDJAM" 73 "VADDOILTRAIL" 74 "VADDGRAVEL" 75 "VADDDIRT" 76 "VADDROADDAMAGE" 77 "VADDRUTS" 78 "ADDNOSTOPSHOULDER" 79 "ADDTOWING" 80 "ADDSCHOOL" 81 "ADDNIGHT" 82 "ADDEND" 83 "ADDBEGINS" 84 "ADDWITHIN" 85 "ADDDISTANCEBARS" 86 "ADDMINIMUM" 87 "ADDADVICE" 88 "ADDACCESS" 89 "ADDALLWAY" 90 "ADDBUS_EXCEPT" 91 "ADDEXCEPTDELIVERY" 92 "ADDEXCEPTLOCAL" 93 "ADDFROG" 94 "ADDPRIOTURNL" 95 "ADDPRIOTURNR" 96 "ADDSTART" 97 "ADDSTOPIN" 98 "ADDEXIT" 99 "ADDHAZWATER" 100 "ADDDAY" 101 "ADDSL" 102 "ADDLORRYTRAILER" 103 "ADDLORRYSEMI" 104 "VADDLORRYTRAILER" 105 "VADDLORRYSEMI" 106 "ADDSLOW" 107 "ADDSL5" 108 "ADDSL10" 109 "ADDSL15" 110 "ADDSL20" 111 "ADDSL25" 112 "ADDSL30" 113 "ADDSL35" 114 "ADDSL40" 115 "ADDSL45" 116 "ADDSL50" 117 "ADDSL55" 118 "ADDSL60" 119 "ADDSL65" 120 "ADDSL70" 121 "ADDSL75" 122 "ADDSL80" 123 "ADDSL85" 124 "ADDSL90" 125 "ADDSL95" 126 "ADDSL100" 127 "ADDSL105" 128 "ADDSL110" 129 "ADDSL115" 130 "ADDSL120" 131 "ADDSL125" 132 "ADDSL130" 133 "ADDSL135" 134 "ADDSL140" 135 "ADDSL145" 136 "ADDSL150" 137 "ADDSL155" 138 "ADDSL160" 139 "ADDBIKEROAD" 140 "ADDLORRYTRAILER_EXCEPT" 141 "ADDLORRYSEMI_EXCEPT" 142 "Reserved142" 143 "Reserved143" 144 "Reserved144" 145 "Reserved145" 146 "Reserved146" 147 "Reserved147" 148 "Reserved148" 149 "Reserved149" 150 "Reserved150" 151 "Reserved151" 152 "Reserved152" 153 "Reserved153" 154 "Reserved154" 155 "Reserved155" 156 "Reserved156" 157 "Reserved157" 158 "Reserved158" 159 "Reserved159" 160 "Reserved160" 161 "Reserved161" 162 "Reserved162" 163 "Reserved163" 164 "Reserved164" 165 "Reserved165" 166 "Reserved166" 167 "Reserved167" 168 "Reserved168" 169 "Reserved169" ;
VAL_ 244 VFC_TS12_SupSign1Type 0 "UNKNOWN" 1 "ADDCAR" 2 "ADDLORRY" 3 "ADDTRAILER" 4 "ADDCARAVAN" 5 "ADDBUS" 6 "ADDTRACTOR" 7 "ADDMCYCLE" 8 "ADDLORRYBUSTRAILER_DEPRECATED" 9 "ADDLORRYBUS_DEPRECATED" 10 "ADDHAZMAT" 11 "ADDTANK" 12 "ADDTRAM" 13 "ADDWET" 14 "ADDFOG" 15 "ADDRAIN" 16 "ADDSNOW" 17 "ADDTIME" 18 "ADDSECTION" 19 "ADDDISTANCE" 20 "ADDWEIGHT" 21 "ADDEXITL" 22 "ADDEXITR" 23 "ADDLANES" 24 "ADDRADAR" 25 "ADDRAPPEL" 26 "ADDPRIOTURN" 27 "ADDLORRY_EXCEPT" 28 "ADDTRACTOR_OVER" 29 "ADDTEXT" 30 "ADDSIGN" 31 "ADDRAINSNOW" 32 "ADDHUMP" 33 "VADDLORRYBUSTRAILER_DEPRECATED" 34 "VADDLORRYBUS_DEPRECATED" 35 "VADDLORRYTRAILER_DEPRECATED" 36 "ADDLORRYTRAILER_DEPRECATED" 37 "ADDCAMPER" 38 "ADDZONE" 39 "ADDCRASHRISK" 40 "ADDACCIDENT" 41 "ADDJAM" 42 "ADDSMOKE" 43 "ADDOILTRAIL" 44 "ADDGRAVEL" 45 "ADDDIRT" 46 "ADDRWORKSEXIT" 47 "ADDROADDAMAGE" 48 "ADDRWORKSENTRY" 49 "ADDLOWTREE" 50 "ADDRWORKSACCESS" 51 "ADDRUTS" 52 "ADDSOFTSHOULDERCAR" 53 "ADDSOFTSHOULDERLORRY" 54 "VADDSIGN" 55 "VADDCAR" 56 "VADDLORRY" 57 "VADDTRAILER" 58 "VADDCARAVAN" 59 "VADDBUS" 60 "VADDWET" 61 "VADDFOG" 62 "VADDRAIN" 63 "VADDSNOW" 64 "VADDRAINSNOW" 65 "VADDTEXT" 66 "VADDSECTION" 67 "VADDDISTANCE" 68 "VADDWEIGHT" 69 "VADDZONE" 70 "VADDCRASHRISK" 71 "VADDACCIDENT" 72 "VADDJAM" 73 "VADDOILTRAIL" 74 "VADDGRAVEL" 75 "VADDDIRT" 76 "VADDROADDAMAGE" 77 "VADDRUTS" 78 "ADDNOSTOPSHOULDER" 79 "ADDTOWING" 80 "ADDSCHOOL" 81 "ADDNIGHT" 82 "ADDEND" 83 "ADDBEGINS" 84 "ADDWITHIN" 85 "ADDDISTANCEBARS" 86 "ADDMINIMUM" 87 "ADDADVICE" 88 "ADDACCESS" 89 "ADDALLWAY" 90 "ADDBUS_EXCEPT" 91 "ADDEXCEPTDELIVERY" 92 "ADDEXCEPTLOCAL" 93 "ADDFROG" 94 "ADDPRIOTURNL" 95 "ADDPRIOTURNR" 96 "ADDSTART" 97 "ADDSTOPIN" 98 "ADDEXIT" 99 "ADDHAZWATER" 100 "ADDDAY" 101 "ADDSL" 102 "ADDLORRYTRAILER" 103 "ADDLORRYSEMI" 104 "VADDLORRYTRAILER" 105 "VADDLORRYSEMI" 106 "ADDSLOW" 107 "ADDSL5" 108 "ADDSL10" 109 "ADDSL15" 110 "ADDSL20" 111 "ADDSL25" 112 "ADDSL30" 113 "ADDSL35" 114 "ADDSL40" 115 "ADDSL45" 116 "ADDSL50" 117 "ADDSL55" 118 "ADDSL60" 119 "ADDSL65" 120 "ADDSL70" 121 "ADDSL75" 122 "ADDSL80" 123 "ADDSL85" 124 "ADDSL90" 125 "ADDSL95" 126 "ADDSL100" 127 "ADDSL105" 128 "ADDSL110" 129 "ADDSL115" 130 "ADDSL120" 131 "ADDSL125" 132 "ADDSL130" 133 "ADDSL135" 134 "ADDSL140" 135 "ADDSL145" 136 "ADDSL150" 137 "ADDSL155" 138 "ADDSL160" 139 "ADDBIKEROAD" 140 "ADDLORRYTRAILER_EXCEPT" 141 "ADDLORRYSEMI_EXCEPT" 142 "Reserved142" 143 "Reserved143" 144 "Reserved144" 145 "Reserved145" 146 "Reserved146" 147 "Reserved147" 148 "Reserved148" 149 "Reserved149" 150 "Reserved150" 151 "Reserved151" 152 "Reserved152" 153 "Reserved153" 154 "Reserved154" 155 "Reserved155" 156 "Reserved156" 157 "Reserved157" 158 "Reserved158" 159 "Reserved159" 160 "Reserved160" 161 "Reserved161" 162 "Reserved162" 163 "Reserved163" 164 "Reserved164" 165 "Reserved165" 166 "Reserved166" 167 "Reserved167" 168 "Reserved168" 169 "Reserved169" ;
VAL_ 244 VFC_TS12_SupSign2Type 0 "UNKNOWN" 1 "ADDCAR" 2 "ADDLORRY" 3 "ADDTRAILER" 4 "ADDCARAVAN" 5 "ADDBUS" 6 "ADDTRACTOR" 7 "ADDMCYCLE" 8 "ADDLORRYBUSTRAILER_DEPRECATED" 9 "ADDLORRYBUS_DEPRECATED" 10 "ADDHAZMAT" 11 "ADDTANK" 12 "ADDTRAM" 13 "ADDWET" 14 "ADDFOG" 15 "ADDRAIN" 16 "ADDSNOW" 17 "ADDTIME" 18 "ADDSECTION" 19 "ADDDISTANCE" 20 "ADDWEIGHT" 21 "ADDEXITL" 22 "ADDEXITR" 23 "ADDLANES" 24 "ADDRADAR" 25 "ADDRAPPEL" 26 "ADDPRIOTURN" 27 "ADDLORRY_EXCEPT" 28 "ADDTRACTOR_OVER" 29 "ADDTEXT" 30 "ADDSIGN" 31 "ADDRAINSNOW" 32 "ADDHUMP" 33 "VADDLORRYBUSTRAILER_DEPRECATED" 34 "VADDLORRYBUS_DEPRECATED" 35 "VADDLORRYTRAILER_DEPRECATED" 36 "ADDLORRYTRAILER_DEPRECATED" 37 "ADDCAMPER" 38 "ADDZONE" 39 "ADDCRASHRISK" 40 "ADDACCIDENT" 41 "ADDJAM" 42 "ADDSMOKE" 43 "ADDOILTRAIL" 44 "ADDGRAVEL" 45 "ADDDIRT" 46 "ADDRWORKSEXIT" 47 "ADDROADDAMAGE" 48 "ADDRWORKSENTRY" 49 "ADDLOWTREE" 50 "ADDRWORKSACCESS" 51 "ADDRUTS" 52 "ADDSOFTSHOULDERCAR" 53 "ADDSOFTSHOULDERLORRY" 54 "VADDSIGN" 55 "VADDCAR" 56 "VADDLORRY" 57 "VADDTRAILER" 58 "VADDCARAVAN" 59 "VADDBUS" 60 "VADDWET" 61 "VADDFOG" 62 "VADDRAIN" 63 "VADDSNOW" 64 "VADDRAINSNOW" 65 "VADDTEXT" 66 "VADDSECTION" 67 "VADDDISTANCE" 68 "VADDWEIGHT" 69 "VADDZONE" 70 "VADDCRASHRISK" 71 "VADDACCIDENT" 72 "VADDJAM" 73 "VADDOILTRAIL" 74 "VADDGRAVEL" 75 "VADDDIRT" 76 "VADDROADDAMAGE" 77 "VADDRUTS" 78 "ADDNOSTOPSHOULDER" 79 "ADDTOWING" 80 "ADDSCHOOL" 81 "ADDNIGHT" 82 "ADDEND" 83 "ADDBEGINS" 84 "ADDWITHIN" 85 "ADDDISTANCEBARS" 86 "ADDMINIMUM" 87 "ADDADVICE" 88 "ADDACCESS" 89 "ADDALLWAY" 90 "ADDBUS_EXCEPT" 91 "ADDEXCEPTDELIVERY" 92 "ADDEXCEPTLOCAL" 93 "ADDFROG" 94 "ADDPRIOTURNL" 95 "ADDPRIOTURNR" 96 "ADDSTART" 97 "ADDSTOPIN" 98 "ADDEXIT" 99 "ADDHAZWATER" 100 "ADDDAY" 101 "ADDSL" 102 "ADDLORRYTRAILER" 103 "ADDLORRYSEMI" 104 "VADDLORRYTRAILER" 105 "VADDLORRYSEMI" 106 "ADDSLOW" 107 "ADDSL5" 108 "ADDSL10" 109 "ADDSL15" 110 "ADDSL20" 111 "ADDSL25" 112 "ADDSL30" 113 "ADDSL35" 114 "ADDSL40" 115 "ADDSL45" 116 "ADDSL50" 117 "ADDSL55" 118 "ADDSL60" 119 "ADDSL65" 120 "ADDSL70" 121 "ADDSL75" 122 "ADDSL80" 123 "ADDSL85" 124 "ADDSL90" 125 "ADDSL95" 126 "ADDSL100" 127 "ADDSL105" 128 "ADDSL110" 129 "ADDSL115" 130 "ADDSL120" 131 "ADDSL125" 132 "ADDSL130" 133 "ADDSL135" 134 "ADDSL140" 135 "ADDSL145" 136 "ADDSL150" 137 "ADDSL155" 138 "ADDSL160" 139 "ADDBIKEROAD" 140 "ADDLORRYTRAILER_EXCEPT" 141 "ADDLORRYSEMI_EXCEPT" 142 "Reserved142" 143 "Reserved143" 144 "Reserved144" 145 "Reserved145" 146 "Reserved146" 147 "Reserved147" 148 "Reserved148" 149 "Reserved149" 150 "Reserved150" 151 "Reserved151" 152 "Reserved152" 153 "Reserved153" 154 "Reserved154" 155 "Reserved155" 156 "Reserved156" 157 "Reserved157" 158 "Reserved158" 159 "Reserved159" 160 "Reserved160" 161 "Reserved161" 162 "Reserved162" 163 "Reserved163" 164 "Reserved164" 165 "Reserved165" 166 "Reserved166" 167 "Reserved167" 168 "Reserved168" 169 "Reserved169" ;
VAL_ 244 VFC_TS12_SupSign3Type 0 "UNKNOWN" 1 "ADDCAR" 2 "ADDLORRY" 3 "ADDTRAILER" 4 "ADDCARAVAN" 5 "ADDBUS" 6 "ADDTRACTOR" 7 "ADDMCYCLE" 8 "ADDLORRYBUSTRAILER_DEPRECATED" 9 "ADDLORRYBUS_DEPRECATED" 10 "ADDHAZMAT" 11 "ADDTANK" 12 "ADDTRAM" 13 "ADDWET" 14 "ADDFOG" 15 "ADDRAIN" 16 "ADDSNOW" 17 "ADDTIME" 18 "ADDSECTION" 19 "ADDDISTANCE" 20 "ADDWEIGHT" 21 "ADDEXITL" 22 "ADDEXITR" 23 "ADDLANES" 24 "ADDRADAR" 25 "ADDRAPPEL" 26 "ADDPRIOTURN" 27 "ADDLORRY_EXCEPT" 28 "ADDTRACTOR_OVER" 29 "ADDTEXT" 30 "ADDSIGN" 31 "ADDRAINSNOW" 32 "ADDHUMP" 33 "VADDLORRYBUSTRAILER_DEPRECATED" 34 "VADDLORRYBUS_DEPRECATED" 35 "VADDLORRYTRAILER_DEPRECATED" 36 "ADDLORRYTRAILER_DEPRECATED" 37 "ADDCAMPER" 38 "ADDZONE" 39 "ADDCRASHRISK" 40 "ADDACCIDENT" 41 "ADDJAM" 42 "ADDSMOKE" 43 "ADDOILTRAIL" 44 "ADDGRAVEL" 45 "ADDDIRT" 46 "ADDRWORKSEXIT" 47 "ADDROADDAMAGE" 48 "ADDRWORKSENTRY" 49 "ADDLOWTREE" 50 "ADDRWORKSACCESS" 51 "ADDRUTS" 52 "ADDSOFTSHOULDERCAR" 53 "ADDSOFTSHOULDERLORRY" 54 "VADDSIGN" 55 "VADDCAR" 56 "VADDLORRY" 57 "VADDTRAILER" 58 "VADDCARAVAN" 59 "VADDBUS" 60 "VADDWET" 61 "VADDFOG" 62 "VADDRAIN" 63 "VADDSNOW" 64 "VADDRAINSNOW" 65 "VADDTEXT" 66 "VADDSECTION" 67 "VADDDISTANCE" 68 "VADDWEIGHT" 69 "VADDZONE" 70 "VADDCRASHRISK" 71 "VADDACCIDENT" 72 "VADDJAM" 73 "VADDOILTRAIL" 74 "VADDGRAVEL" 75 "VADDDIRT" 76 "VADDROADDAMAGE" 77 "VADDRUTS" 78 "ADDNOSTOPSHOULDER" 79 "ADDTOWING" 80 "ADDSCHOOL" 81 "ADDNIGHT" 82 "ADDEND" 83 "ADDBEGINS" 84 "ADDWITHIN" 85 "ADDDISTANCEBARS" 86 "ADDMINIMUM" 87 "ADDADVICE" 88 "ADDACCESS" 89 "ADDALLWAY" 90 "ADDBUS_EXCEPT" 91 "ADDEXCEPTDELIVERY" 92 "ADDEXCEPTLOCAL" 93 "ADDFROG" 94 "ADDPRIOTURNL" 95 "ADDPRIOTURNR" 96 "ADDSTART" 97 "ADDSTOPIN" 98 "ADDEXIT" 99 "ADDHAZWATER" 100 "ADDDAY" 101 "ADDSL" 102 "ADDLORRYTRAILER" 103 "ADDLORRYSEMI" 104 "VADDLORRYTRAILER" 105 "VADDLORRYSEMI" 106 "ADDSLOW" 107 "ADDSL5" 108 "ADDSL10" 109 "ADDSL15" 110 "ADDSL20" 111 "ADDSL25" 112 "ADDSL30" 113 "ADDSL35" 114 "ADDSL40" 115 "ADDSL45" 116 "ADDSL50" 117 "ADDSL55" 118 "ADDSL60" 119 "ADDSL65" 120 "ADDSL70" 121 "ADDSL75" 122 "ADDSL80" 123 "ADDSL85" 124 "ADDSL90" 125 "ADDSL95" 126 "ADDSL100" 127 "ADDSL105" 128 "ADDSL110" 129 "ADDSL115" 130 "ADDSL120" 131 "ADDSL125" 132 "ADDSL130" 133 "ADDSL135" 134 "ADDSL140" 135 "ADDSL145" 136 "ADDSL150" 137 "ADDSL155" 138 "ADDSL160" 139 "ADDBIKEROAD" 140 "ADDLORRYTRAILER_EXCEPT" 141 "ADDLORRYSEMI_EXCEPT" 142 "Reserved142" 143 "Reserved143" 144 "Reserved144" 145 "Reserved145" 146 "Reserved146" 147 "Reserved147" 148 "Reserved148" 149 "Reserved149" 150 "Reserved150" 151 "Reserved151" 152 "Reserved152" 153 "Reserved153" 154 "Reserved154" 155 "Reserved155" 156 "Reserved156" 157 "Reserved157" 158 "Reserved158" 159 "Reserved159" 160 "Reserved160" 161 "Reserved161" 162 "Reserved162" 163 "Reserved163" 164 "Reserved164" 165 "Reserved165" 166 "Reserved166" 167 "Reserved167" 168 "Reserved168" 169 "Reserved169" ;
VAL_ 244 VFC_TS12_SupSign4Type 0 "UNKNOWN" 1 "ADDCAR" 2 "ADDLORRY" 3 "ADDTRAILER" 4 "ADDCARAVAN" 5 "ADDBUS" 6 "ADDTRACTOR" 7 "ADDMCYCLE" 8 "ADDLORRYBUSTRAILER_DEPRECATED" 9 "ADDLORRYBUS_DEPRECATED" 10 "ADDHAZMAT" 11 "ADDTANK" 12 "ADDTRAM" 13 "ADDWET" 14 "ADDFOG" 15 "ADDRAIN" 16 "ADDSNOW" 17 "ADDTIME" 18 "ADDSECTION" 19 "ADDDISTANCE" 20 "ADDWEIGHT" 21 "ADDEXITL" 22 "ADDEXITR" 23 "ADDLANES" 24 "ADDRADAR" 25 "ADDRAPPEL" 26 "ADDPRIOTURN" 27 "ADDLORRY_EXCEPT" 28 "ADDTRACTOR_OVER" 29 "ADDTEXT" 30 "ADDSIGN" 31 "ADDRAINSNOW" 32 "ADDHUMP" 33 "VADDLORRYBUSTRAILER_DEPRECATED" 34 "VADDLORRYBUS_DEPRECATED" 35 "VADDLORRYTRAILER_DEPRECATED" 36 "ADDLORRYTRAILER_DEPRECATED" 37 "ADDCAMPER" 38 "ADDZONE" 39 "ADDCRASHRISK" 40 "ADDACCIDENT" 41 "ADDJAM" 42 "ADDSMOKE" 43 "ADDOILTRAIL" 44 "ADDGRAVEL" 45 "ADDDIRT" 46 "ADDRWORKSEXIT" 47 "ADDROADDAMAGE" 48 "ADDRWORKSENTRY" 49 "ADDLOWTREE" 50 "ADDRWORKSACCESS" 51 "ADDRUTS" 52 "ADDSOFTSHOULDERCAR" 53 "ADDSOFTSHOULDERLORRY" 54 "VADDSIGN" 55 "VADDCAR" 56 "VADDLORRY" 57 "VADDTRAILER" 58 "VADDCARAVAN" 59 "VADDBUS" 60 "VADDWET" 61 "VADDFOG" 62 "VADDRAIN" 63 "VADDSNOW" 64 "VADDRAINSNOW" 65 "VADDTEXT" 66 "VADDSECTION" 67 "VADDDISTANCE" 68 "VADDWEIGHT" 69 "VADDZONE" 70 "VADDCRASHRISK" 71 "VADDACCIDENT" 72 "VADDJAM" 73 "VADDOILTRAIL" 74 "VADDGRAVEL" 75 "VADDDIRT" 76 "VADDROADDAMAGE" 77 "VADDRUTS" 78 "ADDNOSTOPSHOULDER" 79 "ADDTOWING" 80 "ADDSCHOOL" 81 "ADDNIGHT" 82 "ADDEND" 83 "ADDBEGINS" 84 "ADDWITHIN" 85 "ADDDISTANCEBARS" 86 "ADDMINIMUM" 87 "ADDADVICE" 88 "ADDACCESS" 89 "ADDALLWAY" 90 "ADDBUS_EXCEPT" 91 "ADDEXCEPTDELIVERY" 92 "ADDEXCEPTLOCAL" 93 "ADDFROG" 94 "ADDPRIOTURNL" 95 "ADDPRIOTURNR" 96 "ADDSTART" 97 "ADDSTOPIN" 98 "ADDEXIT" 99 "ADDHAZWATER" 100 "ADDDAY" 101 "ADDSL" 102 "ADDLORRYTRAILER" 103 "ADDLORRYSEMI" 104 "VADDLORRYTRAILER" 105 "VADDLORRYSEMI" 106 "ADDSLOW" 107 "ADDSL5" 108 "ADDSL10" 109 "ADDSL15" 110 "ADDSL20" 111 "ADDSL25" 112 "ADDSL30" 113 "ADDSL35" 114 "ADDSL40" 115 "ADDSL45" 116 "ADDSL50" 117 "ADDSL55" 118 "ADDSL60" 119 "ADDSL65" 120 "ADDSL70" 121 "ADDSL75" 122 "ADDSL80" 123 "ADDSL85" 124 "ADDSL90" 125 "ADDSL95" 126 "ADDSL100" 127 "ADDSL105" 128 "ADDSL110" 129 "ADDSL115" 130 "ADDSL120" 131 "ADDSL125" 132 "ADDSL130" 133 "ADDSL135" 134 "ADDSL140" 135 "ADDSL145" 136 "ADDSL150" 137 "ADDSL155" 138 "ADDSL160" 139 "ADDBIKEROAD" 140 "ADDLORRYTRAILER_EXCEPT" 141 "ADDLORRYSEMI_EXCEPT" 142 "Reserved142" 143 "Reserved143" 144 "Reserved144" 145 "Reserved145" 146 "Reserved146" 147 "Reserved147" 148 "Reserved148" 149 "Reserved149" 150 "Reserved150" 151 "Reserved151" 152 "Reserved152" 153 "Reserved153" 154 "Reserved154" 155 "Reserved155" 156 "Reserved156" 157 "Reserved157" 158 "Reserved158" 159 "Reserved159" 160 "Reserved160" 161 "Reserved161" 162 "Reserved162" 163 "Reserved163" 164 "Reserved164" 165 "Reserved165" 166 "Reserved166" 167 "Reserved167" 168 "Reserved168" 169 "Reserved169" ;
VAL_ 244 VFC_TS12_SupSign5Type 0 "UNKNOWN" 1 "ADDCAR" 2 "ADDLORRY" 3 "ADDTRAILER" 4 "ADDCARAVAN" 5 "ADDBUS" 6 "ADDTRACTOR" 7 "ADDMCYCLE" 8 "ADDLORRYBUSTRAILER_DEPRECATED" 9 "ADDLORRYBUS_DEPRECATED" 10 "ADDHAZMAT" 11 "ADDTANK" 12 "ADDTRAM" 13 "ADDWET" 14 "ADDFOG" 15 "ADDRAIN" 16 "ADDSNOW" 17 "ADDTIME" 18 "ADDSECTION" 19 "ADDDISTANCE" 20 "ADDWEIGHT" 21 "ADDEXITL" 22 "ADDEXITR" 23 "ADDLANES" 24 "ADDRADAR" 25 "ADDRAPPEL" 26 "ADDPRIOTURN" 27 "ADDLORRY_EXCEPT" 28 "ADDTRACTOR_OVER" 29 "ADDTEXT" 30 "ADDSIGN" 31 "ADDRAINSNOW" 32 "ADDHUMP" 33 "VADDLORRYBUSTRAILER_DEPRECATED" 34 "VADDLORRYBUS_DEPRECATED" 35 "VADDLORRYTRAILER_DEPRECATED" 36 "ADDLORRYTRAILER_DEPRECATED" 37 "ADDCAMPER" 38 "ADDZONE" 39 "ADDCRASHRISK" 40 "ADDACCIDENT" 41 "ADDJAM" 42 "ADDSMOKE" 43 "ADDOILTRAIL" 44 "ADDGRAVEL" 45 "ADDDIRT" 46 "ADDRWORKSEXIT" 47 "ADDROADDAMAGE" 48 "ADDRWORKSENTRY" 49 "ADDLOWTREE" 50 "ADDRWORKSACCESS" 51 "ADDRUTS" 52 "ADDSOFTSHOULDERCAR" 53 "ADDSOFTSHOULDERLORRY" 54 "VADDSIGN" 55 "VADDCAR" 56 "VADDLORRY" 57 "VADDTRAILER" 58 "VADDCARAVAN" 59 "VADDBUS" 60 "VADDWET" 61 "VADDFOG" 62 "VADDRAIN" 63 "VADDSNOW" 64 "VADDRAINSNOW" 65 "VADDTEXT" 66 "VADDSECTION" 67 "VADDDISTANCE" 68 "VADDWEIGHT" 69 "VADDZONE" 70 "VADDCRASHRISK" 71 "VADDACCIDENT" 72 "VADDJAM" 73 "VADDOILTRAIL" 74 "VADDGRAVEL" 75 "VADDDIRT" 76 "VADDROADDAMAGE" 77 "VADDRUTS" 78 "ADDNOSTOPSHOULDER" 79 "ADDTOWING" 80 "ADDSCHOOL" 81 "ADDNIGHT" 82 "ADDEND" 83 "ADDBEGINS" 84 "ADDWITHIN" 85 "ADDDISTANCEBARS" 86 "ADDMINIMUM" 87 "ADDADVICE" 88 "ADDACCESS" 89 "ADDALLWAY" 90 "ADDBUS_EXCEPT" 91 "ADDEXCEPTDELIVERY" 92 "ADDEXCEPTLOCAL" 93 "ADDFROG" 94 "ADDPRIOTURNL" 95 "ADDPRIOTURNR" 96 "ADDSTART" 97 "ADDSTOPIN" 98 "ADDEXIT" 99 "ADDHAZWATER" 100 "ADDDAY" 101 "ADDSL" 102 "ADDLORRYTRAILER" 103 "ADDLORRYSEMI" 104 "VADDLORRYTRAILER" 105 "VADDLORRYSEMI" 106 "ADDSLOW" 107 "ADDSL5" 108 "ADDSL10" 109 "ADDSL15" 110 "ADDSL20" 111 "ADDSL25" 112 "ADDSL30" 113 "ADDSL35" 114 "ADDSL40" 115 "ADDSL45" 116 "ADDSL50" 117 "ADDSL55" 118 "ADDSL60" 119 "ADDSL65" 120 "ADDSL70" 121 "ADDSL75" 122 "ADDSL80" 123 "ADDSL85" 124 "ADDSL90" 125 "ADDSL95" 126 "ADDSL100" 127 "ADDSL105" 128 "ADDSL110" 129 "ADDSL115" 130 "ADDSL120" 131 "ADDSL125" 132 "ADDSL130" 133 "ADDSL135" 134 "ADDSL140" 135 "ADDSL145" 136 "ADDSL150" 137 "ADDSL155" 138 "ADDSL160" 139 "ADDBIKEROAD" 140 "ADDLORRYTRAILER_EXCEPT" 141 "ADDLORRYSEMI_EXCEPT" 142 "Reserved142" 143 "Reserved143" 144 "Reserved144" 145 "Reserved145" 146 "Reserved146" 147 "Reserved147" 148 "Reserved148" 149 "Reserved149" 150 "Reserved150" 151 "Reserved151" 152 "Reserved152" 153 "Reserved153" 154 "Reserved154" 155 "Reserved155" 156 "Reserved156" 157 "Reserved157" 158 "Reserved158" 159 "Reserved159" 160 "Reserved160" 161 "Reserved161" 162 "Reserved162" 163 "Reserved163" 164 "Reserved164" 165 "Reserved165" 166 "Reserved166" 167 "Reserved167" 168 "Reserved168" 169 "Reserved169" ;
VAL_ 244 VFC_TS13_Type 0 "UNKNOWN" 1 "SL5" 2 "SL10" 3 "SL15" 4 "SL20" 5 "SL25" 6 "SL30" 7 "SL35" 8 "SL40" 9 "SL45" 10 "SL50" 11 "SL55" 12 "SL60" 13 "SL65" 14 "SL70" 15 "SL75" 16 "SL80" 17 "SL85" 18 "SL90" 19 "SL95" 20 "SL100" 21 "SL105" 22 "SL110" 23 "SL115" 24 "SL120" 25 "SL125" 26 "SL130" 27 "SL135" 28 "SL140" 29 "SL145" 30 "SL150" 31 "SL155" 32 "SL160" 33 "OP" 34 "OL" 35 "ESL" 36 "EOP" 37 "EOL" 38 "EA" 39 "VSL5" 40 "VSL10" 41 "VSL15" 42 "VSL20" 43 "VSL25" 44 "VSL30" 45 "VSL35" 46 "VSL40" 47 "VSL45" 48 "VSL50" 49 "VSL55" 50 "VSL60" 51 "VSL65" 52 "VSL70" 53 "VSL75" 54 "VSL80" 55 "VSL85" 56 "VSL90" 57 "VSL95" 58 "VSL100" 59 "VSL105" 60 "VSL110" 61 "VSL115" 62 "VSL120" 63 "VSL125" 64 "VSL130" 65 "VSL135" 66 "VSL140" 67 "VSL145" 68 "VSL150" 69 "VSL155" 70 "VSL160" 71 "VOP" 72 "VOL" 73 "VESL" 74 "VEOP" 75 "VEOL" 76 "VEA" 77 "NOENTRY" 78 "NOALL" 79 "NOCAR" 80 "NOLORRY" 81 "NOHAZMAT" 82 "NOBIKE" 83 "NOPED" 84 "NOCARBIKE" 85 "NOTWOWAY" 86 "WEIGHT" 87 "HEIGHT" 88 "WIDTH" 89 "LENGTH" 90 "PRIOCROSS" 91 "GIVEWAY" 92 "PRIOCROSSYIELDTORIGHT" 93 "WARNDANGER" 94 "WARNCURVEL" 95 "WARNCURVER" 96 "WARNDCURVEL" 97 "WARNDCURVER" 98 "WARNTRAIN" 99 "WARNJAM" 100 "WARNANIMAL_DEPRECATED" 101 "WARNRWORKS" 102 "WARNSLOPED" 103 "WARNSLOPEU" 104 "PRIOSTREET" 105 "EPRIOSTREET" 106 "STOP" 107 "ASL" 108 "EASL" 109 "MSL" 110 "EMSL" 111 "MLC" 112 "WBDIAGL" 113 "WBDIAGR" 114 "WBROUND" 115 "NOLTURN" 116 "NORTURN" 117 "NOUTURN" 118 "NOPARK" 119 "NOSTOP" 120 "SMOG" 121 "UMWELT" 122 "EUMWELT" 123 "DOUANE" 124 "FWAY" 125 "EFWAY" 126 "HWAY" 127 "EHWAY" 128 "NORIDER" 129 "WARNCONST" 130 "WARNCONSTL" 131 "WARNCONSTR" 132 "WARNPED" 133 "WARNKIDS" 134 "WARNBIKE" 135 "WARNSKID" 136 "ZEBRA" 137 "ONEWAYS" 138 "ONEWAYU" 139 "SLOWDOWN" 140 "NOCARRIAGE" 141 "NOLORRYTRAILER" 142 "NOBUS" 143 "NOTRACTOR" 144 "LORRYDIST" 145 "CARDIST" 146 "WARNROUND" 147 "WARNWILDANIMAL" 148 "WARNCATTLE" 149 "WARNFROG" 150 "WARNBUS" 151 "WARNWIND" 152 "WARNSNOW" 153 "WARNPCROSS" 154 "WARNHUMP" 155 "WARNROCK" 156 "WARNLOWTREE" 157 "WARNGRAVEL" 158 "WARNTWOWAY" 159 "WARNLIGHTS" 160 "WARNPLANE" 161 "VNOENTRY" 162 "VNOALL" 163 "VNOCAR" 164 "VNOLORRY" 165 "VNOCARBIKE" 166 "VWEIGHT" 167 "VHEIGHT" 168 "VWIDTH" 169 "VLENGTH" 170 "VWARNDANGER" 171 "VWARNJAM" 172 "VWARNRWORKS" 173 "VWARNSKID" 174 "VASL" 175 "VEASL" 176 "VNOLORRYTRAILER" 177 "VNOBUS" 178 "VLORRYDIST" 179 "VCARDIST" 180 "VWARNSNOW" 181 "VWARNHUMP" 182 "VWARNGRAVEL" 183 "CALM" 184 "ECALM" 185 "TWN" 186 "ETWN" 187 "DEADEND" 188 "AXLEWEIGHT" 189 "WARNRIDER" 190 "WARNDRAWBRIDGE" 191 "WARNPIER" 192 "TRINATURE" 193 "VWARNCONST" 194 "VWARNCONSTL" 195 "VWARNCONSTR" 196 "VWARNCURVEL" 197 "VWARNCURVER" 198 "VWARNDCURVEL" 199 "VWARNDCURVER" 200 "VWARNLIGHTS" 201 "WBBENTLEFT" 202 "WBBENTLEFTRIGHT" 203 "WBBENTRIGHT" 204 "WBDIAGLR" 205 "WBLEFT" 206 "WBRIGHT" 207 "WBUP" 208 "WBUPLEFT" 209 "WBUPRIGHT" 210 "WBHAZWATER" 211 "NOHAZWATER" 212 "SCHOOL" 213 "ESCHOOL" 214 "HAZMAT" 215 "EMERGENCYBAY" 216 "ENDOFLANEL" 217 "ENDOFLANER" 218 "ENOPARK" 219 "EONEWAY" 220 "EPARK" 221 "ETOLL" 222 "NOPARKL" 223 "NOPARKLR" 224 "NOPARKR" 225 "NOSTOPL" 226 "NOSTOPLR" 227 "NOSTOPR" 228 "NOTURNONRED" 229 "ONEWAYL" 230 "ONEWAYR" 231 "PARK" 232 "PRIOCROSSL" 233 "PRIOCROSSR" 234 "TOLL" 235 "TUNNEL" 236 "TWOWAY" 237 "WARNCROSS" 238 "WARNCROSSL" 239 "WARNCROSSLR" 240 "WARNCROSSR" 241 "WARNCROSSRL" 242 "WARNCROSST" 243 "WARNGIVEWAYAHEAD" 244 "WARNSLAHEAD" 245 "WARNSTOPAHEAD" 246 "WBBUS" 247 "WRONGWAY" 248 "HAZWATER" 249 "GIVEWAYROUND" 250 "WARNWINDINGL" 251 "WARNWINDINGR" 252 "WARNHAIRPINL" 253 "WARNHAIRPINR" 254 "WARNPEDBIKE" 255 "WARNCROSSY" 256 "WARNBRANCHL" 257 "WARNBRANCHR" 258 "WARNAXLEWEIGHT" 259 "WARNWEIGHT" 260 "WARNHEIGHT" 261 "WARNLENGTH" 262 "WARNWIDTH" 263 "WARNBLACKSPOT" 264 "WARNMERGEL" 265 "WARNMERGER" 266 "WARNTUNNEL" 267 "WARNTRACTOR" 268 "WARNRWORKSVEHICLE" 269 "WARNNARROWBRIDGE" 270 "WARNFLAGGER" 271 "LANES" 272 "LANESHIFTL" 273 "LANESHIFTR" 274 "NEWLANEL" 275 "NEWLANER" 276 "RIGHTTURNONRED" 277 "BORDERLIMIT" 278 "EMBEDDEDRAIN" 279 "VWARNWEIGHT" 280 "VWARNHEIGHT" 281 "VWARNLENGTH" 282 "VWARNWIDTH" 283 "VENDOFLANEL" 284 "VENDOFLANER" 285 "VLANES" 286 "VLANESHIFTL" 287 "VLANESHIFTR" 288 "VNEWLANEL" 289 "VNEWLANER" 290 "NOUP" 291 "VOFF" 292 "ASL5" 293 "ASL10" 294 "ASL15" 295 "ASL20" 296 "ASL25" 297 "ASL30" 298 "ASL35" 299 "ASL40" 300 "ASL45" 301 "ASL50" 302 "ASL55" 303 "ASL60" 304 "ASL65" 305 "ASL70" 306 "ASL75" 307 "ASL80" 308 "ASL85" 309 "ASL90" 310 "ASL95" 311 "ASL100" 312 "ASL105" 313 "ASL110" 314 "ASL115" 315 "ASL120" 316 "ASL125" 317 "ASL130" 318 "ASL135" 319 "ASL140" 320 "ASL145" 321 "ASL150" 322 "ASL155" 323 "ASL160" 324 "VASL5" 325 "VASL10" 326 "VASL15" 327 "VASL20" 328 "VASL25" 329 "VASL30" 330 "VASL35" 331 "VASL40" 332 "VASL45" 333 "VASL50" 334 "VASL55" 335 "VASL60" 336 "VASL65" 337 "VASL70" 338 "VASL75" 339 "VASL80" 340 "VASL85" 341 "VASL90" 342 "VASL95" 343 "VASL100" 344 "VASL105" 345 "VASL110" 346 "VASL115" 347 "VASL120" 348 "VASL125" 349 "VASL130" 350 "VASL135" 351 "VASL140" 352 "VASL145" 353 "VASL150" 354 "VASL155" 355 "VASL160" 356 "WARNTRAINGATED" 357 "KEEPRIGHTCAR" 358 "ASLCURVE5" 359 "ASLCURVE10" 360 "ASLCURVE15" 361 "ASLCURVE20" 362 "ASLCURVE25" 363 "ASLCURVE30" 364 "ASLCURVE35" 365 "ASLCURVE40" 366 "ASLCURVE45" 367 "ASLCURVE50" 368 "ASLCURVE55" 369 "ASLCURVE60" 370 "ASLCURVE65" 371 "ASLCURVE70" 372 "ASLCURVE75" 373 "ASLCURVE80" 374 "ASLCURVE85" 375 "ASLCURVE90" 376 "ASLCURVE95" 377 "ASLCURVE100" 378 "ASLCURVE105" 379 "ASLCURVE110" 380 "ASLCURVE115" 381 "ASLCURVE120" 382 "ASLCURVE125" 383 "ASLCURVE130" 384 "ASLCURVE135" 385 "ASLCURVE140" 386 "ASLCURVE145" 387 "ASLCURVE150" 388 "ASLCURVE155" 389 "ASLCURVE160" 390 "KIDS" 391 "EKIDS" 392 "BIKEROAD" 393 "EBIKEROAD" 394 "PEDSTREET" 395 "EPEDSTREET" 396 "PEDBIKESTREET" 397 "EPEDBIKESTREET" 398 "EWARNKIDS" 399 "CALM20" 400 "CALM30" 401 "ECALM20" 402 "ECALM30" 403 "FWAYGREEN" 404 "TWN40" 405 "TWN50" 406 "TWN60" 407 "TWN70" 408 "ETWN40" 409 "ETWN50" 410 "ETWN60" 411 "ETWN70" 412 "WBBIKE" 413 "EWBBIKE" 414 "WBPED" 415 "EWBPED" 416 "WBPEDBIKESEP" 417 "EWBPEDBIKESEP" 418 "WBPEDBIKESHARED" 419 "EWBPEDBIKESHARED" 420 "EFWAYGREEN" 421 "Reserved0421" 422 "Reserved0422" 423 "Reserved0423" 424 "Reserved0424" 425 "Reserved0425" 426 "Reserved0426" 427 "Reserved0427" 428 "Reserved0428" 429 "Reserved0429" 430 "Reserved0430" 431 "Reserved0431" 432 "Reserved0432" 433 "Reserved0433" 434 "Reserved0434" 435 "Reserved0435" 436 "Reserved0436" 437 "Reserved0437" 438 "Reserved0438" 439 "Reserved0439" 440 "Reserved0440" 441 "Reserved0441" 442 "Reserved0442" 443 "Reserved0443" 444 "Reserved0444" 445 "Reserved0445" 446 "Reserved0446" 447 "Reserved0447" 448 "Reserved0448" 449 "Reserved0449" ;
VAL_ 244 VFC_TS13_EmbeddedInfo 0 "Unknown" 1 "Not Embedded" 2 "Border Limit" 3 "Multi Lane" 4 "Rain" 5 "Vehicle Type" 6 "Plate" 7 "Error Value" 8 "Vehicle Sticker" 9 "Reserved09" 10 "Reserved10" 11 "Reserved11" 12 "Reserved12" 13 "Reserved13" 14 "Reserved14" 15 "Reserved15" ;
VAL_ 244 VFC_TS13_ValidTimeRange1Start 127 "Unknown" ;
VAL_ 244 VFC_TS13_ValidTimeRange1End 127 "Unknown" ;
VAL_ 244 VFC_TS13_ValidTimeRange2Start 127 "Unknown" ;
VAL_ 244 VFC_TS13_ValidTimeRange2End 127 "Unknown" ;
VAL_ 244 VFC_TS13_ValidInDistUnit 0 "Unknown" ;
VAL_ 244 VFC_TS13_ValidSectionUnit 0 "Unknown" 1 "Meter" 2 "Kilometer" 3 "Foot" 4 "Yard" 5 "Mile" 6 "Reserved6" 7 "Reserved7" ;
VAL_ 244 VFC_TS13_SupSign0Type 0 "UNKNOWN" 1 "ADDCAR" 2 "ADDLORRY" 3 "ADDTRAILER" 4 "ADDCARAVAN" 5 "ADDBUS" 6 "ADDTRACTOR" 7 "ADDMCYCLE" 8 "ADDLORRYBUSTRAILER_DEPRECATED" 9 "ADDLORRYBUS_DEPRECATED" 10 "ADDHAZMAT" 11 "ADDTANK" 12 "ADDTRAM" 13 "ADDWET" 14 "ADDFOG" 15 "ADDRAIN" 16 "ADDSNOW" 17 "ADDTIME" 18 "ADDSECTION" 19 "ADDDISTANCE" 20 "ADDWEIGHT" 21 "ADDEXITL" 22 "ADDEXITR" 23 "ADDLANES" 24 "ADDRADAR" 25 "ADDRAPPEL" 26 "ADDPRIOTURN" 27 "ADDLORRY_EXCEPT" 28 "ADDTRACTOR_OVER" 29 "ADDTEXT" 30 "ADDSIGN" 31 "ADDRAINSNOW" 32 "ADDHUMP" 33 "VADDLORRYBUSTRAILER_DEPRECATED" 34 "VADDLORRYBUS_DEPRECATED" 35 "VADDLORRYTRAILER_DEPRECATED" 36 "ADDLORRYTRAILER_DEPRECATED" 37 "ADDCAMPER" 38 "ADDZONE" 39 "ADDCRASHRISK" 40 "ADDACCIDENT" 41 "ADDJAM" 42 "ADDSMOKE" 43 "ADDOILTRAIL" 44 "ADDGRAVEL" 45 "ADDDIRT" 46 "ADDRWORKSEXIT" 47 "ADDROADDAMAGE" 48 "ADDRWORKSENTRY" 49 "ADDLOWTREE" 50 "ADDRWORKSACCESS" 51 "ADDRUTS" 52 "ADDSOFTSHOULDERCAR" 53 "ADDSOFTSHOULDERLORRY" 54 "VADDSIGN" 55 "VADDCAR" 56 "VADDLORRY" 57 "VADDTRAILER" 58 "VADDCARAVAN" 59 "VADDBUS" 60 "VADDWET" 61 "VADDFOG" 62 "VADDRAIN" 63 "VADDSNOW" 64 "VADDRAINSNOW" 65 "VADDTEXT" 66 "VADDSECTION" 67 "VADDDISTANCE" 68 "VADDWEIGHT" 69 "VADDZONE" 70 "VADDCRASHRISK" 71 "VADDACCIDENT" 72 "VADDJAM" 73 "VADDOILTRAIL" 74 "VADDGRAVEL" 75 "VADDDIRT" 76 "VADDROADDAMAGE" 77 "VADDRUTS" 78 "ADDNOSTOPSHOULDER" 79 "ADDTOWING" 80 "ADDSCHOOL" 81 "ADDNIGHT" 82 "ADDEND" 83 "ADDBEGINS" 84 "ADDWITHIN" 85 "ADDDISTANCEBARS" 86 "ADDMINIMUM" 87 "ADDADVICE" 88 "ADDACCESS" 89 "ADDALLWAY" 90 "ADDBUS_EXCEPT" 91 "ADDEXCEPTDELIVERY" 92 "ADDEXCEPTLOCAL" 93 "ADDFROG" 94 "ADDPRIOTURNL" 95 "ADDPRIOTURNR" 96 "ADDSTART" 97 "ADDSTOPIN" 98 "ADDEXIT" 99 "ADDHAZWATER" 100 "ADDDAY" 101 "ADDSL" 102 "ADDLORRYTRAILER" 103 "ADDLORRYSEMI" 104 "VADDLORRYTRAILER" 105 "VADDLORRYSEMI" 106 "ADDSLOW" 107 "ADDSL5" 108 "ADDSL10" 109 "ADDSL15" 110 "ADDSL20" 111 "ADDSL25" 112 "ADDSL30" 113 "ADDSL35" 114 "ADDSL40" 115 "ADDSL45" 116 "ADDSL50" 117 "ADDSL55" 118 "ADDSL60" 119 "ADDSL65" 120 "ADDSL70" 121 "ADDSL75" 122 "ADDSL80" 123 "ADDSL85" 124 "ADDSL90" 125 "ADDSL95" 126 "ADDSL100" 127 "ADDSL105" 128 "ADDSL110" 129 "ADDSL115" 130 "ADDSL120" 131 "ADDSL125" 132 "ADDSL130" 133 "ADDSL135" 134 "ADDSL140" 135 "ADDSL145" 136 "ADDSL150" 137 "ADDSL155" 138 "ADDSL160" 139 "ADDBIKEROAD" 140 "ADDLORRYTRAILER_EXCEPT" 141 "ADDLORRYSEMI_EXCEPT" 142 "Reserved142" 143 "Reserved143" 144 "Reserved144" 145 "Reserved145" 146 "Reserved146" 147 "Reserved147" 148 "Reserved148" 149 "Reserved149" 150 "Reserved150" 151 "Reserved151" 152 "Reserved152" 153 "Reserved153" 154 "Reserved154" 155 "Reserved155" 156 "Reserved156" 157 "Reserved157" 158 "Reserved158" 159 "Reserved159" 160 "Reserved160" 161 "Reserved161" 162 "Reserved162" 163 "Reserved163" 164 "Reserved164" 165 "Reserved165" 166 "Reserved166" 167 "Reserved167" 168 "Reserved168" 169 "Reserved169" ;
VAL_ 244 VFC_TS13_SupSign1Type 0 "UNKNOWN" 1 "ADDCAR" 2 "ADDLORRY" 3 "ADDTRAILER" 4 "ADDCARAVAN" 5 "ADDBUS" 6 "ADDTRACTOR" 7 "ADDMCYCLE" 8 "ADDLORRYBUSTRAILER_DEPRECATED" 9 "ADDLORRYBUS_DEPRECATED" 10 "ADDHAZMAT" 11 "ADDTANK" 12 "ADDTRAM" 13 "ADDWET" 14 "ADDFOG" 15 "ADDRAIN" 16 "ADDSNOW" 17 "ADDTIME" 18 "ADDSECTION" 19 "ADDDISTANCE" 20 "ADDWEIGHT" 21 "ADDEXITL" 22 "ADDEXITR" 23 "ADDLANES" 24 "ADDRADAR" 25 "ADDRAPPEL" 26 "ADDPRIOTURN" 27 "ADDLORRY_EXCEPT" 28 "ADDTRACTOR_OVER" 29 "ADDTEXT" 30 "ADDSIGN" 31 "ADDRAINSNOW" 32 "ADDHUMP" 33 "VADDLORRYBUSTRAILER_DEPRECATED" 34 "VADDLORRYBUS_DEPRECATED" 35 "VADDLORRYTRAILER_DEPRECATED" 36 "ADDLORRYTRAILER_DEPRECATED" 37 "ADDCAMPER" 38 "ADDZONE" 39 "ADDCRASHRISK" 40 "ADDACCIDENT" 41 "ADDJAM" 42 "ADDSMOKE" 43 "ADDOILTRAIL" 44 "ADDGRAVEL" 45 "ADDDIRT" 46 "ADDRWORKSEXIT" 47 "ADDROADDAMAGE" 48 "ADDRWORKSENTRY" 49 "ADDLOWTREE" 50 "ADDRWORKSACCESS" 51 "ADDRUTS" 52 "ADDSOFTSHOULDERCAR" 53 "ADDSOFTSHOULDERLORRY" 54 "VADDSIGN" 55 "VADDCAR" 56 "VADDLORRY" 57 "VADDTRAILER" 58 "VADDCARAVAN" 59 "VADDBUS" 60 "VADDWET" 61 "VADDFOG" 62 "VADDRAIN" 63 "VADDSNOW" 64 "VADDRAINSNOW" 65 "VADDTEXT" 66 "VADDSECTION" 67 "VADDDISTANCE" 68 "VADDWEIGHT" 69 "VADDZONE" 70 "VADDCRASHRISK" 71 "VADDACCIDENT" 72 "VADDJAM" 73 "VADDOILTRAIL" 74 "VADDGRAVEL" 75 "VADDDIRT" 76 "VADDROADDAMAGE" 77 "VADDRUTS" 78 "ADDNOSTOPSHOULDER" 79 "ADDTOWING" 80 "ADDSCHOOL" 81 "ADDNIGHT" 82 "ADDEND" 83 "ADDBEGINS" 84 "ADDWITHIN" 85 "ADDDISTANCEBARS" 86 "ADDMINIMUM" 87 "ADDADVICE" 88 "ADDACCESS" 89 "ADDALLWAY" 90 "ADDBUS_EXCEPT" 91 "ADDEXCEPTDELIVERY" 92 "ADDEXCEPTLOCAL" 93 "ADDFROG" 94 "ADDPRIOTURNL" 95 "ADDPRIOTURNR" 96 "ADDSTART" 97 "ADDSTOPIN" 98 "ADDEXIT" 99 "ADDHAZWATER" 100 "ADDDAY" 101 "ADDSL" 102 "ADDLORRYTRAILER" 103 "ADDLORRYSEMI" 104 "VADDLORRYTRAILER" 105 "VADDLORRYSEMI" 106 "ADDSLOW" 107 "ADDSL5" 108 "ADDSL10" 109 "ADDSL15" 110 "ADDSL20" 111 "ADDSL25" 112 "ADDSL30" 113 "ADDSL35" 114 "ADDSL40" 115 "ADDSL45" 116 "ADDSL50" 117 "ADDSL55" 118 "ADDSL60" 119 "ADDSL65" 120 "ADDSL70" 121 "ADDSL75" 122 "ADDSL80" 123 "ADDSL85" 124 "ADDSL90" 125 "ADDSL95" 126 "ADDSL100" 127 "ADDSL105" 128 "ADDSL110" 129 "ADDSL115" 130 "ADDSL120" 131 "ADDSL125" 132 "ADDSL130" 133 "ADDSL135" 134 "ADDSL140" 135 "ADDSL145" 136 "ADDSL150" 137 "ADDSL155" 138 "ADDSL160" 139 "ADDBIKEROAD" 140 "ADDLORRYTRAILER_EXCEPT" 141 "ADDLORRYSEMI_EXCEPT" 142 "Reserved142" 143 "Reserved143" 144 "Reserved144" 145 "Reserved145" 146 "Reserved146" 147 "Reserved147" 148 "Reserved148" 149 "Reserved149" 150 "Reserved150" 151 "Reserved151" 152 "Reserved152" 153 "Reserved153" 154 "Reserved154" 155 "Reserved155" 156 "Reserved156" 157 "Reserved157" 158 "Reserved158" 159 "Reserved159" 160 "Reserved160" 161 "Reserved161" 162 "Reserved162" 163 "Reserved163" 164 "Reserved164" 165 "Reserved165" 166 "Reserved166" 167 "Reserved167" 168 "Reserved168" 169 "Reserved169" ;
VAL_ 244 VFC_TS13_SupSign2Type 0 "UNKNOWN" 1 "ADDCAR" 2 "ADDLORRY" 3 "ADDTRAILER" 4 "ADDCARAVAN" 5 "ADDBUS" 6 "ADDTRACTOR" 7 "ADDMCYCLE" 8 "ADDLORRYBUSTRAILER_DEPRECATED" 9 "ADDLORRYBUS_DEPRECATED" 10 "ADDHAZMAT" 11 "ADDTANK" 12 "ADDTRAM" 13 "ADDWET" 14 "ADDFOG" 15 "ADDRAIN" 16 "ADDSNOW" 17 "ADDTIME" 18 "ADDSECTION" 19 "ADDDISTANCE" 20 "ADDWEIGHT" 21 "ADDEXITL" 22 "ADDEXITR" 23 "ADDLANES" 24 "ADDRADAR" 25 "ADDRAPPEL" 26 "ADDPRIOTURN" 27 "ADDLORRY_EXCEPT" 28 "ADDTRACTOR_OVER" 29 "ADDTEXT" 30 "ADDSIGN" 31 "ADDRAINSNOW" 32 "ADDHUMP" 33 "VADDLORRYBUSTRAILER_DEPRECATED" 34 "VADDLORRYBUS_DEPRECATED" 35 "VADDLORRYTRAILER_DEPRECATED" 36 "ADDLORRYTRAILER_DEPRECATED" 37 "ADDCAMPER" 38 "ADDZONE" 39 "ADDCRASHRISK" 40 "ADDACCIDENT" 41 "ADDJAM" 42 "ADDSMOKE" 43 "ADDOILTRAIL" 44 "ADDGRAVEL" 45 "ADDDIRT" 46 "ADDRWORKSEXIT" 47 "ADDROADDAMAGE" 48 "ADDRWORKSENTRY" 49 "ADDLOWTREE" 50 "ADDRWORKSACCESS" 51 "ADDRUTS" 52 "ADDSOFTSHOULDERCAR" 53 "ADDSOFTSHOULDERLORRY" 54 "VADDSIGN" 55 "VADDCAR" 56 "VADDLORRY" 57 "VADDTRAILER" 58 "VADDCARAVAN" 59 "VADDBUS" 60 "VADDWET" 61 "VADDFOG" 62 "VADDRAIN" 63 "VADDSNOW" 64 "VADDRAINSNOW" 65 "VADDTEXT" 66 "VADDSECTION" 67 "VADDDISTANCE" 68 "VADDWEIGHT" 69 "VADDZONE" 70 "VADDCRASHRISK" 71 "VADDACCIDENT" 72 "VADDJAM" 73 "VADDOILTRAIL" 74 "VADDGRAVEL" 75 "VADDDIRT" 76 "VADDROADDAMAGE" 77 "VADDRUTS" 78 "ADDNOSTOPSHOULDER" 79 "ADDTOWING" 80 "ADDSCHOOL" 81 "ADDNIGHT" 82 "ADDEND" 83 "ADDBEGINS" 84 "ADDWITHIN" 85 "ADDDISTANCEBARS" 86 "ADDMINIMUM" 87 "ADDADVICE" 88 "ADDACCESS" 89 "ADDALLWAY" 90 "ADDBUS_EXCEPT" 91 "ADDEXCEPTDELIVERY" 92 "ADDEXCEPTLOCAL" 93 "ADDFROG" 94 "ADDPRIOTURNL" 95 "ADDPRIOTURNR" 96 "ADDSTART" 97 "ADDSTOPIN" 98 "ADDEXIT" 99 "ADDHAZWATER" 100 "ADDDAY" 101 "ADDSL" 102 "ADDLORRYTRAILER" 103 "ADDLORRYSEMI" 104 "VADDLORRYTRAILER" 105 "VADDLORRYSEMI" 106 "ADDSLOW" 107 "ADDSL5" 108 "ADDSL10" 109 "ADDSL15" 110 "ADDSL20" 111 "ADDSL25" 112 "ADDSL30" 113 "ADDSL35" 114 "ADDSL40" 115 "ADDSL45" 116 "ADDSL50" 117 "ADDSL55" 118 "ADDSL60" 119 "ADDSL65" 120 "ADDSL70" 121 "ADDSL75" 122 "ADDSL80" 123 "ADDSL85" 124 "ADDSL90" 125 "ADDSL95" 126 "ADDSL100" 127 "ADDSL105" 128 "ADDSL110" 129 "ADDSL115" 130 "ADDSL120" 131 "ADDSL125" 132 "ADDSL130" 133 "ADDSL135" 134 "ADDSL140" 135 "ADDSL145" 136 "ADDSL150" 137 "ADDSL155" 138 "ADDSL160" 139 "ADDBIKEROAD" 140 "ADDLORRYTRAILER_EXCEPT" 141 "ADDLORRYSEMI_EXCEPT" 142 "Reserved142" 143 "Reserved143" 144 "Reserved144" 145 "Reserved145" 146 "Reserved146" 147 "Reserved147" 148 "Reserved148" 149 "Reserved149" 150 "Reserved150" 151 "Reserved151" 152 "Reserved152" 153 "Reserved153" 154 "Reserved154" 155 "Reserved155" 156 "Reserved156" 157 "Reserved157" 158 "Reserved158" 159 "Reserved159" 160 "Reserved160" 161 "Reserved161" 162 "Reserved162" 163 "Reserved163" 164 "Reserved164" 165 "Reserved165" 166 "Reserved166" 167 "Reserved167" 168 "Reserved168" 169 "Reserved169" ;
VAL_ 244 VFC_TS13_SupSign3Type 0 "UNKNOWN" 1 "ADDCAR" 2 "ADDLORRY" 3 "ADDTRAILER" 4 "ADDCARAVAN" 5 "ADDBUS" 6 "ADDTRACTOR" 7 "ADDMCYCLE" 8 "ADDLORRYBUSTRAILER_DEPRECATED" 9 "ADDLORRYBUS_DEPRECATED" 10 "ADDHAZMAT" 11 "ADDTANK" 12 "ADDTRAM" 13 "ADDWET" 14 "ADDFOG" 15 "ADDRAIN" 16 "ADDSNOW" 17 "ADDTIME" 18 "ADDSECTION" 19 "ADDDISTANCE" 20 "ADDWEIGHT" 21 "ADDEXITL" 22 "ADDEXITR" 23 "ADDLANES" 24 "ADDRADAR" 25 "ADDRAPPEL" 26 "ADDPRIOTURN" 27 "ADDLORRY_EXCEPT" 28 "ADDTRACTOR_OVER" 29 "ADDTEXT" 30 "ADDSIGN" 31 "ADDRAINSNOW" 32 "ADDHUMP" 33 "VADDLORRYBUSTRAILER_DEPRECATED" 34 "VADDLORRYBUS_DEPRECATED" 35 "VADDLORRYTRAILER_DEPRECATED" 36 "ADDLORRYTRAILER_DEPRECATED" 37 "ADDCAMPER" 38 "ADDZONE" 39 "ADDCRASHRISK" 40 "ADDACCIDENT" 41 "ADDJAM" 42 "ADDSMOKE" 43 "ADDOILTRAIL" 44 "ADDGRAVEL" 45 "ADDDIRT" 46 "ADDRWORKSEXIT" 47 "ADDROADDAMAGE" 48 "ADDRWORKSENTRY" 49 "ADDLOWTREE" 50 "ADDRWORKSACCESS" 51 "ADDRUTS" 52 "ADDSOFTSHOULDERCAR" 53 "ADDSOFTSHOULDERLORRY" 54 "VADDSIGN" 55 "VADDCAR" 56 "VADDLORRY" 57 "VADDTRAILER" 58 "VADDCARAVAN" 59 "VADDBUS" 60 "VADDWET" 61 "VADDFOG" 62 "VADDRAIN" 63 "VADDSNOW" 64 "VADDRAINSNOW" 65 "VADDTEXT" 66 "VADDSECTION" 67 "VADDDISTANCE" 68 "VADDWEIGHT" 69 "VADDZONE" 70 "VADDCRASHRISK" 71 "VADDACCIDENT" 72 "VADDJAM" 73 "VADDOILTRAIL" 74 "VADDGRAVEL" 75 "VADDDIRT" 76 "VADDROADDAMAGE" 77 "VADDRUTS" 78 "ADDNOSTOPSHOULDER" 79 "ADDTOWING" 80 "ADDSCHOOL" 81 "ADDNIGHT" 82 "ADDEND" 83 "ADDBEGINS" 84 "ADDWITHIN" 85 "ADDDISTANCEBARS" 86 "ADDMINIMUM" 87 "ADDADVICE" 88 "ADDACCESS" 89 "ADDALLWAY" 90 "ADDBUS_EXCEPT" 91 "ADDEXCEPTDELIVERY" 92 "ADDEXCEPTLOCAL" 93 "ADDFROG" 94 "ADDPRIOTURNL" 95 "ADDPRIOTURNR" 96 "ADDSTART" 97 "ADDSTOPIN" 98 "ADDEXIT" 99 "ADDHAZWATER" 100 "ADDDAY" 101 "ADDSL" 102 "ADDLORRYTRAILER" 103 "ADDLORRYSEMI" 104 "VADDLORRYTRAILER" 105 "VADDLORRYSEMI" 106 "ADDSLOW" 107 "ADDSL5" 108 "ADDSL10" 109 "ADDSL15" 110 "ADDSL20" 111 "ADDSL25" 112 "ADDSL30" 113 "ADDSL35" 114 "ADDSL40" 115 "ADDSL45" 116 "ADDSL50" 117 "ADDSL55" 118 "ADDSL60" 119 "ADDSL65" 120 "ADDSL70" 121 "ADDSL75" 122 "ADDSL80" 123 "ADDSL85" 124 "ADDSL90" 125 "ADDSL95" 126 "ADDSL100" 127 "ADDSL105" 128 "ADDSL110" 129 "ADDSL115" 130 "ADDSL120" 131 "ADDSL125" 132 "ADDSL130" 133 "ADDSL135" 134 "ADDSL140" 135 "ADDSL145" 136 "ADDSL150" 137 "ADDSL155" 138 "ADDSL160" 139 "ADDBIKEROAD" 140 "ADDLORRYTRAILER_EXCEPT" 141 "ADDLORRYSEMI_EXCEPT" 142 "Reserved142" 143 "Reserved143" 144 "Reserved144" 145 "Reserved145" 146 "Reserved146" 147 "Reserved147" 148 "Reserved148" 149 "Reserved149" 150 "Reserved150" 151 "Reserved151" 152 "Reserved152" 153 "Reserved153" 154 "Reserved154" 155 "Reserved155" 156 "Reserved156" 157 "Reserved157" 158 "Reserved158" 159 "Reserved159" 160 "Reserved160" 161 "Reserved161" 162 "Reserved162" 163 "Reserved163" 164 "Reserved164" 165 "Reserved165" 166 "Reserved166" 167 "Reserved167" 168 "Reserved168" 169 "Reserved169" ;
VAL_ 244 VFC_TS13_SupSign4Type 0 "UNKNOWN" 1 "ADDCAR" 2 "ADDLORRY" 3 "ADDTRAILER" 4 "ADDCARAVAN" 5 "ADDBUS" 6 "ADDTRACTOR" 7 "ADDMCYCLE" 8 "ADDLORRYBUSTRAILER_DEPRECATED" 9 "ADDLORRYBUS_DEPRECATED" 10 "ADDHAZMAT" 11 "ADDTANK" 12 "ADDTRAM" 13 "ADDWET" 14 "ADDFOG" 15 "ADDRAIN" 16 "ADDSNOW" 17 "ADDTIME" 18 "ADDSECTION" 19 "ADDDISTANCE" 20 "ADDWEIGHT" 21 "ADDEXITL" 22 "ADDEXITR" 23 "ADDLANES" 24 "ADDRADAR" 25 "ADDRAPPEL" 26 "ADDPRIOTURN" 27 "ADDLORRY_EXCEPT" 28 "ADDTRACTOR_OVER" 29 "ADDTEXT" 30 "ADDSIGN" 31 "ADDRAINSNOW" 32 "ADDHUMP" 33 "VADDLORRYBUSTRAILER_DEPRECATED" 34 "VADDLORRYBUS_DEPRECATED" 35 "VADDLORRYTRAILER_DEPRECATED" 36 "ADDLORRYTRAILER_DEPRECATED" 37 "ADDCAMPER" 38 "ADDZONE" 39 "ADDCRASHRISK" 40 "ADDACCIDENT" 41 "ADDJAM" 42 "ADDSMOKE" 43 "ADDOILTRAIL" 44 "ADDGRAVEL" 45 "ADDDIRT" 46 "ADDRWORKSEXIT" 47 "ADDROADDAMAGE" 48 "ADDRWORKSENTRY" 49 "ADDLOWTREE" 50 "ADDRWORKSACCESS" 51 "ADDRUTS" 52 "ADDSOFTSHOULDERCAR" 53 "ADDSOFTSHOULDERLORRY" 54 "VADDSIGN" 55 "VADDCAR" 56 "VADDLORRY" 57 "VADDTRAILER" 58 "VADDCARAVAN" 59 "VADDBUS" 60 "VADDWET" 61 "VADDFOG" 62 "VADDRAIN" 63 "VADDSNOW" 64 "VADDRAINSNOW" 65 "VADDTEXT" 66 "VADDSECTION" 67 "VADDDISTANCE" 68 "VADDWEIGHT" 69 "VADDZONE" 70 "VADDCRASHRISK" 71 "VADDACCIDENT" 72 "VADDJAM" 73 "VADDOILTRAIL" 74 "VADDGRAVEL" 75 "VADDDIRT" 76 "VADDROADDAMAGE" 77 "VADDRUTS" 78 "ADDNOSTOPSHOULDER" 79 "ADDTOWING" 80 "ADDSCHOOL" 81 "ADDNIGHT" 82 "ADDEND" 83 "ADDBEGINS" 84 "ADDWITHIN" 85 "ADDDISTANCEBARS" 86 "ADDMINIMUM" 87 "ADDADVICE" 88 "ADDACCESS" 89 "ADDALLWAY" 90 "ADDBUS_EXCEPT" 91 "ADDEXCEPTDELIVERY" 92 "ADDEXCEPTLOCAL" 93 "ADDFROG" 94 "ADDPRIOTURNL" 95 "ADDPRIOTURNR" 96 "ADDSTART" 97 "ADDSTOPIN" 98 "ADDEXIT" 99 "ADDHAZWATER" 100 "ADDDAY" 101 "ADDSL" 102 "ADDLORRYTRAILER" 103 "ADDLORRYSEMI" 104 "VADDLORRYTRAILER" 105 "VADDLORRYSEMI" 106 "ADDSLOW" 107 "ADDSL5" 108 "ADDSL10" 109 "ADDSL15" 110 "ADDSL20" 111 "ADDSL25" 112 "ADDSL30" 113 "ADDSL35" 114 "ADDSL40" 115 "ADDSL45" 116 "ADDSL50" 117 "ADDSL55" 118 "ADDSL60" 119 "ADDSL65" 120 "ADDSL70" 121 "ADDSL75" 122 "ADDSL80" 123 "ADDSL85" 124 "ADDSL90" 125 "ADDSL95" 126 "ADDSL100" 127 "ADDSL105" 128 "ADDSL110" 129 "ADDSL115" 130 "ADDSL120" 131 "ADDSL125" 132 "ADDSL130" 133 "ADDSL135" 134 "ADDSL140" 135 "ADDSL145" 136 "ADDSL150" 137 "ADDSL155" 138 "ADDSL160" 139 "ADDBIKEROAD" 140 "ADDLORRYTRAILER_EXCEPT" 141 "ADDLORRYSEMI_EXCEPT" 142 "Reserved142" 143 "Reserved143" 144 "Reserved144" 145 "Reserved145" 146 "Reserved146" 147 "Reserved147" 148 "Reserved148" 149 "Reserved149" 150 "Reserved150" 151 "Reserved151" 152 "Reserved152" 153 "Reserved153" 154 "Reserved154" 155 "Reserved155" 156 "Reserved156" 157 "Reserved157" 158 "Reserved158" 159 "Reserved159" 160 "Reserved160" 161 "Reserved161" 162 "Reserved162" 163 "Reserved163" 164 "Reserved164" 165 "Reserved165" 166 "Reserved166" 167 "Reserved167" 168 "Reserved168" 169 "Reserved169" ;
VAL_ 244 VFC_TS13_SupSign5Type 0 "UNKNOWN" 1 "ADDCAR" 2 "ADDLORRY" 3 "ADDTRAILER" 4 "ADDCARAVAN" 5 "ADDBUS" 6 "ADDTRACTOR" 7 "ADDMCYCLE" 8 "ADDLORRYBUSTRAILER_DEPRECATED" 9 "ADDLORRYBUS_DEPRECATED" 10 "ADDHAZMAT" 11 "ADDTANK" 12 "ADDTRAM" 13 "ADDWET" 14 "ADDFOG" 15 "ADDRAIN" 16 "ADDSNOW" 17 "ADDTIME" 18 "ADDSECTION" 19 "ADDDISTANCE" 20 "ADDWEIGHT" 21 "ADDEXITL" 22 "ADDEXITR" 23 "ADDLANES" 24 "ADDRADAR" 25 "ADDRAPPEL" 26 "ADDPRIOTURN" 27 "ADDLORRY_EXCEPT" 28 "ADDTRACTOR_OVER" 29 "ADDTEXT" 30 "ADDSIGN" 31 "ADDRAINSNOW" 32 "ADDHUMP" 33 "VADDLORRYBUSTRAILER_DEPRECATED" 34 "VADDLORRYBUS_DEPRECATED" 35 "VADDLORRYTRAILER_DEPRECATED" 36 "ADDLORRYTRAILER_DEPRECATED" 37 "ADDCAMPER" 38 "ADDZONE" 39 "ADDCRASHRISK" 40 "ADDACCIDENT" 41 "ADDJAM" 42 "ADDSMOKE" 43 "ADDOILTRAIL" 44 "ADDGRAVEL" 45 "ADDDIRT" 46 "ADDRWORKSEXIT" 47 "ADDROADDAMAGE" 48 "ADDRWORKSENTRY" 49 "ADDLOWTREE" 50 "ADDRWORKSACCESS" 51 "ADDRUTS" 52 "ADDSOFTSHOULDERCAR" 53 "ADDSOFTSHOULDERLORRY" 54 "VADDSIGN" 55 "VADDCAR" 56 "VADDLORRY" 57 "VADDTRAILER" 58 "VADDCARAVAN" 59 "VADDBUS" 60 "VADDWET" 61 "VADDFOG" 62 "VADDRAIN" 63 "VADDSNOW" 64 "VADDRAINSNOW" 65 "VADDTEXT" 66 "VADDSECTION" 67 "VADDDISTANCE" 68 "VADDWEIGHT" 69 "VADDZONE" 70 "VADDCRASHRISK" 71 "VADDACCIDENT" 72 "VADDJAM" 73 "VADDOILTRAIL" 74 "VADDGRAVEL" 75 "VADDDIRT" 76 "VADDROADDAMAGE" 77 "VADDRUTS" 78 "ADDNOSTOPSHOULDER" 79 "ADDTOWING" 80 "ADDSCHOOL" 81 "ADDNIGHT" 82 "ADDEND" 83 "ADDBEGINS" 84 "ADDWITHIN" 85 "ADDDISTANCEBARS" 86 "ADDMINIMUM" 87 "ADDADVICE" 88 "ADDACCESS" 89 "ADDALLWAY" 90 "ADDBUS_EXCEPT" 91 "ADDEXCEPTDELIVERY" 92 "ADDEXCEPTLOCAL" 93 "ADDFROG" 94 "ADDPRIOTURNL" 95 "ADDPRIOTURNR" 96 "ADDSTART" 97 "ADDSTOPIN" 98 "ADDEXIT" 99 "ADDHAZWATER" 100 "ADDDAY" 101 "ADDSL" 102 "ADDLORRYTRAILER" 103 "ADDLORRYSEMI" 104 "VADDLORRYTRAILER" 105 "VADDLORRYSEMI" 106 "ADDSLOW" 107 "ADDSL5" 108 "ADDSL10" 109 "ADDSL15" 110 "ADDSL20" 111 "ADDSL25" 112 "ADDSL30" 113 "ADDSL35" 114 "ADDSL40" 115 "ADDSL45" 116 "ADDSL50" 117 "ADDSL55" 118 "ADDSL60" 119 "ADDSL65" 120 "ADDSL70" 121 "ADDSL75" 122 "ADDSL80" 123 "ADDSL85" 124 "ADDSL90" 125 "ADDSL95" 126 "ADDSL100" 127 "ADDSL105" 128 "ADDSL110" 129 "ADDSL115" 130 "ADDSL120" 131 "ADDSL125" 132 "ADDSL130" 133 "ADDSL135" 134 "ADDSL140" 135 "ADDSL145" 136 "ADDSL150" 137 "ADDSL155" 138 "ADDSL160" 139 "ADDBIKEROAD" 140 "ADDLORRYTRAILER_EXCEPT" 141 "ADDLORRYSEMI_EXCEPT" 142 "Reserved142" 143 "Reserved143" 144 "Reserved144" 145 "Reserved145" 146 "Reserved146" 147 "Reserved147" 148 "Reserved148" 149 "Reserved149" 150 "Reserved150" 151 "Reserved151" 152 "Reserved152" 153 "Reserved153" 154 "Reserved154" 155 "Reserved155" 156 "Reserved156" 157 "Reserved157" 158 "Reserved158" 159 "Reserved159" 160 "Reserved160" 161 "Reserved161" 162 "Reserved162" 163 "Reserved163" 164 "Reserved164" 165 "Reserved165" 166 "Reserved166" 167 "Reserved167" 168 "Reserved168" 169 "Reserved169" ;
VAL_ 245 VFC_TS14_Type 0 "UNKNOWN" 1 "SL5" 2 "SL10" 3 "SL15" 4 "SL20" 5 "SL25" 6 "SL30" 7 "SL35" 8 "SL40" 9 "SL45" 10 "SL50" 11 "SL55" 12 "SL60" 13 "SL65" 14 "SL70" 15 "SL75" 16 "SL80" 17 "SL85" 18 "SL90" 19 "SL95" 20 "SL100" 21 "SL105" 22 "SL110" 23 "SL115" 24 "SL120" 25 "SL125" 26 "SL130" 27 "SL135" 28 "SL140" 29 "SL145" 30 "SL150" 31 "SL155" 32 "SL160" 33 "OP" 34 "OL" 35 "ESL" 36 "EOP" 37 "EOL" 38 "EA" 39 "VSL5" 40 "VSL10" 41 "VSL15" 42 "VSL20" 43 "VSL25" 44 "VSL30" 45 "VSL35" 46 "VSL40" 47 "VSL45" 48 "VSL50" 49 "VSL55" 50 "VSL60" 51 "VSL65" 52 "VSL70" 53 "VSL75" 54 "VSL80" 55 "VSL85" 56 "VSL90" 57 "VSL95" 58 "VSL100" 59 "VSL105" 60 "VSL110" 61 "VSL115" 62 "VSL120" 63 "VSL125" 64 "VSL130" 65 "VSL135" 66 "VSL140" 67 "VSL145" 68 "VSL150" 69 "VSL155" 70 "VSL160" 71 "VOP" 72 "VOL" 73 "VESL" 74 "VEOP" 75 "VEOL" 76 "VEA" 77 "NOENTRY" 78 "NOALL" 79 "NOCAR" 80 "NOLORRY" 81 "NOHAZMAT" 82 "NOBIKE" 83 "NOPED" 84 "NOCARBIKE" 85 "NOTWOWAY" 86 "WEIGHT" 87 "HEIGHT" 88 "WIDTH" 89 "LENGTH" 90 "PRIOCROSS" 91 "GIVEWAY" 92 "PRIOCROSSYIELDTORIGHT" 93 "WARNDANGER" 94 "WARNCURVEL" 95 "WARNCURVER" 96 "WARNDCURVEL" 97 "WARNDCURVER" 98 "WARNTRAIN" 99 "WARNJAM" 100 "WARNANIMAL_DEPRECATED" 101 "WARNRWORKS" 102 "WARNSLOPED" 103 "WARNSLOPEU" 104 "PRIOSTREET" 105 "EPRIOSTREET" 106 "STOP" 107 "ASL" 108 "EASL" 109 "MSL" 110 "EMSL" 111 "MLC" 112 "WBDIAGL" 113 "WBDIAGR" 114 "WBROUND" 115 "NOLTURN" 116 "NORTURN" 117 "NOUTURN" 118 "NOPARK" 119 "NOSTOP" 120 "SMOG" 121 "UMWELT" 122 "EUMWELT" 123 "DOUANE" 124 "FWAY" 125 "EFWAY" 126 "HWAY" 127 "EHWAY" 128 "NORIDER" 129 "WARNCONST" 130 "WARNCONSTL" 131 "WARNCONSTR" 132 "WARNPED" 133 "WARNKIDS" 134 "WARNBIKE" 135 "WARNSKID" 136 "ZEBRA" 137 "ONEWAYS" 138 "ONEWAYU" 139 "SLOWDOWN" 140 "NOCARRIAGE" 141 "NOLORRYTRAILER" 142 "NOBUS" 143 "NOTRACTOR" 144 "LORRYDIST" 145 "CARDIST" 146 "WARNROUND" 147 "WARNWILDANIMAL" 148 "WARNCATTLE" 149 "WARNFROG" 150 "WARNBUS" 151 "WARNWIND" 152 "WARNSNOW" 153 "WARNPCROSS" 154 "WARNHUMP" 155 "WARNROCK" 156 "WARNLOWTREE" 157 "WARNGRAVEL" 158 "WARNTWOWAY" 159 "WARNLIGHTS" 160 "WARNPLANE" 161 "VNOENTRY" 162 "VNOALL" 163 "VNOCAR" 164 "VNOLORRY" 165 "VNOCARBIKE" 166 "VWEIGHT" 167 "VHEIGHT" 168 "VWIDTH" 169 "VLENGTH" 170 "VWARNDANGER" 171 "VWARNJAM" 172 "VWARNRWORKS" 173 "VWARNSKID" 174 "VASL" 175 "VEASL" 176 "VNOLORRYTRAILER" 177 "VNOBUS" 178 "VLORRYDIST" 179 "VCARDIST" 180 "VWARNSNOW" 181 "VWARNHUMP" 182 "VWARNGRAVEL" 183 "CALM" 184 "ECALM" 185 "TWN" 186 "ETWN" 187 "DEADEND" 188 "AXLEWEIGHT" 189 "WARNRIDER" 190 "WARNDRAWBRIDGE" 191 "WARNPIER" 192 "TRINATURE" 193 "VWARNCONST" 194 "VWARNCONSTL" 195 "VWARNCONSTR" 196 "VWARNCURVEL" 197 "VWARNCURVER" 198 "VWARNDCURVEL" 199 "VWARNDCURVER" 200 "VWARNLIGHTS" 201 "WBBENTLEFT" 202 "WBBENTLEFTRIGHT" 203 "WBBENTRIGHT" 204 "WBDIAGLR" 205 "WBLEFT" 206 "WBRIGHT" 207 "WBUP" 208 "WBUPLEFT" 209 "WBUPRIGHT" 210 "WBHAZWATER" 211 "NOHAZWATER" 212 "SCHOOL" 213 "ESCHOOL" 214 "HAZMAT" 215 "EMERGENCYBAY" 216 "ENDOFLANEL" 217 "ENDOFLANER" 218 "ENOPARK" 219 "EONEWAY" 220 "EPARK" 221 "ETOLL" 222 "NOPARKL" 223 "NOPARKLR" 224 "NOPARKR" 225 "NOSTOPL" 226 "NOSTOPLR" 227 "NOSTOPR" 228 "NOTURNONRED" 229 "ONEWAYL" 230 "ONEWAYR" 231 "PARK" 232 "PRIOCROSSL" 233 "PRIOCROSSR" 234 "TOLL" 235 "TUNNEL" 236 "TWOWAY" 237 "WARNCROSS" 238 "WARNCROSSL" 239 "WARNCROSSLR" 240 "WARNCROSSR" 241 "WARNCROSSRL" 242 "WARNCROSST" 243 "WARNGIVEWAYAHEAD" 244 "WARNSLAHEAD" 245 "WARNSTOPAHEAD" 246 "WBBUS" 247 "WRONGWAY" 248 "HAZWATER" 249 "GIVEWAYROUND" 250 "WARNWINDINGL" 251 "WARNWINDINGR" 252 "WARNHAIRPINL" 253 "WARNHAIRPINR" 254 "WARNPEDBIKE" 255 "WARNCROSSY" 256 "WARNBRANCHL" 257 "WARNBRANCHR" 258 "WARNAXLEWEIGHT" 259 "WARNWEIGHT" 260 "WARNHEIGHT" 261 "WARNLENGTH" 262 "WARNWIDTH" 263 "WARNBLACKSPOT" 264 "WARNMERGEL" 265 "WARNMERGER" 266 "WARNTUNNEL" 267 "WARNTRACTOR" 268 "WARNRWORKSVEHICLE" 269 "WARNNARROWBRIDGE" 270 "WARNFLAGGER" 271 "LANES" 272 "LANESHIFTL" 273 "LANESHIFTR" 274 "NEWLANEL" 275 "NEWLANER" 276 "RIGHTTURNONRED" 277 "BORDERLIMIT" 278 "EMBEDDEDRAIN" 279 "VWARNWEIGHT" 280 "VWARNHEIGHT" 281 "VWARNLENGTH" 282 "VWARNWIDTH" 283 "VENDOFLANEL" 284 "VENDOFLANER" 285 "VLANES" 286 "VLANESHIFTL" 287 "VLANESHIFTR" 288 "VNEWLANEL" 289 "VNEWLANER" 290 "NOUP" 291 "VOFF" 292 "ASL5" 293 "ASL10" 294 "ASL15" 295 "ASL20" 296 "ASL25" 297 "ASL30" 298 "ASL35" 299 "ASL40" 300 "ASL45" 301 "ASL50" 302 "ASL55" 303 "ASL60" 304 "ASL65" 305 "ASL70" 306 "ASL75" 307 "ASL80" 308 "ASL85" 309 "ASL90" 310 "ASL95" 311 "ASL100" 312 "ASL105" 313 "ASL110" 314 "ASL115" 315 "ASL120" 316 "ASL125" 317 "ASL130" 318 "ASL135" 319 "ASL140" 320 "ASL145" 321 "ASL150" 322 "ASL155" 323 "ASL160" 324 "VASL5" 325 "VASL10" 326 "VASL15" 327 "VASL20" 328 "VASL25" 329 "VASL30" 330 "VASL35" 331 "VASL40" 332 "VASL45" 333 "VASL50" 334 "VASL55" 335 "VASL60" 336 "VASL65" 337 "VASL70" 338 "VASL75" 339 "VASL80" 340 "VASL85" 341 "VASL90" 342 "VASL95" 343 "VASL100" 344 "VASL105" 345 "VASL110" 346 "VASL115" 347 "VASL120" 348 "VASL125" 349 "VASL130" 350 "VASL135" 351 "VASL140" 352 "VASL145" 353 "VASL150" 354 "VASL155" 355 "VASL160" 356 "WARNTRAINGATED" 357 "KEEPRIGHTCAR" 358 "ASLCURVE5" 359 "ASLCURVE10" 360 "ASLCURVE15" 361 "ASLCURVE20" 362 "ASLCURVE25" 363 "ASLCURVE30" 364 "ASLCURVE35" 365 "ASLCURVE40" 366 "ASLCURVE45" 367 "ASLCURVE50" 368 "ASLCURVE55" 369 "ASLCURVE60" 370 "ASLCURVE65" 371 "ASLCURVE70" 372 "ASLCURVE75" 373 "ASLCURVE80" 374 "ASLCURVE85" 375 "ASLCURVE90" 376 "ASLCURVE95" 377 "ASLCURVE100" 378 "ASLCURVE105" 379 "ASLCURVE110" 380 "ASLCURVE115" 381 "ASLCURVE120" 382 "ASLCURVE125" 383 "ASLCURVE130" 384 "ASLCURVE135" 385 "ASLCURVE140" 386 "ASLCURVE145" 387 "ASLCURVE150" 388 "ASLCURVE155" 389 "ASLCURVE160" 390 "KIDS" 391 "EKIDS" 392 "BIKEROAD" 393 "EBIKEROAD" 394 "PEDSTREET" 395 "EPEDSTREET" 396 "PEDBIKESTREET" 397 "EPEDBIKESTREET" 398 "EWARNKIDS" 399 "CALM20" 400 "CALM30" 401 "ECALM20" 402 "ECALM30" 403 "FWAYGREEN" 404 "TWN40" 405 "TWN50" 406 "TWN60" 407 "TWN70" 408 "ETWN40" 409 "ETWN50" 410 "ETWN60" 411 "ETWN70" 412 "WBBIKE" 413 "EWBBIKE" 414 "WBPED" 415 "EWBPED" 416 "WBPEDBIKESEP" 417 "EWBPEDBIKESEP" 418 "WBPEDBIKESHARED" 419 "EWBPEDBIKESHARED" 420 "EFWAYGREEN" 421 "Reserved0421" 422 "Reserved0422" 423 "Reserved0423" 424 "Reserved0424" 425 "Reserved0425" 426 "Reserved0426" 427 "Reserved0427" 428 "Reserved0428" 429 "Reserved0429" 430 "Reserved0430" 431 "Reserved0431" 432 "Reserved0432" 433 "Reserved0433" 434 "Reserved0434" 435 "Reserved0435" 436 "Reserved0436" 437 "Reserved0437" 438 "Reserved0438" 439 "Reserved0439" 440 "Reserved0440" 441 "Reserved0441" 442 "Reserved0442" 443 "Reserved0443" 444 "Reserved0444" 445 "Reserved0445" 446 "Reserved0446" 447 "Reserved0447" 448 "Reserved0448" 449 "Reserved0449" ;
VAL_ 245 VFC_TS14_EmbeddedInfo 0 "Unknown" 1 "Not Embedded" 2 "Border Limit" 3 "Multi Lane" 4 "Rain" 5 "Vehicle Type" 6 "Plate" 7 "Error Value" 8 "Vehicle Sticker" 9 "Reserved09" 10 "Reserved10" 11 "Reserved11" 12 "Reserved12" 13 "Reserved13" 14 "Reserved14" 15 "Reserved15" ;
VAL_ 245 VFC_TS14_ValidTimeRange1Start 127 "Unknown" ;
VAL_ 245 VFC_TS14_ValidTimeRange1End 127 "Unknown" ;
VAL_ 245 VFC_TS14_ValidTimeRange2Start 127 "Unknown" ;
VAL_ 245 VFC_TS14_ValidTimeRange2End 127 "Unknown" ;
VAL_ 245 VFC_TS14_ValidInDistUnit 0 "Unknown" ;
VAL_ 245 VFC_TS14_ValidSectionUnit 0 "Unknown" 1 "Meter" 2 "Kilometer" 3 "Foot" 4 "Yard" 5 "Mile" 6 "Reserved6" 7 "Reserved7" ;
VAL_ 245 VFC_TS14_SupSign0Type 0 "UNKNOWN" 1 "ADDCAR" 2 "ADDLORRY" 3 "ADDTRAILER" 4 "ADDCARAVAN" 5 "ADDBUS" 6 "ADDTRACTOR" 7 "ADDMCYCLE" 8 "ADDLORRYBUSTRAILER_DEPRECATED" 9 "ADDLORRYBUS_DEPRECATED" 10 "ADDHAZMAT" 11 "ADDTANK" 12 "ADDTRAM" 13 "ADDWET" 14 "ADDFOG" 15 "ADDRAIN" 16 "ADDSNOW" 17 "ADDTIME" 18 "ADDSECTION" 19 "ADDDISTANCE" 20 "ADDWEIGHT" 21 "ADDEXITL" 22 "ADDEXITR" 23 "ADDLANES" 24 "ADDRADAR" 25 "ADDRAPPEL" 26 "ADDPRIOTURN" 27 "ADDLORRY_EXCEPT" 28 "ADDTRACTOR_OVER" 29 "ADDTEXT" 30 "ADDSIGN" 31 "ADDRAINSNOW" 32 "ADDHUMP" 33 "VADDLORRYBUSTRAILER_DEPRECATED" 34 "VADDLORRYBUS_DEPRECATED" 35 "VADDLORRYTRAILER_DEPRECATED" 36 "ADDLORRYTRAILER_DEPRECATED" 37 "ADDCAMPER" 38 "ADDZONE" 39 "ADDCRASHRISK" 40 "ADDACCIDENT" 41 "ADDJAM" 42 "ADDSMOKE" 43 "ADDOILTRAIL" 44 "ADDGRAVEL" 45 "ADDDIRT" 46 "ADDRWORKSEXIT" 47 "ADDROADDAMAGE" 48 "ADDRWORKSENTRY" 49 "ADDLOWTREE" 50 "ADDRWORKSACCESS" 51 "ADDRUTS" 52 "ADDSOFTSHOULDERCAR" 53 "ADDSOFTSHOULDERLORRY" 54 "VADDSIGN" 55 "VADDCAR" 56 "VADDLORRY" 57 "VADDTRAILER" 58 "VADDCARAVAN" 59 "VADDBUS" 60 "VADDWET" 61 "VADDFOG" 62 "VADDRAIN" 63 "VADDSNOW" 64 "VADDRAINSNOW" 65 "VADDTEXT" 66 "VADDSECTION" 67 "VADDDISTANCE" 68 "VADDWEIGHT" 69 "VADDZONE" 70 "VADDCRASHRISK" 71 "VADDACCIDENT" 72 "VADDJAM" 73 "VADDOILTRAIL" 74 "VADDGRAVEL" 75 "VADDDIRT" 76 "VADDROADDAMAGE" 77 "VADDRUTS" 78 "ADDNOSTOPSHOULDER" 79 "ADDTOWING" 80 "ADDSCHOOL" 81 "ADDNIGHT" 82 "ADDEND" 83 "ADDBEGINS" 84 "ADDWITHIN" 85 "ADDDISTANCEBARS" 86 "ADDMINIMUM" 87 "ADDADVICE" 88 "ADDACCESS" 89 "ADDALLWAY" 90 "ADDBUS_EXCEPT" 91 "ADDEXCEPTDELIVERY" 92 "ADDEXCEPTLOCAL" 93 "ADDFROG" 94 "ADDPRIOTURNL" 95 "ADDPRIOTURNR" 96 "ADDSTART" 97 "ADDSTOPIN" 98 "ADDEXIT" 99 "ADDHAZWATER" 100 "ADDDAY" 101 "ADDSL" 102 "ADDLORRYTRAILER" 103 "ADDLORRYSEMI" 104 "VADDLORRYTRAILER" 105 "VADDLORRYSEMI" 106 "ADDSLOW" 107 "ADDSL5" 108 "ADDSL10" 109 "ADDSL15" 110 "ADDSL20" 111 "ADDSL25" 112 "ADDSL30" 113 "ADDSL35" 114 "ADDSL40" 115 "ADDSL45" 116 "ADDSL50" 117 "ADDSL55" 118 "ADDSL60" 119 "ADDSL65" 120 "ADDSL70" 121 "ADDSL75" 122 "ADDSL80" 123 "ADDSL85" 124 "ADDSL90" 125 "ADDSL95" 126 "ADDSL100" 127 "ADDSL105" 128 "ADDSL110" 129 "ADDSL115" 130 "ADDSL120" 131 "ADDSL125" 132 "ADDSL130" 133 "ADDSL135" 134 "ADDSL140" 135 "ADDSL145" 136 "ADDSL150" 137 "ADDSL155" 138 "ADDSL160" 139 "ADDBIKEROAD" 140 "ADDLORRYTRAILER_EXCEPT" 141 "ADDLORRYSEMI_EXCEPT" 142 "Reserved142" 143 "Reserved143" 144 "Reserved144" 145 "Reserved145" 146 "Reserved146" 147 "Reserved147" 148 "Reserved148" 149 "Reserved149" 150 "Reserved150" 151 "Reserved151" 152 "Reserved152" 153 "Reserved153" 154 "Reserved154" 155 "Reserved155" 156 "Reserved156" 157 "Reserved157" 158 "Reserved158" 159 "Reserved159" 160 "Reserved160" 161 "Reserved161" 162 "Reserved162" 163 "Reserved163" 164 "Reserved164" 165 "Reserved165" 166 "Reserved166" 167 "Reserved167" 168 "Reserved168" 169 "Reserved169" ;
VAL_ 245 VFC_TS14_SupSign1Type 0 "UNKNOWN" 1 "ADDCAR" 2 "ADDLORRY" 3 "ADDTRAILER" 4 "ADDCARAVAN" 5 "ADDBUS" 6 "ADDTRACTOR" 7 "ADDMCYCLE" 8 "ADDLORRYBUSTRAILER_DEPRECATED" 9 "ADDLORRYBUS_DEPRECATED" 10 "ADDHAZMAT" 11 "ADDTANK" 12 "ADDTRAM" 13 "ADDWET" 14 "ADDFOG" 15 "ADDRAIN" 16 "ADDSNOW" 17 "ADDTIME" 18 "ADDSECTION" 19 "ADDDISTANCE" 20 "ADDWEIGHT" 21 "ADDEXITL" 22 "ADDEXITR" 23 "ADDLANES" 24 "ADDRADAR" 25 "ADDRAPPEL" 26 "ADDPRIOTURN" 27 "ADDLORRY_EXCEPT" 28 "ADDTRACTOR_OVER" 29 "ADDTEXT" 30 "ADDSIGN" 31 "ADDRAINSNOW" 32 "ADDHUMP" 33 "VADDLORRYBUSTRAILER_DEPRECATED" 34 "VADDLORRYBUS_DEPRECATED" 35 "VADDLORRYTRAILER_DEPRECATED" 36 "ADDLORRYTRAILER_DEPRECATED" 37 "ADDCAMPER" 38 "ADDZONE" 39 "ADDCRASHRISK" 40 "ADDACCIDENT" 41 "ADDJAM" 42 "ADDSMOKE" 43 "ADDOILTRAIL" 44 "ADDGRAVEL" 45 "ADDDIRT" 46 "ADDRWORKSEXIT" 47 "ADDROADDAMAGE" 48 "ADDRWORKSENTRY" 49 "ADDLOWTREE" 50 "ADDRWORKSACCESS" 51 "ADDRUTS" 52 "ADDSOFTSHOULDERCAR" 53 "ADDSOFTSHOULDERLORRY" 54 "VADDSIGN" 55 "VADDCAR" 56 "VADDLORRY" 57 "VADDTRAILER" 58 "VADDCARAVAN" 59 "VADDBUS" 60 "VADDWET" 61 "VADDFOG" 62 "VADDRAIN" 63 "VADDSNOW" 64 "VADDRAINSNOW" 65 "VADDTEXT" 66 "VADDSECTION" 67 "VADDDISTANCE" 68 "VADDWEIGHT" 69 "VADDZONE" 70 "VADDCRASHRISK" 71 "VADDACCIDENT" 72 "VADDJAM" 73 "VADDOILTRAIL" 74 "VADDGRAVEL" 75 "VADDDIRT" 76 "VADDROADDAMAGE" 77 "VADDRUTS" 78 "ADDNOSTOPSHOULDER" 79 "ADDTOWING" 80 "ADDSCHOOL" 81 "ADDNIGHT" 82 "ADDEND" 83 "ADDBEGINS" 84 "ADDWITHIN" 85 "ADDDISTANCEBARS" 86 "ADDMINIMUM" 87 "ADDADVICE" 88 "ADDACCESS" 89 "ADDALLWAY" 90 "ADDBUS_EXCEPT" 91 "ADDEXCEPTDELIVERY" 92 "ADDEXCEPTLOCAL" 93 "ADDFROG" 94 "ADDPRIOTURNL" 95 "ADDPRIOTURNR" 96 "ADDSTART" 97 "ADDSTOPIN" 98 "ADDEXIT" 99 "ADDHAZWATER" 100 "ADDDAY" 101 "ADDSL" 102 "ADDLORRYTRAILER" 103 "ADDLORRYSEMI" 104 "VADDLORRYTRAILER" 105 "VADDLORRYSEMI" 106 "ADDSLOW" 107 "ADDSL5" 108 "ADDSL10" 109 "ADDSL15" 110 "ADDSL20" 111 "ADDSL25" 112 "ADDSL30" 113 "ADDSL35" 114 "ADDSL40" 115 "ADDSL45" 116 "ADDSL50" 117 "ADDSL55" 118 "ADDSL60" 119 "ADDSL65" 120 "ADDSL70" 121 "ADDSL75" 122 "ADDSL80" 123 "ADDSL85" 124 "ADDSL90" 125 "ADDSL95" 126 "ADDSL100" 127 "ADDSL105" 128 "ADDSL110" 129 "ADDSL115" 130 "ADDSL120" 131 "ADDSL125" 132 "ADDSL130" 133 "ADDSL135" 134 "ADDSL140" 135 "ADDSL145" 136 "ADDSL150" 137 "ADDSL155" 138 "ADDSL160" 139 "ADDBIKEROAD" 140 "ADDLORRYTRAILER_EXCEPT" 141 "ADDLORRYSEMI_EXCEPT" 142 "Reserved142" 143 "Reserved143" 144 "Reserved144" 145 "Reserved145" 146 "Reserved146" 147 "Reserved147" 148 "Reserved148" 149 "Reserved149" 150 "Reserved150" 151 "Reserved151" 152 "Reserved152" 153 "Reserved153" 154 "Reserved154" 155 "Reserved155" 156 "Reserved156" 157 "Reserved157" 158 "Reserved158" 159 "Reserved159" 160 "Reserved160" 161 "Reserved161" 162 "Reserved162" 163 "Reserved163" 164 "Reserved164" 165 "Reserved165" 166 "Reserved166" 167 "Reserved167" 168 "Reserved168" 169 "Reserved169" ;
VAL_ 245 VFC_TS14_SupSign2Type 0 "UNKNOWN" 1 "ADDCAR" 2 "ADDLORRY" 3 "ADDTRAILER" 4 "ADDCARAVAN" 5 "ADDBUS" 6 "ADDTRACTOR" 7 "ADDMCYCLE" 8 "ADDLORRYBUSTRAILER_DEPRECATED" 9 "ADDLORRYBUS_DEPRECATED" 10 "ADDHAZMAT" 11 "ADDTANK" 12 "ADDTRAM" 13 "ADDWET" 14 "ADDFOG" 15 "ADDRAIN" 16 "ADDSNOW" 17 "ADDTIME" 18 "ADDSECTION" 19 "ADDDISTANCE" 20 "ADDWEIGHT" 21 "ADDEXITL" 22 "ADDEXITR" 23 "ADDLANES" 24 "ADDRADAR" 25 "ADDRAPPEL" 26 "ADDPRIOTURN" 27 "ADDLORRY_EXCEPT" 28 "ADDTRACTOR_OVER" 29 "ADDTEXT" 30 "ADDSIGN" 31 "ADDRAINSNOW" 32 "ADDHUMP" 33 "VADDLORRYBUSTRAILER_DEPRECATED" 34 "VADDLORRYBUS_DEPRECATED" 35 "VADDLORRYTRAILER_DEPRECATED" 36 "ADDLORRYTRAILER_DEPRECATED" 37 "ADDCAMPER" 38 "ADDZONE" 39 "ADDCRASHRISK" 40 "ADDACCIDENT" 41 "ADDJAM" 42 "ADDSMOKE" 43 "ADDOILTRAIL" 44 "ADDGRAVEL" 45 "ADDDIRT" 46 "ADDRWORKSEXIT" 47 "ADDROADDAMAGE" 48 "ADDRWORKSENTRY" 49 "ADDLOWTREE" 50 "ADDRWORKSACCESS" 51 "ADDRUTS" 52 "ADDSOFTSHOULDERCAR" 53 "ADDSOFTSHOULDERLORRY" 54 "VADDSIGN" 55 "VADDCAR" 56 "VADDLORRY" 57 "VADDTRAILER" 58 "VADDCARAVAN" 59 "VADDBUS" 60 "VADDWET" 61 "VADDFOG" 62 "VADDRAIN" 63 "VADDSNOW" 64 "VADDRAINSNOW" 65 "VADDTEXT" 66 "VADDSECTION" 67 "VADDDISTANCE" 68 "VADDWEIGHT" 69 "VADDZONE" 70 "VADDCRASHRISK" 71 "VADDACCIDENT" 72 "VADDJAM" 73 "VADDOILTRAIL" 74 "VADDGRAVEL" 75 "VADDDIRT" 76 "VADDROADDAMAGE" 77 "VADDRUTS" 78 "ADDNOSTOPSHOULDER" 79 "ADDTOWING" 80 "ADDSCHOOL" 81 "ADDNIGHT" 82 "ADDEND" 83 "ADDBEGINS" 84 "ADDWITHIN" 85 "ADDDISTANCEBARS" 86 "ADDMINIMUM" 87 "ADDADVICE" 88 "ADDACCESS" 89 "ADDALLWAY" 90 "ADDBUS_EXCEPT" 91 "ADDEXCEPTDELIVERY" 92 "ADDEXCEPTLOCAL" 93 "ADDFROG" 94 "ADDPRIOTURNL" 95 "ADDPRIOTURNR" 96 "ADDSTART" 97 "ADDSTOPIN" 98 "ADDEXIT" 99 "ADDHAZWATER" 100 "ADDDAY" 101 "ADDSL" 102 "ADDLORRYTRAILER" 103 "ADDLORRYSEMI" 104 "VADDLORRYTRAILER" 105 "VADDLORRYSEMI" 106 "ADDSLOW" 107 "ADDSL5" 108 "ADDSL10" 109 "ADDSL15" 110 "ADDSL20" 111 "ADDSL25" 112 "ADDSL30" 113 "ADDSL35" 114 "ADDSL40" 115 "ADDSL45" 116 "ADDSL50" 117 "ADDSL55" 118 "ADDSL60" 119 "ADDSL65" 120 "ADDSL70" 121 "ADDSL75" 122 "ADDSL80" 123 "ADDSL85" 124 "ADDSL90" 125 "ADDSL95" 126 "ADDSL100" 127 "ADDSL105" 128 "ADDSL110" 129 "ADDSL115" 130 "ADDSL120" 131 "ADDSL125" 132 "ADDSL130" 133 "ADDSL135" 134 "ADDSL140" 135 "ADDSL145" 136 "ADDSL150" 137 "ADDSL155" 138 "ADDSL160" 139 "ADDBIKEROAD" 140 "ADDLORRYTRAILER_EXCEPT" 141 "ADDLORRYSEMI_EXCEPT" 142 "Reserved142" 143 "Reserved143" 144 "Reserved144" 145 "Reserved145" 146 "Reserved146" 147 "Reserved147" 148 "Reserved148" 149 "Reserved149" 150 "Reserved150" 151 "Reserved151" 152 "Reserved152" 153 "Reserved153" 154 "Reserved154" 155 "Reserved155" 156 "Reserved156" 157 "Reserved157" 158 "Reserved158" 159 "Reserved159" 160 "Reserved160" 161 "Reserved161" 162 "Reserved162" 163 "Reserved163" 164 "Reserved164" 165 "Reserved165" 166 "Reserved166" 167 "Reserved167" 168 "Reserved168" 169 "Reserved169" ;
VAL_ 245 VFC_TS14_SupSign3Type 0 "UNKNOWN" 1 "ADDCAR" 2 "ADDLORRY" 3 "ADDTRAILER" 4 "ADDCARAVAN" 5 "ADDBUS" 6 "ADDTRACTOR" 7 "ADDMCYCLE" 8 "ADDLORRYBUSTRAILER_DEPRECATED" 9 "ADDLORRYBUS_DEPRECATED" 10 "ADDHAZMAT" 11 "ADDTANK" 12 "ADDTRAM" 13 "ADDWET" 14 "ADDFOG" 15 "ADDRAIN" 16 "ADDSNOW" 17 "ADDTIME" 18 "ADDSECTION" 19 "ADDDISTANCE" 20 "ADDWEIGHT" 21 "ADDEXITL" 22 "ADDEXITR" 23 "ADDLANES" 24 "ADDRADAR" 25 "ADDRAPPEL" 26 "ADDPRIOTURN" 27 "ADDLORRY_EXCEPT" 28 "ADDTRACTOR_OVER" 29 "ADDTEXT" 30 "ADDSIGN" 31 "ADDRAINSNOW" 32 "ADDHUMP" 33 "VADDLORRYBUSTRAILER_DEPRECATED" 34 "VADDLORRYBUS_DEPRECATED" 35 "VADDLORRYTRAILER_DEPRECATED" 36 "ADDLORRYTRAILER_DEPRECATED" 37 "ADDCAMPER" 38 "ADDZONE" 39 "ADDCRASHRISK" 40 "ADDACCIDENT" 41 "ADDJAM" 42 "ADDSMOKE" 43 "ADDOILTRAIL" 44 "ADDGRAVEL" 45 "ADDDIRT" 46 "ADDRWORKSEXIT" 47 "ADDROADDAMAGE" 48 "ADDRWORKSENTRY" 49 "ADDLOWTREE" 50 "ADDRWORKSACCESS" 51 "ADDRUTS" 52 "ADDSOFTSHOULDERCAR" 53 "ADDSOFTSHOULDERLORRY" 54 "VADDSIGN" 55 "VADDCAR" 56 "VADDLORRY" 57 "VADDTRAILER" 58 "VADDCARAVAN" 59 "VADDBUS" 60 "VADDWET" 61 "VADDFOG" 62 "VADDRAIN" 63 "VADDSNOW" 64 "VADDRAINSNOW" 65 "VADDTEXT" 66 "VADDSECTION" 67 "VADDDISTANCE" 68 "VADDWEIGHT" 69 "VADDZONE" 70 "VADDCRASHRISK" 71 "VADDACCIDENT" 72 "VADDJAM" 73 "VADDOILTRAIL" 74 "VADDGRAVEL" 75 "VADDDIRT" 76 "VADDROADDAMAGE" 77 "VADDRUTS" 78 "ADDNOSTOPSHOULDER" 79 "ADDTOWING" 80 "ADDSCHOOL" 81 "ADDNIGHT" 82 "ADDEND" 83 "ADDBEGINS" 84 "ADDWITHIN" 85 "ADDDISTANCEBARS" 86 "ADDMINIMUM" 87 "ADDADVICE" 88 "ADDACCESS" 89 "ADDALLWAY" 90 "ADDBUS_EXCEPT" 91 "ADDEXCEPTDELIVERY" 92 "ADDEXCEPTLOCAL" 93 "ADDFROG" 94 "ADDPRIOTURNL" 95 "ADDPRIOTURNR" 96 "ADDSTART" 97 "ADDSTOPIN" 98 "ADDEXIT" 99 "ADDHAZWATER" 100 "ADDDAY" 101 "ADDSL" 102 "ADDLORRYTRAILER" 103 "ADDLORRYSEMI" 104 "VADDLORRYTRAILER" 105 "VADDLORRYSEMI" 106 "ADDSLOW" 107 "ADDSL5" 108 "ADDSL10" 109 "ADDSL15" 110 "ADDSL20" 111 "ADDSL25" 112 "ADDSL30" 113 "ADDSL35" 114 "ADDSL40" 115 "ADDSL45" 116 "ADDSL50" 117 "ADDSL55" 118 "ADDSL60" 119 "ADDSL65" 120 "ADDSL70" 121 "ADDSL75" 122 "ADDSL80" 123 "ADDSL85" 124 "ADDSL90" 125 "ADDSL95" 126 "ADDSL100" 127 "ADDSL105" 128 "ADDSL110" 129 "ADDSL115" 130 "ADDSL120" 131 "ADDSL125" 132 "ADDSL130" 133 "ADDSL135" 134 "ADDSL140" 135 "ADDSL145" 136 "ADDSL150" 137 "ADDSL155" 138 "ADDSL160" 139 "ADDBIKEROAD" 140 "ADDLORRYTRAILER_EXCEPT" 141 "ADDLORRYSEMI_EXCEPT" 142 "Reserved142" 143 "Reserved143" 144 "Reserved144" 145 "Reserved145" 146 "Reserved146" 147 "Reserved147" 148 "Reserved148" 149 "Reserved149" 150 "Reserved150" 151 "Reserved151" 152 "Reserved152" 153 "Reserved153" 154 "Reserved154" 155 "Reserved155" 156 "Reserved156" 157 "Reserved157" 158 "Reserved158" 159 "Reserved159" 160 "Reserved160" 161 "Reserved161" 162 "Reserved162" 163 "Reserved163" 164 "Reserved164" 165 "Reserved165" 166 "Reserved166" 167 "Reserved167" 168 "Reserved168" 169 "Reserved169" ;
VAL_ 245 VFC_TS14_SupSign4Type 0 "UNKNOWN" 1 "ADDCAR" 2 "ADDLORRY" 3 "ADDTRAILER" 4 "ADDCARAVAN" 5 "ADDBUS" 6 "ADDTRACTOR" 7 "ADDMCYCLE" 8 "ADDLORRYBUSTRAILER_DEPRECATED" 9 "ADDLORRYBUS_DEPRECATED" 10 "ADDHAZMAT" 11 "ADDTANK" 12 "ADDTRAM" 13 "ADDWET" 14 "ADDFOG" 15 "ADDRAIN" 16 "ADDSNOW" 17 "ADDTIME" 18 "ADDSECTION" 19 "ADDDISTANCE" 20 "ADDWEIGHT" 21 "ADDEXITL" 22 "ADDEXITR" 23 "ADDLANES" 24 "ADDRADAR" 25 "ADDRAPPEL" 26 "ADDPRIOTURN" 27 "ADDLORRY_EXCEPT" 28 "ADDTRACTOR_OVER" 29 "ADDTEXT" 30 "ADDSIGN" 31 "ADDRAINSNOW" 32 "ADDHUMP" 33 "VADDLORRYBUSTRAILER_DEPRECATED" 34 "VADDLORRYBUS_DEPRECATED" 35 "VADDLORRYTRAILER_DEPRECATED" 36 "ADDLORRYTRAILER_DEPRECATED" 37 "ADDCAMPER" 38 "ADDZONE" 39 "ADDCRASHRISK" 40 "ADDACCIDENT" 41 "ADDJAM" 42 "ADDSMOKE" 43 "ADDOILTRAIL" 44 "ADDGRAVEL" 45 "ADDDIRT" 46 "ADDRWORKSEXIT" 47 "ADDROADDAMAGE" 48 "ADDRWORKSENTRY" 49 "ADDLOWTREE" 50 "ADDRWORKSACCESS" 51 "ADDRUTS" 52 "ADDSOFTSHOULDERCAR" 53 "ADDSOFTSHOULDERLORRY" 54 "VADDSIGN" 55 "VADDCAR" 56 "VADDLORRY" 57 "VADDTRAILER" 58 "VADDCARAVAN" 59 "VADDBUS" 60 "VADDWET" 61 "VADDFOG" 62 "VADDRAIN" 63 "VADDSNOW" 64 "VADDRAINSNOW" 65 "VADDTEXT" 66 "VADDSECTION" 67 "VADDDISTANCE" 68 "VADDWEIGHT" 69 "VADDZONE" 70 "VADDCRASHRISK" 71 "VADDACCIDENT" 72 "VADDJAM" 73 "VADDOILTRAIL" 74 "VADDGRAVEL" 75 "VADDDIRT" 76 "VADDROADDAMAGE" 77 "VADDRUTS" 78 "ADDNOSTOPSHOULDER" 79 "ADDTOWING" 80 "ADDSCHOOL" 81 "ADDNIGHT" 82 "ADDEND" 83 "ADDBEGINS" 84 "ADDWITHIN" 85 "ADDDISTANCEBARS" 86 "ADDMINIMUM" 87 "ADDADVICE" 88 "ADDACCESS" 89 "ADDALLWAY" 90 "ADDBUS_EXCEPT" 91 "ADDEXCEPTDELIVERY" 92 "ADDEXCEPTLOCAL" 93 "ADDFROG" 94 "ADDPRIOTURNL" 95 "ADDPRIOTURNR" 96 "ADDSTART" 97 "ADDSTOPIN" 98 "ADDEXIT" 99 "ADDHAZWATER" 100 "ADDDAY" 101 "ADDSL" 102 "ADDLORRYTRAILER" 103 "ADDLORRYSEMI" 104 "VADDLORRYTRAILER" 105 "VADDLORRYSEMI" 106 "ADDSLOW" 107 "ADDSL5" 108 "ADDSL10" 109 "ADDSL15" 110 "ADDSL20" 111 "ADDSL25" 112 "ADDSL30" 113 "ADDSL35" 114 "ADDSL40" 115 "ADDSL45" 116 "ADDSL50" 117 "ADDSL55" 118 "ADDSL60" 119 "ADDSL65" 120 "ADDSL70" 121 "ADDSL75" 122 "ADDSL80" 123 "ADDSL85" 124 "ADDSL90" 125 "ADDSL95" 126 "ADDSL100" 127 "ADDSL105" 128 "ADDSL110" 129 "ADDSL115" 130 "ADDSL120" 131 "ADDSL125" 132 "ADDSL130" 133 "ADDSL135" 134 "ADDSL140" 135 "ADDSL145" 136 "ADDSL150" 137 "ADDSL155" 138 "ADDSL160" 139 "ADDBIKEROAD" 140 "ADDLORRYTRAILER_EXCEPT" 141 "ADDLORRYSEMI_EXCEPT" 142 "Reserved142" 143 "Reserved143" 144 "Reserved144" 145 "Reserved145" 146 "Reserved146" 147 "Reserved147" 148 "Reserved148" 149 "Reserved149" 150 "Reserved150" 151 "Reserved151" 152 "Reserved152" 153 "Reserved153" 154 "Reserved154" 155 "Reserved155" 156 "Reserved156" 157 "Reserved157" 158 "Reserved158" 159 "Reserved159" 160 "Reserved160" 161 "Reserved161" 162 "Reserved162" 163 "Reserved163" 164 "Reserved164" 165 "Reserved165" 166 "Reserved166" 167 "Reserved167" 168 "Reserved168" 169 "Reserved169" ;
VAL_ 245 VFC_TS14_SupSign5Type 0 "UNKNOWN" 1 "ADDCAR" 2 "ADDLORRY" 3 "ADDTRAILER" 4 "ADDCARAVAN" 5 "ADDBUS" 6 "ADDTRACTOR" 7 "ADDMCYCLE" 8 "ADDLORRYBUSTRAILER_DEPRECATED" 9 "ADDLORRYBUS_DEPRECATED" 10 "ADDHAZMAT" 11 "ADDTANK" 12 "ADDTRAM" 13 "ADDWET" 14 "ADDFOG" 15 "ADDRAIN" 16 "ADDSNOW" 17 "ADDTIME" 18 "ADDSECTION" 19 "ADDDISTANCE" 20 "ADDWEIGHT" 21 "ADDEXITL" 22 "ADDEXITR" 23 "ADDLANES" 24 "ADDRADAR" 25 "ADDRAPPEL" 26 "ADDPRIOTURN" 27 "ADDLORRY_EXCEPT" 28 "ADDTRACTOR_OVER" 29 "ADDTEXT" 30 "ADDSIGN" 31 "ADDRAINSNOW" 32 "ADDHUMP" 33 "VADDLORRYBUSTRAILER_DEPRECATED" 34 "VADDLORRYBUS_DEPRECATED" 35 "VADDLORRYTRAILER_DEPRECATED" 36 "ADDLORRYTRAILER_DEPRECATED" 37 "ADDCAMPER" 38 "ADDZONE" 39 "ADDCRASHRISK" 40 "ADDACCIDENT" 41 "ADDJAM" 42 "ADDSMOKE" 43 "ADDOILTRAIL" 44 "ADDGRAVEL" 45 "ADDDIRT" 46 "ADDRWORKSEXIT" 47 "ADDROADDAMAGE" 48 "ADDRWORKSENTRY" 49 "ADDLOWTREE" 50 "ADDRWORKSACCESS" 51 "ADDRUTS" 52 "ADDSOFTSHOULDERCAR" 53 "ADDSOFTSHOULDERLORRY" 54 "VADDSIGN" 55 "VADDCAR" 56 "VADDLORRY" 57 "VADDTRAILER" 58 "VADDCARAVAN" 59 "VADDBUS" 60 "VADDWET" 61 "VADDFOG" 62 "VADDRAIN" 63 "VADDSNOW" 64 "VADDRAINSNOW" 65 "VADDTEXT" 66 "VADDSECTION" 67 "VADDDISTANCE" 68 "VADDWEIGHT" 69 "VADDZONE" 70 "VADDCRASHRISK" 71 "VADDACCIDENT" 72 "VADDJAM" 73 "VADDOILTRAIL" 74 "VADDGRAVEL" 75 "VADDDIRT" 76 "VADDROADDAMAGE" 77 "VADDRUTS" 78 "ADDNOSTOPSHOULDER" 79 "ADDTOWING" 80 "ADDSCHOOL" 81 "ADDNIGHT" 82 "ADDEND" 83 "ADDBEGINS" 84 "ADDWITHIN" 85 "ADDDISTANCEBARS" 86 "ADDMINIMUM" 87 "ADDADVICE" 88 "ADDACCESS" 89 "ADDALLWAY" 90 "ADDBUS_EXCEPT" 91 "ADDEXCEPTDELIVERY" 92 "ADDEXCEPTLOCAL" 93 "ADDFROG" 94 "ADDPRIOTURNL" 95 "ADDPRIOTURNR" 96 "ADDSTART" 97 "ADDSTOPIN" 98 "ADDEXIT" 99 "ADDHAZWATER" 100 "ADDDAY" 101 "ADDSL" 102 "ADDLORRYTRAILER" 103 "ADDLORRYSEMI" 104 "VADDLORRYTRAILER" 105 "VADDLORRYSEMI" 106 "ADDSLOW" 107 "ADDSL5" 108 "ADDSL10" 109 "ADDSL15" 110 "ADDSL20" 111 "ADDSL25" 112 "ADDSL30" 113 "ADDSL35" 114 "ADDSL40" 115 "ADDSL45" 116 "ADDSL50" 117 "ADDSL55" 118 "ADDSL60" 119 "ADDSL65" 120 "ADDSL70" 121 "ADDSL75" 122 "ADDSL80" 123 "ADDSL85" 124 "ADDSL90" 125 "ADDSL95" 126 "ADDSL100" 127 "ADDSL105" 128 "ADDSL110" 129 "ADDSL115" 130 "ADDSL120" 131 "ADDSL125" 132 "ADDSL130" 133 "ADDSL135" 134 "ADDSL140" 135 "ADDSL145" 136 "ADDSL150" 137 "ADDSL155" 138 "ADDSL160" 139 "ADDBIKEROAD" 140 "ADDLORRYTRAILER_EXCEPT" 141 "ADDLORRYSEMI_EXCEPT" 142 "Reserved142" 143 "Reserved143" 144 "Reserved144" 145 "Reserved145" 146 "Reserved146" 147 "Reserved147" 148 "Reserved148" 149 "Reserved149" 150 "Reserved150" 151 "Reserved151" 152 "Reserved152" 153 "Reserved153" 154 "Reserved154" 155 "Reserved155" 156 "Reserved156" 157 "Reserved157" 158 "Reserved158" 159 "Reserved159" 160 "Reserved160" 161 "Reserved161" 162 "Reserved162" 163 "Reserved163" 164 "Reserved164" 165 "Reserved165" 166 "Reserved166" 167 "Reserved167" 168 "Reserved168" 169 "Reserved169" ;
VAL_ 245 VFC_TS15_Type 0 "UNKNOWN" 1 "SL5" 2 "SL10" 3 "SL15" 4 "SL20" 5 "SL25" 6 "SL30" 7 "SL35" 8 "SL40" 9 "SL45" 10 "SL50" 11 "SL55" 12 "SL60" 13 "SL65" 14 "SL70" 15 "SL75" 16 "SL80" 17 "SL85" 18 "SL90" 19 "SL95" 20 "SL100" 21 "SL105" 22 "SL110" 23 "SL115" 24 "SL120" 25 "SL125" 26 "SL130" 27 "SL135" 28 "SL140" 29 "SL145" 30 "SL150" 31 "SL155" 32 "SL160" 33 "OP" 34 "OL" 35 "ESL" 36 "EOP" 37 "EOL" 38 "EA" 39 "VSL5" 40 "VSL10" 41 "VSL15" 42 "VSL20" 43 "VSL25" 44 "VSL30" 45 "VSL35" 46 "VSL40" 47 "VSL45" 48 "VSL50" 49 "VSL55" 50 "VSL60" 51 "VSL65" 52 "VSL70" 53 "VSL75" 54 "VSL80" 55 "VSL85" 56 "VSL90" 57 "VSL95" 58 "VSL100" 59 "VSL105" 60 "VSL110" 61 "VSL115" 62 "VSL120" 63 "VSL125" 64 "VSL130" 65 "VSL135" 66 "VSL140" 67 "VSL145" 68 "VSL150" 69 "VSL155" 70 "VSL160" 71 "VOP" 72 "VOL" 73 "VESL" 74 "VEOP" 75 "VEOL" 76 "VEA" 77 "NOENTRY" 78 "NOALL" 79 "NOCAR" 80 "NOLORRY" 81 "NOHAZMAT" 82 "NOBIKE" 83 "NOPED" 84 "NOCARBIKE" 85 "NOTWOWAY" 86 "WEIGHT" 87 "HEIGHT" 88 "WIDTH" 89 "LENGTH" 90 "PRIOCROSS" 91 "GIVEWAY" 92 "PRIOCROSSYIELDTORIGHT" 93 "WARNDANGER" 94 "WARNCURVEL" 95 "WARNCURVER" 96 "WARNDCURVEL" 97 "WARNDCURVER" 98 "WARNTRAIN" 99 "WARNJAM" 100 "WARNANIMAL_DEPRECATED" 101 "WARNRWORKS" 102 "WARNSLOPED" 103 "WARNSLOPEU" 104 "PRIOSTREET" 105 "EPRIOSTREET" 106 "STOP" 107 "ASL" 108 "EASL" 109 "MSL" 110 "EMSL" 111 "MLC" 112 "WBDIAGL" 113 "WBDIAGR" 114 "WBROUND" 115 "NOLTURN" 116 "NORTURN" 117 "NOUTURN" 118 "NOPARK" 119 "NOSTOP" 120 "SMOG" 121 "UMWELT" 122 "EUMWELT" 123 "DOUANE" 124 "FWAY" 125 "EFWAY" 126 "HWAY" 127 "EHWAY" 128 "NORIDER" 129 "WARNCONST" 130 "WARNCONSTL" 131 "WARNCONSTR" 132 "WARNPED" 133 "WARNKIDS" 134 "WARNBIKE" 135 "WARNSKID" 136 "ZEBRA" 137 "ONEWAYS" 138 "ONEWAYU" 139 "SLOWDOWN" 140 "NOCARRIAGE" 141 "NOLORRYTRAILER" 142 "NOBUS" 143 "NOTRACTOR" 144 "LORRYDIST" 145 "CARDIST" 146 "WARNROUND" 147 "WARNWILDANIMAL" 148 "WARNCATTLE" 149 "WARNFROG" 150 "WARNBUS" 151 "WARNWIND" 152 "WARNSNOW" 153 "WARNPCROSS" 154 "WARNHUMP" 155 "WARNROCK" 156 "WARNLOWTREE" 157 "WARNGRAVEL" 158 "WARNTWOWAY" 159 "WARNLIGHTS" 160 "WARNPLANE" 161 "VNOENTRY" 162 "VNOALL" 163 "VNOCAR" 164 "VNOLORRY" 165 "VNOCARBIKE" 166 "VWEIGHT" 167 "VHEIGHT" 168 "VWIDTH" 169 "VLENGTH" 170 "VWARNDANGER" 171 "VWARNJAM" 172 "VWARNRWORKS" 173 "VWARNSKID" 174 "VASL" 175 "VEASL" 176 "VNOLORRYTRAILER" 177 "VNOBUS" 178 "VLORRYDIST" 179 "VCARDIST" 180 "VWARNSNOW" 181 "VWARNHUMP" 182 "VWARNGRAVEL" 183 "CALM" 184 "ECALM" 185 "TWN" 186 "ETWN" 187 "DEADEND" 188 "AXLEWEIGHT" 189 "WARNRIDER" 190 "WARNDRAWBRIDGE" 191 "WARNPIER" 192 "TRINATURE" 193 "VWARNCONST" 194 "VWARNCONSTL" 195 "VWARNCONSTR" 196 "VWARNCURVEL" 197 "VWARNCURVER" 198 "VWARNDCURVEL" 199 "VWARNDCURVER" 200 "VWARNLIGHTS" 201 "WBBENTLEFT" 202 "WBBENTLEFTRIGHT" 203 "WBBENTRIGHT" 204 "WBDIAGLR" 205 "WBLEFT" 206 "WBRIGHT" 207 "WBUP" 208 "WBUPLEFT" 209 "WBUPRIGHT" 210 "WBHAZWATER" 211 "NOHAZWATER" 212 "SCHOOL" 213 "ESCHOOL" 214 "HAZMAT" 215 "EMERGENCYBAY" 216 "ENDOFLANEL" 217 "ENDOFLANER" 218 "ENOPARK" 219 "EONEWAY" 220 "EPARK" 221 "ETOLL" 222 "NOPARKL" 223 "NOPARKLR" 224 "NOPARKR" 225 "NOSTOPL" 226 "NOSTOPLR" 227 "NOSTOPR" 228 "NOTURNONRED" 229 "ONEWAYL" 230 "ONEWAYR" 231 "PARK" 232 "PRIOCROSSL" 233 "PRIOCROSSR" 234 "TOLL" 235 "TUNNEL" 236 "TWOWAY" 237 "WARNCROSS" 238 "WARNCROSSL" 239 "WARNCROSSLR" 240 "WARNCROSSR" 241 "WARNCROSSRL" 242 "WARNCROSST" 243 "WARNGIVEWAYAHEAD" 244 "WARNSLAHEAD" 245 "WARNSTOPAHEAD" 246 "WBBUS" 247 "WRONGWAY" 248 "HAZWATER" 249 "GIVEWAYROUND" 250 "WARNWINDINGL" 251 "WARNWINDINGR" 252 "WARNHAIRPINL" 253 "WARNHAIRPINR" 254 "WARNPEDBIKE" 255 "WARNCROSSY" 256 "WARNBRANCHL" 257 "WARNBRANCHR" 258 "WARNAXLEWEIGHT" 259 "WARNWEIGHT" 260 "WARNHEIGHT" 261 "WARNLENGTH" 262 "WARNWIDTH" 263 "WARNBLACKSPOT" 264 "WARNMERGEL" 265 "WARNMERGER" 266 "WARNTUNNEL" 267 "WARNTRACTOR" 268 "WARNRWORKSVEHICLE" 269 "WARNNARROWBRIDGE" 270 "WARNFLAGGER" 271 "LANES" 272 "LANESHIFTL" 273 "LANESHIFTR" 274 "NEWLANEL" 275 "NEWLANER" 276 "RIGHTTURNONRED" 277 "BORDERLIMIT" 278 "EMBEDDEDRAIN" 279 "VWARNWEIGHT" 280 "VWARNHEIGHT" 281 "VWARNLENGTH" 282 "VWARNWIDTH" 283 "VENDOFLANEL" 284 "VENDOFLANER" 285 "VLANES" 286 "VLANESHIFTL" 287 "VLANESHIFTR" 288 "VNEWLANEL" 289 "VNEWLANER" 290 "NOUP" 291 "VOFF" 292 "ASL5" 293 "ASL10" 294 "ASL15" 295 "ASL20" 296 "ASL25" 297 "ASL30" 298 "ASL35" 299 "ASL40" 300 "ASL45" 301 "ASL50" 302 "ASL55" 303 "ASL60" 304 "ASL65" 305 "ASL70" 306 "ASL75" 307 "ASL80" 308 "ASL85" 309 "ASL90" 310 "ASL95" 311 "ASL100" 312 "ASL105" 313 "ASL110" 314 "ASL115" 315 "ASL120" 316 "ASL125" 317 "ASL130" 318 "ASL135" 319 "ASL140" 320 "ASL145" 321 "ASL150" 322 "ASL155" 323 "ASL160" 324 "VASL5" 325 "VASL10" 326 "VASL15" 327 "VASL20" 328 "VASL25" 329 "VASL30" 330 "VASL35" 331 "VASL40" 332 "VASL45" 333 "VASL50" 334 "VASL55" 335 "VASL60" 336 "VASL65" 337 "VASL70" 338 "VASL75" 339 "VASL80" 340 "VASL85" 341 "VASL90" 342 "VASL95" 343 "VASL100" 344 "VASL105" 345 "VASL110" 346 "VASL115" 347 "VASL120" 348 "VASL125" 349 "VASL130" 350 "VASL135" 351 "VASL140" 352 "VASL145" 353 "VASL150" 354 "VASL155" 355 "VASL160" 356 "WARNTRAINGATED" 357 "KEEPRIGHTCAR" 358 "ASLCURVE5" 359 "ASLCURVE10" 360 "ASLCURVE15" 361 "ASLCURVE20" 362 "ASLCURVE25" 363 "ASLCURVE30" 364 "ASLCURVE35" 365 "ASLCURVE40" 366 "ASLCURVE45" 367 "ASLCURVE50" 368 "ASLCURVE55" 369 "ASLCURVE60" 370 "ASLCURVE65" 371 "ASLCURVE70" 372 "ASLCURVE75" 373 "ASLCURVE80" 374 "ASLCURVE85" 375 "ASLCURVE90" 376 "ASLCURVE95" 377 "ASLCURVE100" 378 "ASLCURVE105" 379 "ASLCURVE110" 380 "ASLCURVE115" 381 "ASLCURVE120" 382 "ASLCURVE125" 383 "ASLCURVE130" 384 "ASLCURVE135" 385 "ASLCURVE140" 386 "ASLCURVE145" 387 "ASLCURVE150" 388 "ASLCURVE155" 389 "ASLCURVE160" 390 "KIDS" 391 "EKIDS" 392 "BIKEROAD" 393 "EBIKEROAD" 394 "PEDSTREET" 395 "EPEDSTREET" 396 "PEDBIKESTREET" 397 "EPEDBIKESTREET" 398 "EWARNKIDS" 399 "CALM20" 400 "CALM30" 401 "ECALM20" 402 "ECALM30" 403 "FWAYGREEN" 404 "TWN40" 405 "TWN50" 406 "TWN60" 407 "TWN70" 408 "ETWN40" 409 "ETWN50" 410 "ETWN60" 411 "ETWN70" 412 "WBBIKE" 413 "EWBBIKE" 414 "WBPED" 415 "EWBPED" 416 "WBPEDBIKESEP" 417 "EWBPEDBIKESEP" 418 "WBPEDBIKESHARED" 419 "EWBPEDBIKESHARED" 420 "EFWAYGREEN" 421 "Reserved0421" 422 "Reserved0422" 423 "Reserved0423" 424 "Reserved0424" 425 "Reserved0425" 426 "Reserved0426" 427 "Reserved0427" 428 "Reserved0428" 429 "Reserved0429" 430 "Reserved0430" 431 "Reserved0431" 432 "Reserved0432" 433 "Reserved0433" 434 "Reserved0434" 435 "Reserved0435" 436 "Reserved0436" 437 "Reserved0437" 438 "Reserved0438" 439 "Reserved0439" 440 "Reserved0440" 441 "Reserved0441" 442 "Reserved0442" 443 "Reserved0443" 444 "Reserved0444" 445 "Reserved0445" 446 "Reserved0446" 447 "Reserved0447" 448 "Reserved0448" 449 "Reserved0449" ;
VAL_ 245 VFC_TS15_EmbeddedInfo 0 "Unknown" 1 "Not Embedded" 2 "Border Limit" 3 "Multi Lane" 4 "Rain" 5 "Vehicle Type" 6 "Plate" 7 "Error Value" 8 "Vehicle Sticker" 9 "Reserved09" 10 "Reserved10" 11 "Reserved11" 12 "Reserved12" 13 "Reserved13" 14 "Reserved14" 15 "Reserved15" ;
VAL_ 245 VFC_TS15_ValidTimeRange1Start 127 "Unknown" ;
VAL_ 245 VFC_TS15_ValidTimeRange1End 127 "Unknown" ;
VAL_ 245 VFC_TS15_ValidTimeRange2Start 127 "Unknown" ;
VAL_ 245 VFC_TS15_ValidTimeRange2End 127 "Unknown" ;
VAL_ 245 VFC_TS15_ValidInDistUnit 0 "Unknown" ;
VAL_ 245 VFC_TS15_ValidSectionUnit 0 "Unknown" 1 "Meter" 2 "Kilometer" 3 "Foot" 4 "Yard" 5 "Mile" 6 "Reserved6" 7 "Reserved7" ;
VAL_ 245 VFC_TS15_SupSign0Type 0 "UNKNOWN" 1 "ADDCAR" 2 "ADDLORRY" 3 "ADDTRAILER" 4 "ADDCARAVAN" 5 "ADDBUS" 6 "ADDTRACTOR" 7 "ADDMCYCLE" 8 "ADDLORRYBUSTRAILER_DEPRECATED" 9 "ADDLORRYBUS_DEPRECATED" 10 "ADDHAZMAT" 11 "ADDTANK" 12 "ADDTRAM" 13 "ADDWET" 14 "ADDFOG" 15 "ADDRAIN" 16 "ADDSNOW" 17 "ADDTIME" 18 "ADDSECTION" 19 "ADDDISTANCE" 20 "ADDWEIGHT" 21 "ADDEXITL" 22 "ADDEXITR" 23 "ADDLANES" 24 "ADDRADAR" 25 "ADDRAPPEL" 26 "ADDPRIOTURN" 27 "ADDLORRY_EXCEPT" 28 "ADDTRACTOR_OVER" 29 "ADDTEXT" 30 "ADDSIGN" 31 "ADDRAINSNOW" 32 "ADDHUMP" 33 "VADDLORRYBUSTRAILER_DEPRECATED" 34 "VADDLORRYBUS_DEPRECATED" 35 "VADDLORRYTRAILER_DEPRECATED" 36 "ADDLORRYTRAILER_DEPRECATED" 37 "ADDCAMPER" 38 "ADDZONE" 39 "ADDCRASHRISK" 40 "ADDACCIDENT" 41 "ADDJAM" 42 "ADDSMOKE" 43 "ADDOILTRAIL" 44 "ADDGRAVEL" 45 "ADDDIRT" 46 "ADDRWORKSEXIT" 47 "ADDROADDAMAGE" 48 "ADDRWORKSENTRY" 49 "ADDLOWTREE" 50 "ADDRWORKSACCESS" 51 "ADDRUTS" 52 "ADDSOFTSHOULDERCAR" 53 "ADDSOFTSHOULDERLORRY" 54 "VADDSIGN" 55 "VADDCAR" 56 "VADDLORRY" 57 "VADDTRAILER" 58 "VADDCARAVAN" 59 "VADDBUS" 60 "VADDWET" 61 "VADDFOG" 62 "VADDRAIN" 63 "VADDSNOW" 64 "VADDRAINSNOW" 65 "VADDTEXT" 66 "VADDSECTION" 67 "VADDDISTANCE" 68 "VADDWEIGHT" 69 "VADDZONE" 70 "VADDCRASHRISK" 71 "VADDACCIDENT" 72 "VADDJAM" 73 "VADDOILTRAIL" 74 "VADDGRAVEL" 75 "VADDDIRT" 76 "VADDROADDAMAGE" 77 "VADDRUTS" 78 "ADDNOSTOPSHOULDER" 79 "ADDTOWING" 80 "ADDSCHOOL" 81 "ADDNIGHT" 82 "ADDEND" 83 "ADDBEGINS" 84 "ADDWITHIN" 85 "ADDDISTANCEBARS" 86 "ADDMINIMUM" 87 "ADDADVICE" 88 "ADDACCESS" 89 "ADDALLWAY" 90 "ADDBUS_EXCEPT" 91 "ADDEXCEPTDELIVERY" 92 "ADDEXCEPTLOCAL" 93 "ADDFROG" 94 "ADDPRIOTURNL" 95 "ADDPRIOTURNR" 96 "ADDSTART" 97 "ADDSTOPIN" 98 "ADDEXIT" 99 "ADDHAZWATER" 100 "ADDDAY" 101 "ADDSL" 102 "ADDLORRYTRAILER" 103 "ADDLORRYSEMI" 104 "VADDLORRYTRAILER" 105 "VADDLORRYSEMI" 106 "ADDSLOW" 107 "ADDSL5" 108 "ADDSL10" 109 "ADDSL15" 110 "ADDSL20" 111 "ADDSL25" 112 "ADDSL30" 113 "ADDSL35" 114 "ADDSL40" 115 "ADDSL45" 116 "ADDSL50" 117 "ADDSL55" 118 "ADDSL60" 119 "ADDSL65" 120 "ADDSL70" 121 "ADDSL75" 122 "ADDSL80" 123 "ADDSL85" 124 "ADDSL90" 125 "ADDSL95" 126 "ADDSL100" 127 "ADDSL105" 128 "ADDSL110" 129 "ADDSL115" 130 "ADDSL120" 131 "ADDSL125" 132 "ADDSL130" 133 "ADDSL135" 134 "ADDSL140" 135 "ADDSL145" 136 "ADDSL150" 137 "ADDSL155" 138 "ADDSL160" 139 "ADDBIKEROAD" 140 "ADDLORRYTRAILER_EXCEPT" 141 "ADDLORRYSEMI_EXCEPT" 142 "Reserved142" 143 "Reserved143" 144 "Reserved144" 145 "Reserved145" 146 "Reserved146" 147 "Reserved147" 148 "Reserved148" 149 "Reserved149" 150 "Reserved150" 151 "Reserved151" 152 "Reserved152" 153 "Reserved153" 154 "Reserved154" 155 "Reserved155" 156 "Reserved156" 157 "Reserved157" 158 "Reserved158" 159 "Reserved159" 160 "Reserved160" 161 "Reserved161" 162 "Reserved162" 163 "Reserved163" 164 "Reserved164" 165 "Reserved165" 166 "Reserved166" 167 "Reserved167" 168 "Reserved168" 169 "Reserved169" ;
VAL_ 245 VFC_TS15_SupSign1Type 0 "UNKNOWN" 1 "ADDCAR" 2 "ADDLORRY" 3 "ADDTRAILER" 4 "ADDCARAVAN" 5 "ADDBUS" 6 "ADDTRACTOR" 7 "ADDMCYCLE" 8 "ADDLORRYBUSTRAILER_DEPRECATED" 9 "ADDLORRYBUS_DEPRECATED" 10 "ADDHAZMAT" 11 "ADDTANK" 12 "ADDTRAM" 13 "ADDWET" 14 "ADDFOG" 15 "ADDRAIN" 16 "ADDSNOW" 17 "ADDTIME" 18 "ADDSECTION" 19 "ADDDISTANCE" 20 "ADDWEIGHT" 21 "ADDEXITL" 22 "ADDEXITR" 23 "ADDLANES" 24 "ADDRADAR" 25 "ADDRAPPEL" 26 "ADDPRIOTURN" 27 "ADDLORRY_EXCEPT" 28 "ADDTRACTOR_OVER" 29 "ADDTEXT" 30 "ADDSIGN" 31 "ADDRAINSNOW" 32 "ADDHUMP" 33 "VADDLORRYBUSTRAILER_DEPRECATED" 34 "VADDLORRYBUS_DEPRECATED" 35 "VADDLORRYTRAILER_DEPRECATED" 36 "ADDLORRYTRAILER_DEPRECATED" 37 "ADDCAMPER" 38 "ADDZONE" 39 "ADDCRASHRISK" 40 "ADDACCIDENT" 41 "ADDJAM" 42 "ADDSMOKE" 43 "ADDOILTRAIL" 44 "ADDGRAVEL" 45 "ADDDIRT" 46 "ADDRWORKSEXIT" 47 "ADDROADDAMAGE" 48 "ADDRWORKSENTRY" 49 "ADDLOWTREE" 50 "ADDRWORKSACCESS" 51 "ADDRUTS" 52 "ADDSOFTSHOULDERCAR" 53 "ADDSOFTSHOULDERLORRY" 54 "VADDSIGN" 55 "VADDCAR" 56 "VADDLORRY" 57 "VADDTRAILER" 58 "VADDCARAVAN" 59 "VADDBUS" 60 "VADDWET" 61 "VADDFOG" 62 "VADDRAIN" 63 "VADDSNOW" 64 "VADDRAINSNOW" 65 "VADDTEXT" 66 "VADDSECTION" 67 "VADDDISTANCE" 68 "VADDWEIGHT" 69 "VADDZONE" 70 "VADDCRASHRISK" 71 "VADDACCIDENT" 72 "VADDJAM" 73 "VADDOILTRAIL" 74 "VADDGRAVEL" 75 "VADDDIRT" 76 "VADDROADDAMAGE" 77 "VADDRUTS" 78 "ADDNOSTOPSHOULDER" 79 "ADDTOWING" 80 "ADDSCHOOL" 81 "ADDNIGHT" 82 "ADDEND" 83 "ADDBEGINS" 84 "ADDWITHIN" 85 "ADDDISTANCEBARS" 86 "ADDMINIMUM" 87 "ADDADVICE" 88 "ADDACCESS" 89 "ADDALLWAY" 90 "ADDBUS_EXCEPT" 91 "ADDEXCEPTDELIVERY" 92 "ADDEXCEPTLOCAL" 93 "ADDFROG" 94 "ADDPRIOTURNL" 95 "ADDPRIOTURNR" 96 "ADDSTART" 97 "ADDSTOPIN" 98 "ADDEXIT" 99 "ADDHAZWATER" 100 "ADDDAY" 101 "ADDSL" 102 "ADDLORRYTRAILER" 103 "ADDLORRYSEMI" 104 "VADDLORRYTRAILER" 105 "VADDLORRYSEMI" 106 "ADDSLOW" 107 "ADDSL5" 108 "ADDSL10" 109 "ADDSL15" 110 "ADDSL20" 111 "ADDSL25" 112 "ADDSL30" 113 "ADDSL35" 114 "ADDSL40" 115 "ADDSL45" 116 "ADDSL50" 117 "ADDSL55" 118 "ADDSL60" 119 "ADDSL65" 120 "ADDSL70" 121 "ADDSL75" 122 "ADDSL80" 123 "ADDSL85" 124 "ADDSL90" 125 "ADDSL95" 126 "ADDSL100" 127 "ADDSL105" 128 "ADDSL110" 129 "ADDSL115" 130 "ADDSL120" 131 "ADDSL125" 132 "ADDSL130" 133 "ADDSL135" 134 "ADDSL140" 135 "ADDSL145" 136 "ADDSL150" 137 "ADDSL155" 138 "ADDSL160" 139 "ADDBIKEROAD" 140 "ADDLORRYTRAILER_EXCEPT" 141 "ADDLORRYSEMI_EXCEPT" 142 "Reserved142" 143 "Reserved143" 144 "Reserved144" 145 "Reserved145" 146 "Reserved146" 147 "Reserved147" 148 "Reserved148" 149 "Reserved149" 150 "Reserved150" 151 "Reserved151" 152 "Reserved152" 153 "Reserved153" 154 "Reserved154" 155 "Reserved155" 156 "Reserved156" 157 "Reserved157" 158 "Reserved158" 159 "Reserved159" 160 "Reserved160" 161 "Reserved161" 162 "Reserved162" 163 "Reserved163" 164 "Reserved164" 165 "Reserved165" 166 "Reserved166" 167 "Reserved167" 168 "Reserved168" 169 "Reserved169" ;
VAL_ 245 VFC_TS15_SupSign2Type 0 "UNKNOWN" 1 "ADDCAR" 2 "ADDLORRY" 3 "ADDTRAILER" 4 "ADDCARAVAN" 5 "ADDBUS" 6 "ADDTRACTOR" 7 "ADDMCYCLE" 8 "ADDLORRYBUSTRAILER_DEPRECATED" 9 "ADDLORRYBUS_DEPRECATED" 10 "ADDHAZMAT" 11 "ADDTANK" 12 "ADDTRAM" 13 "ADDWET" 14 "ADDFOG" 15 "ADDRAIN" 16 "ADDSNOW" 17 "ADDTIME" 18 "ADDSECTION" 19 "ADDDISTANCE" 20 "ADDWEIGHT" 21 "ADDEXITL" 22 "ADDEXITR" 23 "ADDLANES" 24 "ADDRADAR" 25 "ADDRAPPEL" 26 "ADDPRIOTURN" 27 "ADDLORRY_EXCEPT" 28 "ADDTRACTOR_OVER" 29 "ADDTEXT" 30 "ADDSIGN" 31 "ADDRAINSNOW" 32 "ADDHUMP" 33 "VADDLORRYBUSTRAILER_DEPRECATED" 34 "VADDLORRYBUS_DEPRECATED" 35 "VADDLORRYTRAILER_DEPRECATED" 36 "ADDLORRYTRAILER_DEPRECATED" 37 "ADDCAMPER" 38 "ADDZONE" 39 "ADDCRASHRISK" 40 "ADDACCIDENT" 41 "ADDJAM" 42 "ADDSMOKE" 43 "ADDOILTRAIL" 44 "ADDGRAVEL" 45 "ADDDIRT" 46 "ADDRWORKSEXIT" 47 "ADDROADDAMAGE" 48 "ADDRWORKSENTRY" 49 "ADDLOWTREE" 50 "ADDRWORKSACCESS" 51 "ADDRUTS" 52 "ADDSOFTSHOULDERCAR" 53 "ADDSOFTSHOULDERLORRY" 54 "VADDSIGN" 55 "VADDCAR" 56 "VADDLORRY" 57 "VADDTRAILER" 58 "VADDCARAVAN" 59 "VADDBUS" 60 "VADDWET" 61 "VADDFOG" 62 "VADDRAIN" 63 "VADDSNOW" 64 "VADDRAINSNOW" 65 "VADDTEXT" 66 "VADDSECTION" 67 "VADDDISTANCE" 68 "VADDWEIGHT" 69 "VADDZONE" 70 "VADDCRASHRISK" 71 "VADDACCIDENT" 72 "VADDJAM" 73 "VADDOILTRAIL" 74 "VADDGRAVEL" 75 "VADDDIRT" 76 "VADDROADDAMAGE" 77 "VADDRUTS" 78 "ADDNOSTOPSHOULDER" 79 "ADDTOWING" 80 "ADDSCHOOL" 81 "ADDNIGHT" 82 "ADDEND" 83 "ADDBEGINS" 84 "ADDWITHIN" 85 "ADDDISTANCEBARS" 86 "ADDMINIMUM" 87 "ADDADVICE" 88 "ADDACCESS" 89 "ADDALLWAY" 90 "ADDBUS_EXCEPT" 91 "ADDEXCEPTDELIVERY" 92 "ADDEXCEPTLOCAL" 93 "ADDFROG" 94 "ADDPRIOTURNL" 95 "ADDPRIOTURNR" 96 "ADDSTART" 97 "ADDSTOPIN" 98 "ADDEXIT" 99 "ADDHAZWATER" 100 "ADDDAY" 101 "ADDSL" 102 "ADDLORRYTRAILER" 103 "ADDLORRYSEMI" 104 "VADDLORRYTRAILER" 105 "VADDLORRYSEMI" 106 "ADDSLOW" 107 "ADDSL5" 108 "ADDSL10" 109 "ADDSL15" 110 "ADDSL20" 111 "ADDSL25" 112 "ADDSL30" 113 "ADDSL35" 114 "ADDSL40" 115 "ADDSL45" 116 "ADDSL50" 117 "ADDSL55" 118 "ADDSL60" 119 "ADDSL65" 120 "ADDSL70" 121 "ADDSL75" 122 "ADDSL80" 123 "ADDSL85" 124 "ADDSL90" 125 "ADDSL95" 126 "ADDSL100" 127 "ADDSL105" 128 "ADDSL110" 129 "ADDSL115" 130 "ADDSL120" 131 "ADDSL125" 132 "ADDSL130" 133 "ADDSL135" 134 "ADDSL140" 135 "ADDSL145" 136 "ADDSL150" 137 "ADDSL155" 138 "ADDSL160" 139 "ADDBIKEROAD" 140 "ADDLORRYTRAILER_EXCEPT" 141 "ADDLORRYSEMI_EXCEPT" 142 "Reserved142" 143 "Reserved143" 144 "Reserved144" 145 "Reserved145" 146 "Reserved146" 147 "Reserved147" 148 "Reserved148" 149 "Reserved149" 150 "Reserved150" 151 "Reserved151" 152 "Reserved152" 153 "Reserved153" 154 "Reserved154" 155 "Reserved155" 156 "Reserved156" 157 "Reserved157" 158 "Reserved158" 159 "Reserved159" 160 "Reserved160" 161 "Reserved161" 162 "Reserved162" 163 "Reserved163" 164 "Reserved164" 165 "Reserved165" 166 "Reserved166" 167 "Reserved167" 168 "Reserved168" 169 "Reserved169" ;
VAL_ 245 VFC_TS15_SupSign3Type 0 "UNKNOWN" 1 "ADDCAR" 2 "ADDLORRY" 3 "ADDTRAILER" 4 "ADDCARAVAN" 5 "ADDBUS" 6 "ADDTRACTOR" 7 "ADDMCYCLE" 8 "ADDLORRYBUSTRAILER_DEPRECATED" 9 "ADDLORRYBUS_DEPRECATED" 10 "ADDHAZMAT" 11 "ADDTANK" 12 "ADDTRAM" 13 "ADDWET" 14 "ADDFOG" 15 "ADDRAIN" 16 "ADDSNOW" 17 "ADDTIME" 18 "ADDSECTION" 19 "ADDDISTANCE" 20 "ADDWEIGHT" 21 "ADDEXITL" 22 "ADDEXITR" 23 "ADDLANES" 24 "ADDRADAR" 25 "ADDRAPPEL" 26 "ADDPRIOTURN" 27 "ADDLORRY_EXCEPT" 28 "ADDTRACTOR_OVER" 29 "ADDTEXT" 30 "ADDSIGN" 31 "ADDRAINSNOW" 32 "ADDHUMP" 33 "VADDLORRYBUSTRAILER_DEPRECATED" 34 "VADDLORRYBUS_DEPRECATED" 35 "VADDLORRYTRAILER_DEPRECATED" 36 "ADDLORRYTRAILER_DEPRECATED" 37 "ADDCAMPER" 38 "ADDZONE" 39 "ADDCRASHRISK" 40 "ADDACCIDENT" 41 "ADDJAM" 42 "ADDSMOKE" 43 "ADDOILTRAIL" 44 "ADDGRAVEL" 45 "ADDDIRT" 46 "ADDRWORKSEXIT" 47 "ADDROADDAMAGE" 48 "ADDRWORKSENTRY" 49 "ADDLOWTREE" 50 "ADDRWORKSACCESS" 51 "ADDRUTS" 52 "ADDSOFTSHOULDERCAR" 53 "ADDSOFTSHOULDERLORRY" 54 "VADDSIGN" 55 "VADDCAR" 56 "VADDLORRY" 57 "VADDTRAILER" 58 "VADDCARAVAN" 59 "VADDBUS" 60 "VADDWET" 61 "VADDFOG" 62 "VADDRAIN" 63 "VADDSNOW" 64 "VADDRAINSNOW" 65 "VADDTEXT" 66 "VADDSECTION" 67 "VADDDISTANCE" 68 "VADDWEIGHT" 69 "VADDZONE" 70 "VADDCRASHRISK" 71 "VADDACCIDENT" 72 "VADDJAM" 73 "VADDOILTRAIL" 74 "VADDGRAVEL" 75 "VADDDIRT" 76 "VADDROADDAMAGE" 77 "VADDRUTS" 78 "ADDNOSTOPSHOULDER" 79 "ADDTOWING" 80 "ADDSCHOOL" 81 "ADDNIGHT" 82 "ADDEND" 83 "ADDBEGINS" 84 "ADDWITHIN" 85 "ADDDISTANCEBARS" 86 "ADDMINIMUM" 87 "ADDADVICE" 88 "ADDACCESS" 89 "ADDALLWAY" 90 "ADDBUS_EXCEPT" 91 "ADDEXCEPTDELIVERY" 92 "ADDEXCEPTLOCAL" 93 "ADDFROG" 94 "ADDPRIOTURNL" 95 "ADDPRIOTURNR" 96 "ADDSTART" 97 "ADDSTOPIN" 98 "ADDEXIT" 99 "ADDHAZWATER" 100 "ADDDAY" 101 "ADDSL" 102 "ADDLORRYTRAILER" 103 "ADDLORRYSEMI" 104 "VADDLORRYTRAILER" 105 "VADDLORRYSEMI" 106 "ADDSLOW" 107 "ADDSL5" 108 "ADDSL10" 109 "ADDSL15" 110 "ADDSL20" 111 "ADDSL25" 112 "ADDSL30" 113 "ADDSL35" 114 "ADDSL40" 115 "ADDSL45" 116 "ADDSL50" 117 "ADDSL55" 118 "ADDSL60" 119 "ADDSL65" 120 "ADDSL70" 121 "ADDSL75" 122 "ADDSL80" 123 "ADDSL85" 124 "ADDSL90" 125 "ADDSL95" 126 "ADDSL100" 127 "ADDSL105" 128 "ADDSL110" 129 "ADDSL115" 130 "ADDSL120" 131 "ADDSL125" 132 "ADDSL130" 133 "ADDSL135" 134 "ADDSL140" 135 "ADDSL145" 136 "ADDSL150" 137 "ADDSL155" 138 "ADDSL160" 139 "ADDBIKEROAD" 140 "ADDLORRYTRAILER_EXCEPT" 141 "ADDLORRYSEMI_EXCEPT" 142 "Reserved142" 143 "Reserved143" 144 "Reserved144" 145 "Reserved145" 146 "Reserved146" 147 "Reserved147" 148 "Reserved148" 149 "Reserved149" 150 "Reserved150" 151 "Reserved151" 152 "Reserved152" 153 "Reserved153" 154 "Reserved154" 155 "Reserved155" 156 "Reserved156" 157 "Reserved157" 158 "Reserved158" 159 "Reserved159" 160 "Reserved160" 161 "Reserved161" 162 "Reserved162" 163 "Reserved163" 164 "Reserved164" 165 "Reserved165" 166 "Reserved166" 167 "Reserved167" 168 "Reserved168" 169 "Reserved169" ;
VAL_ 245 VFC_TS15_SupSign4Type 0 "UNKNOWN" 1 "ADDCAR" 2 "ADDLORRY" 3 "ADDTRAILER" 4 "ADDCARAVAN" 5 "ADDBUS" 6 "ADDTRACTOR" 7 "ADDMCYCLE" 8 "ADDLORRYBUSTRAILER_DEPRECATED" 9 "ADDLORRYBUS_DEPRECATED" 10 "ADDHAZMAT" 11 "ADDTANK" 12 "ADDTRAM" 13 "ADDWET" 14 "ADDFOG" 15 "ADDRAIN" 16 "ADDSNOW" 17 "ADDTIME" 18 "ADDSECTION" 19 "ADDDISTANCE" 20 "ADDWEIGHT" 21 "ADDEXITL" 22 "ADDEXITR" 23 "ADDLANES" 24 "ADDRADAR" 25 "ADDRAPPEL" 26 "ADDPRIOTURN" 27 "ADDLORRY_EXCEPT" 28 "ADDTRACTOR_OVER" 29 "ADDTEXT" 30 "ADDSIGN" 31 "ADDRAINSNOW" 32 "ADDHUMP" 33 "VADDLORRYBUSTRAILER_DEPRECATED" 34 "VADDLORRYBUS_DEPRECATED" 35 "VADDLORRYTRAILER_DEPRECATED" 36 "ADDLORRYTRAILER_DEPRECATED" 37 "ADDCAMPER" 38 "ADDZONE" 39 "ADDCRASHRISK" 40 "ADDACCIDENT" 41 "ADDJAM" 42 "ADDSMOKE" 43 "ADDOILTRAIL" 44 "ADDGRAVEL" 45 "ADDDIRT" 46 "ADDRWORKSEXIT" 47 "ADDROADDAMAGE" 48 "ADDRWORKSENTRY" 49 "ADDLOWTREE" 50 "ADDRWORKSACCESS" 51 "ADDRUTS" 52 "ADDSOFTSHOULDERCAR" 53 "ADDSOFTSHOULDERLORRY" 54 "VADDSIGN" 55 "VADDCAR" 56 "VADDLORRY" 57 "VADDTRAILER" 58 "VADDCARAVAN" 59 "VADDBUS" 60 "VADDWET" 61 "VADDFOG" 62 "VADDRAIN" 63 "VADDSNOW" 64 "VADDRAINSNOW" 65 "VADDTEXT" 66 "VADDSECTION" 67 "VADDDISTANCE" 68 "VADDWEIGHT" 69 "VADDZONE" 70 "VADDCRASHRISK" 71 "VADDACCIDENT" 72 "VADDJAM" 73 "VADDOILTRAIL" 74 "VADDGRAVEL" 75 "VADDDIRT" 76 "VADDROADDAMAGE" 77 "VADDRUTS" 78 "ADDNOSTOPSHOULDER" 79 "ADDTOWING" 80 "ADDSCHOOL" 81 "ADDNIGHT" 82 "ADDEND" 83 "ADDBEGINS" 84 "ADDWITHIN" 85 "ADDDISTANCEBARS" 86 "ADDMINIMUM" 87 "ADDADVICE" 88 "ADDACCESS" 89 "ADDALLWAY" 90 "ADDBUS_EXCEPT" 91 "ADDEXCEPTDELIVERY" 92 "ADDEXCEPTLOCAL" 93 "ADDFROG" 94 "ADDPRIOTURNL" 95 "ADDPRIOTURNR" 96 "ADDSTART" 97 "ADDSTOPIN" 98 "ADDEXIT" 99 "ADDHAZWATER" 100 "ADDDAY" 101 "ADDSL" 102 "ADDLORRYTRAILER" 103 "ADDLORRYSEMI" 104 "VADDLORRYTRAILER" 105 "VADDLORRYSEMI" 106 "ADDSLOW" 107 "ADDSL5" 108 "ADDSL10" 109 "ADDSL15" 110 "ADDSL20" 111 "ADDSL25" 112 "ADDSL30" 113 "ADDSL35" 114 "ADDSL40" 115 "ADDSL45" 116 "ADDSL50" 117 "ADDSL55" 118 "ADDSL60" 119 "ADDSL65" 120 "ADDSL70" 121 "ADDSL75" 122 "ADDSL80" 123 "ADDSL85" 124 "ADDSL90" 125 "ADDSL95" 126 "ADDSL100" 127 "ADDSL105" 128 "ADDSL110" 129 "ADDSL115" 130 "ADDSL120" 131 "ADDSL125" 132 "ADDSL130" 133 "ADDSL135" 134 "ADDSL140" 135 "ADDSL145" 136 "ADDSL150" 137 "ADDSL155" 138 "ADDSL160" 139 "ADDBIKEROAD" 140 "ADDLORRYTRAILER_EXCEPT" 141 "ADDLORRYSEMI_EXCEPT" 142 "Reserved142" 143 "Reserved143" 144 "Reserved144" 145 "Reserved145" 146 "Reserved146" 147 "Reserved147" 148 "Reserved148" 149 "Reserved149" 150 "Reserved150" 151 "Reserved151" 152 "Reserved152" 153 "Reserved153" 154 "Reserved154" 155 "Reserved155" 156 "Reserved156" 157 "Reserved157" 158 "Reserved158" 159 "Reserved159" 160 "Reserved160" 161 "Reserved161" 162 "Reserved162" 163 "Reserved163" 164 "Reserved164" 165 "Reserved165" 166 "Reserved166" 167 "Reserved167" 168 "Reserved168" 169 "Reserved169" ;
VAL_ 245 VFC_TS15_SupSign5Type 0 "UNKNOWN" 1 "ADDCAR" 2 "ADDLORRY" 3 "ADDTRAILER" 4 "ADDCARAVAN" 5 "ADDBUS" 6 "ADDTRACTOR" 7 "ADDMCYCLE" 8 "ADDLORRYBUSTRAILER_DEPRECATED" 9 "ADDLORRYBUS_DEPRECATED" 10 "ADDHAZMAT" 11 "ADDTANK" 12 "ADDTRAM" 13 "ADDWET" 14 "ADDFOG" 15 "ADDRAIN" 16 "ADDSNOW" 17 "ADDTIME" 18 "ADDSECTION" 19 "ADDDISTANCE" 20 "ADDWEIGHT" 21 "ADDEXITL" 22 "ADDEXITR" 23 "ADDLANES" 24 "ADDRADAR" 25 "ADDRAPPEL" 26 "ADDPRIOTURN" 27 "ADDLORRY_EXCEPT" 28 "ADDTRACTOR_OVER" 29 "ADDTEXT" 30 "ADDSIGN" 31 "ADDRAINSNOW" 32 "ADDHUMP" 33 "VADDLORRYBUSTRAILER_DEPRECATED" 34 "VADDLORRYBUS_DEPRECATED" 35 "VADDLORRYTRAILER_DEPRECATED" 36 "ADDLORRYTRAILER_DEPRECATED" 37 "ADDCAMPER" 38 "ADDZONE" 39 "ADDCRASHRISK" 40 "ADDACCIDENT" 41 "ADDJAM" 42 "ADDSMOKE" 43 "ADDOILTRAIL" 44 "ADDGRAVEL" 45 "ADDDIRT" 46 "ADDRWORKSEXIT" 47 "ADDROADDAMAGE" 48 "ADDRWORKSENTRY" 49 "ADDLOWTREE" 50 "ADDRWORKSACCESS" 51 "ADDRUTS" 52 "ADDSOFTSHOULDERCAR" 53 "ADDSOFTSHOULDERLORRY" 54 "VADDSIGN" 55 "VADDCAR" 56 "VADDLORRY" 57 "VADDTRAILER" 58 "VADDCARAVAN" 59 "VADDBUS" 60 "VADDWET" 61 "VADDFOG" 62 "VADDRAIN" 63 "VADDSNOW" 64 "VADDRAINSNOW" 65 "VADDTEXT" 66 "VADDSECTION" 67 "VADDDISTANCE" 68 "VADDWEIGHT" 69 "VADDZONE" 70 "VADDCRASHRISK" 71 "VADDACCIDENT" 72 "VADDJAM" 73 "VADDOILTRAIL" 74 "VADDGRAVEL" 75 "VADDDIRT" 76 "VADDROADDAMAGE" 77 "VADDRUTS" 78 "ADDNOSTOPSHOULDER" 79 "ADDTOWING" 80 "ADDSCHOOL" 81 "ADDNIGHT" 82 "ADDEND" 83 "ADDBEGINS" 84 "ADDWITHIN" 85 "ADDDISTANCEBARS" 86 "ADDMINIMUM" 87 "ADDADVICE" 88 "ADDACCESS" 89 "ADDALLWAY" 90 "ADDBUS_EXCEPT" 91 "ADDEXCEPTDELIVERY" 92 "ADDEXCEPTLOCAL" 93 "ADDFROG" 94 "ADDPRIOTURNL" 95 "ADDPRIOTURNR" 96 "ADDSTART" 97 "ADDSTOPIN" 98 "ADDEXIT" 99 "ADDHAZWATER" 100 "ADDDAY" 101 "ADDSL" 102 "ADDLORRYTRAILER" 103 "ADDLORRYSEMI" 104 "VADDLORRYTRAILER" 105 "VADDLORRYSEMI" 106 "ADDSLOW" 107 "ADDSL5" 108 "ADDSL10" 109 "ADDSL15" 110 "ADDSL20" 111 "ADDSL25" 112 "ADDSL30" 113 "ADDSL35" 114 "ADDSL40" 115 "ADDSL45" 116 "ADDSL50" 117 "ADDSL55" 118 "ADDSL60" 119 "ADDSL65" 120 "ADDSL70" 121 "ADDSL75" 122 "ADDSL80" 123 "ADDSL85" 124 "ADDSL90" 125 "ADDSL95" 126 "ADDSL100" 127 "ADDSL105" 128 "ADDSL110" 129 "ADDSL115" 130 "ADDSL120" 131 "ADDSL125" 132 "ADDSL130" 133 "ADDSL135" 134 "ADDSL140" 135 "ADDSL145" 136 "ADDSL150" 137 "ADDSL155" 138 "ADDSL160" 139 "ADDBIKEROAD" 140 "ADDLORRYTRAILER_EXCEPT" 141 "ADDLORRYSEMI_EXCEPT" 142 "Reserved142" 143 "Reserved143" 144 "Reserved144" 145 "Reserved145" 146 "Reserved146" 147 "Reserved147" 148 "Reserved148" 149 "Reserved149" 150 "Reserved150" 151 "Reserved151" 152 "Reserved152" 153 "Reserved153" 154 "Reserved154" 155 "Reserved155" 156 "Reserved156" 157 "Reserved157" 158 "Reserved158" 159 "Reserved159" 160 "Reserved160" 161 "Reserved161" 162 "Reserved162" 163 "Reserved163" 164 "Reserved164" 165 "Reserved165" 166 "Reserved166" 167 "Reserved167" 168 "Reserved168" 169 "Reserved169" ;
VAL_ 517 RFL_ObjHdr_SensorState 0 "SENSOR FULLY OPERATIONAL" 1 "HW MALFUNCTION" 2 "DSP ISSUES" 3 "COMMUNICATION ERRORS" 4 "MISALIGNMENT (OUT OF SPEC)" 5 "SENSOR BLIDNESS DETECTED" 6 "SENSOR DISTUBED" 7 "OTHER ISSUES" 8 "DEGRADED BY REQUEST" 9 "RESERVED1" 10 "RESERVED2" 11 "RESERVED3" 12 "RESERVED4" 13 "RESERVED5" 14 "RESERVED6" 15 "INVALID" ;
VAL_ 517 RFL_ObjHdr_ObjectDownSel 0 "no downselection" 1 "downselected" ;
VAL_ 517 RFL_ObjHdr_AziOutOfSpec 0 "In spec Azimuth Alignemdn" 1 "Out of spec Azimuth Alignement" ;
VAL_ 517 RFL_ObjHdr_ElevOutOfSpec 0 "In Spec Elevation Alignment" 1 "Out of spec Elevation Alignement" ;
VAL_ 528 RFL_Obj00A_Measured 0 "not measured" 1 "measured" ;
VAL_ 528 RFL_Obj00A_Valid 0 "not valid" 1 "valid" ;
VAL_ 528 RFL_Obj00A_RefPosIndex 0 "Front corner left" 1 "Front center" 2 "Front corner right" 3 "Front wheelcase left" 4 "Front wheelcase right" 5 "Side middle left" 6 "Side middle right" 7 "Rear wheelcase left" 8 "Rear wheelcase right" 9 "Rear corner left" 10 "Rear center" 11 "Rear corner right" 12 "Object center" 13 "Rear wheelcase center" 14 "Front wheelcase center" 15 "Invalid" ;
VAL_ 529 RFL_Obj00B_BehaviorType 0 "No_Target" 1 "FCTA" 2 "RCTA" 3 "BSD" 4 "LCA" 5 "HWA" 6 "Reserved1" 7 "Reserved2" ;
VAL_ 530 RFL_Obj01A_Measured 0 "not measured" 1 "measured" ;
VAL_ 530 RFL_Obj01A_Valid 0 "not valid" 1 "valid" ;
VAL_ 530 RFL_Obj01A_RefPosIndex 0 "Front corner left" 1 "Front center" 2 "Front corner right" 3 "Front wheelcase left" 4 "Front wheelcase right" 5 "Side middle left" 6 "Side middle right" 7 "Rear wheelcase left" 8 "Rear wheelcase right" 9 "Rear corner left" 10 "Rear center" 11 "Rear corner right" 12 "Object center" 13 "Rear wheelcase center" 14 "Front wheelcase center" 15 "Invalid" ;
VAL_ 531 RFL_Obj01B_BehaviorType 0 "No_Target" 1 "FCTA" 2 "RCTA" 3 "BSD" 4 "LCA" 5 "HWA" 6 "Reserved1" 7 "Reserved2" ;
VAL_ 532 RFL_Obj02A_Measured 0 "not measured" 1 "measured" ;
VAL_ 532 RFL_Obj02A_Valid 0 "not valid" 1 "valid" ;
VAL_ 532 RFL_Obj02A_RefPosIndex 0 "Front corner left" 1 "Front center" 2 "Front corner right" 3 "Front wheelcase left" 4 "Front wheelcase right" 5 "Side middle left" 6 "Side middle right" 7 "Rear wheelcase left" 8 "Rear wheelcase right" 9 "Rear corner left" 10 "Rear center" 11 "Rear corner right" 12 "Object center" 13 "Rear wheelcase center" 14 "Front wheelcase center" 15 "Invalid" ;
VAL_ 533 RFL_Obj02B_BehaviorType 0 "No_Target" 1 "FCTA" 2 "RCTA" 3 "BSD" 4 "LCA" 5 "HWA" 6 "Reserved1" 7 "Reserved2" ;
VAL_ 534 RFL_Obj03A_Measured 0 "not measured" 1 "measured" ;
VAL_ 534 RFL_Obj03A_Valid 0 "not valid" 1 "valid" ;
VAL_ 534 RFL_Obj03A_RefPosIndex 0 "Front corner left" 1 "Front center" 2 "Front corner right" 3 "Front wheelcase left" 4 "Front wheelcase right" 5 "Side middle left" 6 "Side middle right" 7 "Rear wheelcase left" 8 "Rear wheelcase right" 9 "Rear corner left" 10 "Rear center" 11 "Rear corner right" 12 "Object center" 13 "Rear wheelcase center" 14 "Front wheelcase center" 15 "Invalid" ;
VAL_ 535 RFL_Obj03B_BehaviorType 0 "No_Target" 1 "FCTA" 2 "RCTA" 3 "BSD" 4 "LCA" 5 "HWA" 6 "Reserved1" 7 "Reserved2" ;
SIG_GROUP_ 244 SG_VFC_TrafficSign_12_13 1 : VFC_TS_12_13_CRC VFC_TS_12_13_AliveCtr VFC_TS_12_13_ProtBlockCtr VFC_TS12_ObjId VFC_TS12_Type VFC_TS12_ExistProb VFC_TS12_Px VFC_TS12_Py VFC_TS12_Pz VFC_TS12_PxStdDev VFC_TS12_Width VFC_TS12_Height VFC_TS12_EmbeddedInfo VFC_TS12_ValidLane VFC_TS12_ValidDay VFC_TS12_ValidTimeRange1Start VFC_TS12_ValidTimeRange1End VFC_TS12_ValidTimeRange2Start VFC_TS12_ValidTimeRange2End VFC_TS12_ValidInDist VFC_TS12_ValidInDistUnit VFC_TS12_ValidSection VFC_TS12_ValidSectionUnit VFC_TS12_NumValidSupSigns VFC_TS12_SupSign0ExistProb VFC_TS12_SupSign1ExistProb VFC_TS12_SupSign2ExistProb VFC_TS12_SupSign3ExistProb VFC_TS12_SupSign4ExistProb VFC_TS12_SupSign5ExistProb VFC_TS12_SupSign0Type VFC_TS12_SupSign1Type VFC_TS12_SupSign2Type VFC_TS12_SupSign3Type VFC_TS12_SupSign4Type VFC_TS12_SupSign5Type VFC_TS13_ObjId VFC_TS13_Type VFC_TS13_ExistProb VFC_TS13_Px VFC_TS13_Py VFC_TS13_Pz VFC_TS13_PxStdDev VFC_TS13_Width VFC_TS13_Height VFC_TS13_EmbeddedInfo VFC_TS13_ValidLane VFC_TS13_ValidDay VFC_TS13_ValidTimeRange1Start VFC_TS13_ValidTimeRange1End VFC_TS13_ValidTimeRange2Start VFC_TS13_ValidTimeRange2End VFC_TS13_ValidInDist VFC_TS13_ValidInDistUnit VFC_TS13_ValidSection VFC_TS13_ValidSectionUnit VFC_TS13_NumValidSupSigns VFC_TS13_SupSign0ExistProb VFC_TS13_SupSign1ExistProb VFC_TS13_SupSign2ExistProb VFC_TS13_SupSign3ExistProb VFC_TS13_SupSign4ExistProb VFC_TS13_SupSign5ExistProb VFC_TS13_SupSign0Type VFC_TS13_SupSign1Type VFC_TS13_SupSign2Type VFC_TS13_SupSign3Type VFC_TS13_SupSign4Type VFC_TS13_SupSign5Type;
SIG_GROUP_ 245 SG_VFC_TrafficSign_14_15 1 : VFC_TS_14_15_CRC VFC_TS_14_15_AliveCtr VFC_TS_14_15_ProtBlockCtr VFC_TS14_ObjId VFC_TS14_Type VFC_TS14_ExistProb VFC_TS14_Px VFC_TS14_Py VFC_TS14_Pz VFC_TS14_PxStdDev VFC_TS14_Width VFC_TS14_Height VFC_TS14_EmbeddedInfo VFC_TS14_ValidLane VFC_TS14_ValidDay VFC_TS14_ValidTimeRange1Start VFC_TS14_ValidTimeRange1End VFC_TS14_ValidTimeRange2Start VFC_TS14_ValidTimeRange2End VFC_TS14_ValidInDist VFC_TS14_ValidInDistUnit VFC_TS14_ValidSection VFC_TS14_ValidSectionUnit VFC_TS14_NumValidSupSigns VFC_TS14_SupSign0ExistProb VFC_TS14_SupSign1ExistProb VFC_TS14_SupSign2ExistProb VFC_TS14_SupSign3ExistProb VFC_TS14_SupSign4ExistProb VFC_TS14_SupSign5ExistProb VFC_TS14_SupSign0Type VFC_TS14_SupSign1Type VFC_TS14_SupSign2Type VFC_TS14_SupSign3Type VFC_TS14_SupSign4Type VFC_TS14_SupSign5Type VFC_TS15_ObjId VFC_TS15_Type VFC_TS15_ExistProb VFC_TS15_Px VFC_TS15_Py VFC_TS15_Pz VFC_TS15_PxStdDev VFC_TS15_Width VFC_TS15_Height VFC_TS15_EmbeddedInfo VFC_TS15_ValidLane VFC_TS15_ValidDay VFC_TS15_ValidTimeRange1Start VFC_TS15_ValidTimeRange1End VFC_TS15_ValidTimeRange2Start VFC_TS15_ValidTimeRange2End VFC_TS15_ValidInDist VFC_TS15_ValidInDistUnit VFC_TS15_ValidSection VFC_TS15_ValidSectionUnit VFC_TS15_NumValidSupSigns VFC_TS15_SupSign0ExistProb VFC_TS15_SupSign1ExistProb VFC_TS15_SupSign2ExistProb VFC_TS15_SupSign3ExistProb VFC_TS15_SupSign4ExistProb VFC_TS15_SupSign5ExistProb VFC_TS15_SupSign0Type VFC_TS15_SupSign1Type VFC_TS15_SupSign2Type VFC_TS15_SupSign3Type VFC_TS15_SupSign4Type VFC_TS15_SupSign5Type;
