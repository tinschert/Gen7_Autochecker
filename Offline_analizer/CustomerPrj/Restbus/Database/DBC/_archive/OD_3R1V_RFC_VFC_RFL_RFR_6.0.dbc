VERSION "created by canmatrix"

NS_ :

BS_:

BU_: RadarFrontCenter VideoFrontCenter RadarFrontLeft RadarFrontRight ReceiveECU

BO_ 131 VFC_RoadClothoid_03_05: 64 VideoFrontCenter
 SG_ VFC_Cloth_03_05_CRC : 0|16@1+ (1,0) [0|65535] ""  RadarFrontCenter
 SG_ VFC_Cloth_03_05_AliveCtr : 16|8@1+ (1,0) [0|255] ""  RadarFrontCenter
 SG_ VFC_Cloth_03_05_ProtBlockCtr : 24|4@1+ (1,0) [0|15] ""  RadarFrontCenter
 SG_ VFC_Cloth03_LaneAssociation : 32|4@1+ (1,0) [0|15] ""  RadarFrontCenter
 SG_ VFC_Cloth03_Colour : 37|3@1+ (1,0) [0|7] ""  RadarFrontCenter
 SG_ VFC_Cloth03_RangeXBegin : 40|9@1+ (0.25,0) [0|127.75] "m"  RadarFrontCenter
 SG_ VFC_Cloth03_RangeXEnd : 49|9@1+ (0.5,0) [0|255.5] "m"  RadarFrontCenter
 SG_ VFC_Cloth03_ExistProb : 58|6@1+ (2,0) [0|100] "%"  RadarFrontCenter
 SG_ VFC_Cloth03_CurvChange : 64|24@1+ (1.86264514923096E-009,-0.015625) [-0.015625|0.0156249981373549] "1/m^2"  RadarFrontCenter
 SG_ VFC_Cloth03_Curv : 88|15@1+ (3.814697265625E-006,-0.0625) [-0.0625|0.0624961853027344] "1/m"  RadarFrontCenter
 SG_ VFC_Cloth03_PyStdDev : 103|9@1+ (0.0078125,0) [0|3.9921875] "m"  RadarFrontCenter
 SG_ VFC_Cloth03_Py : 112|12@1+ (0.0078125,-16) [-16|15.9921875] "m"  RadarFrontCenter
 SG_ VFC_Cloth03_OrientationYaw : 124|12@1+ (0.00048828125,-1) [-1|0.99951171875] "rad"  RadarFrontCenter
 SG_ VFC_Cloth03_Width : 136|8@1+ (0.01,0) [0|2.55] "m"  RadarFrontCenter
 SG_ VFC_Cloth03_Type : 144|4@1+ (1,0) [0|15] ""  RadarFrontCenter
 SG_ VFC_Cloth04_LaneAssociation : 192|4@1+ (1,0) [0|15] ""  RadarFrontCenter
 SG_ VFC_Cloth04_Colour : 197|3@1+ (1,0) [0|7] ""  RadarFrontCenter
 SG_ VFC_Cloth04_RangeXBegin : 200|9@1+ (0.25,0) [0|127.75] "m"  RadarFrontCenter
 SG_ VFC_Cloth04_RangeXEnd : 209|9@1+ (0.5,0) [0|255.5] "m"  RadarFrontCenter
 SG_ VFC_Cloth04_ExistProb : 218|6@1+ (2,0) [0|100] "%"  RadarFrontCenter
 SG_ VFC_Cloth04_CurvChange : 224|24@1+ (1.86264514923096E-009,-0.015625) [-0.015625|0.0156249981373549] "1/m^2"  RadarFrontCenter
 SG_ VFC_Cloth04_Curv : 248|15@1+ (3.814697265625E-006,-0.0625) [-0.0625|0.0624961853027344] "1/m"  RadarFrontCenter
 SG_ VFC_Cloth04_PyStdDev : 263|9@1+ (0.0078125,0) [0|3.9921875] "m"  RadarFrontCenter
 SG_ VFC_Cloth04_Py : 272|12@1+ (0.0078125,-16) [-16|15.9921875] "m"  RadarFrontCenter
 SG_ VFC_Cloth04_OrientationYaw : 284|12@1+ (0.00048828125,-1) [-1|0.99951171875] "rad"  RadarFrontCenter
 SG_ VFC_Cloth04_Width : 296|8@1+ (0.01,0) [0|2.55] "m"  RadarFrontCenter
 SG_ VFC_Cloth04_Type : 304|4@1+ (1,0) [0|15] ""  RadarFrontCenter
 SG_ VFC_Cloth05_LaneAssociation : 352|4@1+ (1,0) [0|15] ""  RadarFrontCenter
 SG_ VFC_Cloth05_Colour : 357|3@1+ (1,0) [0|7] ""  RadarFrontCenter
 SG_ VFC_Cloth05_RangeXBegin : 360|9@1+ (0.25,0) [0|127.75] "m"  RadarFrontCenter
 SG_ VFC_Cloth05_RangeXEnd : 369|9@1+ (0.5,0) [0|255.5] "m"  RadarFrontCenter
 SG_ VFC_Cloth05_ExistProb : 378|6@1+ (2,0) [0|100] "%"  RadarFrontCenter
 SG_ VFC_Cloth05_CurvChange : 384|24@1+ (1.86264514923096E-009,-0.015625) [-0.015625|0.0156249981373549] "1/m^2"  RadarFrontCenter
 SG_ VFC_Cloth05_Curv : 408|15@1+ (3.814697265625E-006,-0.0625) [-0.0625|0.0624961853027344] "1/m"  RadarFrontCenter
 SG_ VFC_Cloth05_PyStdDev : 423|9@1+ (0.0078125,0) [0|3.9921875] "m"  RadarFrontCenter
 SG_ VFC_Cloth05_Py : 432|12@1+ (0.0078125,-16) [-16|15.9921875] "m"  RadarFrontCenter
 SG_ VFC_Cloth05_OrientationYaw : 444|12@1+ (0.00048828125,-1) [-1|0.99951171875] "rad"  RadarFrontCenter
 SG_ VFC_Cloth05_Width : 456|8@1+ (0.01,0) [0|2.55] "m"  RadarFrontCenter
 SG_ VFC_Cloth05_Type : 464|4@1+ (1,0) [0|15] ""  RadarFrontCenter

BO_ 132 VFC_RoadClothoid_06_08: 64 VideoFrontCenter
 SG_ VFC_Cloth_06_08_CRC : 0|16@1+ (1,0) [0|65535] ""  RadarFrontCenter
 SG_ VFC_Cloth_06_08_AliveCtr : 16|8@1+ (1,0) [0|255] ""  RadarFrontCenter
 SG_ VFC_Cloth_06_08_ProtBlockCtr : 24|4@1+ (1,0) [0|15] ""  RadarFrontCenter
 SG_ VFC_Cloth06_LaneAssociation : 32|4@1+ (1,0) [0|15] ""  RadarFrontCenter
 SG_ VFC_Cloth06_Colour : 37|3@1+ (1,0) [0|7] ""  RadarFrontCenter
 SG_ VFC_Cloth06_RangeXBegin : 40|9@1+ (0.25,0) [0|127.75] "m"  RadarFrontCenter
 SG_ VFC_Cloth06_RangeXEnd : 49|9@1+ (0.5,0) [0|255.5] "m"  RadarFrontCenter
 SG_ VFC_Cloth06_ExistProb : 58|6@1+ (2,0) [0|100] "%"  RadarFrontCenter
 SG_ VFC_Cloth06_CurvChange : 64|24@1+ (1.86264514923096E-009,-0.015625) [-0.015625|0.0156249981373549] "1/m^2"  RadarFrontCenter
 SG_ VFC_Cloth06_Curv : 88|15@1+ (3.814697265625E-006,-0.0625) [-0.0625|0.0624961853027344] "1/m"  RadarFrontCenter
 SG_ VFC_Cloth06_PyStdDev : 103|9@1+ (0.0078125,0) [0|3.9921875] "m"  RadarFrontCenter
 SG_ VFC_Cloth06_Py : 112|12@1+ (0.0078125,-16) [-16|15.9921875] "m"  RadarFrontCenter
 SG_ VFC_Cloth06_OrientationYaw : 124|12@1+ (0.00048828125,-1) [-1|0.99951171875] "rad"  RadarFrontCenter
 SG_ VFC_Cloth06_Width : 136|8@1+ (0.01,0) [0|2.55] "m"  RadarFrontCenter
 SG_ VFC_Cloth06_Type : 144|4@1+ (1,0) [0|15] ""  RadarFrontCenter
 SG_ VFC_Cloth07_LaneAssociation : 192|4@1+ (1,0) [0|15] ""  RadarFrontCenter
 SG_ VFC_Cloth07_Colour : 197|3@1+ (1,0) [0|7] ""  RadarFrontCenter
 SG_ VFC_Cloth07_RangeXBegin : 200|9@1+ (0.25,0) [0|127.75] "m"  RadarFrontCenter
 SG_ VFC_Cloth07_RangeXEnd : 209|9@1+ (0.5,0) [0|255.5] "m"  RadarFrontCenter
 SG_ VFC_Cloth07_ExistProb : 218|6@1+ (2,0) [0|100] "%"  RadarFrontCenter
 SG_ VFC_Cloth07_CurvChange : 224|24@1+ (1.86264514923096E-009,-0.015625) [-0.015625|0.0156249981373549] "1/m^2"  RadarFrontCenter
 SG_ VFC_Cloth07_Curv : 248|15@1+ (3.814697265625E-006,-0.0625) [-0.0625|0.0624961853027344] "1/m"  RadarFrontCenter
 SG_ VFC_Cloth07_PyStdDev : 263|9@1+ (0.0078125,0) [0|3.9921875] "m"  RadarFrontCenter
 SG_ VFC_Cloth07_Py : 272|12@1+ (0.0078125,-16) [-16|15.9921875] "m"  RadarFrontCenter
 SG_ VFC_Cloth07_OrientationYaw : 284|12@1+ (0.00048828125,-1) [-1|0.99951171875] "rad"  RadarFrontCenter
 SG_ VFC_Cloth07_Width : 296|8@1+ (0.01,0) [0|2.55] "m"  RadarFrontCenter
 SG_ VFC_Cloth07_Type : 304|4@1+ (1,0) [0|15] ""  RadarFrontCenter
 SG_ VFC_Cloth08_LaneAssociation : 352|4@1+ (1,0) [0|15] ""  RadarFrontCenter
 SG_ VFC_Cloth08_Colour : 357|3@1+ (1,0) [0|7] ""  RadarFrontCenter
 SG_ VFC_Cloth08_RangeXBegin : 360|9@1+ (0.25,0) [0|127.75] "m"  RadarFrontCenter
 SG_ VFC_Cloth08_RangeXEnd : 369|9@1+ (0.5,0) [0|255.5] "m"  RadarFrontCenter
 SG_ VFC_Cloth08_ExistProb : 378|6@1+ (2,0) [0|100] "%"  RadarFrontCenter
 SG_ VFC_Cloth08_CurvChange : 384|24@1+ (1.86264514923096E-009,-0.015625) [-0.015625|0.0156249981373549] "1/m^2"  RadarFrontCenter
 SG_ VFC_Cloth08_Curv : 408|15@1+ (3.814697265625E-006,-0.0625) [-0.0625|0.0624961853027344] "1/m"  RadarFrontCenter
 SG_ VFC_Cloth08_PyStdDev : 423|9@1+ (0.0078125,0) [0|3.9921875] "m"  RadarFrontCenter
 SG_ VFC_Cloth08_Py : 432|12@1+ (0.0078125,-16) [-16|15.9921875] "m"  RadarFrontCenter
 SG_ VFC_Cloth08_OrientationYaw : 444|12@1+ (0.00048828125,-1) [-1|0.99951171875] "rad"  RadarFrontCenter
 SG_ VFC_Cloth08_Width : 456|8@1+ (0.01,0) [0|2.55] "m"  RadarFrontCenter
 SG_ VFC_Cloth08_Type : 464|4@1+ (1,0) [0|15] ""  RadarFrontCenter

BO_ 133 VFC_RoadClothoid_09_11: 64 VideoFrontCenter
 SG_ VFC_Cloth_09_11_CRC : 0|16@1+ (1,0) [0|65535] ""  RadarFrontCenter
 SG_ VFC_Cloth_09_11_AliveCtr : 16|8@1+ (1,0) [0|255] ""  RadarFrontCenter
 SG_ VFC_Cloth_09_11_ProtBlockCtr : 24|4@1+ (1,0) [0|15] ""  RadarFrontCenter
 SG_ VFC_Cloth09_LaneAssociation : 32|4@1+ (1,0) [0|15] ""  RadarFrontCenter
 SG_ VFC_Cloth09_Colour : 37|3@1+ (1,0) [0|7] ""  RadarFrontCenter
 SG_ VFC_Cloth09_RangeXBegin : 40|9@1+ (0.25,0) [0|127.75] "m"  RadarFrontCenter
 SG_ VFC_Cloth09_RangeXEnd : 49|9@1+ (0.5,0) [0|255.5] "m"  RadarFrontCenter
 SG_ VFC_Cloth09_ExistProb : 58|6@1+ (2,0) [0|100] "%"  RadarFrontCenter
 SG_ VFC_Cloth09_CurvChange : 64|24@1+ (1.86264514923096E-009,-0.015625) [-0.015625|0.0156249981373549] "1/m^2"  RadarFrontCenter
 SG_ VFC_Cloth09_Curv : 88|15@1+ (3.814697265625E-006,-0.0625) [-0.0625|0.0624961853027344] "1/m"  RadarFrontCenter
 SG_ VFC_Cloth09_PyStdDev : 103|9@1+ (0.0078125,0) [0|3.9921875] "m"  RadarFrontCenter
 SG_ VFC_Cloth09_Py : 112|12@1+ (0.0078125,-16) [-16|15.9921875] "m"  RadarFrontCenter
 SG_ VFC_Cloth09_OrientationYaw : 124|12@1+ (0.00048828125,-1) [-1|0.99951171875] "rad"  RadarFrontCenter
 SG_ VFC_Cloth09_Width : 136|8@1+ (0.01,0) [0|2.55] "m"  RadarFrontCenter
 SG_ VFC_Cloth09_Type : 144|4@1+ (1,0) [0|15] ""  RadarFrontCenter
 SG_ VFC_Cloth10_LaneAssociation : 192|4@1+ (1,0) [0|15] ""  RadarFrontCenter
 SG_ VFC_Cloth10_Colour : 197|3@1+ (1,0) [0|7] ""  RadarFrontCenter
 SG_ VFC_Cloth10_RangeXBegin : 200|9@1+ (0.25,0) [0|127.75] "m"  RadarFrontCenter
 SG_ VFC_Cloth10_RangeXEnd : 209|9@1+ (0.5,0) [0|255.5] "m"  RadarFrontCenter
 SG_ VFC_Cloth10_ExistProb : 218|6@1+ (2,0) [0|100] "%"  RadarFrontCenter
 SG_ VFC_Cloth10_CurvChange : 224|24@1+ (1.86264514923096E-009,-0.015625) [-0.015625|0.0156249981373549] "1/m^2"  RadarFrontCenter
 SG_ VFC_Cloth10_Curv : 248|15@1+ (3.814697265625E-006,-0.0625) [-0.0625|0.0624961853027344] "1/m"  RadarFrontCenter
 SG_ VFC_Cloth10_PyStdDev : 263|9@1+ (0.0078125,0) [0|3.9921875] "m"  RadarFrontCenter
 SG_ VFC_Cloth10_Py : 272|12@1+ (0.0078125,-16) [-16|15.9921875] "m"  RadarFrontCenter
 SG_ VFC_Cloth10_OrientationYaw : 284|12@1+ (0.00048828125,-1) [-1|0.99951171875] "rad"  RadarFrontCenter
 SG_ VFC_Cloth10_Width : 296|8@1+ (0.01,0) [0|2.55] "m"  RadarFrontCenter
 SG_ VFC_Cloth10_Type : 304|4@1+ (1,0) [0|15] ""  RadarFrontCenter
 SG_ VFC_Cloth11_LaneAssociation : 352|4@1+ (1,0) [0|15] ""  RadarFrontCenter
 SG_ VFC_Cloth11_Colour : 357|3@1+ (1,0) [0|7] ""  RadarFrontCenter
 SG_ VFC_Cloth11_RangeXBegin : 360|9@1+ (0.25,0) [0|127.75] "m"  RadarFrontCenter
 SG_ VFC_Cloth11_RangeXEnd : 369|9@1+ (0.5,0) [0|255.5] "m"  RadarFrontCenter
 SG_ VFC_Cloth11_ExistProb : 378|6@1+ (2,0) [0|100] "%"  RadarFrontCenter
 SG_ VFC_Cloth11_CurvChange : 384|24@1+ (1.86264514923096E-009,-0.015625) [-0.015625|0.0156249981373549] "1/m^2"  RadarFrontCenter
 SG_ VFC_Cloth11_Curv : 408|15@1+ (3.814697265625E-006,-0.0625) [-0.0625|0.0624961853027344] "1/m"  RadarFrontCenter
 SG_ VFC_Cloth11_PyStdDev : 423|9@1+ (0.0078125,0) [0|3.9921875] "m"  RadarFrontCenter
 SG_ VFC_Cloth11_Py : 432|12@1+ (0.0078125,-16) [-16|15.9921875] "m"  RadarFrontCenter
 SG_ VFC_Cloth11_OrientationYaw : 444|12@1+ (0.00048828125,-1) [-1|0.99951171875] "rad"  RadarFrontCenter
 SG_ VFC_Cloth11_Width : 456|8@1+ (0.01,0) [0|2.55] "m"  RadarFrontCenter
 SG_ VFC_Cloth11_Type : 464|4@1+ (1,0) [0|15] ""  RadarFrontCenter

BO_ 146 VFC_RoadPolynomial_00_02: 64 VideoFrontCenter
 SG_ VFC_Poly_00_02_CRC : 0|16@1+ (1,0) [0|65535] ""  RadarFrontCenter
 SG_ VFC_Poly_00_02_AliveCtr : 16|8@1+ (1,0) [0|255] ""  RadarFrontCenter
 SG_ VFC_Poly_00_02_ProtBlockCtr : 24|4@1+ (1,0) [0|15] ""  RadarFrontCenter
 SG_ VFC_Poly00_LaneAssociation : 32|4@1+ (1,0) [0|15] ""  RadarFrontCenter
 SG_ VFC_Poly00_Type : 36|4@1+ (1,0) [0|15] ""  RadarFrontCenter
 SG_ VFC_Poly00_ExistProb : 40|6@1+ (2,0) [0|100] "%"  RadarFrontCenter
 SG_ VFC_Poly00_CoefficientYc3 : 46|18@1+ (1.49011611938476E-008,-0.001953125) [-0.001953125|0.00195311009883879] "1/m^2"  RadarFrontCenter
 SG_ VFC_Poly00_Colour : 64|3@1+ (1,0) [0|7] ""  RadarFrontCenter
 SG_ VFC_Poly00_CoefficientYc2 : 67|17@1+ (9.5367431640625E-007,-0.0625) [-0.0625|0.0624990463256836] "1/m"  RadarFrontCenter
 SG_ VFC_Poly00_CoefficientYc0 : 84|12@1+ (0.0078125,-16) [-16|15.9921875] "m"  RadarFrontCenter
 SG_ VFC_Poly00_CoefficientYc1 : 96|15@1+ (6.103515625E-005,-1) [-1|0.99993896484375] "1"  RadarFrontCenter
 SG_ VFC_Poly00_CoefficientYc2Corr : 111|17@1+ (9.5367431640625E-007,-0.0625) [-0.0625|0.0624990463256836] "1/m"  RadarFrontCenter
 SG_ VFC_Poly00_CoefficientYc3Corr : 128|18@1+ (1.49011611938476E-008,-0.001953125) [-0.001953125|0.00195311009883879] "1/m^2"  RadarFrontCenter
 SG_ VFC_Poly00_Width : 146|6@1+ (0.01,0) [0|0.63] "m"  RadarFrontCenter
 SG_ VFC_Poly00_RangeXCorrectionPoint : 152|8@1+ (1,0) [0|255] "m"  RadarFrontCenter
 SG_ VFC_Poly00_RangeXBegin : 160|9@1+ (0.25,0) [0|127.75] "m"  RadarFrontCenter
 SG_ VFC_Poly00_Reserved0 : 169|7@1+ (1,0) [0|127] "unitless"  RadarFrontCenter
 SG_ VFC_Poly00_RangeXEnd : 176|9@1+ (0.5,0) [0|255.5] "m"  RadarFrontCenter
 SG_ VFC_Poly00_Reserved1 : 185|7@1+ (1,0) [0|127] "unitless"  RadarFrontCenter
 SG_ VFC_Poly01_LaneAssociation : 192|4@1+ (1,0) [0|15] ""  RadarFrontCenter
 SG_ VFC_Poly01_Type : 196|4@1+ (1,0) [0|15] ""  RadarFrontCenter
 SG_ VFC_Poly01_ExistProb : 200|6@1+ (2,0) [0|100] "%"  RadarFrontCenter
 SG_ VFC_Poly01_CoefficientYc3 : 206|18@1+ (1.49011611938476E-008,-0.001953125) [-0.001953125|0.00195311009883879] "1/m^2"  RadarFrontCenter
 SG_ VFC_Poly01_Colour : 224|3@1+ (1,0) [0|7] ""  RadarFrontCenter
 SG_ VFC_Poly01_CoefficientYc2 : 227|17@1+ (9.5367431640625E-007,-0.0625) [-0.0625|0.0624990463256836] "1/m"  RadarFrontCenter
 SG_ VFC_Poly01_CoefficientYc0 : 244|12@1+ (0.0078125,-16) [-16|15.9921875] "m"  RadarFrontCenter
 SG_ VFC_Poly01_CoefficientYc1 : 256|15@1+ (6.103515625E-005,-1) [-1|0.99993896484375] "1"  RadarFrontCenter
 SG_ VFC_Poly01_CoefficientYc2Corr : 271|17@1+ (9.5367431640625E-007,-0.0625) [-0.0625|0.0624990463256836] "1/m"  RadarFrontCenter
 SG_ VFC_Poly01_CoefficientYc3Corr : 288|18@1+ (1.49011611938476E-008,-0.001953125) [-0.001953125|0.00195311009883879] "1/m^2"  RadarFrontCenter
 SG_ VFC_Poly01_Width : 306|6@1+ (0.01,0) [0|0.63] "m"  RadarFrontCenter
 SG_ VFC_Poly01_RangeXCorrectionPoint : 312|8@1+ (1,0) [0|255] "m"  RadarFrontCenter
 SG_ VFC_Poly01_RangeXBegin : 320|9@1+ (0.25,0) [0|127.75] "m"  RadarFrontCenter
 SG_ VFC_Poly01_Reserved0 : 329|7@1+ (1,0) [0|127] "unitless"  RadarFrontCenter
 SG_ VFC_Poly01_RangeXEnd : 336|9@1+ (0.5,0) [0|255.5] "m"  RadarFrontCenter
 SG_ VFC_Poly01_Reserved1 : 345|7@1+ (1,0) [0|127] "unitless"  RadarFrontCenter
 SG_ VFC_Poly02_LaneAssociation : 352|4@1+ (1,0) [0|15] ""  RadarFrontCenter
 SG_ VFC_Poly02_Type : 356|4@1+ (1,0) [0|15] ""  RadarFrontCenter
 SG_ VFC_Poly02_ExistProb : 360|6@1+ (2,0) [0|100] "%"  RadarFrontCenter
 SG_ VFC_Poly02_CoefficientYc3 : 366|18@1+ (1.49011611938476E-008,-0.001953125) [-0.001953125|0.00195311009883879] "1/m^2"  RadarFrontCenter
 SG_ VFC_Poly02_Colour : 384|3@1+ (1,0) [0|7] ""  RadarFrontCenter
 SG_ VFC_Poly02_CoefficientYc2 : 387|17@1+ (9.5367431640625E-007,-0.0625) [-0.0625|0.0624990463256836] "1/m"  RadarFrontCenter
 SG_ VFC_Poly02_CoefficientYc0 : 404|12@1+ (0.0078125,-16) [-16|15.9921875] "m"  RadarFrontCenter
 SG_ VFC_Poly02_CoefficientYc1 : 416|15@1+ (6.103515625E-005,-1) [-1|0.99993896484375] "1"  RadarFrontCenter
 SG_ VFC_Poly02_CoefficientYc2Corr : 431|17@1+ (9.5367431640625E-007,-0.0625) [-0.0625|0.0624990463256836] "1/m"  RadarFrontCenter
 SG_ VFC_Poly02_CoefficientYc3Corr : 448|18@1+ (1.49011611938476E-008,-0.001953125) [-0.001953125|0.00195311009883879] "1/m^2"  RadarFrontCenter
 SG_ VFC_Poly02_Width : 466|6@1+ (0.01,0) [0|0.63] "m"  RadarFrontCenter
 SG_ VFC_Poly02_RangeXCorrectionPoint : 472|8@1+ (1,0) [0|255] "m"  RadarFrontCenter
 SG_ VFC_Poly02_RangeXBegin : 480|9@1+ (0.25,0) [0|127.75] "m"  RadarFrontCenter
 SG_ VFC_Poly02_Reserved0 : 489|7@1+ (1,0) [0|127] "unitless"  RadarFrontCenter
 SG_ VFC_Poly02_RangeXEnd : 496|9@1+ (0.5,0) [0|255.5] "m"  RadarFrontCenter
 SG_ VFC_Poly02_Reserved1 : 505|7@1+ (1,0) [0|127] "unitless"  RadarFrontCenter

BO_ 147 VFC_RoadPolynomial_03_05: 64 VideoFrontCenter
 SG_ VFC_Poly_03_05_CRC : 0|16@1+ (1,0) [0|65535] ""  RadarFrontCenter
 SG_ VFC_Poly_03_05_AliveCtr : 16|8@1+ (1,0) [0|255] ""  RadarFrontCenter
 SG_ VFC_Poly_03_05_ProtBlockCtr : 24|4@1+ (1,0) [0|15] ""  RadarFrontCenter
 SG_ VFC_Poly03_LaneAssociation : 32|4@1+ (1,0) [0|15] ""  RadarFrontCenter
 SG_ VFC_Poly03_Type : 36|4@1+ (1,0) [0|15] ""  RadarFrontCenter
 SG_ VFC_Poly03_ExistProb : 40|6@1+ (2,0) [0|100] "%"  RadarFrontCenter
 SG_ VFC_Poly03_CoefficientYc3 : 46|18@1+ (1.49011611938476E-008,-0.001953125) [-0.001953125|0.00195311009883879] "1/m^2"  RadarFrontCenter
 SG_ VFC_Poly03_Colour : 64|3@1+ (1,0) [0|7] ""  RadarFrontCenter
 SG_ VFC_Poly03_CoefficientYc2 : 67|17@1+ (9.5367431640625E-007,-0.0625) [-0.0625|0.0624990463256836] "1/m"  RadarFrontCenter
 SG_ VFC_Poly03_CoefficientYc0 : 84|12@1+ (0.0078125,-16) [-16|15.9921875] "m"  RadarFrontCenter
 SG_ VFC_Poly03_CoefficientYc1 : 96|15@1+ (6.103515625E-005,-1) [-1|0.99993896484375] "1"  RadarFrontCenter
 SG_ VFC_Poly03_CoefficientYc2Corr : 111|17@1+ (9.5367431640625E-007,-0.0625) [-0.0625|0.0624990463256836] "1/m"  RadarFrontCenter
 SG_ VFC_Poly03_CoefficientYc3Corr : 128|18@1+ (1.49011611938476E-008,-0.001953125) [-0.001953125|0.00195311009883879] "1/m^2"  RadarFrontCenter
 SG_ VFC_Poly03_Width : 146|6@1+ (0.01,0) [0|0.63] "m"  RadarFrontCenter
 SG_ VFC_Poly03_RangeXCorrectionPoint : 152|8@1+ (1,0) [0|255] "m"  RadarFrontCenter
 SG_ VFC_Poly03_RangeXBegin : 160|9@1+ (0.25,0) [0|127.75] "m"  RadarFrontCenter
 SG_ VFC_Poly03_Reserved0 : 169|7@1+ (1,0) [0|127] "unitless"  RadarFrontCenter
 SG_ VFC_Poly03_RangeXEnd : 176|9@1+ (0.5,0) [0|255.5] "m"  RadarFrontCenter
 SG_ VFC_Poly03_Reserved1 : 185|7@1+ (1,0) [0|127] "unitless"  RadarFrontCenter
 SG_ VFC_Poly04_LaneAssociation : 192|4@1+ (1,0) [0|15] ""  RadarFrontCenter
 SG_ VFC_Poly04_Type : 196|4@1+ (1,0) [0|15] ""  RadarFrontCenter
 SG_ VFC_Poly04_ExistProb : 200|6@1+ (2,0) [0|100] "%"  RadarFrontCenter
 SG_ VFC_Poly04_CoefficientYc3 : 206|18@1+ (1.49011611938476E-008,-0.001953125) [-0.001953125|0.00195311009883879] "1/m^2"  RadarFrontCenter
 SG_ VFC_Poly04_Colour : 224|3@1+ (1,0) [0|7] ""  RadarFrontCenter
 SG_ VFC_Poly04_CoefficientYc2 : 227|17@1+ (9.5367431640625E-007,-0.0625) [-0.0625|0.0624990463256836] "1/m"  RadarFrontCenter
 SG_ VFC_Poly04_CoefficientYc0 : 244|12@1+ (0.0078125,-16) [-16|15.9921875] "m"  RadarFrontCenter
 SG_ VFC_Poly04_CoefficientYc1 : 256|15@1+ (6.103515625E-005,-1) [-1|0.99993896484375] "1"  RadarFrontCenter
 SG_ VFC_Poly04_CoefficientYc2Corr : 271|17@1+ (9.5367431640625E-007,-0.0625) [-0.0625|0.0624990463256836] "1/m"  RadarFrontCenter
 SG_ VFC_Poly04_CoefficientYc3Corr : 288|18@1+ (1.49011611938476E-008,-0.001953125) [-0.001953125|0.00195311009883879] "1/m^2"  RadarFrontCenter
 SG_ VFC_Poly04_Width : 306|6@1+ (0.01,0) [0|0.63] "m"  RadarFrontCenter
 SG_ VFC_Poly04_RangeXCorrectionPoint : 312|8@1+ (1,0) [0|255] "m"  RadarFrontCenter
 SG_ VFC_Poly04_RangeXBegin : 320|9@1+ (0.25,0) [0|127.75] "m"  RadarFrontCenter
 SG_ VFC_Poly04_Reserved0 : 329|7@1+ (1,0) [0|127] "unitless"  RadarFrontCenter
 SG_ VFC_Poly04_RangeXEnd : 336|9@1+ (0.5,0) [0|255.5] "m"  RadarFrontCenter
 SG_ VFC_Poly04_Reserved1 : 345|7@1+ (1,0) [0|127] "unitless"  RadarFrontCenter
 SG_ VFC_Poly05_LaneAssociation : 352|4@1+ (1,0) [0|15] ""  RadarFrontCenter
 SG_ VFC_Poly05_Type : 356|4@1+ (1,0) [0|15] ""  RadarFrontCenter
 SG_ VFC_Poly05_ExistProb : 360|6@1+ (2,0) [0|100] "%"  RadarFrontCenter
 SG_ VFC_Poly05_CoefficientYc3 : 366|18@1+ (1.49011611938476E-008,-0.001953125) [-0.001953125|0.00195311009883879] "1/m^2"  RadarFrontCenter
 SG_ VFC_Poly05_Colour : 384|3@1+ (1,0) [0|7] ""  RadarFrontCenter
 SG_ VFC_Poly05_CoefficientYc2 : 387|17@1+ (9.5367431640625E-007,-0.0625) [-0.0625|0.0624990463256836] "1/m"  RadarFrontCenter
 SG_ VFC_Poly05_CoefficientYc0 : 404|12@1+ (0.0078125,-16) [-16|15.9921875] "m"  RadarFrontCenter
 SG_ VFC_Poly05_CoefficientYc1 : 416|15@1+ (6.103515625E-005,-1) [-1|0.99993896484375] "1"  RadarFrontCenter
 SG_ VFC_Poly05_CoefficientYc2Corr : 431|17@1+ (9.5367431640625E-007,-0.0625) [-0.0625|0.0624990463256836] "1/m"  RadarFrontCenter
 SG_ VFC_Poly05_CoefficientYc3Corr : 448|18@1+ (1.49011611938476E-008,-0.001953125) [-0.001953125|0.00195311009883879] "1/m^2"  RadarFrontCenter
 SG_ VFC_Poly05_Width : 466|6@1+ (0.01,0) [0|0.63] "m"  RadarFrontCenter
 SG_ VFC_Poly05_RangeXCorrectionPoint : 472|8@1+ (1,0) [0|255] "m"  RadarFrontCenter
 SG_ VFC_Poly05_RangeXBegin : 480|9@1+ (0.25,0) [0|127.75] "m"  RadarFrontCenter
 SG_ VFC_Poly05_Reserved0 : 489|7@1+ (1,0) [0|127] "unitless"  RadarFrontCenter
 SG_ VFC_Poly05_RangeXEnd : 496|9@1+ (0.5,0) [0|255.5] "m"  RadarFrontCenter
 SG_ VFC_Poly05_Reserved1 : 505|7@1+ (1,0) [0|127] "unitless"  RadarFrontCenter

BO_ 148 VFC_RoadPolynomial_06_08: 64 VideoFrontCenter
 SG_ VFC_Poly_06_08_CRC : 0|16@1+ (1,0) [0|65535] ""  RadarFrontCenter
 SG_ VFC_Poly_06_08_AliveCtr : 16|8@1+ (1,0) [0|255] ""  RadarFrontCenter
 SG_ VFC_Poly_06_08_ProtBlockCtr : 24|4@1+ (1,0) [0|15] ""  RadarFrontCenter
 SG_ VFC_Poly06_LaneAssociation : 32|4@1+ (1,0) [0|15] ""  RadarFrontCenter
 SG_ VFC_Poly06_Type : 36|4@1+ (1,0) [0|15] ""  RadarFrontCenter
 SG_ VFC_Poly06_ExistProb : 40|6@1+ (2,0) [0|100] "%"  RadarFrontCenter
 SG_ VFC_Poly06_CoefficientYc3 : 46|18@1+ (1.49011611938476E-008,-0.001953125) [-0.001953125|0.00195311009883879] "1/m^2"  RadarFrontCenter
 SG_ VFC_Poly06_Colour : 64|3@1+ (1,0) [0|7] ""  RadarFrontCenter
 SG_ VFC_Poly06_CoefficientYc2 : 67|17@1+ (9.5367431640625E-007,-0.0625) [-0.0625|0.0624990463256836] "1/m"  RadarFrontCenter
 SG_ VFC_Poly06_CoefficientYc0 : 84|12@1+ (0.0078125,-16) [-16|15.9921875] "m"  RadarFrontCenter
 SG_ VFC_Poly06_CoefficientYc1 : 96|15@1+ (6.103515625E-005,-1) [-1|0.99993896484375] "1"  RadarFrontCenter
 SG_ VFC_Poly06_CoefficientYc2Corr : 111|17@1+ (9.5367431640625E-007,-0.0625) [-0.0625|0.0624990463256836] "1/m"  RadarFrontCenter
 SG_ VFC_Poly06_CoefficientYc3Corr : 128|18@1+ (1.49011611938476E-008,-0.001953125) [-0.001953125|0.00195311009883879] "1/m^2"  RadarFrontCenter
 SG_ VFC_Poly06_Width : 146|6@1+ (0.01,0) [0|0.63] "m"  RadarFrontCenter
 SG_ VFC_Poly06_RangeXCorrectionPoint : 152|8@1+ (1,0) [0|255] "m"  RadarFrontCenter
 SG_ VFC_Poly06_RangeXBegin : 160|9@1+ (0.25,0) [0|127.75] "m"  RadarFrontCenter
 SG_ VFC_Poly06_Reserved0 : 169|7@1+ (1,0) [0|127] "unitless"  RadarFrontCenter
 SG_ VFC_Poly06_RangeXEnd : 176|9@1+ (0.5,0) [0|255.5] "m"  RadarFrontCenter
 SG_ VFC_Poly06_Reserved1 : 185|7@1+ (1,0) [0|127] "unitless"  RadarFrontCenter
 SG_ VFC_Poly07_LaneAssociation : 192|4@1+ (1,0) [0|15] ""  RadarFrontCenter
 SG_ VFC_Poly07_Type : 196|4@1+ (1,0) [0|15] ""  RadarFrontCenter
 SG_ VFC_Poly07_ExistProb : 200|6@1+ (2,0) [0|100] "%"  RadarFrontCenter
 SG_ VFC_Poly07_CoefficientYc3 : 206|18@1+ (1.49011611938476E-008,-0.001953125) [-0.001953125|0.00195311009883879] "1/m^2"  RadarFrontCenter
 SG_ VFC_Poly07_Colour : 224|3@1+ (1,0) [0|7] ""  RadarFrontCenter
 SG_ VFC_Poly07_CoefficientYc2 : 227|17@1+ (9.5367431640625E-007,-0.0625) [-0.0625|0.0624990463256836] "1/m"  RadarFrontCenter
 SG_ VFC_Poly07_CoefficientYc0 : 244|12@1+ (0.0078125,-16) [-16|15.9921875] "m"  RadarFrontCenter
 SG_ VFC_Poly07_CoefficientYc1 : 256|15@1+ (6.103515625E-005,-1) [-1|0.99993896484375] "1"  RadarFrontCenter
 SG_ VFC_Poly07_CoefficientYc2Corr : 271|17@1+ (9.5367431640625E-007,-0.0625) [-0.0625|0.0624990463256836] "1/m"  RadarFrontCenter
 SG_ VFC_Poly07_CoefficientYc3Corr : 288|18@1+ (1.49011611938476E-008,-0.001953125) [-0.001953125|0.00195311009883879] "1/m^2"  RadarFrontCenter
 SG_ VFC_Poly07_Width : 306|6@1+ (0.01,0) [0|0.63] "m"  RadarFrontCenter
 SG_ VFC_Poly07_RangeXCorrectionPoint : 312|8@1+ (1,0) [0|255] "m"  RadarFrontCenter
 SG_ VFC_Poly07_RangeXBegin : 320|9@1+ (0.25,0) [0|127.75] "m"  RadarFrontCenter
 SG_ VFC_Poly07_Reserved0 : 329|7@1+ (1,0) [0|127] "unitless"  RadarFrontCenter
 SG_ VFC_Poly07_RangeXEnd : 336|9@1+ (0.5,0) [0|255.5] "m"  RadarFrontCenter
 SG_ VFC_Poly07_Reserved1 : 345|7@1+ (1,0) [0|127] "unitless"  RadarFrontCenter
 SG_ VFC_Poly08_LaneAssociation : 352|4@1+ (1,0) [0|15] ""  RadarFrontCenter
 SG_ VFC_Poly08_Type : 356|4@1+ (1,0) [0|15] ""  RadarFrontCenter
 SG_ VFC_Poly08_ExistProb : 360|6@1+ (2,0) [0|100] "%"  RadarFrontCenter
 SG_ VFC_Poly08_CoefficientYc3 : 366|18@1+ (1.49011611938476E-008,-0.001953125) [-0.001953125|0.00195311009883879] "1/m^2"  RadarFrontCenter
 SG_ VFC_Poly08_Colour : 384|3@1+ (1,0) [0|7] ""  RadarFrontCenter
 SG_ VFC_Poly08_CoefficientYc2 : 387|17@1+ (9.5367431640625E-007,-0.0625) [-0.0625|0.0624990463256836] "1/m"  RadarFrontCenter
 SG_ VFC_Poly08_CoefficientYc0 : 404|12@1+ (0.0078125,-16) [-16|15.9921875] "m"  RadarFrontCenter
 SG_ VFC_Poly08_CoefficientYc1 : 416|15@1+ (6.103515625E-005,-1) [-1|0.99993896484375] "1"  RadarFrontCenter
 SG_ VFC_Poly08_CoefficientYc2Corr : 431|17@1+ (9.5367431640625E-007,-0.0625) [-0.0625|0.0624990463256836] "1/m"  RadarFrontCenter
 SG_ VFC_Poly08_CoefficientYc3Corr : 448|18@1+ (1.49011611938476E-008,-0.001953125) [-0.001953125|0.00195311009883879] "1/m^2"  RadarFrontCenter
 SG_ VFC_Poly08_Width : 466|6@1+ (0.01,0) [0|0.63] "m"  RadarFrontCenter
 SG_ VFC_Poly08_RangeXCorrectionPoint : 472|8@1+ (1,0) [0|255] "m"  RadarFrontCenter
 SG_ VFC_Poly08_RangeXBegin : 480|9@1+ (0.25,0) [0|127.75] "m"  RadarFrontCenter
 SG_ VFC_Poly08_Reserved0 : 489|7@1+ (1,0) [0|127] "unitless"  RadarFrontCenter
 SG_ VFC_Poly08_RangeXEnd : 496|9@1+ (0.5,0) [0|255.5] "m"  RadarFrontCenter
 SG_ VFC_Poly08_Reserved1 : 505|7@1+ (1,0) [0|127] "unitless"  RadarFrontCenter

BO_ 149 VFC_RoadPolynomial_09_11: 64 VideoFrontCenter
 SG_ VFC_Poly_09_11_CRC : 0|16@1+ (1,0) [0|65535] ""  RadarFrontCenter
 SG_ VFC_Poly_09_11_AliveCtr : 16|8@1+ (1,0) [0|255] ""  RadarFrontCenter
 SG_ VFC_Poly_09_11_ProtBlockCtr : 24|4@1+ (1,0) [0|15] ""  RadarFrontCenter
 SG_ VFC_Poly09_LaneAssociation : 32|4@1+ (1,0) [0|15] ""  RadarFrontCenter
 SG_ VFC_Poly09_Type : 36|4@1+ (1,0) [0|15] ""  RadarFrontCenter
 SG_ VFC_Poly09_ExistProb : 40|6@1+ (2,0) [0|100] "%"  RadarFrontCenter
 SG_ VFC_Poly09_CoefficientYc3 : 46|18@1+ (1.49011611938476E-008,-0.001953125) [-0.001953125|0.00195311009883879] "1/m^2"  RadarFrontCenter
 SG_ VFC_Poly09_Colour : 64|3@1+ (1,0) [0|7] ""  RadarFrontCenter
 SG_ VFC_Poly09_CoefficientYc2 : 67|17@1+ (9.5367431640625E-007,-0.0625) [-0.0625|0.0624990463256836] "1/m"  RadarFrontCenter
 SG_ VFC_Poly09_CoefficientYc0 : 84|12@1+ (0.0078125,-16) [-16|15.9921875] "m"  RadarFrontCenter
 SG_ VFC_Poly09_CoefficientYc1 : 96|15@1+ (6.103515625E-005,-1) [-1|0.99993896484375] "1"  RadarFrontCenter
 SG_ VFC_Poly09_CoefficientYc2Corr : 111|17@1+ (9.5367431640625E-007,-0.0625) [-0.0625|0.0624990463256836] "1/m"  RadarFrontCenter
 SG_ VFC_Poly09_CoefficientYc3Corr : 128|18@1+ (1.49011611938476E-008,-0.001953125) [-0.001953125|0.00195311009883879] "1/m^2"  RadarFrontCenter
 SG_ VFC_Poly09_Width : 146|6@1+ (0.01,0) [0|0.63] "m"  RadarFrontCenter
 SG_ VFC_Poly09_RangeXCorrectionPoint : 152|8@1+ (1,0) [0|255] "m"  RadarFrontCenter
 SG_ VFC_Poly09_RangeXBegin : 160|9@1+ (0.25,0) [0|127.75] "m"  RadarFrontCenter
 SG_ VFC_Poly09_Reserved0 : 169|7@1+ (1,0) [0|127] "unitless"  RadarFrontCenter
 SG_ VFC_Poly09_RangeXEnd : 176|9@1+ (0.5,0) [0|255.5] "m"  RadarFrontCenter
 SG_ VFC_Poly09_Reserved1 : 185|7@1+ (1,0) [0|127] "unitless"  RadarFrontCenter
 SG_ VFC_Poly10_LaneAssociation : 192|4@1+ (1,0) [0|15] ""  RadarFrontCenter
 SG_ VFC_Poly10_Type : 196|4@1+ (1,0) [0|15] ""  RadarFrontCenter
 SG_ VFC_Poly10_ExistProb : 200|6@1+ (2,0) [0|100] "%"  RadarFrontCenter
 SG_ VFC_Poly10_CoefficientYc3 : 206|18@1+ (1.49011611938476E-008,-0.001953125) [-0.001953125|0.00195311009883879] "1/m^2"  RadarFrontCenter
 SG_ VFC_Poly10_Colour : 224|3@1+ (1,0) [0|7] ""  RadarFrontCenter
 SG_ VFC_Poly10_CoefficientYc2 : 227|17@1+ (9.5367431640625E-007,-0.0625) [-0.0625|0.0624990463256836] "1/m"  RadarFrontCenter
 SG_ VFC_Poly10_CoefficientYc0 : 244|12@1+ (0.0078125,-16) [-16|15.9921875] "m"  RadarFrontCenter
 SG_ VFC_Poly10_CoefficientYc1 : 256|15@1+ (6.103515625E-005,-1) [-1|0.99993896484375] "1"  RadarFrontCenter
 SG_ VFC_Poly10_CoefficientYc2Corr : 271|17@1+ (9.5367431640625E-007,-0.0625) [-0.0625|0.0624990463256836] "1/m"  RadarFrontCenter
 SG_ VFC_Poly10_CoefficientYc3Corr : 288|18@1+ (1.49011611938476E-008,-0.001953125) [-0.001953125|0.00195311009883879] "1/m^2"  RadarFrontCenter
 SG_ VFC_Poly10_Width : 306|6@1+ (0.01,0) [0|0.63] "m"  RadarFrontCenter
 SG_ VFC_Poly10_RangeXCorrectionPoint : 312|8@1+ (1,0) [0|255] "m"  RadarFrontCenter
 SG_ VFC_Poly10_RangeXBegin : 320|9@1+ (0.25,0) [0|127.75] "m"  RadarFrontCenter
 SG_ VFC_Poly10_Reserved0 : 329|7@1+ (1,0) [0|127] "unitless"  RadarFrontCenter
 SG_ VFC_Poly10_RangeXEnd : 336|9@1+ (0.5,0) [0|255.5] "m"  RadarFrontCenter
 SG_ VFC_Poly10_Reserved1 : 345|7@1+ (1,0) [0|127] "unitless"  RadarFrontCenter
 SG_ VFC_Poly11_LaneAssociation : 352|4@1+ (1,0) [0|15] ""  RadarFrontCenter
 SG_ VFC_Poly11_Type : 356|4@1+ (1,0) [0|15] ""  RadarFrontCenter
 SG_ VFC_Poly11_ExistProb : 360|6@1+ (2,0) [0|100] "%"  RadarFrontCenter
 SG_ VFC_Poly11_CoefficientYc3 : 366|18@1+ (1.49011611938476E-008,-0.001953125) [-0.001953125|0.00195311009883879] "1/m^2"  RadarFrontCenter
 SG_ VFC_Poly11_Colour : 384|3@1+ (1,0) [0|7] ""  RadarFrontCenter
 SG_ VFC_Poly11_CoefficientYc2 : 387|17@1+ (9.5367431640625E-007,-0.0625) [-0.0625|0.0624990463256836] "1/m"  RadarFrontCenter
 SG_ VFC_Poly11_CoefficientYc0 : 404|12@1+ (0.0078125,-16) [-16|15.9921875] "m"  RadarFrontCenter
 SG_ VFC_Poly11_CoefficientYc1 : 416|15@1+ (6.103515625E-005,-1) [-1|0.99993896484375] "1"  RadarFrontCenter
 SG_ VFC_Poly11_CoefficientYc2Corr : 431|17@1+ (9.5367431640625E-007,-0.0625) [-0.0625|0.0624990463256836] "1/m"  RadarFrontCenter
 SG_ VFC_Poly11_CoefficientYc3Corr : 448|18@1+ (1.49011611938476E-008,-0.001953125) [-0.001953125|0.00195311009883879] "1/m^2"  RadarFrontCenter
 SG_ VFC_Poly11_Width : 466|6@1+ (0.01,0) [0|0.63] "m"  RadarFrontCenter
 SG_ VFC_Poly11_RangeXCorrectionPoint : 472|8@1+ (1,0) [0|255] "m"  RadarFrontCenter
 SG_ VFC_Poly11_RangeXBegin : 480|9@1+ (0.25,0) [0|127.75] "m"  RadarFrontCenter
 SG_ VFC_Poly11_Reserved0 : 489|7@1+ (1,0) [0|127] "unitless"  RadarFrontCenter
 SG_ VFC_Poly11_RangeXEnd : 496|9@1+ (0.5,0) [0|255.5] "m"  RadarFrontCenter
 SG_ VFC_Poly11_Reserved1 : 505|7@1+ (1,0) [0|127] "unitless"  RadarFrontCenter

BO_ 162 VFC_Road2DPolynomial_00_02: 64 VideoFrontCenter
 SG_ VFC_2DPoly_00_02_CRC : 0|16@1+ (1,0) [0|65535] ""  RadarFrontCenter
 SG_ VFC_2DPoly_00_02_AliveCtr : 16|8@1+ (1,0) [0|255] ""  RadarFrontCenter
 SG_ VFC_2DPoly_00_02_ProtBlockCtr : 24|4@1+ (1,0) [0|15] ""  RadarFrontCenter
 SG_ VFC_2DPoly00_LaneAssociation : 32|4@1+ (1,0) [0|15] ""  RadarFrontCenter
 SG_ VFC_2DPoly00_ExistProb : 38|6@1+ (2,0) [0|100] "%"  RadarFrontCenter
 SG_ VFC_2DPoly00_Type : 44|4@1+ (1,0) [0|15] ""  RadarFrontCenter
 SG_ VFC_2DPoly00_CoefficientUc0 : 48|16@1+ (0.25,-8192) [-8192|8191.75] "pixel"  RadarFrontCenter
 SG_ VFC_2DPoly00_CoefficientUc1 : 64|16@1+ (0.25,-8192) [-8192|8191.75] "pixel"  RadarFrontCenter
 SG_ VFC_2DPoly00_CoefficientUc2 : 80|16@1+ (0.25,-8192) [-8192|8191.75] "pixel"  RadarFrontCenter
 SG_ VFC_2DPoly00_CoefficientUc3 : 96|16@1+ (0.25,-8192) [-8192|8191.75] "pixel"  RadarFrontCenter
 SG_ VFC_2DPoly00_CoefficientUc4 : 112|16@1+ (0.25,-8192) [-8192|8191.75] "pixel"  RadarFrontCenter
 SG_ VFC_2DPoly00_CoefficientUc5 : 128|16@1+ (0.25,-8192) [-8192|8191.75] "pixel"  RadarFrontCenter
 SG_ VFC_2DPoly00_RangeVBegin : 144|12@1+ (1,0) [0|4095] "pixel"  RadarFrontCenter
 SG_ VFC_2DPoly00_RangeVEnd : 156|12@1+ (1,0) [0|4095] "pixel"  RadarFrontCenter
 SG_ VFC_2DPoly01_LaneAssociation : 192|4@1+ (1,0) [0|15] ""  RadarFrontCenter
 SG_ VFC_2DPoly01_ExistProb : 198|6@1+ (2,0) [0|100] "%"  RadarFrontCenter
 SG_ VFC_2DPoly01_Type : 204|4@1+ (1,0) [0|15] ""  RadarFrontCenter
 SG_ VFC_2DPoly01_CoefficientUc0 : 208|16@1+ (0.25,-8192) [-8192|8191.75] "pixel"  RadarFrontCenter
 SG_ VFC_2DPoly01_CoefficientUc1 : 224|16@1+ (0.25,-8192) [-8192|8191.75] "pixel"  RadarFrontCenter
 SG_ VFC_2DPoly01_CoefficientUc2 : 240|16@1+ (0.25,-8192) [-8192|8191.75] "pixel"  RadarFrontCenter
 SG_ VFC_2DPoly01_CoefficientUc3 : 256|16@1+ (0.25,-8192) [-8192|8191.75] "pixel"  RadarFrontCenter
 SG_ VFC_2DPoly01_CoefficientUc4 : 272|16@1+ (0.25,-8192) [-8192|8191.75] "pixel"  RadarFrontCenter
 SG_ VFC_2DPoly01_CoefficientUc5 : 288|16@1+ (0.25,-8192) [-8192|8191.75] "pixel"  RadarFrontCenter
 SG_ VFC_2DPoly01_RangeVBegin : 304|12@1+ (1,0) [0|4095] "pixel"  RadarFrontCenter
 SG_ VFC_2DPoly01_RangeVEnd : 316|12@1+ (1,0) [0|4095] "pixel"  RadarFrontCenter
 SG_ VFC_2DPoly02_LaneAssociation : 352|4@1+ (1,0) [0|15] ""  RadarFrontCenter
 SG_ VFC_2DPoly02_ExistProb : 358|6@1+ (2,0) [0|100] "%"  RadarFrontCenter
 SG_ VFC_2DPoly02_Type : 364|4@1+ (1,0) [0|15] ""  RadarFrontCenter
 SG_ VFC_2DPoly02_CoefficientUc0 : 368|16@1+ (0.25,-8192) [-8192|8191.75] "pixel"  RadarFrontCenter
 SG_ VFC_2DPoly02_CoefficientUc1 : 384|16@1+ (0.25,-8192) [-8192|8191.75] "pixel"  RadarFrontCenter
 SG_ VFC_2DPoly02_CoefficientUc2 : 400|16@1+ (0.25,-8192) [-8192|8191.75] "pixel"  RadarFrontCenter
 SG_ VFC_2DPoly02_CoefficientUc3 : 416|16@1+ (0.25,-8192) [-8192|8191.75] "pixel"  RadarFrontCenter
 SG_ VFC_2DPoly02_CoefficientUc4 : 432|16@1+ (0.25,-8192) [-8192|8191.75] "pixel"  RadarFrontCenter
 SG_ VFC_2DPoly02_CoefficientUc5 : 448|16@1+ (0.25,-8192) [-8192|8191.75] "pixel"  RadarFrontCenter
 SG_ VFC_2DPoly02_RangeVBegin : 464|12@1+ (1,0) [0|4095] "pixel"  RadarFrontCenter
 SG_ VFC_2DPoly02_RangeVEnd : 476|12@1+ (1,0) [0|4095] "pixel"  RadarFrontCenter

BO_ 163 VFC_Road2DPolynomial_03_05: 64 VideoFrontCenter
 SG_ VFC_2DPoly_03_05_CRC : 0|16@1+ (1,0) [0|65535] ""  RadarFrontCenter
 SG_ VFC_2DPoly_03_05_AliveCtr : 16|8@1+ (1,0) [0|255] ""  RadarFrontCenter
 SG_ VFC_2DPoly_03_05_ProtBlockCtr : 24|4@1+ (1,0) [0|15] ""  RadarFrontCenter
 SG_ VFC_2DPoly03_LaneAssociation : 32|4@1+ (1,0) [0|15] ""  RadarFrontCenter
 SG_ VFC_2DPoly03_ExistProb : 38|6@1+ (2,0) [0|100] "%"  RadarFrontCenter
 SG_ VFC_2DPoly03_Type : 44|4@1+ (1,0) [0|15] ""  RadarFrontCenter
 SG_ VFC_2DPoly03_CoefficientUc0 : 48|16@1+ (0.25,-8192) [-8192|8191.75] "pixel"  RadarFrontCenter
 SG_ VFC_2DPoly03_CoefficientUc1 : 64|16@1+ (0.25,-8192) [-8192|8191.75] "pixel"  RadarFrontCenter
 SG_ VFC_2DPoly03_CoefficientUc2 : 80|16@1+ (0.25,-8192) [-8192|8191.75] "pixel"  RadarFrontCenter
 SG_ VFC_2DPoly03_CoefficientUc3 : 96|16@1+ (0.25,-8192) [-8192|8191.75] "pixel"  RadarFrontCenter
 SG_ VFC_2DPoly03_CoefficientUc4 : 112|16@1+ (0.25,-8192) [-8192|8191.75] "pixel"  RadarFrontCenter
 SG_ VFC_2DPoly03_CoefficientUc5 : 128|16@1+ (0.25,-8192) [-8192|8191.75] "pixel"  RadarFrontCenter
 SG_ VFC_2DPoly03_RangeVBegin : 144|12@1+ (1,0) [0|4095] "pixel"  RadarFrontCenter
 SG_ VFC_2DPoly03_RangeVEnd : 156|12@1+ (1,0) [0|4095] "pixel"  RadarFrontCenter
 SG_ VFC_2DPoly04_LaneAssociation : 192|4@1+ (1,0) [0|15] ""  RadarFrontCenter
 SG_ VFC_2DPoly04_ExistProb : 198|6@1+ (2,0) [0|100] "%"  RadarFrontCenter
 SG_ VFC_2DPoly04_Type : 204|4@1+ (1,0) [0|15] ""  RadarFrontCenter
 SG_ VFC_2DPoly04_CoefficientUc0 : 208|16@1+ (0.25,-8192) [-8192|8191.75] "pixel"  RadarFrontCenter
 SG_ VFC_2DPoly04_CoefficientUc1 : 224|16@1+ (0.25,-8192) [-8192|8191.75] "pixel"  RadarFrontCenter
 SG_ VFC_2DPoly04_CoefficientUc2 : 240|16@1+ (0.25,-8192) [-8192|8191.75] "pixel"  RadarFrontCenter
 SG_ VFC_2DPoly04_CoefficientUc3 : 256|16@1+ (0.25,-8192) [-8192|8191.75] "pixel"  RadarFrontCenter
 SG_ VFC_2DPoly04_CoefficientUc4 : 272|16@1+ (0.25,-8192) [-8192|8191.75] "pixel"  RadarFrontCenter
 SG_ VFC_2DPoly04_CoefficientUc5 : 288|16@1+ (0.25,-8192) [-8192|8191.75] "pixel"  RadarFrontCenter
 SG_ VFC_2DPoly04_RangeVBegin : 304|12@1+ (1,0) [0|4095] "pixel"  RadarFrontCenter
 SG_ VFC_2DPoly04_RangeVEnd : 316|12@1+ (1,0) [0|4095] "pixel"  RadarFrontCenter
 SG_ VFC_2DPoly05_LaneAssociation : 352|4@1+ (1,0) [0|15] ""  RadarFrontCenter
 SG_ VFC_2DPoly05_ExistProb : 358|6@1+ (2,0) [0|100] "%"  RadarFrontCenter
 SG_ VFC_2DPoly05_Type : 364|4@1+ (1,0) [0|15] ""  RadarFrontCenter
 SG_ VFC_2DPoly05_CoefficientUc0 : 368|16@1+ (0.25,-8192) [-8192|8191.75] "pixel"  RadarFrontCenter
 SG_ VFC_2DPoly05_CoefficientUc1 : 384|16@1+ (0.25,-8192) [-8192|8191.75] "pixel"  RadarFrontCenter
 SG_ VFC_2DPoly05_CoefficientUc2 : 400|16@1+ (0.25,-8192) [-8192|8191.75] "pixel"  RadarFrontCenter
 SG_ VFC_2DPoly05_CoefficientUc3 : 416|16@1+ (0.25,-8192) [-8192|8191.75] "pixel"  RadarFrontCenter
 SG_ VFC_2DPoly05_CoefficientUc4 : 432|16@1+ (0.25,-8192) [-8192|8191.75] "pixel"  RadarFrontCenter
 SG_ VFC_2DPoly05_CoefficientUc5 : 448|16@1+ (0.25,-8192) [-8192|8191.75] "pixel"  RadarFrontCenter
 SG_ VFC_2DPoly05_RangeVBegin : 464|12@1+ (1,0) [0|4095] "pixel"  RadarFrontCenter
 SG_ VFC_2DPoly05_RangeVEnd : 476|12@1+ (1,0) [0|4095] "pixel"  RadarFrontCenter

BO_ 164 VFC_Road2DPolynomial_06_08: 64 VideoFrontCenter
 SG_ VFC_2DPoly_06_08_CRC : 0|16@1+ (1,0) [0|65535] ""  RadarFrontCenter
 SG_ VFC_2DPoly_06_08_AliveCtr : 16|8@1+ (1,0) [0|255] ""  RadarFrontCenter
 SG_ VFC_2DPoly_06_08_ProtBlockCtr : 24|4@1+ (1,0) [0|15] ""  RadarFrontCenter
 SG_ VFC_2DPoly06_LaneAssociation : 32|4@1+ (1,0) [0|15] ""  RadarFrontCenter
 SG_ VFC_2DPoly06_ExistProb : 38|6@1+ (2,0) [0|100] "%"  RadarFrontCenter
 SG_ VFC_2DPoly06_Type : 44|4@1+ (1,0) [0|15] ""  RadarFrontCenter
 SG_ VFC_2DPoly06_CoefficientUc0 : 48|16@1+ (0.25,-8192) [-8192|8191.75] "pixel"  RadarFrontCenter
 SG_ VFC_2DPoly06_CoefficientUc1 : 64|16@1+ (0.25,-8192) [-8192|8191.75] "pixel"  RadarFrontCenter
 SG_ VFC_2DPoly06_CoefficientUc2 : 80|16@1+ (0.25,-8192) [-8192|8191.75] "pixel"  RadarFrontCenter
 SG_ VFC_2DPoly06_CoefficientUc3 : 96|16@1+ (0.25,-8192) [-8192|8191.75] "pixel"  RadarFrontCenter
 SG_ VFC_2DPoly06_CoefficientUc4 : 112|16@1+ (0.25,-8192) [-8192|8191.75] "pixel"  RadarFrontCenter
 SG_ VFC_2DPoly06_CoefficientUc5 : 128|16@1+ (0.25,-8192) [-8192|8191.75] "pixel"  RadarFrontCenter
 SG_ VFC_2DPoly06_RangeVBegin : 144|12@1+ (1,0) [0|4095] "pixel"  RadarFrontCenter
 SG_ VFC_2DPoly06_RangeVEnd : 156|12@1+ (1,0) [0|4095] "pixel"  RadarFrontCenter
 SG_ VFC_2DPoly07_LaneAssociation : 192|4@1+ (1,0) [0|15] ""  RadarFrontCenter
 SG_ VFC_2DPoly07_ExistProb : 198|6@1+ (2,0) [0|100] "%"  RadarFrontCenter
 SG_ VFC_2DPoly07_Type : 204|4@1+ (1,0) [0|15] ""  RadarFrontCenter
 SG_ VFC_2DPoly07_CoefficientUc0 : 208|16@1+ (0.25,-8192) [-8192|8191.75] "pixel"  RadarFrontCenter
 SG_ VFC_2DPoly07_CoefficientUc1 : 224|16@1+ (0.25,-8192) [-8192|8191.75] "pixel"  RadarFrontCenter
 SG_ VFC_2DPoly07_CoefficientUc2 : 240|16@1+ (0.25,-8192) [-8192|8191.75] "pixel"  RadarFrontCenter
 SG_ VFC_2DPoly07_CoefficientUc3 : 256|16@1+ (0.25,-8192) [-8192|8191.75] "pixel"  RadarFrontCenter
 SG_ VFC_2DPoly07_CoefficientUc4 : 272|16@1+ (0.25,-8192) [-8192|8191.75] "pixel"  RadarFrontCenter
 SG_ VFC_2DPoly07_CoefficientUc5 : 288|16@1+ (0.25,-8192) [-8192|8191.75] "pixel"  RadarFrontCenter
 SG_ VFC_2DPoly07_RangeVBegin : 304|12@1+ (1,0) [0|4095] "pixel"  RadarFrontCenter
 SG_ VFC_2DPoly07_RangeVEnd : 316|12@1+ (1,0) [0|4095] "pixel"  RadarFrontCenter
 SG_ VFC_2DPoly08_LaneAssociation : 352|4@1+ (1,0) [0|15] ""  RadarFrontCenter
 SG_ VFC_2DPoly08_ExistProb : 358|6@1+ (2,0) [0|100] "%"  RadarFrontCenter
 SG_ VFC_2DPoly08_Type : 364|4@1+ (1,0) [0|15] ""  RadarFrontCenter
 SG_ VFC_2DPoly08_CoefficientUc0 : 368|16@1+ (0.25,-8192) [-8192|8191.75] "pixel"  RadarFrontCenter
 SG_ VFC_2DPoly08_CoefficientUc1 : 384|16@1+ (0.25,-8192) [-8192|8191.75] "pixel"  RadarFrontCenter
 SG_ VFC_2DPoly08_CoefficientUc2 : 400|16@1+ (0.25,-8192) [-8192|8191.75] "pixel"  RadarFrontCenter
 SG_ VFC_2DPoly08_CoefficientUc3 : 416|16@1+ (0.25,-8192) [-8192|8191.75] "pixel"  RadarFrontCenter
 SG_ VFC_2DPoly08_CoefficientUc4 : 432|16@1+ (0.25,-8192) [-8192|8191.75] "pixel"  RadarFrontCenter
 SG_ VFC_2DPoly08_CoefficientUc5 : 448|16@1+ (0.25,-8192) [-8192|8191.75] "pixel"  RadarFrontCenter
 SG_ VFC_2DPoly08_RangeVBegin : 464|12@1+ (1,0) [0|4095] "pixel"  RadarFrontCenter
 SG_ VFC_2DPoly08_RangeVEnd : 476|12@1+ (1,0) [0|4095] "pixel"  RadarFrontCenter

BO_ 165 VFC_Road2DPolynomial_09_11: 64 VideoFrontCenter
 SG_ VFC_2DPoly_09_11_CRC : 0|16@1+ (1,0) [0|65535] ""  RadarFrontCenter
 SG_ VFC_2DPoly_09_11_AliveCtr : 16|8@1+ (1,0) [0|255] ""  RadarFrontCenter
 SG_ VFC_2DPoly_09_11_ProtBlockCtr : 24|4@1+ (1,0) [0|15] ""  RadarFrontCenter
 SG_ VFC_2DPoly09_LaneAssociation : 32|4@1+ (1,0) [0|15] ""  RadarFrontCenter
 SG_ VFC_2DPoly09_ExistProb : 38|6@1+ (2,0) [0|100] "%"  RadarFrontCenter
 SG_ VFC_2DPoly09_Type : 44|4@1+ (1,0) [0|15] ""  RadarFrontCenter
 SG_ VFC_2DPoly09_CoefficientUc0 : 48|16@1+ (0.25,-8192) [-8192|8191.75] "pixel"  RadarFrontCenter
 SG_ VFC_2DPoly09_CoefficientUc1 : 64|16@1+ (0.25,-8192) [-8192|8191.75] "pixel"  RadarFrontCenter
 SG_ VFC_2DPoly09_CoefficientUc2 : 80|16@1+ (0.25,-8192) [-8192|8191.75] "pixel"  RadarFrontCenter
 SG_ VFC_2DPoly09_CoefficientUc3 : 96|16@1+ (0.25,-8192) [-8192|8191.75] "pixel"  RadarFrontCenter
 SG_ VFC_2DPoly09_CoefficientUc4 : 112|16@1+ (0.25,-8192) [-8192|8191.75] "pixel"  RadarFrontCenter
 SG_ VFC_2DPoly09_CoefficientUc5 : 128|16@1+ (0.25,-8192) [-8192|8191.75] "pixel"  RadarFrontCenter
 SG_ VFC_2DPoly09_RangeVBegin : 144|12@1+ (1,0) [0|4095] "pixel"  RadarFrontCenter
 SG_ VFC_2DPoly09_RangeVEnd : 156|12@1+ (1,0) [0|4095] "pixel"  RadarFrontCenter
 SG_ VFC_2DPoly10_LaneAssociation : 192|4@1+ (1,0) [0|15] ""  RadarFrontCenter
 SG_ VFC_2DPoly10_ExistProb : 198|6@1+ (2,0) [0|100] "%"  RadarFrontCenter
 SG_ VFC_2DPoly10_Type : 204|4@1+ (1,0) [0|15] ""  RadarFrontCenter
 SG_ VFC_2DPoly10_CoefficientUc0 : 208|16@1+ (0.25,-8192) [-8192|8191.75] "pixel"  RadarFrontCenter
 SG_ VFC_2DPoly10_CoefficientUc1 : 224|16@1+ (0.25,-8192) [-8192|8191.75] "pixel"  RadarFrontCenter
 SG_ VFC_2DPoly10_CoefficientUc2 : 240|16@1+ (0.25,-8192) [-8192|8191.75] "pixel"  RadarFrontCenter
 SG_ VFC_2DPoly10_CoefficientUc3 : 256|16@1+ (0.25,-8192) [-8192|8191.75] "pixel"  RadarFrontCenter
 SG_ VFC_2DPoly10_CoefficientUc4 : 272|16@1+ (0.25,-8192) [-8192|8191.75] "pixel"  RadarFrontCenter
 SG_ VFC_2DPoly10_CoefficientUc5 : 288|16@1+ (0.25,-8192) [-8192|8191.75] "pixel"  RadarFrontCenter
 SG_ VFC_2DPoly10_RangeVBegin : 304|12@1+ (1,0) [0|4095] "pixel"  RadarFrontCenter
 SG_ VFC_2DPoly10_RangeVEnd : 316|12@1+ (1,0) [0|4095] "pixel"  RadarFrontCenter
 SG_ VFC_2DPoly11_LaneAssociation : 352|4@1+ (1,0) [0|15] ""  RadarFrontCenter
 SG_ VFC_2DPoly11_ExistProb : 358|6@1+ (2,0) [0|100] "%"  RadarFrontCenter
 SG_ VFC_2DPoly11_Type : 364|4@1+ (1,0) [0|15] ""  RadarFrontCenter
 SG_ VFC_2DPoly11_CoefficientUc0 : 368|16@1+ (0.25,-8192) [-8192|8191.75] "pixel"  RadarFrontCenter
 SG_ VFC_2DPoly11_CoefficientUc1 : 384|16@1+ (0.25,-8192) [-8192|8191.75] "pixel"  RadarFrontCenter
 SG_ VFC_2DPoly11_CoefficientUc2 : 400|16@1+ (0.25,-8192) [-8192|8191.75] "pixel"  RadarFrontCenter
 SG_ VFC_2DPoly11_CoefficientUc3 : 416|16@1+ (0.25,-8192) [-8192|8191.75] "pixel"  RadarFrontCenter
 SG_ VFC_2DPoly11_CoefficientUc4 : 432|16@1+ (0.25,-8192) [-8192|8191.75] "pixel"  RadarFrontCenter
 SG_ VFC_2DPoly11_CoefficientUc5 : 448|16@1+ (0.25,-8192) [-8192|8191.75] "pixel"  RadarFrontCenter
 SG_ VFC_2DPoly11_RangeVBegin : 464|12@1+ (1,0) [0|4095] "pixel"  RadarFrontCenter
 SG_ VFC_2DPoly11_RangeVEnd : 476|12@1+ (1,0) [0|4095] "pixel"  RadarFrontCenter

BO_ 178 VFC_RoadMarking_00_06: 64 VideoFrontCenter
 SG_ VFC_RM_00_06_CRC : 0|16@1+ (1,0) [0|65535] ""  RadarFrontCenter
 SG_ VFC_RM_00_06_AliveCtr : 16|8@1+ (1,0) [0|255] ""  RadarFrontCenter
 SG_ VFC_RM_00_06_ProtBlockCtr : 24|4@1+ (1,0) [0|15] ""  RadarFrontCenter
 SG_ VFC_RM00_ExistProb : 32|6@1+ (2,0) [0|100] "%"  RadarFrontCenter
 SG_ VFC_RM00_Type : 38|5@1+ (1,0) [0|31] ""  RadarFrontCenter
 SG_ VFC_RM00_VertexPoint00x : 43|11@1+ (0.1,0) [0|204.7] "m"  RadarFrontCenter
 SG_ VFC_RM00_VertexPoint00y : 54|9@1+ (0.1,-25.6) [-25.6|25.5] "m"  RadarFrontCenter
 SG_ VFC_RM00_VertexPoint01x : 63|11@1+ (0.1,0) [0|204.7] "m"  RadarFrontCenter
 SG_ VFC_RM00_VertexPoint01y : 74|9@1+ (0.1,-25.6) [-25.6|25.5] "m"  RadarFrontCenter
 SG_ VFC_RM01_ExistProb : 96|6@1+ (2,0) [0|100] "%"  RadarFrontCenter
 SG_ VFC_RM01_Type : 102|5@1+ (1,0) [0|31] ""  RadarFrontCenter
 SG_ VFC_RM01_VertexPoint00x : 107|11@1+ (0.1,0) [0|204.7] "m"  RadarFrontCenter
 SG_ VFC_RM01_VertexPoint00y : 118|9@1+ (0.1,-25.6) [-25.6|25.5] "m"  RadarFrontCenter
 SG_ VFC_RM01_VertexPoint01x : 127|11@1+ (0.1,0) [0|204.7] "m"  RadarFrontCenter
 SG_ VFC_RM01_VertexPoint01y : 138|9@1+ (0.1,-25.6) [-25.6|25.5] "m"  RadarFrontCenter
 SG_ VFC_RM02_ExistProb : 160|6@1+ (2,0) [0|100] "%"  RadarFrontCenter
 SG_ VFC_RM02_Type : 166|5@1+ (1,0) [0|31] ""  RadarFrontCenter
 SG_ VFC_RM02_VertexPoint00x : 171|11@1+ (0.1,0) [0|204.7] "m"  RadarFrontCenter
 SG_ VFC_RM02_VertexPoint00y : 182|9@1+ (0.1,-25.6) [-25.6|25.5] "m"  RadarFrontCenter
 SG_ VFC_RM02_VertexPoint01x : 191|11@1+ (0.1,0) [0|204.7] "m"  RadarFrontCenter
 SG_ VFC_RM02_VertexPoint01y : 202|9@1+ (0.1,-25.6) [-25.6|25.5] "m"  RadarFrontCenter
 SG_ VFC_RM03_ExistProb : 224|6@1+ (2,0) [0|100] "%"  RadarFrontCenter
 SG_ VFC_RM03_Type : 230|5@1+ (1,0) [0|31] ""  RadarFrontCenter
 SG_ VFC_RM03_VertexPoint00x : 235|11@1+ (0.1,0) [0|204.7] "m"  RadarFrontCenter
 SG_ VFC_RM03_VertexPoint00y : 246|9@1+ (0.1,-25.6) [-25.6|25.5] "m"  RadarFrontCenter
 SG_ VFC_RM03_VertexPoint01x : 255|11@1+ (0.1,0) [0|204.7] "m"  RadarFrontCenter
 SG_ VFC_RM03_VertexPoint01y : 266|9@1+ (0.1,-25.6) [-25.6|25.5] "m"  RadarFrontCenter
 SG_ VFC_RM04_ExistProb : 288|6@1+ (2,0) [0|100] "%"  RadarFrontCenter
 SG_ VFC_RM04_Type : 294|5@1+ (1,0) [0|31] ""  RadarFrontCenter
 SG_ VFC_RM04_VertexPoint00x : 299|11@1+ (0.1,0) [0|204.7] "m"  RadarFrontCenter
 SG_ VFC_RM04_VertexPoint00y : 310|9@1+ (0.1,-25.6) [-25.6|25.5] "m"  RadarFrontCenter
 SG_ VFC_RM04_VertexPoint01x : 319|11@1+ (0.1,0) [0|204.7] "m"  RadarFrontCenter
 SG_ VFC_RM04_VertexPoint01y : 330|9@1+ (0.1,-25.6) [-25.6|25.5] "m"  RadarFrontCenter
 SG_ VFC_RM05_ExistProb : 352|6@1+ (2,0) [0|100] "%"  RadarFrontCenter
 SG_ VFC_RM05_Type : 358|5@1+ (1,0) [0|31] ""  RadarFrontCenter
 SG_ VFC_RM05_VertexPoint00x : 363|11@1+ (0.1,0) [0|204.7] "m"  RadarFrontCenter
 SG_ VFC_RM05_VertexPoint00y : 374|9@1+ (0.1,-25.6) [-25.6|25.5] "m"  RadarFrontCenter
 SG_ VFC_RM05_VertexPoint01x : 383|11@1+ (0.1,0) [0|204.7] "m"  RadarFrontCenter
 SG_ VFC_RM05_VertexPoint01y : 394|9@1+ (0.1,-25.6) [-25.6|25.5] "m"  RadarFrontCenter
 SG_ VFC_RM06_ExistProb : 416|6@1+ (2,0) [0|100] "%"  RadarFrontCenter
 SG_ VFC_RM06_Type : 422|5@1+ (1,0) [0|31] ""  RadarFrontCenter
 SG_ VFC_RM06_VertexPoint00x : 427|11@1+ (0.1,0) [0|204.7] "m"  RadarFrontCenter
 SG_ VFC_RM06_VertexPoint00y : 438|9@1+ (0.1,-25.6) [-25.6|25.5] "m"  RadarFrontCenter
 SG_ VFC_RM06_VertexPoint01x : 447|11@1+ (0.1,0) [0|204.7] "m"  RadarFrontCenter
 SG_ VFC_RM06_VertexPoint01y : 458|9@1+ (0.1,-25.6) [-25.6|25.5] "m"  RadarFrontCenter

BO_ 224 VFC_TrafficLightHdr: 20 VideoFrontCenter
 SG_ VFC_TLHdr_CRC : 0|16@1+ (1,0) [0|65535] ""  RadarFrontCenter
 SG_ VFC_TLHdr_AliveCtr : 16|8@1+ (1,0) [0|255] ""  RadarFrontCenter
 SG_ VFC_TLHdr_ProtBlockCtr : 24|4@1+ (1,0) [0|15] ""  RadarFrontCenter
 SG_ VFC_TLHdr_IfVersionIdMajor : 32|8@1+ (1,0) [0|255] ""  RadarFrontCenter
 SG_ VFC_TLHdr_IfVersionIdMinor : 40|8@1+ (1,0) [0|255] ""  RadarFrontCenter
 SG_ VFC_TLHdr_NumTrafficLights : 48|5@1+ (1,0) [0|31] ""  RadarFrontCenter
 SG_ VFC_TLHdr_TimeStampStatus : 56|8@1+ (1,0) [0|255] ""  RadarFrontCenter
 SG_ VFC_TLHdr_TimeStamp : 64|26@1+ (1,0) [0|67108863] "ms"  RadarFrontCenter
 SG_ VFC_TLHdr_State : 96|3@1+ (1,0) [0|7] ""  RadarFrontCenter
 SG_ VFC_TLHdr_MostRelevantTLId : 104|5@1+ (1,0) [0|31] ""  RadarFrontCenter
 SG_ VFC_TLHdr_Reserved0 : 112|8@1+ (1,0) [0|255] ""  RadarFrontCenter
 SG_ VFC_TLHdr_Reserved1 : 120|8@1+ (1,0) [0|255] ""  RadarFrontCenter

CM_ SG_ 131 VFC_Cloth_03_05_CRC "CRC - Autosar E2E Profile 5";
CM_ SG_ 131 VFC_Cloth_03_05_AliveCtr "Alive counter - Autosar E2E Profile 5";
CM_ SG_ 131 VFC_Cloth_03_05_ProtBlockCtr "Protocol-Signal: Block-Counter";
CM_ SG_ 131 VFC_Cloth03_LaneAssociation "Position relative to the ego lane. ISO 23150:2022(E): Road object lane association (A.2.93)";
CM_ SG_ 131 VFC_Cloth03_Colour "The color of the line. Similar to ISO 23150:2022(E): Colour value - object level (A.2.107)";
CM_ SG_ 131 VFC_Cloth03_RangeXBegin "Longitudinal begin of the clothoid. ISO 23150:2022(E): Polynomial range x {begin, end} (A.2.120)";
CM_ SG_ 131 VFC_Cloth03_RangeXEnd "Longitudinal end of the clothoid. ISO 23150:2022(E): Polynomial range x {begin, end} (A.2.120)";
CM_ SG_ 131 VFC_Cloth03_ExistProb "Confidence for this clothoid, probability that it describes the true lane boundary. ISO 23150:2022(E): Existence probability - object level (A.2.1)";
CM_ SG_ 131 VFC_Cloth03_CurvChange "Curvature change or alteration of the clothoid, also called kappaDt (resolution = 2^-29)";
CM_ SG_ 131 VFC_Cloth03_Curv "Curvature of the clothoid, also called kappa (resolution = 2^-18)";
CM_ SG_ 131 VFC_Cloth03_PyStdDev "Standard deviation at x=0 of the lateral offset (resolution = 2^-7)";
CM_ SG_ 131 VFC_Cloth03_Py "Lateral offset at x=0, also called LatDeviation (resolution = 2^-7)";
CM_ SG_ 131 VFC_Cloth03_OrientationYaw "Heading angle, difference in yaw angle between vehicle heading and clothoid (resolution = 2^-11). ISO 23150:2022(E): Orientation {yaw, pitch, roll} (A.2.17)";
CM_ SG_ 131 VFC_Cloth03_Width "Width of the line. ISO 23150:2022(E): Extent {width} - polynomial (A.2.121)";
CM_ SG_ 131 VFC_Cloth03_Type "Type of the Line. ISO 23150:2022(E): Road marking type (A.2.91)";
CM_ SG_ 131 VFC_Cloth04_LaneAssociation "Position relative to the ego lane. ISO 23150:2022(E): Road object lane association (A.2.93)";
CM_ SG_ 131 VFC_Cloth04_Colour "The color of the line. Similar to ISO 23150:2022(E): Colour value - object level (A.2.107)";
CM_ SG_ 131 VFC_Cloth04_RangeXBegin "Longitudinal begin of the clothoid. ISO 23150:2022(E): Polynomial range x {begin, end} (A.2.120)";
CM_ SG_ 131 VFC_Cloth04_RangeXEnd "Longitudinal end of the clothoid. ISO 23150:2022(E): Polynomial range x {begin, end} (A.2.120)";
CM_ SG_ 131 VFC_Cloth04_ExistProb "Confidence for this clothoid, probability that it describes the true lane boundary. ISO 23150:2022(E): Existence probability - object level (A.2.1)";
CM_ SG_ 131 VFC_Cloth04_CurvChange "Curvature change or alteration of the clothoid, also called kappaDt (resolution = 2^-29)";
CM_ SG_ 131 VFC_Cloth04_Curv "Curvature of the clothoid, also called kappa (resolution = 2^-18)";
CM_ SG_ 131 VFC_Cloth04_PyStdDev "Standard deviation at x=0 of the lateral offset (resolution = 2^-7)";
CM_ SG_ 131 VFC_Cloth04_Py "Lateral offset at x=0, also called LatDeviation (resolution = 2^-7)";
CM_ SG_ 131 VFC_Cloth04_OrientationYaw "Heading angle, difference in yaw angle between vehicle heading and clothoid (resolution = 2^-11). ISO 23150:2022(E): Orientation {yaw, pitch, roll} (A.2.17)";
CM_ SG_ 131 VFC_Cloth04_Width "Width of the line. ISO 23150:2022(E): Extent {width} - polynomial (A.2.121)";
CM_ SG_ 131 VFC_Cloth04_Type "Type of the Line. ISO 23150:2022(E): Road marking type (A.2.91)";
CM_ SG_ 131 VFC_Cloth05_LaneAssociation "Position relative to the ego lane. ISO 23150:2022(E): Road object lane association (A.2.93)";
CM_ SG_ 131 VFC_Cloth05_Colour "The color of the line. Similar to ISO 23150:2022(E): Colour value - object level (A.2.107)";
CM_ SG_ 131 VFC_Cloth05_RangeXBegin "Longitudinal begin of the clothoid. ISO 23150:2022(E): Polynomial range x {begin, end} (A.2.120)";
CM_ SG_ 131 VFC_Cloth05_RangeXEnd "Longitudinal end of the clothoid. ISO 23150:2022(E): Polynomial range x {begin, end} (A.2.120)";
CM_ SG_ 131 VFC_Cloth05_ExistProb "Confidence for this clothoid, probability that it describes the true lane boundary. ISO 23150:2022(E): Existence probability - object level (A.2.1)";
CM_ SG_ 131 VFC_Cloth05_CurvChange "Curvature change or alteration of the clothoid, also called kappaDt (resolution = 2^-29)";
CM_ SG_ 131 VFC_Cloth05_Curv "Curvature of the clothoid, also called kappa (resolution = 2^-18)";
CM_ SG_ 131 VFC_Cloth05_PyStdDev "Standard deviation at x=0 of the lateral offset (resolution = 2^-7)";
CM_ SG_ 131 VFC_Cloth05_Py "Lateral offset at x=0, also called LatDeviation (resolution = 2^-7)";
CM_ SG_ 131 VFC_Cloth05_OrientationYaw "Heading angle, difference in yaw angle between vehicle heading and clothoid (resolution = 2^-11). ISO 23150:2022(E): Orientation {yaw, pitch, roll} (A.2.17)";
CM_ SG_ 131 VFC_Cloth05_Width "Width of the line. ISO 23150:2022(E): Extent {width} - polynomial (A.2.121)";
CM_ SG_ 131 VFC_Cloth05_Type "Type of the Line. ISO 23150:2022(E): Road marking type (A.2.91)";
CM_ SG_ 132 VFC_Cloth_06_08_CRC "CRC - Autosar E2E Profile 5";
CM_ SG_ 132 VFC_Cloth_06_08_AliveCtr "Alive counter - Autosar E2E Profile 5";
CM_ SG_ 132 VFC_Cloth_06_08_ProtBlockCtr "Protocol-Signal: Block-Counter";
CM_ SG_ 132 VFC_Cloth06_LaneAssociation "Position relative to the ego lane. ISO 23150:2022(E): Road object lane association (A.2.93)";
CM_ SG_ 132 VFC_Cloth06_Colour "The color of the line. Similar to ISO 23150:2022(E): Colour value - object level (A.2.107)";
CM_ SG_ 132 VFC_Cloth06_RangeXBegin "Longitudinal begin of the clothoid. ISO 23150:2022(E): Polynomial range x {begin, end} (A.2.120)";
CM_ SG_ 132 VFC_Cloth06_RangeXEnd "Longitudinal end of the clothoid. ISO 23150:2022(E): Polynomial range x {begin, end} (A.2.120)";
CM_ SG_ 132 VFC_Cloth06_ExistProb "Confidence for this clothoid, probability that it describes the true lane boundary. ISO 23150:2022(E): Existence probability - object level (A.2.1)";
CM_ SG_ 132 VFC_Cloth06_CurvChange "Curvature change or alteration of the clothoid, also called kappaDt (resolution = 2^-29)";
CM_ SG_ 132 VFC_Cloth06_Curv "Curvature of the clothoid, also called kappa (resolution = 2^-18)";
CM_ SG_ 132 VFC_Cloth06_PyStdDev "Standard deviation at x=0 of the lateral offset (resolution = 2^-7)";
CM_ SG_ 132 VFC_Cloth06_Py "Lateral offset at x=0, also called LatDeviation (resolution = 2^-7)";
CM_ SG_ 132 VFC_Cloth06_OrientationYaw "Heading angle, difference in yaw angle between vehicle heading and clothoid (resolution = 2^-11). ISO 23150:2022(E): Orientation {yaw, pitch, roll} (A.2.17)";
CM_ SG_ 132 VFC_Cloth06_Width "Width of the line. ISO 23150:2022(E): Extent {width} - polynomial (A.2.121)";
CM_ SG_ 132 VFC_Cloth06_Type "Type of the Line. ISO 23150:2022(E): Road marking type (A.2.91)";
CM_ SG_ 132 VFC_Cloth07_LaneAssociation "Position relative to the ego lane. ISO 23150:2022(E): Road object lane association (A.2.93)";
CM_ SG_ 132 VFC_Cloth07_Colour "The color of the line. Similar to ISO 23150:2022(E): Colour value - object level (A.2.107)";
CM_ SG_ 132 VFC_Cloth07_RangeXBegin "Longitudinal begin of the clothoid. ISO 23150:2022(E): Polynomial range x {begin, end} (A.2.120)";
CM_ SG_ 132 VFC_Cloth07_RangeXEnd "Longitudinal end of the clothoid. ISO 23150:2022(E): Polynomial range x {begin, end} (A.2.120)";
CM_ SG_ 132 VFC_Cloth07_ExistProb "Confidence for this clothoid, probability that it describes the true lane boundary. ISO 23150:2022(E): Existence probability - object level (A.2.1)";
CM_ SG_ 132 VFC_Cloth07_CurvChange "Curvature change or alteration of the clothoid, also called kappaDt (resolution = 2^-29)";
CM_ SG_ 132 VFC_Cloth07_Curv "Curvature of the clothoid, also called kappa (resolution = 2^-18)";
CM_ SG_ 132 VFC_Cloth07_PyStdDev "Standard deviation at x=0 of the lateral offset (resolution = 2^-7)";
CM_ SG_ 132 VFC_Cloth07_Py "Lateral offset at x=0, also called LatDeviation (resolution = 2^-7)";
CM_ SG_ 132 VFC_Cloth07_OrientationYaw "Heading angle, difference in yaw angle between vehicle heading and clothoid (resolution = 2^-11). ISO 23150:2022(E): Orientation {yaw, pitch, roll} (A.2.17)";
CM_ SG_ 132 VFC_Cloth07_Width "Width of the line. ISO 23150:2022(E): Extent {width} - polynomial (A.2.121)";
CM_ SG_ 132 VFC_Cloth07_Type "Type of the Line. ISO 23150:2022(E): Road marking type (A.2.91)";
CM_ SG_ 132 VFC_Cloth08_LaneAssociation "Position relative to the ego lane. ISO 23150:2022(E): Road object lane association (A.2.93)";
CM_ SG_ 132 VFC_Cloth08_Colour "The color of the line. Similar to ISO 23150:2022(E): Colour value - object level (A.2.107)";
CM_ SG_ 132 VFC_Cloth08_RangeXBegin "Longitudinal begin of the clothoid. ISO 23150:2022(E): Polynomial range x {begin, end} (A.2.120)";
CM_ SG_ 132 VFC_Cloth08_RangeXEnd "Longitudinal end of the clothoid. ISO 23150:2022(E): Polynomial range x {begin, end} (A.2.120)";
CM_ SG_ 132 VFC_Cloth08_ExistProb "Confidence for this clothoid, probability that it describes the true lane boundary. ISO 23150:2022(E): Existence probability - object level (A.2.1)";
CM_ SG_ 132 VFC_Cloth08_CurvChange "Curvature change or alteration of the clothoid, also called kappaDt (resolution = 2^-29)";
CM_ SG_ 132 VFC_Cloth08_Curv "Curvature of the clothoid, also called kappa (resolution = 2^-18)";
CM_ SG_ 132 VFC_Cloth08_PyStdDev "Standard deviation at x=0 of the lateral offset (resolution = 2^-7)";
CM_ SG_ 132 VFC_Cloth08_Py "Lateral offset at x=0, also called LatDeviation (resolution = 2^-7)";
CM_ SG_ 132 VFC_Cloth08_OrientationYaw "Heading angle, difference in yaw angle between vehicle heading and clothoid (resolution = 2^-11). ISO 23150:2022(E): Orientation {yaw, pitch, roll} (A.2.17)";
CM_ SG_ 132 VFC_Cloth08_Width "Width of the line. ISO 23150:2022(E): Extent {width} - polynomial (A.2.121)";
CM_ SG_ 132 VFC_Cloth08_Type "Type of the Line. ISO 23150:2022(E): Road marking type (A.2.91)";
CM_ SG_ 133 VFC_Cloth_09_11_CRC "CRC - Autosar E2E Profile 5";
CM_ SG_ 133 VFC_Cloth_09_11_AliveCtr "Alive counter - Autosar E2E Profile 5";
CM_ SG_ 133 VFC_Cloth_09_11_ProtBlockCtr "Protocol-Signal: Block-Counter";
CM_ SG_ 133 VFC_Cloth09_LaneAssociation "Position relative to the ego lane. ISO 23150:2022(E): Road object lane association (A.2.93)";
CM_ SG_ 133 VFC_Cloth09_Colour "The color of the line. Similar to ISO 23150:2022(E): Colour value - object level (A.2.107)";
CM_ SG_ 133 VFC_Cloth09_RangeXBegin "Longitudinal begin of the clothoid. ISO 23150:2022(E): Polynomial range x {begin, end} (A.2.120)";
CM_ SG_ 133 VFC_Cloth09_RangeXEnd "Longitudinal end of the clothoid. ISO 23150:2022(E): Polynomial range x {begin, end} (A.2.120)";
CM_ SG_ 133 VFC_Cloth09_ExistProb "Confidence for this clothoid, probability that it describes the true lane boundary. ISO 23150:2022(E): Existence probability - object level (A.2.1)";
CM_ SG_ 133 VFC_Cloth09_CurvChange "Curvature change or alteration of the clothoid, also called kappaDt (resolution = 2^-29)";
CM_ SG_ 133 VFC_Cloth09_Curv "Curvature of the clothoid, also called kappa (resolution = 2^-18)";
CM_ SG_ 133 VFC_Cloth09_PyStdDev "Standard deviation at x=0 of the lateral offset (resolution = 2^-7)";
CM_ SG_ 133 VFC_Cloth09_Py "Lateral offset at x=0, also called LatDeviation (resolution = 2^-7)";
CM_ SG_ 133 VFC_Cloth09_OrientationYaw "Heading angle, difference in yaw angle between vehicle heading and clothoid (resolution = 2^-11). ISO 23150:2022(E): Orientation {yaw, pitch, roll} (A.2.17)";
CM_ SG_ 133 VFC_Cloth09_Width "Width of the line. ISO 23150:2022(E): Extent {width} - polynomial (A.2.121)";
CM_ SG_ 133 VFC_Cloth09_Type "Type of the Line. ISO 23150:2022(E): Road marking type (A.2.91)";
CM_ SG_ 133 VFC_Cloth10_LaneAssociation "Position relative to the ego lane. ISO 23150:2022(E): Road object lane association (A.2.93)";
CM_ SG_ 133 VFC_Cloth10_Colour "The color of the line. Similar to ISO 23150:2022(E): Colour value - object level (A.2.107)";
CM_ SG_ 133 VFC_Cloth10_RangeXBegin "Longitudinal begin of the clothoid. ISO 23150:2022(E): Polynomial range x {begin, end} (A.2.120)";
CM_ SG_ 133 VFC_Cloth10_RangeXEnd "Longitudinal end of the clothoid. ISO 23150:2022(E): Polynomial range x {begin, end} (A.2.120)";
CM_ SG_ 133 VFC_Cloth10_ExistProb "Confidence for this clothoid, probability that it describes the true lane boundary. ISO 23150:2022(E): Existence probability - object level (A.2.1)";
CM_ SG_ 133 VFC_Cloth10_CurvChange "Curvature change or alteration of the clothoid, also called kappaDt (resolution = 2^-29)";
CM_ SG_ 133 VFC_Cloth10_Curv "Curvature of the clothoid, also called kappa (resolution = 2^-18)";
CM_ SG_ 133 VFC_Cloth10_PyStdDev "Standard deviation at x=0 of the lateral offset (resolution = 2^-7)";
CM_ SG_ 133 VFC_Cloth10_Py "Lateral offset at x=0, also called LatDeviation (resolution = 2^-7)";
CM_ SG_ 133 VFC_Cloth10_OrientationYaw "Heading angle, difference in yaw angle between vehicle heading and clothoid (resolution = 2^-11). ISO 23150:2022(E): Orientation {yaw, pitch, roll} (A.2.17)";
CM_ SG_ 133 VFC_Cloth10_Width "Width of the line. ISO 23150:2022(E): Extent {width} - polynomial (A.2.121)";
CM_ SG_ 133 VFC_Cloth10_Type "Type of the Line. ISO 23150:2022(E): Road marking type (A.2.91)";
CM_ SG_ 133 VFC_Cloth11_LaneAssociation "Position relative to the ego lane. ISO 23150:2022(E): Road object lane association (A.2.93)";
CM_ SG_ 133 VFC_Cloth11_Colour "The color of the line. Similar to ISO 23150:2022(E): Colour value - object level (A.2.107)";
CM_ SG_ 133 VFC_Cloth11_RangeXBegin "Longitudinal begin of the clothoid. ISO 23150:2022(E): Polynomial range x {begin, end} (A.2.120)";
CM_ SG_ 133 VFC_Cloth11_RangeXEnd "Longitudinal end of the clothoid. ISO 23150:2022(E): Polynomial range x {begin, end} (A.2.120)";
CM_ SG_ 133 VFC_Cloth11_ExistProb "Confidence for this clothoid, probability that it describes the true lane boundary. ISO 23150:2022(E): Existence probability - object level (A.2.1)";
CM_ SG_ 133 VFC_Cloth11_CurvChange "Curvature change or alteration of the clothoid, also called kappaDt (resolution = 2^-29)";
CM_ SG_ 133 VFC_Cloth11_Curv "Curvature of the clothoid, also called kappa (resolution = 2^-18)";
CM_ SG_ 133 VFC_Cloth11_PyStdDev "Standard deviation at x=0 of the lateral offset (resolution = 2^-7)";
CM_ SG_ 133 VFC_Cloth11_Py "Lateral offset at x=0, also called LatDeviation (resolution = 2^-7)";
CM_ SG_ 133 VFC_Cloth11_OrientationYaw "Heading angle, difference in yaw angle between vehicle heading and clothoid (resolution = 2^-11). ISO 23150:2022(E): Orientation {yaw, pitch, roll} (A.2.17)";
CM_ SG_ 133 VFC_Cloth11_Width "Width of the line. ISO 23150:2022(E): Extent {width} - polynomial (A.2.121)";
CM_ SG_ 133 VFC_Cloth11_Type "Type of the Line. ISO 23150:2022(E): Road marking type (A.2.91)";
CM_ SG_ 146 VFC_Poly_00_02_CRC "CRC - Autosar E2E Profile 5";
CM_ SG_ 146 VFC_Poly_00_02_AliveCtr "Alive counter - Autosar E2E Profile 5";
CM_ SG_ 146 VFC_Poly_00_02_ProtBlockCtr "Protocol-Signal: Block-Counter";
CM_ SG_ 146 VFC_Poly00_LaneAssociation "Position relative to the ego lane. ISO 23150:2022(E): Road object lane association (A.2.93)";
CM_ SG_ 146 VFC_Poly00_Type "Type of the Line. ISO 23150:2022(E): Road marking type (A.2.91)";
CM_ SG_ 146 VFC_Poly00_ExistProb "Confidence for this line, probability that it describes the true lane boundary. ISO 23150:2022(E): Existence probability - object level (A.2.1)";
CM_ SG_ 146 VFC_Poly00_CoefficientYc3 "c3 coefficient of the  lateral polynomial.(resolution = 2^-26)  ISO 23150:2022(E): Polynomial coefficient y {c0,c1,c2,c3} (A.2.116)";
CM_ SG_ 146 VFC_Poly00_Colour "The color of the line. Similar to ISO 23150:2022(E): Colour value - object level (A.2.107)";
CM_ SG_ 146 VFC_Poly00_CoefficientYc2 "c2 coefficient of  the  lateral polynomial.(resolution = 2^-20) ISO 23150:2022(E): Polynomial coefficient y {c0,c1,c2,c3} (A.2.116)";
CM_ SG_ 146 VFC_Poly00_CoefficientYc0 "c0 coefficient of the lateral polynomial. (resolution = 2^-7) ISO 23150:2022(E): Polynomial coefficient y {c0,c1,c2,c3} (A.2.116)";
CM_ SG_ 146 VFC_Poly00_CoefficientYc1 "c1 coefficient of  the lateral polynomial. (resolution = 2^-14) ISO 23150:2022(E): Polynomial coefficient y {c0,c1,c2,c3} (A.2.116)";
CM_ SG_ 146 VFC_Poly00_CoefficientYc2Corr "c2 correction coefficient for lateral polynomial. (resolution = 2^-20) If X > XCorrectionPoint then Yc2Corr*(X-XCorrectionPoint)^2 shall be added to Y value. Deviation form ISO 23150:2022(E) polynomial representation";
CM_ SG_ 146 VFC_Poly00_CoefficientYc3Corr "c3 correction coefficient for lateral polynomial. (resolution = 2^-26) If X > XCorrectionPoint then Yc3Corr*(X-XCorrectionPoint)^3 shall be added to Y value. Deviation form 23150:2022(E) polynomial representation";
CM_ SG_ 146 VFC_Poly00_Width "Width of the line. ISO 23150:2022(E): Extent {width} - polynomial (A.2.121)";
CM_ SG_ 146 VFC_Poly00_RangeXCorrectionPoint "Transition point along the X axis the correction parameters shall be applied on the polynomial.  ISO 23150:2022(E): Polynomial range x {begin, end} (A.2.120)";
CM_ SG_ 146 VFC_Poly00_RangeXBegin "Longitudinal begin of the polynomial. ISO 23150:2022(E): Polynomial range x {begin, end} (A.2.120)";
CM_ SG_ 146 VFC_Poly00_Reserved0 "Reserved for future use";
CM_ SG_ 146 VFC_Poly00_RangeXEnd "Longitudinal end of the polynomial. ISO 23150:2022(E): Polynomial range x {begin, end} (A.2.120)";
CM_ SG_ 146 VFC_Poly00_Reserved1 "Reserved for future use";
CM_ SG_ 146 VFC_Poly01_LaneAssociation "Position relative to the ego lane. ISO 23150:2022(E): Road object lane association (A.2.93)";
CM_ SG_ 146 VFC_Poly01_Type "Type of the Line. ISO 23150:2022(E): Road marking type (A.2.91)";
CM_ SG_ 146 VFC_Poly01_ExistProb "Confidence for this line, probability that it describes the true lane boundary. ISO 23150:2022(E): Existence probability - object level (A.2.1)";
CM_ SG_ 146 VFC_Poly01_CoefficientYc3 "c3 coefficient of the  lateral polynomial.(resolution = 2^-26)  ISO 23150:2022(E): Polynomial coefficient y {c0,c1,c2,c3} (A.2.116)";
CM_ SG_ 146 VFC_Poly01_Colour "The color of the line. Similar to ISO 23150:2022(E): Colour value - object level (A.2.107)";
CM_ SG_ 146 VFC_Poly01_CoefficientYc2 "c2 coefficient of  the  lateral polynomial.(resolution = 2^-20) ISO 23150:2022(E): Polynomial coefficient y {c0,c1,c2,c3} (A.2.116)";
CM_ SG_ 146 VFC_Poly01_CoefficientYc0 "c0 coefficient of the lateral polynomial. (resolution = 2^-7) ISO 23150:2022(E): Polynomial coefficient y {c0,c1,c2,c3} (A.2.116)";
CM_ SG_ 146 VFC_Poly01_CoefficientYc1 "c1 coefficient of  the lateral polynomial. (resolution = 2^-14) ISO 23150:2022(E): Polynomial coefficient y {c0,c1,c2,c3} (A.2.116)";
CM_ SG_ 146 VFC_Poly01_CoefficientYc2Corr "c2 correction coefficient for lateral polynomial. (resolution = 2^-20) If X > XCorrectionPoint then Yc2Corr*(X-XCorrectionPoint)^2 shall be added to Y value. Deviation form ISO 23150:2022(E) polynomial representation";
CM_ SG_ 146 VFC_Poly01_CoefficientYc3Corr "c3 correction coefficient for lateral polynomial. (resolution = 2^-26) If X > XCorrectionPoint then Yc3Corr*(X-XCorrectionPoint)^3 shall be added to Y value. Deviation form 23150:2022(E) polynomial representation";
CM_ SG_ 146 VFC_Poly01_Width "Width of the line. ISO 23150:2022(E): Extent {width} - polynomial (A.2.121)";
CM_ SG_ 146 VFC_Poly01_RangeXCorrectionPoint "Transition point along the X axis the correction parameters shall be applied on the polynomial.  ISO 23150:2022(E): Polynomial range x {begin, end} (A.2.120)";
CM_ SG_ 146 VFC_Poly01_RangeXBegin "Longitudinal begin of the polynomial. ISO 23150:2022(E): Polynomial range x {begin, end} (A.2.120)";
CM_ SG_ 146 VFC_Poly01_Reserved0 "Reserved for future use";
CM_ SG_ 146 VFC_Poly01_RangeXEnd "Longitudinal end of the polynomial. ISO 23150:2022(E): Polynomial range x {begin, end} (A.2.120)";
CM_ SG_ 146 VFC_Poly01_Reserved1 "Reserved for future use";
CM_ SG_ 146 VFC_Poly02_LaneAssociation "Position relative to the ego lane. ISO 23150:2022(E): Road object lane association (A.2.93)";
CM_ SG_ 146 VFC_Poly02_Type "Type of the Line. ISO 23150:2022(E): Road marking type (A.2.91)";
CM_ SG_ 146 VFC_Poly02_ExistProb "Confidence for this line, probability that it describes the true lane boundary. ISO 23150:2022(E): Existence probability - object level (A.2.1)";
CM_ SG_ 146 VFC_Poly02_CoefficientYc3 "c3 coefficient of the  lateral polynomial.(resolution = 2^-26)  ISO 23150:2022(E): Polynomial coefficient y {c0,c1,c2,c3} (A.2.116)";
CM_ SG_ 146 VFC_Poly02_Colour "The color of the line. Similar to ISO 23150:2022(E): Colour value - object level (A.2.107)";
CM_ SG_ 146 VFC_Poly02_CoefficientYc2 "c2 coefficient of  the  lateral polynomial.(resolution = 2^-20) ISO 23150:2022(E): Polynomial coefficient y {c0,c1,c2,c3} (A.2.116)";
CM_ SG_ 146 VFC_Poly02_CoefficientYc0 "c0 coefficient of the lateral polynomial. (resolution = 2^-7) ISO 23150:2022(E): Polynomial coefficient y {c0,c1,c2,c3} (A.2.116)";
CM_ SG_ 146 VFC_Poly02_CoefficientYc1 "c1 coefficient of  the lateral polynomial. (resolution = 2^-14) ISO 23150:2022(E): Polynomial coefficient y {c0,c1,c2,c3} (A.2.116)";
CM_ SG_ 146 VFC_Poly02_CoefficientYc2Corr "c2 correction coefficient for lateral polynomial. (resolution = 2^-20) If X > XCorrectionPoint then Yc2Corr*(X-XCorrectionPoint)^2 shall be added to Y value. Deviation form ISO 23150:2022(E) polynomial representation";
CM_ SG_ 146 VFC_Poly02_CoefficientYc3Corr "c3 correction coefficient for lateral polynomial. (resolution = 2^-26) If X > XCorrectionPoint then Yc3Corr*(X-XCorrectionPoint)^3 shall be added to Y value. Deviation form 23150:2022(E) polynomial representation";
CM_ SG_ 146 VFC_Poly02_Width "Width of the line. ISO 23150:2022(E): Extent {width} - polynomial (A.2.121)";
CM_ SG_ 146 VFC_Poly02_RangeXCorrectionPoint "Transition point along the X axis the correction parameters shall be applied on the polynomial.  ISO 23150:2022(E): Polynomial range x {begin, end} (A.2.120)";
CM_ SG_ 146 VFC_Poly02_RangeXBegin "Longitudinal begin of the polynomial. ISO 23150:2022(E): Polynomial range x {begin, end} (A.2.120)";
CM_ SG_ 146 VFC_Poly02_Reserved0 "Reserved for future use";
CM_ SG_ 146 VFC_Poly02_RangeXEnd "Longitudinal end of the polynomial. ISO 23150:2022(E): Polynomial range x {begin, end} (A.2.120)";
CM_ SG_ 146 VFC_Poly02_Reserved1 "Reserved for future use";
CM_ SG_ 147 VFC_Poly_03_05_CRC "CRC - Autosar E2E Profile 5";
CM_ SG_ 147 VFC_Poly_03_05_AliveCtr "Alive counter - Autosar E2E Profile 5";
CM_ SG_ 147 VFC_Poly_03_05_ProtBlockCtr "Protocol-Signal: Block-Counter";
CM_ SG_ 147 VFC_Poly03_LaneAssociation "Position relative to the ego lane. ISO 23150:2022(E): Road object lane association (A.2.93)";
CM_ SG_ 147 VFC_Poly03_Type "Type of the Line. ISO 23150:2022(E): Road marking type (A.2.91)";
CM_ SG_ 147 VFC_Poly03_ExistProb "Confidence for this line, probability that it describes the true lane boundary. ISO 23150:2022(E): Existence probability - object level (A.2.1)";
CM_ SG_ 147 VFC_Poly03_CoefficientYc3 "c3 coefficient of the  lateral polynomial.(resolution = 2^-26)  ISO 23150:2022(E): Polynomial coefficient y {c0,c1,c2,c3} (A.2.116)";
CM_ SG_ 147 VFC_Poly03_Colour "The color of the line. Similar to ISO 23150:2022(E): Colour value - object level (A.2.107)";
CM_ SG_ 147 VFC_Poly03_CoefficientYc2 "c2 coefficient of  the  lateral polynomial.(resolution = 2^-20) ISO 23150:2022(E): Polynomial coefficient y {c0,c1,c2,c3} (A.2.116)";
CM_ SG_ 147 VFC_Poly03_CoefficientYc0 "c0 coefficient of the lateral polynomial. (resolution = 2^-7) ISO 23150:2022(E): Polynomial coefficient y {c0,c1,c2,c3} (A.2.116)";
CM_ SG_ 147 VFC_Poly03_CoefficientYc1 "c1 coefficient of  the lateral polynomial. (resolution = 2^-14) ISO 23150:2022(E): Polynomial coefficient y {c0,c1,c2,c3} (A.2.116)";
CM_ SG_ 147 VFC_Poly03_CoefficientYc2Corr "c2 correction coefficient for lateral polynomial. (resolution = 2^-20) If X > XCorrectionPoint then Yc2Corr*(X-XCorrectionPoint)^2 shall be added to Y value. Deviation form ISO 23150:2022(E) polynomial representation";
CM_ SG_ 147 VFC_Poly03_CoefficientYc3Corr "c3 correction coefficient for lateral polynomial. (resolution = 2^-26) If X > XCorrectionPoint then Yc3Corr*(X-XCorrectionPoint)^3 shall be added to Y value. Deviation form 23150:2022(E) polynomial representation";
CM_ SG_ 147 VFC_Poly03_Width "Width of the line. ISO 23150:2022(E): Extent {width} - polynomial (A.2.121)";
CM_ SG_ 147 VFC_Poly03_RangeXCorrectionPoint "Transition point along the X axis the correction parameters shall be applied on the polynomial.  ISO 23150:2022(E): Polynomial range x {begin, end} (A.2.120)";
CM_ SG_ 147 VFC_Poly03_RangeXBegin "Longitudinal begin of the polynomial. ISO 23150:2022(E): Polynomial range x {begin, end} (A.2.120)";
CM_ SG_ 147 VFC_Poly03_Reserved0 "Reserved for future use";
CM_ SG_ 147 VFC_Poly03_RangeXEnd "Longitudinal end of the polynomial. ISO 23150:2022(E): Polynomial range x {begin, end} (A.2.120)";
CM_ SG_ 147 VFC_Poly03_Reserved1 "Reserved for future use";
CM_ SG_ 147 VFC_Poly04_LaneAssociation "Position relative to the ego lane. ISO 23150:2022(E): Road object lane association (A.2.93)";
CM_ SG_ 147 VFC_Poly04_Type "Type of the Line. ISO 23150:2022(E): Road marking type (A.2.91)";
CM_ SG_ 147 VFC_Poly04_ExistProb "Confidence for this line, probability that it describes the true lane boundary. ISO 23150:2022(E): Existence probability - object level (A.2.1)";
CM_ SG_ 147 VFC_Poly04_CoefficientYc3 "c3 coefficient of the  lateral polynomial.(resolution = 2^-26)  ISO 23150:2022(E): Polynomial coefficient y {c0,c1,c2,c3} (A.2.116)";
CM_ SG_ 147 VFC_Poly04_Colour "The color of the line. Similar to ISO 23150:2022(E): Colour value - object level (A.2.107)";
CM_ SG_ 147 VFC_Poly04_CoefficientYc2 "c2 coefficient of  the  lateral polynomial.(resolution = 2^-20) ISO 23150:2022(E): Polynomial coefficient y {c0,c1,c2,c3} (A.2.116)";
CM_ SG_ 147 VFC_Poly04_CoefficientYc0 "c0 coefficient of the lateral polynomial. (resolution = 2^-7) ISO 23150:2022(E): Polynomial coefficient y {c0,c1,c2,c3} (A.2.116)";
CM_ SG_ 147 VFC_Poly04_CoefficientYc1 "c1 coefficient of  the lateral polynomial. (resolution = 2^-14) ISO 23150:2022(E): Polynomial coefficient y {c0,c1,c2,c3} (A.2.116)";
CM_ SG_ 147 VFC_Poly04_CoefficientYc2Corr "c2 correction coefficient for lateral polynomial. (resolution = 2^-20) If X > XCorrectionPoint then Yc2Corr*(X-XCorrectionPoint)^2 shall be added to Y value. Deviation form ISO 23150:2022(E) polynomial representation";
CM_ SG_ 147 VFC_Poly04_CoefficientYc3Corr "c3 correction coefficient for lateral polynomial. (resolution = 2^-26) If X > XCorrectionPoint then Yc3Corr*(X-XCorrectionPoint)^3 shall be added to Y value. Deviation form 23150:2022(E) polynomial representation";
CM_ SG_ 147 VFC_Poly04_Width "Width of the line. ISO 23150:2022(E): Extent {width} - polynomial (A.2.121)";
CM_ SG_ 147 VFC_Poly04_RangeXCorrectionPoint "Transition point along the X axis the correction parameters shall be applied on the polynomial.  ISO 23150:2022(E): Polynomial range x {begin, end} (A.2.120)";
CM_ SG_ 147 VFC_Poly04_RangeXBegin "Longitudinal begin of the polynomial. ISO 23150:2022(E): Polynomial range x {begin, end} (A.2.120)";
CM_ SG_ 147 VFC_Poly04_Reserved0 "Reserved for future use";
CM_ SG_ 147 VFC_Poly04_RangeXEnd "Longitudinal end of the polynomial. ISO 23150:2022(E): Polynomial range x {begin, end} (A.2.120)";
CM_ SG_ 147 VFC_Poly04_Reserved1 "Reserved for future use";
CM_ SG_ 147 VFC_Poly05_LaneAssociation "Position relative to the ego lane. ISO 23150:2022(E): Road object lane association (A.2.93)";
CM_ SG_ 147 VFC_Poly05_Type "Type of the Line. ISO 23150:2022(E): Road marking type (A.2.91)";
CM_ SG_ 147 VFC_Poly05_ExistProb "Confidence for this line, probability that it describes the true lane boundary. ISO 23150:2022(E): Existence probability - object level (A.2.1)";
CM_ SG_ 147 VFC_Poly05_CoefficientYc3 "c3 coefficient of the  lateral polynomial.(resolution = 2^-26)  ISO 23150:2022(E): Polynomial coefficient y {c0,c1,c2,c3} (A.2.116)";
CM_ SG_ 147 VFC_Poly05_Colour "The color of the line. Similar to ISO 23150:2022(E): Colour value - object level (A.2.107)";
CM_ SG_ 147 VFC_Poly05_CoefficientYc2 "c2 coefficient of  the  lateral polynomial.(resolution = 2^-20) ISO 23150:2022(E): Polynomial coefficient y {c0,c1,c2,c3} (A.2.116)";
CM_ SG_ 147 VFC_Poly05_CoefficientYc0 "c0 coefficient of the lateral polynomial. (resolution = 2^-7) ISO 23150:2022(E): Polynomial coefficient y {c0,c1,c2,c3} (A.2.116)";
CM_ SG_ 147 VFC_Poly05_CoefficientYc1 "c1 coefficient of  the lateral polynomial. (resolution = 2^-14) ISO 23150:2022(E): Polynomial coefficient y {c0,c1,c2,c3} (A.2.116)";
CM_ SG_ 147 VFC_Poly05_CoefficientYc2Corr "c2 correction coefficient for lateral polynomial. (resolution = 2^-20) If X > XCorrectionPoint then Yc2Corr*(X-XCorrectionPoint)^2 shall be added to Y value. Deviation form ISO 23150:2022(E) polynomial representation";
CM_ SG_ 147 VFC_Poly05_CoefficientYc3Corr "c3 correction coefficient for lateral polynomial. (resolution = 2^-26) If X > XCorrectionPoint then Yc3Corr*(X-XCorrectionPoint)^3 shall be added to Y value. Deviation form 23150:2022(E) polynomial representation";
CM_ SG_ 147 VFC_Poly05_Width "Width of the line. ISO 23150:2022(E): Extent {width} - polynomial (A.2.121)";
CM_ SG_ 147 VFC_Poly05_RangeXCorrectionPoint "Transition point along the X axis the correction parameters shall be applied on the polynomial.  ISO 23150:2022(E): Polynomial range x {begin, end} (A.2.120)";
CM_ SG_ 147 VFC_Poly05_RangeXBegin "Longitudinal begin of the polynomial. ISO 23150:2022(E): Polynomial range x {begin, end} (A.2.120)";
CM_ SG_ 147 VFC_Poly05_Reserved0 "Reserved for future use";
CM_ SG_ 147 VFC_Poly05_RangeXEnd "Longitudinal end of the polynomial. ISO 23150:2022(E): Polynomial range x {begin, end} (A.2.120)";
CM_ SG_ 147 VFC_Poly05_Reserved1 "Reserved for future use";
CM_ SG_ 148 VFC_Poly_06_08_CRC "CRC - Autosar E2E Profile 5";
CM_ SG_ 148 VFC_Poly_06_08_AliveCtr "Alive counter - Autosar E2E Profile 5";
CM_ SG_ 148 VFC_Poly_06_08_ProtBlockCtr "Protocol-Signal: Block-Counter";
CM_ SG_ 148 VFC_Poly06_LaneAssociation "Position relative to the ego lane. ISO 23150:2022(E): Road object lane association (A.2.93)";
CM_ SG_ 148 VFC_Poly06_Type "Type of the Line. ISO 23150:2022(E): Road marking type (A.2.91)";
CM_ SG_ 148 VFC_Poly06_ExistProb "Confidence for this line, probability that it describes the true lane boundary. ISO 23150:2022(E): Existence probability - object level (A.2.1)";
CM_ SG_ 148 VFC_Poly06_CoefficientYc3 "c3 coefficient of the  lateral polynomial.(resolution = 2^-26)  ISO 23150:2022(E): Polynomial coefficient y {c0,c1,c2,c3} (A.2.116)";
CM_ SG_ 148 VFC_Poly06_Colour "The color of the line. Similar to ISO 23150:2022(E): Colour value - object level (A.2.107)";
CM_ SG_ 148 VFC_Poly06_CoefficientYc2 "c2 coefficient of  the  lateral polynomial.(resolution = 2^-20) ISO 23150:2022(E): Polynomial coefficient y {c0,c1,c2,c3} (A.2.116)";
CM_ SG_ 148 VFC_Poly06_CoefficientYc0 "c0 coefficient of the lateral polynomial. (resolution = 2^-7) ISO 23150:2022(E): Polynomial coefficient y {c0,c1,c2,c3} (A.2.116)";
CM_ SG_ 148 VFC_Poly06_CoefficientYc1 "c1 coefficient of  the lateral polynomial. (resolution = 2^-14) ISO 23150:2022(E): Polynomial coefficient y {c0,c1,c2,c3} (A.2.116)";
CM_ SG_ 148 VFC_Poly06_CoefficientYc2Corr "c2 correction coefficient for lateral polynomial. (resolution = 2^-20) If X > XCorrectionPoint then Yc2Corr*(X-XCorrectionPoint)^2 shall be added to Y value. Deviation form ISO 23150:2022(E) polynomial representation";
CM_ SG_ 148 VFC_Poly06_CoefficientYc3Corr "c3 correction coefficient for lateral polynomial. (resolution = 2^-26) If X > XCorrectionPoint then Yc3Corr*(X-XCorrectionPoint)^3 shall be added to Y value. Deviation form 23150:2022(E) polynomial representation";
CM_ SG_ 148 VFC_Poly06_Width "Width of the line. ISO 23150:2022(E): Extent {width} - polynomial (A.2.121)";
CM_ SG_ 148 VFC_Poly06_RangeXCorrectionPoint "Transition point along the X axis the correction parameters shall be applied on the polynomial.  ISO 23150:2022(E): Polynomial range x {begin, end} (A.2.120)";
CM_ SG_ 148 VFC_Poly06_RangeXBegin "Longitudinal begin of the polynomial. ISO 23150:2022(E): Polynomial range x {begin, end} (A.2.120)";
CM_ SG_ 148 VFC_Poly06_Reserved0 "Reserved for future use";
CM_ SG_ 148 VFC_Poly06_RangeXEnd "Longitudinal end of the polynomial. ISO 23150:2022(E): Polynomial range x {begin, end} (A.2.120)";
CM_ SG_ 148 VFC_Poly06_Reserved1 "Reserved for future use";
CM_ SG_ 148 VFC_Poly07_LaneAssociation "Position relative to the ego lane. ISO 23150:2022(E): Road object lane association (A.2.93)";
CM_ SG_ 148 VFC_Poly07_Type "Type of the Line. ISO 23150:2022(E): Road marking type (A.2.91)";
CM_ SG_ 148 VFC_Poly07_ExistProb "Confidence for this line, probability that it describes the true lane boundary. ISO 23150:2022(E): Existence probability - object level (A.2.1)";
CM_ SG_ 148 VFC_Poly07_CoefficientYc3 "c3 coefficient of the  lateral polynomial.(resolution = 2^-26)  ISO 23150:2022(E): Polynomial coefficient y {c0,c1,c2,c3} (A.2.116)";
CM_ SG_ 148 VFC_Poly07_Colour "The color of the line. Similar to ISO 23150:2022(E): Colour value - object level (A.2.107)";
CM_ SG_ 148 VFC_Poly07_CoefficientYc2 "c2 coefficient of  the  lateral polynomial.(resolution = 2^-20) ISO 23150:2022(E): Polynomial coefficient y {c0,c1,c2,c3} (A.2.116)";
CM_ SG_ 148 VFC_Poly07_CoefficientYc0 "c0 coefficient of the lateral polynomial. (resolution = 2^-7) ISO 23150:2022(E): Polynomial coefficient y {c0,c1,c2,c3} (A.2.116)";
CM_ SG_ 148 VFC_Poly07_CoefficientYc1 "c1 coefficient of  the lateral polynomial. (resolution = 2^-14) ISO 23150:2022(E): Polynomial coefficient y {c0,c1,c2,c3} (A.2.116)";
CM_ SG_ 148 VFC_Poly07_CoefficientYc2Corr "c2 correction coefficient for lateral polynomial. (resolution = 2^-20) If X > XCorrectionPoint then Yc2Corr*(X-XCorrectionPoint)^2 shall be added to Y value. Deviation form ISO 23150:2022(E) polynomial representation";
CM_ SG_ 148 VFC_Poly07_CoefficientYc3Corr "c3 correction coefficient for lateral polynomial. (resolution = 2^-26) If X > XCorrectionPoint then Yc3Corr*(X-XCorrectionPoint)^3 shall be added to Y value. Deviation form 23150:2022(E) polynomial representation";
CM_ SG_ 148 VFC_Poly07_Width "Width of the line. ISO 23150:2022(E): Extent {width} - polynomial (A.2.121)";
CM_ SG_ 148 VFC_Poly07_RangeXCorrectionPoint "Transition point along the X axis the correction parameters shall be applied on the polynomial.  ISO 23150:2022(E): Polynomial range x {begin, end} (A.2.120)";
CM_ SG_ 148 VFC_Poly07_RangeXBegin "Longitudinal begin of the polynomial. ISO 23150:2022(E): Polynomial range x {begin, end} (A.2.120)";
CM_ SG_ 148 VFC_Poly07_Reserved0 "Reserved for future use";
CM_ SG_ 148 VFC_Poly07_RangeXEnd "Longitudinal end of the polynomial. ISO 23150:2022(E): Polynomial range x {begin, end} (A.2.120)";
CM_ SG_ 148 VFC_Poly07_Reserved1 "Reserved for future use";
CM_ SG_ 148 VFC_Poly08_LaneAssociation "Position relative to the ego lane. ISO 23150:2022(E): Road object lane association (A.2.93)";
CM_ SG_ 148 VFC_Poly08_Type "Type of the Line. ISO 23150:2022(E): Road marking type (A.2.91)";
CM_ SG_ 148 VFC_Poly08_ExistProb "Confidence for this line, probability that it describes the true lane boundary. ISO 23150:2022(E): Existence probability - object level (A.2.1)";
CM_ SG_ 148 VFC_Poly08_CoefficientYc3 "c3 coefficient of the  lateral polynomial.(resolution = 2^-26)  ISO 23150:2022(E): Polynomial coefficient y {c0,c1,c2,c3} (A.2.116)";
CM_ SG_ 148 VFC_Poly08_Colour "The color of the line. Similar to ISO 23150:2022(E): Colour value - object level (A.2.107)";
CM_ SG_ 148 VFC_Poly08_CoefficientYc2 "c2 coefficient of  the  lateral polynomial.(resolution = 2^-20) ISO 23150:2022(E): Polynomial coefficient y {c0,c1,c2,c3} (A.2.116)";
CM_ SG_ 148 VFC_Poly08_CoefficientYc0 "c0 coefficient of the lateral polynomial. (resolution = 2^-7) ISO 23150:2022(E): Polynomial coefficient y {c0,c1,c2,c3} (A.2.116)";
CM_ SG_ 148 VFC_Poly08_CoefficientYc1 "c1 coefficient of  the lateral polynomial. (resolution = 2^-14) ISO 23150:2022(E): Polynomial coefficient y {c0,c1,c2,c3} (A.2.116)";
CM_ SG_ 148 VFC_Poly08_CoefficientYc2Corr "c2 correction coefficient for lateral polynomial. (resolution = 2^-20) If X > XCorrectionPoint then Yc2Corr*(X-XCorrectionPoint)^2 shall be added to Y value. Deviation form ISO 23150:2022(E) polynomial representation";
CM_ SG_ 148 VFC_Poly08_CoefficientYc3Corr "c3 correction coefficient for lateral polynomial. (resolution = 2^-26) If X > XCorrectionPoint then Yc3Corr*(X-XCorrectionPoint)^3 shall be added to Y value. Deviation form 23150:2022(E) polynomial representation";
CM_ SG_ 148 VFC_Poly08_Width "Width of the line. ISO 23150:2022(E): Extent {width} - polynomial (A.2.121)";
CM_ SG_ 148 VFC_Poly08_RangeXCorrectionPoint "Transition point along the X axis the correction parameters shall be applied on the polynomial.  ISO 23150:2022(E): Polynomial range x {begin, end} (A.2.120)";
CM_ SG_ 148 VFC_Poly08_RangeXBegin "Longitudinal begin of the polynomial. ISO 23150:2022(E): Polynomial range x {begin, end} (A.2.120)";
CM_ SG_ 148 VFC_Poly08_Reserved0 "Reserved for future use";
CM_ SG_ 148 VFC_Poly08_RangeXEnd "Longitudinal end of the polynomial. ISO 23150:2022(E): Polynomial range x {begin, end} (A.2.120)";
CM_ SG_ 148 VFC_Poly08_Reserved1 "Reserved for future use";
CM_ SG_ 149 VFC_Poly_09_11_CRC "CRC - Autosar E2E Profile 5";
CM_ SG_ 149 VFC_Poly_09_11_AliveCtr "Alive counter - Autosar E2E Profile 5";
CM_ SG_ 149 VFC_Poly_09_11_ProtBlockCtr "Protocol-Signal: Block-Counter";
CM_ SG_ 149 VFC_Poly09_LaneAssociation "Position relative to the ego lane. ISO 23150:2022(E): Road object lane association (A.2.93)";
CM_ SG_ 149 VFC_Poly09_Type "Type of the Line. ISO 23150:2022(E): Road marking type (A.2.91)";
CM_ SG_ 149 VFC_Poly09_ExistProb "Confidence for this line, probability that it describes the true lane boundary. ISO 23150:2022(E): Existence probability - object level (A.2.1)";
CM_ SG_ 149 VFC_Poly09_CoefficientYc3 "c3 coefficient of the  lateral polynomial.(resolution = 2^-26)  ISO 23150:2022(E): Polynomial coefficient y {c0,c1,c2,c3} (A.2.116)";
CM_ SG_ 149 VFC_Poly09_Colour "The color of the line. Similar to ISO 23150:2022(E): Colour value - object level (A.2.107)";
CM_ SG_ 149 VFC_Poly09_CoefficientYc2 "c2 coefficient of  the  lateral polynomial.(resolution = 2^-20) ISO 23150:2022(E): Polynomial coefficient y {c0,c1,c2,c3} (A.2.116)";
CM_ SG_ 149 VFC_Poly09_CoefficientYc0 "c0 coefficient of the lateral polynomial. (resolution = 2^-7) ISO 23150:2022(E): Polynomial coefficient y {c0,c1,c2,c3} (A.2.116)";
CM_ SG_ 149 VFC_Poly09_CoefficientYc1 "c1 coefficient of  the lateral polynomial. (resolution = 2^-14) ISO 23150:2022(E): Polynomial coefficient y {c0,c1,c2,c3} (A.2.116)";
CM_ SG_ 149 VFC_Poly09_CoefficientYc2Corr "c2 correction coefficient for lateral polynomial. (resolution = 2^-20) If X > XCorrectionPoint then Yc2Corr*(X-XCorrectionPoint)^2 shall be added to Y value. Deviation form ISO 23150:2022(E) polynomial representation";
CM_ SG_ 149 VFC_Poly09_CoefficientYc3Corr "c3 correction coefficient for lateral polynomial. (resolution = 2^-26) If X > XCorrectionPoint then Yc3Corr*(X-XCorrectionPoint)^3 shall be added to Y value. Deviation form 23150:2022(E) polynomial representation";
CM_ SG_ 149 VFC_Poly09_Width "Width of the line. ISO 23150:2022(E): Extent {width} - polynomial (A.2.121)";
CM_ SG_ 149 VFC_Poly09_RangeXCorrectionPoint "Transition point along the X axis the correction parameters shall be applied on the polynomial.  ISO 23150:2022(E): Polynomial range x {begin, end} (A.2.120)";
CM_ SG_ 149 VFC_Poly09_RangeXBegin "Longitudinal begin of the polynomial. ISO 23150:2022(E): Polynomial range x {begin, end} (A.2.120)";
CM_ SG_ 149 VFC_Poly09_Reserved0 "Reserved for future use";
CM_ SG_ 149 VFC_Poly09_RangeXEnd "Longitudinal end of the polynomial. ISO 23150:2022(E): Polynomial range x {begin, end} (A.2.120)";
CM_ SG_ 149 VFC_Poly09_Reserved1 "Reserved for future use";
CM_ SG_ 149 VFC_Poly10_LaneAssociation "Position relative to the ego lane. ISO 23150:2022(E): Road object lane association (A.2.93)";
CM_ SG_ 149 VFC_Poly10_Type "Type of the Line. ISO 23150:2022(E): Road marking type (A.2.91)";
CM_ SG_ 149 VFC_Poly10_ExistProb "Confidence for this line, probability that it describes the true lane boundary. ISO 23150:2022(E): Existence probability - object level (A.2.1)";
CM_ SG_ 149 VFC_Poly10_CoefficientYc3 "c3 coefficient of the  lateral polynomial.(resolution = 2^-26)  ISO 23150:2022(E): Polynomial coefficient y {c0,c1,c2,c3} (A.2.116)";
CM_ SG_ 149 VFC_Poly10_Colour "The color of the line. Similar to ISO 23150:2022(E): Colour value - object level (A.2.107)";
CM_ SG_ 149 VFC_Poly10_CoefficientYc2 "c2 coefficient of  the  lateral polynomial.(resolution = 2^-20) ISO 23150:2022(E): Polynomial coefficient y {c0,c1,c2,c3} (A.2.116)";
CM_ SG_ 149 VFC_Poly10_CoefficientYc0 "c0 coefficient of the lateral polynomial. (resolution = 2^-7) ISO 23150:2022(E): Polynomial coefficient y {c0,c1,c2,c3} (A.2.116)";
CM_ SG_ 149 VFC_Poly10_CoefficientYc1 "c1 coefficient of  the lateral polynomial. (resolution = 2^-14) ISO 23150:2022(E): Polynomial coefficient y {c0,c1,c2,c3} (A.2.116)";
CM_ SG_ 149 VFC_Poly10_CoefficientYc2Corr "c2 correction coefficient for lateral polynomial. (resolution = 2^-20) If X > XCorrectionPoint then Yc2Corr*(X-XCorrectionPoint)^2 shall be added to Y value. Deviation form ISO 23150:2022(E) polynomial representation";
CM_ SG_ 149 VFC_Poly10_CoefficientYc3Corr "c3 correction coefficient for lateral polynomial. (resolution = 2^-26) If X > XCorrectionPoint then Yc3Corr*(X-XCorrectionPoint)^3 shall be added to Y value. Deviation form 23150:2022(E) polynomial representation";
CM_ SG_ 149 VFC_Poly10_Width "Width of the line. ISO 23150:2022(E): Extent {width} - polynomial (A.2.121)";
CM_ SG_ 149 VFC_Poly10_RangeXCorrectionPoint "Transition point along the X axis the correction parameters shall be applied on the polynomial.  ISO 23150:2022(E): Polynomial range x {begin, end} (A.2.120)";
CM_ SG_ 149 VFC_Poly10_RangeXBegin "Longitudinal begin of the polynomial. ISO 23150:2022(E): Polynomial range x {begin, end} (A.2.120)";
CM_ SG_ 149 VFC_Poly10_Reserved0 "Reserved for future use";
CM_ SG_ 149 VFC_Poly10_RangeXEnd "Longitudinal end of the polynomial. ISO 23150:2022(E): Polynomial range x {begin, end} (A.2.120)";
CM_ SG_ 149 VFC_Poly10_Reserved1 "Reserved for future use";
CM_ SG_ 149 VFC_Poly11_LaneAssociation "Position relative to the ego lane. ISO 23150:2022(E): Road object lane association (A.2.93)";
CM_ SG_ 149 VFC_Poly11_Type "Type of the Line. ISO 23150:2022(E): Road marking type (A.2.91)";
CM_ SG_ 149 VFC_Poly11_ExistProb "Confidence for this line, probability that it describes the true lane boundary. ISO 23150:2022(E): Existence probability - object level (A.2.1)";
CM_ SG_ 149 VFC_Poly11_CoefficientYc3 "c3 coefficient of the  lateral polynomial.(resolution = 2^-26)  ISO 23150:2022(E): Polynomial coefficient y {c0,c1,c2,c3} (A.2.116)";
CM_ SG_ 149 VFC_Poly11_Colour "The color of the line. Similar to ISO 23150:2022(E): Colour value - object level (A.2.107)";
CM_ SG_ 149 VFC_Poly11_CoefficientYc2 "c2 coefficient of  the  lateral polynomial.(resolution = 2^-20) ISO 23150:2022(E): Polynomial coefficient y {c0,c1,c2,c3} (A.2.116)";
CM_ SG_ 149 VFC_Poly11_CoefficientYc0 "c0 coefficient of the lateral polynomial. (resolution = 2^-7) ISO 23150:2022(E): Polynomial coefficient y {c0,c1,c2,c3} (A.2.116)";
CM_ SG_ 149 VFC_Poly11_CoefficientYc1 "c1 coefficient of  the lateral polynomial. (resolution = 2^-14) ISO 23150:2022(E): Polynomial coefficient y {c0,c1,c2,c3} (A.2.116)";
CM_ SG_ 149 VFC_Poly11_CoefficientYc2Corr "c2 correction coefficient for lateral polynomial. (resolution = 2^-20) If X > XCorrectionPoint then Yc2Corr*(X-XCorrectionPoint)^2 shall be added to Y value. Deviation form ISO 23150:2022(E) polynomial representation";
CM_ SG_ 149 VFC_Poly11_CoefficientYc3Corr "c3 correction coefficient for lateral polynomial. (resolution = 2^-26) If X > XCorrectionPoint then Yc3Corr*(X-XCorrectionPoint)^3 shall be added to Y value. Deviation form 23150:2022(E) polynomial representation";
CM_ SG_ 149 VFC_Poly11_Width "Width of the line. ISO 23150:2022(E): Extent {width} - polynomial (A.2.121)";
CM_ SG_ 149 VFC_Poly11_RangeXCorrectionPoint "Transition point along the X axis the correction parameters shall be applied on the polynomial.  ISO 23150:2022(E): Polynomial range x {begin, end} (A.2.120)";
CM_ SG_ 149 VFC_Poly11_RangeXBegin "Longitudinal begin of the polynomial. ISO 23150:2022(E): Polynomial range x {begin, end} (A.2.120)";
CM_ SG_ 149 VFC_Poly11_Reserved0 "Reserved for future use";
CM_ SG_ 149 VFC_Poly11_RangeXEnd "Longitudinal end of the polynomial. ISO 23150:2022(E): Polynomial range x {begin, end} (A.2.120)";
CM_ SG_ 149 VFC_Poly11_Reserved1 "Reserved for future use";
CM_ SG_ 162 VFC_2DPoly_00_02_CRC "CRC - Autosar E2E Profile 5";
CM_ SG_ 162 VFC_2DPoly_00_02_AliveCtr "Alive counter - Autosar E2E Profile 5";
CM_ SG_ 162 VFC_2DPoly_00_02_ProtBlockCtr "Protocol-Signal: Block-Counter";
CM_ SG_ 162 VFC_2DPoly00_LaneAssociation "Position relative to the ego lane. ISO 23150:2022(E): Road object lane association (A.2.93)";
CM_ SG_ 162 VFC_2DPoly00_ExistProb "ISO 23150:2022(E): Existence probability - object level (A.2.1)";
CM_ SG_ 162 VFC_2DPoly00_Type "Type of the Line. ISO 23150:2022(E): Road marking type (A.2.91)";
CM_ SG_ 162 VFC_2DPoly00_CoefficientUc0 "Polynomial coefficient for the u-axis value (in CV coordinates, origin top left). Similar to ISO 23150:2022(E): Polynomial coefficient y {c0,c1,c2,c3} (A.2.116)";
CM_ SG_ 162 VFC_2DPoly00_CoefficientUc1 "Polynomial coefficient for the u-axis value (in CV coordinates, origin top left). Similar to ISO 23150:2022(E): Polynomial coefficient y {c0,c1,c2,c3} (A.2.116)";
CM_ SG_ 162 VFC_2DPoly00_CoefficientUc2 "Polynomial coefficient for the u-axis value (in CV coordinates, origin top left). Similar to ISO 23150:2022(E): Polynomial coefficient y {c0,c1,c2,c3} (A.2.116)";
CM_ SG_ 162 VFC_2DPoly00_CoefficientUc3 "Polynomial coefficient for the u-axis value (in CV coordinates, origin top left). Similar to ISO 23150:2022(E): Polynomial coefficient y {c0,c1,c2,c3} (A.2.116)";
CM_ SG_ 162 VFC_2DPoly00_CoefficientUc4 "Polynomial coefficient for the u-axis value (in CV coordinates, origin top left). Similar to ISO 23150:2022(E): Polynomial coefficient y {c0,c1,c2,c3} (A.2.116)";
CM_ SG_ 162 VFC_2DPoly00_CoefficientUc5 "Polynomial coefficient for the u-axis value (in CV coordinates, origin top left). Similar to ISO 23150:2022(E): Polynomial coefficient y {c0,c1,c2,c3} (A.2.116)";
CM_ SG_ 162 VFC_2DPoly00_RangeVBegin "Longitudinal begin of the polynomial (big v value) (in CV coordinates, origin top left). Similar to ISO 23150:2022(E): Polynomial range x {begin, end} (A.2.120)";
CM_ SG_ 162 VFC_2DPoly00_RangeVEnd "Longitudinal end of the polynomial (small v value) (in CV coordinates, origin top left). Similar to ISO 23150:2022(E): Polynomial range x {begin, end} (A.2.120)";
CM_ SG_ 162 VFC_2DPoly01_LaneAssociation "Position relative to the ego lane. ISO 23150:2022(E): Road object lane association (A.2.93)";
CM_ SG_ 162 VFC_2DPoly01_ExistProb "ISO 23150:2022(E): Existence probability - object level (A.2.1)";
CM_ SG_ 162 VFC_2DPoly01_Type "Type of the Line. ISO 23150:2022(E): Road marking type (A.2.91)";
CM_ SG_ 162 VFC_2DPoly01_CoefficientUc0 "Polynomial coefficient for the u-axis value (in CV coordinates, origin top left). Similar to ISO 23150:2022(E): Polynomial coefficient y {c0,c1,c2,c3} (A.2.116)";
CM_ SG_ 162 VFC_2DPoly01_CoefficientUc1 "Polynomial coefficient for the u-axis value (in CV coordinates, origin top left). Similar to ISO 23150:2022(E): Polynomial coefficient y {c0,c1,c2,c3} (A.2.116)";
CM_ SG_ 162 VFC_2DPoly01_CoefficientUc2 "Polynomial coefficient for the u-axis value (in CV coordinates, origin top left). Similar to ISO 23150:2022(E): Polynomial coefficient y {c0,c1,c2,c3} (A.2.116)";
CM_ SG_ 162 VFC_2DPoly01_CoefficientUc3 "Polynomial coefficient for the u-axis value (in CV coordinates, origin top left). Similar to ISO 23150:2022(E): Polynomial coefficient y {c0,c1,c2,c3} (A.2.116)";
CM_ SG_ 162 VFC_2DPoly01_CoefficientUc4 "Polynomial coefficient for the u-axis value (in CV coordinates, origin top left). Similar to ISO 23150:2022(E): Polynomial coefficient y {c0,c1,c2,c3} (A.2.116)";
CM_ SG_ 162 VFC_2DPoly01_CoefficientUc5 "Polynomial coefficient for the u-axis value (in CV coordinates, origin top left). Similar to ISO 23150:2022(E): Polynomial coefficient y {c0,c1,c2,c3} (A.2.116)";
CM_ SG_ 162 VFC_2DPoly01_RangeVBegin "Longitudinal begin of the polynomial (big v value) (in CV coordinates, origin top left). Similar to ISO 23150:2022(E): Polynomial range x {begin, end} (A.2.120)";
CM_ SG_ 162 VFC_2DPoly01_RangeVEnd "Longitudinal end of the polynomial (small v value) (in CV coordinates, origin top left). Similar to ISO 23150:2022(E): Polynomial range x {begin, end} (A.2.120)";
CM_ SG_ 162 VFC_2DPoly02_LaneAssociation "Position relative to the ego lane. ISO 23150:2022(E): Road object lane association (A.2.93)";
CM_ SG_ 162 VFC_2DPoly02_ExistProb "ISO 23150:2022(E): Existence probability - object level (A.2.1)";
CM_ SG_ 162 VFC_2DPoly02_Type "Type of the Line. ISO 23150:2022(E): Road marking type (A.2.91)";
CM_ SG_ 162 VFC_2DPoly02_CoefficientUc0 "Polynomial coefficient for the u-axis value (in CV coordinates, origin top left). Similar to ISO 23150:2022(E): Polynomial coefficient y {c0,c1,c2,c3} (A.2.116)";
CM_ SG_ 162 VFC_2DPoly02_CoefficientUc1 "Polynomial coefficient for the u-axis value (in CV coordinates, origin top left). Similar to ISO 23150:2022(E): Polynomial coefficient y {c0,c1,c2,c3} (A.2.116)";
CM_ SG_ 162 VFC_2DPoly02_CoefficientUc2 "Polynomial coefficient for the u-axis value (in CV coordinates, origin top left). Similar to ISO 23150:2022(E): Polynomial coefficient y {c0,c1,c2,c3} (A.2.116)";
CM_ SG_ 162 VFC_2DPoly02_CoefficientUc3 "Polynomial coefficient for the u-axis value (in CV coordinates, origin top left). Similar to ISO 23150:2022(E): Polynomial coefficient y {c0,c1,c2,c3} (A.2.116)";
CM_ SG_ 162 VFC_2DPoly02_CoefficientUc4 "Polynomial coefficient for the u-axis value (in CV coordinates, origin top left). Similar to ISO 23150:2022(E): Polynomial coefficient y {c0,c1,c2,c3} (A.2.116)";
CM_ SG_ 162 VFC_2DPoly02_CoefficientUc5 "Polynomial coefficient for the u-axis value (in CV coordinates, origin top left). Similar to ISO 23150:2022(E): Polynomial coefficient y {c0,c1,c2,c3} (A.2.116)";
CM_ SG_ 162 VFC_2DPoly02_RangeVBegin "Longitudinal begin of the polynomial (big v value) (in CV coordinates, origin top left). Similar to ISO 23150:2022(E): Polynomial range x {begin, end} (A.2.120)";
CM_ SG_ 162 VFC_2DPoly02_RangeVEnd "Longitudinal end of the polynomial (small v value) (in CV coordinates, origin top left). Similar to ISO 23150:2022(E): Polynomial range x {begin, end} (A.2.120)";
CM_ SG_ 163 VFC_2DPoly_03_05_CRC "CRC - Autosar E2E Profile 5";
CM_ SG_ 163 VFC_2DPoly_03_05_AliveCtr "Alive counter - Autosar E2E Profile 5";
CM_ SG_ 163 VFC_2DPoly_03_05_ProtBlockCtr "Protocol-Signal: Block-Counter";
CM_ SG_ 163 VFC_2DPoly03_LaneAssociation "Position relative to the ego lane. ISO 23150:2022(E): Road object lane association (A.2.93)";
CM_ SG_ 163 VFC_2DPoly03_ExistProb "ISO 23150:2022(E): Existence probability - object level (A.2.1)";
CM_ SG_ 163 VFC_2DPoly03_Type "Type of the Line. ISO 23150:2022(E): Road marking type (A.2.91)";
CM_ SG_ 163 VFC_2DPoly03_CoefficientUc0 "Polynomial coefficient for the u-axis value (in CV coordinates, origin top left). Similar to ISO 23150:2022(E): Polynomial coefficient y {c0,c1,c2,c3} (A.2.116)";
CM_ SG_ 163 VFC_2DPoly03_CoefficientUc1 "Polynomial coefficient for the u-axis value (in CV coordinates, origin top left). Similar to ISO 23150:2022(E): Polynomial coefficient y {c0,c1,c2,c3} (A.2.116)";
CM_ SG_ 163 VFC_2DPoly03_CoefficientUc2 "Polynomial coefficient for the u-axis value (in CV coordinates, origin top left). Similar to ISO 23150:2022(E): Polynomial coefficient y {c0,c1,c2,c3} (A.2.116)";
CM_ SG_ 163 VFC_2DPoly03_CoefficientUc3 "Polynomial coefficient for the u-axis value (in CV coordinates, origin top left). Similar to ISO 23150:2022(E): Polynomial coefficient y {c0,c1,c2,c3} (A.2.116)";
CM_ SG_ 163 VFC_2DPoly03_CoefficientUc4 "Polynomial coefficient for the u-axis value (in CV coordinates, origin top left). Similar to ISO 23150:2022(E): Polynomial coefficient y {c0,c1,c2,c3} (A.2.116)";
CM_ SG_ 163 VFC_2DPoly03_CoefficientUc5 "Polynomial coefficient for the u-axis value (in CV coordinates, origin top left). Similar to ISO 23150:2022(E): Polynomial coefficient y {c0,c1,c2,c3} (A.2.116)";
CM_ SG_ 163 VFC_2DPoly03_RangeVBegin "Longitudinal begin of the polynomial (big v value) (in CV coordinates, origin top left). Similar to ISO 23150:2022(E): Polynomial range x {begin, end} (A.2.120)";
CM_ SG_ 163 VFC_2DPoly03_RangeVEnd "Longitudinal end of the polynomial (small v value) (in CV coordinates, origin top left). Similar to ISO 23150:2022(E): Polynomial range x {begin, end} (A.2.120)";
CM_ SG_ 163 VFC_2DPoly04_LaneAssociation "Position relative to the ego lane. ISO 23150:2022(E): Road object lane association (A.2.93)";
CM_ SG_ 163 VFC_2DPoly04_ExistProb "ISO 23150:2022(E): Existence probability - object level (A.2.1)";
CM_ SG_ 163 VFC_2DPoly04_Type "Type of the Line. ISO 23150:2022(E): Road marking type (A.2.91)";
CM_ SG_ 163 VFC_2DPoly04_CoefficientUc0 "Polynomial coefficient for the u-axis value (in CV coordinates, origin top left). Similar to ISO 23150:2022(E): Polynomial coefficient y {c0,c1,c2,c3} (A.2.116)";
CM_ SG_ 163 VFC_2DPoly04_CoefficientUc1 "Polynomial coefficient for the u-axis value (in CV coordinates, origin top left). Similar to ISO 23150:2022(E): Polynomial coefficient y {c0,c1,c2,c3} (A.2.116)";
CM_ SG_ 163 VFC_2DPoly04_CoefficientUc2 "Polynomial coefficient for the u-axis value (in CV coordinates, origin top left). Similar to ISO 23150:2022(E): Polynomial coefficient y {c0,c1,c2,c3} (A.2.116)";
CM_ SG_ 163 VFC_2DPoly04_CoefficientUc3 "Polynomial coefficient for the u-axis value (in CV coordinates, origin top left). Similar to ISO 23150:2022(E): Polynomial coefficient y {c0,c1,c2,c3} (A.2.116)";
CM_ SG_ 163 VFC_2DPoly04_CoefficientUc4 "Polynomial coefficient for the u-axis value (in CV coordinates, origin top left). Similar to ISO 23150:2022(E): Polynomial coefficient y {c0,c1,c2,c3} (A.2.116)";
CM_ SG_ 163 VFC_2DPoly04_CoefficientUc5 "Polynomial coefficient for the u-axis value (in CV coordinates, origin top left). Similar to ISO 23150:2022(E): Polynomial coefficient y {c0,c1,c2,c3} (A.2.116)";
CM_ SG_ 163 VFC_2DPoly04_RangeVBegin "Longitudinal begin of the polynomial (big v value) (in CV coordinates, origin top left). Similar to ISO 23150:2022(E): Polynomial range x {begin, end} (A.2.120)";
CM_ SG_ 163 VFC_2DPoly04_RangeVEnd "Longitudinal end of the polynomial (small v value) (in CV coordinates, origin top left). Similar to ISO 23150:2022(E): Polynomial range x {begin, end} (A.2.120)";
CM_ SG_ 163 VFC_2DPoly05_LaneAssociation "Position relative to the ego lane. ISO 23150:2022(E): Road object lane association (A.2.93)";
CM_ SG_ 163 VFC_2DPoly05_ExistProb "ISO 23150:2022(E): Existence probability - object level (A.2.1)";
CM_ SG_ 163 VFC_2DPoly05_Type "Type of the Line. ISO 23150:2022(E): Road marking type (A.2.91)";
CM_ SG_ 163 VFC_2DPoly05_CoefficientUc0 "Polynomial coefficient for the u-axis value (in CV coordinates, origin top left). Similar to ISO 23150:2022(E): Polynomial coefficient y {c0,c1,c2,c3} (A.2.116)";
CM_ SG_ 163 VFC_2DPoly05_CoefficientUc1 "Polynomial coefficient for the u-axis value (in CV coordinates, origin top left). Similar to ISO 23150:2022(E): Polynomial coefficient y {c0,c1,c2,c3} (A.2.116)";
CM_ SG_ 163 VFC_2DPoly05_CoefficientUc2 "Polynomial coefficient for the u-axis value (in CV coordinates, origin top left). Similar to ISO 23150:2022(E): Polynomial coefficient y {c0,c1,c2,c3} (A.2.116)";
CM_ SG_ 163 VFC_2DPoly05_CoefficientUc3 "Polynomial coefficient for the u-axis value (in CV coordinates, origin top left). Similar to ISO 23150:2022(E): Polynomial coefficient y {c0,c1,c2,c3} (A.2.116)";
CM_ SG_ 163 VFC_2DPoly05_CoefficientUc4 "Polynomial coefficient for the u-axis value (in CV coordinates, origin top left). Similar to ISO 23150:2022(E): Polynomial coefficient y {c0,c1,c2,c3} (A.2.116)";
CM_ SG_ 163 VFC_2DPoly05_CoefficientUc5 "Polynomial coefficient for the u-axis value (in CV coordinates, origin top left). Similar to ISO 23150:2022(E): Polynomial coefficient y {c0,c1,c2,c3} (A.2.116)";
CM_ SG_ 163 VFC_2DPoly05_RangeVBegin "Longitudinal begin of the polynomial (big v value) (in CV coordinates, origin top left). Similar to ISO 23150:2022(E): Polynomial range x {begin, end} (A.2.120)";
CM_ SG_ 163 VFC_2DPoly05_RangeVEnd "Longitudinal end of the polynomial (small v value) (in CV coordinates, origin top left). Similar to ISO 23150:2022(E): Polynomial range x {begin, end} (A.2.120)";
CM_ SG_ 164 VFC_2DPoly_06_08_CRC "CRC - Autosar E2E Profile 5";
CM_ SG_ 164 VFC_2DPoly_06_08_AliveCtr "Alive counter - Autosar E2E Profile 5";
CM_ SG_ 164 VFC_2DPoly_06_08_ProtBlockCtr "Protocol-Signal: Block-Counter";
CM_ SG_ 164 VFC_2DPoly06_LaneAssociation "Position relative to the ego lane. ISO 23150:2022(E): Road object lane association (A.2.93)";
CM_ SG_ 164 VFC_2DPoly06_ExistProb "ISO 23150:2022(E): Existence probability - object level (A.2.1)";
CM_ SG_ 164 VFC_2DPoly06_Type "Type of the Line. ISO 23150:2022(E): Road marking type (A.2.91)";
CM_ SG_ 164 VFC_2DPoly06_CoefficientUc0 "Polynomial coefficient for the u-axis value (in CV coordinates, origin top left). Similar to ISO 23150:2022(E): Polynomial coefficient y {c0,c1,c2,c3} (A.2.116)";
CM_ SG_ 164 VFC_2DPoly06_CoefficientUc1 "Polynomial coefficient for the u-axis value (in CV coordinates, origin top left). Similar to ISO 23150:2022(E): Polynomial coefficient y {c0,c1,c2,c3} (A.2.116)";
CM_ SG_ 164 VFC_2DPoly06_CoefficientUc2 "Polynomial coefficient for the u-axis value (in CV coordinates, origin top left). Similar to ISO 23150:2022(E): Polynomial coefficient y {c0,c1,c2,c3} (A.2.116)";
CM_ SG_ 164 VFC_2DPoly06_CoefficientUc3 "Polynomial coefficient for the u-axis value (in CV coordinates, origin top left). Similar to ISO 23150:2022(E): Polynomial coefficient y {c0,c1,c2,c3} (A.2.116)";
CM_ SG_ 164 VFC_2DPoly06_CoefficientUc4 "Polynomial coefficient for the u-axis value (in CV coordinates, origin top left). Similar to ISO 23150:2022(E): Polynomial coefficient y {c0,c1,c2,c3} (A.2.116)";
CM_ SG_ 164 VFC_2DPoly06_CoefficientUc5 "Polynomial coefficient for the u-axis value (in CV coordinates, origin top left). Similar to ISO 23150:2022(E): Polynomial coefficient y {c0,c1,c2,c3} (A.2.116)";
CM_ SG_ 164 VFC_2DPoly06_RangeVBegin "Longitudinal begin of the polynomial (big v value) (in CV coordinates, origin top left). Similar to ISO 23150:2022(E): Polynomial range x {begin, end} (A.2.120)";
CM_ SG_ 164 VFC_2DPoly06_RangeVEnd "Longitudinal end of the polynomial (small v value) (in CV coordinates, origin top left). Similar to ISO 23150:2022(E): Polynomial range x {begin, end} (A.2.120)";
CM_ SG_ 164 VFC_2DPoly07_LaneAssociation "Position relative to the ego lane. ISO 23150:2022(E): Road object lane association (A.2.93)";
CM_ SG_ 164 VFC_2DPoly07_ExistProb "ISO 23150:2022(E): Existence probability - object level (A.2.1)";
CM_ SG_ 164 VFC_2DPoly07_Type "Type of the Line. ISO 23150:2022(E): Road marking type (A.2.91)";
CM_ SG_ 164 VFC_2DPoly07_CoefficientUc0 "Polynomial coefficient for the u-axis value (in CV coordinates, origin top left). Similar to ISO 23150:2022(E): Polynomial coefficient y {c0,c1,c2,c3} (A.2.116)";
CM_ SG_ 164 VFC_2DPoly07_CoefficientUc1 "Polynomial coefficient for the u-axis value (in CV coordinates, origin top left). Similar to ISO 23150:2022(E): Polynomial coefficient y {c0,c1,c2,c3} (A.2.116)";
CM_ SG_ 164 VFC_2DPoly07_CoefficientUc2 "Polynomial coefficient for the u-axis value (in CV coordinates, origin top left). Similar to ISO 23150:2022(E): Polynomial coefficient y {c0,c1,c2,c3} (A.2.116)";
CM_ SG_ 164 VFC_2DPoly07_CoefficientUc3 "Polynomial coefficient for the u-axis value (in CV coordinates, origin top left). Similar to ISO 23150:2022(E): Polynomial coefficient y {c0,c1,c2,c3} (A.2.116)";
CM_ SG_ 164 VFC_2DPoly07_CoefficientUc4 "Polynomial coefficient for the u-axis value (in CV coordinates, origin top left). Similar to ISO 23150:2022(E): Polynomial coefficient y {c0,c1,c2,c3} (A.2.116)";
CM_ SG_ 164 VFC_2DPoly07_CoefficientUc5 "Polynomial coefficient for the u-axis value (in CV coordinates, origin top left). Similar to ISO 23150:2022(E): Polynomial coefficient y {c0,c1,c2,c3} (A.2.116)";
CM_ SG_ 164 VFC_2DPoly07_RangeVBegin "Longitudinal begin of the polynomial (big v value) (in CV coordinates, origin top left). Similar to ISO 23150:2022(E): Polynomial range x {begin, end} (A.2.120)";
CM_ SG_ 164 VFC_2DPoly07_RangeVEnd "Longitudinal end of the polynomial (small v value) (in CV coordinates, origin top left). Similar to ISO 23150:2022(E): Polynomial range x {begin, end} (A.2.120)";
CM_ SG_ 164 VFC_2DPoly08_LaneAssociation "Position relative to the ego lane. ISO 23150:2022(E): Road object lane association (A.2.93)";
CM_ SG_ 164 VFC_2DPoly08_ExistProb "ISO 23150:2022(E): Existence probability - object level (A.2.1)";
CM_ SG_ 164 VFC_2DPoly08_Type "Type of the Line. ISO 23150:2022(E): Road marking type (A.2.91)";
CM_ SG_ 164 VFC_2DPoly08_CoefficientUc0 "Polynomial coefficient for the u-axis value (in CV coordinates, origin top left). Similar to ISO 23150:2022(E): Polynomial coefficient y {c0,c1,c2,c3} (A.2.116)";
CM_ SG_ 164 VFC_2DPoly08_CoefficientUc1 "Polynomial coefficient for the u-axis value (in CV coordinates, origin top left). Similar to ISO 23150:2022(E): Polynomial coefficient y {c0,c1,c2,c3} (A.2.116)";
CM_ SG_ 164 VFC_2DPoly08_CoefficientUc2 "Polynomial coefficient for the u-axis value (in CV coordinates, origin top left). Similar to ISO 23150:2022(E): Polynomial coefficient y {c0,c1,c2,c3} (A.2.116)";
CM_ SG_ 164 VFC_2DPoly08_CoefficientUc3 "Polynomial coefficient for the u-axis value (in CV coordinates, origin top left). Similar to ISO 23150:2022(E): Polynomial coefficient y {c0,c1,c2,c3} (A.2.116)";
CM_ SG_ 164 VFC_2DPoly08_CoefficientUc4 "Polynomial coefficient for the u-axis value (in CV coordinates, origin top left). Similar to ISO 23150:2022(E): Polynomial coefficient y {c0,c1,c2,c3} (A.2.116)";
CM_ SG_ 164 VFC_2DPoly08_CoefficientUc5 "Polynomial coefficient for the u-axis value (in CV coordinates, origin top left). Similar to ISO 23150:2022(E): Polynomial coefficient y {c0,c1,c2,c3} (A.2.116)";
CM_ SG_ 164 VFC_2DPoly08_RangeVBegin "Longitudinal begin of the polynomial (big v value) (in CV coordinates, origin top left). Similar to ISO 23150:2022(E): Polynomial range x {begin, end} (A.2.120)";
CM_ SG_ 164 VFC_2DPoly08_RangeVEnd "Longitudinal end of the polynomial (small v value) (in CV coordinates, origin top left). Similar to ISO 23150:2022(E): Polynomial range x {begin, end} (A.2.120)";
CM_ SG_ 165 VFC_2DPoly_09_11_CRC "CRC - Autosar E2E Profile 5";
CM_ SG_ 165 VFC_2DPoly_09_11_AliveCtr "Alive counter - Autosar E2E Profile 5";
CM_ SG_ 165 VFC_2DPoly_09_11_ProtBlockCtr "Protocol-Signal: Block-Counter";
CM_ SG_ 165 VFC_2DPoly09_LaneAssociation "Position relative to the ego lane. ISO 23150:2022(E): Road object lane association (A.2.93)";
CM_ SG_ 165 VFC_2DPoly09_ExistProb "ISO 23150:2022(E): Existence probability - object level (A.2.1)";
CM_ SG_ 165 VFC_2DPoly09_Type "Type of the Line. ISO 23150:2022(E): Road marking type (A.2.91)";
CM_ SG_ 165 VFC_2DPoly09_CoefficientUc0 "Polynomial coefficient for the u-axis value (in CV coordinates, origin top left). Similar to ISO 23150:2022(E): Polynomial coefficient y {c0,c1,c2,c3} (A.2.116)";
CM_ SG_ 165 VFC_2DPoly09_CoefficientUc1 "Polynomial coefficient for the u-axis value (in CV coordinates, origin top left). Similar to ISO 23150:2022(E): Polynomial coefficient y {c0,c1,c2,c3} (A.2.116)";
CM_ SG_ 165 VFC_2DPoly09_CoefficientUc2 "Polynomial coefficient for the u-axis value (in CV coordinates, origin top left). Similar to ISO 23150:2022(E): Polynomial coefficient y {c0,c1,c2,c3} (A.2.116)";
CM_ SG_ 165 VFC_2DPoly09_CoefficientUc3 "Polynomial coefficient for the u-axis value (in CV coordinates, origin top left). Similar to ISO 23150:2022(E): Polynomial coefficient y {c0,c1,c2,c3} (A.2.116)";
CM_ SG_ 165 VFC_2DPoly09_CoefficientUc4 "Polynomial coefficient for the u-axis value (in CV coordinates, origin top left). Similar to ISO 23150:2022(E): Polynomial coefficient y {c0,c1,c2,c3} (A.2.116)";
CM_ SG_ 165 VFC_2DPoly09_CoefficientUc5 "Polynomial coefficient for the u-axis value (in CV coordinates, origin top left). Similar to ISO 23150:2022(E): Polynomial coefficient y {c0,c1,c2,c3} (A.2.116)";
CM_ SG_ 165 VFC_2DPoly09_RangeVBegin "Longitudinal begin of the polynomial (big v value) (in CV coordinates, origin top left). Similar to ISO 23150:2022(E): Polynomial range x {begin, end} (A.2.120)";
CM_ SG_ 165 VFC_2DPoly09_RangeVEnd "Longitudinal end of the polynomial (small v value) (in CV coordinates, origin top left). Similar to ISO 23150:2022(E): Polynomial range x {begin, end} (A.2.120)";
CM_ SG_ 165 VFC_2DPoly10_LaneAssociation "Position relative to the ego lane. ISO 23150:2022(E): Road object lane association (A.2.93)";
CM_ SG_ 165 VFC_2DPoly10_ExistProb "ISO 23150:2022(E): Existence probability - object level (A.2.1)";
CM_ SG_ 165 VFC_2DPoly10_Type "Type of the Line. ISO 23150:2022(E): Road marking type (A.2.91)";
CM_ SG_ 165 VFC_2DPoly10_CoefficientUc0 "Polynomial coefficient for the u-axis value (in CV coordinates, origin top left). Similar to ISO 23150:2022(E): Polynomial coefficient y {c0,c1,c2,c3} (A.2.116)";
CM_ SG_ 165 VFC_2DPoly10_CoefficientUc1 "Polynomial coefficient for the u-axis value (in CV coordinates, origin top left). Similar to ISO 23150:2022(E): Polynomial coefficient y {c0,c1,c2,c3} (A.2.116)";
CM_ SG_ 165 VFC_2DPoly10_CoefficientUc2 "Polynomial coefficient for the u-axis value (in CV coordinates, origin top left). Similar to ISO 23150:2022(E): Polynomial coefficient y {c0,c1,c2,c3} (A.2.116)";
CM_ SG_ 165 VFC_2DPoly10_CoefficientUc3 "Polynomial coefficient for the u-axis value (in CV coordinates, origin top left). Similar to ISO 23150:2022(E): Polynomial coefficient y {c0,c1,c2,c3} (A.2.116)";
CM_ SG_ 165 VFC_2DPoly10_CoefficientUc4 "Polynomial coefficient for the u-axis value (in CV coordinates, origin top left). Similar to ISO 23150:2022(E): Polynomial coefficient y {c0,c1,c2,c3} (A.2.116)";
CM_ SG_ 165 VFC_2DPoly10_CoefficientUc5 "Polynomial coefficient for the u-axis value (in CV coordinates, origin top left). Similar to ISO 23150:2022(E): Polynomial coefficient y {c0,c1,c2,c3} (A.2.116)";
CM_ SG_ 165 VFC_2DPoly10_RangeVBegin "Longitudinal begin of the polynomial (big v value) (in CV coordinates, origin top left). Similar to ISO 23150:2022(E): Polynomial range x {begin, end} (A.2.120)";
CM_ SG_ 165 VFC_2DPoly10_RangeVEnd "Longitudinal end of the polynomial (small v value) (in CV coordinates, origin top left). Similar to ISO 23150:2022(E): Polynomial range x {begin, end} (A.2.120)";
CM_ SG_ 165 VFC_2DPoly11_LaneAssociation "Position relative to the ego lane. ISO 23150:2022(E): Road object lane association (A.2.93)";
CM_ SG_ 165 VFC_2DPoly11_ExistProb "ISO 23150:2022(E): Existence probability - object level (A.2.1)";
CM_ SG_ 165 VFC_2DPoly11_Type "Type of the Line. ISO 23150:2022(E): Road marking type (A.2.91)";
CM_ SG_ 165 VFC_2DPoly11_CoefficientUc0 "Polynomial coefficient for the u-axis value (in CV coordinates, origin top left). Similar to ISO 23150:2022(E): Polynomial coefficient y {c0,c1,c2,c3} (A.2.116)";
CM_ SG_ 165 VFC_2DPoly11_CoefficientUc1 "Polynomial coefficient for the u-axis value (in CV coordinates, origin top left). Similar to ISO 23150:2022(E): Polynomial coefficient y {c0,c1,c2,c3} (A.2.116)";
CM_ SG_ 165 VFC_2DPoly11_CoefficientUc2 "Polynomial coefficient for the u-axis value (in CV coordinates, origin top left). Similar to ISO 23150:2022(E): Polynomial coefficient y {c0,c1,c2,c3} (A.2.116)";
CM_ SG_ 165 VFC_2DPoly11_CoefficientUc3 "Polynomial coefficient for the u-axis value (in CV coordinates, origin top left). Similar to ISO 23150:2022(E): Polynomial coefficient y {c0,c1,c2,c3} (A.2.116)";
CM_ SG_ 165 VFC_2DPoly11_CoefficientUc4 "Polynomial coefficient for the u-axis value (in CV coordinates, origin top left). Similar to ISO 23150:2022(E): Polynomial coefficient y {c0,c1,c2,c3} (A.2.116)";
CM_ SG_ 165 VFC_2DPoly11_CoefficientUc5 "Polynomial coefficient for the u-axis value (in CV coordinates, origin top left). Similar to ISO 23150:2022(E): Polynomial coefficient y {c0,c1,c2,c3} (A.2.116)";
CM_ SG_ 165 VFC_2DPoly11_RangeVBegin "Longitudinal begin of the polynomial (big v value) (in CV coordinates, origin top left). Similar to ISO 23150:2022(E): Polynomial range x {begin, end} (A.2.120)";
CM_ SG_ 165 VFC_2DPoly11_RangeVEnd "Longitudinal end of the polynomial (small v value) (in CV coordinates, origin top left). Similar to ISO 23150:2022(E): Polynomial range x {begin, end} (A.2.120)";
CM_ SG_ 178 VFC_RM_00_06_CRC "CRC - Autosar E2E Profile 5";
CM_ SG_ 178 VFC_RM_00_06_AliveCtr "Alive counter - Autosar E2E Profile 5";
CM_ SG_ 178 VFC_RM_00_06_ProtBlockCtr "Protocol-Signal: Block-Counter";
CM_ SG_ 178 VFC_RM00_ExistProb "ISO 23150:2022(E): Existence probability - object level (A.2.1)";
CM_ SG_ 178 VFC_RM00_Type "ISO 23150:2022(E): Road marking type (A.2.91)";
CM_ SG_ 178 VFC_RM00_VertexPoint00x "Point00 connected to Point01 results in straight line. ISO 23150:2022(E): Vertex point {x, y, z} (A.2.112)";
CM_ SG_ 178 VFC_RM00_VertexPoint00y "Point00 connected to Point01 results in straight line. ISO 23150:2022(E): Vertex point {x, y, z} (A.2.112)";
CM_ SG_ 178 VFC_RM00_VertexPoint01x "Point00 connected to Point01 results in straight line. ISO 23150:2022(E): Vertex point {x, y, z} (A.2.112)";
CM_ SG_ 178 VFC_RM00_VertexPoint01y "Point00 connected to Point01 results in straight line. ISO 23150:2022(E): Vertex point {x, y, z} (A.2.112)";
CM_ SG_ 178 VFC_RM01_ExistProb "ISO 23150:2022(E): Existence probability - object level (A.2.1)";
CM_ SG_ 178 VFC_RM01_Type "ISO 23150:2022(E): Road marking type (A.2.91)";
CM_ SG_ 178 VFC_RM01_VertexPoint00x "Point00 connected to Point01 results in straight line. ISO 23150:2022(E): Vertex point {x, y, z} (A.2.112)";
CM_ SG_ 178 VFC_RM01_VertexPoint00y "Point00 connected to Point01 results in straight line. ISO 23150:2022(E): Vertex point {x, y, z} (A.2.112)";
CM_ SG_ 178 VFC_RM01_VertexPoint01x "Point00 connected to Point01 results in straight line. ISO 23150:2022(E): Vertex point {x, y, z} (A.2.112)";
CM_ SG_ 178 VFC_RM01_VertexPoint01y "Point00 connected to Point01 results in straight line. ISO 23150:2022(E): Vertex point {x, y, z} (A.2.112)";
CM_ SG_ 178 VFC_RM02_ExistProb "ISO 23150:2022(E): Existence probability - object level (A.2.1)";
CM_ SG_ 178 VFC_RM02_Type "ISO 23150:2022(E): Road marking type (A.2.91)";
CM_ SG_ 178 VFC_RM02_VertexPoint00x "Point00 connected to Point01 results in straight line. ISO 23150:2022(E): Vertex point {x, y, z} (A.2.112)";
CM_ SG_ 178 VFC_RM02_VertexPoint00y "Point00 connected to Point01 results in straight line. ISO 23150:2022(E): Vertex point {x, y, z} (A.2.112)";
CM_ SG_ 178 VFC_RM02_VertexPoint01x "Point00 connected to Point01 results in straight line. ISO 23150:2022(E): Vertex point {x, y, z} (A.2.112)";
CM_ SG_ 178 VFC_RM02_VertexPoint01y "Point00 connected to Point01 results in straight line. ISO 23150:2022(E): Vertex point {x, y, z} (A.2.112)";
CM_ SG_ 178 VFC_RM03_ExistProb "ISO 23150:2022(E): Existence probability - object level (A.2.1)";
CM_ SG_ 178 VFC_RM03_Type "ISO 23150:2022(E): Road marking type (A.2.91)";
CM_ SG_ 178 VFC_RM03_VertexPoint00x "Point00 connected to Point01 results in straight line. ISO 23150:2022(E): Vertex point {x, y, z} (A.2.112)";
CM_ SG_ 178 VFC_RM03_VertexPoint00y "Point00 connected to Point01 results in straight line. ISO 23150:2022(E): Vertex point {x, y, z} (A.2.112)";
CM_ SG_ 178 VFC_RM03_VertexPoint01x "Point00 connected to Point01 results in straight line. ISO 23150:2022(E): Vertex point {x, y, z} (A.2.112)";
CM_ SG_ 178 VFC_RM03_VertexPoint01y "Point00 connected to Point01 results in straight line. ISO 23150:2022(E): Vertex point {x, y, z} (A.2.112)";
CM_ SG_ 178 VFC_RM04_ExistProb "ISO 23150:2022(E): Existence probability - object level (A.2.1)";
CM_ SG_ 178 VFC_RM04_Type "ISO 23150:2022(E): Road marking type (A.2.91)";
CM_ SG_ 178 VFC_RM04_VertexPoint00x "Point00 connected to Point01 results in straight line. ISO 23150:2022(E): Vertex point {x, y, z} (A.2.112)";
CM_ SG_ 178 VFC_RM04_VertexPoint00y "Point00 connected to Point01 results in straight line. ISO 23150:2022(E): Vertex point {x, y, z} (A.2.112)";
CM_ SG_ 178 VFC_RM04_VertexPoint01x "Point00 connected to Point01 results in straight line. ISO 23150:2022(E): Vertex point {x, y, z} (A.2.112)";
CM_ SG_ 178 VFC_RM04_VertexPoint01y "Point00 connected to Point01 results in straight line. ISO 23150:2022(E): Vertex point {x, y, z} (A.2.112)";
CM_ SG_ 178 VFC_RM05_ExistProb "ISO 23150:2022(E): Existence probability - object level (A.2.1)";
CM_ SG_ 178 VFC_RM05_Type "ISO 23150:2022(E): Road marking type (A.2.91)";
CM_ SG_ 178 VFC_RM05_VertexPoint00x "Point00 connected to Point01 results in straight line. ISO 23150:2022(E): Vertex point {x, y, z} (A.2.112)";
CM_ SG_ 178 VFC_RM05_VertexPoint00y "Point00 connected to Point01 results in straight line. ISO 23150:2022(E): Vertex point {x, y, z} (A.2.112)";
CM_ SG_ 178 VFC_RM05_VertexPoint01x "Point00 connected to Point01 results in straight line. ISO 23150:2022(E): Vertex point {x, y, z} (A.2.112)";
CM_ SG_ 178 VFC_RM05_VertexPoint01y "Point00 connected to Point01 results in straight line. ISO 23150:2022(E): Vertex point {x, y, z} (A.2.112)";
CM_ SG_ 178 VFC_RM06_ExistProb "ISO 23150:2022(E): Existence probability - object level (A.2.1)";
CM_ SG_ 178 VFC_RM06_Type "ISO 23150:2022(E): Road marking type (A.2.91)";
CM_ SG_ 178 VFC_RM06_VertexPoint00x "Point00 connected to Point01 results in straight line. ISO 23150:2022(E): Vertex point {x, y, z} (A.2.112)";
CM_ SG_ 178 VFC_RM06_VertexPoint00y "Point00 connected to Point01 results in straight line. ISO 23150:2022(E): Vertex point {x, y, z} (A.2.112)";
CM_ SG_ 178 VFC_RM06_VertexPoint01x "Point00 connected to Point01 results in straight line. ISO 23150:2022(E): Vertex point {x, y, z} (A.2.112)";
CM_ SG_ 178 VFC_RM06_VertexPoint01y "Point00 connected to Point01 results in straight line. ISO 23150:2022(E): Vertex point {x, y, z} (A.2.112)";
CM_ SG_ 224 VFC_TLHdr_CRC "CRC - Autosar E2E Profile 5";
CM_ SG_ 224 VFC_TLHdr_AliveCtr "Alive counter - Autosar E2E Profile 5";
CM_ SG_ 224 VFC_TLHdr_ProtBlockCtr "Protocol-Signal: Block-Counter";
CM_ SG_ 224 VFC_TLHdr_IfVersionIdMajor "Version information of the interface. e. g. version 1.0: Major = 1. ISO 23150:2022(E): Interface version ID {major, minor, patch} (A.1.1)";
CM_ SG_ 224 VFC_TLHdr_IfVersionIdMinor "Version information of the interface. e. g. version 1.0: Minor = 0. ISO 23150:2022(E): Interface version ID {major, minor, patch} (A.1.1)";
CM_ SG_ 224 VFC_TLHdr_NumTrafficLights "Protocol-Signal: count of all traffic lights ISO 23150:2022(E): Number of valid traffic lights (A.1.12.7)";
CM_ SG_ 224 VFC_TLHdr_TimeStampStatus "Autosar StbM_TimeBaseStatusType bitfield with extension:
Bit 0: TIMEOUT
Bit 1: Reserved1
Bit 2: SYNC_TO_GATEWAY
Bit 3: GLOBAL_TIME_BASE
Bit 4: TIMELEAP_FUTURE
Bit 5: TIMELEAP_PAST
Bit 6: Reserved6
Bit 7: Extension: GENERAL_ERROR";
CM_ SG_ 224 VFC_TLHdr_TimeStamp "TimeStamp of Objects ISO 23150:2022(E) Time stamp �prediction (A.1.5.1)";
CM_ SG_ 224 VFC_TLHdr_State "Traffic light function and degradation state";
CM_ SG_ 224 VFC_TLHdr_MostRelevantTLId "Index of traffic light object which is most relevant";
CM_ SG_ 224 VFC_TLHdr_Reserved0 "Reserved for future usage";
CM_ SG_ 224 VFC_TLHdr_Reserved1 "Reserved for future usage";
BA_DEF_ SG_  "GenSigSendType" ENUM  "Cyclic","OnWrite","OnWriteWithRepetition","OnChange","OnChangeWithRepetition","IfActive","IfActiveWithRepetition";
BA_DEF_ BO_  "GenMsgCycleTimeFast" INT 2 50000;
BA_DEF_ BO_  "GenMsgILSupport" ENUM  "No","Yes";
BA_DEF_ BO_  "CANFD_BRS" ENUM  "0","1";
BA_DEF_ BO_  "GenMsgCycleTime" INT 0 65535;
BA_DEF_ BO_  "GenMsgSendType" ENUM  "Event","cyclic";
BA_DEF_ BO_  "VFrameFormat" ENUM  "StandardCAN","ExtendedCAN","reserved","reserved","reserved","reserved","reserved","reserved","reserved","reserved","reserved","reserved","reserved","reserved","StandardCAN_FD","ExtendedCAN_FD";
BA_DEF_ SG_  "GenSigStartValue" FLOAT 0 100000000000;
BA_DEF_DEF_  "GenSigSendType" "Cyclic";
BA_DEF_DEF_  "GenMsgCycleTimeFast" 100;
BA_DEF_DEF_  "GenMsgILSupport" "Yes";
BA_DEF_DEF_  "CANFD_BRS" "1";
BA_DEF_DEF_  "GenMsgCycleTime" 0;
BA_DEF_DEF_  "GenMsgSendType" "";
BA_DEF_DEF_  "VFrameFormat" "";
BA_DEF_DEF_  "GenSigStartValue" 0;
BA_ "GenMsgSendType" BO_ 131 0;
BA_ "VFrameFormat" BO_ 131 14;
BA_ "GenMsgSendType" BO_ 132 0;
BA_ "VFrameFormat" BO_ 132 14;
BA_ "GenMsgSendType" BO_ 133 0;
BA_ "VFrameFormat" BO_ 133 14;
BA_ "GenMsgSendType" BO_ 146 0;
BA_ "VFrameFormat" BO_ 146 14;
BA_ "GenMsgSendType" BO_ 147 0;
BA_ "VFrameFormat" BO_ 147 14;
BA_ "GenMsgSendType" BO_ 148 0;
BA_ "VFrameFormat" BO_ 148 14;
BA_ "GenMsgSendType" BO_ 149 0;
BA_ "VFrameFormat" BO_ 149 14;
BA_ "GenMsgSendType" BO_ 162 0;
BA_ "VFrameFormat" BO_ 162 14;
BA_ "GenMsgSendType" BO_ 163 0;
BA_ "VFrameFormat" BO_ 163 14;
BA_ "GenMsgSendType" BO_ 164 0;
BA_ "VFrameFormat" BO_ 164 14;
BA_ "GenMsgSendType" BO_ 165 0;
BA_ "VFrameFormat" BO_ 165 14;
BA_ "GenMsgSendType" BO_ 178 0;
BA_ "VFrameFormat" BO_ 178 14;
BA_ "GenMsgSendType" BO_ 224 0;
BA_ "VFrameFormat" BO_ 224 14;
BA_ "GenSigStartValue" SG_ 131 VFC_Cloth03_CurvChange 8388607;
BA_ "GenSigStartValue" SG_ 131 VFC_Cloth03_Curv 16384;
BA_ "GenSigStartValue" SG_ 131 VFC_Cloth03_Py 2048;
BA_ "GenSigStartValue" SG_ 131 VFC_Cloth03_OrientationYaw 2048;
BA_ "GenSigStartValue" SG_ 131 VFC_Cloth04_CurvChange 8388607;
BA_ "GenSigStartValue" SG_ 131 VFC_Cloth04_Curv 16384;
BA_ "GenSigStartValue" SG_ 131 VFC_Cloth04_Py 2048;
BA_ "GenSigStartValue" SG_ 131 VFC_Cloth04_OrientationYaw 2048;
BA_ "GenSigStartValue" SG_ 131 VFC_Cloth05_CurvChange 8388607;
BA_ "GenSigStartValue" SG_ 131 VFC_Cloth05_Curv 16384;
BA_ "GenSigStartValue" SG_ 131 VFC_Cloth05_Py 2048;
BA_ "GenSigStartValue" SG_ 131 VFC_Cloth05_OrientationYaw 2048;
BA_ "GenSigStartValue" SG_ 132 VFC_Cloth06_CurvChange 8388607;
BA_ "GenSigStartValue" SG_ 132 VFC_Cloth06_Curv 16384;
BA_ "GenSigStartValue" SG_ 132 VFC_Cloth06_Py 2048;
BA_ "GenSigStartValue" SG_ 132 VFC_Cloth06_OrientationYaw 2048;
BA_ "GenSigStartValue" SG_ 132 VFC_Cloth07_CurvChange 8388607;
BA_ "GenSigStartValue" SG_ 132 VFC_Cloth07_Curv 16384;
BA_ "GenSigStartValue" SG_ 132 VFC_Cloth07_Py 2048;
BA_ "GenSigStartValue" SG_ 132 VFC_Cloth07_OrientationYaw 2048;
BA_ "GenSigStartValue" SG_ 132 VFC_Cloth08_CurvChange 8388607;
BA_ "GenSigStartValue" SG_ 132 VFC_Cloth08_Curv 16384;
BA_ "GenSigStartValue" SG_ 132 VFC_Cloth08_Py 2048;
BA_ "GenSigStartValue" SG_ 132 VFC_Cloth08_OrientationYaw 2048;
BA_ "GenSigStartValue" SG_ 133 VFC_Cloth09_CurvChange 8388607;
BA_ "GenSigStartValue" SG_ 133 VFC_Cloth09_Curv 16384;
BA_ "GenSigStartValue" SG_ 133 VFC_Cloth09_Py 2048;
BA_ "GenSigStartValue" SG_ 133 VFC_Cloth09_OrientationYaw 2048;
BA_ "GenSigStartValue" SG_ 133 VFC_Cloth10_CurvChange 8388607;
BA_ "GenSigStartValue" SG_ 133 VFC_Cloth10_Curv 16384;
BA_ "GenSigStartValue" SG_ 133 VFC_Cloth10_Py 2048;
BA_ "GenSigStartValue" SG_ 133 VFC_Cloth10_OrientationYaw 2048;
BA_ "GenSigStartValue" SG_ 133 VFC_Cloth11_CurvChange 8388607;
BA_ "GenSigStartValue" SG_ 133 VFC_Cloth11_Curv 16384;
BA_ "GenSigStartValue" SG_ 133 VFC_Cloth11_Py 2048;
BA_ "GenSigStartValue" SG_ 133 VFC_Cloth11_OrientationYaw 2048;
BA_ "GenSigStartValue" SG_ 146 VFC_Poly00_CoefficientYc3 131072;
BA_ "GenSigStartValue" SG_ 146 VFC_Poly00_CoefficientYc2 65536;
BA_ "GenSigStartValue" SG_ 146 VFC_Poly00_CoefficientYc0 2048;
BA_ "GenSigStartValue" SG_ 146 VFC_Poly00_CoefficientYc1 16384;
BA_ "GenSigStartValue" SG_ 146 VFC_Poly00_CoefficientYc2Corr 65536;
BA_ "GenSigStartValue" SG_ 146 VFC_Poly00_CoefficientYc3Corr 131072;
BA_ "GenSigStartValue" SG_ 146 VFC_Poly01_CoefficientYc3 131072;
BA_ "GenSigStartValue" SG_ 146 VFC_Poly01_CoefficientYc2 65536;
BA_ "GenSigStartValue" SG_ 146 VFC_Poly01_CoefficientYc0 2048;
BA_ "GenSigStartValue" SG_ 146 VFC_Poly01_CoefficientYc1 16384;
BA_ "GenSigStartValue" SG_ 146 VFC_Poly01_CoefficientYc2Corr 65536;
BA_ "GenSigStartValue" SG_ 146 VFC_Poly01_CoefficientYc3Corr 131072;
BA_ "GenSigStartValue" SG_ 146 VFC_Poly02_CoefficientYc3 131072;
BA_ "GenSigStartValue" SG_ 146 VFC_Poly02_CoefficientYc2 65536;
BA_ "GenSigStartValue" SG_ 146 VFC_Poly02_CoefficientYc0 2048;
BA_ "GenSigStartValue" SG_ 146 VFC_Poly02_CoefficientYc1 16384;
BA_ "GenSigStartValue" SG_ 146 VFC_Poly02_CoefficientYc2Corr 65536;
BA_ "GenSigStartValue" SG_ 146 VFC_Poly02_CoefficientYc3Corr 131072;
BA_ "GenSigStartValue" SG_ 147 VFC_Poly03_CoefficientYc3 131072;
BA_ "GenSigStartValue" SG_ 147 VFC_Poly03_CoefficientYc2 65536;
BA_ "GenSigStartValue" SG_ 147 VFC_Poly03_CoefficientYc0 2048;
BA_ "GenSigStartValue" SG_ 147 VFC_Poly03_CoefficientYc1 16384;
BA_ "GenSigStartValue" SG_ 147 VFC_Poly03_CoefficientYc2Corr 65536;
BA_ "GenSigStartValue" SG_ 147 VFC_Poly03_CoefficientYc3Corr 131072;
BA_ "GenSigStartValue" SG_ 147 VFC_Poly04_CoefficientYc3 131072;
BA_ "GenSigStartValue" SG_ 147 VFC_Poly04_CoefficientYc2 65536;
BA_ "GenSigStartValue" SG_ 147 VFC_Poly04_CoefficientYc0 2048;
BA_ "GenSigStartValue" SG_ 147 VFC_Poly04_CoefficientYc1 16384;
BA_ "GenSigStartValue" SG_ 147 VFC_Poly04_CoefficientYc2Corr 65536;
BA_ "GenSigStartValue" SG_ 147 VFC_Poly04_CoefficientYc3Corr 131072;
BA_ "GenSigStartValue" SG_ 147 VFC_Poly05_CoefficientYc3 131072;
BA_ "GenSigStartValue" SG_ 147 VFC_Poly05_CoefficientYc2 65536;
BA_ "GenSigStartValue" SG_ 147 VFC_Poly05_CoefficientYc0 2048;
BA_ "GenSigStartValue" SG_ 147 VFC_Poly05_CoefficientYc1 16384;
BA_ "GenSigStartValue" SG_ 147 VFC_Poly05_CoefficientYc2Corr 65536;
BA_ "GenSigStartValue" SG_ 147 VFC_Poly05_CoefficientYc3Corr 131072;
BA_ "GenSigStartValue" SG_ 148 VFC_Poly06_CoefficientYc3 131072;
BA_ "GenSigStartValue" SG_ 148 VFC_Poly06_CoefficientYc2 65536;
BA_ "GenSigStartValue" SG_ 148 VFC_Poly06_CoefficientYc0 2048;
BA_ "GenSigStartValue" SG_ 148 VFC_Poly06_CoefficientYc1 16384;
BA_ "GenSigStartValue" SG_ 148 VFC_Poly06_CoefficientYc2Corr 65536;
BA_ "GenSigStartValue" SG_ 148 VFC_Poly06_CoefficientYc3Corr 131072;
BA_ "GenSigStartValue" SG_ 148 VFC_Poly07_CoefficientYc3 131072;
BA_ "GenSigStartValue" SG_ 148 VFC_Poly07_CoefficientYc2 65536;
BA_ "GenSigStartValue" SG_ 148 VFC_Poly07_CoefficientYc0 2048;
BA_ "GenSigStartValue" SG_ 148 VFC_Poly07_CoefficientYc1 16384;
BA_ "GenSigStartValue" SG_ 148 VFC_Poly07_CoefficientYc2Corr 65536;
BA_ "GenSigStartValue" SG_ 148 VFC_Poly07_CoefficientYc3Corr 131072;
BA_ "GenSigStartValue" SG_ 148 VFC_Poly08_CoefficientYc3 131072;
BA_ "GenSigStartValue" SG_ 148 VFC_Poly08_CoefficientYc2 65536;
BA_ "GenSigStartValue" SG_ 148 VFC_Poly08_CoefficientYc0 2048;
BA_ "GenSigStartValue" SG_ 148 VFC_Poly08_CoefficientYc1 16384;
BA_ "GenSigStartValue" SG_ 148 VFC_Poly08_CoefficientYc2Corr 65536;
BA_ "GenSigStartValue" SG_ 148 VFC_Poly08_CoefficientYc3Corr 131072;
BA_ "GenSigStartValue" SG_ 149 VFC_Poly09_CoefficientYc3 131072;
BA_ "GenSigStartValue" SG_ 149 VFC_Poly09_CoefficientYc2 65536;
BA_ "GenSigStartValue" SG_ 149 VFC_Poly09_CoefficientYc0 2048;
BA_ "GenSigStartValue" SG_ 149 VFC_Poly09_CoefficientYc1 16384;
BA_ "GenSigStartValue" SG_ 149 VFC_Poly09_CoefficientYc2Corr 65536;
BA_ "GenSigStartValue" SG_ 149 VFC_Poly09_CoefficientYc3Corr 131072;
BA_ "GenSigStartValue" SG_ 149 VFC_Poly10_CoefficientYc3 131072;
BA_ "GenSigStartValue" SG_ 149 VFC_Poly10_CoefficientYc2 65536;
BA_ "GenSigStartValue" SG_ 149 VFC_Poly10_CoefficientYc0 2048;
BA_ "GenSigStartValue" SG_ 149 VFC_Poly10_CoefficientYc1 16384;
BA_ "GenSigStartValue" SG_ 149 VFC_Poly10_CoefficientYc2Corr 65536;
BA_ "GenSigStartValue" SG_ 149 VFC_Poly10_CoefficientYc3Corr 131072;
BA_ "GenSigStartValue" SG_ 149 VFC_Poly11_CoefficientYc3 131072;
BA_ "GenSigStartValue" SG_ 149 VFC_Poly11_CoefficientYc2 65536;
BA_ "GenSigStartValue" SG_ 149 VFC_Poly11_CoefficientYc0 2048;
BA_ "GenSigStartValue" SG_ 149 VFC_Poly11_CoefficientYc1 16384;
BA_ "GenSigStartValue" SG_ 149 VFC_Poly11_CoefficientYc2Corr 65536;
BA_ "GenSigStartValue" SG_ 149 VFC_Poly11_CoefficientYc3Corr 131072;
BA_ "GenSigStartValue" SG_ 162 VFC_2DPoly00_CoefficientUc0 32768;
BA_ "GenSigStartValue" SG_ 162 VFC_2DPoly00_CoefficientUc1 32768;
BA_ "GenSigStartValue" SG_ 162 VFC_2DPoly00_CoefficientUc2 32768;
BA_ "GenSigStartValue" SG_ 162 VFC_2DPoly00_CoefficientUc3 32768;
BA_ "GenSigStartValue" SG_ 162 VFC_2DPoly00_CoefficientUc4 32768;
BA_ "GenSigStartValue" SG_ 162 VFC_2DPoly00_CoefficientUc5 32768;
BA_ "GenSigStartValue" SG_ 162 VFC_2DPoly01_CoefficientUc0 32768;
BA_ "GenSigStartValue" SG_ 162 VFC_2DPoly01_CoefficientUc1 32768;
BA_ "GenSigStartValue" SG_ 162 VFC_2DPoly01_CoefficientUc2 32768;
BA_ "GenSigStartValue" SG_ 162 VFC_2DPoly01_CoefficientUc3 32768;
BA_ "GenSigStartValue" SG_ 162 VFC_2DPoly01_CoefficientUc4 32768;
BA_ "GenSigStartValue" SG_ 162 VFC_2DPoly01_CoefficientUc5 32768;
BA_ "GenSigStartValue" SG_ 162 VFC_2DPoly02_CoefficientUc0 32768;
BA_ "GenSigStartValue" SG_ 162 VFC_2DPoly02_CoefficientUc1 32768;
BA_ "GenSigStartValue" SG_ 162 VFC_2DPoly02_CoefficientUc2 32768;
BA_ "GenSigStartValue" SG_ 162 VFC_2DPoly02_CoefficientUc3 32768;
BA_ "GenSigStartValue" SG_ 162 VFC_2DPoly02_CoefficientUc4 32768;
BA_ "GenSigStartValue" SG_ 162 VFC_2DPoly02_CoefficientUc5 32768;
BA_ "GenSigStartValue" SG_ 163 VFC_2DPoly03_CoefficientUc0 32768;
BA_ "GenSigStartValue" SG_ 163 VFC_2DPoly03_CoefficientUc1 32768;
BA_ "GenSigStartValue" SG_ 163 VFC_2DPoly03_CoefficientUc2 32768;
BA_ "GenSigStartValue" SG_ 163 VFC_2DPoly03_CoefficientUc3 32768;
BA_ "GenSigStartValue" SG_ 163 VFC_2DPoly03_CoefficientUc4 32768;
BA_ "GenSigStartValue" SG_ 163 VFC_2DPoly03_CoefficientUc5 32768;
BA_ "GenSigStartValue" SG_ 163 VFC_2DPoly04_CoefficientUc0 32768;
BA_ "GenSigStartValue" SG_ 163 VFC_2DPoly04_CoefficientUc1 32768;
BA_ "GenSigStartValue" SG_ 163 VFC_2DPoly04_CoefficientUc2 32768;
BA_ "GenSigStartValue" SG_ 163 VFC_2DPoly04_CoefficientUc3 32768;
BA_ "GenSigStartValue" SG_ 163 VFC_2DPoly04_CoefficientUc4 32768;
BA_ "GenSigStartValue" SG_ 163 VFC_2DPoly04_CoefficientUc5 32768;
BA_ "GenSigStartValue" SG_ 163 VFC_2DPoly05_CoefficientUc0 32768;
BA_ "GenSigStartValue" SG_ 163 VFC_2DPoly05_CoefficientUc1 32768;
BA_ "GenSigStartValue" SG_ 163 VFC_2DPoly05_CoefficientUc2 32768;
BA_ "GenSigStartValue" SG_ 163 VFC_2DPoly05_CoefficientUc3 32768;
BA_ "GenSigStartValue" SG_ 163 VFC_2DPoly05_CoefficientUc4 32768;
BA_ "GenSigStartValue" SG_ 163 VFC_2DPoly05_CoefficientUc5 32768;
BA_ "GenSigStartValue" SG_ 164 VFC_2DPoly06_CoefficientUc0 32768;
BA_ "GenSigStartValue" SG_ 164 VFC_2DPoly06_CoefficientUc1 32768;
BA_ "GenSigStartValue" SG_ 164 VFC_2DPoly06_CoefficientUc2 32768;
BA_ "GenSigStartValue" SG_ 164 VFC_2DPoly06_CoefficientUc3 32768;
BA_ "GenSigStartValue" SG_ 164 VFC_2DPoly06_CoefficientUc4 32768;
BA_ "GenSigStartValue" SG_ 164 VFC_2DPoly06_CoefficientUc5 32768;
BA_ "GenSigStartValue" SG_ 164 VFC_2DPoly07_CoefficientUc0 32768;
BA_ "GenSigStartValue" SG_ 164 VFC_2DPoly07_CoefficientUc1 32768;
BA_ "GenSigStartValue" SG_ 164 VFC_2DPoly07_CoefficientUc2 32768;
BA_ "GenSigStartValue" SG_ 164 VFC_2DPoly07_CoefficientUc3 32768;
BA_ "GenSigStartValue" SG_ 164 VFC_2DPoly07_CoefficientUc4 32768;
BA_ "GenSigStartValue" SG_ 164 VFC_2DPoly07_CoefficientUc5 32768;
BA_ "GenSigStartValue" SG_ 164 VFC_2DPoly08_CoefficientUc0 32768;
BA_ "GenSigStartValue" SG_ 164 VFC_2DPoly08_CoefficientUc1 32768;
BA_ "GenSigStartValue" SG_ 164 VFC_2DPoly08_CoefficientUc2 32768;
BA_ "GenSigStartValue" SG_ 164 VFC_2DPoly08_CoefficientUc3 32768;
BA_ "GenSigStartValue" SG_ 164 VFC_2DPoly08_CoefficientUc4 32768;
BA_ "GenSigStartValue" SG_ 164 VFC_2DPoly08_CoefficientUc5 32768;
BA_ "GenSigStartValue" SG_ 165 VFC_2DPoly09_CoefficientUc0 32768;
BA_ "GenSigStartValue" SG_ 165 VFC_2DPoly09_CoefficientUc1 32768;
BA_ "GenSigStartValue" SG_ 165 VFC_2DPoly09_CoefficientUc2 32768;
BA_ "GenSigStartValue" SG_ 165 VFC_2DPoly09_CoefficientUc3 32768;
BA_ "GenSigStartValue" SG_ 165 VFC_2DPoly09_CoefficientUc4 32768;
BA_ "GenSigStartValue" SG_ 165 VFC_2DPoly09_CoefficientUc5 32768;
BA_ "GenSigStartValue" SG_ 165 VFC_2DPoly10_CoefficientUc0 32768;
BA_ "GenSigStartValue" SG_ 165 VFC_2DPoly10_CoefficientUc1 32768;
BA_ "GenSigStartValue" SG_ 165 VFC_2DPoly10_CoefficientUc2 32768;
BA_ "GenSigStartValue" SG_ 165 VFC_2DPoly10_CoefficientUc3 32768;
BA_ "GenSigStartValue" SG_ 165 VFC_2DPoly10_CoefficientUc4 32768;
BA_ "GenSigStartValue" SG_ 165 VFC_2DPoly10_CoefficientUc5 32768;
BA_ "GenSigStartValue" SG_ 165 VFC_2DPoly11_CoefficientUc0 32768;
BA_ "GenSigStartValue" SG_ 165 VFC_2DPoly11_CoefficientUc1 32768;
BA_ "GenSigStartValue" SG_ 165 VFC_2DPoly11_CoefficientUc2 32768;
BA_ "GenSigStartValue" SG_ 165 VFC_2DPoly11_CoefficientUc3 32768;
BA_ "GenSigStartValue" SG_ 165 VFC_2DPoly11_CoefficientUc4 32768;
BA_ "GenSigStartValue" SG_ 165 VFC_2DPoly11_CoefficientUc5 32768;
BA_ "GenSigStartValue" SG_ 178 VFC_RM00_VertexPoint00y 256;
BA_ "GenSigStartValue" SG_ 178 VFC_RM00_VertexPoint01y 256;
BA_ "GenSigStartValue" SG_ 178 VFC_RM01_VertexPoint00y 256;
BA_ "GenSigStartValue" SG_ 178 VFC_RM01_VertexPoint01y 256;
BA_ "GenSigStartValue" SG_ 178 VFC_RM02_VertexPoint00y 256;
BA_ "GenSigStartValue" SG_ 178 VFC_RM02_VertexPoint01y 256;
BA_ "GenSigStartValue" SG_ 178 VFC_RM03_VertexPoint00y 256;
BA_ "GenSigStartValue" SG_ 178 VFC_RM03_VertexPoint01y 256;
BA_ "GenSigStartValue" SG_ 178 VFC_RM04_VertexPoint00y 256;
BA_ "GenSigStartValue" SG_ 178 VFC_RM04_VertexPoint01y 256;
BA_ "GenSigStartValue" SG_ 178 VFC_RM05_VertexPoint00y 256;
BA_ "GenSigStartValue" SG_ 178 VFC_RM05_VertexPoint01y 256;
BA_ "GenSigStartValue" SG_ 178 VFC_RM06_VertexPoint00y 256;
BA_ "GenSigStartValue" SG_ 178 VFC_RM06_VertexPoint01y 256;
BA_ "GenSigStartValue" SG_ 224 VFC_TLHdr_IfVersionIdMajor 1;
BA_ "GenSigStartValue" SG_ 224 VFC_TLHdr_IfVersionIdMinor 2;
VAL_ 131 VFC_Cloth03_LaneAssociation 0 "LEFT_EGO_LINE" 1 "RIGHT_EGO_LINE" 2 "LEFT_LEFT_LINE" 3 "RIGHT_RIGHT_LINE" 4 "ROAD_EDGE_LEFT" 5 "ROAD_EDGE_RIGHT" 6 "RAISED_LEFT" 7 "RAISED_RIGHT" 8 "NOT_SELECTED_CANDIDATE" 9 "EGO_TRACK_LEFT" 10 "EGO_TRACK_RIGHT" 11 "Reserved11" 12 "Reserved12" 13 "Reserved13" 14 "Reserved14" 15 "Reserved15" ;
VAL_ 131 VFC_Cloth03_Colour 0 "COLOR_WHITE" 1 "COLOR_YELLOW" 2 "COLOR_RED" 3 "COLOR_BLUE" 4 "COLOR_GREEN" 5 "RESERVED5" 6 "RESERVED6" 7 "COLOR_UNKNOWN" ;
VAL_ 131 VFC_Cloth03_Type 0 "TYPE_SOLID_LINE" 1 "TYPE_DASHED_LINE" 2 "TYPE_DOUBLE_DASHED_DASHED" 3 "TYPE_DOUBLE_DASHED_SOLID" 4 "TYPE_DOUBLE_SOLID_DASHED" 5 "TYPE_DOUBLE_SOLID_SOLID" 6 "TYPE_MULTIPLE" 7 "TYPE_MULTIPLE_WARNING" 8 "TYPE_BOTTS_DOTS" 9 "TYPE_ROAD_EDGE" 10 "TYPE_ROAD_FURNITURE" 11 "TYPE_CURBSTONE" 12 "TYPE_TRAFFIC_STATIC" 13 "TYPE_UNKNOWN_RAISED" 14 "TYPE_UNKNOWN" 15 "Reserved15" ;
VAL_ 131 VFC_Cloth04_LaneAssociation 0 "LEFT_EGO_LINE" 1 "RIGHT_EGO_LINE" 2 "LEFT_LEFT_LINE" 3 "RIGHT_RIGHT_LINE" 4 "ROAD_EDGE_LEFT" 5 "ROAD_EDGE_RIGHT" 6 "RAISED_LEFT" 7 "RAISED_RIGHT" 8 "NOT_SELECTED_CANDIDATE" 9 "EGO_TRACK_LEFT" 10 "EGO_TRACK_RIGHT" 11 "Reserved11" 12 "Reserved12" 13 "Reserved13" 14 "Reserved14" 15 "Reserved15" ;
VAL_ 131 VFC_Cloth04_Colour 0 "COLOR_WHITE" 1 "COLOR_YELLOW" 2 "COLOR_RED" 3 "COLOR_BLUE" 4 "COLOR_GREEN" 5 "RESERVED5" 6 "RESERVED6" 7 "COLOR_UNKNOWN" ;
VAL_ 131 VFC_Cloth04_Type 0 "TYPE_SOLID_LINE" 1 "TYPE_DASHED_LINE" 2 "TYPE_DOUBLE_DASHED_DASHED" 3 "TYPE_DOUBLE_DASHED_SOLID" 4 "TYPE_DOUBLE_SOLID_DASHED" 5 "TYPE_DOUBLE_SOLID_SOLID" 6 "TYPE_MULTIPLE" 7 "TYPE_MULTIPLE_WARNING" 8 "TYPE_BOTTS_DOTS" 9 "TYPE_ROAD_EDGE" 10 "TYPE_ROAD_FURNITURE" 11 "TYPE_CURBSTONE" 12 "TYPE_TRAFFIC_STATIC" 13 "TYPE_UNKNOWN_RAISED" 14 "TYPE_UNKNOWN" 15 "Reserved15" ;
VAL_ 131 VFC_Cloth05_LaneAssociation 0 "LEFT_EGO_LINE" 1 "RIGHT_EGO_LINE" 2 "LEFT_LEFT_LINE" 3 "RIGHT_RIGHT_LINE" 4 "ROAD_EDGE_LEFT" 5 "ROAD_EDGE_RIGHT" 6 "RAISED_LEFT" 7 "RAISED_RIGHT" 8 "NOT_SELECTED_CANDIDATE" 9 "EGO_TRACK_LEFT" 10 "EGO_TRACK_RIGHT" 11 "Reserved11" 12 "Reserved12" 13 "Reserved13" 14 "Reserved14" 15 "Reserved15" ;
VAL_ 131 VFC_Cloth05_Colour 0 "COLOR_WHITE" 1 "COLOR_YELLOW" 2 "COLOR_RED" 3 "COLOR_BLUE" 4 "COLOR_GREEN" 5 "RESERVED5" 6 "RESERVED6" 7 "COLOR_UNKNOWN" ;
VAL_ 131 VFC_Cloth05_Type 0 "TYPE_SOLID_LINE" 1 "TYPE_DASHED_LINE" 2 "TYPE_DOUBLE_DASHED_DASHED" 3 "TYPE_DOUBLE_DASHED_SOLID" 4 "TYPE_DOUBLE_SOLID_DASHED" 5 "TYPE_DOUBLE_SOLID_SOLID" 6 "TYPE_MULTIPLE" 7 "TYPE_MULTIPLE_WARNING" 8 "TYPE_BOTTS_DOTS" 9 "TYPE_ROAD_EDGE" 10 "TYPE_ROAD_FURNITURE" 11 "TYPE_CURBSTONE" 12 "TYPE_TRAFFIC_STATIC" 13 "TYPE_UNKNOWN_RAISED" 14 "TYPE_UNKNOWN" 15 "Reserved15" ;
VAL_ 132 VFC_Cloth06_LaneAssociation 0 "LEFT_EGO_LINE" 1 "RIGHT_EGO_LINE" 2 "LEFT_LEFT_LINE" 3 "RIGHT_RIGHT_LINE" 4 "ROAD_EDGE_LEFT" 5 "ROAD_EDGE_RIGHT" 6 "RAISED_LEFT" 7 "RAISED_RIGHT" 8 "NOT_SELECTED_CANDIDATE" 9 "EGO_TRACK_LEFT" 10 "EGO_TRACK_RIGHT" 11 "Reserved11" 12 "Reserved12" 13 "Reserved13" 14 "Reserved14" 15 "Reserved15" ;
VAL_ 132 VFC_Cloth06_Colour 0 "COLOR_WHITE" 1 "COLOR_YELLOW" 2 "COLOR_RED" 3 "COLOR_BLUE" 4 "COLOR_GREEN" 5 "RESERVED5" 6 "RESERVED6" 7 "COLOR_UNKNOWN" ;
VAL_ 132 VFC_Cloth06_Type 0 "TYPE_SOLID_LINE" 1 "TYPE_DASHED_LINE" 2 "TYPE_DOUBLE_DASHED_DASHED" 3 "TYPE_DOUBLE_DASHED_SOLID" 4 "TYPE_DOUBLE_SOLID_DASHED" 5 "TYPE_DOUBLE_SOLID_SOLID" 6 "TYPE_MULTIPLE" 7 "TYPE_MULTIPLE_WARNING" 8 "TYPE_BOTTS_DOTS" 9 "TYPE_ROAD_EDGE" 10 "TYPE_ROAD_FURNITURE" 11 "TYPE_CURBSTONE" 12 "TYPE_TRAFFIC_STATIC" 13 "TYPE_UNKNOWN_RAISED" 14 "TYPE_UNKNOWN" 15 "Reserved15" ;
VAL_ 132 VFC_Cloth07_LaneAssociation 0 "LEFT_EGO_LINE" 1 "RIGHT_EGO_LINE" 2 "LEFT_LEFT_LINE" 3 "RIGHT_RIGHT_LINE" 4 "ROAD_EDGE_LEFT" 5 "ROAD_EDGE_RIGHT" 6 "RAISED_LEFT" 7 "RAISED_RIGHT" 8 "NOT_SELECTED_CANDIDATE" 9 "EGO_TRACK_LEFT" 10 "EGO_TRACK_RIGHT" 11 "Reserved11" 12 "Reserved12" 13 "Reserved13" 14 "Reserved14" 15 "Reserved15" ;
VAL_ 132 VFC_Cloth07_Colour 0 "COLOR_WHITE" 1 "COLOR_YELLOW" 2 "COLOR_RED" 3 "COLOR_BLUE" 4 "COLOR_GREEN" 5 "RESERVED5" 6 "RESERVED6" 7 "COLOR_UNKNOWN" ;
VAL_ 132 VFC_Cloth07_Type 0 "TYPE_SOLID_LINE" 1 "TYPE_DASHED_LINE" 2 "TYPE_DOUBLE_DASHED_DASHED" 3 "TYPE_DOUBLE_DASHED_SOLID" 4 "TYPE_DOUBLE_SOLID_DASHED" 5 "TYPE_DOUBLE_SOLID_SOLID" 6 "TYPE_MULTIPLE" 7 "TYPE_MULTIPLE_WARNING" 8 "TYPE_BOTTS_DOTS" 9 "TYPE_ROAD_EDGE" 10 "TYPE_ROAD_FURNITURE" 11 "TYPE_CURBSTONE" 12 "TYPE_TRAFFIC_STATIC" 13 "TYPE_UNKNOWN_RAISED" 14 "TYPE_UNKNOWN" 15 "Reserved15" ;
VAL_ 132 VFC_Cloth08_LaneAssociation 0 "LEFT_EGO_LINE" 1 "RIGHT_EGO_LINE" 2 "LEFT_LEFT_LINE" 3 "RIGHT_RIGHT_LINE" 4 "ROAD_EDGE_LEFT" 5 "ROAD_EDGE_RIGHT" 6 "RAISED_LEFT" 7 "RAISED_RIGHT" 8 "NOT_SELECTED_CANDIDATE" 9 "EGO_TRACK_LEFT" 10 "EGO_TRACK_RIGHT" 11 "Reserved11" 12 "Reserved12" 13 "Reserved13" 14 "Reserved14" 15 "Reserved15" ;
VAL_ 132 VFC_Cloth08_Colour 0 "COLOR_WHITE" 1 "COLOR_YELLOW" 2 "COLOR_RED" 3 "COLOR_BLUE" 4 "COLOR_GREEN" 5 "RESERVED5" 6 "RESERVED6" 7 "COLOR_UNKNOWN" ;
VAL_ 132 VFC_Cloth08_Type 0 "TYPE_SOLID_LINE" 1 "TYPE_DASHED_LINE" 2 "TYPE_DOUBLE_DASHED_DASHED" 3 "TYPE_DOUBLE_DASHED_SOLID" 4 "TYPE_DOUBLE_SOLID_DASHED" 5 "TYPE_DOUBLE_SOLID_SOLID" 6 "TYPE_MULTIPLE" 7 "TYPE_MULTIPLE_WARNING" 8 "TYPE_BOTTS_DOTS" 9 "TYPE_ROAD_EDGE" 10 "TYPE_ROAD_FURNITURE" 11 "TYPE_CURBSTONE" 12 "TYPE_TRAFFIC_STATIC" 13 "TYPE_UNKNOWN_RAISED" 14 "TYPE_UNKNOWN" 15 "Reserved15" ;
VAL_ 133 VFC_Cloth09_LaneAssociation 0 "LEFT_EGO_LINE" 1 "RIGHT_EGO_LINE" 2 "LEFT_LEFT_LINE" 3 "RIGHT_RIGHT_LINE" 4 "ROAD_EDGE_LEFT" 5 "ROAD_EDGE_RIGHT" 6 "RAISED_LEFT" 7 "RAISED_RIGHT" 8 "NOT_SELECTED_CANDIDATE" 9 "EGO_TRACK_LEFT" 10 "EGO_TRACK_RIGHT" 11 "Reserved11" 12 "Reserved12" 13 "Reserved13" 14 "Reserved14" 15 "Reserved15" ;
VAL_ 133 VFC_Cloth09_Colour 0 "COLOR_WHITE" 1 "COLOR_YELLOW" 2 "COLOR_RED" 3 "COLOR_BLUE" 4 "COLOR_GREEN" 5 "RESERVED5" 6 "RESERVED6" 7 "COLOR_UNKNOWN" ;
VAL_ 133 VFC_Cloth09_Type 0 "TYPE_SOLID_LINE" 1 "TYPE_DASHED_LINE" 2 "TYPE_DOUBLE_DASHED_DASHED" 3 "TYPE_DOUBLE_DASHED_SOLID" 4 "TYPE_DOUBLE_SOLID_DASHED" 5 "TYPE_DOUBLE_SOLID_SOLID" 6 "TYPE_MULTIPLE" 7 "TYPE_MULTIPLE_WARNING" 8 "TYPE_BOTTS_DOTS" 9 "TYPE_ROAD_EDGE" 10 "TYPE_ROAD_FURNITURE" 11 "TYPE_CURBSTONE" 12 "TYPE_TRAFFIC_STATIC" 13 "TYPE_UNKNOWN_RAISED" 14 "TYPE_UNKNOWN" 15 "Reserved15" ;
VAL_ 133 VFC_Cloth10_LaneAssociation 0 "LEFT_EGO_LINE" 1 "RIGHT_EGO_LINE" 2 "LEFT_LEFT_LINE" 3 "RIGHT_RIGHT_LINE" 4 "ROAD_EDGE_LEFT" 5 "ROAD_EDGE_RIGHT" 6 "RAISED_LEFT" 7 "RAISED_RIGHT" 8 "NOT_SELECTED_CANDIDATE" 9 "EGO_TRACK_LEFT" 10 "EGO_TRACK_RIGHT" 11 "Reserved11" 12 "Reserved12" 13 "Reserved13" 14 "Reserved14" 15 "Reserved15" ;
VAL_ 133 VFC_Cloth10_Colour 0 "COLOR_WHITE" 1 "COLOR_YELLOW" 2 "COLOR_RED" 3 "COLOR_BLUE" 4 "COLOR_GREEN" 5 "RESERVED5" 6 "RESERVED6" 7 "COLOR_UNKNOWN" ;
VAL_ 133 VFC_Cloth10_Type 0 "TYPE_SOLID_LINE" 1 "TYPE_DASHED_LINE" 2 "TYPE_DOUBLE_DASHED_DASHED" 3 "TYPE_DOUBLE_DASHED_SOLID" 4 "TYPE_DOUBLE_SOLID_DASHED" 5 "TYPE_DOUBLE_SOLID_SOLID" 6 "TYPE_MULTIPLE" 7 "TYPE_MULTIPLE_WARNING" 8 "TYPE_BOTTS_DOTS" 9 "TYPE_ROAD_EDGE" 10 "TYPE_ROAD_FURNITURE" 11 "TYPE_CURBSTONE" 12 "TYPE_TRAFFIC_STATIC" 13 "TYPE_UNKNOWN_RAISED" 14 "TYPE_UNKNOWN" 15 "Reserved15" ;
VAL_ 133 VFC_Cloth11_LaneAssociation 0 "LEFT_EGO_LINE" 1 "RIGHT_EGO_LINE" 2 "LEFT_LEFT_LINE" 3 "RIGHT_RIGHT_LINE" 4 "ROAD_EDGE_LEFT" 5 "ROAD_EDGE_RIGHT" 6 "RAISED_LEFT" 7 "RAISED_RIGHT" 8 "NOT_SELECTED_CANDIDATE" 9 "EGO_TRACK_LEFT" 10 "EGO_TRACK_RIGHT" 11 "Reserved11" 12 "Reserved12" 13 "Reserved13" 14 "Reserved14" 15 "Reserved15" ;
VAL_ 133 VFC_Cloth11_Colour 0 "COLOR_WHITE" 1 "COLOR_YELLOW" 2 "COLOR_RED" 3 "COLOR_BLUE" 4 "COLOR_GREEN" 5 "RESERVED5" 6 "RESERVED6" 7 "COLOR_UNKNOWN" ;
VAL_ 133 VFC_Cloth11_Type 0 "TYPE_SOLID_LINE" 1 "TYPE_DASHED_LINE" 2 "TYPE_DOUBLE_DASHED_DASHED" 3 "TYPE_DOUBLE_DASHED_SOLID" 4 "TYPE_DOUBLE_SOLID_DASHED" 5 "TYPE_DOUBLE_SOLID_SOLID" 6 "TYPE_MULTIPLE" 7 "TYPE_MULTIPLE_WARNING" 8 "TYPE_BOTTS_DOTS" 9 "TYPE_ROAD_EDGE" 10 "TYPE_ROAD_FURNITURE" 11 "TYPE_CURBSTONE" 12 "TYPE_TRAFFIC_STATIC" 13 "TYPE_UNKNOWN_RAISED" 14 "TYPE_UNKNOWN" 15 "Reserved15" ;
VAL_ 146 VFC_Poly00_LaneAssociation 0 "LEFT_EGO_LINE" 1 "RIGHT_EGO_LINE" 2 "LEFT_LEFT_LINE" 3 "RIGHT_RIGHT_LINE" 4 "ROAD_EDGE_LEFT" 5 "ROAD_EDGE_RIGHT" 6 "RAISED_LEFT" 7 "RAISED_RIGHT" 8 "NOT_SELECTED_CANDIDATE" 9 "EGO_TRACK_LEFT" 10 "EGO_TRACK_RIGHT" 11 "Reserved11" 12 "Reserved12" 13 "Reserved13" 14 "Reserved14" 15 "Reserved15" ;
VAL_ 146 VFC_Poly00_Type 0 "TYPE_SOLID_LINE" 1 "TYPE_DASHED_LINE" 2 "TYPE_DOUBLE_DASHED_DASHED" 3 "TYPE_DOUBLE_DASHED_SOLID" 4 "TYPE_DOUBLE_SOLID_DASHED" 5 "TYPE_DOUBLE_SOLID_SOLID" 6 "TYPE_MULTIPLE" 7 "TYPE_MULTIPLE_WARNING" 8 "TYPE_BOTTS_DOTS" 9 "TYPE_ROAD_EDGE" 10 "TYPE_ROAD_FURNITURE" 11 "TYPE_CURBSTONE" 12 "TYPE_TRAFFIC_STATIC" 13 "TYPE_UNKNOWN_RAISED" 14 "TYPE_UNKNOWN" 15 "Reserved15" ;
VAL_ 146 VFC_Poly00_Colour 0 "COLOR_WHITE" 1 "COLOR_YELLOW" 2 "COLOR_RED" 3 "COLOR_BLUE" 4 "COLOR_GREEN" 5 "RESERVED5" 6 "RESERVED6" 7 "COLOR_UNKNOWN" ;
VAL_ 146 VFC_Poly01_LaneAssociation 0 "LEFT_EGO_LINE" 1 "RIGHT_EGO_LINE" 2 "LEFT_LEFT_LINE" 3 "RIGHT_RIGHT_LINE" 4 "ROAD_EDGE_LEFT" 5 "ROAD_EDGE_RIGHT" 6 "RAISED_LEFT" 7 "RAISED_RIGHT" 8 "NOT_SELECTED_CANDIDATE" 9 "EGO_TRACK_LEFT" 10 "EGO_TRACK_RIGHT" 11 "Reserved11" 12 "Reserved12" 13 "Reserved13" 14 "Reserved14" 15 "Reserved15" ;
VAL_ 146 VFC_Poly01_Type 0 "TYPE_SOLID_LINE" 1 "TYPE_DASHED_LINE" 2 "TYPE_DOUBLE_DASHED_DASHED" 3 "TYPE_DOUBLE_DASHED_SOLID" 4 "TYPE_DOUBLE_SOLID_DASHED" 5 "TYPE_DOUBLE_SOLID_SOLID" 6 "TYPE_MULTIPLE" 7 "TYPE_MULTIPLE_WARNING" 8 "TYPE_BOTTS_DOTS" 9 "TYPE_ROAD_EDGE" 10 "TYPE_ROAD_FURNITURE" 11 "TYPE_CURBSTONE" 12 "TYPE_TRAFFIC_STATIC" 13 "TYPE_UNKNOWN_RAISED" 14 "TYPE_UNKNOWN" 15 "Reserved15" ;
VAL_ 146 VFC_Poly01_Colour 0 "COLOR_WHITE" 1 "COLOR_YELLOW" 2 "COLOR_RED" 3 "COLOR_BLUE" 4 "COLOR_GREEN" 5 "RESERVED5" 6 "RESERVED6" 7 "COLOR_UNKNOWN" ;
VAL_ 146 VFC_Poly02_LaneAssociation 0 "LEFT_EGO_LINE" 1 "RIGHT_EGO_LINE" 2 "LEFT_LEFT_LINE" 3 "RIGHT_RIGHT_LINE" 4 "ROAD_EDGE_LEFT" 5 "ROAD_EDGE_RIGHT" 6 "RAISED_LEFT" 7 "RAISED_RIGHT" 8 "NOT_SELECTED_CANDIDATE" 9 "EGO_TRACK_LEFT" 10 "EGO_TRACK_RIGHT" 11 "Reserved11" 12 "Reserved12" 13 "Reserved13" 14 "Reserved14" 15 "Reserved15" ;
VAL_ 146 VFC_Poly02_Type 0 "TYPE_SOLID_LINE" 1 "TYPE_DASHED_LINE" 2 "TYPE_DOUBLE_DASHED_DASHED" 3 "TYPE_DOUBLE_DASHED_SOLID" 4 "TYPE_DOUBLE_SOLID_DASHED" 5 "TYPE_DOUBLE_SOLID_SOLID" 6 "TYPE_MULTIPLE" 7 "TYPE_MULTIPLE_WARNING" 8 "TYPE_BOTTS_DOTS" 9 "TYPE_ROAD_EDGE" 10 "TYPE_ROAD_FURNITURE" 11 "TYPE_CURBSTONE" 12 "TYPE_TRAFFIC_STATIC" 13 "TYPE_UNKNOWN_RAISED" 14 "TYPE_UNKNOWN" 15 "Reserved15" ;
VAL_ 146 VFC_Poly02_Colour 0 "COLOR_WHITE" 1 "COLOR_YELLOW" 2 "COLOR_RED" 3 "COLOR_BLUE" 4 "COLOR_GREEN" 5 "RESERVED5" 6 "RESERVED6" 7 "COLOR_UNKNOWN" ;
VAL_ 147 VFC_Poly03_LaneAssociation 0 "LEFT_EGO_LINE" 1 "RIGHT_EGO_LINE" 2 "LEFT_LEFT_LINE" 3 "RIGHT_RIGHT_LINE" 4 "ROAD_EDGE_LEFT" 5 "ROAD_EDGE_RIGHT" 6 "RAISED_LEFT" 7 "RAISED_RIGHT" 8 "NOT_SELECTED_CANDIDATE" 9 "EGO_TRACK_LEFT" 10 "EGO_TRACK_RIGHT" 11 "Reserved11" 12 "Reserved12" 13 "Reserved13" 14 "Reserved14" 15 "Reserved15" ;
VAL_ 147 VFC_Poly03_Type 0 "TYPE_SOLID_LINE" 1 "TYPE_DASHED_LINE" 2 "TYPE_DOUBLE_DASHED_DASHED" 3 "TYPE_DOUBLE_DASHED_SOLID" 4 "TYPE_DOUBLE_SOLID_DASHED" 5 "TYPE_DOUBLE_SOLID_SOLID" 6 "TYPE_MULTIPLE" 7 "TYPE_MULTIPLE_WARNING" 8 "TYPE_BOTTS_DOTS" 9 "TYPE_ROAD_EDGE" 10 "TYPE_ROAD_FURNITURE" 11 "TYPE_CURBSTONE" 12 "TYPE_TRAFFIC_STATIC" 13 "TYPE_UNKNOWN_RAISED" 14 "TYPE_UNKNOWN" 15 "Reserved15" ;
VAL_ 147 VFC_Poly03_Colour 0 "COLOR_WHITE" 1 "COLOR_YELLOW" 2 "COLOR_RED" 3 "COLOR_BLUE" 4 "COLOR_GREEN" 5 "RESERVED5" 6 "RESERVED6" 7 "COLOR_UNKNOWN" ;
VAL_ 147 VFC_Poly04_LaneAssociation 0 "LEFT_EGO_LINE" 1 "RIGHT_EGO_LINE" 2 "LEFT_LEFT_LINE" 3 "RIGHT_RIGHT_LINE" 4 "ROAD_EDGE_LEFT" 5 "ROAD_EDGE_RIGHT" 6 "RAISED_LEFT" 7 "RAISED_RIGHT" 8 "NOT_SELECTED_CANDIDATE" 9 "EGO_TRACK_LEFT" 10 "EGO_TRACK_RIGHT" 11 "Reserved11" 12 "Reserved12" 13 "Reserved13" 14 "Reserved14" 15 "Reserved15" ;
VAL_ 147 VFC_Poly04_Type 0 "TYPE_SOLID_LINE" 1 "TYPE_DASHED_LINE" 2 "TYPE_DOUBLE_DASHED_DASHED" 3 "TYPE_DOUBLE_DASHED_SOLID" 4 "TYPE_DOUBLE_SOLID_DASHED" 5 "TYPE_DOUBLE_SOLID_SOLID" 6 "TYPE_MULTIPLE" 7 "TYPE_MULTIPLE_WARNING" 8 "TYPE_BOTTS_DOTS" 9 "TYPE_ROAD_EDGE" 10 "TYPE_ROAD_FURNITURE" 11 "TYPE_CURBSTONE" 12 "TYPE_TRAFFIC_STATIC" 13 "TYPE_UNKNOWN_RAISED" 14 "TYPE_UNKNOWN" 15 "Reserved15" ;
VAL_ 147 VFC_Poly04_Colour 0 "COLOR_WHITE" 1 "COLOR_YELLOW" 2 "COLOR_RED" 3 "COLOR_BLUE" 4 "COLOR_GREEN" 5 "RESERVED5" 6 "RESERVED6" 7 "COLOR_UNKNOWN" ;
VAL_ 147 VFC_Poly05_LaneAssociation 0 "LEFT_EGO_LINE" 1 "RIGHT_EGO_LINE" 2 "LEFT_LEFT_LINE" 3 "RIGHT_RIGHT_LINE" 4 "ROAD_EDGE_LEFT" 5 "ROAD_EDGE_RIGHT" 6 "RAISED_LEFT" 7 "RAISED_RIGHT" 8 "NOT_SELECTED_CANDIDATE" 9 "EGO_TRACK_LEFT" 10 "EGO_TRACK_RIGHT" 11 "Reserved11" 12 "Reserved12" 13 "Reserved13" 14 "Reserved14" 15 "Reserved15" ;
VAL_ 147 VFC_Poly05_Type 0 "TYPE_SOLID_LINE" 1 "TYPE_DASHED_LINE" 2 "TYPE_DOUBLE_DASHED_DASHED" 3 "TYPE_DOUBLE_DASHED_SOLID" 4 "TYPE_DOUBLE_SOLID_DASHED" 5 "TYPE_DOUBLE_SOLID_SOLID" 6 "TYPE_MULTIPLE" 7 "TYPE_MULTIPLE_WARNING" 8 "TYPE_BOTTS_DOTS" 9 "TYPE_ROAD_EDGE" 10 "TYPE_ROAD_FURNITURE" 11 "TYPE_CURBSTONE" 12 "TYPE_TRAFFIC_STATIC" 13 "TYPE_UNKNOWN_RAISED" 14 "TYPE_UNKNOWN" 15 "Reserved15" ;
VAL_ 147 VFC_Poly05_Colour 0 "COLOR_WHITE" 1 "COLOR_YELLOW" 2 "COLOR_RED" 3 "COLOR_BLUE" 4 "COLOR_GREEN" 5 "RESERVED5" 6 "RESERVED6" 7 "COLOR_UNKNOWN" ;
VAL_ 148 VFC_Poly06_LaneAssociation 0 "LEFT_EGO_LINE" 1 "RIGHT_EGO_LINE" 2 "LEFT_LEFT_LINE" 3 "RIGHT_RIGHT_LINE" 4 "ROAD_EDGE_LEFT" 5 "ROAD_EDGE_RIGHT" 6 "RAISED_LEFT" 7 "RAISED_RIGHT" 8 "NOT_SELECTED_CANDIDATE" 9 "EGO_TRACK_LEFT" 10 "EGO_TRACK_RIGHT" 11 "Reserved11" 12 "Reserved12" 13 "Reserved13" 14 "Reserved14" 15 "Reserved15" ;
VAL_ 148 VFC_Poly06_Type 0 "TYPE_SOLID_LINE" 1 "TYPE_DASHED_LINE" 2 "TYPE_DOUBLE_DASHED_DASHED" 3 "TYPE_DOUBLE_DASHED_SOLID" 4 "TYPE_DOUBLE_SOLID_DASHED" 5 "TYPE_DOUBLE_SOLID_SOLID" 6 "TYPE_MULTIPLE" 7 "TYPE_MULTIPLE_WARNING" 8 "TYPE_BOTTS_DOTS" 9 "TYPE_ROAD_EDGE" 10 "TYPE_ROAD_FURNITURE" 11 "TYPE_CURBSTONE" 12 "TYPE_TRAFFIC_STATIC" 13 "TYPE_UNKNOWN_RAISED" 14 "TYPE_UNKNOWN" 15 "Reserved15" ;
VAL_ 148 VFC_Poly06_Colour 0 "COLOR_WHITE" 1 "COLOR_YELLOW" 2 "COLOR_RED" 3 "COLOR_BLUE" 4 "COLOR_GREEN" 5 "RESERVED5" 6 "RESERVED6" 7 "COLOR_UNKNOWN" ;
VAL_ 148 VFC_Poly07_LaneAssociation 0 "LEFT_EGO_LINE" 1 "RIGHT_EGO_LINE" 2 "LEFT_LEFT_LINE" 3 "RIGHT_RIGHT_LINE" 4 "ROAD_EDGE_LEFT" 5 "ROAD_EDGE_RIGHT" 6 "RAISED_LEFT" 7 "RAISED_RIGHT" 8 "NOT_SELECTED_CANDIDATE" 9 "EGO_TRACK_LEFT" 10 "EGO_TRACK_RIGHT" 11 "Reserved11" 12 "Reserved12" 13 "Reserved13" 14 "Reserved14" 15 "Reserved15" ;
VAL_ 148 VFC_Poly07_Type 0 "TYPE_SOLID_LINE" 1 "TYPE_DASHED_LINE" 2 "TYPE_DOUBLE_DASHED_DASHED" 3 "TYPE_DOUBLE_DASHED_SOLID" 4 "TYPE_DOUBLE_SOLID_DASHED" 5 "TYPE_DOUBLE_SOLID_SOLID" 6 "TYPE_MULTIPLE" 7 "TYPE_MULTIPLE_WARNING" 8 "TYPE_BOTTS_DOTS" 9 "TYPE_ROAD_EDGE" 10 "TYPE_ROAD_FURNITURE" 11 "TYPE_CURBSTONE" 12 "TYPE_TRAFFIC_STATIC" 13 "TYPE_UNKNOWN_RAISED" 14 "TYPE_UNKNOWN" 15 "Reserved15" ;
VAL_ 148 VFC_Poly07_Colour 0 "COLOR_WHITE" 1 "COLOR_YELLOW" 2 "COLOR_RED" 3 "COLOR_BLUE" 4 "COLOR_GREEN" 5 "RESERVED5" 6 "RESERVED6" 7 "COLOR_UNKNOWN" ;
VAL_ 148 VFC_Poly08_LaneAssociation 0 "LEFT_EGO_LINE" 1 "RIGHT_EGO_LINE" 2 "LEFT_LEFT_LINE" 3 "RIGHT_RIGHT_LINE" 4 "ROAD_EDGE_LEFT" 5 "ROAD_EDGE_RIGHT" 6 "RAISED_LEFT" 7 "RAISED_RIGHT" 8 "NOT_SELECTED_CANDIDATE" 9 "EGO_TRACK_LEFT" 10 "EGO_TRACK_RIGHT" 11 "Reserved11" 12 "Reserved12" 13 "Reserved13" 14 "Reserved14" 15 "Reserved15" ;
VAL_ 148 VFC_Poly08_Type 0 "TYPE_SOLID_LINE" 1 "TYPE_DASHED_LINE" 2 "TYPE_DOUBLE_DASHED_DASHED" 3 "TYPE_DOUBLE_DASHED_SOLID" 4 "TYPE_DOUBLE_SOLID_DASHED" 5 "TYPE_DOUBLE_SOLID_SOLID" 6 "TYPE_MULTIPLE" 7 "TYPE_MULTIPLE_WARNING" 8 "TYPE_BOTTS_DOTS" 9 "TYPE_ROAD_EDGE" 10 "TYPE_ROAD_FURNITURE" 11 "TYPE_CURBSTONE" 12 "TYPE_TRAFFIC_STATIC" 13 "TYPE_UNKNOWN_RAISED" 14 "TYPE_UNKNOWN" 15 "Reserved15" ;
VAL_ 148 VFC_Poly08_Colour 0 "COLOR_WHITE" 1 "COLOR_YELLOW" 2 "COLOR_RED" 3 "COLOR_BLUE" 4 "COLOR_GREEN" 5 "RESERVED5" 6 "RESERVED6" 7 "COLOR_UNKNOWN" ;
VAL_ 149 VFC_Poly09_LaneAssociation 0 "LEFT_EGO_LINE" 1 "RIGHT_EGO_LINE" 2 "LEFT_LEFT_LINE" 3 "RIGHT_RIGHT_LINE" 4 "ROAD_EDGE_LEFT" 5 "ROAD_EDGE_RIGHT" 6 "RAISED_LEFT" 7 "RAISED_RIGHT" 8 "NOT_SELECTED_CANDIDATE" 9 "EGO_TRACK_LEFT" 10 "EGO_TRACK_RIGHT" 11 "Reserved11" 12 "Reserved12" 13 "Reserved13" 14 "Reserved14" 15 "Reserved15" ;
VAL_ 149 VFC_Poly09_Type 0 "TYPE_SOLID_LINE" 1 "TYPE_DASHED_LINE" 2 "TYPE_DOUBLE_DASHED_DASHED" 3 "TYPE_DOUBLE_DASHED_SOLID" 4 "TYPE_DOUBLE_SOLID_DASHED" 5 "TYPE_DOUBLE_SOLID_SOLID" 6 "TYPE_MULTIPLE" 7 "TYPE_MULTIPLE_WARNING" 8 "TYPE_BOTTS_DOTS" 9 "TYPE_ROAD_EDGE" 10 "TYPE_ROAD_FURNITURE" 11 "TYPE_CURBSTONE" 12 "TYPE_TRAFFIC_STATIC" 13 "TYPE_UNKNOWN_RAISED" 14 "TYPE_UNKNOWN" 15 "Reserved15" ;
VAL_ 149 VFC_Poly09_Colour 0 "COLOR_WHITE" 1 "COLOR_YELLOW" 2 "COLOR_RED" 3 "COLOR_BLUE" 4 "COLOR_GREEN" 5 "RESERVED5" 6 "RESERVED6" 7 "COLOR_UNKNOWN" ;
VAL_ 149 VFC_Poly10_LaneAssociation 0 "LEFT_EGO_LINE" 1 "RIGHT_EGO_LINE" 2 "LEFT_LEFT_LINE" 3 "RIGHT_RIGHT_LINE" 4 "ROAD_EDGE_LEFT" 5 "ROAD_EDGE_RIGHT" 6 "RAISED_LEFT" 7 "RAISED_RIGHT" 8 "NOT_SELECTED_CANDIDATE" 9 "EGO_TRACK_LEFT" 10 "EGO_TRACK_RIGHT" 11 "Reserved11" 12 "Reserved12" 13 "Reserved13" 14 "Reserved14" 15 "Reserved15" ;
VAL_ 149 VFC_Poly10_Type 0 "TYPE_SOLID_LINE" 1 "TYPE_DASHED_LINE" 2 "TYPE_DOUBLE_DASHED_DASHED" 3 "TYPE_DOUBLE_DASHED_SOLID" 4 "TYPE_DOUBLE_SOLID_DASHED" 5 "TYPE_DOUBLE_SOLID_SOLID" 6 "TYPE_MULTIPLE" 7 "TYPE_MULTIPLE_WARNING" 8 "TYPE_BOTTS_DOTS" 9 "TYPE_ROAD_EDGE" 10 "TYPE_ROAD_FURNITURE" 11 "TYPE_CURBSTONE" 12 "TYPE_TRAFFIC_STATIC" 13 "TYPE_UNKNOWN_RAISED" 14 "TYPE_UNKNOWN" 15 "Reserved15" ;
VAL_ 149 VFC_Poly10_Colour 0 "COLOR_WHITE" 1 "COLOR_YELLOW" 2 "COLOR_RED" 3 "COLOR_BLUE" 4 "COLOR_GREEN" 5 "RESERVED5" 6 "RESERVED6" 7 "COLOR_UNKNOWN" ;
VAL_ 149 VFC_Poly11_LaneAssociation 0 "LEFT_EGO_LINE" 1 "RIGHT_EGO_LINE" 2 "LEFT_LEFT_LINE" 3 "RIGHT_RIGHT_LINE" 4 "ROAD_EDGE_LEFT" 5 "ROAD_EDGE_RIGHT" 6 "RAISED_LEFT" 7 "RAISED_RIGHT" 8 "NOT_SELECTED_CANDIDATE" 9 "EGO_TRACK_LEFT" 10 "EGO_TRACK_RIGHT" 11 "Reserved11" 12 "Reserved12" 13 "Reserved13" 14 "Reserved14" 15 "Reserved15" ;
VAL_ 149 VFC_Poly11_Type 0 "TYPE_SOLID_LINE" 1 "TYPE_DASHED_LINE" 2 "TYPE_DOUBLE_DASHED_DASHED" 3 "TYPE_DOUBLE_DASHED_SOLID" 4 "TYPE_DOUBLE_SOLID_DASHED" 5 "TYPE_DOUBLE_SOLID_SOLID" 6 "TYPE_MULTIPLE" 7 "TYPE_MULTIPLE_WARNING" 8 "TYPE_BOTTS_DOTS" 9 "TYPE_ROAD_EDGE" 10 "TYPE_ROAD_FURNITURE" 11 "TYPE_CURBSTONE" 12 "TYPE_TRAFFIC_STATIC" 13 "TYPE_UNKNOWN_RAISED" 14 "TYPE_UNKNOWN" 15 "Reserved15" ;
VAL_ 149 VFC_Poly11_Colour 0 "COLOR_WHITE" 1 "COLOR_YELLOW" 2 "COLOR_RED" 3 "COLOR_BLUE" 4 "COLOR_GREEN" 5 "RESERVED5" 6 "RESERVED6" 7 "COLOR_UNKNOWN" ;
VAL_ 162 VFC_2DPoly00_LaneAssociation 0 "LEFT_EGO_LINE" 1 "RIGHT_EGO_LINE" 2 "LEFT_LEFT_LINE" 3 "RIGHT_RIGHT_LINE" 4 "ROAD_EDGE_LEFT" 5 "ROAD_EDGE_RIGHT" 6 "RAISED_LEFT" 7 "RAISED_RIGHT" 8 "NOT_SELECTED_CANDIDATE" 9 "EGO_TRACK_LEFT" 10 "EGO_TRACK_RIGHT" 11 "Reserved11" 12 "Reserved12" 13 "Reserved13" 14 "Reserved14" 15 "Reserved15" ;
VAL_ 162 VFC_2DPoly00_Type 0 "TYPE_SOLID_LINE" 1 "TYPE_DASHED_LINE" 2 "TYPE_DOUBLE_DASHED_DASHED" 3 "TYPE_DOUBLE_DASHED_SOLID" 4 "TYPE_DOUBLE_SOLID_DASHED" 5 "TYPE_DOUBLE_SOLID_SOLID" 6 "TYPE_MULTIPLE" 7 "TYPE_MULTIPLE_WARNING" 8 "TYPE_BOTTS_DOTS" 9 "TYPE_ROAD_EDGE" 10 "TYPE_ROAD_FURNITURE" 11 "TYPE_CURBSTONE" 12 "TYPE_TRAFFIC_STATIC" 13 "TYPE_UNKNOWN_RAISED" 14 "TYPE_UNKNOWN" 15 "Reserved15" ;
VAL_ 162 VFC_2DPoly01_LaneAssociation 0 "LEFT_EGO_LINE" 1 "RIGHT_EGO_LINE" 2 "LEFT_LEFT_LINE" 3 "RIGHT_RIGHT_LINE" 4 "ROAD_EDGE_LEFT" 5 "ROAD_EDGE_RIGHT" 6 "RAISED_LEFT" 7 "RAISED_RIGHT" 8 "NOT_SELECTED_CANDIDATE" 9 "EGO_TRACK_LEFT" 10 "EGO_TRACK_RIGHT" 11 "Reserved11" 12 "Reserved12" 13 "Reserved13" 14 "Reserved14" 15 "Reserved15" ;
VAL_ 162 VFC_2DPoly01_Type 0 "TYPE_SOLID_LINE" 1 "TYPE_DASHED_LINE" 2 "TYPE_DOUBLE_DASHED_DASHED" 3 "TYPE_DOUBLE_DASHED_SOLID" 4 "TYPE_DOUBLE_SOLID_DASHED" 5 "TYPE_DOUBLE_SOLID_SOLID" 6 "TYPE_MULTIPLE" 7 "TYPE_MULTIPLE_WARNING" 8 "TYPE_BOTTS_DOTS" 9 "TYPE_ROAD_EDGE" 10 "TYPE_ROAD_FURNITURE" 11 "TYPE_CURBSTONE" 12 "TYPE_TRAFFIC_STATIC" 13 "TYPE_UNKNOWN_RAISED" 14 "TYPE_UNKNOWN" 15 "Reserved15" ;
VAL_ 162 VFC_2DPoly02_LaneAssociation 0 "LEFT_EGO_LINE" 1 "RIGHT_EGO_LINE" 2 "LEFT_LEFT_LINE" 3 "RIGHT_RIGHT_LINE" 4 "ROAD_EDGE_LEFT" 5 "ROAD_EDGE_RIGHT" 6 "RAISED_LEFT" 7 "RAISED_RIGHT" 8 "NOT_SELECTED_CANDIDATE" 9 "EGO_TRACK_LEFT" 10 "EGO_TRACK_RIGHT" 11 "Reserved11" 12 "Reserved12" 13 "Reserved13" 14 "Reserved14" 15 "Reserved15" ;
VAL_ 162 VFC_2DPoly02_Type 0 "TYPE_SOLID_LINE" 1 "TYPE_DASHED_LINE" 2 "TYPE_DOUBLE_DASHED_DASHED" 3 "TYPE_DOUBLE_DASHED_SOLID" 4 "TYPE_DOUBLE_SOLID_DASHED" 5 "TYPE_DOUBLE_SOLID_SOLID" 6 "TYPE_MULTIPLE" 7 "TYPE_MULTIPLE_WARNING" 8 "TYPE_BOTTS_DOTS" 9 "TYPE_ROAD_EDGE" 10 "TYPE_ROAD_FURNITURE" 11 "TYPE_CURBSTONE" 12 "TYPE_TRAFFIC_STATIC" 13 "TYPE_UNKNOWN_RAISED" 14 "TYPE_UNKNOWN" 15 "Reserved15" ;
VAL_ 163 VFC_2DPoly03_LaneAssociation 0 "LEFT_EGO_LINE" 1 "RIGHT_EGO_LINE" 2 "LEFT_LEFT_LINE" 3 "RIGHT_RIGHT_LINE" 4 "ROAD_EDGE_LEFT" 5 "ROAD_EDGE_RIGHT" 6 "RAISED_LEFT" 7 "RAISED_RIGHT" 8 "NOT_SELECTED_CANDIDATE" 9 "EGO_TRACK_LEFT" 10 "EGO_TRACK_RIGHT" 11 "Reserved11" 12 "Reserved12" 13 "Reserved13" 14 "Reserved14" 15 "Reserved15" ;
VAL_ 163 VFC_2DPoly03_Type 0 "TYPE_SOLID_LINE" 1 "TYPE_DASHED_LINE" 2 "TYPE_DOUBLE_DASHED_DASHED" 3 "TYPE_DOUBLE_DASHED_SOLID" 4 "TYPE_DOUBLE_SOLID_DASHED" 5 "TYPE_DOUBLE_SOLID_SOLID" 6 "TYPE_MULTIPLE" 7 "TYPE_MULTIPLE_WARNING" 8 "TYPE_BOTTS_DOTS" 9 "TYPE_ROAD_EDGE" 10 "TYPE_ROAD_FURNITURE" 11 "TYPE_CURBSTONE" 12 "TYPE_TRAFFIC_STATIC" 13 "TYPE_UNKNOWN_RAISED" 14 "TYPE_UNKNOWN" 15 "Reserved15" ;
VAL_ 163 VFC_2DPoly04_LaneAssociation 0 "LEFT_EGO_LINE" 1 "RIGHT_EGO_LINE" 2 "LEFT_LEFT_LINE" 3 "RIGHT_RIGHT_LINE" 4 "ROAD_EDGE_LEFT" 5 "ROAD_EDGE_RIGHT" 6 "RAISED_LEFT" 7 "RAISED_RIGHT" 8 "NOT_SELECTED_CANDIDATE" 9 "EGO_TRACK_LEFT" 10 "EGO_TRACK_RIGHT" 11 "Reserved11" 12 "Reserved12" 13 "Reserved13" 14 "Reserved14" 15 "Reserved15" ;
VAL_ 163 VFC_2DPoly04_Type 0 "TYPE_SOLID_LINE" 1 "TYPE_DASHED_LINE" 2 "TYPE_DOUBLE_DASHED_DASHED" 3 "TYPE_DOUBLE_DASHED_SOLID" 4 "TYPE_DOUBLE_SOLID_DASHED" 5 "TYPE_DOUBLE_SOLID_SOLID" 6 "TYPE_MULTIPLE" 7 "TYPE_MULTIPLE_WARNING" 8 "TYPE_BOTTS_DOTS" 9 "TYPE_ROAD_EDGE" 10 "TYPE_ROAD_FURNITURE" 11 "TYPE_CURBSTONE" 12 "TYPE_TRAFFIC_STATIC" 13 "TYPE_UNKNOWN_RAISED" 14 "TYPE_UNKNOWN" 15 "Reserved15" ;
VAL_ 163 VFC_2DPoly05_LaneAssociation 0 "LEFT_EGO_LINE" 1 "RIGHT_EGO_LINE" 2 "LEFT_LEFT_LINE" 3 "RIGHT_RIGHT_LINE" 4 "ROAD_EDGE_LEFT" 5 "ROAD_EDGE_RIGHT" 6 "RAISED_LEFT" 7 "RAISED_RIGHT" 8 "NOT_SELECTED_CANDIDATE" 9 "EGO_TRACK_LEFT" 10 "EGO_TRACK_RIGHT" 11 "Reserved11" 12 "Reserved12" 13 "Reserved13" 14 "Reserved14" 15 "Reserved15" ;
VAL_ 163 VFC_2DPoly05_Type 0 "TYPE_SOLID_LINE" 1 "TYPE_DASHED_LINE" 2 "TYPE_DOUBLE_DASHED_DASHED" 3 "TYPE_DOUBLE_DASHED_SOLID" 4 "TYPE_DOUBLE_SOLID_DASHED" 5 "TYPE_DOUBLE_SOLID_SOLID" 6 "TYPE_MULTIPLE" 7 "TYPE_MULTIPLE_WARNING" 8 "TYPE_BOTTS_DOTS" 9 "TYPE_ROAD_EDGE" 10 "TYPE_ROAD_FURNITURE" 11 "TYPE_CURBSTONE" 12 "TYPE_TRAFFIC_STATIC" 13 "TYPE_UNKNOWN_RAISED" 14 "TYPE_UNKNOWN" 15 "Reserved15" ;
VAL_ 164 VFC_2DPoly06_LaneAssociation 0 "LEFT_EGO_LINE" 1 "RIGHT_EGO_LINE" 2 "LEFT_LEFT_LINE" 3 "RIGHT_RIGHT_LINE" 4 "ROAD_EDGE_LEFT" 5 "ROAD_EDGE_RIGHT" 6 "RAISED_LEFT" 7 "RAISED_RIGHT" 8 "NOT_SELECTED_CANDIDATE" 9 "EGO_TRACK_LEFT" 10 "EGO_TRACK_RIGHT" 11 "Reserved11" 12 "Reserved12" 13 "Reserved13" 14 "Reserved14" 15 "Reserved15" ;
VAL_ 164 VFC_2DPoly06_Type 0 "TYPE_SOLID_LINE" 1 "TYPE_DASHED_LINE" 2 "TYPE_DOUBLE_DASHED_DASHED" 3 "TYPE_DOUBLE_DASHED_SOLID" 4 "TYPE_DOUBLE_SOLID_DASHED" 5 "TYPE_DOUBLE_SOLID_SOLID" 6 "TYPE_MULTIPLE" 7 "TYPE_MULTIPLE_WARNING" 8 "TYPE_BOTTS_DOTS" 9 "TYPE_ROAD_EDGE" 10 "TYPE_ROAD_FURNITURE" 11 "TYPE_CURBSTONE" 12 "TYPE_TRAFFIC_STATIC" 13 "TYPE_UNKNOWN_RAISED" 14 "TYPE_UNKNOWN" 15 "Reserved15" ;
VAL_ 164 VFC_2DPoly07_LaneAssociation 0 "LEFT_EGO_LINE" 1 "RIGHT_EGO_LINE" 2 "LEFT_LEFT_LINE" 3 "RIGHT_RIGHT_LINE" 4 "ROAD_EDGE_LEFT" 5 "ROAD_EDGE_RIGHT" 6 "RAISED_LEFT" 7 "RAISED_RIGHT" 8 "NOT_SELECTED_CANDIDATE" 9 "EGO_TRACK_LEFT" 10 "EGO_TRACK_RIGHT" 11 "Reserved11" 12 "Reserved12" 13 "Reserved13" 14 "Reserved14" 15 "Reserved15" ;
VAL_ 164 VFC_2DPoly07_Type 0 "TYPE_SOLID_LINE" 1 "TYPE_DASHED_LINE" 2 "TYPE_DOUBLE_DASHED_DASHED" 3 "TYPE_DOUBLE_DASHED_SOLID" 4 "TYPE_DOUBLE_SOLID_DASHED" 5 "TYPE_DOUBLE_SOLID_SOLID" 6 "TYPE_MULTIPLE" 7 "TYPE_MULTIPLE_WARNING" 8 "TYPE_BOTTS_DOTS" 9 "TYPE_ROAD_EDGE" 10 "TYPE_ROAD_FURNITURE" 11 "TYPE_CURBSTONE" 12 "TYPE_TRAFFIC_STATIC" 13 "TYPE_UNKNOWN_RAISED" 14 "TYPE_UNKNOWN" 15 "Reserved15" ;
VAL_ 164 VFC_2DPoly08_LaneAssociation 0 "LEFT_EGO_LINE" 1 "RIGHT_EGO_LINE" 2 "LEFT_LEFT_LINE" 3 "RIGHT_RIGHT_LINE" 4 "ROAD_EDGE_LEFT" 5 "ROAD_EDGE_RIGHT" 6 "RAISED_LEFT" 7 "RAISED_RIGHT" 8 "NOT_SELECTED_CANDIDATE" 9 "EGO_TRACK_LEFT" 10 "EGO_TRACK_RIGHT" 11 "Reserved11" 12 "Reserved12" 13 "Reserved13" 14 "Reserved14" 15 "Reserved15" ;
VAL_ 164 VFC_2DPoly08_Type 0 "TYPE_SOLID_LINE" 1 "TYPE_DASHED_LINE" 2 "TYPE_DOUBLE_DASHED_DASHED" 3 "TYPE_DOUBLE_DASHED_SOLID" 4 "TYPE_DOUBLE_SOLID_DASHED" 5 "TYPE_DOUBLE_SOLID_SOLID" 6 "TYPE_MULTIPLE" 7 "TYPE_MULTIPLE_WARNING" 8 "TYPE_BOTTS_DOTS" 9 "TYPE_ROAD_EDGE" 10 "TYPE_ROAD_FURNITURE" 11 "TYPE_CURBSTONE" 12 "TYPE_TRAFFIC_STATIC" 13 "TYPE_UNKNOWN_RAISED" 14 "TYPE_UNKNOWN" 15 "Reserved15" ;
VAL_ 165 VFC_2DPoly09_LaneAssociation 0 "LEFT_EGO_LINE" 1 "RIGHT_EGO_LINE" 2 "LEFT_LEFT_LINE" 3 "RIGHT_RIGHT_LINE" 4 "ROAD_EDGE_LEFT" 5 "ROAD_EDGE_RIGHT" 6 "RAISED_LEFT" 7 "RAISED_RIGHT" 8 "NOT_SELECTED_CANDIDATE" 9 "EGO_TRACK_LEFT" 10 "EGO_TRACK_RIGHT" 11 "Reserved11" 12 "Reserved12" 13 "Reserved13" 14 "Reserved14" 15 "Reserved15" ;
VAL_ 165 VFC_2DPoly09_Type 0 "TYPE_SOLID_LINE" 1 "TYPE_DASHED_LINE" 2 "TYPE_DOUBLE_DASHED_DASHED" 3 "TYPE_DOUBLE_DASHED_SOLID" 4 "TYPE_DOUBLE_SOLID_DASHED" 5 "TYPE_DOUBLE_SOLID_SOLID" 6 "TYPE_MULTIPLE" 7 "TYPE_MULTIPLE_WARNING" 8 "TYPE_BOTTS_DOTS" 9 "TYPE_ROAD_EDGE" 10 "TYPE_ROAD_FURNITURE" 11 "TYPE_CURBSTONE" 12 "TYPE_TRAFFIC_STATIC" 13 "TYPE_UNKNOWN_RAISED" 14 "TYPE_UNKNOWN" 15 "Reserved15" ;
VAL_ 165 VFC_2DPoly10_LaneAssociation 0 "LEFT_EGO_LINE" 1 "RIGHT_EGO_LINE" 2 "LEFT_LEFT_LINE" 3 "RIGHT_RIGHT_LINE" 4 "ROAD_EDGE_LEFT" 5 "ROAD_EDGE_RIGHT" 6 "RAISED_LEFT" 7 "RAISED_RIGHT" 8 "NOT_SELECTED_CANDIDATE" 9 "EGO_TRACK_LEFT" 10 "EGO_TRACK_RIGHT" 11 "Reserved11" 12 "Reserved12" 13 "Reserved13" 14 "Reserved14" 15 "Reserved15" ;
VAL_ 165 VFC_2DPoly10_Type 0 "TYPE_SOLID_LINE" 1 "TYPE_DASHED_LINE" 2 "TYPE_DOUBLE_DASHED_DASHED" 3 "TYPE_DOUBLE_DASHED_SOLID" 4 "TYPE_DOUBLE_SOLID_DASHED" 5 "TYPE_DOUBLE_SOLID_SOLID" 6 "TYPE_MULTIPLE" 7 "TYPE_MULTIPLE_WARNING" 8 "TYPE_BOTTS_DOTS" 9 "TYPE_ROAD_EDGE" 10 "TYPE_ROAD_FURNITURE" 11 "TYPE_CURBSTONE" 12 "TYPE_TRAFFIC_STATIC" 13 "TYPE_UNKNOWN_RAISED" 14 "TYPE_UNKNOWN" 15 "Reserved15" ;
VAL_ 165 VFC_2DPoly11_LaneAssociation 0 "LEFT_EGO_LINE" 1 "RIGHT_EGO_LINE" 2 "LEFT_LEFT_LINE" 3 "RIGHT_RIGHT_LINE" 4 "ROAD_EDGE_LEFT" 5 "ROAD_EDGE_RIGHT" 6 "RAISED_LEFT" 7 "RAISED_RIGHT" 8 "NOT_SELECTED_CANDIDATE" 9 "EGO_TRACK_LEFT" 10 "EGO_TRACK_RIGHT" 11 "Reserved11" 12 "Reserved12" 13 "Reserved13" 14 "Reserved14" 15 "Reserved15" ;
VAL_ 165 VFC_2DPoly11_Type 0 "TYPE_SOLID_LINE" 1 "TYPE_DASHED_LINE" 2 "TYPE_DOUBLE_DASHED_DASHED" 3 "TYPE_DOUBLE_DASHED_SOLID" 4 "TYPE_DOUBLE_SOLID_DASHED" 5 "TYPE_DOUBLE_SOLID_SOLID" 6 "TYPE_MULTIPLE" 7 "TYPE_MULTIPLE_WARNING" 8 "TYPE_BOTTS_DOTS" 9 "TYPE_ROAD_EDGE" 10 "TYPE_ROAD_FURNITURE" 11 "TYPE_CURBSTONE" 12 "TYPE_TRAFFIC_STATIC" 13 "TYPE_UNKNOWN_RAISED" 14 "TYPE_UNKNOWN" 15 "Reserved15" ;
VAL_ 178 VFC_RM00_Type 0 "Stop_Line" 1 "Zebra_Crossing_Start" 2 "Zebra_Crossing_End" 3 "Arrow_Forward" 4 "Arrow_Left" 5 "Arrow_Right" 6 "Arrow_Straight_Left" 7 "Arrow_Straight_Right" 8 "Arrow_Turning_Point_Left" 9 "Arrow_Turning_Point_Right" 10 "Arrow_45_Deg_Left" 11 "Arrow_45_Deg_Right" 12 "Virtual_Stop_Area_Begin" 13 "Virtual_Stop_Area_End" 14 "Virtual_Braking_Area_Begin" 15 "Virtual_Braking_Area_End" 16 "Reserved16" 17 "Reserved17" 18 "Reserved18" 19 "Reserved19" 20 "Reserved20" 21 "Reserved21" 22 "Reserved22" 23 "Reserved23" 24 "Reserved24" 25 "Reserved25" 26 "Reserved26" 27 "Reserved27" 28 "Reserved28" 29 "Reserved29" 30 "Reserved30" 31 "Reserved31" ;
VAL_ 178 VFC_RM01_Type 0 "Stop_Line" 1 "Zebra_Crossing_Start" 2 "Zebra_Crossing_End" 3 "Arrow_Forward" 4 "Arrow_Left" 5 "Arrow_Right" 6 "Arrow_Straight_Left" 7 "Arrow_Straight_Right" 8 "Arrow_Turning_Point_Left" 9 "Arrow_Turning_Point_Right" 10 "Arrow_45_Deg_Left" 11 "Arrow_45_Deg_Right" 12 "Virtual_Stop_Area_Begin" 13 "Virtual_Stop_Area_End" 14 "Virtual_Braking_Area_Begin" 15 "Virtual_Braking_Area_End" 16 "Reserved16" 17 "Reserved17" 18 "Reserved18" 19 "Reserved19" 20 "Reserved20" 21 "Reserved21" 22 "Reserved22" 23 "Reserved23" 24 "Reserved24" 25 "Reserved25" 26 "Reserved26" 27 "Reserved27" 28 "Reserved28" 29 "Reserved29" 30 "Reserved30" 31 "Reserved31" ;
VAL_ 178 VFC_RM02_Type 0 "Stop_Line" 1 "Zebra_Crossing_Start" 2 "Zebra_Crossing_End" 3 "Arrow_Forward" 4 "Arrow_Left" 5 "Arrow_Right" 6 "Arrow_Straight_Left" 7 "Arrow_Straight_Right" 8 "Arrow_Turning_Point_Left" 9 "Arrow_Turning_Point_Right" 10 "Arrow_45_Deg_Left" 11 "Arrow_45_Deg_Right" 12 "Virtual_Stop_Area_Begin" 13 "Virtual_Stop_Area_End" 14 "Virtual_Braking_Area_Begin" 15 "Virtual_Braking_Area_End" 16 "Reserved16" 17 "Reserved17" 18 "Reserved18" 19 "Reserved19" 20 "Reserved20" 21 "Reserved21" 22 "Reserved22" 23 "Reserved23" 24 "Reserved24" 25 "Reserved25" 26 "Reserved26" 27 "Reserved27" 28 "Reserved28" 29 "Reserved29" 30 "Reserved30" 31 "Reserved31" ;
VAL_ 178 VFC_RM03_Type 0 "Stop_Line" 1 "Zebra_Crossing_Start" 2 "Zebra_Crossing_End" 3 "Arrow_Forward" 4 "Arrow_Left" 5 "Arrow_Right" 6 "Arrow_Straight_Left" 7 "Arrow_Straight_Right" 8 "Arrow_Turning_Point_Left" 9 "Arrow_Turning_Point_Right" 10 "Arrow_45_Deg_Left" 11 "Arrow_45_Deg_Right" 12 "Virtual_Stop_Area_Begin" 13 "Virtual_Stop_Area_End" 14 "Virtual_Braking_Area_Begin" 15 "Virtual_Braking_Area_End" 16 "Reserved16" 17 "Reserved17" 18 "Reserved18" 19 "Reserved19" 20 "Reserved20" 21 "Reserved21" 22 "Reserved22" 23 "Reserved23" 24 "Reserved24" 25 "Reserved25" 26 "Reserved26" 27 "Reserved27" 28 "Reserved28" 29 "Reserved29" 30 "Reserved30" 31 "Reserved31" ;
VAL_ 178 VFC_RM04_Type 0 "Stop_Line" 1 "Zebra_Crossing_Start" 2 "Zebra_Crossing_End" 3 "Arrow_Forward" 4 "Arrow_Left" 5 "Arrow_Right" 6 "Arrow_Straight_Left" 7 "Arrow_Straight_Right" 8 "Arrow_Turning_Point_Left" 9 "Arrow_Turning_Point_Right" 10 "Arrow_45_Deg_Left" 11 "Arrow_45_Deg_Right" 12 "Virtual_Stop_Area_Begin" 13 "Virtual_Stop_Area_End" 14 "Virtual_Braking_Area_Begin" 15 "Virtual_Braking_Area_End" 16 "Reserved16" 17 "Reserved17" 18 "Reserved18" 19 "Reserved19" 20 "Reserved20" 21 "Reserved21" 22 "Reserved22" 23 "Reserved23" 24 "Reserved24" 25 "Reserved25" 26 "Reserved26" 27 "Reserved27" 28 "Reserved28" 29 "Reserved29" 30 "Reserved30" 31 "Reserved31" ;
VAL_ 178 VFC_RM05_Type 0 "Stop_Line" 1 "Zebra_Crossing_Start" 2 "Zebra_Crossing_End" 3 "Arrow_Forward" 4 "Arrow_Left" 5 "Arrow_Right" 6 "Arrow_Straight_Left" 7 "Arrow_Straight_Right" 8 "Arrow_Turning_Point_Left" 9 "Arrow_Turning_Point_Right" 10 "Arrow_45_Deg_Left" 11 "Arrow_45_Deg_Right" 12 "Virtual_Stop_Area_Begin" 13 "Virtual_Stop_Area_End" 14 "Virtual_Braking_Area_Begin" 15 "Virtual_Braking_Area_End" 16 "Reserved16" 17 "Reserved17" 18 "Reserved18" 19 "Reserved19" 20 "Reserved20" 21 "Reserved21" 22 "Reserved22" 23 "Reserved23" 24 "Reserved24" 25 "Reserved25" 26 "Reserved26" 27 "Reserved27" 28 "Reserved28" 29 "Reserved29" 30 "Reserved30" 31 "Reserved31" ;
VAL_ 178 VFC_RM06_Type 0 "Stop_Line" 1 "Zebra_Crossing_Start" 2 "Zebra_Crossing_End" 3 "Arrow_Forward" 4 "Arrow_Left" 5 "Arrow_Right" 6 "Arrow_Straight_Left" 7 "Arrow_Straight_Right" 8 "Arrow_Turning_Point_Left" 9 "Arrow_Turning_Point_Right" 10 "Arrow_45_Deg_Left" 11 "Arrow_45_Deg_Right" 12 "Virtual_Stop_Area_Begin" 13 "Virtual_Stop_Area_End" 14 "Virtual_Braking_Area_Begin" 15 "Virtual_Braking_Area_End" 16 "Reserved16" 17 "Reserved17" 18 "Reserved18" 19 "Reserved19" 20 "Reserved20" 21 "Reserved21" 22 "Reserved22" 23 "Reserved23" 24 "Reserved24" 25 "Reserved25" 26 "Reserved26" 27 "Reserved27" 28 "Reserved28" 29 "Reserved29" 30 "Reserved30" 31 "Reserved31" ;
VAL_ 224 VFC_TLHdr_State 0 "Off" 1 "On" 2 "Error" 3 "Reduced sight" 4 "Reserved4" 5 "Reserved5" 6 "Reserved6" 7 "Reserved7" ;
SIG_GROUP_ 131 SG_VFC_RoadClothoid_03_05 1 : VFC_Cloth_03_05_CRC VFC_Cloth_03_05_AliveCtr VFC_Cloth_03_05_ProtBlockCtr VFC_Cloth03_LaneAssociation VFC_Cloth03_Colour VFC_Cloth03_RangeXBegin VFC_Cloth03_RangeXEnd VFC_Cloth03_ExistProb VFC_Cloth03_CurvChange VFC_Cloth03_Curv VFC_Cloth03_PyStdDev VFC_Cloth03_Py VFC_Cloth03_OrientationYaw VFC_Cloth03_Width VFC_Cloth03_Type VFC_Cloth04_LaneAssociation VFC_Cloth04_Colour VFC_Cloth04_RangeXBegin VFC_Cloth04_RangeXEnd VFC_Cloth04_ExistProb VFC_Cloth04_CurvChange VFC_Cloth04_Curv VFC_Cloth04_PyStdDev VFC_Cloth04_Py VFC_Cloth04_OrientationYaw VFC_Cloth04_Width VFC_Cloth04_Type VFC_Cloth05_LaneAssociation VFC_Cloth05_Colour VFC_Cloth05_RangeXBegin VFC_Cloth05_RangeXEnd VFC_Cloth05_ExistProb VFC_Cloth05_CurvChange VFC_Cloth05_Curv VFC_Cloth05_PyStdDev VFC_Cloth05_Py VFC_Cloth05_OrientationYaw VFC_Cloth05_Width VFC_Cloth05_Type;
SIG_GROUP_ 132 SG_VFC_RoadClothoid_06_08 1 : VFC_Cloth_06_08_CRC VFC_Cloth_06_08_AliveCtr VFC_Cloth_06_08_ProtBlockCtr VFC_Cloth06_LaneAssociation VFC_Cloth06_Colour VFC_Cloth06_RangeXBegin VFC_Cloth06_RangeXEnd VFC_Cloth06_ExistProb VFC_Cloth06_CurvChange VFC_Cloth06_Curv VFC_Cloth06_PyStdDev VFC_Cloth06_Py VFC_Cloth06_OrientationYaw VFC_Cloth06_Width VFC_Cloth06_Type VFC_Cloth07_LaneAssociation VFC_Cloth07_Colour VFC_Cloth07_RangeXBegin VFC_Cloth07_RangeXEnd VFC_Cloth07_ExistProb VFC_Cloth07_CurvChange VFC_Cloth07_Curv VFC_Cloth07_PyStdDev VFC_Cloth07_Py VFC_Cloth07_OrientationYaw VFC_Cloth07_Width VFC_Cloth07_Type VFC_Cloth08_LaneAssociation VFC_Cloth08_Colour VFC_Cloth08_RangeXBegin VFC_Cloth08_RangeXEnd VFC_Cloth08_ExistProb VFC_Cloth08_CurvChange VFC_Cloth08_Curv VFC_Cloth08_PyStdDev VFC_Cloth08_Py VFC_Cloth08_OrientationYaw VFC_Cloth08_Width VFC_Cloth08_Type;
SIG_GROUP_ 133 SG_VFC_RoadClothoid_09_11 1 : VFC_Cloth_09_11_CRC VFC_Cloth_09_11_AliveCtr VFC_Cloth_09_11_ProtBlockCtr VFC_Cloth09_LaneAssociation VFC_Cloth09_Colour VFC_Cloth09_RangeXBegin VFC_Cloth09_RangeXEnd VFC_Cloth09_ExistProb VFC_Cloth09_CurvChange VFC_Cloth09_Curv VFC_Cloth09_PyStdDev VFC_Cloth09_Py VFC_Cloth09_OrientationYaw VFC_Cloth09_Width VFC_Cloth09_Type VFC_Cloth10_LaneAssociation VFC_Cloth10_Colour VFC_Cloth10_RangeXBegin VFC_Cloth10_RangeXEnd VFC_Cloth10_ExistProb VFC_Cloth10_CurvChange VFC_Cloth10_Curv VFC_Cloth10_PyStdDev VFC_Cloth10_Py VFC_Cloth10_OrientationYaw VFC_Cloth10_Width VFC_Cloth10_Type VFC_Cloth11_LaneAssociation VFC_Cloth11_Colour VFC_Cloth11_RangeXBegin VFC_Cloth11_RangeXEnd VFC_Cloth11_ExistProb VFC_Cloth11_CurvChange VFC_Cloth11_Curv VFC_Cloth11_PyStdDev VFC_Cloth11_Py VFC_Cloth11_OrientationYaw VFC_Cloth11_Width VFC_Cloth11_Type;
SIG_GROUP_ 146 SG_VFC_RoadPolynomial_00_02 1 : VFC_Poly_00_02_CRC VFC_Poly_00_02_AliveCtr VFC_Poly_00_02_ProtBlockCtr VFC_Poly00_LaneAssociation VFC_Poly00_Type VFC_Poly00_ExistProb VFC_Poly00_CoefficientYc3 VFC_Poly00_Colour VFC_Poly00_CoefficientYc2 VFC_Poly00_CoefficientYc0 VFC_Poly00_CoefficientYc1 VFC_Poly00_CoefficientYc2Corr VFC_Poly00_CoefficientYc3Corr VFC_Poly00_Width VFC_Poly00_RangeXCorrectionPoint VFC_Poly00_RangeXBegin VFC_Poly00_Reserved0 VFC_Poly00_RangeXEnd VFC_Poly00_Reserved1 VFC_Poly01_LaneAssociation VFC_Poly01_Type VFC_Poly01_ExistProb VFC_Poly01_CoefficientYc3 VFC_Poly01_Colour VFC_Poly01_CoefficientYc2 VFC_Poly01_CoefficientYc0 VFC_Poly01_CoefficientYc1 VFC_Poly01_CoefficientYc2Corr VFC_Poly01_CoefficientYc3Corr VFC_Poly01_Width VFC_Poly01_RangeXCorrectionPoint VFC_Poly01_RangeXBegin VFC_Poly01_Reserved0 VFC_Poly01_RangeXEnd VFC_Poly01_Reserved1 VFC_Poly02_LaneAssociation VFC_Poly02_Type VFC_Poly02_ExistProb VFC_Poly02_CoefficientYc3 VFC_Poly02_Colour VFC_Poly02_CoefficientYc2 VFC_Poly02_CoefficientYc0 VFC_Poly02_CoefficientYc1 VFC_Poly02_CoefficientYc2Corr VFC_Poly02_CoefficientYc3Corr VFC_Poly02_Width VFC_Poly02_RangeXCorrectionPoint VFC_Poly02_RangeXBegin VFC_Poly02_Reserved0 VFC_Poly02_RangeXEnd VFC_Poly02_Reserved1;
SIG_GROUP_ 147 SG_VFC_RoadPolynomial_03_05 1 : VFC_Poly_03_05_CRC VFC_Poly_03_05_AliveCtr VFC_Poly_03_05_ProtBlockCtr VFC_Poly03_LaneAssociation VFC_Poly03_Type VFC_Poly03_ExistProb VFC_Poly03_CoefficientYc3 VFC_Poly03_Colour VFC_Poly03_CoefficientYc2 VFC_Poly03_CoefficientYc0 VFC_Poly03_CoefficientYc1 VFC_Poly03_CoefficientYc2Corr VFC_Poly03_CoefficientYc3Corr VFC_Poly03_Width VFC_Poly03_RangeXCorrectionPoint VFC_Poly03_RangeXBegin VFC_Poly03_Reserved0 VFC_Poly03_RangeXEnd VFC_Poly03_Reserved1 VFC_Poly04_LaneAssociation VFC_Poly04_Type VFC_Poly04_ExistProb VFC_Poly04_CoefficientYc3 VFC_Poly04_Colour VFC_Poly04_CoefficientYc2 VFC_Poly04_CoefficientYc0 VFC_Poly04_CoefficientYc1 VFC_Poly04_CoefficientYc2Corr VFC_Poly04_CoefficientYc3Corr VFC_Poly04_Width VFC_Poly04_RangeXCorrectionPoint VFC_Poly04_RangeXBegin VFC_Poly04_Reserved0 VFC_Poly04_RangeXEnd VFC_Poly04_Reserved1 VFC_Poly05_LaneAssociation VFC_Poly05_Type VFC_Poly05_ExistProb VFC_Poly05_CoefficientYc3 VFC_Poly05_Colour VFC_Poly05_CoefficientYc2 VFC_Poly05_CoefficientYc0 VFC_Poly05_CoefficientYc1 VFC_Poly05_CoefficientYc2Corr VFC_Poly05_CoefficientYc3Corr VFC_Poly05_Width VFC_Poly05_RangeXCorrectionPoint VFC_Poly05_RangeXBegin VFC_Poly05_Reserved0 VFC_Poly05_RangeXEnd VFC_Poly05_Reserved1;
SIG_GROUP_ 148 SG_VFC_RoadPolynomial_06_08 1 : VFC_Poly_06_08_CRC VFC_Poly_06_08_AliveCtr VFC_Poly_06_08_ProtBlockCtr VFC_Poly06_LaneAssociation VFC_Poly06_Type VFC_Poly06_ExistProb VFC_Poly06_CoefficientYc3 VFC_Poly06_Colour VFC_Poly06_CoefficientYc2 VFC_Poly06_CoefficientYc0 VFC_Poly06_CoefficientYc1 VFC_Poly06_CoefficientYc2Corr VFC_Poly06_CoefficientYc3Corr VFC_Poly06_Width VFC_Poly06_RangeXCorrectionPoint VFC_Poly06_RangeXBegin VFC_Poly06_Reserved0 VFC_Poly06_RangeXEnd VFC_Poly06_Reserved1 VFC_Poly07_LaneAssociation VFC_Poly07_Type VFC_Poly07_ExistProb VFC_Poly07_CoefficientYc3 VFC_Poly07_Colour VFC_Poly07_CoefficientYc2 VFC_Poly07_CoefficientYc0 VFC_Poly07_CoefficientYc1 VFC_Poly07_CoefficientYc2Corr VFC_Poly07_CoefficientYc3Corr VFC_Poly07_Width VFC_Poly07_RangeXCorrectionPoint VFC_Poly07_RangeXBegin VFC_Poly07_Reserved0 VFC_Poly07_RangeXEnd VFC_Poly07_Reserved1 VFC_Poly08_LaneAssociation VFC_Poly08_Type VFC_Poly08_ExistProb VFC_Poly08_CoefficientYc3 VFC_Poly08_Colour VFC_Poly08_CoefficientYc2 VFC_Poly08_CoefficientYc0 VFC_Poly08_CoefficientYc1 VFC_Poly08_CoefficientYc2Corr VFC_Poly08_CoefficientYc3Corr VFC_Poly08_Width VFC_Poly08_RangeXCorrectionPoint VFC_Poly08_RangeXBegin VFC_Poly08_Reserved0 VFC_Poly08_RangeXEnd VFC_Poly08_Reserved1;
SIG_GROUP_ 149 SG_VFC_RoadPolynomial_09_11 1 : VFC_Poly_09_11_CRC VFC_Poly_09_11_AliveCtr VFC_Poly_09_11_ProtBlockCtr VFC_Poly09_LaneAssociation VFC_Poly09_Type VFC_Poly09_ExistProb VFC_Poly09_CoefficientYc3 VFC_Poly09_Colour VFC_Poly09_CoefficientYc2 VFC_Poly09_CoefficientYc0 VFC_Poly09_CoefficientYc1 VFC_Poly09_CoefficientYc2Corr VFC_Poly09_CoefficientYc3Corr VFC_Poly09_Width VFC_Poly09_RangeXCorrectionPoint VFC_Poly09_RangeXBegin VFC_Poly09_Reserved0 VFC_Poly09_RangeXEnd VFC_Poly09_Reserved1 VFC_Poly10_LaneAssociation VFC_Poly10_Type VFC_Poly10_ExistProb VFC_Poly10_CoefficientYc3 VFC_Poly10_Colour VFC_Poly10_CoefficientYc2 VFC_Poly10_CoefficientYc0 VFC_Poly10_CoefficientYc1 VFC_Poly10_CoefficientYc2Corr VFC_Poly10_CoefficientYc3Corr VFC_Poly10_Width VFC_Poly10_RangeXCorrectionPoint VFC_Poly10_RangeXBegin VFC_Poly10_Reserved0 VFC_Poly10_RangeXEnd VFC_Poly10_Reserved1 VFC_Poly11_LaneAssociation VFC_Poly11_Type VFC_Poly11_ExistProb VFC_Poly11_CoefficientYc3 VFC_Poly11_Colour VFC_Poly11_CoefficientYc2 VFC_Poly11_CoefficientYc0 VFC_Poly11_CoefficientYc1 VFC_Poly11_CoefficientYc2Corr VFC_Poly11_CoefficientYc3Corr VFC_Poly11_Width VFC_Poly11_RangeXCorrectionPoint VFC_Poly11_RangeXBegin VFC_Poly11_Reserved0 VFC_Poly11_RangeXEnd VFC_Poly11_Reserved1;
SIG_GROUP_ 162 SG_VFC_Road2DPolynomial_00_02 1 : VFC_2DPoly_00_02_CRC VFC_2DPoly_00_02_AliveCtr VFC_2DPoly_00_02_ProtBlockCtr VFC_2DPoly00_LaneAssociation VFC_2DPoly00_ExistProb VFC_2DPoly00_Type VFC_2DPoly00_CoefficientUc0 VFC_2DPoly00_CoefficientUc1 VFC_2DPoly00_CoefficientUc2 VFC_2DPoly00_CoefficientUc3 VFC_2DPoly00_CoefficientUc4 VFC_2DPoly00_CoefficientUc5 VFC_2DPoly00_RangeVBegin VFC_2DPoly00_RangeVEnd VFC_2DPoly01_LaneAssociation VFC_2DPoly01_ExistProb VFC_2DPoly01_Type VFC_2DPoly01_CoefficientUc0 VFC_2DPoly01_CoefficientUc1 VFC_2DPoly01_CoefficientUc2 VFC_2DPoly01_CoefficientUc3 VFC_2DPoly01_CoefficientUc4 VFC_2DPoly01_CoefficientUc5 VFC_2DPoly01_RangeVBegin VFC_2DPoly01_RangeVEnd VFC_2DPoly02_LaneAssociation VFC_2DPoly02_ExistProb VFC_2DPoly02_Type VFC_2DPoly02_CoefficientUc0 VFC_2DPoly02_CoefficientUc1 VFC_2DPoly02_CoefficientUc2 VFC_2DPoly02_CoefficientUc3 VFC_2DPoly02_CoefficientUc4 VFC_2DPoly02_CoefficientUc5 VFC_2DPoly02_RangeVBegin VFC_2DPoly02_RangeVEnd;
SIG_GROUP_ 163 SG_VFC_Road2DPolynomial_03_05 1 : VFC_2DPoly_03_05_CRC VFC_2DPoly_03_05_AliveCtr VFC_2DPoly_03_05_ProtBlockCtr VFC_2DPoly03_LaneAssociation VFC_2DPoly03_ExistProb VFC_2DPoly03_Type VFC_2DPoly03_CoefficientUc0 VFC_2DPoly03_CoefficientUc1 VFC_2DPoly03_CoefficientUc2 VFC_2DPoly03_CoefficientUc3 VFC_2DPoly03_CoefficientUc4 VFC_2DPoly03_CoefficientUc5 VFC_2DPoly03_RangeVBegin VFC_2DPoly03_RangeVEnd VFC_2DPoly04_LaneAssociation VFC_2DPoly04_ExistProb VFC_2DPoly04_Type VFC_2DPoly04_CoefficientUc0 VFC_2DPoly04_CoefficientUc1 VFC_2DPoly04_CoefficientUc2 VFC_2DPoly04_CoefficientUc3 VFC_2DPoly04_CoefficientUc4 VFC_2DPoly04_CoefficientUc5 VFC_2DPoly04_RangeVBegin VFC_2DPoly04_RangeVEnd VFC_2DPoly05_LaneAssociation VFC_2DPoly05_ExistProb VFC_2DPoly05_Type VFC_2DPoly05_CoefficientUc0 VFC_2DPoly05_CoefficientUc1 VFC_2DPoly05_CoefficientUc2 VFC_2DPoly05_CoefficientUc3 VFC_2DPoly05_CoefficientUc4 VFC_2DPoly05_CoefficientUc5 VFC_2DPoly05_RangeVBegin VFC_2DPoly05_RangeVEnd;
SIG_GROUP_ 164 SG_VFC_Road2DPolynomial_06_08 1 : VFC_2DPoly_06_08_CRC VFC_2DPoly_06_08_AliveCtr VFC_2DPoly_06_08_ProtBlockCtr VFC_2DPoly06_LaneAssociation VFC_2DPoly06_ExistProb VFC_2DPoly06_Type VFC_2DPoly06_CoefficientUc0 VFC_2DPoly06_CoefficientUc1 VFC_2DPoly06_CoefficientUc2 VFC_2DPoly06_CoefficientUc3 VFC_2DPoly06_CoefficientUc4 VFC_2DPoly06_CoefficientUc5 VFC_2DPoly06_RangeVBegin VFC_2DPoly06_RangeVEnd VFC_2DPoly07_LaneAssociation VFC_2DPoly07_ExistProb VFC_2DPoly07_Type VFC_2DPoly07_CoefficientUc0 VFC_2DPoly07_CoefficientUc1 VFC_2DPoly07_CoefficientUc2 VFC_2DPoly07_CoefficientUc3 VFC_2DPoly07_CoefficientUc4 VFC_2DPoly07_CoefficientUc5 VFC_2DPoly07_RangeVBegin VFC_2DPoly07_RangeVEnd VFC_2DPoly08_LaneAssociation VFC_2DPoly08_ExistProb VFC_2DPoly08_Type VFC_2DPoly08_CoefficientUc0 VFC_2DPoly08_CoefficientUc1 VFC_2DPoly08_CoefficientUc2 VFC_2DPoly08_CoefficientUc3 VFC_2DPoly08_CoefficientUc4 VFC_2DPoly08_CoefficientUc5 VFC_2DPoly08_RangeVBegin VFC_2DPoly08_RangeVEnd;
SIG_GROUP_ 165 SG_VFC_Road2DPolynomial_09_11 1 : VFC_2DPoly_09_11_CRC VFC_2DPoly_09_11_AliveCtr VFC_2DPoly_09_11_ProtBlockCtr VFC_2DPoly09_LaneAssociation VFC_2DPoly09_ExistProb VFC_2DPoly09_Type VFC_2DPoly09_CoefficientUc0 VFC_2DPoly09_CoefficientUc1 VFC_2DPoly09_CoefficientUc2 VFC_2DPoly09_CoefficientUc3 VFC_2DPoly09_CoefficientUc4 VFC_2DPoly09_CoefficientUc5 VFC_2DPoly09_RangeVBegin VFC_2DPoly09_RangeVEnd VFC_2DPoly10_LaneAssociation VFC_2DPoly10_ExistProb VFC_2DPoly10_Type VFC_2DPoly10_CoefficientUc0 VFC_2DPoly10_CoefficientUc1 VFC_2DPoly10_CoefficientUc2 VFC_2DPoly10_CoefficientUc3 VFC_2DPoly10_CoefficientUc4 VFC_2DPoly10_CoefficientUc5 VFC_2DPoly10_RangeVBegin VFC_2DPoly10_RangeVEnd VFC_2DPoly11_LaneAssociation VFC_2DPoly11_ExistProb VFC_2DPoly11_Type VFC_2DPoly11_CoefficientUc0 VFC_2DPoly11_CoefficientUc1 VFC_2DPoly11_CoefficientUc2 VFC_2DPoly11_CoefficientUc3 VFC_2DPoly11_CoefficientUc4 VFC_2DPoly11_CoefficientUc5 VFC_2DPoly11_RangeVBegin VFC_2DPoly11_RangeVEnd;
SIG_GROUP_ 178 SG_VFC_RoadMarking_00_06 1 : VFC_RM_00_06_CRC VFC_RM_00_06_AliveCtr VFC_RM_00_06_ProtBlockCtr VFC_RM00_ExistProb VFC_RM00_Type VFC_RM00_VertexPoint00x VFC_RM00_VertexPoint00y VFC_RM00_VertexPoint01x VFC_RM00_VertexPoint01y VFC_RM01_ExistProb VFC_RM01_Type VFC_RM01_VertexPoint00x VFC_RM01_VertexPoint00y VFC_RM01_VertexPoint01x VFC_RM01_VertexPoint01y VFC_RM02_ExistProb VFC_RM02_Type VFC_RM02_VertexPoint00x VFC_RM02_VertexPoint00y VFC_RM02_VertexPoint01x VFC_RM02_VertexPoint01y VFC_RM03_ExistProb VFC_RM03_Type VFC_RM03_VertexPoint00x VFC_RM03_VertexPoint00y VFC_RM03_VertexPoint01x VFC_RM03_VertexPoint01y VFC_RM04_ExistProb VFC_RM04_Type VFC_RM04_VertexPoint00x VFC_RM04_VertexPoint00y VFC_RM04_VertexPoint01x VFC_RM04_VertexPoint01y VFC_RM05_ExistProb VFC_RM05_Type VFC_RM05_VertexPoint00x VFC_RM05_VertexPoint00y VFC_RM05_VertexPoint01x VFC_RM05_VertexPoint01y VFC_RM06_ExistProb VFC_RM06_Type VFC_RM06_VertexPoint00x VFC_RM06_VertexPoint00y VFC_RM06_VertexPoint01x VFC_RM06_VertexPoint01y;
SIG_GROUP_ 224 SG_VFC_TrafficLightHdr 1 : VFC_TLHdr_CRC VFC_TLHdr_AliveCtr VFC_TLHdr_ProtBlockCtr VFC_TLHdr_IfVersionIdMajor VFC_TLHdr_IfVersionIdMinor VFC_TLHdr_NumTrafficLights VFC_TLHdr_TimeStampStatus VFC_TLHdr_TimeStamp VFC_TLHdr_State VFC_TLHdr_MostRelevantTLId VFC_TLHdr_Reserved0 VFC_TLHdr_Reserved1;
