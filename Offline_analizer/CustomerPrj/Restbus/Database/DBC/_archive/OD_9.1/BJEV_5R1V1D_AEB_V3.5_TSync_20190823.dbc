VERSION "created by canmatrix"

NS_ :

BS_:

BU_: RadarFrontCenter DASy MPC3

BO_ 460 RFC_Location_120_121: 64 RadarFrontCenter
 SG_ RFC_Loc120_CRC : 0|16@1+ (1,0) [0|65535] ""  DASy
 SG_ RFC_Loc120_AliveCtr : 16|8@1+ (1,0) [0|255] ""  DASy
 SG_ RFC_Loc120_ProtBlockCtr : 24|8@1+ (1,0) [0|255] ""  DASy
 SG_ RFC_Loc120_Dr : 32|16@1+ (0.0078125,0) [0|511.9921875] "m"  DASy
 SG_ RFC_Loc120_Vr : 48|16@1+ (0.00390625,-128) [-128|127.99609375] "m/s"  DASy
 SG_ RFC_Loc120_Theta : 64|16@1+ (0.01,-327.68) [-90|90] "deg"  DASy
 SG_ RFC_Loc120_Phi : 80|16@1+ (0.01,-327.68) [-30|30] "deg"  DASy
 SG_ RFC_Loc120_DrVnce : 96|16@1+ (1.52588E-005,0) [0|0.999984741210937] "m^2"  DASy
 SG_ RFC_Loc120_VrVnce : 112|16@1+ (1.52588E-005,0) [0|0.999984741210937] "m^2/s^2"  DASy
 SG_ RFC_Loc120_ThetaVnce : 128|16@1+ (0.00390625,0) [0|255.99609375] "deg^2"  DASy
 SG_ RFC_Loc120_PhiVnce : 144|16@1+ (0.00390625,0) [0|255.99609375] "deg^2"  DASy
 SG_ RFC_Loc120_DrVrCoVnce : 160|16@1+ (3.814697265625E-006,-0.125) [-0.125|0.124996185302734] "m^2/s"  DASy
 SG_ RFC_Loc120_RCS : 176|16@1+ (0.00390625,-128) [-128|127.99609375] "dBsm"  DASy
 SG_ RFC_Loc120_RSSI : 192|16@1+ (0.00195312,0) [0|127.998046875] "dimensionless"  DASy
 SG_ RFC_Loc120_DrVrQuality : 208|8@1+ (1,0) [0|255] "dimensionless"  DASy
 SG_ RFC_Loc120_ThetaQuality : 216|8@1+ (1,0) [0|255] "dimensionless"  DASy
 SG_ RFC_Loc120_PhiQuality : 224|8@1+ (1,0) [0|255] "dimensionless"  DASy
 SG_ RFC_Loc121_Dr : 256|16@1+ (0.0078125,0) [0|511.9921875] "m"  DASy
 SG_ RFC_Loc121_Vr : 272|16@1+ (0.00390625,-128) [-128|127.99609375] "m/s"  DASy
 SG_ RFC_Loc121_Theta : 288|16@1+ (0.01,-327.68) [-90|90] "deg"  DASy
 SG_ RFC_Loc121_Phi : 304|16@1+ (0.01,-327.68) [-30|30] "deg"  DASy
 SG_ RFC_Loc121_DrVnce : 320|16@1+ (1.52588E-005,0) [0|0.999984741210937] "m^2"  DASy
 SG_ RFC_Loc121_VrVnce : 336|16@1+ (1.52588E-005,0) [0|0.999984741210937] "m^2/s^2"  DASy
 SG_ RFC_Loc121_ThetaVnce : 352|16@1+ (0.00390625,0) [0|255.99609375] "deg^2"  DASy
 SG_ RFC_Loc121_PhiVnce : 368|16@1+ (0.00390625,0) [0|255.99609375] "deg^2"  DASy
 SG_ RFC_Loc121_DrVrCoVnce : 384|16@1+ (3.814697265625E-006,-0.125) [-0.125|0.124996185302734] "m^2/s"  DASy
 SG_ RFC_Loc121_RCS : 400|16@1+ (0.00390625,-128) [-128|127.99609375] "dBsm"  DASy
 SG_ RFC_Loc121_RSSI : 416|16@1+ (0.00195312,0) [0|127.998046875] "dimensionless"  DASy
 SG_ RFC_Loc121_DrVrQuality : 432|8@1+ (1,0) [0|255] "dimensionless"  DASy
 SG_ RFC_Loc121_ThetaQuality : 440|8@1+ (1,0) [0|255] "dimensionless"  DASy
 SG_ RFC_Loc121_PhiQuality : 448|8@1+ (1,0) [0|255] "dimensionless"  DASy

BO_ 461 RFC_Location_122_123: 64 RadarFrontCenter
 SG_ RFC_Loc122_CRC : 0|16@1+ (1,0) [0|65535] ""  DASy
 SG_ RFC_Loc122_AliveCtr : 16|8@1+ (1,0) [0|255] ""  DASy
 SG_ RFC_Loc122_ProtBlockCtr : 24|8@1+ (1,0) [0|255] ""  DASy
 SG_ RFC_Loc122_Dr : 32|16@1+ (0.0078125,0) [0|511.9921875] "m"  DASy
 SG_ RFC_Loc122_Vr : 48|16@1+ (0.00390625,-128) [-128|127.99609375] "m/s"  DASy
 SG_ RFC_Loc122_Theta : 64|16@1+ (0.01,-327.68) [-90|90] "deg"  DASy
 SG_ RFC_Loc122_Phi : 80|16@1+ (0.01,-327.68) [-30|30] "deg"  DASy
 SG_ RFC_Loc122_DrVnce : 96|16@1+ (1.52588E-005,0) [0|0.999984741210937] "m^2"  DASy
 SG_ RFC_Loc122_VrVnce : 112|16@1+ (1.52588E-005,0) [0|0.999984741210937] "m^2/s^2"  DASy
 SG_ RFC_Loc122_ThetaVnce : 128|16@1+ (0.00390625,0) [0|255.99609375] "deg^2"  DASy
 SG_ RFC_Loc122_PhiVnce : 144|16@1+ (0.00390625,0) [0|255.99609375] "deg^2"  DASy
 SG_ RFC_Loc122_DrVrCoVnce : 160|16@1+ (3.814697265625E-006,-0.125) [-0.125|0.124996185302734] "m^2/s"  DASy
 SG_ RFC_Loc122_RCS : 176|16@1+ (0.00390625,-128) [-128|127.99609375] "dBsm"  DASy
 SG_ RFC_Loc122_RSSI : 192|16@1+ (0.00195312,0) [0|127.998046875] "dimensionless"  DASy
 SG_ RFC_Loc122_DrVrQuality : 208|8@1+ (1,0) [0|255] "dimensionless"  DASy
 SG_ RFC_Loc122_ThetaQuality : 216|8@1+ (1,0) [0|255] "dimensionless"  DASy
 SG_ RFC_Loc122_PhiQuality : 224|8@1+ (1,0) [0|255] "dimensionless"  DASy
 SG_ RFC_Loc123_Dr : 256|16@1+ (0.0078125,0) [0|511.9921875] "m"  DASy
 SG_ RFC_Loc123_Vr : 272|16@1+ (0.00390625,-128) [-128|127.99609375] "m/s"  DASy
 SG_ RFC_Loc123_Theta : 288|16@1+ (0.01,-327.68) [-90|90] "deg"  DASy
 SG_ RFC_Loc123_Phi : 304|16@1+ (0.01,-327.68) [-30|30] "deg"  DASy
 SG_ RFC_Loc123_DrVnce : 320|16@1+ (1.52588E-005,0) [0|0.999984741210937] "m^2"  DASy
 SG_ RFC_Loc123_VrVnce : 336|16@1+ (1.52588E-005,0) [0|0.999984741210937] "m^2/s^2"  DASy
 SG_ RFC_Loc123_ThetaVnce : 352|16@1+ (0.00390625,0) [0|255.99609375] "deg^2"  DASy
 SG_ RFC_Loc123_PhiVnce : 368|16@1+ (0.00390625,0) [0|255.99609375] "deg^2"  DASy
 SG_ RFC_Loc123_DrVrCoVnce : 384|16@1+ (3.814697265625E-006,-0.125) [-0.125|0.124996185302734] "m^2/s"  DASy
 SG_ RFC_Loc123_RCS : 400|16@1+ (0.00390625,-128) [-128|127.99609375] "dBsm"  DASy
 SG_ RFC_Loc123_RSSI : 416|16@1+ (0.00195312,0) [0|127.998046875] "dimensionless"  DASy
 SG_ RFC_Loc123_DrVrQuality : 432|8@1+ (1,0) [0|255] "dimensionless"  DASy
 SG_ RFC_Loc123_ThetaQuality : 440|8@1+ (1,0) [0|255] "dimensionless"  DASy
 SG_ RFC_Loc123_PhiQuality : 448|8@1+ (1,0) [0|255] "dimensionless"  DASy

BO_ 462 RFC_Location_124_125: 64 RadarFrontCenter
 SG_ RFC_Loc124_CRC : 0|16@1+ (1,0) [0|65535] ""  DASy
 SG_ RFC_Loc124_AliveCtr : 16|8@1+ (1,0) [0|255] ""  DASy
 SG_ RFC_Loc124_ProtBlockCtr : 24|8@1+ (1,0) [0|255] ""  DASy
 SG_ RFC_Loc124_Dr : 32|16@1+ (0.0078125,0) [0|511.9921875] "m"  DASy
 SG_ RFC_Loc124_Vr : 48|16@1+ (0.00390625,-128) [-128|127.99609375] "m/s"  DASy
 SG_ RFC_Loc124_Theta : 64|16@1+ (0.01,-327.68) [-90|90] "deg"  DASy
 SG_ RFC_Loc124_Phi : 80|16@1+ (0.01,-327.68) [-30|30] "deg"  DASy
 SG_ RFC_Loc124_DrVnce : 96|16@1+ (1.52588E-005,0) [0|0.999984741210937] "m^2"  DASy
 SG_ RFC_Loc124_VrVnce : 112|16@1+ (1.52588E-005,0) [0|0.999984741210937] "m^2/s^2"  DASy
 SG_ RFC_Loc124_ThetaVnce : 128|16@1+ (0.00390625,0) [0|255.99609375] "deg^2"  DASy
 SG_ RFC_Loc124_PhiVnce : 144|16@1+ (0.00390625,0) [0|255.99609375] "deg^2"  DASy
 SG_ RFC_Loc124_DrVrCoVnce : 160|16@1+ (3.814697265625E-006,-0.125) [-0.125|0.124996185302734] "m^2/s"  DASy
 SG_ RFC_Loc124_RCS : 176|16@1+ (0.00390625,-128) [-128|127.99609375] "dBsm"  DASy
 SG_ RFC_Loc124_RSSI : 192|16@1+ (0.00195312,0) [0|127.998046875] "dimensionless"  DASy
 SG_ RFC_Loc124_DrVrQuality : 208|8@1+ (1,0) [0|255] "dimensionless"  DASy
 SG_ RFC_Loc124_ThetaQuality : 216|8@1+ (1,0) [0|255] "dimensionless"  DASy
 SG_ RFC_Loc124_PhiQuality : 224|8@1+ (1,0) [0|255] "dimensionless"  DASy
 SG_ RFC_Loc125_Dr : 256|16@1+ (0.0078125,0) [0|511.9921875] "m"  DASy
 SG_ RFC_Loc125_Vr : 272|16@1+ (0.00390625,-128) [-128|127.99609375] "m/s"  DASy
 SG_ RFC_Loc125_Theta : 288|16@1+ (0.01,-327.68) [-90|90] "deg"  DASy
 SG_ RFC_Loc125_Phi : 304|16@1+ (0.01,-327.68) [-30|30] "deg"  DASy
 SG_ RFC_Loc125_DrVnce : 320|16@1+ (1.52588E-005,0) [0|0.999984741210937] "m^2"  DASy
 SG_ RFC_Loc125_VrVnce : 336|16@1+ (1.52588E-005,0) [0|0.999984741210937] "m^2/s^2"  DASy
 SG_ RFC_Loc125_ThetaVnce : 352|16@1+ (0.00390625,0) [0|255.99609375] "deg^2"  DASy
 SG_ RFC_Loc125_PhiVnce : 368|16@1+ (0.00390625,0) [0|255.99609375] "deg^2"  DASy
 SG_ RFC_Loc125_DrVrCoVnce : 384|16@1+ (3.814697265625E-006,-0.125) [-0.125|0.124996185302734] "m^2/s"  DASy
 SG_ RFC_Loc125_RCS : 400|16@1+ (0.00390625,-128) [-128|127.99609375] "dBsm"  DASy
 SG_ RFC_Loc125_RSSI : 416|16@1+ (0.00195312,0) [0|127.998046875] "dimensionless"  DASy
 SG_ RFC_Loc125_DrVrQuality : 432|8@1+ (1,0) [0|255] "dimensionless"  DASy
 SG_ RFC_Loc125_ThetaQuality : 440|8@1+ (1,0) [0|255] "dimensionless"  DASy
 SG_ RFC_Loc125_PhiQuality : 448|8@1+ (1,0) [0|255] "dimensionless"  DASy

BO_ 463 RFC_Location_126_127: 64 RadarFrontCenter
 SG_ RFC_Loc126_CRC : 0|16@1+ (1,0) [0|65535] ""  DASy
 SG_ RFC_Loc126_AliveCtr : 16|8@1+ (1,0) [0|255] ""  DASy
 SG_ RFC_Loc126_ProtBlockCtr : 24|8@1+ (1,0) [0|255] ""  DASy
 SG_ RFC_Loc126_Dr : 32|16@1+ (0.0078125,0) [0|511.9921875] "m"  DASy
 SG_ RFC_Loc126_Vr : 48|16@1+ (0.00390625,-128) [-128|127.99609375] "m/s"  DASy
 SG_ RFC_Loc126_Theta : 64|16@1+ (0.01,-327.68) [-90|90] "deg"  DASy
 SG_ RFC_Loc126_Phi : 80|16@1+ (0.01,-327.68) [-30|30] "deg"  DASy
 SG_ RFC_Loc126_DrVnce : 96|16@1+ (1.52588E-005,0) [0|0.999984741210937] "m^2"  DASy
 SG_ RFC_Loc126_VrVnce : 112|16@1+ (1.52588E-005,0) [0|0.999984741210937] "m^2/s^2"  DASy
 SG_ RFC_Loc126_ThetaVnce : 128|16@1+ (0.00390625,0) [0|255.99609375] "deg^2"  DASy
 SG_ RFC_Loc126_PhiVnce : 144|16@1+ (0.00390625,0) [0|255.99609375] "deg^2"  DASy
 SG_ RFC_Loc126_DrVrCoVnce : 160|16@1+ (3.814697265625E-006,-0.125) [-0.125|0.124996185302734] "m^2/s"  DASy
 SG_ RFC_Loc126_RCS : 176|16@1+ (0.00390625,-128) [-128|127.99609375] "dBsm"  DASy
 SG_ RFC_Loc126_RSSI : 192|16@1+ (0.00195312,0) [0|127.998046875] "dimensionless"  DASy
 SG_ RFC_Loc126_DrVrQuality : 208|8@1+ (1,0) [0|255] "dimensionless"  DASy
 SG_ RFC_Loc126_ThetaQuality : 216|8@1+ (1,0) [0|255] "dimensionless"  DASy
 SG_ RFC_Loc126_PhiQuality : 224|8@1+ (1,0) [0|255] "dimensionless"  DASy
 SG_ RFC_Loc127_Dr : 256|16@1+ (0.0078125,0) [0|511.9921875] "m"  DASy
 SG_ RFC_Loc127_Vr : 272|16@1+ (0.00390625,-128) [-128|127.99609375] "m/s"  DASy
 SG_ RFC_Loc127_Theta : 288|16@1+ (0.01,-327.68) [-90|90] "deg"  DASy
 SG_ RFC_Loc127_Phi : 304|16@1+ (0.01,-327.68) [-30|30] "deg"  DASy
 SG_ RFC_Loc127_DrVnce : 320|16@1+ (1.52588E-005,0) [0|0.999984741210937] "m^2"  DASy
 SG_ RFC_Loc127_VrVnce : 336|16@1+ (1.52588E-005,0) [0|0.999984741210937] "m^2/s^2"  DASy
 SG_ RFC_Loc127_ThetaVnce : 352|16@1+ (0.00390625,0) [0|255.99609375] "deg^2"  DASy
 SG_ RFC_Loc127_PhiVnce : 368|16@1+ (0.00390625,0) [0|255.99609375] "deg^2"  DASy
 SG_ RFC_Loc127_DrVrCoVnce : 384|16@1+ (3.814697265625E-006,-0.125) [-0.125|0.124996185302734] "m^2/s"  DASy
 SG_ RFC_Loc127_RCS : 400|16@1+ (0.00390625,-128) [-128|127.99609375] "dBsm"  DASy
 SG_ RFC_Loc127_RSSI : 416|16@1+ (0.00195312,0) [0|127.998046875] "dimensionless"  DASy
 SG_ RFC_Loc127_DrVrQuality : 432|8@1+ (1,0) [0|255] "dimensionless"  DASy
 SG_ RFC_Loc127_ThetaQuality : 440|8@1+ (1,0) [0|255] "dimensionless"  DASy
 SG_ RFC_Loc127_PhiQuality : 448|8@1+ (1,0) [0|255] "dimensionless"  DASy

BO_ 464 RFC_Location_128_129: 64 RadarFrontCenter
 SG_ RFC_Loc128_CRC : 0|16@1+ (1,0) [0|65535] ""  DASy
 SG_ RFC_Loc128_AliveCtr : 16|8@1+ (1,0) [0|255] ""  DASy
 SG_ RFC_Loc128_ProtBlockCtr : 24|8@1+ (1,0) [0|255] ""  DASy
 SG_ RFC_Loc128_Dr : 32|16@1+ (0.0078125,0) [0|511.9921875] "m"  DASy
 SG_ RFC_Loc128_Vr : 48|16@1+ (0.00390625,-128) [-128|127.99609375] "m/s"  DASy
 SG_ RFC_Loc128_Theta : 64|16@1+ (0.01,-327.68) [-90|90] "deg"  DASy
 SG_ RFC_Loc128_Phi : 80|16@1+ (0.01,-327.68) [-30|30] "deg"  DASy
 SG_ RFC_Loc128_DrVnce : 96|16@1+ (1.52588E-005,0) [0|0.999984741210937] "m^2"  DASy
 SG_ RFC_Loc128_VrVnce : 112|16@1+ (1.52588E-005,0) [0|0.999984741210937] "m^2/s^2"  DASy
 SG_ RFC_Loc128_ThetaVnce : 128|16@1+ (0.00390625,0) [0|255.99609375] "deg^2"  DASy
 SG_ RFC_Loc128_PhiVnce : 144|16@1+ (0.00390625,0) [0|255.99609375] "deg^2"  DASy
 SG_ RFC_Loc128_DrVrCoVnce : 160|16@1+ (3.814697265625E-006,-0.125) [-0.125|0.124996185302734] "m^2/s"  DASy
 SG_ RFC_Loc128_RCS : 176|16@1+ (0.00390625,-128) [-128|127.99609375] "dBsm"  DASy
 SG_ RFC_Loc128_RSSI : 192|16@1+ (0.00195312,0) [0|127.998046875] "dimensionless"  DASy
 SG_ RFC_Loc128_DrVrQuality : 208|8@1+ (1,0) [0|255] "dimensionless"  DASy
 SG_ RFC_Loc128_ThetaQuality : 216|8@1+ (1,0) [0|255] "dimensionless"  DASy
 SG_ RFC_Loc128_PhiQuality : 224|8@1+ (1,0) [0|255] "dimensionless"  DASy
 SG_ RFC_Loc129_Dr : 256|16@1+ (0.0078125,0) [0|511.9921875] "m"  DASy
 SG_ RFC_Loc129_Vr : 272|16@1+ (0.00390625,-128) [-128|127.99609375] "m/s"  DASy
 SG_ RFC_Loc129_Theta : 288|16@1+ (0.01,-327.68) [-90|90] "deg"  DASy
 SG_ RFC_Loc129_Phi : 304|16@1+ (0.01,-327.68) [-30|30] "deg"  DASy
 SG_ RFC_Loc129_DrVnce : 320|16@1+ (1.52588E-005,0) [0|0.999984741210937] "m^2"  DASy
 SG_ RFC_Loc129_VrVnce : 336|16@1+ (1.52588E-005,0) [0|0.999984741210937] "m^2/s^2"  DASy
 SG_ RFC_Loc129_ThetaVnce : 352|16@1+ (0.00390625,0) [0|255.99609375] "deg^2"  DASy
 SG_ RFC_Loc129_PhiVnce : 368|16@1+ (0.00390625,0) [0|255.99609375] "deg^2"  DASy
 SG_ RFC_Loc129_DrVrCoVnce : 384|16@1+ (3.814697265625E-006,-0.125) [-0.125|0.124996185302734] "m^2/s"  DASy
 SG_ RFC_Loc129_RCS : 400|16@1+ (0.00390625,-128) [-128|127.99609375] "dBsm"  DASy
 SG_ RFC_Loc129_RSSI : 416|16@1+ (0.00195312,0) [0|127.998046875] "dimensionless"  DASy
 SG_ RFC_Loc129_DrVrQuality : 432|8@1+ (1,0) [0|255] "dimensionless"  DASy
 SG_ RFC_Loc129_ThetaQuality : 440|8@1+ (1,0) [0|255] "dimensionless"  DASy
 SG_ RFC_Loc129_PhiQuality : 448|8@1+ (1,0) [0|255] "dimensionless"  DASy

BO_ 465 RFC_Location_130_131: 64 RadarFrontCenter
 SG_ RFC_Loc130_CRC : 0|16@1+ (1,0) [0|65535] ""  DASy
 SG_ RFC_Loc130_AliveCtr : 16|8@1+ (1,0) [0|255] ""  DASy
 SG_ RFC_Loc130_ProtBlockCtr : 24|8@1+ (1,0) [0|255] ""  DASy
 SG_ RFC_Loc130_Dr : 32|16@1+ (0.0078125,0) [0|511.9921875] "m"  DASy
 SG_ RFC_Loc130_Vr : 48|16@1+ (0.00390625,-128) [-128|127.99609375] "m/s"  DASy
 SG_ RFC_Loc130_Theta : 64|16@1+ (0.01,-327.68) [-90|90] "deg"  DASy
 SG_ RFC_Loc130_Phi : 80|16@1+ (0.01,-327.68) [-30|30] "deg"  DASy
 SG_ RFC_Loc130_DrVnce : 96|16@1+ (1.52588E-005,0) [0|0.999984741210937] "m^2"  DASy
 SG_ RFC_Loc130_VrVnce : 112|16@1+ (1.52588E-005,0) [0|0.999984741210937] "m^2/s^2"  DASy
 SG_ RFC_Loc130_ThetaVnce : 128|16@1+ (0.00390625,0) [0|255.99609375] "deg^2"  DASy
 SG_ RFC_Loc130_PhiVnce : 144|16@1+ (0.00390625,0) [0|255.99609375] "deg^2"  DASy
 SG_ RFC_Loc130_DrVrCoVnce : 160|16@1+ (3.814697265625E-006,-0.125) [-0.125|0.124996185302734] "m^2/s"  DASy
 SG_ RFC_Loc130_RCS : 176|16@1+ (0.00390625,-128) [-128|127.99609375] "dBsm"  DASy
 SG_ RFC_Loc130_RSSI : 192|16@1+ (0.00195312,0) [0|127.998046875] "dimensionless"  DASy
 SG_ RFC_Loc130_DrVrQuality : 208|8@1+ (1,0) [0|255] "dimensionless"  DASy
 SG_ RFC_Loc130_ThetaQuality : 216|8@1+ (1,0) [0|255] "dimensionless"  DASy
 SG_ RFC_Loc130_PhiQuality : 224|8@1+ (1,0) [0|255] "dimensionless"  DASy
 SG_ RFC_Loc131_Dr : 256|16@1+ (0.0078125,0) [0|511.9921875] "m"  DASy
 SG_ RFC_Loc131_Vr : 272|16@1+ (0.00390625,-128) [-128|127.99609375] "m/s"  DASy
 SG_ RFC_Loc131_Theta : 288|16@1+ (0.01,-327.68) [-90|90] "deg"  DASy
 SG_ RFC_Loc131_Phi : 304|16@1+ (0.01,-327.68) [-30|30] "deg"  DASy
 SG_ RFC_Loc131_DrVnce : 320|16@1+ (1.52588E-005,0) [0|0.999984741210937] "m^2"  DASy
 SG_ RFC_Loc131_VrVnce : 336|16@1+ (1.52588E-005,0) [0|0.999984741210937] "m^2/s^2"  DASy
 SG_ RFC_Loc131_ThetaVnce : 352|16@1+ (0.00390625,0) [0|255.99609375] "deg^2"  DASy
 SG_ RFC_Loc131_PhiVnce : 368|16@1+ (0.00390625,0) [0|255.99609375] "deg^2"  DASy
 SG_ RFC_Loc131_DrVrCoVnce : 384|16@1+ (3.814697265625E-006,-0.125) [-0.125|0.124996185302734] "m^2/s"  DASy
 SG_ RFC_Loc131_RCS : 400|16@1+ (0.00390625,-128) [-128|127.99609375] "dBsm"  DASy
 SG_ RFC_Loc131_RSSI : 416|16@1+ (0.00195312,0) [0|127.998046875] "dimensionless"  DASy
 SG_ RFC_Loc131_DrVrQuality : 432|8@1+ (1,0) [0|255] "dimensionless"  DASy
 SG_ RFC_Loc131_ThetaQuality : 440|8@1+ (1,0) [0|255] "dimensionless"  DASy
 SG_ RFC_Loc131_PhiQuality : 448|8@1+ (1,0) [0|255] "dimensionless"  DASy

BO_ 466 RFC_Location_132_133: 64 RadarFrontCenter
 SG_ RFC_Loc132_CRC : 0|16@1+ (1,0) [0|65535] ""  DASy
 SG_ RFC_Loc132_AliveCtr : 16|8@1+ (1,0) [0|255] ""  DASy
 SG_ RFC_Loc132_ProtBlockCtr : 24|8@1+ (1,0) [0|255] ""  DASy
 SG_ RFC_Loc132_Dr : 32|16@1+ (0.0078125,0) [0|511.9921875] "m"  DASy
 SG_ RFC_Loc132_Vr : 48|16@1+ (0.00390625,-128) [-128|127.99609375] "m/s"  DASy
 SG_ RFC_Loc132_Theta : 64|16@1+ (0.01,-327.68) [-90|90] "deg"  DASy
 SG_ RFC_Loc132_Phi : 80|16@1+ (0.01,-327.68) [-30|30] "deg"  DASy
 SG_ RFC_Loc132_DrVnce : 96|16@1+ (1.52588E-005,0) [0|0.999984741210937] "m^2"  DASy
 SG_ RFC_Loc132_VrVnce : 112|16@1+ (1.52588E-005,0) [0|0.999984741210937] "m^2/s^2"  DASy
 SG_ RFC_Loc132_ThetaVnce : 128|16@1+ (0.00390625,0) [0|255.99609375] "deg^2"  DASy
 SG_ RFC_Loc132_PhiVnce : 144|16@1+ (0.00390625,0) [0|255.99609375] "deg^2"  DASy
 SG_ RFC_Loc132_DrVrCoVnce : 160|16@1+ (3.814697265625E-006,-0.125) [-0.125|0.124996185302734] "m^2/s"  DASy
 SG_ RFC_Loc132_RCS : 176|16@1+ (0.00390625,-128) [-128|127.99609375] "dBsm"  DASy
 SG_ RFC_Loc132_RSSI : 192|16@1+ (0.00195312,0) [0|127.998046875] "dimensionless"  DASy
 SG_ RFC_Loc132_DrVrQuality : 208|8@1+ (1,0) [0|255] "dimensionless"  DASy
 SG_ RFC_Loc132_ThetaQuality : 216|8@1+ (1,0) [0|255] "dimensionless"  DASy
 SG_ RFC_Loc132_PhiQuality : 224|8@1+ (1,0) [0|255] "dimensionless"  DASy
 SG_ RFC_Loc133_Dr : 256|16@1+ (0.0078125,0) [0|511.9921875] "m"  DASy
 SG_ RFC_Loc133_Vr : 272|16@1+ (0.00390625,-128) [-128|127.99609375] "m/s"  DASy
 SG_ RFC_Loc133_Theta : 288|16@1+ (0.01,-327.68) [-90|90] "deg"  DASy
 SG_ RFC_Loc133_Phi : 304|16@1+ (0.01,-327.68) [-30|30] "deg"  DASy
 SG_ RFC_Loc133_DrVnce : 320|16@1+ (1.52588E-005,0) [0|0.999984741210937] "m^2"  DASy
 SG_ RFC_Loc133_VrVnce : 336|16@1+ (1.52588E-005,0) [0|0.999984741210937] "m^2/s^2"  DASy
 SG_ RFC_Loc133_ThetaVnce : 352|16@1+ (0.00390625,0) [0|255.99609375] "deg^2"  DASy
 SG_ RFC_Loc133_PhiVnce : 368|16@1+ (0.00390625,0) [0|255.99609375] "deg^2"  DASy
 SG_ RFC_Loc133_DrVrCoVnce : 384|16@1+ (3.814697265625E-006,-0.125) [-0.125|0.124996185302734] "m^2/s"  DASy
 SG_ RFC_Loc133_RCS : 400|16@1+ (0.00390625,-128) [-128|127.99609375] "dBsm"  DASy
 SG_ RFC_Loc133_RSSI : 416|16@1+ (0.00195312,0) [0|127.998046875] "dimensionless"  DASy
 SG_ RFC_Loc133_DrVrQuality : 432|8@1+ (1,0) [0|255] "dimensionless"  DASy
 SG_ RFC_Loc133_ThetaQuality : 440|8@1+ (1,0) [0|255] "dimensionless"  DASy
 SG_ RFC_Loc133_PhiQuality : 448|8@1+ (1,0) [0|255] "dimensionless"  DASy

BO_ 467 RFC_Location_134_135: 64 RadarFrontCenter
 SG_ RFC_Loc134_CRC : 0|16@1+ (1,0) [0|65535] ""  DASy
 SG_ RFC_Loc134_AliveCtr : 16|8@1+ (1,0) [0|255] ""  DASy
 SG_ RFC_Loc134_ProtBlockCtr : 24|8@1+ (1,0) [0|255] ""  DASy
 SG_ RFC_Loc134_Dr : 32|16@1+ (0.0078125,0) [0|511.9921875] "m"  DASy
 SG_ RFC_Loc134_Vr : 48|16@1+ (0.00390625,-128) [-128|127.99609375] "m/s"  DASy
 SG_ RFC_Loc134_Theta : 64|16@1+ (0.01,-327.68) [-90|90] "deg"  DASy
 SG_ RFC_Loc134_Phi : 80|16@1+ (0.01,-327.68) [-30|30] "deg"  DASy
 SG_ RFC_Loc134_DrVnce : 96|16@1+ (1.52588E-005,0) [0|0.999984741210937] "m^2"  DASy
 SG_ RFC_Loc134_VrVnce : 112|16@1+ (1.52588E-005,0) [0|0.999984741210937] "m^2/s^2"  DASy
 SG_ RFC_Loc134_ThetaVnce : 128|16@1+ (0.00390625,0) [0|255.99609375] "deg^2"  DASy
 SG_ RFC_Loc134_PhiVnce : 144|16@1+ (0.00390625,0) [0|255.99609375] "deg^2"  DASy
 SG_ RFC_Loc134_DrVrCoVnce : 160|16@1+ (3.814697265625E-006,-0.125) [-0.125|0.124996185302734] "m^2/s"  DASy
 SG_ RFC_Loc134_RCS : 176|16@1+ (0.00390625,-128) [-128|127.99609375] "dBsm"  DASy
 SG_ RFC_Loc134_RSSI : 192|16@1+ (0.00195312,0) [0|127.998046875] "dimensionless"  DASy
 SG_ RFC_Loc134_DrVrQuality : 208|8@1+ (1,0) [0|255] "dimensionless"  DASy
 SG_ RFC_Loc134_ThetaQuality : 216|8@1+ (1,0) [0|255] "dimensionless"  DASy
 SG_ RFC_Loc134_PhiQuality : 224|8@1+ (1,0) [0|255] "dimensionless"  DASy
 SG_ RFC_Loc135_Dr : 256|16@1+ (0.0078125,0) [0|511.9921875] "m"  DASy
 SG_ RFC_Loc135_Vr : 272|16@1+ (0.00390625,-128) [-128|127.99609375] "m/s"  DASy
 SG_ RFC_Loc135_Theta : 288|16@1+ (0.01,-327.68) [-90|90] "deg"  DASy
 SG_ RFC_Loc135_Phi : 304|16@1+ (0.01,-327.68) [-30|30] "deg"  DASy
 SG_ RFC_Loc135_DrVnce : 320|16@1+ (1.52588E-005,0) [0|0.999984741210937] "m^2"  DASy
 SG_ RFC_Loc135_VrVnce : 336|16@1+ (1.52588E-005,0) [0|0.999984741210937] "m^2/s^2"  DASy
 SG_ RFC_Loc135_ThetaVnce : 352|16@1+ (0.00390625,0) [0|255.99609375] "deg^2"  DASy
 SG_ RFC_Loc135_PhiVnce : 368|16@1+ (0.00390625,0) [0|255.99609375] "deg^2"  DASy
 SG_ RFC_Loc135_DrVrCoVnce : 384|16@1+ (3.814697265625E-006,-0.125) [-0.125|0.124996185302734] "m^2/s"  DASy
 SG_ RFC_Loc135_RCS : 400|16@1+ (0.00390625,-128) [-128|127.99609375] "dBsm"  DASy
 SG_ RFC_Loc135_RSSI : 416|16@1+ (0.00195312,0) [0|127.998046875] "dimensionless"  DASy
 SG_ RFC_Loc135_DrVrQuality : 432|8@1+ (1,0) [0|255] "dimensionless"  DASy
 SG_ RFC_Loc135_ThetaQuality : 440|8@1+ (1,0) [0|255] "dimensionless"  DASy
 SG_ RFC_Loc135_PhiQuality : 448|8@1+ (1,0) [0|255] "dimensionless"  DASy

BO_ 468 RFC_Location_136_137: 64 RadarFrontCenter
 SG_ RFC_Loc136_CRC : 0|16@1+ (1,0) [0|65535] ""  DASy
 SG_ RFC_Loc136_AliveCtr : 16|8@1+ (1,0) [0|255] ""  DASy
 SG_ RFC_Loc136_ProtBlockCtr : 24|8@1+ (1,0) [0|255] ""  DASy
 SG_ RFC_Loc136_Dr : 32|16@1+ (0.0078125,0) [0|511.9921875] "m"  DASy
 SG_ RFC_Loc136_Vr : 48|16@1+ (0.00390625,-128) [-128|127.99609375] "m/s"  DASy
 SG_ RFC_Loc136_Theta : 64|16@1+ (0.01,-327.68) [-90|90] "deg"  DASy
 SG_ RFC_Loc136_Phi : 80|16@1+ (0.01,-327.68) [-30|30] "deg"  DASy
 SG_ RFC_Loc136_DrVnce : 96|16@1+ (1.52588E-005,0) [0|0.999984741210937] "m^2"  DASy
 SG_ RFC_Loc136_VrVnce : 112|16@1+ (1.52588E-005,0) [0|0.999984741210937] "m^2/s^2"  DASy
 SG_ RFC_Loc136_ThetaVnce : 128|16@1+ (0.00390625,0) [0|255.99609375] "deg^2"  DASy
 SG_ RFC_Loc136_PhiVnce : 144|16@1+ (0.00390625,0) [0|255.99609375] "deg^2"  DASy
 SG_ RFC_Loc136_DrVrCoVnce : 160|16@1+ (3.814697265625E-006,-0.125) [-0.125|0.124996185302734] "m^2/s"  DASy
 SG_ RFC_Loc136_RCS : 176|16@1+ (0.00390625,-128) [-128|127.99609375] "dBsm"  DASy
 SG_ RFC_Loc136_RSSI : 192|16@1+ (0.00195312,0) [0|127.998046875] "dimensionless"  DASy
 SG_ RFC_Loc136_DrVrQuality : 208|8@1+ (1,0) [0|255] "dimensionless"  DASy
 SG_ RFC_Loc136_ThetaQuality : 216|8@1+ (1,0) [0|255] "dimensionless"  DASy
 SG_ RFC_Loc136_PhiQuality : 224|8@1+ (1,0) [0|255] "dimensionless"  DASy
 SG_ RFC_Loc137_Dr : 256|16@1+ (0.0078125,0) [0|511.9921875] "m"  DASy
 SG_ RFC_Loc137_Vr : 272|16@1+ (0.00390625,-128) [-128|127.99609375] "m/s"  DASy
 SG_ RFC_Loc137_Theta : 288|16@1+ (0.01,-327.68) [-90|90] "deg"  DASy
 SG_ RFC_Loc137_Phi : 304|16@1+ (0.01,-327.68) [-30|30] "deg"  DASy
 SG_ RFC_Loc137_DrVnce : 320|16@1+ (1.52588E-005,0) [0|0.999984741210937] "m^2"  DASy
 SG_ RFC_Loc137_VrVnce : 336|16@1+ (1.52588E-005,0) [0|0.999984741210937] "m^2/s^2"  DASy
 SG_ RFC_Loc137_ThetaVnce : 352|16@1+ (0.00390625,0) [0|255.99609375] "deg^2"  DASy
 SG_ RFC_Loc137_PhiVnce : 368|16@1+ (0.00390625,0) [0|255.99609375] "deg^2"  DASy
 SG_ RFC_Loc137_DrVrCoVnce : 384|16@1+ (3.814697265625E-006,-0.125) [-0.125|0.124996185302734] "m^2/s"  DASy
 SG_ RFC_Loc137_RCS : 400|16@1+ (0.00390625,-128) [-128|127.99609375] "dBsm"  DASy
 SG_ RFC_Loc137_RSSI : 416|16@1+ (0.00195312,0) [0|127.998046875] "dimensionless"  DASy
 SG_ RFC_Loc137_DrVrQuality : 432|8@1+ (1,0) [0|255] "dimensionless"  DASy
 SG_ RFC_Loc137_ThetaQuality : 440|8@1+ (1,0) [0|255] "dimensionless"  DASy
 SG_ RFC_Loc137_PhiQuality : 448|8@1+ (1,0) [0|255] "dimensionless"  DASy

BO_ 469 RFC_Location_138_139: 64 RadarFrontCenter
 SG_ RFC_Loc138_CRC : 0|16@1+ (1,0) [0|65535] ""  DASy
 SG_ RFC_Loc138_AliveCtr : 16|8@1+ (1,0) [0|255] ""  DASy
 SG_ RFC_Loc138_ProtBlockCtr : 24|8@1+ (1,0) [0|255] ""  DASy
 SG_ RFC_Loc138_Dr : 32|16@1+ (0.0078125,0) [0|511.9921875] "m"  DASy
 SG_ RFC_Loc138_Vr : 48|16@1+ (0.00390625,-128) [-128|127.99609375] "m/s"  DASy
 SG_ RFC_Loc138_Theta : 64|16@1+ (0.01,-327.68) [-90|90] "deg"  DASy
 SG_ RFC_Loc138_Phi : 80|16@1+ (0.01,-327.68) [-30|30] "deg"  DASy
 SG_ RFC_Loc138_DrVnce : 96|16@1+ (1.52588E-005,0) [0|0.999984741210937] "m^2"  DASy
 SG_ RFC_Loc138_VrVnce : 112|16@1+ (1.52588E-005,0) [0|0.999984741210937] "m^2/s^2"  DASy
 SG_ RFC_Loc138_ThetaVnce : 128|16@1+ (0.00390625,0) [0|255.99609375] "deg^2"  DASy
 SG_ RFC_Loc138_PhiVnce : 144|16@1+ (0.00390625,0) [0|255.99609375] "deg^2"  DASy
 SG_ RFC_Loc138_DrVrCoVnce : 160|16@1+ (3.814697265625E-006,-0.125) [-0.125|0.124996185302734] "m^2/s"  DASy
 SG_ RFC_Loc138_RCS : 176|16@1+ (0.00390625,-128) [-128|127.99609375] "dBsm"  DASy
 SG_ RFC_Loc138_RSSI : 192|16@1+ (0.00195312,0) [0|127.998046875] "dimensionless"  DASy
 SG_ RFC_Loc138_DrVrQuality : 208|8@1+ (1,0) [0|255] "dimensionless"  DASy
 SG_ RFC_Loc138_ThetaQuality : 216|8@1+ (1,0) [0|255] "dimensionless"  DASy
 SG_ RFC_Loc138_PhiQuality : 224|8@1+ (1,0) [0|255] "dimensionless"  DASy
 SG_ RFC_Loc139_Dr : 256|16@1+ (0.0078125,0) [0|511.9921875] "m"  DASy
 SG_ RFC_Loc139_Vr : 272|16@1+ (0.00390625,-128) [-128|127.99609375] "m/s"  DASy
 SG_ RFC_Loc139_Theta : 288|16@1+ (0.01,-327.68) [-90|90] "deg"  DASy
 SG_ RFC_Loc139_Phi : 304|16@1+ (0.01,-327.68) [-30|30] "deg"  DASy
 SG_ RFC_Loc139_DrVnce : 320|16@1+ (1.52588E-005,0) [0|0.999984741210937] "m^2"  DASy
 SG_ RFC_Loc139_VrVnce : 336|16@1+ (1.52588E-005,0) [0|0.999984741210937] "m^2/s^2"  DASy
 SG_ RFC_Loc139_ThetaVnce : 352|16@1+ (0.00390625,0) [0|255.99609375] "deg^2"  DASy
 SG_ RFC_Loc139_PhiVnce : 368|16@1+ (0.00390625,0) [0|255.99609375] "deg^2"  DASy
 SG_ RFC_Loc139_DrVrCoVnce : 384|16@1+ (3.814697265625E-006,-0.125) [-0.125|0.124996185302734] "m^2/s"  DASy
 SG_ RFC_Loc139_RCS : 400|16@1+ (0.00390625,-128) [-128|127.99609375] "dBsm"  DASy
 SG_ RFC_Loc139_RSSI : 416|16@1+ (0.00195312,0) [0|127.998046875] "dimensionless"  DASy
 SG_ RFC_Loc139_DrVrQuality : 432|8@1+ (1,0) [0|255] "dimensionless"  DASy
 SG_ RFC_Loc139_ThetaQuality : 440|8@1+ (1,0) [0|255] "dimensionless"  DASy
 SG_ RFC_Loc139_PhiQuality : 448|8@1+ (1,0) [0|255] "dimensionless"  DASy

BO_ 470 RFC_Location_140_141: 64 RadarFrontCenter
 SG_ RFC_Loc140_CRC : 0|16@1+ (1,0) [0|65535] ""  DASy
 SG_ RFC_Loc140_AliveCtr : 16|8@1+ (1,0) [0|255] ""  DASy
 SG_ RFC_Loc140_ProtBlockCtr : 24|8@1+ (1,0) [0|255] ""  DASy
 SG_ RFC_Loc140_Dr : 32|16@1+ (0.0078125,0) [0|511.9921875] "m"  DASy
 SG_ RFC_Loc140_Vr : 48|16@1+ (0.00390625,-128) [-128|127.99609375] "m/s"  DASy
 SG_ RFC_Loc140_Theta : 64|16@1+ (0.01,-327.68) [-90|90] "deg"  DASy
 SG_ RFC_Loc140_Phi : 80|16@1+ (0.01,-327.68) [-30|30] "deg"  DASy
 SG_ RFC_Loc140_DrVnce : 96|16@1+ (1.52588E-005,0) [0|0.999984741210937] "m^2"  DASy
 SG_ RFC_Loc140_VrVnce : 112|16@1+ (1.52588E-005,0) [0|0.999984741210937] "m^2/s^2"  DASy
 SG_ RFC_Loc140_ThetaVnce : 128|16@1+ (0.00390625,0) [0|255.99609375] "deg^2"  DASy
 SG_ RFC_Loc140_PhiVnce : 144|16@1+ (0.00390625,0) [0|255.99609375] "deg^2"  DASy
 SG_ RFC_Loc140_DrVrCoVnce : 160|16@1+ (3.814697265625E-006,-0.125) [-0.125|0.124996185302734] "m^2/s"  DASy
 SG_ RFC_Loc140_RCS : 176|16@1+ (0.00390625,-128) [-128|127.99609375] "dBsm"  DASy
 SG_ RFC_Loc140_RSSI : 192|16@1+ (0.00195312,0) [0|127.998046875] "dimensionless"  DASy
 SG_ RFC_Loc140_DrVrQuality : 208|8@1+ (1,0) [0|255] "dimensionless"  DASy
 SG_ RFC_Loc140_ThetaQuality : 216|8@1+ (1,0) [0|255] "dimensionless"  DASy
 SG_ RFC_Loc140_PhiQuality : 224|8@1+ (1,0) [0|255] "dimensionless"  DASy
 SG_ RFC_Loc141_Dr : 256|16@1+ (0.0078125,0) [0|511.9921875] "m"  DASy
 SG_ RFC_Loc141_Vr : 272|16@1+ (0.00390625,-128) [-128|127.99609375] "m/s"  DASy
 SG_ RFC_Loc141_Theta : 288|16@1+ (0.01,-327.68) [-90|90] "deg"  DASy
 SG_ RFC_Loc141_Phi : 304|16@1+ (0.01,-327.68) [-30|30] "deg"  DASy
 SG_ RFC_Loc141_DrVnce : 320|16@1+ (1.52588E-005,0) [0|0.999984741210937] "m^2"  DASy
 SG_ RFC_Loc141_VrVnce : 336|16@1+ (1.52588E-005,0) [0|0.999984741210937] "m^2/s^2"  DASy
 SG_ RFC_Loc141_ThetaVnce : 352|16@1+ (0.00390625,0) [0|255.99609375] "deg^2"  DASy
 SG_ RFC_Loc141_PhiVnce : 368|16@1+ (0.00390625,0) [0|255.99609375] "deg^2"  DASy
 SG_ RFC_Loc141_DrVrCoVnce : 384|16@1+ (3.814697265625E-006,-0.125) [-0.125|0.124996185302734] "m^2/s"  DASy
 SG_ RFC_Loc141_RCS : 400|16@1+ (0.00390625,-128) [-128|127.99609375] "dBsm"  DASy
 SG_ RFC_Loc141_RSSI : 416|16@1+ (0.00195312,0) [0|127.998046875] "dimensionless"  DASy
 SG_ RFC_Loc141_DrVrQuality : 432|8@1+ (1,0) [0|255] "dimensionless"  DASy
 SG_ RFC_Loc141_ThetaQuality : 440|8@1+ (1,0) [0|255] "dimensionless"  DASy
 SG_ RFC_Loc141_PhiQuality : 448|8@1+ (1,0) [0|255] "dimensionless"  DASy

BO_ 471 RFC_Location_142_143: 64 RadarFrontCenter
 SG_ RFC_Loc142_CRC : 0|16@1+ (1,0) [0|65535] ""  DASy
 SG_ RFC_Loc142_AliveCtr : 16|8@1+ (1,0) [0|255] ""  DASy
 SG_ RFC_Loc142_ProtBlockCtr : 24|8@1+ (1,0) [0|255] ""  DASy
 SG_ RFC_Loc142_Dr : 32|16@1+ (0.0078125,0) [0|511.9921875] "m"  DASy
 SG_ RFC_Loc142_Vr : 48|16@1+ (0.00390625,-128) [-128|127.99609375] "m/s"  DASy
 SG_ RFC_Loc142_Theta : 64|16@1+ (0.01,-327.68) [-90|90] "deg"  DASy
 SG_ RFC_Loc142_Phi : 80|16@1+ (0.01,-327.68) [-30|30] "deg"  DASy
 SG_ RFC_Loc142_DrVnce : 96|16@1+ (1.52588E-005,0) [0|0.999984741210937] "m^2"  DASy
 SG_ RFC_Loc142_VrVnce : 112|16@1+ (1.52588E-005,0) [0|0.999984741210937] "m^2/s^2"  DASy
 SG_ RFC_Loc142_ThetaVnce : 128|16@1+ (0.00390625,0) [0|255.99609375] "deg^2"  DASy
 SG_ RFC_Loc142_PhiVnce : 144|16@1+ (0.00390625,0) [0|255.99609375] "deg^2"  DASy
 SG_ RFC_Loc142_DrVrCoVnce : 160|16@1+ (3.814697265625E-006,-0.125) [-0.125|0.124996185302734] "m^2/s"  DASy
 SG_ RFC_Loc142_RCS : 176|16@1+ (0.00390625,-128) [-128|127.99609375] "dBsm"  DASy
 SG_ RFC_Loc142_RSSI : 192|16@1+ (0.00195312,0) [0|127.998046875] "dimensionless"  DASy
 SG_ RFC_Loc142_DrVrQuality : 208|8@1+ (1,0) [0|255] "dimensionless"  DASy
 SG_ RFC_Loc142_ThetaQuality : 216|8@1+ (1,0) [0|255] "dimensionless"  DASy
 SG_ RFC_Loc142_PhiQuality : 224|8@1+ (1,0) [0|255] "dimensionless"  DASy
 SG_ RFC_Loc143_Dr : 256|16@1+ (0.0078125,0) [0|511.9921875] "m"  DASy
 SG_ RFC_Loc143_Vr : 272|16@1+ (0.00390625,-128) [-128|127.99609375] "m/s"  DASy
 SG_ RFC_Loc143_Theta : 288|16@1+ (0.01,-327.68) [-90|90] "deg"  DASy
 SG_ RFC_Loc143_Phi : 304|16@1+ (0.01,-327.68) [-30|30] "deg"  DASy
 SG_ RFC_Loc143_DrVnce : 320|16@1+ (1.52588E-005,0) [0|0.999984741210937] "m^2"  DASy
 SG_ RFC_Loc143_VrVnce : 336|16@1+ (1.52588E-005,0) [0|0.999984741210937] "m^2/s^2"  DASy
 SG_ RFC_Loc143_ThetaVnce : 352|16@1+ (0.00390625,0) [0|255.99609375] "deg^2"  DASy
 SG_ RFC_Loc143_PhiVnce : 368|16@1+ (0.00390625,0) [0|255.99609375] "deg^2"  DASy
 SG_ RFC_Loc143_DrVrCoVnce : 384|16@1+ (3.814697265625E-006,-0.125) [-0.125|0.124996185302734] "m^2/s"  DASy
 SG_ RFC_Loc143_RCS : 400|16@1+ (0.00390625,-128) [-128|127.99609375] "dBsm"  DASy
 SG_ RFC_Loc143_RSSI : 416|16@1+ (0.00195312,0) [0|127.998046875] "dimensionless"  DASy
 SG_ RFC_Loc143_DrVrQuality : 432|8@1+ (1,0) [0|255] "dimensionless"  DASy
 SG_ RFC_Loc143_ThetaQuality : 440|8@1+ (1,0) [0|255] "dimensionless"  DASy
 SG_ RFC_Loc143_PhiQuality : 448|8@1+ (1,0) [0|255] "dimensionless"  DASy

BO_ 472 RFC_Location_144_145: 64 RadarFrontCenter
 SG_ RFC_Loc144_CRC : 0|16@1+ (1,0) [0|65535] ""  DASy
 SG_ RFC_Loc144_AliveCtr : 16|8@1+ (1,0) [0|255] ""  DASy
 SG_ RFC_Loc144_ProtBlockCtr : 24|8@1+ (1,0) [0|255] ""  DASy
 SG_ RFC_Loc144_Dr : 32|16@1+ (0.0078125,0) [0|511.9921875] "m"  DASy
 SG_ RFC_Loc144_Vr : 48|16@1+ (0.00390625,-128) [-128|127.99609375] "m/s"  DASy
 SG_ RFC_Loc144_Theta : 64|16@1+ (0.01,-327.68) [-90|90] "deg"  DASy
 SG_ RFC_Loc144_Phi : 80|16@1+ (0.01,-327.68) [-30|30] "deg"  DASy
 SG_ RFC_Loc144_DrVnce : 96|16@1+ (1.52588E-005,0) [0|0.999984741210937] "m^2"  DASy
 SG_ RFC_Loc144_VrVnce : 112|16@1+ (1.52588E-005,0) [0|0.999984741210937] "m^2/s^2"  DASy
 SG_ RFC_Loc144_ThetaVnce : 128|16@1+ (0.00390625,0) [0|255.99609375] "deg^2"  DASy
 SG_ RFC_Loc144_PhiVnce : 144|16@1+ (0.00390625,0) [0|255.99609375] "deg^2"  DASy
 SG_ RFC_Loc144_DrVrCoVnce : 160|16@1+ (3.814697265625E-006,-0.125) [-0.125|0.124996185302734] "m^2/s"  DASy
 SG_ RFC_Loc144_RCS : 176|16@1+ (0.00390625,-128) [-128|127.99609375] "dBsm"  DASy
 SG_ RFC_Loc144_RSSI : 192|16@1+ (0.00195312,0) [0|127.998046875] "dimensionless"  DASy
 SG_ RFC_Loc144_DrVrQuality : 208|8@1+ (1,0) [0|255] "dimensionless"  DASy
 SG_ RFC_Loc144_ThetaQuality : 216|8@1+ (1,0) [0|255] "dimensionless"  DASy
 SG_ RFC_Loc144_PhiQuality : 224|8@1+ (1,0) [0|255] "dimensionless"  DASy
 SG_ RFC_Loc145_Dr : 256|16@1+ (0.0078125,0) [0|511.9921875] "m"  DASy
 SG_ RFC_Loc145_Vr : 272|16@1+ (0.00390625,-128) [-128|127.99609375] "m/s"  DASy
 SG_ RFC_Loc145_Theta : 288|16@1+ (0.01,-327.68) [-90|90] "deg"  DASy
 SG_ RFC_Loc145_Phi : 304|16@1+ (0.01,-327.68) [-30|30] "deg"  DASy
 SG_ RFC_Loc145_DrVnce : 320|16@1+ (1.52588E-005,0) [0|0.999984741210937] "m^2"  DASy
 SG_ RFC_Loc145_VrVnce : 336|16@1+ (1.52588E-005,0) [0|0.999984741210937] "m^2/s^2"  DASy
 SG_ RFC_Loc145_ThetaVnce : 352|16@1+ (0.00390625,0) [0|255.99609375] "deg^2"  DASy
 SG_ RFC_Loc145_PhiVnce : 368|16@1+ (0.00390625,0) [0|255.99609375] "deg^2"  DASy
 SG_ RFC_Loc145_DrVrCoVnce : 384|16@1+ (3.814697265625E-006,-0.125) [-0.125|0.124996185302734] "m^2/s"  DASy
 SG_ RFC_Loc145_RCS : 400|16@1+ (0.00390625,-128) [-128|127.99609375] "dBsm"  DASy
 SG_ RFC_Loc145_RSSI : 416|16@1+ (0.00195312,0) [0|127.998046875] "dimensionless"  DASy
 SG_ RFC_Loc145_DrVrQuality : 432|8@1+ (1,0) [0|255] "dimensionless"  DASy
 SG_ RFC_Loc145_ThetaQuality : 440|8@1+ (1,0) [0|255] "dimensionless"  DASy
 SG_ RFC_Loc145_PhiQuality : 448|8@1+ (1,0) [0|255] "dimensionless"  DASy

BO_ 473 RFC_Location_146_147: 64 RadarFrontCenter
 SG_ RFC_Loc146_CRC : 0|16@1+ (1,0) [0|65535] ""  DASy
 SG_ RFC_Loc146_AliveCtr : 16|8@1+ (1,0) [0|255] ""  DASy
 SG_ RFC_Loc146_ProtBlockCtr : 24|8@1+ (1,0) [0|255] ""  DASy
 SG_ RFC_Loc146_Dr : 32|16@1+ (0.0078125,0) [0|511.9921875] "m"  DASy
 SG_ RFC_Loc146_Vr : 48|16@1+ (0.00390625,-128) [-128|127.99609375] "m/s"  DASy
 SG_ RFC_Loc146_Theta : 64|16@1+ (0.01,-327.68) [-90|90] "deg"  DASy
 SG_ RFC_Loc146_Phi : 80|16@1+ (0.01,-327.68) [-30|30] "deg"  DASy
 SG_ RFC_Loc146_DrVnce : 96|16@1+ (1.52588E-005,0) [0|0.999984741210937] "m^2"  DASy
 SG_ RFC_Loc146_VrVnce : 112|16@1+ (1.52588E-005,0) [0|0.999984741210937] "m^2/s^2"  DASy
 SG_ RFC_Loc146_ThetaVnce : 128|16@1+ (0.00390625,0) [0|255.99609375] "deg^2"  DASy
 SG_ RFC_Loc146_PhiVnce : 144|16@1+ (0.00390625,0) [0|255.99609375] "deg^2"  DASy
 SG_ RFC_Loc146_DrVrCoVnce : 160|16@1+ (3.814697265625E-006,-0.125) [-0.125|0.124996185302734] "m^2/s"  DASy
 SG_ RFC_Loc146_RCS : 176|16@1+ (0.00390625,-128) [-128|127.99609375] "dBsm"  DASy
 SG_ RFC_Loc146_RSSI : 192|16@1+ (0.00195312,0) [0|127.998046875] "dimensionless"  DASy
 SG_ RFC_Loc146_DrVrQuality : 208|8@1+ (1,0) [0|255] "dimensionless"  DASy
 SG_ RFC_Loc146_ThetaQuality : 216|8@1+ (1,0) [0|255] "dimensionless"  DASy
 SG_ RFC_Loc146_PhiQuality : 224|8@1+ (1,0) [0|255] "dimensionless"  DASy
 SG_ RFC_Loc147_Dr : 256|16@1+ (0.0078125,0) [0|511.9921875] "m"  DASy
 SG_ RFC_Loc147_Vr : 272|16@1+ (0.00390625,-128) [-128|127.99609375] "m/s"  DASy
 SG_ RFC_Loc147_Theta : 288|16@1+ (0.01,-327.68) [-90|90] "deg"  DASy
 SG_ RFC_Loc147_Phi : 304|16@1+ (0.01,-327.68) [-30|30] "deg"  DASy
 SG_ RFC_Loc147_DrVnce : 320|16@1+ (1.52588E-005,0) [0|0.999984741210937] "m^2"  DASy
 SG_ RFC_Loc147_VrVnce : 336|16@1+ (1.52588E-005,0) [0|0.999984741210937] "m^2/s^2"  DASy
 SG_ RFC_Loc147_ThetaVnce : 352|16@1+ (0.00390625,0) [0|255.99609375] "deg^2"  DASy
 SG_ RFC_Loc147_PhiVnce : 368|16@1+ (0.00390625,0) [0|255.99609375] "deg^2"  DASy
 SG_ RFC_Loc147_DrVrCoVnce : 384|16@1+ (3.814697265625E-006,-0.125) [-0.125|0.124996185302734] "m^2/s"  DASy
 SG_ RFC_Loc147_RCS : 400|16@1+ (0.00390625,-128) [-128|127.99609375] "dBsm"  DASy
 SG_ RFC_Loc147_RSSI : 416|16@1+ (0.00195312,0) [0|127.998046875] "dimensionless"  DASy
 SG_ RFC_Loc147_DrVrQuality : 432|8@1+ (1,0) [0|255] "dimensionless"  DASy
 SG_ RFC_Loc147_ThetaQuality : 440|8@1+ (1,0) [0|255] "dimensionless"  DASy
 SG_ RFC_Loc147_PhiQuality : 448|8@1+ (1,0) [0|255] "dimensionless"  DASy

BO_ 474 RFC_Location_148_149: 64 RadarFrontCenter
 SG_ RFC_Loc148_CRC : 0|16@1+ (1,0) [0|65535] ""  DASy
 SG_ RFC_Loc148_AliveCtr : 16|8@1+ (1,0) [0|255] ""  DASy
 SG_ RFC_Loc148_ProtBlockCtr : 24|8@1+ (1,0) [0|255] ""  DASy
 SG_ RFC_Loc148_Dr : 32|16@1+ (0.0078125,0) [0|511.9921875] "m"  DASy
 SG_ RFC_Loc148_Vr : 48|16@1+ (0.00390625,-128) [-128|127.99609375] "m/s"  DASy
 SG_ RFC_Loc148_Theta : 64|16@1+ (0.01,-327.68) [-90|90] "deg"  DASy
 SG_ RFC_Loc148_Phi : 80|16@1+ (0.01,-327.68) [-30|30] "deg"  DASy
 SG_ RFC_Loc148_DrVnce : 96|16@1+ (1.52588E-005,0) [0|0.999984741210937] "m^2"  DASy
 SG_ RFC_Loc148_VrVnce : 112|16@1+ (1.52588E-005,0) [0|0.999984741210937] "m^2/s^2"  DASy
 SG_ RFC_Loc148_ThetaVnce : 128|16@1+ (0.00390625,0) [0|255.99609375] "deg^2"  DASy
 SG_ RFC_Loc148_PhiVnce : 144|16@1+ (0.00390625,0) [0|255.99609375] "deg^2"  DASy
 SG_ RFC_Loc148_DrVrCoVnce : 160|16@1+ (3.814697265625E-006,-0.125) [-0.125|0.124996185302734] "m^2/s"  DASy
 SG_ RFC_Loc148_RCS : 176|16@1+ (0.00390625,-128) [-128|127.99609375] "dBsm"  DASy
 SG_ RFC_Loc148_RSSI : 192|16@1+ (0.00195312,0) [0|127.998046875] "dimensionless"  DASy
 SG_ RFC_Loc148_DrVrQuality : 208|8@1+ (1,0) [0|255] "dimensionless"  DASy
 SG_ RFC_Loc148_ThetaQuality : 216|8@1+ (1,0) [0|255] "dimensionless"  DASy
 SG_ RFC_Loc148_PhiQuality : 224|8@1+ (1,0) [0|255] "dimensionless"  DASy
 SG_ RFC_Loc149_Dr : 256|16@1+ (0.0078125,0) [0|511.9921875] "m"  DASy
 SG_ RFC_Loc149_Vr : 272|16@1+ (0.00390625,-128) [-128|127.99609375] "m/s"  DASy
 SG_ RFC_Loc149_Theta : 288|16@1+ (0.01,-327.68) [-90|90] "deg"  DASy
 SG_ RFC_Loc149_Phi : 304|16@1+ (0.01,-327.68) [-30|30] "deg"  DASy
 SG_ RFC_Loc149_DrVnce : 320|16@1+ (1.52588E-005,0) [0|0.999984741210937] "m^2"  DASy
 SG_ RFC_Loc149_VrVnce : 336|16@1+ (1.52588E-005,0) [0|0.999984741210937] "m^2/s^2"  DASy
 SG_ RFC_Loc149_ThetaVnce : 352|16@1+ (0.00390625,0) [0|255.99609375] "deg^2"  DASy
 SG_ RFC_Loc149_PhiVnce : 368|16@1+ (0.00390625,0) [0|255.99609375] "deg^2"  DASy
 SG_ RFC_Loc149_DrVrCoVnce : 384|16@1+ (3.814697265625E-006,-0.125) [-0.125|0.124996185302734] "m^2/s"  DASy
 SG_ RFC_Loc149_RCS : 400|16@1+ (0.00390625,-128) [-128|127.99609375] "dBsm"  DASy
 SG_ RFC_Loc149_RSSI : 416|16@1+ (0.00195312,0) [0|127.998046875] "dimensionless"  DASy
 SG_ RFC_Loc149_DrVrQuality : 432|8@1+ (1,0) [0|255] "dimensionless"  DASy
 SG_ RFC_Loc149_ThetaQuality : 440|8@1+ (1,0) [0|255] "dimensionless"  DASy
 SG_ RFC_Loc149_PhiQuality : 448|8@1+ (1,0) [0|255] "dimensionless"  DASy

BO_ 475 RFC_Location_150_151: 64 RadarFrontCenter
 SG_ RFC_Loc150_CRC : 0|16@1+ (1,0) [0|65535] ""  DASy
 SG_ RFC_Loc150_AliveCtr : 16|8@1+ (1,0) [0|255] ""  DASy
 SG_ RFC_Loc150_ProtBlockCtr : 24|8@1+ (1,0) [0|255] ""  DASy
 SG_ RFC_Loc150_Dr : 32|16@1+ (0.0078125,0) [0|511.9921875] "m"  DASy
 SG_ RFC_Loc150_Vr : 48|16@1+ (0.00390625,-128) [-128|127.99609375] "m/s"  DASy
 SG_ RFC_Loc150_Theta : 64|16@1+ (0.01,-327.68) [-90|90] "deg"  DASy
 SG_ RFC_Loc150_Phi : 80|16@1+ (0.01,-327.68) [-30|30] "deg"  DASy
 SG_ RFC_Loc150_DrVnce : 96|16@1+ (1.52588E-005,0) [0|0.999984741210937] "m^2"  DASy
 SG_ RFC_Loc150_VrVnce : 112|16@1+ (1.52588E-005,0) [0|0.999984741210937] "m^2/s^2"  DASy
 SG_ RFC_Loc150_ThetaVnce : 128|16@1+ (0.00390625,0) [0|255.99609375] "deg^2"  DASy
 SG_ RFC_Loc150_PhiVnce : 144|16@1+ (0.00390625,0) [0|255.99609375] "deg^2"  DASy
 SG_ RFC_Loc150_DrVrCoVnce : 160|16@1+ (3.814697265625E-006,-0.125) [-0.125|0.124996185302734] "m^2/s"  DASy
 SG_ RFC_Loc150_RCS : 176|16@1+ (0.00390625,-128) [-128|127.99609375] "dBsm"  DASy
 SG_ RFC_Loc150_RSSI : 192|16@1+ (0.00195312,0) [0|127.998046875] "dimensionless"  DASy
 SG_ RFC_Loc150_DrVrQuality : 208|8@1+ (1,0) [0|255] "dimensionless"  DASy
 SG_ RFC_Loc150_ThetaQuality : 216|8@1+ (1,0) [0|255] "dimensionless"  DASy
 SG_ RFC_Loc150_PhiQuality : 224|8@1+ (1,0) [0|255] "dimensionless"  DASy
 SG_ RFC_Loc151_Dr : 256|16@1+ (0.0078125,0) [0|511.9921875] "m"  DASy
 SG_ RFC_Loc151_Vr : 272|16@1+ (0.00390625,-128) [-128|127.99609375] "m/s"  DASy
 SG_ RFC_Loc151_Theta : 288|16@1+ (0.01,-327.68) [-90|90] "deg"  DASy
 SG_ RFC_Loc151_Phi : 304|16@1+ (0.01,-327.68) [-30|30] "deg"  DASy
 SG_ RFC_Loc151_DrVnce : 320|16@1+ (1.52588E-005,0) [0|0.999984741210937] "m^2"  DASy
 SG_ RFC_Loc151_VrVnce : 336|16@1+ (1.52588E-005,0) [0|0.999984741210937] "m^2/s^2"  DASy
 SG_ RFC_Loc151_ThetaVnce : 352|16@1+ (0.00390625,0) [0|255.99609375] "deg^2"  DASy
 SG_ RFC_Loc151_PhiVnce : 368|16@1+ (0.00390625,0) [0|255.99609375] "deg^2"  DASy
 SG_ RFC_Loc151_DrVrCoVnce : 384|16@1+ (3.814697265625E-006,-0.125) [-0.125|0.124996185302734] "m^2/s"  DASy
 SG_ RFC_Loc151_RCS : 400|16@1+ (0.00390625,-128) [-128|127.99609375] "dBsm"  DASy
 SG_ RFC_Loc151_RSSI : 416|16@1+ (0.00195312,0) [0|127.998046875] "dimensionless"  DASy
 SG_ RFC_Loc151_DrVrQuality : 432|8@1+ (1,0) [0|255] "dimensionless"  DASy
 SG_ RFC_Loc151_ThetaQuality : 440|8@1+ (1,0) [0|255] "dimensionless"  DASy
 SG_ RFC_Loc151_PhiQuality : 448|8@1+ (1,0) [0|255] "dimensionless"  DASy

BO_ 476 RFC_Location_152_153: 64 RadarFrontCenter
 SG_ RFC_Loc152_CRC : 0|16@1+ (1,0) [0|65535] ""  DASy
 SG_ RFC_Loc152_AliveCtr : 16|8@1+ (1,0) [0|255] ""  DASy
 SG_ RFC_Loc152_ProtBlockCtr : 24|8@1+ (1,0) [0|255] ""  DASy
 SG_ RFC_Loc152_Dr : 32|16@1+ (0.0078125,0) [0|511.9921875] "m"  DASy
 SG_ RFC_Loc152_Vr : 48|16@1+ (0.00390625,-128) [-128|127.99609375] "m/s"  DASy
 SG_ RFC_Loc152_Theta : 64|16@1+ (0.01,-327.68) [-90|90] "deg"  DASy
 SG_ RFC_Loc152_Phi : 80|16@1+ (0.01,-327.68) [-30|30] "deg"  DASy
 SG_ RFC_Loc152_DrVnce : 96|16@1+ (1.52588E-005,0) [0|0.999984741210937] "m^2"  DASy
 SG_ RFC_Loc152_VrVnce : 112|16@1+ (1.52588E-005,0) [0|0.999984741210937] "m^2/s^2"  DASy
 SG_ RFC_Loc152_ThetaVnce : 128|16@1+ (0.00390625,0) [0|255.99609375] "deg^2"  DASy
 SG_ RFC_Loc152_PhiVnce : 144|16@1+ (0.00390625,0) [0|255.99609375] "deg^2"  DASy
 SG_ RFC_Loc152_DrVrCoVnce : 160|16@1+ (3.814697265625E-006,-0.125) [-0.125|0.124996185302734] "m^2/s"  DASy
 SG_ RFC_Loc152_RCS : 176|16@1+ (0.00390625,-128) [-128|127.99609375] "dBsm"  DASy
 SG_ RFC_Loc152_RSSI : 192|16@1+ (0.00195312,0) [0|127.998046875] "dimensionless"  DASy
 SG_ RFC_Loc152_DrVrQuality : 208|8@1+ (1,0) [0|255] "dimensionless"  DASy
 SG_ RFC_Loc152_ThetaQuality : 216|8@1+ (1,0) [0|255] "dimensionless"  DASy
 SG_ RFC_Loc152_PhiQuality : 224|8@1+ (1,0) [0|255] "dimensionless"  DASy
 SG_ RFC_Loc153_Dr : 256|16@1+ (0.0078125,0) [0|511.9921875] "m"  DASy
 SG_ RFC_Loc153_Vr : 272|16@1+ (0.00390625,-128) [-128|127.99609375] "m/s"  DASy
 SG_ RFC_Loc153_Theta : 288|16@1+ (0.01,-327.68) [-90|90] "deg"  DASy
 SG_ RFC_Loc153_Phi : 304|16@1+ (0.01,-327.68) [-30|30] "deg"  DASy
 SG_ RFC_Loc153_DrVnce : 320|16@1+ (1.52588E-005,0) [0|0.999984741210937] "m^2"  DASy
 SG_ RFC_Loc153_VrVnce : 336|16@1+ (1.52588E-005,0) [0|0.999984741210937] "m^2/s^2"  DASy
 SG_ RFC_Loc153_ThetaVnce : 352|16@1+ (0.00390625,0) [0|255.99609375] "deg^2"  DASy
 SG_ RFC_Loc153_PhiVnce : 368|16@1+ (0.00390625,0) [0|255.99609375] "deg^2"  DASy
 SG_ RFC_Loc153_DrVrCoVnce : 384|16@1+ (3.814697265625E-006,-0.125) [-0.125|0.124996185302734] "m^2/s"  DASy
 SG_ RFC_Loc153_RCS : 400|16@1+ (0.00390625,-128) [-128|127.99609375] "dBsm"  DASy
 SG_ RFC_Loc153_RSSI : 416|16@1+ (0.00195312,0) [0|127.998046875] "dimensionless"  DASy
 SG_ RFC_Loc153_DrVrQuality : 432|8@1+ (1,0) [0|255] "dimensionless"  DASy
 SG_ RFC_Loc153_ThetaQuality : 440|8@1+ (1,0) [0|255] "dimensionless"  DASy
 SG_ RFC_Loc153_PhiQuality : 448|8@1+ (1,0) [0|255] "dimensionless"  DASy

BO_ 477 RFC_Location_154_155: 64 RadarFrontCenter
 SG_ RFC_Loc154_CRC : 0|16@1+ (1,0) [0|65535] ""  DASy
 SG_ RFC_Loc154_AliveCtr : 16|8@1+ (1,0) [0|255] ""  DASy
 SG_ RFC_Loc154_ProtBlockCtr : 24|8@1+ (1,0) [0|255] ""  DASy
 SG_ RFC_Loc154_Dr : 32|16@1+ (0.0078125,0) [0|511.9921875] "m"  DASy
 SG_ RFC_Loc154_Vr : 48|16@1+ (0.00390625,-128) [-128|127.99609375] "m/s"  DASy
 SG_ RFC_Loc154_Theta : 64|16@1+ (0.01,-327.68) [-90|90] "deg"  DASy
 SG_ RFC_Loc154_Phi : 80|16@1+ (0.01,-327.68) [-30|30] "deg"  DASy
 SG_ RFC_Loc154_DrVnce : 96|16@1+ (1.52588E-005,0) [0|0.999984741210937] "m^2"  DASy
 SG_ RFC_Loc154_VrVnce : 112|16@1+ (1.52588E-005,0) [0|0.999984741210937] "m^2/s^2"  DASy
 SG_ RFC_Loc154_ThetaVnce : 128|16@1+ (0.00390625,0) [0|255.99609375] "deg^2"  DASy
 SG_ RFC_Loc154_PhiVnce : 144|16@1+ (0.00390625,0) [0|255.99609375] "deg^2"  DASy
 SG_ RFC_Loc154_DrVrCoVnce : 160|16@1+ (3.814697265625E-006,-0.125) [-0.125|0.124996185302734] "m^2/s"  DASy
 SG_ RFC_Loc154_RCS : 176|16@1+ (0.00390625,-128) [-128|127.99609375] "dBsm"  DASy
 SG_ RFC_Loc154_RSSI : 192|16@1+ (0.00195312,0) [0|127.998046875] "dimensionless"  DASy
 SG_ RFC_Loc154_DrVrQuality : 208|8@1+ (1,0) [0|255] "dimensionless"  DASy
 SG_ RFC_Loc154_ThetaQuality : 216|8@1+ (1,0) [0|255] "dimensionless"  DASy
 SG_ RFC_Loc154_PhiQuality : 224|8@1+ (1,0) [0|255] "dimensionless"  DASy
 SG_ RFC_Loc155_Dr : 256|16@1+ (0.0078125,0) [0|511.9921875] "m"  DASy
 SG_ RFC_Loc155_Vr : 272|16@1+ (0.00390625,-128) [-128|127.99609375] "m/s"  DASy
 SG_ RFC_Loc155_Theta : 288|16@1+ (0.01,-327.68) [-90|90] "deg"  DASy
 SG_ RFC_Loc155_Phi : 304|16@1+ (0.01,-327.68) [-30|30] "deg"  DASy
 SG_ RFC_Loc155_DrVnce : 320|16@1+ (1.52588E-005,0) [0|0.999984741210937] "m^2"  DASy
 SG_ RFC_Loc155_VrVnce : 336|16@1+ (1.52588E-005,0) [0|0.999984741210937] "m^2/s^2"  DASy
 SG_ RFC_Loc155_ThetaVnce : 352|16@1+ (0.00390625,0) [0|255.99609375] "deg^2"  DASy
 SG_ RFC_Loc155_PhiVnce : 368|16@1+ (0.00390625,0) [0|255.99609375] "deg^2"  DASy
 SG_ RFC_Loc155_DrVrCoVnce : 384|16@1+ (3.814697265625E-006,-0.125) [-0.125|0.124996185302734] "m^2/s"  DASy
 SG_ RFC_Loc155_RCS : 400|16@1+ (0.00390625,-128) [-128|127.99609375] "dBsm"  DASy
 SG_ RFC_Loc155_RSSI : 416|16@1+ (0.00195312,0) [0|127.998046875] "dimensionless"  DASy
 SG_ RFC_Loc155_DrVrQuality : 432|8@1+ (1,0) [0|255] "dimensionless"  DASy
 SG_ RFC_Loc155_ThetaQuality : 440|8@1+ (1,0) [0|255] "dimensionless"  DASy
 SG_ RFC_Loc155_PhiQuality : 448|8@1+ (1,0) [0|255] "dimensionless"  DASy

BO_ 478 RFC_Location_156_157: 64 RadarFrontCenter
 SG_ RFC_Loc156_CRC : 0|16@1+ (1,0) [0|65535] ""  DASy
 SG_ RFC_Loc156_AliveCtr : 16|8@1+ (1,0) [0|255] ""  DASy
 SG_ RFC_Loc156_ProtBlockCtr : 24|8@1+ (1,0) [0|255] ""  DASy
 SG_ RFC_Loc156_Dr : 32|16@1+ (0.0078125,0) [0|511.9921875] "m"  DASy
 SG_ RFC_Loc156_Vr : 48|16@1+ (0.00390625,-128) [-128|127.99609375] "m/s"  DASy
 SG_ RFC_Loc156_Theta : 64|16@1+ (0.01,-327.68) [-90|90] "deg"  DASy
 SG_ RFC_Loc156_Phi : 80|16@1+ (0.01,-327.68) [-30|30] "deg"  DASy
 SG_ RFC_Loc156_DrVnce : 96|16@1+ (1.52588E-005,0) [0|0.999984741210937] "m^2"  DASy
 SG_ RFC_Loc156_VrVnce : 112|16@1+ (1.52588E-005,0) [0|0.999984741210937] "m^2/s^2"  DASy
 SG_ RFC_Loc156_ThetaVnce : 128|16@1+ (0.00390625,0) [0|255.99609375] "deg^2"  DASy
 SG_ RFC_Loc156_PhiVnce : 144|16@1+ (0.00390625,0) [0|255.99609375] "deg^2"  DASy
 SG_ RFC_Loc156_DrVrCoVnce : 160|16@1+ (3.814697265625E-006,-0.125) [-0.125|0.124996185302734] "m^2/s"  DASy
 SG_ RFC_Loc156_RCS : 176|16@1+ (0.00390625,-128) [-128|127.99609375] "dBsm"  DASy
 SG_ RFC_Loc156_RSSI : 192|16@1+ (0.00195312,0) [0|127.998046875] "dimensionless"  DASy
 SG_ RFC_Loc156_DrVrQuality : 208|8@1+ (1,0) [0|255] "dimensionless"  DASy
 SG_ RFC_Loc156_ThetaQuality : 216|8@1+ (1,0) [0|255] "dimensionless"  DASy
 SG_ RFC_Loc156_PhiQuality : 224|8@1+ (1,0) [0|255] "dimensionless"  DASy
 SG_ RFC_Loc157_Dr : 256|16@1+ (0.0078125,0) [0|511.9921875] "m"  DASy
 SG_ RFC_Loc157_Vr : 272|16@1+ (0.00390625,-128) [-128|127.99609375] "m/s"  DASy
 SG_ RFC_Loc157_Theta : 288|16@1+ (0.01,-327.68) [-90|90] "deg"  DASy
 SG_ RFC_Loc157_Phi : 304|16@1+ (0.01,-327.68) [-30|30] "deg"  DASy
 SG_ RFC_Loc157_DrVnce : 320|16@1+ (1.52588E-005,0) [0|0.999984741210937] "m^2"  DASy
 SG_ RFC_Loc157_VrVnce : 336|16@1+ (1.52588E-005,0) [0|0.999984741210937] "m^2/s^2"  DASy
 SG_ RFC_Loc157_ThetaVnce : 352|16@1+ (0.00390625,0) [0|255.99609375] "deg^2"  DASy
 SG_ RFC_Loc157_PhiVnce : 368|16@1+ (0.00390625,0) [0|255.99609375] "deg^2"  DASy
 SG_ RFC_Loc157_DrVrCoVnce : 384|16@1+ (3.814697265625E-006,-0.125) [-0.125|0.124996185302734] "m^2/s"  DASy
 SG_ RFC_Loc157_RCS : 400|16@1+ (0.00390625,-128) [-128|127.99609375] "dBsm"  DASy
 SG_ RFC_Loc157_RSSI : 416|16@1+ (0.00195312,0) [0|127.998046875] "dimensionless"  DASy
 SG_ RFC_Loc157_DrVrQuality : 432|8@1+ (1,0) [0|255] "dimensionless"  DASy
 SG_ RFC_Loc157_ThetaQuality : 440|8@1+ (1,0) [0|255] "dimensionless"  DASy
 SG_ RFC_Loc157_PhiQuality : 448|8@1+ (1,0) [0|255] "dimensionless"  DASy

BO_ 479 RFC_Location_158_159: 64 RadarFrontCenter
 SG_ RFC_Loc158_CRC : 0|16@1+ (1,0) [0|65535] ""  DASy
 SG_ RFC_Loc158_AliveCtr : 16|8@1+ (1,0) [0|255] ""  DASy
 SG_ RFC_Loc158_ProtBlockCtr : 24|8@1+ (1,0) [0|255] ""  DASy
 SG_ RFC_Loc158_Dr : 32|16@1+ (0.0078125,0) [0|511.9921875] "m"  DASy
 SG_ RFC_Loc158_Vr : 48|16@1+ (0.00390625,-128) [-128|127.99609375] "m/s"  DASy
 SG_ RFC_Loc158_Theta : 64|16@1+ (0.01,-327.68) [-90|90] "deg"  DASy
 SG_ RFC_Loc158_Phi : 80|16@1+ (0.01,-327.68) [-30|30] "deg"  DASy
 SG_ RFC_Loc158_DrVnce : 96|16@1+ (1.52588E-005,0) [0|0.999984741210937] "m^2"  DASy
 SG_ RFC_Loc158_VrVnce : 112|16@1+ (1.52588E-005,0) [0|0.999984741210937] "m^2/s^2"  DASy
 SG_ RFC_Loc158_ThetaVnce : 128|16@1+ (0.00390625,0) [0|255.99609375] "deg^2"  DASy
 SG_ RFC_Loc158_PhiVnce : 144|16@1+ (0.00390625,0) [0|255.99609375] "deg^2"  DASy
 SG_ RFC_Loc158_DrVrCoVnce : 160|16@1+ (3.814697265625E-006,-0.125) [-0.125|0.124996185302734] "m^2/s"  DASy
 SG_ RFC_Loc158_RCS : 176|16@1+ (0.00390625,-128) [-128|127.99609375] "dBsm"  DASy
 SG_ RFC_Loc158_RSSI : 192|16@1+ (0.00195312,0) [0|127.998046875] "dimensionless"  DASy
 SG_ RFC_Loc158_DrVrQuality : 208|8@1+ (1,0) [0|255] "dimensionless"  DASy
 SG_ RFC_Loc158_ThetaQuality : 216|8@1+ (1,0) [0|255] "dimensionless"  DASy
 SG_ RFC_Loc158_PhiQuality : 224|8@1+ (1,0) [0|255] "dimensionless"  DASy
 SG_ RFC_Loc159_Dr : 256|16@1+ (0.0078125,0) [0|511.9921875] "m"  DASy
 SG_ RFC_Loc159_Vr : 272|16@1+ (0.00390625,-128) [-128|127.99609375] "m/s"  DASy
 SG_ RFC_Loc159_Theta : 288|16@1+ (0.01,-327.68) [-90|90] "deg"  DASy
 SG_ RFC_Loc159_Phi : 304|16@1+ (0.01,-327.68) [-30|30] "deg"  DASy
 SG_ RFC_Loc159_DrVnce : 320|16@1+ (1.52588E-005,0) [0|0.999984741210937] "m^2"  DASy
 SG_ RFC_Loc159_VrVnce : 336|16@1+ (1.52588E-005,0) [0|0.999984741210937] "m^2/s^2"  DASy
 SG_ RFC_Loc159_ThetaVnce : 352|16@1+ (0.00390625,0) [0|255.99609375] "deg^2"  DASy
 SG_ RFC_Loc159_PhiVnce : 368|16@1+ (0.00390625,0) [0|255.99609375] "deg^2"  DASy
 SG_ RFC_Loc159_DrVrCoVnce : 384|16@1+ (3.814697265625E-006,-0.125) [-0.125|0.124996185302734] "m^2/s"  DASy
 SG_ RFC_Loc159_RCS : 400|16@1+ (0.00390625,-128) [-128|127.99609375] "dBsm"  DASy
 SG_ RFC_Loc159_RSSI : 416|16@1+ (0.00195312,0) [0|127.998046875] "dimensionless"  DASy
 SG_ RFC_Loc159_DrVrQuality : 432|8@1+ (1,0) [0|255] "dimensionless"  DASy
 SG_ RFC_Loc159_ThetaQuality : 440|8@1+ (1,0) [0|255] "dimensionless"  DASy
 SG_ RFC_Loc159_PhiQuality : 448|8@1+ (1,0) [0|255] "dimensionless"  DASy

BO_ 480 RFC_Location_160_161: 64 RadarFrontCenter
 SG_ RFC_Loc160_CRC : 0|16@1+ (1,0) [0|65535] ""  DASy
 SG_ RFC_Loc160_AliveCtr : 16|8@1+ (1,0) [0|255] ""  DASy
 SG_ RFC_Loc160_ProtBlockCtr : 24|8@1+ (1,0) [0|255] ""  DASy
 SG_ RFC_Loc160_Dr : 32|16@1+ (0.0078125,0) [0|511.9921875] "m"  DASy
 SG_ RFC_Loc160_Vr : 48|16@1+ (0.00390625,-128) [-128|127.99609375] "m/s"  DASy
 SG_ RFC_Loc160_Theta : 64|16@1+ (0.01,-327.68) [-90|90] "deg"  DASy
 SG_ RFC_Loc160_Phi : 80|16@1+ (0.01,-327.68) [-30|30] "deg"  DASy
 SG_ RFC_Loc160_DrVnce : 96|16@1+ (1.52588E-005,0) [0|0.999984741210937] "m^2"  DASy
 SG_ RFC_Loc160_VrVnce : 112|16@1+ (1.52588E-005,0) [0|0.999984741210937] "m^2/s^2"  DASy
 SG_ RFC_Loc160_ThetaVnce : 128|16@1+ (0.00390625,0) [0|255.99609375] "deg^2"  DASy
 SG_ RFC_Loc160_PhiVnce : 144|16@1+ (0.00390625,0) [0|255.99609375] "deg^2"  DASy
 SG_ RFC_Loc160_DrVrCoVnce : 160|16@1+ (3.814697265625E-006,-0.125) [-0.125|0.124996185302734] "m^2/s"  DASy
 SG_ RFC_Loc160_RCS : 176|16@1+ (0.00390625,-128) [-128|127.99609375] "dBsm"  DASy
 SG_ RFC_Loc160_RSSI : 192|16@1+ (0.00195312,0) [0|127.998046875] "dimensionless"  DASy
 SG_ RFC_Loc160_DrVrQuality : 208|8@1+ (1,0) [0|255] "dimensionless"  DASy
 SG_ RFC_Loc160_ThetaQuality : 216|8@1+ (1,0) [0|255] "dimensionless"  DASy
 SG_ RFC_Loc160_PhiQuality : 224|8@1+ (1,0) [0|255] "dimensionless"  DASy
 SG_ RFC_Loc161_Dr : 256|16@1+ (0.0078125,0) [0|511.9921875] "m"  DASy
 SG_ RFC_Loc161_Vr : 272|16@1+ (0.00390625,-128) [-128|127.99609375] "m/s"  DASy
 SG_ RFC_Loc161_Theta : 288|16@1+ (0.01,-327.68) [-90|90] "deg"  DASy
 SG_ RFC_Loc161_Phi : 304|16@1+ (0.01,-327.68) [-30|30] "deg"  DASy
 SG_ RFC_Loc161_DrVnce : 320|16@1+ (1.52588E-005,0) [0|0.999984741210937] "m^2"  DASy
 SG_ RFC_Loc161_VrVnce : 336|16@1+ (1.52588E-005,0) [0|0.999984741210937] "m^2/s^2"  DASy
 SG_ RFC_Loc161_ThetaVnce : 352|16@1+ (0.00390625,0) [0|255.99609375] "deg^2"  DASy
 SG_ RFC_Loc161_PhiVnce : 368|16@1+ (0.00390625,0) [0|255.99609375] "deg^2"  DASy
 SG_ RFC_Loc161_DrVrCoVnce : 384|16@1+ (3.814697265625E-006,-0.125) [-0.125|0.124996185302734] "m^2/s"  DASy
 SG_ RFC_Loc161_RCS : 400|16@1+ (0.00390625,-128) [-128|127.99609375] "dBsm"  DASy
 SG_ RFC_Loc161_RSSI : 416|16@1+ (0.00195312,0) [0|127.998046875] "dimensionless"  DASy
 SG_ RFC_Loc161_DrVrQuality : 432|8@1+ (1,0) [0|255] "dimensionless"  DASy
 SG_ RFC_Loc161_ThetaQuality : 440|8@1+ (1,0) [0|255] "dimensionless"  DASy
 SG_ RFC_Loc161_PhiQuality : 448|8@1+ (1,0) [0|255] "dimensionless"  DASy

BO_ 481 RFC_Location_162_163: 64 RadarFrontCenter
 SG_ RFC_Loc162_CRC : 0|16@1+ (1,0) [0|65535] ""  DASy
 SG_ RFC_Loc162_AliveCtr : 16|8@1+ (1,0) [0|255] ""  DASy
 SG_ RFC_Loc162_ProtBlockCtr : 24|8@1+ (1,0) [0|255] ""  DASy
 SG_ RFC_Loc162_Dr : 32|16@1+ (0.0078125,0) [0|511.9921875] "m"  DASy
 SG_ RFC_Loc162_Vr : 48|16@1+ (0.00390625,-128) [-128|127.99609375] "m/s"  DASy
 SG_ RFC_Loc162_Theta : 64|16@1+ (0.01,-327.68) [-90|90] "deg"  DASy
 SG_ RFC_Loc162_Phi : 80|16@1+ (0.01,-327.68) [-30|30] "deg"  DASy
 SG_ RFC_Loc162_DrVnce : 96|16@1+ (1.52588E-005,0) [0|0.999984741210937] "m^2"  DASy
 SG_ RFC_Loc162_VrVnce : 112|16@1+ (1.52588E-005,0) [0|0.999984741210937] "m^2/s^2"  DASy
 SG_ RFC_Loc162_ThetaVnce : 128|16@1+ (0.00390625,0) [0|255.99609375] "deg^2"  DASy
 SG_ RFC_Loc162_PhiVnce : 144|16@1+ (0.00390625,0) [0|255.99609375] "deg^2"  DASy
 SG_ RFC_Loc162_DrVrCoVnce : 160|16@1+ (3.814697265625E-006,-0.125) [-0.125|0.124996185302734] "m^2/s"  DASy
 SG_ RFC_Loc162_RCS : 176|16@1+ (0.00390625,-128) [-128|127.99609375] "dBsm"  DASy
 SG_ RFC_Loc162_RSSI : 192|16@1+ (0.00195312,0) [0|127.998046875] "dimensionless"  DASy
 SG_ RFC_Loc162_DrVrQuality : 208|8@1+ (1,0) [0|255] "dimensionless"  DASy
 SG_ RFC_Loc162_ThetaQuality : 216|8@1+ (1,0) [0|255] "dimensionless"  DASy
 SG_ RFC_Loc162_PhiQuality : 224|8@1+ (1,0) [0|255] "dimensionless"  DASy
 SG_ RFC_Loc163_Dr : 256|16@1+ (0.0078125,0) [0|511.9921875] "m"  DASy
 SG_ RFC_Loc163_Vr : 272|16@1+ (0.00390625,-128) [-128|127.99609375] "m/s"  DASy
 SG_ RFC_Loc163_Theta : 288|16@1+ (0.01,-327.68) [-90|90] "deg"  DASy
 SG_ RFC_Loc163_Phi : 304|16@1+ (0.01,-327.68) [-30|30] "deg"  DASy
 SG_ RFC_Loc163_DrVnce : 320|16@1+ (1.52588E-005,0) [0|0.999984741210937] "m^2"  DASy
 SG_ RFC_Loc163_VrVnce : 336|16@1+ (1.52588E-005,0) [0|0.999984741210937] "m^2/s^2"  DASy
 SG_ RFC_Loc163_ThetaVnce : 352|16@1+ (0.00390625,0) [0|255.99609375] "deg^2"  DASy
 SG_ RFC_Loc163_PhiVnce : 368|16@1+ (0.00390625,0) [0|255.99609375] "deg^2"  DASy
 SG_ RFC_Loc163_DrVrCoVnce : 384|16@1+ (3.814697265625E-006,-0.125) [-0.125|0.124996185302734] "m^2/s"  DASy
 SG_ RFC_Loc163_RCS : 400|16@1+ (0.00390625,-128) [-128|127.99609375] "dBsm"  DASy
 SG_ RFC_Loc163_RSSI : 416|16@1+ (0.00195312,0) [0|127.998046875] "dimensionless"  DASy
 SG_ RFC_Loc163_DrVrQuality : 432|8@1+ (1,0) [0|255] "dimensionless"  DASy
 SG_ RFC_Loc163_ThetaQuality : 440|8@1+ (1,0) [0|255] "dimensionless"  DASy
 SG_ RFC_Loc163_PhiQuality : 448|8@1+ (1,0) [0|255] "dimensionless"  DASy

BO_ 482 RFC_Location_164_165: 64 RadarFrontCenter
 SG_ RFC_Loc164_CRC : 0|16@1+ (1,0) [0|65535] ""  DASy
 SG_ RFC_Loc164_AliveCtr : 16|8@1+ (1,0) [0|255] ""  DASy
 SG_ RFC_Loc164_ProtBlockCtr : 24|8@1+ (1,0) [0|255] ""  DASy
 SG_ RFC_Loc164_Dr : 32|16@1+ (0.0078125,0) [0|511.9921875] "m"  DASy
 SG_ RFC_Loc164_Vr : 48|16@1+ (0.00390625,-128) [-128|127.99609375] "m/s"  DASy
 SG_ RFC_Loc164_Theta : 64|16@1+ (0.01,-327.68) [-90|90] "deg"  DASy
 SG_ RFC_Loc164_Phi : 80|16@1+ (0.01,-327.68) [-30|30] "deg"  DASy
 SG_ RFC_Loc164_DrVnce : 96|16@1+ (1.52588E-005,0) [0|0.999984741210937] "m^2"  DASy
 SG_ RFC_Loc164_VrVnce : 112|16@1+ (1.52588E-005,0) [0|0.999984741210937] "m^2/s^2"  DASy
 SG_ RFC_Loc164_ThetaVnce : 128|16@1+ (0.00390625,0) [0|255.99609375] "deg^2"  DASy
 SG_ RFC_Loc164_PhiVnce : 144|16@1+ (0.00390625,0) [0|255.99609375] "deg^2"  DASy
 SG_ RFC_Loc164_DrVrCoVnce : 160|16@1+ (3.814697265625E-006,-0.125) [-0.125|0.124996185302734] "m^2/s"  DASy
 SG_ RFC_Loc164_RCS : 176|16@1+ (0.00390625,-128) [-128|127.99609375] "dBsm"  DASy
 SG_ RFC_Loc164_RSSI : 192|16@1+ (0.00195312,0) [0|127.998046875] "dimensionless"  DASy
 SG_ RFC_Loc164_DrVrQuality : 208|8@1+ (1,0) [0|255] "dimensionless"  DASy
 SG_ RFC_Loc164_ThetaQuality : 216|8@1+ (1,0) [0|255] "dimensionless"  DASy
 SG_ RFC_Loc164_PhiQuality : 224|8@1+ (1,0) [0|255] "dimensionless"  DASy
 SG_ RFC_Loc165_Dr : 256|16@1+ (0.0078125,0) [0|511.9921875] "m"  DASy
 SG_ RFC_Loc165_Vr : 272|16@1+ (0.00390625,-128) [-128|127.99609375] "m/s"  DASy
 SG_ RFC_Loc165_Theta : 288|16@1+ (0.01,-327.68) [-90|90] "deg"  DASy
 SG_ RFC_Loc165_Phi : 304|16@1+ (0.01,-327.68) [-30|30] "deg"  DASy
 SG_ RFC_Loc165_DrVnce : 320|16@1+ (1.52588E-005,0) [0|0.999984741210937] "m^2"  DASy
 SG_ RFC_Loc165_VrVnce : 336|16@1+ (1.52588E-005,0) [0|0.999984741210937] "m^2/s^2"  DASy
 SG_ RFC_Loc165_ThetaVnce : 352|16@1+ (0.00390625,0) [0|255.99609375] "deg^2"  DASy
 SG_ RFC_Loc165_PhiVnce : 368|16@1+ (0.00390625,0) [0|255.99609375] "deg^2"  DASy
 SG_ RFC_Loc165_DrVrCoVnce : 384|16@1+ (3.814697265625E-006,-0.125) [-0.125|0.124996185302734] "m^2/s"  DASy
 SG_ RFC_Loc165_RCS : 400|16@1+ (0.00390625,-128) [-128|127.99609375] "dBsm"  DASy
 SG_ RFC_Loc165_RSSI : 416|16@1+ (0.00195312,0) [0|127.998046875] "dimensionless"  DASy
 SG_ RFC_Loc165_DrVrQuality : 432|8@1+ (1,0) [0|255] "dimensionless"  DASy
 SG_ RFC_Loc165_ThetaQuality : 440|8@1+ (1,0) [0|255] "dimensionless"  DASy
 SG_ RFC_Loc165_PhiQuality : 448|8@1+ (1,0) [0|255] "dimensionless"  DASy

BO_ 483 RFC_Location_166_167: 64 RadarFrontCenter
 SG_ RFC_Loc166_CRC : 0|16@1+ (1,0) [0|65535] ""  DASy
 SG_ RFC_Loc166_AliveCtr : 16|8@1+ (1,0) [0|255] ""  DASy
 SG_ RFC_Loc166_ProtBlockCtr : 24|8@1+ (1,0) [0|255] ""  DASy
 SG_ RFC_Loc166_Dr : 32|16@1+ (0.0078125,0) [0|511.9921875] "m"  DASy
 SG_ RFC_Loc166_Vr : 48|16@1+ (0.00390625,-128) [-128|127.99609375] "m/s"  DASy
 SG_ RFC_Loc166_Theta : 64|16@1+ (0.01,-327.68) [-90|90] "deg"  DASy
 SG_ RFC_Loc166_Phi : 80|16@1+ (0.01,-327.68) [-30|30] "deg"  DASy
 SG_ RFC_Loc166_DrVnce : 96|16@1+ (1.52588E-005,0) [0|0.999984741210937] "m^2"  DASy
 SG_ RFC_Loc166_VrVnce : 112|16@1+ (1.52588E-005,0) [0|0.999984741210937] "m^2/s^2"  DASy
 SG_ RFC_Loc166_ThetaVnce : 128|16@1+ (0.00390625,0) [0|255.99609375] "deg^2"  DASy
 SG_ RFC_Loc166_PhiVnce : 144|16@1+ (0.00390625,0) [0|255.99609375] "deg^2"  DASy
 SG_ RFC_Loc166_DrVrCoVnce : 160|16@1+ (3.814697265625E-006,-0.125) [-0.125|0.124996185302734] "m^2/s"  DASy
 SG_ RFC_Loc166_RCS : 176|16@1+ (0.00390625,-128) [-128|127.99609375] "dBsm"  DASy
 SG_ RFC_Loc166_RSSI : 192|16@1+ (0.00195312,0) [0|127.998046875] "dimensionless"  DASy
 SG_ RFC_Loc166_DrVrQuality : 208|8@1+ (1,0) [0|255] "dimensionless"  DASy
 SG_ RFC_Loc166_ThetaQuality : 216|8@1+ (1,0) [0|255] "dimensionless"  DASy
 SG_ RFC_Loc166_PhiQuality : 224|8@1+ (1,0) [0|255] "dimensionless"  DASy
 SG_ RFC_Loc167_Dr : 256|16@1+ (0.0078125,0) [0|511.9921875] "m"  DASy
 SG_ RFC_Loc167_Vr : 272|16@1+ (0.00390625,-128) [-128|127.99609375] "m/s"  DASy
 SG_ RFC_Loc167_Theta : 288|16@1+ (0.01,-327.68) [-90|90] "deg"  DASy
 SG_ RFC_Loc167_Phi : 304|16@1+ (0.01,-327.68) [-30|30] "deg"  DASy
 SG_ RFC_Loc167_DrVnce : 320|16@1+ (1.52588E-005,0) [0|0.999984741210937] "m^2"  DASy
 SG_ RFC_Loc167_VrVnce : 336|16@1+ (1.52588E-005,0) [0|0.999984741210937] "m^2/s^2"  DASy
 SG_ RFC_Loc167_ThetaVnce : 352|16@1+ (0.00390625,0) [0|255.99609375] "deg^2"  DASy
 SG_ RFC_Loc167_PhiVnce : 368|16@1+ (0.00390625,0) [0|255.99609375] "deg^2"  DASy
 SG_ RFC_Loc167_DrVrCoVnce : 384|16@1+ (3.814697265625E-006,-0.125) [-0.125|0.124996185302734] "m^2/s"  DASy
 SG_ RFC_Loc167_RCS : 400|16@1+ (0.00390625,-128) [-128|127.99609375] "dBsm"  DASy
 SG_ RFC_Loc167_RSSI : 416|16@1+ (0.00195312,0) [0|127.998046875] "dimensionless"  DASy
 SG_ RFC_Loc167_DrVrQuality : 432|8@1+ (1,0) [0|255] "dimensionless"  DASy
 SG_ RFC_Loc167_ThetaQuality : 440|8@1+ (1,0) [0|255] "dimensionless"  DASy
 SG_ RFC_Loc167_PhiQuality : 448|8@1+ (1,0) [0|255] "dimensionless"  DASy

BO_ 484 RFC_Location_168_169: 64 RadarFrontCenter
 SG_ RFC_Loc168_CRC : 0|16@1+ (1,0) [0|65535] ""  DASy
 SG_ RFC_Loc168_AliveCtr : 16|8@1+ (1,0) [0|255] ""  DASy
 SG_ RFC_Loc168_ProtBlockCtr : 24|8@1+ (1,0) [0|255] ""  DASy
 SG_ RFC_Loc168_Dr : 32|16@1+ (0.0078125,0) [0|511.9921875] "m"  DASy
 SG_ RFC_Loc168_Vr : 48|16@1+ (0.00390625,-128) [-128|127.99609375] "m/s"  DASy
 SG_ RFC_Loc168_Theta : 64|16@1+ (0.01,-327.68) [-90|90] "deg"  DASy
 SG_ RFC_Loc168_Phi : 80|16@1+ (0.01,-327.68) [-30|30] "deg"  DASy
 SG_ RFC_Loc168_DrVnce : 96|16@1+ (1.52588E-005,0) [0|0.999984741210937] "m^2"  DASy
 SG_ RFC_Loc168_VrVnce : 112|16@1+ (1.52588E-005,0) [0|0.999984741210937] "m^2/s^2"  DASy
 SG_ RFC_Loc168_ThetaVnce : 128|16@1+ (0.00390625,0) [0|255.99609375] "deg^2"  DASy
 SG_ RFC_Loc168_PhiVnce : 144|16@1+ (0.00390625,0) [0|255.99609375] "deg^2"  DASy
 SG_ RFC_Loc168_DrVrCoVnce : 160|16@1+ (3.814697265625E-006,-0.125) [-0.125|0.124996185302734] "m^2/s"  DASy
 SG_ RFC_Loc168_RCS : 176|16@1+ (0.00390625,-128) [-128|127.99609375] "dBsm"  DASy
 SG_ RFC_Loc168_RSSI : 192|16@1+ (0.00195312,0) [0|127.998046875] "dimensionless"  DASy
 SG_ RFC_Loc168_DrVrQuality : 208|8@1+ (1,0) [0|255] "dimensionless"  DASy
 SG_ RFC_Loc168_ThetaQuality : 216|8@1+ (1,0) [0|255] "dimensionless"  DASy
 SG_ RFC_Loc168_PhiQuality : 224|8@1+ (1,0) [0|255] "dimensionless"  DASy
 SG_ RFC_Loc169_Dr : 256|16@1+ (0.0078125,0) [0|511.9921875] "m"  DASy
 SG_ RFC_Loc169_Vr : 272|16@1+ (0.00390625,-128) [-128|127.99609375] "m/s"  DASy
 SG_ RFC_Loc169_Theta : 288|16@1+ (0.01,-327.68) [-90|90] "deg"  DASy
 SG_ RFC_Loc169_Phi : 304|16@1+ (0.01,-327.68) [-30|30] "deg"  DASy
 SG_ RFC_Loc169_DrVnce : 320|16@1+ (1.52588E-005,0) [0|0.999984741210937] "m^2"  DASy
 SG_ RFC_Loc169_VrVnce : 336|16@1+ (1.52588E-005,0) [0|0.999984741210937] "m^2/s^2"  DASy
 SG_ RFC_Loc169_ThetaVnce : 352|16@1+ (0.00390625,0) [0|255.99609375] "deg^2"  DASy
 SG_ RFC_Loc169_PhiVnce : 368|16@1+ (0.00390625,0) [0|255.99609375] "deg^2"  DASy
 SG_ RFC_Loc169_DrVrCoVnce : 384|16@1+ (3.814697265625E-006,-0.125) [-0.125|0.124996185302734] "m^2/s"  DASy
 SG_ RFC_Loc169_RCS : 400|16@1+ (0.00390625,-128) [-128|127.99609375] "dBsm"  DASy
 SG_ RFC_Loc169_RSSI : 416|16@1+ (0.00195312,0) [0|127.998046875] "dimensionless"  DASy
 SG_ RFC_Loc169_DrVrQuality : 432|8@1+ (1,0) [0|255] "dimensionless"  DASy
 SG_ RFC_Loc169_ThetaQuality : 440|8@1+ (1,0) [0|255] "dimensionless"  DASy
 SG_ RFC_Loc169_PhiQuality : 448|8@1+ (1,0) [0|255] "dimensionless"  DASy

CM_ SG_ 460 RFC_Loc120_CRC "CRC - Autosar E2E Profile 5, DataID = TBD";
CM_ SG_ 460 RFC_Loc120_AliveCtr "Alive counter - Autosar E2E Profile 5";
CM_ SG_ 460 RFC_Loc120_ProtBlockCtr "Protocol-Signal: Block-Counter";
CM_ SG_ 460 RFC_Loc120_Dr "Location radial distance";
CM_ SG_ 460 RFC_Loc120_Vr "Location radial relative velocity";
CM_ SG_ 460 RFC_Loc120_Theta "Location azimuth angle. \"Not a number\" TBD";
CM_ SG_ 460 RFC_Loc120_Phi "Location elevation angle. \"Not a number\" TBD";
CM_ SG_ 460 RFC_Loc120_DrVnce "Variance of Location radial distance";
CM_ SG_ 460 RFC_Loc120_VrVnce "Variance of Location radial relative velocity";
CM_ SG_ 460 RFC_Loc120_ThetaVnce "Variance of Location azimuth angle";
CM_ SG_ 460 RFC_Loc120_PhiVnce "Variance of Location elevation angle";
CM_ SG_ 460 RFC_Loc120_DrVrCoVnce "Covariance of Dr and Vr";
CM_ SG_ 460 RFC_Loc120_RCS "Radar Cross Section (RCS) estimation";
CM_ SG_ 460 RFC_Loc120_RSSI "Received Signal Strength Indication (RSSI)";
CM_ SG_ 460 RFC_Loc120_DrVrQuality "Quality of radial distance and velocity resolution processing. Physical range [0..1]";
CM_ SG_ 460 RFC_Loc120_ThetaQuality "Probability for correct signal model (azimuth angle). Physical range [0..1]";
CM_ SG_ 460 RFC_Loc120_PhiQuality "Probability for correct signal model (elevation angle). Physical range [0..1]";
CM_ SG_ 460 RFC_Loc121_Dr "Location radial distance";
CM_ SG_ 460 RFC_Loc121_Vr "Location radial relative velocity";
CM_ SG_ 460 RFC_Loc121_Theta "Location azimuth angle. \"Not a number\" TBD";
CM_ SG_ 460 RFC_Loc121_Phi "Location elevation angle. \"Not a number\" TBD";
CM_ SG_ 460 RFC_Loc121_DrVnce "Variance of Location radial distance";
CM_ SG_ 460 RFC_Loc121_VrVnce "Variance of Location radial relative velocity";
CM_ SG_ 460 RFC_Loc121_ThetaVnce "Variance of Location azimuth angle";
CM_ SG_ 460 RFC_Loc121_PhiVnce "Variance of Location elevation angle";
CM_ SG_ 460 RFC_Loc121_DrVrCoVnce "Covariance of Dr and Vr";
CM_ SG_ 460 RFC_Loc121_RCS "Radar Cross Section (RCS) estimation";
CM_ SG_ 460 RFC_Loc121_RSSI "Received Signal Strength Indication (RSSI)";
CM_ SG_ 460 RFC_Loc121_DrVrQuality "Quality of radial distance and velocity resolution processing. Physical range [0..1]";
CM_ SG_ 460 RFC_Loc121_ThetaQuality "Probability for correct signal model (azimuth angle). Physical range [0..1]";
CM_ SG_ 460 RFC_Loc121_PhiQuality "Probability for correct signal model (elevation angle). Physical range [0..1]";
CM_ SG_ 461 RFC_Loc122_CRC "CRC - Autosar E2E Profile 5, DataID = TBD";
CM_ SG_ 461 RFC_Loc122_AliveCtr "Alive counter - Autosar E2E Profile 5";
CM_ SG_ 461 RFC_Loc122_ProtBlockCtr "Protocol-Signal: Block-Counter";
CM_ SG_ 461 RFC_Loc122_Dr "Location radial distance";
CM_ SG_ 461 RFC_Loc122_Vr "Location radial relative velocity";
CM_ SG_ 461 RFC_Loc122_Theta "Location azimuth angle. \"Not a number\" TBD";
CM_ SG_ 461 RFC_Loc122_Phi "Location elevation angle. \"Not a number\" TBD";
CM_ SG_ 461 RFC_Loc122_DrVnce "Variance of Location radial distance";
CM_ SG_ 461 RFC_Loc122_VrVnce "Variance of Location radial relative velocity";
CM_ SG_ 461 RFC_Loc122_ThetaVnce "Variance of Location azimuth angle";
CM_ SG_ 461 RFC_Loc122_PhiVnce "Variance of Location elevation angle";
CM_ SG_ 461 RFC_Loc122_DrVrCoVnce "Covariance of Dr and Vr";
CM_ SG_ 461 RFC_Loc122_RCS "Radar Cross Section (RCS) estimation";
CM_ SG_ 461 RFC_Loc122_RSSI "Received Signal Strength Indication (RSSI)";
CM_ SG_ 461 RFC_Loc122_DrVrQuality "Quality of radial distance and velocity resolution processing. Physical range [0..1]";
CM_ SG_ 461 RFC_Loc122_ThetaQuality "Probability for correct signal model (azimuth angle). Physical range [0..1]";
CM_ SG_ 461 RFC_Loc122_PhiQuality "Probability for correct signal model (elevation angle). Physical range [0..1]";
CM_ SG_ 461 RFC_Loc123_Dr "Location radial distance";
CM_ SG_ 461 RFC_Loc123_Vr "Location radial relative velocity";
CM_ SG_ 461 RFC_Loc123_Theta "Location azimuth angle. \"Not a number\" TBD";
CM_ SG_ 461 RFC_Loc123_Phi "Location elevation angle. \"Not a number\" TBD";
CM_ SG_ 461 RFC_Loc123_DrVnce "Variance of Location radial distance";
CM_ SG_ 461 RFC_Loc123_VrVnce "Variance of Location radial relative velocity";
CM_ SG_ 461 RFC_Loc123_ThetaVnce "Variance of Location azimuth angle";
CM_ SG_ 461 RFC_Loc123_PhiVnce "Variance of Location elevation angle";
CM_ SG_ 461 RFC_Loc123_DrVrCoVnce "Covariance of Dr and Vr";
CM_ SG_ 461 RFC_Loc123_RCS "Radar Cross Section (RCS) estimation";
CM_ SG_ 461 RFC_Loc123_RSSI "Received Signal Strength Indication (RSSI)";
CM_ SG_ 461 RFC_Loc123_DrVrQuality "Quality of radial distance and velocity resolution processing. Physical range [0..1]";
CM_ SG_ 461 RFC_Loc123_ThetaQuality "Probability for correct signal model (azimuth angle). Physical range [0..1]";
CM_ SG_ 461 RFC_Loc123_PhiQuality "Probability for correct signal model (elevation angle). Physical range [0..1]";
CM_ SG_ 462 RFC_Loc124_CRC "CRC - Autosar E2E Profile 5, DataID = TBD";
CM_ SG_ 462 RFC_Loc124_AliveCtr "Alive counter - Autosar E2E Profile 5";
CM_ SG_ 462 RFC_Loc124_ProtBlockCtr "Protocol-Signal: Block-Counter";
CM_ SG_ 462 RFC_Loc124_Dr "Location radial distance";
CM_ SG_ 462 RFC_Loc124_Vr "Location radial relative velocity";
CM_ SG_ 462 RFC_Loc124_Theta "Location azimuth angle. \"Not a number\" TBD";
CM_ SG_ 462 RFC_Loc124_Phi "Location elevation angle. \"Not a number\" TBD";
CM_ SG_ 462 RFC_Loc124_DrVnce "Variance of Location radial distance";
CM_ SG_ 462 RFC_Loc124_VrVnce "Variance of Location radial relative velocity";
CM_ SG_ 462 RFC_Loc124_ThetaVnce "Variance of Location azimuth angle";
CM_ SG_ 462 RFC_Loc124_PhiVnce "Variance of Location elevation angle";
CM_ SG_ 462 RFC_Loc124_DrVrCoVnce "Covariance of Dr and Vr";
CM_ SG_ 462 RFC_Loc124_RCS "Radar Cross Section (RCS) estimation";
CM_ SG_ 462 RFC_Loc124_RSSI "Received Signal Strength Indication (RSSI)";
CM_ SG_ 462 RFC_Loc124_DrVrQuality "Quality of radial distance and velocity resolution processing. Physical range [0..1]";
CM_ SG_ 462 RFC_Loc124_ThetaQuality "Probability for correct signal model (azimuth angle). Physical range [0..1]";
CM_ SG_ 462 RFC_Loc124_PhiQuality "Probability for correct signal model (elevation angle). Physical range [0..1]";
CM_ SG_ 462 RFC_Loc125_Dr "Location radial distance";
CM_ SG_ 462 RFC_Loc125_Vr "Location radial relative velocity";
CM_ SG_ 462 RFC_Loc125_Theta "Location azimuth angle. \"Not a number\" TBD";
CM_ SG_ 462 RFC_Loc125_Phi "Location elevation angle. \"Not a number\" TBD";
CM_ SG_ 462 RFC_Loc125_DrVnce "Variance of Location radial distance";
CM_ SG_ 462 RFC_Loc125_VrVnce "Variance of Location radial relative velocity";
CM_ SG_ 462 RFC_Loc125_ThetaVnce "Variance of Location azimuth angle";
CM_ SG_ 462 RFC_Loc125_PhiVnce "Variance of Location elevation angle";
CM_ SG_ 462 RFC_Loc125_DrVrCoVnce "Covariance of Dr and Vr";
CM_ SG_ 462 RFC_Loc125_RCS "Radar Cross Section (RCS) estimation";
CM_ SG_ 462 RFC_Loc125_RSSI "Received Signal Strength Indication (RSSI)";
CM_ SG_ 462 RFC_Loc125_DrVrQuality "Quality of radial distance and velocity resolution processing. Physical range [0..1]";
CM_ SG_ 462 RFC_Loc125_ThetaQuality "Probability for correct signal model (azimuth angle). Physical range [0..1]";
CM_ SG_ 462 RFC_Loc125_PhiQuality "Probability for correct signal model (elevation angle). Physical range [0..1]";
CM_ SG_ 463 RFC_Loc126_CRC "CRC - Autosar E2E Profile 5, DataID = TBD";
CM_ SG_ 463 RFC_Loc126_AliveCtr "Alive counter - Autosar E2E Profile 5";
CM_ SG_ 463 RFC_Loc126_ProtBlockCtr "Protocol-Signal: Block-Counter";
CM_ SG_ 463 RFC_Loc126_Dr "Location radial distance";
CM_ SG_ 463 RFC_Loc126_Vr "Location radial relative velocity";
CM_ SG_ 463 RFC_Loc126_Theta "Location azimuth angle. \"Not a number\" TBD";
CM_ SG_ 463 RFC_Loc126_Phi "Location elevation angle. \"Not a number\" TBD";
CM_ SG_ 463 RFC_Loc126_DrVnce "Variance of Location radial distance";
CM_ SG_ 463 RFC_Loc126_VrVnce "Variance of Location radial relative velocity";
CM_ SG_ 463 RFC_Loc126_ThetaVnce "Variance of Location azimuth angle";
CM_ SG_ 463 RFC_Loc126_PhiVnce "Variance of Location elevation angle";
CM_ SG_ 463 RFC_Loc126_DrVrCoVnce "Covariance of Dr and Vr";
CM_ SG_ 463 RFC_Loc126_RCS "Radar Cross Section (RCS) estimation";
CM_ SG_ 463 RFC_Loc126_RSSI "Received Signal Strength Indication (RSSI)";
CM_ SG_ 463 RFC_Loc126_DrVrQuality "Quality of radial distance and velocity resolution processing. Physical range [0..1]";
CM_ SG_ 463 RFC_Loc126_ThetaQuality "Probability for correct signal model (azimuth angle). Physical range [0..1]";
CM_ SG_ 463 RFC_Loc126_PhiQuality "Probability for correct signal model (elevation angle). Physical range [0..1]";
CM_ SG_ 463 RFC_Loc127_Dr "Location radial distance";
CM_ SG_ 463 RFC_Loc127_Vr "Location radial relative velocity";
CM_ SG_ 463 RFC_Loc127_Theta "Location azimuth angle. \"Not a number\" TBD";
CM_ SG_ 463 RFC_Loc127_Phi "Location elevation angle. \"Not a number\" TBD";
CM_ SG_ 463 RFC_Loc127_DrVnce "Variance of Location radial distance";
CM_ SG_ 463 RFC_Loc127_VrVnce "Variance of Location radial relative velocity";
CM_ SG_ 463 RFC_Loc127_ThetaVnce "Variance of Location azimuth angle";
CM_ SG_ 463 RFC_Loc127_PhiVnce "Variance of Location elevation angle";
CM_ SG_ 463 RFC_Loc127_DrVrCoVnce "Covariance of Dr and Vr";
CM_ SG_ 463 RFC_Loc127_RCS "Radar Cross Section (RCS) estimation";
CM_ SG_ 463 RFC_Loc127_RSSI "Received Signal Strength Indication (RSSI)";
CM_ SG_ 463 RFC_Loc127_DrVrQuality "Quality of radial distance and velocity resolution processing. Physical range [0..1]";
CM_ SG_ 463 RFC_Loc127_ThetaQuality "Probability for correct signal model (azimuth angle). Physical range [0..1]";
CM_ SG_ 463 RFC_Loc127_PhiQuality "Probability for correct signal model (elevation angle). Physical range [0..1]";
CM_ SG_ 464 RFC_Loc128_CRC "CRC - Autosar E2E Profile 5, DataID = TBD";
CM_ SG_ 464 RFC_Loc128_AliveCtr "Alive counter - Autosar E2E Profile 5";
CM_ SG_ 464 RFC_Loc128_ProtBlockCtr "Protocol-Signal: Block-Counter";
CM_ SG_ 464 RFC_Loc128_Dr "Location radial distance";
CM_ SG_ 464 RFC_Loc128_Vr "Location radial relative velocity";
CM_ SG_ 464 RFC_Loc128_Theta "Location azimuth angle. \"Not a number\" TBD";
CM_ SG_ 464 RFC_Loc128_Phi "Location elevation angle. \"Not a number\" TBD";
CM_ SG_ 464 RFC_Loc128_DrVnce "Variance of Location radial distance";
CM_ SG_ 464 RFC_Loc128_VrVnce "Variance of Location radial relative velocity";
CM_ SG_ 464 RFC_Loc128_ThetaVnce "Variance of Location azimuth angle";
CM_ SG_ 464 RFC_Loc128_PhiVnce "Variance of Location elevation angle";
CM_ SG_ 464 RFC_Loc128_DrVrCoVnce "Covariance of Dr and Vr";
CM_ SG_ 464 RFC_Loc128_RCS "Radar Cross Section (RCS) estimation";
CM_ SG_ 464 RFC_Loc128_RSSI "Received Signal Strength Indication (RSSI)";
CM_ SG_ 464 RFC_Loc128_DrVrQuality "Quality of radial distance and velocity resolution processing. Physical range [0..1]";
CM_ SG_ 464 RFC_Loc128_ThetaQuality "Probability for correct signal model (azimuth angle). Physical range [0..1]";
CM_ SG_ 464 RFC_Loc128_PhiQuality "Probability for correct signal model (elevation angle). Physical range [0..1]";
CM_ SG_ 464 RFC_Loc129_Dr "Location radial distance";
CM_ SG_ 464 RFC_Loc129_Vr "Location radial relative velocity";
CM_ SG_ 464 RFC_Loc129_Theta "Location azimuth angle. \"Not a number\" TBD";
CM_ SG_ 464 RFC_Loc129_Phi "Location elevation angle. \"Not a number\" TBD";
CM_ SG_ 464 RFC_Loc129_DrVnce "Variance of Location radial distance";
CM_ SG_ 464 RFC_Loc129_VrVnce "Variance of Location radial relative velocity";
CM_ SG_ 464 RFC_Loc129_ThetaVnce "Variance of Location azimuth angle";
CM_ SG_ 464 RFC_Loc129_PhiVnce "Variance of Location elevation angle";
CM_ SG_ 464 RFC_Loc129_DrVrCoVnce "Covariance of Dr and Vr";
CM_ SG_ 464 RFC_Loc129_RCS "Radar Cross Section (RCS) estimation";
CM_ SG_ 464 RFC_Loc129_RSSI "Received Signal Strength Indication (RSSI)";
CM_ SG_ 464 RFC_Loc129_DrVrQuality "Quality of radial distance and velocity resolution processing. Physical range [0..1]";
CM_ SG_ 464 RFC_Loc129_ThetaQuality "Probability for correct signal model (azimuth angle). Physical range [0..1]";
CM_ SG_ 464 RFC_Loc129_PhiQuality "Probability for correct signal model (elevation angle). Physical range [0..1]";
CM_ SG_ 465 RFC_Loc130_CRC "CRC - Autosar E2E Profile 5, DataID = TBD";
CM_ SG_ 465 RFC_Loc130_AliveCtr "Alive counter - Autosar E2E Profile 5";
CM_ SG_ 465 RFC_Loc130_ProtBlockCtr "Protocol-Signal: Block-Counter";
CM_ SG_ 465 RFC_Loc130_Dr "Location radial distance";
CM_ SG_ 465 RFC_Loc130_Vr "Location radial relative velocity";
CM_ SG_ 465 RFC_Loc130_Theta "Location azimuth angle. \"Not a number\" TBD";
CM_ SG_ 465 RFC_Loc130_Phi "Location elevation angle. \"Not a number\" TBD";
CM_ SG_ 465 RFC_Loc130_DrVnce "Variance of Location radial distance";
CM_ SG_ 465 RFC_Loc130_VrVnce "Variance of Location radial relative velocity";
CM_ SG_ 465 RFC_Loc130_ThetaVnce "Variance of Location azimuth angle";
CM_ SG_ 465 RFC_Loc130_PhiVnce "Variance of Location elevation angle";
CM_ SG_ 465 RFC_Loc130_DrVrCoVnce "Covariance of Dr and Vr";
CM_ SG_ 465 RFC_Loc130_RCS "Radar Cross Section (RCS) estimation";
CM_ SG_ 465 RFC_Loc130_RSSI "Received Signal Strength Indication (RSSI)";
CM_ SG_ 465 RFC_Loc130_DrVrQuality "Quality of radial distance and velocity resolution processing. Physical range [0..1]";
CM_ SG_ 465 RFC_Loc130_ThetaQuality "Probability for correct signal model (azimuth angle). Physical range [0..1]";
CM_ SG_ 465 RFC_Loc130_PhiQuality "Probability for correct signal model (elevation angle). Physical range [0..1]";
CM_ SG_ 465 RFC_Loc131_Dr "Location radial distance";
CM_ SG_ 465 RFC_Loc131_Vr "Location radial relative velocity";
CM_ SG_ 465 RFC_Loc131_Theta "Location azimuth angle. \"Not a number\" TBD";
CM_ SG_ 465 RFC_Loc131_Phi "Location elevation angle. \"Not a number\" TBD";
CM_ SG_ 465 RFC_Loc131_DrVnce "Variance of Location radial distance";
CM_ SG_ 465 RFC_Loc131_VrVnce "Variance of Location radial relative velocity";
CM_ SG_ 465 RFC_Loc131_ThetaVnce "Variance of Location azimuth angle";
CM_ SG_ 465 RFC_Loc131_PhiVnce "Variance of Location elevation angle";
CM_ SG_ 465 RFC_Loc131_DrVrCoVnce "Covariance of Dr and Vr";
CM_ SG_ 465 RFC_Loc131_RCS "Radar Cross Section (RCS) estimation";
CM_ SG_ 465 RFC_Loc131_RSSI "Received Signal Strength Indication (RSSI)";
CM_ SG_ 465 RFC_Loc131_DrVrQuality "Quality of radial distance and velocity resolution processing. Physical range [0..1]";
CM_ SG_ 465 RFC_Loc131_ThetaQuality "Probability for correct signal model (azimuth angle). Physical range [0..1]";
CM_ SG_ 465 RFC_Loc131_PhiQuality "Probability for correct signal model (elevation angle). Physical range [0..1]";
CM_ SG_ 466 RFC_Loc132_CRC "CRC - Autosar E2E Profile 5, DataID = TBD";
CM_ SG_ 466 RFC_Loc132_AliveCtr "Alive counter - Autosar E2E Profile 5";
CM_ SG_ 466 RFC_Loc132_ProtBlockCtr "Protocol-Signal: Block-Counter";
CM_ SG_ 466 RFC_Loc132_Dr "Location radial distance";
CM_ SG_ 466 RFC_Loc132_Vr "Location radial relative velocity";
CM_ SG_ 466 RFC_Loc132_Theta "Location azimuth angle. \"Not a number\" TBD";
CM_ SG_ 466 RFC_Loc132_Phi "Location elevation angle. \"Not a number\" TBD";
CM_ SG_ 466 RFC_Loc132_DrVnce "Variance of Location radial distance";
CM_ SG_ 466 RFC_Loc132_VrVnce "Variance of Location radial relative velocity";
CM_ SG_ 466 RFC_Loc132_ThetaVnce "Variance of Location azimuth angle";
CM_ SG_ 466 RFC_Loc132_PhiVnce "Variance of Location elevation angle";
CM_ SG_ 466 RFC_Loc132_DrVrCoVnce "Covariance of Dr and Vr";
CM_ SG_ 466 RFC_Loc132_RCS "Radar Cross Section (RCS) estimation";
CM_ SG_ 466 RFC_Loc132_RSSI "Received Signal Strength Indication (RSSI)";
CM_ SG_ 466 RFC_Loc132_DrVrQuality "Quality of radial distance and velocity resolution processing. Physical range [0..1]";
CM_ SG_ 466 RFC_Loc132_ThetaQuality "Probability for correct signal model (azimuth angle). Physical range [0..1]";
CM_ SG_ 466 RFC_Loc132_PhiQuality "Probability for correct signal model (elevation angle). Physical range [0..1]";
CM_ SG_ 466 RFC_Loc133_Dr "Location radial distance";
CM_ SG_ 466 RFC_Loc133_Vr "Location radial relative velocity";
CM_ SG_ 466 RFC_Loc133_Theta "Location azimuth angle. \"Not a number\" TBD";
CM_ SG_ 466 RFC_Loc133_Phi "Location elevation angle. \"Not a number\" TBD";
CM_ SG_ 466 RFC_Loc133_DrVnce "Variance of Location radial distance";
CM_ SG_ 466 RFC_Loc133_VrVnce "Variance of Location radial relative velocity";
CM_ SG_ 466 RFC_Loc133_ThetaVnce "Variance of Location azimuth angle";
CM_ SG_ 466 RFC_Loc133_PhiVnce "Variance of Location elevation angle";
CM_ SG_ 466 RFC_Loc133_DrVrCoVnce "Covariance of Dr and Vr";
CM_ SG_ 466 RFC_Loc133_RCS "Radar Cross Section (RCS) estimation";
CM_ SG_ 466 RFC_Loc133_RSSI "Received Signal Strength Indication (RSSI)";
CM_ SG_ 466 RFC_Loc133_DrVrQuality "Quality of radial distance and velocity resolution processing. Physical range [0..1]";
CM_ SG_ 466 RFC_Loc133_ThetaQuality "Probability for correct signal model (azimuth angle). Physical range [0..1]";
CM_ SG_ 466 RFC_Loc133_PhiQuality "Probability for correct signal model (elevation angle). Physical range [0..1]";
CM_ SG_ 467 RFC_Loc134_CRC "CRC - Autosar E2E Profile 5, DataID = TBD";
CM_ SG_ 467 RFC_Loc134_AliveCtr "Alive counter - Autosar E2E Profile 5";
CM_ SG_ 467 RFC_Loc134_ProtBlockCtr "Protocol-Signal: Block-Counter";
CM_ SG_ 467 RFC_Loc134_Dr "Location radial distance";
CM_ SG_ 467 RFC_Loc134_Vr "Location radial relative velocity";
CM_ SG_ 467 RFC_Loc134_Theta "Location azimuth angle. \"Not a number\" TBD";
CM_ SG_ 467 RFC_Loc134_Phi "Location elevation angle. \"Not a number\" TBD";
CM_ SG_ 467 RFC_Loc134_DrVnce "Variance of Location radial distance";
CM_ SG_ 467 RFC_Loc134_VrVnce "Variance of Location radial relative velocity";
CM_ SG_ 467 RFC_Loc134_ThetaVnce "Variance of Location azimuth angle";
CM_ SG_ 467 RFC_Loc134_PhiVnce "Variance of Location elevation angle";
CM_ SG_ 467 RFC_Loc134_DrVrCoVnce "Covariance of Dr and Vr";
CM_ SG_ 467 RFC_Loc134_RCS "Radar Cross Section (RCS) estimation";
CM_ SG_ 467 RFC_Loc134_RSSI "Received Signal Strength Indication (RSSI)";
CM_ SG_ 467 RFC_Loc134_DrVrQuality "Quality of radial distance and velocity resolution processing. Physical range [0..1]";
CM_ SG_ 467 RFC_Loc134_ThetaQuality "Probability for correct signal model (azimuth angle). Physical range [0..1]";
CM_ SG_ 467 RFC_Loc134_PhiQuality "Probability for correct signal model (elevation angle). Physical range [0..1]";
CM_ SG_ 467 RFC_Loc135_Dr "Location radial distance";
CM_ SG_ 467 RFC_Loc135_Vr "Location radial relative velocity";
CM_ SG_ 467 RFC_Loc135_Theta "Location azimuth angle. \"Not a number\" TBD";
CM_ SG_ 467 RFC_Loc135_Phi "Location elevation angle. \"Not a number\" TBD";
CM_ SG_ 467 RFC_Loc135_DrVnce "Variance of Location radial distance";
CM_ SG_ 467 RFC_Loc135_VrVnce "Variance of Location radial relative velocity";
CM_ SG_ 467 RFC_Loc135_ThetaVnce "Variance of Location azimuth angle";
CM_ SG_ 467 RFC_Loc135_PhiVnce "Variance of Location elevation angle";
CM_ SG_ 467 RFC_Loc135_DrVrCoVnce "Covariance of Dr and Vr";
CM_ SG_ 467 RFC_Loc135_RCS "Radar Cross Section (RCS) estimation";
CM_ SG_ 467 RFC_Loc135_RSSI "Received Signal Strength Indication (RSSI)";
CM_ SG_ 467 RFC_Loc135_DrVrQuality "Quality of radial distance and velocity resolution processing. Physical range [0..1]";
CM_ SG_ 467 RFC_Loc135_ThetaQuality "Probability for correct signal model (azimuth angle). Physical range [0..1]";
CM_ SG_ 467 RFC_Loc135_PhiQuality "Probability for correct signal model (elevation angle). Physical range [0..1]";
CM_ SG_ 468 RFC_Loc136_CRC "CRC - Autosar E2E Profile 5, DataID = TBD";
CM_ SG_ 468 RFC_Loc136_AliveCtr "Alive counter - Autosar E2E Profile 5";
CM_ SG_ 468 RFC_Loc136_ProtBlockCtr "Protocol-Signal: Block-Counter";
CM_ SG_ 468 RFC_Loc136_Dr "Location radial distance";
CM_ SG_ 468 RFC_Loc136_Vr "Location radial relative velocity";
CM_ SG_ 468 RFC_Loc136_Theta "Location azimuth angle. \"Not a number\" TBD";
CM_ SG_ 468 RFC_Loc136_Phi "Location elevation angle. \"Not a number\" TBD";
CM_ SG_ 468 RFC_Loc136_DrVnce "Variance of Location radial distance";
CM_ SG_ 468 RFC_Loc136_VrVnce "Variance of Location radial relative velocity";
CM_ SG_ 468 RFC_Loc136_ThetaVnce "Variance of Location azimuth angle";
CM_ SG_ 468 RFC_Loc136_PhiVnce "Variance of Location elevation angle";
CM_ SG_ 468 RFC_Loc136_DrVrCoVnce "Covariance of Dr and Vr";
CM_ SG_ 468 RFC_Loc136_RCS "Radar Cross Section (RCS) estimation";
CM_ SG_ 468 RFC_Loc136_RSSI "Received Signal Strength Indication (RSSI)";
CM_ SG_ 468 RFC_Loc136_DrVrQuality "Quality of radial distance and velocity resolution processing. Physical range [0..1]";
CM_ SG_ 468 RFC_Loc136_ThetaQuality "Probability for correct signal model (azimuth angle). Physical range [0..1]";
CM_ SG_ 468 RFC_Loc136_PhiQuality "Probability for correct signal model (elevation angle). Physical range [0..1]";
CM_ SG_ 468 RFC_Loc137_Dr "Location radial distance";
CM_ SG_ 468 RFC_Loc137_Vr "Location radial relative velocity";
CM_ SG_ 468 RFC_Loc137_Theta "Location azimuth angle. \"Not a number\" TBD";
CM_ SG_ 468 RFC_Loc137_Phi "Location elevation angle. \"Not a number\" TBD";
CM_ SG_ 468 RFC_Loc137_DrVnce "Variance of Location radial distance";
CM_ SG_ 468 RFC_Loc137_VrVnce "Variance of Location radial relative velocity";
CM_ SG_ 468 RFC_Loc137_ThetaVnce "Variance of Location azimuth angle";
CM_ SG_ 468 RFC_Loc137_PhiVnce "Variance of Location elevation angle";
CM_ SG_ 468 RFC_Loc137_DrVrCoVnce "Covariance of Dr and Vr";
CM_ SG_ 468 RFC_Loc137_RCS "Radar Cross Section (RCS) estimation";
CM_ SG_ 468 RFC_Loc137_RSSI "Received Signal Strength Indication (RSSI)";
CM_ SG_ 468 RFC_Loc137_DrVrQuality "Quality of radial distance and velocity resolution processing. Physical range [0..1]";
CM_ SG_ 468 RFC_Loc137_ThetaQuality "Probability for correct signal model (azimuth angle). Physical range [0..1]";
CM_ SG_ 468 RFC_Loc137_PhiQuality "Probability for correct signal model (elevation angle). Physical range [0..1]";
CM_ SG_ 469 RFC_Loc138_CRC "CRC - Autosar E2E Profile 5, DataID = TBD";
CM_ SG_ 469 RFC_Loc138_AliveCtr "Alive counter - Autosar E2E Profile 5";
CM_ SG_ 469 RFC_Loc138_ProtBlockCtr "Protocol-Signal: Block-Counter";
CM_ SG_ 469 RFC_Loc138_Dr "Location radial distance";
CM_ SG_ 469 RFC_Loc138_Vr "Location radial relative velocity";
CM_ SG_ 469 RFC_Loc138_Theta "Location azimuth angle. \"Not a number\" TBD";
CM_ SG_ 469 RFC_Loc138_Phi "Location elevation angle. \"Not a number\" TBD";
CM_ SG_ 469 RFC_Loc138_DrVnce "Variance of Location radial distance";
CM_ SG_ 469 RFC_Loc138_VrVnce "Variance of Location radial relative velocity";
CM_ SG_ 469 RFC_Loc138_ThetaVnce "Variance of Location azimuth angle";
CM_ SG_ 469 RFC_Loc138_PhiVnce "Variance of Location elevation angle";
CM_ SG_ 469 RFC_Loc138_DrVrCoVnce "Covariance of Dr and Vr";
CM_ SG_ 469 RFC_Loc138_RCS "Radar Cross Section (RCS) estimation";
CM_ SG_ 469 RFC_Loc138_RSSI "Received Signal Strength Indication (RSSI)";
CM_ SG_ 469 RFC_Loc138_DrVrQuality "Quality of radial distance and velocity resolution processing. Physical range [0..1]";
CM_ SG_ 469 RFC_Loc138_ThetaQuality "Probability for correct signal model (azimuth angle). Physical range [0..1]";
CM_ SG_ 469 RFC_Loc138_PhiQuality "Probability for correct signal model (elevation angle). Physical range [0..1]";
CM_ SG_ 469 RFC_Loc139_Dr "Location radial distance";
CM_ SG_ 469 RFC_Loc139_Vr "Location radial relative velocity";
CM_ SG_ 469 RFC_Loc139_Theta "Location azimuth angle. \"Not a number\" TBD";
CM_ SG_ 469 RFC_Loc139_Phi "Location elevation angle. \"Not a number\" TBD";
CM_ SG_ 469 RFC_Loc139_DrVnce "Variance of Location radial distance";
CM_ SG_ 469 RFC_Loc139_VrVnce "Variance of Location radial relative velocity";
CM_ SG_ 469 RFC_Loc139_ThetaVnce "Variance of Location azimuth angle";
CM_ SG_ 469 RFC_Loc139_PhiVnce "Variance of Location elevation angle";
CM_ SG_ 469 RFC_Loc139_DrVrCoVnce "Covariance of Dr and Vr";
CM_ SG_ 469 RFC_Loc139_RCS "Radar Cross Section (RCS) estimation";
CM_ SG_ 469 RFC_Loc139_RSSI "Received Signal Strength Indication (RSSI)";
CM_ SG_ 469 RFC_Loc139_DrVrQuality "Quality of radial distance and velocity resolution processing. Physical range [0..1]";
CM_ SG_ 469 RFC_Loc139_ThetaQuality "Probability for correct signal model (azimuth angle). Physical range [0..1]";
CM_ SG_ 469 RFC_Loc139_PhiQuality "Probability for correct signal model (elevation angle). Physical range [0..1]";
CM_ SG_ 470 RFC_Loc140_CRC "CRC - Autosar E2E Profile 5, DataID = TBD";
CM_ SG_ 470 RFC_Loc140_AliveCtr "Alive counter - Autosar E2E Profile 5";
CM_ SG_ 470 RFC_Loc140_ProtBlockCtr "Protocol-Signal: Block-Counter";
CM_ SG_ 470 RFC_Loc140_Dr "Location radial distance";
CM_ SG_ 470 RFC_Loc140_Vr "Location radial relative velocity";
CM_ SG_ 470 RFC_Loc140_Theta "Location azimuth angle. \"Not a number\" TBD";
CM_ SG_ 470 RFC_Loc140_Phi "Location elevation angle. \"Not a number\" TBD";
CM_ SG_ 470 RFC_Loc140_DrVnce "Variance of Location radial distance";
CM_ SG_ 470 RFC_Loc140_VrVnce "Variance of Location radial relative velocity";
CM_ SG_ 470 RFC_Loc140_ThetaVnce "Variance of Location azimuth angle";
CM_ SG_ 470 RFC_Loc140_PhiVnce "Variance of Location elevation angle";
CM_ SG_ 470 RFC_Loc140_DrVrCoVnce "Covariance of Dr and Vr";
CM_ SG_ 470 RFC_Loc140_RCS "Radar Cross Section (RCS) estimation";
CM_ SG_ 470 RFC_Loc140_RSSI "Received Signal Strength Indication (RSSI)";
CM_ SG_ 470 RFC_Loc140_DrVrQuality "Quality of radial distance and velocity resolution processing. Physical range [0..1]";
CM_ SG_ 470 RFC_Loc140_ThetaQuality "Probability for correct signal model (azimuth angle). Physical range [0..1]";
CM_ SG_ 470 RFC_Loc140_PhiQuality "Probability for correct signal model (elevation angle). Physical range [0..1]";
CM_ SG_ 470 RFC_Loc141_Dr "Location radial distance";
CM_ SG_ 470 RFC_Loc141_Vr "Location radial relative velocity";
CM_ SG_ 470 RFC_Loc141_Theta "Location azimuth angle. \"Not a number\" TBD";
CM_ SG_ 470 RFC_Loc141_Phi "Location elevation angle. \"Not a number\" TBD";
CM_ SG_ 470 RFC_Loc141_DrVnce "Variance of Location radial distance";
CM_ SG_ 470 RFC_Loc141_VrVnce "Variance of Location radial relative velocity";
CM_ SG_ 470 RFC_Loc141_ThetaVnce "Variance of Location azimuth angle";
CM_ SG_ 470 RFC_Loc141_PhiVnce "Variance of Location elevation angle";
CM_ SG_ 470 RFC_Loc141_DrVrCoVnce "Covariance of Dr and Vr";
CM_ SG_ 470 RFC_Loc141_RCS "Radar Cross Section (RCS) estimation";
CM_ SG_ 470 RFC_Loc141_RSSI "Received Signal Strength Indication (RSSI)";
CM_ SG_ 470 RFC_Loc141_DrVrQuality "Quality of radial distance and velocity resolution processing. Physical range [0..1]";
CM_ SG_ 470 RFC_Loc141_ThetaQuality "Probability for correct signal model (azimuth angle). Physical range [0..1]";
CM_ SG_ 470 RFC_Loc141_PhiQuality "Probability for correct signal model (elevation angle). Physical range [0..1]";
CM_ SG_ 471 RFC_Loc142_CRC "CRC - Autosar E2E Profile 5, DataID = TBD";
CM_ SG_ 471 RFC_Loc142_AliveCtr "Alive counter - Autosar E2E Profile 5";
CM_ SG_ 471 RFC_Loc142_ProtBlockCtr "Protocol-Signal: Block-Counter";
CM_ SG_ 471 RFC_Loc142_Dr "Location radial distance";
CM_ SG_ 471 RFC_Loc142_Vr "Location radial relative velocity";
CM_ SG_ 471 RFC_Loc142_Theta "Location azimuth angle. \"Not a number\" TBD";
CM_ SG_ 471 RFC_Loc142_Phi "Location elevation angle. \"Not a number\" TBD";
CM_ SG_ 471 RFC_Loc142_DrVnce "Variance of Location radial distance";
CM_ SG_ 471 RFC_Loc142_VrVnce "Variance of Location radial relative velocity";
CM_ SG_ 471 RFC_Loc142_ThetaVnce "Variance of Location azimuth angle";
CM_ SG_ 471 RFC_Loc142_PhiVnce "Variance of Location elevation angle";
CM_ SG_ 471 RFC_Loc142_DrVrCoVnce "Covariance of Dr and Vr";
CM_ SG_ 471 RFC_Loc142_RCS "Radar Cross Section (RCS) estimation";
CM_ SG_ 471 RFC_Loc142_RSSI "Received Signal Strength Indication (RSSI)";
CM_ SG_ 471 RFC_Loc142_DrVrQuality "Quality of radial distance and velocity resolution processing. Physical range [0..1]";
CM_ SG_ 471 RFC_Loc142_ThetaQuality "Probability for correct signal model (azimuth angle). Physical range [0..1]";
CM_ SG_ 471 RFC_Loc142_PhiQuality "Probability for correct signal model (elevation angle). Physical range [0..1]";
CM_ SG_ 471 RFC_Loc143_Dr "Location radial distance";
CM_ SG_ 471 RFC_Loc143_Vr "Location radial relative velocity";
CM_ SG_ 471 RFC_Loc143_Theta "Location azimuth angle. \"Not a number\" TBD";
CM_ SG_ 471 RFC_Loc143_Phi "Location elevation angle. \"Not a number\" TBD";
CM_ SG_ 471 RFC_Loc143_DrVnce "Variance of Location radial distance";
CM_ SG_ 471 RFC_Loc143_VrVnce "Variance of Location radial relative velocity";
CM_ SG_ 471 RFC_Loc143_ThetaVnce "Variance of Location azimuth angle";
CM_ SG_ 471 RFC_Loc143_PhiVnce "Variance of Location elevation angle";
CM_ SG_ 471 RFC_Loc143_DrVrCoVnce "Covariance of Dr and Vr";
CM_ SG_ 471 RFC_Loc143_RCS "Radar Cross Section (RCS) estimation";
CM_ SG_ 471 RFC_Loc143_RSSI "Received Signal Strength Indication (RSSI)";
CM_ SG_ 471 RFC_Loc143_DrVrQuality "Quality of radial distance and velocity resolution processing. Physical range [0..1]";
CM_ SG_ 471 RFC_Loc143_ThetaQuality "Probability for correct signal model (azimuth angle). Physical range [0..1]";
CM_ SG_ 471 RFC_Loc143_PhiQuality "Probability for correct signal model (elevation angle). Physical range [0..1]";
CM_ SG_ 472 RFC_Loc144_CRC "CRC - Autosar E2E Profile 5, DataID = TBD";
CM_ SG_ 472 RFC_Loc144_AliveCtr "Alive counter - Autosar E2E Profile 5";
CM_ SG_ 472 RFC_Loc144_ProtBlockCtr "Protocol-Signal: Block-Counter";
CM_ SG_ 472 RFC_Loc144_Dr "Location radial distance";
CM_ SG_ 472 RFC_Loc144_Vr "Location radial relative velocity";
CM_ SG_ 472 RFC_Loc144_Theta "Location azimuth angle. \"Not a number\" TBD";
CM_ SG_ 472 RFC_Loc144_Phi "Location elevation angle. \"Not a number\" TBD";
CM_ SG_ 472 RFC_Loc144_DrVnce "Variance of Location radial distance";
CM_ SG_ 472 RFC_Loc144_VrVnce "Variance of Location radial relative velocity";
CM_ SG_ 472 RFC_Loc144_ThetaVnce "Variance of Location azimuth angle";
CM_ SG_ 472 RFC_Loc144_PhiVnce "Variance of Location elevation angle";
CM_ SG_ 472 RFC_Loc144_DrVrCoVnce "Covariance of Dr and Vr";
CM_ SG_ 472 RFC_Loc144_RCS "Radar Cross Section (RCS) estimation";
CM_ SG_ 472 RFC_Loc144_RSSI "Received Signal Strength Indication (RSSI)";
CM_ SG_ 472 RFC_Loc144_DrVrQuality "Quality of radial distance and velocity resolution processing. Physical range [0..1]";
CM_ SG_ 472 RFC_Loc144_ThetaQuality "Probability for correct signal model (azimuth angle). Physical range [0..1]";
CM_ SG_ 472 RFC_Loc144_PhiQuality "Probability for correct signal model (elevation angle). Physical range [0..1]";
CM_ SG_ 472 RFC_Loc145_Dr "Location radial distance";
CM_ SG_ 472 RFC_Loc145_Vr "Location radial relative velocity";
CM_ SG_ 472 RFC_Loc145_Theta "Location azimuth angle. \"Not a number\" TBD";
CM_ SG_ 472 RFC_Loc145_Phi "Location elevation angle. \"Not a number\" TBD";
CM_ SG_ 472 RFC_Loc145_DrVnce "Variance of Location radial distance";
CM_ SG_ 472 RFC_Loc145_VrVnce "Variance of Location radial relative velocity";
CM_ SG_ 472 RFC_Loc145_ThetaVnce "Variance of Location azimuth angle";
CM_ SG_ 472 RFC_Loc145_PhiVnce "Variance of Location elevation angle";
CM_ SG_ 472 RFC_Loc145_DrVrCoVnce "Covariance of Dr and Vr";
CM_ SG_ 472 RFC_Loc145_RCS "Radar Cross Section (RCS) estimation";
CM_ SG_ 472 RFC_Loc145_RSSI "Received Signal Strength Indication (RSSI)";
CM_ SG_ 472 RFC_Loc145_DrVrQuality "Quality of radial distance and velocity resolution processing. Physical range [0..1]";
CM_ SG_ 472 RFC_Loc145_ThetaQuality "Probability for correct signal model (azimuth angle). Physical range [0..1]";
CM_ SG_ 472 RFC_Loc145_PhiQuality "Probability for correct signal model (elevation angle). Physical range [0..1]";
CM_ SG_ 473 RFC_Loc146_CRC "CRC - Autosar E2E Profile 5, DataID = TBD";
CM_ SG_ 473 RFC_Loc146_AliveCtr "Alive counter - Autosar E2E Profile 5";
CM_ SG_ 473 RFC_Loc146_ProtBlockCtr "Protocol-Signal: Block-Counter";
CM_ SG_ 473 RFC_Loc146_Dr "Location radial distance";
CM_ SG_ 473 RFC_Loc146_Vr "Location radial relative velocity";
CM_ SG_ 473 RFC_Loc146_Theta "Location azimuth angle. \"Not a number\" TBD";
CM_ SG_ 473 RFC_Loc146_Phi "Location elevation angle. \"Not a number\" TBD";
CM_ SG_ 473 RFC_Loc146_DrVnce "Variance of Location radial distance";
CM_ SG_ 473 RFC_Loc146_VrVnce "Variance of Location radial relative velocity";
CM_ SG_ 473 RFC_Loc146_ThetaVnce "Variance of Location azimuth angle";
CM_ SG_ 473 RFC_Loc146_PhiVnce "Variance of Location elevation angle";
CM_ SG_ 473 RFC_Loc146_DrVrCoVnce "Covariance of Dr and Vr";
CM_ SG_ 473 RFC_Loc146_RCS "Radar Cross Section (RCS) estimation";
CM_ SG_ 473 RFC_Loc146_RSSI "Received Signal Strength Indication (RSSI)";
CM_ SG_ 473 RFC_Loc146_DrVrQuality "Quality of radial distance and velocity resolution processing. Physical range [0..1]";
CM_ SG_ 473 RFC_Loc146_ThetaQuality "Probability for correct signal model (azimuth angle). Physical range [0..1]";
CM_ SG_ 473 RFC_Loc146_PhiQuality "Probability for correct signal model (elevation angle). Physical range [0..1]";
CM_ SG_ 473 RFC_Loc147_Dr "Location radial distance";
CM_ SG_ 473 RFC_Loc147_Vr "Location radial relative velocity";
CM_ SG_ 473 RFC_Loc147_Theta "Location azimuth angle. \"Not a number\" TBD";
CM_ SG_ 473 RFC_Loc147_Phi "Location elevation angle. \"Not a number\" TBD";
CM_ SG_ 473 RFC_Loc147_DrVnce "Variance of Location radial distance";
CM_ SG_ 473 RFC_Loc147_VrVnce "Variance of Location radial relative velocity";
CM_ SG_ 473 RFC_Loc147_ThetaVnce "Variance of Location azimuth angle";
CM_ SG_ 473 RFC_Loc147_PhiVnce "Variance of Location elevation angle";
CM_ SG_ 473 RFC_Loc147_DrVrCoVnce "Covariance of Dr and Vr";
CM_ SG_ 473 RFC_Loc147_RCS "Radar Cross Section (RCS) estimation";
CM_ SG_ 473 RFC_Loc147_RSSI "Received Signal Strength Indication (RSSI)";
CM_ SG_ 473 RFC_Loc147_DrVrQuality "Quality of radial distance and velocity resolution processing. Physical range [0..1]";
CM_ SG_ 473 RFC_Loc147_ThetaQuality "Probability for correct signal model (azimuth angle). Physical range [0..1]";
CM_ SG_ 473 RFC_Loc147_PhiQuality "Probability for correct signal model (elevation angle). Physical range [0..1]";
CM_ SG_ 474 RFC_Loc148_CRC "CRC - Autosar E2E Profile 5, DataID = TBD";
CM_ SG_ 474 RFC_Loc148_AliveCtr "Alive counter - Autosar E2E Profile 5";
CM_ SG_ 474 RFC_Loc148_ProtBlockCtr "Protocol-Signal: Block-Counter";
CM_ SG_ 474 RFC_Loc148_Dr "Location radial distance";
CM_ SG_ 474 RFC_Loc148_Vr "Location radial relative velocity";
CM_ SG_ 474 RFC_Loc148_Theta "Location azimuth angle. \"Not a number\" TBD";
CM_ SG_ 474 RFC_Loc148_Phi "Location elevation angle. \"Not a number\" TBD";
CM_ SG_ 474 RFC_Loc148_DrVnce "Variance of Location radial distance";
CM_ SG_ 474 RFC_Loc148_VrVnce "Variance of Location radial relative velocity";
CM_ SG_ 474 RFC_Loc148_ThetaVnce "Variance of Location azimuth angle";
CM_ SG_ 474 RFC_Loc148_PhiVnce "Variance of Location elevation angle";
CM_ SG_ 474 RFC_Loc148_DrVrCoVnce "Covariance of Dr and Vr";
CM_ SG_ 474 RFC_Loc148_RCS "Radar Cross Section (RCS) estimation";
CM_ SG_ 474 RFC_Loc148_RSSI "Received Signal Strength Indication (RSSI)";
CM_ SG_ 474 RFC_Loc148_DrVrQuality "Quality of radial distance and velocity resolution processing. Physical range [0..1]";
CM_ SG_ 474 RFC_Loc148_ThetaQuality "Probability for correct signal model (azimuth angle). Physical range [0..1]";
CM_ SG_ 474 RFC_Loc148_PhiQuality "Probability for correct signal model (elevation angle). Physical range [0..1]";
CM_ SG_ 474 RFC_Loc149_Dr "Location radial distance";
CM_ SG_ 474 RFC_Loc149_Vr "Location radial relative velocity";
CM_ SG_ 474 RFC_Loc149_Theta "Location azimuth angle. \"Not a number\" TBD";
CM_ SG_ 474 RFC_Loc149_Phi "Location elevation angle. \"Not a number\" TBD";
CM_ SG_ 474 RFC_Loc149_DrVnce "Variance of Location radial distance";
CM_ SG_ 474 RFC_Loc149_VrVnce "Variance of Location radial relative velocity";
CM_ SG_ 474 RFC_Loc149_ThetaVnce "Variance of Location azimuth angle";
CM_ SG_ 474 RFC_Loc149_PhiVnce "Variance of Location elevation angle";
CM_ SG_ 474 RFC_Loc149_DrVrCoVnce "Covariance of Dr and Vr";
CM_ SG_ 474 RFC_Loc149_RCS "Radar Cross Section (RCS) estimation";
CM_ SG_ 474 RFC_Loc149_RSSI "Received Signal Strength Indication (RSSI)";
CM_ SG_ 474 RFC_Loc149_DrVrQuality "Quality of radial distance and velocity resolution processing. Physical range [0..1]";
CM_ SG_ 474 RFC_Loc149_ThetaQuality "Probability for correct signal model (azimuth angle). Physical range [0..1]";
CM_ SG_ 474 RFC_Loc149_PhiQuality "Probability for correct signal model (elevation angle). Physical range [0..1]";
CM_ SG_ 475 RFC_Loc150_CRC "CRC - Autosar E2E Profile 5, DataID = TBD";
CM_ SG_ 475 RFC_Loc150_AliveCtr "Alive counter - Autosar E2E Profile 5";
CM_ SG_ 475 RFC_Loc150_ProtBlockCtr "Protocol-Signal: Block-Counter";
CM_ SG_ 475 RFC_Loc150_Dr "Location radial distance";
CM_ SG_ 475 RFC_Loc150_Vr "Location radial relative velocity";
CM_ SG_ 475 RFC_Loc150_Theta "Location azimuth angle. \"Not a number\" TBD";
CM_ SG_ 475 RFC_Loc150_Phi "Location elevation angle. \"Not a number\" TBD";
CM_ SG_ 475 RFC_Loc150_DrVnce "Variance of Location radial distance";
CM_ SG_ 475 RFC_Loc150_VrVnce "Variance of Location radial relative velocity";
CM_ SG_ 475 RFC_Loc150_ThetaVnce "Variance of Location azimuth angle";
CM_ SG_ 475 RFC_Loc150_PhiVnce "Variance of Location elevation angle";
CM_ SG_ 475 RFC_Loc150_DrVrCoVnce "Covariance of Dr and Vr";
CM_ SG_ 475 RFC_Loc150_RCS "Radar Cross Section (RCS) estimation";
CM_ SG_ 475 RFC_Loc150_RSSI "Received Signal Strength Indication (RSSI)";
CM_ SG_ 475 RFC_Loc150_DrVrQuality "Quality of radial distance and velocity resolution processing. Physical range [0..1]";
CM_ SG_ 475 RFC_Loc150_ThetaQuality "Probability for correct signal model (azimuth angle). Physical range [0..1]";
CM_ SG_ 475 RFC_Loc150_PhiQuality "Probability for correct signal model (elevation angle). Physical range [0..1]";
CM_ SG_ 475 RFC_Loc151_Dr "Location radial distance";
CM_ SG_ 475 RFC_Loc151_Vr "Location radial relative velocity";
CM_ SG_ 475 RFC_Loc151_Theta "Location azimuth angle. \"Not a number\" TBD";
CM_ SG_ 475 RFC_Loc151_Phi "Location elevation angle. \"Not a number\" TBD";
CM_ SG_ 475 RFC_Loc151_DrVnce "Variance of Location radial distance";
CM_ SG_ 475 RFC_Loc151_VrVnce "Variance of Location radial relative velocity";
CM_ SG_ 475 RFC_Loc151_ThetaVnce "Variance of Location azimuth angle";
CM_ SG_ 475 RFC_Loc151_PhiVnce "Variance of Location elevation angle";
CM_ SG_ 475 RFC_Loc151_DrVrCoVnce "Covariance of Dr and Vr";
CM_ SG_ 475 RFC_Loc151_RCS "Radar Cross Section (RCS) estimation";
CM_ SG_ 475 RFC_Loc151_RSSI "Received Signal Strength Indication (RSSI)";
CM_ SG_ 475 RFC_Loc151_DrVrQuality "Quality of radial distance and velocity resolution processing. Physical range [0..1]";
CM_ SG_ 475 RFC_Loc151_ThetaQuality "Probability for correct signal model (azimuth angle). Physical range [0..1]";
CM_ SG_ 475 RFC_Loc151_PhiQuality "Probability for correct signal model (elevation angle). Physical range [0..1]";
CM_ SG_ 476 RFC_Loc152_CRC "CRC - Autosar E2E Profile 5, DataID = TBD";
CM_ SG_ 476 RFC_Loc152_AliveCtr "Alive counter - Autosar E2E Profile 5";
CM_ SG_ 476 RFC_Loc152_ProtBlockCtr "Protocol-Signal: Block-Counter";
CM_ SG_ 476 RFC_Loc152_Dr "Location radial distance";
CM_ SG_ 476 RFC_Loc152_Vr "Location radial relative velocity";
CM_ SG_ 476 RFC_Loc152_Theta "Location azimuth angle. \"Not a number\" TBD";
CM_ SG_ 476 RFC_Loc152_Phi "Location elevation angle. \"Not a number\" TBD";
CM_ SG_ 476 RFC_Loc152_DrVnce "Variance of Location radial distance";
CM_ SG_ 476 RFC_Loc152_VrVnce "Variance of Location radial relative velocity";
CM_ SG_ 476 RFC_Loc152_ThetaVnce "Variance of Location azimuth angle";
CM_ SG_ 476 RFC_Loc152_PhiVnce "Variance of Location elevation angle";
CM_ SG_ 476 RFC_Loc152_DrVrCoVnce "Covariance of Dr and Vr";
CM_ SG_ 476 RFC_Loc152_RCS "Radar Cross Section (RCS) estimation";
CM_ SG_ 476 RFC_Loc152_RSSI "Received Signal Strength Indication (RSSI)";
CM_ SG_ 476 RFC_Loc152_DrVrQuality "Quality of radial distance and velocity resolution processing. Physical range [0..1]";
CM_ SG_ 476 RFC_Loc152_ThetaQuality "Probability for correct signal model (azimuth angle). Physical range [0..1]";
CM_ SG_ 476 RFC_Loc152_PhiQuality "Probability for correct signal model (elevation angle). Physical range [0..1]";
CM_ SG_ 476 RFC_Loc153_Dr "Location radial distance";
CM_ SG_ 476 RFC_Loc153_Vr "Location radial relative velocity";
CM_ SG_ 476 RFC_Loc153_Theta "Location azimuth angle. \"Not a number\" TBD";
CM_ SG_ 476 RFC_Loc153_Phi "Location elevation angle. \"Not a number\" TBD";
CM_ SG_ 476 RFC_Loc153_DrVnce "Variance of Location radial distance";
CM_ SG_ 476 RFC_Loc153_VrVnce "Variance of Location radial relative velocity";
CM_ SG_ 476 RFC_Loc153_ThetaVnce "Variance of Location azimuth angle";
CM_ SG_ 476 RFC_Loc153_PhiVnce "Variance of Location elevation angle";
CM_ SG_ 476 RFC_Loc153_DrVrCoVnce "Covariance of Dr and Vr";
CM_ SG_ 476 RFC_Loc153_RCS "Radar Cross Section (RCS) estimation";
CM_ SG_ 476 RFC_Loc153_RSSI "Received Signal Strength Indication (RSSI)";
CM_ SG_ 476 RFC_Loc153_DrVrQuality "Quality of radial distance and velocity resolution processing. Physical range [0..1]";
CM_ SG_ 476 RFC_Loc153_ThetaQuality "Probability for correct signal model (azimuth angle). Physical range [0..1]";
CM_ SG_ 476 RFC_Loc153_PhiQuality "Probability for correct signal model (elevation angle). Physical range [0..1]";
CM_ SG_ 477 RFC_Loc154_CRC "CRC - Autosar E2E Profile 5, DataID = TBD";
CM_ SG_ 477 RFC_Loc154_AliveCtr "Alive counter - Autosar E2E Profile 5";
CM_ SG_ 477 RFC_Loc154_ProtBlockCtr "Protocol-Signal: Block-Counter";
CM_ SG_ 477 RFC_Loc154_Dr "Location radial distance";
CM_ SG_ 477 RFC_Loc154_Vr "Location radial relative velocity";
CM_ SG_ 477 RFC_Loc154_Theta "Location azimuth angle. \"Not a number\" TBD";
CM_ SG_ 477 RFC_Loc154_Phi "Location elevation angle. \"Not a number\" TBD";
CM_ SG_ 477 RFC_Loc154_DrVnce "Variance of Location radial distance";
CM_ SG_ 477 RFC_Loc154_VrVnce "Variance of Location radial relative velocity";
CM_ SG_ 477 RFC_Loc154_ThetaVnce "Variance of Location azimuth angle";
CM_ SG_ 477 RFC_Loc154_PhiVnce "Variance of Location elevation angle";
CM_ SG_ 477 RFC_Loc154_DrVrCoVnce "Covariance of Dr and Vr";
CM_ SG_ 477 RFC_Loc154_RCS "Radar Cross Section (RCS) estimation";
CM_ SG_ 477 RFC_Loc154_RSSI "Received Signal Strength Indication (RSSI)";
CM_ SG_ 477 RFC_Loc154_DrVrQuality "Quality of radial distance and velocity resolution processing. Physical range [0..1]";
CM_ SG_ 477 RFC_Loc154_ThetaQuality "Probability for correct signal model (azimuth angle). Physical range [0..1]";
CM_ SG_ 477 RFC_Loc154_PhiQuality "Probability for correct signal model (elevation angle). Physical range [0..1]";
CM_ SG_ 477 RFC_Loc155_Dr "Location radial distance";
CM_ SG_ 477 RFC_Loc155_Vr "Location radial relative velocity";
CM_ SG_ 477 RFC_Loc155_Theta "Location azimuth angle. \"Not a number\" TBD";
CM_ SG_ 477 RFC_Loc155_Phi "Location elevation angle. \"Not a number\" TBD";
CM_ SG_ 477 RFC_Loc155_DrVnce "Variance of Location radial distance";
CM_ SG_ 477 RFC_Loc155_VrVnce "Variance of Location radial relative velocity";
CM_ SG_ 477 RFC_Loc155_ThetaVnce "Variance of Location azimuth angle";
CM_ SG_ 477 RFC_Loc155_PhiVnce "Variance of Location elevation angle";
CM_ SG_ 477 RFC_Loc155_DrVrCoVnce "Covariance of Dr and Vr";
CM_ SG_ 477 RFC_Loc155_RCS "Radar Cross Section (RCS) estimation";
CM_ SG_ 477 RFC_Loc155_RSSI "Received Signal Strength Indication (RSSI)";
CM_ SG_ 477 RFC_Loc155_DrVrQuality "Quality of radial distance and velocity resolution processing. Physical range [0..1]";
CM_ SG_ 477 RFC_Loc155_ThetaQuality "Probability for correct signal model (azimuth angle). Physical range [0..1]";
CM_ SG_ 477 RFC_Loc155_PhiQuality "Probability for correct signal model (elevation angle). Physical range [0..1]";
CM_ SG_ 478 RFC_Loc156_CRC "CRC - Autosar E2E Profile 5, DataID = TBD";
CM_ SG_ 478 RFC_Loc156_AliveCtr "Alive counter - Autosar E2E Profile 5";
CM_ SG_ 478 RFC_Loc156_ProtBlockCtr "Protocol-Signal: Block-Counter";
CM_ SG_ 478 RFC_Loc156_Dr "Location radial distance";
CM_ SG_ 478 RFC_Loc156_Vr "Location radial relative velocity";
CM_ SG_ 478 RFC_Loc156_Theta "Location azimuth angle. \"Not a number\" TBD";
CM_ SG_ 478 RFC_Loc156_Phi "Location elevation angle. \"Not a number\" TBD";
CM_ SG_ 478 RFC_Loc156_DrVnce "Variance of Location radial distance";
CM_ SG_ 478 RFC_Loc156_VrVnce "Variance of Location radial relative velocity";
CM_ SG_ 478 RFC_Loc156_ThetaVnce "Variance of Location azimuth angle";
CM_ SG_ 478 RFC_Loc156_PhiVnce "Variance of Location elevation angle";
CM_ SG_ 478 RFC_Loc156_DrVrCoVnce "Covariance of Dr and Vr";
CM_ SG_ 478 RFC_Loc156_RCS "Radar Cross Section (RCS) estimation";
CM_ SG_ 478 RFC_Loc156_RSSI "Received Signal Strength Indication (RSSI)";
CM_ SG_ 478 RFC_Loc156_DrVrQuality "Quality of radial distance and velocity resolution processing. Physical range [0..1]";
CM_ SG_ 478 RFC_Loc156_ThetaQuality "Probability for correct signal model (azimuth angle). Physical range [0..1]";
CM_ SG_ 478 RFC_Loc156_PhiQuality "Probability for correct signal model (elevation angle). Physical range [0..1]";
CM_ SG_ 478 RFC_Loc157_Dr "Location radial distance";
CM_ SG_ 478 RFC_Loc157_Vr "Location radial relative velocity";
CM_ SG_ 478 RFC_Loc157_Theta "Location azimuth angle. \"Not a number\" TBD";
CM_ SG_ 478 RFC_Loc157_Phi "Location elevation angle. \"Not a number\" TBD";
CM_ SG_ 478 RFC_Loc157_DrVnce "Variance of Location radial distance";
CM_ SG_ 478 RFC_Loc157_VrVnce "Variance of Location radial relative velocity";
CM_ SG_ 478 RFC_Loc157_ThetaVnce "Variance of Location azimuth angle";
CM_ SG_ 478 RFC_Loc157_PhiVnce "Variance of Location elevation angle";
CM_ SG_ 478 RFC_Loc157_DrVrCoVnce "Covariance of Dr and Vr";
CM_ SG_ 478 RFC_Loc157_RCS "Radar Cross Section (RCS) estimation";
CM_ SG_ 478 RFC_Loc157_RSSI "Received Signal Strength Indication (RSSI)";
CM_ SG_ 478 RFC_Loc157_DrVrQuality "Quality of radial distance and velocity resolution processing. Physical range [0..1]";
CM_ SG_ 478 RFC_Loc157_ThetaQuality "Probability for correct signal model (azimuth angle). Physical range [0..1]";
CM_ SG_ 478 RFC_Loc157_PhiQuality "Probability for correct signal model (elevation angle). Physical range [0..1]";
CM_ SG_ 479 RFC_Loc158_CRC "CRC - Autosar E2E Profile 5, DataID = TBD";
CM_ SG_ 479 RFC_Loc158_AliveCtr "Alive counter - Autosar E2E Profile 5";
CM_ SG_ 479 RFC_Loc158_ProtBlockCtr "Protocol-Signal: Block-Counter";
CM_ SG_ 479 RFC_Loc158_Dr "Location radial distance";
CM_ SG_ 479 RFC_Loc158_Vr "Location radial relative velocity";
CM_ SG_ 479 RFC_Loc158_Theta "Location azimuth angle. \"Not a number\" TBD";
CM_ SG_ 479 RFC_Loc158_Phi "Location elevation angle. \"Not a number\" TBD";
CM_ SG_ 479 RFC_Loc158_DrVnce "Variance of Location radial distance";
CM_ SG_ 479 RFC_Loc158_VrVnce "Variance of Location radial relative velocity";
CM_ SG_ 479 RFC_Loc158_ThetaVnce "Variance of Location azimuth angle";
CM_ SG_ 479 RFC_Loc158_PhiVnce "Variance of Location elevation angle";
CM_ SG_ 479 RFC_Loc158_DrVrCoVnce "Covariance of Dr and Vr";
CM_ SG_ 479 RFC_Loc158_RCS "Radar Cross Section (RCS) estimation";
CM_ SG_ 479 RFC_Loc158_RSSI "Received Signal Strength Indication (RSSI)";
CM_ SG_ 479 RFC_Loc158_DrVrQuality "Quality of radial distance and velocity resolution processing. Physical range [0..1]";
CM_ SG_ 479 RFC_Loc158_ThetaQuality "Probability for correct signal model (azimuth angle). Physical range [0..1]";
CM_ SG_ 479 RFC_Loc158_PhiQuality "Probability for correct signal model (elevation angle). Physical range [0..1]";
CM_ SG_ 479 RFC_Loc159_Dr "Location radial distance";
CM_ SG_ 479 RFC_Loc159_Vr "Location radial relative velocity";
CM_ SG_ 479 RFC_Loc159_Theta "Location azimuth angle. \"Not a number\" TBD";
CM_ SG_ 479 RFC_Loc159_Phi "Location elevation angle. \"Not a number\" TBD";
CM_ SG_ 479 RFC_Loc159_DrVnce "Variance of Location radial distance";
CM_ SG_ 479 RFC_Loc159_VrVnce "Variance of Location radial relative velocity";
CM_ SG_ 479 RFC_Loc159_ThetaVnce "Variance of Location azimuth angle";
CM_ SG_ 479 RFC_Loc159_PhiVnce "Variance of Location elevation angle";
CM_ SG_ 479 RFC_Loc159_DrVrCoVnce "Covariance of Dr and Vr";
CM_ SG_ 479 RFC_Loc159_RCS "Radar Cross Section (RCS) estimation";
CM_ SG_ 479 RFC_Loc159_RSSI "Received Signal Strength Indication (RSSI)";
CM_ SG_ 479 RFC_Loc159_DrVrQuality "Quality of radial distance and velocity resolution processing. Physical range [0..1]";
CM_ SG_ 479 RFC_Loc159_ThetaQuality "Probability for correct signal model (azimuth angle). Physical range [0..1]";
CM_ SG_ 479 RFC_Loc159_PhiQuality "Probability for correct signal model (elevation angle). Physical range [0..1]";
CM_ SG_ 480 RFC_Loc160_CRC "CRC - Autosar E2E Profile 5, DataID = TBD";
CM_ SG_ 480 RFC_Loc160_AliveCtr "Alive counter - Autosar E2E Profile 5";
CM_ SG_ 480 RFC_Loc160_ProtBlockCtr "Protocol-Signal: Block-Counter";
CM_ SG_ 480 RFC_Loc160_Dr "Location radial distance";
CM_ SG_ 480 RFC_Loc160_Vr "Location radial relative velocity";
CM_ SG_ 480 RFC_Loc160_Theta "Location azimuth angle. \"Not a number\" TBD";
CM_ SG_ 480 RFC_Loc160_Phi "Location elevation angle. \"Not a number\" TBD";
CM_ SG_ 480 RFC_Loc160_DrVnce "Variance of Location radial distance";
CM_ SG_ 480 RFC_Loc160_VrVnce "Variance of Location radial relative velocity";
CM_ SG_ 480 RFC_Loc160_ThetaVnce "Variance of Location azimuth angle";
CM_ SG_ 480 RFC_Loc160_PhiVnce "Variance of Location elevation angle";
CM_ SG_ 480 RFC_Loc160_DrVrCoVnce "Covariance of Dr and Vr";
CM_ SG_ 480 RFC_Loc160_RCS "Radar Cross Section (RCS) estimation";
CM_ SG_ 480 RFC_Loc160_RSSI "Received Signal Strength Indication (RSSI)";
CM_ SG_ 480 RFC_Loc160_DrVrQuality "Quality of radial distance and velocity resolution processing. Physical range [0..1]";
CM_ SG_ 480 RFC_Loc160_ThetaQuality "Probability for correct signal model (azimuth angle). Physical range [0..1]";
CM_ SG_ 480 RFC_Loc160_PhiQuality "Probability for correct signal model (elevation angle). Physical range [0..1]";
CM_ SG_ 480 RFC_Loc161_Dr "Location radial distance";
CM_ SG_ 480 RFC_Loc161_Vr "Location radial relative velocity";
CM_ SG_ 480 RFC_Loc161_Theta "Location azimuth angle. \"Not a number\" TBD";
CM_ SG_ 480 RFC_Loc161_Phi "Location elevation angle. \"Not a number\" TBD";
CM_ SG_ 480 RFC_Loc161_DrVnce "Variance of Location radial distance";
CM_ SG_ 480 RFC_Loc161_VrVnce "Variance of Location radial relative velocity";
CM_ SG_ 480 RFC_Loc161_ThetaVnce "Variance of Location azimuth angle";
CM_ SG_ 480 RFC_Loc161_PhiVnce "Variance of Location elevation angle";
CM_ SG_ 480 RFC_Loc161_DrVrCoVnce "Covariance of Dr and Vr";
CM_ SG_ 480 RFC_Loc161_RCS "Radar Cross Section (RCS) estimation";
CM_ SG_ 480 RFC_Loc161_RSSI "Received Signal Strength Indication (RSSI)";
CM_ SG_ 480 RFC_Loc161_DrVrQuality "Quality of radial distance and velocity resolution processing. Physical range [0..1]";
CM_ SG_ 480 RFC_Loc161_ThetaQuality "Probability for correct signal model (azimuth angle). Physical range [0..1]";
CM_ SG_ 480 RFC_Loc161_PhiQuality "Probability for correct signal model (elevation angle). Physical range [0..1]";
CM_ SG_ 481 RFC_Loc162_CRC "CRC - Autosar E2E Profile 5, DataID = TBD";
CM_ SG_ 481 RFC_Loc162_AliveCtr "Alive counter - Autosar E2E Profile 5";
CM_ SG_ 481 RFC_Loc162_ProtBlockCtr "Protocol-Signal: Block-Counter";
CM_ SG_ 481 RFC_Loc162_Dr "Location radial distance";
CM_ SG_ 481 RFC_Loc162_Vr "Location radial relative velocity";
CM_ SG_ 481 RFC_Loc162_Theta "Location azimuth angle. \"Not a number\" TBD";
CM_ SG_ 481 RFC_Loc162_Phi "Location elevation angle. \"Not a number\" TBD";
CM_ SG_ 481 RFC_Loc162_DrVnce "Variance of Location radial distance";
CM_ SG_ 481 RFC_Loc162_VrVnce "Variance of Location radial relative velocity";
CM_ SG_ 481 RFC_Loc162_ThetaVnce "Variance of Location azimuth angle";
CM_ SG_ 481 RFC_Loc162_PhiVnce "Variance of Location elevation angle";
CM_ SG_ 481 RFC_Loc162_DrVrCoVnce "Covariance of Dr and Vr";
CM_ SG_ 481 RFC_Loc162_RCS "Radar Cross Section (RCS) estimation";
CM_ SG_ 481 RFC_Loc162_RSSI "Received Signal Strength Indication (RSSI)";
CM_ SG_ 481 RFC_Loc162_DrVrQuality "Quality of radial distance and velocity resolution processing. Physical range [0..1]";
CM_ SG_ 481 RFC_Loc162_ThetaQuality "Probability for correct signal model (azimuth angle). Physical range [0..1]";
CM_ SG_ 481 RFC_Loc162_PhiQuality "Probability for correct signal model (elevation angle). Physical range [0..1]";
CM_ SG_ 481 RFC_Loc163_Dr "Location radial distance";
CM_ SG_ 481 RFC_Loc163_Vr "Location radial relative velocity";
CM_ SG_ 481 RFC_Loc163_Theta "Location azimuth angle. \"Not a number\" TBD";
CM_ SG_ 481 RFC_Loc163_Phi "Location elevation angle. \"Not a number\" TBD";
CM_ SG_ 481 RFC_Loc163_DrVnce "Variance of Location radial distance";
CM_ SG_ 481 RFC_Loc163_VrVnce "Variance of Location radial relative velocity";
CM_ SG_ 481 RFC_Loc163_ThetaVnce "Variance of Location azimuth angle";
CM_ SG_ 481 RFC_Loc163_PhiVnce "Variance of Location elevation angle";
CM_ SG_ 481 RFC_Loc163_DrVrCoVnce "Covariance of Dr and Vr";
CM_ SG_ 481 RFC_Loc163_RCS "Radar Cross Section (RCS) estimation";
CM_ SG_ 481 RFC_Loc163_RSSI "Received Signal Strength Indication (RSSI)";
CM_ SG_ 481 RFC_Loc163_DrVrQuality "Quality of radial distance and velocity resolution processing. Physical range [0..1]";
CM_ SG_ 481 RFC_Loc163_ThetaQuality "Probability for correct signal model (azimuth angle). Physical range [0..1]";
CM_ SG_ 481 RFC_Loc163_PhiQuality "Probability for correct signal model (elevation angle). Physical range [0..1]";
CM_ SG_ 482 RFC_Loc164_CRC "CRC - Autosar E2E Profile 5, DataID = TBD";
CM_ SG_ 482 RFC_Loc164_AliveCtr "Alive counter - Autosar E2E Profile 5";
CM_ SG_ 482 RFC_Loc164_ProtBlockCtr "Protocol-Signal: Block-Counter";
CM_ SG_ 482 RFC_Loc164_Dr "Location radial distance";
CM_ SG_ 482 RFC_Loc164_Vr "Location radial relative velocity";
CM_ SG_ 482 RFC_Loc164_Theta "Location azimuth angle. \"Not a number\" TBD";
CM_ SG_ 482 RFC_Loc164_Phi "Location elevation angle. \"Not a number\" TBD";
CM_ SG_ 482 RFC_Loc164_DrVnce "Variance of Location radial distance";
CM_ SG_ 482 RFC_Loc164_VrVnce "Variance of Location radial relative velocity";
CM_ SG_ 482 RFC_Loc164_ThetaVnce "Variance of Location azimuth angle";
CM_ SG_ 482 RFC_Loc164_PhiVnce "Variance of Location elevation angle";
CM_ SG_ 482 RFC_Loc164_DrVrCoVnce "Covariance of Dr and Vr";
CM_ SG_ 482 RFC_Loc164_RCS "Radar Cross Section (RCS) estimation";
CM_ SG_ 482 RFC_Loc164_RSSI "Received Signal Strength Indication (RSSI)";
CM_ SG_ 482 RFC_Loc164_DrVrQuality "Quality of radial distance and velocity resolution processing. Physical range [0..1]";
CM_ SG_ 482 RFC_Loc164_ThetaQuality "Probability for correct signal model (azimuth angle). Physical range [0..1]";
CM_ SG_ 482 RFC_Loc164_PhiQuality "Probability for correct signal model (elevation angle). Physical range [0..1]";
CM_ SG_ 482 RFC_Loc165_Dr "Location radial distance";
CM_ SG_ 482 RFC_Loc165_Vr "Location radial relative velocity";
CM_ SG_ 482 RFC_Loc165_Theta "Location azimuth angle. \"Not a number\" TBD";
CM_ SG_ 482 RFC_Loc165_Phi "Location elevation angle. \"Not a number\" TBD";
CM_ SG_ 482 RFC_Loc165_DrVnce "Variance of Location radial distance";
CM_ SG_ 482 RFC_Loc165_VrVnce "Variance of Location radial relative velocity";
CM_ SG_ 482 RFC_Loc165_ThetaVnce "Variance of Location azimuth angle";
CM_ SG_ 482 RFC_Loc165_PhiVnce "Variance of Location elevation angle";
CM_ SG_ 482 RFC_Loc165_DrVrCoVnce "Covariance of Dr and Vr";
CM_ SG_ 482 RFC_Loc165_RCS "Radar Cross Section (RCS) estimation";
CM_ SG_ 482 RFC_Loc165_RSSI "Received Signal Strength Indication (RSSI)";
CM_ SG_ 482 RFC_Loc165_DrVrQuality "Quality of radial distance and velocity resolution processing. Physical range [0..1]";
CM_ SG_ 482 RFC_Loc165_ThetaQuality "Probability for correct signal model (azimuth angle). Physical range [0..1]";
CM_ SG_ 482 RFC_Loc165_PhiQuality "Probability for correct signal model (elevation angle). Physical range [0..1]";
CM_ SG_ 483 RFC_Loc166_CRC "CRC - Autosar E2E Profile 5, DataID = TBD";
CM_ SG_ 483 RFC_Loc166_AliveCtr "Alive counter - Autosar E2E Profile 5";
CM_ SG_ 483 RFC_Loc166_ProtBlockCtr "Protocol-Signal: Block-Counter";
CM_ SG_ 483 RFC_Loc166_Dr "Location radial distance";
CM_ SG_ 483 RFC_Loc166_Vr "Location radial relative velocity";
CM_ SG_ 483 RFC_Loc166_Theta "Location azimuth angle. \"Not a number\" TBD";
CM_ SG_ 483 RFC_Loc166_Phi "Location elevation angle. \"Not a number\" TBD";
CM_ SG_ 483 RFC_Loc166_DrVnce "Variance of Location radial distance";
CM_ SG_ 483 RFC_Loc166_VrVnce "Variance of Location radial relative velocity";
CM_ SG_ 483 RFC_Loc166_ThetaVnce "Variance of Location azimuth angle";
CM_ SG_ 483 RFC_Loc166_PhiVnce "Variance of Location elevation angle";
CM_ SG_ 483 RFC_Loc166_DrVrCoVnce "Covariance of Dr and Vr";
CM_ SG_ 483 RFC_Loc166_RCS "Radar Cross Section (RCS) estimation";
CM_ SG_ 483 RFC_Loc166_RSSI "Received Signal Strength Indication (RSSI)";
CM_ SG_ 483 RFC_Loc166_DrVrQuality "Quality of radial distance and velocity resolution processing. Physical range [0..1]";
CM_ SG_ 483 RFC_Loc166_ThetaQuality "Probability for correct signal model (azimuth angle). Physical range [0..1]";
CM_ SG_ 483 RFC_Loc166_PhiQuality "Probability for correct signal model (elevation angle). Physical range [0..1]";
CM_ SG_ 483 RFC_Loc167_Dr "Location radial distance";
CM_ SG_ 483 RFC_Loc167_Vr "Location radial relative velocity";
CM_ SG_ 483 RFC_Loc167_Theta "Location azimuth angle. \"Not a number\" TBD";
CM_ SG_ 483 RFC_Loc167_Phi "Location elevation angle. \"Not a number\" TBD";
CM_ SG_ 483 RFC_Loc167_DrVnce "Variance of Location radial distance";
CM_ SG_ 483 RFC_Loc167_VrVnce "Variance of Location radial relative velocity";
CM_ SG_ 483 RFC_Loc167_ThetaVnce "Variance of Location azimuth angle";
CM_ SG_ 483 RFC_Loc167_PhiVnce "Variance of Location elevation angle";
CM_ SG_ 483 RFC_Loc167_DrVrCoVnce "Covariance of Dr and Vr";
CM_ SG_ 483 RFC_Loc167_RCS "Radar Cross Section (RCS) estimation";
CM_ SG_ 483 RFC_Loc167_RSSI "Received Signal Strength Indication (RSSI)";
CM_ SG_ 483 RFC_Loc167_DrVrQuality "Quality of radial distance and velocity resolution processing. Physical range [0..1]";
CM_ SG_ 483 RFC_Loc167_ThetaQuality "Probability for correct signal model (azimuth angle). Physical range [0..1]";
CM_ SG_ 483 RFC_Loc167_PhiQuality "Probability for correct signal model (elevation angle). Physical range [0..1]";
CM_ SG_ 484 RFC_Loc168_CRC "CRC - Autosar E2E Profile 5, DataID = TBD";
CM_ SG_ 484 RFC_Loc168_AliveCtr "Alive counter - Autosar E2E Profile 5";
CM_ SG_ 484 RFC_Loc168_ProtBlockCtr "Protocol-Signal: Block-Counter";
CM_ SG_ 484 RFC_Loc168_Dr "Location radial distance";
CM_ SG_ 484 RFC_Loc168_Vr "Location radial relative velocity";
CM_ SG_ 484 RFC_Loc168_Theta "Location azimuth angle. \"Not a number\" TBD";
CM_ SG_ 484 RFC_Loc168_Phi "Location elevation angle. \"Not a number\" TBD";
CM_ SG_ 484 RFC_Loc168_DrVnce "Variance of Location radial distance";
CM_ SG_ 484 RFC_Loc168_VrVnce "Variance of Location radial relative velocity";
CM_ SG_ 484 RFC_Loc168_ThetaVnce "Variance of Location azimuth angle";
CM_ SG_ 484 RFC_Loc168_PhiVnce "Variance of Location elevation angle";
CM_ SG_ 484 RFC_Loc168_DrVrCoVnce "Covariance of Dr and Vr";
CM_ SG_ 484 RFC_Loc168_RCS "Radar Cross Section (RCS) estimation";
CM_ SG_ 484 RFC_Loc168_RSSI "Received Signal Strength Indication (RSSI)";
CM_ SG_ 484 RFC_Loc168_DrVrQuality "Quality of radial distance and velocity resolution processing. Physical range [0..1]";
CM_ SG_ 484 RFC_Loc168_ThetaQuality "Probability for correct signal model (azimuth angle). Physical range [0..1]";
CM_ SG_ 484 RFC_Loc168_PhiQuality "Probability for correct signal model (elevation angle). Physical range [0..1]";
CM_ SG_ 484 RFC_Loc169_Dr "Location radial distance";
CM_ SG_ 484 RFC_Loc169_Vr "Location radial relative velocity";
CM_ SG_ 484 RFC_Loc169_Theta "Location azimuth angle. \"Not a number\" TBD";
CM_ SG_ 484 RFC_Loc169_Phi "Location elevation angle. \"Not a number\" TBD";
CM_ SG_ 484 RFC_Loc169_DrVnce "Variance of Location radial distance";
CM_ SG_ 484 RFC_Loc169_VrVnce "Variance of Location radial relative velocity";
CM_ SG_ 484 RFC_Loc169_ThetaVnce "Variance of Location azimuth angle";
CM_ SG_ 484 RFC_Loc169_PhiVnce "Variance of Location elevation angle";
CM_ SG_ 484 RFC_Loc169_DrVrCoVnce "Covariance of Dr and Vr";
CM_ SG_ 484 RFC_Loc169_RCS "Radar Cross Section (RCS) estimation";
CM_ SG_ 484 RFC_Loc169_RSSI "Received Signal Strength Indication (RSSI)";
CM_ SG_ 484 RFC_Loc169_DrVrQuality "Quality of radial distance and velocity resolution processing. Physical range [0..1]";
CM_ SG_ 484 RFC_Loc169_ThetaQuality "Probability for correct signal model (azimuth angle). Physical range [0..1]";
CM_ SG_ 484 RFC_Loc169_PhiQuality "Probability for correct signal model (elevation angle). Physical range [0..1]";
BA_DEF_ BO_  "GenMsgSendType" ENUM  "cyclic","NoMsgSendType","IfActive","Event","CA","CE";
BA_DEF_ BO_  "GenMsgCycleTime" INT 0 0;
BA_DEF_ SG_  "GenSigSendType" ENUM  "cyclic","OnChange","OnWrite","IfActive","OnChangeWithRepetition","OnWriteWithRepetition","IfActiveWithRepetition","CA","CE","Event";
BA_DEF_ SG_  "GenSigStartValue" INT 0 0;
BA_DEF_ BO_  "CANFD_BRS" ENUM  "0","1";
BA_DEF_ BO_  "VFrameFormat" ENUM  "StandardCAN","ExtendedCAN","reserved","reserved","reserved","reserved","reserved","reserved","reserved","reserved","reserved","reserved","reserved","reserved","StandardCAN_FD","ExtendedCAN_FD";
BA_DEF_ BO_  "GenMsgILSupport" ENUM  "No","Yes";
BA_DEF_ SG_  "sigDespEng" STRING ;
BA_DEF_ SG_  "sigSecLevel" STRING ;
BA_DEF_ SG_  "sigConfig" STRING ;
BA_DEF_ SG_  "sigExplanation" STRING ;
BA_DEF_DEF_  "GenMsgSendType" "cyclic";
BA_DEF_DEF_  "GenMsgCycleTime" 0;
BA_DEF_DEF_  "GenSigSendType" "cyclic";
BA_DEF_DEF_  "GenSigStartValue" 0;
BA_DEF_DEF_  "CANFD_BRS" "1";
BA_DEF_DEF_  "VFrameFormat" "";
BA_DEF_DEF_  "GenMsgILSupport" "Yes";
BA_DEF_DEF_  "sigDespEng" "";
BA_DEF_DEF_  "sigSecLevel" "";
BA_DEF_DEF_  "sigConfig" "";
BA_DEF_DEF_  "sigExplanation" "";
BA_ "GenMsgSendType" BO_ 460 3;
BA_ "VFrameFormat" BO_ 460 14;
BA_ "GenMsgSendType" BO_ 461 3;
BA_ "VFrameFormat" BO_ 461 14;
BA_ "GenMsgSendType" BO_ 462 3;
BA_ "VFrameFormat" BO_ 462 14;
BA_ "GenMsgSendType" BO_ 463 3;
BA_ "VFrameFormat" BO_ 463 14;
BA_ "GenMsgSendType" BO_ 464 3;
BA_ "VFrameFormat" BO_ 464 14;
BA_ "GenMsgSendType" BO_ 465 3;
BA_ "VFrameFormat" BO_ 465 14;
BA_ "GenMsgSendType" BO_ 466 3;
BA_ "VFrameFormat" BO_ 466 14;
BA_ "GenMsgSendType" BO_ 467 3;
BA_ "VFrameFormat" BO_ 467 14;
BA_ "GenMsgSendType" BO_ 468 3;
BA_ "VFrameFormat" BO_ 468 14;
BA_ "GenMsgSendType" BO_ 469 3;
BA_ "VFrameFormat" BO_ 469 14;
BA_ "GenMsgSendType" BO_ 470 3;
BA_ "VFrameFormat" BO_ 470 14;
BA_ "GenMsgSendType" BO_ 471 3;
BA_ "VFrameFormat" BO_ 471 14;
BA_ "GenMsgSendType" BO_ 472 3;
BA_ "VFrameFormat" BO_ 472 14;
BA_ "GenMsgSendType" BO_ 473 3;
BA_ "VFrameFormat" BO_ 473 14;
BA_ "GenMsgSendType" BO_ 474 3;
BA_ "VFrameFormat" BO_ 474 14;
BA_ "GenMsgSendType" BO_ 475 3;
BA_ "VFrameFormat" BO_ 475 14;
BA_ "GenMsgSendType" BO_ 476 3;
BA_ "VFrameFormat" BO_ 476 14;
BA_ "GenMsgSendType" BO_ 477 3;
BA_ "VFrameFormat" BO_ 477 14;
BA_ "GenMsgSendType" BO_ 478 3;
BA_ "VFrameFormat" BO_ 478 14;
BA_ "GenMsgSendType" BO_ 479 3;
BA_ "VFrameFormat" BO_ 479 14;
BA_ "GenMsgSendType" BO_ 480 3;
BA_ "VFrameFormat" BO_ 480 14;
BA_ "GenMsgSendType" BO_ 481 3;
BA_ "VFrameFormat" BO_ 481 14;
BA_ "GenMsgSendType" BO_ 482 3;
BA_ "VFrameFormat" BO_ 482 14;
BA_ "GenMsgSendType" BO_ 483 3;
BA_ "VFrameFormat" BO_ 483 14;
BA_ "GenMsgSendType" BO_ 484 3;
BA_ "VFrameFormat" BO_ 484 14;
BA_ "GenSigSendType" SG_ 460 RFC_Loc120_CRC 9;
BA_ "GenSigSendType" SG_ 460 RFC_Loc120_AliveCtr 9;
BA_ "GenSigSendType" SG_ 460 RFC_Loc120_ProtBlockCtr 9;
BA_ "GenSigSendType" SG_ 460 RFC_Loc120_Dr 9;
BA_ "GenSigSendType" SG_ 460 RFC_Loc120_Vr 9;
BA_ "GenSigStartValue" SG_ 460 RFC_Loc120_Vr 32768;
BA_ "GenSigSendType" SG_ 460 RFC_Loc120_Theta 9;
BA_ "GenSigStartValue" SG_ 460 RFC_Loc120_Theta 32768;
BA_ "GenSigSendType" SG_ 460 RFC_Loc120_Phi 9;
BA_ "GenSigStartValue" SG_ 460 RFC_Loc120_Phi 32768;
BA_ "GenSigSendType" SG_ 460 RFC_Loc120_DrVnce 9;
BA_ "GenSigSendType" SG_ 460 RFC_Loc120_VrVnce 9;
BA_ "GenSigSendType" SG_ 460 RFC_Loc120_ThetaVnce 9;
BA_ "GenSigSendType" SG_ 460 RFC_Loc120_PhiVnce 9;
BA_ "GenSigSendType" SG_ 460 RFC_Loc120_DrVrCoVnce 9;
BA_ "GenSigStartValue" SG_ 460 RFC_Loc120_DrVrCoVnce 32768;
BA_ "GenSigSendType" SG_ 460 RFC_Loc120_RCS 9;
BA_ "GenSigStartValue" SG_ 460 RFC_Loc120_RCS 32768;
BA_ "GenSigSendType" SG_ 460 RFC_Loc120_RSSI 9;
BA_ "GenSigSendType" SG_ 460 RFC_Loc120_DrVrQuality 9;
BA_ "GenSigSendType" SG_ 460 RFC_Loc120_ThetaQuality 9;
BA_ "GenSigSendType" SG_ 460 RFC_Loc120_PhiQuality 9;
BA_ "GenSigSendType" SG_ 460 RFC_Loc121_Dr 9;
BA_ "GenSigSendType" SG_ 460 RFC_Loc121_Vr 9;
BA_ "GenSigStartValue" SG_ 460 RFC_Loc121_Vr 32768;
BA_ "GenSigSendType" SG_ 460 RFC_Loc121_Theta 9;
BA_ "GenSigStartValue" SG_ 460 RFC_Loc121_Theta 32768;
BA_ "GenSigSendType" SG_ 460 RFC_Loc121_Phi 9;
BA_ "GenSigStartValue" SG_ 460 RFC_Loc121_Phi 32768;
BA_ "GenSigSendType" SG_ 460 RFC_Loc121_DrVnce 9;
BA_ "GenSigSendType" SG_ 460 RFC_Loc121_VrVnce 9;
BA_ "GenSigSendType" SG_ 460 RFC_Loc121_ThetaVnce 9;
BA_ "GenSigSendType" SG_ 460 RFC_Loc121_PhiVnce 9;
BA_ "GenSigSendType" SG_ 460 RFC_Loc121_DrVrCoVnce 9;
BA_ "GenSigStartValue" SG_ 460 RFC_Loc121_DrVrCoVnce 32768;
BA_ "GenSigSendType" SG_ 460 RFC_Loc121_RCS 9;
BA_ "GenSigStartValue" SG_ 460 RFC_Loc121_RCS 32768;
BA_ "GenSigSendType" SG_ 460 RFC_Loc121_RSSI 9;
BA_ "GenSigSendType" SG_ 460 RFC_Loc121_DrVrQuality 9;
BA_ "GenSigSendType" SG_ 460 RFC_Loc121_ThetaQuality 9;
BA_ "GenSigSendType" SG_ 460 RFC_Loc121_PhiQuality 9;
BA_ "GenSigSendType" SG_ 461 RFC_Loc122_CRC 9;
BA_ "GenSigSendType" SG_ 461 RFC_Loc122_AliveCtr 9;
BA_ "GenSigSendType" SG_ 461 RFC_Loc122_ProtBlockCtr 9;
BA_ "GenSigSendType" SG_ 461 RFC_Loc122_Dr 9;
BA_ "GenSigSendType" SG_ 461 RFC_Loc122_Vr 9;
BA_ "GenSigStartValue" SG_ 461 RFC_Loc122_Vr 32768;
BA_ "GenSigSendType" SG_ 461 RFC_Loc122_Theta 9;
BA_ "GenSigStartValue" SG_ 461 RFC_Loc122_Theta 32768;
BA_ "GenSigSendType" SG_ 461 RFC_Loc122_Phi 9;
BA_ "GenSigStartValue" SG_ 461 RFC_Loc122_Phi 32768;
BA_ "GenSigSendType" SG_ 461 RFC_Loc122_DrVnce 9;
BA_ "GenSigSendType" SG_ 461 RFC_Loc122_VrVnce 9;
BA_ "GenSigSendType" SG_ 461 RFC_Loc122_ThetaVnce 9;
BA_ "GenSigSendType" SG_ 461 RFC_Loc122_PhiVnce 9;
BA_ "GenSigSendType" SG_ 461 RFC_Loc122_DrVrCoVnce 9;
BA_ "GenSigStartValue" SG_ 461 RFC_Loc122_DrVrCoVnce 32768;
BA_ "GenSigSendType" SG_ 461 RFC_Loc122_RCS 9;
BA_ "GenSigStartValue" SG_ 461 RFC_Loc122_RCS 32768;
BA_ "GenSigSendType" SG_ 461 RFC_Loc122_RSSI 9;
BA_ "GenSigSendType" SG_ 461 RFC_Loc122_DrVrQuality 9;
BA_ "GenSigSendType" SG_ 461 RFC_Loc122_ThetaQuality 9;
BA_ "GenSigSendType" SG_ 461 RFC_Loc122_PhiQuality 9;
BA_ "GenSigSendType" SG_ 461 RFC_Loc123_Dr 9;
BA_ "GenSigSendType" SG_ 461 RFC_Loc123_Vr 9;
BA_ "GenSigStartValue" SG_ 461 RFC_Loc123_Vr 32768;
BA_ "GenSigSendType" SG_ 461 RFC_Loc123_Theta 9;
BA_ "GenSigStartValue" SG_ 461 RFC_Loc123_Theta 32768;
BA_ "GenSigSendType" SG_ 461 RFC_Loc123_Phi 9;
BA_ "GenSigStartValue" SG_ 461 RFC_Loc123_Phi 32768;
BA_ "GenSigSendType" SG_ 461 RFC_Loc123_DrVnce 9;
BA_ "GenSigSendType" SG_ 461 RFC_Loc123_VrVnce 9;
BA_ "GenSigSendType" SG_ 461 RFC_Loc123_ThetaVnce 9;
BA_ "GenSigSendType" SG_ 461 RFC_Loc123_PhiVnce 9;
BA_ "GenSigSendType" SG_ 461 RFC_Loc123_DrVrCoVnce 9;
BA_ "GenSigStartValue" SG_ 461 RFC_Loc123_DrVrCoVnce 32768;
BA_ "GenSigSendType" SG_ 461 RFC_Loc123_RCS 9;
BA_ "GenSigStartValue" SG_ 461 RFC_Loc123_RCS 32768;
BA_ "GenSigSendType" SG_ 461 RFC_Loc123_RSSI 9;
BA_ "GenSigSendType" SG_ 461 RFC_Loc123_DrVrQuality 9;
BA_ "GenSigSendType" SG_ 461 RFC_Loc123_ThetaQuality 9;
BA_ "GenSigSendType" SG_ 461 RFC_Loc123_PhiQuality 9;
BA_ "GenSigSendType" SG_ 462 RFC_Loc124_CRC 9;
BA_ "GenSigSendType" SG_ 462 RFC_Loc124_AliveCtr 9;
BA_ "GenSigSendType" SG_ 462 RFC_Loc124_ProtBlockCtr 9;
BA_ "GenSigSendType" SG_ 462 RFC_Loc124_Dr 9;
BA_ "GenSigSendType" SG_ 462 RFC_Loc124_Vr 9;
BA_ "GenSigStartValue" SG_ 462 RFC_Loc124_Vr 32768;
BA_ "GenSigSendType" SG_ 462 RFC_Loc124_Theta 9;
BA_ "GenSigStartValue" SG_ 462 RFC_Loc124_Theta 32768;
BA_ "GenSigSendType" SG_ 462 RFC_Loc124_Phi 9;
BA_ "GenSigStartValue" SG_ 462 RFC_Loc124_Phi 32768;
BA_ "GenSigSendType" SG_ 462 RFC_Loc124_DrVnce 9;
BA_ "GenSigSendType" SG_ 462 RFC_Loc124_VrVnce 9;
BA_ "GenSigSendType" SG_ 462 RFC_Loc124_ThetaVnce 9;
BA_ "GenSigSendType" SG_ 462 RFC_Loc124_PhiVnce 9;
BA_ "GenSigSendType" SG_ 462 RFC_Loc124_DrVrCoVnce 9;
BA_ "GenSigStartValue" SG_ 462 RFC_Loc124_DrVrCoVnce 32768;
BA_ "GenSigSendType" SG_ 462 RFC_Loc124_RCS 9;
BA_ "GenSigStartValue" SG_ 462 RFC_Loc124_RCS 32768;
BA_ "GenSigSendType" SG_ 462 RFC_Loc124_RSSI 9;
BA_ "GenSigSendType" SG_ 462 RFC_Loc124_DrVrQuality 9;
BA_ "GenSigSendType" SG_ 462 RFC_Loc124_ThetaQuality 9;
BA_ "GenSigSendType" SG_ 462 RFC_Loc124_PhiQuality 9;
BA_ "GenSigSendType" SG_ 462 RFC_Loc125_Dr 9;
BA_ "GenSigSendType" SG_ 462 RFC_Loc125_Vr 9;
BA_ "GenSigStartValue" SG_ 462 RFC_Loc125_Vr 32768;
BA_ "GenSigSendType" SG_ 462 RFC_Loc125_Theta 9;
BA_ "GenSigStartValue" SG_ 462 RFC_Loc125_Theta 32768;
BA_ "GenSigSendType" SG_ 462 RFC_Loc125_Phi 9;
BA_ "GenSigStartValue" SG_ 462 RFC_Loc125_Phi 32768;
BA_ "GenSigSendType" SG_ 462 RFC_Loc125_DrVnce 9;
BA_ "GenSigSendType" SG_ 462 RFC_Loc125_VrVnce 9;
BA_ "GenSigSendType" SG_ 462 RFC_Loc125_ThetaVnce 9;
BA_ "GenSigSendType" SG_ 462 RFC_Loc125_PhiVnce 9;
BA_ "GenSigSendType" SG_ 462 RFC_Loc125_DrVrCoVnce 9;
BA_ "GenSigStartValue" SG_ 462 RFC_Loc125_DrVrCoVnce 32768;
BA_ "GenSigSendType" SG_ 462 RFC_Loc125_RCS 9;
BA_ "GenSigStartValue" SG_ 462 RFC_Loc125_RCS 32768;
BA_ "GenSigSendType" SG_ 462 RFC_Loc125_RSSI 9;
BA_ "GenSigSendType" SG_ 462 RFC_Loc125_DrVrQuality 9;
BA_ "GenSigSendType" SG_ 462 RFC_Loc125_ThetaQuality 9;
BA_ "GenSigSendType" SG_ 462 RFC_Loc125_PhiQuality 9;
BA_ "GenSigSendType" SG_ 463 RFC_Loc126_CRC 9;
BA_ "GenSigSendType" SG_ 463 RFC_Loc126_AliveCtr 9;
BA_ "GenSigSendType" SG_ 463 RFC_Loc126_ProtBlockCtr 9;
BA_ "GenSigSendType" SG_ 463 RFC_Loc126_Dr 9;
BA_ "GenSigSendType" SG_ 463 RFC_Loc126_Vr 9;
BA_ "GenSigStartValue" SG_ 463 RFC_Loc126_Vr 32768;
BA_ "GenSigSendType" SG_ 463 RFC_Loc126_Theta 9;
BA_ "GenSigStartValue" SG_ 463 RFC_Loc126_Theta 32768;
BA_ "GenSigSendType" SG_ 463 RFC_Loc126_Phi 9;
BA_ "GenSigStartValue" SG_ 463 RFC_Loc126_Phi 32768;
BA_ "GenSigSendType" SG_ 463 RFC_Loc126_DrVnce 9;
BA_ "GenSigSendType" SG_ 463 RFC_Loc126_VrVnce 9;
BA_ "GenSigSendType" SG_ 463 RFC_Loc126_ThetaVnce 9;
BA_ "GenSigSendType" SG_ 463 RFC_Loc126_PhiVnce 9;
BA_ "GenSigSendType" SG_ 463 RFC_Loc126_DrVrCoVnce 9;
BA_ "GenSigStartValue" SG_ 463 RFC_Loc126_DrVrCoVnce 32768;
BA_ "GenSigSendType" SG_ 463 RFC_Loc126_RCS 9;
BA_ "GenSigStartValue" SG_ 463 RFC_Loc126_RCS 32768;
BA_ "GenSigSendType" SG_ 463 RFC_Loc126_RSSI 9;
BA_ "GenSigSendType" SG_ 463 RFC_Loc126_DrVrQuality 9;
BA_ "GenSigSendType" SG_ 463 RFC_Loc126_ThetaQuality 9;
BA_ "GenSigSendType" SG_ 463 RFC_Loc126_PhiQuality 9;
BA_ "GenSigSendType" SG_ 463 RFC_Loc127_Dr 9;
BA_ "GenSigSendType" SG_ 463 RFC_Loc127_Vr 9;
BA_ "GenSigStartValue" SG_ 463 RFC_Loc127_Vr 32768;
BA_ "GenSigSendType" SG_ 463 RFC_Loc127_Theta 9;
BA_ "GenSigStartValue" SG_ 463 RFC_Loc127_Theta 32768;
BA_ "GenSigSendType" SG_ 463 RFC_Loc127_Phi 9;
BA_ "GenSigStartValue" SG_ 463 RFC_Loc127_Phi 32768;
BA_ "GenSigSendType" SG_ 463 RFC_Loc127_DrVnce 9;
BA_ "GenSigSendType" SG_ 463 RFC_Loc127_VrVnce 9;
BA_ "GenSigSendType" SG_ 463 RFC_Loc127_ThetaVnce 9;
BA_ "GenSigSendType" SG_ 463 RFC_Loc127_PhiVnce 9;
BA_ "GenSigSendType" SG_ 463 RFC_Loc127_DrVrCoVnce 9;
BA_ "GenSigStartValue" SG_ 463 RFC_Loc127_DrVrCoVnce 32768;
BA_ "GenSigSendType" SG_ 463 RFC_Loc127_RCS 9;
BA_ "GenSigStartValue" SG_ 463 RFC_Loc127_RCS 32768;
BA_ "GenSigSendType" SG_ 463 RFC_Loc127_RSSI 9;
BA_ "GenSigSendType" SG_ 463 RFC_Loc127_DrVrQuality 9;
BA_ "GenSigSendType" SG_ 463 RFC_Loc127_ThetaQuality 9;
BA_ "GenSigSendType" SG_ 463 RFC_Loc127_PhiQuality 9;
BA_ "GenSigSendType" SG_ 464 RFC_Loc128_CRC 9;
BA_ "GenSigSendType" SG_ 464 RFC_Loc128_AliveCtr 9;
BA_ "GenSigSendType" SG_ 464 RFC_Loc128_ProtBlockCtr 9;
BA_ "GenSigSendType" SG_ 464 RFC_Loc128_Dr 9;
BA_ "GenSigSendType" SG_ 464 RFC_Loc128_Vr 9;
BA_ "GenSigStartValue" SG_ 464 RFC_Loc128_Vr 32768;
BA_ "GenSigSendType" SG_ 464 RFC_Loc128_Theta 9;
BA_ "GenSigStartValue" SG_ 464 RFC_Loc128_Theta 32768;
BA_ "GenSigSendType" SG_ 464 RFC_Loc128_Phi 9;
BA_ "GenSigStartValue" SG_ 464 RFC_Loc128_Phi 32768;
BA_ "GenSigSendType" SG_ 464 RFC_Loc128_DrVnce 9;
BA_ "GenSigSendType" SG_ 464 RFC_Loc128_VrVnce 9;
BA_ "GenSigSendType" SG_ 464 RFC_Loc128_ThetaVnce 9;
BA_ "GenSigSendType" SG_ 464 RFC_Loc128_PhiVnce 9;
BA_ "GenSigSendType" SG_ 464 RFC_Loc128_DrVrCoVnce 9;
BA_ "GenSigStartValue" SG_ 464 RFC_Loc128_DrVrCoVnce 32768;
BA_ "GenSigSendType" SG_ 464 RFC_Loc128_RCS 9;
BA_ "GenSigStartValue" SG_ 464 RFC_Loc128_RCS 32768;
BA_ "GenSigSendType" SG_ 464 RFC_Loc128_RSSI 9;
BA_ "GenSigSendType" SG_ 464 RFC_Loc128_DrVrQuality 9;
BA_ "GenSigSendType" SG_ 464 RFC_Loc128_ThetaQuality 9;
BA_ "GenSigSendType" SG_ 464 RFC_Loc128_PhiQuality 9;
BA_ "GenSigSendType" SG_ 464 RFC_Loc129_Dr 9;
BA_ "GenSigSendType" SG_ 464 RFC_Loc129_Vr 9;
BA_ "GenSigStartValue" SG_ 464 RFC_Loc129_Vr 32768;
BA_ "GenSigSendType" SG_ 464 RFC_Loc129_Theta 9;
BA_ "GenSigStartValue" SG_ 464 RFC_Loc129_Theta 32768;
BA_ "GenSigSendType" SG_ 464 RFC_Loc129_Phi 9;
BA_ "GenSigStartValue" SG_ 464 RFC_Loc129_Phi 32768;
BA_ "GenSigSendType" SG_ 464 RFC_Loc129_DrVnce 9;
BA_ "GenSigSendType" SG_ 464 RFC_Loc129_VrVnce 9;
BA_ "GenSigSendType" SG_ 464 RFC_Loc129_ThetaVnce 9;
BA_ "GenSigSendType" SG_ 464 RFC_Loc129_PhiVnce 9;
BA_ "GenSigSendType" SG_ 464 RFC_Loc129_DrVrCoVnce 9;
BA_ "GenSigStartValue" SG_ 464 RFC_Loc129_DrVrCoVnce 32768;
BA_ "GenSigSendType" SG_ 464 RFC_Loc129_RCS 9;
BA_ "GenSigStartValue" SG_ 464 RFC_Loc129_RCS 32768;
BA_ "GenSigSendType" SG_ 464 RFC_Loc129_RSSI 9;
BA_ "GenSigSendType" SG_ 464 RFC_Loc129_DrVrQuality 9;
BA_ "GenSigSendType" SG_ 464 RFC_Loc129_ThetaQuality 9;
BA_ "GenSigSendType" SG_ 464 RFC_Loc129_PhiQuality 9;
BA_ "GenSigSendType" SG_ 465 RFC_Loc130_CRC 9;
BA_ "GenSigSendType" SG_ 465 RFC_Loc130_AliveCtr 9;
BA_ "GenSigSendType" SG_ 465 RFC_Loc130_ProtBlockCtr 9;
BA_ "GenSigSendType" SG_ 465 RFC_Loc130_Dr 9;
BA_ "GenSigSendType" SG_ 465 RFC_Loc130_Vr 9;
BA_ "GenSigStartValue" SG_ 465 RFC_Loc130_Vr 32768;
BA_ "GenSigSendType" SG_ 465 RFC_Loc130_Theta 9;
BA_ "GenSigStartValue" SG_ 465 RFC_Loc130_Theta 32768;
BA_ "GenSigSendType" SG_ 465 RFC_Loc130_Phi 9;
BA_ "GenSigStartValue" SG_ 465 RFC_Loc130_Phi 32768;
BA_ "GenSigSendType" SG_ 465 RFC_Loc130_DrVnce 9;
BA_ "GenSigSendType" SG_ 465 RFC_Loc130_VrVnce 9;
BA_ "GenSigSendType" SG_ 465 RFC_Loc130_ThetaVnce 9;
BA_ "GenSigSendType" SG_ 465 RFC_Loc130_PhiVnce 9;
BA_ "GenSigSendType" SG_ 465 RFC_Loc130_DrVrCoVnce 9;
BA_ "GenSigStartValue" SG_ 465 RFC_Loc130_DrVrCoVnce 32768;
BA_ "GenSigSendType" SG_ 465 RFC_Loc130_RCS 9;
BA_ "GenSigStartValue" SG_ 465 RFC_Loc130_RCS 32768;
BA_ "GenSigSendType" SG_ 465 RFC_Loc130_RSSI 9;
BA_ "GenSigSendType" SG_ 465 RFC_Loc130_DrVrQuality 9;
BA_ "GenSigSendType" SG_ 465 RFC_Loc130_ThetaQuality 9;
BA_ "GenSigSendType" SG_ 465 RFC_Loc130_PhiQuality 9;
BA_ "GenSigSendType" SG_ 465 RFC_Loc131_Dr 9;
BA_ "GenSigSendType" SG_ 465 RFC_Loc131_Vr 9;
BA_ "GenSigStartValue" SG_ 465 RFC_Loc131_Vr 32768;
BA_ "GenSigSendType" SG_ 465 RFC_Loc131_Theta 9;
BA_ "GenSigStartValue" SG_ 465 RFC_Loc131_Theta 32768;
BA_ "GenSigSendType" SG_ 465 RFC_Loc131_Phi 9;
BA_ "GenSigStartValue" SG_ 465 RFC_Loc131_Phi 32768;
BA_ "GenSigSendType" SG_ 465 RFC_Loc131_DrVnce 9;
BA_ "GenSigSendType" SG_ 465 RFC_Loc131_VrVnce 9;
BA_ "GenSigSendType" SG_ 465 RFC_Loc131_ThetaVnce 9;
BA_ "GenSigSendType" SG_ 465 RFC_Loc131_PhiVnce 9;
BA_ "GenSigSendType" SG_ 465 RFC_Loc131_DrVrCoVnce 9;
BA_ "GenSigStartValue" SG_ 465 RFC_Loc131_DrVrCoVnce 32768;
BA_ "GenSigSendType" SG_ 465 RFC_Loc131_RCS 9;
BA_ "GenSigStartValue" SG_ 465 RFC_Loc131_RCS 32768;
BA_ "GenSigSendType" SG_ 465 RFC_Loc131_RSSI 9;
BA_ "GenSigSendType" SG_ 465 RFC_Loc131_DrVrQuality 9;
BA_ "GenSigSendType" SG_ 465 RFC_Loc131_ThetaQuality 9;
BA_ "GenSigSendType" SG_ 465 RFC_Loc131_PhiQuality 9;
BA_ "GenSigSendType" SG_ 466 RFC_Loc132_CRC 9;
BA_ "GenSigSendType" SG_ 466 RFC_Loc132_AliveCtr 9;
BA_ "GenSigSendType" SG_ 466 RFC_Loc132_ProtBlockCtr 9;
BA_ "GenSigSendType" SG_ 466 RFC_Loc132_Dr 9;
BA_ "GenSigSendType" SG_ 466 RFC_Loc132_Vr 9;
BA_ "GenSigStartValue" SG_ 466 RFC_Loc132_Vr 32768;
BA_ "GenSigSendType" SG_ 466 RFC_Loc132_Theta 9;
BA_ "GenSigStartValue" SG_ 466 RFC_Loc132_Theta 32768;
BA_ "GenSigSendType" SG_ 466 RFC_Loc132_Phi 9;
BA_ "GenSigStartValue" SG_ 466 RFC_Loc132_Phi 32768;
BA_ "GenSigSendType" SG_ 466 RFC_Loc132_DrVnce 9;
BA_ "GenSigSendType" SG_ 466 RFC_Loc132_VrVnce 9;
BA_ "GenSigSendType" SG_ 466 RFC_Loc132_ThetaVnce 9;
BA_ "GenSigSendType" SG_ 466 RFC_Loc132_PhiVnce 9;
BA_ "GenSigSendType" SG_ 466 RFC_Loc132_DrVrCoVnce 9;
BA_ "GenSigStartValue" SG_ 466 RFC_Loc132_DrVrCoVnce 32768;
BA_ "GenSigSendType" SG_ 466 RFC_Loc132_RCS 9;
BA_ "GenSigStartValue" SG_ 466 RFC_Loc132_RCS 32768;
BA_ "GenSigSendType" SG_ 466 RFC_Loc132_RSSI 9;
BA_ "GenSigSendType" SG_ 466 RFC_Loc132_DrVrQuality 9;
BA_ "GenSigSendType" SG_ 466 RFC_Loc132_ThetaQuality 9;
BA_ "GenSigSendType" SG_ 466 RFC_Loc132_PhiQuality 9;
BA_ "GenSigSendType" SG_ 466 RFC_Loc133_Dr 9;
BA_ "GenSigSendType" SG_ 466 RFC_Loc133_Vr 9;
BA_ "GenSigStartValue" SG_ 466 RFC_Loc133_Vr 32768;
BA_ "GenSigSendType" SG_ 466 RFC_Loc133_Theta 9;
BA_ "GenSigStartValue" SG_ 466 RFC_Loc133_Theta 32768;
BA_ "GenSigSendType" SG_ 466 RFC_Loc133_Phi 9;
BA_ "GenSigStartValue" SG_ 466 RFC_Loc133_Phi 32768;
BA_ "GenSigSendType" SG_ 466 RFC_Loc133_DrVnce 9;
BA_ "GenSigSendType" SG_ 466 RFC_Loc133_VrVnce 9;
BA_ "GenSigSendType" SG_ 466 RFC_Loc133_ThetaVnce 9;
BA_ "GenSigSendType" SG_ 466 RFC_Loc133_PhiVnce 9;
BA_ "GenSigSendType" SG_ 466 RFC_Loc133_DrVrCoVnce 9;
BA_ "GenSigStartValue" SG_ 466 RFC_Loc133_DrVrCoVnce 32768;
BA_ "GenSigSendType" SG_ 466 RFC_Loc133_RCS 9;
BA_ "GenSigStartValue" SG_ 466 RFC_Loc133_RCS 32768;
BA_ "GenSigSendType" SG_ 466 RFC_Loc133_RSSI 9;
BA_ "GenSigSendType" SG_ 466 RFC_Loc133_DrVrQuality 9;
BA_ "GenSigSendType" SG_ 466 RFC_Loc133_ThetaQuality 9;
BA_ "GenSigSendType" SG_ 466 RFC_Loc133_PhiQuality 9;
BA_ "GenSigSendType" SG_ 467 RFC_Loc134_CRC 9;
BA_ "GenSigSendType" SG_ 467 RFC_Loc134_AliveCtr 9;
BA_ "GenSigSendType" SG_ 467 RFC_Loc134_ProtBlockCtr 9;
BA_ "GenSigSendType" SG_ 467 RFC_Loc134_Dr 9;
BA_ "GenSigSendType" SG_ 467 RFC_Loc134_Vr 9;
BA_ "GenSigStartValue" SG_ 467 RFC_Loc134_Vr 32768;
BA_ "GenSigSendType" SG_ 467 RFC_Loc134_Theta 9;
BA_ "GenSigStartValue" SG_ 467 RFC_Loc134_Theta 32768;
BA_ "GenSigSendType" SG_ 467 RFC_Loc134_Phi 9;
BA_ "GenSigStartValue" SG_ 467 RFC_Loc134_Phi 32768;
BA_ "GenSigSendType" SG_ 467 RFC_Loc134_DrVnce 9;
BA_ "GenSigSendType" SG_ 467 RFC_Loc134_VrVnce 9;
BA_ "GenSigSendType" SG_ 467 RFC_Loc134_ThetaVnce 9;
BA_ "GenSigSendType" SG_ 467 RFC_Loc134_PhiVnce 9;
BA_ "GenSigSendType" SG_ 467 RFC_Loc134_DrVrCoVnce 9;
BA_ "GenSigStartValue" SG_ 467 RFC_Loc134_DrVrCoVnce 32768;
BA_ "GenSigSendType" SG_ 467 RFC_Loc134_RCS 9;
BA_ "GenSigStartValue" SG_ 467 RFC_Loc134_RCS 32768;
BA_ "GenSigSendType" SG_ 467 RFC_Loc134_RSSI 9;
BA_ "GenSigSendType" SG_ 467 RFC_Loc134_DrVrQuality 9;
BA_ "GenSigSendType" SG_ 467 RFC_Loc134_ThetaQuality 9;
BA_ "GenSigSendType" SG_ 467 RFC_Loc134_PhiQuality 9;
BA_ "GenSigSendType" SG_ 467 RFC_Loc135_Dr 9;
BA_ "GenSigSendType" SG_ 467 RFC_Loc135_Vr 9;
BA_ "GenSigStartValue" SG_ 467 RFC_Loc135_Vr 32768;
BA_ "GenSigSendType" SG_ 467 RFC_Loc135_Theta 9;
BA_ "GenSigStartValue" SG_ 467 RFC_Loc135_Theta 32768;
BA_ "GenSigSendType" SG_ 467 RFC_Loc135_Phi 9;
BA_ "GenSigStartValue" SG_ 467 RFC_Loc135_Phi 32768;
BA_ "GenSigSendType" SG_ 467 RFC_Loc135_DrVnce 9;
BA_ "GenSigSendType" SG_ 467 RFC_Loc135_VrVnce 9;
BA_ "GenSigSendType" SG_ 467 RFC_Loc135_ThetaVnce 9;
BA_ "GenSigSendType" SG_ 467 RFC_Loc135_PhiVnce 9;
BA_ "GenSigSendType" SG_ 467 RFC_Loc135_DrVrCoVnce 9;
BA_ "GenSigStartValue" SG_ 467 RFC_Loc135_DrVrCoVnce 32768;
BA_ "GenSigSendType" SG_ 467 RFC_Loc135_RCS 9;
BA_ "GenSigStartValue" SG_ 467 RFC_Loc135_RCS 32768;
BA_ "GenSigSendType" SG_ 467 RFC_Loc135_RSSI 9;
BA_ "GenSigSendType" SG_ 467 RFC_Loc135_DrVrQuality 9;
BA_ "GenSigSendType" SG_ 467 RFC_Loc135_ThetaQuality 9;
BA_ "GenSigSendType" SG_ 467 RFC_Loc135_PhiQuality 9;
BA_ "GenSigSendType" SG_ 468 RFC_Loc136_CRC 9;
BA_ "GenSigSendType" SG_ 468 RFC_Loc136_AliveCtr 9;
BA_ "GenSigSendType" SG_ 468 RFC_Loc136_ProtBlockCtr 9;
BA_ "GenSigSendType" SG_ 468 RFC_Loc136_Dr 9;
BA_ "GenSigSendType" SG_ 468 RFC_Loc136_Vr 9;
BA_ "GenSigStartValue" SG_ 468 RFC_Loc136_Vr 32768;
BA_ "GenSigSendType" SG_ 468 RFC_Loc136_Theta 9;
BA_ "GenSigStartValue" SG_ 468 RFC_Loc136_Theta 32768;
BA_ "GenSigSendType" SG_ 468 RFC_Loc136_Phi 9;
BA_ "GenSigStartValue" SG_ 468 RFC_Loc136_Phi 32768;
BA_ "GenSigSendType" SG_ 468 RFC_Loc136_DrVnce 9;
BA_ "GenSigSendType" SG_ 468 RFC_Loc136_VrVnce 9;
BA_ "GenSigSendType" SG_ 468 RFC_Loc136_ThetaVnce 9;
BA_ "GenSigSendType" SG_ 468 RFC_Loc136_PhiVnce 9;
BA_ "GenSigSendType" SG_ 468 RFC_Loc136_DrVrCoVnce 9;
BA_ "GenSigStartValue" SG_ 468 RFC_Loc136_DrVrCoVnce 32768;
BA_ "GenSigSendType" SG_ 468 RFC_Loc136_RCS 9;
BA_ "GenSigStartValue" SG_ 468 RFC_Loc136_RCS 32768;
BA_ "GenSigSendType" SG_ 468 RFC_Loc136_RSSI 9;
BA_ "GenSigSendType" SG_ 468 RFC_Loc136_DrVrQuality 9;
BA_ "GenSigSendType" SG_ 468 RFC_Loc136_ThetaQuality 9;
BA_ "GenSigSendType" SG_ 468 RFC_Loc136_PhiQuality 9;
BA_ "GenSigSendType" SG_ 468 RFC_Loc137_Dr 9;
BA_ "GenSigSendType" SG_ 468 RFC_Loc137_Vr 9;
BA_ "GenSigStartValue" SG_ 468 RFC_Loc137_Vr 32768;
BA_ "GenSigSendType" SG_ 468 RFC_Loc137_Theta 9;
BA_ "GenSigStartValue" SG_ 468 RFC_Loc137_Theta 32768;
BA_ "GenSigSendType" SG_ 468 RFC_Loc137_Phi 9;
BA_ "GenSigStartValue" SG_ 468 RFC_Loc137_Phi 32768;
BA_ "GenSigSendType" SG_ 468 RFC_Loc137_DrVnce 9;
BA_ "GenSigSendType" SG_ 468 RFC_Loc137_VrVnce 9;
BA_ "GenSigSendType" SG_ 468 RFC_Loc137_ThetaVnce 9;
BA_ "GenSigSendType" SG_ 468 RFC_Loc137_PhiVnce 9;
BA_ "GenSigSendType" SG_ 468 RFC_Loc137_DrVrCoVnce 9;
BA_ "GenSigStartValue" SG_ 468 RFC_Loc137_DrVrCoVnce 32768;
BA_ "GenSigSendType" SG_ 468 RFC_Loc137_RCS 9;
BA_ "GenSigStartValue" SG_ 468 RFC_Loc137_RCS 32768;
BA_ "GenSigSendType" SG_ 468 RFC_Loc137_RSSI 9;
BA_ "GenSigSendType" SG_ 468 RFC_Loc137_DrVrQuality 9;
BA_ "GenSigSendType" SG_ 468 RFC_Loc137_ThetaQuality 9;
BA_ "GenSigSendType" SG_ 468 RFC_Loc137_PhiQuality 9;
BA_ "GenSigSendType" SG_ 469 RFC_Loc138_CRC 9;
BA_ "GenSigSendType" SG_ 469 RFC_Loc138_AliveCtr 9;
BA_ "GenSigSendType" SG_ 469 RFC_Loc138_ProtBlockCtr 9;
BA_ "GenSigSendType" SG_ 469 RFC_Loc138_Dr 9;
BA_ "GenSigSendType" SG_ 469 RFC_Loc138_Vr 9;
BA_ "GenSigStartValue" SG_ 469 RFC_Loc138_Vr 32768;
BA_ "GenSigSendType" SG_ 469 RFC_Loc138_Theta 9;
BA_ "GenSigStartValue" SG_ 469 RFC_Loc138_Theta 32768;
BA_ "GenSigSendType" SG_ 469 RFC_Loc138_Phi 9;
BA_ "GenSigStartValue" SG_ 469 RFC_Loc138_Phi 32768;
BA_ "GenSigSendType" SG_ 469 RFC_Loc138_DrVnce 9;
BA_ "GenSigSendType" SG_ 469 RFC_Loc138_VrVnce 9;
BA_ "GenSigSendType" SG_ 469 RFC_Loc138_ThetaVnce 9;
BA_ "GenSigSendType" SG_ 469 RFC_Loc138_PhiVnce 9;
BA_ "GenSigSendType" SG_ 469 RFC_Loc138_DrVrCoVnce 9;
BA_ "GenSigStartValue" SG_ 469 RFC_Loc138_DrVrCoVnce 32768;
BA_ "GenSigSendType" SG_ 469 RFC_Loc138_RCS 9;
BA_ "GenSigStartValue" SG_ 469 RFC_Loc138_RCS 32768;
BA_ "GenSigSendType" SG_ 469 RFC_Loc138_RSSI 9;
BA_ "GenSigSendType" SG_ 469 RFC_Loc138_DrVrQuality 9;
BA_ "GenSigSendType" SG_ 469 RFC_Loc138_ThetaQuality 9;
BA_ "GenSigSendType" SG_ 469 RFC_Loc138_PhiQuality 9;
BA_ "GenSigSendType" SG_ 469 RFC_Loc139_Dr 9;
BA_ "GenSigSendType" SG_ 469 RFC_Loc139_Vr 9;
BA_ "GenSigStartValue" SG_ 469 RFC_Loc139_Vr 32768;
BA_ "GenSigSendType" SG_ 469 RFC_Loc139_Theta 9;
BA_ "GenSigStartValue" SG_ 469 RFC_Loc139_Theta 32768;
BA_ "GenSigSendType" SG_ 469 RFC_Loc139_Phi 9;
BA_ "GenSigStartValue" SG_ 469 RFC_Loc139_Phi 32768;
BA_ "GenSigSendType" SG_ 469 RFC_Loc139_DrVnce 9;
BA_ "GenSigSendType" SG_ 469 RFC_Loc139_VrVnce 9;
BA_ "GenSigSendType" SG_ 469 RFC_Loc139_ThetaVnce 9;
BA_ "GenSigSendType" SG_ 469 RFC_Loc139_PhiVnce 9;
BA_ "GenSigSendType" SG_ 469 RFC_Loc139_DrVrCoVnce 9;
BA_ "GenSigStartValue" SG_ 469 RFC_Loc139_DrVrCoVnce 32768;
BA_ "GenSigSendType" SG_ 469 RFC_Loc139_RCS 9;
BA_ "GenSigStartValue" SG_ 469 RFC_Loc139_RCS 32768;
BA_ "GenSigSendType" SG_ 469 RFC_Loc139_RSSI 9;
BA_ "GenSigSendType" SG_ 469 RFC_Loc139_DrVrQuality 9;
BA_ "GenSigSendType" SG_ 469 RFC_Loc139_ThetaQuality 9;
BA_ "GenSigSendType" SG_ 469 RFC_Loc139_PhiQuality 9;
BA_ "GenSigSendType" SG_ 470 RFC_Loc140_CRC 9;
BA_ "GenSigSendType" SG_ 470 RFC_Loc140_AliveCtr 9;
BA_ "GenSigSendType" SG_ 470 RFC_Loc140_ProtBlockCtr 9;
BA_ "GenSigSendType" SG_ 470 RFC_Loc140_Dr 9;
BA_ "GenSigSendType" SG_ 470 RFC_Loc140_Vr 9;
BA_ "GenSigStartValue" SG_ 470 RFC_Loc140_Vr 32768;
BA_ "GenSigSendType" SG_ 470 RFC_Loc140_Theta 9;
BA_ "GenSigStartValue" SG_ 470 RFC_Loc140_Theta 32768;
BA_ "GenSigSendType" SG_ 470 RFC_Loc140_Phi 9;
BA_ "GenSigStartValue" SG_ 470 RFC_Loc140_Phi 32768;
BA_ "GenSigSendType" SG_ 470 RFC_Loc140_DrVnce 9;
BA_ "GenSigSendType" SG_ 470 RFC_Loc140_VrVnce 9;
BA_ "GenSigSendType" SG_ 470 RFC_Loc140_ThetaVnce 9;
BA_ "GenSigSendType" SG_ 470 RFC_Loc140_PhiVnce 9;
BA_ "GenSigSendType" SG_ 470 RFC_Loc140_DrVrCoVnce 9;
BA_ "GenSigStartValue" SG_ 470 RFC_Loc140_DrVrCoVnce 32768;
BA_ "GenSigSendType" SG_ 470 RFC_Loc140_RCS 9;
BA_ "GenSigStartValue" SG_ 470 RFC_Loc140_RCS 32768;
BA_ "GenSigSendType" SG_ 470 RFC_Loc140_RSSI 9;
BA_ "GenSigSendType" SG_ 470 RFC_Loc140_DrVrQuality 9;
BA_ "GenSigSendType" SG_ 470 RFC_Loc140_ThetaQuality 9;
BA_ "GenSigSendType" SG_ 470 RFC_Loc140_PhiQuality 9;
BA_ "GenSigSendType" SG_ 470 RFC_Loc141_Dr 9;
BA_ "GenSigSendType" SG_ 470 RFC_Loc141_Vr 9;
BA_ "GenSigStartValue" SG_ 470 RFC_Loc141_Vr 32768;
BA_ "GenSigSendType" SG_ 470 RFC_Loc141_Theta 9;
BA_ "GenSigStartValue" SG_ 470 RFC_Loc141_Theta 32768;
BA_ "GenSigSendType" SG_ 470 RFC_Loc141_Phi 9;
BA_ "GenSigStartValue" SG_ 470 RFC_Loc141_Phi 32768;
BA_ "GenSigSendType" SG_ 470 RFC_Loc141_DrVnce 9;
BA_ "GenSigSendType" SG_ 470 RFC_Loc141_VrVnce 9;
BA_ "GenSigSendType" SG_ 470 RFC_Loc141_ThetaVnce 9;
BA_ "GenSigSendType" SG_ 470 RFC_Loc141_PhiVnce 9;
BA_ "GenSigSendType" SG_ 470 RFC_Loc141_DrVrCoVnce 9;
BA_ "GenSigStartValue" SG_ 470 RFC_Loc141_DrVrCoVnce 32768;
BA_ "GenSigSendType" SG_ 470 RFC_Loc141_RCS 9;
BA_ "GenSigStartValue" SG_ 470 RFC_Loc141_RCS 32768;
BA_ "GenSigSendType" SG_ 470 RFC_Loc141_RSSI 9;
BA_ "GenSigSendType" SG_ 470 RFC_Loc141_DrVrQuality 9;
BA_ "GenSigSendType" SG_ 470 RFC_Loc141_ThetaQuality 9;
BA_ "GenSigSendType" SG_ 470 RFC_Loc141_PhiQuality 9;
BA_ "GenSigSendType" SG_ 471 RFC_Loc142_CRC 9;
BA_ "GenSigSendType" SG_ 471 RFC_Loc142_AliveCtr 9;
BA_ "GenSigSendType" SG_ 471 RFC_Loc142_ProtBlockCtr 9;
BA_ "GenSigSendType" SG_ 471 RFC_Loc142_Dr 9;
BA_ "GenSigSendType" SG_ 471 RFC_Loc142_Vr 9;
BA_ "GenSigStartValue" SG_ 471 RFC_Loc142_Vr 32768;
BA_ "GenSigSendType" SG_ 471 RFC_Loc142_Theta 9;
BA_ "GenSigStartValue" SG_ 471 RFC_Loc142_Theta 32768;
BA_ "GenSigSendType" SG_ 471 RFC_Loc142_Phi 9;
BA_ "GenSigStartValue" SG_ 471 RFC_Loc142_Phi 32768;
BA_ "GenSigSendType" SG_ 471 RFC_Loc142_DrVnce 9;
BA_ "GenSigSendType" SG_ 471 RFC_Loc142_VrVnce 9;
BA_ "GenSigSendType" SG_ 471 RFC_Loc142_ThetaVnce 9;
BA_ "GenSigSendType" SG_ 471 RFC_Loc142_PhiVnce 9;
BA_ "GenSigSendType" SG_ 471 RFC_Loc142_DrVrCoVnce 9;
BA_ "GenSigStartValue" SG_ 471 RFC_Loc142_DrVrCoVnce 32768;
BA_ "GenSigSendType" SG_ 471 RFC_Loc142_RCS 9;
BA_ "GenSigStartValue" SG_ 471 RFC_Loc142_RCS 32768;
BA_ "GenSigSendType" SG_ 471 RFC_Loc142_RSSI 9;
BA_ "GenSigSendType" SG_ 471 RFC_Loc142_DrVrQuality 9;
BA_ "GenSigSendType" SG_ 471 RFC_Loc142_ThetaQuality 9;
BA_ "GenSigSendType" SG_ 471 RFC_Loc142_PhiQuality 9;
BA_ "GenSigSendType" SG_ 471 RFC_Loc143_Dr 9;
BA_ "GenSigSendType" SG_ 471 RFC_Loc143_Vr 9;
BA_ "GenSigStartValue" SG_ 471 RFC_Loc143_Vr 32768;
BA_ "GenSigSendType" SG_ 471 RFC_Loc143_Theta 9;
BA_ "GenSigStartValue" SG_ 471 RFC_Loc143_Theta 32768;
BA_ "GenSigSendType" SG_ 471 RFC_Loc143_Phi 9;
BA_ "GenSigStartValue" SG_ 471 RFC_Loc143_Phi 32768;
BA_ "GenSigSendType" SG_ 471 RFC_Loc143_DrVnce 9;
BA_ "GenSigSendType" SG_ 471 RFC_Loc143_VrVnce 9;
BA_ "GenSigSendType" SG_ 471 RFC_Loc143_ThetaVnce 9;
BA_ "GenSigSendType" SG_ 471 RFC_Loc143_PhiVnce 9;
BA_ "GenSigSendType" SG_ 471 RFC_Loc143_DrVrCoVnce 9;
BA_ "GenSigStartValue" SG_ 471 RFC_Loc143_DrVrCoVnce 32768;
BA_ "GenSigSendType" SG_ 471 RFC_Loc143_RCS 9;
BA_ "GenSigStartValue" SG_ 471 RFC_Loc143_RCS 32768;
BA_ "GenSigSendType" SG_ 471 RFC_Loc143_RSSI 9;
BA_ "GenSigSendType" SG_ 471 RFC_Loc143_DrVrQuality 9;
BA_ "GenSigSendType" SG_ 471 RFC_Loc143_ThetaQuality 9;
BA_ "GenSigSendType" SG_ 471 RFC_Loc143_PhiQuality 9;
BA_ "GenSigSendType" SG_ 472 RFC_Loc144_CRC 9;
BA_ "GenSigSendType" SG_ 472 RFC_Loc144_AliveCtr 9;
BA_ "GenSigSendType" SG_ 472 RFC_Loc144_ProtBlockCtr 9;
BA_ "GenSigSendType" SG_ 472 RFC_Loc144_Dr 9;
BA_ "GenSigSendType" SG_ 472 RFC_Loc144_Vr 9;
BA_ "GenSigStartValue" SG_ 472 RFC_Loc144_Vr 32768;
BA_ "GenSigSendType" SG_ 472 RFC_Loc144_Theta 9;
BA_ "GenSigStartValue" SG_ 472 RFC_Loc144_Theta 32768;
BA_ "GenSigSendType" SG_ 472 RFC_Loc144_Phi 9;
BA_ "GenSigStartValue" SG_ 472 RFC_Loc144_Phi 32768;
BA_ "GenSigSendType" SG_ 472 RFC_Loc144_DrVnce 9;
BA_ "GenSigSendType" SG_ 472 RFC_Loc144_VrVnce 9;
BA_ "GenSigSendType" SG_ 472 RFC_Loc144_ThetaVnce 9;
BA_ "GenSigSendType" SG_ 472 RFC_Loc144_PhiVnce 9;
BA_ "GenSigSendType" SG_ 472 RFC_Loc144_DrVrCoVnce 9;
BA_ "GenSigStartValue" SG_ 472 RFC_Loc144_DrVrCoVnce 32768;
BA_ "GenSigSendType" SG_ 472 RFC_Loc144_RCS 9;
BA_ "GenSigStartValue" SG_ 472 RFC_Loc144_RCS 32768;
BA_ "GenSigSendType" SG_ 472 RFC_Loc144_RSSI 9;
BA_ "GenSigSendType" SG_ 472 RFC_Loc144_DrVrQuality 9;
BA_ "GenSigSendType" SG_ 472 RFC_Loc144_ThetaQuality 9;
BA_ "GenSigSendType" SG_ 472 RFC_Loc144_PhiQuality 9;
BA_ "GenSigSendType" SG_ 472 RFC_Loc145_Dr 9;
BA_ "GenSigSendType" SG_ 472 RFC_Loc145_Vr 9;
BA_ "GenSigStartValue" SG_ 472 RFC_Loc145_Vr 32768;
BA_ "GenSigSendType" SG_ 472 RFC_Loc145_Theta 9;
BA_ "GenSigStartValue" SG_ 472 RFC_Loc145_Theta 32768;
BA_ "GenSigSendType" SG_ 472 RFC_Loc145_Phi 9;
BA_ "GenSigStartValue" SG_ 472 RFC_Loc145_Phi 32768;
BA_ "GenSigSendType" SG_ 472 RFC_Loc145_DrVnce 9;
BA_ "GenSigSendType" SG_ 472 RFC_Loc145_VrVnce 9;
BA_ "GenSigSendType" SG_ 472 RFC_Loc145_ThetaVnce 9;
BA_ "GenSigSendType" SG_ 472 RFC_Loc145_PhiVnce 9;
BA_ "GenSigSendType" SG_ 472 RFC_Loc145_DrVrCoVnce 9;
BA_ "GenSigStartValue" SG_ 472 RFC_Loc145_DrVrCoVnce 32768;
BA_ "GenSigSendType" SG_ 472 RFC_Loc145_RCS 9;
BA_ "GenSigStartValue" SG_ 472 RFC_Loc145_RCS 32768;
BA_ "GenSigSendType" SG_ 472 RFC_Loc145_RSSI 9;
BA_ "GenSigSendType" SG_ 472 RFC_Loc145_DrVrQuality 9;
BA_ "GenSigSendType" SG_ 472 RFC_Loc145_ThetaQuality 9;
BA_ "GenSigSendType" SG_ 472 RFC_Loc145_PhiQuality 9;
BA_ "GenSigSendType" SG_ 473 RFC_Loc146_CRC 9;
BA_ "GenSigSendType" SG_ 473 RFC_Loc146_AliveCtr 9;
BA_ "GenSigSendType" SG_ 473 RFC_Loc146_ProtBlockCtr 9;
BA_ "GenSigSendType" SG_ 473 RFC_Loc146_Dr 9;
BA_ "GenSigSendType" SG_ 473 RFC_Loc146_Vr 9;
BA_ "GenSigStartValue" SG_ 473 RFC_Loc146_Vr 32768;
BA_ "GenSigSendType" SG_ 473 RFC_Loc146_Theta 9;
BA_ "GenSigStartValue" SG_ 473 RFC_Loc146_Theta 32768;
BA_ "GenSigSendType" SG_ 473 RFC_Loc146_Phi 9;
BA_ "GenSigStartValue" SG_ 473 RFC_Loc146_Phi 32768;
BA_ "GenSigSendType" SG_ 473 RFC_Loc146_DrVnce 9;
BA_ "GenSigSendType" SG_ 473 RFC_Loc146_VrVnce 9;
BA_ "GenSigSendType" SG_ 473 RFC_Loc146_ThetaVnce 9;
BA_ "GenSigSendType" SG_ 473 RFC_Loc146_PhiVnce 9;
BA_ "GenSigSendType" SG_ 473 RFC_Loc146_DrVrCoVnce 9;
BA_ "GenSigStartValue" SG_ 473 RFC_Loc146_DrVrCoVnce 32768;
BA_ "GenSigSendType" SG_ 473 RFC_Loc146_RCS 9;
BA_ "GenSigStartValue" SG_ 473 RFC_Loc146_RCS 32768;
BA_ "GenSigSendType" SG_ 473 RFC_Loc146_RSSI 9;
BA_ "GenSigSendType" SG_ 473 RFC_Loc146_DrVrQuality 9;
BA_ "GenSigSendType" SG_ 473 RFC_Loc146_ThetaQuality 9;
BA_ "GenSigSendType" SG_ 473 RFC_Loc146_PhiQuality 9;
BA_ "GenSigSendType" SG_ 473 RFC_Loc147_Dr 9;
BA_ "GenSigSendType" SG_ 473 RFC_Loc147_Vr 9;
BA_ "GenSigStartValue" SG_ 473 RFC_Loc147_Vr 32768;
BA_ "GenSigSendType" SG_ 473 RFC_Loc147_Theta 9;
BA_ "GenSigStartValue" SG_ 473 RFC_Loc147_Theta 32768;
BA_ "GenSigSendType" SG_ 473 RFC_Loc147_Phi 9;
BA_ "GenSigStartValue" SG_ 473 RFC_Loc147_Phi 32768;
BA_ "GenSigSendType" SG_ 473 RFC_Loc147_DrVnce 9;
BA_ "GenSigSendType" SG_ 473 RFC_Loc147_VrVnce 9;
BA_ "GenSigSendType" SG_ 473 RFC_Loc147_ThetaVnce 9;
BA_ "GenSigSendType" SG_ 473 RFC_Loc147_PhiVnce 9;
BA_ "GenSigSendType" SG_ 473 RFC_Loc147_DrVrCoVnce 9;
BA_ "GenSigStartValue" SG_ 473 RFC_Loc147_DrVrCoVnce 32768;
BA_ "GenSigSendType" SG_ 473 RFC_Loc147_RCS 9;
BA_ "GenSigStartValue" SG_ 473 RFC_Loc147_RCS 32768;
BA_ "GenSigSendType" SG_ 473 RFC_Loc147_RSSI 9;
BA_ "GenSigSendType" SG_ 473 RFC_Loc147_DrVrQuality 9;
BA_ "GenSigSendType" SG_ 473 RFC_Loc147_ThetaQuality 9;
BA_ "GenSigSendType" SG_ 473 RFC_Loc147_PhiQuality 9;
BA_ "GenSigSendType" SG_ 474 RFC_Loc148_CRC 9;
BA_ "GenSigSendType" SG_ 474 RFC_Loc148_AliveCtr 9;
BA_ "GenSigSendType" SG_ 474 RFC_Loc148_ProtBlockCtr 9;
BA_ "GenSigSendType" SG_ 474 RFC_Loc148_Dr 9;
BA_ "GenSigSendType" SG_ 474 RFC_Loc148_Vr 9;
BA_ "GenSigStartValue" SG_ 474 RFC_Loc148_Vr 32768;
BA_ "GenSigSendType" SG_ 474 RFC_Loc148_Theta 9;
BA_ "GenSigStartValue" SG_ 474 RFC_Loc148_Theta 32768;
BA_ "GenSigSendType" SG_ 474 RFC_Loc148_Phi 9;
BA_ "GenSigStartValue" SG_ 474 RFC_Loc148_Phi 32768;
BA_ "GenSigSendType" SG_ 474 RFC_Loc148_DrVnce 9;
BA_ "GenSigSendType" SG_ 474 RFC_Loc148_VrVnce 9;
BA_ "GenSigSendType" SG_ 474 RFC_Loc148_ThetaVnce 9;
BA_ "GenSigSendType" SG_ 474 RFC_Loc148_PhiVnce 9;
BA_ "GenSigSendType" SG_ 474 RFC_Loc148_DrVrCoVnce 9;
BA_ "GenSigStartValue" SG_ 474 RFC_Loc148_DrVrCoVnce 32768;
BA_ "GenSigSendType" SG_ 474 RFC_Loc148_RCS 9;
BA_ "GenSigStartValue" SG_ 474 RFC_Loc148_RCS 32768;
BA_ "GenSigSendType" SG_ 474 RFC_Loc148_RSSI 9;
BA_ "GenSigSendType" SG_ 474 RFC_Loc148_DrVrQuality 9;
BA_ "GenSigSendType" SG_ 474 RFC_Loc148_ThetaQuality 9;
BA_ "GenSigSendType" SG_ 474 RFC_Loc148_PhiQuality 9;
BA_ "GenSigSendType" SG_ 474 RFC_Loc149_Dr 9;
BA_ "GenSigSendType" SG_ 474 RFC_Loc149_Vr 9;
BA_ "GenSigStartValue" SG_ 474 RFC_Loc149_Vr 32768;
BA_ "GenSigSendType" SG_ 474 RFC_Loc149_Theta 9;
BA_ "GenSigStartValue" SG_ 474 RFC_Loc149_Theta 32768;
BA_ "GenSigSendType" SG_ 474 RFC_Loc149_Phi 9;
BA_ "GenSigStartValue" SG_ 474 RFC_Loc149_Phi 32768;
BA_ "GenSigSendType" SG_ 474 RFC_Loc149_DrVnce 9;
BA_ "GenSigSendType" SG_ 474 RFC_Loc149_VrVnce 9;
BA_ "GenSigSendType" SG_ 474 RFC_Loc149_ThetaVnce 9;
BA_ "GenSigSendType" SG_ 474 RFC_Loc149_PhiVnce 9;
BA_ "GenSigSendType" SG_ 474 RFC_Loc149_DrVrCoVnce 9;
BA_ "GenSigStartValue" SG_ 474 RFC_Loc149_DrVrCoVnce 32768;
BA_ "GenSigSendType" SG_ 474 RFC_Loc149_RCS 9;
BA_ "GenSigStartValue" SG_ 474 RFC_Loc149_RCS 32768;
BA_ "GenSigSendType" SG_ 474 RFC_Loc149_RSSI 9;
BA_ "GenSigSendType" SG_ 474 RFC_Loc149_DrVrQuality 9;
BA_ "GenSigSendType" SG_ 474 RFC_Loc149_ThetaQuality 9;
BA_ "GenSigSendType" SG_ 474 RFC_Loc149_PhiQuality 9;
BA_ "GenSigSendType" SG_ 475 RFC_Loc150_CRC 9;
BA_ "GenSigSendType" SG_ 475 RFC_Loc150_AliveCtr 9;
BA_ "GenSigSendType" SG_ 475 RFC_Loc150_ProtBlockCtr 9;
BA_ "GenSigSendType" SG_ 475 RFC_Loc150_Dr 9;
BA_ "GenSigSendType" SG_ 475 RFC_Loc150_Vr 9;
BA_ "GenSigStartValue" SG_ 475 RFC_Loc150_Vr 32768;
BA_ "GenSigSendType" SG_ 475 RFC_Loc150_Theta 9;
BA_ "GenSigStartValue" SG_ 475 RFC_Loc150_Theta 32768;
BA_ "GenSigSendType" SG_ 475 RFC_Loc150_Phi 9;
BA_ "GenSigStartValue" SG_ 475 RFC_Loc150_Phi 32768;
BA_ "GenSigSendType" SG_ 475 RFC_Loc150_DrVnce 9;
BA_ "GenSigSendType" SG_ 475 RFC_Loc150_VrVnce 9;
BA_ "GenSigSendType" SG_ 475 RFC_Loc150_ThetaVnce 9;
BA_ "GenSigSendType" SG_ 475 RFC_Loc150_PhiVnce 9;
BA_ "GenSigSendType" SG_ 475 RFC_Loc150_DrVrCoVnce 9;
BA_ "GenSigStartValue" SG_ 475 RFC_Loc150_DrVrCoVnce 32768;
BA_ "GenSigSendType" SG_ 475 RFC_Loc150_RCS 9;
BA_ "GenSigStartValue" SG_ 475 RFC_Loc150_RCS 32768;
BA_ "GenSigSendType" SG_ 475 RFC_Loc150_RSSI 9;
BA_ "GenSigSendType" SG_ 475 RFC_Loc150_DrVrQuality 9;
BA_ "GenSigSendType" SG_ 475 RFC_Loc150_ThetaQuality 9;
BA_ "GenSigSendType" SG_ 475 RFC_Loc150_PhiQuality 9;
BA_ "GenSigSendType" SG_ 475 RFC_Loc151_Dr 9;
BA_ "GenSigSendType" SG_ 475 RFC_Loc151_Vr 9;
BA_ "GenSigStartValue" SG_ 475 RFC_Loc151_Vr 32768;
BA_ "GenSigSendType" SG_ 475 RFC_Loc151_Theta 9;
BA_ "GenSigStartValue" SG_ 475 RFC_Loc151_Theta 32768;
BA_ "GenSigSendType" SG_ 475 RFC_Loc151_Phi 9;
BA_ "GenSigStartValue" SG_ 475 RFC_Loc151_Phi 32768;
BA_ "GenSigSendType" SG_ 475 RFC_Loc151_DrVnce 9;
BA_ "GenSigSendType" SG_ 475 RFC_Loc151_VrVnce 9;
BA_ "GenSigSendType" SG_ 475 RFC_Loc151_ThetaVnce 9;
BA_ "GenSigSendType" SG_ 475 RFC_Loc151_PhiVnce 9;
BA_ "GenSigSendType" SG_ 475 RFC_Loc151_DrVrCoVnce 9;
BA_ "GenSigStartValue" SG_ 475 RFC_Loc151_DrVrCoVnce 32768;
BA_ "GenSigSendType" SG_ 475 RFC_Loc151_RCS 9;
BA_ "GenSigStartValue" SG_ 475 RFC_Loc151_RCS 32768;
BA_ "GenSigSendType" SG_ 475 RFC_Loc151_RSSI 9;
BA_ "GenSigSendType" SG_ 475 RFC_Loc151_DrVrQuality 9;
BA_ "GenSigSendType" SG_ 475 RFC_Loc151_ThetaQuality 9;
BA_ "GenSigSendType" SG_ 475 RFC_Loc151_PhiQuality 9;
BA_ "GenSigSendType" SG_ 476 RFC_Loc152_CRC 9;
BA_ "GenSigSendType" SG_ 476 RFC_Loc152_AliveCtr 9;
BA_ "GenSigSendType" SG_ 476 RFC_Loc152_ProtBlockCtr 9;
BA_ "GenSigSendType" SG_ 476 RFC_Loc152_Dr 9;
BA_ "GenSigSendType" SG_ 476 RFC_Loc152_Vr 9;
BA_ "GenSigStartValue" SG_ 476 RFC_Loc152_Vr 32768;
BA_ "GenSigSendType" SG_ 476 RFC_Loc152_Theta 9;
BA_ "GenSigStartValue" SG_ 476 RFC_Loc152_Theta 32768;
BA_ "GenSigSendType" SG_ 476 RFC_Loc152_Phi 9;
BA_ "GenSigStartValue" SG_ 476 RFC_Loc152_Phi 32768;
BA_ "GenSigSendType" SG_ 476 RFC_Loc152_DrVnce 9;
BA_ "GenSigSendType" SG_ 476 RFC_Loc152_VrVnce 9;
BA_ "GenSigSendType" SG_ 476 RFC_Loc152_ThetaVnce 9;
BA_ "GenSigSendType" SG_ 476 RFC_Loc152_PhiVnce 9;
BA_ "GenSigSendType" SG_ 476 RFC_Loc152_DrVrCoVnce 9;
BA_ "GenSigStartValue" SG_ 476 RFC_Loc152_DrVrCoVnce 32768;
BA_ "GenSigSendType" SG_ 476 RFC_Loc152_RCS 9;
BA_ "GenSigStartValue" SG_ 476 RFC_Loc152_RCS 32768;
BA_ "GenSigSendType" SG_ 476 RFC_Loc152_RSSI 9;
BA_ "GenSigSendType" SG_ 476 RFC_Loc152_DrVrQuality 9;
BA_ "GenSigSendType" SG_ 476 RFC_Loc152_ThetaQuality 9;
BA_ "GenSigSendType" SG_ 476 RFC_Loc152_PhiQuality 9;
BA_ "GenSigSendType" SG_ 476 RFC_Loc153_Dr 9;
BA_ "GenSigSendType" SG_ 476 RFC_Loc153_Vr 9;
BA_ "GenSigStartValue" SG_ 476 RFC_Loc153_Vr 32768;
BA_ "GenSigSendType" SG_ 476 RFC_Loc153_Theta 9;
BA_ "GenSigStartValue" SG_ 476 RFC_Loc153_Theta 32768;
BA_ "GenSigSendType" SG_ 476 RFC_Loc153_Phi 9;
BA_ "GenSigStartValue" SG_ 476 RFC_Loc153_Phi 32768;
BA_ "GenSigSendType" SG_ 476 RFC_Loc153_DrVnce 9;
BA_ "GenSigSendType" SG_ 476 RFC_Loc153_VrVnce 9;
BA_ "GenSigSendType" SG_ 476 RFC_Loc153_ThetaVnce 9;
BA_ "GenSigSendType" SG_ 476 RFC_Loc153_PhiVnce 9;
BA_ "GenSigSendType" SG_ 476 RFC_Loc153_DrVrCoVnce 9;
BA_ "GenSigStartValue" SG_ 476 RFC_Loc153_DrVrCoVnce 32768;
BA_ "GenSigSendType" SG_ 476 RFC_Loc153_RCS 9;
BA_ "GenSigStartValue" SG_ 476 RFC_Loc153_RCS 32768;
BA_ "GenSigSendType" SG_ 476 RFC_Loc153_RSSI 9;
BA_ "GenSigSendType" SG_ 476 RFC_Loc153_DrVrQuality 9;
BA_ "GenSigSendType" SG_ 476 RFC_Loc153_ThetaQuality 9;
BA_ "GenSigSendType" SG_ 476 RFC_Loc153_PhiQuality 9;
BA_ "GenSigSendType" SG_ 477 RFC_Loc154_CRC 9;
BA_ "GenSigSendType" SG_ 477 RFC_Loc154_AliveCtr 9;
BA_ "GenSigSendType" SG_ 477 RFC_Loc154_ProtBlockCtr 9;
BA_ "GenSigSendType" SG_ 477 RFC_Loc154_Dr 9;
BA_ "GenSigSendType" SG_ 477 RFC_Loc154_Vr 9;
BA_ "GenSigStartValue" SG_ 477 RFC_Loc154_Vr 32768;
BA_ "GenSigSendType" SG_ 477 RFC_Loc154_Theta 9;
BA_ "GenSigStartValue" SG_ 477 RFC_Loc154_Theta 32768;
BA_ "GenSigSendType" SG_ 477 RFC_Loc154_Phi 9;
BA_ "GenSigStartValue" SG_ 477 RFC_Loc154_Phi 32768;
BA_ "GenSigSendType" SG_ 477 RFC_Loc154_DrVnce 9;
BA_ "GenSigSendType" SG_ 477 RFC_Loc154_VrVnce 9;
BA_ "GenSigSendType" SG_ 477 RFC_Loc154_ThetaVnce 9;
BA_ "GenSigSendType" SG_ 477 RFC_Loc154_PhiVnce 9;
BA_ "GenSigSendType" SG_ 477 RFC_Loc154_DrVrCoVnce 9;
BA_ "GenSigStartValue" SG_ 477 RFC_Loc154_DrVrCoVnce 32768;
BA_ "GenSigSendType" SG_ 477 RFC_Loc154_RCS 9;
BA_ "GenSigStartValue" SG_ 477 RFC_Loc154_RCS 32768;
BA_ "GenSigSendType" SG_ 477 RFC_Loc154_RSSI 9;
BA_ "GenSigSendType" SG_ 477 RFC_Loc154_DrVrQuality 9;
BA_ "GenSigSendType" SG_ 477 RFC_Loc154_ThetaQuality 9;
BA_ "GenSigSendType" SG_ 477 RFC_Loc154_PhiQuality 9;
BA_ "GenSigSendType" SG_ 477 RFC_Loc155_Dr 9;
BA_ "GenSigSendType" SG_ 477 RFC_Loc155_Vr 9;
BA_ "GenSigStartValue" SG_ 477 RFC_Loc155_Vr 32768;
BA_ "GenSigSendType" SG_ 477 RFC_Loc155_Theta 9;
BA_ "GenSigStartValue" SG_ 477 RFC_Loc155_Theta 32768;
BA_ "GenSigSendType" SG_ 477 RFC_Loc155_Phi 9;
BA_ "GenSigStartValue" SG_ 477 RFC_Loc155_Phi 32768;
BA_ "GenSigSendType" SG_ 477 RFC_Loc155_DrVnce 9;
BA_ "GenSigSendType" SG_ 477 RFC_Loc155_VrVnce 9;
BA_ "GenSigSendType" SG_ 477 RFC_Loc155_ThetaVnce 9;
BA_ "GenSigSendType" SG_ 477 RFC_Loc155_PhiVnce 9;
BA_ "GenSigSendType" SG_ 477 RFC_Loc155_DrVrCoVnce 9;
BA_ "GenSigStartValue" SG_ 477 RFC_Loc155_DrVrCoVnce 32768;
BA_ "GenSigSendType" SG_ 477 RFC_Loc155_RCS 9;
BA_ "GenSigStartValue" SG_ 477 RFC_Loc155_RCS 32768;
BA_ "GenSigSendType" SG_ 477 RFC_Loc155_RSSI 9;
BA_ "GenSigSendType" SG_ 477 RFC_Loc155_DrVrQuality 9;
BA_ "GenSigSendType" SG_ 477 RFC_Loc155_ThetaQuality 9;
BA_ "GenSigSendType" SG_ 477 RFC_Loc155_PhiQuality 9;
BA_ "GenSigSendType" SG_ 478 RFC_Loc156_CRC 9;
BA_ "GenSigSendType" SG_ 478 RFC_Loc156_AliveCtr 9;
BA_ "GenSigSendType" SG_ 478 RFC_Loc156_ProtBlockCtr 9;
BA_ "GenSigSendType" SG_ 478 RFC_Loc156_Dr 9;
BA_ "GenSigSendType" SG_ 478 RFC_Loc156_Vr 9;
BA_ "GenSigStartValue" SG_ 478 RFC_Loc156_Vr 32768;
BA_ "GenSigSendType" SG_ 478 RFC_Loc156_Theta 9;
BA_ "GenSigStartValue" SG_ 478 RFC_Loc156_Theta 32768;
BA_ "GenSigSendType" SG_ 478 RFC_Loc156_Phi 9;
BA_ "GenSigStartValue" SG_ 478 RFC_Loc156_Phi 32768;
BA_ "GenSigSendType" SG_ 478 RFC_Loc156_DrVnce 9;
BA_ "GenSigSendType" SG_ 478 RFC_Loc156_VrVnce 9;
BA_ "GenSigSendType" SG_ 478 RFC_Loc156_ThetaVnce 9;
BA_ "GenSigSendType" SG_ 478 RFC_Loc156_PhiVnce 9;
BA_ "GenSigSendType" SG_ 478 RFC_Loc156_DrVrCoVnce 9;
BA_ "GenSigStartValue" SG_ 478 RFC_Loc156_DrVrCoVnce 32768;
BA_ "GenSigSendType" SG_ 478 RFC_Loc156_RCS 9;
BA_ "GenSigStartValue" SG_ 478 RFC_Loc156_RCS 32768;
BA_ "GenSigSendType" SG_ 478 RFC_Loc156_RSSI 9;
BA_ "GenSigSendType" SG_ 478 RFC_Loc156_DrVrQuality 9;
BA_ "GenSigSendType" SG_ 478 RFC_Loc156_ThetaQuality 9;
BA_ "GenSigSendType" SG_ 478 RFC_Loc156_PhiQuality 9;
BA_ "GenSigSendType" SG_ 478 RFC_Loc157_Dr 9;
BA_ "GenSigSendType" SG_ 478 RFC_Loc157_Vr 9;
BA_ "GenSigStartValue" SG_ 478 RFC_Loc157_Vr 32768;
BA_ "GenSigSendType" SG_ 478 RFC_Loc157_Theta 9;
BA_ "GenSigStartValue" SG_ 478 RFC_Loc157_Theta 32768;
BA_ "GenSigSendType" SG_ 478 RFC_Loc157_Phi 9;
BA_ "GenSigStartValue" SG_ 478 RFC_Loc157_Phi 32768;
BA_ "GenSigSendType" SG_ 478 RFC_Loc157_DrVnce 9;
BA_ "GenSigSendType" SG_ 478 RFC_Loc157_VrVnce 9;
BA_ "GenSigSendType" SG_ 478 RFC_Loc157_ThetaVnce 9;
BA_ "GenSigSendType" SG_ 478 RFC_Loc157_PhiVnce 9;
BA_ "GenSigSendType" SG_ 478 RFC_Loc157_DrVrCoVnce 9;
BA_ "GenSigStartValue" SG_ 478 RFC_Loc157_DrVrCoVnce 32768;
BA_ "GenSigSendType" SG_ 478 RFC_Loc157_RCS 9;
BA_ "GenSigStartValue" SG_ 478 RFC_Loc157_RCS 32768;
BA_ "GenSigSendType" SG_ 478 RFC_Loc157_RSSI 9;
BA_ "GenSigSendType" SG_ 478 RFC_Loc157_DrVrQuality 9;
BA_ "GenSigSendType" SG_ 478 RFC_Loc157_ThetaQuality 9;
BA_ "GenSigSendType" SG_ 478 RFC_Loc157_PhiQuality 9;
BA_ "GenSigSendType" SG_ 479 RFC_Loc158_CRC 9;
BA_ "GenSigSendType" SG_ 479 RFC_Loc158_AliveCtr 9;
BA_ "GenSigSendType" SG_ 479 RFC_Loc158_ProtBlockCtr 9;
BA_ "GenSigSendType" SG_ 479 RFC_Loc158_Dr 9;
BA_ "GenSigSendType" SG_ 479 RFC_Loc158_Vr 9;
BA_ "GenSigStartValue" SG_ 479 RFC_Loc158_Vr 32768;
BA_ "GenSigSendType" SG_ 479 RFC_Loc158_Theta 9;
BA_ "GenSigStartValue" SG_ 479 RFC_Loc158_Theta 32768;
BA_ "GenSigSendType" SG_ 479 RFC_Loc158_Phi 9;
BA_ "GenSigStartValue" SG_ 479 RFC_Loc158_Phi 32768;
BA_ "GenSigSendType" SG_ 479 RFC_Loc158_DrVnce 9;
BA_ "GenSigSendType" SG_ 479 RFC_Loc158_VrVnce 9;
BA_ "GenSigSendType" SG_ 479 RFC_Loc158_ThetaVnce 9;
BA_ "GenSigSendType" SG_ 479 RFC_Loc158_PhiVnce 9;
BA_ "GenSigSendType" SG_ 479 RFC_Loc158_DrVrCoVnce 9;
BA_ "GenSigStartValue" SG_ 479 RFC_Loc158_DrVrCoVnce 32768;
BA_ "GenSigSendType" SG_ 479 RFC_Loc158_RCS 9;
BA_ "GenSigStartValue" SG_ 479 RFC_Loc158_RCS 32768;
BA_ "GenSigSendType" SG_ 479 RFC_Loc158_RSSI 9;
BA_ "GenSigSendType" SG_ 479 RFC_Loc158_DrVrQuality 9;
BA_ "GenSigSendType" SG_ 479 RFC_Loc158_ThetaQuality 9;
BA_ "GenSigSendType" SG_ 479 RFC_Loc158_PhiQuality 9;
BA_ "GenSigSendType" SG_ 479 RFC_Loc159_Dr 9;
BA_ "GenSigSendType" SG_ 479 RFC_Loc159_Vr 9;
BA_ "GenSigStartValue" SG_ 479 RFC_Loc159_Vr 32768;
BA_ "GenSigSendType" SG_ 479 RFC_Loc159_Theta 9;
BA_ "GenSigStartValue" SG_ 479 RFC_Loc159_Theta 32768;
BA_ "GenSigSendType" SG_ 479 RFC_Loc159_Phi 9;
BA_ "GenSigStartValue" SG_ 479 RFC_Loc159_Phi 32768;
BA_ "GenSigSendType" SG_ 479 RFC_Loc159_DrVnce 9;
BA_ "GenSigSendType" SG_ 479 RFC_Loc159_VrVnce 9;
BA_ "GenSigSendType" SG_ 479 RFC_Loc159_ThetaVnce 9;
BA_ "GenSigSendType" SG_ 479 RFC_Loc159_PhiVnce 9;
BA_ "GenSigSendType" SG_ 479 RFC_Loc159_DrVrCoVnce 9;
BA_ "GenSigStartValue" SG_ 479 RFC_Loc159_DrVrCoVnce 32768;
BA_ "GenSigSendType" SG_ 479 RFC_Loc159_RCS 9;
BA_ "GenSigStartValue" SG_ 479 RFC_Loc159_RCS 32768;
BA_ "GenSigSendType" SG_ 479 RFC_Loc159_RSSI 9;
BA_ "GenSigSendType" SG_ 479 RFC_Loc159_DrVrQuality 9;
BA_ "GenSigSendType" SG_ 479 RFC_Loc159_ThetaQuality 9;
BA_ "GenSigSendType" SG_ 479 RFC_Loc159_PhiQuality 9;
BA_ "GenSigSendType" SG_ 480 RFC_Loc160_CRC 9;
BA_ "GenSigSendType" SG_ 480 RFC_Loc160_AliveCtr 9;
BA_ "GenSigSendType" SG_ 480 RFC_Loc160_ProtBlockCtr 9;
BA_ "GenSigSendType" SG_ 480 RFC_Loc160_Dr 9;
BA_ "GenSigSendType" SG_ 480 RFC_Loc160_Vr 9;
BA_ "GenSigStartValue" SG_ 480 RFC_Loc160_Vr 32768;
BA_ "GenSigSendType" SG_ 480 RFC_Loc160_Theta 9;
BA_ "GenSigStartValue" SG_ 480 RFC_Loc160_Theta 32768;
BA_ "GenSigSendType" SG_ 480 RFC_Loc160_Phi 9;
BA_ "GenSigStartValue" SG_ 480 RFC_Loc160_Phi 32768;
BA_ "GenSigSendType" SG_ 480 RFC_Loc160_DrVnce 9;
BA_ "GenSigSendType" SG_ 480 RFC_Loc160_VrVnce 9;
BA_ "GenSigSendType" SG_ 480 RFC_Loc160_ThetaVnce 9;
BA_ "GenSigSendType" SG_ 480 RFC_Loc160_PhiVnce 9;
BA_ "GenSigSendType" SG_ 480 RFC_Loc160_DrVrCoVnce 9;
BA_ "GenSigStartValue" SG_ 480 RFC_Loc160_DrVrCoVnce 32768;
BA_ "GenSigSendType" SG_ 480 RFC_Loc160_RCS 9;
BA_ "GenSigStartValue" SG_ 480 RFC_Loc160_RCS 32768;
BA_ "GenSigSendType" SG_ 480 RFC_Loc160_RSSI 9;
BA_ "GenSigSendType" SG_ 480 RFC_Loc160_DrVrQuality 9;
BA_ "GenSigSendType" SG_ 480 RFC_Loc160_ThetaQuality 9;
BA_ "GenSigSendType" SG_ 480 RFC_Loc160_PhiQuality 9;
BA_ "GenSigSendType" SG_ 480 RFC_Loc161_Dr 9;
BA_ "GenSigSendType" SG_ 480 RFC_Loc161_Vr 9;
BA_ "GenSigStartValue" SG_ 480 RFC_Loc161_Vr 32768;
BA_ "GenSigSendType" SG_ 480 RFC_Loc161_Theta 9;
BA_ "GenSigStartValue" SG_ 480 RFC_Loc161_Theta 32768;
BA_ "GenSigSendType" SG_ 480 RFC_Loc161_Phi 9;
BA_ "GenSigStartValue" SG_ 480 RFC_Loc161_Phi 32768;
BA_ "GenSigSendType" SG_ 480 RFC_Loc161_DrVnce 9;
BA_ "GenSigSendType" SG_ 480 RFC_Loc161_VrVnce 9;
BA_ "GenSigSendType" SG_ 480 RFC_Loc161_ThetaVnce 9;
BA_ "GenSigSendType" SG_ 480 RFC_Loc161_PhiVnce 9;
BA_ "GenSigSendType" SG_ 480 RFC_Loc161_DrVrCoVnce 9;
BA_ "GenSigStartValue" SG_ 480 RFC_Loc161_DrVrCoVnce 32768;
BA_ "GenSigSendType" SG_ 480 RFC_Loc161_RCS 9;
BA_ "GenSigStartValue" SG_ 480 RFC_Loc161_RCS 32768;
BA_ "GenSigSendType" SG_ 480 RFC_Loc161_RSSI 9;
BA_ "GenSigSendType" SG_ 480 RFC_Loc161_DrVrQuality 9;
BA_ "GenSigSendType" SG_ 480 RFC_Loc161_ThetaQuality 9;
BA_ "GenSigSendType" SG_ 480 RFC_Loc161_PhiQuality 9;
BA_ "GenSigSendType" SG_ 481 RFC_Loc162_CRC 9;
BA_ "GenSigSendType" SG_ 481 RFC_Loc162_AliveCtr 9;
BA_ "GenSigSendType" SG_ 481 RFC_Loc162_ProtBlockCtr 9;
BA_ "GenSigSendType" SG_ 481 RFC_Loc162_Dr 9;
BA_ "GenSigSendType" SG_ 481 RFC_Loc162_Vr 9;
BA_ "GenSigStartValue" SG_ 481 RFC_Loc162_Vr 32768;
BA_ "GenSigSendType" SG_ 481 RFC_Loc162_Theta 9;
BA_ "GenSigStartValue" SG_ 481 RFC_Loc162_Theta 32768;
BA_ "GenSigSendType" SG_ 481 RFC_Loc162_Phi 9;
BA_ "GenSigStartValue" SG_ 481 RFC_Loc162_Phi 32768;
BA_ "GenSigSendType" SG_ 481 RFC_Loc162_DrVnce 9;
BA_ "GenSigSendType" SG_ 481 RFC_Loc162_VrVnce 9;
BA_ "GenSigSendType" SG_ 481 RFC_Loc162_ThetaVnce 9;
BA_ "GenSigSendType" SG_ 481 RFC_Loc162_PhiVnce 9;
BA_ "GenSigSendType" SG_ 481 RFC_Loc162_DrVrCoVnce 9;
BA_ "GenSigStartValue" SG_ 481 RFC_Loc162_DrVrCoVnce 32768;
BA_ "GenSigSendType" SG_ 481 RFC_Loc162_RCS 9;
BA_ "GenSigStartValue" SG_ 481 RFC_Loc162_RCS 32768;
BA_ "GenSigSendType" SG_ 481 RFC_Loc162_RSSI 9;
BA_ "GenSigSendType" SG_ 481 RFC_Loc162_DrVrQuality 9;
BA_ "GenSigSendType" SG_ 481 RFC_Loc162_ThetaQuality 9;
BA_ "GenSigSendType" SG_ 481 RFC_Loc162_PhiQuality 9;
BA_ "GenSigSendType" SG_ 481 RFC_Loc163_Dr 9;
BA_ "GenSigSendType" SG_ 481 RFC_Loc163_Vr 9;
BA_ "GenSigStartValue" SG_ 481 RFC_Loc163_Vr 32768;
BA_ "GenSigSendType" SG_ 481 RFC_Loc163_Theta 9;
BA_ "GenSigStartValue" SG_ 481 RFC_Loc163_Theta 32768;
BA_ "GenSigSendType" SG_ 481 RFC_Loc163_Phi 9;
BA_ "GenSigStartValue" SG_ 481 RFC_Loc163_Phi 32768;
BA_ "GenSigSendType" SG_ 481 RFC_Loc163_DrVnce 9;
BA_ "GenSigSendType" SG_ 481 RFC_Loc163_VrVnce 9;
BA_ "GenSigSendType" SG_ 481 RFC_Loc163_ThetaVnce 9;
BA_ "GenSigSendType" SG_ 481 RFC_Loc163_PhiVnce 9;
BA_ "GenSigSendType" SG_ 481 RFC_Loc163_DrVrCoVnce 9;
BA_ "GenSigStartValue" SG_ 481 RFC_Loc163_DrVrCoVnce 32768;
BA_ "GenSigSendType" SG_ 481 RFC_Loc163_RCS 9;
BA_ "GenSigStartValue" SG_ 481 RFC_Loc163_RCS 32768;
BA_ "GenSigSendType" SG_ 481 RFC_Loc163_RSSI 9;
BA_ "GenSigSendType" SG_ 481 RFC_Loc163_DrVrQuality 9;
BA_ "GenSigSendType" SG_ 481 RFC_Loc163_ThetaQuality 9;
BA_ "GenSigSendType" SG_ 481 RFC_Loc163_PhiQuality 9;
BA_ "GenSigSendType" SG_ 482 RFC_Loc164_CRC 9;
BA_ "GenSigSendType" SG_ 482 RFC_Loc164_AliveCtr 9;
BA_ "GenSigSendType" SG_ 482 RFC_Loc164_ProtBlockCtr 9;
BA_ "GenSigSendType" SG_ 482 RFC_Loc164_Dr 9;
BA_ "GenSigSendType" SG_ 482 RFC_Loc164_Vr 9;
BA_ "GenSigStartValue" SG_ 482 RFC_Loc164_Vr 32768;
BA_ "GenSigSendType" SG_ 482 RFC_Loc164_Theta 9;
BA_ "GenSigStartValue" SG_ 482 RFC_Loc164_Theta 32768;
BA_ "GenSigSendType" SG_ 482 RFC_Loc164_Phi 9;
BA_ "GenSigStartValue" SG_ 482 RFC_Loc164_Phi 32768;
BA_ "GenSigSendType" SG_ 482 RFC_Loc164_DrVnce 9;
BA_ "GenSigSendType" SG_ 482 RFC_Loc164_VrVnce 9;
BA_ "GenSigSendType" SG_ 482 RFC_Loc164_ThetaVnce 9;
BA_ "GenSigSendType" SG_ 482 RFC_Loc164_PhiVnce 9;
BA_ "GenSigSendType" SG_ 482 RFC_Loc164_DrVrCoVnce 9;
BA_ "GenSigStartValue" SG_ 482 RFC_Loc164_DrVrCoVnce 32768;
BA_ "GenSigSendType" SG_ 482 RFC_Loc164_RCS 9;
BA_ "GenSigStartValue" SG_ 482 RFC_Loc164_RCS 32768;
BA_ "GenSigSendType" SG_ 482 RFC_Loc164_RSSI 9;
BA_ "GenSigSendType" SG_ 482 RFC_Loc164_DrVrQuality 9;
BA_ "GenSigSendType" SG_ 482 RFC_Loc164_ThetaQuality 9;
BA_ "GenSigSendType" SG_ 482 RFC_Loc164_PhiQuality 9;
BA_ "GenSigSendType" SG_ 482 RFC_Loc165_Dr 9;
BA_ "GenSigSendType" SG_ 482 RFC_Loc165_Vr 9;
BA_ "GenSigStartValue" SG_ 482 RFC_Loc165_Vr 32768;
BA_ "GenSigSendType" SG_ 482 RFC_Loc165_Theta 9;
BA_ "GenSigStartValue" SG_ 482 RFC_Loc165_Theta 32768;
BA_ "GenSigSendType" SG_ 482 RFC_Loc165_Phi 9;
BA_ "GenSigStartValue" SG_ 482 RFC_Loc165_Phi 32768;
BA_ "GenSigSendType" SG_ 482 RFC_Loc165_DrVnce 9;
BA_ "GenSigSendType" SG_ 482 RFC_Loc165_VrVnce 9;
BA_ "GenSigSendType" SG_ 482 RFC_Loc165_ThetaVnce 9;
BA_ "GenSigSendType" SG_ 482 RFC_Loc165_PhiVnce 9;
BA_ "GenSigSendType" SG_ 482 RFC_Loc165_DrVrCoVnce 9;
BA_ "GenSigStartValue" SG_ 482 RFC_Loc165_DrVrCoVnce 32768;
BA_ "GenSigSendType" SG_ 482 RFC_Loc165_RCS 9;
BA_ "GenSigStartValue" SG_ 482 RFC_Loc165_RCS 32768;
BA_ "GenSigSendType" SG_ 482 RFC_Loc165_RSSI 9;
BA_ "GenSigSendType" SG_ 482 RFC_Loc165_DrVrQuality 9;
BA_ "GenSigSendType" SG_ 482 RFC_Loc165_ThetaQuality 9;
BA_ "GenSigSendType" SG_ 482 RFC_Loc165_PhiQuality 9;
BA_ "GenSigSendType" SG_ 483 RFC_Loc166_CRC 9;
BA_ "GenSigSendType" SG_ 483 RFC_Loc166_AliveCtr 9;
BA_ "GenSigSendType" SG_ 483 RFC_Loc166_ProtBlockCtr 9;
BA_ "GenSigSendType" SG_ 483 RFC_Loc166_Dr 9;
BA_ "GenSigSendType" SG_ 483 RFC_Loc166_Vr 9;
BA_ "GenSigStartValue" SG_ 483 RFC_Loc166_Vr 32768;
BA_ "GenSigSendType" SG_ 483 RFC_Loc166_Theta 9;
BA_ "GenSigStartValue" SG_ 483 RFC_Loc166_Theta 32768;
BA_ "GenSigSendType" SG_ 483 RFC_Loc166_Phi 9;
BA_ "GenSigStartValue" SG_ 483 RFC_Loc166_Phi 32768;
BA_ "GenSigSendType" SG_ 483 RFC_Loc166_DrVnce 9;
BA_ "GenSigSendType" SG_ 483 RFC_Loc166_VrVnce 9;
BA_ "GenSigSendType" SG_ 483 RFC_Loc166_ThetaVnce 9;
BA_ "GenSigSendType" SG_ 483 RFC_Loc166_PhiVnce 9;
BA_ "GenSigSendType" SG_ 483 RFC_Loc166_DrVrCoVnce 9;
BA_ "GenSigStartValue" SG_ 483 RFC_Loc166_DrVrCoVnce 32768;
BA_ "GenSigSendType" SG_ 483 RFC_Loc166_RCS 9;
BA_ "GenSigStartValue" SG_ 483 RFC_Loc166_RCS 32768;
BA_ "GenSigSendType" SG_ 483 RFC_Loc166_RSSI 9;
BA_ "GenSigSendType" SG_ 483 RFC_Loc166_DrVrQuality 9;
BA_ "GenSigSendType" SG_ 483 RFC_Loc166_ThetaQuality 9;
BA_ "GenSigSendType" SG_ 483 RFC_Loc166_PhiQuality 9;
BA_ "GenSigSendType" SG_ 483 RFC_Loc167_Dr 9;
BA_ "GenSigSendType" SG_ 483 RFC_Loc167_Vr 9;
BA_ "GenSigStartValue" SG_ 483 RFC_Loc167_Vr 32768;
BA_ "GenSigSendType" SG_ 483 RFC_Loc167_Theta 9;
BA_ "GenSigStartValue" SG_ 483 RFC_Loc167_Theta 32768;
BA_ "GenSigSendType" SG_ 483 RFC_Loc167_Phi 9;
BA_ "GenSigStartValue" SG_ 483 RFC_Loc167_Phi 32768;
BA_ "GenSigSendType" SG_ 483 RFC_Loc167_DrVnce 9;
BA_ "GenSigSendType" SG_ 483 RFC_Loc167_VrVnce 9;
BA_ "GenSigSendType" SG_ 483 RFC_Loc167_ThetaVnce 9;
BA_ "GenSigSendType" SG_ 483 RFC_Loc167_PhiVnce 9;
BA_ "GenSigSendType" SG_ 483 RFC_Loc167_DrVrCoVnce 9;
BA_ "GenSigStartValue" SG_ 483 RFC_Loc167_DrVrCoVnce 32768;
BA_ "GenSigSendType" SG_ 483 RFC_Loc167_RCS 9;
BA_ "GenSigStartValue" SG_ 483 RFC_Loc167_RCS 32768;
BA_ "GenSigSendType" SG_ 483 RFC_Loc167_RSSI 9;
BA_ "GenSigSendType" SG_ 483 RFC_Loc167_DrVrQuality 9;
BA_ "GenSigSendType" SG_ 483 RFC_Loc167_ThetaQuality 9;
BA_ "GenSigSendType" SG_ 483 RFC_Loc167_PhiQuality 9;
BA_ "GenSigSendType" SG_ 484 RFC_Loc168_CRC 9;
BA_ "GenSigSendType" SG_ 484 RFC_Loc168_AliveCtr 9;
BA_ "GenSigSendType" SG_ 484 RFC_Loc168_ProtBlockCtr 9;
BA_ "GenSigSendType" SG_ 484 RFC_Loc168_Dr 9;
BA_ "GenSigSendType" SG_ 484 RFC_Loc168_Vr 9;
BA_ "GenSigStartValue" SG_ 484 RFC_Loc168_Vr 32768;
BA_ "GenSigSendType" SG_ 484 RFC_Loc168_Theta 9;
BA_ "GenSigStartValue" SG_ 484 RFC_Loc168_Theta 32768;
BA_ "GenSigSendType" SG_ 484 RFC_Loc168_Phi 9;
BA_ "GenSigStartValue" SG_ 484 RFC_Loc168_Phi 32768;
BA_ "GenSigSendType" SG_ 484 RFC_Loc168_DrVnce 9;
BA_ "GenSigSendType" SG_ 484 RFC_Loc168_VrVnce 9;
BA_ "GenSigSendType" SG_ 484 RFC_Loc168_ThetaVnce 9;
BA_ "GenSigSendType" SG_ 484 RFC_Loc168_PhiVnce 9;
BA_ "GenSigSendType" SG_ 484 RFC_Loc168_DrVrCoVnce 9;
BA_ "GenSigStartValue" SG_ 484 RFC_Loc168_DrVrCoVnce 32768;
BA_ "GenSigSendType" SG_ 484 RFC_Loc168_RCS 9;
BA_ "GenSigStartValue" SG_ 484 RFC_Loc168_RCS 32768;
BA_ "GenSigSendType" SG_ 484 RFC_Loc168_RSSI 9;
BA_ "GenSigSendType" SG_ 484 RFC_Loc168_DrVrQuality 9;
BA_ "GenSigSendType" SG_ 484 RFC_Loc168_ThetaQuality 9;
BA_ "GenSigSendType" SG_ 484 RFC_Loc168_PhiQuality 9;
BA_ "GenSigSendType" SG_ 484 RFC_Loc169_Dr 9;
BA_ "GenSigSendType" SG_ 484 RFC_Loc169_Vr 9;
BA_ "GenSigStartValue" SG_ 484 RFC_Loc169_Vr 32768;
BA_ "GenSigSendType" SG_ 484 RFC_Loc169_Theta 9;
BA_ "GenSigStartValue" SG_ 484 RFC_Loc169_Theta 32768;
BA_ "GenSigSendType" SG_ 484 RFC_Loc169_Phi 9;
BA_ "GenSigStartValue" SG_ 484 RFC_Loc169_Phi 32768;
BA_ "GenSigSendType" SG_ 484 RFC_Loc169_DrVnce 9;
BA_ "GenSigSendType" SG_ 484 RFC_Loc169_VrVnce 9;
BA_ "GenSigSendType" SG_ 484 RFC_Loc169_ThetaVnce 9;
BA_ "GenSigSendType" SG_ 484 RFC_Loc169_PhiVnce 9;
BA_ "GenSigSendType" SG_ 484 RFC_Loc169_DrVrCoVnce 9;
BA_ "GenSigStartValue" SG_ 484 RFC_Loc169_DrVrCoVnce 32768;
BA_ "GenSigSendType" SG_ 484 RFC_Loc169_RCS 9;
BA_ "GenSigStartValue" SG_ 484 RFC_Loc169_RCS 32768;
BA_ "GenSigSendType" SG_ 484 RFC_Loc169_RSSI 9;
BA_ "GenSigSendType" SG_ 484 RFC_Loc169_DrVrQuality 9;
BA_ "GenSigSendType" SG_ 484 RFC_Loc169_ThetaQuality 9;
BA_ "GenSigSendType" SG_ 484 RFC_Loc169_PhiQuality 9;
