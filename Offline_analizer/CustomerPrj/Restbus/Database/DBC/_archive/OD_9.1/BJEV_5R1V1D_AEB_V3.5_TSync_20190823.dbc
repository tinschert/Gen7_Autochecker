VERSION "created by canmatrix"

NS_ :

BS_:

BU_: RadarFrontCenter DASy MPC3

BO_ 194 VFC_Object09A: 64 MPC3
 SG_ VFC_Obj09A_CRC : 0|16@1+ (1,0) [0|65535] ""  RadarFrontCenter,DASy
 SG_ VFC_Obj09A_AliveCtr : 16|8@1+ (1,0) [0|255] ""  RadarFrontCenter,DASy
 SG_ VFC_Obj09A_BlockCtr : 24|4@1+ (1,0) [0|15] ""  RadarFrontCenter,DASy
 SG_ VFC_Obj09A_ProtOrderIndex : 32|6@1+ (1,0) [0|63] ""  RadarFrontCenter,DASy
 SG_ VFC_Obj09A_Ax : 39|9@1+ (0.1,-16) [-16|16] "m/s^2"  RadarFrontCenter,DASy
 SG_ VFC_Obj09A_Vx : 48|12@1+ (0.1,-154) [-154|50] "m/s"  RadarFrontCenter,DASy
 SG_ VFC_Obj09A_Dx : 60|12@1+ (0.05,0) [0|204.7] "m"  RadarFrontCenter,DASy
 SG_ VFC_Obj09A_Dy : 72|14@1+ (0.01,-80) [-80|80] "m"  RadarFrontCenter,DASy
 SG_ VFC_Obj09A_Vy : 86|10@1+ (0.1,-50) [-50|50] "m/s"  RadarFrontCenter,DASy
 SG_ VFC_Obj09A_Ay : 96|8@1+ (0.1,-12) [-12|12] "m/s^2"  RadarFrontCenter,DASy
 SG_ VFC_Obj09A_DyStdDev : 104|10@1+ (0.02,0) [0|20] "m"  RadarFrontCenter,DASy
 SG_ VFC_Obj09A_DxStdDev : 118|10@1+ (0.05,0) [0|50] "m"  RadarFrontCenter,DASy
 SG_ VFC_Obj09A_VxStdDev : 128|10@1+ (0.1,0) [0|100] "m/s"  RadarFrontCenter,DASy
 SG_ VFC_Obj09A_ExistProb : 138|6@1+ (2,0) [0|100] "%"  RadarFrontCenter,DASy
 SG_ VFC_Obj09A_VyStdDev : 144|9@1+ (0.1,0) [0|50] "m/s"  RadarFrontCenter,DASy
 SG_ VFC_Obj09A_TypeProb : 154|6@1+ (2,0) [0|100] "%"  RadarFrontCenter,DASy
 SG_ VFC_Obj09A_AxStdDev : 160|8@1+ (0.1,0) [0|25] "m/s^2"  RadarFrontCenter,DASy
 SG_ VFC_Obj09A_AyStdDev : 168|8@1+ (0.1,0) [0|25] "m/s^2"  RadarFrontCenter,DASy
 SG_ VFC_Obj09A_PhiLeft : 176|13@1+ (0.00025,-1) [-1|1] ""  RadarFrontCenter,DASy
 SG_ VFC_Obj09A_ClassifiedView : 189|3@1+ (1,0) [0|7] ""  RadarFrontCenter,DASy
 SG_ VFC_Obj09A_Length : 192|9@1+ (0.05,0) [0|25.5] "m"  RadarFrontCenter,DASy
 SG_ VFC_Obj09A_WidthStdDev : 201|7@1+ (0.01,0) [0|1] "m"  RadarFrontCenter,DASy
 SG_ VFC_Obj09A_Height : 208|9@1+ (0.01,0) [0|5.11] "m"  RadarFrontCenter,DASy
 SG_ VFC_Obj09A_HeightStdDev : 217|7@1+ (0.01,0) [0|1] "m"  RadarFrontCenter,DASy
 SG_ VFC_Obj09A_PhiLeftStdDev : 224|8@1+ (0.0002,0) [0|0.05] ""  RadarFrontCenter,DASy
 SG_ VFC_Obj09A_HeadingStdDev : 232|6@1+ (0.01,0) [0|0.5] "rad"  RadarFrontCenter,DASy
 SG_ VFC_Obj09A_Measured : 238|2@1+ (1,0) [0|3] ""  RadarFrontCenter,DASy
 SG_ VFC_Obj09A_Heading : 240|9@1+ (0.01,-1.57) [-1.57|1.57] "rad"  RadarFrontCenter,DASy
 SG_ VFC_Obj09A_LengthStdDev : 249|7@1+ (0.05,0) [0|5] "m"  RadarFrontCenter,DASy
 SG_ VFC_Obj09A_PhiMid : 256|13@1+ (0.00025,-1) [-1|1] ""  RadarFrontCenter,DASy
 SG_ VFC_Obj09A_Width : 269|11@1+ (0.01,0) [0|12] "m"  RadarFrontCenter,DASy
 SG_ VFC_Obj09A_PhiMidStdDev : 280|8@1+ (0.0002,0) [0|0.05] ""  RadarFrontCenter,DASy
 SG_ VFC_Obj09A_PhiRight : 288|13@1+ (0.00025,-1) [-1|1] ""  RadarFrontCenter,DASy
 SG_ VFC_Obj09A_VisibleView : 301|3@1+ (1,0) [0|4] ""  RadarFrontCenter,DASy
 SG_ VFC_Obj09A_PhiRightStdDev : 304|8@1+ (0.0002,0) [0|0.05] ""  RadarFrontCenter,DASy
 SG_ VFC_Obj09A_PhiLeftVel : 312|13@1+ (0.001,-4) [-4|4] "1/s"  RadarFrontCenter,DASy
 SG_ VFC_Obj09A_PhiRightVel : 328|13@1+ (0.001,-4) [-4|4] "1/s"  RadarFrontCenter,DASy
 SG_ VFC_Obj09A_PhiRightVelStdDev : 344|8@1+ (0.001,0) [0|0.25] "1/s"  RadarFrontCenter,DASy
 SG_ VFC_Obj09A_PhiLeftVelStdDev : 352|8@1+ (0.001,0) [0|0.25] "1/s"  RadarFrontCenter,DASy
 SG_ VFC_Obj09A_PhiTop : 360|12@1+ (0.00025,-0.4) [-0.4|0.4] ""  RadarFrontCenter,DASy
 SG_ VFC_Obj09A_PhiBottom : 372|12@1+ (0.00025,-0.4) [-0.4|0.4] ""  RadarFrontCenter,DASy
 SG_ VFC_Obj09A_PhiTopStdDev : 384|8@1+ (0.0002,0) [0|0.05] ""  RadarFrontCenter,DASy
 SG_ VFC_Obj09A_HeadOrientation : 392|4@1+ (1,0) [0|10] ""  RadarFrontCenter,DASy
 SG_ VFC_Obj09A_Type : 396|4@1+ (1,0) [0|15] ""  RadarFrontCenter,DASy
 SG_ VFC_Obj09A_PhiBottomStdDev : 400|8@1+ (0.0002,0) [0|0.05] ""  RadarFrontCenter,DASy
 SG_ VFC_Obj09A_NormVx : 408|16@1+ (0.001,-40) [-40|25] "1/s"  RadarFrontCenter,DASy
 SG_ VFC_Obj09A_NormAx : 424|13@1+ (0.002,-10) [-10|6] "1/s^2"  RadarFrontCenter,DASy
 SG_ VFC_Obj09A_NormAxStdDev : 440|10@1+ (0.0025,0) [0|2.5] "1/s^2"  RadarFrontCenter,DASy
 SG_ VFC_Obj09A_ProbMovingLat : 450|6@1+ (2,0) [0|100] "%"  RadarFrontCenter,DASy
 SG_ VFC_Obj09A_ID : 456|8@1+ (1,0) [0|254] ""  RadarFrontCenter,DASy
 SG_ VFC_Obj09A_NormVxStdDev : 464|10@1+ (0.001,0) [0|1] "1/s"  RadarFrontCenter,DASy
 SG_ VFC_Obj09A_ProbMovingLong : 474|6@1+ (2,0) [0|100] "%"  RadarFrontCenter,DASy

BO_ 195 VFC_Object09B: 16 MPC3
 SG_ VFC_Obj09B_TTIPC_StdDev : 120|7@1+ (0.0625,0) [0|7.875] ""  RadarFrontCenter,DASy
 SG_ VFC_Obj09B_TTIPC : 104|11@1+ (0.008,-8) [-8|8] ""  RadarFrontCenter,DASy
 SG_ VFC_Obj09B_AngLongitude : 88|10@1+ (0.005,-2.5) [-2.5|2.5] "rad/s"  RadarFrontCenter,DASy
 SG_ VFC_Obj09B_CRC : 0|16@1+ (1,0) [0|65535] ""  RadarFrontCenter,DASy
 SG_ VFC_Obj09B_AliveCtr : 16|8@1+ (1,0) [0|255] ""  RadarFrontCenter,DASy
 SG_ VFC_Obj09B_BlockCtr : 24|4@1+ (1,0) [0|15] ""  RadarFrontCenter,DASy
 SG_ VFC_Obj09B_ScaleChange : 32|14@1+ (0.0001,0.5) [0.5|2.1] ""  RadarFrontCenter,DASy
 SG_ VFC_Obj09B_ScaleChngStdDev : 48|10@1+ (0.0001,0) [0|0.1] ""  RadarFrontCenter,DASy
 SG_ VFC_Obj09B_LineEdgeRightEgo : 58|1@1+ (1,0) [0|1] ""  RadarFrontCenter,DASy
 SG_ VFC_Obj09B_LineEdgeLeftEgo : 59|1@1+ (1,0) [0|1] ""  RadarFrontCenter,DASy
 SG_ VFC_Obj09B_CompletelyInImg : 60|1@1+ (1,0) [0|1] ""  RadarFrontCenter,DASy
 SG_ VFC_Obj09B_DirIndicator : 61|3@1+ (1,0) [0|7] ""  RadarFrontCenter,DASy
 SG_ VFC_Obj09B_LineEdgeAngle : 64|13@1+ (0.00025,-1) [-1|1] "rad"  RadarFrontCenter,DASy
 SG_ VFC_Obj09B_BrakeLight : 77|3@1+ (1,0) [0|7] ""  RadarFrontCenter,DASy
 SG_ VFC_Obj09B_MeasSource : 80|5@1+ (1,0) [0|31] ""  RadarFrontCenter,DASy
 SG_ VFC_Obj09B_Reliab : 98|6@1+ (1,0) [0|63] ""  RadarFrontCenter,DASy

BO_ 196 VFC_Object10A: 64 MPC3
 SG_ VFC_Obj10A_CRC : 0|16@1+ (1,0) [0|65535] ""  RadarFrontCenter,DASy
 SG_ VFC_Obj10A_AliveCtr : 16|8@1+ (1,0) [0|255] ""  RadarFrontCenter,DASy
 SG_ VFC_Obj10A_BlockCtr : 24|4@1+ (1,0) [0|15] ""  RadarFrontCenter,DASy
 SG_ VFC_Obj10A_ProtOrderIndex : 32|6@1+ (1,0) [0|63] ""  RadarFrontCenter,DASy
 SG_ VFC_Obj10A_Ax : 39|9@1+ (0.1,-16) [-16|16] "m/s^2"  RadarFrontCenter,DASy
 SG_ VFC_Obj10A_Vx : 48|12@1+ (0.1,-154) [-154|50] "m/s"  RadarFrontCenter,DASy
 SG_ VFC_Obj10A_Dx : 60|12@1+ (0.05,0) [0|204.7] "m"  RadarFrontCenter,DASy
 SG_ VFC_Obj10A_Dy : 72|14@1+ (0.01,-80) [-80|80] "m"  RadarFrontCenter,DASy
 SG_ VFC_Obj10A_Vy : 86|10@1+ (0.1,-50) [-50|50] "m/s"  RadarFrontCenter,DASy
 SG_ VFC_Obj10A_Ay : 96|8@1+ (0.1,-12) [-12|12] "m/s^2"  RadarFrontCenter,DASy
 SG_ VFC_Obj10A_DyStdDev : 104|10@1+ (0.02,0) [0|20] "m"  RadarFrontCenter,DASy
 SG_ VFC_Obj10A_DxStdDev : 118|10@1+ (0.05,0) [0|50] "m"  RadarFrontCenter,DASy
 SG_ VFC_Obj10A_VxStdDev : 128|10@1+ (0.1,0) [0|100] "m/s"  RadarFrontCenter,DASy
 SG_ VFC_Obj10A_ExistProb : 138|6@1+ (2,0) [0|100] "%"  RadarFrontCenter,DASy
 SG_ VFC_Obj10A_VyStdDev : 144|9@1+ (0.1,0) [0|50] "m/s"  RadarFrontCenter,DASy
 SG_ VFC_Obj10A_TypeProb : 154|6@1+ (2,0) [0|100] "%"  RadarFrontCenter,DASy
 SG_ VFC_Obj10A_AxStdDev : 160|8@1+ (0.1,0) [0|25] "m/s^2"  RadarFrontCenter,DASy
 SG_ VFC_Obj10A_AyStdDev : 168|8@1+ (0.1,0) [0|25] "m/s^2"  RadarFrontCenter,DASy
 SG_ VFC_Obj10A_PhiLeft : 176|13@1+ (0.00025,-1) [-1|1] ""  RadarFrontCenter,DASy
 SG_ VFC_Obj10A_ClassifiedView : 189|3@1+ (1,0) [0|7] ""  RadarFrontCenter,DASy
 SG_ VFC_Obj10A_Length : 192|9@1+ (0.05,0) [0|25.5] "m"  RadarFrontCenter,DASy
 SG_ VFC_Obj10A_WidthStdDev : 201|7@1+ (0.01,0) [0|1] "m"  RadarFrontCenter,DASy
 SG_ VFC_Obj10A_Height : 208|9@1+ (0.01,0) [0|5.11] "m"  RadarFrontCenter,DASy
 SG_ VFC_Obj10A_HeightStdDev : 217|7@1+ (0.01,0) [0|1] "m"  RadarFrontCenter,DASy
 SG_ VFC_Obj10A_PhiLeftStdDev : 224|8@1+ (0.0002,0) [0|0.05] ""  RadarFrontCenter,DASy
 SG_ VFC_Obj10A_HeadingStdDev : 232|6@1+ (0.01,0) [0|0.5] "rad"  RadarFrontCenter,DASy
 SG_ VFC_Obj10A_Measured : 238|2@1+ (1,0) [0|3] ""  RadarFrontCenter,DASy
 SG_ VFC_Obj10A_Heading : 240|9@1+ (0.01,-1.57) [-1.57|1.57] "rad"  RadarFrontCenter,DASy
 SG_ VFC_Obj10A_LengthStdDev : 249|7@1+ (0.05,0) [0|5] "m"  RadarFrontCenter,DASy
 SG_ VFC_Obj10A_PhiMid : 256|13@1+ (0.00025,-1) [-1|1] ""  RadarFrontCenter,DASy
 SG_ VFC_Obj10A_Width : 269|11@1+ (0.01,0) [0|12] "m"  RadarFrontCenter,DASy
 SG_ VFC_Obj10A_PhiMidStdDev : 280|8@1+ (0.0002,0) [0|0.05] ""  RadarFrontCenter,DASy
 SG_ VFC_Obj10A_PhiRight : 288|13@1+ (0.00025,-1) [-1|1] ""  RadarFrontCenter,DASy
 SG_ VFC_Obj10A_VisibleView : 301|3@1+ (1,0) [0|4] ""  RadarFrontCenter,DASy
 SG_ VFC_Obj10A_PhiRightStdDev : 304|8@1+ (0.0002,0) [0|0.05] ""  RadarFrontCenter,DASy
 SG_ VFC_Obj10A_PhiLeftVel : 312|13@1+ (0.001,-4) [-4|4] "1/s"  RadarFrontCenter,DASy
 SG_ VFC_Obj10A_PhiRightVel : 328|13@1+ (0.001,-4) [-4|4] "1/s"  RadarFrontCenter,DASy
 SG_ VFC_Obj10A_PhiRightVelStdDev : 344|8@1+ (0.001,0) [0|0.25] "1/s"  RadarFrontCenter,DASy
 SG_ VFC_Obj10A_PhiLeftVelStdDev : 352|8@1+ (0.001,0) [0|0.25] "1/s"  RadarFrontCenter,DASy
 SG_ VFC_Obj10A_PhiTop : 360|12@1+ (0.00025,-0.4) [-0.4|0.4] ""  RadarFrontCenter,DASy
 SG_ VFC_Obj10A_PhiBottom : 372|12@1+ (0.00025,-0.4) [-0.4|0.4] ""  RadarFrontCenter,DASy
 SG_ VFC_Obj10A_PhiTopStdDev : 384|8@1+ (0.0002,0) [0|0.05] ""  RadarFrontCenter,DASy
 SG_ VFC_Obj10A_HeadOrientation : 392|4@1+ (1,0) [0|10] ""  RadarFrontCenter,DASy
 SG_ VFC_Obj10A_Type : 396|4@1+ (1,0) [0|15] ""  RadarFrontCenter,DASy
 SG_ VFC_Obj10A_PhiBottomStdDev : 400|8@1+ (0.0002,0) [0|0.05] ""  RadarFrontCenter,DASy
 SG_ VFC_Obj10A_NormVx : 408|16@1+ (0.001,-40) [-40|25] "1/s"  RadarFrontCenter,DASy
 SG_ VFC_Obj10A_NormAx : 424|13@1+ (0.002,-10) [-10|6] "1/s^2"  RadarFrontCenter,DASy
 SG_ VFC_Obj10A_NormAxStdDev : 440|10@1+ (0.0025,0) [0|2.5] "1/s^2"  RadarFrontCenter,DASy
 SG_ VFC_Obj10A_ProbMovingLat : 450|6@1+ (2,0) [0|100] "%"  RadarFrontCenter,DASy
 SG_ VFC_Obj10A_ID : 456|8@1+ (1,0) [0|254] ""  RadarFrontCenter,DASy
 SG_ VFC_Obj10A_NormVxStdDev : 464|10@1+ (0.001,0) [0|1] "1/s"  RadarFrontCenter,DASy
 SG_ VFC_Obj10A_ProbMovingLong : 474|6@1+ (2,0) [0|100] "%"  RadarFrontCenter,DASy

BO_ 197 VFC_Object10B: 16 MPC3
 SG_ VFC_Obj10B_TTIPC_StdDev : 120|7@1+ (0.0625,0) [0|7.875] ""  RadarFrontCenter,DASy
 SG_ VFC_Obj10B_TTIPC : 104|11@1+ (0.008,-8) [-8|8] ""  RadarFrontCenter,DASy
 SG_ VFC_Obj10B_AngLongitude : 88|10@1+ (0.005,-2.5) [-2.5|2.5] "rad/s"  RadarFrontCenter,DASy
 SG_ VFC_Obj10B_CRC : 0|16@1+ (1,0) [0|65535] ""  RadarFrontCenter,DASy
 SG_ VFC_Obj10B_AliveCtr : 16|8@1+ (1,0) [0|255] ""  RadarFrontCenter,DASy
 SG_ VFC_Obj10B_BlockCtr : 24|4@1+ (1,0) [0|15] ""  RadarFrontCenter,DASy
 SG_ VFC_Obj10B_ScaleChange : 32|14@1+ (0.0001,0.5) [0.5|2.1] ""  RadarFrontCenter,DASy
 SG_ VFC_Obj10B_ScaleChngStdDev : 48|10@1+ (0.0001,0) [0|0.1] ""  RadarFrontCenter,DASy
 SG_ VFC_Obj10B_LineEdgeRightEgo : 58|1@1+ (1,0) [0|1] ""  RadarFrontCenter,DASy
 SG_ VFC_Obj10B_LineEdgeLeftEgo : 59|1@1+ (1,0) [0|1] ""  RadarFrontCenter,DASy
 SG_ VFC_Obj10B_CompletelyInImg : 60|1@1+ (1,0) [0|1] ""  RadarFrontCenter,DASy
 SG_ VFC_Obj10B_DirIndicator : 61|3@1+ (1,0) [0|7] ""  RadarFrontCenter,DASy
 SG_ VFC_Obj10B_LineEdgeAngle : 64|13@1+ (0.00025,-1) [-1|1] "rad"  RadarFrontCenter,DASy
 SG_ VFC_Obj10B_BrakeLight : 77|3@1+ (1,0) [0|7] ""  RadarFrontCenter,DASy
 SG_ VFC_Obj10B_MeasSource : 80|5@1+ (1,0) [0|31] ""  RadarFrontCenter,DASy
 SG_ VFC_Obj10B_Reliab : 98|6@1+ (1,0) [0|63] ""  RadarFrontCenter,DASy

BO_ 198 VFC_Object11A: 64 MPC3
 SG_ VFC_Obj11A_CRC : 0|16@1+ (1,0) [0|65535] ""  RadarFrontCenter,DASy
 SG_ VFC_Obj11A_AliveCtr : 16|8@1+ (1,0) [0|255] ""  RadarFrontCenter,DASy
 SG_ VFC_Obj11A_BlockCtr : 24|4@1+ (1,0) [0|15] ""  RadarFrontCenter,DASy
 SG_ VFC_Obj11A_ProtOrderIndex : 32|6@1+ (1,0) [0|63] ""  RadarFrontCenter,DASy
 SG_ VFC_Obj11A_Ax : 39|9@1+ (0.1,-16) [-16|16] "m/s^2"  RadarFrontCenter,DASy
 SG_ VFC_Obj11A_Vx : 48|12@1+ (0.1,-154) [-154|50] "m/s"  RadarFrontCenter,DASy
 SG_ VFC_Obj11A_Dx : 60|12@1+ (0.05,0) [0|204.7] "m"  RadarFrontCenter,DASy
 SG_ VFC_Obj11A_Dy : 72|14@1+ (0.01,-80) [-80|80] "m"  RadarFrontCenter,DASy
 SG_ VFC_Obj11A_Vy : 86|10@1+ (0.1,-50) [-50|50] "m/s"  RadarFrontCenter,DASy
 SG_ VFC_Obj11A_Ay : 96|8@1+ (0.1,-12) [-12|12] "m/s^2"  RadarFrontCenter,DASy
 SG_ VFC_Obj11A_DyStdDev : 104|10@1+ (0.02,0) [0|20] "m"  RadarFrontCenter,DASy
 SG_ VFC_Obj11A_DxStdDev : 118|10@1+ (0.05,0) [0|50] "m"  RadarFrontCenter,DASy
 SG_ VFC_Obj11A_VxStdDev : 128|10@1+ (0.1,0) [0|100] "m/s"  RadarFrontCenter,DASy
 SG_ VFC_Obj11A_ExistProb : 138|6@1+ (2,0) [0|100] "%"  RadarFrontCenter,DASy
 SG_ VFC_Obj11A_VyStdDev : 144|9@1+ (0.1,0) [0|50] "m/s"  RadarFrontCenter,DASy
 SG_ VFC_Obj11A_TypeProb : 154|6@1+ (2,0) [0|100] "%"  RadarFrontCenter,DASy
 SG_ VFC_Obj11A_AxStdDev : 160|8@1+ (0.1,0) [0|25] "m/s^2"  RadarFrontCenter,DASy
 SG_ VFC_Obj11A_AyStdDev : 168|8@1+ (0.1,0) [0|25] "m/s^2"  RadarFrontCenter,DASy
 SG_ VFC_Obj11A_PhiLeft : 176|13@1+ (0.00025,-1) [-1|1] ""  RadarFrontCenter,DASy
 SG_ VFC_Obj11A_ClassifiedView : 189|3@1+ (1,0) [0|7] ""  RadarFrontCenter,DASy
 SG_ VFC_Obj11A_Length : 192|9@1+ (0.05,0) [0|25.5] "m"  RadarFrontCenter,DASy
 SG_ VFC_Obj11A_WidthStdDev : 201|7@1+ (0.01,0) [0|1] "m"  RadarFrontCenter,DASy
 SG_ VFC_Obj11A_Height : 208|9@1+ (0.01,0) [0|5.11] "m"  RadarFrontCenter,DASy
 SG_ VFC_Obj11A_HeightStdDev : 217|7@1+ (0.01,0) [0|1] "m"  RadarFrontCenter,DASy
 SG_ VFC_Obj11A_PhiLeftStdDev : 224|8@1+ (0.0002,0) [0|0.05] ""  RadarFrontCenter,DASy
 SG_ VFC_Obj11A_HeadingStdDev : 232|6@1+ (0.01,0) [0|0.5] "rad"  RadarFrontCenter,DASy
 SG_ VFC_Obj11A_Measured : 238|2@1+ (1,0) [0|3] ""  RadarFrontCenter,DASy
 SG_ VFC_Obj11A_Heading : 240|9@1+ (0.01,-1.57) [-1.57|1.57] "rad"  RadarFrontCenter,DASy
 SG_ VFC_Obj11A_LengthStdDev : 249|7@1+ (0.05,0) [0|5] "m"  RadarFrontCenter,DASy
 SG_ VFC_Obj11A_PhiMid : 256|13@1+ (0.00025,-1) [-1|1] ""  RadarFrontCenter,DASy
 SG_ VFC_Obj11A_Width : 269|11@1+ (0.01,0) [0|12] "m"  RadarFrontCenter,DASy
 SG_ VFC_Obj11A_PhiMidStdDev : 280|8@1+ (0.0002,0) [0|0.05] ""  RadarFrontCenter,DASy
 SG_ VFC_Obj11A_PhiRight : 288|13@1+ (0.00025,-1) [-1|1] ""  RadarFrontCenter,DASy
 SG_ VFC_Obj11A_VisibleView : 301|3@1+ (1,0) [0|4] ""  RadarFrontCenter,DASy
 SG_ VFC_Obj11A_PhiRightStdDev : 304|8@1+ (0.0002,0) [0|0.05] ""  RadarFrontCenter,DASy
 SG_ VFC_Obj11A_PhiLeftVel : 312|13@1+ (0.001,-4) [-4|4] "1/s"  RadarFrontCenter,DASy
 SG_ VFC_Obj11A_PhiRightVel : 328|13@1+ (0.001,-4) [-4|4] "1/s"  RadarFrontCenter,DASy
 SG_ VFC_Obj11A_PhiRightVelStdDev : 344|8@1+ (0.001,0) [0|0.25] "1/s"  RadarFrontCenter,DASy
 SG_ VFC_Obj11A_PhiLeftVelStdDev : 352|8@1+ (0.001,0) [0|0.25] "1/s"  RadarFrontCenter,DASy
 SG_ VFC_Obj11A_PhiTop : 360|12@1+ (0.00025,-0.4) [-0.4|0.4] ""  RadarFrontCenter,DASy
 SG_ VFC_Obj11A_PhiBottom : 372|12@1+ (0.00025,-0.4) [-0.4|0.4] ""  RadarFrontCenter,DASy
 SG_ VFC_Obj11A_PhiTopStdDev : 384|8@1+ (0.0002,0) [0|0.05] ""  RadarFrontCenter,DASy
 SG_ VFC_Obj11A_HeadOrientation : 392|4@1+ (1,0) [0|10] ""  RadarFrontCenter,DASy
 SG_ VFC_Obj11A_Type : 396|4@1+ (1,0) [0|15] ""  RadarFrontCenter,DASy
 SG_ VFC_Obj11A_PhiBottomStdDev : 400|8@1+ (0.0002,0) [0|0.05] ""  RadarFrontCenter,DASy
 SG_ VFC_Obj11A_NormVx : 408|16@1+ (0.001,-40) [-40|25] "1/s"  RadarFrontCenter,DASy
 SG_ VFC_Obj11A_NormAx : 424|13@1+ (0.002,-10) [-10|6] "1/s^2"  RadarFrontCenter,DASy
 SG_ VFC_Obj11A_NormAxStdDev : 440|10@1+ (0.0025,0) [0|2.5] "1/s^2"  RadarFrontCenter,DASy
 SG_ VFC_Obj11A_ProbMovingLat : 450|6@1+ (2,0) [0|100] "%"  RadarFrontCenter,DASy
 SG_ VFC_Obj11A_ID : 456|8@1+ (1,0) [0|254] ""  RadarFrontCenter,DASy
 SG_ VFC_Obj11A_NormVxStdDev : 464|10@1+ (0.001,0) [0|1] "1/s"  RadarFrontCenter,DASy
 SG_ VFC_Obj11A_ProbMovingLong : 474|6@1+ (2,0) [0|100] "%"  RadarFrontCenter,DASy

BO_ 199 VFC_Object11B: 16 MPC3
 SG_ VFC_Obj11B_TTIPC_StdDev : 120|7@1+ (0.0625,0) [0|7.875] ""  RadarFrontCenter,DASy
 SG_ VFC_Obj11B_TTIPC : 104|11@1+ (0.008,-8) [-8|8] ""  RadarFrontCenter,DASy
 SG_ VFC_Obj11B_AngLongitude : 88|10@1+ (0.005,-2.5) [-2.5|2.5] "rad/s"  RadarFrontCenter,DASy
 SG_ VFC_Obj11B_CRC : 0|16@1+ (1,0) [0|65535] ""  RadarFrontCenter,DASy
 SG_ VFC_Obj11B_AliveCtr : 16|8@1+ (1,0) [0|255] ""  RadarFrontCenter,DASy
 SG_ VFC_Obj11B_BlockCtr : 24|4@1+ (1,0) [0|15] ""  RadarFrontCenter,DASy
 SG_ VFC_Obj11B_ScaleChange : 32|14@1+ (0.0001,0.5) [0.5|2.1] ""  RadarFrontCenter,DASy
 SG_ VFC_Obj11B_ScaleChngStdDev : 48|10@1+ (0.0001,0) [0|0.1] ""  RadarFrontCenter,DASy
 SG_ VFC_Obj11B_LineEdgeRightEgo : 58|1@1+ (1,0) [0|1] ""  RadarFrontCenter,DASy
 SG_ VFC_Obj11B_LineEdgeLeftEgo : 59|1@1+ (1,0) [0|1] ""  RadarFrontCenter,DASy
 SG_ VFC_Obj11B_CompletelyInImg : 60|1@1+ (1,0) [0|1] ""  RadarFrontCenter,DASy
 SG_ VFC_Obj11B_DirIndicator : 61|3@1+ (1,0) [0|7] ""  RadarFrontCenter,DASy
 SG_ VFC_Obj11B_LineEdgeAngle : 64|13@1+ (0.00025,-1) [-1|1] "rad"  RadarFrontCenter,DASy
 SG_ VFC_Obj11B_BrakeLight : 77|3@1+ (1,0) [0|7] ""  RadarFrontCenter,DASy
 SG_ VFC_Obj11B_MeasSource : 80|5@1+ (1,0) [0|31] ""  RadarFrontCenter,DASy
 SG_ VFC_Obj11B_Reliab : 98|6@1+ (1,0) [0|63] ""  RadarFrontCenter,DASy

BO_ 200 VFC_Object12A: 64 MPC3
 SG_ VFC_Obj12A_CRC : 0|16@1+ (1,0) [0|65535] ""  RadarFrontCenter,DASy
 SG_ VFC_Obj12A_AliveCtr : 16|8@1+ (1,0) [0|255] ""  RadarFrontCenter,DASy
 SG_ VFC_Obj12A_BlockCtr : 24|4@1+ (1,0) [0|15] ""  RadarFrontCenter,DASy
 SG_ VFC_Obj12A_ProtOrderIndex : 32|6@1+ (1,0) [0|63] ""  RadarFrontCenter,DASy
 SG_ VFC_Obj12A_Ax : 39|9@1+ (0.1,-16) [-16|16] "m/s^2"  RadarFrontCenter,DASy
 SG_ VFC_Obj12A_Vx : 48|12@1+ (0.1,-154) [-154|50] "m/s"  RadarFrontCenter,DASy
 SG_ VFC_Obj12A_Dx : 60|12@1+ (0.05,0) [0|204.7] "m"  RadarFrontCenter,DASy
 SG_ VFC_Obj12A_Dy : 72|14@1+ (0.01,-80) [-80|80] "m"  RadarFrontCenter,DASy
 SG_ VFC_Obj12A_Vy : 86|10@1+ (0.1,-50) [-50|50] "m/s"  RadarFrontCenter,DASy
 SG_ VFC_Obj12A_Ay : 96|8@1+ (0.1,-12) [-12|12] "m/s^2"  RadarFrontCenter,DASy
 SG_ VFC_Obj12A_DyStdDev : 104|10@1+ (0.02,0) [0|20] "m"  RadarFrontCenter,DASy
 SG_ VFC_Obj12A_DxStdDev : 118|10@1+ (0.05,0) [0|50] "m"  RadarFrontCenter,DASy
 SG_ VFC_Obj12A_VxStdDev : 128|10@1+ (0.1,0) [0|100] "m/s"  RadarFrontCenter,DASy
 SG_ VFC_Obj12A_ExistProb : 138|6@1+ (2,0) [0|100] "%"  RadarFrontCenter,DASy
 SG_ VFC_Obj12A_VyStdDev : 144|9@1+ (0.1,0) [0|50] "m/s"  RadarFrontCenter,DASy
 SG_ VFC_Obj12A_TypeProb : 154|6@1+ (2,0) [0|100] "%"  RadarFrontCenter,DASy
 SG_ VFC_Obj12A_AxStdDev : 160|8@1+ (0.1,0) [0|25] "m/s^2"  RadarFrontCenter,DASy
 SG_ VFC_Obj12A_AyStdDev : 168|8@1+ (0.1,0) [0|25] "m/s^2"  RadarFrontCenter,DASy
 SG_ VFC_Obj12A_PhiLeft : 176|13@1+ (0.00025,-1) [-1|1] ""  RadarFrontCenter,DASy
 SG_ VFC_Obj12A_ClassifiedView : 189|3@1+ (1,0) [0|7] ""  RadarFrontCenter,DASy
 SG_ VFC_Obj12A_Length : 192|9@1+ (0.05,0) [0|25.5] "m"  RadarFrontCenter,DASy
 SG_ VFC_Obj12A_WidthStdDev : 201|7@1+ (0.01,0) [0|1] "m"  RadarFrontCenter,DASy
 SG_ VFC_Obj12A_Height : 208|9@1+ (0.01,0) [0|5.11] "m"  RadarFrontCenter,DASy
 SG_ VFC_Obj12A_HeightStdDev : 217|7@1+ (0.01,0) [0|1] "m"  RadarFrontCenter,DASy
 SG_ VFC_Obj12A_PhiLeftStdDev : 224|8@1+ (0.0002,0) [0|0.05] ""  RadarFrontCenter,DASy
 SG_ VFC_Obj12A_HeadingStdDev : 232|6@1+ (0.01,0) [0|0.5] "rad"  RadarFrontCenter,DASy
 SG_ VFC_Obj12A_Measured : 238|2@1+ (1,0) [0|3] ""  RadarFrontCenter,DASy
 SG_ VFC_Obj12A_Heading : 240|9@1+ (0.01,-1.57) [-1.57|1.57] "rad"  RadarFrontCenter,DASy
 SG_ VFC_Obj12A_LengthStdDev : 249|7@1+ (0.05,0) [0|5] "m"  RadarFrontCenter,DASy
 SG_ VFC_Obj12A_PhiMid : 256|13@1+ (0.00025,-1) [-1|1] ""  RadarFrontCenter,DASy
 SG_ VFC_Obj12A_Width : 269|11@1+ (0.01,0) [0|12] "m"  RadarFrontCenter,DASy
 SG_ VFC_Obj12A_PhiMidStdDev : 280|8@1+ (0.0002,0) [0|0.05] ""  RadarFrontCenter,DASy
 SG_ VFC_Obj12A_PhiRight : 288|13@1+ (0.00025,-1) [-1|1] ""  RadarFrontCenter,DASy
 SG_ VFC_Obj12A_VisibleView : 301|3@1+ (1,0) [0|4] ""  RadarFrontCenter,DASy
 SG_ VFC_Obj12A_PhiRightStdDev : 304|8@1+ (0.0002,0) [0|0.05] ""  RadarFrontCenter,DASy
 SG_ VFC_Obj12A_PhiLeftVel : 312|13@1+ (0.001,-4) [-4|4] "1/s"  RadarFrontCenter,DASy
 SG_ VFC_Obj12A_PhiRightVel : 328|13@1+ (0.001,-4) [-4|4] "1/s"  RadarFrontCenter,DASy
 SG_ VFC_Obj12A_PhiRightVelStdDev : 344|8@1+ (0.001,0) [0|0.25] "1/s"  RadarFrontCenter,DASy
 SG_ VFC_Obj12A_PhiLeftVelStdDev : 352|8@1+ (0.001,0) [0|0.25] "1/s"  RadarFrontCenter,DASy
 SG_ VFC_Obj12A_PhiTop : 360|12@1+ (0.00025,-0.4) [-0.4|0.4] ""  RadarFrontCenter,DASy
 SG_ VFC_Obj12A_PhiBottom : 372|12@1+ (0.00025,-0.4) [-0.4|0.4] ""  RadarFrontCenter,DASy
 SG_ VFC_Obj12A_PhiTopStdDev : 384|8@1+ (0.0002,0) [0|0.05] ""  RadarFrontCenter,DASy
 SG_ VFC_Obj12A_HeadOrientation : 392|4@1+ (1,0) [0|10] ""  RadarFrontCenter,DASy
 SG_ VFC_Obj12A_Type : 396|4@1+ (1,0) [0|15] ""  RadarFrontCenter,DASy
 SG_ VFC_Obj12A_PhiBottomStdDev : 400|8@1+ (0.0002,0) [0|0.05] ""  RadarFrontCenter,DASy
 SG_ VFC_Obj12A_NormVx : 408|16@1+ (0.001,-40) [-40|25] "1/s"  RadarFrontCenter,DASy
 SG_ VFC_Obj12A_NormAx : 424|13@1+ (0.002,-10) [-10|6] "1/s^2"  RadarFrontCenter,DASy
 SG_ VFC_Obj12A_NormAxStdDev : 440|10@1+ (0.0025,0) [0|2.5] "1/s^2"  RadarFrontCenter,DASy
 SG_ VFC_Obj12A_ProbMovingLat : 450|6@1+ (2,0) [0|100] "%"  RadarFrontCenter,DASy
 SG_ VFC_Obj12A_ID : 456|8@1+ (1,0) [0|254] ""  RadarFrontCenter,DASy
 SG_ VFC_Obj12A_NormVxStdDev : 464|10@1+ (0.001,0) [0|1] "1/s"  RadarFrontCenter,DASy
 SG_ VFC_Obj12A_ProbMovingLong : 474|6@1+ (2,0) [0|100] "%"  RadarFrontCenter,DASy

BO_ 201 VFC_Object12B: 16 MPC3
 SG_ VFC_Obj12B_TTIPC_StdDev : 120|7@1+ (0.0625,0) [0|7.875] ""  RadarFrontCenter,DASy
 SG_ VFC_Obj12B_TTIPC : 104|11@1+ (0.008,-8) [-8|8] ""  RadarFrontCenter,DASy
 SG_ VFC_Obj12B_AngLongitude : 88|10@1+ (0.005,-2.5) [-2.5|2.5] "rad/s"  RadarFrontCenter,DASy
 SG_ VFC_Obj12B_CRC : 0|16@1+ (1,0) [0|65535] ""  RadarFrontCenter,DASy
 SG_ VFC_Obj12B_AliveCtr : 16|8@1+ (1,0) [0|255] ""  RadarFrontCenter,DASy
 SG_ VFC_Obj12B_BlockCtr : 24|4@1+ (1,0) [0|15] ""  RadarFrontCenter,DASy
 SG_ VFC_Obj12B_ScaleChange : 32|14@1+ (0.0001,0.5) [0.5|2.1] ""  RadarFrontCenter,DASy
 SG_ VFC_Obj12B_ScaleChngStdDev : 48|10@1+ (0.0001,0) [0|0.1] ""  RadarFrontCenter,DASy
 SG_ VFC_Obj12B_LineEdgeRightEgo : 58|1@1+ (1,0) [0|1] ""  RadarFrontCenter,DASy
 SG_ VFC_Obj12B_LineEdgeLeftEgo : 59|1@1+ (1,0) [0|1] ""  RadarFrontCenter,DASy
 SG_ VFC_Obj12B_CompletelyInImg : 60|1@1+ (1,0) [0|1] ""  RadarFrontCenter,DASy
 SG_ VFC_Obj12B_DirIndicator : 61|3@1+ (1,0) [0|7] ""  RadarFrontCenter,DASy
 SG_ VFC_Obj12B_LineEdgeAngle : 64|13@1+ (0.00025,-1) [-1|1] "rad"  RadarFrontCenter,DASy
 SG_ VFC_Obj12B_BrakeLight : 77|3@1+ (1,0) [0|7] ""  RadarFrontCenter,DASy
 SG_ VFC_Obj12B_MeasSource : 80|5@1+ (1,0) [0|31] ""  RadarFrontCenter,DASy
 SG_ VFC_Obj12B_Reliab : 98|6@1+ (1,0) [0|63] ""  RadarFrontCenter,DASy

BO_ 202 VFC_Object13A: 64 MPC3
 SG_ VFC_Obj13A_CRC : 0|16@1+ (1,0) [0|65535] ""  RadarFrontCenter,DASy
 SG_ VFC_Obj13A_AliveCtr : 16|8@1+ (1,0) [0|255] ""  RadarFrontCenter,DASy
 SG_ VFC_Obj13A_BlockCtr : 24|4@1+ (1,0) [0|15] ""  RadarFrontCenter,DASy
 SG_ VFC_Obj13A_ProtOrderIndex : 32|6@1+ (1,0) [0|63] ""  RadarFrontCenter,DASy
 SG_ VFC_Obj13A_Ax : 39|9@1+ (0.1,-16) [-16|16] "m/s^2"  RadarFrontCenter,DASy
 SG_ VFC_Obj13A_Vx : 48|12@1+ (0.1,-154) [-154|50] "m/s"  RadarFrontCenter,DASy
 SG_ VFC_Obj13A_Dx : 60|12@1+ (0.05,0) [0|204.7] "m"  RadarFrontCenter,DASy
 SG_ VFC_Obj13A_Dy : 72|14@1+ (0.01,-80) [-80|80] "m"  RadarFrontCenter,DASy
 SG_ VFC_Obj13A_Vy : 86|10@1+ (0.1,-50) [-50|50] "m/s"  RadarFrontCenter,DASy
 SG_ VFC_Obj13A_Ay : 96|8@1+ (0.1,-12) [-12|12] "m/s^2"  RadarFrontCenter,DASy
 SG_ VFC_Obj13A_DyStdDev : 104|10@1+ (0.02,0) [0|20] "m"  RadarFrontCenter,DASy
 SG_ VFC_Obj13A_DxStdDev : 118|10@1+ (0.05,0) [0|50] "m"  RadarFrontCenter,DASy
 SG_ VFC_Obj13A_VxStdDev : 128|10@1+ (0.1,0) [0|100] "m/s"  RadarFrontCenter,DASy
 SG_ VFC_Obj13A_ExistProb : 138|6@1+ (2,0) [0|100] "%"  RadarFrontCenter,DASy
 SG_ VFC_Obj13A_VyStdDev : 144|9@1+ (0.1,0) [0|50] "m/s"  RadarFrontCenter,DASy
 SG_ VFC_Obj13A_TypeProb : 154|6@1+ (2,0) [0|100] "%"  RadarFrontCenter,DASy
 SG_ VFC_Obj13A_AxStdDev : 160|8@1+ (0.1,0) [0|25] "m/s^2"  RadarFrontCenter,DASy
 SG_ VFC_Obj13A_AyStdDev : 168|8@1+ (0.1,0) [0|25] "m/s^2"  RadarFrontCenter,DASy
 SG_ VFC_Obj13A_PhiLeft : 176|13@1+ (0.00025,-1) [-1|1] ""  RadarFrontCenter,DASy
 SG_ VFC_Obj13A_ClassifiedView : 189|3@1+ (1,0) [0|7] ""  RadarFrontCenter,DASy
 SG_ VFC_Obj13A_Length : 192|9@1+ (0.05,0) [0|25.5] "m"  RadarFrontCenter,DASy
 SG_ VFC_Obj13A_WidthStdDev : 201|7@1+ (0.01,0) [0|1] "m"  RadarFrontCenter,DASy
 SG_ VFC_Obj13A_Height : 208|9@1+ (0.01,0) [0|5.11] "m"  RadarFrontCenter,DASy
 SG_ VFC_Obj13A_HeightStdDev : 217|7@1+ (0.01,0) [0|1] "m"  RadarFrontCenter,DASy
 SG_ VFC_Obj13A_PhiLeftStdDev : 224|8@1+ (0.0002,0) [0|0.05] ""  RadarFrontCenter,DASy
 SG_ VFC_Obj13A_HeadingStdDev : 232|6@1+ (0.01,0) [0|0.5] "rad"  RadarFrontCenter,DASy
 SG_ VFC_Obj13A_Measured : 238|2@1+ (1,0) [0|3] ""  RadarFrontCenter,DASy
 SG_ VFC_Obj13A_Heading : 240|9@1+ (0.01,-1.57) [-1.57|1.57] "rad"  RadarFrontCenter,DASy
 SG_ VFC_Obj13A_LengthStdDev : 249|7@1+ (0.05,0) [0|5] "m"  RadarFrontCenter,DASy
 SG_ VFC_Obj13A_PhiMid : 256|13@1+ (0.00025,-1) [-1|1] ""  RadarFrontCenter,DASy
 SG_ VFC_Obj13A_Width : 269|11@1+ (0.01,0) [0|12] "m"  RadarFrontCenter,DASy
 SG_ VFC_Obj13A_PhiMidStdDev : 280|8@1+ (0.0002,0) [0|0.05] ""  RadarFrontCenter,DASy
 SG_ VFC_Obj13A_PhiRight : 288|13@1+ (0.00025,-1) [-1|1] ""  RadarFrontCenter,DASy
 SG_ VFC_Obj13A_VisibleView : 301|3@1+ (1,0) [0|4] ""  RadarFrontCenter,DASy
 SG_ VFC_Obj13A_PhiRightStdDev : 304|8@1+ (0.0002,0) [0|0.05] ""  RadarFrontCenter,DASy
 SG_ VFC_Obj13A_PhiLeftVel : 312|13@1+ (0.001,-4) [-4|4] "1/s"  RadarFrontCenter,DASy
 SG_ VFC_Obj13A_PhiRightVel : 328|13@1+ (0.001,-4) [-4|4] "1/s"  RadarFrontCenter,DASy
 SG_ VFC_Obj13A_PhiRightVelStdDev : 344|8@1+ (0.001,0) [0|0.25] "1/s"  RadarFrontCenter,DASy
 SG_ VFC_Obj13A_PhiLeftVelStdDev : 352|8@1+ (0.001,0) [0|0.25] "1/s"  RadarFrontCenter,DASy
 SG_ VFC_Obj13A_PhiTop : 360|12@1+ (0.00025,-0.4) [-0.4|0.4] ""  RadarFrontCenter,DASy
 SG_ VFC_Obj13A_PhiBottom : 372|12@1+ (0.00025,-0.4) [-0.4|0.4] ""  RadarFrontCenter,DASy
 SG_ VFC_Obj13A_PhiTopStdDev : 384|8@1+ (0.0002,0) [0|0.05] ""  RadarFrontCenter,DASy
 SG_ VFC_Obj13A_HeadOrientation : 392|4@1+ (1,0) [0|10] ""  RadarFrontCenter,DASy
 SG_ VFC_Obj13A_Type : 396|4@1+ (1,0) [0|15] ""  RadarFrontCenter,DASy
 SG_ VFC_Obj13A_PhiBottomStdDev : 400|8@1+ (0.0002,0) [0|0.05] ""  RadarFrontCenter,DASy
 SG_ VFC_Obj13A_NormVx : 408|16@1+ (0.001,-40) [-40|25] "1/s"  RadarFrontCenter,DASy
 SG_ VFC_Obj13A_NormAx : 424|13@1+ (0.002,-10) [-10|6] "1/s^2"  RadarFrontCenter,DASy
 SG_ VFC_Obj13A_NormAxStdDev : 440|10@1+ (0.0025,0) [0|2.5] "1/s^2"  RadarFrontCenter,DASy
 SG_ VFC_Obj13A_ProbMovingLat : 450|6@1+ (2,0) [0|100] "%"  RadarFrontCenter,DASy
 SG_ VFC_Obj13A_ID : 456|8@1+ (1,0) [0|254] ""  RadarFrontCenter,DASy
 SG_ VFC_Obj13A_NormVxStdDev : 464|10@1+ (0.001,0) [0|1] "1/s"  RadarFrontCenter,DASy
 SG_ VFC_Obj13A_ProbMovingLong : 474|6@1+ (2,0) [0|100] "%"  RadarFrontCenter,DASy

BO_ 203 VFC_Object13B: 16 MPC3
 SG_ VFC_Obj13B_TTIPC_StdDev : 120|7@1+ (0.0625,0) [0|7.875] ""  RadarFrontCenter,DASy
 SG_ VFC_Obj13B_TTIPC : 104|11@1+ (0.008,-8) [-8|8] ""  RadarFrontCenter,DASy
 SG_ VFC_Obj13B_AngLongitude : 88|10@1+ (0.005,-2.5) [-2.5|2.5] "rad/s"  RadarFrontCenter,DASy
 SG_ VFC_Obj13B_CRC : 0|16@1+ (1,0) [0|65535] ""  RadarFrontCenter,DASy
 SG_ VFC_Obj13B_AliveCtr : 16|8@1+ (1,0) [0|255] ""  RadarFrontCenter,DASy
 SG_ VFC_Obj13B_BlockCtr : 24|4@1+ (1,0) [0|15] ""  RadarFrontCenter,DASy
 SG_ VFC_Obj13B_ScaleChange : 32|14@1+ (0.0001,0.5) [0.5|2.1] ""  RadarFrontCenter,DASy
 SG_ VFC_Obj13B_ScaleChngStdDev : 48|10@1+ (0.0001,0) [0|0.1] ""  RadarFrontCenter,DASy
 SG_ VFC_Obj13B_LineEdgeRightEgo : 58|1@1+ (1,0) [0|1] ""  RadarFrontCenter,DASy
 SG_ VFC_Obj13B_LineEdgeLeftEgo : 59|1@1+ (1,0) [0|1] ""  RadarFrontCenter,DASy
 SG_ VFC_Obj13B_CompletelyInImg : 60|1@1+ (1,0) [0|1] ""  RadarFrontCenter,DASy
 SG_ VFC_Obj13B_DirIndicator : 61|3@1+ (1,0) [0|7] ""  RadarFrontCenter,DASy
 SG_ VFC_Obj13B_LineEdgeAngle : 64|13@1+ (0.00025,-1) [-1|1] "rad"  RadarFrontCenter,DASy
 SG_ VFC_Obj13B_BrakeLight : 77|3@1+ (1,0) [0|7] ""  RadarFrontCenter,DASy
 SG_ VFC_Obj13B_MeasSource : 80|5@1+ (1,0) [0|31] ""  RadarFrontCenter,DASy
 SG_ VFC_Obj13B_Reliab : 98|6@1+ (1,0) [0|63] ""  RadarFrontCenter,DASy

BO_ 204 VFC_Object14A: 64 MPC3
 SG_ VFC_Obj14A_CRC : 0|16@1+ (1,0) [0|65535] ""  RadarFrontCenter,DASy
 SG_ VFC_Obj14A_AliveCtr : 16|8@1+ (1,0) [0|255] ""  RadarFrontCenter,DASy
 SG_ VFC_Obj14A_BlockCtr : 24|4@1+ (1,0) [0|15] ""  RadarFrontCenter,DASy
 SG_ VFC_Obj14A_ProtOrderIndex : 32|6@1+ (1,0) [0|63] ""  RadarFrontCenter,DASy
 SG_ VFC_Obj14A_Ax : 39|9@1+ (0.1,-16) [-16|16] "m/s^2"  RadarFrontCenter,DASy
 SG_ VFC_Obj14A_Vx : 48|12@1+ (0.1,-154) [-154|50] "m/s"  RadarFrontCenter,DASy
 SG_ VFC_Obj14A_Dx : 60|12@1+ (0.05,0) [0|204.7] "m"  RadarFrontCenter,DASy
 SG_ VFC_Obj14A_Dy : 72|14@1+ (0.01,-80) [-80|80] "m"  RadarFrontCenter,DASy
 SG_ VFC_Obj14A_Vy : 86|10@1+ (0.1,-50) [-50|50] "m/s"  RadarFrontCenter,DASy
 SG_ VFC_Obj14A_Ay : 96|8@1+ (0.1,-12) [-12|12] "m/s^2"  RadarFrontCenter,DASy
 SG_ VFC_Obj14A_DyStdDev : 104|10@1+ (0.02,0) [0|20] "m"  RadarFrontCenter,DASy
 SG_ VFC_Obj14A_DxStdDev : 118|10@1+ (0.05,0) [0|50] "m"  RadarFrontCenter,DASy
 SG_ VFC_Obj14A_VxStdDev : 128|10@1+ (0.1,0) [0|100] "m/s"  RadarFrontCenter,DASy
 SG_ VFC_Obj14A_ExistProb : 138|6@1+ (2,0) [0|100] "%"  RadarFrontCenter,DASy
 SG_ VFC_Obj14A_VyStdDev : 144|9@1+ (0.1,0) [0|50] "m/s"  RadarFrontCenter,DASy
 SG_ VFC_Obj14A_TypeProb : 154|6@1+ (2,0) [0|100] "%"  RadarFrontCenter,DASy
 SG_ VFC_Obj14A_AxStdDev : 160|8@1+ (0.1,0) [0|25] "m/s^2"  RadarFrontCenter,DASy
 SG_ VFC_Obj14A_AyStdDev : 168|8@1+ (0.1,0) [0|25] "m/s^2"  RadarFrontCenter,DASy
 SG_ VFC_Obj14A_PhiLeft : 176|13@1+ (0.00025,-1) [-1|1] ""  RadarFrontCenter,DASy
 SG_ VFC_Obj14A_ClassifiedView : 189|3@1+ (1,0) [0|7] ""  RadarFrontCenter,DASy
 SG_ VFC_Obj14A_Length : 192|9@1+ (0.05,0) [0|25.5] "m"  RadarFrontCenter,DASy
 SG_ VFC_Obj14A_WidthStdDev : 201|7@1+ (0.01,0) [0|1] "m"  RadarFrontCenter,DASy
 SG_ VFC_Obj14A_Height : 208|9@1+ (0.01,0) [0|5.11] "m"  RadarFrontCenter,DASy
 SG_ VFC_Obj14A_HeightStdDev : 217|7@1+ (0.01,0) [0|1] "m"  RadarFrontCenter,DASy
 SG_ VFC_Obj14A_PhiLeftStdDev : 224|8@1+ (0.0002,0) [0|0.05] ""  RadarFrontCenter,DASy
 SG_ VFC_Obj14A_HeadingStdDev : 232|6@1+ (0.01,0) [0|0.5] "rad"  RadarFrontCenter,DASy
 SG_ VFC_Obj14A_Measured : 238|2@1+ (1,0) [0|3] ""  RadarFrontCenter,DASy
 SG_ VFC_Obj14A_Heading : 240|9@1+ (0.01,-1.57) [-1.57|1.57] "rad"  RadarFrontCenter,DASy
 SG_ VFC_Obj14A_LengthStdDev : 249|7@1+ (0.05,0) [0|5] "m"  RadarFrontCenter,DASy
 SG_ VFC_Obj14A_PhiMid : 256|13@1+ (0.00025,-1) [-1|1] ""  RadarFrontCenter,DASy
 SG_ VFC_Obj14A_Width : 269|11@1+ (0.01,0) [0|12] "m"  RadarFrontCenter,DASy
 SG_ VFC_Obj14A_PhiMidStdDev : 280|8@1+ (0.0002,0) [0|0.05] ""  RadarFrontCenter,DASy
 SG_ VFC_Obj14A_PhiRight : 288|13@1+ (0.00025,-1) [-1|1] ""  RadarFrontCenter,DASy
 SG_ VFC_Obj14A_VisibleView : 301|3@1+ (1,0) [0|4] ""  RadarFrontCenter,DASy
 SG_ VFC_Obj14A_PhiRightStdDev : 304|8@1+ (0.0002,0) [0|0.05] ""  RadarFrontCenter,DASy
 SG_ VFC_Obj14A_PhiLeftVel : 312|13@1+ (0.001,-4) [-4|4] "1/s"  RadarFrontCenter,DASy
 SG_ VFC_Obj14A_PhiRightVel : 328|13@1+ (0.001,-4) [-4|4] "1/s"  RadarFrontCenter,DASy
 SG_ VFC_Obj14A_PhiRightVelStdDev : 344|8@1+ (0.001,0) [0|0.25] "1/s"  RadarFrontCenter,DASy
 SG_ VFC_Obj14A_PhiLeftVelStdDev : 352|8@1+ (0.001,0) [0|0.25] "1/s"  RadarFrontCenter,DASy
 SG_ VFC_Obj14A_PhiTop : 360|12@1+ (0.00025,-0.4) [-0.4|0.4] ""  RadarFrontCenter,DASy
 SG_ VFC_Obj14A_PhiBottom : 372|12@1+ (0.00025,-0.4) [-0.4|0.4] ""  RadarFrontCenter,DASy
 SG_ VFC_Obj14A_PhiTopStdDev : 384|8@1+ (0.0002,0) [0|0.05] ""  RadarFrontCenter,DASy
 SG_ VFC_Obj14A_HeadOrientation : 392|4@1+ (1,0) [0|10] ""  RadarFrontCenter,DASy
 SG_ VFC_Obj14A_Type : 396|4@1+ (1,0) [0|15] ""  RadarFrontCenter,DASy
 SG_ VFC_Obj14A_PhiBottomStdDev : 400|8@1+ (0.0002,0) [0|0.05] ""  RadarFrontCenter,DASy
 SG_ VFC_Obj14A_NormVx : 408|16@1+ (0.001,-40) [-40|25] "1/s"  RadarFrontCenter,DASy
 SG_ VFC_Obj14A_NormAx : 424|13@1+ (0.002,-10) [-10|6] "1/s^2"  RadarFrontCenter,DASy
 SG_ VFC_Obj14A_NormAxStdDev : 440|10@1+ (0.0025,0) [0|2.5] "1/s^2"  RadarFrontCenter,DASy
 SG_ VFC_Obj14A_ProbMovingLat : 450|6@1+ (2,0) [0|100] "%"  RadarFrontCenter,DASy
 SG_ VFC_Obj14A_ID : 456|8@1+ (1,0) [0|254] ""  RadarFrontCenter,DASy
 SG_ VFC_Obj14A_NormVxStdDev : 464|10@1+ (0.001,0) [0|1] "1/s"  RadarFrontCenter,DASy
 SG_ VFC_Obj14A_ProbMovingLong : 474|6@1+ (2,0) [0|100] "%"  RadarFrontCenter,DASy

BO_ 205 VFC_Object14B: 16 MPC3
 SG_ VFC_Obj14B_TTIPC_StdDev : 120|7@1+ (0.0625,0) [0|7.875] ""  RadarFrontCenter,DASy
 SG_ VFC_Obj14B_TTIPC : 104|11@1+ (0.008,-8) [-8|8] ""  RadarFrontCenter,DASy
 SG_ VFC_Obj14B_AngLongitude : 88|10@1+ (0.005,-2.5) [-2.5|2.5] "rad/s"  RadarFrontCenter,DASy
 SG_ VFC_Obj14B_CRC : 0|16@1+ (1,0) [0|65535] ""  RadarFrontCenter,DASy
 SG_ VFC_Obj14B_AliveCtr : 16|8@1+ (1,0) [0|255] ""  RadarFrontCenter,DASy
 SG_ VFC_Obj14B_BlockCtr : 24|4@1+ (1,0) [0|15] ""  RadarFrontCenter,DASy
 SG_ VFC_Obj14B_ScaleChange : 32|14@1+ (0.0001,0.5) [0.5|2.1] ""  RadarFrontCenter,DASy
 SG_ VFC_Obj14B_ScaleChngStdDev : 48|10@1+ (0.0001,0) [0|0.1] ""  RadarFrontCenter,DASy
 SG_ VFC_Obj14B_LineEdgeRightEgo : 58|1@1+ (1,0) [0|1] ""  RadarFrontCenter,DASy
 SG_ VFC_Obj14B_LineEdgeLeftEgo : 59|1@1+ (1,0) [0|1] ""  RadarFrontCenter,DASy
 SG_ VFC_Obj14B_CompletelyInImg : 60|1@1+ (1,0) [0|1] ""  RadarFrontCenter,DASy
 SG_ VFC_Obj14B_DirIndicator : 61|3@1+ (1,0) [0|7] ""  RadarFrontCenter,DASy
 SG_ VFC_Obj14B_LineEdgeAngle : 64|13@1+ (0.00025,-1) [-1|1] "rad"  RadarFrontCenter,DASy
 SG_ VFC_Obj14B_BrakeLight : 77|3@1+ (1,0) [0|7] ""  RadarFrontCenter,DASy
 SG_ VFC_Obj14B_MeasSource : 80|5@1+ (1,0) [0|31] ""  RadarFrontCenter,DASy
 SG_ VFC_Obj14B_Reliab : 98|6@1+ (1,0) [0|63] ""  RadarFrontCenter,DASy

BO_ 206 VFC_Object15A: 64 MPC3
 SG_ VFC_Obj15A_CRC : 0|16@1+ (1,0) [0|65535] ""  RadarFrontCenter,DASy
 SG_ VFC_Obj15A_AliveCtr : 16|8@1+ (1,0) [0|255] ""  RadarFrontCenter,DASy
 SG_ VFC_Obj15A_BlockCtr : 24|4@1+ (1,0) [0|15] ""  RadarFrontCenter,DASy
 SG_ VFC_Obj15A_ProtOrderIndex : 32|6@1+ (1,0) [0|63] ""  RadarFrontCenter,DASy
 SG_ VFC_Obj15A_Ax : 39|9@1+ (0.1,-16) [-16|16] "m/s^2"  RadarFrontCenter,DASy
 SG_ VFC_Obj15A_Vx : 48|12@1+ (0.1,-154) [-154|50] "m/s"  RadarFrontCenter,DASy
 SG_ VFC_Obj15A_Dx : 60|12@1+ (0.05,0) [0|204.7] "m"  RadarFrontCenter,DASy
 SG_ VFC_Obj15A_Dy : 72|14@1+ (0.01,-80) [-80|80] "m"  RadarFrontCenter,DASy
 SG_ VFC_Obj15A_Vy : 86|10@1+ (0.1,-50) [-50|50] "m/s"  RadarFrontCenter,DASy
 SG_ VFC_Obj15A_Ay : 96|8@1+ (0.1,-12) [-12|12] "m/s^2"  RadarFrontCenter,DASy
 SG_ VFC_Obj15A_DyStdDev : 104|10@1+ (0.02,0) [0|20] "m"  RadarFrontCenter,DASy
 SG_ VFC_Obj15A_DxStdDev : 118|10@1+ (0.05,0) [0|50] "m"  RadarFrontCenter,DASy
 SG_ VFC_Obj15A_VxStdDev : 128|10@1+ (0.1,0) [0|100] "m/s"  RadarFrontCenter,DASy
 SG_ VFC_Obj15A_ExistProb : 138|6@1+ (2,0) [0|100] "%"  RadarFrontCenter,DASy
 SG_ VFC_Obj15A_VyStdDev : 144|9@1+ (0.1,0) [0|50] "m/s"  RadarFrontCenter,DASy
 SG_ VFC_Obj15A_TypeProb : 154|6@1+ (2,0) [0|100] "%"  RadarFrontCenter,DASy
 SG_ VFC_Obj15A_AxStdDev : 160|8@1+ (0.1,0) [0|25] "m/s^2"  RadarFrontCenter,DASy
 SG_ VFC_Obj15A_AyStdDev : 168|8@1+ (0.1,0) [0|25] "m/s^2"  RadarFrontCenter,DASy
 SG_ VFC_Obj15A_PhiLeft : 176|13@1+ (0.00025,-1) [-1|1] ""  RadarFrontCenter,DASy
 SG_ VFC_Obj15A_ClassifiedView : 189|3@1+ (1,0) [0|7] ""  RadarFrontCenter,DASy
 SG_ VFC_Obj15A_Length : 192|9@1+ (0.05,0) [0|25.5] "m"  RadarFrontCenter,DASy
 SG_ VFC_Obj15A_WidthStdDev : 201|7@1+ (0.01,0) [0|1] "m"  RadarFrontCenter,DASy
 SG_ VFC_Obj15A_Height : 208|9@1+ (0.01,0) [0|5.11] "m"  RadarFrontCenter,DASy
 SG_ VFC_Obj15A_HeightStdDev : 217|7@1+ (0.01,0) [0|1] "m"  RadarFrontCenter,DASy
 SG_ VFC_Obj15A_PhiLeftStdDev : 224|8@1+ (0.0002,0) [0|0.05] ""  RadarFrontCenter,DASy
 SG_ VFC_Obj15A_HeadingStdDev : 232|6@1+ (0.01,0) [0|0.5] "rad"  RadarFrontCenter,DASy
 SG_ VFC_Obj15A_Measured : 238|2@1+ (1,0) [0|3] ""  RadarFrontCenter,DASy
 SG_ VFC_Obj15A_Heading : 240|9@1+ (0.01,-1.57) [-1.57|1.57] "rad"  RadarFrontCenter,DASy
 SG_ VFC_Obj15A_LengthStdDev : 249|7@1+ (0.05,0) [0|5] "m"  RadarFrontCenter,DASy
 SG_ VFC_Obj15A_PhiMid : 256|13@1+ (0.00025,-1) [-1|1] ""  RadarFrontCenter,DASy
 SG_ VFC_Obj15A_Width : 269|11@1+ (0.01,0) [0|12] "m"  RadarFrontCenter,DASy
 SG_ VFC_Obj15A_PhiMidStdDev : 280|8@1+ (0.0002,0) [0|0.05] ""  RadarFrontCenter,DASy
 SG_ VFC_Obj15A_PhiRight : 288|13@1+ (0.00025,-1) [-1|1] ""  RadarFrontCenter,DASy
 SG_ VFC_Obj15A_VisibleView : 301|3@1+ (1,0) [0|4] ""  RadarFrontCenter,DASy
 SG_ VFC_Obj15A_PhiRightStdDev : 304|8@1+ (0.0002,0) [0|0.05] ""  RadarFrontCenter,DASy
 SG_ VFC_Obj15A_PhiLeftVel : 312|13@1+ (0.001,-4) [-4|4] "1/s"  RadarFrontCenter,DASy
 SG_ VFC_Obj15A_PhiRightVel : 328|13@1+ (0.001,-4) [-4|4] "1/s"  RadarFrontCenter,DASy
 SG_ VFC_Obj15A_PhiRightVelStdDev : 344|8@1+ (0.001,0) [0|0.25] "1/s"  RadarFrontCenter,DASy
 SG_ VFC_Obj15A_PhiLeftVelStdDev : 352|8@1+ (0.001,0) [0|0.25] "1/s"  RadarFrontCenter,DASy
 SG_ VFC_Obj15A_PhiTop : 360|12@1+ (0.00025,-0.4) [-0.4|0.4] ""  RadarFrontCenter,DASy
 SG_ VFC_Obj15A_PhiBottom : 372|12@1+ (0.00025,-0.4) [-0.4|0.4] ""  RadarFrontCenter,DASy
 SG_ VFC_Obj15A_PhiTopStdDev : 384|8@1+ (0.0002,0) [0|0.05] ""  RadarFrontCenter,DASy
 SG_ VFC_Obj15A_HeadOrientation : 392|4@1+ (1,0) [0|10] ""  RadarFrontCenter,DASy
 SG_ VFC_Obj15A_Type : 396|4@1+ (1,0) [0|15] ""  RadarFrontCenter,DASy
 SG_ VFC_Obj15A_PhiBottomStdDev : 400|8@1+ (0.0002,0) [0|0.05] ""  RadarFrontCenter,DASy
 SG_ VFC_Obj15A_NormVx : 408|16@1+ (0.001,-40) [-40|25] "1/s"  RadarFrontCenter,DASy
 SG_ VFC_Obj15A_NormAx : 424|13@1+ (0.002,-10) [-10|6] "1/s^2"  RadarFrontCenter,DASy
 SG_ VFC_Obj15A_NormAxStdDev : 440|10@1+ (0.0025,0) [0|2.5] "1/s^2"  RadarFrontCenter,DASy
 SG_ VFC_Obj15A_ProbMovingLat : 450|6@1+ (2,0) [0|100] "%"  RadarFrontCenter,DASy
 SG_ VFC_Obj15A_ID : 456|8@1+ (1,0) [0|254] ""  RadarFrontCenter,DASy
 SG_ VFC_Obj15A_NormVxStdDev : 464|10@1+ (0.001,0) [0|1] "1/s"  RadarFrontCenter,DASy
 SG_ VFC_Obj15A_ProbMovingLong : 474|6@1+ (2,0) [0|100] "%"  RadarFrontCenter,DASy

BO_ 207 VFC_Object15B: 16 MPC3
 SG_ VFC_Obj15B_TTIPC_StdDev : 120|7@1+ (0.0625,0) [0|7.875] ""  RadarFrontCenter,DASy
 SG_ VFC_Obj15B_TTIPC : 104|11@1+ (0.008,-8) [-8|8] ""  RadarFrontCenter,DASy
 SG_ VFC_Obj15B_AngLongitude : 88|10@1+ (0.005,-2.5) [-2.5|2.5] "rad/s"  RadarFrontCenter,DASy
 SG_ VFC_Obj15B_CRC : 0|16@1+ (1,0) [0|65535] ""  RadarFrontCenter,DASy
 SG_ VFC_Obj15B_AliveCtr : 16|8@1+ (1,0) [0|255] ""  RadarFrontCenter,DASy
 SG_ VFC_Obj15B_BlockCtr : 24|4@1+ (1,0) [0|15] ""  RadarFrontCenter,DASy
 SG_ VFC_Obj15B_ScaleChange : 32|14@1+ (0.0001,0.5) [0.5|2.1] ""  RadarFrontCenter,DASy
 SG_ VFC_Obj15B_ScaleChngStdDev : 48|10@1+ (0.0001,0) [0|0.1] ""  RadarFrontCenter,DASy
 SG_ VFC_Obj15B_LineEdgeRightEgo : 58|1@1+ (1,0) [0|1] ""  RadarFrontCenter,DASy
 SG_ VFC_Obj15B_LineEdgeLeftEgo : 59|1@1+ (1,0) [0|1] ""  RadarFrontCenter,DASy
 SG_ VFC_Obj15B_CompletelyInImg : 60|1@1+ (1,0) [0|1] ""  RadarFrontCenter,DASy
 SG_ VFC_Obj15B_DirIndicator : 61|3@1+ (1,0) [0|7] ""  RadarFrontCenter,DASy
 SG_ VFC_Obj15B_LineEdgeAngle : 64|13@1+ (0.00025,-1) [-1|1] "rad"  RadarFrontCenter,DASy
 SG_ VFC_Obj15B_BrakeLight : 77|3@1+ (1,0) [0|7] ""  RadarFrontCenter,DASy
 SG_ VFC_Obj15B_MeasSource : 80|5@1+ (1,0) [0|31] ""  RadarFrontCenter,DASy
 SG_ VFC_Obj15B_Reliab : 98|6@1+ (1,0) [0|63] ""  RadarFrontCenter,DASy

BO_ 208 VFC_Object16A: 64 MPC3
 SG_ VFC_Obj16A_CRC : 0|16@1+ (1,0) [0|65535] ""  RadarFrontCenter,DASy
 SG_ VFC_Obj16A_AliveCtr : 16|8@1+ (1,0) [0|255] ""  RadarFrontCenter,DASy
 SG_ VFC_Obj16A_BlockCtr : 24|4@1+ (1,0) [0|15] ""  RadarFrontCenter,DASy
 SG_ VFC_Obj16A_ProtOrderIndex : 32|6@1+ (1,0) [0|63] ""  RadarFrontCenter,DASy
 SG_ VFC_Obj16A_Ax : 39|9@1+ (0.1,-16) [-16|16] "m/s^2"  RadarFrontCenter,DASy
 SG_ VFC_Obj16A_Vx : 48|12@1+ (0.1,-154) [-154|50] "m/s"  RadarFrontCenter,DASy
 SG_ VFC_Obj16A_Dx : 60|12@1+ (0.05,0) [0|204.7] "m"  RadarFrontCenter,DASy
 SG_ VFC_Obj16A_Dy : 72|14@1+ (0.01,-80) [-80|80] "m"  RadarFrontCenter,DASy
 SG_ VFC_Obj16A_Vy : 86|10@1+ (0.1,-50) [-50|50] "m/s"  RadarFrontCenter,DASy
 SG_ VFC_Obj16A_Ay : 96|8@1+ (0.1,-12) [-12|12] "m/s^2"  RadarFrontCenter,DASy
 SG_ VFC_Obj16A_DyStdDev : 104|10@1+ (0.02,0) [0|20] "m"  RadarFrontCenter,DASy
 SG_ VFC_Obj16A_DxStdDev : 118|10@1+ (0.05,0) [0|50] "m"  RadarFrontCenter,DASy
 SG_ VFC_Obj16A_VxStdDev : 128|10@1+ (0.1,0) [0|100] "m/s"  RadarFrontCenter,DASy
 SG_ VFC_Obj16A_ExistProb : 138|6@1+ (2,0) [0|100] "%"  RadarFrontCenter,DASy
 SG_ VFC_Obj16A_VyStdDev : 144|9@1+ (0.1,0) [0|50] "m/s"  RadarFrontCenter,DASy
 SG_ VFC_Obj16A_TypeProb : 154|6@1+ (2,0) [0|100] "%"  RadarFrontCenter,DASy
 SG_ VFC_Obj16A_AxStdDev : 160|8@1+ (0.1,0) [0|25] "m/s^2"  RadarFrontCenter,DASy
 SG_ VFC_Obj16A_AyStdDev : 168|8@1+ (0.1,0) [0|25] "m/s^2"  RadarFrontCenter,DASy
 SG_ VFC_Obj16A_PhiLeft : 176|13@1+ (0.00025,-1) [-1|1] ""  RadarFrontCenter,DASy
 SG_ VFC_Obj16A_ClassifiedView : 189|3@1+ (1,0) [0|7] ""  RadarFrontCenter,DASy
 SG_ VFC_Obj16A_Length : 192|9@1+ (0.05,0) [0|25.5] "m"  RadarFrontCenter,DASy
 SG_ VFC_Obj16A_WidthStdDev : 201|7@1+ (0.01,0) [0|1] "m"  RadarFrontCenter,DASy
 SG_ VFC_Obj16A_Height : 208|9@1+ (0.01,0) [0|5.11] "m"  RadarFrontCenter,DASy
 SG_ VFC_Obj16A_HeightStdDev : 217|7@1+ (0.01,0) [0|1] "m"  RadarFrontCenter,DASy
 SG_ VFC_Obj16A_PhiLeftStdDev : 224|8@1+ (0.0002,0) [0|0.05] ""  RadarFrontCenter,DASy
 SG_ VFC_Obj16A_HeadingStdDev : 232|6@1+ (0.01,0) [0|0.5] "rad"  RadarFrontCenter,DASy
 SG_ VFC_Obj16A_Measured : 238|2@1+ (1,0) [0|3] ""  RadarFrontCenter,DASy
 SG_ VFC_Obj16A_Heading : 240|9@1+ (0.01,-1.57) [-1.57|1.57] "rad"  RadarFrontCenter,DASy
 SG_ VFC_Obj16A_LengthStdDev : 249|7@1+ (0.05,0) [0|5] "m"  RadarFrontCenter,DASy
 SG_ VFC_Obj16A_PhiMid : 256|13@1+ (0.00025,-1) [-1|1] ""  RadarFrontCenter,DASy
 SG_ VFC_Obj16A_Width : 269|11@1+ (0.01,0) [0|12] "m"  RadarFrontCenter,DASy
 SG_ VFC_Obj16A_PhiMidStdDev : 280|8@1+ (0.0002,0) [0|0.05] ""  RadarFrontCenter,DASy
 SG_ VFC_Obj16A_PhiRight : 288|13@1+ (0.00025,-1) [-1|1] ""  RadarFrontCenter,DASy
 SG_ VFC_Obj16A_VisibleView : 301|3@1+ (1,0) [0|4] ""  RadarFrontCenter,DASy
 SG_ VFC_Obj16A_PhiRightStdDev : 304|8@1+ (0.0002,0) [0|0.05] ""  RadarFrontCenter,DASy
 SG_ VFC_Obj16A_PhiLeftVel : 312|13@1+ (0.001,-4) [-4|4] "1/s"  RadarFrontCenter,DASy
 SG_ VFC_Obj16A_PhiRightVel : 328|13@1+ (0.001,-4) [-4|4] "1/s"  RadarFrontCenter,DASy
 SG_ VFC_Obj16A_PhiRightVelStdDev : 344|8@1+ (0.001,0) [0|0.25] "1/s"  RadarFrontCenter,DASy
 SG_ VFC_Obj16A_PhiLeftVelStdDev : 352|8@1+ (0.001,0) [0|0.25] "1/s"  RadarFrontCenter,DASy
 SG_ VFC_Obj16A_PhiTop : 360|12@1+ (0.00025,-0.4) [-0.4|0.4] ""  RadarFrontCenter,DASy
 SG_ VFC_Obj16A_PhiBottom : 372|12@1+ (0.00025,-0.4) [-0.4|0.4] ""  RadarFrontCenter,DASy
 SG_ VFC_Obj16A_PhiTopStdDev : 384|8@1+ (0.0002,0) [0|0.05] ""  RadarFrontCenter,DASy
 SG_ VFC_Obj16A_HeadOrientation : 392|4@1+ (1,0) [0|10] ""  RadarFrontCenter,DASy
 SG_ VFC_Obj16A_Type : 396|4@1+ (1,0) [0|15] ""  RadarFrontCenter,DASy
 SG_ VFC_Obj16A_PhiBottomStdDev : 400|8@1+ (0.0002,0) [0|0.05] ""  RadarFrontCenter,DASy
 SG_ VFC_Obj16A_NormVx : 408|16@1+ (0.001,-40) [-40|25] "1/s"  RadarFrontCenter,DASy
 SG_ VFC_Obj16A_NormAx : 424|13@1+ (0.002,-10) [-10|6] "1/s^2"  RadarFrontCenter,DASy
 SG_ VFC_Obj16A_NormAxStdDev : 440|10@1+ (0.0025,0) [0|2.5] "1/s^2"  RadarFrontCenter,DASy
 SG_ VFC_Obj16A_ProbMovingLat : 450|6@1+ (2,0) [0|100] "%"  RadarFrontCenter,DASy
 SG_ VFC_Obj16A_ID : 456|8@1+ (1,0) [0|254] ""  RadarFrontCenter,DASy
 SG_ VFC_Obj16A_NormVxStdDev : 464|10@1+ (0.001,0) [0|1] "1/s"  RadarFrontCenter,DASy
 SG_ VFC_Obj16A_ProbMovingLong : 474|6@1+ (2,0) [0|100] "%"  RadarFrontCenter,DASy

BO_ 209 VFC_Object16B: 16 MPC3
 SG_ VFC_Obj16B_TTIPC_StdDev : 120|7@1+ (0.0625,0) [0|7.875] ""  RadarFrontCenter,DASy
 SG_ VFC_Obj16B_TTIPC : 104|11@1+ (0.008,-8) [-8|8] ""  RadarFrontCenter,DASy
 SG_ VFC_Obj16B_AngLongitude : 88|10@1+ (0.005,-2.5) [-2.5|2.5] "rad/s"  RadarFrontCenter,DASy
 SG_ VFC_Obj16B_CRC : 0|16@1+ (1,0) [0|65535] ""  RadarFrontCenter,DASy
 SG_ VFC_Obj16B_AliveCtr : 16|8@1+ (1,0) [0|255] ""  RadarFrontCenter,DASy
 SG_ VFC_Obj16B_BlockCtr : 24|4@1+ (1,0) [0|15] ""  RadarFrontCenter,DASy
 SG_ VFC_Obj16B_ScaleChange : 32|14@1+ (0.0001,0.5) [0.5|2.1] ""  RadarFrontCenter,DASy
 SG_ VFC_Obj16B_ScaleChngStdDev : 48|10@1+ (0.0001,0) [0|0.1] ""  RadarFrontCenter,DASy
 SG_ VFC_Obj16B_LineEdgeRightEgo : 58|1@1+ (1,0) [0|1] ""  RadarFrontCenter,DASy
 SG_ VFC_Obj16B_LineEdgeLeftEgo : 59|1@1+ (1,0) [0|1] ""  RadarFrontCenter,DASy
 SG_ VFC_Obj16B_CompletelyInImg : 60|1@1+ (1,0) [0|1] ""  RadarFrontCenter,DASy
 SG_ VFC_Obj16B_DirIndicator : 61|3@1+ (1,0) [0|7] ""  RadarFrontCenter,DASy
 SG_ VFC_Obj16B_LineEdgeAngle : 64|13@1+ (0.00025,-1) [-1|1] "rad"  RadarFrontCenter,DASy
 SG_ VFC_Obj16B_BrakeLight : 77|3@1+ (1,0) [0|7] ""  RadarFrontCenter,DASy
 SG_ VFC_Obj16B_MeasSource : 80|5@1+ (1,0) [0|31] ""  RadarFrontCenter,DASy
 SG_ VFC_Obj16B_Reliab : 98|6@1+ (1,0) [0|63] ""  RadarFrontCenter,DASy

BO_ 210 VFC_Object17A: 64 MPC3
 SG_ VFC_Obj17A_CRC : 0|16@1+ (1,0) [0|65535] ""  RadarFrontCenter,DASy
 SG_ VFC_Obj17A_AliveCtr : 16|8@1+ (1,0) [0|255] ""  RadarFrontCenter,DASy
 SG_ VFC_Obj17A_BlockCtr : 24|4@1+ (1,0) [0|15] ""  RadarFrontCenter,DASy
 SG_ VFC_Obj17A_ProtOrderIndex : 32|6@1+ (1,0) [0|63] ""  RadarFrontCenter,DASy
 SG_ VFC_Obj17A_Ax : 39|9@1+ (0.1,-16) [-16|16] "m/s^2"  RadarFrontCenter,DASy
 SG_ VFC_Obj17A_Vx : 48|12@1+ (0.1,-154) [-154|50] "m/s"  RadarFrontCenter,DASy
 SG_ VFC_Obj17A_Dx : 60|12@1+ (0.05,0) [0|204.7] "m"  RadarFrontCenter,DASy
 SG_ VFC_Obj17A_Dy : 72|14@1+ (0.01,-80) [-80|80] "m"  RadarFrontCenter,DASy
 SG_ VFC_Obj17A_Vy : 86|10@1+ (0.1,-50) [-50|50] "m/s"  RadarFrontCenter,DASy
 SG_ VFC_Obj17A_Ay : 96|8@1+ (0.1,-12) [-12|12] "m/s^2"  RadarFrontCenter,DASy
 SG_ VFC_Obj17A_DyStdDev : 104|10@1+ (0.02,0) [0|20] "m"  RadarFrontCenter,DASy
 SG_ VFC_Obj17A_DxStdDev : 118|10@1+ (0.05,0) [0|50] "m"  RadarFrontCenter,DASy
 SG_ VFC_Obj17A_VxStdDev : 128|10@1+ (0.1,0) [0|100] "m/s"  RadarFrontCenter,DASy
 SG_ VFC_Obj17A_ExistProb : 138|6@1+ (2,0) [0|100] "%"  RadarFrontCenter,DASy
 SG_ VFC_Obj17A_VyStdDev : 144|9@1+ (0.1,0) [0|50] "m/s"  RadarFrontCenter,DASy
 SG_ VFC_Obj17A_TypeProb : 154|6@1+ (2,0) [0|100] "%"  RadarFrontCenter,DASy
 SG_ VFC_Obj17A_AxStdDev : 160|8@1+ (0.1,0) [0|25] "m/s^2"  RadarFrontCenter,DASy
 SG_ VFC_Obj17A_AyStdDev : 168|8@1+ (0.1,0) [0|25] "m/s^2"  RadarFrontCenter,DASy
 SG_ VFC_Obj17A_PhiLeft : 176|13@1+ (0.00025,-1) [-1|1] ""  RadarFrontCenter,DASy
 SG_ VFC_Obj17A_ClassifiedView : 189|3@1+ (1,0) [0|7] ""  RadarFrontCenter,DASy
 SG_ VFC_Obj17A_Length : 192|9@1+ (0.05,0) [0|25.5] "m"  RadarFrontCenter,DASy
 SG_ VFC_Obj17A_WidthStdDev : 201|7@1+ (0.01,0) [0|1] "m"  RadarFrontCenter,DASy
 SG_ VFC_Obj17A_Height : 208|9@1+ (0.01,0) [0|5.11] "m"  RadarFrontCenter,DASy
 SG_ VFC_Obj17A_HeightStdDev : 217|7@1+ (0.01,0) [0|1] "m"  RadarFrontCenter,DASy
 SG_ VFC_Obj17A_PhiLeftStdDev : 224|8@1+ (0.0002,0) [0|0.05] ""  RadarFrontCenter,DASy
 SG_ VFC_Obj17A_HeadingStdDev : 232|6@1+ (0.01,0) [0|0.5] "rad"  RadarFrontCenter,DASy
 SG_ VFC_Obj17A_Measured : 238|2@1+ (1,0) [0|3] ""  RadarFrontCenter,DASy
 SG_ VFC_Obj17A_Heading : 240|9@1+ (0.01,-1.57) [-1.57|1.57] "rad"  RadarFrontCenter,DASy
 SG_ VFC_Obj17A_LengthStdDev : 249|7@1+ (0.05,0) [0|5] "m"  RadarFrontCenter,DASy
 SG_ VFC_Obj17A_PhiMid : 256|13@1+ (0.00025,-1) [-1|1] ""  RadarFrontCenter,DASy
 SG_ VFC_Obj17A_Width : 269|11@1+ (0.01,0) [0|12] "m"  RadarFrontCenter,DASy
 SG_ VFC_Obj17A_PhiMidStdDev : 280|8@1+ (0.0002,0) [0|0.05] ""  RadarFrontCenter,DASy
 SG_ VFC_Obj17A_PhiRight : 288|13@1+ (0.00025,-1) [-1|1] ""  RadarFrontCenter,DASy
 SG_ VFC_Obj17A_VisibleView : 301|3@1+ (1,0) [0|4] ""  RadarFrontCenter,DASy
 SG_ VFC_Obj17A_PhiRightStdDev : 304|8@1+ (0.0002,0) [0|0.05] ""  RadarFrontCenter,DASy
 SG_ VFC_Obj17A_PhiLeftVel : 312|13@1+ (0.001,-4) [-4|4] "1/s"  RadarFrontCenter,DASy
 SG_ VFC_Obj17A_PhiRightVel : 328|13@1+ (0.001,-4) [-4|4] "1/s"  RadarFrontCenter,DASy
 SG_ VFC_Obj17A_PhiRightVelStdDev : 344|8@1+ (0.001,0) [0|0.25] "1/s"  RadarFrontCenter,DASy
 SG_ VFC_Obj17A_PhiLeftVelStdDev : 352|8@1+ (0.001,0) [0|0.25] "1/s"  RadarFrontCenter,DASy
 SG_ VFC_Obj17A_PhiTop : 360|12@1+ (0.00025,-0.4) [-0.4|0.4] ""  RadarFrontCenter,DASy
 SG_ VFC_Obj17A_PhiBottom : 372|12@1+ (0.00025,-0.4) [-0.4|0.4] ""  RadarFrontCenter,DASy
 SG_ VFC_Obj17A_PhiTopStdDev : 384|8@1+ (0.0002,0) [0|0.05] ""  RadarFrontCenter,DASy
 SG_ VFC_Obj17A_HeadOrientation : 392|4@1+ (1,0) [0|10] ""  RadarFrontCenter,DASy
 SG_ VFC_Obj17A_Type : 396|4@1+ (1,0) [0|15] ""  RadarFrontCenter,DASy
 SG_ VFC_Obj17A_PhiBottomStdDev : 400|8@1+ (0.0002,0) [0|0.05] ""  RadarFrontCenter,DASy
 SG_ VFC_Obj17A_NormVx : 408|16@1+ (0.001,-40) [-40|25] "1/s"  RadarFrontCenter,DASy
 SG_ VFC_Obj17A_NormAx : 424|13@1+ (0.002,-10) [-10|6] "1/s^2"  RadarFrontCenter,DASy
 SG_ VFC_Obj17A_NormAxStdDev : 440|10@1+ (0.0025,0) [0|2.5] "1/s^2"  RadarFrontCenter,DASy
 SG_ VFC_Obj17A_ProbMovingLat : 450|6@1+ (2,0) [0|100] "%"  RadarFrontCenter,DASy
 SG_ VFC_Obj17A_ID : 456|8@1+ (1,0) [0|254] ""  RadarFrontCenter,DASy
 SG_ VFC_Obj17A_NormVxStdDev : 464|10@1+ (0.001,0) [0|1] "1/s"  RadarFrontCenter,DASy
 SG_ VFC_Obj17A_ProbMovingLong : 474|6@1+ (2,0) [0|100] "%"  RadarFrontCenter,DASy

BO_ 211 VFC_Object17B: 16 MPC3
 SG_ VFC_Obj17B_TTIPC_StdDev : 120|7@1+ (0.0625,0) [0|7.875] ""  RadarFrontCenter,DASy
 SG_ VFC_Obj17B_TTIPC : 104|11@1+ (0.008,-8) [-8|8] ""  RadarFrontCenter,DASy
 SG_ VFC_Obj17B_AngLongitude : 88|10@1+ (0.005,-2.5) [-2.5|2.5] "rad/s"  RadarFrontCenter,DASy
 SG_ VFC_Obj17B_CRC : 0|16@1+ (1,0) [0|65535] ""  RadarFrontCenter,DASy
 SG_ VFC_Obj17B_AliveCtr : 16|8@1+ (1,0) [0|255] ""  RadarFrontCenter,DASy
 SG_ VFC_Obj17B_BlockCtr : 24|4@1+ (1,0) [0|15] ""  RadarFrontCenter,DASy
 SG_ VFC_Obj17B_ScaleChange : 32|14@1+ (0.0001,0.5) [0.5|2.1] ""  RadarFrontCenter,DASy
 SG_ VFC_Obj17B_ScaleChngStdDev : 48|10@1+ (0.0001,0) [0|0.1] ""  RadarFrontCenter,DASy
 SG_ VFC_Obj17B_LineEdgeRightEgo : 58|1@1+ (1,0) [0|1] ""  RadarFrontCenter,DASy
 SG_ VFC_Obj17B_LineEdgeLeftEgo : 59|1@1+ (1,0) [0|1] ""  RadarFrontCenter,DASy
 SG_ VFC_Obj17B_CompletelyInImg : 60|1@1+ (1,0) [0|1] ""  RadarFrontCenter,DASy
 SG_ VFC_Obj17B_DirIndicator : 61|3@1+ (1,0) [0|7] ""  RadarFrontCenter,DASy
 SG_ VFC_Obj17B_LineEdgeAngle : 64|13@1+ (0.00025,-1) [-1|1] "rad"  RadarFrontCenter,DASy
 SG_ VFC_Obj17B_BrakeLight : 77|3@1+ (1,0) [0|7] ""  RadarFrontCenter,DASy
 SG_ VFC_Obj17B_MeasSource : 80|5@1+ (1,0) [0|31] ""  RadarFrontCenter,DASy
 SG_ VFC_Obj17B_Reliab : 98|6@1+ (1,0) [0|63] ""  RadarFrontCenter,DASy

BO_ 212 VFC_Object18A: 64 MPC3
 SG_ VFC_Obj18A_CRC : 0|16@1+ (1,0) [0|65535] ""  RadarFrontCenter,DASy
 SG_ VFC_Obj18A_AliveCtr : 16|8@1+ (1,0) [0|255] ""  RadarFrontCenter,DASy
 SG_ VFC_Obj18A_BlockCtr : 24|4@1+ (1,0) [0|15] ""  RadarFrontCenter,DASy
 SG_ VFC_Obj18A_ProtOrderIndex : 32|6@1+ (1,0) [0|63] ""  RadarFrontCenter,DASy
 SG_ VFC_Obj18A_Ax : 39|9@1+ (0.1,-16) [-16|16] "m/s^2"  RadarFrontCenter,DASy
 SG_ VFC_Obj18A_Vx : 48|12@1+ (0.1,-154) [-154|50] "m/s"  RadarFrontCenter,DASy
 SG_ VFC_Obj18A_Dx : 60|12@1+ (0.05,0) [0|204.7] "m"  RadarFrontCenter,DASy
 SG_ VFC_Obj18A_Dy : 72|14@1+ (0.01,-80) [-80|80] "m"  RadarFrontCenter,DASy
 SG_ VFC_Obj18A_Vy : 86|10@1+ (0.1,-50) [-50|50] "m/s"  RadarFrontCenter,DASy
 SG_ VFC_Obj18A_Ay : 96|8@1+ (0.1,-12) [-12|12] "m/s^2"  RadarFrontCenter,DASy
 SG_ VFC_Obj18A_DyStdDev : 104|10@1+ (0.02,0) [0|20] "m"  RadarFrontCenter,DASy
 SG_ VFC_Obj18A_DxStdDev : 118|10@1+ (0.05,0) [0|50] "m"  RadarFrontCenter,DASy
 SG_ VFC_Obj18A_VxStdDev : 128|10@1+ (0.1,0) [0|100] "m/s"  RadarFrontCenter,DASy
 SG_ VFC_Obj18A_ExistProb : 138|6@1+ (2,0) [0|100] "%"  RadarFrontCenter,DASy
 SG_ VFC_Obj18A_VyStdDev : 144|9@1+ (0.1,0) [0|50] "m/s"  RadarFrontCenter,DASy
 SG_ VFC_Obj18A_TypeProb : 154|6@1+ (2,0) [0|100] "%"  RadarFrontCenter,DASy
 SG_ VFC_Obj18A_AxStdDev : 160|8@1+ (0.1,0) [0|25] "m/s^2"  RadarFrontCenter,DASy
 SG_ VFC_Obj18A_AyStdDev : 168|8@1+ (0.1,0) [0|25] "m/s^2"  RadarFrontCenter,DASy
 SG_ VFC_Obj18A_PhiLeft : 176|13@1+ (0.00025,-1) [-1|1] ""  RadarFrontCenter,DASy
 SG_ VFC_Obj18A_ClassifiedView : 189|3@1+ (1,0) [0|7] ""  RadarFrontCenter,DASy
 SG_ VFC_Obj18A_Length : 192|9@1+ (0.05,0) [0|25.5] "m"  RadarFrontCenter,DASy
 SG_ VFC_Obj18A_WidthStdDev : 201|7@1+ (0.01,0) [0|1] "m"  RadarFrontCenter,DASy
 SG_ VFC_Obj18A_Height : 208|9@1+ (0.01,0) [0|5.11] "m"  RadarFrontCenter,DASy
 SG_ VFC_Obj18A_HeightStdDev : 217|7@1+ (0.01,0) [0|1] "m"  RadarFrontCenter,DASy
 SG_ VFC_Obj18A_PhiLeftStdDev : 224|8@1+ (0.0002,0) [0|0.05] ""  RadarFrontCenter,DASy
 SG_ VFC_Obj18A_HeadingStdDev : 232|6@1+ (0.01,0) [0|0.5] "rad"  RadarFrontCenter,DASy
 SG_ VFC_Obj18A_Measured : 238|2@1+ (1,0) [0|3] ""  RadarFrontCenter,DASy
 SG_ VFC_Obj18A_Heading : 240|9@1+ (0.01,-1.57) [-1.57|1.57] "rad"  RadarFrontCenter,DASy
 SG_ VFC_Obj18A_LengthStdDev : 249|7@1+ (0.05,0) [0|5] "m"  RadarFrontCenter,DASy
 SG_ VFC_Obj18A_PhiMid : 256|13@1+ (0.00025,-1) [-1|1] ""  RadarFrontCenter,DASy
 SG_ VFC_Obj18A_Width : 269|11@1+ (0.01,0) [0|12] "m"  RadarFrontCenter,DASy
 SG_ VFC_Obj18A_PhiMidStdDev : 280|8@1+ (0.0002,0) [0|0.05] ""  RadarFrontCenter,DASy
 SG_ VFC_Obj18A_PhiRight : 288|13@1+ (0.00025,-1) [-1|1] ""  RadarFrontCenter,DASy
 SG_ VFC_Obj18A_VisibleView : 301|3@1+ (1,0) [0|4] ""  RadarFrontCenter,DASy
 SG_ VFC_Obj18A_PhiRightStdDev : 304|8@1+ (0.0002,0) [0|0.05] ""  RadarFrontCenter,DASy
 SG_ VFC_Obj18A_PhiLeftVel : 312|13@1+ (0.001,-4) [-4|4] "1/s"  RadarFrontCenter,DASy
 SG_ VFC_Obj18A_PhiRightVel : 328|13@1+ (0.001,-4) [-4|4] "1/s"  RadarFrontCenter,DASy
 SG_ VFC_Obj18A_PhiRightVelStdDev : 344|8@1+ (0.001,0) [0|0.25] "1/s"  RadarFrontCenter,DASy
 SG_ VFC_Obj18A_PhiLeftVelStdDev : 352|8@1+ (0.001,0) [0|0.25] "1/s"  RadarFrontCenter,DASy
 SG_ VFC_Obj18A_PhiTop : 360|12@1+ (0.00025,-0.4) [-0.4|0.4] ""  RadarFrontCenter,DASy
 SG_ VFC_Obj18A_PhiBottom : 372|12@1+ (0.00025,-0.4) [-0.4|0.4] ""  RadarFrontCenter,DASy
 SG_ VFC_Obj18A_PhiTopStdDev : 384|8@1+ (0.0002,0) [0|0.05] ""  RadarFrontCenter,DASy
 SG_ VFC_Obj18A_HeadOrientation : 392|4@1+ (1,0) [0|10] ""  RadarFrontCenter,DASy
 SG_ VFC_Obj18A_Type : 396|4@1+ (1,0) [0|15] ""  RadarFrontCenter,DASy
 SG_ VFC_Obj18A_PhiBottomStdDev : 400|8@1+ (0.0002,0) [0|0.05] ""  RadarFrontCenter,DASy
 SG_ VFC_Obj18A_NormVx : 408|16@1+ (0.001,-40) [-40|25] "1/s"  RadarFrontCenter,DASy
 SG_ VFC_Obj18A_NormAx : 424|13@1+ (0.002,-10) [-10|6] "1/s^2"  RadarFrontCenter,DASy
 SG_ VFC_Obj18A_NormAxStdDev : 440|10@1+ (0.0025,0) [0|2.5] "1/s^2"  RadarFrontCenter,DASy
 SG_ VFC_Obj18A_ProbMovingLat : 450|6@1+ (2,0) [0|100] "%"  RadarFrontCenter,DASy
 SG_ VFC_Obj18A_ID : 456|8@1+ (1,0) [0|254] ""  RadarFrontCenter,DASy
 SG_ VFC_Obj18A_NormVxStdDev : 464|10@1+ (0.001,0) [0|1] "1/s"  RadarFrontCenter,DASy
 SG_ VFC_Obj18A_ProbMovingLong : 474|6@1+ (2,0) [0|100] "%"  RadarFrontCenter,DASy

BO_ 213 VFC_Object18B: 16 MPC3
 SG_ VFC_Obj18B_TTIPC_StdDev : 120|7@1+ (0.0625,0) [0|7.875] ""  RadarFrontCenter,DASy
 SG_ VFC_Obj18B_TTIPC : 104|11@1+ (0.008,-8) [-8|8] ""  RadarFrontCenter,DASy
 SG_ VFC_Obj18B_AngLongitude : 88|10@1+ (0.005,-2.5) [-2.5|2.5] "rad/s"  RadarFrontCenter,DASy
 SG_ VFC_Obj18B_CRC : 0|16@1+ (1,0) [0|65535] ""  RadarFrontCenter,DASy
 SG_ VFC_Obj18B_AliveCtr : 16|8@1+ (1,0) [0|255] ""  RadarFrontCenter,DASy
 SG_ VFC_Obj18B_BlockCtr : 24|4@1+ (1,0) [0|15] ""  RadarFrontCenter,DASy
 SG_ VFC_Obj18B_ScaleChange : 32|14@1+ (0.0001,0.5) [0.5|2.1] ""  RadarFrontCenter,DASy
 SG_ VFC_Obj18B_ScaleChngStdDev : 48|10@1+ (0.0001,0) [0|0.1] ""  RadarFrontCenter,DASy
 SG_ VFC_Obj18B_LineEdgeRightEgo : 58|1@1+ (1,0) [0|1] ""  RadarFrontCenter,DASy
 SG_ VFC_Obj18B_LineEdgeLeftEgo : 59|1@1+ (1,0) [0|1] ""  RadarFrontCenter,DASy
 SG_ VFC_Obj18B_CompletelyInImg : 60|1@1+ (1,0) [0|1] ""  RadarFrontCenter,DASy
 SG_ VFC_Obj18B_DirIndicator : 61|3@1+ (1,0) [0|7] ""  RadarFrontCenter,DASy
 SG_ VFC_Obj18B_LineEdgeAngle : 64|13@1+ (0.00025,-1) [-1|1] "rad"  RadarFrontCenter,DASy
 SG_ VFC_Obj18B_BrakeLight : 77|3@1+ (1,0) [0|7] ""  RadarFrontCenter,DASy
 SG_ VFC_Obj18B_MeasSource : 80|5@1+ (1,0) [0|31] ""  RadarFrontCenter,DASy
 SG_ VFC_Obj18B_Reliab : 98|6@1+ (1,0) [0|63] ""  RadarFrontCenter,DASy

CM_ SG_ 194 VFC_Obj09A_CRC "CRC - Autosar E2E Profile 5";
CM_ SG_ 194 VFC_Obj09A_AliveCtr "Alive counter - Autosar E2E Profile 5";
CM_ SG_ 194 VFC_Obj09A_BlockCtr "Protocol-Signal: Block-Counter";
CM_ SG_ 194 VFC_Obj09A_ProtOrderIndex "Protocol-Signal: Index to ensure same order in Tx and Rx of the objects";
CM_ SG_ 194 VFC_Obj09A_Ax "Object Acceleration in longitudinal direction";
CM_ SG_ 194 VFC_Obj09A_Vx "Object Velocity in longitudinal direction";
CM_ SG_ 194 VFC_Obj09A_Dx "Object Position in longitudinal direction";
CM_ SG_ 194 VFC_Obj09A_Dy "Object Position in lateral direction";
CM_ SG_ 194 VFC_Obj09A_Vy "Object Velocity in lateral direction";
CM_ SG_ 194 VFC_Obj09A_Ay "Object Acceleration in lateral direction";
CM_ SG_ 194 VFC_Obj09A_DyStdDev "Standard deviation of Object position in lateral direction";
CM_ SG_ 194 VFC_Obj09A_DxStdDev "Standard deviation of Object position in longitudinal direction";
CM_ SG_ 194 VFC_Obj09A_VxStdDev "Standard deviation of Object velocity in longitudinal direction";
CM_ SG_ 194 VFC_Obj09A_ExistProb "Object existence probability";
CM_ SG_ 194 VFC_Obj09A_VyStdDev "Standard deviation of Object velocity in lateral direction";
CM_ SG_ 194 VFC_Obj09A_TypeProb "Probability of the classified object type";
CM_ SG_ 194 VFC_Obj09A_AxStdDev "Standard deviation of Object acceleration in longitudinal direction";
CM_ SG_ 194 VFC_Obj09A_AyStdDev "Standard deviation of Object acceleration in lateral direction";
CM_ SG_ 194 VFC_Obj09A_PhiLeft "ACCS Viewing Angle of left object edge(dimensionless)";
CM_ SG_ 194 VFC_Obj09A_ClassifiedView "The classified view of object to be used in connection with Heading angle";
CM_ SG_ 194 VFC_Obj09A_Length "Length of the object";
CM_ SG_ 194 VFC_Obj09A_WidthStdDev "Standard deviation of object width";
CM_ SG_ 194 VFC_Obj09A_Height "Height of the object";
CM_ SG_ 194 VFC_Obj09A_HeightStdDev "Standard deviation of object height";
CM_ SG_ 194 VFC_Obj09A_PhiLeftStdDev "Standard deviation of the ACCS angle of left object(dimensionless)";
CM_ SG_ 194 VFC_Obj09A_HeadingStdDev "Standard deviation of object Heading angle";
CM_ SG_ 194 VFC_Obj09A_Measured "Indicator if the object detected is measured or predicted.";
CM_ SG_ 194 VFC_Obj09A_Heading "Heading angle of the object";
CM_ SG_ 194 VFC_Obj09A_LengthStdDev "Standard deviation of object length";
CM_ SG_ 194 VFC_Obj09A_PhiMid "Viewing angle of the ACCS middle of the object(dimensionless)";
CM_ SG_ 194 VFC_Obj09A_Width "Width of the object";
CM_ SG_ 194 VFC_Obj09A_PhiMidStdDev "Standard deviation of the ACCS middle angle of object(dimensionless)";
CM_ SG_ 194 VFC_Obj09A_PhiRight "ACCS Viewing Angle of right object edge(dimensionless)";
CM_ SG_ 194 VFC_Obj09A_VisibleView "The visible view of the detectd object";
CM_ SG_ 194 VFC_Obj09A_PhiRightStdDev "Standard deviation of the ACCS angle of right object(dimensionless)";
CM_ SG_ 194 VFC_Obj09A_PhiLeftVel "Velocity of the ACCS viewing angle of the left edge";
CM_ SG_ 194 VFC_Obj09A_PhiRightVel "Velocity of the ACCS viewing angle of the right edge";
CM_ SG_ 194 VFC_Obj09A_PhiRightVelStdDev "Standard deviation of ACCS viewing angle velocity of right object edge from ego vehicle related to camera";
CM_ SG_ 194 VFC_Obj09A_PhiLeftVelStdDev "Standard deviation of ACCS viewing angle velocity of left object edge from ego vehicle related to camera";
CM_ SG_ 194 VFC_Obj09A_PhiTop "ACCS Viewing angle of the top of the object(dimensionless)";
CM_ SG_ 194 VFC_Obj09A_PhiBottom "ACCS Viewing angle of the bottom of the object(dimensionless)";
CM_ SG_ 194 VFC_Obj09A_PhiTopStdDev "Standard deviation  of the ACCS top angle of object(dimensionless)";
CM_ SG_ 194 VFC_Obj09A_HeadOrientation "The orientation of the head of cyclists or pedestrians that are detected.";
CM_ SG_ 194 VFC_Obj09A_Type "Classification of the object";
CM_ SG_ 194 VFC_Obj09A_PhiBottomStdDev "Standard deviation of the ACCS bottom angle of object(dimensionless)";
CM_ SG_ 194 VFC_Obj09A_NormVx "Normalised object velocity in longitudinal direction.";
CM_ SG_ 194 VFC_Obj09A_NormAx "Normalised object acceleration in longitudinal direction.";
CM_ SG_ 194 VFC_Obj09A_NormAxStdDev "Standard deviation of Normalized Object Acceleration in longitudinal direction";
CM_ SG_ 194 VFC_Obj09A_ProbMovingLat "Probability of object moving laterally";
CM_ SG_ 194 VFC_Obj09A_ID "Unique Object ID";
CM_ SG_ 194 VFC_Obj09A_NormVxStdDev "Standard deviation of Normalized Object Velocity in longitudinal direction";
CM_ SG_ 194 VFC_Obj09A_ProbMovingLong "Probability of object moving longitudinally";
CM_ SG_ 195 VFC_Obj09B_TTIPC_StdDev "Inverse TTI standard deviation";
CM_ SG_ 195 VFC_Obj09B_TTIPC "Inverse TTI";
CM_ SG_ 195 VFC_Obj09B_AngLongitude "angular velocity with regarding to longitudinal direction";
CM_ SG_ 195 VFC_Obj09B_CRC "CRC - Autosar E2E Profile 5";
CM_ SG_ 195 VFC_Obj09B_AliveCtr "Alive counter - Autosar E2E Profile 5";
CM_ SG_ 195 VFC_Obj09B_BlockCtr "Protocol-Signal: Block Counter";
CM_ SG_ 195 VFC_Obj09B_ScaleChange "A scale change of of the detected object";
CM_ SG_ 195 VFC_Obj09B_ScaleChngStdDev "Standard deviation of object scale change";
CM_ SG_ 195 VFC_Obj09B_LineEdgeRightEgo "ObjLineEdgeAngle refers to the line which limits the host vehicle lane on the right side";
CM_ SG_ 195 VFC_Obj09B_LineEdgeLeftEgo "ObjLineEdgeAngle refers to the line which limits the host vehicle lane on the left side";
CM_ SG_ 195 VFC_Obj09B_CompletelyInImg "indicator if the object is completely measrued in the image";
CM_ SG_ 195 VFC_Obj09B_DirIndicator "The detected direction indicator lights";
CM_ SG_ 195 VFC_Obj09B_LineEdgeAngle "Angle between the video object's edge and the lane marking";
CM_ SG_ 195 VFC_Obj09B_BrakeLight "The number of detected lights. More confident if more lights are detected.";
CM_ SG_ 195 VFC_Obj09B_MeasSource "Bitmask for the measurement programs from which this object originates";
CM_ SG_ 195 VFC_Obj09B_Reliab "Bitmask that indicates the algorithmic paths that have detected this object";
CM_ SG_ 196 VFC_Obj10A_CRC "CRC - Autosar E2E Profile 5";
CM_ SG_ 196 VFC_Obj10A_AliveCtr "Alive counter - Autosar E2E Profile 5";
CM_ SG_ 196 VFC_Obj10A_BlockCtr "Protocol-Signal: Block-Counter";
CM_ SG_ 196 VFC_Obj10A_ProtOrderIndex "Protocol-Signal: Index to ensure same order in Tx and Rx of the objects";
CM_ SG_ 196 VFC_Obj10A_Ax "Object Acceleration in longitudinal direction";
CM_ SG_ 196 VFC_Obj10A_Vx "Object Velocity in longitudinal direction";
CM_ SG_ 196 VFC_Obj10A_Dx "Object Position in longitudinal direction";
CM_ SG_ 196 VFC_Obj10A_Dy "Object Position in lateral direction";
CM_ SG_ 196 VFC_Obj10A_Vy "Object Velocity in lateral direction";
CM_ SG_ 196 VFC_Obj10A_Ay "Object Acceleration in lateral direction";
CM_ SG_ 196 VFC_Obj10A_DyStdDev "Standard deviation of Object position in lateral direction";
CM_ SG_ 196 VFC_Obj10A_DxStdDev "Standard deviation of Object position in longitudinal direction";
CM_ SG_ 196 VFC_Obj10A_VxStdDev "Standard deviation of Object velocity in longitudinal direction";
CM_ SG_ 196 VFC_Obj10A_ExistProb "Object existence probability";
CM_ SG_ 196 VFC_Obj10A_VyStdDev "Standard deviation of Object velocity in lateral direction";
CM_ SG_ 196 VFC_Obj10A_TypeProb "Probability of the classified object type";
CM_ SG_ 196 VFC_Obj10A_AxStdDev "Standard deviation of Object acceleration in longitudinal direction";
CM_ SG_ 196 VFC_Obj10A_AyStdDev "Standard deviation of Object acceleration in lateral direction";
CM_ SG_ 196 VFC_Obj10A_PhiLeft "ACCS Viewing Angle of left object edge(dimensionless)";
CM_ SG_ 196 VFC_Obj10A_ClassifiedView "The classified view of object to be used in connection with Heading angle";
CM_ SG_ 196 VFC_Obj10A_Length "Length of the object";
CM_ SG_ 196 VFC_Obj10A_WidthStdDev "Standard deviation of object width";
CM_ SG_ 196 VFC_Obj10A_Height "Height of the object";
CM_ SG_ 196 VFC_Obj10A_HeightStdDev "Standard deviation of object height";
CM_ SG_ 196 VFC_Obj10A_PhiLeftStdDev "Standard deviation of the ACCS angle of left object(dimensionless)";
CM_ SG_ 196 VFC_Obj10A_HeadingStdDev "Standard deviation of object Heading angle";
CM_ SG_ 196 VFC_Obj10A_Measured "Indicator if the object detected is measured or predicted.";
CM_ SG_ 196 VFC_Obj10A_Heading "Heading angle of the object";
CM_ SG_ 196 VFC_Obj10A_LengthStdDev "Standard deviation of object length";
CM_ SG_ 196 VFC_Obj10A_PhiMid "Viewing angle of the ACCS middle of the object(dimensionless)";
CM_ SG_ 196 VFC_Obj10A_Width "Width of the object";
CM_ SG_ 196 VFC_Obj10A_PhiMidStdDev "Standard deviation of the ACCS middle angle of object(dimensionless)";
CM_ SG_ 196 VFC_Obj10A_PhiRight "ACCS Viewing Angle of right object edge(dimensionless)";
CM_ SG_ 196 VFC_Obj10A_VisibleView "The visible view of the detectd object";
CM_ SG_ 196 VFC_Obj10A_PhiRightStdDev "Standard deviation of the ACCS angle of right object(dimensionless)";
CM_ SG_ 196 VFC_Obj10A_PhiLeftVel "Velocity of the ACCS viewing angle of the left edge";
CM_ SG_ 196 VFC_Obj10A_PhiRightVel "Velocity of the ACCS viewing angle of the right edge";
CM_ SG_ 196 VFC_Obj10A_PhiRightVelStdDev "Standard deviation of ACCS viewing angle velocity of right object edge from ego vehicle related to camera";
CM_ SG_ 196 VFC_Obj10A_PhiLeftVelStdDev "Standard deviation of ACCS viewing angle velocity of left object edge from ego vehicle related to camera";
CM_ SG_ 196 VFC_Obj10A_PhiTop "ACCS Viewing angle of the top of the object(dimensionless)";
CM_ SG_ 196 VFC_Obj10A_PhiBottom "ACCS Viewing angle of the bottom of the object(dimensionless)";
CM_ SG_ 196 VFC_Obj10A_PhiTopStdDev "Standard deviation  of the ACCS top angle of object(dimensionless)";
CM_ SG_ 196 VFC_Obj10A_HeadOrientation "The orientation of the head of cyclists or pedestrians that are detected.";
CM_ SG_ 196 VFC_Obj10A_Type "Classification of the object";
CM_ SG_ 196 VFC_Obj10A_PhiBottomStdDev "Standard deviation of the ACCS bottom angle of object(dimensionless)";
CM_ SG_ 196 VFC_Obj10A_NormVx "Normalised object velocity in longitudinal direction.";
CM_ SG_ 196 VFC_Obj10A_NormAx "Normalised object acceleration in longitudinal direction.";
CM_ SG_ 196 VFC_Obj10A_NormAxStdDev "Standard deviation of Normalized Object Acceleration in longitudinal direction";
CM_ SG_ 196 VFC_Obj10A_ProbMovingLat "Probability of object moving laterally";
CM_ SG_ 196 VFC_Obj10A_ID "Unique Object ID";
CM_ SG_ 196 VFC_Obj10A_NormVxStdDev "Standard deviation of Normalized Object Velocity in longitudinal direction";
CM_ SG_ 196 VFC_Obj10A_ProbMovingLong "Probability of object moving longitudinally";
CM_ SG_ 197 VFC_Obj10B_TTIPC_StdDev "Inverse TTI standard deviation";
CM_ SG_ 197 VFC_Obj10B_TTIPC "Inverse TTI";
CM_ SG_ 197 VFC_Obj10B_AngLongitude "angular velocity with regarding to longitudinal direction";
CM_ SG_ 197 VFC_Obj10B_CRC "CRC - Autosar E2E Profile 5";
CM_ SG_ 197 VFC_Obj10B_AliveCtr "Alive counter - Autosar E2E Profile 5";
CM_ SG_ 197 VFC_Obj10B_BlockCtr "Protocol-Signal: Block Counter";
CM_ SG_ 197 VFC_Obj10B_ScaleChange "A scale change of of the detected object";
CM_ SG_ 197 VFC_Obj10B_ScaleChngStdDev "Standard deviation of object scale change";
CM_ SG_ 197 VFC_Obj10B_LineEdgeRightEgo "ObjLineEdgeAngle refers to the line which limits the host vehicle lane on the right side";
CM_ SG_ 197 VFC_Obj10B_LineEdgeLeftEgo "ObjLineEdgeAngle refers to the line which limits the host vehicle lane on the left side";
CM_ SG_ 197 VFC_Obj10B_CompletelyInImg "indicator if the object is completely measrued in the image";
CM_ SG_ 197 VFC_Obj10B_DirIndicator "The detected direction indicator lights";
CM_ SG_ 197 VFC_Obj10B_LineEdgeAngle "Angle between the video object's edge and the lane marking";
CM_ SG_ 197 VFC_Obj10B_BrakeLight "The number of detected lights. More confident if more lights are detected.";
CM_ SG_ 197 VFC_Obj10B_MeasSource "Bitmask for the measurement programs from which this object originates";
CM_ SG_ 197 VFC_Obj10B_Reliab "Bitmask that indicates the algorithmic paths that have detected this object";
CM_ SG_ 198 VFC_Obj11A_CRC "CRC - Autosar E2E Profile 5";
CM_ SG_ 198 VFC_Obj11A_AliveCtr "Alive counter - Autosar E2E Profile 5";
CM_ SG_ 198 VFC_Obj11A_BlockCtr "Protocol-Signal: Block-Counter";
CM_ SG_ 198 VFC_Obj11A_ProtOrderIndex "Protocol-Signal: Index to ensure same order in Tx and Rx of the objects";
CM_ SG_ 198 VFC_Obj11A_Ax "Object Acceleration in longitudinal direction";
CM_ SG_ 198 VFC_Obj11A_Vx "Object Velocity in longitudinal direction";
CM_ SG_ 198 VFC_Obj11A_Dx "Object Position in longitudinal direction";
CM_ SG_ 198 VFC_Obj11A_Dy "Object Position in lateral direction";
CM_ SG_ 198 VFC_Obj11A_Vy "Object Velocity in lateral direction";
CM_ SG_ 198 VFC_Obj11A_Ay "Object Acceleration in lateral direction";
CM_ SG_ 198 VFC_Obj11A_DyStdDev "Standard deviation of Object position in lateral direction";
CM_ SG_ 198 VFC_Obj11A_DxStdDev "Standard deviation of Object position in longitudinal direction";
CM_ SG_ 198 VFC_Obj11A_VxStdDev "Standard deviation of Object velocity in longitudinal direction";
CM_ SG_ 198 VFC_Obj11A_ExistProb "Object existence probability";
CM_ SG_ 198 VFC_Obj11A_VyStdDev "Standard deviation of Object velocity in lateral direction";
CM_ SG_ 198 VFC_Obj11A_TypeProb "Probability of the classified object type";
CM_ SG_ 198 VFC_Obj11A_AxStdDev "Standard deviation of Object acceleration in longitudinal direction";
CM_ SG_ 198 VFC_Obj11A_AyStdDev "Standard deviation of Object acceleration in lateral direction";
CM_ SG_ 198 VFC_Obj11A_PhiLeft "ACCS Viewing Angle of left object edge(dimensionless)";
CM_ SG_ 198 VFC_Obj11A_ClassifiedView "The classified view of object to be used in connection with Heading angle";
CM_ SG_ 198 VFC_Obj11A_Length "Length of the object";
CM_ SG_ 198 VFC_Obj11A_WidthStdDev "Standard deviation of object width";
CM_ SG_ 198 VFC_Obj11A_Height "Height of the object";
CM_ SG_ 198 VFC_Obj11A_HeightStdDev "Standard deviation of object height";
CM_ SG_ 198 VFC_Obj11A_PhiLeftStdDev "Standard deviation of the ACCS angle of left object(dimensionless)";
CM_ SG_ 198 VFC_Obj11A_HeadingStdDev "Standard deviation of object Heading angle";
CM_ SG_ 198 VFC_Obj11A_Measured "Indicator if the object detected is measured or predicted.";
CM_ SG_ 198 VFC_Obj11A_Heading "Heading angle of the object";
CM_ SG_ 198 VFC_Obj11A_LengthStdDev "Standard deviation of object length";
CM_ SG_ 198 VFC_Obj11A_PhiMid "Viewing angle of the ACCS middle of the object(dimensionless)";
CM_ SG_ 198 VFC_Obj11A_Width "Width of the object";
CM_ SG_ 198 VFC_Obj11A_PhiMidStdDev "Standard deviation of the ACCS middle angle of object(dimensionless)";
CM_ SG_ 198 VFC_Obj11A_PhiRight "ACCS Viewing Angle of right object edge(dimensionless)";
CM_ SG_ 198 VFC_Obj11A_VisibleView "The visible view of the detectd object";
CM_ SG_ 198 VFC_Obj11A_PhiRightStdDev "Standard deviation of the ACCS angle of right object(dimensionless)";
CM_ SG_ 198 VFC_Obj11A_PhiLeftVel "Velocity of the ACCS viewing angle of the left edge";
CM_ SG_ 198 VFC_Obj11A_PhiRightVel "Velocity of the ACCS viewing angle of the right edge";
CM_ SG_ 198 VFC_Obj11A_PhiRightVelStdDev "Standard deviation of ACCS viewing angle velocity of right object edge from ego vehicle related to camera";
CM_ SG_ 198 VFC_Obj11A_PhiLeftVelStdDev "Standard deviation of ACCS viewing angle velocity of left object edge from ego vehicle related to camera";
CM_ SG_ 198 VFC_Obj11A_PhiTop "ACCS Viewing angle of the top of the object(dimensionless)";
CM_ SG_ 198 VFC_Obj11A_PhiBottom "ACCS Viewing angle of the bottom of the object(dimensionless)";
CM_ SG_ 198 VFC_Obj11A_PhiTopStdDev "Standard deviation  of the ACCS top angle of object(dimensionless)";
CM_ SG_ 198 VFC_Obj11A_HeadOrientation "The orientation of the head of cyclists or pedestrians that are detected.";
CM_ SG_ 198 VFC_Obj11A_Type "Classification of the object";
CM_ SG_ 198 VFC_Obj11A_PhiBottomStdDev "Standard deviation of the ACCS bottom angle of object(dimensionless)";
CM_ SG_ 198 VFC_Obj11A_NormVx "Normalised object velocity in longitudinal direction.";
CM_ SG_ 198 VFC_Obj11A_NormAx "Normalised object acceleration in longitudinal direction.";
CM_ SG_ 198 VFC_Obj11A_NormAxStdDev "Standard deviation of Normalized Object Acceleration in longitudinal direction";
CM_ SG_ 198 VFC_Obj11A_ProbMovingLat "Probability of object moving laterally";
CM_ SG_ 198 VFC_Obj11A_ID "Unique Object ID";
CM_ SG_ 198 VFC_Obj11A_NormVxStdDev "Standard deviation of Normalized Object Velocity in longitudinal direction";
CM_ SG_ 198 VFC_Obj11A_ProbMovingLong "Probability of object moving longitudinally";
CM_ SG_ 199 VFC_Obj11B_TTIPC_StdDev "Inverse TTI standard deviation";
CM_ SG_ 199 VFC_Obj11B_TTIPC "Inverse TTI";
CM_ SG_ 199 VFC_Obj11B_AngLongitude "angular velocity with regarding to longitudinal direction";
CM_ SG_ 199 VFC_Obj11B_CRC "CRC - Autosar E2E Profile 5";
CM_ SG_ 199 VFC_Obj11B_AliveCtr "Alive counter - Autosar E2E Profile 5";
CM_ SG_ 199 VFC_Obj11B_BlockCtr "Protocol-Signal: Block Counter";
CM_ SG_ 199 VFC_Obj11B_ScaleChange "A scale change of of the detected object";
CM_ SG_ 199 VFC_Obj11B_ScaleChngStdDev "Standard deviation of object scale change";
CM_ SG_ 199 VFC_Obj11B_LineEdgeRightEgo "ObjLineEdgeAngle refers to the line which limits the host vehicle lane on the right side";
CM_ SG_ 199 VFC_Obj11B_LineEdgeLeftEgo "ObjLineEdgeAngle refers to the line which limits the host vehicle lane on the left side";
CM_ SG_ 199 VFC_Obj11B_CompletelyInImg "indicator if the object is completely measrued in the image";
CM_ SG_ 199 VFC_Obj11B_DirIndicator "The detected direction indicator lights";
CM_ SG_ 199 VFC_Obj11B_LineEdgeAngle "Angle between the video object's edge and the lane marking";
CM_ SG_ 199 VFC_Obj11B_BrakeLight "The number of detected lights. More confident if more lights are detected.";
CM_ SG_ 199 VFC_Obj11B_MeasSource "Bitmask for the measurement programs from which this object originates";
CM_ SG_ 199 VFC_Obj11B_Reliab "Bitmask that indicates the algorithmic paths that have detected this object";
CM_ SG_ 200 VFC_Obj12A_CRC "CRC - Autosar E2E Profile 5";
CM_ SG_ 200 VFC_Obj12A_AliveCtr "Alive counter - Autosar E2E Profile 5";
CM_ SG_ 200 VFC_Obj12A_BlockCtr "Protocol-Signal: Block-Counter";
CM_ SG_ 200 VFC_Obj12A_ProtOrderIndex "Protocol-Signal: Index to ensure same order in Tx and Rx of the objects";
CM_ SG_ 200 VFC_Obj12A_Ax "Object Acceleration in longitudinal direction";
CM_ SG_ 200 VFC_Obj12A_Vx "Object Velocity in longitudinal direction";
CM_ SG_ 200 VFC_Obj12A_Dx "Object Position in longitudinal direction";
CM_ SG_ 200 VFC_Obj12A_Dy "Object Position in lateral direction";
CM_ SG_ 200 VFC_Obj12A_Vy "Object Velocity in lateral direction";
CM_ SG_ 200 VFC_Obj12A_Ay "Object Acceleration in lateral direction";
CM_ SG_ 200 VFC_Obj12A_DyStdDev "Standard deviation of Object position in lateral direction";
CM_ SG_ 200 VFC_Obj12A_DxStdDev "Standard deviation of Object position in longitudinal direction";
CM_ SG_ 200 VFC_Obj12A_VxStdDev "Standard deviation of Object velocity in longitudinal direction";
CM_ SG_ 200 VFC_Obj12A_ExistProb "Object existence probability";
CM_ SG_ 200 VFC_Obj12A_VyStdDev "Standard deviation of Object velocity in lateral direction";
CM_ SG_ 200 VFC_Obj12A_TypeProb "Probability of the classified object type";
CM_ SG_ 200 VFC_Obj12A_AxStdDev "Standard deviation of Object acceleration in longitudinal direction";
CM_ SG_ 200 VFC_Obj12A_AyStdDev "Standard deviation of Object acceleration in lateral direction";
CM_ SG_ 200 VFC_Obj12A_PhiLeft "ACCS Viewing Angle of left object edge(dimensionless)";
CM_ SG_ 200 VFC_Obj12A_ClassifiedView "The classified view of object to be used in connection with Heading angle";
CM_ SG_ 200 VFC_Obj12A_Length "Length of the object";
CM_ SG_ 200 VFC_Obj12A_WidthStdDev "Standard deviation of object width";
CM_ SG_ 200 VFC_Obj12A_Height "Height of the object";
CM_ SG_ 200 VFC_Obj12A_HeightStdDev "Standard deviation of object height";
CM_ SG_ 200 VFC_Obj12A_PhiLeftStdDev "Standard deviation of the ACCS angle of left object(dimensionless)";
CM_ SG_ 200 VFC_Obj12A_HeadingStdDev "Standard deviation of object Heading angle";
CM_ SG_ 200 VFC_Obj12A_Measured "Indicator if the object detected is measured or predicted.";
CM_ SG_ 200 VFC_Obj12A_Heading "Heading angle of the object";
CM_ SG_ 200 VFC_Obj12A_LengthStdDev "Standard deviation of object length";
CM_ SG_ 200 VFC_Obj12A_PhiMid "Viewing angle of the ACCS middle of the object(dimensionless)";
CM_ SG_ 200 VFC_Obj12A_Width "Width of the object";
CM_ SG_ 200 VFC_Obj12A_PhiMidStdDev "Standard deviation of the ACCS middle angle of object(dimensionless)";
CM_ SG_ 200 VFC_Obj12A_PhiRight "ACCS Viewing Angle of right object edge(dimensionless)";
CM_ SG_ 200 VFC_Obj12A_VisibleView "The visible view of the detectd object";
CM_ SG_ 200 VFC_Obj12A_PhiRightStdDev "Standard deviation of the ACCS angle of right object(dimensionless)";
CM_ SG_ 200 VFC_Obj12A_PhiLeftVel "Velocity of the ACCS viewing angle of the left edge";
CM_ SG_ 200 VFC_Obj12A_PhiRightVel "Velocity of the ACCS viewing angle of the right edge";
CM_ SG_ 200 VFC_Obj12A_PhiRightVelStdDev "Standard deviation of ACCS viewing angle velocity of right object edge from ego vehicle related to camera";
CM_ SG_ 200 VFC_Obj12A_PhiLeftVelStdDev "Standard deviation of ACCS viewing angle velocity of left object edge from ego vehicle related to camera";
CM_ SG_ 200 VFC_Obj12A_PhiTop "ACCS Viewing angle of the top of the object(dimensionless)";
CM_ SG_ 200 VFC_Obj12A_PhiBottom "ACCS Viewing angle of the bottom of the object(dimensionless)";
CM_ SG_ 200 VFC_Obj12A_PhiTopStdDev "Standard deviation  of the ACCS top angle of object(dimensionless)";
CM_ SG_ 200 VFC_Obj12A_HeadOrientation "The orientation of the head of cyclists or pedestrians that are detected.";
CM_ SG_ 200 VFC_Obj12A_Type "Classification of the object";
CM_ SG_ 200 VFC_Obj12A_PhiBottomStdDev "Standard deviation of the ACCS bottom angle of object(dimensionless)";
CM_ SG_ 200 VFC_Obj12A_NormVx "Normalised object velocity in longitudinal direction.";
CM_ SG_ 200 VFC_Obj12A_NormAx "Normalised object acceleration in longitudinal direction.";
CM_ SG_ 200 VFC_Obj12A_NormAxStdDev "Standard deviation of Normalized Object Acceleration in longitudinal direction";
CM_ SG_ 200 VFC_Obj12A_ProbMovingLat "Probability of object moving laterally";
CM_ SG_ 200 VFC_Obj12A_ID "Unique Object ID";
CM_ SG_ 200 VFC_Obj12A_NormVxStdDev "Standard deviation of Normalized Object Velocity in longitudinal direction";
CM_ SG_ 200 VFC_Obj12A_ProbMovingLong "Probability of object moving longitudinally";
CM_ SG_ 201 VFC_Obj12B_TTIPC_StdDev "Inverse TTI standard deviation";
CM_ SG_ 201 VFC_Obj12B_TTIPC "Inverse TTI";
CM_ SG_ 201 VFC_Obj12B_AngLongitude "angular velocity with regarding to longitudinal direction";
CM_ SG_ 201 VFC_Obj12B_CRC "CRC - Autosar E2E Profile 5";
CM_ SG_ 201 VFC_Obj12B_AliveCtr "Alive counter - Autosar E2E Profile 5";
CM_ SG_ 201 VFC_Obj12B_BlockCtr "Protocol-Signal: Block Counter";
CM_ SG_ 201 VFC_Obj12B_ScaleChange "A scale change of of the detected object";
CM_ SG_ 201 VFC_Obj12B_ScaleChngStdDev "Standard deviation of object scale change";
CM_ SG_ 201 VFC_Obj12B_LineEdgeRightEgo "ObjLineEdgeAngle refers to the line which limits the host vehicle lane on the right side";
CM_ SG_ 201 VFC_Obj12B_LineEdgeLeftEgo "ObjLineEdgeAngle refers to the line which limits the host vehicle lane on the left side";
CM_ SG_ 201 VFC_Obj12B_CompletelyInImg "indicator if the object is completely measrued in the image";
CM_ SG_ 201 VFC_Obj12B_DirIndicator "The detected direction indicator lights";
CM_ SG_ 201 VFC_Obj12B_LineEdgeAngle "Angle between the video object's edge and the lane marking";
CM_ SG_ 201 VFC_Obj12B_BrakeLight "The number of detected lights. More confident if more lights are detected.";
CM_ SG_ 201 VFC_Obj12B_MeasSource "Bitmask for the measurement programs from which this object originates";
CM_ SG_ 201 VFC_Obj12B_Reliab "Bitmask that indicates the algorithmic paths that have detected this object";
CM_ SG_ 202 VFC_Obj13A_CRC "CRC - Autosar E2E Profile 5";
CM_ SG_ 202 VFC_Obj13A_AliveCtr "Alive counter - Autosar E2E Profile 5";
CM_ SG_ 202 VFC_Obj13A_BlockCtr "Protocol-Signal: Block-Counter";
CM_ SG_ 202 VFC_Obj13A_ProtOrderIndex "Protocol-Signal: Index to ensure same order in Tx and Rx of the objects";
CM_ SG_ 202 VFC_Obj13A_Ax "Object Acceleration in longitudinal direction";
CM_ SG_ 202 VFC_Obj13A_Vx "Object Velocity in longitudinal direction";
CM_ SG_ 202 VFC_Obj13A_Dx "Object Position in longitudinal direction";
CM_ SG_ 202 VFC_Obj13A_Dy "Object Position in lateral direction";
CM_ SG_ 202 VFC_Obj13A_Vy "Object Velocity in lateral direction";
CM_ SG_ 202 VFC_Obj13A_Ay "Object Acceleration in lateral direction";
CM_ SG_ 202 VFC_Obj13A_DyStdDev "Standard deviation of Object position in lateral direction";
CM_ SG_ 202 VFC_Obj13A_DxStdDev "Standard deviation of Object position in longitudinal direction";
CM_ SG_ 202 VFC_Obj13A_VxStdDev "Standard deviation of Object velocity in longitudinal direction";
CM_ SG_ 202 VFC_Obj13A_ExistProb "Object existence probability";
CM_ SG_ 202 VFC_Obj13A_VyStdDev "Standard deviation of Object velocity in lateral direction";
CM_ SG_ 202 VFC_Obj13A_TypeProb "Probability of the classified object type";
CM_ SG_ 202 VFC_Obj13A_AxStdDev "Standard deviation of Object acceleration in longitudinal direction";
CM_ SG_ 202 VFC_Obj13A_AyStdDev "Standard deviation of Object acceleration in lateral direction";
CM_ SG_ 202 VFC_Obj13A_PhiLeft "ACCS Viewing Angle of left object edge(dimensionless)";
CM_ SG_ 202 VFC_Obj13A_ClassifiedView "The classified view of object to be used in connection with Heading angle";
CM_ SG_ 202 VFC_Obj13A_Length "Length of the object";
CM_ SG_ 202 VFC_Obj13A_WidthStdDev "Standard deviation of object width";
CM_ SG_ 202 VFC_Obj13A_Height "Height of the object";
CM_ SG_ 202 VFC_Obj13A_HeightStdDev "Standard deviation of object height";
CM_ SG_ 202 VFC_Obj13A_PhiLeftStdDev "Standard deviation of the ACCS angle of left object(dimensionless)";
CM_ SG_ 202 VFC_Obj13A_HeadingStdDev "Standard deviation of object Heading angle";
CM_ SG_ 202 VFC_Obj13A_Measured "Indicator if the object detected is measured or predicted.";
CM_ SG_ 202 VFC_Obj13A_Heading "Heading angle of the object";
CM_ SG_ 202 VFC_Obj13A_LengthStdDev "Standard deviation of object length";
CM_ SG_ 202 VFC_Obj13A_PhiMid "Viewing angle of the ACCS middle of the object(dimensionless)";
CM_ SG_ 202 VFC_Obj13A_Width "Width of the object";
CM_ SG_ 202 VFC_Obj13A_PhiMidStdDev "Standard deviation of the ACCS middle angle of object(dimensionless)";
CM_ SG_ 202 VFC_Obj13A_PhiRight "ACCS Viewing Angle of right object edge(dimensionless)";
CM_ SG_ 202 VFC_Obj13A_VisibleView "The visible view of the detectd object";
CM_ SG_ 202 VFC_Obj13A_PhiRightStdDev "Standard deviation of the ACCS angle of right object(dimensionless)";
CM_ SG_ 202 VFC_Obj13A_PhiLeftVel "Velocity of the ACCS viewing angle of the left edge";
CM_ SG_ 202 VFC_Obj13A_PhiRightVel "Velocity of the ACCS viewing angle of the right edge";
CM_ SG_ 202 VFC_Obj13A_PhiRightVelStdDev "Standard deviation of ACCS viewing angle velocity of right object edge from ego vehicle related to camera";
CM_ SG_ 202 VFC_Obj13A_PhiLeftVelStdDev "Standard deviation of ACCS viewing angle velocity of left object edge from ego vehicle related to camera";
CM_ SG_ 202 VFC_Obj13A_PhiTop "ACCS Viewing angle of the top of the object(dimensionless)";
CM_ SG_ 202 VFC_Obj13A_PhiBottom "ACCS Viewing angle of the bottom of the object(dimensionless)";
CM_ SG_ 202 VFC_Obj13A_PhiTopStdDev "Standard deviation  of the ACCS top angle of object(dimensionless)";
CM_ SG_ 202 VFC_Obj13A_HeadOrientation "The orientation of the head of cyclists or pedestrians that are detected.";
CM_ SG_ 202 VFC_Obj13A_Type "Classification of the object";
CM_ SG_ 202 VFC_Obj13A_PhiBottomStdDev "Standard deviation of the ACCS bottom angle of object(dimensionless)";
CM_ SG_ 202 VFC_Obj13A_NormVx "Normalised object velocity in longitudinal direction.";
CM_ SG_ 202 VFC_Obj13A_NormAx "Normalised object acceleration in longitudinal direction.";
CM_ SG_ 202 VFC_Obj13A_NormAxStdDev "Standard deviation of Normalized Object Acceleration in longitudinal direction";
CM_ SG_ 202 VFC_Obj13A_ProbMovingLat "Probability of object moving laterally";
CM_ SG_ 202 VFC_Obj13A_ID "Unique Object ID";
CM_ SG_ 202 VFC_Obj13A_NormVxStdDev "Standard deviation of Normalized Object Velocity in longitudinal direction";
CM_ SG_ 202 VFC_Obj13A_ProbMovingLong "Probability of object moving longitudinally";
CM_ SG_ 203 VFC_Obj13B_TTIPC_StdDev "Inverse TTI standard deviation";
CM_ SG_ 203 VFC_Obj13B_TTIPC "Inverse TTI";
CM_ SG_ 203 VFC_Obj13B_AngLongitude "angular velocity with regarding to longitudinal direction";
CM_ SG_ 203 VFC_Obj13B_CRC "CRC - Autosar E2E Profile 5";
CM_ SG_ 203 VFC_Obj13B_AliveCtr "Alive counter - Autosar E2E Profile 5";
CM_ SG_ 203 VFC_Obj13B_BlockCtr "Protocol-Signal: Block Counter";
CM_ SG_ 203 VFC_Obj13B_ScaleChange "A scale change of of the detected object";
CM_ SG_ 203 VFC_Obj13B_ScaleChngStdDev "Standard deviation of object scale change";
CM_ SG_ 203 VFC_Obj13B_LineEdgeRightEgo "ObjLineEdgeAngle refers to the line which limits the host vehicle lane on the right side";
CM_ SG_ 203 VFC_Obj13B_LineEdgeLeftEgo "ObjLineEdgeAngle refers to the line which limits the host vehicle lane on the left side";
CM_ SG_ 203 VFC_Obj13B_CompletelyInImg "indicator if the object is completely measrued in the image";
CM_ SG_ 203 VFC_Obj13B_DirIndicator "The detected direction indicator lights";
CM_ SG_ 203 VFC_Obj13B_LineEdgeAngle "Angle between the video object's edge and the lane marking";
CM_ SG_ 203 VFC_Obj13B_BrakeLight "The number of detected lights. More confident if more lights are detected.";
CM_ SG_ 203 VFC_Obj13B_MeasSource "Bitmask for the measurement programs from which this object originates";
CM_ SG_ 203 VFC_Obj13B_Reliab "Bitmask that indicates the algorithmic paths that have detected this object";
CM_ SG_ 204 VFC_Obj14A_CRC "CRC - Autosar E2E Profile 5";
CM_ SG_ 204 VFC_Obj14A_AliveCtr "Alive counter - Autosar E2E Profile 5";
CM_ SG_ 204 VFC_Obj14A_BlockCtr "Protocol-Signal: Block-Counter";
CM_ SG_ 204 VFC_Obj14A_ProtOrderIndex "Protocol-Signal: Index to ensure same order in Tx and Rx of the objects";
CM_ SG_ 204 VFC_Obj14A_Ax "Object Acceleration in longitudinal direction";
CM_ SG_ 204 VFC_Obj14A_Vx "Object Velocity in longitudinal direction";
CM_ SG_ 204 VFC_Obj14A_Dx "Object Position in longitudinal direction";
CM_ SG_ 204 VFC_Obj14A_Dy "Object Position in lateral direction";
CM_ SG_ 204 VFC_Obj14A_Vy "Object Velocity in lateral direction";
CM_ SG_ 204 VFC_Obj14A_Ay "Object Acceleration in lateral direction";
CM_ SG_ 204 VFC_Obj14A_DyStdDev "Standard deviation of Object position in lateral direction";
CM_ SG_ 204 VFC_Obj14A_DxStdDev "Standard deviation of Object position in longitudinal direction";
CM_ SG_ 204 VFC_Obj14A_VxStdDev "Standard deviation of Object velocity in longitudinal direction";
CM_ SG_ 204 VFC_Obj14A_ExistProb "Object existence probability";
CM_ SG_ 204 VFC_Obj14A_VyStdDev "Standard deviation of Object velocity in lateral direction";
CM_ SG_ 204 VFC_Obj14A_TypeProb "Probability of the classified object type";
CM_ SG_ 204 VFC_Obj14A_AxStdDev "Standard deviation of Object acceleration in longitudinal direction";
CM_ SG_ 204 VFC_Obj14A_AyStdDev "Standard deviation of Object acceleration in lateral direction";
CM_ SG_ 204 VFC_Obj14A_PhiLeft "ACCS Viewing Angle of left object edge(dimensionless)";
CM_ SG_ 204 VFC_Obj14A_ClassifiedView "The classified view of object to be used in connection with Heading angle";
CM_ SG_ 204 VFC_Obj14A_Length "Length of the object";
CM_ SG_ 204 VFC_Obj14A_WidthStdDev "Standard deviation of object width";
CM_ SG_ 204 VFC_Obj14A_Height "Height of the object";
CM_ SG_ 204 VFC_Obj14A_HeightStdDev "Standard deviation of object height";
CM_ SG_ 204 VFC_Obj14A_PhiLeftStdDev "Standard deviation of the ACCS angle of left object(dimensionless)";
CM_ SG_ 204 VFC_Obj14A_HeadingStdDev "Standard deviation of object Heading angle";
CM_ SG_ 204 VFC_Obj14A_Measured "Indicator if the object detected is measured or predicted.";
CM_ SG_ 204 VFC_Obj14A_Heading "Heading angle of the object";
CM_ SG_ 204 VFC_Obj14A_LengthStdDev "Standard deviation of object length";
CM_ SG_ 204 VFC_Obj14A_PhiMid "Viewing angle of the ACCS middle of the object(dimensionless)";
CM_ SG_ 204 VFC_Obj14A_Width "Width of the object";
CM_ SG_ 204 VFC_Obj14A_PhiMidStdDev "Standard deviation of the ACCS middle angle of object(dimensionless)";
CM_ SG_ 204 VFC_Obj14A_PhiRight "ACCS Viewing Angle of right object edge(dimensionless)";
CM_ SG_ 204 VFC_Obj14A_VisibleView "The visible view of the detectd object";
CM_ SG_ 204 VFC_Obj14A_PhiRightStdDev "Standard deviation of the ACCS angle of right object(dimensionless)";
CM_ SG_ 204 VFC_Obj14A_PhiLeftVel "Velocity of the ACCS viewing angle of the left edge";
CM_ SG_ 204 VFC_Obj14A_PhiRightVel "Velocity of the ACCS viewing angle of the right edge";
CM_ SG_ 204 VFC_Obj14A_PhiRightVelStdDev "Standard deviation of ACCS viewing angle velocity of right object edge from ego vehicle related to camera";
CM_ SG_ 204 VFC_Obj14A_PhiLeftVelStdDev "Standard deviation of ACCS viewing angle velocity of left object edge from ego vehicle related to camera";
CM_ SG_ 204 VFC_Obj14A_PhiTop "ACCS Viewing angle of the top of the object(dimensionless)";
CM_ SG_ 204 VFC_Obj14A_PhiBottom "ACCS Viewing angle of the bottom of the object(dimensionless)";
CM_ SG_ 204 VFC_Obj14A_PhiTopStdDev "Standard deviation  of the ACCS top angle of object(dimensionless)";
CM_ SG_ 204 VFC_Obj14A_HeadOrientation "The orientation of the head of cyclists or pedestrians that are detected.";
CM_ SG_ 204 VFC_Obj14A_Type "Classification of the object";
CM_ SG_ 204 VFC_Obj14A_PhiBottomStdDev "Standard deviation of the ACCS bottom angle of object(dimensionless)";
CM_ SG_ 204 VFC_Obj14A_NormVx "Normalised object velocity in longitudinal direction.";
CM_ SG_ 204 VFC_Obj14A_NormAx "Normalised object acceleration in longitudinal direction.";
CM_ SG_ 204 VFC_Obj14A_NormAxStdDev "Standard deviation of Normalized Object Acceleration in longitudinal direction";
CM_ SG_ 204 VFC_Obj14A_ProbMovingLat "Probability of object moving laterally";
CM_ SG_ 204 VFC_Obj14A_ID "Unique Object ID";
CM_ SG_ 204 VFC_Obj14A_NormVxStdDev "Standard deviation of Normalized Object Velocity in longitudinal direction";
CM_ SG_ 204 VFC_Obj14A_ProbMovingLong "Probability of object moving longitudinally";
CM_ SG_ 205 VFC_Obj14B_TTIPC_StdDev "Inverse TTI standard deviation";
CM_ SG_ 205 VFC_Obj14B_TTIPC "Inverse TTI";
CM_ SG_ 205 VFC_Obj14B_AngLongitude "angular velocity with regarding to longitudinal direction";
CM_ SG_ 205 VFC_Obj14B_CRC "CRC - Autosar E2E Profile 5";
CM_ SG_ 205 VFC_Obj14B_AliveCtr "Alive counter - Autosar E2E Profile 5";
CM_ SG_ 205 VFC_Obj14B_BlockCtr "Protocol-Signal: Block Counter";
CM_ SG_ 205 VFC_Obj14B_ScaleChange "A scale change of of the detected object";
CM_ SG_ 205 VFC_Obj14B_ScaleChngStdDev "Standard deviation of object scale change";
CM_ SG_ 205 VFC_Obj14B_LineEdgeRightEgo "ObjLineEdgeAngle refers to the line which limits the host vehicle lane on the right side";
CM_ SG_ 205 VFC_Obj14B_LineEdgeLeftEgo "ObjLineEdgeAngle refers to the line which limits the host vehicle lane on the left side";
CM_ SG_ 205 VFC_Obj14B_CompletelyInImg "indicator if the object is completely measrued in the image";
CM_ SG_ 205 VFC_Obj14B_DirIndicator "The detected direction indicator lights";
CM_ SG_ 205 VFC_Obj14B_LineEdgeAngle "Angle between the video object's edge and the lane marking";
CM_ SG_ 205 VFC_Obj14B_BrakeLight "The number of detected lights. More confident if more lights are detected.";
CM_ SG_ 205 VFC_Obj14B_MeasSource "Bitmask for the measurement programs from which this object originates";
CM_ SG_ 205 VFC_Obj14B_Reliab "Bitmask that indicates the algorithmic paths that have detected this object";
CM_ SG_ 206 VFC_Obj15A_CRC "CRC - Autosar E2E Profile 5";
CM_ SG_ 206 VFC_Obj15A_AliveCtr "Alive counter - Autosar E2E Profile 5";
CM_ SG_ 206 VFC_Obj15A_BlockCtr "Protocol-Signal: Block-Counter";
CM_ SG_ 206 VFC_Obj15A_ProtOrderIndex "Protocol-Signal: Index to ensure same order in Tx and Rx of the objects";
CM_ SG_ 206 VFC_Obj15A_Ax "Object Acceleration in longitudinal direction";
CM_ SG_ 206 VFC_Obj15A_Vx "Object Velocity in longitudinal direction";
CM_ SG_ 206 VFC_Obj15A_Dx "Object Position in longitudinal direction";
CM_ SG_ 206 VFC_Obj15A_Dy "Object Position in lateral direction";
CM_ SG_ 206 VFC_Obj15A_Vy "Object Velocity in lateral direction";
CM_ SG_ 206 VFC_Obj15A_Ay "Object Acceleration in lateral direction";
CM_ SG_ 206 VFC_Obj15A_DyStdDev "Standard deviation of Object position in lateral direction";
CM_ SG_ 206 VFC_Obj15A_DxStdDev "Standard deviation of Object position in longitudinal direction";
CM_ SG_ 206 VFC_Obj15A_VxStdDev "Standard deviation of Object velocity in longitudinal direction";
CM_ SG_ 206 VFC_Obj15A_ExistProb "Object existence probability";
CM_ SG_ 206 VFC_Obj15A_VyStdDev "Standard deviation of Object velocity in lateral direction";
CM_ SG_ 206 VFC_Obj15A_TypeProb "Probability of the classified object type";
CM_ SG_ 206 VFC_Obj15A_AxStdDev "Standard deviation of Object acceleration in longitudinal direction";
CM_ SG_ 206 VFC_Obj15A_AyStdDev "Standard deviation of Object acceleration in lateral direction";
CM_ SG_ 206 VFC_Obj15A_PhiLeft "ACCS Viewing Angle of left object edge(dimensionless)";
CM_ SG_ 206 VFC_Obj15A_ClassifiedView "The classified view of object to be used in connection with Heading angle";
CM_ SG_ 206 VFC_Obj15A_Length "Length of the object";
CM_ SG_ 206 VFC_Obj15A_WidthStdDev "Standard deviation of object width";
CM_ SG_ 206 VFC_Obj15A_Height "Height of the object";
CM_ SG_ 206 VFC_Obj15A_HeightStdDev "Standard deviation of object height";
CM_ SG_ 206 VFC_Obj15A_PhiLeftStdDev "Standard deviation of the ACCS angle of left object(dimensionless)";
CM_ SG_ 206 VFC_Obj15A_HeadingStdDev "Standard deviation of object Heading angle";
CM_ SG_ 206 VFC_Obj15A_Measured "Indicator if the object detected is measured or predicted.";
CM_ SG_ 206 VFC_Obj15A_Heading "Heading angle of the object";
CM_ SG_ 206 VFC_Obj15A_LengthStdDev "Standard deviation of object length";
CM_ SG_ 206 VFC_Obj15A_PhiMid "Viewing angle of the ACCS middle of the object(dimensionless)";
CM_ SG_ 206 VFC_Obj15A_Width "Width of the object";
CM_ SG_ 206 VFC_Obj15A_PhiMidStdDev "Standard deviation of the ACCS middle angle of object(dimensionless)";
CM_ SG_ 206 VFC_Obj15A_PhiRight "ACCS Viewing Angle of right object edge(dimensionless)";
CM_ SG_ 206 VFC_Obj15A_VisibleView "The visible view of the detectd object";
CM_ SG_ 206 VFC_Obj15A_PhiRightStdDev "Standard deviation of the ACCS angle of right object(dimensionless)";
CM_ SG_ 206 VFC_Obj15A_PhiLeftVel "Velocity of the ACCS viewing angle of the left edge";
CM_ SG_ 206 VFC_Obj15A_PhiRightVel "Velocity of the ACCS viewing angle of the right edge";
CM_ SG_ 206 VFC_Obj15A_PhiRightVelStdDev "Standard deviation of ACCS viewing angle velocity of right object edge from ego vehicle related to camera";
CM_ SG_ 206 VFC_Obj15A_PhiLeftVelStdDev "Standard deviation of ACCS viewing angle velocity of left object edge from ego vehicle related to camera";
CM_ SG_ 206 VFC_Obj15A_PhiTop "ACCS Viewing angle of the top of the object(dimensionless)";
CM_ SG_ 206 VFC_Obj15A_PhiBottom "ACCS Viewing angle of the bottom of the object(dimensionless)";
CM_ SG_ 206 VFC_Obj15A_PhiTopStdDev "Standard deviation  of the ACCS top angle of object(dimensionless)";
CM_ SG_ 206 VFC_Obj15A_HeadOrientation "The orientation of the head of cyclists or pedestrians that are detected.";
CM_ SG_ 206 VFC_Obj15A_Type "Classification of the object";
CM_ SG_ 206 VFC_Obj15A_PhiBottomStdDev "Standard deviation of the ACCS bottom angle of object(dimensionless)";
CM_ SG_ 206 VFC_Obj15A_NormVx "Normalised object velocity in longitudinal direction.";
CM_ SG_ 206 VFC_Obj15A_NormAx "Normalised object acceleration in longitudinal direction.";
CM_ SG_ 206 VFC_Obj15A_NormAxStdDev "Standard deviation of Normalized Object Acceleration in longitudinal direction";
CM_ SG_ 206 VFC_Obj15A_ProbMovingLat "Probability of object moving laterally";
CM_ SG_ 206 VFC_Obj15A_ID "Unique Object ID";
CM_ SG_ 206 VFC_Obj15A_NormVxStdDev "Standard deviation of Normalized Object Velocity in longitudinal direction";
CM_ SG_ 206 VFC_Obj15A_ProbMovingLong "Probability of object moving longitudinally";
CM_ SG_ 207 VFC_Obj15B_TTIPC_StdDev "Inverse TTI standard deviation";
CM_ SG_ 207 VFC_Obj15B_TTIPC "Inverse TTI";
CM_ SG_ 207 VFC_Obj15B_AngLongitude "angular velocity with regarding to longitudinal direction";
CM_ SG_ 207 VFC_Obj15B_CRC "CRC - Autosar E2E Profile 5";
CM_ SG_ 207 VFC_Obj15B_AliveCtr "Alive counter - Autosar E2E Profile 5";
CM_ SG_ 207 VFC_Obj15B_BlockCtr "Protocol-Signal: Block Counter";
CM_ SG_ 207 VFC_Obj15B_ScaleChange "A scale change of of the detected object";
CM_ SG_ 207 VFC_Obj15B_ScaleChngStdDev "Standard deviation of object scale change";
CM_ SG_ 207 VFC_Obj15B_LineEdgeRightEgo "ObjLineEdgeAngle refers to the line which limits the host vehicle lane on the right side";
CM_ SG_ 207 VFC_Obj15B_LineEdgeLeftEgo "ObjLineEdgeAngle refers to the line which limits the host vehicle lane on the left side";
CM_ SG_ 207 VFC_Obj15B_CompletelyInImg "indicator if the object is completely measrued in the image";
CM_ SG_ 207 VFC_Obj15B_DirIndicator "The detected direction indicator lights";
CM_ SG_ 207 VFC_Obj15B_LineEdgeAngle "Angle between the video object's edge and the lane marking";
CM_ SG_ 207 VFC_Obj15B_BrakeLight "The number of detected lights. More confident if more lights are detected.";
CM_ SG_ 207 VFC_Obj15B_MeasSource "Bitmask for the measurement programs from which this object originates";
CM_ SG_ 207 VFC_Obj15B_Reliab "Bitmask that indicates the algorithmic paths that have detected this object";
CM_ SG_ 208 VFC_Obj16A_CRC "CRC - Autosar E2E Profile 5";
CM_ SG_ 208 VFC_Obj16A_AliveCtr "Alive counter - Autosar E2E Profile 5";
CM_ SG_ 208 VFC_Obj16A_BlockCtr "Protocol-Signal: Block-Counter";
CM_ SG_ 208 VFC_Obj16A_ProtOrderIndex "Protocol-Signal: Index to ensure same order in Tx and Rx of the objects";
CM_ SG_ 208 VFC_Obj16A_Ax "Object Acceleration in longitudinal direction";
CM_ SG_ 208 VFC_Obj16A_Vx "Object Velocity in longitudinal direction";
CM_ SG_ 208 VFC_Obj16A_Dx "Object Position in longitudinal direction";
CM_ SG_ 208 VFC_Obj16A_Dy "Object Position in lateral direction";
CM_ SG_ 208 VFC_Obj16A_Vy "Object Velocity in lateral direction";
CM_ SG_ 208 VFC_Obj16A_Ay "Object Acceleration in lateral direction";
CM_ SG_ 208 VFC_Obj16A_DyStdDev "Standard deviation of Object position in lateral direction";
CM_ SG_ 208 VFC_Obj16A_DxStdDev "Standard deviation of Object position in longitudinal direction";
CM_ SG_ 208 VFC_Obj16A_VxStdDev "Standard deviation of Object velocity in longitudinal direction";
CM_ SG_ 208 VFC_Obj16A_ExistProb "Object existence probability";
CM_ SG_ 208 VFC_Obj16A_VyStdDev "Standard deviation of Object velocity in lateral direction";
CM_ SG_ 208 VFC_Obj16A_TypeProb "Probability of the classified object type";
CM_ SG_ 208 VFC_Obj16A_AxStdDev "Standard deviation of Object acceleration in longitudinal direction";
CM_ SG_ 208 VFC_Obj16A_AyStdDev "Standard deviation of Object acceleration in lateral direction";
CM_ SG_ 208 VFC_Obj16A_PhiLeft "ACCS Viewing Angle of left object edge(dimensionless)";
CM_ SG_ 208 VFC_Obj16A_ClassifiedView "The classified view of object to be used in connection with Heading angle";
CM_ SG_ 208 VFC_Obj16A_Length "Length of the object";
CM_ SG_ 208 VFC_Obj16A_WidthStdDev "Standard deviation of object width";
CM_ SG_ 208 VFC_Obj16A_Height "Height of the object";
CM_ SG_ 208 VFC_Obj16A_HeightStdDev "Standard deviation of object height";
CM_ SG_ 208 VFC_Obj16A_PhiLeftStdDev "Standard deviation of the ACCS angle of left object(dimensionless)";
CM_ SG_ 208 VFC_Obj16A_HeadingStdDev "Standard deviation of object Heading angle";
CM_ SG_ 208 VFC_Obj16A_Measured "Indicator if the object detected is measured or predicted.";
CM_ SG_ 208 VFC_Obj16A_Heading "Heading angle of the object";
CM_ SG_ 208 VFC_Obj16A_LengthStdDev "Standard deviation of object length";
CM_ SG_ 208 VFC_Obj16A_PhiMid "Viewing angle of the ACCS middle of the object(dimensionless)";
CM_ SG_ 208 VFC_Obj16A_Width "Width of the object";
CM_ SG_ 208 VFC_Obj16A_PhiMidStdDev "Standard deviation of the ACCS middle angle of object(dimensionless)";
CM_ SG_ 208 VFC_Obj16A_PhiRight "ACCS Viewing Angle of right object edge(dimensionless)";
CM_ SG_ 208 VFC_Obj16A_VisibleView "The visible view of the detectd object";
CM_ SG_ 208 VFC_Obj16A_PhiRightStdDev "Standard deviation of the ACCS angle of right object(dimensionless)";
CM_ SG_ 208 VFC_Obj16A_PhiLeftVel "Velocity of the ACCS viewing angle of the left edge";
CM_ SG_ 208 VFC_Obj16A_PhiRightVel "Velocity of the ACCS viewing angle of the right edge";
CM_ SG_ 208 VFC_Obj16A_PhiRightVelStdDev "Standard deviation of ACCS viewing angle velocity of right object edge from ego vehicle related to camera";
CM_ SG_ 208 VFC_Obj16A_PhiLeftVelStdDev "Standard deviation of ACCS viewing angle velocity of left object edge from ego vehicle related to camera";
CM_ SG_ 208 VFC_Obj16A_PhiTop "ACCS Viewing angle of the top of the object(dimensionless)";
CM_ SG_ 208 VFC_Obj16A_PhiBottom "ACCS Viewing angle of the bottom of the object(dimensionless)";
CM_ SG_ 208 VFC_Obj16A_PhiTopStdDev "Standard deviation  of the ACCS top angle of object(dimensionless)";
CM_ SG_ 208 VFC_Obj16A_HeadOrientation "The orientation of the head of cyclists or pedestrians that are detected.";
CM_ SG_ 208 VFC_Obj16A_Type "Classification of the object";
CM_ SG_ 208 VFC_Obj16A_PhiBottomStdDev "Standard deviation of the ACCS bottom angle of object(dimensionless)";
CM_ SG_ 208 VFC_Obj16A_NormVx "Normalised object velocity in longitudinal direction.";
CM_ SG_ 208 VFC_Obj16A_NormAx "Normalised object acceleration in longitudinal direction.";
CM_ SG_ 208 VFC_Obj16A_NormAxStdDev "Standard deviation of Normalized Object Acceleration in longitudinal direction";
CM_ SG_ 208 VFC_Obj16A_ProbMovingLat "Probability of object moving laterally";
CM_ SG_ 208 VFC_Obj16A_ID "Unique Object ID";
CM_ SG_ 208 VFC_Obj16A_NormVxStdDev "Standard deviation of Normalized Object Velocity in longitudinal direction";
CM_ SG_ 208 VFC_Obj16A_ProbMovingLong "Probability of object moving longitudinally";
CM_ SG_ 209 VFC_Obj16B_TTIPC_StdDev "Inverse TTI standard deviation";
CM_ SG_ 209 VFC_Obj16B_TTIPC "Inverse TTI";
CM_ SG_ 209 VFC_Obj16B_AngLongitude "angular velocity with regarding to longitudinal direction";
CM_ SG_ 209 VFC_Obj16B_CRC "CRC - Autosar E2E Profile 5";
CM_ SG_ 209 VFC_Obj16B_AliveCtr "Alive counter - Autosar E2E Profile 5";
CM_ SG_ 209 VFC_Obj16B_BlockCtr "Protocol-Signal: Block Counter";
CM_ SG_ 209 VFC_Obj16B_ScaleChange "A scale change of of the detected object";
CM_ SG_ 209 VFC_Obj16B_ScaleChngStdDev "Standard deviation of object scale change";
CM_ SG_ 209 VFC_Obj16B_LineEdgeRightEgo "ObjLineEdgeAngle refers to the line which limits the host vehicle lane on the right side";
CM_ SG_ 209 VFC_Obj16B_LineEdgeLeftEgo "ObjLineEdgeAngle refers to the line which limits the host vehicle lane on the left side";
CM_ SG_ 209 VFC_Obj16B_CompletelyInImg "indicator if the object is completely measrued in the image";
CM_ SG_ 209 VFC_Obj16B_DirIndicator "The detected direction indicator lights";
CM_ SG_ 209 VFC_Obj16B_LineEdgeAngle "Angle between the video object's edge and the lane marking";
CM_ SG_ 209 VFC_Obj16B_BrakeLight "The number of detected lights. More confident if more lights are detected.";
CM_ SG_ 209 VFC_Obj16B_MeasSource "Bitmask for the measurement programs from which this object originates";
CM_ SG_ 209 VFC_Obj16B_Reliab "Bitmask that indicates the algorithmic paths that have detected this object";
CM_ SG_ 210 VFC_Obj17A_CRC "CRC - Autosar E2E Profile 5";
CM_ SG_ 210 VFC_Obj17A_AliveCtr "Alive counter - Autosar E2E Profile 5";
CM_ SG_ 210 VFC_Obj17A_BlockCtr "Protocol-Signal: Block-Counter";
CM_ SG_ 210 VFC_Obj17A_ProtOrderIndex "Protocol-Signal: Index to ensure same order in Tx and Rx of the objects";
CM_ SG_ 210 VFC_Obj17A_Ax "Object Acceleration in longitudinal direction";
CM_ SG_ 210 VFC_Obj17A_Vx "Object Velocity in longitudinal direction";
CM_ SG_ 210 VFC_Obj17A_Dx "Object Position in longitudinal direction";
CM_ SG_ 210 VFC_Obj17A_Dy "Object Position in lateral direction";
CM_ SG_ 210 VFC_Obj17A_Vy "Object Velocity in lateral direction";
CM_ SG_ 210 VFC_Obj17A_Ay "Object Acceleration in lateral direction";
CM_ SG_ 210 VFC_Obj17A_DyStdDev "Standard deviation of Object position in lateral direction";
CM_ SG_ 210 VFC_Obj17A_DxStdDev "Standard deviation of Object position in longitudinal direction";
CM_ SG_ 210 VFC_Obj17A_VxStdDev "Standard deviation of Object velocity in longitudinal direction";
CM_ SG_ 210 VFC_Obj17A_ExistProb "Object existence probability";
CM_ SG_ 210 VFC_Obj17A_VyStdDev "Standard deviation of Object velocity in lateral direction";
CM_ SG_ 210 VFC_Obj17A_TypeProb "Probability of the classified object type";
CM_ SG_ 210 VFC_Obj17A_AxStdDev "Standard deviation of Object acceleration in longitudinal direction";
CM_ SG_ 210 VFC_Obj17A_AyStdDev "Standard deviation of Object acceleration in lateral direction";
CM_ SG_ 210 VFC_Obj17A_PhiLeft "ACCS Viewing Angle of left object edge(dimensionless)";
CM_ SG_ 210 VFC_Obj17A_ClassifiedView "The classified view of object to be used in connection with Heading angle";
CM_ SG_ 210 VFC_Obj17A_Length "Length of the object";
CM_ SG_ 210 VFC_Obj17A_WidthStdDev "Standard deviation of object width";
CM_ SG_ 210 VFC_Obj17A_Height "Height of the object";
CM_ SG_ 210 VFC_Obj17A_HeightStdDev "Standard deviation of object height";
CM_ SG_ 210 VFC_Obj17A_PhiLeftStdDev "Standard deviation of the ACCS angle of left object(dimensionless)";
CM_ SG_ 210 VFC_Obj17A_HeadingStdDev "Standard deviation of object Heading angle";
CM_ SG_ 210 VFC_Obj17A_Measured "Indicator if the object detected is measured or predicted.";
CM_ SG_ 210 VFC_Obj17A_Heading "Heading angle of the object";
CM_ SG_ 210 VFC_Obj17A_LengthStdDev "Standard deviation of object length";
CM_ SG_ 210 VFC_Obj17A_PhiMid "Viewing angle of the ACCS middle of the object(dimensionless)";
CM_ SG_ 210 VFC_Obj17A_Width "Width of the object";
CM_ SG_ 210 VFC_Obj17A_PhiMidStdDev "Standard deviation of the ACCS middle angle of object(dimensionless)";
CM_ SG_ 210 VFC_Obj17A_PhiRight "ACCS Viewing Angle of right object edge(dimensionless)";
CM_ SG_ 210 VFC_Obj17A_VisibleView "The visible view of the detectd object";
CM_ SG_ 210 VFC_Obj17A_PhiRightStdDev "Standard deviation of the ACCS angle of right object(dimensionless)";
CM_ SG_ 210 VFC_Obj17A_PhiLeftVel "Velocity of the ACCS viewing angle of the left edge";
CM_ SG_ 210 VFC_Obj17A_PhiRightVel "Velocity of the ACCS viewing angle of the right edge";
CM_ SG_ 210 VFC_Obj17A_PhiRightVelStdDev "Standard deviation of ACCS viewing angle velocity of right object edge from ego vehicle related to camera";
CM_ SG_ 210 VFC_Obj17A_PhiLeftVelStdDev "Standard deviation of ACCS viewing angle velocity of left object edge from ego vehicle related to camera";
CM_ SG_ 210 VFC_Obj17A_PhiTop "ACCS Viewing angle of the top of the object(dimensionless)";
CM_ SG_ 210 VFC_Obj17A_PhiBottom "ACCS Viewing angle of the bottom of the object(dimensionless)";
CM_ SG_ 210 VFC_Obj17A_PhiTopStdDev "Standard deviation  of the ACCS top angle of object(dimensionless)";
CM_ SG_ 210 VFC_Obj17A_HeadOrientation "The orientation of the head of cyclists or pedestrians that are detected.";
CM_ SG_ 210 VFC_Obj17A_Type "Classification of the object";
CM_ SG_ 210 VFC_Obj17A_PhiBottomStdDev "Standard deviation of the ACCS bottom angle of object(dimensionless)";
CM_ SG_ 210 VFC_Obj17A_NormVx "Normalised object velocity in longitudinal direction.";
CM_ SG_ 210 VFC_Obj17A_NormAx "Normalised object acceleration in longitudinal direction.";
CM_ SG_ 210 VFC_Obj17A_NormAxStdDev "Standard deviation of Normalized Object Acceleration in longitudinal direction";
CM_ SG_ 210 VFC_Obj17A_ProbMovingLat "Probability of object moving laterally";
CM_ SG_ 210 VFC_Obj17A_ID "Unique Object ID";
CM_ SG_ 210 VFC_Obj17A_NormVxStdDev "Standard deviation of Normalized Object Velocity in longitudinal direction";
CM_ SG_ 210 VFC_Obj17A_ProbMovingLong "Probability of object moving longitudinally";
CM_ SG_ 211 VFC_Obj17B_TTIPC_StdDev "Inverse TTI standard deviation";
CM_ SG_ 211 VFC_Obj17B_TTIPC "Inverse TTI";
CM_ SG_ 211 VFC_Obj17B_AngLongitude "angular velocity with regarding to longitudinal direction";
CM_ SG_ 211 VFC_Obj17B_CRC "CRC - Autosar E2E Profile 5";
CM_ SG_ 211 VFC_Obj17B_AliveCtr "Alive counter - Autosar E2E Profile 5";
CM_ SG_ 211 VFC_Obj17B_BlockCtr "Protocol-Signal: Block Counter";
CM_ SG_ 211 VFC_Obj17B_ScaleChange "A scale change of of the detected object";
CM_ SG_ 211 VFC_Obj17B_ScaleChngStdDev "Standard deviation of object scale change";
CM_ SG_ 211 VFC_Obj17B_LineEdgeRightEgo "ObjLineEdgeAngle refers to the line which limits the host vehicle lane on the right side";
CM_ SG_ 211 VFC_Obj17B_LineEdgeLeftEgo "ObjLineEdgeAngle refers to the line which limits the host vehicle lane on the left side";
CM_ SG_ 211 VFC_Obj17B_CompletelyInImg "indicator if the object is completely measrued in the image";
CM_ SG_ 211 VFC_Obj17B_DirIndicator "The detected direction indicator lights";
CM_ SG_ 211 VFC_Obj17B_LineEdgeAngle "Angle between the video object's edge and the lane marking";
CM_ SG_ 211 VFC_Obj17B_BrakeLight "The number of detected lights. More confident if more lights are detected.";
CM_ SG_ 211 VFC_Obj17B_MeasSource "Bitmask for the measurement programs from which this object originates";
CM_ SG_ 211 VFC_Obj17B_Reliab "Bitmask that indicates the algorithmic paths that have detected this object";
CM_ SG_ 212 VFC_Obj18A_CRC "CRC - Autosar E2E Profile 5";
CM_ SG_ 212 VFC_Obj18A_AliveCtr "Alive counter - Autosar E2E Profile 5";
CM_ SG_ 212 VFC_Obj18A_BlockCtr "Protocol-Signal: Block-Counter";
CM_ SG_ 212 VFC_Obj18A_ProtOrderIndex "Protocol-Signal: Index to ensure same order in Tx and Rx of the objects";
CM_ SG_ 212 VFC_Obj18A_Ax "Object Acceleration in longitudinal direction";
CM_ SG_ 212 VFC_Obj18A_Vx "Object Velocity in longitudinal direction";
CM_ SG_ 212 VFC_Obj18A_Dx "Object Position in longitudinal direction";
CM_ SG_ 212 VFC_Obj18A_Dy "Object Position in lateral direction";
CM_ SG_ 212 VFC_Obj18A_Vy "Object Velocity in lateral direction";
CM_ SG_ 212 VFC_Obj18A_Ay "Object Acceleration in lateral direction";
CM_ SG_ 212 VFC_Obj18A_DyStdDev "Standard deviation of Object position in lateral direction";
CM_ SG_ 212 VFC_Obj18A_DxStdDev "Standard deviation of Object position in longitudinal direction";
CM_ SG_ 212 VFC_Obj18A_VxStdDev "Standard deviation of Object velocity in longitudinal direction";
CM_ SG_ 212 VFC_Obj18A_ExistProb "Object existence probability";
CM_ SG_ 212 VFC_Obj18A_VyStdDev "Standard deviation of Object velocity in lateral direction";
CM_ SG_ 212 VFC_Obj18A_TypeProb "Probability of the classified object type";
CM_ SG_ 212 VFC_Obj18A_AxStdDev "Standard deviation of Object acceleration in longitudinal direction";
CM_ SG_ 212 VFC_Obj18A_AyStdDev "Standard deviation of Object acceleration in lateral direction";
CM_ SG_ 212 VFC_Obj18A_PhiLeft "ACCS Viewing Angle of left object edge(dimensionless)";
CM_ SG_ 212 VFC_Obj18A_ClassifiedView "The classified view of object to be used in connection with Heading angle";
CM_ SG_ 212 VFC_Obj18A_Length "Length of the object";
CM_ SG_ 212 VFC_Obj18A_WidthStdDev "Standard deviation of object width";
CM_ SG_ 212 VFC_Obj18A_Height "Height of the object";
CM_ SG_ 212 VFC_Obj18A_HeightStdDev "Standard deviation of object height";
CM_ SG_ 212 VFC_Obj18A_PhiLeftStdDev "Standard deviation of the ACCS angle of left object(dimensionless)";
CM_ SG_ 212 VFC_Obj18A_HeadingStdDev "Standard deviation of object Heading angle";
CM_ SG_ 212 VFC_Obj18A_Measured "Indicator if the object detected is measured or predicted.";
CM_ SG_ 212 VFC_Obj18A_Heading "Heading angle of the object";
CM_ SG_ 212 VFC_Obj18A_LengthStdDev "Standard deviation of object length";
CM_ SG_ 212 VFC_Obj18A_PhiMid "Viewing angle of the ACCS middle of the object(dimensionless)";
CM_ SG_ 212 VFC_Obj18A_Width "Width of the object";
CM_ SG_ 212 VFC_Obj18A_PhiMidStdDev "Standard deviation of the ACCS middle angle of object(dimensionless)";
CM_ SG_ 212 VFC_Obj18A_PhiRight "ACCS Viewing Angle of right object edge(dimensionless)";
CM_ SG_ 212 VFC_Obj18A_VisibleView "The visible view of the detectd object";
CM_ SG_ 212 VFC_Obj18A_PhiRightStdDev "Standard deviation of the ACCS angle of right object(dimensionless)";
CM_ SG_ 212 VFC_Obj18A_PhiLeftVel "Velocity of the ACCS viewing angle of the left edge";
CM_ SG_ 212 VFC_Obj18A_PhiRightVel "Velocity of the ACCS viewing angle of the right edge";
CM_ SG_ 212 VFC_Obj18A_PhiRightVelStdDev "Standard deviation of ACCS viewing angle velocity of right object edge from ego vehicle related to camera";
CM_ SG_ 212 VFC_Obj18A_PhiLeftVelStdDev "Standard deviation of ACCS viewing angle velocity of left object edge from ego vehicle related to camera";
CM_ SG_ 212 VFC_Obj18A_PhiTop "ACCS Viewing angle of the top of the object(dimensionless)";
CM_ SG_ 212 VFC_Obj18A_PhiBottom "ACCS Viewing angle of the bottom of the object(dimensionless)";
CM_ SG_ 212 VFC_Obj18A_PhiTopStdDev "Standard deviation  of the ACCS top angle of object(dimensionless)";
CM_ SG_ 212 VFC_Obj18A_HeadOrientation "The orientation of the head of cyclists or pedestrians that are detected.";
CM_ SG_ 212 VFC_Obj18A_Type "Classification of the object";
CM_ SG_ 212 VFC_Obj18A_PhiBottomStdDev "Standard deviation of the ACCS bottom angle of object(dimensionless)";
CM_ SG_ 212 VFC_Obj18A_NormVx "Normalised object velocity in longitudinal direction.";
CM_ SG_ 212 VFC_Obj18A_NormAx "Normalised object acceleration in longitudinal direction.";
CM_ SG_ 212 VFC_Obj18A_NormAxStdDev "Standard deviation of Normalized Object Acceleration in longitudinal direction";
CM_ SG_ 212 VFC_Obj18A_ProbMovingLat "Probability of object moving laterally";
CM_ SG_ 212 VFC_Obj18A_ID "Unique Object ID";
CM_ SG_ 212 VFC_Obj18A_NormVxStdDev "Standard deviation of Normalized Object Velocity in longitudinal direction";
CM_ SG_ 212 VFC_Obj18A_ProbMovingLong "Probability of object moving longitudinally";
CM_ SG_ 213 VFC_Obj18B_TTIPC_StdDev "Inverse TTI standard deviation";
CM_ SG_ 213 VFC_Obj18B_TTIPC "Inverse TTI";
CM_ SG_ 213 VFC_Obj18B_AngLongitude "angular velocity with regarding to longitudinal direction";
CM_ SG_ 213 VFC_Obj18B_CRC "CRC - Autosar E2E Profile 5";
CM_ SG_ 213 VFC_Obj18B_AliveCtr "Alive counter - Autosar E2E Profile 5";
CM_ SG_ 213 VFC_Obj18B_BlockCtr "Protocol-Signal: Block Counter";
CM_ SG_ 213 VFC_Obj18B_ScaleChange "A scale change of of the detected object";
CM_ SG_ 213 VFC_Obj18B_ScaleChngStdDev "Standard deviation of object scale change";
CM_ SG_ 213 VFC_Obj18B_LineEdgeRightEgo "ObjLineEdgeAngle refers to the line which limits the host vehicle lane on the right side";
CM_ SG_ 213 VFC_Obj18B_LineEdgeLeftEgo "ObjLineEdgeAngle refers to the line which limits the host vehicle lane on the left side";
CM_ SG_ 213 VFC_Obj18B_CompletelyInImg "indicator if the object is completely measrued in the image";
CM_ SG_ 213 VFC_Obj18B_DirIndicator "The detected direction indicator lights";
CM_ SG_ 213 VFC_Obj18B_LineEdgeAngle "Angle between the video object's edge and the lane marking";
CM_ SG_ 213 VFC_Obj18B_BrakeLight "The number of detected lights. More confident if more lights are detected.";
CM_ SG_ 213 VFC_Obj18B_MeasSource "Bitmask for the measurement programs from which this object originates";
CM_ SG_ 213 VFC_Obj18B_Reliab "Bitmask that indicates the algorithmic paths that have detected this object";
BA_DEF_ BO_  "GenMsgSendType" ENUM  "cyclic","NoMsgSendType","IfActive","Event","CA","CE";
BA_DEF_ BO_  "GenMsgCycleTime" INT 0 0;
BA_DEF_ SG_  "GenSigSendType" ENUM  "cyclic","OnChange","OnWrite","IfActive","OnChangeWithRepetition","OnWriteWithRepetition","IfActiveWithRepetition","CA","CE","Event";
BA_DEF_ SG_  "GenSigStartValue" INT 0 0;
BA_DEF_ BO_  "CANFD_BRS" ENUM  "0","1";
BA_DEF_ BO_  "VFrameFormat" ENUM  "StandardCAN","ExtendedCAN","reserved","reserved","reserved","reserved","reserved","reserved","reserved","reserved","reserved","reserved","reserved","reserved","StandardCAN_FD","ExtendedCAN_FD";
BA_DEF_ BO_  "GenMsgILSupport" ENUM  "No","Yes";
BA_DEF_ SG_  "sigDespEng" STRING ;
BA_DEF_ SG_  "sigSecLevel" STRING ;
BA_DEF_ SG_  "sigConfig" STRING ;
BA_DEF_ SG_  "sigExplanation" STRING ;
BA_DEF_DEF_  "GenMsgSendType" "cyclic";
BA_DEF_DEF_  "GenMsgCycleTime" 0;
BA_DEF_DEF_  "GenSigSendType" "cyclic";
BA_DEF_DEF_  "GenSigStartValue" 0;
BA_DEF_DEF_  "CANFD_BRS" "1";
BA_DEF_DEF_  "VFrameFormat" "";
BA_DEF_DEF_  "GenMsgILSupport" "Yes";
BA_DEF_DEF_  "sigDespEng" "";
BA_DEF_DEF_  "sigSecLevel" "";
BA_DEF_DEF_  "sigConfig" "";
BA_DEF_DEF_  "sigExplanation" "";
BA_ "GenMsgSendType" BO_ 194 3;
BA_ "VFrameFormat" BO_ 194 14;
BA_ "GenMsgSendType" BO_ 195 3;
BA_ "VFrameFormat" BO_ 195 14;
BA_ "GenMsgSendType" BO_ 196 3;
BA_ "VFrameFormat" BO_ 196 14;
BA_ "GenMsgSendType" BO_ 197 3;
BA_ "VFrameFormat" BO_ 197 14;
BA_ "GenMsgSendType" BO_ 198 3;
BA_ "VFrameFormat" BO_ 198 14;
BA_ "GenMsgSendType" BO_ 199 3;
BA_ "VFrameFormat" BO_ 199 14;
BA_ "GenMsgSendType" BO_ 200 3;
BA_ "VFrameFormat" BO_ 200 14;
BA_ "GenMsgSendType" BO_ 201 3;
BA_ "VFrameFormat" BO_ 201 14;
BA_ "GenMsgSendType" BO_ 202 3;
BA_ "VFrameFormat" BO_ 202 14;
BA_ "GenMsgSendType" BO_ 203 3;
BA_ "VFrameFormat" BO_ 203 14;
BA_ "GenMsgSendType" BO_ 204 3;
BA_ "VFrameFormat" BO_ 204 14;
BA_ "GenMsgSendType" BO_ 205 3;
BA_ "VFrameFormat" BO_ 205 14;
BA_ "GenMsgSendType" BO_ 206 3;
BA_ "VFrameFormat" BO_ 206 14;
BA_ "GenMsgSendType" BO_ 207 3;
BA_ "VFrameFormat" BO_ 207 14;
BA_ "GenMsgSendType" BO_ 208 3;
BA_ "VFrameFormat" BO_ 208 14;
BA_ "GenMsgSendType" BO_ 209 3;
BA_ "VFrameFormat" BO_ 209 14;
BA_ "GenMsgSendType" BO_ 210 3;
BA_ "VFrameFormat" BO_ 210 14;
BA_ "GenMsgSendType" BO_ 211 3;
BA_ "VFrameFormat" BO_ 211 14;
BA_ "GenMsgSendType" BO_ 212 3;
BA_ "VFrameFormat" BO_ 212 14;
BA_ "GenMsgSendType" BO_ 213 3;
BA_ "VFrameFormat" BO_ 213 14;
BA_ "GenSigSendType" SG_ 194 VFC_Obj09A_CRC 9;
BA_ "GenSigSendType" SG_ 194 VFC_Obj09A_AliveCtr 9;
BA_ "GenSigSendType" SG_ 194 VFC_Obj09A_BlockCtr 9;
BA_ "GenSigSendType" SG_ 194 VFC_Obj09A_ProtOrderIndex 9;
BA_ "GenSigStartValue" SG_ 194 VFC_Obj09A_Ax 160;
BA_ "GenSigSendType" SG_ 194 VFC_Obj09A_Ax 9;
BA_ "GenSigStartValue" SG_ 194 VFC_Obj09A_Vx 1540;
BA_ "GenSigSendType" SG_ 194 VFC_Obj09A_Vx 9;
BA_ "GenSigSendType" SG_ 194 VFC_Obj09A_Dx 9;
BA_ "GenSigStartValue" SG_ 194 VFC_Obj09A_Dy 8000;
BA_ "GenSigSendType" SG_ 194 VFC_Obj09A_Dy 9;
BA_ "GenSigStartValue" SG_ 194 VFC_Obj09A_Vy 500;
BA_ "GenSigSendType" SG_ 194 VFC_Obj09A_Vy 9;
BA_ "GenSigStartValue" SG_ 194 VFC_Obj09A_Ay 120;
BA_ "GenSigSendType" SG_ 194 VFC_Obj09A_Ay 9;
BA_ "GenSigSendType" SG_ 194 VFC_Obj09A_DyStdDev 9;
BA_ "GenSigSendType" SG_ 194 VFC_Obj09A_DxStdDev 9;
BA_ "GenSigSendType" SG_ 194 VFC_Obj09A_VxStdDev 9;
BA_ "GenSigSendType" SG_ 194 VFC_Obj09A_ExistProb 9;
BA_ "GenSigSendType" SG_ 194 VFC_Obj09A_VyStdDev 9;
BA_ "GenSigSendType" SG_ 194 VFC_Obj09A_TypeProb 9;
BA_ "GenSigSendType" SG_ 194 VFC_Obj09A_AxStdDev 9;
BA_ "GenSigSendType" SG_ 194 VFC_Obj09A_AyStdDev 9;
BA_ "GenSigStartValue" SG_ 194 VFC_Obj09A_PhiLeft 4000;
BA_ "GenSigSendType" SG_ 194 VFC_Obj09A_PhiLeft 9;
BA_ "GenSigSendType" SG_ 194 VFC_Obj09A_ClassifiedView 9;
BA_ "GenSigSendType" SG_ 194 VFC_Obj09A_Length 9;
BA_ "GenSigSendType" SG_ 194 VFC_Obj09A_WidthStdDev 9;
BA_ "GenSigSendType" SG_ 194 VFC_Obj09A_Height 9;
BA_ "GenSigSendType" SG_ 194 VFC_Obj09A_HeightStdDev 9;
BA_ "GenSigSendType" SG_ 194 VFC_Obj09A_PhiLeftStdDev 9;
BA_ "GenSigSendType" SG_ 194 VFC_Obj09A_HeadingStdDev 9;
BA_ "GenSigSendType" SG_ 194 VFC_Obj09A_Measured 9;
BA_ "GenSigStartValue" SG_ 194 VFC_Obj09A_Heading 157;
BA_ "GenSigSendType" SG_ 194 VFC_Obj09A_Heading 9;
BA_ "GenSigSendType" SG_ 194 VFC_Obj09A_LengthStdDev 9;
BA_ "GenSigStartValue" SG_ 194 VFC_Obj09A_PhiMid 4000;
BA_ "GenSigSendType" SG_ 194 VFC_Obj09A_PhiMid 9;
BA_ "GenSigSendType" SG_ 194 VFC_Obj09A_Width 9;
BA_ "GenSigSendType" SG_ 194 VFC_Obj09A_PhiMidStdDev 9;
BA_ "GenSigStartValue" SG_ 194 VFC_Obj09A_PhiRight 4000;
BA_ "GenSigSendType" SG_ 194 VFC_Obj09A_PhiRight 9;
BA_ "GenSigSendType" SG_ 194 VFC_Obj09A_VisibleView 9;
BA_ "GenSigSendType" SG_ 194 VFC_Obj09A_PhiRightStdDev 9;
BA_ "GenSigStartValue" SG_ 194 VFC_Obj09A_PhiLeftVel 4000;
BA_ "GenSigSendType" SG_ 194 VFC_Obj09A_PhiLeftVel 9;
BA_ "GenSigStartValue" SG_ 194 VFC_Obj09A_PhiRightVel 4000;
BA_ "GenSigSendType" SG_ 194 VFC_Obj09A_PhiRightVel 9;
BA_ "GenSigSendType" SG_ 194 VFC_Obj09A_PhiRightVelStdDev 9;
BA_ "GenSigSendType" SG_ 194 VFC_Obj09A_PhiLeftVelStdDev 9;
BA_ "GenSigStartValue" SG_ 194 VFC_Obj09A_PhiTop 1600;
BA_ "GenSigSendType" SG_ 194 VFC_Obj09A_PhiTop 9;
BA_ "GenSigStartValue" SG_ 194 VFC_Obj09A_PhiBottom 1600;
BA_ "GenSigSendType" SG_ 194 VFC_Obj09A_PhiBottom 9;
BA_ "GenSigSendType" SG_ 194 VFC_Obj09A_PhiTopStdDev 9;
BA_ "GenSigSendType" SG_ 194 VFC_Obj09A_HeadOrientation 9;
BA_ "GenSigSendType" SG_ 194 VFC_Obj09A_Type 9;
BA_ "GenSigSendType" SG_ 194 VFC_Obj09A_PhiBottomStdDev 9;
BA_ "GenSigStartValue" SG_ 194 VFC_Obj09A_NormVx 40000;
BA_ "GenSigSendType" SG_ 194 VFC_Obj09A_NormVx 9;
BA_ "GenSigStartValue" SG_ 194 VFC_Obj09A_NormAx 5000;
BA_ "GenSigSendType" SG_ 194 VFC_Obj09A_NormAx 9;
BA_ "GenSigSendType" SG_ 194 VFC_Obj09A_NormAxStdDev 9;
BA_ "GenSigSendType" SG_ 194 VFC_Obj09A_ProbMovingLat 9;
BA_ "GenSigSendType" SG_ 194 VFC_Obj09A_ID 9;
BA_ "GenSigSendType" SG_ 194 VFC_Obj09A_NormVxStdDev 9;
BA_ "GenSigSendType" SG_ 194 VFC_Obj09A_ProbMovingLong 9;
BA_ "GenSigSendType" SG_ 195 VFC_Obj09B_TTIPC_StdDev 9;
BA_ "GenSigSendType" SG_ 195 VFC_Obj09B_TTIPC 9;
BA_ "GenSigStartValue" SG_ 195 VFC_Obj09B_AngLongitude 500;
BA_ "GenSigSendType" SG_ 195 VFC_Obj09B_AngLongitude 9;
BA_ "GenSigSendType" SG_ 195 VFC_Obj09B_CRC 9;
BA_ "GenSigSendType" SG_ 195 VFC_Obj09B_AliveCtr 9;
BA_ "GenSigSendType" SG_ 195 VFC_Obj09B_BlockCtr 9;
BA_ "GenSigSendType" SG_ 195 VFC_Obj09B_ScaleChange 9;
BA_ "GenSigSendType" SG_ 195 VFC_Obj09B_ScaleChngStdDev 9;
BA_ "GenSigSendType" SG_ 195 VFC_Obj09B_LineEdgeRightEgo 9;
BA_ "GenSigSendType" SG_ 195 VFC_Obj09B_LineEdgeLeftEgo 9;
BA_ "GenSigSendType" SG_ 195 VFC_Obj09B_CompletelyInImg 9;
BA_ "GenSigSendType" SG_ 195 VFC_Obj09B_DirIndicator 9;
BA_ "GenSigStartValue" SG_ 195 VFC_Obj09B_LineEdgeAngle 4000;
BA_ "GenSigSendType" SG_ 195 VFC_Obj09B_LineEdgeAngle 9;
BA_ "GenSigSendType" SG_ 195 VFC_Obj09B_BrakeLight 9;
BA_ "GenSigSendType" SG_ 195 VFC_Obj09B_MeasSource 9;
BA_ "GenSigSendType" SG_ 195 VFC_Obj09B_Reliab 9;
BA_ "GenSigSendType" SG_ 196 VFC_Obj10A_CRC 9;
BA_ "GenSigSendType" SG_ 196 VFC_Obj10A_AliveCtr 9;
BA_ "GenSigSendType" SG_ 196 VFC_Obj10A_BlockCtr 9;
BA_ "GenSigSendType" SG_ 196 VFC_Obj10A_ProtOrderIndex 9;
BA_ "GenSigStartValue" SG_ 196 VFC_Obj10A_Ax 160;
BA_ "GenSigSendType" SG_ 196 VFC_Obj10A_Ax 9;
BA_ "GenSigStartValue" SG_ 196 VFC_Obj10A_Vx 1540;
BA_ "GenSigSendType" SG_ 196 VFC_Obj10A_Vx 9;
BA_ "GenSigSendType" SG_ 196 VFC_Obj10A_Dx 9;
BA_ "GenSigStartValue" SG_ 196 VFC_Obj10A_Dy 8000;
BA_ "GenSigSendType" SG_ 196 VFC_Obj10A_Dy 9;
BA_ "GenSigStartValue" SG_ 196 VFC_Obj10A_Vy 500;
BA_ "GenSigSendType" SG_ 196 VFC_Obj10A_Vy 9;
BA_ "GenSigStartValue" SG_ 196 VFC_Obj10A_Ay 120;
BA_ "GenSigSendType" SG_ 196 VFC_Obj10A_Ay 9;
BA_ "GenSigSendType" SG_ 196 VFC_Obj10A_DyStdDev 9;
BA_ "GenSigSendType" SG_ 196 VFC_Obj10A_DxStdDev 9;
BA_ "GenSigSendType" SG_ 196 VFC_Obj10A_VxStdDev 9;
BA_ "GenSigSendType" SG_ 196 VFC_Obj10A_ExistProb 9;
BA_ "GenSigSendType" SG_ 196 VFC_Obj10A_VyStdDev 9;
BA_ "GenSigSendType" SG_ 196 VFC_Obj10A_TypeProb 9;
BA_ "GenSigSendType" SG_ 196 VFC_Obj10A_AxStdDev 9;
BA_ "GenSigSendType" SG_ 196 VFC_Obj10A_AyStdDev 9;
BA_ "GenSigStartValue" SG_ 196 VFC_Obj10A_PhiLeft 4000;
BA_ "GenSigSendType" SG_ 196 VFC_Obj10A_PhiLeft 9;
BA_ "GenSigSendType" SG_ 196 VFC_Obj10A_ClassifiedView 9;
BA_ "GenSigSendType" SG_ 196 VFC_Obj10A_Length 9;
BA_ "GenSigSendType" SG_ 196 VFC_Obj10A_WidthStdDev 9;
BA_ "GenSigSendType" SG_ 196 VFC_Obj10A_Height 9;
BA_ "GenSigSendType" SG_ 196 VFC_Obj10A_HeightStdDev 9;
BA_ "GenSigSendType" SG_ 196 VFC_Obj10A_PhiLeftStdDev 9;
BA_ "GenSigSendType" SG_ 196 VFC_Obj10A_HeadingStdDev 9;
BA_ "GenSigSendType" SG_ 196 VFC_Obj10A_Measured 9;
BA_ "GenSigStartValue" SG_ 196 VFC_Obj10A_Heading 157;
BA_ "GenSigSendType" SG_ 196 VFC_Obj10A_Heading 9;
BA_ "GenSigSendType" SG_ 196 VFC_Obj10A_LengthStdDev 9;
BA_ "GenSigStartValue" SG_ 196 VFC_Obj10A_PhiMid 4000;
BA_ "GenSigSendType" SG_ 196 VFC_Obj10A_PhiMid 9;
BA_ "GenSigSendType" SG_ 196 VFC_Obj10A_Width 9;
BA_ "GenSigSendType" SG_ 196 VFC_Obj10A_PhiMidStdDev 9;
BA_ "GenSigStartValue" SG_ 196 VFC_Obj10A_PhiRight 4000;
BA_ "GenSigSendType" SG_ 196 VFC_Obj10A_PhiRight 9;
BA_ "GenSigSendType" SG_ 196 VFC_Obj10A_VisibleView 9;
BA_ "GenSigSendType" SG_ 196 VFC_Obj10A_PhiRightStdDev 9;
BA_ "GenSigStartValue" SG_ 196 VFC_Obj10A_PhiLeftVel 4000;
BA_ "GenSigSendType" SG_ 196 VFC_Obj10A_PhiLeftVel 9;
BA_ "GenSigStartValue" SG_ 196 VFC_Obj10A_PhiRightVel 4000;
BA_ "GenSigSendType" SG_ 196 VFC_Obj10A_PhiRightVel 9;
BA_ "GenSigSendType" SG_ 196 VFC_Obj10A_PhiRightVelStdDev 9;
BA_ "GenSigSendType" SG_ 196 VFC_Obj10A_PhiLeftVelStdDev 9;
BA_ "GenSigStartValue" SG_ 196 VFC_Obj10A_PhiTop 1600;
BA_ "GenSigSendType" SG_ 196 VFC_Obj10A_PhiTop 9;
BA_ "GenSigStartValue" SG_ 196 VFC_Obj10A_PhiBottom 1600;
BA_ "GenSigSendType" SG_ 196 VFC_Obj10A_PhiBottom 9;
BA_ "GenSigSendType" SG_ 196 VFC_Obj10A_PhiTopStdDev 9;
BA_ "GenSigSendType" SG_ 196 VFC_Obj10A_HeadOrientation 9;
BA_ "GenSigSendType" SG_ 196 VFC_Obj10A_Type 9;
BA_ "GenSigSendType" SG_ 196 VFC_Obj10A_PhiBottomStdDev 9;
BA_ "GenSigStartValue" SG_ 196 VFC_Obj10A_NormVx 40000;
BA_ "GenSigSendType" SG_ 196 VFC_Obj10A_NormVx 9;
BA_ "GenSigStartValue" SG_ 196 VFC_Obj10A_NormAx 5000;
BA_ "GenSigSendType" SG_ 196 VFC_Obj10A_NormAx 9;
BA_ "GenSigSendType" SG_ 196 VFC_Obj10A_NormAxStdDev 9;
BA_ "GenSigSendType" SG_ 196 VFC_Obj10A_ProbMovingLat 9;
BA_ "GenSigSendType" SG_ 196 VFC_Obj10A_ID 9;
BA_ "GenSigSendType" SG_ 196 VFC_Obj10A_NormVxStdDev 9;
BA_ "GenSigSendType" SG_ 196 VFC_Obj10A_ProbMovingLong 9;
BA_ "GenSigSendType" SG_ 197 VFC_Obj10B_TTIPC_StdDev 9;
BA_ "GenSigSendType" SG_ 197 VFC_Obj10B_TTIPC 9;
BA_ "GenSigStartValue" SG_ 197 VFC_Obj10B_AngLongitude 500;
BA_ "GenSigSendType" SG_ 197 VFC_Obj10B_AngLongitude 9;
BA_ "GenSigSendType" SG_ 197 VFC_Obj10B_CRC 9;
BA_ "GenSigSendType" SG_ 197 VFC_Obj10B_AliveCtr 9;
BA_ "GenSigSendType" SG_ 197 VFC_Obj10B_BlockCtr 9;
BA_ "GenSigSendType" SG_ 197 VFC_Obj10B_ScaleChange 9;
BA_ "GenSigSendType" SG_ 197 VFC_Obj10B_ScaleChngStdDev 9;
BA_ "GenSigSendType" SG_ 197 VFC_Obj10B_LineEdgeRightEgo 9;
BA_ "GenSigSendType" SG_ 197 VFC_Obj10B_LineEdgeLeftEgo 9;
BA_ "GenSigSendType" SG_ 197 VFC_Obj10B_CompletelyInImg 9;
BA_ "GenSigSendType" SG_ 197 VFC_Obj10B_DirIndicator 9;
BA_ "GenSigStartValue" SG_ 197 VFC_Obj10B_LineEdgeAngle 4000;
BA_ "GenSigSendType" SG_ 197 VFC_Obj10B_LineEdgeAngle 9;
BA_ "GenSigSendType" SG_ 197 VFC_Obj10B_BrakeLight 9;
BA_ "GenSigSendType" SG_ 197 VFC_Obj10B_MeasSource 9;
BA_ "GenSigSendType" SG_ 197 VFC_Obj10B_Reliab 9;
BA_ "GenSigSendType" SG_ 198 VFC_Obj11A_CRC 9;
BA_ "GenSigSendType" SG_ 198 VFC_Obj11A_AliveCtr 9;
BA_ "GenSigSendType" SG_ 198 VFC_Obj11A_BlockCtr 9;
BA_ "GenSigSendType" SG_ 198 VFC_Obj11A_ProtOrderIndex 9;
BA_ "GenSigStartValue" SG_ 198 VFC_Obj11A_Ax 160;
BA_ "GenSigSendType" SG_ 198 VFC_Obj11A_Ax 9;
BA_ "GenSigStartValue" SG_ 198 VFC_Obj11A_Vx 1540;
BA_ "GenSigSendType" SG_ 198 VFC_Obj11A_Vx 9;
BA_ "GenSigSendType" SG_ 198 VFC_Obj11A_Dx 9;
BA_ "GenSigStartValue" SG_ 198 VFC_Obj11A_Dy 8000;
BA_ "GenSigSendType" SG_ 198 VFC_Obj11A_Dy 9;
BA_ "GenSigStartValue" SG_ 198 VFC_Obj11A_Vy 500;
BA_ "GenSigSendType" SG_ 198 VFC_Obj11A_Vy 9;
BA_ "GenSigStartValue" SG_ 198 VFC_Obj11A_Ay 120;
BA_ "GenSigSendType" SG_ 198 VFC_Obj11A_Ay 9;
BA_ "GenSigSendType" SG_ 198 VFC_Obj11A_DyStdDev 9;
BA_ "GenSigSendType" SG_ 198 VFC_Obj11A_DxStdDev 9;
BA_ "GenSigSendType" SG_ 198 VFC_Obj11A_VxStdDev 9;
BA_ "GenSigSendType" SG_ 198 VFC_Obj11A_ExistProb 9;
BA_ "GenSigSendType" SG_ 198 VFC_Obj11A_VyStdDev 9;
BA_ "GenSigSendType" SG_ 198 VFC_Obj11A_TypeProb 9;
BA_ "GenSigSendType" SG_ 198 VFC_Obj11A_AxStdDev 9;
BA_ "GenSigSendType" SG_ 198 VFC_Obj11A_AyStdDev 9;
BA_ "GenSigStartValue" SG_ 198 VFC_Obj11A_PhiLeft 4000;
BA_ "GenSigSendType" SG_ 198 VFC_Obj11A_PhiLeft 9;
BA_ "GenSigSendType" SG_ 198 VFC_Obj11A_ClassifiedView 9;
BA_ "GenSigSendType" SG_ 198 VFC_Obj11A_Length 9;
BA_ "GenSigSendType" SG_ 198 VFC_Obj11A_WidthStdDev 9;
BA_ "GenSigSendType" SG_ 198 VFC_Obj11A_Height 9;
BA_ "GenSigSendType" SG_ 198 VFC_Obj11A_HeightStdDev 9;
BA_ "GenSigSendType" SG_ 198 VFC_Obj11A_PhiLeftStdDev 9;
BA_ "GenSigSendType" SG_ 198 VFC_Obj11A_HeadingStdDev 9;
BA_ "GenSigSendType" SG_ 198 VFC_Obj11A_Measured 9;
BA_ "GenSigStartValue" SG_ 198 VFC_Obj11A_Heading 157;
BA_ "GenSigSendType" SG_ 198 VFC_Obj11A_Heading 9;
BA_ "GenSigSendType" SG_ 198 VFC_Obj11A_LengthStdDev 9;
BA_ "GenSigStartValue" SG_ 198 VFC_Obj11A_PhiMid 4000;
BA_ "GenSigSendType" SG_ 198 VFC_Obj11A_PhiMid 9;
BA_ "GenSigSendType" SG_ 198 VFC_Obj11A_Width 9;
BA_ "GenSigSendType" SG_ 198 VFC_Obj11A_PhiMidStdDev 9;
BA_ "GenSigStartValue" SG_ 198 VFC_Obj11A_PhiRight 4000;
BA_ "GenSigSendType" SG_ 198 VFC_Obj11A_PhiRight 9;
BA_ "GenSigSendType" SG_ 198 VFC_Obj11A_VisibleView 9;
BA_ "GenSigSendType" SG_ 198 VFC_Obj11A_PhiRightStdDev 9;
BA_ "GenSigStartValue" SG_ 198 VFC_Obj11A_PhiLeftVel 4000;
BA_ "GenSigSendType" SG_ 198 VFC_Obj11A_PhiLeftVel 9;
BA_ "GenSigStartValue" SG_ 198 VFC_Obj11A_PhiRightVel 4000;
BA_ "GenSigSendType" SG_ 198 VFC_Obj11A_PhiRightVel 9;
BA_ "GenSigSendType" SG_ 198 VFC_Obj11A_PhiRightVelStdDev 9;
BA_ "GenSigSendType" SG_ 198 VFC_Obj11A_PhiLeftVelStdDev 9;
BA_ "GenSigStartValue" SG_ 198 VFC_Obj11A_PhiTop 1600;
BA_ "GenSigSendType" SG_ 198 VFC_Obj11A_PhiTop 9;
BA_ "GenSigStartValue" SG_ 198 VFC_Obj11A_PhiBottom 1600;
BA_ "GenSigSendType" SG_ 198 VFC_Obj11A_PhiBottom 9;
BA_ "GenSigSendType" SG_ 198 VFC_Obj11A_PhiTopStdDev 9;
BA_ "GenSigSendType" SG_ 198 VFC_Obj11A_HeadOrientation 9;
BA_ "GenSigSendType" SG_ 198 VFC_Obj11A_Type 9;
BA_ "GenSigSendType" SG_ 198 VFC_Obj11A_PhiBottomStdDev 9;
BA_ "GenSigStartValue" SG_ 198 VFC_Obj11A_NormVx 40000;
BA_ "GenSigSendType" SG_ 198 VFC_Obj11A_NormVx 9;
BA_ "GenSigStartValue" SG_ 198 VFC_Obj11A_NormAx 5000;
BA_ "GenSigSendType" SG_ 198 VFC_Obj11A_NormAx 9;
BA_ "GenSigSendType" SG_ 198 VFC_Obj11A_NormAxStdDev 9;
BA_ "GenSigSendType" SG_ 198 VFC_Obj11A_ProbMovingLat 9;
BA_ "GenSigSendType" SG_ 198 VFC_Obj11A_ID 9;
BA_ "GenSigSendType" SG_ 198 VFC_Obj11A_NormVxStdDev 9;
BA_ "GenSigSendType" SG_ 198 VFC_Obj11A_ProbMovingLong 9;
BA_ "GenSigSendType" SG_ 199 VFC_Obj11B_TTIPC_StdDev 9;
BA_ "GenSigSendType" SG_ 199 VFC_Obj11B_TTIPC 9;
BA_ "GenSigStartValue" SG_ 199 VFC_Obj11B_AngLongitude 500;
BA_ "GenSigSendType" SG_ 199 VFC_Obj11B_AngLongitude 9;
BA_ "GenSigSendType" SG_ 199 VFC_Obj11B_CRC 9;
BA_ "GenSigSendType" SG_ 199 VFC_Obj11B_AliveCtr 9;
BA_ "GenSigSendType" SG_ 199 VFC_Obj11B_BlockCtr 9;
BA_ "GenSigSendType" SG_ 199 VFC_Obj11B_ScaleChange 9;
BA_ "GenSigSendType" SG_ 199 VFC_Obj11B_ScaleChngStdDev 9;
BA_ "GenSigSendType" SG_ 199 VFC_Obj11B_LineEdgeRightEgo 9;
BA_ "GenSigSendType" SG_ 199 VFC_Obj11B_LineEdgeLeftEgo 9;
BA_ "GenSigSendType" SG_ 199 VFC_Obj11B_CompletelyInImg 9;
BA_ "GenSigSendType" SG_ 199 VFC_Obj11B_DirIndicator 9;
BA_ "GenSigStartValue" SG_ 199 VFC_Obj11B_LineEdgeAngle 4000;
BA_ "GenSigSendType" SG_ 199 VFC_Obj11B_LineEdgeAngle 9;
BA_ "GenSigSendType" SG_ 199 VFC_Obj11B_BrakeLight 9;
BA_ "GenSigSendType" SG_ 199 VFC_Obj11B_MeasSource 9;
BA_ "GenSigSendType" SG_ 199 VFC_Obj11B_Reliab 9;
BA_ "GenSigSendType" SG_ 200 VFC_Obj12A_CRC 9;
BA_ "GenSigSendType" SG_ 200 VFC_Obj12A_AliveCtr 9;
BA_ "GenSigSendType" SG_ 200 VFC_Obj12A_BlockCtr 9;
BA_ "GenSigSendType" SG_ 200 VFC_Obj12A_ProtOrderIndex 9;
BA_ "GenSigStartValue" SG_ 200 VFC_Obj12A_Ax 160;
BA_ "GenSigSendType" SG_ 200 VFC_Obj12A_Ax 9;
BA_ "GenSigStartValue" SG_ 200 VFC_Obj12A_Vx 1540;
BA_ "GenSigSendType" SG_ 200 VFC_Obj12A_Vx 9;
BA_ "GenSigSendType" SG_ 200 VFC_Obj12A_Dx 9;
BA_ "GenSigStartValue" SG_ 200 VFC_Obj12A_Dy 8000;
BA_ "GenSigSendType" SG_ 200 VFC_Obj12A_Dy 9;
BA_ "GenSigStartValue" SG_ 200 VFC_Obj12A_Vy 500;
BA_ "GenSigSendType" SG_ 200 VFC_Obj12A_Vy 9;
BA_ "GenSigStartValue" SG_ 200 VFC_Obj12A_Ay 120;
BA_ "GenSigSendType" SG_ 200 VFC_Obj12A_Ay 9;
BA_ "GenSigSendType" SG_ 200 VFC_Obj12A_DyStdDev 9;
BA_ "GenSigSendType" SG_ 200 VFC_Obj12A_DxStdDev 9;
BA_ "GenSigSendType" SG_ 200 VFC_Obj12A_VxStdDev 9;
BA_ "GenSigSendType" SG_ 200 VFC_Obj12A_ExistProb 9;
BA_ "GenSigSendType" SG_ 200 VFC_Obj12A_VyStdDev 9;
BA_ "GenSigSendType" SG_ 200 VFC_Obj12A_TypeProb 9;
BA_ "GenSigSendType" SG_ 200 VFC_Obj12A_AxStdDev 9;
BA_ "GenSigSendType" SG_ 200 VFC_Obj12A_AyStdDev 9;
BA_ "GenSigStartValue" SG_ 200 VFC_Obj12A_PhiLeft 4000;
BA_ "GenSigSendType" SG_ 200 VFC_Obj12A_PhiLeft 9;
BA_ "GenSigSendType" SG_ 200 VFC_Obj12A_ClassifiedView 9;
BA_ "GenSigSendType" SG_ 200 VFC_Obj12A_Length 9;
BA_ "GenSigSendType" SG_ 200 VFC_Obj12A_WidthStdDev 9;
BA_ "GenSigSendType" SG_ 200 VFC_Obj12A_Height 9;
BA_ "GenSigSendType" SG_ 200 VFC_Obj12A_HeightStdDev 9;
BA_ "GenSigSendType" SG_ 200 VFC_Obj12A_PhiLeftStdDev 9;
BA_ "GenSigSendType" SG_ 200 VFC_Obj12A_HeadingStdDev 9;
BA_ "GenSigSendType" SG_ 200 VFC_Obj12A_Measured 9;
BA_ "GenSigStartValue" SG_ 200 VFC_Obj12A_Heading 157;
BA_ "GenSigSendType" SG_ 200 VFC_Obj12A_Heading 9;
BA_ "GenSigSendType" SG_ 200 VFC_Obj12A_LengthStdDev 9;
BA_ "GenSigStartValue" SG_ 200 VFC_Obj12A_PhiMid 4000;
BA_ "GenSigSendType" SG_ 200 VFC_Obj12A_PhiMid 9;
BA_ "GenSigSendType" SG_ 200 VFC_Obj12A_Width 9;
BA_ "GenSigSendType" SG_ 200 VFC_Obj12A_PhiMidStdDev 9;
BA_ "GenSigStartValue" SG_ 200 VFC_Obj12A_PhiRight 4000;
BA_ "GenSigSendType" SG_ 200 VFC_Obj12A_PhiRight 9;
BA_ "GenSigSendType" SG_ 200 VFC_Obj12A_VisibleView 9;
BA_ "GenSigSendType" SG_ 200 VFC_Obj12A_PhiRightStdDev 9;
BA_ "GenSigStartValue" SG_ 200 VFC_Obj12A_PhiLeftVel 4000;
BA_ "GenSigSendType" SG_ 200 VFC_Obj12A_PhiLeftVel 9;
BA_ "GenSigStartValue" SG_ 200 VFC_Obj12A_PhiRightVel 4000;
BA_ "GenSigSendType" SG_ 200 VFC_Obj12A_PhiRightVel 9;
BA_ "GenSigSendType" SG_ 200 VFC_Obj12A_PhiRightVelStdDev 9;
BA_ "GenSigSendType" SG_ 200 VFC_Obj12A_PhiLeftVelStdDev 9;
BA_ "GenSigStartValue" SG_ 200 VFC_Obj12A_PhiTop 1600;
BA_ "GenSigSendType" SG_ 200 VFC_Obj12A_PhiTop 9;
BA_ "GenSigStartValue" SG_ 200 VFC_Obj12A_PhiBottom 1600;
BA_ "GenSigSendType" SG_ 200 VFC_Obj12A_PhiBottom 9;
BA_ "GenSigSendType" SG_ 200 VFC_Obj12A_PhiTopStdDev 9;
BA_ "GenSigSendType" SG_ 200 VFC_Obj12A_HeadOrientation 9;
BA_ "GenSigSendType" SG_ 200 VFC_Obj12A_Type 9;
BA_ "GenSigSendType" SG_ 200 VFC_Obj12A_PhiBottomStdDev 9;
BA_ "GenSigStartValue" SG_ 200 VFC_Obj12A_NormVx 40000;
BA_ "GenSigSendType" SG_ 200 VFC_Obj12A_NormVx 9;
BA_ "GenSigStartValue" SG_ 200 VFC_Obj12A_NormAx 5000;
BA_ "GenSigSendType" SG_ 200 VFC_Obj12A_NormAx 9;
BA_ "GenSigSendType" SG_ 200 VFC_Obj12A_NormAxStdDev 9;
BA_ "GenSigSendType" SG_ 200 VFC_Obj12A_ProbMovingLat 9;
BA_ "GenSigSendType" SG_ 200 VFC_Obj12A_ID 9;
BA_ "GenSigSendType" SG_ 200 VFC_Obj12A_NormVxStdDev 9;
BA_ "GenSigSendType" SG_ 200 VFC_Obj12A_ProbMovingLong 9;
BA_ "GenSigSendType" SG_ 201 VFC_Obj12B_TTIPC_StdDev 9;
BA_ "GenSigSendType" SG_ 201 VFC_Obj12B_TTIPC 9;
BA_ "GenSigStartValue" SG_ 201 VFC_Obj12B_AngLongitude 500;
BA_ "GenSigSendType" SG_ 201 VFC_Obj12B_AngLongitude 9;
BA_ "GenSigSendType" SG_ 201 VFC_Obj12B_CRC 9;
BA_ "GenSigSendType" SG_ 201 VFC_Obj12B_AliveCtr 9;
BA_ "GenSigSendType" SG_ 201 VFC_Obj12B_BlockCtr 9;
BA_ "GenSigSendType" SG_ 201 VFC_Obj12B_ScaleChange 9;
BA_ "GenSigSendType" SG_ 201 VFC_Obj12B_ScaleChngStdDev 9;
BA_ "GenSigSendType" SG_ 201 VFC_Obj12B_LineEdgeRightEgo 9;
BA_ "GenSigSendType" SG_ 201 VFC_Obj12B_LineEdgeLeftEgo 9;
BA_ "GenSigSendType" SG_ 201 VFC_Obj12B_CompletelyInImg 9;
BA_ "GenSigSendType" SG_ 201 VFC_Obj12B_DirIndicator 9;
BA_ "GenSigStartValue" SG_ 201 VFC_Obj12B_LineEdgeAngle 4000;
BA_ "GenSigSendType" SG_ 201 VFC_Obj12B_LineEdgeAngle 9;
BA_ "GenSigSendType" SG_ 201 VFC_Obj12B_BrakeLight 9;
BA_ "GenSigSendType" SG_ 201 VFC_Obj12B_MeasSource 9;
BA_ "GenSigSendType" SG_ 201 VFC_Obj12B_Reliab 9;
BA_ "GenSigSendType" SG_ 202 VFC_Obj13A_CRC 9;
BA_ "GenSigSendType" SG_ 202 VFC_Obj13A_AliveCtr 9;
BA_ "GenSigSendType" SG_ 202 VFC_Obj13A_BlockCtr 9;
BA_ "GenSigSendType" SG_ 202 VFC_Obj13A_ProtOrderIndex 9;
BA_ "GenSigStartValue" SG_ 202 VFC_Obj13A_Ax 160;
BA_ "GenSigSendType" SG_ 202 VFC_Obj13A_Ax 9;
BA_ "GenSigStartValue" SG_ 202 VFC_Obj13A_Vx 1540;
BA_ "GenSigSendType" SG_ 202 VFC_Obj13A_Vx 9;
BA_ "GenSigSendType" SG_ 202 VFC_Obj13A_Dx 9;
BA_ "GenSigStartValue" SG_ 202 VFC_Obj13A_Dy 8000;
BA_ "GenSigSendType" SG_ 202 VFC_Obj13A_Dy 9;
BA_ "GenSigStartValue" SG_ 202 VFC_Obj13A_Vy 500;
BA_ "GenSigSendType" SG_ 202 VFC_Obj13A_Vy 9;
BA_ "GenSigStartValue" SG_ 202 VFC_Obj13A_Ay 120;
BA_ "GenSigSendType" SG_ 202 VFC_Obj13A_Ay 9;
BA_ "GenSigSendType" SG_ 202 VFC_Obj13A_DyStdDev 9;
BA_ "GenSigSendType" SG_ 202 VFC_Obj13A_DxStdDev 9;
BA_ "GenSigSendType" SG_ 202 VFC_Obj13A_VxStdDev 9;
BA_ "GenSigSendType" SG_ 202 VFC_Obj13A_ExistProb 9;
BA_ "GenSigSendType" SG_ 202 VFC_Obj13A_VyStdDev 9;
BA_ "GenSigSendType" SG_ 202 VFC_Obj13A_TypeProb 9;
BA_ "GenSigSendType" SG_ 202 VFC_Obj13A_AxStdDev 9;
BA_ "GenSigSendType" SG_ 202 VFC_Obj13A_AyStdDev 9;
BA_ "GenSigStartValue" SG_ 202 VFC_Obj13A_PhiLeft 4000;
BA_ "GenSigSendType" SG_ 202 VFC_Obj13A_PhiLeft 9;
BA_ "GenSigSendType" SG_ 202 VFC_Obj13A_ClassifiedView 9;
BA_ "GenSigSendType" SG_ 202 VFC_Obj13A_Length 9;
BA_ "GenSigSendType" SG_ 202 VFC_Obj13A_WidthStdDev 9;
BA_ "GenSigSendType" SG_ 202 VFC_Obj13A_Height 9;
BA_ "GenSigSendType" SG_ 202 VFC_Obj13A_HeightStdDev 9;
BA_ "GenSigSendType" SG_ 202 VFC_Obj13A_PhiLeftStdDev 9;
BA_ "GenSigSendType" SG_ 202 VFC_Obj13A_HeadingStdDev 9;
BA_ "GenSigSendType" SG_ 202 VFC_Obj13A_Measured 9;
BA_ "GenSigStartValue" SG_ 202 VFC_Obj13A_Heading 157;
BA_ "GenSigSendType" SG_ 202 VFC_Obj13A_Heading 9;
BA_ "GenSigSendType" SG_ 202 VFC_Obj13A_LengthStdDev 9;
BA_ "GenSigStartValue" SG_ 202 VFC_Obj13A_PhiMid 4000;
BA_ "GenSigSendType" SG_ 202 VFC_Obj13A_PhiMid 9;
BA_ "GenSigSendType" SG_ 202 VFC_Obj13A_Width 9;
BA_ "GenSigSendType" SG_ 202 VFC_Obj13A_PhiMidStdDev 9;
BA_ "GenSigStartValue" SG_ 202 VFC_Obj13A_PhiRight 4000;
BA_ "GenSigSendType" SG_ 202 VFC_Obj13A_PhiRight 9;
BA_ "GenSigSendType" SG_ 202 VFC_Obj13A_VisibleView 9;
BA_ "GenSigSendType" SG_ 202 VFC_Obj13A_PhiRightStdDev 9;
BA_ "GenSigStartValue" SG_ 202 VFC_Obj13A_PhiLeftVel 4000;
BA_ "GenSigSendType" SG_ 202 VFC_Obj13A_PhiLeftVel 9;
BA_ "GenSigStartValue" SG_ 202 VFC_Obj13A_PhiRightVel 4000;
BA_ "GenSigSendType" SG_ 202 VFC_Obj13A_PhiRightVel 9;
BA_ "GenSigSendType" SG_ 202 VFC_Obj13A_PhiRightVelStdDev 9;
BA_ "GenSigSendType" SG_ 202 VFC_Obj13A_PhiLeftVelStdDev 9;
BA_ "GenSigStartValue" SG_ 202 VFC_Obj13A_PhiTop 1600;
BA_ "GenSigSendType" SG_ 202 VFC_Obj13A_PhiTop 9;
BA_ "GenSigStartValue" SG_ 202 VFC_Obj13A_PhiBottom 1600;
BA_ "GenSigSendType" SG_ 202 VFC_Obj13A_PhiBottom 9;
BA_ "GenSigSendType" SG_ 202 VFC_Obj13A_PhiTopStdDev 9;
BA_ "GenSigSendType" SG_ 202 VFC_Obj13A_HeadOrientation 9;
BA_ "GenSigSendType" SG_ 202 VFC_Obj13A_Type 9;
BA_ "GenSigSendType" SG_ 202 VFC_Obj13A_PhiBottomStdDev 9;
BA_ "GenSigStartValue" SG_ 202 VFC_Obj13A_NormVx 40000;
BA_ "GenSigSendType" SG_ 202 VFC_Obj13A_NormVx 9;
BA_ "GenSigStartValue" SG_ 202 VFC_Obj13A_NormAx 5000;
BA_ "GenSigSendType" SG_ 202 VFC_Obj13A_NormAx 9;
BA_ "GenSigSendType" SG_ 202 VFC_Obj13A_NormAxStdDev 9;
BA_ "GenSigSendType" SG_ 202 VFC_Obj13A_ProbMovingLat 9;
BA_ "GenSigSendType" SG_ 202 VFC_Obj13A_ID 9;
BA_ "GenSigSendType" SG_ 202 VFC_Obj13A_NormVxStdDev 9;
BA_ "GenSigSendType" SG_ 202 VFC_Obj13A_ProbMovingLong 9;
BA_ "GenSigSendType" SG_ 203 VFC_Obj13B_TTIPC_StdDev 9;
BA_ "GenSigSendType" SG_ 203 VFC_Obj13B_TTIPC 9;
BA_ "GenSigStartValue" SG_ 203 VFC_Obj13B_AngLongitude 500;
BA_ "GenSigSendType" SG_ 203 VFC_Obj13B_AngLongitude 9;
BA_ "GenSigSendType" SG_ 203 VFC_Obj13B_CRC 9;
BA_ "GenSigSendType" SG_ 203 VFC_Obj13B_AliveCtr 9;
BA_ "GenSigSendType" SG_ 203 VFC_Obj13B_BlockCtr 9;
BA_ "GenSigSendType" SG_ 203 VFC_Obj13B_ScaleChange 9;
BA_ "GenSigSendType" SG_ 203 VFC_Obj13B_ScaleChngStdDev 9;
BA_ "GenSigSendType" SG_ 203 VFC_Obj13B_LineEdgeRightEgo 9;
BA_ "GenSigSendType" SG_ 203 VFC_Obj13B_LineEdgeLeftEgo 9;
BA_ "GenSigSendType" SG_ 203 VFC_Obj13B_CompletelyInImg 9;
BA_ "GenSigSendType" SG_ 203 VFC_Obj13B_DirIndicator 9;
BA_ "GenSigStartValue" SG_ 203 VFC_Obj13B_LineEdgeAngle 4000;
BA_ "GenSigSendType" SG_ 203 VFC_Obj13B_LineEdgeAngle 9;
BA_ "GenSigSendType" SG_ 203 VFC_Obj13B_BrakeLight 9;
BA_ "GenSigSendType" SG_ 203 VFC_Obj13B_MeasSource 9;
BA_ "GenSigSendType" SG_ 203 VFC_Obj13B_Reliab 9;
BA_ "GenSigSendType" SG_ 204 VFC_Obj14A_CRC 9;
BA_ "GenSigSendType" SG_ 204 VFC_Obj14A_AliveCtr 9;
BA_ "GenSigSendType" SG_ 204 VFC_Obj14A_BlockCtr 9;
BA_ "GenSigSendType" SG_ 204 VFC_Obj14A_ProtOrderIndex 9;
BA_ "GenSigStartValue" SG_ 204 VFC_Obj14A_Ax 160;
BA_ "GenSigSendType" SG_ 204 VFC_Obj14A_Ax 9;
BA_ "GenSigStartValue" SG_ 204 VFC_Obj14A_Vx 1540;
BA_ "GenSigSendType" SG_ 204 VFC_Obj14A_Vx 9;
BA_ "GenSigSendType" SG_ 204 VFC_Obj14A_Dx 9;
BA_ "GenSigStartValue" SG_ 204 VFC_Obj14A_Dy 8000;
BA_ "GenSigSendType" SG_ 204 VFC_Obj14A_Dy 9;
BA_ "GenSigStartValue" SG_ 204 VFC_Obj14A_Vy 500;
BA_ "GenSigSendType" SG_ 204 VFC_Obj14A_Vy 9;
BA_ "GenSigStartValue" SG_ 204 VFC_Obj14A_Ay 120;
BA_ "GenSigSendType" SG_ 204 VFC_Obj14A_Ay 9;
BA_ "GenSigSendType" SG_ 204 VFC_Obj14A_DyStdDev 9;
BA_ "GenSigSendType" SG_ 204 VFC_Obj14A_DxStdDev 9;
BA_ "GenSigSendType" SG_ 204 VFC_Obj14A_VxStdDev 9;
BA_ "GenSigSendType" SG_ 204 VFC_Obj14A_ExistProb 9;
BA_ "GenSigSendType" SG_ 204 VFC_Obj14A_VyStdDev 9;
BA_ "GenSigSendType" SG_ 204 VFC_Obj14A_TypeProb 9;
BA_ "GenSigSendType" SG_ 204 VFC_Obj14A_AxStdDev 9;
BA_ "GenSigSendType" SG_ 204 VFC_Obj14A_AyStdDev 9;
BA_ "GenSigStartValue" SG_ 204 VFC_Obj14A_PhiLeft 4000;
BA_ "GenSigSendType" SG_ 204 VFC_Obj14A_PhiLeft 9;
BA_ "GenSigSendType" SG_ 204 VFC_Obj14A_ClassifiedView 9;
BA_ "GenSigSendType" SG_ 204 VFC_Obj14A_Length 9;
BA_ "GenSigSendType" SG_ 204 VFC_Obj14A_WidthStdDev 9;
BA_ "GenSigSendType" SG_ 204 VFC_Obj14A_Height 9;
BA_ "GenSigSendType" SG_ 204 VFC_Obj14A_HeightStdDev 9;
BA_ "GenSigSendType" SG_ 204 VFC_Obj14A_PhiLeftStdDev 9;
BA_ "GenSigSendType" SG_ 204 VFC_Obj14A_HeadingStdDev 9;
BA_ "GenSigSendType" SG_ 204 VFC_Obj14A_Measured 9;
BA_ "GenSigStartValue" SG_ 204 VFC_Obj14A_Heading 157;
BA_ "GenSigSendType" SG_ 204 VFC_Obj14A_Heading 9;
BA_ "GenSigSendType" SG_ 204 VFC_Obj14A_LengthStdDev 9;
BA_ "GenSigStartValue" SG_ 204 VFC_Obj14A_PhiMid 4000;
BA_ "GenSigSendType" SG_ 204 VFC_Obj14A_PhiMid 9;
BA_ "GenSigSendType" SG_ 204 VFC_Obj14A_Width 9;
BA_ "GenSigSendType" SG_ 204 VFC_Obj14A_PhiMidStdDev 9;
BA_ "GenSigStartValue" SG_ 204 VFC_Obj14A_PhiRight 4000;
BA_ "GenSigSendType" SG_ 204 VFC_Obj14A_PhiRight 9;
BA_ "GenSigSendType" SG_ 204 VFC_Obj14A_VisibleView 9;
BA_ "GenSigSendType" SG_ 204 VFC_Obj14A_PhiRightStdDev 9;
BA_ "GenSigStartValue" SG_ 204 VFC_Obj14A_PhiLeftVel 4000;
BA_ "GenSigSendType" SG_ 204 VFC_Obj14A_PhiLeftVel 9;
BA_ "GenSigStartValue" SG_ 204 VFC_Obj14A_PhiRightVel 4000;
BA_ "GenSigSendType" SG_ 204 VFC_Obj14A_PhiRightVel 9;
BA_ "GenSigSendType" SG_ 204 VFC_Obj14A_PhiRightVelStdDev 9;
BA_ "GenSigSendType" SG_ 204 VFC_Obj14A_PhiLeftVelStdDev 9;
BA_ "GenSigStartValue" SG_ 204 VFC_Obj14A_PhiTop 1600;
BA_ "GenSigSendType" SG_ 204 VFC_Obj14A_PhiTop 9;
BA_ "GenSigStartValue" SG_ 204 VFC_Obj14A_PhiBottom 1600;
BA_ "GenSigSendType" SG_ 204 VFC_Obj14A_PhiBottom 9;
BA_ "GenSigSendType" SG_ 204 VFC_Obj14A_PhiTopStdDev 9;
BA_ "GenSigSendType" SG_ 204 VFC_Obj14A_HeadOrientation 9;
BA_ "GenSigSendType" SG_ 204 VFC_Obj14A_Type 9;
BA_ "GenSigSendType" SG_ 204 VFC_Obj14A_PhiBottomStdDev 9;
BA_ "GenSigStartValue" SG_ 204 VFC_Obj14A_NormVx 40000;
BA_ "GenSigSendType" SG_ 204 VFC_Obj14A_NormVx 9;
BA_ "GenSigStartValue" SG_ 204 VFC_Obj14A_NormAx 5000;
BA_ "GenSigSendType" SG_ 204 VFC_Obj14A_NormAx 9;
BA_ "GenSigSendType" SG_ 204 VFC_Obj14A_NormAxStdDev 9;
BA_ "GenSigSendType" SG_ 204 VFC_Obj14A_ProbMovingLat 9;
BA_ "GenSigSendType" SG_ 204 VFC_Obj14A_ID 9;
BA_ "GenSigSendType" SG_ 204 VFC_Obj14A_NormVxStdDev 9;
BA_ "GenSigSendType" SG_ 204 VFC_Obj14A_ProbMovingLong 9;
BA_ "GenSigSendType" SG_ 205 VFC_Obj14B_TTIPC_StdDev 9;
BA_ "GenSigSendType" SG_ 205 VFC_Obj14B_TTIPC 9;
BA_ "GenSigStartValue" SG_ 205 VFC_Obj14B_AngLongitude 500;
BA_ "GenSigSendType" SG_ 205 VFC_Obj14B_AngLongitude 9;
BA_ "GenSigSendType" SG_ 205 VFC_Obj14B_CRC 9;
BA_ "GenSigSendType" SG_ 205 VFC_Obj14B_AliveCtr 9;
BA_ "GenSigSendType" SG_ 205 VFC_Obj14B_BlockCtr 9;
BA_ "GenSigSendType" SG_ 205 VFC_Obj14B_ScaleChange 9;
BA_ "GenSigSendType" SG_ 205 VFC_Obj14B_ScaleChngStdDev 9;
BA_ "GenSigSendType" SG_ 205 VFC_Obj14B_LineEdgeRightEgo 9;
BA_ "GenSigSendType" SG_ 205 VFC_Obj14B_LineEdgeLeftEgo 9;
BA_ "GenSigSendType" SG_ 205 VFC_Obj14B_CompletelyInImg 9;
BA_ "GenSigSendType" SG_ 205 VFC_Obj14B_DirIndicator 9;
BA_ "GenSigStartValue" SG_ 205 VFC_Obj14B_LineEdgeAngle 4000;
BA_ "GenSigSendType" SG_ 205 VFC_Obj14B_LineEdgeAngle 9;
BA_ "GenSigSendType" SG_ 205 VFC_Obj14B_BrakeLight 9;
BA_ "GenSigSendType" SG_ 205 VFC_Obj14B_MeasSource 9;
BA_ "GenSigSendType" SG_ 205 VFC_Obj14B_Reliab 9;
BA_ "GenSigSendType" SG_ 206 VFC_Obj15A_CRC 9;
BA_ "GenSigSendType" SG_ 206 VFC_Obj15A_AliveCtr 9;
BA_ "GenSigSendType" SG_ 206 VFC_Obj15A_BlockCtr 9;
BA_ "GenSigSendType" SG_ 206 VFC_Obj15A_ProtOrderIndex 9;
BA_ "GenSigStartValue" SG_ 206 VFC_Obj15A_Ax 160;
BA_ "GenSigSendType" SG_ 206 VFC_Obj15A_Ax 9;
BA_ "GenSigStartValue" SG_ 206 VFC_Obj15A_Vx 1540;
BA_ "GenSigSendType" SG_ 206 VFC_Obj15A_Vx 9;
BA_ "GenSigSendType" SG_ 206 VFC_Obj15A_Dx 9;
BA_ "GenSigStartValue" SG_ 206 VFC_Obj15A_Dy 8000;
BA_ "GenSigSendType" SG_ 206 VFC_Obj15A_Dy 9;
BA_ "GenSigStartValue" SG_ 206 VFC_Obj15A_Vy 500;
BA_ "GenSigSendType" SG_ 206 VFC_Obj15A_Vy 9;
BA_ "GenSigStartValue" SG_ 206 VFC_Obj15A_Ay 120;
BA_ "GenSigSendType" SG_ 206 VFC_Obj15A_Ay 9;
BA_ "GenSigSendType" SG_ 206 VFC_Obj15A_DyStdDev 9;
BA_ "GenSigSendType" SG_ 206 VFC_Obj15A_DxStdDev 9;
BA_ "GenSigSendType" SG_ 206 VFC_Obj15A_VxStdDev 9;
BA_ "GenSigSendType" SG_ 206 VFC_Obj15A_ExistProb 9;
BA_ "GenSigSendType" SG_ 206 VFC_Obj15A_VyStdDev 9;
BA_ "GenSigSendType" SG_ 206 VFC_Obj15A_TypeProb 9;
BA_ "GenSigSendType" SG_ 206 VFC_Obj15A_AxStdDev 9;
BA_ "GenSigSendType" SG_ 206 VFC_Obj15A_AyStdDev 9;
BA_ "GenSigStartValue" SG_ 206 VFC_Obj15A_PhiLeft 4000;
BA_ "GenSigSendType" SG_ 206 VFC_Obj15A_PhiLeft 9;
BA_ "GenSigSendType" SG_ 206 VFC_Obj15A_ClassifiedView 9;
BA_ "GenSigSendType" SG_ 206 VFC_Obj15A_Length 9;
BA_ "GenSigSendType" SG_ 206 VFC_Obj15A_WidthStdDev 9;
BA_ "GenSigSendType" SG_ 206 VFC_Obj15A_Height 9;
BA_ "GenSigSendType" SG_ 206 VFC_Obj15A_HeightStdDev 9;
BA_ "GenSigSendType" SG_ 206 VFC_Obj15A_PhiLeftStdDev 9;
BA_ "GenSigSendType" SG_ 206 VFC_Obj15A_HeadingStdDev 9;
BA_ "GenSigSendType" SG_ 206 VFC_Obj15A_Measured 9;
BA_ "GenSigStartValue" SG_ 206 VFC_Obj15A_Heading 157;
BA_ "GenSigSendType" SG_ 206 VFC_Obj15A_Heading 9;
BA_ "GenSigSendType" SG_ 206 VFC_Obj15A_LengthStdDev 9;
BA_ "GenSigStartValue" SG_ 206 VFC_Obj15A_PhiMid 4000;
BA_ "GenSigSendType" SG_ 206 VFC_Obj15A_PhiMid 9;
BA_ "GenSigSendType" SG_ 206 VFC_Obj15A_Width 9;
BA_ "GenSigSendType" SG_ 206 VFC_Obj15A_PhiMidStdDev 9;
BA_ "GenSigStartValue" SG_ 206 VFC_Obj15A_PhiRight 4000;
BA_ "GenSigSendType" SG_ 206 VFC_Obj15A_PhiRight 9;
BA_ "GenSigSendType" SG_ 206 VFC_Obj15A_VisibleView 9;
BA_ "GenSigSendType" SG_ 206 VFC_Obj15A_PhiRightStdDev 9;
BA_ "GenSigStartValue" SG_ 206 VFC_Obj15A_PhiLeftVel 4000;
BA_ "GenSigSendType" SG_ 206 VFC_Obj15A_PhiLeftVel 9;
BA_ "GenSigStartValue" SG_ 206 VFC_Obj15A_PhiRightVel 4000;
BA_ "GenSigSendType" SG_ 206 VFC_Obj15A_PhiRightVel 9;
BA_ "GenSigSendType" SG_ 206 VFC_Obj15A_PhiRightVelStdDev 9;
BA_ "GenSigSendType" SG_ 206 VFC_Obj15A_PhiLeftVelStdDev 9;
BA_ "GenSigStartValue" SG_ 206 VFC_Obj15A_PhiTop 1600;
BA_ "GenSigSendType" SG_ 206 VFC_Obj15A_PhiTop 9;
BA_ "GenSigStartValue" SG_ 206 VFC_Obj15A_PhiBottom 1600;
BA_ "GenSigSendType" SG_ 206 VFC_Obj15A_PhiBottom 9;
BA_ "GenSigSendType" SG_ 206 VFC_Obj15A_PhiTopStdDev 9;
BA_ "GenSigSendType" SG_ 206 VFC_Obj15A_HeadOrientation 9;
BA_ "GenSigSendType" SG_ 206 VFC_Obj15A_Type 9;
BA_ "GenSigSendType" SG_ 206 VFC_Obj15A_PhiBottomStdDev 9;
BA_ "GenSigStartValue" SG_ 206 VFC_Obj15A_NormVx 40000;
BA_ "GenSigSendType" SG_ 206 VFC_Obj15A_NormVx 9;
BA_ "GenSigStartValue" SG_ 206 VFC_Obj15A_NormAx 5000;
BA_ "GenSigSendType" SG_ 206 VFC_Obj15A_NormAx 9;
BA_ "GenSigSendType" SG_ 206 VFC_Obj15A_NormAxStdDev 9;
BA_ "GenSigSendType" SG_ 206 VFC_Obj15A_ProbMovingLat 9;
BA_ "GenSigSendType" SG_ 206 VFC_Obj15A_ID 9;
BA_ "GenSigSendType" SG_ 206 VFC_Obj15A_NormVxStdDev 9;
BA_ "GenSigSendType" SG_ 206 VFC_Obj15A_ProbMovingLong 9;
BA_ "GenSigSendType" SG_ 207 VFC_Obj15B_TTIPC_StdDev 9;
BA_ "GenSigSendType" SG_ 207 VFC_Obj15B_TTIPC 9;
BA_ "GenSigStartValue" SG_ 207 VFC_Obj15B_AngLongitude 500;
BA_ "GenSigSendType" SG_ 207 VFC_Obj15B_AngLongitude 9;
BA_ "GenSigSendType" SG_ 207 VFC_Obj15B_CRC 9;
BA_ "GenSigSendType" SG_ 207 VFC_Obj15B_AliveCtr 9;
BA_ "GenSigSendType" SG_ 207 VFC_Obj15B_BlockCtr 9;
BA_ "GenSigSendType" SG_ 207 VFC_Obj15B_ScaleChange 9;
BA_ "GenSigSendType" SG_ 207 VFC_Obj15B_ScaleChngStdDev 9;
BA_ "GenSigSendType" SG_ 207 VFC_Obj15B_LineEdgeRightEgo 9;
BA_ "GenSigSendType" SG_ 207 VFC_Obj15B_LineEdgeLeftEgo 9;
BA_ "GenSigSendType" SG_ 207 VFC_Obj15B_CompletelyInImg 9;
BA_ "GenSigSendType" SG_ 207 VFC_Obj15B_DirIndicator 9;
BA_ "GenSigStartValue" SG_ 207 VFC_Obj15B_LineEdgeAngle 4000;
BA_ "GenSigSendType" SG_ 207 VFC_Obj15B_LineEdgeAngle 9;
BA_ "GenSigSendType" SG_ 207 VFC_Obj15B_BrakeLight 9;
BA_ "GenSigSendType" SG_ 207 VFC_Obj15B_MeasSource 9;
BA_ "GenSigSendType" SG_ 207 VFC_Obj15B_Reliab 9;
BA_ "GenSigSendType" SG_ 208 VFC_Obj16A_CRC 9;
BA_ "GenSigSendType" SG_ 208 VFC_Obj16A_AliveCtr 9;
BA_ "GenSigSendType" SG_ 208 VFC_Obj16A_BlockCtr 9;
BA_ "GenSigSendType" SG_ 208 VFC_Obj16A_ProtOrderIndex 9;
BA_ "GenSigStartValue" SG_ 208 VFC_Obj16A_Ax 160;
BA_ "GenSigSendType" SG_ 208 VFC_Obj16A_Ax 9;
BA_ "GenSigStartValue" SG_ 208 VFC_Obj16A_Vx 1540;
BA_ "GenSigSendType" SG_ 208 VFC_Obj16A_Vx 9;
BA_ "GenSigSendType" SG_ 208 VFC_Obj16A_Dx 9;
BA_ "GenSigStartValue" SG_ 208 VFC_Obj16A_Dy 8000;
BA_ "GenSigSendType" SG_ 208 VFC_Obj16A_Dy 9;
BA_ "GenSigStartValue" SG_ 208 VFC_Obj16A_Vy 500;
BA_ "GenSigSendType" SG_ 208 VFC_Obj16A_Vy 9;
BA_ "GenSigStartValue" SG_ 208 VFC_Obj16A_Ay 120;
BA_ "GenSigSendType" SG_ 208 VFC_Obj16A_Ay 9;
BA_ "GenSigSendType" SG_ 208 VFC_Obj16A_DyStdDev 9;
BA_ "GenSigSendType" SG_ 208 VFC_Obj16A_DxStdDev 9;
BA_ "GenSigSendType" SG_ 208 VFC_Obj16A_VxStdDev 9;
BA_ "GenSigSendType" SG_ 208 VFC_Obj16A_ExistProb 9;
BA_ "GenSigSendType" SG_ 208 VFC_Obj16A_VyStdDev 9;
BA_ "GenSigSendType" SG_ 208 VFC_Obj16A_TypeProb 9;
BA_ "GenSigSendType" SG_ 208 VFC_Obj16A_AxStdDev 9;
BA_ "GenSigSendType" SG_ 208 VFC_Obj16A_AyStdDev 9;
BA_ "GenSigStartValue" SG_ 208 VFC_Obj16A_PhiLeft 4000;
BA_ "GenSigSendType" SG_ 208 VFC_Obj16A_PhiLeft 9;
BA_ "GenSigSendType" SG_ 208 VFC_Obj16A_ClassifiedView 9;
BA_ "GenSigSendType" SG_ 208 VFC_Obj16A_Length 9;
BA_ "GenSigSendType" SG_ 208 VFC_Obj16A_WidthStdDev 9;
BA_ "GenSigSendType" SG_ 208 VFC_Obj16A_Height 9;
BA_ "GenSigSendType" SG_ 208 VFC_Obj16A_HeightStdDev 9;
BA_ "GenSigSendType" SG_ 208 VFC_Obj16A_PhiLeftStdDev 9;
BA_ "GenSigSendType" SG_ 208 VFC_Obj16A_HeadingStdDev 9;
BA_ "GenSigSendType" SG_ 208 VFC_Obj16A_Measured 9;
BA_ "GenSigStartValue" SG_ 208 VFC_Obj16A_Heading 157;
BA_ "GenSigSendType" SG_ 208 VFC_Obj16A_Heading 9;
BA_ "GenSigSendType" SG_ 208 VFC_Obj16A_LengthStdDev 9;
BA_ "GenSigStartValue" SG_ 208 VFC_Obj16A_PhiMid 4000;
BA_ "GenSigSendType" SG_ 208 VFC_Obj16A_PhiMid 9;
BA_ "GenSigSendType" SG_ 208 VFC_Obj16A_Width 9;
BA_ "GenSigSendType" SG_ 208 VFC_Obj16A_PhiMidStdDev 9;
BA_ "GenSigStartValue" SG_ 208 VFC_Obj16A_PhiRight 4000;
BA_ "GenSigSendType" SG_ 208 VFC_Obj16A_PhiRight 9;
BA_ "GenSigSendType" SG_ 208 VFC_Obj16A_VisibleView 9;
BA_ "GenSigSendType" SG_ 208 VFC_Obj16A_PhiRightStdDev 9;
BA_ "GenSigStartValue" SG_ 208 VFC_Obj16A_PhiLeftVel 4000;
BA_ "GenSigSendType" SG_ 208 VFC_Obj16A_PhiLeftVel 9;
BA_ "GenSigStartValue" SG_ 208 VFC_Obj16A_PhiRightVel 4000;
BA_ "GenSigSendType" SG_ 208 VFC_Obj16A_PhiRightVel 9;
BA_ "GenSigSendType" SG_ 208 VFC_Obj16A_PhiRightVelStdDev 9;
BA_ "GenSigSendType" SG_ 208 VFC_Obj16A_PhiLeftVelStdDev 9;
BA_ "GenSigStartValue" SG_ 208 VFC_Obj16A_PhiTop 1600;
BA_ "GenSigSendType" SG_ 208 VFC_Obj16A_PhiTop 9;
BA_ "GenSigStartValue" SG_ 208 VFC_Obj16A_PhiBottom 1600;
BA_ "GenSigSendType" SG_ 208 VFC_Obj16A_PhiBottom 9;
BA_ "GenSigSendType" SG_ 208 VFC_Obj16A_PhiTopStdDev 9;
BA_ "GenSigSendType" SG_ 208 VFC_Obj16A_HeadOrientation 9;
BA_ "GenSigSendType" SG_ 208 VFC_Obj16A_Type 9;
BA_ "GenSigSendType" SG_ 208 VFC_Obj16A_PhiBottomStdDev 9;
BA_ "GenSigStartValue" SG_ 208 VFC_Obj16A_NormVx 40000;
BA_ "GenSigSendType" SG_ 208 VFC_Obj16A_NormVx 9;
BA_ "GenSigStartValue" SG_ 208 VFC_Obj16A_NormAx 5000;
BA_ "GenSigSendType" SG_ 208 VFC_Obj16A_NormAx 9;
BA_ "GenSigSendType" SG_ 208 VFC_Obj16A_NormAxStdDev 9;
BA_ "GenSigSendType" SG_ 208 VFC_Obj16A_ProbMovingLat 9;
BA_ "GenSigSendType" SG_ 208 VFC_Obj16A_ID 9;
BA_ "GenSigSendType" SG_ 208 VFC_Obj16A_NormVxStdDev 9;
BA_ "GenSigSendType" SG_ 208 VFC_Obj16A_ProbMovingLong 9;
BA_ "GenSigSendType" SG_ 209 VFC_Obj16B_TTIPC_StdDev 9;
BA_ "GenSigSendType" SG_ 209 VFC_Obj16B_TTIPC 9;
BA_ "GenSigStartValue" SG_ 209 VFC_Obj16B_AngLongitude 500;
BA_ "GenSigSendType" SG_ 209 VFC_Obj16B_AngLongitude 9;
BA_ "GenSigSendType" SG_ 209 VFC_Obj16B_CRC 9;
BA_ "GenSigSendType" SG_ 209 VFC_Obj16B_AliveCtr 9;
BA_ "GenSigSendType" SG_ 209 VFC_Obj16B_BlockCtr 9;
BA_ "GenSigSendType" SG_ 209 VFC_Obj16B_ScaleChange 9;
BA_ "GenSigSendType" SG_ 209 VFC_Obj16B_ScaleChngStdDev 9;
BA_ "GenSigSendType" SG_ 209 VFC_Obj16B_LineEdgeRightEgo 9;
BA_ "GenSigSendType" SG_ 209 VFC_Obj16B_LineEdgeLeftEgo 9;
BA_ "GenSigSendType" SG_ 209 VFC_Obj16B_CompletelyInImg 9;
BA_ "GenSigSendType" SG_ 209 VFC_Obj16B_DirIndicator 9;
BA_ "GenSigStartValue" SG_ 209 VFC_Obj16B_LineEdgeAngle 4000;
BA_ "GenSigSendType" SG_ 209 VFC_Obj16B_LineEdgeAngle 9;
BA_ "GenSigSendType" SG_ 209 VFC_Obj16B_BrakeLight 9;
BA_ "GenSigSendType" SG_ 209 VFC_Obj16B_MeasSource 9;
BA_ "GenSigSendType" SG_ 209 VFC_Obj16B_Reliab 9;
BA_ "GenSigSendType" SG_ 210 VFC_Obj17A_CRC 9;
BA_ "GenSigSendType" SG_ 210 VFC_Obj17A_AliveCtr 9;
BA_ "GenSigSendType" SG_ 210 VFC_Obj17A_BlockCtr 9;
BA_ "GenSigSendType" SG_ 210 VFC_Obj17A_ProtOrderIndex 9;
BA_ "GenSigStartValue" SG_ 210 VFC_Obj17A_Ax 160;
BA_ "GenSigSendType" SG_ 210 VFC_Obj17A_Ax 9;
BA_ "GenSigStartValue" SG_ 210 VFC_Obj17A_Vx 1540;
BA_ "GenSigSendType" SG_ 210 VFC_Obj17A_Vx 9;
BA_ "GenSigSendType" SG_ 210 VFC_Obj17A_Dx 9;
BA_ "GenSigStartValue" SG_ 210 VFC_Obj17A_Dy 8000;
BA_ "GenSigSendType" SG_ 210 VFC_Obj17A_Dy 9;
BA_ "GenSigStartValue" SG_ 210 VFC_Obj17A_Vy 500;
BA_ "GenSigSendType" SG_ 210 VFC_Obj17A_Vy 9;
BA_ "GenSigStartValue" SG_ 210 VFC_Obj17A_Ay 120;
BA_ "GenSigSendType" SG_ 210 VFC_Obj17A_Ay 9;
BA_ "GenSigSendType" SG_ 210 VFC_Obj17A_DyStdDev 9;
BA_ "GenSigSendType" SG_ 210 VFC_Obj17A_DxStdDev 9;
BA_ "GenSigSendType" SG_ 210 VFC_Obj17A_VxStdDev 9;
BA_ "GenSigSendType" SG_ 210 VFC_Obj17A_ExistProb 9;
BA_ "GenSigSendType" SG_ 210 VFC_Obj17A_VyStdDev 9;
BA_ "GenSigSendType" SG_ 210 VFC_Obj17A_TypeProb 9;
BA_ "GenSigSendType" SG_ 210 VFC_Obj17A_AxStdDev 9;
BA_ "GenSigSendType" SG_ 210 VFC_Obj17A_AyStdDev 9;
BA_ "GenSigStartValue" SG_ 210 VFC_Obj17A_PhiLeft 4000;
BA_ "GenSigSendType" SG_ 210 VFC_Obj17A_PhiLeft 9;
BA_ "GenSigSendType" SG_ 210 VFC_Obj17A_ClassifiedView 9;
BA_ "GenSigSendType" SG_ 210 VFC_Obj17A_Length 9;
BA_ "GenSigSendType" SG_ 210 VFC_Obj17A_WidthStdDev 9;
BA_ "GenSigSendType" SG_ 210 VFC_Obj17A_Height 9;
BA_ "GenSigSendType" SG_ 210 VFC_Obj17A_HeightStdDev 9;
BA_ "GenSigSendType" SG_ 210 VFC_Obj17A_PhiLeftStdDev 9;
BA_ "GenSigSendType" SG_ 210 VFC_Obj17A_HeadingStdDev 9;
BA_ "GenSigSendType" SG_ 210 VFC_Obj17A_Measured 9;
BA_ "GenSigStartValue" SG_ 210 VFC_Obj17A_Heading 157;
BA_ "GenSigSendType" SG_ 210 VFC_Obj17A_Heading 9;
BA_ "GenSigSendType" SG_ 210 VFC_Obj17A_LengthStdDev 9;
BA_ "GenSigStartValue" SG_ 210 VFC_Obj17A_PhiMid 4000;
BA_ "GenSigSendType" SG_ 210 VFC_Obj17A_PhiMid 9;
BA_ "GenSigSendType" SG_ 210 VFC_Obj17A_Width 9;
BA_ "GenSigSendType" SG_ 210 VFC_Obj17A_PhiMidStdDev 9;
BA_ "GenSigStartValue" SG_ 210 VFC_Obj17A_PhiRight 4000;
BA_ "GenSigSendType" SG_ 210 VFC_Obj17A_PhiRight 9;
BA_ "GenSigSendType" SG_ 210 VFC_Obj17A_VisibleView 9;
BA_ "GenSigSendType" SG_ 210 VFC_Obj17A_PhiRightStdDev 9;
BA_ "GenSigStartValue" SG_ 210 VFC_Obj17A_PhiLeftVel 4000;
BA_ "GenSigSendType" SG_ 210 VFC_Obj17A_PhiLeftVel 9;
BA_ "GenSigStartValue" SG_ 210 VFC_Obj17A_PhiRightVel 4000;
BA_ "GenSigSendType" SG_ 210 VFC_Obj17A_PhiRightVel 9;
BA_ "GenSigSendType" SG_ 210 VFC_Obj17A_PhiRightVelStdDev 9;
BA_ "GenSigSendType" SG_ 210 VFC_Obj17A_PhiLeftVelStdDev 9;
BA_ "GenSigStartValue" SG_ 210 VFC_Obj17A_PhiTop 1600;
BA_ "GenSigSendType" SG_ 210 VFC_Obj17A_PhiTop 9;
BA_ "GenSigStartValue" SG_ 210 VFC_Obj17A_PhiBottom 1600;
BA_ "GenSigSendType" SG_ 210 VFC_Obj17A_PhiBottom 9;
BA_ "GenSigSendType" SG_ 210 VFC_Obj17A_PhiTopStdDev 9;
BA_ "GenSigSendType" SG_ 210 VFC_Obj17A_HeadOrientation 9;
BA_ "GenSigSendType" SG_ 210 VFC_Obj17A_Type 9;
BA_ "GenSigSendType" SG_ 210 VFC_Obj17A_PhiBottomStdDev 9;
BA_ "GenSigStartValue" SG_ 210 VFC_Obj17A_NormVx 40000;
BA_ "GenSigSendType" SG_ 210 VFC_Obj17A_NormVx 9;
BA_ "GenSigStartValue" SG_ 210 VFC_Obj17A_NormAx 5000;
BA_ "GenSigSendType" SG_ 210 VFC_Obj17A_NormAx 9;
BA_ "GenSigSendType" SG_ 210 VFC_Obj17A_NormAxStdDev 9;
BA_ "GenSigSendType" SG_ 210 VFC_Obj17A_ProbMovingLat 9;
BA_ "GenSigSendType" SG_ 210 VFC_Obj17A_ID 9;
BA_ "GenSigSendType" SG_ 210 VFC_Obj17A_NormVxStdDev 9;
BA_ "GenSigSendType" SG_ 210 VFC_Obj17A_ProbMovingLong 9;
BA_ "GenSigSendType" SG_ 211 VFC_Obj17B_TTIPC_StdDev 9;
BA_ "GenSigSendType" SG_ 211 VFC_Obj17B_TTIPC 9;
BA_ "GenSigStartValue" SG_ 211 VFC_Obj17B_AngLongitude 500;
BA_ "GenSigSendType" SG_ 211 VFC_Obj17B_AngLongitude 9;
BA_ "GenSigSendType" SG_ 211 VFC_Obj17B_CRC 9;
BA_ "GenSigSendType" SG_ 211 VFC_Obj17B_AliveCtr 9;
BA_ "GenSigSendType" SG_ 211 VFC_Obj17B_BlockCtr 9;
BA_ "GenSigSendType" SG_ 211 VFC_Obj17B_ScaleChange 9;
BA_ "GenSigSendType" SG_ 211 VFC_Obj17B_ScaleChngStdDev 9;
BA_ "GenSigSendType" SG_ 211 VFC_Obj17B_LineEdgeRightEgo 9;
BA_ "GenSigSendType" SG_ 211 VFC_Obj17B_LineEdgeLeftEgo 9;
BA_ "GenSigSendType" SG_ 211 VFC_Obj17B_CompletelyInImg 9;
BA_ "GenSigSendType" SG_ 211 VFC_Obj17B_DirIndicator 9;
BA_ "GenSigStartValue" SG_ 211 VFC_Obj17B_LineEdgeAngle 4000;
BA_ "GenSigSendType" SG_ 211 VFC_Obj17B_LineEdgeAngle 9;
BA_ "GenSigSendType" SG_ 211 VFC_Obj17B_BrakeLight 9;
BA_ "GenSigSendType" SG_ 211 VFC_Obj17B_MeasSource 9;
BA_ "GenSigSendType" SG_ 211 VFC_Obj17B_Reliab 9;
BA_ "GenSigSendType" SG_ 212 VFC_Obj18A_CRC 9;
BA_ "GenSigSendType" SG_ 212 VFC_Obj18A_AliveCtr 9;
BA_ "GenSigSendType" SG_ 212 VFC_Obj18A_BlockCtr 9;
BA_ "GenSigSendType" SG_ 212 VFC_Obj18A_ProtOrderIndex 9;
BA_ "GenSigStartValue" SG_ 212 VFC_Obj18A_Ax 160;
BA_ "GenSigSendType" SG_ 212 VFC_Obj18A_Ax 9;
BA_ "GenSigStartValue" SG_ 212 VFC_Obj18A_Vx 1540;
BA_ "GenSigSendType" SG_ 212 VFC_Obj18A_Vx 9;
BA_ "GenSigSendType" SG_ 212 VFC_Obj18A_Dx 9;
BA_ "GenSigStartValue" SG_ 212 VFC_Obj18A_Dy 8000;
BA_ "GenSigSendType" SG_ 212 VFC_Obj18A_Dy 9;
BA_ "GenSigStartValue" SG_ 212 VFC_Obj18A_Vy 500;
BA_ "GenSigSendType" SG_ 212 VFC_Obj18A_Vy 9;
BA_ "GenSigStartValue" SG_ 212 VFC_Obj18A_Ay 120;
BA_ "GenSigSendType" SG_ 212 VFC_Obj18A_Ay 9;
BA_ "GenSigSendType" SG_ 212 VFC_Obj18A_DyStdDev 9;
BA_ "GenSigSendType" SG_ 212 VFC_Obj18A_DxStdDev 9;
BA_ "GenSigSendType" SG_ 212 VFC_Obj18A_VxStdDev 9;
BA_ "GenSigSendType" SG_ 212 VFC_Obj18A_ExistProb 9;
BA_ "GenSigSendType" SG_ 212 VFC_Obj18A_VyStdDev 9;
BA_ "GenSigSendType" SG_ 212 VFC_Obj18A_TypeProb 9;
BA_ "GenSigSendType" SG_ 212 VFC_Obj18A_AxStdDev 9;
BA_ "GenSigSendType" SG_ 212 VFC_Obj18A_AyStdDev 9;
BA_ "GenSigStartValue" SG_ 212 VFC_Obj18A_PhiLeft 4000;
BA_ "GenSigSendType" SG_ 212 VFC_Obj18A_PhiLeft 9;
BA_ "GenSigSendType" SG_ 212 VFC_Obj18A_ClassifiedView 9;
BA_ "GenSigSendType" SG_ 212 VFC_Obj18A_Length 9;
BA_ "GenSigSendType" SG_ 212 VFC_Obj18A_WidthStdDev 9;
BA_ "GenSigSendType" SG_ 212 VFC_Obj18A_Height 9;
BA_ "GenSigSendType" SG_ 212 VFC_Obj18A_HeightStdDev 9;
BA_ "GenSigSendType" SG_ 212 VFC_Obj18A_PhiLeftStdDev 9;
BA_ "GenSigSendType" SG_ 212 VFC_Obj18A_HeadingStdDev 9;
BA_ "GenSigSendType" SG_ 212 VFC_Obj18A_Measured 9;
BA_ "GenSigStartValue" SG_ 212 VFC_Obj18A_Heading 157;
BA_ "GenSigSendType" SG_ 212 VFC_Obj18A_Heading 9;
BA_ "GenSigSendType" SG_ 212 VFC_Obj18A_LengthStdDev 9;
BA_ "GenSigStartValue" SG_ 212 VFC_Obj18A_PhiMid 4000;
BA_ "GenSigSendType" SG_ 212 VFC_Obj18A_PhiMid 9;
BA_ "GenSigSendType" SG_ 212 VFC_Obj18A_Width 9;
BA_ "GenSigSendType" SG_ 212 VFC_Obj18A_PhiMidStdDev 9;
BA_ "GenSigStartValue" SG_ 212 VFC_Obj18A_PhiRight 4000;
BA_ "GenSigSendType" SG_ 212 VFC_Obj18A_PhiRight 9;
BA_ "GenSigSendType" SG_ 212 VFC_Obj18A_VisibleView 9;
BA_ "GenSigSendType" SG_ 212 VFC_Obj18A_PhiRightStdDev 9;
BA_ "GenSigStartValue" SG_ 212 VFC_Obj18A_PhiLeftVel 4000;
BA_ "GenSigSendType" SG_ 212 VFC_Obj18A_PhiLeftVel 9;
BA_ "GenSigStartValue" SG_ 212 VFC_Obj18A_PhiRightVel 4000;
BA_ "GenSigSendType" SG_ 212 VFC_Obj18A_PhiRightVel 9;
BA_ "GenSigSendType" SG_ 212 VFC_Obj18A_PhiRightVelStdDev 9;
BA_ "GenSigSendType" SG_ 212 VFC_Obj18A_PhiLeftVelStdDev 9;
BA_ "GenSigStartValue" SG_ 212 VFC_Obj18A_PhiTop 1600;
BA_ "GenSigSendType" SG_ 212 VFC_Obj18A_PhiTop 9;
BA_ "GenSigStartValue" SG_ 212 VFC_Obj18A_PhiBottom 1600;
BA_ "GenSigSendType" SG_ 212 VFC_Obj18A_PhiBottom 9;
BA_ "GenSigSendType" SG_ 212 VFC_Obj18A_PhiTopStdDev 9;
BA_ "GenSigSendType" SG_ 212 VFC_Obj18A_HeadOrientation 9;
BA_ "GenSigSendType" SG_ 212 VFC_Obj18A_Type 9;
BA_ "GenSigSendType" SG_ 212 VFC_Obj18A_PhiBottomStdDev 9;
BA_ "GenSigStartValue" SG_ 212 VFC_Obj18A_NormVx 40000;
BA_ "GenSigSendType" SG_ 212 VFC_Obj18A_NormVx 9;
BA_ "GenSigStartValue" SG_ 212 VFC_Obj18A_NormAx 5000;
BA_ "GenSigSendType" SG_ 212 VFC_Obj18A_NormAx 9;
BA_ "GenSigSendType" SG_ 212 VFC_Obj18A_NormAxStdDev 9;
BA_ "GenSigSendType" SG_ 212 VFC_Obj18A_ProbMovingLat 9;
BA_ "GenSigSendType" SG_ 212 VFC_Obj18A_ID 9;
BA_ "GenSigSendType" SG_ 212 VFC_Obj18A_NormVxStdDev 9;
BA_ "GenSigSendType" SG_ 212 VFC_Obj18A_ProbMovingLong 9;
BA_ "GenSigSendType" SG_ 213 VFC_Obj18B_TTIPC_StdDev 9;
BA_ "GenSigSendType" SG_ 213 VFC_Obj18B_TTIPC 9;
BA_ "GenSigStartValue" SG_ 213 VFC_Obj18B_AngLongitude 500;
BA_ "GenSigSendType" SG_ 213 VFC_Obj18B_AngLongitude 9;
BA_ "GenSigSendType" SG_ 213 VFC_Obj18B_CRC 9;
BA_ "GenSigSendType" SG_ 213 VFC_Obj18B_AliveCtr 9;
BA_ "GenSigSendType" SG_ 213 VFC_Obj18B_BlockCtr 9;
BA_ "GenSigSendType" SG_ 213 VFC_Obj18B_ScaleChange 9;
BA_ "GenSigSendType" SG_ 213 VFC_Obj18B_ScaleChngStdDev 9;
BA_ "GenSigSendType" SG_ 213 VFC_Obj18B_LineEdgeRightEgo 9;
BA_ "GenSigSendType" SG_ 213 VFC_Obj18B_LineEdgeLeftEgo 9;
BA_ "GenSigSendType" SG_ 213 VFC_Obj18B_CompletelyInImg 9;
BA_ "GenSigSendType" SG_ 213 VFC_Obj18B_DirIndicator 9;
BA_ "GenSigStartValue" SG_ 213 VFC_Obj18B_LineEdgeAngle 4000;
BA_ "GenSigSendType" SG_ 213 VFC_Obj18B_LineEdgeAngle 9;
BA_ "GenSigSendType" SG_ 213 VFC_Obj18B_BrakeLight 9;
BA_ "GenSigSendType" SG_ 213 VFC_Obj18B_MeasSource 9;
BA_ "GenSigSendType" SG_ 213 VFC_Obj18B_Reliab 9;
VAL_ 194 VFC_Obj09A_ClassifiedView 0 "Unknown" 1 "Front" 2 "Rear" 3 "Left" 4 "Right" ;
VAL_ 194 VFC_Obj09A_Measured 0 "Invalid" 1 "Predicted" 2 "Measured" 3 "Reserved" ;
VAL_ 194 VFC_Obj09A_VisibleView 0 "UNKNOWN" 1 "CLASSIC" 2 "SIDE" 3 "CLASSIC_SIDE" 4 "SIDE_CLASSIC" ;
VAL_ 194 VFC_Obj09A_HeadOrientation 0 "N/A" 1 "Head front" 2 "Head left front" 3 "Head left" 4 "Head left back" 5 "Head back" 6 "Head right back" 7 "Head right" 8 "Head right front" 15 "Unknown" ;
VAL_ 194 VFC_Obj09A_Type 0 "No type" 1 "Car" 2 "Truck" 3 "Motorcycle" 4 "Pedestrian" 5 "Cyclist" 6 "Animal" ;
VAL_ 195 VFC_Obj09B_LineEdgeRightEgo 0 "Right" 1 "Not Right" ;
VAL_ 195 VFC_Obj09B_LineEdgeLeftEgo 0 "Left" 1 "Not Left" ;
VAL_ 195 VFC_Obj09B_CompletelyInImg 0 "completely measured" 1 "not completely measured" ;
VAL_ 195 VFC_Obj09B_DirIndicator 0 "No direction indicator" 1 "Left indicator" 2 "Right indicator" 3 "Warning Lights" 4 "Unknown" ;
VAL_ 195 VFC_Obj09B_BrakeLight 0 "No light detected" 1 "One light detected" 2 "Two lights detected" 3 "Three lights detected" 4 "Unknown" ;
VAL_ 195 VFC_Obj09B_MeasSource 1 "MOD" 2 "PDET" 4 "OFT" 8 "OLS" 16 "Reserved" ;
VAL_ 195 VFC_Obj09B_Reliab 1 "Classifier Path" 2 "Flow Path" 4 "Disparity Path" 8 "Semantic Segmentation Path" 16 "Flow Stixel Path" 32 "Reserved" ;
VAL_ 196 VFC_Obj10A_ClassifiedView 0 "Unknown" 1 "Front" 2 "Rear" 3 "Left" 4 "Right" ;
VAL_ 196 VFC_Obj10A_Measured 0 "Invalid" 1 "Predicted" 2 "Measured" 3 "Reserved" ;
VAL_ 196 VFC_Obj10A_VisibleView 0 "UNKNOWN" 1 "CLASSIC" 2 "SIDE" 3 "CLASSIC_SIDE" 4 "SIDE_CLASSIC" ;
VAL_ 196 VFC_Obj10A_HeadOrientation 0 "N/A" 1 "Head front" 2 "Head left front" 3 "Head left" 4 "Head left back" 5 "Head back" 6 "Head right back" 7 "Head right" 8 "Head right front" 15 "Unknown" ;
VAL_ 196 VFC_Obj10A_Type 0 "No type" 1 "Car" 2 "Truck" 3 "Motorcycle" 4 "Pedestrian" 5 "Cyclist" 6 "Animal" ;
VAL_ 197 VFC_Obj10B_LineEdgeRightEgo 0 "Right" 1 "Not Right" ;
VAL_ 197 VFC_Obj10B_LineEdgeLeftEgo 0 "Left" 1 "Not Left" ;
VAL_ 197 VFC_Obj10B_CompletelyInImg 0 "completely measured" 1 "not completely measured" ;
VAL_ 197 VFC_Obj10B_DirIndicator 0 "No direction indicator" 1 "Left indicator" 2 "Right indicator" 3 "Warning Lights" 4 "Unknown" ;
VAL_ 197 VFC_Obj10B_BrakeLight 0 "No light detected" 1 "One light detected" 2 "Two lights detected" 3 "Three lights detected" 4 "Unknown" ;
VAL_ 197 VFC_Obj10B_MeasSource 1 "MOD" 2 "PDET" 4 "OFT" 8 "OLS" 16 "Reserved" ;
VAL_ 197 VFC_Obj10B_Reliab 1 "Classifier Path" 2 "Flow Path" 4 "Disparity Path" 8 "Semantic Segmentation Path" 16 "Flow Stixel Path" 32 "Reserved" ;
VAL_ 198 VFC_Obj11A_ClassifiedView 0 "Unknown" 1 "Front" 2 "Rear" 3 "Left" 4 "Right" ;
VAL_ 198 VFC_Obj11A_Measured 0 "Invalid" 1 "Predicted" 2 "Measured" 3 "Reserved" ;
VAL_ 198 VFC_Obj11A_VisibleView 0 "UNKNOWN" 1 "CLASSIC" 2 "SIDE" 3 "CLASSIC_SIDE" 4 "SIDE_CLASSIC" ;
VAL_ 198 VFC_Obj11A_HeadOrientation 0 "N/A" 1 "Head front" 2 "Head left front" 3 "Head left" 4 "Head left back" 5 "Head back" 6 "Head right back" 7 "Head right" 8 "Head right front" 15 "Unknown" ;
VAL_ 198 VFC_Obj11A_Type 0 "No type" 1 "Car" 2 "Truck" 3 "Motorcycle" 4 "Pedestrian" 5 "Cyclist" 6 "Animal" ;
VAL_ 199 VFC_Obj11B_LineEdgeRightEgo 0 "Right" 1 "Not Right" ;
VAL_ 199 VFC_Obj11B_LineEdgeLeftEgo 0 "Left" 1 "Not Left" ;
VAL_ 199 VFC_Obj11B_CompletelyInImg 0 "completely measured" 1 "not completely measured" ;
VAL_ 199 VFC_Obj11B_DirIndicator 0 "No direction indicator" 1 "Left indicator" 2 "Right indicator" 3 "Warning Lights" 4 "Unknown" ;
VAL_ 199 VFC_Obj11B_BrakeLight 0 "No light detected" 1 "One light detected" 2 "Two lights detected" 3 "Three lights detected" 4 "Unknown" ;
VAL_ 199 VFC_Obj11B_MeasSource 1 "MOD" 2 "PDET" 4 "OFT" 8 "OLS" 16 "Reserved" ;
VAL_ 199 VFC_Obj11B_Reliab 1 "Classifier Path" 2 "Flow Path" 4 "Disparity Path" 8 "Semantic Segmentation Path" 16 "Flow Stixel Path" 32 "Reserved" ;
VAL_ 200 VFC_Obj12A_ClassifiedView 0 "Unknown" 1 "Front" 2 "Rear" 3 "Left" 4 "Right" ;
VAL_ 200 VFC_Obj12A_Measured 0 "Invalid" 1 "Predicted" 2 "Measured" 3 "Reserved" ;
VAL_ 200 VFC_Obj12A_VisibleView 0 "UNKNOWN" 1 "CLASSIC" 2 "SIDE" 3 "CLASSIC_SIDE" 4 "SIDE_CLASSIC" ;
VAL_ 200 VFC_Obj12A_HeadOrientation 0 "N/A" 1 "Head front" 2 "Head left front" 3 "Head left" 4 "Head left back" 5 "Head back" 6 "Head right back" 7 "Head right" 8 "Head right front" 15 "Unknown" ;
VAL_ 200 VFC_Obj12A_Type 0 "No type" 1 "Car" 2 "Truck" 3 "Motorcycle" 4 "Pedestrian" 5 "Cyclist" 6 "Animal" ;
VAL_ 201 VFC_Obj12B_LineEdgeRightEgo 0 "Right" 1 "Not Right" ;
VAL_ 201 VFC_Obj12B_LineEdgeLeftEgo 0 "Left" 1 "Not Left" ;
VAL_ 201 VFC_Obj12B_CompletelyInImg 0 "completely measured" 1 "not completely measured" ;
VAL_ 201 VFC_Obj12B_DirIndicator 0 "No direction indicator" 1 "Left indicator" 2 "Right indicator" 3 "Warning Lights" 4 "Unknown" ;
VAL_ 201 VFC_Obj12B_BrakeLight 0 "No light detected" 1 "One light detected" 2 "Two lights detected" 3 "Three lights detected" 4 "Unknown" ;
VAL_ 201 VFC_Obj12B_MeasSource 1 "MOD" 2 "PDET" 4 "OFT" 8 "OLS" 16 "Reserved" ;
VAL_ 201 VFC_Obj12B_Reliab 1 "Classifier Path" 2 "Flow Path" 4 "Disparity Path" 8 "Semantic Segmentation Path" 16 "Flow Stixel Path" 32 "Reserved" ;
VAL_ 202 VFC_Obj13A_ClassifiedView 0 "Unknown" 1 "Front" 2 "Rear" 3 "Left" 4 "Right" ;
VAL_ 202 VFC_Obj13A_Measured 0 "Invalid" 1 "Predicted" 2 "Measured" 3 "Reserved" ;
VAL_ 202 VFC_Obj13A_VisibleView 0 "UNKNOWN" 1 "CLASSIC" 2 "SIDE" 3 "CLASSIC_SIDE" 4 "SIDE_CLASSIC" ;
VAL_ 202 VFC_Obj13A_HeadOrientation 0 "N/A" 1 "Head front" 2 "Head left front" 3 "Head left" 4 "Head left back" 5 "Head back" 6 "Head right back" 7 "Head right" 8 "Head right front" 15 "Unknown" ;
VAL_ 202 VFC_Obj13A_Type 0 "No type" 1 "Car" 2 "Truck" 3 "Motorcycle" 4 "Pedestrian" 5 "Cyclist" 6 "Animal" ;
VAL_ 203 VFC_Obj13B_LineEdgeRightEgo 0 "Right" 1 "Not Right" ;
VAL_ 203 VFC_Obj13B_LineEdgeLeftEgo 0 "Left" 1 "Not Left" ;
VAL_ 203 VFC_Obj13B_CompletelyInImg 0 "completely measured" 1 "not completely measured" ;
VAL_ 203 VFC_Obj13B_DirIndicator 0 "No direction indicator" 1 "Left indicator" 2 "Right indicator" 3 "Warning Lights" 4 "Unknown" ;
VAL_ 203 VFC_Obj13B_BrakeLight 0 "No light detected" 1 "One light detected" 2 "Two lights detected" 3 "Three lights detected" 4 "Unknown" ;
VAL_ 203 VFC_Obj13B_MeasSource 1 "MOD" 2 "PDET" 4 "OFT" 8 "OLS" 16 "Reserved" ;
VAL_ 203 VFC_Obj13B_Reliab 1 "Classifier Path" 2 "Flow Path" 4 "Disparity Path" 8 "Semantic Segmentation Path" 16 "Flow Stixel Path" 32 "Reserved" ;
VAL_ 204 VFC_Obj14A_ClassifiedView 0 "Unknown" 1 "Front" 2 "Rear" 3 "Left" 4 "Right" ;
VAL_ 204 VFC_Obj14A_Measured 0 "Invalid" 1 "Predicted" 2 "Measured" 3 "Reserved" ;
VAL_ 204 VFC_Obj14A_VisibleView 0 "UNKNOWN" 1 "CLASSIC" 2 "SIDE" 3 "CLASSIC_SIDE" 4 "SIDE_CLASSIC" ;
VAL_ 204 VFC_Obj14A_HeadOrientation 0 "N/A" 1 "Head front" 2 "Head left front" 3 "Head left" 4 "Head left back" 5 "Head back" 6 "Head right back" 7 "Head right" 8 "Head right front" 15 "Unknown" ;
VAL_ 204 VFC_Obj14A_Type 0 "No type" 1 "Car" 2 "Truck" 3 "Motorcycle" 4 "Pedestrian" 5 "Cyclist" 6 "Animal" ;
VAL_ 205 VFC_Obj14B_LineEdgeRightEgo 0 "Right" 1 "Not Right" ;
VAL_ 205 VFC_Obj14B_LineEdgeLeftEgo 0 "Left" 1 "Not Left" ;
VAL_ 205 VFC_Obj14B_CompletelyInImg 0 "completely measured" 1 "not completely measured" ;
VAL_ 205 VFC_Obj14B_DirIndicator 0 "No direction indicator" 1 "Left indicator" 2 "Right indicator" 3 "Warning Lights" 4 "Unknown" ;
VAL_ 205 VFC_Obj14B_BrakeLight 0 "No light detected" 1 "One light detected" 2 "Two lights detected" 3 "Three lights detected" 4 "Unknown" ;
VAL_ 205 VFC_Obj14B_MeasSource 1 "MOD" 2 "PDET" 4 "OFT" 8 "OLS" 16 "Reserved" ;
VAL_ 205 VFC_Obj14B_Reliab 1 "Classifier Path" 2 "Flow Path" 4 "Disparity Path" 8 "Semantic Segmentation Path" 16 "Flow Stixel Path" 32 "Reserved" ;
VAL_ 206 VFC_Obj15A_ClassifiedView 0 "Unknown" 1 "Front" 2 "Rear" 3 "Left" 4 "Right" ;
VAL_ 206 VFC_Obj15A_Measured 0 "Invalid" 1 "Predicted" 2 "Measured" 3 "Reserved" ;
VAL_ 206 VFC_Obj15A_VisibleView 0 "UNKNOWN" 1 "CLASSIC" 2 "SIDE" 3 "CLASSIC_SIDE" 4 "SIDE_CLASSIC" ;
VAL_ 206 VFC_Obj15A_HeadOrientation 0 "N/A" 1 "Head front" 2 "Head left front" 3 "Head left" 4 "Head left back" 5 "Head back" 6 "Head right back" 7 "Head right" 8 "Head right front" 15 "Unknown" ;
VAL_ 206 VFC_Obj15A_Type 0 "No type" 1 "Car" 2 "Truck" 3 "Motorcycle" 4 "Pedestrian" 5 "Cyclist" 6 "Animal" ;
VAL_ 207 VFC_Obj15B_LineEdgeRightEgo 0 "Right" 1 "Not Right" ;
VAL_ 207 VFC_Obj15B_LineEdgeLeftEgo 0 "Left" 1 "Not Left" ;
VAL_ 207 VFC_Obj15B_CompletelyInImg 0 "completely measured" 1 "not completely measured" ;
VAL_ 207 VFC_Obj15B_DirIndicator 0 "No direction indicator" 1 "Left indicator" 2 "Right indicator" 3 "Warning Lights" 4 "Unknown" ;
VAL_ 207 VFC_Obj15B_BrakeLight 0 "No light detected" 1 "One light detected" 2 "Two lights detected" 3 "Three lights detected" 4 "Unknown" ;
VAL_ 207 VFC_Obj15B_MeasSource 1 "MOD" 2 "PDET" 4 "OFT" 8 "OLS" 16 "Reserved" ;
VAL_ 207 VFC_Obj15B_Reliab 1 "Classifier Path" 2 "Flow Path" 4 "Disparity Path" 8 "Semantic Segmentation Path" 16 "Flow Stixel Path" 32 "Reserved" ;
VAL_ 208 VFC_Obj16A_ClassifiedView 0 "Unknown" 1 "Front" 2 "Rear" 3 "Left" 4 "Right" ;
VAL_ 208 VFC_Obj16A_Measured 0 "Invalid" 1 "Predicted" 2 "Measured" 3 "Reserved" ;
VAL_ 208 VFC_Obj16A_VisibleView 0 "UNKNOWN" 1 "CLASSIC" 2 "SIDE" 3 "CLASSIC_SIDE" 4 "SIDE_CLASSIC" ;
VAL_ 208 VFC_Obj16A_HeadOrientation 0 "N/A" 1 "Head front" 2 "Head left front" 3 "Head left" 4 "Head left back" 5 "Head back" 6 "Head right back" 7 "Head right" 8 "Head right front" 15 "Unknown" ;
VAL_ 208 VFC_Obj16A_Type 0 "No type" 1 "Car" 2 "Truck" 3 "Motorcycle" 4 "Pedestrian" 5 "Cyclist" 6 "Animal" ;
VAL_ 209 VFC_Obj16B_LineEdgeRightEgo 0 "Right" 1 "Not Right" ;
VAL_ 209 VFC_Obj16B_LineEdgeLeftEgo 0 "Left" 1 "Not Left" ;
VAL_ 209 VFC_Obj16B_CompletelyInImg 0 "completely measured" 1 "not completely measured" ;
VAL_ 209 VFC_Obj16B_DirIndicator 0 "No direction indicator" 1 "Left indicator" 2 "Right indicator" 3 "Warning Lights" 4 "Unknown" ;
VAL_ 209 VFC_Obj16B_BrakeLight 0 "No light detected" 1 "One light detected" 2 "Two lights detected" 3 "Three lights detected" 4 "Unknown" ;
VAL_ 209 VFC_Obj16B_MeasSource 1 "MOD" 2 "PDET" 4 "OFT" 8 "OLS" 16 "Reserved" ;
VAL_ 209 VFC_Obj16B_Reliab 1 "Classifier Path" 2 "Flow Path" 4 "Disparity Path" 8 "Semantic Segmentation Path" 16 "Flow Stixel Path" 32 "Reserved" ;
VAL_ 210 VFC_Obj17A_ClassifiedView 0 "Unknown" 1 "Front" 2 "Rear" 3 "Left" 4 "Right" ;
VAL_ 210 VFC_Obj17A_Measured 0 "Invalid" 1 "Predicted" 2 "Measured" 3 "Reserved" ;
VAL_ 210 VFC_Obj17A_VisibleView 0 "UNKNOWN" 1 "CLASSIC" 2 "SIDE" 3 "CLASSIC_SIDE" 4 "SIDE_CLASSIC" ;
VAL_ 210 VFC_Obj17A_HeadOrientation 0 "N/A" 1 "Head front" 2 "Head left front" 3 "Head left" 4 "Head left back" 5 "Head back" 6 "Head right back" 7 "Head right" 8 "Head right front" 15 "Unknown" ;
VAL_ 210 VFC_Obj17A_Type 0 "No type" 1 "Car" 2 "Truck" 3 "Motorcycle" 4 "Pedestrian" 5 "Cyclist" 6 "Animal" ;
VAL_ 211 VFC_Obj17B_LineEdgeRightEgo 0 "Right" 1 "Not Right" ;
VAL_ 211 VFC_Obj17B_LineEdgeLeftEgo 0 "Left" 1 "Not Left" ;
VAL_ 211 VFC_Obj17B_CompletelyInImg 0 "completely measured" 1 "not completely measured" ;
VAL_ 211 VFC_Obj17B_DirIndicator 0 "No direction indicator" 1 "Left indicator" 2 "Right indicator" 3 "Warning Lights" 4 "Unknown" ;
VAL_ 211 VFC_Obj17B_BrakeLight 0 "No light detected" 1 "One light detected" 2 "Two lights detected" 3 "Three lights detected" 4 "Unknown" ;
VAL_ 211 VFC_Obj17B_MeasSource 1 "MOD" 2 "PDET" 4 "OFT" 8 "OLS" 16 "Reserved" ;
VAL_ 211 VFC_Obj17B_Reliab 1 "Classifier Path" 2 "Flow Path" 4 "Disparity Path" 8 "Semantic Segmentation Path" 16 "Flow Stixel Path" 32 "Reserved" ;
VAL_ 212 VFC_Obj18A_ClassifiedView 0 "Unknown" 1 "Front" 2 "Rear" 3 "Left" 4 "Right" ;
VAL_ 212 VFC_Obj18A_Measured 0 "Invalid" 1 "Predicted" 2 "Measured" 3 "Reserved" ;
VAL_ 212 VFC_Obj18A_VisibleView 0 "UNKNOWN" 1 "CLASSIC" 2 "SIDE" 3 "CLASSIC_SIDE" 4 "SIDE_CLASSIC" ;
VAL_ 212 VFC_Obj18A_HeadOrientation 0 "N/A" 1 "Head front" 2 "Head left front" 3 "Head left" 4 "Head left back" 5 "Head back" 6 "Head right back" 7 "Head right" 8 "Head right front" 15 "Unknown" ;
VAL_ 212 VFC_Obj18A_Type 0 "No type" 1 "Car" 2 "Truck" 3 "Motorcycle" 4 "Pedestrian" 5 "Cyclist" 6 "Animal" ;
VAL_ 213 VFC_Obj18B_LineEdgeRightEgo 0 "Right" 1 "Not Right" ;
VAL_ 213 VFC_Obj18B_LineEdgeLeftEgo 0 "Left" 1 "Not Left" ;
VAL_ 213 VFC_Obj18B_CompletelyInImg 0 "completely measured" 1 "not completely measured" ;
VAL_ 213 VFC_Obj18B_DirIndicator 0 "No direction indicator" 1 "Left indicator" 2 "Right indicator" 3 "Warning Lights" 4 "Unknown" ;
VAL_ 213 VFC_Obj18B_BrakeLight 0 "No light detected" 1 "One light detected" 2 "Two lights detected" 3 "Three lights detected" 4 "Unknown" ;
VAL_ 213 VFC_Obj18B_MeasSource 1 "MOD" 2 "PDET" 4 "OFT" 8 "OLS" 16 "Reserved" ;
VAL_ 213 VFC_Obj18B_Reliab 1 "Classifier Path" 2 "Flow Path" 4 "Disparity Path" 8 "Semantic Segmentation Path" 16 "Flow Stixel Path" 32 "Reserved" ;
