VERSION "created by canmatrix"

NS_ :

BS_:

BU_: RadarFrontCenter VideoFrontCenter RadarFrontLeft RadarFrontRight ReceiveECU

BO_ 925 RFL_Obj07: 64 RadarFrontLeft
 SG_ RFL_Obj07_CRC : 0|16@1+ (1,0) [0|65535] ""  VideoFrontCenter
 SG_ RFL_Obj07_AliveCtr : 16|8@1+ (1,0) [0|255] ""  VideoFrontCenter
 SG_ RFL_Obj07_ProtBlockCtr : 24|4@1+ (1,0) [0|15] ""  VideoFrontCenter
 SG_ RFL_Obj07_ReferencePoint : 28|4@1+ (1,0) [0|15] ""  VideoFrontCenter
 SG_ RFL_Obj07_ObjId : 32|7@1+ (1,0) [0|127] ""  VideoFrontCenter
 SG_ RFL_Obj07_MeasurementStatus : 39|1@1+ (1,0) [0|1] ""  VideoFrontCenter
 SG_ RFL_Obj07_Px : 40|13@1+ (0.0625,-256) [-256|255.9375] "m"  VideoFrontCenter
 SG_ RFL_Obj07_Py : 53|11@1+ (0.125,-128) [-128|127.875] "m"  VideoFrontCenter
 SG_ RFL_Obj07_PxVnce : 64|12@1+ (0.01,0) [0|30] "m^2"  VideoFrontCenter
 SG_ RFL_Obj07_PyVnce : 76|12@1+ (0.01,0) [0|30] "m^2"  VideoFrontCenter
 SG_ RFL_Obj07_Vx : 88|12@1+ (0.0625,-128) [-128|127.9375] "m/s"  VideoFrontCenter
 SG_ RFL_Obj07_Vy : 100|10@1+ (0.125,-64) [-64|63.875] "m/s"  VideoFrontCenter
 SG_ RFL_Obj07_Ax : 110|10@1+ (0.03125,-16) [-16|15.96875] "m/s^2"  VideoFrontCenter
 SG_ RFL_Obj07_Ay : 120|9@1+ (0.0625,-16) [-16|15.9375] "m/s^2"  VideoFrontCenter
 SG_ RFL_Obj07_OrientationYaw : 129|9@1+ (0.0175,-4.48) [-3.15|3.15] "rad"  VideoFrontCenter
 SG_ RFL_Obj07_ExistProb : 138|6@1+ (2,0) [0|100] "%"  VideoFrontCenter
 SG_ RFL_Obj07_VxVnce : 144|12@1+ (0.01,0) [0|30] "m^2/s^2"  VideoFrontCenter
 SG_ RFL_Obj07_VyVnce : 156|12@1+ (0.01,0) [0|30] "m^2/s^2"  VideoFrontCenter
 SG_ RFL_Obj07_AxVnce : 168|12@1+ (0.01,0) [0|30] "m^2/s^4"  VideoFrontCenter
 SG_ RFL_Obj07_AyVnce : 180|12@1+ (0.01,0) [0|30] "m^2/s^4"  VideoFrontCenter
 SG_ RFL_Obj07_OrientationYawVnce : 192|12@1+ (0.0003,0) [0|1] "rad^2"  VideoFrontCenter
 SG_ RFL_Obj07_MovingObserved : 204|6@1+ (2,0) [0|100] "%"  VideoFrontCenter
 SG_ RFL_Obj07_MovingProbability : 210|6@1+ (2,0) [0|100] "%"  VideoFrontCenter
 SG_ RFL_Obj07_Length : 216|7@1+ (0.125,0) [0|15.875] "m"  VideoFrontCenter
 SG_ RFL_Obj07_Valid : 223|1@1+ (1,0) [0|1] ""  VideoFrontCenter
 SG_ RFL_Obj07_LengthVnce : 224|12@1+ (0.01,0) [0|30] "m^2"  VideoFrontCenter
 SG_ RFL_Obj07_WidthVnce : 236|12@1+ (0.01,0) [0|30] "m^2"  VideoFrontCenter
 SG_ RFL_Obj07_Width : 248|7@1+ (0.125,0) [0|15.875] "m"  VideoFrontCenter
 SG_ RFL_Obj07_BehaviorType : 255|3@1+ (1,0) [0|7] ""  VideoFrontCenter
 SG_ RFL_Obj07_ObstacleConf : 258|6@1+ (2,0) [0|100] "%"  VideoFrontCenter
 SG_ RFL_Obj07_NonObstacleConf : 264|6@1+ (2,0) [0|100] "%"  VideoFrontCenter
 SG_ RFL_Obj07_PxPyCoVnce : 272|12@1+ (0.01,0) [0|30] "m^2"  VideoFrontCenter
 SG_ RFL_Obj07_PxVxCoVnce : 284|12@1+ (0.01,0) [0|30] "m^2/s"  VideoFrontCenter
 SG_ RFL_Obj07_PxVyCoVnce : 296|12@1+ (0.01,0) [0|30] "m^2/s"  VideoFrontCenter
 SG_ RFL_Obj07_PyVxCoVnce : 308|12@1+ (0.01,0) [0|30] "m^2/s"  VideoFrontCenter
 SG_ RFL_Obj07_PyVyCoVnce : 320|12@1+ (0.01,0) [0|30] "m^2/s"  VideoFrontCenter
 SG_ RFL_Obj07_VxVyCoVnce : 332|12@1+ (0.01,0) [0|30] "m^2/s^2"  VideoFrontCenter
 SG_ RFL_Obj07_PxAxCoVnce : 344|12@1+ (0.01,0) [0|30] "m^2/s^2"  VideoFrontCenter
 SG_ RFL_Obj07_PxAyCoVnce : 356|12@1+ (0.01,0) [0|30] "m^2/s^2"  VideoFrontCenter
 SG_ RFL_Obj07_PyAxCoVnce : 368|12@1+ (0.01,0) [0|30] "m^2/s^2"  VideoFrontCenter
 SG_ RFL_Obj07_PyAyCoVnce : 380|12@1+ (0.01,0) [0|30] "m^2/s^2"  VideoFrontCenter
 SG_ RFL_Obj07_VxAxCoVnce : 392|12@1+ (0.01,0) [0|30] "m^2/s^3"  VideoFrontCenter
 SG_ RFL_Obj07_VxAyCoVnce : 404|12@1+ (0.01,0) [0|30] "m^2/s^3"  VideoFrontCenter
 SG_ RFL_Obj07_VyAxCoVnce : 416|12@1+ (0.01,0) [0|30] "m^2/s^3"  VideoFrontCenter
 SG_ RFL_Obj07_VyAyCoVnce : 428|12@1+ (0.01,0) [0|30] "m^2/s^3"  VideoFrontCenter
 SG_ RFL_Obj07_AxAyCoVnce : 440|12@1+ (0.01,0) [0|30] "m^2/s^4"  VideoFrontCenter
 SG_ RFL_Obj07_MobileObstConf : 452|6@1+ (2,0) [0|100] "%"  VideoFrontCenter
 SG_ RFL_Obj07_Mob4PlusWhlConf : 458|6@1+ (2,0) [0|100] "%"  VideoFrontCenter
 SG_ RFL_Obj07_Mob2WhlConf : 464|6@1+ (2,0) [0|100] "%"  VideoFrontCenter
 SG_ RFL_Obj07_MobPedConf : 470|6@1+ (2,0) [0|100] "%"  VideoFrontCenter
 SG_ RFL_Obj07_FourPlusWhlCarConf : 476|6@1+ (2,0) [0|100] "%"  VideoFrontCenter
 SG_ RFL_Obj07_FourPlusWhlHGVConf : 482|6@1+ (2,0) [0|100] "%"  VideoFrontCenter
 SG_ RFL_Obj07_GroundReflexConf : 488|6@1+ (2,0) [0|100] "%"  VideoFrontCenter
 SG_ RFL_Obj07_StatObstConf : 494|6@1+ (2,0) [0|100] "%"  VideoFrontCenter
 SG_ RFL_Obj07_StatBarrierConf : 500|6@1+ (2,0) [0|100] "%"  VideoFrontCenter

BO_ 926 RFL_Obj08: 64 RadarFrontLeft
 SG_ RFL_Obj08_CRC : 0|16@1+ (1,0) [0|65535] ""  VideoFrontCenter
 SG_ RFL_Obj08_AliveCtr : 16|8@1+ (1,0) [0|255] ""  VideoFrontCenter
 SG_ RFL_Obj08_ProtBlockCtr : 24|4@1+ (1,0) [0|15] ""  VideoFrontCenter
 SG_ RFL_Obj08_ReferencePoint : 28|4@1+ (1,0) [0|15] ""  VideoFrontCenter
 SG_ RFL_Obj08_ObjId : 32|7@1+ (1,0) [0|127] ""  VideoFrontCenter
 SG_ RFL_Obj08_MeasurementStatus : 39|1@1+ (1,0) [0|1] ""  VideoFrontCenter
 SG_ RFL_Obj08_Px : 40|13@1+ (0.0625,-256) [-256|255.9375] "m"  VideoFrontCenter
 SG_ RFL_Obj08_Py : 53|11@1+ (0.125,-128) [-128|127.875] "m"  VideoFrontCenter
 SG_ RFL_Obj08_PxVnce : 64|12@1+ (0.01,0) [0|30] "m^2"  VideoFrontCenter
 SG_ RFL_Obj08_PyVnce : 76|12@1+ (0.01,0) [0|30] "m^2"  VideoFrontCenter
 SG_ RFL_Obj08_Vx : 88|12@1+ (0.0625,-128) [-128|127.9375] "m/s"  VideoFrontCenter
 SG_ RFL_Obj08_Vy : 100|10@1+ (0.125,-64) [-64|63.875] "m/s"  VideoFrontCenter
 SG_ RFL_Obj08_Ax : 110|10@1+ (0.03125,-16) [-16|15.96875] "m/s^2"  VideoFrontCenter
 SG_ RFL_Obj08_Ay : 120|9@1+ (0.0625,-16) [-16|15.9375] "m/s^2"  VideoFrontCenter
 SG_ RFL_Obj08_OrientationYaw : 129|9@1+ (0.0175,-4.48) [-3.15|3.15] "rad"  VideoFrontCenter
 SG_ RFL_Obj08_ExistProb : 138|6@1+ (2,0) [0|100] "%"  VideoFrontCenter
 SG_ RFL_Obj08_VxVnce : 144|12@1+ (0.01,0) [0|30] "m^2/s^2"  VideoFrontCenter
 SG_ RFL_Obj08_VyVnce : 156|12@1+ (0.01,0) [0|30] "m^2/s^2"  VideoFrontCenter
 SG_ RFL_Obj08_AxVnce : 168|12@1+ (0.01,0) [0|30] "m^2/s^4"  VideoFrontCenter
 SG_ RFL_Obj08_AyVnce : 180|12@1+ (0.01,0) [0|30] "m^2/s^4"  VideoFrontCenter
 SG_ RFL_Obj08_OrientationYawVnce : 192|12@1+ (0.0003,0) [0|1] "rad^2"  VideoFrontCenter
 SG_ RFL_Obj08_MovingObserved : 204|6@1+ (2,0) [0|100] "%"  VideoFrontCenter
 SG_ RFL_Obj08_MovingProbability : 210|6@1+ (2,0) [0|100] "%"  VideoFrontCenter
 SG_ RFL_Obj08_Length : 216|7@1+ (0.125,0) [0|15.875] "m"  VideoFrontCenter
 SG_ RFL_Obj08_Valid : 223|1@1+ (1,0) [0|1] ""  VideoFrontCenter
 SG_ RFL_Obj08_LengthVnce : 224|12@1+ (0.01,0) [0|30] "m^2"  VideoFrontCenter
 SG_ RFL_Obj08_WidthVnce : 236|12@1+ (0.01,0) [0|30] "m^2"  VideoFrontCenter
 SG_ RFL_Obj08_Width : 248|7@1+ (0.125,0) [0|15.875] "m"  VideoFrontCenter
 SG_ RFL_Obj08_BehaviorType : 255|3@1+ (1,0) [0|7] ""  VideoFrontCenter
 SG_ RFL_Obj08_ObstacleConf : 258|6@1+ (2,0) [0|100] "%"  VideoFrontCenter
 SG_ RFL_Obj08_NonObstacleConf : 264|6@1+ (2,0) [0|100] "%"  VideoFrontCenter
 SG_ RFL_Obj08_PxPyCoVnce : 272|12@1+ (0.01,0) [0|30] "m^2"  VideoFrontCenter
 SG_ RFL_Obj08_PxVxCoVnce : 284|12@1+ (0.01,0) [0|30] "m^2/s"  VideoFrontCenter
 SG_ RFL_Obj08_PxVyCoVnce : 296|12@1+ (0.01,0) [0|30] "m^2/s"  VideoFrontCenter
 SG_ RFL_Obj08_PyVxCoVnce : 308|12@1+ (0.01,0) [0|30] "m^2/s"  VideoFrontCenter
 SG_ RFL_Obj08_PyVyCoVnce : 320|12@1+ (0.01,0) [0|30] "m^2/s"  VideoFrontCenter
 SG_ RFL_Obj08_VxVyCoVnce : 332|12@1+ (0.01,0) [0|30] "m^2/s^2"  VideoFrontCenter
 SG_ RFL_Obj08_PxAxCoVnce : 344|12@1+ (0.01,0) [0|30] "m^2/s^2"  VideoFrontCenter
 SG_ RFL_Obj08_PxAyCoVnce : 356|12@1+ (0.01,0) [0|30] "m^2/s^2"  VideoFrontCenter
 SG_ RFL_Obj08_PyAxCoVnce : 368|12@1+ (0.01,0) [0|30] "m^2/s^2"  VideoFrontCenter
 SG_ RFL_Obj08_PyAyCoVnce : 380|12@1+ (0.01,0) [0|30] "m^2/s^2"  VideoFrontCenter
 SG_ RFL_Obj08_VxAxCoVnce : 392|12@1+ (0.01,0) [0|30] "m^2/s^3"  VideoFrontCenter
 SG_ RFL_Obj08_VxAyCoVnce : 404|12@1+ (0.01,0) [0|30] "m^2/s^3"  VideoFrontCenter
 SG_ RFL_Obj08_VyAxCoVnce : 416|12@1+ (0.01,0) [0|30] "m^2/s^3"  VideoFrontCenter
 SG_ RFL_Obj08_VyAyCoVnce : 428|12@1+ (0.01,0) [0|30] "m^2/s^3"  VideoFrontCenter
 SG_ RFL_Obj08_AxAyCoVnce : 440|12@1+ (0.01,0) [0|30] "m^2/s^4"  VideoFrontCenter
 SG_ RFL_Obj08_MobileObstConf : 452|6@1+ (2,0) [0|100] "%"  VideoFrontCenter
 SG_ RFL_Obj08_Mob4PlusWhlConf : 458|6@1+ (2,0) [0|100] "%"  VideoFrontCenter
 SG_ RFL_Obj08_Mob2WhlConf : 464|6@1+ (2,0) [0|100] "%"  VideoFrontCenter
 SG_ RFL_Obj08_MobPedConf : 470|6@1+ (2,0) [0|100] "%"  VideoFrontCenter
 SG_ RFL_Obj08_FourPlusWhlCarConf : 476|6@1+ (2,0) [0|100] "%"  VideoFrontCenter
 SG_ RFL_Obj08_FourPlusWhlHGVConf : 482|6@1+ (2,0) [0|100] "%"  VideoFrontCenter
 SG_ RFL_Obj08_GroundReflexConf : 488|6@1+ (2,0) [0|100] "%"  VideoFrontCenter
 SG_ RFL_Obj08_StatObstConf : 494|6@1+ (2,0) [0|100] "%"  VideoFrontCenter
 SG_ RFL_Obj08_StatBarrierConf : 500|6@1+ (2,0) [0|100] "%"  VideoFrontCenter

BO_ 927 RFL_Obj09: 64 RadarFrontLeft
 SG_ RFL_Obj09_CRC : 0|16@1+ (1,0) [0|65535] ""  VideoFrontCenter
 SG_ RFL_Obj09_AliveCtr : 16|8@1+ (1,0) [0|255] ""  VideoFrontCenter
 SG_ RFL_Obj09_ProtBlockCtr : 24|4@1+ (1,0) [0|15] ""  VideoFrontCenter
 SG_ RFL_Obj09_ReferencePoint : 28|4@1+ (1,0) [0|15] ""  VideoFrontCenter
 SG_ RFL_Obj09_ObjId : 32|7@1+ (1,0) [0|127] ""  VideoFrontCenter
 SG_ RFL_Obj09_MeasurementStatus : 39|1@1+ (1,0) [0|1] ""  VideoFrontCenter
 SG_ RFL_Obj09_Px : 40|13@1+ (0.0625,-256) [-256|255.9375] "m"  VideoFrontCenter
 SG_ RFL_Obj09_Py : 53|11@1+ (0.125,-128) [-128|127.875] "m"  VideoFrontCenter
 SG_ RFL_Obj09_PxVnce : 64|12@1+ (0.01,0) [0|30] "m^2"  VideoFrontCenter
 SG_ RFL_Obj09_PyVnce : 76|12@1+ (0.01,0) [0|30] "m^2"  VideoFrontCenter
 SG_ RFL_Obj09_Vx : 88|12@1+ (0.0625,-128) [-128|127.9375] "m/s"  VideoFrontCenter
 SG_ RFL_Obj09_Vy : 100|10@1+ (0.125,-64) [-64|63.875] "m/s"  VideoFrontCenter
 SG_ RFL_Obj09_Ax : 110|10@1+ (0.03125,-16) [-16|15.96875] "m/s^2"  VideoFrontCenter
 SG_ RFL_Obj09_Ay : 120|9@1+ (0.0625,-16) [-16|15.9375] "m/s^2"  VideoFrontCenter
 SG_ RFL_Obj09_OrientationYaw : 129|9@1+ (0.0175,-4.48) [-3.15|3.15] "rad"  VideoFrontCenter
 SG_ RFL_Obj09_ExistProb : 138|6@1+ (2,0) [0|100] "%"  VideoFrontCenter
 SG_ RFL_Obj09_VxVnce : 144|12@1+ (0.01,0) [0|30] "m^2/s^2"  VideoFrontCenter
 SG_ RFL_Obj09_VyVnce : 156|12@1+ (0.01,0) [0|30] "m^2/s^2"  VideoFrontCenter
 SG_ RFL_Obj09_AxVnce : 168|12@1+ (0.01,0) [0|30] "m^2/s^4"  VideoFrontCenter
 SG_ RFL_Obj09_AyVnce : 180|12@1+ (0.01,0) [0|30] "m^2/s^4"  VideoFrontCenter
 SG_ RFL_Obj09_OrientationYawVnce : 192|12@1+ (0.0003,0) [0|1] "rad^2"  VideoFrontCenter
 SG_ RFL_Obj09_MovingObserved : 204|6@1+ (2,0) [0|100] "%"  VideoFrontCenter
 SG_ RFL_Obj09_MovingProbability : 210|6@1+ (2,0) [0|100] "%"  VideoFrontCenter
 SG_ RFL_Obj09_Length : 216|7@1+ (0.125,0) [0|15.875] "m"  VideoFrontCenter
 SG_ RFL_Obj09_Valid : 223|1@1+ (1,0) [0|1] ""  VideoFrontCenter
 SG_ RFL_Obj09_LengthVnce : 224|12@1+ (0.01,0) [0|30] "m^2"  VideoFrontCenter
 SG_ RFL_Obj09_WidthVnce : 236|12@1+ (0.01,0) [0|30] "m^2"  VideoFrontCenter
 SG_ RFL_Obj09_Width : 248|7@1+ (0.125,0) [0|15.875] "m"  VideoFrontCenter
 SG_ RFL_Obj09_BehaviorType : 255|3@1+ (1,0) [0|7] ""  VideoFrontCenter
 SG_ RFL_Obj09_ObstacleConf : 258|6@1+ (2,0) [0|100] "%"  VideoFrontCenter
 SG_ RFL_Obj09_NonObstacleConf : 264|6@1+ (2,0) [0|100] "%"  VideoFrontCenter
 SG_ RFL_Obj09_PxPyCoVnce : 272|12@1+ (0.01,0) [0|30] "m^2"  VideoFrontCenter
 SG_ RFL_Obj09_PxVxCoVnce : 284|12@1+ (0.01,0) [0|30] "m^2/s"  VideoFrontCenter
 SG_ RFL_Obj09_PxVyCoVnce : 296|12@1+ (0.01,0) [0|30] "m^2/s"  VideoFrontCenter
 SG_ RFL_Obj09_PyVxCoVnce : 308|12@1+ (0.01,0) [0|30] "m^2/s"  VideoFrontCenter
 SG_ RFL_Obj09_PyVyCoVnce : 320|12@1+ (0.01,0) [0|30] "m^2/s"  VideoFrontCenter
 SG_ RFL_Obj09_VxVyCoVnce : 332|12@1+ (0.01,0) [0|30] "m^2/s^2"  VideoFrontCenter
 SG_ RFL_Obj09_PxAxCoVnce : 344|12@1+ (0.01,0) [0|30] "m^2/s^2"  VideoFrontCenter
 SG_ RFL_Obj09_PxAyCoVnce : 356|12@1+ (0.01,0) [0|30] "m^2/s^2"  VideoFrontCenter
 SG_ RFL_Obj09_PyAxCoVnce : 368|12@1+ (0.01,0) [0|30] "m^2/s^2"  VideoFrontCenter
 SG_ RFL_Obj09_PyAyCoVnce : 380|12@1+ (0.01,0) [0|30] "m^2/s^2"  VideoFrontCenter
 SG_ RFL_Obj09_VxAxCoVnce : 392|12@1+ (0.01,0) [0|30] "m^2/s^3"  VideoFrontCenter
 SG_ RFL_Obj09_VxAyCoVnce : 404|12@1+ (0.01,0) [0|30] "m^2/s^3"  VideoFrontCenter
 SG_ RFL_Obj09_VyAxCoVnce : 416|12@1+ (0.01,0) [0|30] "m^2/s^3"  VideoFrontCenter
 SG_ RFL_Obj09_VyAyCoVnce : 428|12@1+ (0.01,0) [0|30] "m^2/s^3"  VideoFrontCenter
 SG_ RFL_Obj09_AxAyCoVnce : 440|12@1+ (0.01,0) [0|30] "m^2/s^4"  VideoFrontCenter
 SG_ RFL_Obj09_MobileObstConf : 452|6@1+ (2,0) [0|100] "%"  VideoFrontCenter
 SG_ RFL_Obj09_Mob4PlusWhlConf : 458|6@1+ (2,0) [0|100] "%"  VideoFrontCenter
 SG_ RFL_Obj09_Mob2WhlConf : 464|6@1+ (2,0) [0|100] "%"  VideoFrontCenter
 SG_ RFL_Obj09_MobPedConf : 470|6@1+ (2,0) [0|100] "%"  VideoFrontCenter
 SG_ RFL_Obj09_FourPlusWhlCarConf : 476|6@1+ (2,0) [0|100] "%"  VideoFrontCenter
 SG_ RFL_Obj09_FourPlusWhlHGVConf : 482|6@1+ (2,0) [0|100] "%"  VideoFrontCenter
 SG_ RFL_Obj09_GroundReflexConf : 488|6@1+ (2,0) [0|100] "%"  VideoFrontCenter
 SG_ RFL_Obj09_StatObstConf : 494|6@1+ (2,0) [0|100] "%"  VideoFrontCenter
 SG_ RFL_Obj09_StatBarrierConf : 500|6@1+ (2,0) [0|100] "%"  VideoFrontCenter

BO_ 1172 RFR_ObjHdr: 48 RadarFrontRight
 SG_ RFR_ObjHdr_CRC : 0|16@1+ (1,0) [0|65535] ""  VideoFrontCenter
 SG_ RFR_ObjHdr_AliveCtr : 16|8@1+ (1,0) [0|255] ""  VideoFrontCenter
 SG_ RFR_ObjHdr_ProtBlockCtr : 24|4@1+ (1,0) [0|15] ""  VideoFrontCenter
 SG_ RFR_ObjHdr_IfVersionIdMajor : 32|8@1+ (1,0) [0|255] ""  VideoFrontCenter
 SG_ RFR_ObjHdr_IfVersionIdMinor : 40|8@1+ (1,0) [0|255] ""  VideoFrontCenter
 SG_ RFR_ObjHdr_NumValidObjects : 48|6@1+ (1,0) [0|40] ""  VideoFrontCenter
 SG_ RFR_ObjHdr_TimeStampStatus : 56|8@1+ (1,0) [0|255] ""  VideoFrontCenter
 SG_ RFR_ObjHdr_TimeStamp : 64|26@1+ (1,0) [0|67108863] "ms"  VideoFrontCenter
 SG_ RFR_ObjHdr_SensorState : 96|8@1+ (1,0) [0|255] ""  VideoFrontCenter
 SG_ RFR_ObjHdr_AziOutOfSpec : 109|1@1+ (1,0) [0|1] ""  VideoFrontCenter
 SG_ RFR_ObjHdr_ElevOutOfSpec : 110|1@1+ (1,0) [0|1] ""  VideoFrontCenter
 SG_ RFR_ObjHdr_ObjectDownSel : 111|1@1+ (1,0) [0|1] ""  VideoFrontCenter
 SG_ RFR_ObjHdr_SensorOriginPointY : 112|8@1+ (0.01,-1.28) [-1.28|1.27] "m"  VideoFrontCenter
 SG_ RFR_ObjHdr_SensorOriginPointX : 120|9@1+ (0.02,-5.12) [-5.12|5.1] "m"  VideoFrontCenter
 SG_ RFR_ObjHdr_SensorOriginPointZ : 129|5@1+ (0.05,0) [0|1.55] "m"  VideoFrontCenter
 SG_ RFR_ObjHdr_SensorOrientYaw : 136|16@1+ (0.00017,-5.57056) [-3.2|3.2] "rad"  VideoFrontCenter
 SG_ RFR_ObjHdr_SensorOrientPitch : 152|12@1+ (0.00017,-0.34816) [-0.34816|0.34799] "rad"  VideoFrontCenter
 SG_ RFR_ObjHdr_SensorOrientRoll : 164|12@1+ (0.00017,-0.34816) [-0.2|0.2] "rad"  VideoFrontCenter
 SG_ RFR_ObjHdr_FovAzimuthBegin : 176|15@1+ (0.00017,-2.78528) [-1.6|1.6] "rad"  VideoFrontCenter
 SG_ RFR_ObjHdr_FovAzimuthEnd : 192|15@1+ (0.00017,-2.78528) [-1.6|1.6] "rad"  VideoFrontCenter
 SG_ RFR_ObjHdr_FovElevationBegin : 208|12@1+ (0.00017,-0.34816) [-0.34816|0.34799] "rad"  VideoFrontCenter
 SG_ RFR_ObjHdr_FovElevationEnd : 220|12@1+ (0.00017,-0.34816) [-0.34816|0.34799] "rad"  VideoFrontCenter
 SG_ RFR_ObjHdr_DetectionRange : 232|9@1+ (1,0) [0|511] "m"  VideoFrontCenter
 SG_ RFR_ObjHdr_TimeStampLocal : 248|26@1+ (1,0) [0|67108863] "ms"  VideoFrontCenter

BO_ 1174 RFR_Obj00: 64 RadarFrontRight
 SG_ RFR_Obj00_CRC : 0|16@1+ (1,0) [0|65535] ""  VideoFrontCenter
 SG_ RFR_Obj00_AliveCtr : 16|8@1+ (1,0) [0|255] ""  VideoFrontCenter
 SG_ RFR_Obj00_ProtBlockCtr : 24|4@1+ (1,0) [0|15] ""  VideoFrontCenter
 SG_ RFR_Obj00_ReferencePoint : 28|4@1+ (1,0) [0|15] ""  VideoFrontCenter
 SG_ RFR_Obj00_ObjId : 32|7@1+ (1,0) [0|127] ""  VideoFrontCenter
 SG_ RFR_Obj00_MeasurementStatus : 39|1@1+ (1,0) [0|1] ""  VideoFrontCenter
 SG_ RFR_Obj00_Px : 40|13@1+ (0.0625,-256) [-256|255.9375] "m"  VideoFrontCenter
 SG_ RFR_Obj00_Py : 53|11@1+ (0.125,-128) [-128|127.875] "m"  VideoFrontCenter
 SG_ RFR_Obj00_PxVnce : 64|12@1+ (0.01,0) [0|30] "m^2"  VideoFrontCenter
 SG_ RFR_Obj00_PyVnce : 76|12@1+ (0.01,0) [0|30] "m^2"  VideoFrontCenter
 SG_ RFR_Obj00_Vx : 88|12@1+ (0.0625,-128) [-128|127.9375] "m/s"  VideoFrontCenter
 SG_ RFR_Obj00_Vy : 100|10@1+ (0.125,-64) [-64|63.875] "m/s"  VideoFrontCenter
 SG_ RFR_Obj00_Ax : 110|10@1+ (0.03125,-16) [-16|15.96875] "m/s^2"  VideoFrontCenter
 SG_ RFR_Obj00_Ay : 120|9@1+ (0.0625,-16) [-16|15.9375] "m/s^2"  VideoFrontCenter
 SG_ RFR_Obj00_OrientationYaw : 129|9@1+ (0.0175,-4.48) [-3.15|3.15] "rad"  VideoFrontCenter
 SG_ RFR_Obj00_ExistProb : 138|6@1+ (2,0) [0|100] "%"  VideoFrontCenter
 SG_ RFR_Obj00_VxVnce : 144|12@1+ (0.01,0) [0|30] "m^2/s^2"  VideoFrontCenter
 SG_ RFR_Obj00_VyVnce : 156|12@1+ (0.01,0) [0|30] "m^2/s^2"  VideoFrontCenter
 SG_ RFR_Obj00_AxVnce : 168|12@1+ (0.01,0) [0|30] "m^2/s^4"  VideoFrontCenter
 SG_ RFR_Obj00_AyVnce : 180|12@1+ (0.01,0) [0|30] "m^2/s^4"  VideoFrontCenter
 SG_ RFR_Obj00_OrientationYawVnce : 192|12@1+ (0.0003,0) [0|1] "rad^2"  VideoFrontCenter
 SG_ RFR_Obj00_MovingObserved : 204|6@1+ (2,0) [0|100] "%"  VideoFrontCenter
 SG_ RFR_Obj00_MovingProbability : 210|6@1+ (2,0) [0|100] "%"  VideoFrontCenter
 SG_ RFR_Obj00_Length : 216|7@1+ (0.125,0) [0|15.875] "m"  VideoFrontCenter
 SG_ RFR_Obj00_Valid : 223|1@1+ (1,0) [0|1] ""  VideoFrontCenter
 SG_ RFR_Obj00_LengthVnce : 224|12@1+ (0.01,0) [0|30] "m^2"  VideoFrontCenter
 SG_ RFR_Obj00_WidthVnce : 236|12@1+ (0.01,0) [0|30] "m^2"  VideoFrontCenter
 SG_ RFR_Obj00_Width : 248|7@1+ (0.125,0) [0|15.875] "m"  VideoFrontCenter
 SG_ RFR_Obj00_BehaviorType : 255|3@1+ (1,0) [0|7] ""  VideoFrontCenter
 SG_ RFR_Obj00_ObstacleConf : 258|6@1+ (2,0) [0|100] "%"  VideoFrontCenter
 SG_ RFR_Obj00_NonObstacleConf : 264|6@1+ (2,0) [0|100] "%"  VideoFrontCenter
 SG_ RFR_Obj00_PxPyCoVnce : 272|12@1+ (0.01,0) [0|30] "m^2"  VideoFrontCenter
 SG_ RFR_Obj00_PxVxCoVnce : 284|12@1+ (0.01,0) [0|30] "m^2/s"  VideoFrontCenter
 SG_ RFR_Obj00_PxVyCoVnce : 296|12@1+ (0.01,0) [0|30] "m^2/s"  VideoFrontCenter
 SG_ RFR_Obj00_PyVxCoVnce : 308|12@1+ (0.01,0) [0|30] "m^2/s"  VideoFrontCenter
 SG_ RFR_Obj00_PyVyCoVnce : 320|12@1+ (0.01,0) [0|30] "m^2/s"  VideoFrontCenter
 SG_ RFR_Obj00_VxVyCoVnce : 332|12@1+ (0.01,0) [0|30] "m^2/s^2"  VideoFrontCenter
 SG_ RFR_Obj00_PxAxCoVnce : 344|12@1+ (0.01,0) [0|30] "m^2/s^2"  VideoFrontCenter
 SG_ RFR_Obj00_PxAyCoVnce : 356|12@1+ (0.01,0) [0|30] "m^2/s^2"  VideoFrontCenter
 SG_ RFR_Obj00_PyAxCoVnce : 368|12@1+ (0.01,0) [0|30] "m^2/s^2"  VideoFrontCenter
 SG_ RFR_Obj00_PyAyCoVnce : 380|12@1+ (0.01,0) [0|30] "m^2/s^2"  VideoFrontCenter
 SG_ RFR_Obj00_VxAxCoVnce : 392|12@1+ (0.01,0) [0|30] "m^2/s^3"  VideoFrontCenter
 SG_ RFR_Obj00_VxAyCoVnce : 404|12@1+ (0.01,0) [0|30] "m^2/s^3"  VideoFrontCenter
 SG_ RFR_Obj00_VyAxCoVnce : 416|12@1+ (0.01,0) [0|30] "m^2/s^3"  VideoFrontCenter
 SG_ RFR_Obj00_VyAyCoVnce : 428|12@1+ (0.01,0) [0|30] "m^2/s^3"  VideoFrontCenter
 SG_ RFR_Obj00_AxAyCoVnce : 440|12@1+ (0.01,0) [0|30] "m^2/s^4"  VideoFrontCenter
 SG_ RFR_Obj00_MobileObstConf : 452|6@1+ (2,0) [0|100] "%"  VideoFrontCenter
 SG_ RFR_Obj00_Mob4PlusWhlConf : 458|6@1+ (2,0) [0|100] "%"  VideoFrontCenter
 SG_ RFR_Obj00_Mob2WhlConf : 464|6@1+ (2,0) [0|100] "%"  VideoFrontCenter
 SG_ RFR_Obj00_MobPedConf : 470|6@1+ (2,0) [0|100] "%"  VideoFrontCenter
 SG_ RFR_Obj00_FourPlusWhlCarConf : 476|6@1+ (2,0) [0|100] "%"  VideoFrontCenter
 SG_ RFR_Obj00_FourPlusWhlHGVConf : 482|6@1+ (2,0) [0|100] "%"  VideoFrontCenter
 SG_ RFR_Obj00_GroundReflexConf : 488|6@1+ (2,0) [0|100] "%"  VideoFrontCenter
 SG_ RFR_Obj00_StatObstConf : 494|6@1+ (2,0) [0|100] "%"  VideoFrontCenter
 SG_ RFR_Obj00_StatBarrierConf : 500|6@1+ (2,0) [0|100] "%"  VideoFrontCenter

BO_ 1175 RFR_Obj01: 64 RadarFrontRight
 SG_ RFR_Obj01_CRC : 0|16@1+ (1,0) [0|65535] ""  VideoFrontCenter
 SG_ RFR_Obj01_AliveCtr : 16|8@1+ (1,0) [0|255] ""  VideoFrontCenter
 SG_ RFR_Obj01_ProtBlockCtr : 24|4@1+ (1,0) [0|15] ""  VideoFrontCenter
 SG_ RFR_Obj01_ReferencePoint : 28|4@1+ (1,0) [0|15] ""  VideoFrontCenter
 SG_ RFR_Obj01_ObjId : 32|7@1+ (1,0) [0|127] ""  VideoFrontCenter
 SG_ RFR_Obj01_MeasurementStatus : 39|1@1+ (1,0) [0|1] ""  VideoFrontCenter
 SG_ RFR_Obj01_Px : 40|13@1+ (0.0625,-256) [-256|255.9375] "m"  VideoFrontCenter
 SG_ RFR_Obj01_Py : 53|11@1+ (0.125,-128) [-128|127.875] "m"  VideoFrontCenter
 SG_ RFR_Obj01_PxVnce : 64|12@1+ (0.01,0) [0|30] "m^2"  VideoFrontCenter
 SG_ RFR_Obj01_PyVnce : 76|12@1+ (0.01,0) [0|30] "m^2"  VideoFrontCenter
 SG_ RFR_Obj01_Vx : 88|12@1+ (0.0625,-128) [-128|127.9375] "m/s"  VideoFrontCenter
 SG_ RFR_Obj01_Vy : 100|10@1+ (0.125,-64) [-64|63.875] "m/s"  VideoFrontCenter
 SG_ RFR_Obj01_Ax : 110|10@1+ (0.03125,-16) [-16|15.96875] "m/s^2"  VideoFrontCenter
 SG_ RFR_Obj01_Ay : 120|9@1+ (0.0625,-16) [-16|15.9375] "m/s^2"  VideoFrontCenter
 SG_ RFR_Obj01_OrientationYaw : 129|9@1+ (0.0175,-4.48) [-3.15|3.15] "rad"  VideoFrontCenter
 SG_ RFR_Obj01_ExistProb : 138|6@1+ (2,0) [0|100] "%"  VideoFrontCenter
 SG_ RFR_Obj01_VxVnce : 144|12@1+ (0.01,0) [0|30] "m^2/s^2"  VideoFrontCenter
 SG_ RFR_Obj01_VyVnce : 156|12@1+ (0.01,0) [0|30] "m^2/s^2"  VideoFrontCenter
 SG_ RFR_Obj01_AxVnce : 168|12@1+ (0.01,0) [0|30] "m^2/s^4"  VideoFrontCenter
 SG_ RFR_Obj01_AyVnce : 180|12@1+ (0.01,0) [0|30] "m^2/s^4"  VideoFrontCenter
 SG_ RFR_Obj01_OrientationYawVnce : 192|12@1+ (0.0003,0) [0|1] "rad^2"  VideoFrontCenter
 SG_ RFR_Obj01_MovingObserved : 204|6@1+ (2,0) [0|100] "%"  VideoFrontCenter
 SG_ RFR_Obj01_MovingProbability : 210|6@1+ (2,0) [0|100] "%"  VideoFrontCenter
 SG_ RFR_Obj01_Length : 216|7@1+ (0.125,0) [0|15.875] "m"  VideoFrontCenter
 SG_ RFR_Obj01_Valid : 223|1@1+ (1,0) [0|1] ""  VideoFrontCenter
 SG_ RFR_Obj01_LengthVnce : 224|12@1+ (0.01,0) [0|30] "m^2"  VideoFrontCenter
 SG_ RFR_Obj01_WidthVnce : 236|12@1+ (0.01,0) [0|30] "m^2"  VideoFrontCenter
 SG_ RFR_Obj01_Width : 248|7@1+ (0.125,0) [0|15.875] "m"  VideoFrontCenter
 SG_ RFR_Obj01_BehaviorType : 255|3@1+ (1,0) [0|7] ""  VideoFrontCenter
 SG_ RFR_Obj01_ObstacleConf : 258|6@1+ (2,0) [0|100] "%"  VideoFrontCenter
 SG_ RFR_Obj01_NonObstacleConf : 264|6@1+ (2,0) [0|100] "%"  VideoFrontCenter
 SG_ RFR_Obj01_PxPyCoVnce : 272|12@1+ (0.01,0) [0|30] "m^2"  VideoFrontCenter
 SG_ RFR_Obj01_PxVxCoVnce : 284|12@1+ (0.01,0) [0|30] "m^2/s"  VideoFrontCenter
 SG_ RFR_Obj01_PxVyCoVnce : 296|12@1+ (0.01,0) [0|30] "m^2/s"  VideoFrontCenter
 SG_ RFR_Obj01_PyVxCoVnce : 308|12@1+ (0.01,0) [0|30] "m^2/s"  VideoFrontCenter
 SG_ RFR_Obj01_PyVyCoVnce : 320|12@1+ (0.01,0) [0|30] "m^2/s"  VideoFrontCenter
 SG_ RFR_Obj01_VxVyCoVnce : 332|12@1+ (0.01,0) [0|30] "m^2/s^2"  VideoFrontCenter
 SG_ RFR_Obj01_PxAxCoVnce : 344|12@1+ (0.01,0) [0|30] "m^2/s^2"  VideoFrontCenter
 SG_ RFR_Obj01_PxAyCoVnce : 356|12@1+ (0.01,0) [0|30] "m^2/s^2"  VideoFrontCenter
 SG_ RFR_Obj01_PyAxCoVnce : 368|12@1+ (0.01,0) [0|30] "m^2/s^2"  VideoFrontCenter
 SG_ RFR_Obj01_PyAyCoVnce : 380|12@1+ (0.01,0) [0|30] "m^2/s^2"  VideoFrontCenter
 SG_ RFR_Obj01_VxAxCoVnce : 392|12@1+ (0.01,0) [0|30] "m^2/s^3"  VideoFrontCenter
 SG_ RFR_Obj01_VxAyCoVnce : 404|12@1+ (0.01,0) [0|30] "m^2/s^3"  VideoFrontCenter
 SG_ RFR_Obj01_VyAxCoVnce : 416|12@1+ (0.01,0) [0|30] "m^2/s^3"  VideoFrontCenter
 SG_ RFR_Obj01_VyAyCoVnce : 428|12@1+ (0.01,0) [0|30] "m^2/s^3"  VideoFrontCenter
 SG_ RFR_Obj01_AxAyCoVnce : 440|12@1+ (0.01,0) [0|30] "m^2/s^4"  VideoFrontCenter
 SG_ RFR_Obj01_MobileObstConf : 452|6@1+ (2,0) [0|100] "%"  VideoFrontCenter
 SG_ RFR_Obj01_Mob4PlusWhlConf : 458|6@1+ (2,0) [0|100] "%"  VideoFrontCenter
 SG_ RFR_Obj01_Mob2WhlConf : 464|6@1+ (2,0) [0|100] "%"  VideoFrontCenter
 SG_ RFR_Obj01_MobPedConf : 470|6@1+ (2,0) [0|100] "%"  VideoFrontCenter
 SG_ RFR_Obj01_FourPlusWhlCarConf : 476|6@1+ (2,0) [0|100] "%"  VideoFrontCenter
 SG_ RFR_Obj01_FourPlusWhlHGVConf : 482|6@1+ (2,0) [0|100] "%"  VideoFrontCenter
 SG_ RFR_Obj01_GroundReflexConf : 488|6@1+ (2,0) [0|100] "%"  VideoFrontCenter
 SG_ RFR_Obj01_StatObstConf : 494|6@1+ (2,0) [0|100] "%"  VideoFrontCenter
 SG_ RFR_Obj01_StatBarrierConf : 500|6@1+ (2,0) [0|100] "%"  VideoFrontCenter

BO_ 1176 RFR_Obj02: 64 RadarFrontRight
 SG_ RFR_Obj02_CRC : 0|16@1+ (1,0) [0|65535] ""  VideoFrontCenter
 SG_ RFR_Obj02_AliveCtr : 16|8@1+ (1,0) [0|255] ""  VideoFrontCenter
 SG_ RFR_Obj02_ProtBlockCtr : 24|4@1+ (1,0) [0|15] ""  VideoFrontCenter
 SG_ RFR_Obj02_ReferencePoint : 28|4@1+ (1,0) [0|15] ""  VideoFrontCenter
 SG_ RFR_Obj02_ObjId : 32|7@1+ (1,0) [0|127] ""  VideoFrontCenter
 SG_ RFR_Obj02_MeasurementStatus : 39|1@1+ (1,0) [0|1] ""  VideoFrontCenter
 SG_ RFR_Obj02_Px : 40|13@1+ (0.0625,-256) [-256|255.9375] "m"  VideoFrontCenter
 SG_ RFR_Obj02_Py : 53|11@1+ (0.125,-128) [-128|127.875] "m"  VideoFrontCenter
 SG_ RFR_Obj02_PxVnce : 64|12@1+ (0.01,0) [0|30] "m^2"  VideoFrontCenter
 SG_ RFR_Obj02_PyVnce : 76|12@1+ (0.01,0) [0|30] "m^2"  VideoFrontCenter
 SG_ RFR_Obj02_Vx : 88|12@1+ (0.0625,-128) [-128|127.9375] "m/s"  VideoFrontCenter
 SG_ RFR_Obj02_Vy : 100|10@1+ (0.125,-64) [-64|63.875] "m/s"  VideoFrontCenter
 SG_ RFR_Obj02_Ax : 110|10@1+ (0.03125,-16) [-16|15.96875] "m/s^2"  VideoFrontCenter
 SG_ RFR_Obj02_Ay : 120|9@1+ (0.0625,-16) [-16|15.9375] "m/s^2"  VideoFrontCenter
 SG_ RFR_Obj02_OrientationYaw : 129|9@1+ (0.0175,-4.48) [-3.15|3.15] "rad"  VideoFrontCenter
 SG_ RFR_Obj02_ExistProb : 138|6@1+ (2,0) [0|100] "%"  VideoFrontCenter
 SG_ RFR_Obj02_VxVnce : 144|12@1+ (0.01,0) [0|30] "m^2/s^2"  VideoFrontCenter
 SG_ RFR_Obj02_VyVnce : 156|12@1+ (0.01,0) [0|30] "m^2/s^2"  VideoFrontCenter
 SG_ RFR_Obj02_AxVnce : 168|12@1+ (0.01,0) [0|30] "m^2/s^4"  VideoFrontCenter
 SG_ RFR_Obj02_AyVnce : 180|12@1+ (0.01,0) [0|30] "m^2/s^4"  VideoFrontCenter
 SG_ RFR_Obj02_OrientationYawVnce : 192|12@1+ (0.0003,0) [0|1] "rad^2"  VideoFrontCenter
 SG_ RFR_Obj02_MovingObserved : 204|6@1+ (2,0) [0|100] "%"  VideoFrontCenter
 SG_ RFR_Obj02_MovingProbability : 210|6@1+ (2,0) [0|100] "%"  VideoFrontCenter
 SG_ RFR_Obj02_Length : 216|7@1+ (0.125,0) [0|15.875] "m"  VideoFrontCenter
 SG_ RFR_Obj02_Valid : 223|1@1+ (1,0) [0|1] ""  VideoFrontCenter
 SG_ RFR_Obj02_LengthVnce : 224|12@1+ (0.01,0) [0|30] "m^2"  VideoFrontCenter
 SG_ RFR_Obj02_WidthVnce : 236|12@1+ (0.01,0) [0|30] "m^2"  VideoFrontCenter
 SG_ RFR_Obj02_Width : 248|7@1+ (0.125,0) [0|15.875] "m"  VideoFrontCenter
 SG_ RFR_Obj02_BehaviorType : 255|3@1+ (1,0) [0|7] ""  VideoFrontCenter
 SG_ RFR_Obj02_ObstacleConf : 258|6@1+ (2,0) [0|100] "%"  VideoFrontCenter
 SG_ RFR_Obj02_NonObstacleConf : 264|6@1+ (2,0) [0|100] "%"  VideoFrontCenter
 SG_ RFR_Obj02_PxPyCoVnce : 272|12@1+ (0.01,0) [0|30] "m^2"  VideoFrontCenter
 SG_ RFR_Obj02_PxVxCoVnce : 284|12@1+ (0.01,0) [0|30] "m^2/s"  VideoFrontCenter
 SG_ RFR_Obj02_PxVyCoVnce : 296|12@1+ (0.01,0) [0|30] "m^2/s"  VideoFrontCenter
 SG_ RFR_Obj02_PyVxCoVnce : 308|12@1+ (0.01,0) [0|30] "m^2/s"  VideoFrontCenter
 SG_ RFR_Obj02_PyVyCoVnce : 320|12@1+ (0.01,0) [0|30] "m^2/s"  VideoFrontCenter
 SG_ RFR_Obj02_VxVyCoVnce : 332|12@1+ (0.01,0) [0|30] "m^2/s^2"  VideoFrontCenter
 SG_ RFR_Obj02_PxAxCoVnce : 344|12@1+ (0.01,0) [0|30] "m^2/s^2"  VideoFrontCenter
 SG_ RFR_Obj02_PxAyCoVnce : 356|12@1+ (0.01,0) [0|30] "m^2/s^2"  VideoFrontCenter
 SG_ RFR_Obj02_PyAxCoVnce : 368|12@1+ (0.01,0) [0|30] "m^2/s^2"  VideoFrontCenter
 SG_ RFR_Obj02_PyAyCoVnce : 380|12@1+ (0.01,0) [0|30] "m^2/s^2"  VideoFrontCenter
 SG_ RFR_Obj02_VxAxCoVnce : 392|12@1+ (0.01,0) [0|30] "m^2/s^3"  VideoFrontCenter
 SG_ RFR_Obj02_VxAyCoVnce : 404|12@1+ (0.01,0) [0|30] "m^2/s^3"  VideoFrontCenter
 SG_ RFR_Obj02_VyAxCoVnce : 416|12@1+ (0.01,0) [0|30] "m^2/s^3"  VideoFrontCenter
 SG_ RFR_Obj02_VyAyCoVnce : 428|12@1+ (0.01,0) [0|30] "m^2/s^3"  VideoFrontCenter
 SG_ RFR_Obj02_AxAyCoVnce : 440|12@1+ (0.01,0) [0|30] "m^2/s^4"  VideoFrontCenter
 SG_ RFR_Obj02_MobileObstConf : 452|6@1+ (2,0) [0|100] "%"  VideoFrontCenter
 SG_ RFR_Obj02_Mob4PlusWhlConf : 458|6@1+ (2,0) [0|100] "%"  VideoFrontCenter
 SG_ RFR_Obj02_Mob2WhlConf : 464|6@1+ (2,0) [0|100] "%"  VideoFrontCenter
 SG_ RFR_Obj02_MobPedConf : 470|6@1+ (2,0) [0|100] "%"  VideoFrontCenter
 SG_ RFR_Obj02_FourPlusWhlCarConf : 476|6@1+ (2,0) [0|100] "%"  VideoFrontCenter
 SG_ RFR_Obj02_FourPlusWhlHGVConf : 482|6@1+ (2,0) [0|100] "%"  VideoFrontCenter
 SG_ RFR_Obj02_GroundReflexConf : 488|6@1+ (2,0) [0|100] "%"  VideoFrontCenter
 SG_ RFR_Obj02_StatObstConf : 494|6@1+ (2,0) [0|100] "%"  VideoFrontCenter
 SG_ RFR_Obj02_StatBarrierConf : 500|6@1+ (2,0) [0|100] "%"  VideoFrontCenter

BO_ 1177 RFR_Obj03: 64 RadarFrontRight
 SG_ RFR_Obj03_CRC : 0|16@1+ (1,0) [0|65535] ""  VideoFrontCenter
 SG_ RFR_Obj03_AliveCtr : 16|8@1+ (1,0) [0|255] ""  VideoFrontCenter
 SG_ RFR_Obj03_ProtBlockCtr : 24|4@1+ (1,0) [0|15] ""  VideoFrontCenter
 SG_ RFR_Obj03_ReferencePoint : 28|4@1+ (1,0) [0|15] ""  VideoFrontCenter
 SG_ RFR_Obj03_ObjId : 32|7@1+ (1,0) [0|127] ""  VideoFrontCenter
 SG_ RFR_Obj03_MeasurementStatus : 39|1@1+ (1,0) [0|1] ""  VideoFrontCenter
 SG_ RFR_Obj03_Px : 40|13@1+ (0.0625,-256) [-256|255.9375] "m"  VideoFrontCenter
 SG_ RFR_Obj03_Py : 53|11@1+ (0.125,-128) [-128|127.875] "m"  VideoFrontCenter
 SG_ RFR_Obj03_PxVnce : 64|12@1+ (0.01,0) [0|30] "m^2"  VideoFrontCenter
 SG_ RFR_Obj03_PyVnce : 76|12@1+ (0.01,0) [0|30] "m^2"  VideoFrontCenter
 SG_ RFR_Obj03_Vx : 88|12@1+ (0.0625,-128) [-128|127.9375] "m/s"  VideoFrontCenter
 SG_ RFR_Obj03_Vy : 100|10@1+ (0.125,-64) [-64|63.875] "m/s"  VideoFrontCenter
 SG_ RFR_Obj03_Ax : 110|10@1+ (0.03125,-16) [-16|15.96875] "m/s^2"  VideoFrontCenter
 SG_ RFR_Obj03_Ay : 120|9@1+ (0.0625,-16) [-16|15.9375] "m/s^2"  VideoFrontCenter
 SG_ RFR_Obj03_OrientationYaw : 129|9@1+ (0.0175,-4.48) [-3.15|3.15] "rad"  VideoFrontCenter
 SG_ RFR_Obj03_ExistProb : 138|6@1+ (2,0) [0|100] "%"  VideoFrontCenter
 SG_ RFR_Obj03_VxVnce : 144|12@1+ (0.01,0) [0|30] "m^2/s^2"  VideoFrontCenter
 SG_ RFR_Obj03_VyVnce : 156|12@1+ (0.01,0) [0|30] "m^2/s^2"  VideoFrontCenter
 SG_ RFR_Obj03_AxVnce : 168|12@1+ (0.01,0) [0|30] "m^2/s^4"  VideoFrontCenter
 SG_ RFR_Obj03_AyVnce : 180|12@1+ (0.01,0) [0|30] "m^2/s^4"  VideoFrontCenter
 SG_ RFR_Obj03_OrientationYawVnce : 192|12@1+ (0.0003,0) [0|1] "rad^2"  VideoFrontCenter
 SG_ RFR_Obj03_MovingObserved : 204|6@1+ (2,0) [0|100] "%"  VideoFrontCenter
 SG_ RFR_Obj03_MovingProbability : 210|6@1+ (2,0) [0|100] "%"  VideoFrontCenter
 SG_ RFR_Obj03_Length : 216|7@1+ (0.125,0) [0|15.875] "m"  VideoFrontCenter
 SG_ RFR_Obj03_Valid : 223|1@1+ (1,0) [0|1] ""  VideoFrontCenter
 SG_ RFR_Obj03_LengthVnce : 224|12@1+ (0.01,0) [0|30] "m^2"  VideoFrontCenter
 SG_ RFR_Obj03_WidthVnce : 236|12@1+ (0.01,0) [0|30] "m^2"  VideoFrontCenter
 SG_ RFR_Obj03_Width : 248|7@1+ (0.125,0) [0|15.875] "m"  VideoFrontCenter
 SG_ RFR_Obj03_BehaviorType : 255|3@1+ (1,0) [0|7] ""  VideoFrontCenter
 SG_ RFR_Obj03_ObstacleConf : 258|6@1+ (2,0) [0|100] "%"  VideoFrontCenter
 SG_ RFR_Obj03_NonObstacleConf : 264|6@1+ (2,0) [0|100] "%"  VideoFrontCenter
 SG_ RFR_Obj03_PxPyCoVnce : 272|12@1+ (0.01,0) [0|30] "m^2"  VideoFrontCenter
 SG_ RFR_Obj03_PxVxCoVnce : 284|12@1+ (0.01,0) [0|30] "m^2/s"  VideoFrontCenter
 SG_ RFR_Obj03_PxVyCoVnce : 296|12@1+ (0.01,0) [0|30] "m^2/s"  VideoFrontCenter
 SG_ RFR_Obj03_PyVxCoVnce : 308|12@1+ (0.01,0) [0|30] "m^2/s"  VideoFrontCenter
 SG_ RFR_Obj03_PyVyCoVnce : 320|12@1+ (0.01,0) [0|30] "m^2/s"  VideoFrontCenter
 SG_ RFR_Obj03_VxVyCoVnce : 332|12@1+ (0.01,0) [0|30] "m^2/s^2"  VideoFrontCenter
 SG_ RFR_Obj03_PxAxCoVnce : 344|12@1+ (0.01,0) [0|30] "m^2/s^2"  VideoFrontCenter
 SG_ RFR_Obj03_PxAyCoVnce : 356|12@1+ (0.01,0) [0|30] "m^2/s^2"  VideoFrontCenter
 SG_ RFR_Obj03_PyAxCoVnce : 368|12@1+ (0.01,0) [0|30] "m^2/s^2"  VideoFrontCenter
 SG_ RFR_Obj03_PyAyCoVnce : 380|12@1+ (0.01,0) [0|30] "m^2/s^2"  VideoFrontCenter
 SG_ RFR_Obj03_VxAxCoVnce : 392|12@1+ (0.01,0) [0|30] "m^2/s^3"  VideoFrontCenter
 SG_ RFR_Obj03_VxAyCoVnce : 404|12@1+ (0.01,0) [0|30] "m^2/s^3"  VideoFrontCenter
 SG_ RFR_Obj03_VyAxCoVnce : 416|12@1+ (0.01,0) [0|30] "m^2/s^3"  VideoFrontCenter
 SG_ RFR_Obj03_VyAyCoVnce : 428|12@1+ (0.01,0) [0|30] "m^2/s^3"  VideoFrontCenter
 SG_ RFR_Obj03_AxAyCoVnce : 440|12@1+ (0.01,0) [0|30] "m^2/s^4"  VideoFrontCenter
 SG_ RFR_Obj03_MobileObstConf : 452|6@1+ (2,0) [0|100] "%"  VideoFrontCenter
 SG_ RFR_Obj03_Mob4PlusWhlConf : 458|6@1+ (2,0) [0|100] "%"  VideoFrontCenter
 SG_ RFR_Obj03_Mob2WhlConf : 464|6@1+ (2,0) [0|100] "%"  VideoFrontCenter
 SG_ RFR_Obj03_MobPedConf : 470|6@1+ (2,0) [0|100] "%"  VideoFrontCenter
 SG_ RFR_Obj03_FourPlusWhlCarConf : 476|6@1+ (2,0) [0|100] "%"  VideoFrontCenter
 SG_ RFR_Obj03_FourPlusWhlHGVConf : 482|6@1+ (2,0) [0|100] "%"  VideoFrontCenter
 SG_ RFR_Obj03_GroundReflexConf : 488|6@1+ (2,0) [0|100] "%"  VideoFrontCenter
 SG_ RFR_Obj03_StatObstConf : 494|6@1+ (2,0) [0|100] "%"  VideoFrontCenter
 SG_ RFR_Obj03_StatBarrierConf : 500|6@1+ (2,0) [0|100] "%"  VideoFrontCenter

BO_ 1178 RFR_Obj04: 64 RadarFrontRight
 SG_ RFR_Obj04_CRC : 0|16@1+ (1,0) [0|65535] ""  VideoFrontCenter
 SG_ RFR_Obj04_AliveCtr : 16|8@1+ (1,0) [0|255] ""  VideoFrontCenter
 SG_ RFR_Obj04_ProtBlockCtr : 24|4@1+ (1,0) [0|15] ""  VideoFrontCenter
 SG_ RFR_Obj04_ReferencePoint : 28|4@1+ (1,0) [0|15] ""  VideoFrontCenter
 SG_ RFR_Obj04_ObjId : 32|7@1+ (1,0) [0|127] ""  VideoFrontCenter
 SG_ RFR_Obj04_MeasurementStatus : 39|1@1+ (1,0) [0|1] ""  VideoFrontCenter
 SG_ RFR_Obj04_Px : 40|13@1+ (0.0625,-256) [-256|255.9375] "m"  VideoFrontCenter
 SG_ RFR_Obj04_Py : 53|11@1+ (0.125,-128) [-128|127.875] "m"  VideoFrontCenter
 SG_ RFR_Obj04_PxVnce : 64|12@1+ (0.01,0) [0|30] "m^2"  VideoFrontCenter
 SG_ RFR_Obj04_PyVnce : 76|12@1+ (0.01,0) [0|30] "m^2"  VideoFrontCenter
 SG_ RFR_Obj04_Vx : 88|12@1+ (0.0625,-128) [-128|127.9375] "m/s"  VideoFrontCenter
 SG_ RFR_Obj04_Vy : 100|10@1+ (0.125,-64) [-64|63.875] "m/s"  VideoFrontCenter
 SG_ RFR_Obj04_Ax : 110|10@1+ (0.03125,-16) [-16|15.96875] "m/s^2"  VideoFrontCenter
 SG_ RFR_Obj04_Ay : 120|9@1+ (0.0625,-16) [-16|15.9375] "m/s^2"  VideoFrontCenter
 SG_ RFR_Obj04_OrientationYaw : 129|9@1+ (0.0175,-4.48) [-3.15|3.15] "rad"  VideoFrontCenter
 SG_ RFR_Obj04_ExistProb : 138|6@1+ (2,0) [0|100] "%"  VideoFrontCenter
 SG_ RFR_Obj04_VxVnce : 144|12@1+ (0.01,0) [0|30] "m^2/s^2"  VideoFrontCenter
 SG_ RFR_Obj04_VyVnce : 156|12@1+ (0.01,0) [0|30] "m^2/s^2"  VideoFrontCenter
 SG_ RFR_Obj04_AxVnce : 168|12@1+ (0.01,0) [0|30] "m^2/s^4"  VideoFrontCenter
 SG_ RFR_Obj04_AyVnce : 180|12@1+ (0.01,0) [0|30] "m^2/s^4"  VideoFrontCenter
 SG_ RFR_Obj04_OrientationYawVnce : 192|12@1+ (0.0003,0) [0|1] "rad^2"  VideoFrontCenter
 SG_ RFR_Obj04_MovingObserved : 204|6@1+ (2,0) [0|100] "%"  VideoFrontCenter
 SG_ RFR_Obj04_MovingProbability : 210|6@1+ (2,0) [0|100] "%"  VideoFrontCenter
 SG_ RFR_Obj04_Length : 216|7@1+ (0.125,0) [0|15.875] "m"  VideoFrontCenter
 SG_ RFR_Obj04_Valid : 223|1@1+ (1,0) [0|1] ""  VideoFrontCenter
 SG_ RFR_Obj04_LengthVnce : 224|12@1+ (0.01,0) [0|30] "m^2"  VideoFrontCenter
 SG_ RFR_Obj04_WidthVnce : 236|12@1+ (0.01,0) [0|30] "m^2"  VideoFrontCenter
 SG_ RFR_Obj04_Width : 248|7@1+ (0.125,0) [0|15.875] "m"  VideoFrontCenter
 SG_ RFR_Obj04_BehaviorType : 255|3@1+ (1,0) [0|7] ""  VideoFrontCenter
 SG_ RFR_Obj04_ObstacleConf : 258|6@1+ (2,0) [0|100] "%"  VideoFrontCenter
 SG_ RFR_Obj04_NonObstacleConf : 264|6@1+ (2,0) [0|100] "%"  VideoFrontCenter
 SG_ RFR_Obj04_PxPyCoVnce : 272|12@1+ (0.01,0) [0|30] "m^2"  VideoFrontCenter
 SG_ RFR_Obj04_PxVxCoVnce : 284|12@1+ (0.01,0) [0|30] "m^2/s"  VideoFrontCenter
 SG_ RFR_Obj04_PxVyCoVnce : 296|12@1+ (0.01,0) [0|30] "m^2/s"  VideoFrontCenter
 SG_ RFR_Obj04_PyVxCoVnce : 308|12@1+ (0.01,0) [0|30] "m^2/s"  VideoFrontCenter
 SG_ RFR_Obj04_PyVyCoVnce : 320|12@1+ (0.01,0) [0|30] "m^2/s"  VideoFrontCenter
 SG_ RFR_Obj04_VxVyCoVnce : 332|12@1+ (0.01,0) [0|30] "m^2/s^2"  VideoFrontCenter
 SG_ RFR_Obj04_PxAxCoVnce : 344|12@1+ (0.01,0) [0|30] "m^2/s^2"  VideoFrontCenter
 SG_ RFR_Obj04_PxAyCoVnce : 356|12@1+ (0.01,0) [0|30] "m^2/s^2"  VideoFrontCenter
 SG_ RFR_Obj04_PyAxCoVnce : 368|12@1+ (0.01,0) [0|30] "m^2/s^2"  VideoFrontCenter
 SG_ RFR_Obj04_PyAyCoVnce : 380|12@1+ (0.01,0) [0|30] "m^2/s^2"  VideoFrontCenter
 SG_ RFR_Obj04_VxAxCoVnce : 392|12@1+ (0.01,0) [0|30] "m^2/s^3"  VideoFrontCenter
 SG_ RFR_Obj04_VxAyCoVnce : 404|12@1+ (0.01,0) [0|30] "m^2/s^3"  VideoFrontCenter
 SG_ RFR_Obj04_VyAxCoVnce : 416|12@1+ (0.01,0) [0|30] "m^2/s^3"  VideoFrontCenter
 SG_ RFR_Obj04_VyAyCoVnce : 428|12@1+ (0.01,0) [0|30] "m^2/s^3"  VideoFrontCenter
 SG_ RFR_Obj04_AxAyCoVnce : 440|12@1+ (0.01,0) [0|30] "m^2/s^4"  VideoFrontCenter
 SG_ RFR_Obj04_MobileObstConf : 452|6@1+ (2,0) [0|100] "%"  VideoFrontCenter
 SG_ RFR_Obj04_Mob4PlusWhlConf : 458|6@1+ (2,0) [0|100] "%"  VideoFrontCenter
 SG_ RFR_Obj04_Mob2WhlConf : 464|6@1+ (2,0) [0|100] "%"  VideoFrontCenter
 SG_ RFR_Obj04_MobPedConf : 470|6@1+ (2,0) [0|100] "%"  VideoFrontCenter
 SG_ RFR_Obj04_FourPlusWhlCarConf : 476|6@1+ (2,0) [0|100] "%"  VideoFrontCenter
 SG_ RFR_Obj04_FourPlusWhlHGVConf : 482|6@1+ (2,0) [0|100] "%"  VideoFrontCenter
 SG_ RFR_Obj04_GroundReflexConf : 488|6@1+ (2,0) [0|100] "%"  VideoFrontCenter
 SG_ RFR_Obj04_StatObstConf : 494|6@1+ (2,0) [0|100] "%"  VideoFrontCenter
 SG_ RFR_Obj04_StatBarrierConf : 500|6@1+ (2,0) [0|100] "%"  VideoFrontCenter

BO_ 1179 RFR_Obj05: 64 RadarFrontRight
 SG_ RFR_Obj05_CRC : 0|16@1+ (1,0) [0|65535] ""  VideoFrontCenter
 SG_ RFR_Obj05_AliveCtr : 16|8@1+ (1,0) [0|255] ""  VideoFrontCenter
 SG_ RFR_Obj05_ProtBlockCtr : 24|4@1+ (1,0) [0|15] ""  VideoFrontCenter
 SG_ RFR_Obj05_ReferencePoint : 28|4@1+ (1,0) [0|15] ""  VideoFrontCenter
 SG_ RFR_Obj05_ObjId : 32|7@1+ (1,0) [0|127] ""  VideoFrontCenter
 SG_ RFR_Obj05_MeasurementStatus : 39|1@1+ (1,0) [0|1] ""  VideoFrontCenter
 SG_ RFR_Obj05_Px : 40|13@1+ (0.0625,-256) [-256|255.9375] "m"  VideoFrontCenter
 SG_ RFR_Obj05_Py : 53|11@1+ (0.125,-128) [-128|127.875] "m"  VideoFrontCenter
 SG_ RFR_Obj05_PxVnce : 64|12@1+ (0.01,0) [0|30] "m^2"  VideoFrontCenter
 SG_ RFR_Obj05_PyVnce : 76|12@1+ (0.01,0) [0|30] "m^2"  VideoFrontCenter
 SG_ RFR_Obj05_Vx : 88|12@1+ (0.0625,-128) [-128|127.9375] "m/s"  VideoFrontCenter
 SG_ RFR_Obj05_Vy : 100|10@1+ (0.125,-64) [-64|63.875] "m/s"  VideoFrontCenter
 SG_ RFR_Obj05_Ax : 110|10@1+ (0.03125,-16) [-16|15.96875] "m/s^2"  VideoFrontCenter
 SG_ RFR_Obj05_Ay : 120|9@1+ (0.0625,-16) [-16|15.9375] "m/s^2"  VideoFrontCenter
 SG_ RFR_Obj05_OrientationYaw : 129|9@1+ (0.0175,-4.48) [-3.15|3.15] "rad"  VideoFrontCenter
 SG_ RFR_Obj05_ExistProb : 138|6@1+ (2,0) [0|100] "%"  VideoFrontCenter
 SG_ RFR_Obj05_VxVnce : 144|12@1+ (0.01,0) [0|30] "m^2/s^2"  VideoFrontCenter
 SG_ RFR_Obj05_VyVnce : 156|12@1+ (0.01,0) [0|30] "m^2/s^2"  VideoFrontCenter
 SG_ RFR_Obj05_AxVnce : 168|12@1+ (0.01,0) [0|30] "m^2/s^4"  VideoFrontCenter
 SG_ RFR_Obj05_AyVnce : 180|12@1+ (0.01,0) [0|30] "m^2/s^4"  VideoFrontCenter
 SG_ RFR_Obj05_OrientationYawVnce : 192|12@1+ (0.0003,0) [0|1] "rad^2"  VideoFrontCenter
 SG_ RFR_Obj05_MovingObserved : 204|6@1+ (2,0) [0|100] "%"  VideoFrontCenter
 SG_ RFR_Obj05_MovingProbability : 210|6@1+ (2,0) [0|100] "%"  VideoFrontCenter
 SG_ RFR_Obj05_Length : 216|7@1+ (0.125,0) [0|15.875] "m"  VideoFrontCenter
 SG_ RFR_Obj05_Valid : 223|1@1+ (1,0) [0|1] ""  VideoFrontCenter
 SG_ RFR_Obj05_LengthVnce : 224|12@1+ (0.01,0) [0|30] "m^2"  VideoFrontCenter
 SG_ RFR_Obj05_WidthVnce : 236|12@1+ (0.01,0) [0|30] "m^2"  VideoFrontCenter
 SG_ RFR_Obj05_Width : 248|7@1+ (0.125,0) [0|15.875] "m"  VideoFrontCenter
 SG_ RFR_Obj05_BehaviorType : 255|3@1+ (1,0) [0|7] ""  VideoFrontCenter
 SG_ RFR_Obj05_ObstacleConf : 258|6@1+ (2,0) [0|100] "%"  VideoFrontCenter
 SG_ RFR_Obj05_NonObstacleConf : 264|6@1+ (2,0) [0|100] "%"  VideoFrontCenter
 SG_ RFR_Obj05_PxPyCoVnce : 272|12@1+ (0.01,0) [0|30] "m^2"  VideoFrontCenter
 SG_ RFR_Obj05_PxVxCoVnce : 284|12@1+ (0.01,0) [0|30] "m^2/s"  VideoFrontCenter
 SG_ RFR_Obj05_PxVyCoVnce : 296|12@1+ (0.01,0) [0|30] "m^2/s"  VideoFrontCenter
 SG_ RFR_Obj05_PyVxCoVnce : 308|12@1+ (0.01,0) [0|30] "m^2/s"  VideoFrontCenter
 SG_ RFR_Obj05_PyVyCoVnce : 320|12@1+ (0.01,0) [0|30] "m^2/s"  VideoFrontCenter
 SG_ RFR_Obj05_VxVyCoVnce : 332|12@1+ (0.01,0) [0|30] "m^2/s^2"  VideoFrontCenter
 SG_ RFR_Obj05_PxAxCoVnce : 344|12@1+ (0.01,0) [0|30] "m^2/s^2"  VideoFrontCenter
 SG_ RFR_Obj05_PxAyCoVnce : 356|12@1+ (0.01,0) [0|30] "m^2/s^2"  VideoFrontCenter
 SG_ RFR_Obj05_PyAxCoVnce : 368|12@1+ (0.01,0) [0|30] "m^2/s^2"  VideoFrontCenter
 SG_ RFR_Obj05_PyAyCoVnce : 380|12@1+ (0.01,0) [0|30] "m^2/s^2"  VideoFrontCenter
 SG_ RFR_Obj05_VxAxCoVnce : 392|12@1+ (0.01,0) [0|30] "m^2/s^3"  VideoFrontCenter
 SG_ RFR_Obj05_VxAyCoVnce : 404|12@1+ (0.01,0) [0|30] "m^2/s^3"  VideoFrontCenter
 SG_ RFR_Obj05_VyAxCoVnce : 416|12@1+ (0.01,0) [0|30] "m^2/s^3"  VideoFrontCenter
 SG_ RFR_Obj05_VyAyCoVnce : 428|12@1+ (0.01,0) [0|30] "m^2/s^3"  VideoFrontCenter
 SG_ RFR_Obj05_AxAyCoVnce : 440|12@1+ (0.01,0) [0|30] "m^2/s^4"  VideoFrontCenter
 SG_ RFR_Obj05_MobileObstConf : 452|6@1+ (2,0) [0|100] "%"  VideoFrontCenter
 SG_ RFR_Obj05_Mob4PlusWhlConf : 458|6@1+ (2,0) [0|100] "%"  VideoFrontCenter
 SG_ RFR_Obj05_Mob2WhlConf : 464|6@1+ (2,0) [0|100] "%"  VideoFrontCenter
 SG_ RFR_Obj05_MobPedConf : 470|6@1+ (2,0) [0|100] "%"  VideoFrontCenter
 SG_ RFR_Obj05_FourPlusWhlCarConf : 476|6@1+ (2,0) [0|100] "%"  VideoFrontCenter
 SG_ RFR_Obj05_FourPlusWhlHGVConf : 482|6@1+ (2,0) [0|100] "%"  VideoFrontCenter
 SG_ RFR_Obj05_GroundReflexConf : 488|6@1+ (2,0) [0|100] "%"  VideoFrontCenter
 SG_ RFR_Obj05_StatObstConf : 494|6@1+ (2,0) [0|100] "%"  VideoFrontCenter
 SG_ RFR_Obj05_StatBarrierConf : 500|6@1+ (2,0) [0|100] "%"  VideoFrontCenter

BO_ 1180 RFR_Obj06: 64 RadarFrontRight
 SG_ RFR_Obj06_CRC : 0|16@1+ (1,0) [0|65535] ""  VideoFrontCenter
 SG_ RFR_Obj06_AliveCtr : 16|8@1+ (1,0) [0|255] ""  VideoFrontCenter
 SG_ RFR_Obj06_ProtBlockCtr : 24|4@1+ (1,0) [0|15] ""  VideoFrontCenter
 SG_ RFR_Obj06_ReferencePoint : 28|4@1+ (1,0) [0|15] ""  VideoFrontCenter
 SG_ RFR_Obj06_ObjId : 32|7@1+ (1,0) [0|127] ""  VideoFrontCenter
 SG_ RFR_Obj06_MeasurementStatus : 39|1@1+ (1,0) [0|1] ""  VideoFrontCenter
 SG_ RFR_Obj06_Px : 40|13@1+ (0.0625,-256) [-256|255.9375] "m"  VideoFrontCenter
 SG_ RFR_Obj06_Py : 53|11@1+ (0.125,-128) [-128|127.875] "m"  VideoFrontCenter
 SG_ RFR_Obj06_PxVnce : 64|12@1+ (0.01,0) [0|30] "m^2"  VideoFrontCenter
 SG_ RFR_Obj06_PyVnce : 76|12@1+ (0.01,0) [0|30] "m^2"  VideoFrontCenter
 SG_ RFR_Obj06_Vx : 88|12@1+ (0.0625,-128) [-128|127.9375] "m/s"  VideoFrontCenter
 SG_ RFR_Obj06_Vy : 100|10@1+ (0.125,-64) [-64|63.875] "m/s"  VideoFrontCenter
 SG_ RFR_Obj06_Ax : 110|10@1+ (0.03125,-16) [-16|15.96875] "m/s^2"  VideoFrontCenter
 SG_ RFR_Obj06_Ay : 120|9@1+ (0.0625,-16) [-16|15.9375] "m/s^2"  VideoFrontCenter
 SG_ RFR_Obj06_OrientationYaw : 129|9@1+ (0.0175,-4.48) [-3.15|3.15] "rad"  VideoFrontCenter
 SG_ RFR_Obj06_ExistProb : 138|6@1+ (2,0) [0|100] "%"  VideoFrontCenter
 SG_ RFR_Obj06_VxVnce : 144|12@1+ (0.01,0) [0|30] "m^2/s^2"  VideoFrontCenter
 SG_ RFR_Obj06_VyVnce : 156|12@1+ (0.01,0) [0|30] "m^2/s^2"  VideoFrontCenter
 SG_ RFR_Obj06_AxVnce : 168|12@1+ (0.01,0) [0|30] "m^2/s^4"  VideoFrontCenter
 SG_ RFR_Obj06_AyVnce : 180|12@1+ (0.01,0) [0|30] "m^2/s^4"  VideoFrontCenter
 SG_ RFR_Obj06_OrientationYawVnce : 192|12@1+ (0.0003,0) [0|1] "rad^2"  VideoFrontCenter
 SG_ RFR_Obj06_MovingObserved : 204|6@1+ (2,0) [0|100] "%"  VideoFrontCenter
 SG_ RFR_Obj06_MovingProbability : 210|6@1+ (2,0) [0|100] "%"  VideoFrontCenter
 SG_ RFR_Obj06_Length : 216|7@1+ (0.125,0) [0|15.875] "m"  VideoFrontCenter
 SG_ RFR_Obj06_Valid : 223|1@1+ (1,0) [0|1] ""  VideoFrontCenter
 SG_ RFR_Obj06_LengthVnce : 224|12@1+ (0.01,0) [0|30] "m^2"  VideoFrontCenter
 SG_ RFR_Obj06_WidthVnce : 236|12@1+ (0.01,0) [0|30] "m^2"  VideoFrontCenter
 SG_ RFR_Obj06_Width : 248|7@1+ (0.125,0) [0|15.875] "m"  VideoFrontCenter
 SG_ RFR_Obj06_BehaviorType : 255|3@1+ (1,0) [0|7] ""  VideoFrontCenter
 SG_ RFR_Obj06_ObstacleConf : 258|6@1+ (2,0) [0|100] "%"  VideoFrontCenter
 SG_ RFR_Obj06_NonObstacleConf : 264|6@1+ (2,0) [0|100] "%"  VideoFrontCenter
 SG_ RFR_Obj06_PxPyCoVnce : 272|12@1+ (0.01,0) [0|30] "m^2"  VideoFrontCenter
 SG_ RFR_Obj06_PxVxCoVnce : 284|12@1+ (0.01,0) [0|30] "m^2/s"  VideoFrontCenter
 SG_ RFR_Obj06_PxVyCoVnce : 296|12@1+ (0.01,0) [0|30] "m^2/s"  VideoFrontCenter
 SG_ RFR_Obj06_PyVxCoVnce : 308|12@1+ (0.01,0) [0|30] "m^2/s"  VideoFrontCenter
 SG_ RFR_Obj06_PyVyCoVnce : 320|12@1+ (0.01,0) [0|30] "m^2/s"  VideoFrontCenter
 SG_ RFR_Obj06_VxVyCoVnce : 332|12@1+ (0.01,0) [0|30] "m^2/s^2"  VideoFrontCenter
 SG_ RFR_Obj06_PxAxCoVnce : 344|12@1+ (0.01,0) [0|30] "m^2/s^2"  VideoFrontCenter
 SG_ RFR_Obj06_PxAyCoVnce : 356|12@1+ (0.01,0) [0|30] "m^2/s^2"  VideoFrontCenter
 SG_ RFR_Obj06_PyAxCoVnce : 368|12@1+ (0.01,0) [0|30] "m^2/s^2"  VideoFrontCenter
 SG_ RFR_Obj06_PyAyCoVnce : 380|12@1+ (0.01,0) [0|30] "m^2/s^2"  VideoFrontCenter
 SG_ RFR_Obj06_VxAxCoVnce : 392|12@1+ (0.01,0) [0|30] "m^2/s^3"  VideoFrontCenter
 SG_ RFR_Obj06_VxAyCoVnce : 404|12@1+ (0.01,0) [0|30] "m^2/s^3"  VideoFrontCenter
 SG_ RFR_Obj06_VyAxCoVnce : 416|12@1+ (0.01,0) [0|30] "m^2/s^3"  VideoFrontCenter
 SG_ RFR_Obj06_VyAyCoVnce : 428|12@1+ (0.01,0) [0|30] "m^2/s^3"  VideoFrontCenter
 SG_ RFR_Obj06_AxAyCoVnce : 440|12@1+ (0.01,0) [0|30] "m^2/s^4"  VideoFrontCenter
 SG_ RFR_Obj06_MobileObstConf : 452|6@1+ (2,0) [0|100] "%"  VideoFrontCenter
 SG_ RFR_Obj06_Mob4PlusWhlConf : 458|6@1+ (2,0) [0|100] "%"  VideoFrontCenter
 SG_ RFR_Obj06_Mob2WhlConf : 464|6@1+ (2,0) [0|100] "%"  VideoFrontCenter
 SG_ RFR_Obj06_MobPedConf : 470|6@1+ (2,0) [0|100] "%"  VideoFrontCenter
 SG_ RFR_Obj06_FourPlusWhlCarConf : 476|6@1+ (2,0) [0|100] "%"  VideoFrontCenter
 SG_ RFR_Obj06_FourPlusWhlHGVConf : 482|6@1+ (2,0) [0|100] "%"  VideoFrontCenter
 SG_ RFR_Obj06_GroundReflexConf : 488|6@1+ (2,0) [0|100] "%"  VideoFrontCenter
 SG_ RFR_Obj06_StatObstConf : 494|6@1+ (2,0) [0|100] "%"  VideoFrontCenter
 SG_ RFR_Obj06_StatBarrierConf : 500|6@1+ (2,0) [0|100] "%"  VideoFrontCenter

BO_ 1181 RFR_Obj07: 64 RadarFrontRight
 SG_ RFR_Obj07_CRC : 0|16@1+ (1,0) [0|65535] ""  VideoFrontCenter
 SG_ RFR_Obj07_AliveCtr : 16|8@1+ (1,0) [0|255] ""  VideoFrontCenter
 SG_ RFR_Obj07_ProtBlockCtr : 24|4@1+ (1,0) [0|15] ""  VideoFrontCenter
 SG_ RFR_Obj07_ReferencePoint : 28|4@1+ (1,0) [0|15] ""  VideoFrontCenter
 SG_ RFR_Obj07_ObjId : 32|7@1+ (1,0) [0|127] ""  VideoFrontCenter
 SG_ RFR_Obj07_MeasurementStatus : 39|1@1+ (1,0) [0|1] ""  VideoFrontCenter
 SG_ RFR_Obj07_Px : 40|13@1+ (0.0625,-256) [-256|255.9375] "m"  VideoFrontCenter
 SG_ RFR_Obj07_Py : 53|11@1+ (0.125,-128) [-128|127.875] "m"  VideoFrontCenter
 SG_ RFR_Obj07_PxVnce : 64|12@1+ (0.01,0) [0|30] "m^2"  VideoFrontCenter
 SG_ RFR_Obj07_PyVnce : 76|12@1+ (0.01,0) [0|30] "m^2"  VideoFrontCenter
 SG_ RFR_Obj07_Vx : 88|12@1+ (0.0625,-128) [-128|127.9375] "m/s"  VideoFrontCenter
 SG_ RFR_Obj07_Vy : 100|10@1+ (0.125,-64) [-64|63.875] "m/s"  VideoFrontCenter
 SG_ RFR_Obj07_Ax : 110|10@1+ (0.03125,-16) [-16|15.96875] "m/s^2"  VideoFrontCenter
 SG_ RFR_Obj07_Ay : 120|9@1+ (0.0625,-16) [-16|15.9375] "m/s^2"  VideoFrontCenter
 SG_ RFR_Obj07_OrientationYaw : 129|9@1+ (0.0175,-4.48) [-3.15|3.15] "rad"  VideoFrontCenter
 SG_ RFR_Obj07_ExistProb : 138|6@1+ (2,0) [0|100] "%"  VideoFrontCenter
 SG_ RFR_Obj07_VxVnce : 144|12@1+ (0.01,0) [0|30] "m^2/s^2"  VideoFrontCenter
 SG_ RFR_Obj07_VyVnce : 156|12@1+ (0.01,0) [0|30] "m^2/s^2"  VideoFrontCenter
 SG_ RFR_Obj07_AxVnce : 168|12@1+ (0.01,0) [0|30] "m^2/s^4"  VideoFrontCenter
 SG_ RFR_Obj07_AyVnce : 180|12@1+ (0.01,0) [0|30] "m^2/s^4"  VideoFrontCenter
 SG_ RFR_Obj07_OrientationYawVnce : 192|12@1+ (0.0003,0) [0|1] "rad^2"  VideoFrontCenter
 SG_ RFR_Obj07_MovingObserved : 204|6@1+ (2,0) [0|100] "%"  VideoFrontCenter
 SG_ RFR_Obj07_MovingProbability : 210|6@1+ (2,0) [0|100] "%"  VideoFrontCenter
 SG_ RFR_Obj07_Length : 216|7@1+ (0.125,0) [0|15.875] "m"  VideoFrontCenter
 SG_ RFR_Obj07_Valid : 223|1@1+ (1,0) [0|1] ""  VideoFrontCenter
 SG_ RFR_Obj07_LengthVnce : 224|12@1+ (0.01,0) [0|30] "m^2"  VideoFrontCenter
 SG_ RFR_Obj07_WidthVnce : 236|12@1+ (0.01,0) [0|30] "m^2"  VideoFrontCenter
 SG_ RFR_Obj07_Width : 248|7@1+ (0.125,0) [0|15.875] "m"  VideoFrontCenter
 SG_ RFR_Obj07_BehaviorType : 255|3@1+ (1,0) [0|7] ""  VideoFrontCenter
 SG_ RFR_Obj07_ObstacleConf : 258|6@1+ (2,0) [0|100] "%"  VideoFrontCenter
 SG_ RFR_Obj07_NonObstacleConf : 264|6@1+ (2,0) [0|100] "%"  VideoFrontCenter
 SG_ RFR_Obj07_PxPyCoVnce : 272|12@1+ (0.01,0) [0|30] "m^2"  VideoFrontCenter
 SG_ RFR_Obj07_PxVxCoVnce : 284|12@1+ (0.01,0) [0|30] "m^2/s"  VideoFrontCenter
 SG_ RFR_Obj07_PxVyCoVnce : 296|12@1+ (0.01,0) [0|30] "m^2/s"  VideoFrontCenter
 SG_ RFR_Obj07_PyVxCoVnce : 308|12@1+ (0.01,0) [0|30] "m^2/s"  VideoFrontCenter
 SG_ RFR_Obj07_PyVyCoVnce : 320|12@1+ (0.01,0) [0|30] "m^2/s"  VideoFrontCenter
 SG_ RFR_Obj07_VxVyCoVnce : 332|12@1+ (0.01,0) [0|30] "m^2/s^2"  VideoFrontCenter
 SG_ RFR_Obj07_PxAxCoVnce : 344|12@1+ (0.01,0) [0|30] "m^2/s^2"  VideoFrontCenter
 SG_ RFR_Obj07_PxAyCoVnce : 356|12@1+ (0.01,0) [0|30] "m^2/s^2"  VideoFrontCenter
 SG_ RFR_Obj07_PyAxCoVnce : 368|12@1+ (0.01,0) [0|30] "m^2/s^2"  VideoFrontCenter
 SG_ RFR_Obj07_PyAyCoVnce : 380|12@1+ (0.01,0) [0|30] "m^2/s^2"  VideoFrontCenter
 SG_ RFR_Obj07_VxAxCoVnce : 392|12@1+ (0.01,0) [0|30] "m^2/s^3"  VideoFrontCenter
 SG_ RFR_Obj07_VxAyCoVnce : 404|12@1+ (0.01,0) [0|30] "m^2/s^3"  VideoFrontCenter
 SG_ RFR_Obj07_VyAxCoVnce : 416|12@1+ (0.01,0) [0|30] "m^2/s^3"  VideoFrontCenter
 SG_ RFR_Obj07_VyAyCoVnce : 428|12@1+ (0.01,0) [0|30] "m^2/s^3"  VideoFrontCenter
 SG_ RFR_Obj07_AxAyCoVnce : 440|12@1+ (0.01,0) [0|30] "m^2/s^4"  VideoFrontCenter
 SG_ RFR_Obj07_MobileObstConf : 452|6@1+ (2,0) [0|100] "%"  VideoFrontCenter
 SG_ RFR_Obj07_Mob4PlusWhlConf : 458|6@1+ (2,0) [0|100] "%"  VideoFrontCenter
 SG_ RFR_Obj07_Mob2WhlConf : 464|6@1+ (2,0) [0|100] "%"  VideoFrontCenter
 SG_ RFR_Obj07_MobPedConf : 470|6@1+ (2,0) [0|100] "%"  VideoFrontCenter
 SG_ RFR_Obj07_FourPlusWhlCarConf : 476|6@1+ (2,0) [0|100] "%"  VideoFrontCenter
 SG_ RFR_Obj07_FourPlusWhlHGVConf : 482|6@1+ (2,0) [0|100] "%"  VideoFrontCenter
 SG_ RFR_Obj07_GroundReflexConf : 488|6@1+ (2,0) [0|100] "%"  VideoFrontCenter
 SG_ RFR_Obj07_StatObstConf : 494|6@1+ (2,0) [0|100] "%"  VideoFrontCenter
 SG_ RFR_Obj07_StatBarrierConf : 500|6@1+ (2,0) [0|100] "%"  VideoFrontCenter

BO_ 1182 RFR_Obj08: 64 RadarFrontRight
 SG_ RFR_Obj08_CRC : 0|16@1+ (1,0) [0|65535] ""  VideoFrontCenter
 SG_ RFR_Obj08_AliveCtr : 16|8@1+ (1,0) [0|255] ""  VideoFrontCenter
 SG_ RFR_Obj08_ProtBlockCtr : 24|4@1+ (1,0) [0|15] ""  VideoFrontCenter
 SG_ RFR_Obj08_ReferencePoint : 28|4@1+ (1,0) [0|15] ""  VideoFrontCenter
 SG_ RFR_Obj08_ObjId : 32|7@1+ (1,0) [0|127] ""  VideoFrontCenter
 SG_ RFR_Obj08_MeasurementStatus : 39|1@1+ (1,0) [0|1] ""  VideoFrontCenter
 SG_ RFR_Obj08_Px : 40|13@1+ (0.0625,-256) [-256|255.9375] "m"  VideoFrontCenter
 SG_ RFR_Obj08_Py : 53|11@1+ (0.125,-128) [-128|127.875] "m"  VideoFrontCenter
 SG_ RFR_Obj08_PxVnce : 64|12@1+ (0.01,0) [0|30] "m^2"  VideoFrontCenter
 SG_ RFR_Obj08_PyVnce : 76|12@1+ (0.01,0) [0|30] "m^2"  VideoFrontCenter
 SG_ RFR_Obj08_Vx : 88|12@1+ (0.0625,-128) [-128|127.9375] "m/s"  VideoFrontCenter
 SG_ RFR_Obj08_Vy : 100|10@1+ (0.125,-64) [-64|63.875] "m/s"  VideoFrontCenter
 SG_ RFR_Obj08_Ax : 110|10@1+ (0.03125,-16) [-16|15.96875] "m/s^2"  VideoFrontCenter
 SG_ RFR_Obj08_Ay : 120|9@1+ (0.0625,-16) [-16|15.9375] "m/s^2"  VideoFrontCenter
 SG_ RFR_Obj08_OrientationYaw : 129|9@1+ (0.0175,-4.48) [-3.15|3.15] "rad"  VideoFrontCenter
 SG_ RFR_Obj08_ExistProb : 138|6@1+ (2,0) [0|100] "%"  VideoFrontCenter
 SG_ RFR_Obj08_VxVnce : 144|12@1+ (0.01,0) [0|30] "m^2/s^2"  VideoFrontCenter
 SG_ RFR_Obj08_VyVnce : 156|12@1+ (0.01,0) [0|30] "m^2/s^2"  VideoFrontCenter
 SG_ RFR_Obj08_AxVnce : 168|12@1+ (0.01,0) [0|30] "m^2/s^4"  VideoFrontCenter
 SG_ RFR_Obj08_AyVnce : 180|12@1+ (0.01,0) [0|30] "m^2/s^4"  VideoFrontCenter
 SG_ RFR_Obj08_OrientationYawVnce : 192|12@1+ (0.0003,0) [0|1] "rad^2"  VideoFrontCenter
 SG_ RFR_Obj08_MovingObserved : 204|6@1+ (2,0) [0|100] "%"  VideoFrontCenter
 SG_ RFR_Obj08_MovingProbability : 210|6@1+ (2,0) [0|100] "%"  VideoFrontCenter
 SG_ RFR_Obj08_Length : 216|7@1+ (0.125,0) [0|15.875] "m"  VideoFrontCenter
 SG_ RFR_Obj08_Valid : 223|1@1+ (1,0) [0|1] ""  VideoFrontCenter
 SG_ RFR_Obj08_LengthVnce : 224|12@1+ (0.01,0) [0|30] "m^2"  VideoFrontCenter
 SG_ RFR_Obj08_WidthVnce : 236|12@1+ (0.01,0) [0|30] "m^2"  VideoFrontCenter
 SG_ RFR_Obj08_Width : 248|7@1+ (0.125,0) [0|15.875] "m"  VideoFrontCenter
 SG_ RFR_Obj08_BehaviorType : 255|3@1+ (1,0) [0|7] ""  VideoFrontCenter
 SG_ RFR_Obj08_ObstacleConf : 258|6@1+ (2,0) [0|100] "%"  VideoFrontCenter
 SG_ RFR_Obj08_NonObstacleConf : 264|6@1+ (2,0) [0|100] "%"  VideoFrontCenter
 SG_ RFR_Obj08_PxPyCoVnce : 272|12@1+ (0.01,0) [0|30] "m^2"  VideoFrontCenter
 SG_ RFR_Obj08_PxVxCoVnce : 284|12@1+ (0.01,0) [0|30] "m^2/s"  VideoFrontCenter
 SG_ RFR_Obj08_PxVyCoVnce : 296|12@1+ (0.01,0) [0|30] "m^2/s"  VideoFrontCenter
 SG_ RFR_Obj08_PyVxCoVnce : 308|12@1+ (0.01,0) [0|30] "m^2/s"  VideoFrontCenter
 SG_ RFR_Obj08_PyVyCoVnce : 320|12@1+ (0.01,0) [0|30] "m^2/s"  VideoFrontCenter
 SG_ RFR_Obj08_VxVyCoVnce : 332|12@1+ (0.01,0) [0|30] "m^2/s^2"  VideoFrontCenter
 SG_ RFR_Obj08_PxAxCoVnce : 344|12@1+ (0.01,0) [0|30] "m^2/s^2"  VideoFrontCenter
 SG_ RFR_Obj08_PxAyCoVnce : 356|12@1+ (0.01,0) [0|30] "m^2/s^2"  VideoFrontCenter
 SG_ RFR_Obj08_PyAxCoVnce : 368|12@1+ (0.01,0) [0|30] "m^2/s^2"  VideoFrontCenter
 SG_ RFR_Obj08_PyAyCoVnce : 380|12@1+ (0.01,0) [0|30] "m^2/s^2"  VideoFrontCenter
 SG_ RFR_Obj08_VxAxCoVnce : 392|12@1+ (0.01,0) [0|30] "m^2/s^3"  VideoFrontCenter
 SG_ RFR_Obj08_VxAyCoVnce : 404|12@1+ (0.01,0) [0|30] "m^2/s^3"  VideoFrontCenter
 SG_ RFR_Obj08_VyAxCoVnce : 416|12@1+ (0.01,0) [0|30] "m^2/s^3"  VideoFrontCenter
 SG_ RFR_Obj08_VyAyCoVnce : 428|12@1+ (0.01,0) [0|30] "m^2/s^3"  VideoFrontCenter
 SG_ RFR_Obj08_AxAyCoVnce : 440|12@1+ (0.01,0) [0|30] "m^2/s^4"  VideoFrontCenter
 SG_ RFR_Obj08_MobileObstConf : 452|6@1+ (2,0) [0|100] "%"  VideoFrontCenter
 SG_ RFR_Obj08_Mob4PlusWhlConf : 458|6@1+ (2,0) [0|100] "%"  VideoFrontCenter
 SG_ RFR_Obj08_Mob2WhlConf : 464|6@1+ (2,0) [0|100] "%"  VideoFrontCenter
 SG_ RFR_Obj08_MobPedConf : 470|6@1+ (2,0) [0|100] "%"  VideoFrontCenter
 SG_ RFR_Obj08_FourPlusWhlCarConf : 476|6@1+ (2,0) [0|100] "%"  VideoFrontCenter
 SG_ RFR_Obj08_FourPlusWhlHGVConf : 482|6@1+ (2,0) [0|100] "%"  VideoFrontCenter
 SG_ RFR_Obj08_GroundReflexConf : 488|6@1+ (2,0) [0|100] "%"  VideoFrontCenter
 SG_ RFR_Obj08_StatObstConf : 494|6@1+ (2,0) [0|100] "%"  VideoFrontCenter
 SG_ RFR_Obj08_StatBarrierConf : 500|6@1+ (2,0) [0|100] "%"  VideoFrontCenter

BO_ 1183 RFR_Obj09: 64 RadarFrontRight
 SG_ RFR_Obj09_CRC : 0|16@1+ (1,0) [0|65535] ""  VideoFrontCenter
 SG_ RFR_Obj09_AliveCtr : 16|8@1+ (1,0) [0|255] ""  VideoFrontCenter
 SG_ RFR_Obj09_ProtBlockCtr : 24|4@1+ (1,0) [0|15] ""  VideoFrontCenter
 SG_ RFR_Obj09_ReferencePoint : 28|4@1+ (1,0) [0|15] ""  VideoFrontCenter
 SG_ RFR_Obj09_ObjId : 32|7@1+ (1,0) [0|127] ""  VideoFrontCenter
 SG_ RFR_Obj09_MeasurementStatus : 39|1@1+ (1,0) [0|1] ""  VideoFrontCenter
 SG_ RFR_Obj09_Px : 40|13@1+ (0.0625,-256) [-256|255.9375] "m"  VideoFrontCenter
 SG_ RFR_Obj09_Py : 53|11@1+ (0.125,-128) [-128|127.875] "m"  VideoFrontCenter
 SG_ RFR_Obj09_PxVnce : 64|12@1+ (0.01,0) [0|30] "m^2"  VideoFrontCenter
 SG_ RFR_Obj09_PyVnce : 76|12@1+ (0.01,0) [0|30] "m^2"  VideoFrontCenter
 SG_ RFR_Obj09_Vx : 88|12@1+ (0.0625,-128) [-128|127.9375] "m/s"  VideoFrontCenter
 SG_ RFR_Obj09_Vy : 100|10@1+ (0.125,-64) [-64|63.875] "m/s"  VideoFrontCenter
 SG_ RFR_Obj09_Ax : 110|10@1+ (0.03125,-16) [-16|15.96875] "m/s^2"  VideoFrontCenter
 SG_ RFR_Obj09_Ay : 120|9@1+ (0.0625,-16) [-16|15.9375] "m/s^2"  VideoFrontCenter
 SG_ RFR_Obj09_OrientationYaw : 129|9@1+ (0.0175,-4.48) [-3.15|3.15] "rad"  VideoFrontCenter
 SG_ RFR_Obj09_ExistProb : 138|6@1+ (2,0) [0|100] "%"  VideoFrontCenter
 SG_ RFR_Obj09_VxVnce : 144|12@1+ (0.01,0) [0|30] "m^2/s^2"  VideoFrontCenter
 SG_ RFR_Obj09_VyVnce : 156|12@1+ (0.01,0) [0|30] "m^2/s^2"  VideoFrontCenter
 SG_ RFR_Obj09_AxVnce : 168|12@1+ (0.01,0) [0|30] "m^2/s^4"  VideoFrontCenter
 SG_ RFR_Obj09_AyVnce : 180|12@1+ (0.01,0) [0|30] "m^2/s^4"  VideoFrontCenter
 SG_ RFR_Obj09_OrientationYawVnce : 192|12@1+ (0.0003,0) [0|1] "rad^2"  VideoFrontCenter
 SG_ RFR_Obj09_MovingObserved : 204|6@1+ (2,0) [0|100] "%"  VideoFrontCenter
 SG_ RFR_Obj09_MovingProbability : 210|6@1+ (2,0) [0|100] "%"  VideoFrontCenter
 SG_ RFR_Obj09_Length : 216|7@1+ (0.125,0) [0|15.875] "m"  VideoFrontCenter
 SG_ RFR_Obj09_Valid : 223|1@1+ (1,0) [0|1] ""  VideoFrontCenter
 SG_ RFR_Obj09_LengthVnce : 224|12@1+ (0.01,0) [0|30] "m^2"  VideoFrontCenter
 SG_ RFR_Obj09_WidthVnce : 236|12@1+ (0.01,0) [0|30] "m^2"  VideoFrontCenter
 SG_ RFR_Obj09_Width : 248|7@1+ (0.125,0) [0|15.875] "m"  VideoFrontCenter
 SG_ RFR_Obj09_BehaviorType : 255|3@1+ (1,0) [0|7] ""  VideoFrontCenter
 SG_ RFR_Obj09_ObstacleConf : 258|6@1+ (2,0) [0|100] "%"  VideoFrontCenter
 SG_ RFR_Obj09_NonObstacleConf : 264|6@1+ (2,0) [0|100] "%"  VideoFrontCenter
 SG_ RFR_Obj09_PxPyCoVnce : 272|12@1+ (0.01,0) [0|30] "m^2"  VideoFrontCenter
 SG_ RFR_Obj09_PxVxCoVnce : 284|12@1+ (0.01,0) [0|30] "m^2/s"  VideoFrontCenter
 SG_ RFR_Obj09_PxVyCoVnce : 296|12@1+ (0.01,0) [0|30] "m^2/s"  VideoFrontCenter
 SG_ RFR_Obj09_PyVxCoVnce : 308|12@1+ (0.01,0) [0|30] "m^2/s"  VideoFrontCenter
 SG_ RFR_Obj09_PyVyCoVnce : 320|12@1+ (0.01,0) [0|30] "m^2/s"  VideoFrontCenter
 SG_ RFR_Obj09_VxVyCoVnce : 332|12@1+ (0.01,0) [0|30] "m^2/s^2"  VideoFrontCenter
 SG_ RFR_Obj09_PxAxCoVnce : 344|12@1+ (0.01,0) [0|30] "m^2/s^2"  VideoFrontCenter
 SG_ RFR_Obj09_PxAyCoVnce : 356|12@1+ (0.01,0) [0|30] "m^2/s^2"  VideoFrontCenter
 SG_ RFR_Obj09_PyAxCoVnce : 368|12@1+ (0.01,0) [0|30] "m^2/s^2"  VideoFrontCenter
 SG_ RFR_Obj09_PyAyCoVnce : 380|12@1+ (0.01,0) [0|30] "m^2/s^2"  VideoFrontCenter
 SG_ RFR_Obj09_VxAxCoVnce : 392|12@1+ (0.01,0) [0|30] "m^2/s^3"  VideoFrontCenter
 SG_ RFR_Obj09_VxAyCoVnce : 404|12@1+ (0.01,0) [0|30] "m^2/s^3"  VideoFrontCenter
 SG_ RFR_Obj09_VyAxCoVnce : 416|12@1+ (0.01,0) [0|30] "m^2/s^3"  VideoFrontCenter
 SG_ RFR_Obj09_VyAyCoVnce : 428|12@1+ (0.01,0) [0|30] "m^2/s^3"  VideoFrontCenter
 SG_ RFR_Obj09_AxAyCoVnce : 440|12@1+ (0.01,0) [0|30] "m^2/s^4"  VideoFrontCenter
 SG_ RFR_Obj09_MobileObstConf : 452|6@1+ (2,0) [0|100] "%"  VideoFrontCenter
 SG_ RFR_Obj09_Mob4PlusWhlConf : 458|6@1+ (2,0) [0|100] "%"  VideoFrontCenter
 SG_ RFR_Obj09_Mob2WhlConf : 464|6@1+ (2,0) [0|100] "%"  VideoFrontCenter
 SG_ RFR_Obj09_MobPedConf : 470|6@1+ (2,0) [0|100] "%"  VideoFrontCenter
 SG_ RFR_Obj09_FourPlusWhlCarConf : 476|6@1+ (2,0) [0|100] "%"  VideoFrontCenter
 SG_ RFR_Obj09_FourPlusWhlHGVConf : 482|6@1+ (2,0) [0|100] "%"  VideoFrontCenter
 SG_ RFR_Obj09_GroundReflexConf : 488|6@1+ (2,0) [0|100] "%"  VideoFrontCenter
 SG_ RFR_Obj09_StatObstConf : 494|6@1+ (2,0) [0|100] "%"  VideoFrontCenter
 SG_ RFR_Obj09_StatBarrierConf : 500|6@1+ (2,0) [0|100] "%"  VideoFrontCenter

BO_ 2281601536 Dev_Video_SyncVisor_TX: 8 VideoFrontCenter
 SG_ ImgFrameCounter : 7|32@0+ (1,0) [0|4294967295] ""  ReceiveECU
 SG_ ImgReceptionTimer : 39|32@0+ (1,0) [0|4294967295] ""  ReceiveECU

CM_ SG_ 925 RFL_Obj07_CRC "CRC - Autosar E2E Profile 5";
CM_ SG_ 925 RFL_Obj07_AliveCtr "Alive counter - Autosar E2E Profile 5";
CM_ SG_ 925 RFL_Obj07_ProtBlockCtr "Protocol-Signal: Block-Counter";
CM_ SG_ 925 RFL_Obj07_ReferencePoint "Reference Point of the detected object. ISO 23150: Reference point (A.2.17)";
CM_ SG_ 925 RFL_Obj07_ObjId "Unique Object ID. ISO 23150: Object ID (A.2.2)";
CM_ SG_ 925 RFL_Obj07_MeasurementStatus "Object is measured or not. ISO 23150: Measurement status  object level (A.2.9)";
CM_ SG_ 925 RFL_Obj07_Px "Object position in X direction. ISO 23150: Position  object level {x, y, z} (A.2.13)";
CM_ SG_ 925 RFL_Obj07_Py "Object position in Y direction. ISO 23150: Position  object level {x, y, z} (A.2.13)";
CM_ SG_ 925 RFL_Obj07_PxVnce "Variance of object position in X direction. ISO 23150: Position  object level {x, y, z}  error (A.2.14)";
CM_ SG_ 925 RFL_Obj07_PyVnce "Variance of object position in Y direction. ISO 23150: Position  object level {x, y, z}  error (A.2.14)";
CM_ SG_ 925 RFL_Obj07_Vx "Object relative velocity in X direction. ISO 23150: Velocity {x, y, z}  object level (A.2.23)";
CM_ SG_ 925 RFL_Obj07_Vy "Object relative velocity in Y direction. ISO 23150: Velocity {x, y, z}  object level (A.2.23)";
CM_ SG_ 925 RFL_Obj07_Ax "Object relative acceleration in X direction. ISO 23150: Acceleration {x, y, z} (A.2.25)";
CM_ SG_ 925 RFL_Obj07_Ay "Object relative acceleration in Y direction. ISO 23150: Acceleration {x, y, z} (A.2.25)";
CM_ SG_ 925 RFL_Obj07_OrientationYaw "Object orientation yaw angle. ISO 23150: Orientation {yaw, pitch, roll} (A.2.15)";
CM_ SG_ 925 RFL_Obj07_ExistProb "Existence probability of object. ISO 23150: Existence probability  object level (A.2.1)";
CM_ SG_ 925 RFL_Obj07_VxVnce "Variance of object relative velocity in X direction. ISO 23150: Velocity {x, y, z}  object level  error (A.2.24)";
CM_ SG_ 925 RFL_Obj07_VyVnce "Variance of object relative velocity in Y direction. ISO 23150: Velocity {x, y, z}  object level  error (A.2.24)";
CM_ SG_ 925 RFL_Obj07_AxVnce "Variance of object relative acceleration in X direction. ISO 23150: Acceleration {x, y, z}  error (A.2.26)";
CM_ SG_ 925 RFL_Obj07_AyVnce "Variance of object relative acceleration in Y direction. ISO 23150: Acceleration {x, y, z}  error (A.2.26)";
CM_ SG_ 925 RFL_Obj07_OrientationYawVnce "Variance of object orientation yaw angle. ISO 23150: Orientation {yaw, pitch, roll}  error (A.2.16)";
CM_ SG_ 925 RFL_Obj07_MovingObserved "Object has been observed moving over the ground since it was first detected";
CM_ SG_ 925 RFL_Obj07_MovingProbability "Object has been observed moving over the ground";
CM_ SG_ 925 RFL_Obj07_Length "Object Length. ISO 23150: Bounding box extent {length, width, height} (A.2.19)";
CM_ SG_ 925 RFL_Obj07_Valid "Object is valid or not";
CM_ SG_ 925 RFL_Obj07_LengthVnce "Variance of object Length. ISO 23150: Bounding box extent {length, width, height}  error (A.2.20)";
CM_ SG_ 925 RFL_Obj07_WidthVnce "Variance of object Width. ISO 23150: Bounding box extent {length, width, height}  error (A.2.20)";
CM_ SG_ 925 RFL_Obj07_Width "Object Width. ISO 23150: Bounding box extent {length, width, height} (A.2.19)";
CM_ SG_ 925 RFL_Obj07_BehaviorType "Indicates that which behavior the object associated for";
CM_ SG_ 925 RFL_Obj07_ObstacleConf "Confidence of the object being an Obstacle. ISO 23150: Potentially moving object classification type  confidence (A.2.12)";
CM_ SG_ 925 RFL_Obj07_NonObstacleConf "Confidence of the object being a Non-Obstacle. ISO 23150: Potentially moving object classification type  confidence (A.2.12)";
CM_ SG_ 925 RFL_Obj07_PxPyCoVnce "Covariance of Px and Py";
CM_ SG_ 925 RFL_Obj07_PxVxCoVnce "Covariance of Px and Vx";
CM_ SG_ 925 RFL_Obj07_PxVyCoVnce "Covariance of Px and Vy";
CM_ SG_ 925 RFL_Obj07_PyVxCoVnce "Covariance of Py and Vx";
CM_ SG_ 925 RFL_Obj07_PyVyCoVnce "Covariance of Py and Vy";
CM_ SG_ 925 RFL_Obj07_VxVyCoVnce "Covariance of Vx and Vy";
CM_ SG_ 925 RFL_Obj07_PxAxCoVnce "Covariance of Px and Ax";
CM_ SG_ 925 RFL_Obj07_PxAyCoVnce "Covariance of Px and Ay";
CM_ SG_ 925 RFL_Obj07_PyAxCoVnce "Covariance of Py and Ax";
CM_ SG_ 925 RFL_Obj07_PyAyCoVnce "Covariance of Py and Ay";
CM_ SG_ 925 RFL_Obj07_VxAxCoVnce "Covariance of Vx and Ax";
CM_ SG_ 925 RFL_Obj07_VxAyCoVnce "Covariance of Vx and Ay";
CM_ SG_ 925 RFL_Obj07_VyAxCoVnce "Covariance of Vy and Ax";
CM_ SG_ 925 RFL_Obj07_VyAyCoVnce "Covariance of Vy and Ay";
CM_ SG_ 925 RFL_Obj07_AxAyCoVnce "Covariance of Ax and Ay";
CM_ SG_ 925 RFL_Obj07_MobileObstConf "Confidence of the object being a mobile obstacle. ISO 23150: Potentially moving object classification type  confidence (A.2.12)";
CM_ SG_ 925 RFL_Obj07_Mob4PlusWhlConf "Confidence of a mobile object which has 4 or more wheels. ISO 23150: Potentially moving object classification type  confidence (A.2.12)";
CM_ SG_ 925 RFL_Obj07_Mob2WhlConf "Confidence of a mobile object being 2-wheels vehicle. ISO 23150: Potentially moving object classification type  confidence (A.2.12)";
CM_ SG_ 925 RFL_Obj07_MobPedConf "Confidence of a mobile object being a pedestrian. ISO 23150: Potentially moving object classification type  confidence (A.2.12)";
CM_ SG_ 925 RFL_Obj07_FourPlusWhlCarConf "Confidence of a mobile object which has 4 or more wheels--passenger car. ISO 23150: Potentially moving object classification type  confidence (A.2.12)";
CM_ SG_ 925 RFL_Obj07_FourPlusWhlHGVConf "Confidence of a mobile object which has 4 or more wheels--commercial vehicle (Truck). ISO 23150: Potentially moving object classification type  confidence (A.2.12)";
CM_ SG_ 925 RFL_Obj07_GroundReflexConf "Confidence of the object being a ground reflex. ISO 23150: Potentially moving object classification type  confidence (A.2.12)";
CM_ SG_ 925 RFL_Obj07_StatObstConf "Confidence of the object being a stationary obstacle. ISO 23150: Potentially moving object classification type  confidence (A.2.12)";
CM_ SG_ 925 RFL_Obj07_StatBarrierConf "Confidence of the object being a stationary road barrier. ISO 23150: Potentially moving object classification type  confidence (A.2.12)";
CM_ SG_ 926 RFL_Obj08_CRC "CRC - Autosar E2E Profile 5";
CM_ SG_ 926 RFL_Obj08_AliveCtr "Alive counter - Autosar E2E Profile 5";
CM_ SG_ 926 RFL_Obj08_ProtBlockCtr "Protocol-Signal: Block-Counter";
CM_ SG_ 926 RFL_Obj08_ReferencePoint "Reference Point of the detected object. ISO 23150: Reference point (A.2.17)";
CM_ SG_ 926 RFL_Obj08_ObjId "Unique Object ID. ISO 23150: Object ID (A.2.2)";
CM_ SG_ 926 RFL_Obj08_MeasurementStatus "Object is measured or not. ISO 23150: Measurement status  object level (A.2.9)";
CM_ SG_ 926 RFL_Obj08_Px "Object position in X direction. ISO 23150: Position  object level {x, y, z} (A.2.13)";
CM_ SG_ 926 RFL_Obj08_Py "Object position in Y direction. ISO 23150: Position  object level {x, y, z} (A.2.13)";
CM_ SG_ 926 RFL_Obj08_PxVnce "Variance of object position in X direction. ISO 23150: Position  object level {x, y, z}  error (A.2.14)";
CM_ SG_ 926 RFL_Obj08_PyVnce "Variance of object position in Y direction. ISO 23150: Position  object level {x, y, z}  error (A.2.14)";
CM_ SG_ 926 RFL_Obj08_Vx "Object relative velocity in X direction. ISO 23150: Velocity {x, y, z}  object level (A.2.23)";
CM_ SG_ 926 RFL_Obj08_Vy "Object relative velocity in Y direction. ISO 23150: Velocity {x, y, z}  object level (A.2.23)";
CM_ SG_ 926 RFL_Obj08_Ax "Object relative acceleration in X direction. ISO 23150: Acceleration {x, y, z} (A.2.25)";
CM_ SG_ 926 RFL_Obj08_Ay "Object relative acceleration in Y direction. ISO 23150: Acceleration {x, y, z} (A.2.25)";
CM_ SG_ 926 RFL_Obj08_OrientationYaw "Object orientation yaw angle. ISO 23150: Orientation {yaw, pitch, roll} (A.2.15)";
CM_ SG_ 926 RFL_Obj08_ExistProb "Existence probability of object. ISO 23150: Existence probability  object level (A.2.1)";
CM_ SG_ 926 RFL_Obj08_VxVnce "Variance of object relative velocity in X direction. ISO 23150: Velocity {x, y, z}  object level  error (A.2.24)";
CM_ SG_ 926 RFL_Obj08_VyVnce "Variance of object relative velocity in Y direction. ISO 23150: Velocity {x, y, z}  object level  error (A.2.24)";
CM_ SG_ 926 RFL_Obj08_AxVnce "Variance of object relative acceleration in X direction. ISO 23150: Acceleration {x, y, z}  error (A.2.26)";
CM_ SG_ 926 RFL_Obj08_AyVnce "Variance of object relative acceleration in Y direction. ISO 23150: Acceleration {x, y, z}  error (A.2.26)";
CM_ SG_ 926 RFL_Obj08_OrientationYawVnce "Variance of object orientation yaw angle. ISO 23150: Orientation {yaw, pitch, roll}  error (A.2.16)";
CM_ SG_ 926 RFL_Obj08_MovingObserved "Object has been observed moving over the ground since it was first detected";
CM_ SG_ 926 RFL_Obj08_MovingProbability "Object has been observed moving over the ground";
CM_ SG_ 926 RFL_Obj08_Length "Object Length. ISO 23150: Bounding box extent {length, width, height} (A.2.19)";
CM_ SG_ 926 RFL_Obj08_Valid "Object is valid or not";
CM_ SG_ 926 RFL_Obj08_LengthVnce "Variance of object Length. ISO 23150: Bounding box extent {length, width, height}  error (A.2.20)";
CM_ SG_ 926 RFL_Obj08_WidthVnce "Variance of object Width. ISO 23150: Bounding box extent {length, width, height}  error (A.2.20)";
CM_ SG_ 926 RFL_Obj08_Width "Object Width. ISO 23150: Bounding box extent {length, width, height} (A.2.19)";
CM_ SG_ 926 RFL_Obj08_BehaviorType "Indicates that which behavior the object associated for";
CM_ SG_ 926 RFL_Obj08_ObstacleConf "Confidence of the object being an Obstacle. ISO 23150: Potentially moving object classification type  confidence (A.2.12)";
CM_ SG_ 926 RFL_Obj08_NonObstacleConf "Confidence of the object being a Non-Obstacle. ISO 23150: Potentially moving object classification type  confidence (A.2.12)";
CM_ SG_ 926 RFL_Obj08_PxPyCoVnce "Covariance of Px and Py";
CM_ SG_ 926 RFL_Obj08_PxVxCoVnce "Covariance of Px and Vx";
CM_ SG_ 926 RFL_Obj08_PxVyCoVnce "Covariance of Px and Vy";
CM_ SG_ 926 RFL_Obj08_PyVxCoVnce "Covariance of Py and Vx";
CM_ SG_ 926 RFL_Obj08_PyVyCoVnce "Covariance of Py and Vy";
CM_ SG_ 926 RFL_Obj08_VxVyCoVnce "Covariance of Vx and Vy";
CM_ SG_ 926 RFL_Obj08_PxAxCoVnce "Covariance of Px and Ax";
CM_ SG_ 926 RFL_Obj08_PxAyCoVnce "Covariance of Px and Ay";
CM_ SG_ 926 RFL_Obj08_PyAxCoVnce "Covariance of Py and Ax";
CM_ SG_ 926 RFL_Obj08_PyAyCoVnce "Covariance of Py and Ay";
CM_ SG_ 926 RFL_Obj08_VxAxCoVnce "Covariance of Vx and Ax";
CM_ SG_ 926 RFL_Obj08_VxAyCoVnce "Covariance of Vx and Ay";
CM_ SG_ 926 RFL_Obj08_VyAxCoVnce "Covariance of Vy and Ax";
CM_ SG_ 926 RFL_Obj08_VyAyCoVnce "Covariance of Vy and Ay";
CM_ SG_ 926 RFL_Obj08_AxAyCoVnce "Covariance of Ax and Ay";
CM_ SG_ 926 RFL_Obj08_MobileObstConf "Confidence of the object being a mobile obstacle. ISO 23150: Potentially moving object classification type  confidence (A.2.12)";
CM_ SG_ 926 RFL_Obj08_Mob4PlusWhlConf "Confidence of a mobile object which has 4 or more wheels. ISO 23150: Potentially moving object classification type  confidence (A.2.12)";
CM_ SG_ 926 RFL_Obj08_Mob2WhlConf "Confidence of a mobile object being 2-wheels vehicle. ISO 23150: Potentially moving object classification type  confidence (A.2.12)";
CM_ SG_ 926 RFL_Obj08_MobPedConf "Confidence of a mobile object being a pedestrian. ISO 23150: Potentially moving object classification type  confidence (A.2.12)";
CM_ SG_ 926 RFL_Obj08_FourPlusWhlCarConf "Confidence of a mobile object which has 4 or more wheels--passenger car. ISO 23150: Potentially moving object classification type  confidence (A.2.12)";
CM_ SG_ 926 RFL_Obj08_FourPlusWhlHGVConf "Confidence of a mobile object which has 4 or more wheels--commercial vehicle (Truck). ISO 23150: Potentially moving object classification type  confidence (A.2.12)";
CM_ SG_ 926 RFL_Obj08_GroundReflexConf "Confidence of the object being a ground reflex. ISO 23150: Potentially moving object classification type  confidence (A.2.12)";
CM_ SG_ 926 RFL_Obj08_StatObstConf "Confidence of the object being a stationary obstacle. ISO 23150: Potentially moving object classification type  confidence (A.2.12)";
CM_ SG_ 926 RFL_Obj08_StatBarrierConf "Confidence of the object being a stationary road barrier. ISO 23150: Potentially moving object classification type  confidence (A.2.12)";
CM_ SG_ 927 RFL_Obj09_CRC "CRC - Autosar E2E Profile 5";
CM_ SG_ 927 RFL_Obj09_AliveCtr "Alive counter - Autosar E2E Profile 5";
CM_ SG_ 927 RFL_Obj09_ProtBlockCtr "Protocol-Signal: Block-Counter";
CM_ SG_ 927 RFL_Obj09_ReferencePoint "Reference Point of the detected object. ISO 23150: Reference point (A.2.17)";
CM_ SG_ 927 RFL_Obj09_ObjId "Unique Object ID. ISO 23150: Object ID (A.2.2)";
CM_ SG_ 927 RFL_Obj09_MeasurementStatus "Object is measured or not. ISO 23150: Measurement status  object level (A.2.9)";
CM_ SG_ 927 RFL_Obj09_Px "Object position in X direction. ISO 23150: Position  object level {x, y, z} (A.2.13)";
CM_ SG_ 927 RFL_Obj09_Py "Object position in Y direction. ISO 23150: Position  object level {x, y, z} (A.2.13)";
CM_ SG_ 927 RFL_Obj09_PxVnce "Variance of object position in X direction. ISO 23150: Position  object level {x, y, z}  error (A.2.14)";
CM_ SG_ 927 RFL_Obj09_PyVnce "Variance of object position in Y direction. ISO 23150: Position  object level {x, y, z}  error (A.2.14)";
CM_ SG_ 927 RFL_Obj09_Vx "Object relative velocity in X direction. ISO 23150: Velocity {x, y, z}  object level (A.2.23)";
CM_ SG_ 927 RFL_Obj09_Vy "Object relative velocity in Y direction. ISO 23150: Velocity {x, y, z}  object level (A.2.23)";
CM_ SG_ 927 RFL_Obj09_Ax "Object relative acceleration in X direction. ISO 23150: Acceleration {x, y, z} (A.2.25)";
CM_ SG_ 927 RFL_Obj09_Ay "Object relative acceleration in Y direction. ISO 23150: Acceleration {x, y, z} (A.2.25)";
CM_ SG_ 927 RFL_Obj09_OrientationYaw "Object orientation yaw angle. ISO 23150: Orientation {yaw, pitch, roll} (A.2.15)";
CM_ SG_ 927 RFL_Obj09_ExistProb "Existence probability of object. ISO 23150: Existence probability  object level (A.2.1)";
CM_ SG_ 927 RFL_Obj09_VxVnce "Variance of object relative velocity in X direction. ISO 23150: Velocity {x, y, z}  object level  error (A.2.24)";
CM_ SG_ 927 RFL_Obj09_VyVnce "Variance of object relative velocity in Y direction. ISO 23150: Velocity {x, y, z}  object level  error (A.2.24)";
CM_ SG_ 927 RFL_Obj09_AxVnce "Variance of object relative acceleration in X direction. ISO 23150: Acceleration {x, y, z}  error (A.2.26)";
CM_ SG_ 927 RFL_Obj09_AyVnce "Variance of object relative acceleration in Y direction. ISO 23150: Acceleration {x, y, z}  error (A.2.26)";
CM_ SG_ 927 RFL_Obj09_OrientationYawVnce "Variance of object orientation yaw angle. ISO 23150: Orientation {yaw, pitch, roll}  error (A.2.16)";
CM_ SG_ 927 RFL_Obj09_MovingObserved "Object has been observed moving over the ground since it was first detected";
CM_ SG_ 927 RFL_Obj09_MovingProbability "Object has been observed moving over the ground";
CM_ SG_ 927 RFL_Obj09_Length "Object Length. ISO 23150: Bounding box extent {length, width, height} (A.2.19)";
CM_ SG_ 927 RFL_Obj09_Valid "Object is valid or not";
CM_ SG_ 927 RFL_Obj09_LengthVnce "Variance of object Length. ISO 23150: Bounding box extent {length, width, height}  error (A.2.20)";
CM_ SG_ 927 RFL_Obj09_WidthVnce "Variance of object Width. ISO 23150: Bounding box extent {length, width, height}  error (A.2.20)";
CM_ SG_ 927 RFL_Obj09_Width "Object Width. ISO 23150: Bounding box extent {length, width, height} (A.2.19)";
CM_ SG_ 927 RFL_Obj09_BehaviorType "Indicates that which behavior the object associated for";
CM_ SG_ 927 RFL_Obj09_ObstacleConf "Confidence of the object being an Obstacle. ISO 23150: Potentially moving object classification type  confidence (A.2.12)";
CM_ SG_ 927 RFL_Obj09_NonObstacleConf "Confidence of the object being a Non-Obstacle. ISO 23150: Potentially moving object classification type  confidence (A.2.12)";
CM_ SG_ 927 RFL_Obj09_PxPyCoVnce "Covariance of Px and Py";
CM_ SG_ 927 RFL_Obj09_PxVxCoVnce "Covariance of Px and Vx";
CM_ SG_ 927 RFL_Obj09_PxVyCoVnce "Covariance of Px and Vy";
CM_ SG_ 927 RFL_Obj09_PyVxCoVnce "Covariance of Py and Vx";
CM_ SG_ 927 RFL_Obj09_PyVyCoVnce "Covariance of Py and Vy";
CM_ SG_ 927 RFL_Obj09_VxVyCoVnce "Covariance of Vx and Vy";
CM_ SG_ 927 RFL_Obj09_PxAxCoVnce "Covariance of Px and Ax";
CM_ SG_ 927 RFL_Obj09_PxAyCoVnce "Covariance of Px and Ay";
CM_ SG_ 927 RFL_Obj09_PyAxCoVnce "Covariance of Py and Ax";
CM_ SG_ 927 RFL_Obj09_PyAyCoVnce "Covariance of Py and Ay";
CM_ SG_ 927 RFL_Obj09_VxAxCoVnce "Covariance of Vx and Ax";
CM_ SG_ 927 RFL_Obj09_VxAyCoVnce "Covariance of Vx and Ay";
CM_ SG_ 927 RFL_Obj09_VyAxCoVnce "Covariance of Vy and Ax";
CM_ SG_ 927 RFL_Obj09_VyAyCoVnce "Covariance of Vy and Ay";
CM_ SG_ 927 RFL_Obj09_AxAyCoVnce "Covariance of Ax and Ay";
CM_ SG_ 927 RFL_Obj09_MobileObstConf "Confidence of the object being a mobile obstacle. ISO 23150: Potentially moving object classification type  confidence (A.2.12)";
CM_ SG_ 927 RFL_Obj09_Mob4PlusWhlConf "Confidence of a mobile object which has 4 or more wheels. ISO 23150: Potentially moving object classification type  confidence (A.2.12)";
CM_ SG_ 927 RFL_Obj09_Mob2WhlConf "Confidence of a mobile object being 2-wheels vehicle. ISO 23150: Potentially moving object classification type  confidence (A.2.12)";
CM_ SG_ 927 RFL_Obj09_MobPedConf "Confidence of a mobile object being a pedestrian. ISO 23150: Potentially moving object classification type  confidence (A.2.12)";
CM_ SG_ 927 RFL_Obj09_FourPlusWhlCarConf "Confidence of a mobile object which has 4 or more wheels--passenger car. ISO 23150: Potentially moving object classification type  confidence (A.2.12)";
CM_ SG_ 927 RFL_Obj09_FourPlusWhlHGVConf "Confidence of a mobile object which has 4 or more wheels--commercial vehicle (Truck). ISO 23150: Potentially moving object classification type  confidence (A.2.12)";
CM_ SG_ 927 RFL_Obj09_GroundReflexConf "Confidence of the object being a ground reflex. ISO 23150: Potentially moving object classification type  confidence (A.2.12)";
CM_ SG_ 927 RFL_Obj09_StatObstConf "Confidence of the object being a stationary obstacle. ISO 23150: Potentially moving object classification type  confidence (A.2.12)";
CM_ SG_ 927 RFL_Obj09_StatBarrierConf "Confidence of the object being a stationary road barrier. ISO 23150: Potentially moving object classification type  confidence (A.2.12)";
CM_ SG_ 1172 RFR_ObjHdr_CRC "CRC - Autosar E2E Profile 5";
CM_ SG_ 1172 RFR_ObjHdr_AliveCtr "Alive counter - Autosar E2E Profile 5";
CM_ SG_ 1172 RFR_ObjHdr_ProtBlockCtr "Protocol-Signal: Block-Counter";
CM_ SG_ 1172 RFR_ObjHdr_IfVersionIdMajor "Version information of the interface. e. g. version 1.0: Major = 1. ISO 23150: Interface version ID {major, minor, patch} (A.1.1)";
CM_ SG_ 1172 RFR_ObjHdr_IfVersionIdMinor "Version information of the interface. e. g. version 1.0: Minor = 0. ISO 23150: Interface version ID {major, minor, patch} (A.1.1)";
CM_ SG_ 1172 RFR_ObjHdr_NumValidObjects "number of detected VALID Objects that have been sent to the bus. ISO 23150: Number of valid potentially moving objects (A.1.12.1)";
CM_ SG_ 1172 RFR_ObjHdr_TimeStampStatus "Autosar StbM_TimeBaseStatusType bitfield with extension:
Bit 0: TIMEOUT
Bit 1: Reserved1
Bit 2: SYNC_TO_GATEWAY
Bit 3: GLOBAL_TIME_BASE
Bit 4: TIMELEAP_FUTURE
Bit 5: TIMELEAP_PAST
Bit 6: Reserved6
Bit 7: Extension: GENERAL_ERROR";
CM_ SG_ 1172 RFR_ObjHdr_TimeStamp "Time Stamp. ISO 23150: Time stamp  predicted (A.1.5.1)";
CM_ SG_ 1172 RFR_ObjHdr_SensorState "Bit 0: HW MALFUNCTION
Bit 1: DSP ISSUES
Bit 2: COMMUNICATION ERRORS
Bit 3: MISALIGNMENT (OUT OF SPEC)
Bit 4: SENSOR BLIDNESS DETECTED
Bit 5: SENSOR DISTURBED
Bit 6: OTHER ISSUES
Bit 7: RESERVED
Value 0: no event
Value 1: event occured";
CM_ SG_ 1172 RFR_ObjHdr_AziOutOfSpec "The sensor was detected to be out-of-spec due to misalignment in azimuth";
CM_ SG_ 1172 RFR_ObjHdr_ElevOutOfSpec "The sensor was detected to be out-of-spec due to misalignment in elevation";
CM_ SG_ 1172 RFR_ObjHdr_ObjectDownSel "the detected number of objects exceeded the number of max. objects that can be transmitted";
CM_ SG_ 1172 RFR_ObjHdr_SensorOriginPointY "Position of origin of sensor in lateral direction relative to mid axis of vehicle. ISO 23150: Sensor origin point {x, y, z} (A.1.22)";
CM_ SG_ 1172 RFR_ObjHdr_SensorOriginPointX "Position of origin of sensor in longitudinal direction relative to rear axis of vehicle. ISO 23150: Sensor origin point {x, y, z} (A.1.22)";
CM_ SG_ 1172 RFR_ObjHdr_SensorOriginPointZ "Position of origin of sensor in elevation direction relative to ground. ISO 23150: Sensor origin point {x, y, z} (A.1.22)";
CM_ SG_ 1172 RFR_ObjHdr_SensorOrientYaw "angle between sensor mounting direction and vehicle longitudinal axis, Azimuth. ISO 23150: Sensor orientation {yaw, pitch, roll} (A.1.24)";
CM_ SG_ 1172 RFR_ObjHdr_SensorOrientPitch "angle between sensor mounting direction and vehicle longitudinal axis, Elevation. ISO 23150: Sensor orientation {yaw, pitch, roll} (A.1.24)";
CM_ SG_ 1172 RFR_ObjHdr_SensorOrientRoll "Tilt of the mounting sensor. ISO 23150: Sensor orientation {yaw, pitch, roll} (A.1.24)";
CM_ SG_ 1172 RFR_ObjHdr_FovAzimuthBegin "Lower angle of the fied of view Azimuth. ISO 23150: Segment azimuth {begin, end} (A.5.1)";
CM_ SG_ 1172 RFR_ObjHdr_FovAzimuthEnd "Upper angle of the field of view Azimuth. ISO 23150: Segment azimuth {begin, end} (A.5.1)";
CM_ SG_ 1172 RFR_ObjHdr_FovElevationBegin "Lower angle of the fied of view Elevation. ISO 23150: Segment elevation {begin, end} (A.5.2)";
CM_ SG_ 1172 RFR_ObjHdr_FovElevationEnd "Upper angle of the field of view Elevation. ISO 23150: Segment elevation {begin, end} (A.5.2)";
CM_ SG_ 1172 RFR_ObjHdr_DetectionRange "Estimated detection range of the sensor";
CM_ SG_ 1172 RFR_ObjHdr_TimeStampLocal "Local Time Stamp";
CM_ SG_ 1174 RFR_Obj00_CRC "CRC - Autosar E2E Profile 5";
CM_ SG_ 1174 RFR_Obj00_AliveCtr "Alive counter - Autosar E2E Profile 5";
CM_ SG_ 1174 RFR_Obj00_ProtBlockCtr "Protocol-Signal: Block-Counter";
CM_ SG_ 1174 RFR_Obj00_ReferencePoint "Reference Point of the detected object. ISO 23150: Reference point (A.2.17)";
CM_ SG_ 1174 RFR_Obj00_ObjId "Unique Object ID. ISO 23150: Object ID (A.2.2)";
CM_ SG_ 1174 RFR_Obj00_MeasurementStatus "Object is measured or not. ISO 23150: Measurement status  object level (A.2.9)";
CM_ SG_ 1174 RFR_Obj00_Px "Object position in X direction. ISO 23150: Position  object level {x, y, z} (A.2.13)";
CM_ SG_ 1174 RFR_Obj00_Py "Object position in Y direction. ISO 23150: Position  object level {x, y, z} (A.2.13)";
CM_ SG_ 1174 RFR_Obj00_PxVnce "Variance of object position in X direction. ISO 23150: Position  object level {x, y, z}  error (A.2.14)";
CM_ SG_ 1174 RFR_Obj00_PyVnce "Variance of object position in Y direction. ISO 23150: Position  object level {x, y, z}  error (A.2.14)";
CM_ SG_ 1174 RFR_Obj00_Vx "Object relative velocity in X direction. ISO 23150: Velocity {x, y, z}  object level (A.2.23)";
CM_ SG_ 1174 RFR_Obj00_Vy "Object relative velocity in Y direction. ISO 23150: Velocity {x, y, z}  object level (A.2.23)";
CM_ SG_ 1174 RFR_Obj00_Ax "Object relative acceleration in X direction. ISO 23150: Acceleration {x, y, z} (A.2.25)";
CM_ SG_ 1174 RFR_Obj00_Ay "Object relative acceleration in Y direction. ISO 23150: Acceleration {x, y, z} (A.2.25)";
CM_ SG_ 1174 RFR_Obj00_OrientationYaw "Object orientation yaw angle. ISO 23150: Orientation {yaw, pitch, roll} (A.2.15)";
CM_ SG_ 1174 RFR_Obj00_ExistProb "Existence probability of object. ISO 23150: Existence probability  object level (A.2.1)";
CM_ SG_ 1174 RFR_Obj00_VxVnce "Variance of object relative velocity in X direction. ISO 23150: Velocity {x, y, z}  object level  error (A.2.24)";
CM_ SG_ 1174 RFR_Obj00_VyVnce "Variance of object relative velocity in Y direction. ISO 23150: Velocity {x, y, z}  object level  error (A.2.24)";
CM_ SG_ 1174 RFR_Obj00_AxVnce "Variance of object relative acceleration in X direction. ISO 23150: Acceleration {x, y, z}  error (A.2.26)";
CM_ SG_ 1174 RFR_Obj00_AyVnce "Variance of object relative acceleration in Y direction. ISO 23150: Acceleration {x, y, z}  error (A.2.26)";
CM_ SG_ 1174 RFR_Obj00_OrientationYawVnce "Variance of object orientation yaw angle. ISO 23150: Orientation {yaw, pitch, roll}  error (A.2.16)";
CM_ SG_ 1174 RFR_Obj00_MovingObserved "Object has been observed moving over the ground since it was first detected";
CM_ SG_ 1174 RFR_Obj00_MovingProbability "Object has been observed moving over the ground";
CM_ SG_ 1174 RFR_Obj00_Length "Object Length. ISO 23150: Bounding box extent {length, width, height} (A.2.19)";
CM_ SG_ 1174 RFR_Obj00_Valid "Object is valid or not";
CM_ SG_ 1174 RFR_Obj00_LengthVnce "Variance of object Length. ISO 23150: Bounding box extent {length, width, height}  error (A.2.20)";
CM_ SG_ 1174 RFR_Obj00_WidthVnce "Variance of object Width. ISO 23150: Bounding box extent {length, width, height}  error (A.2.20)";
CM_ SG_ 1174 RFR_Obj00_Width "Object Width. ISO 23150: Bounding box extent {length, width, height} (A.2.19)";
CM_ SG_ 1174 RFR_Obj00_BehaviorType "Indicates that which behavior the object associated for";
CM_ SG_ 1174 RFR_Obj00_ObstacleConf "Confidence of the object being an Obstacle. ISO 23150: Potentially moving object classification type  confidence (A.2.12)";
CM_ SG_ 1174 RFR_Obj00_NonObstacleConf "Confidence of the object being a Non-Obstacle. ISO 23150: Potentially moving object classification type  confidence (A.2.12)";
CM_ SG_ 1174 RFR_Obj00_PxPyCoVnce "Covariance of Px and Py";
CM_ SG_ 1174 RFR_Obj00_PxVxCoVnce "Covariance of Px and Vx";
CM_ SG_ 1174 RFR_Obj00_PxVyCoVnce "Covariance of Px and Vy";
CM_ SG_ 1174 RFR_Obj00_PyVxCoVnce "Covariance of Py and Vx";
CM_ SG_ 1174 RFR_Obj00_PyVyCoVnce "Covariance of Py and Vy";
CM_ SG_ 1174 RFR_Obj00_VxVyCoVnce "Covariance of Vx and Vy";
CM_ SG_ 1174 RFR_Obj00_PxAxCoVnce "Covariance of Px and Ax";
CM_ SG_ 1174 RFR_Obj00_PxAyCoVnce "Covariance of Px and Ay";
CM_ SG_ 1174 RFR_Obj00_PyAxCoVnce "Covariance of Py and Ax";
CM_ SG_ 1174 RFR_Obj00_PyAyCoVnce "Covariance of Py and Ay";
CM_ SG_ 1174 RFR_Obj00_VxAxCoVnce "Covariance of Vx and Ax";
CM_ SG_ 1174 RFR_Obj00_VxAyCoVnce "Covariance of Vx and Ay";
CM_ SG_ 1174 RFR_Obj00_VyAxCoVnce "Covariance of Vy and Ax";
CM_ SG_ 1174 RFR_Obj00_VyAyCoVnce "Covariance of Vy and Ay";
CM_ SG_ 1174 RFR_Obj00_AxAyCoVnce "Covariance of Ax and Ay";
CM_ SG_ 1174 RFR_Obj00_MobileObstConf "Confidence of the object being a mobile obstacle. ISO 23150: Potentially moving object classification type  confidence (A.2.12)";
CM_ SG_ 1174 RFR_Obj00_Mob4PlusWhlConf "Confidence of a mobile object which has 4 or more wheels. ISO 23150: Potentially moving object classification type  confidence (A.2.12)";
CM_ SG_ 1174 RFR_Obj00_Mob2WhlConf "Confidence of a mobile object being 2-wheels vehicle. ISO 23150: Potentially moving object classification type  confidence (A.2.12)";
CM_ SG_ 1174 RFR_Obj00_MobPedConf "Confidence of a mobile object being a pedestrian. ISO 23150: Potentially moving object classification type  confidence (A.2.12)";
CM_ SG_ 1174 RFR_Obj00_FourPlusWhlCarConf "Confidence of a mobile object which has 4 or more wheels--passenger car. ISO 23150: Potentially moving object classification type  confidence (A.2.12)";
CM_ SG_ 1174 RFR_Obj00_FourPlusWhlHGVConf "Confidence of a mobile object which has 4 or more wheels--commercial vehicle (Truck). ISO 23150: Potentially moving object classification type  confidence (A.2.12)";
CM_ SG_ 1174 RFR_Obj00_GroundReflexConf "Confidence of the object being a ground reflex. ISO 23150: Potentially moving object classification type  confidence (A.2.12)";
CM_ SG_ 1174 RFR_Obj00_StatObstConf "Confidence of the object being a stationary obstacle. ISO 23150: Potentially moving object classification type  confidence (A.2.12)";
CM_ SG_ 1174 RFR_Obj00_StatBarrierConf "Confidence of the object being a stationary road barrier. ISO 23150: Potentially moving object classification type  confidence (A.2.12)";
CM_ SG_ 1175 RFR_Obj01_CRC "CRC - Autosar E2E Profile 5";
CM_ SG_ 1175 RFR_Obj01_AliveCtr "Alive counter - Autosar E2E Profile 5";
CM_ SG_ 1175 RFR_Obj01_ProtBlockCtr "Protocol-Signal: Block-Counter";
CM_ SG_ 1175 RFR_Obj01_ReferencePoint "Reference Point of the detected object. ISO 23150: Reference point (A.2.17)";
CM_ SG_ 1175 RFR_Obj01_ObjId "Unique Object ID. ISO 23150: Object ID (A.2.2)";
CM_ SG_ 1175 RFR_Obj01_MeasurementStatus "Object is measured or not. ISO 23150: Measurement status  object level (A.2.9)";
CM_ SG_ 1175 RFR_Obj01_Px "Object position in X direction. ISO 23150: Position  object level {x, y, z} (A.2.13)";
CM_ SG_ 1175 RFR_Obj01_Py "Object position in Y direction. ISO 23150: Position  object level {x, y, z} (A.2.13)";
CM_ SG_ 1175 RFR_Obj01_PxVnce "Variance of object position in X direction. ISO 23150: Position  object level {x, y, z}  error (A.2.14)";
CM_ SG_ 1175 RFR_Obj01_PyVnce "Variance of object position in Y direction. ISO 23150: Position  object level {x, y, z}  error (A.2.14)";
CM_ SG_ 1175 RFR_Obj01_Vx "Object relative velocity in X direction. ISO 23150: Velocity {x, y, z}  object level (A.2.23)";
CM_ SG_ 1175 RFR_Obj01_Vy "Object relative velocity in Y direction. ISO 23150: Velocity {x, y, z}  object level (A.2.23)";
CM_ SG_ 1175 RFR_Obj01_Ax "Object relative acceleration in X direction. ISO 23150: Acceleration {x, y, z} (A.2.25)";
CM_ SG_ 1175 RFR_Obj01_Ay "Object relative acceleration in Y direction. ISO 23150: Acceleration {x, y, z} (A.2.25)";
CM_ SG_ 1175 RFR_Obj01_OrientationYaw "Object orientation yaw angle. ISO 23150: Orientation {yaw, pitch, roll} (A.2.15)";
CM_ SG_ 1175 RFR_Obj01_ExistProb "Existence probability of object. ISO 23150: Existence probability  object level (A.2.1)";
CM_ SG_ 1175 RFR_Obj01_VxVnce "Variance of object relative velocity in X direction. ISO 23150: Velocity {x, y, z}  object level  error (A.2.24)";
CM_ SG_ 1175 RFR_Obj01_VyVnce "Variance of object relative velocity in Y direction. ISO 23150: Velocity {x, y, z}  object level  error (A.2.24)";
CM_ SG_ 1175 RFR_Obj01_AxVnce "Variance of object relative acceleration in X direction. ISO 23150: Acceleration {x, y, z}  error (A.2.26)";
CM_ SG_ 1175 RFR_Obj01_AyVnce "Variance of object relative acceleration in Y direction. ISO 23150: Acceleration {x, y, z}  error (A.2.26)";
CM_ SG_ 1175 RFR_Obj01_OrientationYawVnce "Variance of object orientation yaw angle. ISO 23150: Orientation {yaw, pitch, roll}  error (A.2.16)";
CM_ SG_ 1175 RFR_Obj01_MovingObserved "Object has been observed moving over the ground since it was first detected";
CM_ SG_ 1175 RFR_Obj01_MovingProbability "Object has been observed moving over the ground";
CM_ SG_ 1175 RFR_Obj01_Length "Object Length. ISO 23150: Bounding box extent {length, width, height} (A.2.19)";
CM_ SG_ 1175 RFR_Obj01_Valid "Object is valid or not";
CM_ SG_ 1175 RFR_Obj01_LengthVnce "Variance of object Length. ISO 23150: Bounding box extent {length, width, height}  error (A.2.20)";
CM_ SG_ 1175 RFR_Obj01_WidthVnce "Variance of object Width. ISO 23150: Bounding box extent {length, width, height}  error (A.2.20)";
CM_ SG_ 1175 RFR_Obj01_Width "Object Width. ISO 23150: Bounding box extent {length, width, height} (A.2.19)";
CM_ SG_ 1175 RFR_Obj01_BehaviorType "Indicates that which behavior the object associated for";
CM_ SG_ 1175 RFR_Obj01_ObstacleConf "Confidence of the object being an Obstacle. ISO 23150: Potentially moving object classification type  confidence (A.2.12)";
CM_ SG_ 1175 RFR_Obj01_NonObstacleConf "Confidence of the object being a Non-Obstacle. ISO 23150: Potentially moving object classification type  confidence (A.2.12)";
CM_ SG_ 1175 RFR_Obj01_PxPyCoVnce "Covariance of Px and Py";
CM_ SG_ 1175 RFR_Obj01_PxVxCoVnce "Covariance of Px and Vx";
CM_ SG_ 1175 RFR_Obj01_PxVyCoVnce "Covariance of Px and Vy";
CM_ SG_ 1175 RFR_Obj01_PyVxCoVnce "Covariance of Py and Vx";
CM_ SG_ 1175 RFR_Obj01_PyVyCoVnce "Covariance of Py and Vy";
CM_ SG_ 1175 RFR_Obj01_VxVyCoVnce "Covariance of Vx and Vy";
CM_ SG_ 1175 RFR_Obj01_PxAxCoVnce "Covariance of Px and Ax";
CM_ SG_ 1175 RFR_Obj01_PxAyCoVnce "Covariance of Px and Ay";
CM_ SG_ 1175 RFR_Obj01_PyAxCoVnce "Covariance of Py and Ax";
CM_ SG_ 1175 RFR_Obj01_PyAyCoVnce "Covariance of Py and Ay";
CM_ SG_ 1175 RFR_Obj01_VxAxCoVnce "Covariance of Vx and Ax";
CM_ SG_ 1175 RFR_Obj01_VxAyCoVnce "Covariance of Vx and Ay";
CM_ SG_ 1175 RFR_Obj01_VyAxCoVnce "Covariance of Vy and Ax";
CM_ SG_ 1175 RFR_Obj01_VyAyCoVnce "Covariance of Vy and Ay";
CM_ SG_ 1175 RFR_Obj01_AxAyCoVnce "Covariance of Ax and Ay";
CM_ SG_ 1175 RFR_Obj01_MobileObstConf "Confidence of the object being a mobile obstacle. ISO 23150: Potentially moving object classification type  confidence (A.2.12)";
CM_ SG_ 1175 RFR_Obj01_Mob4PlusWhlConf "Confidence of a mobile object which has 4 or more wheels. ISO 23150: Potentially moving object classification type  confidence (A.2.12)";
CM_ SG_ 1175 RFR_Obj01_Mob2WhlConf "Confidence of a mobile object being 2-wheels vehicle. ISO 23150: Potentially moving object classification type  confidence (A.2.12)";
CM_ SG_ 1175 RFR_Obj01_MobPedConf "Confidence of a mobile object being a pedestrian. ISO 23150: Potentially moving object classification type  confidence (A.2.12)";
CM_ SG_ 1175 RFR_Obj01_FourPlusWhlCarConf "Confidence of a mobile object which has 4 or more wheels--passenger car. ISO 23150: Potentially moving object classification type  confidence (A.2.12)";
CM_ SG_ 1175 RFR_Obj01_FourPlusWhlHGVConf "Confidence of a mobile object which has 4 or more wheels--commercial vehicle (Truck). ISO 23150: Potentially moving object classification type  confidence (A.2.12)";
CM_ SG_ 1175 RFR_Obj01_GroundReflexConf "Confidence of the object being a ground reflex. ISO 23150: Potentially moving object classification type  confidence (A.2.12)";
CM_ SG_ 1175 RFR_Obj01_StatObstConf "Confidence of the object being a stationary obstacle. ISO 23150: Potentially moving object classification type  confidence (A.2.12)";
CM_ SG_ 1175 RFR_Obj01_StatBarrierConf "Confidence of the object being a stationary road barrier. ISO 23150: Potentially moving object classification type  confidence (A.2.12)";
CM_ SG_ 1176 RFR_Obj02_CRC "CRC - Autosar E2E Profile 5";
CM_ SG_ 1176 RFR_Obj02_AliveCtr "Alive counter - Autosar E2E Profile 5";
CM_ SG_ 1176 RFR_Obj02_ProtBlockCtr "Protocol-Signal: Block-Counter";
CM_ SG_ 1176 RFR_Obj02_ReferencePoint "Reference Point of the detected object. ISO 23150: Reference point (A.2.17)";
CM_ SG_ 1176 RFR_Obj02_ObjId "Unique Object ID. ISO 23150: Object ID (A.2.2)";
CM_ SG_ 1176 RFR_Obj02_MeasurementStatus "Object is measured or not. ISO 23150: Measurement status  object level (A.2.9)";
CM_ SG_ 1176 RFR_Obj02_Px "Object position in X direction. ISO 23150: Position  object level {x, y, z} (A.2.13)";
CM_ SG_ 1176 RFR_Obj02_Py "Object position in Y direction. ISO 23150: Position  object level {x, y, z} (A.2.13)";
CM_ SG_ 1176 RFR_Obj02_PxVnce "Variance of object position in X direction. ISO 23150: Position  object level {x, y, z}  error (A.2.14)";
CM_ SG_ 1176 RFR_Obj02_PyVnce "Variance of object position in Y direction. ISO 23150: Position  object level {x, y, z}  error (A.2.14)";
CM_ SG_ 1176 RFR_Obj02_Vx "Object relative velocity in X direction. ISO 23150: Velocity {x, y, z}  object level (A.2.23)";
CM_ SG_ 1176 RFR_Obj02_Vy "Object relative velocity in Y direction. ISO 23150: Velocity {x, y, z}  object level (A.2.23)";
CM_ SG_ 1176 RFR_Obj02_Ax "Object relative acceleration in X direction. ISO 23150: Acceleration {x, y, z} (A.2.25)";
CM_ SG_ 1176 RFR_Obj02_Ay "Object relative acceleration in Y direction. ISO 23150: Acceleration {x, y, z} (A.2.25)";
CM_ SG_ 1176 RFR_Obj02_OrientationYaw "Object orientation yaw angle. ISO 23150: Orientation {yaw, pitch, roll} (A.2.15)";
CM_ SG_ 1176 RFR_Obj02_ExistProb "Existence probability of object. ISO 23150: Existence probability  object level (A.2.1)";
CM_ SG_ 1176 RFR_Obj02_VxVnce "Variance of object relative velocity in X direction. ISO 23150: Velocity {x, y, z}  object level  error (A.2.24)";
CM_ SG_ 1176 RFR_Obj02_VyVnce "Variance of object relative velocity in Y direction. ISO 23150: Velocity {x, y, z}  object level  error (A.2.24)";
CM_ SG_ 1176 RFR_Obj02_AxVnce "Variance of object relative acceleration in X direction. ISO 23150: Acceleration {x, y, z}  error (A.2.26)";
CM_ SG_ 1176 RFR_Obj02_AyVnce "Variance of object relative acceleration in Y direction. ISO 23150: Acceleration {x, y, z}  error (A.2.26)";
CM_ SG_ 1176 RFR_Obj02_OrientationYawVnce "Variance of object orientation yaw angle. ISO 23150: Orientation {yaw, pitch, roll}  error (A.2.16)";
CM_ SG_ 1176 RFR_Obj02_MovingObserved "Object has been observed moving over the ground since it was first detected";
CM_ SG_ 1176 RFR_Obj02_MovingProbability "Object has been observed moving over the ground";
CM_ SG_ 1176 RFR_Obj02_Length "Object Length. ISO 23150: Bounding box extent {length, width, height} (A.2.19)";
CM_ SG_ 1176 RFR_Obj02_Valid "Object is valid or not";
CM_ SG_ 1176 RFR_Obj02_LengthVnce "Variance of object Length. ISO 23150: Bounding box extent {length, width, height}  error (A.2.20)";
CM_ SG_ 1176 RFR_Obj02_WidthVnce "Variance of object Width. ISO 23150: Bounding box extent {length, width, height}  error (A.2.20)";
CM_ SG_ 1176 RFR_Obj02_Width "Object Width. ISO 23150: Bounding box extent {length, width, height} (A.2.19)";
CM_ SG_ 1176 RFR_Obj02_BehaviorType "Indicates that which behavior the object associated for";
CM_ SG_ 1176 RFR_Obj02_ObstacleConf "Confidence of the object being an Obstacle. ISO 23150: Potentially moving object classification type  confidence (A.2.12)";
CM_ SG_ 1176 RFR_Obj02_NonObstacleConf "Confidence of the object being a Non-Obstacle. ISO 23150: Potentially moving object classification type  confidence (A.2.12)";
CM_ SG_ 1176 RFR_Obj02_PxPyCoVnce "Covariance of Px and Py";
CM_ SG_ 1176 RFR_Obj02_PxVxCoVnce "Covariance of Px and Vx";
CM_ SG_ 1176 RFR_Obj02_PxVyCoVnce "Covariance of Px and Vy";
CM_ SG_ 1176 RFR_Obj02_PyVxCoVnce "Covariance of Py and Vx";
CM_ SG_ 1176 RFR_Obj02_PyVyCoVnce "Covariance of Py and Vy";
CM_ SG_ 1176 RFR_Obj02_VxVyCoVnce "Covariance of Vx and Vy";
CM_ SG_ 1176 RFR_Obj02_PxAxCoVnce "Covariance of Px and Ax";
CM_ SG_ 1176 RFR_Obj02_PxAyCoVnce "Covariance of Px and Ay";
CM_ SG_ 1176 RFR_Obj02_PyAxCoVnce "Covariance of Py and Ax";
CM_ SG_ 1176 RFR_Obj02_PyAyCoVnce "Covariance of Py and Ay";
CM_ SG_ 1176 RFR_Obj02_VxAxCoVnce "Covariance of Vx and Ax";
CM_ SG_ 1176 RFR_Obj02_VxAyCoVnce "Covariance of Vx and Ay";
CM_ SG_ 1176 RFR_Obj02_VyAxCoVnce "Covariance of Vy and Ax";
CM_ SG_ 1176 RFR_Obj02_VyAyCoVnce "Covariance of Vy and Ay";
CM_ SG_ 1176 RFR_Obj02_AxAyCoVnce "Covariance of Ax and Ay";
CM_ SG_ 1176 RFR_Obj02_MobileObstConf "Confidence of the object being a mobile obstacle. ISO 23150: Potentially moving object classification type  confidence (A.2.12)";
CM_ SG_ 1176 RFR_Obj02_Mob4PlusWhlConf "Confidence of a mobile object which has 4 or more wheels. ISO 23150: Potentially moving object classification type  confidence (A.2.12)";
CM_ SG_ 1176 RFR_Obj02_Mob2WhlConf "Confidence of a mobile object being 2-wheels vehicle. ISO 23150: Potentially moving object classification type  confidence (A.2.12)";
CM_ SG_ 1176 RFR_Obj02_MobPedConf "Confidence of a mobile object being a pedestrian. ISO 23150: Potentially moving object classification type  confidence (A.2.12)";
CM_ SG_ 1176 RFR_Obj02_FourPlusWhlCarConf "Confidence of a mobile object which has 4 or more wheels--passenger car. ISO 23150: Potentially moving object classification type  confidence (A.2.12)";
CM_ SG_ 1176 RFR_Obj02_FourPlusWhlHGVConf "Confidence of a mobile object which has 4 or more wheels--commercial vehicle (Truck). ISO 23150: Potentially moving object classification type  confidence (A.2.12)";
CM_ SG_ 1176 RFR_Obj02_GroundReflexConf "Confidence of the object being a ground reflex. ISO 23150: Potentially moving object classification type  confidence (A.2.12)";
CM_ SG_ 1176 RFR_Obj02_StatObstConf "Confidence of the object being a stationary obstacle. ISO 23150: Potentially moving object classification type  confidence (A.2.12)";
CM_ SG_ 1176 RFR_Obj02_StatBarrierConf "Confidence of the object being a stationary road barrier. ISO 23150: Potentially moving object classification type  confidence (A.2.12)";
CM_ SG_ 1177 RFR_Obj03_CRC "CRC - Autosar E2E Profile 5";
CM_ SG_ 1177 RFR_Obj03_AliveCtr "Alive counter - Autosar E2E Profile 5";
CM_ SG_ 1177 RFR_Obj03_ProtBlockCtr "Protocol-Signal: Block-Counter";
CM_ SG_ 1177 RFR_Obj03_ReferencePoint "Reference Point of the detected object. ISO 23150: Reference point (A.2.17)";
CM_ SG_ 1177 RFR_Obj03_ObjId "Unique Object ID. ISO 23150: Object ID (A.2.2)";
CM_ SG_ 1177 RFR_Obj03_MeasurementStatus "Object is measured or not. ISO 23150: Measurement status  object level (A.2.9)";
CM_ SG_ 1177 RFR_Obj03_Px "Object position in X direction. ISO 23150: Position  object level {x, y, z} (A.2.13)";
CM_ SG_ 1177 RFR_Obj03_Py "Object position in Y direction. ISO 23150: Position  object level {x, y, z} (A.2.13)";
CM_ SG_ 1177 RFR_Obj03_PxVnce "Variance of object position in X direction. ISO 23150: Position  object level {x, y, z}  error (A.2.14)";
CM_ SG_ 1177 RFR_Obj03_PyVnce "Variance of object position in Y direction. ISO 23150: Position  object level {x, y, z}  error (A.2.14)";
CM_ SG_ 1177 RFR_Obj03_Vx "Object relative velocity in X direction. ISO 23150: Velocity {x, y, z}  object level (A.2.23)";
CM_ SG_ 1177 RFR_Obj03_Vy "Object relative velocity in Y direction. ISO 23150: Velocity {x, y, z}  object level (A.2.23)";
CM_ SG_ 1177 RFR_Obj03_Ax "Object relative acceleration in X direction. ISO 23150: Acceleration {x, y, z} (A.2.25)";
CM_ SG_ 1177 RFR_Obj03_Ay "Object relative acceleration in Y direction. ISO 23150: Acceleration {x, y, z} (A.2.25)";
CM_ SG_ 1177 RFR_Obj03_OrientationYaw "Object orientation yaw angle. ISO 23150: Orientation {yaw, pitch, roll} (A.2.15)";
CM_ SG_ 1177 RFR_Obj03_ExistProb "Existence probability of object. ISO 23150: Existence probability  object level (A.2.1)";
CM_ SG_ 1177 RFR_Obj03_VxVnce "Variance of object relative velocity in X direction. ISO 23150: Velocity {x, y, z}  object level  error (A.2.24)";
CM_ SG_ 1177 RFR_Obj03_VyVnce "Variance of object relative velocity in Y direction. ISO 23150: Velocity {x, y, z}  object level  error (A.2.24)";
CM_ SG_ 1177 RFR_Obj03_AxVnce "Variance of object relative acceleration in X direction. ISO 23150: Acceleration {x, y, z}  error (A.2.26)";
CM_ SG_ 1177 RFR_Obj03_AyVnce "Variance of object relative acceleration in Y direction. ISO 23150: Acceleration {x, y, z}  error (A.2.26)";
CM_ SG_ 1177 RFR_Obj03_OrientationYawVnce "Variance of object orientation yaw angle. ISO 23150: Orientation {yaw, pitch, roll}  error (A.2.16)";
CM_ SG_ 1177 RFR_Obj03_MovingObserved "Object has been observed moving over the ground since it was first detected";
CM_ SG_ 1177 RFR_Obj03_MovingProbability "Object has been observed moving over the ground";
CM_ SG_ 1177 RFR_Obj03_Length "Object Length. ISO 23150: Bounding box extent {length, width, height} (A.2.19)";
CM_ SG_ 1177 RFR_Obj03_Valid "Object is valid or not";
CM_ SG_ 1177 RFR_Obj03_LengthVnce "Variance of object Length. ISO 23150: Bounding box extent {length, width, height}  error (A.2.20)";
CM_ SG_ 1177 RFR_Obj03_WidthVnce "Variance of object Width. ISO 23150: Bounding box extent {length, width, height}  error (A.2.20)";
CM_ SG_ 1177 RFR_Obj03_Width "Object Width. ISO 23150: Bounding box extent {length, width, height} (A.2.19)";
CM_ SG_ 1177 RFR_Obj03_BehaviorType "Indicates that which behavior the object associated for";
CM_ SG_ 1177 RFR_Obj03_ObstacleConf "Confidence of the object being an Obstacle. ISO 23150: Potentially moving object classification type  confidence (A.2.12)";
CM_ SG_ 1177 RFR_Obj03_NonObstacleConf "Confidence of the object being a Non-Obstacle. ISO 23150: Potentially moving object classification type  confidence (A.2.12)";
CM_ SG_ 1177 RFR_Obj03_PxPyCoVnce "Covariance of Px and Py";
CM_ SG_ 1177 RFR_Obj03_PxVxCoVnce "Covariance of Px and Vx";
CM_ SG_ 1177 RFR_Obj03_PxVyCoVnce "Covariance of Px and Vy";
CM_ SG_ 1177 RFR_Obj03_PyVxCoVnce "Covariance of Py and Vx";
CM_ SG_ 1177 RFR_Obj03_PyVyCoVnce "Covariance of Py and Vy";
CM_ SG_ 1177 RFR_Obj03_VxVyCoVnce "Covariance of Vx and Vy";
CM_ SG_ 1177 RFR_Obj03_PxAxCoVnce "Covariance of Px and Ax";
CM_ SG_ 1177 RFR_Obj03_PxAyCoVnce "Covariance of Px and Ay";
CM_ SG_ 1177 RFR_Obj03_PyAxCoVnce "Covariance of Py and Ax";
CM_ SG_ 1177 RFR_Obj03_PyAyCoVnce "Covariance of Py and Ay";
CM_ SG_ 1177 RFR_Obj03_VxAxCoVnce "Covariance of Vx and Ax";
CM_ SG_ 1177 RFR_Obj03_VxAyCoVnce "Covariance of Vx and Ay";
CM_ SG_ 1177 RFR_Obj03_VyAxCoVnce "Covariance of Vy and Ax";
CM_ SG_ 1177 RFR_Obj03_VyAyCoVnce "Covariance of Vy and Ay";
CM_ SG_ 1177 RFR_Obj03_AxAyCoVnce "Covariance of Ax and Ay";
CM_ SG_ 1177 RFR_Obj03_MobileObstConf "Confidence of the object being a mobile obstacle. ISO 23150: Potentially moving object classification type  confidence (A.2.12)";
CM_ SG_ 1177 RFR_Obj03_Mob4PlusWhlConf "Confidence of a mobile object which has 4 or more wheels. ISO 23150: Potentially moving object classification type  confidence (A.2.12)";
CM_ SG_ 1177 RFR_Obj03_Mob2WhlConf "Confidence of a mobile object being 2-wheels vehicle. ISO 23150: Potentially moving object classification type  confidence (A.2.12)";
CM_ SG_ 1177 RFR_Obj03_MobPedConf "Confidence of a mobile object being a pedestrian. ISO 23150: Potentially moving object classification type  confidence (A.2.12)";
CM_ SG_ 1177 RFR_Obj03_FourPlusWhlCarConf "Confidence of a mobile object which has 4 or more wheels--passenger car. ISO 23150: Potentially moving object classification type  confidence (A.2.12)";
CM_ SG_ 1177 RFR_Obj03_FourPlusWhlHGVConf "Confidence of a mobile object which has 4 or more wheels--commercial vehicle (Truck). ISO 23150: Potentially moving object classification type  confidence (A.2.12)";
CM_ SG_ 1177 RFR_Obj03_GroundReflexConf "Confidence of the object being a ground reflex. ISO 23150: Potentially moving object classification type  confidence (A.2.12)";
CM_ SG_ 1177 RFR_Obj03_StatObstConf "Confidence of the object being a stationary obstacle. ISO 23150: Potentially moving object classification type  confidence (A.2.12)";
CM_ SG_ 1177 RFR_Obj03_StatBarrierConf "Confidence of the object being a stationary road barrier. ISO 23150: Potentially moving object classification type  confidence (A.2.12)";
CM_ SG_ 1178 RFR_Obj04_CRC "CRC - Autosar E2E Profile 5";
CM_ SG_ 1178 RFR_Obj04_AliveCtr "Alive counter - Autosar E2E Profile 5";
CM_ SG_ 1178 RFR_Obj04_ProtBlockCtr "Protocol-Signal: Block-Counter";
CM_ SG_ 1178 RFR_Obj04_ReferencePoint "Reference Point of the detected object. ISO 23150: Reference point (A.2.17)";
CM_ SG_ 1178 RFR_Obj04_ObjId "Unique Object ID. ISO 23150: Object ID (A.2.2)";
CM_ SG_ 1178 RFR_Obj04_MeasurementStatus "Object is measured or not. ISO 23150: Measurement status  object level (A.2.9)";
CM_ SG_ 1178 RFR_Obj04_Px "Object position in X direction. ISO 23150: Position  object level {x, y, z} (A.2.13)";
CM_ SG_ 1178 RFR_Obj04_Py "Object position in Y direction. ISO 23150: Position  object level {x, y, z} (A.2.13)";
CM_ SG_ 1178 RFR_Obj04_PxVnce "Variance of object position in X direction. ISO 23150: Position  object level {x, y, z}  error (A.2.14)";
CM_ SG_ 1178 RFR_Obj04_PyVnce "Variance of object position in Y direction. ISO 23150: Position  object level {x, y, z}  error (A.2.14)";
CM_ SG_ 1178 RFR_Obj04_Vx "Object relative velocity in X direction. ISO 23150: Velocity {x, y, z}  object level (A.2.23)";
CM_ SG_ 1178 RFR_Obj04_Vy "Object relative velocity in Y direction. ISO 23150: Velocity {x, y, z}  object level (A.2.23)";
CM_ SG_ 1178 RFR_Obj04_Ax "Object relative acceleration in X direction. ISO 23150: Acceleration {x, y, z} (A.2.25)";
CM_ SG_ 1178 RFR_Obj04_Ay "Object relative acceleration in Y direction. ISO 23150: Acceleration {x, y, z} (A.2.25)";
CM_ SG_ 1178 RFR_Obj04_OrientationYaw "Object orientation yaw angle. ISO 23150: Orientation {yaw, pitch, roll} (A.2.15)";
CM_ SG_ 1178 RFR_Obj04_ExistProb "Existence probability of object. ISO 23150: Existence probability  object level (A.2.1)";
CM_ SG_ 1178 RFR_Obj04_VxVnce "Variance of object relative velocity in X direction. ISO 23150: Velocity {x, y, z}  object level  error (A.2.24)";
CM_ SG_ 1178 RFR_Obj04_VyVnce "Variance of object relative velocity in Y direction. ISO 23150: Velocity {x, y, z}  object level  error (A.2.24)";
CM_ SG_ 1178 RFR_Obj04_AxVnce "Variance of object relative acceleration in X direction. ISO 23150: Acceleration {x, y, z}  error (A.2.26)";
CM_ SG_ 1178 RFR_Obj04_AyVnce "Variance of object relative acceleration in Y direction. ISO 23150: Acceleration {x, y, z}  error (A.2.26)";
CM_ SG_ 1178 RFR_Obj04_OrientationYawVnce "Variance of object orientation yaw angle. ISO 23150: Orientation {yaw, pitch, roll}  error (A.2.16)";
CM_ SG_ 1178 RFR_Obj04_MovingObserved "Object has been observed moving over the ground since it was first detected";
CM_ SG_ 1178 RFR_Obj04_MovingProbability "Object has been observed moving over the ground";
CM_ SG_ 1178 RFR_Obj04_Length "Object Length. ISO 23150: Bounding box extent {length, width, height} (A.2.19)";
CM_ SG_ 1178 RFR_Obj04_Valid "Object is valid or not";
CM_ SG_ 1178 RFR_Obj04_LengthVnce "Variance of object Length. ISO 23150: Bounding box extent {length, width, height}  error (A.2.20)";
CM_ SG_ 1178 RFR_Obj04_WidthVnce "Variance of object Width. ISO 23150: Bounding box extent {length, width, height}  error (A.2.20)";
CM_ SG_ 1178 RFR_Obj04_Width "Object Width. ISO 23150: Bounding box extent {length, width, height} (A.2.19)";
CM_ SG_ 1178 RFR_Obj04_BehaviorType "Indicates that which behavior the object associated for";
CM_ SG_ 1178 RFR_Obj04_ObstacleConf "Confidence of the object being an Obstacle. ISO 23150: Potentially moving object classification type  confidence (A.2.12)";
CM_ SG_ 1178 RFR_Obj04_NonObstacleConf "Confidence of the object being a Non-Obstacle. ISO 23150: Potentially moving object classification type  confidence (A.2.12)";
CM_ SG_ 1178 RFR_Obj04_PxPyCoVnce "Covariance of Px and Py";
CM_ SG_ 1178 RFR_Obj04_PxVxCoVnce "Covariance of Px and Vx";
CM_ SG_ 1178 RFR_Obj04_PxVyCoVnce "Covariance of Px and Vy";
CM_ SG_ 1178 RFR_Obj04_PyVxCoVnce "Covariance of Py and Vx";
CM_ SG_ 1178 RFR_Obj04_PyVyCoVnce "Covariance of Py and Vy";
CM_ SG_ 1178 RFR_Obj04_VxVyCoVnce "Covariance of Vx and Vy";
CM_ SG_ 1178 RFR_Obj04_PxAxCoVnce "Covariance of Px and Ax";
CM_ SG_ 1178 RFR_Obj04_PxAyCoVnce "Covariance of Px and Ay";
CM_ SG_ 1178 RFR_Obj04_PyAxCoVnce "Covariance of Py and Ax";
CM_ SG_ 1178 RFR_Obj04_PyAyCoVnce "Covariance of Py and Ay";
CM_ SG_ 1178 RFR_Obj04_VxAxCoVnce "Covariance of Vx and Ax";
CM_ SG_ 1178 RFR_Obj04_VxAyCoVnce "Covariance of Vx and Ay";
CM_ SG_ 1178 RFR_Obj04_VyAxCoVnce "Covariance of Vy and Ax";
CM_ SG_ 1178 RFR_Obj04_VyAyCoVnce "Covariance of Vy and Ay";
CM_ SG_ 1178 RFR_Obj04_AxAyCoVnce "Covariance of Ax and Ay";
CM_ SG_ 1178 RFR_Obj04_MobileObstConf "Confidence of the object being a mobile obstacle. ISO 23150: Potentially moving object classification type  confidence (A.2.12)";
CM_ SG_ 1178 RFR_Obj04_Mob4PlusWhlConf "Confidence of a mobile object which has 4 or more wheels. ISO 23150: Potentially moving object classification type  confidence (A.2.12)";
CM_ SG_ 1178 RFR_Obj04_Mob2WhlConf "Confidence of a mobile object being 2-wheels vehicle. ISO 23150: Potentially moving object classification type  confidence (A.2.12)";
CM_ SG_ 1178 RFR_Obj04_MobPedConf "Confidence of a mobile object being a pedestrian. ISO 23150: Potentially moving object classification type  confidence (A.2.12)";
CM_ SG_ 1178 RFR_Obj04_FourPlusWhlCarConf "Confidence of a mobile object which has 4 or more wheels--passenger car. ISO 23150: Potentially moving object classification type  confidence (A.2.12)";
CM_ SG_ 1178 RFR_Obj04_FourPlusWhlHGVConf "Confidence of a mobile object which has 4 or more wheels--commercial vehicle (Truck). ISO 23150: Potentially moving object classification type  confidence (A.2.12)";
CM_ SG_ 1178 RFR_Obj04_GroundReflexConf "Confidence of the object being a ground reflex. ISO 23150: Potentially moving object classification type  confidence (A.2.12)";
CM_ SG_ 1178 RFR_Obj04_StatObstConf "Confidence of the object being a stationary obstacle. ISO 23150: Potentially moving object classification type  confidence (A.2.12)";
CM_ SG_ 1178 RFR_Obj04_StatBarrierConf "Confidence of the object being a stationary road barrier. ISO 23150: Potentially moving object classification type  confidence (A.2.12)";
CM_ SG_ 1179 RFR_Obj05_CRC "CRC - Autosar E2E Profile 5";
CM_ SG_ 1179 RFR_Obj05_AliveCtr "Alive counter - Autosar E2E Profile 5";
CM_ SG_ 1179 RFR_Obj05_ProtBlockCtr "Protocol-Signal: Block-Counter";
CM_ SG_ 1179 RFR_Obj05_ReferencePoint "Reference Point of the detected object. ISO 23150: Reference point (A.2.17)";
CM_ SG_ 1179 RFR_Obj05_ObjId "Unique Object ID. ISO 23150: Object ID (A.2.2)";
CM_ SG_ 1179 RFR_Obj05_MeasurementStatus "Object is measured or not. ISO 23150: Measurement status  object level (A.2.9)";
CM_ SG_ 1179 RFR_Obj05_Px "Object position in X direction. ISO 23150: Position  object level {x, y, z} (A.2.13)";
CM_ SG_ 1179 RFR_Obj05_Py "Object position in Y direction. ISO 23150: Position  object level {x, y, z} (A.2.13)";
CM_ SG_ 1179 RFR_Obj05_PxVnce "Variance of object position in X direction. ISO 23150: Position  object level {x, y, z}  error (A.2.14)";
CM_ SG_ 1179 RFR_Obj05_PyVnce "Variance of object position in Y direction. ISO 23150: Position  object level {x, y, z}  error (A.2.14)";
CM_ SG_ 1179 RFR_Obj05_Vx "Object relative velocity in X direction. ISO 23150: Velocity {x, y, z}  object level (A.2.23)";
CM_ SG_ 1179 RFR_Obj05_Vy "Object relative velocity in Y direction. ISO 23150: Velocity {x, y, z}  object level (A.2.23)";
CM_ SG_ 1179 RFR_Obj05_Ax "Object relative acceleration in X direction. ISO 23150: Acceleration {x, y, z} (A.2.25)";
CM_ SG_ 1179 RFR_Obj05_Ay "Object relative acceleration in Y direction. ISO 23150: Acceleration {x, y, z} (A.2.25)";
CM_ SG_ 1179 RFR_Obj05_OrientationYaw "Object orientation yaw angle. ISO 23150: Orientation {yaw, pitch, roll} (A.2.15)";
CM_ SG_ 1179 RFR_Obj05_ExistProb "Existence probability of object. ISO 23150: Existence probability  object level (A.2.1)";
CM_ SG_ 1179 RFR_Obj05_VxVnce "Variance of object relative velocity in X direction. ISO 23150: Velocity {x, y, z}  object level  error (A.2.24)";
CM_ SG_ 1179 RFR_Obj05_VyVnce "Variance of object relative velocity in Y direction. ISO 23150: Velocity {x, y, z}  object level  error (A.2.24)";
CM_ SG_ 1179 RFR_Obj05_AxVnce "Variance of object relative acceleration in X direction. ISO 23150: Acceleration {x, y, z}  error (A.2.26)";
CM_ SG_ 1179 RFR_Obj05_AyVnce "Variance of object relative acceleration in Y direction. ISO 23150: Acceleration {x, y, z}  error (A.2.26)";
CM_ SG_ 1179 RFR_Obj05_OrientationYawVnce "Variance of object orientation yaw angle. ISO 23150: Orientation {yaw, pitch, roll}  error (A.2.16)";
CM_ SG_ 1179 RFR_Obj05_MovingObserved "Object has been observed moving over the ground since it was first detected";
CM_ SG_ 1179 RFR_Obj05_MovingProbability "Object has been observed moving over the ground";
CM_ SG_ 1179 RFR_Obj05_Length "Object Length. ISO 23150: Bounding box extent {length, width, height} (A.2.19)";
CM_ SG_ 1179 RFR_Obj05_Valid "Object is valid or not";
CM_ SG_ 1179 RFR_Obj05_LengthVnce "Variance of object Length. ISO 23150: Bounding box extent {length, width, height}  error (A.2.20)";
CM_ SG_ 1179 RFR_Obj05_WidthVnce "Variance of object Width. ISO 23150: Bounding box extent {length, width, height}  error (A.2.20)";
CM_ SG_ 1179 RFR_Obj05_Width "Object Width. ISO 23150: Bounding box extent {length, width, height} (A.2.19)";
CM_ SG_ 1179 RFR_Obj05_BehaviorType "Indicates that which behavior the object associated for";
CM_ SG_ 1179 RFR_Obj05_ObstacleConf "Confidence of the object being an Obstacle. ISO 23150: Potentially moving object classification type  confidence (A.2.12)";
CM_ SG_ 1179 RFR_Obj05_NonObstacleConf "Confidence of the object being a Non-Obstacle. ISO 23150: Potentially moving object classification type  confidence (A.2.12)";
CM_ SG_ 1179 RFR_Obj05_PxPyCoVnce "Covariance of Px and Py";
CM_ SG_ 1179 RFR_Obj05_PxVxCoVnce "Covariance of Px and Vx";
CM_ SG_ 1179 RFR_Obj05_PxVyCoVnce "Covariance of Px and Vy";
CM_ SG_ 1179 RFR_Obj05_PyVxCoVnce "Covariance of Py and Vx";
CM_ SG_ 1179 RFR_Obj05_PyVyCoVnce "Covariance of Py and Vy";
CM_ SG_ 1179 RFR_Obj05_VxVyCoVnce "Covariance of Vx and Vy";
CM_ SG_ 1179 RFR_Obj05_PxAxCoVnce "Covariance of Px and Ax";
CM_ SG_ 1179 RFR_Obj05_PxAyCoVnce "Covariance of Px and Ay";
CM_ SG_ 1179 RFR_Obj05_PyAxCoVnce "Covariance of Py and Ax";
CM_ SG_ 1179 RFR_Obj05_PyAyCoVnce "Covariance of Py and Ay";
CM_ SG_ 1179 RFR_Obj05_VxAxCoVnce "Covariance of Vx and Ax";
CM_ SG_ 1179 RFR_Obj05_VxAyCoVnce "Covariance of Vx and Ay";
CM_ SG_ 1179 RFR_Obj05_VyAxCoVnce "Covariance of Vy and Ax";
CM_ SG_ 1179 RFR_Obj05_VyAyCoVnce "Covariance of Vy and Ay";
CM_ SG_ 1179 RFR_Obj05_AxAyCoVnce "Covariance of Ax and Ay";
CM_ SG_ 1179 RFR_Obj05_MobileObstConf "Confidence of the object being a mobile obstacle. ISO 23150: Potentially moving object classification type  confidence (A.2.12)";
CM_ SG_ 1179 RFR_Obj05_Mob4PlusWhlConf "Confidence of a mobile object which has 4 or more wheels. ISO 23150: Potentially moving object classification type  confidence (A.2.12)";
CM_ SG_ 1179 RFR_Obj05_Mob2WhlConf "Confidence of a mobile object being 2-wheels vehicle. ISO 23150: Potentially moving object classification type  confidence (A.2.12)";
CM_ SG_ 1179 RFR_Obj05_MobPedConf "Confidence of a mobile object being a pedestrian. ISO 23150: Potentially moving object classification type  confidence (A.2.12)";
CM_ SG_ 1179 RFR_Obj05_FourPlusWhlCarConf "Confidence of a mobile object which has 4 or more wheels--passenger car. ISO 23150: Potentially moving object classification type  confidence (A.2.12)";
CM_ SG_ 1179 RFR_Obj05_FourPlusWhlHGVConf "Confidence of a mobile object which has 4 or more wheels--commercial vehicle (Truck). ISO 23150: Potentially moving object classification type  confidence (A.2.12)";
CM_ SG_ 1179 RFR_Obj05_GroundReflexConf "Confidence of the object being a ground reflex. ISO 23150: Potentially moving object classification type  confidence (A.2.12)";
CM_ SG_ 1179 RFR_Obj05_StatObstConf "Confidence of the object being a stationary obstacle. ISO 23150: Potentially moving object classification type  confidence (A.2.12)";
CM_ SG_ 1179 RFR_Obj05_StatBarrierConf "Confidence of the object being a stationary road barrier. ISO 23150: Potentially moving object classification type  confidence (A.2.12)";
CM_ SG_ 1180 RFR_Obj06_CRC "CRC - Autosar E2E Profile 5";
CM_ SG_ 1180 RFR_Obj06_AliveCtr "Alive counter - Autosar E2E Profile 5";
CM_ SG_ 1180 RFR_Obj06_ProtBlockCtr "Protocol-Signal: Block-Counter";
CM_ SG_ 1180 RFR_Obj06_ReferencePoint "Reference Point of the detected object. ISO 23150: Reference point (A.2.17)";
CM_ SG_ 1180 RFR_Obj06_ObjId "Unique Object ID. ISO 23150: Object ID (A.2.2)";
CM_ SG_ 1180 RFR_Obj06_MeasurementStatus "Object is measured or not. ISO 23150: Measurement status  object level (A.2.9)";
CM_ SG_ 1180 RFR_Obj06_Px "Object position in X direction. ISO 23150: Position  object level {x, y, z} (A.2.13)";
CM_ SG_ 1180 RFR_Obj06_Py "Object position in Y direction. ISO 23150: Position  object level {x, y, z} (A.2.13)";
CM_ SG_ 1180 RFR_Obj06_PxVnce "Variance of object position in X direction. ISO 23150: Position  object level {x, y, z}  error (A.2.14)";
CM_ SG_ 1180 RFR_Obj06_PyVnce "Variance of object position in Y direction. ISO 23150: Position  object level {x, y, z}  error (A.2.14)";
CM_ SG_ 1180 RFR_Obj06_Vx "Object relative velocity in X direction. ISO 23150: Velocity {x, y, z}  object level (A.2.23)";
CM_ SG_ 1180 RFR_Obj06_Vy "Object relative velocity in Y direction. ISO 23150: Velocity {x, y, z}  object level (A.2.23)";
CM_ SG_ 1180 RFR_Obj06_Ax "Object relative acceleration in X direction. ISO 23150: Acceleration {x, y, z} (A.2.25)";
CM_ SG_ 1180 RFR_Obj06_Ay "Object relative acceleration in Y direction. ISO 23150: Acceleration {x, y, z} (A.2.25)";
CM_ SG_ 1180 RFR_Obj06_OrientationYaw "Object orientation yaw angle. ISO 23150: Orientation {yaw, pitch, roll} (A.2.15)";
CM_ SG_ 1180 RFR_Obj06_ExistProb "Existence probability of object. ISO 23150: Existence probability  object level (A.2.1)";
CM_ SG_ 1180 RFR_Obj06_VxVnce "Variance of object relative velocity in X direction. ISO 23150: Velocity {x, y, z}  object level  error (A.2.24)";
CM_ SG_ 1180 RFR_Obj06_VyVnce "Variance of object relative velocity in Y direction. ISO 23150: Velocity {x, y, z}  object level  error (A.2.24)";
CM_ SG_ 1180 RFR_Obj06_AxVnce "Variance of object relative acceleration in X direction. ISO 23150: Acceleration {x, y, z}  error (A.2.26)";
CM_ SG_ 1180 RFR_Obj06_AyVnce "Variance of object relative acceleration in Y direction. ISO 23150: Acceleration {x, y, z}  error (A.2.26)";
CM_ SG_ 1180 RFR_Obj06_OrientationYawVnce "Variance of object orientation yaw angle. ISO 23150: Orientation {yaw, pitch, roll}  error (A.2.16)";
CM_ SG_ 1180 RFR_Obj06_MovingObserved "Object has been observed moving over the ground since it was first detected";
CM_ SG_ 1180 RFR_Obj06_MovingProbability "Object has been observed moving over the ground";
CM_ SG_ 1180 RFR_Obj06_Length "Object Length. ISO 23150: Bounding box extent {length, width, height} (A.2.19)";
CM_ SG_ 1180 RFR_Obj06_Valid "Object is valid or not";
CM_ SG_ 1180 RFR_Obj06_LengthVnce "Variance of object Length. ISO 23150: Bounding box extent {length, width, height}  error (A.2.20)";
CM_ SG_ 1180 RFR_Obj06_WidthVnce "Variance of object Width. ISO 23150: Bounding box extent {length, width, height}  error (A.2.20)";
CM_ SG_ 1180 RFR_Obj06_Width "Object Width. ISO 23150: Bounding box extent {length, width, height} (A.2.19)";
CM_ SG_ 1180 RFR_Obj06_BehaviorType "Indicates that which behavior the object associated for";
CM_ SG_ 1180 RFR_Obj06_ObstacleConf "Confidence of the object being an Obstacle. ISO 23150: Potentially moving object classification type  confidence (A.2.12)";
CM_ SG_ 1180 RFR_Obj06_NonObstacleConf "Confidence of the object being a Non-Obstacle. ISO 23150: Potentially moving object classification type  confidence (A.2.12)";
CM_ SG_ 1180 RFR_Obj06_PxPyCoVnce "Covariance of Px and Py";
CM_ SG_ 1180 RFR_Obj06_PxVxCoVnce "Covariance of Px and Vx";
CM_ SG_ 1180 RFR_Obj06_PxVyCoVnce "Covariance of Px and Vy";
CM_ SG_ 1180 RFR_Obj06_PyVxCoVnce "Covariance of Py and Vx";
CM_ SG_ 1180 RFR_Obj06_PyVyCoVnce "Covariance of Py and Vy";
CM_ SG_ 1180 RFR_Obj06_VxVyCoVnce "Covariance of Vx and Vy";
CM_ SG_ 1180 RFR_Obj06_PxAxCoVnce "Covariance of Px and Ax";
CM_ SG_ 1180 RFR_Obj06_PxAyCoVnce "Covariance of Px and Ay";
CM_ SG_ 1180 RFR_Obj06_PyAxCoVnce "Covariance of Py and Ax";
CM_ SG_ 1180 RFR_Obj06_PyAyCoVnce "Covariance of Py and Ay";
CM_ SG_ 1180 RFR_Obj06_VxAxCoVnce "Covariance of Vx and Ax";
CM_ SG_ 1180 RFR_Obj06_VxAyCoVnce "Covariance of Vx and Ay";
CM_ SG_ 1180 RFR_Obj06_VyAxCoVnce "Covariance of Vy and Ax";
CM_ SG_ 1180 RFR_Obj06_VyAyCoVnce "Covariance of Vy and Ay";
CM_ SG_ 1180 RFR_Obj06_AxAyCoVnce "Covariance of Ax and Ay";
CM_ SG_ 1180 RFR_Obj06_MobileObstConf "Confidence of the object being a mobile obstacle. ISO 23150: Potentially moving object classification type  confidence (A.2.12)";
CM_ SG_ 1180 RFR_Obj06_Mob4PlusWhlConf "Confidence of a mobile object which has 4 or more wheels. ISO 23150: Potentially moving object classification type  confidence (A.2.12)";
CM_ SG_ 1180 RFR_Obj06_Mob2WhlConf "Confidence of a mobile object being 2-wheels vehicle. ISO 23150: Potentially moving object classification type  confidence (A.2.12)";
CM_ SG_ 1180 RFR_Obj06_MobPedConf "Confidence of a mobile object being a pedestrian. ISO 23150: Potentially moving object classification type  confidence (A.2.12)";
CM_ SG_ 1180 RFR_Obj06_FourPlusWhlCarConf "Confidence of a mobile object which has 4 or more wheels--passenger car. ISO 23150: Potentially moving object classification type  confidence (A.2.12)";
CM_ SG_ 1180 RFR_Obj06_FourPlusWhlHGVConf "Confidence of a mobile object which has 4 or more wheels--commercial vehicle (Truck). ISO 23150: Potentially moving object classification type  confidence (A.2.12)";
CM_ SG_ 1180 RFR_Obj06_GroundReflexConf "Confidence of the object being a ground reflex. ISO 23150: Potentially moving object classification type  confidence (A.2.12)";
CM_ SG_ 1180 RFR_Obj06_StatObstConf "Confidence of the object being a stationary obstacle. ISO 23150: Potentially moving object classification type  confidence (A.2.12)";
CM_ SG_ 1180 RFR_Obj06_StatBarrierConf "Confidence of the object being a stationary road barrier. ISO 23150: Potentially moving object classification type  confidence (A.2.12)";
CM_ SG_ 1181 RFR_Obj07_CRC "CRC - Autosar E2E Profile 5";
CM_ SG_ 1181 RFR_Obj07_AliveCtr "Alive counter - Autosar E2E Profile 5";
CM_ SG_ 1181 RFR_Obj07_ProtBlockCtr "Protocol-Signal: Block-Counter";
CM_ SG_ 1181 RFR_Obj07_ReferencePoint "Reference Point of the detected object. ISO 23150: Reference point (A.2.17)";
CM_ SG_ 1181 RFR_Obj07_ObjId "Unique Object ID. ISO 23150: Object ID (A.2.2)";
CM_ SG_ 1181 RFR_Obj07_MeasurementStatus "Object is measured or not. ISO 23150: Measurement status  object level (A.2.9)";
CM_ SG_ 1181 RFR_Obj07_Px "Object position in X direction. ISO 23150: Position  object level {x, y, z} (A.2.13)";
CM_ SG_ 1181 RFR_Obj07_Py "Object position in Y direction. ISO 23150: Position  object level {x, y, z} (A.2.13)";
CM_ SG_ 1181 RFR_Obj07_PxVnce "Variance of object position in X direction. ISO 23150: Position  object level {x, y, z}  error (A.2.14)";
CM_ SG_ 1181 RFR_Obj07_PyVnce "Variance of object position in Y direction. ISO 23150: Position  object level {x, y, z}  error (A.2.14)";
CM_ SG_ 1181 RFR_Obj07_Vx "Object relative velocity in X direction. ISO 23150: Velocity {x, y, z}  object level (A.2.23)";
CM_ SG_ 1181 RFR_Obj07_Vy "Object relative velocity in Y direction. ISO 23150: Velocity {x, y, z}  object level (A.2.23)";
CM_ SG_ 1181 RFR_Obj07_Ax "Object relative acceleration in X direction. ISO 23150: Acceleration {x, y, z} (A.2.25)";
CM_ SG_ 1181 RFR_Obj07_Ay "Object relative acceleration in Y direction. ISO 23150: Acceleration {x, y, z} (A.2.25)";
CM_ SG_ 1181 RFR_Obj07_OrientationYaw "Object orientation yaw angle. ISO 23150: Orientation {yaw, pitch, roll} (A.2.15)";
CM_ SG_ 1181 RFR_Obj07_ExistProb "Existence probability of object. ISO 23150: Existence probability  object level (A.2.1)";
CM_ SG_ 1181 RFR_Obj07_VxVnce "Variance of object relative velocity in X direction. ISO 23150: Velocity {x, y, z}  object level  error (A.2.24)";
CM_ SG_ 1181 RFR_Obj07_VyVnce "Variance of object relative velocity in Y direction. ISO 23150: Velocity {x, y, z}  object level  error (A.2.24)";
CM_ SG_ 1181 RFR_Obj07_AxVnce "Variance of object relative acceleration in X direction. ISO 23150: Acceleration {x, y, z}  error (A.2.26)";
CM_ SG_ 1181 RFR_Obj07_AyVnce "Variance of object relative acceleration in Y direction. ISO 23150: Acceleration {x, y, z}  error (A.2.26)";
CM_ SG_ 1181 RFR_Obj07_OrientationYawVnce "Variance of object orientation yaw angle. ISO 23150: Orientation {yaw, pitch, roll}  error (A.2.16)";
CM_ SG_ 1181 RFR_Obj07_MovingObserved "Object has been observed moving over the ground since it was first detected";
CM_ SG_ 1181 RFR_Obj07_MovingProbability "Object has been observed moving over the ground";
CM_ SG_ 1181 RFR_Obj07_Length "Object Length. ISO 23150: Bounding box extent {length, width, height} (A.2.19)";
CM_ SG_ 1181 RFR_Obj07_Valid "Object is valid or not";
CM_ SG_ 1181 RFR_Obj07_LengthVnce "Variance of object Length. ISO 23150: Bounding box extent {length, width, height}  error (A.2.20)";
CM_ SG_ 1181 RFR_Obj07_WidthVnce "Variance of object Width. ISO 23150: Bounding box extent {length, width, height}  error (A.2.20)";
CM_ SG_ 1181 RFR_Obj07_Width "Object Width. ISO 23150: Bounding box extent {length, width, height} (A.2.19)";
CM_ SG_ 1181 RFR_Obj07_BehaviorType "Indicates that which behavior the object associated for";
CM_ SG_ 1181 RFR_Obj07_ObstacleConf "Confidence of the object being an Obstacle. ISO 23150: Potentially moving object classification type  confidence (A.2.12)";
CM_ SG_ 1181 RFR_Obj07_NonObstacleConf "Confidence of the object being a Non-Obstacle. ISO 23150: Potentially moving object classification type  confidence (A.2.12)";
CM_ SG_ 1181 RFR_Obj07_PxPyCoVnce "Covariance of Px and Py";
CM_ SG_ 1181 RFR_Obj07_PxVxCoVnce "Covariance of Px and Vx";
CM_ SG_ 1181 RFR_Obj07_PxVyCoVnce "Covariance of Px and Vy";
CM_ SG_ 1181 RFR_Obj07_PyVxCoVnce "Covariance of Py and Vx";
CM_ SG_ 1181 RFR_Obj07_PyVyCoVnce "Covariance of Py and Vy";
CM_ SG_ 1181 RFR_Obj07_VxVyCoVnce "Covariance of Vx and Vy";
CM_ SG_ 1181 RFR_Obj07_PxAxCoVnce "Covariance of Px and Ax";
CM_ SG_ 1181 RFR_Obj07_PxAyCoVnce "Covariance of Px and Ay";
CM_ SG_ 1181 RFR_Obj07_PyAxCoVnce "Covariance of Py and Ax";
CM_ SG_ 1181 RFR_Obj07_PyAyCoVnce "Covariance of Py and Ay";
CM_ SG_ 1181 RFR_Obj07_VxAxCoVnce "Covariance of Vx and Ax";
CM_ SG_ 1181 RFR_Obj07_VxAyCoVnce "Covariance of Vx and Ay";
CM_ SG_ 1181 RFR_Obj07_VyAxCoVnce "Covariance of Vy and Ax";
CM_ SG_ 1181 RFR_Obj07_VyAyCoVnce "Covariance of Vy and Ay";
CM_ SG_ 1181 RFR_Obj07_AxAyCoVnce "Covariance of Ax and Ay";
CM_ SG_ 1181 RFR_Obj07_MobileObstConf "Confidence of the object being a mobile obstacle. ISO 23150: Potentially moving object classification type  confidence (A.2.12)";
CM_ SG_ 1181 RFR_Obj07_Mob4PlusWhlConf "Confidence of a mobile object which has 4 or more wheels. ISO 23150: Potentially moving object classification type  confidence (A.2.12)";
CM_ SG_ 1181 RFR_Obj07_Mob2WhlConf "Confidence of a mobile object being 2-wheels vehicle. ISO 23150: Potentially moving object classification type  confidence (A.2.12)";
CM_ SG_ 1181 RFR_Obj07_MobPedConf "Confidence of a mobile object being a pedestrian. ISO 23150: Potentially moving object classification type  confidence (A.2.12)";
CM_ SG_ 1181 RFR_Obj07_FourPlusWhlCarConf "Confidence of a mobile object which has 4 or more wheels--passenger car. ISO 23150: Potentially moving object classification type  confidence (A.2.12)";
CM_ SG_ 1181 RFR_Obj07_FourPlusWhlHGVConf "Confidence of a mobile object which has 4 or more wheels--commercial vehicle (Truck). ISO 23150: Potentially moving object classification type  confidence (A.2.12)";
CM_ SG_ 1181 RFR_Obj07_GroundReflexConf "Confidence of the object being a ground reflex. ISO 23150: Potentially moving object classification type  confidence (A.2.12)";
CM_ SG_ 1181 RFR_Obj07_StatObstConf "Confidence of the object being a stationary obstacle. ISO 23150: Potentially moving object classification type  confidence (A.2.12)";
CM_ SG_ 1181 RFR_Obj07_StatBarrierConf "Confidence of the object being a stationary road barrier. ISO 23150: Potentially moving object classification type  confidence (A.2.12)";
CM_ SG_ 1182 RFR_Obj08_CRC "CRC - Autosar E2E Profile 5";
CM_ SG_ 1182 RFR_Obj08_AliveCtr "Alive counter - Autosar E2E Profile 5";
CM_ SG_ 1182 RFR_Obj08_ProtBlockCtr "Protocol-Signal: Block-Counter";
CM_ SG_ 1182 RFR_Obj08_ReferencePoint "Reference Point of the detected object. ISO 23150: Reference point (A.2.17)";
CM_ SG_ 1182 RFR_Obj08_ObjId "Unique Object ID. ISO 23150: Object ID (A.2.2)";
CM_ SG_ 1182 RFR_Obj08_MeasurementStatus "Object is measured or not. ISO 23150: Measurement status  object level (A.2.9)";
CM_ SG_ 1182 RFR_Obj08_Px "Object position in X direction. ISO 23150: Position  object level {x, y, z} (A.2.13)";
CM_ SG_ 1182 RFR_Obj08_Py "Object position in Y direction. ISO 23150: Position  object level {x, y, z} (A.2.13)";
CM_ SG_ 1182 RFR_Obj08_PxVnce "Variance of object position in X direction. ISO 23150: Position  object level {x, y, z}  error (A.2.14)";
CM_ SG_ 1182 RFR_Obj08_PyVnce "Variance of object position in Y direction. ISO 23150: Position  object level {x, y, z}  error (A.2.14)";
CM_ SG_ 1182 RFR_Obj08_Vx "Object relative velocity in X direction. ISO 23150: Velocity {x, y, z}  object level (A.2.23)";
CM_ SG_ 1182 RFR_Obj08_Vy "Object relative velocity in Y direction. ISO 23150: Velocity {x, y, z}  object level (A.2.23)";
CM_ SG_ 1182 RFR_Obj08_Ax "Object relative acceleration in X direction. ISO 23150: Acceleration {x, y, z} (A.2.25)";
CM_ SG_ 1182 RFR_Obj08_Ay "Object relative acceleration in Y direction. ISO 23150: Acceleration {x, y, z} (A.2.25)";
CM_ SG_ 1182 RFR_Obj08_OrientationYaw "Object orientation yaw angle. ISO 23150: Orientation {yaw, pitch, roll} (A.2.15)";
CM_ SG_ 1182 RFR_Obj08_ExistProb "Existence probability of object. ISO 23150: Existence probability  object level (A.2.1)";
CM_ SG_ 1182 RFR_Obj08_VxVnce "Variance of object relative velocity in X direction. ISO 23150: Velocity {x, y, z}  object level  error (A.2.24)";
CM_ SG_ 1182 RFR_Obj08_VyVnce "Variance of object relative velocity in Y direction. ISO 23150: Velocity {x, y, z}  object level  error (A.2.24)";
CM_ SG_ 1182 RFR_Obj08_AxVnce "Variance of object relative acceleration in X direction. ISO 23150: Acceleration {x, y, z}  error (A.2.26)";
CM_ SG_ 1182 RFR_Obj08_AyVnce "Variance of object relative acceleration in Y direction. ISO 23150: Acceleration {x, y, z}  error (A.2.26)";
CM_ SG_ 1182 RFR_Obj08_OrientationYawVnce "Variance of object orientation yaw angle. ISO 23150: Orientation {yaw, pitch, roll}  error (A.2.16)";
CM_ SG_ 1182 RFR_Obj08_MovingObserved "Object has been observed moving over the ground since it was first detected";
CM_ SG_ 1182 RFR_Obj08_MovingProbability "Object has been observed moving over the ground";
CM_ SG_ 1182 RFR_Obj08_Length "Object Length. ISO 23150: Bounding box extent {length, width, height} (A.2.19)";
CM_ SG_ 1182 RFR_Obj08_Valid "Object is valid or not";
CM_ SG_ 1182 RFR_Obj08_LengthVnce "Variance of object Length. ISO 23150: Bounding box extent {length, width, height}  error (A.2.20)";
CM_ SG_ 1182 RFR_Obj08_WidthVnce "Variance of object Width. ISO 23150: Bounding box extent {length, width, height}  error (A.2.20)";
CM_ SG_ 1182 RFR_Obj08_Width "Object Width. ISO 23150: Bounding box extent {length, width, height} (A.2.19)";
CM_ SG_ 1182 RFR_Obj08_BehaviorType "Indicates that which behavior the object associated for";
CM_ SG_ 1182 RFR_Obj08_ObstacleConf "Confidence of the object being an Obstacle. ISO 23150: Potentially moving object classification type  confidence (A.2.12)";
CM_ SG_ 1182 RFR_Obj08_NonObstacleConf "Confidence of the object being a Non-Obstacle. ISO 23150: Potentially moving object classification type  confidence (A.2.12)";
CM_ SG_ 1182 RFR_Obj08_PxPyCoVnce "Covariance of Px and Py";
CM_ SG_ 1182 RFR_Obj08_PxVxCoVnce "Covariance of Px and Vx";
CM_ SG_ 1182 RFR_Obj08_PxVyCoVnce "Covariance of Px and Vy";
CM_ SG_ 1182 RFR_Obj08_PyVxCoVnce "Covariance of Py and Vx";
CM_ SG_ 1182 RFR_Obj08_PyVyCoVnce "Covariance of Py and Vy";
CM_ SG_ 1182 RFR_Obj08_VxVyCoVnce "Covariance of Vx and Vy";
CM_ SG_ 1182 RFR_Obj08_PxAxCoVnce "Covariance of Px and Ax";
CM_ SG_ 1182 RFR_Obj08_PxAyCoVnce "Covariance of Px and Ay";
CM_ SG_ 1182 RFR_Obj08_PyAxCoVnce "Covariance of Py and Ax";
CM_ SG_ 1182 RFR_Obj08_PyAyCoVnce "Covariance of Py and Ay";
CM_ SG_ 1182 RFR_Obj08_VxAxCoVnce "Covariance of Vx and Ax";
CM_ SG_ 1182 RFR_Obj08_VxAyCoVnce "Covariance of Vx and Ay";
CM_ SG_ 1182 RFR_Obj08_VyAxCoVnce "Covariance of Vy and Ax";
CM_ SG_ 1182 RFR_Obj08_VyAyCoVnce "Covariance of Vy and Ay";
CM_ SG_ 1182 RFR_Obj08_AxAyCoVnce "Covariance of Ax and Ay";
CM_ SG_ 1182 RFR_Obj08_MobileObstConf "Confidence of the object being a mobile obstacle. ISO 23150: Potentially moving object classification type  confidence (A.2.12)";
CM_ SG_ 1182 RFR_Obj08_Mob4PlusWhlConf "Confidence of a mobile object which has 4 or more wheels. ISO 23150: Potentially moving object classification type  confidence (A.2.12)";
CM_ SG_ 1182 RFR_Obj08_Mob2WhlConf "Confidence of a mobile object being 2-wheels vehicle. ISO 23150: Potentially moving object classification type  confidence (A.2.12)";
CM_ SG_ 1182 RFR_Obj08_MobPedConf "Confidence of a mobile object being a pedestrian. ISO 23150: Potentially moving object classification type  confidence (A.2.12)";
CM_ SG_ 1182 RFR_Obj08_FourPlusWhlCarConf "Confidence of a mobile object which has 4 or more wheels--passenger car. ISO 23150: Potentially moving object classification type  confidence (A.2.12)";
CM_ SG_ 1182 RFR_Obj08_FourPlusWhlHGVConf "Confidence of a mobile object which has 4 or more wheels--commercial vehicle (Truck). ISO 23150: Potentially moving object classification type  confidence (A.2.12)";
CM_ SG_ 1182 RFR_Obj08_GroundReflexConf "Confidence of the object being a ground reflex. ISO 23150: Potentially moving object classification type  confidence (A.2.12)";
CM_ SG_ 1182 RFR_Obj08_StatObstConf "Confidence of the object being a stationary obstacle. ISO 23150: Potentially moving object classification type  confidence (A.2.12)";
CM_ SG_ 1182 RFR_Obj08_StatBarrierConf "Confidence of the object being a stationary road barrier. ISO 23150: Potentially moving object classification type  confidence (A.2.12)";
CM_ SG_ 1183 RFR_Obj09_CRC "CRC - Autosar E2E Profile 5";
CM_ SG_ 1183 RFR_Obj09_AliveCtr "Alive counter - Autosar E2E Profile 5";
CM_ SG_ 1183 RFR_Obj09_ProtBlockCtr "Protocol-Signal: Block-Counter";
CM_ SG_ 1183 RFR_Obj09_ReferencePoint "Reference Point of the detected object. ISO 23150: Reference point (A.2.17)";
CM_ SG_ 1183 RFR_Obj09_ObjId "Unique Object ID. ISO 23150: Object ID (A.2.2)";
CM_ SG_ 1183 RFR_Obj09_MeasurementStatus "Object is measured or not. ISO 23150: Measurement status  object level (A.2.9)";
CM_ SG_ 1183 RFR_Obj09_Px "Object position in X direction. ISO 23150: Position  object level {x, y, z} (A.2.13)";
CM_ SG_ 1183 RFR_Obj09_Py "Object position in Y direction. ISO 23150: Position  object level {x, y, z} (A.2.13)";
CM_ SG_ 1183 RFR_Obj09_PxVnce "Variance of object position in X direction. ISO 23150: Position  object level {x, y, z}  error (A.2.14)";
CM_ SG_ 1183 RFR_Obj09_PyVnce "Variance of object position in Y direction. ISO 23150: Position  object level {x, y, z}  error (A.2.14)";
CM_ SG_ 1183 RFR_Obj09_Vx "Object relative velocity in X direction. ISO 23150: Velocity {x, y, z}  object level (A.2.23)";
CM_ SG_ 1183 RFR_Obj09_Vy "Object relative velocity in Y direction. ISO 23150: Velocity {x, y, z}  object level (A.2.23)";
CM_ SG_ 1183 RFR_Obj09_Ax "Object relative acceleration in X direction. ISO 23150: Acceleration {x, y, z} (A.2.25)";
CM_ SG_ 1183 RFR_Obj09_Ay "Object relative acceleration in Y direction. ISO 23150: Acceleration {x, y, z} (A.2.25)";
CM_ SG_ 1183 RFR_Obj09_OrientationYaw "Object orientation yaw angle. ISO 23150: Orientation {yaw, pitch, roll} (A.2.15)";
CM_ SG_ 1183 RFR_Obj09_ExistProb "Existence probability of object. ISO 23150: Existence probability  object level (A.2.1)";
CM_ SG_ 1183 RFR_Obj09_VxVnce "Variance of object relative velocity in X direction. ISO 23150: Velocity {x, y, z}  object level  error (A.2.24)";
CM_ SG_ 1183 RFR_Obj09_VyVnce "Variance of object relative velocity in Y direction. ISO 23150: Velocity {x, y, z}  object level  error (A.2.24)";
CM_ SG_ 1183 RFR_Obj09_AxVnce "Variance of object relative acceleration in X direction. ISO 23150: Acceleration {x, y, z}  error (A.2.26)";
CM_ SG_ 1183 RFR_Obj09_AyVnce "Variance of object relative acceleration in Y direction. ISO 23150: Acceleration {x, y, z}  error (A.2.26)";
CM_ SG_ 1183 RFR_Obj09_OrientationYawVnce "Variance of object orientation yaw angle. ISO 23150: Orientation {yaw, pitch, roll}  error (A.2.16)";
CM_ SG_ 1183 RFR_Obj09_MovingObserved "Object has been observed moving over the ground since it was first detected";
CM_ SG_ 1183 RFR_Obj09_MovingProbability "Object has been observed moving over the ground";
CM_ SG_ 1183 RFR_Obj09_Length "Object Length. ISO 23150: Bounding box extent {length, width, height} (A.2.19)";
CM_ SG_ 1183 RFR_Obj09_Valid "Object is valid or not";
CM_ SG_ 1183 RFR_Obj09_LengthVnce "Variance of object Length. ISO 23150: Bounding box extent {length, width, height}  error (A.2.20)";
CM_ SG_ 1183 RFR_Obj09_WidthVnce "Variance of object Width. ISO 23150: Bounding box extent {length, width, height}  error (A.2.20)";
CM_ SG_ 1183 RFR_Obj09_Width "Object Width. ISO 23150: Bounding box extent {length, width, height} (A.2.19)";
CM_ SG_ 1183 RFR_Obj09_BehaviorType "Indicates that which behavior the object associated for";
CM_ SG_ 1183 RFR_Obj09_ObstacleConf "Confidence of the object being an Obstacle. ISO 23150: Potentially moving object classification type  confidence (A.2.12)";
CM_ SG_ 1183 RFR_Obj09_NonObstacleConf "Confidence of the object being a Non-Obstacle. ISO 23150: Potentially moving object classification type  confidence (A.2.12)";
CM_ SG_ 1183 RFR_Obj09_PxPyCoVnce "Covariance of Px and Py";
CM_ SG_ 1183 RFR_Obj09_PxVxCoVnce "Covariance of Px and Vx";
CM_ SG_ 1183 RFR_Obj09_PxVyCoVnce "Covariance of Px and Vy";
CM_ SG_ 1183 RFR_Obj09_PyVxCoVnce "Covariance of Py and Vx";
CM_ SG_ 1183 RFR_Obj09_PyVyCoVnce "Covariance of Py and Vy";
CM_ SG_ 1183 RFR_Obj09_VxVyCoVnce "Covariance of Vx and Vy";
CM_ SG_ 1183 RFR_Obj09_PxAxCoVnce "Covariance of Px and Ax";
CM_ SG_ 1183 RFR_Obj09_PxAyCoVnce "Covariance of Px and Ay";
CM_ SG_ 1183 RFR_Obj09_PyAxCoVnce "Covariance of Py and Ax";
CM_ SG_ 1183 RFR_Obj09_PyAyCoVnce "Covariance of Py and Ay";
CM_ SG_ 1183 RFR_Obj09_VxAxCoVnce "Covariance of Vx and Ax";
CM_ SG_ 1183 RFR_Obj09_VxAyCoVnce "Covariance of Vx and Ay";
CM_ SG_ 1183 RFR_Obj09_VyAxCoVnce "Covariance of Vy and Ax";
CM_ SG_ 1183 RFR_Obj09_VyAyCoVnce "Covariance of Vy and Ay";
CM_ SG_ 1183 RFR_Obj09_AxAyCoVnce "Covariance of Ax and Ay";
CM_ SG_ 1183 RFR_Obj09_MobileObstConf "Confidence of the object being a mobile obstacle. ISO 23150: Potentially moving object classification type  confidence (A.2.12)";
CM_ SG_ 1183 RFR_Obj09_Mob4PlusWhlConf "Confidence of a mobile object which has 4 or more wheels. ISO 23150: Potentially moving object classification type  confidence (A.2.12)";
CM_ SG_ 1183 RFR_Obj09_Mob2WhlConf "Confidence of a mobile object being 2-wheels vehicle. ISO 23150: Potentially moving object classification type  confidence (A.2.12)";
CM_ SG_ 1183 RFR_Obj09_MobPedConf "Confidence of a mobile object being a pedestrian. ISO 23150: Potentially moving object classification type  confidence (A.2.12)";
CM_ SG_ 1183 RFR_Obj09_FourPlusWhlCarConf "Confidence of a mobile object which has 4 or more wheels--passenger car. ISO 23150: Potentially moving object classification type  confidence (A.2.12)";
CM_ SG_ 1183 RFR_Obj09_FourPlusWhlHGVConf "Confidence of a mobile object which has 4 or more wheels--commercial vehicle (Truck). ISO 23150: Potentially moving object classification type  confidence (A.2.12)";
CM_ SG_ 1183 RFR_Obj09_GroundReflexConf "Confidence of the object being a ground reflex. ISO 23150: Potentially moving object classification type  confidence (A.2.12)";
CM_ SG_ 1183 RFR_Obj09_StatObstConf "Confidence of the object being a stationary obstacle. ISO 23150: Potentially moving object classification type  confidence (A.2.12)";
CM_ SG_ 1183 RFR_Obj09_StatBarrierConf "Confidence of the object being a stationary road barrier. ISO 23150: Potentially moving object classification type  confidence (A.2.12)";
CM_ SG_ 2281601536 ImgFrameCounter "Signal for development purpose only!";
CM_ SG_ 2281601536 ImgReceptionTimer "Signal for development purpose only!";
BA_DEF_ BO_  "CANFD_BRS" ENUM  "0","1";
BA_DEF_ BO_  "GenMsgCycleTime" INT 0 65535;
BA_DEF_ BO_  "GenMsgSendType" ENUM  "Event","cyclic";
BA_DEF_ BO_  "VFrameFormat" ENUM  "StandardCAN","ExtendedCAN","reserved","reserved","reserved","reserved","reserved","reserved","reserved","reserved","reserved","reserved","reserved","reserved","StandardCAN_FD","ExtendedCAN_FD";
BA_DEF_ BO_  "E2Eprofile" STRING ;
BA_DEF_ BO_  "DataID" HEX 0 655535;
BA_DEF_ SG_  "GenSigStartValue" FLOAT 0 100000000000;
BA_DEF_DEF_  "CANFD_BRS" "1";
BA_DEF_DEF_  "GenMsgCycleTime" 0;
BA_DEF_DEF_  "GenMsgSendType" "";
BA_DEF_DEF_  "VFrameFormat" "";
BA_DEF_DEF_  "E2Eprofile" "None";
BA_DEF_DEF_  "DataID" 0;
BA_DEF_DEF_  "GenSigStartValue" 0;
BA_ "DataID" BO_ 925 9117;
BA_ "E2Eprofile" BO_ 925 "AUTOSAR Profile 5";
BA_ "GenMsgSendType" BO_ 925 0;
BA_ "VFrameFormat" BO_ 925 14;
BA_ "DataID" BO_ 926 9118;
BA_ "E2Eprofile" BO_ 926 "AUTOSAR Profile 5";
BA_ "GenMsgSendType" BO_ 926 0;
BA_ "VFrameFormat" BO_ 926 14;
BA_ "DataID" BO_ 927 9119;
BA_ "E2Eprofile" BO_ 927 "AUTOSAR Profile 5";
BA_ "GenMsgSendType" BO_ 927 0;
BA_ "VFrameFormat" BO_ 927 14;
BA_ "DataID" BO_ 1172 9364;
BA_ "E2Eprofile" BO_ 1172 "AUTOSAR Profile 5";
BA_ "GenMsgSendType" BO_ 1172 0;
BA_ "VFrameFormat" BO_ 1172 14;
BA_ "DataID" BO_ 1174 9366;
BA_ "E2Eprofile" BO_ 1174 "AUTOSAR Profile 5";
BA_ "GenMsgSendType" BO_ 1174 0;
BA_ "VFrameFormat" BO_ 1174 14;
BA_ "DataID" BO_ 1175 9367;
BA_ "E2Eprofile" BO_ 1175 "AUTOSAR Profile 5";
BA_ "GenMsgSendType" BO_ 1175 0;
BA_ "VFrameFormat" BO_ 1175 14;
BA_ "DataID" BO_ 1176 9368;
BA_ "E2Eprofile" BO_ 1176 "AUTOSAR Profile 5";
BA_ "GenMsgSendType" BO_ 1176 0;
BA_ "VFrameFormat" BO_ 1176 14;
BA_ "DataID" BO_ 1177 9369;
BA_ "E2Eprofile" BO_ 1177 "AUTOSAR Profile 5";
BA_ "GenMsgSendType" BO_ 1177 0;
BA_ "VFrameFormat" BO_ 1177 14;
BA_ "DataID" BO_ 1178 9370;
BA_ "E2Eprofile" BO_ 1178 "AUTOSAR Profile 5";
BA_ "GenMsgSendType" BO_ 1178 0;
BA_ "VFrameFormat" BO_ 1178 14;
BA_ "DataID" BO_ 1179 9371;
BA_ "E2Eprofile" BO_ 1179 "AUTOSAR Profile 5";
BA_ "GenMsgSendType" BO_ 1179 0;
BA_ "VFrameFormat" BO_ 1179 14;
BA_ "DataID" BO_ 1180 9372;
BA_ "E2Eprofile" BO_ 1180 "AUTOSAR Profile 5";
BA_ "GenMsgSendType" BO_ 1180 0;
BA_ "VFrameFormat" BO_ 1180 14;
BA_ "DataID" BO_ 1181 9373;
BA_ "E2Eprofile" BO_ 1181 "AUTOSAR Profile 5";
BA_ "GenMsgSendType" BO_ 1181 0;
BA_ "VFrameFormat" BO_ 1181 14;
BA_ "DataID" BO_ 1182 9374;
BA_ "E2Eprofile" BO_ 1182 "AUTOSAR Profile 5";
BA_ "GenMsgSendType" BO_ 1182 0;
BA_ "VFrameFormat" BO_ 1182 14;
BA_ "DataID" BO_ 1183 9375;
BA_ "E2Eprofile" BO_ 1183 "AUTOSAR Profile 5";
BA_ "GenMsgSendType" BO_ 1183 0;
BA_ "VFrameFormat" BO_ 1183 14;
BA_ "GenMsgSendType" BO_ 2281601536 1;
BA_ "GenMsgCycleTime" BO_ 2281601536 10;
BA_ "VFrameFormat" BO_ 2281601536 15;
BA_ "GenSigStartValue" SG_ 925 RFL_Obj07_Px 4096;
BA_ "GenSigStartValue" SG_ 925 RFL_Obj07_Py 1024;
BA_ "GenSigStartValue" SG_ 925 RFL_Obj07_Vx 2048;
BA_ "GenSigStartValue" SG_ 925 RFL_Obj07_Vy 512;
BA_ "GenSigStartValue" SG_ 925 RFL_Obj07_Ax 512;
BA_ "GenSigStartValue" SG_ 925 RFL_Obj07_Ay 256;
BA_ "GenSigStartValue" SG_ 925 RFL_Obj07_OrientationYaw 256;
BA_ "GenSigStartValue" SG_ 926 RFL_Obj08_Px 4096;
BA_ "GenSigStartValue" SG_ 926 RFL_Obj08_Py 1024;
BA_ "GenSigStartValue" SG_ 926 RFL_Obj08_Vx 2048;
BA_ "GenSigStartValue" SG_ 926 RFL_Obj08_Vy 512;
BA_ "GenSigStartValue" SG_ 926 RFL_Obj08_Ax 512;
BA_ "GenSigStartValue" SG_ 926 RFL_Obj08_Ay 256;
BA_ "GenSigStartValue" SG_ 926 RFL_Obj08_OrientationYaw 256;
BA_ "GenSigStartValue" SG_ 927 RFL_Obj09_Px 4096;
BA_ "GenSigStartValue" SG_ 927 RFL_Obj09_Py 1024;
BA_ "GenSigStartValue" SG_ 927 RFL_Obj09_Vx 2048;
BA_ "GenSigStartValue" SG_ 927 RFL_Obj09_Vy 512;
BA_ "GenSigStartValue" SG_ 927 RFL_Obj09_Ax 512;
BA_ "GenSigStartValue" SG_ 927 RFL_Obj09_Ay 256;
BA_ "GenSigStartValue" SG_ 927 RFL_Obj09_OrientationYaw 256;
BA_ "GenSigStartValue" SG_ 1172 RFR_ObjHdr_IfVersionIdMajor 1;
BA_ "GenSigStartValue" SG_ 1172 RFR_ObjHdr_IfVersionIdMinor 1;
BA_ "GenSigStartValue" SG_ 1172 RFR_ObjHdr_SensorOriginPointY 128;
BA_ "GenSigStartValue" SG_ 1172 RFR_ObjHdr_SensorOriginPointX 256;
BA_ "GenSigStartValue" SG_ 1172 RFR_ObjHdr_SensorOrientYaw 32768;
BA_ "GenSigStartValue" SG_ 1172 RFR_ObjHdr_SensorOrientPitch 2048;
BA_ "GenSigStartValue" SG_ 1172 RFR_ObjHdr_SensorOrientRoll 2048;
BA_ "GenSigStartValue" SG_ 1172 RFR_ObjHdr_FovAzimuthBegin 16384;
BA_ "GenSigStartValue" SG_ 1172 RFR_ObjHdr_FovAzimuthEnd 16384;
BA_ "GenSigStartValue" SG_ 1172 RFR_ObjHdr_FovElevationBegin 2048;
BA_ "GenSigStartValue" SG_ 1172 RFR_ObjHdr_FovElevationEnd 2048;
BA_ "GenSigStartValue" SG_ 1174 RFR_Obj00_Px 4096;
BA_ "GenSigStartValue" SG_ 1174 RFR_Obj00_Py 1024;
BA_ "GenSigStartValue" SG_ 1174 RFR_Obj00_Vx 2048;
BA_ "GenSigStartValue" SG_ 1174 RFR_Obj00_Vy 512;
BA_ "GenSigStartValue" SG_ 1174 RFR_Obj00_Ax 512;
BA_ "GenSigStartValue" SG_ 1174 RFR_Obj00_Ay 256;
BA_ "GenSigStartValue" SG_ 1174 RFR_Obj00_OrientationYaw 256;
BA_ "GenSigStartValue" SG_ 1175 RFR_Obj01_Px 4096;
BA_ "GenSigStartValue" SG_ 1175 RFR_Obj01_Py 1024;
BA_ "GenSigStartValue" SG_ 1175 RFR_Obj01_Vx 2048;
BA_ "GenSigStartValue" SG_ 1175 RFR_Obj01_Vy 512;
BA_ "GenSigStartValue" SG_ 1175 RFR_Obj01_Ax 512;
BA_ "GenSigStartValue" SG_ 1175 RFR_Obj01_Ay 256;
BA_ "GenSigStartValue" SG_ 1175 RFR_Obj01_OrientationYaw 256;
BA_ "GenSigStartValue" SG_ 1176 RFR_Obj02_Px 4096;
BA_ "GenSigStartValue" SG_ 1176 RFR_Obj02_Py 1024;
BA_ "GenSigStartValue" SG_ 1176 RFR_Obj02_Vx 2048;
BA_ "GenSigStartValue" SG_ 1176 RFR_Obj02_Vy 512;
BA_ "GenSigStartValue" SG_ 1176 RFR_Obj02_Ax 512;
BA_ "GenSigStartValue" SG_ 1176 RFR_Obj02_Ay 256;
BA_ "GenSigStartValue" SG_ 1176 RFR_Obj02_OrientationYaw 256;
BA_ "GenSigStartValue" SG_ 1177 RFR_Obj03_Px 4096;
BA_ "GenSigStartValue" SG_ 1177 RFR_Obj03_Py 1024;
BA_ "GenSigStartValue" SG_ 1177 RFR_Obj03_Vx 2048;
BA_ "GenSigStartValue" SG_ 1177 RFR_Obj03_Vy 512;
BA_ "GenSigStartValue" SG_ 1177 RFR_Obj03_Ax 512;
BA_ "GenSigStartValue" SG_ 1177 RFR_Obj03_Ay 256;
BA_ "GenSigStartValue" SG_ 1177 RFR_Obj03_OrientationYaw 256;
BA_ "GenSigStartValue" SG_ 1178 RFR_Obj04_Px 4096;
BA_ "GenSigStartValue" SG_ 1178 RFR_Obj04_Py 1024;
BA_ "GenSigStartValue" SG_ 1178 RFR_Obj04_Vx 2048;
BA_ "GenSigStartValue" SG_ 1178 RFR_Obj04_Vy 512;
BA_ "GenSigStartValue" SG_ 1178 RFR_Obj04_Ax 512;
BA_ "GenSigStartValue" SG_ 1178 RFR_Obj04_Ay 256;
BA_ "GenSigStartValue" SG_ 1178 RFR_Obj04_OrientationYaw 256;
BA_ "GenSigStartValue" SG_ 1179 RFR_Obj05_Px 4096;
BA_ "GenSigStartValue" SG_ 1179 RFR_Obj05_Py 1024;
BA_ "GenSigStartValue" SG_ 1179 RFR_Obj05_Vx 2048;
BA_ "GenSigStartValue" SG_ 1179 RFR_Obj05_Vy 512;
BA_ "GenSigStartValue" SG_ 1179 RFR_Obj05_Ax 512;
BA_ "GenSigStartValue" SG_ 1179 RFR_Obj05_Ay 256;
BA_ "GenSigStartValue" SG_ 1179 RFR_Obj05_OrientationYaw 256;
BA_ "GenSigStartValue" SG_ 1180 RFR_Obj06_Px 4096;
BA_ "GenSigStartValue" SG_ 1180 RFR_Obj06_Py 1024;
BA_ "GenSigStartValue" SG_ 1180 RFR_Obj06_Vx 2048;
BA_ "GenSigStartValue" SG_ 1180 RFR_Obj06_Vy 512;
BA_ "GenSigStartValue" SG_ 1180 RFR_Obj06_Ax 512;
BA_ "GenSigStartValue" SG_ 1180 RFR_Obj06_Ay 256;
BA_ "GenSigStartValue" SG_ 1180 RFR_Obj06_OrientationYaw 256;
BA_ "GenSigStartValue" SG_ 1181 RFR_Obj07_Px 4096;
BA_ "GenSigStartValue" SG_ 1181 RFR_Obj07_Py 1024;
BA_ "GenSigStartValue" SG_ 1181 RFR_Obj07_Vx 2048;
BA_ "GenSigStartValue" SG_ 1181 RFR_Obj07_Vy 512;
BA_ "GenSigStartValue" SG_ 1181 RFR_Obj07_Ax 512;
BA_ "GenSigStartValue" SG_ 1181 RFR_Obj07_Ay 256;
BA_ "GenSigStartValue" SG_ 1181 RFR_Obj07_OrientationYaw 256;
BA_ "GenSigStartValue" SG_ 1182 RFR_Obj08_Px 4096;
BA_ "GenSigStartValue" SG_ 1182 RFR_Obj08_Py 1024;
BA_ "GenSigStartValue" SG_ 1182 RFR_Obj08_Vx 2048;
BA_ "GenSigStartValue" SG_ 1182 RFR_Obj08_Vy 512;
BA_ "GenSigStartValue" SG_ 1182 RFR_Obj08_Ax 512;
BA_ "GenSigStartValue" SG_ 1182 RFR_Obj08_Ay 256;
BA_ "GenSigStartValue" SG_ 1182 RFR_Obj08_OrientationYaw 256;
BA_ "GenSigStartValue" SG_ 1183 RFR_Obj09_Px 4096;
BA_ "GenSigStartValue" SG_ 1183 RFR_Obj09_Py 1024;
BA_ "GenSigStartValue" SG_ 1183 RFR_Obj09_Vx 2048;
BA_ "GenSigStartValue" SG_ 1183 RFR_Obj09_Vy 512;
BA_ "GenSigStartValue" SG_ 1183 RFR_Obj09_Ax 512;
BA_ "GenSigStartValue" SG_ 1183 RFR_Obj09_Ay 256;
BA_ "GenSigStartValue" SG_ 1183 RFR_Obj09_OrientationYaw 256;
VAL_ 925 RFL_Obj07_ReferencePoint 0 "Front corner left" 1 "Front center" 2 "Front corner right" 3 "Front wheelcase left" 4 "Front wheelcase right" 5 "Side middle left" 6 "Side middle right" 7 "Rear wheelcase left" 8 "Rear wheelcase right" 9 "Rear corner left" 10 "Rear center" 11 "Rear corner right" 12 "Object center" 13 "Rear wheelcase center" 14 "Front wheelcase center" 15 "Invalid" ;
VAL_ 925 RFL_Obj07_MeasurementStatus 0 "not measured" 1 "measured" ;
VAL_ 925 RFL_Obj07_Valid 0 "not valid" 1 "valid" ;
VAL_ 925 RFL_Obj07_BehaviorType 0 "No_Target" 1 "FCTA" 2 "RCTA" 3 "BSD" 4 "LCA" 5 "HWA" 6 "Reserved1" 7 "Reserved2" ;
VAL_ 926 RFL_Obj08_ReferencePoint 0 "Front corner left" 1 "Front center" 2 "Front corner right" 3 "Front wheelcase left" 4 "Front wheelcase right" 5 "Side middle left" 6 "Side middle right" 7 "Rear wheelcase left" 8 "Rear wheelcase right" 9 "Rear corner left" 10 "Rear center" 11 "Rear corner right" 12 "Object center" 13 "Rear wheelcase center" 14 "Front wheelcase center" 15 "Invalid" ;
VAL_ 926 RFL_Obj08_MeasurementStatus 0 "not measured" 1 "measured" ;
VAL_ 926 RFL_Obj08_Valid 0 "not valid" 1 "valid" ;
VAL_ 926 RFL_Obj08_BehaviorType 0 "No_Target" 1 "FCTA" 2 "RCTA" 3 "BSD" 4 "LCA" 5 "HWA" 6 "Reserved1" 7 "Reserved2" ;
VAL_ 927 RFL_Obj09_ReferencePoint 0 "Front corner left" 1 "Front center" 2 "Front corner right" 3 "Front wheelcase left" 4 "Front wheelcase right" 5 "Side middle left" 6 "Side middle right" 7 "Rear wheelcase left" 8 "Rear wheelcase right" 9 "Rear corner left" 10 "Rear center" 11 "Rear corner right" 12 "Object center" 13 "Rear wheelcase center" 14 "Front wheelcase center" 15 "Invalid" ;
VAL_ 927 RFL_Obj09_MeasurementStatus 0 "not measured" 1 "measured" ;
VAL_ 927 RFL_Obj09_Valid 0 "not valid" 1 "valid" ;
VAL_ 927 RFL_Obj09_BehaviorType 0 "No_Target" 1 "FCTA" 2 "RCTA" 3 "BSD" 4 "LCA" 5 "HWA" 6 "Reserved1" 7 "Reserved2" ;
VAL_ 1172 RFR_ObjHdr_AziOutOfSpec 0 "In spec Azimuth Alignemdn" 1 "Out of spec Azimuth Alignement" ;
VAL_ 1172 RFR_ObjHdr_ElevOutOfSpec 0 "In Spec Elevation Alignment" 1 "Out of spec Elevation Alignement" ;
VAL_ 1172 RFR_ObjHdr_ObjectDownSel 0 "no downselection" 1 "downselected" ;
VAL_ 1174 RFR_Obj00_ReferencePoint 0 "Front corner left" 1 "Front center" 2 "Front corner right" 3 "Front wheelcase left" 4 "Front wheelcase right" 5 "Side middle left" 6 "Side middle right" 7 "Rear wheelcase left" 8 "Rear wheelcase right" 9 "Rear corner left" 10 "Rear center" 11 "Rear corner right" 12 "Object center" 13 "Rear wheelcase center" 14 "Front wheelcase center" 15 "Invalid" ;
VAL_ 1174 RFR_Obj00_MeasurementStatus 0 "not measured" 1 "measured" ;
VAL_ 1174 RFR_Obj00_Valid 0 "not valid" 1 "valid" ;
VAL_ 1174 RFR_Obj00_BehaviorType 0 "No_Target" 1 "FCTA" 2 "RCTA" 3 "BSD" 4 "LCA" 5 "HWA" 6 "Reserved1" 7 "Reserved2" ;
VAL_ 1175 RFR_Obj01_ReferencePoint 0 "Front corner left" 1 "Front center" 2 "Front corner right" 3 "Front wheelcase left" 4 "Front wheelcase right" 5 "Side middle left" 6 "Side middle right" 7 "Rear wheelcase left" 8 "Rear wheelcase right" 9 "Rear corner left" 10 "Rear center" 11 "Rear corner right" 12 "Object center" 13 "Rear wheelcase center" 14 "Front wheelcase center" 15 "Invalid" ;
VAL_ 1175 RFR_Obj01_MeasurementStatus 0 "not measured" 1 "measured" ;
VAL_ 1175 RFR_Obj01_Valid 0 "not valid" 1 "valid" ;
VAL_ 1175 RFR_Obj01_BehaviorType 0 "No_Target" 1 "FCTA" 2 "RCTA" 3 "BSD" 4 "LCA" 5 "HWA" 6 "Reserved1" 7 "Reserved2" ;
VAL_ 1176 RFR_Obj02_ReferencePoint 0 "Front corner left" 1 "Front center" 2 "Front corner right" 3 "Front wheelcase left" 4 "Front wheelcase right" 5 "Side middle left" 6 "Side middle right" 7 "Rear wheelcase left" 8 "Rear wheelcase right" 9 "Rear corner left" 10 "Rear center" 11 "Rear corner right" 12 "Object center" 13 "Rear wheelcase center" 14 "Front wheelcase center" 15 "Invalid" ;
VAL_ 1176 RFR_Obj02_MeasurementStatus 0 "not measured" 1 "measured" ;
VAL_ 1176 RFR_Obj02_Valid 0 "not valid" 1 "valid" ;
VAL_ 1176 RFR_Obj02_BehaviorType 0 "No_Target" 1 "FCTA" 2 "RCTA" 3 "BSD" 4 "LCA" 5 "HWA" 6 "Reserved1" 7 "Reserved2" ;
VAL_ 1177 RFR_Obj03_ReferencePoint 0 "Front corner left" 1 "Front center" 2 "Front corner right" 3 "Front wheelcase left" 4 "Front wheelcase right" 5 "Side middle left" 6 "Side middle right" 7 "Rear wheelcase left" 8 "Rear wheelcase right" 9 "Rear corner left" 10 "Rear center" 11 "Rear corner right" 12 "Object center" 13 "Rear wheelcase center" 14 "Front wheelcase center" 15 "Invalid" ;
VAL_ 1177 RFR_Obj03_MeasurementStatus 0 "not measured" 1 "measured" ;
VAL_ 1177 RFR_Obj03_Valid 0 "not valid" 1 "valid" ;
VAL_ 1177 RFR_Obj03_BehaviorType 0 "No_Target" 1 "FCTA" 2 "RCTA" 3 "BSD" 4 "LCA" 5 "HWA" 6 "Reserved1" 7 "Reserved2" ;
VAL_ 1178 RFR_Obj04_ReferencePoint 0 "Front corner left" 1 "Front center" 2 "Front corner right" 3 "Front wheelcase left" 4 "Front wheelcase right" 5 "Side middle left" 6 "Side middle right" 7 "Rear wheelcase left" 8 "Rear wheelcase right" 9 "Rear corner left" 10 "Rear center" 11 "Rear corner right" 12 "Object center" 13 "Rear wheelcase center" 14 "Front wheelcase center" 15 "Invalid" ;
VAL_ 1178 RFR_Obj04_MeasurementStatus 0 "not measured" 1 "measured" ;
VAL_ 1178 RFR_Obj04_Valid 0 "not valid" 1 "valid" ;
VAL_ 1178 RFR_Obj04_BehaviorType 0 "No_Target" 1 "FCTA" 2 "RCTA" 3 "BSD" 4 "LCA" 5 "HWA" 6 "Reserved1" 7 "Reserved2" ;
VAL_ 1179 RFR_Obj05_ReferencePoint 0 "Front corner left" 1 "Front center" 2 "Front corner right" 3 "Front wheelcase left" 4 "Front wheelcase right" 5 "Side middle left" 6 "Side middle right" 7 "Rear wheelcase left" 8 "Rear wheelcase right" 9 "Rear corner left" 10 "Rear center" 11 "Rear corner right" 12 "Object center" 13 "Rear wheelcase center" 14 "Front wheelcase center" 15 "Invalid" ;
VAL_ 1179 RFR_Obj05_MeasurementStatus 0 "not measured" 1 "measured" ;
VAL_ 1179 RFR_Obj05_Valid 0 "not valid" 1 "valid" ;
VAL_ 1179 RFR_Obj05_BehaviorType 0 "No_Target" 1 "FCTA" 2 "RCTA" 3 "BSD" 4 "LCA" 5 "HWA" 6 "Reserved1" 7 "Reserved2" ;
VAL_ 1180 RFR_Obj06_ReferencePoint 0 "Front corner left" 1 "Front center" 2 "Front corner right" 3 "Front wheelcase left" 4 "Front wheelcase right" 5 "Side middle left" 6 "Side middle right" 7 "Rear wheelcase left" 8 "Rear wheelcase right" 9 "Rear corner left" 10 "Rear center" 11 "Rear corner right" 12 "Object center" 13 "Rear wheelcase center" 14 "Front wheelcase center" 15 "Invalid" ;
VAL_ 1180 RFR_Obj06_MeasurementStatus 0 "not measured" 1 "measured" ;
VAL_ 1180 RFR_Obj06_Valid 0 "not valid" 1 "valid" ;
VAL_ 1180 RFR_Obj06_BehaviorType 0 "No_Target" 1 "FCTA" 2 "RCTA" 3 "BSD" 4 "LCA" 5 "HWA" 6 "Reserved1" 7 "Reserved2" ;
VAL_ 1181 RFR_Obj07_ReferencePoint 0 "Front corner left" 1 "Front center" 2 "Front corner right" 3 "Front wheelcase left" 4 "Front wheelcase right" 5 "Side middle left" 6 "Side middle right" 7 "Rear wheelcase left" 8 "Rear wheelcase right" 9 "Rear corner left" 10 "Rear center" 11 "Rear corner right" 12 "Object center" 13 "Rear wheelcase center" 14 "Front wheelcase center" 15 "Invalid" ;
VAL_ 1181 RFR_Obj07_MeasurementStatus 0 "not measured" 1 "measured" ;
VAL_ 1181 RFR_Obj07_Valid 0 "not valid" 1 "valid" ;
VAL_ 1181 RFR_Obj07_BehaviorType 0 "No_Target" 1 "FCTA" 2 "RCTA" 3 "BSD" 4 "LCA" 5 "HWA" 6 "Reserved1" 7 "Reserved2" ;
VAL_ 1182 RFR_Obj08_ReferencePoint 0 "Front corner left" 1 "Front center" 2 "Front corner right" 3 "Front wheelcase left" 4 "Front wheelcase right" 5 "Side middle left" 6 "Side middle right" 7 "Rear wheelcase left" 8 "Rear wheelcase right" 9 "Rear corner left" 10 "Rear center" 11 "Rear corner right" 12 "Object center" 13 "Rear wheelcase center" 14 "Front wheelcase center" 15 "Invalid" ;
VAL_ 1182 RFR_Obj08_MeasurementStatus 0 "not measured" 1 "measured" ;
VAL_ 1182 RFR_Obj08_Valid 0 "not valid" 1 "valid" ;
VAL_ 1182 RFR_Obj08_BehaviorType 0 "No_Target" 1 "FCTA" 2 "RCTA" 3 "BSD" 4 "LCA" 5 "HWA" 6 "Reserved1" 7 "Reserved2" ;
VAL_ 1183 RFR_Obj09_ReferencePoint 0 "Front corner left" 1 "Front center" 2 "Front corner right" 3 "Front wheelcase left" 4 "Front wheelcase right" 5 "Side middle left" 6 "Side middle right" 7 "Rear wheelcase left" 8 "Rear wheelcase right" 9 "Rear corner left" 10 "Rear center" 11 "Rear corner right" 12 "Object center" 13 "Rear wheelcase center" 14 "Front wheelcase center" 15 "Invalid" ;
VAL_ 1183 RFR_Obj09_MeasurementStatus 0 "not measured" 1 "measured" ;
VAL_ 1183 RFR_Obj09_Valid 0 "not valid" 1 "valid" ;
VAL_ 1183 RFR_Obj09_BehaviorType 0 "No_Target" 1 "FCTA" 2 "RCTA" 3 "BSD" 4 "LCA" 5 "HWA" 6 "Reserved1" 7 "Reserved2" ;
SIG_GROUP_ 925 SG_RFL_Obj07 1 : RFL_Obj07_CRC RFL_Obj07_AliveCtr RFL_Obj07_ProtBlockCtr RFL_Obj07_ReferencePoint RFL_Obj07_ObjId RFL_Obj07_MeasurementStatus RFL_Obj07_Px RFL_Obj07_Py RFL_Obj07_PxVnce RFL_Obj07_PyVnce RFL_Obj07_Vx RFL_Obj07_Vy RFL_Obj07_Ax RFL_Obj07_Ay RFL_Obj07_OrientationYaw RFL_Obj07_ExistProb RFL_Obj07_VxVnce RFL_Obj07_VyVnce RFL_Obj07_AxVnce RFL_Obj07_AyVnce RFL_Obj07_OrientationYawVnce RFL_Obj07_MovingObserved RFL_Obj07_MovingProbability RFL_Obj07_Length RFL_Obj07_Valid RFL_Obj07_LengthVnce RFL_Obj07_WidthVnce RFL_Obj07_Width RFL_Obj07_BehaviorType RFL_Obj07_ObstacleConf RFL_Obj07_NonObstacleConf RFL_Obj07_PxPyCoVnce RFL_Obj07_PxVxCoVnce RFL_Obj07_PxVyCoVnce RFL_Obj07_PyVxCoVnce RFL_Obj07_PyVyCoVnce RFL_Obj07_VxVyCoVnce RFL_Obj07_PxAxCoVnce RFL_Obj07_PxAyCoVnce RFL_Obj07_PyAxCoVnce RFL_Obj07_PyAyCoVnce RFL_Obj07_VxAxCoVnce RFL_Obj07_VxAyCoVnce RFL_Obj07_VyAxCoVnce RFL_Obj07_VyAyCoVnce RFL_Obj07_AxAyCoVnce RFL_Obj07_MobileObstConf RFL_Obj07_Mob4PlusWhlConf RFL_Obj07_Mob2WhlConf RFL_Obj07_MobPedConf RFL_Obj07_FourPlusWhlCarConf RFL_Obj07_FourPlusWhlHGVConf RFL_Obj07_GroundReflexConf RFL_Obj07_StatObstConf RFL_Obj07_StatBarrierConf;
SIG_GROUP_ 926 SG_RFL_Obj08 1 : RFL_Obj08_CRC RFL_Obj08_AliveCtr RFL_Obj08_ProtBlockCtr RFL_Obj08_ReferencePoint RFL_Obj08_ObjId RFL_Obj08_MeasurementStatus RFL_Obj08_Px RFL_Obj08_Py RFL_Obj08_PxVnce RFL_Obj08_PyVnce RFL_Obj08_Vx RFL_Obj08_Vy RFL_Obj08_Ax RFL_Obj08_Ay RFL_Obj08_OrientationYaw RFL_Obj08_ExistProb RFL_Obj08_VxVnce RFL_Obj08_VyVnce RFL_Obj08_AxVnce RFL_Obj08_AyVnce RFL_Obj08_OrientationYawVnce RFL_Obj08_MovingObserved RFL_Obj08_MovingProbability RFL_Obj08_Length RFL_Obj08_Valid RFL_Obj08_LengthVnce RFL_Obj08_WidthVnce RFL_Obj08_Width RFL_Obj08_BehaviorType RFL_Obj08_ObstacleConf RFL_Obj08_NonObstacleConf RFL_Obj08_PxPyCoVnce RFL_Obj08_PxVxCoVnce RFL_Obj08_PxVyCoVnce RFL_Obj08_PyVxCoVnce RFL_Obj08_PyVyCoVnce RFL_Obj08_VxVyCoVnce RFL_Obj08_PxAxCoVnce RFL_Obj08_PxAyCoVnce RFL_Obj08_PyAxCoVnce RFL_Obj08_PyAyCoVnce RFL_Obj08_VxAxCoVnce RFL_Obj08_VxAyCoVnce RFL_Obj08_VyAxCoVnce RFL_Obj08_VyAyCoVnce RFL_Obj08_AxAyCoVnce RFL_Obj08_MobileObstConf RFL_Obj08_Mob4PlusWhlConf RFL_Obj08_Mob2WhlConf RFL_Obj08_MobPedConf RFL_Obj08_FourPlusWhlCarConf RFL_Obj08_FourPlusWhlHGVConf RFL_Obj08_GroundReflexConf RFL_Obj08_StatObstConf RFL_Obj08_StatBarrierConf;
SIG_GROUP_ 927 SG_RFL_Obj09 1 : RFL_Obj09_CRC RFL_Obj09_AliveCtr RFL_Obj09_ProtBlockCtr RFL_Obj09_ReferencePoint RFL_Obj09_ObjId RFL_Obj09_MeasurementStatus RFL_Obj09_Px RFL_Obj09_Py RFL_Obj09_PxVnce RFL_Obj09_PyVnce RFL_Obj09_Vx RFL_Obj09_Vy RFL_Obj09_Ax RFL_Obj09_Ay RFL_Obj09_OrientationYaw RFL_Obj09_ExistProb RFL_Obj09_VxVnce RFL_Obj09_VyVnce RFL_Obj09_AxVnce RFL_Obj09_AyVnce RFL_Obj09_OrientationYawVnce RFL_Obj09_MovingObserved RFL_Obj09_MovingProbability RFL_Obj09_Length RFL_Obj09_Valid RFL_Obj09_LengthVnce RFL_Obj09_WidthVnce RFL_Obj09_Width RFL_Obj09_BehaviorType RFL_Obj09_ObstacleConf RFL_Obj09_NonObstacleConf RFL_Obj09_PxPyCoVnce RFL_Obj09_PxVxCoVnce RFL_Obj09_PxVyCoVnce RFL_Obj09_PyVxCoVnce RFL_Obj09_PyVyCoVnce RFL_Obj09_VxVyCoVnce RFL_Obj09_PxAxCoVnce RFL_Obj09_PxAyCoVnce RFL_Obj09_PyAxCoVnce RFL_Obj09_PyAyCoVnce RFL_Obj09_VxAxCoVnce RFL_Obj09_VxAyCoVnce RFL_Obj09_VyAxCoVnce RFL_Obj09_VyAyCoVnce RFL_Obj09_AxAyCoVnce RFL_Obj09_MobileObstConf RFL_Obj09_Mob4PlusWhlConf RFL_Obj09_Mob2WhlConf RFL_Obj09_MobPedConf RFL_Obj09_FourPlusWhlCarConf RFL_Obj09_FourPlusWhlHGVConf RFL_Obj09_GroundReflexConf RFL_Obj09_StatObstConf RFL_Obj09_StatBarrierConf;
SIG_GROUP_ 1172 SG_RFR_ObjHdr 1 : RFR_ObjHdr_CRC RFR_ObjHdr_AliveCtr RFR_ObjHdr_ProtBlockCtr RFR_ObjHdr_IfVersionIdMajor RFR_ObjHdr_IfVersionIdMinor RFR_ObjHdr_NumValidObjects RFR_ObjHdr_TimeStampStatus RFR_ObjHdr_TimeStamp RFR_ObjHdr_SensorState RFR_ObjHdr_AziOutOfSpec RFR_ObjHdr_ElevOutOfSpec RFR_ObjHdr_ObjectDownSel RFR_ObjHdr_SensorOriginPointY RFR_ObjHdr_SensorOriginPointX RFR_ObjHdr_SensorOriginPointZ RFR_ObjHdr_SensorOrientYaw RFR_ObjHdr_SensorOrientPitch RFR_ObjHdr_SensorOrientRoll RFR_ObjHdr_FovAzimuthBegin RFR_ObjHdr_FovAzimuthEnd RFR_ObjHdr_FovElevationBegin RFR_ObjHdr_FovElevationEnd RFR_ObjHdr_DetectionRange RFR_ObjHdr_TimeStampLocal;
SIG_GROUP_ 1174 SG_RFR_Obj00 1 : RFR_Obj00_CRC RFR_Obj00_AliveCtr RFR_Obj00_ProtBlockCtr RFR_Obj00_ReferencePoint RFR_Obj00_ObjId RFR_Obj00_MeasurementStatus RFR_Obj00_Px RFR_Obj00_Py RFR_Obj00_PxVnce RFR_Obj00_PyVnce RFR_Obj00_Vx RFR_Obj00_Vy RFR_Obj00_Ax RFR_Obj00_Ay RFR_Obj00_OrientationYaw RFR_Obj00_ExistProb RFR_Obj00_VxVnce RFR_Obj00_VyVnce RFR_Obj00_AxVnce RFR_Obj00_AyVnce RFR_Obj00_OrientationYawVnce RFR_Obj00_MovingObserved RFR_Obj00_MovingProbability RFR_Obj00_Length RFR_Obj00_Valid RFR_Obj00_LengthVnce RFR_Obj00_WidthVnce RFR_Obj00_Width RFR_Obj00_BehaviorType RFR_Obj00_ObstacleConf RFR_Obj00_NonObstacleConf RFR_Obj00_PxPyCoVnce RFR_Obj00_PxVxCoVnce RFR_Obj00_PxVyCoVnce RFR_Obj00_PyVxCoVnce RFR_Obj00_PyVyCoVnce RFR_Obj00_VxVyCoVnce RFR_Obj00_PxAxCoVnce RFR_Obj00_PxAyCoVnce RFR_Obj00_PyAxCoVnce RFR_Obj00_PyAyCoVnce RFR_Obj00_VxAxCoVnce RFR_Obj00_VxAyCoVnce RFR_Obj00_VyAxCoVnce RFR_Obj00_VyAyCoVnce RFR_Obj00_AxAyCoVnce RFR_Obj00_MobileObstConf RFR_Obj00_Mob4PlusWhlConf RFR_Obj00_Mob2WhlConf RFR_Obj00_MobPedConf RFR_Obj00_FourPlusWhlCarConf RFR_Obj00_FourPlusWhlHGVConf RFR_Obj00_GroundReflexConf RFR_Obj00_StatObstConf RFR_Obj00_StatBarrierConf;
SIG_GROUP_ 1175 SG_RFR_Obj01 1 : RFR_Obj01_CRC RFR_Obj01_AliveCtr RFR_Obj01_ProtBlockCtr RFR_Obj01_ReferencePoint RFR_Obj01_ObjId RFR_Obj01_MeasurementStatus RFR_Obj01_Px RFR_Obj01_Py RFR_Obj01_PxVnce RFR_Obj01_PyVnce RFR_Obj01_Vx RFR_Obj01_Vy RFR_Obj01_Ax RFR_Obj01_Ay RFR_Obj01_OrientationYaw RFR_Obj01_ExistProb RFR_Obj01_VxVnce RFR_Obj01_VyVnce RFR_Obj01_AxVnce RFR_Obj01_AyVnce RFR_Obj01_OrientationYawVnce RFR_Obj01_MovingObserved RFR_Obj01_MovingProbability RFR_Obj01_Length RFR_Obj01_Valid RFR_Obj01_LengthVnce RFR_Obj01_WidthVnce RFR_Obj01_Width RFR_Obj01_BehaviorType RFR_Obj01_ObstacleConf RFR_Obj01_NonObstacleConf RFR_Obj01_PxPyCoVnce RFR_Obj01_PxVxCoVnce RFR_Obj01_PxVyCoVnce RFR_Obj01_PyVxCoVnce RFR_Obj01_PyVyCoVnce RFR_Obj01_VxVyCoVnce RFR_Obj01_PxAxCoVnce RFR_Obj01_PxAyCoVnce RFR_Obj01_PyAxCoVnce RFR_Obj01_PyAyCoVnce RFR_Obj01_VxAxCoVnce RFR_Obj01_VxAyCoVnce RFR_Obj01_VyAxCoVnce RFR_Obj01_VyAyCoVnce RFR_Obj01_AxAyCoVnce RFR_Obj01_MobileObstConf RFR_Obj01_Mob4PlusWhlConf RFR_Obj01_Mob2WhlConf RFR_Obj01_MobPedConf RFR_Obj01_FourPlusWhlCarConf RFR_Obj01_FourPlusWhlHGVConf RFR_Obj01_GroundReflexConf RFR_Obj01_StatObstConf RFR_Obj01_StatBarrierConf;
SIG_GROUP_ 1176 SG_RFR_Obj02 1 : RFR_Obj02_CRC RFR_Obj02_AliveCtr RFR_Obj02_ProtBlockCtr RFR_Obj02_ReferencePoint RFR_Obj02_ObjId RFR_Obj02_MeasurementStatus RFR_Obj02_Px RFR_Obj02_Py RFR_Obj02_PxVnce RFR_Obj02_PyVnce RFR_Obj02_Vx RFR_Obj02_Vy RFR_Obj02_Ax RFR_Obj02_Ay RFR_Obj02_OrientationYaw RFR_Obj02_ExistProb RFR_Obj02_VxVnce RFR_Obj02_VyVnce RFR_Obj02_AxVnce RFR_Obj02_AyVnce RFR_Obj02_OrientationYawVnce RFR_Obj02_MovingObserved RFR_Obj02_MovingProbability RFR_Obj02_Length RFR_Obj02_Valid RFR_Obj02_LengthVnce RFR_Obj02_WidthVnce RFR_Obj02_Width RFR_Obj02_BehaviorType RFR_Obj02_ObstacleConf RFR_Obj02_NonObstacleConf RFR_Obj02_PxPyCoVnce RFR_Obj02_PxVxCoVnce RFR_Obj02_PxVyCoVnce RFR_Obj02_PyVxCoVnce RFR_Obj02_PyVyCoVnce RFR_Obj02_VxVyCoVnce RFR_Obj02_PxAxCoVnce RFR_Obj02_PxAyCoVnce RFR_Obj02_PyAxCoVnce RFR_Obj02_PyAyCoVnce RFR_Obj02_VxAxCoVnce RFR_Obj02_VxAyCoVnce RFR_Obj02_VyAxCoVnce RFR_Obj02_VyAyCoVnce RFR_Obj02_AxAyCoVnce RFR_Obj02_MobileObstConf RFR_Obj02_Mob4PlusWhlConf RFR_Obj02_Mob2WhlConf RFR_Obj02_MobPedConf RFR_Obj02_FourPlusWhlCarConf RFR_Obj02_FourPlusWhlHGVConf RFR_Obj02_GroundReflexConf RFR_Obj02_StatObstConf RFR_Obj02_StatBarrierConf;
SIG_GROUP_ 1177 SG_RFR_Obj03 1 : RFR_Obj03_CRC RFR_Obj03_AliveCtr RFR_Obj03_ProtBlockCtr RFR_Obj03_ReferencePoint RFR_Obj03_ObjId RFR_Obj03_MeasurementStatus RFR_Obj03_Px RFR_Obj03_Py RFR_Obj03_PxVnce RFR_Obj03_PyVnce RFR_Obj03_Vx RFR_Obj03_Vy RFR_Obj03_Ax RFR_Obj03_Ay RFR_Obj03_OrientationYaw RFR_Obj03_ExistProb RFR_Obj03_VxVnce RFR_Obj03_VyVnce RFR_Obj03_AxVnce RFR_Obj03_AyVnce RFR_Obj03_OrientationYawVnce RFR_Obj03_MovingObserved RFR_Obj03_MovingProbability RFR_Obj03_Length RFR_Obj03_Valid RFR_Obj03_LengthVnce RFR_Obj03_WidthVnce RFR_Obj03_Width RFR_Obj03_BehaviorType RFR_Obj03_ObstacleConf RFR_Obj03_NonObstacleConf RFR_Obj03_PxPyCoVnce RFR_Obj03_PxVxCoVnce RFR_Obj03_PxVyCoVnce RFR_Obj03_PyVxCoVnce RFR_Obj03_PyVyCoVnce RFR_Obj03_VxVyCoVnce RFR_Obj03_PxAxCoVnce RFR_Obj03_PxAyCoVnce RFR_Obj03_PyAxCoVnce RFR_Obj03_PyAyCoVnce RFR_Obj03_VxAxCoVnce RFR_Obj03_VxAyCoVnce RFR_Obj03_VyAxCoVnce RFR_Obj03_VyAyCoVnce RFR_Obj03_AxAyCoVnce RFR_Obj03_MobileObstConf RFR_Obj03_Mob4PlusWhlConf RFR_Obj03_Mob2WhlConf RFR_Obj03_MobPedConf RFR_Obj03_FourPlusWhlCarConf RFR_Obj03_FourPlusWhlHGVConf RFR_Obj03_GroundReflexConf RFR_Obj03_StatObstConf RFR_Obj03_StatBarrierConf;
SIG_GROUP_ 1178 SG_RFR_Obj04 1 : RFR_Obj04_CRC RFR_Obj04_AliveCtr RFR_Obj04_ProtBlockCtr RFR_Obj04_ReferencePoint RFR_Obj04_ObjId RFR_Obj04_MeasurementStatus RFR_Obj04_Px RFR_Obj04_Py RFR_Obj04_PxVnce RFR_Obj04_PyVnce RFR_Obj04_Vx RFR_Obj04_Vy RFR_Obj04_Ax RFR_Obj04_Ay RFR_Obj04_OrientationYaw RFR_Obj04_ExistProb RFR_Obj04_VxVnce RFR_Obj04_VyVnce RFR_Obj04_AxVnce RFR_Obj04_AyVnce RFR_Obj04_OrientationYawVnce RFR_Obj04_MovingObserved RFR_Obj04_MovingProbability RFR_Obj04_Length RFR_Obj04_Valid RFR_Obj04_LengthVnce RFR_Obj04_WidthVnce RFR_Obj04_Width RFR_Obj04_BehaviorType RFR_Obj04_ObstacleConf RFR_Obj04_NonObstacleConf RFR_Obj04_PxPyCoVnce RFR_Obj04_PxVxCoVnce RFR_Obj04_PxVyCoVnce RFR_Obj04_PyVxCoVnce RFR_Obj04_PyVyCoVnce RFR_Obj04_VxVyCoVnce RFR_Obj04_PxAxCoVnce RFR_Obj04_PxAyCoVnce RFR_Obj04_PyAxCoVnce RFR_Obj04_PyAyCoVnce RFR_Obj04_VxAxCoVnce RFR_Obj04_VxAyCoVnce RFR_Obj04_VyAxCoVnce RFR_Obj04_VyAyCoVnce RFR_Obj04_AxAyCoVnce RFR_Obj04_MobileObstConf RFR_Obj04_Mob4PlusWhlConf RFR_Obj04_Mob2WhlConf RFR_Obj04_MobPedConf RFR_Obj04_FourPlusWhlCarConf RFR_Obj04_FourPlusWhlHGVConf RFR_Obj04_GroundReflexConf RFR_Obj04_StatObstConf RFR_Obj04_StatBarrierConf;
SIG_GROUP_ 1179 SG_RFR_Obj05 1 : RFR_Obj05_CRC RFR_Obj05_AliveCtr RFR_Obj05_ProtBlockCtr RFR_Obj05_ReferencePoint RFR_Obj05_ObjId RFR_Obj05_MeasurementStatus RFR_Obj05_Px RFR_Obj05_Py RFR_Obj05_PxVnce RFR_Obj05_PyVnce RFR_Obj05_Vx RFR_Obj05_Vy RFR_Obj05_Ax RFR_Obj05_Ay RFR_Obj05_OrientationYaw RFR_Obj05_ExistProb RFR_Obj05_VxVnce RFR_Obj05_VyVnce RFR_Obj05_AxVnce RFR_Obj05_AyVnce RFR_Obj05_OrientationYawVnce RFR_Obj05_MovingObserved RFR_Obj05_MovingProbability RFR_Obj05_Length RFR_Obj05_Valid RFR_Obj05_LengthVnce RFR_Obj05_WidthVnce RFR_Obj05_Width RFR_Obj05_BehaviorType RFR_Obj05_ObstacleConf RFR_Obj05_NonObstacleConf RFR_Obj05_PxPyCoVnce RFR_Obj05_PxVxCoVnce RFR_Obj05_PxVyCoVnce RFR_Obj05_PyVxCoVnce RFR_Obj05_PyVyCoVnce RFR_Obj05_VxVyCoVnce RFR_Obj05_PxAxCoVnce RFR_Obj05_PxAyCoVnce RFR_Obj05_PyAxCoVnce RFR_Obj05_PyAyCoVnce RFR_Obj05_VxAxCoVnce RFR_Obj05_VxAyCoVnce RFR_Obj05_VyAxCoVnce RFR_Obj05_VyAyCoVnce RFR_Obj05_AxAyCoVnce RFR_Obj05_MobileObstConf RFR_Obj05_Mob4PlusWhlConf RFR_Obj05_Mob2WhlConf RFR_Obj05_MobPedConf RFR_Obj05_FourPlusWhlCarConf RFR_Obj05_FourPlusWhlHGVConf RFR_Obj05_GroundReflexConf RFR_Obj05_StatObstConf RFR_Obj05_StatBarrierConf;
SIG_GROUP_ 1180 SG_RFR_Obj06 1 : RFR_Obj06_CRC RFR_Obj06_AliveCtr RFR_Obj06_ProtBlockCtr RFR_Obj06_ReferencePoint RFR_Obj06_ObjId RFR_Obj06_MeasurementStatus RFR_Obj06_Px RFR_Obj06_Py RFR_Obj06_PxVnce RFR_Obj06_PyVnce RFR_Obj06_Vx RFR_Obj06_Vy RFR_Obj06_Ax RFR_Obj06_Ay RFR_Obj06_OrientationYaw RFR_Obj06_ExistProb RFR_Obj06_VxVnce RFR_Obj06_VyVnce RFR_Obj06_AxVnce RFR_Obj06_AyVnce RFR_Obj06_OrientationYawVnce RFR_Obj06_MovingObserved RFR_Obj06_MovingProbability RFR_Obj06_Length RFR_Obj06_Valid RFR_Obj06_LengthVnce RFR_Obj06_WidthVnce RFR_Obj06_Width RFR_Obj06_BehaviorType RFR_Obj06_ObstacleConf RFR_Obj06_NonObstacleConf RFR_Obj06_PxPyCoVnce RFR_Obj06_PxVxCoVnce RFR_Obj06_PxVyCoVnce RFR_Obj06_PyVxCoVnce RFR_Obj06_PyVyCoVnce RFR_Obj06_VxVyCoVnce RFR_Obj06_PxAxCoVnce RFR_Obj06_PxAyCoVnce RFR_Obj06_PyAxCoVnce RFR_Obj06_PyAyCoVnce RFR_Obj06_VxAxCoVnce RFR_Obj06_VxAyCoVnce RFR_Obj06_VyAxCoVnce RFR_Obj06_VyAyCoVnce RFR_Obj06_AxAyCoVnce RFR_Obj06_MobileObstConf RFR_Obj06_Mob4PlusWhlConf RFR_Obj06_Mob2WhlConf RFR_Obj06_MobPedConf RFR_Obj06_FourPlusWhlCarConf RFR_Obj06_FourPlusWhlHGVConf RFR_Obj06_GroundReflexConf RFR_Obj06_StatObstConf RFR_Obj06_StatBarrierConf;
SIG_GROUP_ 1181 SG_RFR_Obj07 1 : RFR_Obj07_CRC RFR_Obj07_AliveCtr RFR_Obj07_ProtBlockCtr RFR_Obj07_ReferencePoint RFR_Obj07_ObjId RFR_Obj07_MeasurementStatus RFR_Obj07_Px RFR_Obj07_Py RFR_Obj07_PxVnce RFR_Obj07_PyVnce RFR_Obj07_Vx RFR_Obj07_Vy RFR_Obj07_Ax RFR_Obj07_Ay RFR_Obj07_OrientationYaw RFR_Obj07_ExistProb RFR_Obj07_VxVnce RFR_Obj07_VyVnce RFR_Obj07_AxVnce RFR_Obj07_AyVnce RFR_Obj07_OrientationYawVnce RFR_Obj07_MovingObserved RFR_Obj07_MovingProbability RFR_Obj07_Length RFR_Obj07_Valid RFR_Obj07_LengthVnce RFR_Obj07_WidthVnce RFR_Obj07_Width RFR_Obj07_BehaviorType RFR_Obj07_ObstacleConf RFR_Obj07_NonObstacleConf RFR_Obj07_PxPyCoVnce RFR_Obj07_PxVxCoVnce RFR_Obj07_PxVyCoVnce RFR_Obj07_PyVxCoVnce RFR_Obj07_PyVyCoVnce RFR_Obj07_VxVyCoVnce RFR_Obj07_PxAxCoVnce RFR_Obj07_PxAyCoVnce RFR_Obj07_PyAxCoVnce RFR_Obj07_PyAyCoVnce RFR_Obj07_VxAxCoVnce RFR_Obj07_VxAyCoVnce RFR_Obj07_VyAxCoVnce RFR_Obj07_VyAyCoVnce RFR_Obj07_AxAyCoVnce RFR_Obj07_MobileObstConf RFR_Obj07_Mob4PlusWhlConf RFR_Obj07_Mob2WhlConf RFR_Obj07_MobPedConf RFR_Obj07_FourPlusWhlCarConf RFR_Obj07_FourPlusWhlHGVConf RFR_Obj07_GroundReflexConf RFR_Obj07_StatObstConf RFR_Obj07_StatBarrierConf;
SIG_GROUP_ 1182 SG_RFR_Obj08 1 : RFR_Obj08_CRC RFR_Obj08_AliveCtr RFR_Obj08_ProtBlockCtr RFR_Obj08_ReferencePoint RFR_Obj08_ObjId RFR_Obj08_MeasurementStatus RFR_Obj08_Px RFR_Obj08_Py RFR_Obj08_PxVnce RFR_Obj08_PyVnce RFR_Obj08_Vx RFR_Obj08_Vy RFR_Obj08_Ax RFR_Obj08_Ay RFR_Obj08_OrientationYaw RFR_Obj08_ExistProb RFR_Obj08_VxVnce RFR_Obj08_VyVnce RFR_Obj08_AxVnce RFR_Obj08_AyVnce RFR_Obj08_OrientationYawVnce RFR_Obj08_MovingObserved RFR_Obj08_MovingProbability RFR_Obj08_Length RFR_Obj08_Valid RFR_Obj08_LengthVnce RFR_Obj08_WidthVnce RFR_Obj08_Width RFR_Obj08_BehaviorType RFR_Obj08_ObstacleConf RFR_Obj08_NonObstacleConf RFR_Obj08_PxPyCoVnce RFR_Obj08_PxVxCoVnce RFR_Obj08_PxVyCoVnce RFR_Obj08_PyVxCoVnce RFR_Obj08_PyVyCoVnce RFR_Obj08_VxVyCoVnce RFR_Obj08_PxAxCoVnce RFR_Obj08_PxAyCoVnce RFR_Obj08_PyAxCoVnce RFR_Obj08_PyAyCoVnce RFR_Obj08_VxAxCoVnce RFR_Obj08_VxAyCoVnce RFR_Obj08_VyAxCoVnce RFR_Obj08_VyAyCoVnce RFR_Obj08_AxAyCoVnce RFR_Obj08_MobileObstConf RFR_Obj08_Mob4PlusWhlConf RFR_Obj08_Mob2WhlConf RFR_Obj08_MobPedConf RFR_Obj08_FourPlusWhlCarConf RFR_Obj08_FourPlusWhlHGVConf RFR_Obj08_GroundReflexConf RFR_Obj08_StatObstConf RFR_Obj08_StatBarrierConf;
SIG_GROUP_ 1183 SG_RFR_Obj09 1 : RFR_Obj09_CRC RFR_Obj09_AliveCtr RFR_Obj09_ProtBlockCtr RFR_Obj09_ReferencePoint RFR_Obj09_ObjId RFR_Obj09_MeasurementStatus RFR_Obj09_Px RFR_Obj09_Py RFR_Obj09_PxVnce RFR_Obj09_PyVnce RFR_Obj09_Vx RFR_Obj09_Vy RFR_Obj09_Ax RFR_Obj09_Ay RFR_Obj09_OrientationYaw RFR_Obj09_ExistProb RFR_Obj09_VxVnce RFR_Obj09_VyVnce RFR_Obj09_AxVnce RFR_Obj09_AyVnce RFR_Obj09_OrientationYawVnce RFR_Obj09_MovingObserved RFR_Obj09_MovingProbability RFR_Obj09_Length RFR_Obj09_Valid RFR_Obj09_LengthVnce RFR_Obj09_WidthVnce RFR_Obj09_Width RFR_Obj09_BehaviorType RFR_Obj09_ObstacleConf RFR_Obj09_NonObstacleConf RFR_Obj09_PxPyCoVnce RFR_Obj09_PxVxCoVnce RFR_Obj09_PxVyCoVnce RFR_Obj09_PyVxCoVnce RFR_Obj09_PyVyCoVnce RFR_Obj09_VxVyCoVnce RFR_Obj09_PxAxCoVnce RFR_Obj09_PxAyCoVnce RFR_Obj09_PyAxCoVnce RFR_Obj09_PyAyCoVnce RFR_Obj09_VxAxCoVnce RFR_Obj09_VxAyCoVnce RFR_Obj09_VyAxCoVnce RFR_Obj09_VyAyCoVnce RFR_Obj09_AxAyCoVnce RFR_Obj09_MobileObstConf RFR_Obj09_Mob4PlusWhlConf RFR_Obj09_Mob2WhlConf RFR_Obj09_MobPedConf RFR_Obj09_FourPlusWhlCarConf RFR_Obj09_FourPlusWhlHGVConf RFR_Obj09_GroundReflexConf RFR_Obj09_StatObstConf RFR_Obj09_StatBarrierConf;
