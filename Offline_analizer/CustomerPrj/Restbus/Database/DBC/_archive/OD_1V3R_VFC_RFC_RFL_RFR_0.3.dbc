VERSION "created by canmatrix"

NS_ :

BS_:

BU_: RadarFrontCenter VideoFrontCenter RadarFrontLeft RadarFrontRight ReceiveECU

BO_ 432 RFC_Obj26: 64 RadarFrontCenter
 SG_ RFC_Obj26_CRC : 0|16@1+ (1,0) [0|65535] ""  VideoFrontCenter
 SG_ RFC_Obj26_AliveCtr : 16|8@1+ (1,0) [0|255] ""  VideoFrontCenter
 SG_ RFC_Obj26_ProtBlockCtr : 24|4@1+ (1,0) [0|15] ""  VideoFrontCenter
 SG_ RFC_Obj26_ReferencePoint : 28|4@1+ (1,0) [0|15] ""  VideoFrontCenter
 SG_ RFC_Obj26_ObjId : 32|7@1+ (1,0) [0|127] ""  VideoFrontCenter
 SG_ RFC_Obj26_MeasurementStatus : 39|1@1+ (1,0) [0|1] ""  VideoFrontCenter
 SG_ RFC_Obj26_Px : 40|13@1+ (0.0625,-256) [-256|255.9375] "m"  VideoFrontCenter
 SG_ RFC_Obj26_Py : 53|11@1+ (0.125,-128) [-128|127.875] "m"  VideoFrontCenter
 SG_ RFC_Obj26_PxVnce : 64|12@1+ (0.01,0) [0|30] "m^2"  VideoFrontCenter
 SG_ RFC_Obj26_PyVnce : 76|12@1+ (0.01,0) [0|30] "m^2"  VideoFrontCenter
 SG_ RFC_Obj26_Vx : 88|12@1+ (0.0625,-128) [-128|127.9375] "m/s"  VideoFrontCenter
 SG_ RFC_Obj26_Vy : 100|10@1+ (0.125,-64) [-64|63.875] "m/s"  VideoFrontCenter
 SG_ RFC_Obj26_Ax : 110|10@1+ (0.03125,-16) [-16|15.96875] "m/s^2"  VideoFrontCenter
 SG_ RFC_Obj26_Ay : 120|9@1+ (0.0625,-16) [-16|15.9375] "m/s^2"  VideoFrontCenter
 SG_ RFC_Obj26_OrientationYaw : 129|9@1+ (0.0175,-4.48) [-3.15|3.15] "rad"  VideoFrontCenter
 SG_ RFC_Obj26_ExistProb : 138|6@1+ (2,0) [0|100] "%"  VideoFrontCenter
 SG_ RFC_Obj26_VxVnce : 144|12@1+ (0.01,0) [0|30] "m^2/s^2"  VideoFrontCenter
 SG_ RFC_Obj26_VyVnce : 156|12@1+ (0.01,0) [0|30] "m^2/s^2"  VideoFrontCenter
 SG_ RFC_Obj26_AxVnce : 168|12@1+ (0.01,0) [0|30] "m^2/s^4"  VideoFrontCenter
 SG_ RFC_Obj26_AyVnce : 180|12@1+ (0.01,0) [0|30] "m^2/s^4"  VideoFrontCenter
 SG_ RFC_Obj26_OrientationYawVnce : 192|12@1+ (0.0003,0) [0|1] "rad^2"  VideoFrontCenter
 SG_ RFC_Obj26_MovingObserved : 204|6@1+ (2,0) [0|100] "%"  VideoFrontCenter
 SG_ RFC_Obj26_MovingProbability : 210|6@1+ (2,0) [0|100] "%"  VideoFrontCenter
 SG_ RFC_Obj26_Length : 216|7@1+ (0.125,0) [0|15.875] "m"  VideoFrontCenter
 SG_ RFC_Obj26_Valid : 223|1@1+ (1,0) [0|1] ""  VideoFrontCenter
 SG_ RFC_Obj26_LengthVnce : 224|12@1+ (0.01,0) [0|30] "m^2"  VideoFrontCenter
 SG_ RFC_Obj26_WidthVnce : 236|12@1+ (0.01,0) [0|30] "m^2"  VideoFrontCenter
 SG_ RFC_Obj26_Width : 248|7@1+ (0.125,0) [0|15.875] "m"  VideoFrontCenter
 SG_ RFC_Obj26_BehaviorType : 255|3@1+ (1,0) [0|7] ""  VideoFrontCenter
 SG_ RFC_Obj26_ObstacleConf : 258|6@1+ (2,0) [0|100] "%"  VideoFrontCenter
 SG_ RFC_Obj26_NonObstacleConf : 264|6@1+ (2,0) [0|100] "%"  VideoFrontCenter
 SG_ RFC_Obj26_PxPyCoVnce : 272|12@1+ (0.01,0) [0|30] "m^2"  VideoFrontCenter
 SG_ RFC_Obj26_PxVxCoVnce : 284|12@1+ (0.01,0) [0|30] "m^2/s"  VideoFrontCenter
 SG_ RFC_Obj26_PxVyCoVnce : 296|12@1+ (0.01,0) [0|30] "m^2/s"  VideoFrontCenter
 SG_ RFC_Obj26_PyVxCoVnce : 308|12@1+ (0.01,0) [0|30] "m^2/s"  VideoFrontCenter
 SG_ RFC_Obj26_PyVyCoVnce : 320|12@1+ (0.01,0) [0|30] "m^2/s"  VideoFrontCenter
 SG_ RFC_Obj26_VxVyCoVnce : 332|12@1+ (0.01,0) [0|30] "m^2/s^2"  VideoFrontCenter
 SG_ RFC_Obj26_PxAxCoVnce : 344|12@1+ (0.01,0) [0|30] "m^2/s^2"  VideoFrontCenter
 SG_ RFC_Obj26_PxAyCoVnce : 356|12@1+ (0.01,0) [0|30] "m^2/s^2"  VideoFrontCenter
 SG_ RFC_Obj26_PyAxCoVnce : 368|12@1+ (0.01,0) [0|30] "m^2/s^2"  VideoFrontCenter
 SG_ RFC_Obj26_PyAyCoVnce : 380|12@1+ (0.01,0) [0|30] "m^2/s^2"  VideoFrontCenter
 SG_ RFC_Obj26_VxAxCoVnce : 392|12@1+ (0.01,0) [0|30] "m^2/s^3"  VideoFrontCenter
 SG_ RFC_Obj26_VxAyCoVnce : 404|12@1+ (0.01,0) [0|30] "m^2/s^3"  VideoFrontCenter
 SG_ RFC_Obj26_VyAxCoVnce : 416|12@1+ (0.01,0) [0|30] "m^2/s^3"  VideoFrontCenter
 SG_ RFC_Obj26_VyAyCoVnce : 428|12@1+ (0.01,0) [0|30] "m^2/s^3"  VideoFrontCenter
 SG_ RFC_Obj26_AxAyCoVnce : 440|12@1+ (0.01,0) [0|30] "m^2/s^4"  VideoFrontCenter
 SG_ RFC_Obj26_MobileObstConf : 452|6@1+ (2,0) [0|100] "%"  VideoFrontCenter
 SG_ RFC_Obj26_Mob4PlusWhlConf : 458|6@1+ (2,0) [0|100] "%"  VideoFrontCenter
 SG_ RFC_Obj26_Mob2WhlConf : 464|6@1+ (2,0) [0|100] "%"  VideoFrontCenter
 SG_ RFC_Obj26_MobPedConf : 470|6@1+ (2,0) [0|100] "%"  VideoFrontCenter
 SG_ RFC_Obj26_FourPlusWhlCarConf : 476|6@1+ (2,0) [0|100] "%"  VideoFrontCenter
 SG_ RFC_Obj26_FourPlusWhlHGVConf : 482|6@1+ (2,0) [0|100] "%"  VideoFrontCenter
 SG_ RFC_Obj26_GroundReflexConf : 488|6@1+ (2,0) [0|100] "%"  VideoFrontCenter
 SG_ RFC_Obj26_StatObstConf : 494|6@1+ (2,0) [0|100] "%"  VideoFrontCenter
 SG_ RFC_Obj26_StatBarrierConf : 500|6@1+ (2,0) [0|100] "%"  VideoFrontCenter

BO_ 433 RFC_Obj27: 64 RadarFrontCenter
 SG_ RFC_Obj27_CRC : 0|16@1+ (1,0) [0|65535] ""  VideoFrontCenter
 SG_ RFC_Obj27_AliveCtr : 16|8@1+ (1,0) [0|255] ""  VideoFrontCenter
 SG_ RFC_Obj27_ProtBlockCtr : 24|4@1+ (1,0) [0|15] ""  VideoFrontCenter
 SG_ RFC_Obj27_ReferencePoint : 28|4@1+ (1,0) [0|15] ""  VideoFrontCenter
 SG_ RFC_Obj27_ObjId : 32|7@1+ (1,0) [0|127] ""  VideoFrontCenter
 SG_ RFC_Obj27_MeasurementStatus : 39|1@1+ (1,0) [0|1] ""  VideoFrontCenter
 SG_ RFC_Obj27_Px : 40|13@1+ (0.0625,-256) [-256|255.9375] "m"  VideoFrontCenter
 SG_ RFC_Obj27_Py : 53|11@1+ (0.125,-128) [-128|127.875] "m"  VideoFrontCenter
 SG_ RFC_Obj27_PxVnce : 64|12@1+ (0.01,0) [0|30] "m^2"  VideoFrontCenter
 SG_ RFC_Obj27_PyVnce : 76|12@1+ (0.01,0) [0|30] "m^2"  VideoFrontCenter
 SG_ RFC_Obj27_Vx : 88|12@1+ (0.0625,-128) [-128|127.9375] "m/s"  VideoFrontCenter
 SG_ RFC_Obj27_Vy : 100|10@1+ (0.125,-64) [-64|63.875] "m/s"  VideoFrontCenter
 SG_ RFC_Obj27_Ax : 110|10@1+ (0.03125,-16) [-16|15.96875] "m/s^2"  VideoFrontCenter
 SG_ RFC_Obj27_Ay : 120|9@1+ (0.0625,-16) [-16|15.9375] "m/s^2"  VideoFrontCenter
 SG_ RFC_Obj27_OrientationYaw : 129|9@1+ (0.0175,-4.48) [-3.15|3.15] "rad"  VideoFrontCenter
 SG_ RFC_Obj27_ExistProb : 138|6@1+ (2,0) [0|100] "%"  VideoFrontCenter
 SG_ RFC_Obj27_VxVnce : 144|12@1+ (0.01,0) [0|30] "m^2/s^2"  VideoFrontCenter
 SG_ RFC_Obj27_VyVnce : 156|12@1+ (0.01,0) [0|30] "m^2/s^2"  VideoFrontCenter
 SG_ RFC_Obj27_AxVnce : 168|12@1+ (0.01,0) [0|30] "m^2/s^4"  VideoFrontCenter
 SG_ RFC_Obj27_AyVnce : 180|12@1+ (0.01,0) [0|30] "m^2/s^4"  VideoFrontCenter
 SG_ RFC_Obj27_OrientationYawVnce : 192|12@1+ (0.0003,0) [0|1] "rad^2"  VideoFrontCenter
 SG_ RFC_Obj27_MovingObserved : 204|6@1+ (2,0) [0|100] "%"  VideoFrontCenter
 SG_ RFC_Obj27_MovingProbability : 210|6@1+ (2,0) [0|100] "%"  VideoFrontCenter
 SG_ RFC_Obj27_Length : 216|7@1+ (0.125,0) [0|15.875] "m"  VideoFrontCenter
 SG_ RFC_Obj27_Valid : 223|1@1+ (1,0) [0|1] ""  VideoFrontCenter
 SG_ RFC_Obj27_LengthVnce : 224|12@1+ (0.01,0) [0|30] "m^2"  VideoFrontCenter
 SG_ RFC_Obj27_WidthVnce : 236|12@1+ (0.01,0) [0|30] "m^2"  VideoFrontCenter
 SG_ RFC_Obj27_Width : 248|7@1+ (0.125,0) [0|15.875] "m"  VideoFrontCenter
 SG_ RFC_Obj27_BehaviorType : 255|3@1+ (1,0) [0|7] ""  VideoFrontCenter
 SG_ RFC_Obj27_ObstacleConf : 258|6@1+ (2,0) [0|100] "%"  VideoFrontCenter
 SG_ RFC_Obj27_NonObstacleConf : 264|6@1+ (2,0) [0|100] "%"  VideoFrontCenter
 SG_ RFC_Obj27_PxPyCoVnce : 272|12@1+ (0.01,0) [0|30] "m^2"  VideoFrontCenter
 SG_ RFC_Obj27_PxVxCoVnce : 284|12@1+ (0.01,0) [0|30] "m^2/s"  VideoFrontCenter
 SG_ RFC_Obj27_PxVyCoVnce : 296|12@1+ (0.01,0) [0|30] "m^2/s"  VideoFrontCenter
 SG_ RFC_Obj27_PyVxCoVnce : 308|12@1+ (0.01,0) [0|30] "m^2/s"  VideoFrontCenter
 SG_ RFC_Obj27_PyVyCoVnce : 320|12@1+ (0.01,0) [0|30] "m^2/s"  VideoFrontCenter
 SG_ RFC_Obj27_VxVyCoVnce : 332|12@1+ (0.01,0) [0|30] "m^2/s^2"  VideoFrontCenter
 SG_ RFC_Obj27_PxAxCoVnce : 344|12@1+ (0.01,0) [0|30] "m^2/s^2"  VideoFrontCenter
 SG_ RFC_Obj27_PxAyCoVnce : 356|12@1+ (0.01,0) [0|30] "m^2/s^2"  VideoFrontCenter
 SG_ RFC_Obj27_PyAxCoVnce : 368|12@1+ (0.01,0) [0|30] "m^2/s^2"  VideoFrontCenter
 SG_ RFC_Obj27_PyAyCoVnce : 380|12@1+ (0.01,0) [0|30] "m^2/s^2"  VideoFrontCenter
 SG_ RFC_Obj27_VxAxCoVnce : 392|12@1+ (0.01,0) [0|30] "m^2/s^3"  VideoFrontCenter
 SG_ RFC_Obj27_VxAyCoVnce : 404|12@1+ (0.01,0) [0|30] "m^2/s^3"  VideoFrontCenter
 SG_ RFC_Obj27_VyAxCoVnce : 416|12@1+ (0.01,0) [0|30] "m^2/s^3"  VideoFrontCenter
 SG_ RFC_Obj27_VyAyCoVnce : 428|12@1+ (0.01,0) [0|30] "m^2/s^3"  VideoFrontCenter
 SG_ RFC_Obj27_AxAyCoVnce : 440|12@1+ (0.01,0) [0|30] "m^2/s^4"  VideoFrontCenter
 SG_ RFC_Obj27_MobileObstConf : 452|6@1+ (2,0) [0|100] "%"  VideoFrontCenter
 SG_ RFC_Obj27_Mob4PlusWhlConf : 458|6@1+ (2,0) [0|100] "%"  VideoFrontCenter
 SG_ RFC_Obj27_Mob2WhlConf : 464|6@1+ (2,0) [0|100] "%"  VideoFrontCenter
 SG_ RFC_Obj27_MobPedConf : 470|6@1+ (2,0) [0|100] "%"  VideoFrontCenter
 SG_ RFC_Obj27_FourPlusWhlCarConf : 476|6@1+ (2,0) [0|100] "%"  VideoFrontCenter
 SG_ RFC_Obj27_FourPlusWhlHGVConf : 482|6@1+ (2,0) [0|100] "%"  VideoFrontCenter
 SG_ RFC_Obj27_GroundReflexConf : 488|6@1+ (2,0) [0|100] "%"  VideoFrontCenter
 SG_ RFC_Obj27_StatObstConf : 494|6@1+ (2,0) [0|100] "%"  VideoFrontCenter
 SG_ RFC_Obj27_StatBarrierConf : 500|6@1+ (2,0) [0|100] "%"  VideoFrontCenter

BO_ 434 RFC_Obj28: 64 RadarFrontCenter
 SG_ RFC_Obj28_CRC : 0|16@1+ (1,0) [0|65535] ""  VideoFrontCenter
 SG_ RFC_Obj28_AliveCtr : 16|8@1+ (1,0) [0|255] ""  VideoFrontCenter
 SG_ RFC_Obj28_ProtBlockCtr : 24|4@1+ (1,0) [0|15] ""  VideoFrontCenter
 SG_ RFC_Obj28_ReferencePoint : 28|4@1+ (1,0) [0|15] ""  VideoFrontCenter
 SG_ RFC_Obj28_ObjId : 32|7@1+ (1,0) [0|127] ""  VideoFrontCenter
 SG_ RFC_Obj28_MeasurementStatus : 39|1@1+ (1,0) [0|1] ""  VideoFrontCenter
 SG_ RFC_Obj28_Px : 40|13@1+ (0.0625,-256) [-256|255.9375] "m"  VideoFrontCenter
 SG_ RFC_Obj28_Py : 53|11@1+ (0.125,-128) [-128|127.875] "m"  VideoFrontCenter
 SG_ RFC_Obj28_PxVnce : 64|12@1+ (0.01,0) [0|30] "m^2"  VideoFrontCenter
 SG_ RFC_Obj28_PyVnce : 76|12@1+ (0.01,0) [0|30] "m^2"  VideoFrontCenter
 SG_ RFC_Obj28_Vx : 88|12@1+ (0.0625,-128) [-128|127.9375] "m/s"  VideoFrontCenter
 SG_ RFC_Obj28_Vy : 100|10@1+ (0.125,-64) [-64|63.875] "m/s"  VideoFrontCenter
 SG_ RFC_Obj28_Ax : 110|10@1+ (0.03125,-16) [-16|15.96875] "m/s^2"  VideoFrontCenter
 SG_ RFC_Obj28_Ay : 120|9@1+ (0.0625,-16) [-16|15.9375] "m/s^2"  VideoFrontCenter
 SG_ RFC_Obj28_OrientationYaw : 129|9@1+ (0.0175,-4.48) [-3.15|3.15] "rad"  VideoFrontCenter
 SG_ RFC_Obj28_ExistProb : 138|6@1+ (2,0) [0|100] "%"  VideoFrontCenter
 SG_ RFC_Obj28_VxVnce : 144|12@1+ (0.01,0) [0|30] "m^2/s^2"  VideoFrontCenter
 SG_ RFC_Obj28_VyVnce : 156|12@1+ (0.01,0) [0|30] "m^2/s^2"  VideoFrontCenter
 SG_ RFC_Obj28_AxVnce : 168|12@1+ (0.01,0) [0|30] "m^2/s^4"  VideoFrontCenter
 SG_ RFC_Obj28_AyVnce : 180|12@1+ (0.01,0) [0|30] "m^2/s^4"  VideoFrontCenter
 SG_ RFC_Obj28_OrientationYawVnce : 192|12@1+ (0.0003,0) [0|1] "rad^2"  VideoFrontCenter
 SG_ RFC_Obj28_MovingObserved : 204|6@1+ (2,0) [0|100] "%"  VideoFrontCenter
 SG_ RFC_Obj28_MovingProbability : 210|6@1+ (2,0) [0|100] "%"  VideoFrontCenter
 SG_ RFC_Obj28_Length : 216|7@1+ (0.125,0) [0|15.875] "m"  VideoFrontCenter
 SG_ RFC_Obj28_Valid : 223|1@1+ (1,0) [0|1] ""  VideoFrontCenter
 SG_ RFC_Obj28_LengthVnce : 224|12@1+ (0.01,0) [0|30] "m^2"  VideoFrontCenter
 SG_ RFC_Obj28_WidthVnce : 236|12@1+ (0.01,0) [0|30] "m^2"  VideoFrontCenter
 SG_ RFC_Obj28_Width : 248|7@1+ (0.125,0) [0|15.875] "m"  VideoFrontCenter
 SG_ RFC_Obj28_BehaviorType : 255|3@1+ (1,0) [0|7] ""  VideoFrontCenter
 SG_ RFC_Obj28_ObstacleConf : 258|6@1+ (2,0) [0|100] "%"  VideoFrontCenter
 SG_ RFC_Obj28_NonObstacleConf : 264|6@1+ (2,0) [0|100] "%"  VideoFrontCenter
 SG_ RFC_Obj28_PxPyCoVnce : 272|12@1+ (0.01,0) [0|30] "m^2"  VideoFrontCenter
 SG_ RFC_Obj28_PxVxCoVnce : 284|12@1+ (0.01,0) [0|30] "m^2/s"  VideoFrontCenter
 SG_ RFC_Obj28_PxVyCoVnce : 296|12@1+ (0.01,0) [0|30] "m^2/s"  VideoFrontCenter
 SG_ RFC_Obj28_PyVxCoVnce : 308|12@1+ (0.01,0) [0|30] "m^2/s"  VideoFrontCenter
 SG_ RFC_Obj28_PyVyCoVnce : 320|12@1+ (0.01,0) [0|30] "m^2/s"  VideoFrontCenter
 SG_ RFC_Obj28_VxVyCoVnce : 332|12@1+ (0.01,0) [0|30] "m^2/s^2"  VideoFrontCenter
 SG_ RFC_Obj28_PxAxCoVnce : 344|12@1+ (0.01,0) [0|30] "m^2/s^2"  VideoFrontCenter
 SG_ RFC_Obj28_PxAyCoVnce : 356|12@1+ (0.01,0) [0|30] "m^2/s^2"  VideoFrontCenter
 SG_ RFC_Obj28_PyAxCoVnce : 368|12@1+ (0.01,0) [0|30] "m^2/s^2"  VideoFrontCenter
 SG_ RFC_Obj28_PyAyCoVnce : 380|12@1+ (0.01,0) [0|30] "m^2/s^2"  VideoFrontCenter
 SG_ RFC_Obj28_VxAxCoVnce : 392|12@1+ (0.01,0) [0|30] "m^2/s^3"  VideoFrontCenter
 SG_ RFC_Obj28_VxAyCoVnce : 404|12@1+ (0.01,0) [0|30] "m^2/s^3"  VideoFrontCenter
 SG_ RFC_Obj28_VyAxCoVnce : 416|12@1+ (0.01,0) [0|30] "m^2/s^3"  VideoFrontCenter
 SG_ RFC_Obj28_VyAyCoVnce : 428|12@1+ (0.01,0) [0|30] "m^2/s^3"  VideoFrontCenter
 SG_ RFC_Obj28_AxAyCoVnce : 440|12@1+ (0.01,0) [0|30] "m^2/s^4"  VideoFrontCenter
 SG_ RFC_Obj28_MobileObstConf : 452|6@1+ (2,0) [0|100] "%"  VideoFrontCenter
 SG_ RFC_Obj28_Mob4PlusWhlConf : 458|6@1+ (2,0) [0|100] "%"  VideoFrontCenter
 SG_ RFC_Obj28_Mob2WhlConf : 464|6@1+ (2,0) [0|100] "%"  VideoFrontCenter
 SG_ RFC_Obj28_MobPedConf : 470|6@1+ (2,0) [0|100] "%"  VideoFrontCenter
 SG_ RFC_Obj28_FourPlusWhlCarConf : 476|6@1+ (2,0) [0|100] "%"  VideoFrontCenter
 SG_ RFC_Obj28_FourPlusWhlHGVConf : 482|6@1+ (2,0) [0|100] "%"  VideoFrontCenter
 SG_ RFC_Obj28_GroundReflexConf : 488|6@1+ (2,0) [0|100] "%"  VideoFrontCenter
 SG_ RFC_Obj28_StatObstConf : 494|6@1+ (2,0) [0|100] "%"  VideoFrontCenter
 SG_ RFC_Obj28_StatBarrierConf : 500|6@1+ (2,0) [0|100] "%"  VideoFrontCenter

BO_ 435 RFC_Obj29: 64 RadarFrontCenter
 SG_ RFC_Obj29_CRC : 0|16@1+ (1,0) [0|65535] ""  VideoFrontCenter
 SG_ RFC_Obj29_AliveCtr : 16|8@1+ (1,0) [0|255] ""  VideoFrontCenter
 SG_ RFC_Obj29_ProtBlockCtr : 24|4@1+ (1,0) [0|15] ""  VideoFrontCenter
 SG_ RFC_Obj29_ReferencePoint : 28|4@1+ (1,0) [0|15] ""  VideoFrontCenter
 SG_ RFC_Obj29_ObjId : 32|7@1+ (1,0) [0|127] ""  VideoFrontCenter
 SG_ RFC_Obj29_MeasurementStatus : 39|1@1+ (1,0) [0|1] ""  VideoFrontCenter
 SG_ RFC_Obj29_Px : 40|13@1+ (0.0625,-256) [-256|255.9375] "m"  VideoFrontCenter
 SG_ RFC_Obj29_Py : 53|11@1+ (0.125,-128) [-128|127.875] "m"  VideoFrontCenter
 SG_ RFC_Obj29_PxVnce : 64|12@1+ (0.01,0) [0|30] "m^2"  VideoFrontCenter
 SG_ RFC_Obj29_PyVnce : 76|12@1+ (0.01,0) [0|30] "m^2"  VideoFrontCenter
 SG_ RFC_Obj29_Vx : 88|12@1+ (0.0625,-128) [-128|127.9375] "m/s"  VideoFrontCenter
 SG_ RFC_Obj29_Vy : 100|10@1+ (0.125,-64) [-64|63.875] "m/s"  VideoFrontCenter
 SG_ RFC_Obj29_Ax : 110|10@1+ (0.03125,-16) [-16|15.96875] "m/s^2"  VideoFrontCenter
 SG_ RFC_Obj29_Ay : 120|9@1+ (0.0625,-16) [-16|15.9375] "m/s^2"  VideoFrontCenter
 SG_ RFC_Obj29_OrientationYaw : 129|9@1+ (0.0175,-4.48) [-3.15|3.15] "rad"  VideoFrontCenter
 SG_ RFC_Obj29_ExistProb : 138|6@1+ (2,0) [0|100] "%"  VideoFrontCenter
 SG_ RFC_Obj29_VxVnce : 144|12@1+ (0.01,0) [0|30] "m^2/s^2"  VideoFrontCenter
 SG_ RFC_Obj29_VyVnce : 156|12@1+ (0.01,0) [0|30] "m^2/s^2"  VideoFrontCenter
 SG_ RFC_Obj29_AxVnce : 168|12@1+ (0.01,0) [0|30] "m^2/s^4"  VideoFrontCenter
 SG_ RFC_Obj29_AyVnce : 180|12@1+ (0.01,0) [0|30] "m^2/s^4"  VideoFrontCenter
 SG_ RFC_Obj29_OrientationYawVnce : 192|12@1+ (0.0003,0) [0|1] "rad^2"  VideoFrontCenter
 SG_ RFC_Obj29_MovingObserved : 204|6@1+ (2,0) [0|100] "%"  VideoFrontCenter
 SG_ RFC_Obj29_MovingProbability : 210|6@1+ (2,0) [0|100] "%"  VideoFrontCenter
 SG_ RFC_Obj29_Length : 216|7@1+ (0.125,0) [0|15.875] "m"  VideoFrontCenter
 SG_ RFC_Obj29_Valid : 223|1@1+ (1,0) [0|1] ""  VideoFrontCenter
 SG_ RFC_Obj29_LengthVnce : 224|12@1+ (0.01,0) [0|30] "m^2"  VideoFrontCenter
 SG_ RFC_Obj29_WidthVnce : 236|12@1+ (0.01,0) [0|30] "m^2"  VideoFrontCenter
 SG_ RFC_Obj29_Width : 248|7@1+ (0.125,0) [0|15.875] "m"  VideoFrontCenter
 SG_ RFC_Obj29_BehaviorType : 255|3@1+ (1,0) [0|7] ""  VideoFrontCenter
 SG_ RFC_Obj29_ObstacleConf : 258|6@1+ (2,0) [0|100] "%"  VideoFrontCenter
 SG_ RFC_Obj29_NonObstacleConf : 264|6@1+ (2,0) [0|100] "%"  VideoFrontCenter
 SG_ RFC_Obj29_PxPyCoVnce : 272|12@1+ (0.01,0) [0|30] "m^2"  VideoFrontCenter
 SG_ RFC_Obj29_PxVxCoVnce : 284|12@1+ (0.01,0) [0|30] "m^2/s"  VideoFrontCenter
 SG_ RFC_Obj29_PxVyCoVnce : 296|12@1+ (0.01,0) [0|30] "m^2/s"  VideoFrontCenter
 SG_ RFC_Obj29_PyVxCoVnce : 308|12@1+ (0.01,0) [0|30] "m^2/s"  VideoFrontCenter
 SG_ RFC_Obj29_PyVyCoVnce : 320|12@1+ (0.01,0) [0|30] "m^2/s"  VideoFrontCenter
 SG_ RFC_Obj29_VxVyCoVnce : 332|12@1+ (0.01,0) [0|30] "m^2/s^2"  VideoFrontCenter
 SG_ RFC_Obj29_PxAxCoVnce : 344|12@1+ (0.01,0) [0|30] "m^2/s^2"  VideoFrontCenter
 SG_ RFC_Obj29_PxAyCoVnce : 356|12@1+ (0.01,0) [0|30] "m^2/s^2"  VideoFrontCenter
 SG_ RFC_Obj29_PyAxCoVnce : 368|12@1+ (0.01,0) [0|30] "m^2/s^2"  VideoFrontCenter
 SG_ RFC_Obj29_PyAyCoVnce : 380|12@1+ (0.01,0) [0|30] "m^2/s^2"  VideoFrontCenter
 SG_ RFC_Obj29_VxAxCoVnce : 392|12@1+ (0.01,0) [0|30] "m^2/s^3"  VideoFrontCenter
 SG_ RFC_Obj29_VxAyCoVnce : 404|12@1+ (0.01,0) [0|30] "m^2/s^3"  VideoFrontCenter
 SG_ RFC_Obj29_VyAxCoVnce : 416|12@1+ (0.01,0) [0|30] "m^2/s^3"  VideoFrontCenter
 SG_ RFC_Obj29_VyAyCoVnce : 428|12@1+ (0.01,0) [0|30] "m^2/s^3"  VideoFrontCenter
 SG_ RFC_Obj29_AxAyCoVnce : 440|12@1+ (0.01,0) [0|30] "m^2/s^4"  VideoFrontCenter
 SG_ RFC_Obj29_MobileObstConf : 452|6@1+ (2,0) [0|100] "%"  VideoFrontCenter
 SG_ RFC_Obj29_Mob4PlusWhlConf : 458|6@1+ (2,0) [0|100] "%"  VideoFrontCenter
 SG_ RFC_Obj29_Mob2WhlConf : 464|6@1+ (2,0) [0|100] "%"  VideoFrontCenter
 SG_ RFC_Obj29_MobPedConf : 470|6@1+ (2,0) [0|100] "%"  VideoFrontCenter
 SG_ RFC_Obj29_FourPlusWhlCarConf : 476|6@1+ (2,0) [0|100] "%"  VideoFrontCenter
 SG_ RFC_Obj29_FourPlusWhlHGVConf : 482|6@1+ (2,0) [0|100] "%"  VideoFrontCenter
 SG_ RFC_Obj29_GroundReflexConf : 488|6@1+ (2,0) [0|100] "%"  VideoFrontCenter
 SG_ RFC_Obj29_StatObstConf : 494|6@1+ (2,0) [0|100] "%"  VideoFrontCenter
 SG_ RFC_Obj29_StatBarrierConf : 500|6@1+ (2,0) [0|100] "%"  VideoFrontCenter

BO_ 436 RFC_Obj30: 64 RadarFrontCenter
 SG_ RFC_Obj30_CRC : 0|16@1+ (1,0) [0|65535] ""  VideoFrontCenter
 SG_ RFC_Obj30_AliveCtr : 16|8@1+ (1,0) [0|255] ""  VideoFrontCenter
 SG_ RFC_Obj30_ProtBlockCtr : 24|4@1+ (1,0) [0|15] ""  VideoFrontCenter
 SG_ RFC_Obj30_ReferencePoint : 28|4@1+ (1,0) [0|15] ""  VideoFrontCenter
 SG_ RFC_Obj30_ObjId : 32|7@1+ (1,0) [0|127] ""  VideoFrontCenter
 SG_ RFC_Obj30_MeasurementStatus : 39|1@1+ (1,0) [0|1] ""  VideoFrontCenter
 SG_ RFC_Obj30_Px : 40|13@1+ (0.0625,-256) [-256|255.9375] "m"  VideoFrontCenter
 SG_ RFC_Obj30_Py : 53|11@1+ (0.125,-128) [-128|127.875] "m"  VideoFrontCenter
 SG_ RFC_Obj30_PxVnce : 64|12@1+ (0.01,0) [0|30] "m^2"  VideoFrontCenter
 SG_ RFC_Obj30_PyVnce : 76|12@1+ (0.01,0) [0|30] "m^2"  VideoFrontCenter
 SG_ RFC_Obj30_Vx : 88|12@1+ (0.0625,-128) [-128|127.9375] "m/s"  VideoFrontCenter
 SG_ RFC_Obj30_Vy : 100|10@1+ (0.125,-64) [-64|63.875] "m/s"  VideoFrontCenter
 SG_ RFC_Obj30_Ax : 110|10@1+ (0.03125,-16) [-16|15.96875] "m/s^2"  VideoFrontCenter
 SG_ RFC_Obj30_Ay : 120|9@1+ (0.0625,-16) [-16|15.9375] "m/s^2"  VideoFrontCenter
 SG_ RFC_Obj30_OrientationYaw : 129|9@1+ (0.0175,-4.48) [-3.15|3.15] "rad"  VideoFrontCenter
 SG_ RFC_Obj30_ExistProb : 138|6@1+ (2,0) [0|100] "%"  VideoFrontCenter
 SG_ RFC_Obj30_VxVnce : 144|12@1+ (0.01,0) [0|30] "m^2/s^2"  VideoFrontCenter
 SG_ RFC_Obj30_VyVnce : 156|12@1+ (0.01,0) [0|30] "m^2/s^2"  VideoFrontCenter
 SG_ RFC_Obj30_AxVnce : 168|12@1+ (0.01,0) [0|30] "m^2/s^4"  VideoFrontCenter
 SG_ RFC_Obj30_AyVnce : 180|12@1+ (0.01,0) [0|30] "m^2/s^4"  VideoFrontCenter
 SG_ RFC_Obj30_OrientationYawVnce : 192|12@1+ (0.0003,0) [0|1] "rad^2"  VideoFrontCenter
 SG_ RFC_Obj30_MovingObserved : 204|6@1+ (2,0) [0|100] "%"  VideoFrontCenter
 SG_ RFC_Obj30_MovingProbability : 210|6@1+ (2,0) [0|100] "%"  VideoFrontCenter
 SG_ RFC_Obj30_Length : 216|7@1+ (0.125,0) [0|15.875] "m"  VideoFrontCenter
 SG_ RFC_Obj30_Valid : 223|1@1+ (1,0) [0|1] ""  VideoFrontCenter
 SG_ RFC_Obj30_LengthVnce : 224|12@1+ (0.01,0) [0|30] "m^2"  VideoFrontCenter
 SG_ RFC_Obj30_WidthVnce : 236|12@1+ (0.01,0) [0|30] "m^2"  VideoFrontCenter
 SG_ RFC_Obj30_Width : 248|7@1+ (0.125,0) [0|15.875] "m"  VideoFrontCenter
 SG_ RFC_Obj30_BehaviorType : 255|3@1+ (1,0) [0|7] ""  VideoFrontCenter
 SG_ RFC_Obj30_ObstacleConf : 258|6@1+ (2,0) [0|100] "%"  VideoFrontCenter
 SG_ RFC_Obj30_NonObstacleConf : 264|6@1+ (2,0) [0|100] "%"  VideoFrontCenter
 SG_ RFC_Obj30_PxPyCoVnce : 272|12@1+ (0.01,0) [0|30] "m^2"  VideoFrontCenter
 SG_ RFC_Obj30_PxVxCoVnce : 284|12@1+ (0.01,0) [0|30] "m^2/s"  VideoFrontCenter
 SG_ RFC_Obj30_PxVyCoVnce : 296|12@1+ (0.01,0) [0|30] "m^2/s"  VideoFrontCenter
 SG_ RFC_Obj30_PyVxCoVnce : 308|12@1+ (0.01,0) [0|30] "m^2/s"  VideoFrontCenter
 SG_ RFC_Obj30_PyVyCoVnce : 320|12@1+ (0.01,0) [0|30] "m^2/s"  VideoFrontCenter
 SG_ RFC_Obj30_VxVyCoVnce : 332|12@1+ (0.01,0) [0|30] "m^2/s^2"  VideoFrontCenter
 SG_ RFC_Obj30_PxAxCoVnce : 344|12@1+ (0.01,0) [0|30] "m^2/s^2"  VideoFrontCenter
 SG_ RFC_Obj30_PxAyCoVnce : 356|12@1+ (0.01,0) [0|30] "m^2/s^2"  VideoFrontCenter
 SG_ RFC_Obj30_PyAxCoVnce : 368|12@1+ (0.01,0) [0|30] "m^2/s^2"  VideoFrontCenter
 SG_ RFC_Obj30_PyAyCoVnce : 380|12@1+ (0.01,0) [0|30] "m^2/s^2"  VideoFrontCenter
 SG_ RFC_Obj30_VxAxCoVnce : 392|12@1+ (0.01,0) [0|30] "m^2/s^3"  VideoFrontCenter
 SG_ RFC_Obj30_VxAyCoVnce : 404|12@1+ (0.01,0) [0|30] "m^2/s^3"  VideoFrontCenter
 SG_ RFC_Obj30_VyAxCoVnce : 416|12@1+ (0.01,0) [0|30] "m^2/s^3"  VideoFrontCenter
 SG_ RFC_Obj30_VyAyCoVnce : 428|12@1+ (0.01,0) [0|30] "m^2/s^3"  VideoFrontCenter
 SG_ RFC_Obj30_AxAyCoVnce : 440|12@1+ (0.01,0) [0|30] "m^2/s^4"  VideoFrontCenter
 SG_ RFC_Obj30_MobileObstConf : 452|6@1+ (2,0) [0|100] "%"  VideoFrontCenter
 SG_ RFC_Obj30_Mob4PlusWhlConf : 458|6@1+ (2,0) [0|100] "%"  VideoFrontCenter
 SG_ RFC_Obj30_Mob2WhlConf : 464|6@1+ (2,0) [0|100] "%"  VideoFrontCenter
 SG_ RFC_Obj30_MobPedConf : 470|6@1+ (2,0) [0|100] "%"  VideoFrontCenter
 SG_ RFC_Obj30_FourPlusWhlCarConf : 476|6@1+ (2,0) [0|100] "%"  VideoFrontCenter
 SG_ RFC_Obj30_FourPlusWhlHGVConf : 482|6@1+ (2,0) [0|100] "%"  VideoFrontCenter
 SG_ RFC_Obj30_GroundReflexConf : 488|6@1+ (2,0) [0|100] "%"  VideoFrontCenter
 SG_ RFC_Obj30_StatObstConf : 494|6@1+ (2,0) [0|100] "%"  VideoFrontCenter
 SG_ RFC_Obj30_StatBarrierConf : 500|6@1+ (2,0) [0|100] "%"  VideoFrontCenter

BO_ 437 RFC_Obj31: 64 RadarFrontCenter
 SG_ RFC_Obj31_CRC : 0|16@1+ (1,0) [0|65535] ""  VideoFrontCenter
 SG_ RFC_Obj31_AliveCtr : 16|8@1+ (1,0) [0|255] ""  VideoFrontCenter
 SG_ RFC_Obj31_ProtBlockCtr : 24|4@1+ (1,0) [0|15] ""  VideoFrontCenter
 SG_ RFC_Obj31_ReferencePoint : 28|4@1+ (1,0) [0|15] ""  VideoFrontCenter
 SG_ RFC_Obj31_ObjId : 32|7@1+ (1,0) [0|127] ""  VideoFrontCenter
 SG_ RFC_Obj31_MeasurementStatus : 39|1@1+ (1,0) [0|1] ""  VideoFrontCenter
 SG_ RFC_Obj31_Px : 40|13@1+ (0.0625,-256) [-256|255.9375] "m"  VideoFrontCenter
 SG_ RFC_Obj31_Py : 53|11@1+ (0.125,-128) [-128|127.875] "m"  VideoFrontCenter
 SG_ RFC_Obj31_PxVnce : 64|12@1+ (0.01,0) [0|30] "m^2"  VideoFrontCenter
 SG_ RFC_Obj31_PyVnce : 76|12@1+ (0.01,0) [0|30] "m^2"  VideoFrontCenter
 SG_ RFC_Obj31_Vx : 88|12@1+ (0.0625,-128) [-128|127.9375] "m/s"  VideoFrontCenter
 SG_ RFC_Obj31_Vy : 100|10@1+ (0.125,-64) [-64|63.875] "m/s"  VideoFrontCenter
 SG_ RFC_Obj31_Ax : 110|10@1+ (0.03125,-16) [-16|15.96875] "m/s^2"  VideoFrontCenter
 SG_ RFC_Obj31_Ay : 120|9@1+ (0.0625,-16) [-16|15.9375] "m/s^2"  VideoFrontCenter
 SG_ RFC_Obj31_OrientationYaw : 129|9@1+ (0.0175,-4.48) [-3.15|3.15] "rad"  VideoFrontCenter
 SG_ RFC_Obj31_ExistProb : 138|6@1+ (2,0) [0|100] "%"  VideoFrontCenter
 SG_ RFC_Obj31_VxVnce : 144|12@1+ (0.01,0) [0|30] "m^2/s^2"  VideoFrontCenter
 SG_ RFC_Obj31_VyVnce : 156|12@1+ (0.01,0) [0|30] "m^2/s^2"  VideoFrontCenter
 SG_ RFC_Obj31_AxVnce : 168|12@1+ (0.01,0) [0|30] "m^2/s^4"  VideoFrontCenter
 SG_ RFC_Obj31_AyVnce : 180|12@1+ (0.01,0) [0|30] "m^2/s^4"  VideoFrontCenter
 SG_ RFC_Obj31_OrientationYawVnce : 192|12@1+ (0.0003,0) [0|1] "rad^2"  VideoFrontCenter
 SG_ RFC_Obj31_MovingObserved : 204|6@1+ (2,0) [0|100] "%"  VideoFrontCenter
 SG_ RFC_Obj31_MovingProbability : 210|6@1+ (2,0) [0|100] "%"  VideoFrontCenter
 SG_ RFC_Obj31_Length : 216|7@1+ (0.125,0) [0|15.875] "m"  VideoFrontCenter
 SG_ RFC_Obj31_Valid : 223|1@1+ (1,0) [0|1] ""  VideoFrontCenter
 SG_ RFC_Obj31_LengthVnce : 224|12@1+ (0.01,0) [0|30] "m^2"  VideoFrontCenter
 SG_ RFC_Obj31_WidthVnce : 236|12@1+ (0.01,0) [0|30] "m^2"  VideoFrontCenter
 SG_ RFC_Obj31_Width : 248|7@1+ (0.125,0) [0|15.875] "m"  VideoFrontCenter
 SG_ RFC_Obj31_BehaviorType : 255|3@1+ (1,0) [0|7] ""  VideoFrontCenter
 SG_ RFC_Obj31_ObstacleConf : 258|6@1+ (2,0) [0|100] "%"  VideoFrontCenter
 SG_ RFC_Obj31_NonObstacleConf : 264|6@1+ (2,0) [0|100] "%"  VideoFrontCenter
 SG_ RFC_Obj31_PxPyCoVnce : 272|12@1+ (0.01,0) [0|30] "m^2"  VideoFrontCenter
 SG_ RFC_Obj31_PxVxCoVnce : 284|12@1+ (0.01,0) [0|30] "m^2/s"  VideoFrontCenter
 SG_ RFC_Obj31_PxVyCoVnce : 296|12@1+ (0.01,0) [0|30] "m^2/s"  VideoFrontCenter
 SG_ RFC_Obj31_PyVxCoVnce : 308|12@1+ (0.01,0) [0|30] "m^2/s"  VideoFrontCenter
 SG_ RFC_Obj31_PyVyCoVnce : 320|12@1+ (0.01,0) [0|30] "m^2/s"  VideoFrontCenter
 SG_ RFC_Obj31_VxVyCoVnce : 332|12@1+ (0.01,0) [0|30] "m^2/s^2"  VideoFrontCenter
 SG_ RFC_Obj31_PxAxCoVnce : 344|12@1+ (0.01,0) [0|30] "m^2/s^2"  VideoFrontCenter
 SG_ RFC_Obj31_PxAyCoVnce : 356|12@1+ (0.01,0) [0|30] "m^2/s^2"  VideoFrontCenter
 SG_ RFC_Obj31_PyAxCoVnce : 368|12@1+ (0.01,0) [0|30] "m^2/s^2"  VideoFrontCenter
 SG_ RFC_Obj31_PyAyCoVnce : 380|12@1+ (0.01,0) [0|30] "m^2/s^2"  VideoFrontCenter
 SG_ RFC_Obj31_VxAxCoVnce : 392|12@1+ (0.01,0) [0|30] "m^2/s^3"  VideoFrontCenter
 SG_ RFC_Obj31_VxAyCoVnce : 404|12@1+ (0.01,0) [0|30] "m^2/s^3"  VideoFrontCenter
 SG_ RFC_Obj31_VyAxCoVnce : 416|12@1+ (0.01,0) [0|30] "m^2/s^3"  VideoFrontCenter
 SG_ RFC_Obj31_VyAyCoVnce : 428|12@1+ (0.01,0) [0|30] "m^2/s^3"  VideoFrontCenter
 SG_ RFC_Obj31_AxAyCoVnce : 440|12@1+ (0.01,0) [0|30] "m^2/s^4"  VideoFrontCenter
 SG_ RFC_Obj31_MobileObstConf : 452|6@1+ (2,0) [0|100] "%"  VideoFrontCenter
 SG_ RFC_Obj31_Mob4PlusWhlConf : 458|6@1+ (2,0) [0|100] "%"  VideoFrontCenter
 SG_ RFC_Obj31_Mob2WhlConf : 464|6@1+ (2,0) [0|100] "%"  VideoFrontCenter
 SG_ RFC_Obj31_MobPedConf : 470|6@1+ (2,0) [0|100] "%"  VideoFrontCenter
 SG_ RFC_Obj31_FourPlusWhlCarConf : 476|6@1+ (2,0) [0|100] "%"  VideoFrontCenter
 SG_ RFC_Obj31_FourPlusWhlHGVConf : 482|6@1+ (2,0) [0|100] "%"  VideoFrontCenter
 SG_ RFC_Obj31_GroundReflexConf : 488|6@1+ (2,0) [0|100] "%"  VideoFrontCenter
 SG_ RFC_Obj31_StatObstConf : 494|6@1+ (2,0) [0|100] "%"  VideoFrontCenter
 SG_ RFC_Obj31_StatBarrierConf : 500|6@1+ (2,0) [0|100] "%"  VideoFrontCenter

BO_ 916 RFL_ObjHdr: 48 RadarFrontLeft
 SG_ RFL_ObjHdr_CRC : 0|16@1+ (1,0) [0|65535] ""  VideoFrontCenter
 SG_ RFL_ObjHdr_AliveCtr : 16|8@1+ (1,0) [0|255] ""  VideoFrontCenter
 SG_ RFL_ObjHdr_ProtBlockCtr : 24|4@1+ (1,0) [0|15] ""  VideoFrontCenter
 SG_ RFL_ObjHdr_IfVersionIdMajor : 32|8@1+ (1,0) [0|255] ""  VideoFrontCenter
 SG_ RFL_ObjHdr_IfVersionIdMinor : 40|8@1+ (1,0) [0|255] ""  VideoFrontCenter
 SG_ RFL_ObjHdr_NumValidObjects : 48|6@1+ (1,0) [0|40] ""  VideoFrontCenter
 SG_ RFL_ObjHdr_TimeStampStatus : 56|8@1+ (1,0) [0|255] ""  VideoFrontCenter
 SG_ RFL_ObjHdr_TimeStamp : 64|26@1+ (1,0) [0|67108863] "ms"  VideoFrontCenter
 SG_ RFL_ObjHdr_SensorState : 96|8@1+ (1,0) [0|255] ""  VideoFrontCenter
 SG_ RFL_ObjHdr_AziOutOfSpec : 109|1@1+ (1,0) [0|1] ""  VideoFrontCenter
 SG_ RFL_ObjHdr_ElevOutOfSpec : 110|1@1+ (1,0) [0|1] ""  VideoFrontCenter
 SG_ RFL_ObjHdr_ObjectDownSel : 111|1@1+ (1,0) [0|1] ""  VideoFrontCenter
 SG_ RFL_ObjHdr_SensorOriginPointY : 112|8@1+ (0.01,-1.28) [-1.28|1.27] "m"  VideoFrontCenter
 SG_ RFL_ObjHdr_SensorOriginPointX : 120|9@1+ (0.02,-5.12) [-5.12|5.1] "m"  VideoFrontCenter
 SG_ RFL_ObjHdr_SensorOriginPointZ : 129|5@1+ (0.05,0) [0|1.55] "m"  VideoFrontCenter
 SG_ RFL_ObjHdr_SensorOrientYaw : 136|16@1+ (0.00017,-5.57056) [-3.2|3.2] "rad"  VideoFrontCenter
 SG_ RFL_ObjHdr_SensorOrientPitch : 152|12@1+ (0.00017,-0.34816) [-0.34816|0.34799] "rad"  VideoFrontCenter
 SG_ RFL_ObjHdr_SensorOrientRoll : 164|12@1+ (0.00017,-0.34816) [-0.2|0.2] "rad"  VideoFrontCenter
 SG_ RFL_ObjHdr_FovAzimuthBegin : 176|15@1+ (0.00017,-2.78528) [-1.6|1.6] "rad"  VideoFrontCenter
 SG_ RFL_ObjHdr_FovAzimuthEnd : 192|15@1+ (0.00017,-2.78528) [-1.6|1.6] "rad"  VideoFrontCenter
 SG_ RFL_ObjHdr_FovElevationBegin : 208|12@1+ (0.00017,-0.34816) [-0.34816|0.34799] "rad"  VideoFrontCenter
 SG_ RFL_ObjHdr_FovElevationEnd : 220|12@1+ (0.00017,-0.34816) [-0.34816|0.34799] "rad"  VideoFrontCenter
 SG_ RFL_ObjHdr_DetectionRange : 232|9@1+ (1,0) [0|511] "m"  VideoFrontCenter
 SG_ RFL_ObjHdr_TimeStampLocal : 248|26@1+ (1,0) [0|67108863] "ms"  VideoFrontCenter

BO_ 918 RFL_Obj00: 64 RadarFrontLeft
 SG_ RFL_Obj00_CRC : 0|16@1+ (1,0) [0|65535] ""  VideoFrontCenter
 SG_ RFL_Obj00_AliveCtr : 16|8@1+ (1,0) [0|255] ""  VideoFrontCenter
 SG_ RFL_Obj00_ProtBlockCtr : 24|4@1+ (1,0) [0|15] ""  VideoFrontCenter
 SG_ RFL_Obj00_ReferencePoint : 28|4@1+ (1,0) [0|15] ""  VideoFrontCenter
 SG_ RFL_Obj00_ObjId : 32|7@1+ (1,0) [0|127] ""  VideoFrontCenter
 SG_ RFL_Obj00_MeasurementStatus : 39|1@1+ (1,0) [0|1] ""  VideoFrontCenter
 SG_ RFL_Obj00_Px : 40|13@1+ (0.0625,-256) [-256|255.9375] "m"  VideoFrontCenter
 SG_ RFL_Obj00_Py : 53|11@1+ (0.125,-128) [-128|127.875] "m"  VideoFrontCenter
 SG_ RFL_Obj00_PxVnce : 64|12@1+ (0.01,0) [0|30] "m^2"  VideoFrontCenter
 SG_ RFL_Obj00_PyVnce : 76|12@1+ (0.01,0) [0|30] "m^2"  VideoFrontCenter
 SG_ RFL_Obj00_Vx : 88|12@1+ (0.0625,-128) [-128|127.9375] "m/s"  VideoFrontCenter
 SG_ RFL_Obj00_Vy : 100|10@1+ (0.125,-64) [-64|63.875] "m/s"  VideoFrontCenter
 SG_ RFL_Obj00_Ax : 110|10@1+ (0.03125,-16) [-16|15.96875] "m/s^2"  VideoFrontCenter
 SG_ RFL_Obj00_Ay : 120|9@1+ (0.0625,-16) [-16|15.9375] "m/s^2"  VideoFrontCenter
 SG_ RFL_Obj00_OrientationYaw : 129|9@1+ (0.0175,-4.48) [-3.15|3.15] "rad"  VideoFrontCenter
 SG_ RFL_Obj00_ExistProb : 138|6@1+ (2,0) [0|100] "%"  VideoFrontCenter
 SG_ RFL_Obj00_VxVnce : 144|12@1+ (0.01,0) [0|30] "m^2/s^2"  VideoFrontCenter
 SG_ RFL_Obj00_VyVnce : 156|12@1+ (0.01,0) [0|30] "m^2/s^2"  VideoFrontCenter
 SG_ RFL_Obj00_AxVnce : 168|12@1+ (0.01,0) [0|30] "m^2/s^4"  VideoFrontCenter
 SG_ RFL_Obj00_AyVnce : 180|12@1+ (0.01,0) [0|30] "m^2/s^4"  VideoFrontCenter
 SG_ RFL_Obj00_OrientationYawVnce : 192|12@1+ (0.0003,0) [0|1] "rad^2"  VideoFrontCenter
 SG_ RFL_Obj00_MovingObserved : 204|6@1+ (2,0) [0|100] "%"  VideoFrontCenter
 SG_ RFL_Obj00_MovingProbability : 210|6@1+ (2,0) [0|100] "%"  VideoFrontCenter
 SG_ RFL_Obj00_Length : 216|7@1+ (0.125,0) [0|15.875] "m"  VideoFrontCenter
 SG_ RFL_Obj00_Valid : 223|1@1+ (1,0) [0|1] ""  VideoFrontCenter
 SG_ RFL_Obj00_LengthVnce : 224|12@1+ (0.01,0) [0|30] "m^2"  VideoFrontCenter
 SG_ RFL_Obj00_WidthVnce : 236|12@1+ (0.01,0) [0|30] "m^2"  VideoFrontCenter
 SG_ RFL_Obj00_Width : 248|7@1+ (0.125,0) [0|15.875] "m"  VideoFrontCenter
 SG_ RFL_Obj00_BehaviorType : 255|3@1+ (1,0) [0|7] ""  VideoFrontCenter
 SG_ RFL_Obj00_ObstacleConf : 258|6@1+ (2,0) [0|100] "%"  VideoFrontCenter
 SG_ RFL_Obj00_NonObstacleConf : 264|6@1+ (2,0) [0|100] "%"  VideoFrontCenter
 SG_ RFL_Obj00_PxPyCoVnce : 272|12@1+ (0.01,0) [0|30] "m^2"  VideoFrontCenter
 SG_ RFL_Obj00_PxVxCoVnce : 284|12@1+ (0.01,0) [0|30] "m^2/s"  VideoFrontCenter
 SG_ RFL_Obj00_PxVyCoVnce : 296|12@1+ (0.01,0) [0|30] "m^2/s"  VideoFrontCenter
 SG_ RFL_Obj00_PyVxCoVnce : 308|12@1+ (0.01,0) [0|30] "m^2/s"  VideoFrontCenter
 SG_ RFL_Obj00_PyVyCoVnce : 320|12@1+ (0.01,0) [0|30] "m^2/s"  VideoFrontCenter
 SG_ RFL_Obj00_VxVyCoVnce : 332|12@1+ (0.01,0) [0|30] "m^2/s^2"  VideoFrontCenter
 SG_ RFL_Obj00_PxAxCoVnce : 344|12@1+ (0.01,0) [0|30] "m^2/s^2"  VideoFrontCenter
 SG_ RFL_Obj00_PxAyCoVnce : 356|12@1+ (0.01,0) [0|30] "m^2/s^2"  VideoFrontCenter
 SG_ RFL_Obj00_PyAxCoVnce : 368|12@1+ (0.01,0) [0|30] "m^2/s^2"  VideoFrontCenter
 SG_ RFL_Obj00_PyAyCoVnce : 380|12@1+ (0.01,0) [0|30] "m^2/s^2"  VideoFrontCenter
 SG_ RFL_Obj00_VxAxCoVnce : 392|12@1+ (0.01,0) [0|30] "m^2/s^3"  VideoFrontCenter
 SG_ RFL_Obj00_VxAyCoVnce : 404|12@1+ (0.01,0) [0|30] "m^2/s^3"  VideoFrontCenter
 SG_ RFL_Obj00_VyAxCoVnce : 416|12@1+ (0.01,0) [0|30] "m^2/s^3"  VideoFrontCenter
 SG_ RFL_Obj00_VyAyCoVnce : 428|12@1+ (0.01,0) [0|30] "m^2/s^3"  VideoFrontCenter
 SG_ RFL_Obj00_AxAyCoVnce : 440|12@1+ (0.01,0) [0|30] "m^2/s^4"  VideoFrontCenter
 SG_ RFL_Obj00_MobileObstConf : 452|6@1+ (2,0) [0|100] "%"  VideoFrontCenter
 SG_ RFL_Obj00_Mob4PlusWhlConf : 458|6@1+ (2,0) [0|100] "%"  VideoFrontCenter
 SG_ RFL_Obj00_Mob2WhlConf : 464|6@1+ (2,0) [0|100] "%"  VideoFrontCenter
 SG_ RFL_Obj00_MobPedConf : 470|6@1+ (2,0) [0|100] "%"  VideoFrontCenter
 SG_ RFL_Obj00_FourPlusWhlCarConf : 476|6@1+ (2,0) [0|100] "%"  VideoFrontCenter
 SG_ RFL_Obj00_FourPlusWhlHGVConf : 482|6@1+ (2,0) [0|100] "%"  VideoFrontCenter
 SG_ RFL_Obj00_GroundReflexConf : 488|6@1+ (2,0) [0|100] "%"  VideoFrontCenter
 SG_ RFL_Obj00_StatObstConf : 494|6@1+ (2,0) [0|100] "%"  VideoFrontCenter
 SG_ RFL_Obj00_StatBarrierConf : 500|6@1+ (2,0) [0|100] "%"  VideoFrontCenter

BO_ 919 RFL_Obj01: 64 RadarFrontLeft
 SG_ RFL_Obj01_CRC : 0|16@1+ (1,0) [0|65535] ""  VideoFrontCenter
 SG_ RFL_Obj01_AliveCtr : 16|8@1+ (1,0) [0|255] ""  VideoFrontCenter
 SG_ RFL_Obj01_ProtBlockCtr : 24|4@1+ (1,0) [0|15] ""  VideoFrontCenter
 SG_ RFL_Obj01_ReferencePoint : 28|4@1+ (1,0) [0|15] ""  VideoFrontCenter
 SG_ RFL_Obj01_ObjId : 32|7@1+ (1,0) [0|127] ""  VideoFrontCenter
 SG_ RFL_Obj01_MeasurementStatus : 39|1@1+ (1,0) [0|1] ""  VideoFrontCenter
 SG_ RFL_Obj01_Px : 40|13@1+ (0.0625,-256) [-256|255.9375] "m"  VideoFrontCenter
 SG_ RFL_Obj01_Py : 53|11@1+ (0.125,-128) [-128|127.875] "m"  VideoFrontCenter
 SG_ RFL_Obj01_PxVnce : 64|12@1+ (0.01,0) [0|30] "m^2"  VideoFrontCenter
 SG_ RFL_Obj01_PyVnce : 76|12@1+ (0.01,0) [0|30] "m^2"  VideoFrontCenter
 SG_ RFL_Obj01_Vx : 88|12@1+ (0.0625,-128) [-128|127.9375] "m/s"  VideoFrontCenter
 SG_ RFL_Obj01_Vy : 100|10@1+ (0.125,-64) [-64|63.875] "m/s"  VideoFrontCenter
 SG_ RFL_Obj01_Ax : 110|10@1+ (0.03125,-16) [-16|15.96875] "m/s^2"  VideoFrontCenter
 SG_ RFL_Obj01_Ay : 120|9@1+ (0.0625,-16) [-16|15.9375] "m/s^2"  VideoFrontCenter
 SG_ RFL_Obj01_OrientationYaw : 129|9@1+ (0.0175,-4.48) [-3.15|3.15] "rad"  VideoFrontCenter
 SG_ RFL_Obj01_ExistProb : 138|6@1+ (2,0) [0|100] "%"  VideoFrontCenter
 SG_ RFL_Obj01_VxVnce : 144|12@1+ (0.01,0) [0|30] "m^2/s^2"  VideoFrontCenter
 SG_ RFL_Obj01_VyVnce : 156|12@1+ (0.01,0) [0|30] "m^2/s^2"  VideoFrontCenter
 SG_ RFL_Obj01_AxVnce : 168|12@1+ (0.01,0) [0|30] "m^2/s^4"  VideoFrontCenter
 SG_ RFL_Obj01_AyVnce : 180|12@1+ (0.01,0) [0|30] "m^2/s^4"  VideoFrontCenter
 SG_ RFL_Obj01_OrientationYawVnce : 192|12@1+ (0.0003,0) [0|1] "rad^2"  VideoFrontCenter
 SG_ RFL_Obj01_MovingObserved : 204|6@1+ (2,0) [0|100] "%"  VideoFrontCenter
 SG_ RFL_Obj01_MovingProbability : 210|6@1+ (2,0) [0|100] "%"  VideoFrontCenter
 SG_ RFL_Obj01_Length : 216|7@1+ (0.125,0) [0|15.875] "m"  VideoFrontCenter
 SG_ RFL_Obj01_Valid : 223|1@1+ (1,0) [0|1] ""  VideoFrontCenter
 SG_ RFL_Obj01_LengthVnce : 224|12@1+ (0.01,0) [0|30] "m^2"  VideoFrontCenter
 SG_ RFL_Obj01_WidthVnce : 236|12@1+ (0.01,0) [0|30] "m^2"  VideoFrontCenter
 SG_ RFL_Obj01_Width : 248|7@1+ (0.125,0) [0|15.875] "m"  VideoFrontCenter
 SG_ RFL_Obj01_BehaviorType : 255|3@1+ (1,0) [0|7] ""  VideoFrontCenter
 SG_ RFL_Obj01_ObstacleConf : 258|6@1+ (2,0) [0|100] "%"  VideoFrontCenter
 SG_ RFL_Obj01_NonObstacleConf : 264|6@1+ (2,0) [0|100] "%"  VideoFrontCenter
 SG_ RFL_Obj01_PxPyCoVnce : 272|12@1+ (0.01,0) [0|30] "m^2"  VideoFrontCenter
 SG_ RFL_Obj01_PxVxCoVnce : 284|12@1+ (0.01,0) [0|30] "m^2/s"  VideoFrontCenter
 SG_ RFL_Obj01_PxVyCoVnce : 296|12@1+ (0.01,0) [0|30] "m^2/s"  VideoFrontCenter
 SG_ RFL_Obj01_PyVxCoVnce : 308|12@1+ (0.01,0) [0|30] "m^2/s"  VideoFrontCenter
 SG_ RFL_Obj01_PyVyCoVnce : 320|12@1+ (0.01,0) [0|30] "m^2/s"  VideoFrontCenter
 SG_ RFL_Obj01_VxVyCoVnce : 332|12@1+ (0.01,0) [0|30] "m^2/s^2"  VideoFrontCenter
 SG_ RFL_Obj01_PxAxCoVnce : 344|12@1+ (0.01,0) [0|30] "m^2/s^2"  VideoFrontCenter
 SG_ RFL_Obj01_PxAyCoVnce : 356|12@1+ (0.01,0) [0|30] "m^2/s^2"  VideoFrontCenter
 SG_ RFL_Obj01_PyAxCoVnce : 368|12@1+ (0.01,0) [0|30] "m^2/s^2"  VideoFrontCenter
 SG_ RFL_Obj01_PyAyCoVnce : 380|12@1+ (0.01,0) [0|30] "m^2/s^2"  VideoFrontCenter
 SG_ RFL_Obj01_VxAxCoVnce : 392|12@1+ (0.01,0) [0|30] "m^2/s^3"  VideoFrontCenter
 SG_ RFL_Obj01_VxAyCoVnce : 404|12@1+ (0.01,0) [0|30] "m^2/s^3"  VideoFrontCenter
 SG_ RFL_Obj01_VyAxCoVnce : 416|12@1+ (0.01,0) [0|30] "m^2/s^3"  VideoFrontCenter
 SG_ RFL_Obj01_VyAyCoVnce : 428|12@1+ (0.01,0) [0|30] "m^2/s^3"  VideoFrontCenter
 SG_ RFL_Obj01_AxAyCoVnce : 440|12@1+ (0.01,0) [0|30] "m^2/s^4"  VideoFrontCenter
 SG_ RFL_Obj01_MobileObstConf : 452|6@1+ (2,0) [0|100] "%"  VideoFrontCenter
 SG_ RFL_Obj01_Mob4PlusWhlConf : 458|6@1+ (2,0) [0|100] "%"  VideoFrontCenter
 SG_ RFL_Obj01_Mob2WhlConf : 464|6@1+ (2,0) [0|100] "%"  VideoFrontCenter
 SG_ RFL_Obj01_MobPedConf : 470|6@1+ (2,0) [0|100] "%"  VideoFrontCenter
 SG_ RFL_Obj01_FourPlusWhlCarConf : 476|6@1+ (2,0) [0|100] "%"  VideoFrontCenter
 SG_ RFL_Obj01_FourPlusWhlHGVConf : 482|6@1+ (2,0) [0|100] "%"  VideoFrontCenter
 SG_ RFL_Obj01_GroundReflexConf : 488|6@1+ (2,0) [0|100] "%"  VideoFrontCenter
 SG_ RFL_Obj01_StatObstConf : 494|6@1+ (2,0) [0|100] "%"  VideoFrontCenter
 SG_ RFL_Obj01_StatBarrierConf : 500|6@1+ (2,0) [0|100] "%"  VideoFrontCenter

BO_ 920 RFL_Obj02: 64 RadarFrontLeft
 SG_ RFL_Obj02_CRC : 0|16@1+ (1,0) [0|65535] ""  VideoFrontCenter
 SG_ RFL_Obj02_AliveCtr : 16|8@1+ (1,0) [0|255] ""  VideoFrontCenter
 SG_ RFL_Obj02_ProtBlockCtr : 24|4@1+ (1,0) [0|15] ""  VideoFrontCenter
 SG_ RFL_Obj02_ReferencePoint : 28|4@1+ (1,0) [0|15] ""  VideoFrontCenter
 SG_ RFL_Obj02_ObjId : 32|7@1+ (1,0) [0|127] ""  VideoFrontCenter
 SG_ RFL_Obj02_MeasurementStatus : 39|1@1+ (1,0) [0|1] ""  VideoFrontCenter
 SG_ RFL_Obj02_Px : 40|13@1+ (0.0625,-256) [-256|255.9375] "m"  VideoFrontCenter
 SG_ RFL_Obj02_Py : 53|11@1+ (0.125,-128) [-128|127.875] "m"  VideoFrontCenter
 SG_ RFL_Obj02_PxVnce : 64|12@1+ (0.01,0) [0|30] "m^2"  VideoFrontCenter
 SG_ RFL_Obj02_PyVnce : 76|12@1+ (0.01,0) [0|30] "m^2"  VideoFrontCenter
 SG_ RFL_Obj02_Vx : 88|12@1+ (0.0625,-128) [-128|127.9375] "m/s"  VideoFrontCenter
 SG_ RFL_Obj02_Vy : 100|10@1+ (0.125,-64) [-64|63.875] "m/s"  VideoFrontCenter
 SG_ RFL_Obj02_Ax : 110|10@1+ (0.03125,-16) [-16|15.96875] "m/s^2"  VideoFrontCenter
 SG_ RFL_Obj02_Ay : 120|9@1+ (0.0625,-16) [-16|15.9375] "m/s^2"  VideoFrontCenter
 SG_ RFL_Obj02_OrientationYaw : 129|9@1+ (0.0175,-4.48) [-3.15|3.15] "rad"  VideoFrontCenter
 SG_ RFL_Obj02_ExistProb : 138|6@1+ (2,0) [0|100] "%"  VideoFrontCenter
 SG_ RFL_Obj02_VxVnce : 144|12@1+ (0.01,0) [0|30] "m^2/s^2"  VideoFrontCenter
 SG_ RFL_Obj02_VyVnce : 156|12@1+ (0.01,0) [0|30] "m^2/s^2"  VideoFrontCenter
 SG_ RFL_Obj02_AxVnce : 168|12@1+ (0.01,0) [0|30] "m^2/s^4"  VideoFrontCenter
 SG_ RFL_Obj02_AyVnce : 180|12@1+ (0.01,0) [0|30] "m^2/s^4"  VideoFrontCenter
 SG_ RFL_Obj02_OrientationYawVnce : 192|12@1+ (0.0003,0) [0|1] "rad^2"  VideoFrontCenter
 SG_ RFL_Obj02_MovingObserved : 204|6@1+ (2,0) [0|100] "%"  VideoFrontCenter
 SG_ RFL_Obj02_MovingProbability : 210|6@1+ (2,0) [0|100] "%"  VideoFrontCenter
 SG_ RFL_Obj02_Length : 216|7@1+ (0.125,0) [0|15.875] "m"  VideoFrontCenter
 SG_ RFL_Obj02_Valid : 223|1@1+ (1,0) [0|1] ""  VideoFrontCenter
 SG_ RFL_Obj02_LengthVnce : 224|12@1+ (0.01,0) [0|30] "m^2"  VideoFrontCenter
 SG_ RFL_Obj02_WidthVnce : 236|12@1+ (0.01,0) [0|30] "m^2"  VideoFrontCenter
 SG_ RFL_Obj02_Width : 248|7@1+ (0.125,0) [0|15.875] "m"  VideoFrontCenter
 SG_ RFL_Obj02_BehaviorType : 255|3@1+ (1,0) [0|7] ""  VideoFrontCenter
 SG_ RFL_Obj02_ObstacleConf : 258|6@1+ (2,0) [0|100] "%"  VideoFrontCenter
 SG_ RFL_Obj02_NonObstacleConf : 264|6@1+ (2,0) [0|100] "%"  VideoFrontCenter
 SG_ RFL_Obj02_PxPyCoVnce : 272|12@1+ (0.01,0) [0|30] "m^2"  VideoFrontCenter
 SG_ RFL_Obj02_PxVxCoVnce : 284|12@1+ (0.01,0) [0|30] "m^2/s"  VideoFrontCenter
 SG_ RFL_Obj02_PxVyCoVnce : 296|12@1+ (0.01,0) [0|30] "m^2/s"  VideoFrontCenter
 SG_ RFL_Obj02_PyVxCoVnce : 308|12@1+ (0.01,0) [0|30] "m^2/s"  VideoFrontCenter
 SG_ RFL_Obj02_PyVyCoVnce : 320|12@1+ (0.01,0) [0|30] "m^2/s"  VideoFrontCenter
 SG_ RFL_Obj02_VxVyCoVnce : 332|12@1+ (0.01,0) [0|30] "m^2/s^2"  VideoFrontCenter
 SG_ RFL_Obj02_PxAxCoVnce : 344|12@1+ (0.01,0) [0|30] "m^2/s^2"  VideoFrontCenter
 SG_ RFL_Obj02_PxAyCoVnce : 356|12@1+ (0.01,0) [0|30] "m^2/s^2"  VideoFrontCenter
 SG_ RFL_Obj02_PyAxCoVnce : 368|12@1+ (0.01,0) [0|30] "m^2/s^2"  VideoFrontCenter
 SG_ RFL_Obj02_PyAyCoVnce : 380|12@1+ (0.01,0) [0|30] "m^2/s^2"  VideoFrontCenter
 SG_ RFL_Obj02_VxAxCoVnce : 392|12@1+ (0.01,0) [0|30] "m^2/s^3"  VideoFrontCenter
 SG_ RFL_Obj02_VxAyCoVnce : 404|12@1+ (0.01,0) [0|30] "m^2/s^3"  VideoFrontCenter
 SG_ RFL_Obj02_VyAxCoVnce : 416|12@1+ (0.01,0) [0|30] "m^2/s^3"  VideoFrontCenter
 SG_ RFL_Obj02_VyAyCoVnce : 428|12@1+ (0.01,0) [0|30] "m^2/s^3"  VideoFrontCenter
 SG_ RFL_Obj02_AxAyCoVnce : 440|12@1+ (0.01,0) [0|30] "m^2/s^4"  VideoFrontCenter
 SG_ RFL_Obj02_MobileObstConf : 452|6@1+ (2,0) [0|100] "%"  VideoFrontCenter
 SG_ RFL_Obj02_Mob4PlusWhlConf : 458|6@1+ (2,0) [0|100] "%"  VideoFrontCenter
 SG_ RFL_Obj02_Mob2WhlConf : 464|6@1+ (2,0) [0|100] "%"  VideoFrontCenter
 SG_ RFL_Obj02_MobPedConf : 470|6@1+ (2,0) [0|100] "%"  VideoFrontCenter
 SG_ RFL_Obj02_FourPlusWhlCarConf : 476|6@1+ (2,0) [0|100] "%"  VideoFrontCenter
 SG_ RFL_Obj02_FourPlusWhlHGVConf : 482|6@1+ (2,0) [0|100] "%"  VideoFrontCenter
 SG_ RFL_Obj02_GroundReflexConf : 488|6@1+ (2,0) [0|100] "%"  VideoFrontCenter
 SG_ RFL_Obj02_StatObstConf : 494|6@1+ (2,0) [0|100] "%"  VideoFrontCenter
 SG_ RFL_Obj02_StatBarrierConf : 500|6@1+ (2,0) [0|100] "%"  VideoFrontCenter

BO_ 921 RFL_Obj03: 64 RadarFrontLeft
 SG_ RFL_Obj03_CRC : 0|16@1+ (1,0) [0|65535] ""  VideoFrontCenter
 SG_ RFL_Obj03_AliveCtr : 16|8@1+ (1,0) [0|255] ""  VideoFrontCenter
 SG_ RFL_Obj03_ProtBlockCtr : 24|4@1+ (1,0) [0|15] ""  VideoFrontCenter
 SG_ RFL_Obj03_ReferencePoint : 28|4@1+ (1,0) [0|15] ""  VideoFrontCenter
 SG_ RFL_Obj03_ObjId : 32|7@1+ (1,0) [0|127] ""  VideoFrontCenter
 SG_ RFL_Obj03_MeasurementStatus : 39|1@1+ (1,0) [0|1] ""  VideoFrontCenter
 SG_ RFL_Obj03_Px : 40|13@1+ (0.0625,-256) [-256|255.9375] "m"  VideoFrontCenter
 SG_ RFL_Obj03_Py : 53|11@1+ (0.125,-128) [-128|127.875] "m"  VideoFrontCenter
 SG_ RFL_Obj03_PxVnce : 64|12@1+ (0.01,0) [0|30] "m^2"  VideoFrontCenter
 SG_ RFL_Obj03_PyVnce : 76|12@1+ (0.01,0) [0|30] "m^2"  VideoFrontCenter
 SG_ RFL_Obj03_Vx : 88|12@1+ (0.0625,-128) [-128|127.9375] "m/s"  VideoFrontCenter
 SG_ RFL_Obj03_Vy : 100|10@1+ (0.125,-64) [-64|63.875] "m/s"  VideoFrontCenter
 SG_ RFL_Obj03_Ax : 110|10@1+ (0.03125,-16) [-16|15.96875] "m/s^2"  VideoFrontCenter
 SG_ RFL_Obj03_Ay : 120|9@1+ (0.0625,-16) [-16|15.9375] "m/s^2"  VideoFrontCenter
 SG_ RFL_Obj03_OrientationYaw : 129|9@1+ (0.0175,-4.48) [-3.15|3.15] "rad"  VideoFrontCenter
 SG_ RFL_Obj03_ExistProb : 138|6@1+ (2,0) [0|100] "%"  VideoFrontCenter
 SG_ RFL_Obj03_VxVnce : 144|12@1+ (0.01,0) [0|30] "m^2/s^2"  VideoFrontCenter
 SG_ RFL_Obj03_VyVnce : 156|12@1+ (0.01,0) [0|30] "m^2/s^2"  VideoFrontCenter
 SG_ RFL_Obj03_AxVnce : 168|12@1+ (0.01,0) [0|30] "m^2/s^4"  VideoFrontCenter
 SG_ RFL_Obj03_AyVnce : 180|12@1+ (0.01,0) [0|30] "m^2/s^4"  VideoFrontCenter
 SG_ RFL_Obj03_OrientationYawVnce : 192|12@1+ (0.0003,0) [0|1] "rad^2"  VideoFrontCenter
 SG_ RFL_Obj03_MovingObserved : 204|6@1+ (2,0) [0|100] "%"  VideoFrontCenter
 SG_ RFL_Obj03_MovingProbability : 210|6@1+ (2,0) [0|100] "%"  VideoFrontCenter
 SG_ RFL_Obj03_Length : 216|7@1+ (0.125,0) [0|15.875] "m"  VideoFrontCenter
 SG_ RFL_Obj03_Valid : 223|1@1+ (1,0) [0|1] ""  VideoFrontCenter
 SG_ RFL_Obj03_LengthVnce : 224|12@1+ (0.01,0) [0|30] "m^2"  VideoFrontCenter
 SG_ RFL_Obj03_WidthVnce : 236|12@1+ (0.01,0) [0|30] "m^2"  VideoFrontCenter
 SG_ RFL_Obj03_Width : 248|7@1+ (0.125,0) [0|15.875] "m"  VideoFrontCenter
 SG_ RFL_Obj03_BehaviorType : 255|3@1+ (1,0) [0|7] ""  VideoFrontCenter
 SG_ RFL_Obj03_ObstacleConf : 258|6@1+ (2,0) [0|100] "%"  VideoFrontCenter
 SG_ RFL_Obj03_NonObstacleConf : 264|6@1+ (2,0) [0|100] "%"  VideoFrontCenter
 SG_ RFL_Obj03_PxPyCoVnce : 272|12@1+ (0.01,0) [0|30] "m^2"  VideoFrontCenter
 SG_ RFL_Obj03_PxVxCoVnce : 284|12@1+ (0.01,0) [0|30] "m^2/s"  VideoFrontCenter
 SG_ RFL_Obj03_PxVyCoVnce : 296|12@1+ (0.01,0) [0|30] "m^2/s"  VideoFrontCenter
 SG_ RFL_Obj03_PyVxCoVnce : 308|12@1+ (0.01,0) [0|30] "m^2/s"  VideoFrontCenter
 SG_ RFL_Obj03_PyVyCoVnce : 320|12@1+ (0.01,0) [0|30] "m^2/s"  VideoFrontCenter
 SG_ RFL_Obj03_VxVyCoVnce : 332|12@1+ (0.01,0) [0|30] "m^2/s^2"  VideoFrontCenter
 SG_ RFL_Obj03_PxAxCoVnce : 344|12@1+ (0.01,0) [0|30] "m^2/s^2"  VideoFrontCenter
 SG_ RFL_Obj03_PxAyCoVnce : 356|12@1+ (0.01,0) [0|30] "m^2/s^2"  VideoFrontCenter
 SG_ RFL_Obj03_PyAxCoVnce : 368|12@1+ (0.01,0) [0|30] "m^2/s^2"  VideoFrontCenter
 SG_ RFL_Obj03_PyAyCoVnce : 380|12@1+ (0.01,0) [0|30] "m^2/s^2"  VideoFrontCenter
 SG_ RFL_Obj03_VxAxCoVnce : 392|12@1+ (0.01,0) [0|30] "m^2/s^3"  VideoFrontCenter
 SG_ RFL_Obj03_VxAyCoVnce : 404|12@1+ (0.01,0) [0|30] "m^2/s^3"  VideoFrontCenter
 SG_ RFL_Obj03_VyAxCoVnce : 416|12@1+ (0.01,0) [0|30] "m^2/s^3"  VideoFrontCenter
 SG_ RFL_Obj03_VyAyCoVnce : 428|12@1+ (0.01,0) [0|30] "m^2/s^3"  VideoFrontCenter
 SG_ RFL_Obj03_AxAyCoVnce : 440|12@1+ (0.01,0) [0|30] "m^2/s^4"  VideoFrontCenter
 SG_ RFL_Obj03_MobileObstConf : 452|6@1+ (2,0) [0|100] "%"  VideoFrontCenter
 SG_ RFL_Obj03_Mob4PlusWhlConf : 458|6@1+ (2,0) [0|100] "%"  VideoFrontCenter
 SG_ RFL_Obj03_Mob2WhlConf : 464|6@1+ (2,0) [0|100] "%"  VideoFrontCenter
 SG_ RFL_Obj03_MobPedConf : 470|6@1+ (2,0) [0|100] "%"  VideoFrontCenter
 SG_ RFL_Obj03_FourPlusWhlCarConf : 476|6@1+ (2,0) [0|100] "%"  VideoFrontCenter
 SG_ RFL_Obj03_FourPlusWhlHGVConf : 482|6@1+ (2,0) [0|100] "%"  VideoFrontCenter
 SG_ RFL_Obj03_GroundReflexConf : 488|6@1+ (2,0) [0|100] "%"  VideoFrontCenter
 SG_ RFL_Obj03_StatObstConf : 494|6@1+ (2,0) [0|100] "%"  VideoFrontCenter
 SG_ RFL_Obj03_StatBarrierConf : 500|6@1+ (2,0) [0|100] "%"  VideoFrontCenter

BO_ 922 RFL_Obj04: 64 RadarFrontLeft
 SG_ RFL_Obj04_CRC : 0|16@1+ (1,0) [0|65535] ""  VideoFrontCenter
 SG_ RFL_Obj04_AliveCtr : 16|8@1+ (1,0) [0|255] ""  VideoFrontCenter
 SG_ RFL_Obj04_ProtBlockCtr : 24|4@1+ (1,0) [0|15] ""  VideoFrontCenter
 SG_ RFL_Obj04_ReferencePoint : 28|4@1+ (1,0) [0|15] ""  VideoFrontCenter
 SG_ RFL_Obj04_ObjId : 32|7@1+ (1,0) [0|127] ""  VideoFrontCenter
 SG_ RFL_Obj04_MeasurementStatus : 39|1@1+ (1,0) [0|1] ""  VideoFrontCenter
 SG_ RFL_Obj04_Px : 40|13@1+ (0.0625,-256) [-256|255.9375] "m"  VideoFrontCenter
 SG_ RFL_Obj04_Py : 53|11@1+ (0.125,-128) [-128|127.875] "m"  VideoFrontCenter
 SG_ RFL_Obj04_PxVnce : 64|12@1+ (0.01,0) [0|30] "m^2"  VideoFrontCenter
 SG_ RFL_Obj04_PyVnce : 76|12@1+ (0.01,0) [0|30] "m^2"  VideoFrontCenter
 SG_ RFL_Obj04_Vx : 88|12@1+ (0.0625,-128) [-128|127.9375] "m/s"  VideoFrontCenter
 SG_ RFL_Obj04_Vy : 100|10@1+ (0.125,-64) [-64|63.875] "m/s"  VideoFrontCenter
 SG_ RFL_Obj04_Ax : 110|10@1+ (0.03125,-16) [-16|15.96875] "m/s^2"  VideoFrontCenter
 SG_ RFL_Obj04_Ay : 120|9@1+ (0.0625,-16) [-16|15.9375] "m/s^2"  VideoFrontCenter
 SG_ RFL_Obj04_OrientationYaw : 129|9@1+ (0.0175,-4.48) [-3.15|3.15] "rad"  VideoFrontCenter
 SG_ RFL_Obj04_ExistProb : 138|6@1+ (2,0) [0|100] "%"  VideoFrontCenter
 SG_ RFL_Obj04_VxVnce : 144|12@1+ (0.01,0) [0|30] "m^2/s^2"  VideoFrontCenter
 SG_ RFL_Obj04_VyVnce : 156|12@1+ (0.01,0) [0|30] "m^2/s^2"  VideoFrontCenter
 SG_ RFL_Obj04_AxVnce : 168|12@1+ (0.01,0) [0|30] "m^2/s^4"  VideoFrontCenter
 SG_ RFL_Obj04_AyVnce : 180|12@1+ (0.01,0) [0|30] "m^2/s^4"  VideoFrontCenter
 SG_ RFL_Obj04_OrientationYawVnce : 192|12@1+ (0.0003,0) [0|1] "rad^2"  VideoFrontCenter
 SG_ RFL_Obj04_MovingObserved : 204|6@1+ (2,0) [0|100] "%"  VideoFrontCenter
 SG_ RFL_Obj04_MovingProbability : 210|6@1+ (2,0) [0|100] "%"  VideoFrontCenter
 SG_ RFL_Obj04_Length : 216|7@1+ (0.125,0) [0|15.875] "m"  VideoFrontCenter
 SG_ RFL_Obj04_Valid : 223|1@1+ (1,0) [0|1] ""  VideoFrontCenter
 SG_ RFL_Obj04_LengthVnce : 224|12@1+ (0.01,0) [0|30] "m^2"  VideoFrontCenter
 SG_ RFL_Obj04_WidthVnce : 236|12@1+ (0.01,0) [0|30] "m^2"  VideoFrontCenter
 SG_ RFL_Obj04_Width : 248|7@1+ (0.125,0) [0|15.875] "m"  VideoFrontCenter
 SG_ RFL_Obj04_BehaviorType : 255|3@1+ (1,0) [0|7] ""  VideoFrontCenter
 SG_ RFL_Obj04_ObstacleConf : 258|6@1+ (2,0) [0|100] "%"  VideoFrontCenter
 SG_ RFL_Obj04_NonObstacleConf : 264|6@1+ (2,0) [0|100] "%"  VideoFrontCenter
 SG_ RFL_Obj04_PxPyCoVnce : 272|12@1+ (0.01,0) [0|30] "m^2"  VideoFrontCenter
 SG_ RFL_Obj04_PxVxCoVnce : 284|12@1+ (0.01,0) [0|30] "m^2/s"  VideoFrontCenter
 SG_ RFL_Obj04_PxVyCoVnce : 296|12@1+ (0.01,0) [0|30] "m^2/s"  VideoFrontCenter
 SG_ RFL_Obj04_PyVxCoVnce : 308|12@1+ (0.01,0) [0|30] "m^2/s"  VideoFrontCenter
 SG_ RFL_Obj04_PyVyCoVnce : 320|12@1+ (0.01,0) [0|30] "m^2/s"  VideoFrontCenter
 SG_ RFL_Obj04_VxVyCoVnce : 332|12@1+ (0.01,0) [0|30] "m^2/s^2"  VideoFrontCenter
 SG_ RFL_Obj04_PxAxCoVnce : 344|12@1+ (0.01,0) [0|30] "m^2/s^2"  VideoFrontCenter
 SG_ RFL_Obj04_PxAyCoVnce : 356|12@1+ (0.01,0) [0|30] "m^2/s^2"  VideoFrontCenter
 SG_ RFL_Obj04_PyAxCoVnce : 368|12@1+ (0.01,0) [0|30] "m^2/s^2"  VideoFrontCenter
 SG_ RFL_Obj04_PyAyCoVnce : 380|12@1+ (0.01,0) [0|30] "m^2/s^2"  VideoFrontCenter
 SG_ RFL_Obj04_VxAxCoVnce : 392|12@1+ (0.01,0) [0|30] "m^2/s^3"  VideoFrontCenter
 SG_ RFL_Obj04_VxAyCoVnce : 404|12@1+ (0.01,0) [0|30] "m^2/s^3"  VideoFrontCenter
 SG_ RFL_Obj04_VyAxCoVnce : 416|12@1+ (0.01,0) [0|30] "m^2/s^3"  VideoFrontCenter
 SG_ RFL_Obj04_VyAyCoVnce : 428|12@1+ (0.01,0) [0|30] "m^2/s^3"  VideoFrontCenter
 SG_ RFL_Obj04_AxAyCoVnce : 440|12@1+ (0.01,0) [0|30] "m^2/s^4"  VideoFrontCenter
 SG_ RFL_Obj04_MobileObstConf : 452|6@1+ (2,0) [0|100] "%"  VideoFrontCenter
 SG_ RFL_Obj04_Mob4PlusWhlConf : 458|6@1+ (2,0) [0|100] "%"  VideoFrontCenter
 SG_ RFL_Obj04_Mob2WhlConf : 464|6@1+ (2,0) [0|100] "%"  VideoFrontCenter
 SG_ RFL_Obj04_MobPedConf : 470|6@1+ (2,0) [0|100] "%"  VideoFrontCenter
 SG_ RFL_Obj04_FourPlusWhlCarConf : 476|6@1+ (2,0) [0|100] "%"  VideoFrontCenter
 SG_ RFL_Obj04_FourPlusWhlHGVConf : 482|6@1+ (2,0) [0|100] "%"  VideoFrontCenter
 SG_ RFL_Obj04_GroundReflexConf : 488|6@1+ (2,0) [0|100] "%"  VideoFrontCenter
 SG_ RFL_Obj04_StatObstConf : 494|6@1+ (2,0) [0|100] "%"  VideoFrontCenter
 SG_ RFL_Obj04_StatBarrierConf : 500|6@1+ (2,0) [0|100] "%"  VideoFrontCenter

BO_ 923 RFL_Obj05: 64 RadarFrontLeft
 SG_ RFL_Obj05_CRC : 0|16@1+ (1,0) [0|65535] ""  VideoFrontCenter
 SG_ RFL_Obj05_AliveCtr : 16|8@1+ (1,0) [0|255] ""  VideoFrontCenter
 SG_ RFL_Obj05_ProtBlockCtr : 24|4@1+ (1,0) [0|15] ""  VideoFrontCenter
 SG_ RFL_Obj05_ReferencePoint : 28|4@1+ (1,0) [0|15] ""  VideoFrontCenter
 SG_ RFL_Obj05_ObjId : 32|7@1+ (1,0) [0|127] ""  VideoFrontCenter
 SG_ RFL_Obj05_MeasurementStatus : 39|1@1+ (1,0) [0|1] ""  VideoFrontCenter
 SG_ RFL_Obj05_Px : 40|13@1+ (0.0625,-256) [-256|255.9375] "m"  VideoFrontCenter
 SG_ RFL_Obj05_Py : 53|11@1+ (0.125,-128) [-128|127.875] "m"  VideoFrontCenter
 SG_ RFL_Obj05_PxVnce : 64|12@1+ (0.01,0) [0|30] "m^2"  VideoFrontCenter
 SG_ RFL_Obj05_PyVnce : 76|12@1+ (0.01,0) [0|30] "m^2"  VideoFrontCenter
 SG_ RFL_Obj05_Vx : 88|12@1+ (0.0625,-128) [-128|127.9375] "m/s"  VideoFrontCenter
 SG_ RFL_Obj05_Vy : 100|10@1+ (0.125,-64) [-64|63.875] "m/s"  VideoFrontCenter
 SG_ RFL_Obj05_Ax : 110|10@1+ (0.03125,-16) [-16|15.96875] "m/s^2"  VideoFrontCenter
 SG_ RFL_Obj05_Ay : 120|9@1+ (0.0625,-16) [-16|15.9375] "m/s^2"  VideoFrontCenter
 SG_ RFL_Obj05_OrientationYaw : 129|9@1+ (0.0175,-4.48) [-3.15|3.15] "rad"  VideoFrontCenter
 SG_ RFL_Obj05_ExistProb : 138|6@1+ (2,0) [0|100] "%"  VideoFrontCenter
 SG_ RFL_Obj05_VxVnce : 144|12@1+ (0.01,0) [0|30] "m^2/s^2"  VideoFrontCenter
 SG_ RFL_Obj05_VyVnce : 156|12@1+ (0.01,0) [0|30] "m^2/s^2"  VideoFrontCenter
 SG_ RFL_Obj05_AxVnce : 168|12@1+ (0.01,0) [0|30] "m^2/s^4"  VideoFrontCenter
 SG_ RFL_Obj05_AyVnce : 180|12@1+ (0.01,0) [0|30] "m^2/s^4"  VideoFrontCenter
 SG_ RFL_Obj05_OrientationYawVnce : 192|12@1+ (0.0003,0) [0|1] "rad^2"  VideoFrontCenter
 SG_ RFL_Obj05_MovingObserved : 204|6@1+ (2,0) [0|100] "%"  VideoFrontCenter
 SG_ RFL_Obj05_MovingProbability : 210|6@1+ (2,0) [0|100] "%"  VideoFrontCenter
 SG_ RFL_Obj05_Length : 216|7@1+ (0.125,0) [0|15.875] "m"  VideoFrontCenter
 SG_ RFL_Obj05_Valid : 223|1@1+ (1,0) [0|1] ""  VideoFrontCenter
 SG_ RFL_Obj05_LengthVnce : 224|12@1+ (0.01,0) [0|30] "m^2"  VideoFrontCenter
 SG_ RFL_Obj05_WidthVnce : 236|12@1+ (0.01,0) [0|30] "m^2"  VideoFrontCenter
 SG_ RFL_Obj05_Width : 248|7@1+ (0.125,0) [0|15.875] "m"  VideoFrontCenter
 SG_ RFL_Obj05_BehaviorType : 255|3@1+ (1,0) [0|7] ""  VideoFrontCenter
 SG_ RFL_Obj05_ObstacleConf : 258|6@1+ (2,0) [0|100] "%"  VideoFrontCenter
 SG_ RFL_Obj05_NonObstacleConf : 264|6@1+ (2,0) [0|100] "%"  VideoFrontCenter
 SG_ RFL_Obj05_PxPyCoVnce : 272|12@1+ (0.01,0) [0|30] "m^2"  VideoFrontCenter
 SG_ RFL_Obj05_PxVxCoVnce : 284|12@1+ (0.01,0) [0|30] "m^2/s"  VideoFrontCenter
 SG_ RFL_Obj05_PxVyCoVnce : 296|12@1+ (0.01,0) [0|30] "m^2/s"  VideoFrontCenter
 SG_ RFL_Obj05_PyVxCoVnce : 308|12@1+ (0.01,0) [0|30] "m^2/s"  VideoFrontCenter
 SG_ RFL_Obj05_PyVyCoVnce : 320|12@1+ (0.01,0) [0|30] "m^2/s"  VideoFrontCenter
 SG_ RFL_Obj05_VxVyCoVnce : 332|12@1+ (0.01,0) [0|30] "m^2/s^2"  VideoFrontCenter
 SG_ RFL_Obj05_PxAxCoVnce : 344|12@1+ (0.01,0) [0|30] "m^2/s^2"  VideoFrontCenter
 SG_ RFL_Obj05_PxAyCoVnce : 356|12@1+ (0.01,0) [0|30] "m^2/s^2"  VideoFrontCenter
 SG_ RFL_Obj05_PyAxCoVnce : 368|12@1+ (0.01,0) [0|30] "m^2/s^2"  VideoFrontCenter
 SG_ RFL_Obj05_PyAyCoVnce : 380|12@1+ (0.01,0) [0|30] "m^2/s^2"  VideoFrontCenter
 SG_ RFL_Obj05_VxAxCoVnce : 392|12@1+ (0.01,0) [0|30] "m^2/s^3"  VideoFrontCenter
 SG_ RFL_Obj05_VxAyCoVnce : 404|12@1+ (0.01,0) [0|30] "m^2/s^3"  VideoFrontCenter
 SG_ RFL_Obj05_VyAxCoVnce : 416|12@1+ (0.01,0) [0|30] "m^2/s^3"  VideoFrontCenter
 SG_ RFL_Obj05_VyAyCoVnce : 428|12@1+ (0.01,0) [0|30] "m^2/s^3"  VideoFrontCenter
 SG_ RFL_Obj05_AxAyCoVnce : 440|12@1+ (0.01,0) [0|30] "m^2/s^4"  VideoFrontCenter
 SG_ RFL_Obj05_MobileObstConf : 452|6@1+ (2,0) [0|100] "%"  VideoFrontCenter
 SG_ RFL_Obj05_Mob4PlusWhlConf : 458|6@1+ (2,0) [0|100] "%"  VideoFrontCenter
 SG_ RFL_Obj05_Mob2WhlConf : 464|6@1+ (2,0) [0|100] "%"  VideoFrontCenter
 SG_ RFL_Obj05_MobPedConf : 470|6@1+ (2,0) [0|100] "%"  VideoFrontCenter
 SG_ RFL_Obj05_FourPlusWhlCarConf : 476|6@1+ (2,0) [0|100] "%"  VideoFrontCenter
 SG_ RFL_Obj05_FourPlusWhlHGVConf : 482|6@1+ (2,0) [0|100] "%"  VideoFrontCenter
 SG_ RFL_Obj05_GroundReflexConf : 488|6@1+ (2,0) [0|100] "%"  VideoFrontCenter
 SG_ RFL_Obj05_StatObstConf : 494|6@1+ (2,0) [0|100] "%"  VideoFrontCenter
 SG_ RFL_Obj05_StatBarrierConf : 500|6@1+ (2,0) [0|100] "%"  VideoFrontCenter

BO_ 924 RFL_Obj06: 64 RadarFrontLeft
 SG_ RFL_Obj06_CRC : 0|16@1+ (1,0) [0|65535] ""  VideoFrontCenter
 SG_ RFL_Obj06_AliveCtr : 16|8@1+ (1,0) [0|255] ""  VideoFrontCenter
 SG_ RFL_Obj06_ProtBlockCtr : 24|4@1+ (1,0) [0|15] ""  VideoFrontCenter
 SG_ RFL_Obj06_ReferencePoint : 28|4@1+ (1,0) [0|15] ""  VideoFrontCenter
 SG_ RFL_Obj06_ObjId : 32|7@1+ (1,0) [0|127] ""  VideoFrontCenter
 SG_ RFL_Obj06_MeasurementStatus : 39|1@1+ (1,0) [0|1] ""  VideoFrontCenter
 SG_ RFL_Obj06_Px : 40|13@1+ (0.0625,-256) [-256|255.9375] "m"  VideoFrontCenter
 SG_ RFL_Obj06_Py : 53|11@1+ (0.125,-128) [-128|127.875] "m"  VideoFrontCenter
 SG_ RFL_Obj06_PxVnce : 64|12@1+ (0.01,0) [0|30] "m^2"  VideoFrontCenter
 SG_ RFL_Obj06_PyVnce : 76|12@1+ (0.01,0) [0|30] "m^2"  VideoFrontCenter
 SG_ RFL_Obj06_Vx : 88|12@1+ (0.0625,-128) [-128|127.9375] "m/s"  VideoFrontCenter
 SG_ RFL_Obj06_Vy : 100|10@1+ (0.125,-64) [-64|63.875] "m/s"  VideoFrontCenter
 SG_ RFL_Obj06_Ax : 110|10@1+ (0.03125,-16) [-16|15.96875] "m/s^2"  VideoFrontCenter
 SG_ RFL_Obj06_Ay : 120|9@1+ (0.0625,-16) [-16|15.9375] "m/s^2"  VideoFrontCenter
 SG_ RFL_Obj06_OrientationYaw : 129|9@1+ (0.0175,-4.48) [-3.15|3.15] "rad"  VideoFrontCenter
 SG_ RFL_Obj06_ExistProb : 138|6@1+ (2,0) [0|100] "%"  VideoFrontCenter
 SG_ RFL_Obj06_VxVnce : 144|12@1+ (0.01,0) [0|30] "m^2/s^2"  VideoFrontCenter
 SG_ RFL_Obj06_VyVnce : 156|12@1+ (0.01,0) [0|30] "m^2/s^2"  VideoFrontCenter
 SG_ RFL_Obj06_AxVnce : 168|12@1+ (0.01,0) [0|30] "m^2/s^4"  VideoFrontCenter
 SG_ RFL_Obj06_AyVnce : 180|12@1+ (0.01,0) [0|30] "m^2/s^4"  VideoFrontCenter
 SG_ RFL_Obj06_OrientationYawVnce : 192|12@1+ (0.0003,0) [0|1] "rad^2"  VideoFrontCenter
 SG_ RFL_Obj06_MovingObserved : 204|6@1+ (2,0) [0|100] "%"  VideoFrontCenter
 SG_ RFL_Obj06_MovingProbability : 210|6@1+ (2,0) [0|100] "%"  VideoFrontCenter
 SG_ RFL_Obj06_Length : 216|7@1+ (0.125,0) [0|15.875] "m"  VideoFrontCenter
 SG_ RFL_Obj06_Valid : 223|1@1+ (1,0) [0|1] ""  VideoFrontCenter
 SG_ RFL_Obj06_LengthVnce : 224|12@1+ (0.01,0) [0|30] "m^2"  VideoFrontCenter
 SG_ RFL_Obj06_WidthVnce : 236|12@1+ (0.01,0) [0|30] "m^2"  VideoFrontCenter
 SG_ RFL_Obj06_Width : 248|7@1+ (0.125,0) [0|15.875] "m"  VideoFrontCenter
 SG_ RFL_Obj06_BehaviorType : 255|3@1+ (1,0) [0|7] ""  VideoFrontCenter
 SG_ RFL_Obj06_ObstacleConf : 258|6@1+ (2,0) [0|100] "%"  VideoFrontCenter
 SG_ RFL_Obj06_NonObstacleConf : 264|6@1+ (2,0) [0|100] "%"  VideoFrontCenter
 SG_ RFL_Obj06_PxPyCoVnce : 272|12@1+ (0.01,0) [0|30] "m^2"  VideoFrontCenter
 SG_ RFL_Obj06_PxVxCoVnce : 284|12@1+ (0.01,0) [0|30] "m^2/s"  VideoFrontCenter
 SG_ RFL_Obj06_PxVyCoVnce : 296|12@1+ (0.01,0) [0|30] "m^2/s"  VideoFrontCenter
 SG_ RFL_Obj06_PyVxCoVnce : 308|12@1+ (0.01,0) [0|30] "m^2/s"  VideoFrontCenter
 SG_ RFL_Obj06_PyVyCoVnce : 320|12@1+ (0.01,0) [0|30] "m^2/s"  VideoFrontCenter
 SG_ RFL_Obj06_VxVyCoVnce : 332|12@1+ (0.01,0) [0|30] "m^2/s^2"  VideoFrontCenter
 SG_ RFL_Obj06_PxAxCoVnce : 344|12@1+ (0.01,0) [0|30] "m^2/s^2"  VideoFrontCenter
 SG_ RFL_Obj06_PxAyCoVnce : 356|12@1+ (0.01,0) [0|30] "m^2/s^2"  VideoFrontCenter
 SG_ RFL_Obj06_PyAxCoVnce : 368|12@1+ (0.01,0) [0|30] "m^2/s^2"  VideoFrontCenter
 SG_ RFL_Obj06_PyAyCoVnce : 380|12@1+ (0.01,0) [0|30] "m^2/s^2"  VideoFrontCenter
 SG_ RFL_Obj06_VxAxCoVnce : 392|12@1+ (0.01,0) [0|30] "m^2/s^3"  VideoFrontCenter
 SG_ RFL_Obj06_VxAyCoVnce : 404|12@1+ (0.01,0) [0|30] "m^2/s^3"  VideoFrontCenter
 SG_ RFL_Obj06_VyAxCoVnce : 416|12@1+ (0.01,0) [0|30] "m^2/s^3"  VideoFrontCenter
 SG_ RFL_Obj06_VyAyCoVnce : 428|12@1+ (0.01,0) [0|30] "m^2/s^3"  VideoFrontCenter
 SG_ RFL_Obj06_AxAyCoVnce : 440|12@1+ (0.01,0) [0|30] "m^2/s^4"  VideoFrontCenter
 SG_ RFL_Obj06_MobileObstConf : 452|6@1+ (2,0) [0|100] "%"  VideoFrontCenter
 SG_ RFL_Obj06_Mob4PlusWhlConf : 458|6@1+ (2,0) [0|100] "%"  VideoFrontCenter
 SG_ RFL_Obj06_Mob2WhlConf : 464|6@1+ (2,0) [0|100] "%"  VideoFrontCenter
 SG_ RFL_Obj06_MobPedConf : 470|6@1+ (2,0) [0|100] "%"  VideoFrontCenter
 SG_ RFL_Obj06_FourPlusWhlCarConf : 476|6@1+ (2,0) [0|100] "%"  VideoFrontCenter
 SG_ RFL_Obj06_FourPlusWhlHGVConf : 482|6@1+ (2,0) [0|100] "%"  VideoFrontCenter
 SG_ RFL_Obj06_GroundReflexConf : 488|6@1+ (2,0) [0|100] "%"  VideoFrontCenter
 SG_ RFL_Obj06_StatObstConf : 494|6@1+ (2,0) [0|100] "%"  VideoFrontCenter
 SG_ RFL_Obj06_StatBarrierConf : 500|6@1+ (2,0) [0|100] "%"  VideoFrontCenter

CM_ SG_ 432 RFC_Obj26_CRC "CRC - Autosar E2E Profile 5";
CM_ SG_ 432 RFC_Obj26_AliveCtr "Alive counter - Autosar E2E Profile 5";
CM_ SG_ 432 RFC_Obj26_ProtBlockCtr "Protocol-Signal: Block-Counter";
CM_ SG_ 432 RFC_Obj26_ReferencePoint "Reference Point of the detected object. ISO 23150: Reference point (A.2.17)";
CM_ SG_ 432 RFC_Obj26_ObjId "Unique Object ID. ISO 23150: Object ID (A.2.2)";
CM_ SG_ 432 RFC_Obj26_MeasurementStatus "Object is measured or not. ISO 23150: Measurement status  object level (A.2.9)";
CM_ SG_ 432 RFC_Obj26_Px "Object position in X direction. ISO 23150: Position  object level {x, y, z} (A.2.13)";
CM_ SG_ 432 RFC_Obj26_Py "Object position in Y direction. ISO 23150: Position  object level {x, y, z} (A.2.13)";
CM_ SG_ 432 RFC_Obj26_PxVnce "Variance of object position in X direction. ISO 23150: Position  object level {x, y, z}  error (A.2.14)";
CM_ SG_ 432 RFC_Obj26_PyVnce "Variance of object position in Y direction. ISO 23150: Position  object level {x, y, z}  error (A.2.14)";
CM_ SG_ 432 RFC_Obj26_Vx "Object relative velocity in X direction. ISO 23150: Velocity {x, y, z}  object level (A.2.23)";
CM_ SG_ 432 RFC_Obj26_Vy "Object relative velocity in Y direction. ISO 23150: Velocity {x, y, z}  object level (A.2.23)";
CM_ SG_ 432 RFC_Obj26_Ax "Object relative acceleration in X direction. ISO 23150: Acceleration {x, y, z} (A.2.25)";
CM_ SG_ 432 RFC_Obj26_Ay "Object relative acceleration in Y direction. ISO 23150: Acceleration {x, y, z} (A.2.25)";
CM_ SG_ 432 RFC_Obj26_OrientationYaw "Object orientation yaw angle. ISO 23150: Orientation {yaw, pitch, roll} (A.2.15)";
CM_ SG_ 432 RFC_Obj26_ExistProb "Existence probability of object. ISO 23150: Existence probability  object level (A.2.1)";
CM_ SG_ 432 RFC_Obj26_VxVnce "Variance of object relative velocity in X direction. ISO 23150: Velocity {x, y, z}  object level  error (A.2.24)";
CM_ SG_ 432 RFC_Obj26_VyVnce "Variance of object relative velocity in Y direction. ISO 23150: Velocity {x, y, z}  object level  error (A.2.24)";
CM_ SG_ 432 RFC_Obj26_AxVnce "Variance of object relative acceleration in X direction. ISO 23150: Acceleration {x, y, z}  error (A.2.26)";
CM_ SG_ 432 RFC_Obj26_AyVnce "Variance of object relative acceleration in Y direction. ISO 23150: Acceleration {x, y, z}  error (A.2.26)";
CM_ SG_ 432 RFC_Obj26_OrientationYawVnce "Variance of object orientation yaw angle. ISO 23150: Orientation {yaw, pitch, roll}  error (A.2.16)";
CM_ SG_ 432 RFC_Obj26_MovingObserved "Object has been observed moving over the ground since it was first detected";
CM_ SG_ 432 RFC_Obj26_MovingProbability "Object has been observed moving over the ground";
CM_ SG_ 432 RFC_Obj26_Length "Object Length. ISO 23150: Bounding box extent {length, width, height} (A.2.19)";
CM_ SG_ 432 RFC_Obj26_Valid "Object is valid or not";
CM_ SG_ 432 RFC_Obj26_LengthVnce "Variance of object Length. ISO 23150: Bounding box extent {length, width, height}  error (A.2.20)";
CM_ SG_ 432 RFC_Obj26_WidthVnce "Variance of object Width. ISO 23150: Bounding box extent {length, width, height}  error (A.2.20)";
CM_ SG_ 432 RFC_Obj26_Width "Object Width. ISO 23150: Bounding box extent {length, width, height} (A.2.19)";
CM_ SG_ 432 RFC_Obj26_BehaviorType "Indicates that which behavior the object associated for";
CM_ SG_ 432 RFC_Obj26_ObstacleConf "Confidence of the object being an Obstacle. ISO 23150: Potentially moving object classification type  confidence (A.2.12)";
CM_ SG_ 432 RFC_Obj26_NonObstacleConf "Confidence of the object being a Non-Obstacle. ISO 23150: Potentially moving object classification type  confidence (A.2.12)";
CM_ SG_ 432 RFC_Obj26_PxPyCoVnce "Covariance of Px and Py";
CM_ SG_ 432 RFC_Obj26_PxVxCoVnce "Covariance of Px and Vx";
CM_ SG_ 432 RFC_Obj26_PxVyCoVnce "Covariance of Px and Vy";
CM_ SG_ 432 RFC_Obj26_PyVxCoVnce "Covariance of Py and Vx";
CM_ SG_ 432 RFC_Obj26_PyVyCoVnce "Covariance of Py and Vy";
CM_ SG_ 432 RFC_Obj26_VxVyCoVnce "Covariance of Vx and Vy";
CM_ SG_ 432 RFC_Obj26_PxAxCoVnce "Covariance of Px and Ax";
CM_ SG_ 432 RFC_Obj26_PxAyCoVnce "Covariance of Px and Ay";
CM_ SG_ 432 RFC_Obj26_PyAxCoVnce "Covariance of Py and Ax";
CM_ SG_ 432 RFC_Obj26_PyAyCoVnce "Covariance of Py and Ay";
CM_ SG_ 432 RFC_Obj26_VxAxCoVnce "Covariance of Vx and Ax";
CM_ SG_ 432 RFC_Obj26_VxAyCoVnce "Covariance of Vx and Ay";
CM_ SG_ 432 RFC_Obj26_VyAxCoVnce "Covariance of Vy and Ax";
CM_ SG_ 432 RFC_Obj26_VyAyCoVnce "Covariance of Vy and Ay";
CM_ SG_ 432 RFC_Obj26_AxAyCoVnce "Covariance of Ax and Ay";
CM_ SG_ 432 RFC_Obj26_MobileObstConf "Confidence of the object being a mobile obstacle. ISO 23150: Potentially moving object classification type  confidence (A.2.12)";
CM_ SG_ 432 RFC_Obj26_Mob4PlusWhlConf "Confidence of a mobile object which has 4 or more wheels. ISO 23150: Potentially moving object classification type  confidence (A.2.12)";
CM_ SG_ 432 RFC_Obj26_Mob2WhlConf "Confidence of a mobile object being 2-wheels vehicle. ISO 23150: Potentially moving object classification type  confidence (A.2.12)";
CM_ SG_ 432 RFC_Obj26_MobPedConf "Confidence of a mobile object being a pedestrian. ISO 23150: Potentially moving object classification type  confidence (A.2.12)";
CM_ SG_ 432 RFC_Obj26_FourPlusWhlCarConf "Confidence of a mobile object which has 4 or more wheels--passenger car. ISO 23150: Potentially moving object classification type  confidence (A.2.12)";
CM_ SG_ 432 RFC_Obj26_FourPlusWhlHGVConf "Confidence of a mobile object which has 4 or more wheels--commercial vehicle (Truck). ISO 23150: Potentially moving object classification type  confidence (A.2.12)";
CM_ SG_ 432 RFC_Obj26_GroundReflexConf "Confidence of the object being a ground reflex. ISO 23150: Potentially moving object classification type  confidence (A.2.12)";
CM_ SG_ 432 RFC_Obj26_StatObstConf "Confidence of the object being a stationary obstacle. ISO 23150: Potentially moving object classification type  confidence (A.2.12)";
CM_ SG_ 432 RFC_Obj26_StatBarrierConf "Confidence of the object being a stationary road barrier. ISO 23150: Potentially moving object classification type  confidence (A.2.12)";
CM_ SG_ 433 RFC_Obj27_CRC "CRC - Autosar E2E Profile 5";
CM_ SG_ 433 RFC_Obj27_AliveCtr "Alive counter - Autosar E2E Profile 5";
CM_ SG_ 433 RFC_Obj27_ProtBlockCtr "Protocol-Signal: Block-Counter";
CM_ SG_ 433 RFC_Obj27_ReferencePoint "Reference Point of the detected object. ISO 23150: Reference point (A.2.17)";
CM_ SG_ 433 RFC_Obj27_ObjId "Unique Object ID. ISO 23150: Object ID (A.2.2)";
CM_ SG_ 433 RFC_Obj27_MeasurementStatus "Object is measured or not. ISO 23150: Measurement status  object level (A.2.9)";
CM_ SG_ 433 RFC_Obj27_Px "Object position in X direction. ISO 23150: Position  object level {x, y, z} (A.2.13)";
CM_ SG_ 433 RFC_Obj27_Py "Object position in Y direction. ISO 23150: Position  object level {x, y, z} (A.2.13)";
CM_ SG_ 433 RFC_Obj27_PxVnce "Variance of object position in X direction. ISO 23150: Position  object level {x, y, z}  error (A.2.14)";
CM_ SG_ 433 RFC_Obj27_PyVnce "Variance of object position in Y direction. ISO 23150: Position  object level {x, y, z}  error (A.2.14)";
CM_ SG_ 433 RFC_Obj27_Vx "Object relative velocity in X direction. ISO 23150: Velocity {x, y, z}  object level (A.2.23)";
CM_ SG_ 433 RFC_Obj27_Vy "Object relative velocity in Y direction. ISO 23150: Velocity {x, y, z}  object level (A.2.23)";
CM_ SG_ 433 RFC_Obj27_Ax "Object relative acceleration in X direction. ISO 23150: Acceleration {x, y, z} (A.2.25)";
CM_ SG_ 433 RFC_Obj27_Ay "Object relative acceleration in Y direction. ISO 23150: Acceleration {x, y, z} (A.2.25)";
CM_ SG_ 433 RFC_Obj27_OrientationYaw "Object orientation yaw angle. ISO 23150: Orientation {yaw, pitch, roll} (A.2.15)";
CM_ SG_ 433 RFC_Obj27_ExistProb "Existence probability of object. ISO 23150: Existence probability  object level (A.2.1)";
CM_ SG_ 433 RFC_Obj27_VxVnce "Variance of object relative velocity in X direction. ISO 23150: Velocity {x, y, z}  object level  error (A.2.24)";
CM_ SG_ 433 RFC_Obj27_VyVnce "Variance of object relative velocity in Y direction. ISO 23150: Velocity {x, y, z}  object level  error (A.2.24)";
CM_ SG_ 433 RFC_Obj27_AxVnce "Variance of object relative acceleration in X direction. ISO 23150: Acceleration {x, y, z}  error (A.2.26)";
CM_ SG_ 433 RFC_Obj27_AyVnce "Variance of object relative acceleration in Y direction. ISO 23150: Acceleration {x, y, z}  error (A.2.26)";
CM_ SG_ 433 RFC_Obj27_OrientationYawVnce "Variance of object orientation yaw angle. ISO 23150: Orientation {yaw, pitch, roll}  error (A.2.16)";
CM_ SG_ 433 RFC_Obj27_MovingObserved "Object has been observed moving over the ground since it was first detected";
CM_ SG_ 433 RFC_Obj27_MovingProbability "Object has been observed moving over the ground";
CM_ SG_ 433 RFC_Obj27_Length "Object Length. ISO 23150: Bounding box extent {length, width, height} (A.2.19)";
CM_ SG_ 433 RFC_Obj27_Valid "Object is valid or not";
CM_ SG_ 433 RFC_Obj27_LengthVnce "Variance of object Length. ISO 23150: Bounding box extent {length, width, height}  error (A.2.20)";
CM_ SG_ 433 RFC_Obj27_WidthVnce "Variance of object Width. ISO 23150: Bounding box extent {length, width, height}  error (A.2.20)";
CM_ SG_ 433 RFC_Obj27_Width "Object Width. ISO 23150: Bounding box extent {length, width, height} (A.2.19)";
CM_ SG_ 433 RFC_Obj27_BehaviorType "Indicates that which behavior the object associated for";
CM_ SG_ 433 RFC_Obj27_ObstacleConf "Confidence of the object being an Obstacle. ISO 23150: Potentially moving object classification type  confidence (A.2.12)";
CM_ SG_ 433 RFC_Obj27_NonObstacleConf "Confidence of the object being a Non-Obstacle. ISO 23150: Potentially moving object classification type  confidence (A.2.12)";
CM_ SG_ 433 RFC_Obj27_PxPyCoVnce "Covariance of Px and Py";
CM_ SG_ 433 RFC_Obj27_PxVxCoVnce "Covariance of Px and Vx";
CM_ SG_ 433 RFC_Obj27_PxVyCoVnce "Covariance of Px and Vy";
CM_ SG_ 433 RFC_Obj27_PyVxCoVnce "Covariance of Py and Vx";
CM_ SG_ 433 RFC_Obj27_PyVyCoVnce "Covariance of Py and Vy";
CM_ SG_ 433 RFC_Obj27_VxVyCoVnce "Covariance of Vx and Vy";
CM_ SG_ 433 RFC_Obj27_PxAxCoVnce "Covariance of Px and Ax";
CM_ SG_ 433 RFC_Obj27_PxAyCoVnce "Covariance of Px and Ay";
CM_ SG_ 433 RFC_Obj27_PyAxCoVnce "Covariance of Py and Ax";
CM_ SG_ 433 RFC_Obj27_PyAyCoVnce "Covariance of Py and Ay";
CM_ SG_ 433 RFC_Obj27_VxAxCoVnce "Covariance of Vx and Ax";
CM_ SG_ 433 RFC_Obj27_VxAyCoVnce "Covariance of Vx and Ay";
CM_ SG_ 433 RFC_Obj27_VyAxCoVnce "Covariance of Vy and Ax";
CM_ SG_ 433 RFC_Obj27_VyAyCoVnce "Covariance of Vy and Ay";
CM_ SG_ 433 RFC_Obj27_AxAyCoVnce "Covariance of Ax and Ay";
CM_ SG_ 433 RFC_Obj27_MobileObstConf "Confidence of the object being a mobile obstacle. ISO 23150: Potentially moving object classification type  confidence (A.2.12)";
CM_ SG_ 433 RFC_Obj27_Mob4PlusWhlConf "Confidence of a mobile object which has 4 or more wheels. ISO 23150: Potentially moving object classification type  confidence (A.2.12)";
CM_ SG_ 433 RFC_Obj27_Mob2WhlConf "Confidence of a mobile object being 2-wheels vehicle. ISO 23150: Potentially moving object classification type  confidence (A.2.12)";
CM_ SG_ 433 RFC_Obj27_MobPedConf "Confidence of a mobile object being a pedestrian. ISO 23150: Potentially moving object classification type  confidence (A.2.12)";
CM_ SG_ 433 RFC_Obj27_FourPlusWhlCarConf "Confidence of a mobile object which has 4 or more wheels--passenger car. ISO 23150: Potentially moving object classification type  confidence (A.2.12)";
CM_ SG_ 433 RFC_Obj27_FourPlusWhlHGVConf "Confidence of a mobile object which has 4 or more wheels--commercial vehicle (Truck). ISO 23150: Potentially moving object classification type  confidence (A.2.12)";
CM_ SG_ 433 RFC_Obj27_GroundReflexConf "Confidence of the object being a ground reflex. ISO 23150: Potentially moving object classification type  confidence (A.2.12)";
CM_ SG_ 433 RFC_Obj27_StatObstConf "Confidence of the object being a stationary obstacle. ISO 23150: Potentially moving object classification type  confidence (A.2.12)";
CM_ SG_ 433 RFC_Obj27_StatBarrierConf "Confidence of the object being a stationary road barrier. ISO 23150: Potentially moving object classification type  confidence (A.2.12)";
CM_ SG_ 434 RFC_Obj28_CRC "CRC - Autosar E2E Profile 5";
CM_ SG_ 434 RFC_Obj28_AliveCtr "Alive counter - Autosar E2E Profile 5";
CM_ SG_ 434 RFC_Obj28_ProtBlockCtr "Protocol-Signal: Block-Counter";
CM_ SG_ 434 RFC_Obj28_ReferencePoint "Reference Point of the detected object. ISO 23150: Reference point (A.2.17)";
CM_ SG_ 434 RFC_Obj28_ObjId "Unique Object ID. ISO 23150: Object ID (A.2.2)";
CM_ SG_ 434 RFC_Obj28_MeasurementStatus "Object is measured or not. ISO 23150: Measurement status  object level (A.2.9)";
CM_ SG_ 434 RFC_Obj28_Px "Object position in X direction. ISO 23150: Position  object level {x, y, z} (A.2.13)";
CM_ SG_ 434 RFC_Obj28_Py "Object position in Y direction. ISO 23150: Position  object level {x, y, z} (A.2.13)";
CM_ SG_ 434 RFC_Obj28_PxVnce "Variance of object position in X direction. ISO 23150: Position  object level {x, y, z}  error (A.2.14)";
CM_ SG_ 434 RFC_Obj28_PyVnce "Variance of object position in Y direction. ISO 23150: Position  object level {x, y, z}  error (A.2.14)";
CM_ SG_ 434 RFC_Obj28_Vx "Object relative velocity in X direction. ISO 23150: Velocity {x, y, z}  object level (A.2.23)";
CM_ SG_ 434 RFC_Obj28_Vy "Object relative velocity in Y direction. ISO 23150: Velocity {x, y, z}  object level (A.2.23)";
CM_ SG_ 434 RFC_Obj28_Ax "Object relative acceleration in X direction. ISO 23150: Acceleration {x, y, z} (A.2.25)";
CM_ SG_ 434 RFC_Obj28_Ay "Object relative acceleration in Y direction. ISO 23150: Acceleration {x, y, z} (A.2.25)";
CM_ SG_ 434 RFC_Obj28_OrientationYaw "Object orientation yaw angle. ISO 23150: Orientation {yaw, pitch, roll} (A.2.15)";
CM_ SG_ 434 RFC_Obj28_ExistProb "Existence probability of object. ISO 23150: Existence probability  object level (A.2.1)";
CM_ SG_ 434 RFC_Obj28_VxVnce "Variance of object relative velocity in X direction. ISO 23150: Velocity {x, y, z}  object level  error (A.2.24)";
CM_ SG_ 434 RFC_Obj28_VyVnce "Variance of object relative velocity in Y direction. ISO 23150: Velocity {x, y, z}  object level  error (A.2.24)";
CM_ SG_ 434 RFC_Obj28_AxVnce "Variance of object relative acceleration in X direction. ISO 23150: Acceleration {x, y, z}  error (A.2.26)";
CM_ SG_ 434 RFC_Obj28_AyVnce "Variance of object relative acceleration in Y direction. ISO 23150: Acceleration {x, y, z}  error (A.2.26)";
CM_ SG_ 434 RFC_Obj28_OrientationYawVnce "Variance of object orientation yaw angle. ISO 23150: Orientation {yaw, pitch, roll}  error (A.2.16)";
CM_ SG_ 434 RFC_Obj28_MovingObserved "Object has been observed moving over the ground since it was first detected";
CM_ SG_ 434 RFC_Obj28_MovingProbability "Object has been observed moving over the ground";
CM_ SG_ 434 RFC_Obj28_Length "Object Length. ISO 23150: Bounding box extent {length, width, height} (A.2.19)";
CM_ SG_ 434 RFC_Obj28_Valid "Object is valid or not";
CM_ SG_ 434 RFC_Obj28_LengthVnce "Variance of object Length. ISO 23150: Bounding box extent {length, width, height}  error (A.2.20)";
CM_ SG_ 434 RFC_Obj28_WidthVnce "Variance of object Width. ISO 23150: Bounding box extent {length, width, height}  error (A.2.20)";
CM_ SG_ 434 RFC_Obj28_Width "Object Width. ISO 23150: Bounding box extent {length, width, height} (A.2.19)";
CM_ SG_ 434 RFC_Obj28_BehaviorType "Indicates that which behavior the object associated for";
CM_ SG_ 434 RFC_Obj28_ObstacleConf "Confidence of the object being an Obstacle. ISO 23150: Potentially moving object classification type  confidence (A.2.12)";
CM_ SG_ 434 RFC_Obj28_NonObstacleConf "Confidence of the object being a Non-Obstacle. ISO 23150: Potentially moving object classification type  confidence (A.2.12)";
CM_ SG_ 434 RFC_Obj28_PxPyCoVnce "Covariance of Px and Py";
CM_ SG_ 434 RFC_Obj28_PxVxCoVnce "Covariance of Px and Vx";
CM_ SG_ 434 RFC_Obj28_PxVyCoVnce "Covariance of Px and Vy";
CM_ SG_ 434 RFC_Obj28_PyVxCoVnce "Covariance of Py and Vx";
CM_ SG_ 434 RFC_Obj28_PyVyCoVnce "Covariance of Py and Vy";
CM_ SG_ 434 RFC_Obj28_VxVyCoVnce "Covariance of Vx and Vy";
CM_ SG_ 434 RFC_Obj28_PxAxCoVnce "Covariance of Px and Ax";
CM_ SG_ 434 RFC_Obj28_PxAyCoVnce "Covariance of Px and Ay";
CM_ SG_ 434 RFC_Obj28_PyAxCoVnce "Covariance of Py and Ax";
CM_ SG_ 434 RFC_Obj28_PyAyCoVnce "Covariance of Py and Ay";
CM_ SG_ 434 RFC_Obj28_VxAxCoVnce "Covariance of Vx and Ax";
CM_ SG_ 434 RFC_Obj28_VxAyCoVnce "Covariance of Vx and Ay";
CM_ SG_ 434 RFC_Obj28_VyAxCoVnce "Covariance of Vy and Ax";
CM_ SG_ 434 RFC_Obj28_VyAyCoVnce "Covariance of Vy and Ay";
CM_ SG_ 434 RFC_Obj28_AxAyCoVnce "Covariance of Ax and Ay";
CM_ SG_ 434 RFC_Obj28_MobileObstConf "Confidence of the object being a mobile obstacle. ISO 23150: Potentially moving object classification type  confidence (A.2.12)";
CM_ SG_ 434 RFC_Obj28_Mob4PlusWhlConf "Confidence of a mobile object which has 4 or more wheels. ISO 23150: Potentially moving object classification type  confidence (A.2.12)";
CM_ SG_ 434 RFC_Obj28_Mob2WhlConf "Confidence of a mobile object being 2-wheels vehicle. ISO 23150: Potentially moving object classification type  confidence (A.2.12)";
CM_ SG_ 434 RFC_Obj28_MobPedConf "Confidence of a mobile object being a pedestrian. ISO 23150: Potentially moving object classification type  confidence (A.2.12)";
CM_ SG_ 434 RFC_Obj28_FourPlusWhlCarConf "Confidence of a mobile object which has 4 or more wheels--passenger car. ISO 23150: Potentially moving object classification type  confidence (A.2.12)";
CM_ SG_ 434 RFC_Obj28_FourPlusWhlHGVConf "Confidence of a mobile object which has 4 or more wheels--commercial vehicle (Truck). ISO 23150: Potentially moving object classification type  confidence (A.2.12)";
CM_ SG_ 434 RFC_Obj28_GroundReflexConf "Confidence of the object being a ground reflex. ISO 23150: Potentially moving object classification type  confidence (A.2.12)";
CM_ SG_ 434 RFC_Obj28_StatObstConf "Confidence of the object being a stationary obstacle. ISO 23150: Potentially moving object classification type  confidence (A.2.12)";
CM_ SG_ 434 RFC_Obj28_StatBarrierConf "Confidence of the object being a stationary road barrier. ISO 23150: Potentially moving object classification type  confidence (A.2.12)";
CM_ SG_ 435 RFC_Obj29_CRC "CRC - Autosar E2E Profile 5";
CM_ SG_ 435 RFC_Obj29_AliveCtr "Alive counter - Autosar E2E Profile 5";
CM_ SG_ 435 RFC_Obj29_ProtBlockCtr "Protocol-Signal: Block-Counter";
CM_ SG_ 435 RFC_Obj29_ReferencePoint "Reference Point of the detected object. ISO 23150: Reference point (A.2.17)";
CM_ SG_ 435 RFC_Obj29_ObjId "Unique Object ID. ISO 23150: Object ID (A.2.2)";
CM_ SG_ 435 RFC_Obj29_MeasurementStatus "Object is measured or not. ISO 23150: Measurement status  object level (A.2.9)";
CM_ SG_ 435 RFC_Obj29_Px "Object position in X direction. ISO 23150: Position  object level {x, y, z} (A.2.13)";
CM_ SG_ 435 RFC_Obj29_Py "Object position in Y direction. ISO 23150: Position  object level {x, y, z} (A.2.13)";
CM_ SG_ 435 RFC_Obj29_PxVnce "Variance of object position in X direction. ISO 23150: Position  object level {x, y, z}  error (A.2.14)";
CM_ SG_ 435 RFC_Obj29_PyVnce "Variance of object position in Y direction. ISO 23150: Position  object level {x, y, z}  error (A.2.14)";
CM_ SG_ 435 RFC_Obj29_Vx "Object relative velocity in X direction. ISO 23150: Velocity {x, y, z}  object level (A.2.23)";
CM_ SG_ 435 RFC_Obj29_Vy "Object relative velocity in Y direction. ISO 23150: Velocity {x, y, z}  object level (A.2.23)";
CM_ SG_ 435 RFC_Obj29_Ax "Object relative acceleration in X direction. ISO 23150: Acceleration {x, y, z} (A.2.25)";
CM_ SG_ 435 RFC_Obj29_Ay "Object relative acceleration in Y direction. ISO 23150: Acceleration {x, y, z} (A.2.25)";
CM_ SG_ 435 RFC_Obj29_OrientationYaw "Object orientation yaw angle. ISO 23150: Orientation {yaw, pitch, roll} (A.2.15)";
CM_ SG_ 435 RFC_Obj29_ExistProb "Existence probability of object. ISO 23150: Existence probability  object level (A.2.1)";
CM_ SG_ 435 RFC_Obj29_VxVnce "Variance of object relative velocity in X direction. ISO 23150: Velocity {x, y, z}  object level  error (A.2.24)";
CM_ SG_ 435 RFC_Obj29_VyVnce "Variance of object relative velocity in Y direction. ISO 23150: Velocity {x, y, z}  object level  error (A.2.24)";
CM_ SG_ 435 RFC_Obj29_AxVnce "Variance of object relative acceleration in X direction. ISO 23150: Acceleration {x, y, z}  error (A.2.26)";
CM_ SG_ 435 RFC_Obj29_AyVnce "Variance of object relative acceleration in Y direction. ISO 23150: Acceleration {x, y, z}  error (A.2.26)";
CM_ SG_ 435 RFC_Obj29_OrientationYawVnce "Variance of object orientation yaw angle. ISO 23150: Orientation {yaw, pitch, roll}  error (A.2.16)";
CM_ SG_ 435 RFC_Obj29_MovingObserved "Object has been observed moving over the ground since it was first detected";
CM_ SG_ 435 RFC_Obj29_MovingProbability "Object has been observed moving over the ground";
CM_ SG_ 435 RFC_Obj29_Length "Object Length. ISO 23150: Bounding box extent {length, width, height} (A.2.19)";
CM_ SG_ 435 RFC_Obj29_Valid "Object is valid or not";
CM_ SG_ 435 RFC_Obj29_LengthVnce "Variance of object Length. ISO 23150: Bounding box extent {length, width, height}  error (A.2.20)";
CM_ SG_ 435 RFC_Obj29_WidthVnce "Variance of object Width. ISO 23150: Bounding box extent {length, width, height}  error (A.2.20)";
CM_ SG_ 435 RFC_Obj29_Width "Object Width. ISO 23150: Bounding box extent {length, width, height} (A.2.19)";
CM_ SG_ 435 RFC_Obj29_BehaviorType "Indicates that which behavior the object associated for";
CM_ SG_ 435 RFC_Obj29_ObstacleConf "Confidence of the object being an Obstacle. ISO 23150: Potentially moving object classification type  confidence (A.2.12)";
CM_ SG_ 435 RFC_Obj29_NonObstacleConf "Confidence of the object being a Non-Obstacle. ISO 23150: Potentially moving object classification type  confidence (A.2.12)";
CM_ SG_ 435 RFC_Obj29_PxPyCoVnce "Covariance of Px and Py";
CM_ SG_ 435 RFC_Obj29_PxVxCoVnce "Covariance of Px and Vx";
CM_ SG_ 435 RFC_Obj29_PxVyCoVnce "Covariance of Px and Vy";
CM_ SG_ 435 RFC_Obj29_PyVxCoVnce "Covariance of Py and Vx";
CM_ SG_ 435 RFC_Obj29_PyVyCoVnce "Covariance of Py and Vy";
CM_ SG_ 435 RFC_Obj29_VxVyCoVnce "Covariance of Vx and Vy";
CM_ SG_ 435 RFC_Obj29_PxAxCoVnce "Covariance of Px and Ax";
CM_ SG_ 435 RFC_Obj29_PxAyCoVnce "Covariance of Px and Ay";
CM_ SG_ 435 RFC_Obj29_PyAxCoVnce "Covariance of Py and Ax";
CM_ SG_ 435 RFC_Obj29_PyAyCoVnce "Covariance of Py and Ay";
CM_ SG_ 435 RFC_Obj29_VxAxCoVnce "Covariance of Vx and Ax";
CM_ SG_ 435 RFC_Obj29_VxAyCoVnce "Covariance of Vx and Ay";
CM_ SG_ 435 RFC_Obj29_VyAxCoVnce "Covariance of Vy and Ax";
CM_ SG_ 435 RFC_Obj29_VyAyCoVnce "Covariance of Vy and Ay";
CM_ SG_ 435 RFC_Obj29_AxAyCoVnce "Covariance of Ax and Ay";
CM_ SG_ 435 RFC_Obj29_MobileObstConf "Confidence of the object being a mobile obstacle. ISO 23150: Potentially moving object classification type  confidence (A.2.12)";
CM_ SG_ 435 RFC_Obj29_Mob4PlusWhlConf "Confidence of a mobile object which has 4 or more wheels. ISO 23150: Potentially moving object classification type  confidence (A.2.12)";
CM_ SG_ 435 RFC_Obj29_Mob2WhlConf "Confidence of a mobile object being 2-wheels vehicle. ISO 23150: Potentially moving object classification type  confidence (A.2.12)";
CM_ SG_ 435 RFC_Obj29_MobPedConf "Confidence of a mobile object being a pedestrian. ISO 23150: Potentially moving object classification type  confidence (A.2.12)";
CM_ SG_ 435 RFC_Obj29_FourPlusWhlCarConf "Confidence of a mobile object which has 4 or more wheels--passenger car. ISO 23150: Potentially moving object classification type  confidence (A.2.12)";
CM_ SG_ 435 RFC_Obj29_FourPlusWhlHGVConf "Confidence of a mobile object which has 4 or more wheels--commercial vehicle (Truck). ISO 23150: Potentially moving object classification type  confidence (A.2.12)";
CM_ SG_ 435 RFC_Obj29_GroundReflexConf "Confidence of the object being a ground reflex. ISO 23150: Potentially moving object classification type  confidence (A.2.12)";
CM_ SG_ 435 RFC_Obj29_StatObstConf "Confidence of the object being a stationary obstacle. ISO 23150: Potentially moving object classification type  confidence (A.2.12)";
CM_ SG_ 435 RFC_Obj29_StatBarrierConf "Confidence of the object being a stationary road barrier. ISO 23150: Potentially moving object classification type  confidence (A.2.12)";
CM_ SG_ 436 RFC_Obj30_CRC "CRC - Autosar E2E Profile 5";
CM_ SG_ 436 RFC_Obj30_AliveCtr "Alive counter - Autosar E2E Profile 5";
CM_ SG_ 436 RFC_Obj30_ProtBlockCtr "Protocol-Signal: Block-Counter";
CM_ SG_ 436 RFC_Obj30_ReferencePoint "Reference Point of the detected object. ISO 23150: Reference point (A.2.17)";
CM_ SG_ 436 RFC_Obj30_ObjId "Unique Object ID. ISO 23150: Object ID (A.2.2)";
CM_ SG_ 436 RFC_Obj30_MeasurementStatus "Object is measured or not. ISO 23150: Measurement status  object level (A.2.9)";
CM_ SG_ 436 RFC_Obj30_Px "Object position in X direction. ISO 23150: Position  object level {x, y, z} (A.2.13)";
CM_ SG_ 436 RFC_Obj30_Py "Object position in Y direction. ISO 23150: Position  object level {x, y, z} (A.2.13)";
CM_ SG_ 436 RFC_Obj30_PxVnce "Variance of object position in X direction. ISO 23150: Position  object level {x, y, z}  error (A.2.14)";
CM_ SG_ 436 RFC_Obj30_PyVnce "Variance of object position in Y direction. ISO 23150: Position  object level {x, y, z}  error (A.2.14)";
CM_ SG_ 436 RFC_Obj30_Vx "Object relative velocity in X direction. ISO 23150: Velocity {x, y, z}  object level (A.2.23)";
CM_ SG_ 436 RFC_Obj30_Vy "Object relative velocity in Y direction. ISO 23150: Velocity {x, y, z}  object level (A.2.23)";
CM_ SG_ 436 RFC_Obj30_Ax "Object relative acceleration in X direction. ISO 23150: Acceleration {x, y, z} (A.2.25)";
CM_ SG_ 436 RFC_Obj30_Ay "Object relative acceleration in Y direction. ISO 23150: Acceleration {x, y, z} (A.2.25)";
CM_ SG_ 436 RFC_Obj30_OrientationYaw "Object orientation yaw angle. ISO 23150: Orientation {yaw, pitch, roll} (A.2.15)";
CM_ SG_ 436 RFC_Obj30_ExistProb "Existence probability of object. ISO 23150: Existence probability  object level (A.2.1)";
CM_ SG_ 436 RFC_Obj30_VxVnce "Variance of object relative velocity in X direction. ISO 23150: Velocity {x, y, z}  object level  error (A.2.24)";
CM_ SG_ 436 RFC_Obj30_VyVnce "Variance of object relative velocity in Y direction. ISO 23150: Velocity {x, y, z}  object level  error (A.2.24)";
CM_ SG_ 436 RFC_Obj30_AxVnce "Variance of object relative acceleration in X direction. ISO 23150: Acceleration {x, y, z}  error (A.2.26)";
CM_ SG_ 436 RFC_Obj30_AyVnce "Variance of object relative acceleration in Y direction. ISO 23150: Acceleration {x, y, z}  error (A.2.26)";
CM_ SG_ 436 RFC_Obj30_OrientationYawVnce "Variance of object orientation yaw angle. ISO 23150: Orientation {yaw, pitch, roll}  error (A.2.16)";
CM_ SG_ 436 RFC_Obj30_MovingObserved "Object has been observed moving over the ground since it was first detected";
CM_ SG_ 436 RFC_Obj30_MovingProbability "Object has been observed moving over the ground";
CM_ SG_ 436 RFC_Obj30_Length "Object Length. ISO 23150: Bounding box extent {length, width, height} (A.2.19)";
CM_ SG_ 436 RFC_Obj30_Valid "Object is valid or not";
CM_ SG_ 436 RFC_Obj30_LengthVnce "Variance of object Length. ISO 23150: Bounding box extent {length, width, height}  error (A.2.20)";
CM_ SG_ 436 RFC_Obj30_WidthVnce "Variance of object Width. ISO 23150: Bounding box extent {length, width, height}  error (A.2.20)";
CM_ SG_ 436 RFC_Obj30_Width "Object Width. ISO 23150: Bounding box extent {length, width, height} (A.2.19)";
CM_ SG_ 436 RFC_Obj30_BehaviorType "Indicates that which behavior the object associated for";
CM_ SG_ 436 RFC_Obj30_ObstacleConf "Confidence of the object being an Obstacle. ISO 23150: Potentially moving object classification type  confidence (A.2.12)";
CM_ SG_ 436 RFC_Obj30_NonObstacleConf "Confidence of the object being a Non-Obstacle. ISO 23150: Potentially moving object classification type  confidence (A.2.12)";
CM_ SG_ 436 RFC_Obj30_PxPyCoVnce "Covariance of Px and Py";
CM_ SG_ 436 RFC_Obj30_PxVxCoVnce "Covariance of Px and Vx";
CM_ SG_ 436 RFC_Obj30_PxVyCoVnce "Covariance of Px and Vy";
CM_ SG_ 436 RFC_Obj30_PyVxCoVnce "Covariance of Py and Vx";
CM_ SG_ 436 RFC_Obj30_PyVyCoVnce "Covariance of Py and Vy";
CM_ SG_ 436 RFC_Obj30_VxVyCoVnce "Covariance of Vx and Vy";
CM_ SG_ 436 RFC_Obj30_PxAxCoVnce "Covariance of Px and Ax";
CM_ SG_ 436 RFC_Obj30_PxAyCoVnce "Covariance of Px and Ay";
CM_ SG_ 436 RFC_Obj30_PyAxCoVnce "Covariance of Py and Ax";
CM_ SG_ 436 RFC_Obj30_PyAyCoVnce "Covariance of Py and Ay";
CM_ SG_ 436 RFC_Obj30_VxAxCoVnce "Covariance of Vx and Ax";
CM_ SG_ 436 RFC_Obj30_VxAyCoVnce "Covariance of Vx and Ay";
CM_ SG_ 436 RFC_Obj30_VyAxCoVnce "Covariance of Vy and Ax";
CM_ SG_ 436 RFC_Obj30_VyAyCoVnce "Covariance of Vy and Ay";
CM_ SG_ 436 RFC_Obj30_AxAyCoVnce "Covariance of Ax and Ay";
CM_ SG_ 436 RFC_Obj30_MobileObstConf "Confidence of the object being a mobile obstacle. ISO 23150: Potentially moving object classification type  confidence (A.2.12)";
CM_ SG_ 436 RFC_Obj30_Mob4PlusWhlConf "Confidence of a mobile object which has 4 or more wheels. ISO 23150: Potentially moving object classification type  confidence (A.2.12)";
CM_ SG_ 436 RFC_Obj30_Mob2WhlConf "Confidence of a mobile object being 2-wheels vehicle. ISO 23150: Potentially moving object classification type  confidence (A.2.12)";
CM_ SG_ 436 RFC_Obj30_MobPedConf "Confidence of a mobile object being a pedestrian. ISO 23150: Potentially moving object classification type  confidence (A.2.12)";
CM_ SG_ 436 RFC_Obj30_FourPlusWhlCarConf "Confidence of a mobile object which has 4 or more wheels--passenger car. ISO 23150: Potentially moving object classification type  confidence (A.2.12)";
CM_ SG_ 436 RFC_Obj30_FourPlusWhlHGVConf "Confidence of a mobile object which has 4 or more wheels--commercial vehicle (Truck). ISO 23150: Potentially moving object classification type  confidence (A.2.12)";
CM_ SG_ 436 RFC_Obj30_GroundReflexConf "Confidence of the object being a ground reflex. ISO 23150: Potentially moving object classification type  confidence (A.2.12)";
CM_ SG_ 436 RFC_Obj30_StatObstConf "Confidence of the object being a stationary obstacle. ISO 23150: Potentially moving object classification type  confidence (A.2.12)";
CM_ SG_ 436 RFC_Obj30_StatBarrierConf "Confidence of the object being a stationary road barrier. ISO 23150: Potentially moving object classification type  confidence (A.2.12)";
CM_ SG_ 437 RFC_Obj31_CRC "CRC - Autosar E2E Profile 5";
CM_ SG_ 437 RFC_Obj31_AliveCtr "Alive counter - Autosar E2E Profile 5";
CM_ SG_ 437 RFC_Obj31_ProtBlockCtr "Protocol-Signal: Block-Counter";
CM_ SG_ 437 RFC_Obj31_ReferencePoint "Reference Point of the detected object. ISO 23150: Reference point (A.2.17)";
CM_ SG_ 437 RFC_Obj31_ObjId "Unique Object ID. ISO 23150: Object ID (A.2.2)";
CM_ SG_ 437 RFC_Obj31_MeasurementStatus "Object is measured or not. ISO 23150: Measurement status  object level (A.2.9)";
CM_ SG_ 437 RFC_Obj31_Px "Object position in X direction. ISO 23150: Position  object level {x, y, z} (A.2.13)";
CM_ SG_ 437 RFC_Obj31_Py "Object position in Y direction. ISO 23150: Position  object level {x, y, z} (A.2.13)";
CM_ SG_ 437 RFC_Obj31_PxVnce "Variance of object position in X direction. ISO 23150: Position  object level {x, y, z}  error (A.2.14)";
CM_ SG_ 437 RFC_Obj31_PyVnce "Variance of object position in Y direction. ISO 23150: Position  object level {x, y, z}  error (A.2.14)";
CM_ SG_ 437 RFC_Obj31_Vx "Object relative velocity in X direction. ISO 23150: Velocity {x, y, z}  object level (A.2.23)";
CM_ SG_ 437 RFC_Obj31_Vy "Object relative velocity in Y direction. ISO 23150: Velocity {x, y, z}  object level (A.2.23)";
CM_ SG_ 437 RFC_Obj31_Ax "Object relative acceleration in X direction. ISO 23150: Acceleration {x, y, z} (A.2.25)";
CM_ SG_ 437 RFC_Obj31_Ay "Object relative acceleration in Y direction. ISO 23150: Acceleration {x, y, z} (A.2.25)";
CM_ SG_ 437 RFC_Obj31_OrientationYaw "Object orientation yaw angle. ISO 23150: Orientation {yaw, pitch, roll} (A.2.15)";
CM_ SG_ 437 RFC_Obj31_ExistProb "Existence probability of object. ISO 23150: Existence probability  object level (A.2.1)";
CM_ SG_ 437 RFC_Obj31_VxVnce "Variance of object relative velocity in X direction. ISO 23150: Velocity {x, y, z}  object level  error (A.2.24)";
CM_ SG_ 437 RFC_Obj31_VyVnce "Variance of object relative velocity in Y direction. ISO 23150: Velocity {x, y, z}  object level  error (A.2.24)";
CM_ SG_ 437 RFC_Obj31_AxVnce "Variance of object relative acceleration in X direction. ISO 23150: Acceleration {x, y, z}  error (A.2.26)";
CM_ SG_ 437 RFC_Obj31_AyVnce "Variance of object relative acceleration in Y direction. ISO 23150: Acceleration {x, y, z}  error (A.2.26)";
CM_ SG_ 437 RFC_Obj31_OrientationYawVnce "Variance of object orientation yaw angle. ISO 23150: Orientation {yaw, pitch, roll}  error (A.2.16)";
CM_ SG_ 437 RFC_Obj31_MovingObserved "Object has been observed moving over the ground since it was first detected";
CM_ SG_ 437 RFC_Obj31_MovingProbability "Object has been observed moving over the ground";
CM_ SG_ 437 RFC_Obj31_Length "Object Length. ISO 23150: Bounding box extent {length, width, height} (A.2.19)";
CM_ SG_ 437 RFC_Obj31_Valid "Object is valid or not";
CM_ SG_ 437 RFC_Obj31_LengthVnce "Variance of object Length. ISO 23150: Bounding box extent {length, width, height}  error (A.2.20)";
CM_ SG_ 437 RFC_Obj31_WidthVnce "Variance of object Width. ISO 23150: Bounding box extent {length, width, height}  error (A.2.20)";
CM_ SG_ 437 RFC_Obj31_Width "Object Width. ISO 23150: Bounding box extent {length, width, height} (A.2.19)";
CM_ SG_ 437 RFC_Obj31_BehaviorType "Indicates that which behavior the object associated for";
CM_ SG_ 437 RFC_Obj31_ObstacleConf "Confidence of the object being an Obstacle. ISO 23150: Potentially moving object classification type  confidence (A.2.12)";
CM_ SG_ 437 RFC_Obj31_NonObstacleConf "Confidence of the object being a Non-Obstacle. ISO 23150: Potentially moving object classification type  confidence (A.2.12)";
CM_ SG_ 437 RFC_Obj31_PxPyCoVnce "Covariance of Px and Py";
CM_ SG_ 437 RFC_Obj31_PxVxCoVnce "Covariance of Px and Vx";
CM_ SG_ 437 RFC_Obj31_PxVyCoVnce "Covariance of Px and Vy";
CM_ SG_ 437 RFC_Obj31_PyVxCoVnce "Covariance of Py and Vx";
CM_ SG_ 437 RFC_Obj31_PyVyCoVnce "Covariance of Py and Vy";
CM_ SG_ 437 RFC_Obj31_VxVyCoVnce "Covariance of Vx and Vy";
CM_ SG_ 437 RFC_Obj31_PxAxCoVnce "Covariance of Px and Ax";
CM_ SG_ 437 RFC_Obj31_PxAyCoVnce "Covariance of Px and Ay";
CM_ SG_ 437 RFC_Obj31_PyAxCoVnce "Covariance of Py and Ax";
CM_ SG_ 437 RFC_Obj31_PyAyCoVnce "Covariance of Py and Ay";
CM_ SG_ 437 RFC_Obj31_VxAxCoVnce "Covariance of Vx and Ax";
CM_ SG_ 437 RFC_Obj31_VxAyCoVnce "Covariance of Vx and Ay";
CM_ SG_ 437 RFC_Obj31_VyAxCoVnce "Covariance of Vy and Ax";
CM_ SG_ 437 RFC_Obj31_VyAyCoVnce "Covariance of Vy and Ay";
CM_ SG_ 437 RFC_Obj31_AxAyCoVnce "Covariance of Ax and Ay";
CM_ SG_ 437 RFC_Obj31_MobileObstConf "Confidence of the object being a mobile obstacle. ISO 23150: Potentially moving object classification type  confidence (A.2.12)";
CM_ SG_ 437 RFC_Obj31_Mob4PlusWhlConf "Confidence of a mobile object which has 4 or more wheels. ISO 23150: Potentially moving object classification type  confidence (A.2.12)";
CM_ SG_ 437 RFC_Obj31_Mob2WhlConf "Confidence of a mobile object being 2-wheels vehicle. ISO 23150: Potentially moving object classification type  confidence (A.2.12)";
CM_ SG_ 437 RFC_Obj31_MobPedConf "Confidence of a mobile object being a pedestrian. ISO 23150: Potentially moving object classification type  confidence (A.2.12)";
CM_ SG_ 437 RFC_Obj31_FourPlusWhlCarConf "Confidence of a mobile object which has 4 or more wheels--passenger car. ISO 23150: Potentially moving object classification type  confidence (A.2.12)";
CM_ SG_ 437 RFC_Obj31_FourPlusWhlHGVConf "Confidence of a mobile object which has 4 or more wheels--commercial vehicle (Truck). ISO 23150: Potentially moving object classification type  confidence (A.2.12)";
CM_ SG_ 437 RFC_Obj31_GroundReflexConf "Confidence of the object being a ground reflex. ISO 23150: Potentially moving object classification type  confidence (A.2.12)";
CM_ SG_ 437 RFC_Obj31_StatObstConf "Confidence of the object being a stationary obstacle. ISO 23150: Potentially moving object classification type  confidence (A.2.12)";
CM_ SG_ 437 RFC_Obj31_StatBarrierConf "Confidence of the object being a stationary road barrier. ISO 23150: Potentially moving object classification type  confidence (A.2.12)";
CM_ SG_ 916 RFL_ObjHdr_CRC "CRC - Autosar E2E Profile 5";
CM_ SG_ 916 RFL_ObjHdr_AliveCtr "Alive counter - Autosar E2E Profile 5";
CM_ SG_ 916 RFL_ObjHdr_ProtBlockCtr "Protocol-Signal: Block-Counter";
CM_ SG_ 916 RFL_ObjHdr_IfVersionIdMajor "Version information of the interface. e. g. version 1.0: Major = 1. ISO 23150: Interface version ID {major, minor, patch} (A.1.1)";
CM_ SG_ 916 RFL_ObjHdr_IfVersionIdMinor "Version information of the interface. e. g. version 1.0: Minor = 0. ISO 23150: Interface version ID {major, minor, patch} (A.1.1)";
CM_ SG_ 916 RFL_ObjHdr_NumValidObjects "number of detected VALID Objects that have been sent to the bus. ISO 23150: Number of valid potentially moving objects (A.1.12.1)";
CM_ SG_ 916 RFL_ObjHdr_TimeStampStatus "Autosar StbM_TimeBaseStatusType bitfield with extension:
Bit 0: TIMEOUT
Bit 1: Reserved1
Bit 2: SYNC_TO_GATEWAY
Bit 3: GLOBAL_TIME_BASE
Bit 4: TIMELEAP_FUTURE
Bit 5: TIMELEAP_PAST
Bit 6: Reserved6
Bit 7: Extension: GENERAL_ERROR";
CM_ SG_ 916 RFL_ObjHdr_TimeStamp "Time Stamp. ISO 23150: Time stamp  predicted (A.1.5.1)";
CM_ SG_ 916 RFL_ObjHdr_SensorState "Bit 0: HW MALFUNCTION
Bit 1: DSP ISSUES
Bit 2: COMMUNICATION ERRORS
Bit 3: MISALIGNMENT (OUT OF SPEC)
Bit 4: SENSOR BLIDNESS DETECTED
Bit 5: SENSOR DISTURBED
Bit 6: OTHER ISSUES
Bit 7: RESERVED
Value 0: no event
Value 1: event occured";
CM_ SG_ 916 RFL_ObjHdr_AziOutOfSpec "The sensor was detected to be out-of-spec due to misalignment in azimuth";
CM_ SG_ 916 RFL_ObjHdr_ElevOutOfSpec "The sensor was detected to be out-of-spec due to misalignment in elevation";
CM_ SG_ 916 RFL_ObjHdr_ObjectDownSel "the detected number of objects exceeded the number of max. objects that can be transmitted";
CM_ SG_ 916 RFL_ObjHdr_SensorOriginPointY "Position of origin of sensor in lateral direction relative to mid axis of vehicle. ISO 23150: Sensor origin point {x, y, z} (A.1.22)";
CM_ SG_ 916 RFL_ObjHdr_SensorOriginPointX "Position of origin of sensor in longitudinal direction relative to rear axis of vehicle. ISO 23150: Sensor origin point {x, y, z} (A.1.22)";
CM_ SG_ 916 RFL_ObjHdr_SensorOriginPointZ "Position of origin of sensor in elevation direction relative to ground. ISO 23150: Sensor origin point {x, y, z} (A.1.22)";
CM_ SG_ 916 RFL_ObjHdr_SensorOrientYaw "angle between sensor mounting direction and vehicle longitudinal axis, Azimuth. ISO 23150: Sensor orientation {yaw, pitch, roll} (A.1.24)";
CM_ SG_ 916 RFL_ObjHdr_SensorOrientPitch "angle between sensor mounting direction and vehicle longitudinal axis, Elevation. ISO 23150: Sensor orientation {yaw, pitch, roll} (A.1.24)";
CM_ SG_ 916 RFL_ObjHdr_SensorOrientRoll "Tilt of the mounting sensor. ISO 23150: Sensor orientation {yaw, pitch, roll} (A.1.24)";
CM_ SG_ 916 RFL_ObjHdr_FovAzimuthBegin "Lower angle of the fied of view Azimuth. ISO 23150: Segment azimuth {begin, end} (A.5.1)";
CM_ SG_ 916 RFL_ObjHdr_FovAzimuthEnd "Upper angle of the field of view Azimuth. ISO 23150: Segment azimuth {begin, end} (A.5.1)";
CM_ SG_ 916 RFL_ObjHdr_FovElevationBegin "Lower angle of the fied of view Elevation. ISO 23150: Segment elevation {begin, end} (A.5.2)";
CM_ SG_ 916 RFL_ObjHdr_FovElevationEnd "Upper angle of the field of view Elevation. ISO 23150: Segment elevation {begin, end} (A.5.2)";
CM_ SG_ 916 RFL_ObjHdr_DetectionRange "Estimated detection range of the sensor";
CM_ SG_ 916 RFL_ObjHdr_TimeStampLocal "Local Time Stamp";
CM_ SG_ 918 RFL_Obj00_CRC "CRC - Autosar E2E Profile 5";
CM_ SG_ 918 RFL_Obj00_AliveCtr "Alive counter - Autosar E2E Profile 5";
CM_ SG_ 918 RFL_Obj00_ProtBlockCtr "Protocol-Signal: Block-Counter";
CM_ SG_ 918 RFL_Obj00_ReferencePoint "Reference Point of the detected object. ISO 23150: Reference point (A.2.17)";
CM_ SG_ 918 RFL_Obj00_ObjId "Unique Object ID. ISO 23150: Object ID (A.2.2)";
CM_ SG_ 918 RFL_Obj00_MeasurementStatus "Object is measured or not. ISO 23150: Measurement status  object level (A.2.9)";
CM_ SG_ 918 RFL_Obj00_Px "Object position in X direction. ISO 23150: Position  object level {x, y, z} (A.2.13)";
CM_ SG_ 918 RFL_Obj00_Py "Object position in Y direction. ISO 23150: Position  object level {x, y, z} (A.2.13)";
CM_ SG_ 918 RFL_Obj00_PxVnce "Variance of object position in X direction. ISO 23150: Position  object level {x, y, z}  error (A.2.14)";
CM_ SG_ 918 RFL_Obj00_PyVnce "Variance of object position in Y direction. ISO 23150: Position  object level {x, y, z}  error (A.2.14)";
CM_ SG_ 918 RFL_Obj00_Vx "Object relative velocity in X direction. ISO 23150: Velocity {x, y, z}  object level (A.2.23)";
CM_ SG_ 918 RFL_Obj00_Vy "Object relative velocity in Y direction. ISO 23150: Velocity {x, y, z}  object level (A.2.23)";
CM_ SG_ 918 RFL_Obj00_Ax "Object relative acceleration in X direction. ISO 23150: Acceleration {x, y, z} (A.2.25)";
CM_ SG_ 918 RFL_Obj00_Ay "Object relative acceleration in Y direction. ISO 23150: Acceleration {x, y, z} (A.2.25)";
CM_ SG_ 918 RFL_Obj00_OrientationYaw "Object orientation yaw angle. ISO 23150: Orientation {yaw, pitch, roll} (A.2.15)";
CM_ SG_ 918 RFL_Obj00_ExistProb "Existence probability of object. ISO 23150: Existence probability  object level (A.2.1)";
CM_ SG_ 918 RFL_Obj00_VxVnce "Variance of object relative velocity in X direction. ISO 23150: Velocity {x, y, z}  object level  error (A.2.24)";
CM_ SG_ 918 RFL_Obj00_VyVnce "Variance of object relative velocity in Y direction. ISO 23150: Velocity {x, y, z}  object level  error (A.2.24)";
CM_ SG_ 918 RFL_Obj00_AxVnce "Variance of object relative acceleration in X direction. ISO 23150: Acceleration {x, y, z}  error (A.2.26)";
CM_ SG_ 918 RFL_Obj00_AyVnce "Variance of object relative acceleration in Y direction. ISO 23150: Acceleration {x, y, z}  error (A.2.26)";
CM_ SG_ 918 RFL_Obj00_OrientationYawVnce "Variance of object orientation yaw angle. ISO 23150: Orientation {yaw, pitch, roll}  error (A.2.16)";
CM_ SG_ 918 RFL_Obj00_MovingObserved "Object has been observed moving over the ground since it was first detected";
CM_ SG_ 918 RFL_Obj00_MovingProbability "Object has been observed moving over the ground";
CM_ SG_ 918 RFL_Obj00_Length "Object Length. ISO 23150: Bounding box extent {length, width, height} (A.2.19)";
CM_ SG_ 918 RFL_Obj00_Valid "Object is valid or not";
CM_ SG_ 918 RFL_Obj00_LengthVnce "Variance of object Length. ISO 23150: Bounding box extent {length, width, height}  error (A.2.20)";
CM_ SG_ 918 RFL_Obj00_WidthVnce "Variance of object Width. ISO 23150: Bounding box extent {length, width, height}  error (A.2.20)";
CM_ SG_ 918 RFL_Obj00_Width "Object Width. ISO 23150: Bounding box extent {length, width, height} (A.2.19)";
CM_ SG_ 918 RFL_Obj00_BehaviorType "Indicates that which behavior the object associated for";
CM_ SG_ 918 RFL_Obj00_ObstacleConf "Confidence of the object being an Obstacle. ISO 23150: Potentially moving object classification type  confidence (A.2.12)";
CM_ SG_ 918 RFL_Obj00_NonObstacleConf "Confidence of the object being a Non-Obstacle. ISO 23150: Potentially moving object classification type  confidence (A.2.12)";
CM_ SG_ 918 RFL_Obj00_PxPyCoVnce "Covariance of Px and Py";
CM_ SG_ 918 RFL_Obj00_PxVxCoVnce "Covariance of Px and Vx";
CM_ SG_ 918 RFL_Obj00_PxVyCoVnce "Covariance of Px and Vy";
CM_ SG_ 918 RFL_Obj00_PyVxCoVnce "Covariance of Py and Vx";
CM_ SG_ 918 RFL_Obj00_PyVyCoVnce "Covariance of Py and Vy";
CM_ SG_ 918 RFL_Obj00_VxVyCoVnce "Covariance of Vx and Vy";
CM_ SG_ 918 RFL_Obj00_PxAxCoVnce "Covariance of Px and Ax";
CM_ SG_ 918 RFL_Obj00_PxAyCoVnce "Covariance of Px and Ay";
CM_ SG_ 918 RFL_Obj00_PyAxCoVnce "Covariance of Py and Ax";
CM_ SG_ 918 RFL_Obj00_PyAyCoVnce "Covariance of Py and Ay";
CM_ SG_ 918 RFL_Obj00_VxAxCoVnce "Covariance of Vx and Ax";
CM_ SG_ 918 RFL_Obj00_VxAyCoVnce "Covariance of Vx and Ay";
CM_ SG_ 918 RFL_Obj00_VyAxCoVnce "Covariance of Vy and Ax";
CM_ SG_ 918 RFL_Obj00_VyAyCoVnce "Covariance of Vy and Ay";
CM_ SG_ 918 RFL_Obj00_AxAyCoVnce "Covariance of Ax and Ay";
CM_ SG_ 918 RFL_Obj00_MobileObstConf "Confidence of the object being a mobile obstacle. ISO 23150: Potentially moving object classification type  confidence (A.2.12)";
CM_ SG_ 918 RFL_Obj00_Mob4PlusWhlConf "Confidence of a mobile object which has 4 or more wheels. ISO 23150: Potentially moving object classification type  confidence (A.2.12)";
CM_ SG_ 918 RFL_Obj00_Mob2WhlConf "Confidence of a mobile object being 2-wheels vehicle. ISO 23150: Potentially moving object classification type  confidence (A.2.12)";
CM_ SG_ 918 RFL_Obj00_MobPedConf "Confidence of a mobile object being a pedestrian. ISO 23150: Potentially moving object classification type  confidence (A.2.12)";
CM_ SG_ 918 RFL_Obj00_FourPlusWhlCarConf "Confidence of a mobile object which has 4 or more wheels--passenger car. ISO 23150: Potentially moving object classification type  confidence (A.2.12)";
CM_ SG_ 918 RFL_Obj00_FourPlusWhlHGVConf "Confidence of a mobile object which has 4 or more wheels--commercial vehicle (Truck). ISO 23150: Potentially moving object classification type  confidence (A.2.12)";
CM_ SG_ 918 RFL_Obj00_GroundReflexConf "Confidence of the object being a ground reflex. ISO 23150: Potentially moving object classification type  confidence (A.2.12)";
CM_ SG_ 918 RFL_Obj00_StatObstConf "Confidence of the object being a stationary obstacle. ISO 23150: Potentially moving object classification type  confidence (A.2.12)";
CM_ SG_ 918 RFL_Obj00_StatBarrierConf "Confidence of the object being a stationary road barrier. ISO 23150: Potentially moving object classification type  confidence (A.2.12)";
CM_ SG_ 919 RFL_Obj01_CRC "CRC - Autosar E2E Profile 5";
CM_ SG_ 919 RFL_Obj01_AliveCtr "Alive counter - Autosar E2E Profile 5";
CM_ SG_ 919 RFL_Obj01_ProtBlockCtr "Protocol-Signal: Block-Counter";
CM_ SG_ 919 RFL_Obj01_ReferencePoint "Reference Point of the detected object. ISO 23150: Reference point (A.2.17)";
CM_ SG_ 919 RFL_Obj01_ObjId "Unique Object ID. ISO 23150: Object ID (A.2.2)";
CM_ SG_ 919 RFL_Obj01_MeasurementStatus "Object is measured or not. ISO 23150: Measurement status  object level (A.2.9)";
CM_ SG_ 919 RFL_Obj01_Px "Object position in X direction. ISO 23150: Position  object level {x, y, z} (A.2.13)";
CM_ SG_ 919 RFL_Obj01_Py "Object position in Y direction. ISO 23150: Position  object level {x, y, z} (A.2.13)";
CM_ SG_ 919 RFL_Obj01_PxVnce "Variance of object position in X direction. ISO 23150: Position  object level {x, y, z}  error (A.2.14)";
CM_ SG_ 919 RFL_Obj01_PyVnce "Variance of object position in Y direction. ISO 23150: Position  object level {x, y, z}  error (A.2.14)";
CM_ SG_ 919 RFL_Obj01_Vx "Object relative velocity in X direction. ISO 23150: Velocity {x, y, z}  object level (A.2.23)";
CM_ SG_ 919 RFL_Obj01_Vy "Object relative velocity in Y direction. ISO 23150: Velocity {x, y, z}  object level (A.2.23)";
CM_ SG_ 919 RFL_Obj01_Ax "Object relative acceleration in X direction. ISO 23150: Acceleration {x, y, z} (A.2.25)";
CM_ SG_ 919 RFL_Obj01_Ay "Object relative acceleration in Y direction. ISO 23150: Acceleration {x, y, z} (A.2.25)";
CM_ SG_ 919 RFL_Obj01_OrientationYaw "Object orientation yaw angle. ISO 23150: Orientation {yaw, pitch, roll} (A.2.15)";
CM_ SG_ 919 RFL_Obj01_ExistProb "Existence probability of object. ISO 23150: Existence probability  object level (A.2.1)";
CM_ SG_ 919 RFL_Obj01_VxVnce "Variance of object relative velocity in X direction. ISO 23150: Velocity {x, y, z}  object level  error (A.2.24)";
CM_ SG_ 919 RFL_Obj01_VyVnce "Variance of object relative velocity in Y direction. ISO 23150: Velocity {x, y, z}  object level  error (A.2.24)";
CM_ SG_ 919 RFL_Obj01_AxVnce "Variance of object relative acceleration in X direction. ISO 23150: Acceleration {x, y, z}  error (A.2.26)";
CM_ SG_ 919 RFL_Obj01_AyVnce "Variance of object relative acceleration in Y direction. ISO 23150: Acceleration {x, y, z}  error (A.2.26)";
CM_ SG_ 919 RFL_Obj01_OrientationYawVnce "Variance of object orientation yaw angle. ISO 23150: Orientation {yaw, pitch, roll}  error (A.2.16)";
CM_ SG_ 919 RFL_Obj01_MovingObserved "Object has been observed moving over the ground since it was first detected";
CM_ SG_ 919 RFL_Obj01_MovingProbability "Object has been observed moving over the ground";
CM_ SG_ 919 RFL_Obj01_Length "Object Length. ISO 23150: Bounding box extent {length, width, height} (A.2.19)";
CM_ SG_ 919 RFL_Obj01_Valid "Object is valid or not";
CM_ SG_ 919 RFL_Obj01_LengthVnce "Variance of object Length. ISO 23150: Bounding box extent {length, width, height}  error (A.2.20)";
CM_ SG_ 919 RFL_Obj01_WidthVnce "Variance of object Width. ISO 23150: Bounding box extent {length, width, height}  error (A.2.20)";
CM_ SG_ 919 RFL_Obj01_Width "Object Width. ISO 23150: Bounding box extent {length, width, height} (A.2.19)";
CM_ SG_ 919 RFL_Obj01_BehaviorType "Indicates that which behavior the object associated for";
CM_ SG_ 919 RFL_Obj01_ObstacleConf "Confidence of the object being an Obstacle. ISO 23150: Potentially moving object classification type  confidence (A.2.12)";
CM_ SG_ 919 RFL_Obj01_NonObstacleConf "Confidence of the object being a Non-Obstacle. ISO 23150: Potentially moving object classification type  confidence (A.2.12)";
CM_ SG_ 919 RFL_Obj01_PxPyCoVnce "Covariance of Px and Py";
CM_ SG_ 919 RFL_Obj01_PxVxCoVnce "Covariance of Px and Vx";
CM_ SG_ 919 RFL_Obj01_PxVyCoVnce "Covariance of Px and Vy";
CM_ SG_ 919 RFL_Obj01_PyVxCoVnce "Covariance of Py and Vx";
CM_ SG_ 919 RFL_Obj01_PyVyCoVnce "Covariance of Py and Vy";
CM_ SG_ 919 RFL_Obj01_VxVyCoVnce "Covariance of Vx and Vy";
CM_ SG_ 919 RFL_Obj01_PxAxCoVnce "Covariance of Px and Ax";
CM_ SG_ 919 RFL_Obj01_PxAyCoVnce "Covariance of Px and Ay";
CM_ SG_ 919 RFL_Obj01_PyAxCoVnce "Covariance of Py and Ax";
CM_ SG_ 919 RFL_Obj01_PyAyCoVnce "Covariance of Py and Ay";
CM_ SG_ 919 RFL_Obj01_VxAxCoVnce "Covariance of Vx and Ax";
CM_ SG_ 919 RFL_Obj01_VxAyCoVnce "Covariance of Vx and Ay";
CM_ SG_ 919 RFL_Obj01_VyAxCoVnce "Covariance of Vy and Ax";
CM_ SG_ 919 RFL_Obj01_VyAyCoVnce "Covariance of Vy and Ay";
CM_ SG_ 919 RFL_Obj01_AxAyCoVnce "Covariance of Ax and Ay";
CM_ SG_ 919 RFL_Obj01_MobileObstConf "Confidence of the object being a mobile obstacle. ISO 23150: Potentially moving object classification type  confidence (A.2.12)";
CM_ SG_ 919 RFL_Obj01_Mob4PlusWhlConf "Confidence of a mobile object which has 4 or more wheels. ISO 23150: Potentially moving object classification type  confidence (A.2.12)";
CM_ SG_ 919 RFL_Obj01_Mob2WhlConf "Confidence of a mobile object being 2-wheels vehicle. ISO 23150: Potentially moving object classification type  confidence (A.2.12)";
CM_ SG_ 919 RFL_Obj01_MobPedConf "Confidence of a mobile object being a pedestrian. ISO 23150: Potentially moving object classification type  confidence (A.2.12)";
CM_ SG_ 919 RFL_Obj01_FourPlusWhlCarConf "Confidence of a mobile object which has 4 or more wheels--passenger car. ISO 23150: Potentially moving object classification type  confidence (A.2.12)";
CM_ SG_ 919 RFL_Obj01_FourPlusWhlHGVConf "Confidence of a mobile object which has 4 or more wheels--commercial vehicle (Truck). ISO 23150: Potentially moving object classification type  confidence (A.2.12)";
CM_ SG_ 919 RFL_Obj01_GroundReflexConf "Confidence of the object being a ground reflex. ISO 23150: Potentially moving object classification type  confidence (A.2.12)";
CM_ SG_ 919 RFL_Obj01_StatObstConf "Confidence of the object being a stationary obstacle. ISO 23150: Potentially moving object classification type  confidence (A.2.12)";
CM_ SG_ 919 RFL_Obj01_StatBarrierConf "Confidence of the object being a stationary road barrier. ISO 23150: Potentially moving object classification type  confidence (A.2.12)";
CM_ SG_ 920 RFL_Obj02_CRC "CRC - Autosar E2E Profile 5";
CM_ SG_ 920 RFL_Obj02_AliveCtr "Alive counter - Autosar E2E Profile 5";
CM_ SG_ 920 RFL_Obj02_ProtBlockCtr "Protocol-Signal: Block-Counter";
CM_ SG_ 920 RFL_Obj02_ReferencePoint "Reference Point of the detected object. ISO 23150: Reference point (A.2.17)";
CM_ SG_ 920 RFL_Obj02_ObjId "Unique Object ID. ISO 23150: Object ID (A.2.2)";
CM_ SG_ 920 RFL_Obj02_MeasurementStatus "Object is measured or not. ISO 23150: Measurement status  object level (A.2.9)";
CM_ SG_ 920 RFL_Obj02_Px "Object position in X direction. ISO 23150: Position  object level {x, y, z} (A.2.13)";
CM_ SG_ 920 RFL_Obj02_Py "Object position in Y direction. ISO 23150: Position  object level {x, y, z} (A.2.13)";
CM_ SG_ 920 RFL_Obj02_PxVnce "Variance of object position in X direction. ISO 23150: Position  object level {x, y, z}  error (A.2.14)";
CM_ SG_ 920 RFL_Obj02_PyVnce "Variance of object position in Y direction. ISO 23150: Position  object level {x, y, z}  error (A.2.14)";
CM_ SG_ 920 RFL_Obj02_Vx "Object relative velocity in X direction. ISO 23150: Velocity {x, y, z}  object level (A.2.23)";
CM_ SG_ 920 RFL_Obj02_Vy "Object relative velocity in Y direction. ISO 23150: Velocity {x, y, z}  object level (A.2.23)";
CM_ SG_ 920 RFL_Obj02_Ax "Object relative acceleration in X direction. ISO 23150: Acceleration {x, y, z} (A.2.25)";
CM_ SG_ 920 RFL_Obj02_Ay "Object relative acceleration in Y direction. ISO 23150: Acceleration {x, y, z} (A.2.25)";
CM_ SG_ 920 RFL_Obj02_OrientationYaw "Object orientation yaw angle. ISO 23150: Orientation {yaw, pitch, roll} (A.2.15)";
CM_ SG_ 920 RFL_Obj02_ExistProb "Existence probability of object. ISO 23150: Existence probability  object level (A.2.1)";
CM_ SG_ 920 RFL_Obj02_VxVnce "Variance of object relative velocity in X direction. ISO 23150: Velocity {x, y, z}  object level  error (A.2.24)";
CM_ SG_ 920 RFL_Obj02_VyVnce "Variance of object relative velocity in Y direction. ISO 23150: Velocity {x, y, z}  object level  error (A.2.24)";
CM_ SG_ 920 RFL_Obj02_AxVnce "Variance of object relative acceleration in X direction. ISO 23150: Acceleration {x, y, z}  error (A.2.26)";
CM_ SG_ 920 RFL_Obj02_AyVnce "Variance of object relative acceleration in Y direction. ISO 23150: Acceleration {x, y, z}  error (A.2.26)";
CM_ SG_ 920 RFL_Obj02_OrientationYawVnce "Variance of object orientation yaw angle. ISO 23150: Orientation {yaw, pitch, roll}  error (A.2.16)";
CM_ SG_ 920 RFL_Obj02_MovingObserved "Object has been observed moving over the ground since it was first detected";
CM_ SG_ 920 RFL_Obj02_MovingProbability "Object has been observed moving over the ground";
CM_ SG_ 920 RFL_Obj02_Length "Object Length. ISO 23150: Bounding box extent {length, width, height} (A.2.19)";
CM_ SG_ 920 RFL_Obj02_Valid "Object is valid or not";
CM_ SG_ 920 RFL_Obj02_LengthVnce "Variance of object Length. ISO 23150: Bounding box extent {length, width, height}  error (A.2.20)";
CM_ SG_ 920 RFL_Obj02_WidthVnce "Variance of object Width. ISO 23150: Bounding box extent {length, width, height}  error (A.2.20)";
CM_ SG_ 920 RFL_Obj02_Width "Object Width. ISO 23150: Bounding box extent {length, width, height} (A.2.19)";
CM_ SG_ 920 RFL_Obj02_BehaviorType "Indicates that which behavior the object associated for";
CM_ SG_ 920 RFL_Obj02_ObstacleConf "Confidence of the object being an Obstacle. ISO 23150: Potentially moving object classification type  confidence (A.2.12)";
CM_ SG_ 920 RFL_Obj02_NonObstacleConf "Confidence of the object being a Non-Obstacle. ISO 23150: Potentially moving object classification type  confidence (A.2.12)";
CM_ SG_ 920 RFL_Obj02_PxPyCoVnce "Covariance of Px and Py";
CM_ SG_ 920 RFL_Obj02_PxVxCoVnce "Covariance of Px and Vx";
CM_ SG_ 920 RFL_Obj02_PxVyCoVnce "Covariance of Px and Vy";
CM_ SG_ 920 RFL_Obj02_PyVxCoVnce "Covariance of Py and Vx";
CM_ SG_ 920 RFL_Obj02_PyVyCoVnce "Covariance of Py and Vy";
CM_ SG_ 920 RFL_Obj02_VxVyCoVnce "Covariance of Vx and Vy";
CM_ SG_ 920 RFL_Obj02_PxAxCoVnce "Covariance of Px and Ax";
CM_ SG_ 920 RFL_Obj02_PxAyCoVnce "Covariance of Px and Ay";
CM_ SG_ 920 RFL_Obj02_PyAxCoVnce "Covariance of Py and Ax";
CM_ SG_ 920 RFL_Obj02_PyAyCoVnce "Covariance of Py and Ay";
CM_ SG_ 920 RFL_Obj02_VxAxCoVnce "Covariance of Vx and Ax";
CM_ SG_ 920 RFL_Obj02_VxAyCoVnce "Covariance of Vx and Ay";
CM_ SG_ 920 RFL_Obj02_VyAxCoVnce "Covariance of Vy and Ax";
CM_ SG_ 920 RFL_Obj02_VyAyCoVnce "Covariance of Vy and Ay";
CM_ SG_ 920 RFL_Obj02_AxAyCoVnce "Covariance of Ax and Ay";
CM_ SG_ 920 RFL_Obj02_MobileObstConf "Confidence of the object being a mobile obstacle. ISO 23150: Potentially moving object classification type  confidence (A.2.12)";
CM_ SG_ 920 RFL_Obj02_Mob4PlusWhlConf "Confidence of a mobile object which has 4 or more wheels. ISO 23150: Potentially moving object classification type  confidence (A.2.12)";
CM_ SG_ 920 RFL_Obj02_Mob2WhlConf "Confidence of a mobile object being 2-wheels vehicle. ISO 23150: Potentially moving object classification type  confidence (A.2.12)";
CM_ SG_ 920 RFL_Obj02_MobPedConf "Confidence of a mobile object being a pedestrian. ISO 23150: Potentially moving object classification type  confidence (A.2.12)";
CM_ SG_ 920 RFL_Obj02_FourPlusWhlCarConf "Confidence of a mobile object which has 4 or more wheels--passenger car. ISO 23150: Potentially moving object classification type  confidence (A.2.12)";
CM_ SG_ 920 RFL_Obj02_FourPlusWhlHGVConf "Confidence of a mobile object which has 4 or more wheels--commercial vehicle (Truck). ISO 23150: Potentially moving object classification type  confidence (A.2.12)";
CM_ SG_ 920 RFL_Obj02_GroundReflexConf "Confidence of the object being a ground reflex. ISO 23150: Potentially moving object classification type  confidence (A.2.12)";
CM_ SG_ 920 RFL_Obj02_StatObstConf "Confidence of the object being a stationary obstacle. ISO 23150: Potentially moving object classification type  confidence (A.2.12)";
CM_ SG_ 920 RFL_Obj02_StatBarrierConf "Confidence of the object being a stationary road barrier. ISO 23150: Potentially moving object classification type  confidence (A.2.12)";
CM_ SG_ 921 RFL_Obj03_CRC "CRC - Autosar E2E Profile 5";
CM_ SG_ 921 RFL_Obj03_AliveCtr "Alive counter - Autosar E2E Profile 5";
CM_ SG_ 921 RFL_Obj03_ProtBlockCtr "Protocol-Signal: Block-Counter";
CM_ SG_ 921 RFL_Obj03_ReferencePoint "Reference Point of the detected object. ISO 23150: Reference point (A.2.17)";
CM_ SG_ 921 RFL_Obj03_ObjId "Unique Object ID. ISO 23150: Object ID (A.2.2)";
CM_ SG_ 921 RFL_Obj03_MeasurementStatus "Object is measured or not. ISO 23150: Measurement status  object level (A.2.9)";
CM_ SG_ 921 RFL_Obj03_Px "Object position in X direction. ISO 23150: Position  object level {x, y, z} (A.2.13)";
CM_ SG_ 921 RFL_Obj03_Py "Object position in Y direction. ISO 23150: Position  object level {x, y, z} (A.2.13)";
CM_ SG_ 921 RFL_Obj03_PxVnce "Variance of object position in X direction. ISO 23150: Position  object level {x, y, z}  error (A.2.14)";
CM_ SG_ 921 RFL_Obj03_PyVnce "Variance of object position in Y direction. ISO 23150: Position  object level {x, y, z}  error (A.2.14)";
CM_ SG_ 921 RFL_Obj03_Vx "Object relative velocity in X direction. ISO 23150: Velocity {x, y, z}  object level (A.2.23)";
CM_ SG_ 921 RFL_Obj03_Vy "Object relative velocity in Y direction. ISO 23150: Velocity {x, y, z}  object level (A.2.23)";
CM_ SG_ 921 RFL_Obj03_Ax "Object relative acceleration in X direction. ISO 23150: Acceleration {x, y, z} (A.2.25)";
CM_ SG_ 921 RFL_Obj03_Ay "Object relative acceleration in Y direction. ISO 23150: Acceleration {x, y, z} (A.2.25)";
CM_ SG_ 921 RFL_Obj03_OrientationYaw "Object orientation yaw angle. ISO 23150: Orientation {yaw, pitch, roll} (A.2.15)";
CM_ SG_ 921 RFL_Obj03_ExistProb "Existence probability of object. ISO 23150: Existence probability  object level (A.2.1)";
CM_ SG_ 921 RFL_Obj03_VxVnce "Variance of object relative velocity in X direction. ISO 23150: Velocity {x, y, z}  object level  error (A.2.24)";
CM_ SG_ 921 RFL_Obj03_VyVnce "Variance of object relative velocity in Y direction. ISO 23150: Velocity {x, y, z}  object level  error (A.2.24)";
CM_ SG_ 921 RFL_Obj03_AxVnce "Variance of object relative acceleration in X direction. ISO 23150: Acceleration {x, y, z}  error (A.2.26)";
CM_ SG_ 921 RFL_Obj03_AyVnce "Variance of object relative acceleration in Y direction. ISO 23150: Acceleration {x, y, z}  error (A.2.26)";
CM_ SG_ 921 RFL_Obj03_OrientationYawVnce "Variance of object orientation yaw angle. ISO 23150: Orientation {yaw, pitch, roll}  error (A.2.16)";
CM_ SG_ 921 RFL_Obj03_MovingObserved "Object has been observed moving over the ground since it was first detected";
CM_ SG_ 921 RFL_Obj03_MovingProbability "Object has been observed moving over the ground";
CM_ SG_ 921 RFL_Obj03_Length "Object Length. ISO 23150: Bounding box extent {length, width, height} (A.2.19)";
CM_ SG_ 921 RFL_Obj03_Valid "Object is valid or not";
CM_ SG_ 921 RFL_Obj03_LengthVnce "Variance of object Length. ISO 23150: Bounding box extent {length, width, height}  error (A.2.20)";
CM_ SG_ 921 RFL_Obj03_WidthVnce "Variance of object Width. ISO 23150: Bounding box extent {length, width, height}  error (A.2.20)";
CM_ SG_ 921 RFL_Obj03_Width "Object Width. ISO 23150: Bounding box extent {length, width, height} (A.2.19)";
CM_ SG_ 921 RFL_Obj03_BehaviorType "Indicates that which behavior the object associated for";
CM_ SG_ 921 RFL_Obj03_ObstacleConf "Confidence of the object being an Obstacle. ISO 23150: Potentially moving object classification type  confidence (A.2.12)";
CM_ SG_ 921 RFL_Obj03_NonObstacleConf "Confidence of the object being a Non-Obstacle. ISO 23150: Potentially moving object classification type  confidence (A.2.12)";
CM_ SG_ 921 RFL_Obj03_PxPyCoVnce "Covariance of Px and Py";
CM_ SG_ 921 RFL_Obj03_PxVxCoVnce "Covariance of Px and Vx";
CM_ SG_ 921 RFL_Obj03_PxVyCoVnce "Covariance of Px and Vy";
CM_ SG_ 921 RFL_Obj03_PyVxCoVnce "Covariance of Py and Vx";
CM_ SG_ 921 RFL_Obj03_PyVyCoVnce "Covariance of Py and Vy";
CM_ SG_ 921 RFL_Obj03_VxVyCoVnce "Covariance of Vx and Vy";
CM_ SG_ 921 RFL_Obj03_PxAxCoVnce "Covariance of Px and Ax";
CM_ SG_ 921 RFL_Obj03_PxAyCoVnce "Covariance of Px and Ay";
CM_ SG_ 921 RFL_Obj03_PyAxCoVnce "Covariance of Py and Ax";
CM_ SG_ 921 RFL_Obj03_PyAyCoVnce "Covariance of Py and Ay";
CM_ SG_ 921 RFL_Obj03_VxAxCoVnce "Covariance of Vx and Ax";
CM_ SG_ 921 RFL_Obj03_VxAyCoVnce "Covariance of Vx and Ay";
CM_ SG_ 921 RFL_Obj03_VyAxCoVnce "Covariance of Vy and Ax";
CM_ SG_ 921 RFL_Obj03_VyAyCoVnce "Covariance of Vy and Ay";
CM_ SG_ 921 RFL_Obj03_AxAyCoVnce "Covariance of Ax and Ay";
CM_ SG_ 921 RFL_Obj03_MobileObstConf "Confidence of the object being a mobile obstacle. ISO 23150: Potentially moving object classification type  confidence (A.2.12)";
CM_ SG_ 921 RFL_Obj03_Mob4PlusWhlConf "Confidence of a mobile object which has 4 or more wheels. ISO 23150: Potentially moving object classification type  confidence (A.2.12)";
CM_ SG_ 921 RFL_Obj03_Mob2WhlConf "Confidence of a mobile object being 2-wheels vehicle. ISO 23150: Potentially moving object classification type  confidence (A.2.12)";
CM_ SG_ 921 RFL_Obj03_MobPedConf "Confidence of a mobile object being a pedestrian. ISO 23150: Potentially moving object classification type  confidence (A.2.12)";
CM_ SG_ 921 RFL_Obj03_FourPlusWhlCarConf "Confidence of a mobile object which has 4 or more wheels--passenger car. ISO 23150: Potentially moving object classification type  confidence (A.2.12)";
CM_ SG_ 921 RFL_Obj03_FourPlusWhlHGVConf "Confidence of a mobile object which has 4 or more wheels--commercial vehicle (Truck). ISO 23150: Potentially moving object classification type  confidence (A.2.12)";
CM_ SG_ 921 RFL_Obj03_GroundReflexConf "Confidence of the object being a ground reflex. ISO 23150: Potentially moving object classification type  confidence (A.2.12)";
CM_ SG_ 921 RFL_Obj03_StatObstConf "Confidence of the object being a stationary obstacle. ISO 23150: Potentially moving object classification type  confidence (A.2.12)";
CM_ SG_ 921 RFL_Obj03_StatBarrierConf "Confidence of the object being a stationary road barrier. ISO 23150: Potentially moving object classification type  confidence (A.2.12)";
CM_ SG_ 922 RFL_Obj04_CRC "CRC - Autosar E2E Profile 5";
CM_ SG_ 922 RFL_Obj04_AliveCtr "Alive counter - Autosar E2E Profile 5";
CM_ SG_ 922 RFL_Obj04_ProtBlockCtr "Protocol-Signal: Block-Counter";
CM_ SG_ 922 RFL_Obj04_ReferencePoint "Reference Point of the detected object. ISO 23150: Reference point (A.2.17)";
CM_ SG_ 922 RFL_Obj04_ObjId "Unique Object ID. ISO 23150: Object ID (A.2.2)";
CM_ SG_ 922 RFL_Obj04_MeasurementStatus "Object is measured or not. ISO 23150: Measurement status  object level (A.2.9)";
CM_ SG_ 922 RFL_Obj04_Px "Object position in X direction. ISO 23150: Position  object level {x, y, z} (A.2.13)";
CM_ SG_ 922 RFL_Obj04_Py "Object position in Y direction. ISO 23150: Position  object level {x, y, z} (A.2.13)";
CM_ SG_ 922 RFL_Obj04_PxVnce "Variance of object position in X direction. ISO 23150: Position  object level {x, y, z}  error (A.2.14)";
CM_ SG_ 922 RFL_Obj04_PyVnce "Variance of object position in Y direction. ISO 23150: Position  object level {x, y, z}  error (A.2.14)";
CM_ SG_ 922 RFL_Obj04_Vx "Object relative velocity in X direction. ISO 23150: Velocity {x, y, z}  object level (A.2.23)";
CM_ SG_ 922 RFL_Obj04_Vy "Object relative velocity in Y direction. ISO 23150: Velocity {x, y, z}  object level (A.2.23)";
CM_ SG_ 922 RFL_Obj04_Ax "Object relative acceleration in X direction. ISO 23150: Acceleration {x, y, z} (A.2.25)";
CM_ SG_ 922 RFL_Obj04_Ay "Object relative acceleration in Y direction. ISO 23150: Acceleration {x, y, z} (A.2.25)";
CM_ SG_ 922 RFL_Obj04_OrientationYaw "Object orientation yaw angle. ISO 23150: Orientation {yaw, pitch, roll} (A.2.15)";
CM_ SG_ 922 RFL_Obj04_ExistProb "Existence probability of object. ISO 23150: Existence probability  object level (A.2.1)";
CM_ SG_ 922 RFL_Obj04_VxVnce "Variance of object relative velocity in X direction. ISO 23150: Velocity {x, y, z}  object level  error (A.2.24)";
CM_ SG_ 922 RFL_Obj04_VyVnce "Variance of object relative velocity in Y direction. ISO 23150: Velocity {x, y, z}  object level  error (A.2.24)";
CM_ SG_ 922 RFL_Obj04_AxVnce "Variance of object relative acceleration in X direction. ISO 23150: Acceleration {x, y, z}  error (A.2.26)";
CM_ SG_ 922 RFL_Obj04_AyVnce "Variance of object relative acceleration in Y direction. ISO 23150: Acceleration {x, y, z}  error (A.2.26)";
CM_ SG_ 922 RFL_Obj04_OrientationYawVnce "Variance of object orientation yaw angle. ISO 23150: Orientation {yaw, pitch, roll}  error (A.2.16)";
CM_ SG_ 922 RFL_Obj04_MovingObserved "Object has been observed moving over the ground since it was first detected";
CM_ SG_ 922 RFL_Obj04_MovingProbability "Object has been observed moving over the ground";
CM_ SG_ 922 RFL_Obj04_Length "Object Length. ISO 23150: Bounding box extent {length, width, height} (A.2.19)";
CM_ SG_ 922 RFL_Obj04_Valid "Object is valid or not";
CM_ SG_ 922 RFL_Obj04_LengthVnce "Variance of object Length. ISO 23150: Bounding box extent {length, width, height}  error (A.2.20)";
CM_ SG_ 922 RFL_Obj04_WidthVnce "Variance of object Width. ISO 23150: Bounding box extent {length, width, height}  error (A.2.20)";
CM_ SG_ 922 RFL_Obj04_Width "Object Width. ISO 23150: Bounding box extent {length, width, height} (A.2.19)";
CM_ SG_ 922 RFL_Obj04_BehaviorType "Indicates that which behavior the object associated for";
CM_ SG_ 922 RFL_Obj04_ObstacleConf "Confidence of the object being an Obstacle. ISO 23150: Potentially moving object classification type  confidence (A.2.12)";
CM_ SG_ 922 RFL_Obj04_NonObstacleConf "Confidence of the object being a Non-Obstacle. ISO 23150: Potentially moving object classification type  confidence (A.2.12)";
CM_ SG_ 922 RFL_Obj04_PxPyCoVnce "Covariance of Px and Py";
CM_ SG_ 922 RFL_Obj04_PxVxCoVnce "Covariance of Px and Vx";
CM_ SG_ 922 RFL_Obj04_PxVyCoVnce "Covariance of Px and Vy";
CM_ SG_ 922 RFL_Obj04_PyVxCoVnce "Covariance of Py and Vx";
CM_ SG_ 922 RFL_Obj04_PyVyCoVnce "Covariance of Py and Vy";
CM_ SG_ 922 RFL_Obj04_VxVyCoVnce "Covariance of Vx and Vy";
CM_ SG_ 922 RFL_Obj04_PxAxCoVnce "Covariance of Px and Ax";
CM_ SG_ 922 RFL_Obj04_PxAyCoVnce "Covariance of Px and Ay";
CM_ SG_ 922 RFL_Obj04_PyAxCoVnce "Covariance of Py and Ax";
CM_ SG_ 922 RFL_Obj04_PyAyCoVnce "Covariance of Py and Ay";
CM_ SG_ 922 RFL_Obj04_VxAxCoVnce "Covariance of Vx and Ax";
CM_ SG_ 922 RFL_Obj04_VxAyCoVnce "Covariance of Vx and Ay";
CM_ SG_ 922 RFL_Obj04_VyAxCoVnce "Covariance of Vy and Ax";
CM_ SG_ 922 RFL_Obj04_VyAyCoVnce "Covariance of Vy and Ay";
CM_ SG_ 922 RFL_Obj04_AxAyCoVnce "Covariance of Ax and Ay";
CM_ SG_ 922 RFL_Obj04_MobileObstConf "Confidence of the object being a mobile obstacle. ISO 23150: Potentially moving object classification type  confidence (A.2.12)";
CM_ SG_ 922 RFL_Obj04_Mob4PlusWhlConf "Confidence of a mobile object which has 4 or more wheels. ISO 23150: Potentially moving object classification type  confidence (A.2.12)";
CM_ SG_ 922 RFL_Obj04_Mob2WhlConf "Confidence of a mobile object being 2-wheels vehicle. ISO 23150: Potentially moving object classification type  confidence (A.2.12)";
CM_ SG_ 922 RFL_Obj04_MobPedConf "Confidence of a mobile object being a pedestrian. ISO 23150: Potentially moving object classification type  confidence (A.2.12)";
CM_ SG_ 922 RFL_Obj04_FourPlusWhlCarConf "Confidence of a mobile object which has 4 or more wheels--passenger car. ISO 23150: Potentially moving object classification type  confidence (A.2.12)";
CM_ SG_ 922 RFL_Obj04_FourPlusWhlHGVConf "Confidence of a mobile object which has 4 or more wheels--commercial vehicle (Truck). ISO 23150: Potentially moving object classification type  confidence (A.2.12)";
CM_ SG_ 922 RFL_Obj04_GroundReflexConf "Confidence of the object being a ground reflex. ISO 23150: Potentially moving object classification type  confidence (A.2.12)";
CM_ SG_ 922 RFL_Obj04_StatObstConf "Confidence of the object being a stationary obstacle. ISO 23150: Potentially moving object classification type  confidence (A.2.12)";
CM_ SG_ 922 RFL_Obj04_StatBarrierConf "Confidence of the object being a stationary road barrier. ISO 23150: Potentially moving object classification type  confidence (A.2.12)";
CM_ SG_ 923 RFL_Obj05_CRC "CRC - Autosar E2E Profile 5";
CM_ SG_ 923 RFL_Obj05_AliveCtr "Alive counter - Autosar E2E Profile 5";
CM_ SG_ 923 RFL_Obj05_ProtBlockCtr "Protocol-Signal: Block-Counter";
CM_ SG_ 923 RFL_Obj05_ReferencePoint "Reference Point of the detected object. ISO 23150: Reference point (A.2.17)";
CM_ SG_ 923 RFL_Obj05_ObjId "Unique Object ID. ISO 23150: Object ID (A.2.2)";
CM_ SG_ 923 RFL_Obj05_MeasurementStatus "Object is measured or not. ISO 23150: Measurement status  object level (A.2.9)";
CM_ SG_ 923 RFL_Obj05_Px "Object position in X direction. ISO 23150: Position  object level {x, y, z} (A.2.13)";
CM_ SG_ 923 RFL_Obj05_Py "Object position in Y direction. ISO 23150: Position  object level {x, y, z} (A.2.13)";
CM_ SG_ 923 RFL_Obj05_PxVnce "Variance of object position in X direction. ISO 23150: Position  object level {x, y, z}  error (A.2.14)";
CM_ SG_ 923 RFL_Obj05_PyVnce "Variance of object position in Y direction. ISO 23150: Position  object level {x, y, z}  error (A.2.14)";
CM_ SG_ 923 RFL_Obj05_Vx "Object relative velocity in X direction. ISO 23150: Velocity {x, y, z}  object level (A.2.23)";
CM_ SG_ 923 RFL_Obj05_Vy "Object relative velocity in Y direction. ISO 23150: Velocity {x, y, z}  object level (A.2.23)";
CM_ SG_ 923 RFL_Obj05_Ax "Object relative acceleration in X direction. ISO 23150: Acceleration {x, y, z} (A.2.25)";
CM_ SG_ 923 RFL_Obj05_Ay "Object relative acceleration in Y direction. ISO 23150: Acceleration {x, y, z} (A.2.25)";
CM_ SG_ 923 RFL_Obj05_OrientationYaw "Object orientation yaw angle. ISO 23150: Orientation {yaw, pitch, roll} (A.2.15)";
CM_ SG_ 923 RFL_Obj05_ExistProb "Existence probability of object. ISO 23150: Existence probability  object level (A.2.1)";
CM_ SG_ 923 RFL_Obj05_VxVnce "Variance of object relative velocity in X direction. ISO 23150: Velocity {x, y, z}  object level  error (A.2.24)";
CM_ SG_ 923 RFL_Obj05_VyVnce "Variance of object relative velocity in Y direction. ISO 23150: Velocity {x, y, z}  object level  error (A.2.24)";
CM_ SG_ 923 RFL_Obj05_AxVnce "Variance of object relative acceleration in X direction. ISO 23150: Acceleration {x, y, z}  error (A.2.26)";
CM_ SG_ 923 RFL_Obj05_AyVnce "Variance of object relative acceleration in Y direction. ISO 23150: Acceleration {x, y, z}  error (A.2.26)";
CM_ SG_ 923 RFL_Obj05_OrientationYawVnce "Variance of object orientation yaw angle. ISO 23150: Orientation {yaw, pitch, roll}  error (A.2.16)";
CM_ SG_ 923 RFL_Obj05_MovingObserved "Object has been observed moving over the ground since it was first detected";
CM_ SG_ 923 RFL_Obj05_MovingProbability "Object has been observed moving over the ground";
CM_ SG_ 923 RFL_Obj05_Length "Object Length. ISO 23150: Bounding box extent {length, width, height} (A.2.19)";
CM_ SG_ 923 RFL_Obj05_Valid "Object is valid or not";
CM_ SG_ 923 RFL_Obj05_LengthVnce "Variance of object Length. ISO 23150: Bounding box extent {length, width, height}  error (A.2.20)";
CM_ SG_ 923 RFL_Obj05_WidthVnce "Variance of object Width. ISO 23150: Bounding box extent {length, width, height}  error (A.2.20)";
CM_ SG_ 923 RFL_Obj05_Width "Object Width. ISO 23150: Bounding box extent {length, width, height} (A.2.19)";
CM_ SG_ 923 RFL_Obj05_BehaviorType "Indicates that which behavior the object associated for";
CM_ SG_ 923 RFL_Obj05_ObstacleConf "Confidence of the object being an Obstacle. ISO 23150: Potentially moving object classification type  confidence (A.2.12)";
CM_ SG_ 923 RFL_Obj05_NonObstacleConf "Confidence of the object being a Non-Obstacle. ISO 23150: Potentially moving object classification type  confidence (A.2.12)";
CM_ SG_ 923 RFL_Obj05_PxPyCoVnce "Covariance of Px and Py";
CM_ SG_ 923 RFL_Obj05_PxVxCoVnce "Covariance of Px and Vx";
CM_ SG_ 923 RFL_Obj05_PxVyCoVnce "Covariance of Px and Vy";
CM_ SG_ 923 RFL_Obj05_PyVxCoVnce "Covariance of Py and Vx";
CM_ SG_ 923 RFL_Obj05_PyVyCoVnce "Covariance of Py and Vy";
CM_ SG_ 923 RFL_Obj05_VxVyCoVnce "Covariance of Vx and Vy";
CM_ SG_ 923 RFL_Obj05_PxAxCoVnce "Covariance of Px and Ax";
CM_ SG_ 923 RFL_Obj05_PxAyCoVnce "Covariance of Px and Ay";
CM_ SG_ 923 RFL_Obj05_PyAxCoVnce "Covariance of Py and Ax";
CM_ SG_ 923 RFL_Obj05_PyAyCoVnce "Covariance of Py and Ay";
CM_ SG_ 923 RFL_Obj05_VxAxCoVnce "Covariance of Vx and Ax";
CM_ SG_ 923 RFL_Obj05_VxAyCoVnce "Covariance of Vx and Ay";
CM_ SG_ 923 RFL_Obj05_VyAxCoVnce "Covariance of Vy and Ax";
CM_ SG_ 923 RFL_Obj05_VyAyCoVnce "Covariance of Vy and Ay";
CM_ SG_ 923 RFL_Obj05_AxAyCoVnce "Covariance of Ax and Ay";
CM_ SG_ 923 RFL_Obj05_MobileObstConf "Confidence of the object being a mobile obstacle. ISO 23150: Potentially moving object classification type  confidence (A.2.12)";
CM_ SG_ 923 RFL_Obj05_Mob4PlusWhlConf "Confidence of a mobile object which has 4 or more wheels. ISO 23150: Potentially moving object classification type  confidence (A.2.12)";
CM_ SG_ 923 RFL_Obj05_Mob2WhlConf "Confidence of a mobile object being 2-wheels vehicle. ISO 23150: Potentially moving object classification type  confidence (A.2.12)";
CM_ SG_ 923 RFL_Obj05_MobPedConf "Confidence of a mobile object being a pedestrian. ISO 23150: Potentially moving object classification type  confidence (A.2.12)";
CM_ SG_ 923 RFL_Obj05_FourPlusWhlCarConf "Confidence of a mobile object which has 4 or more wheels--passenger car. ISO 23150: Potentially moving object classification type  confidence (A.2.12)";
CM_ SG_ 923 RFL_Obj05_FourPlusWhlHGVConf "Confidence of a mobile object which has 4 or more wheels--commercial vehicle (Truck). ISO 23150: Potentially moving object classification type  confidence (A.2.12)";
CM_ SG_ 923 RFL_Obj05_GroundReflexConf "Confidence of the object being a ground reflex. ISO 23150: Potentially moving object classification type  confidence (A.2.12)";
CM_ SG_ 923 RFL_Obj05_StatObstConf "Confidence of the object being a stationary obstacle. ISO 23150: Potentially moving object classification type  confidence (A.2.12)";
CM_ SG_ 923 RFL_Obj05_StatBarrierConf "Confidence of the object being a stationary road barrier. ISO 23150: Potentially moving object classification type  confidence (A.2.12)";
CM_ SG_ 924 RFL_Obj06_CRC "CRC - Autosar E2E Profile 5";
CM_ SG_ 924 RFL_Obj06_AliveCtr "Alive counter - Autosar E2E Profile 5";
CM_ SG_ 924 RFL_Obj06_ProtBlockCtr "Protocol-Signal: Block-Counter";
CM_ SG_ 924 RFL_Obj06_ReferencePoint "Reference Point of the detected object. ISO 23150: Reference point (A.2.17)";
CM_ SG_ 924 RFL_Obj06_ObjId "Unique Object ID. ISO 23150: Object ID (A.2.2)";
CM_ SG_ 924 RFL_Obj06_MeasurementStatus "Object is measured or not. ISO 23150: Measurement status  object level (A.2.9)";
CM_ SG_ 924 RFL_Obj06_Px "Object position in X direction. ISO 23150: Position  object level {x, y, z} (A.2.13)";
CM_ SG_ 924 RFL_Obj06_Py "Object position in Y direction. ISO 23150: Position  object level {x, y, z} (A.2.13)";
CM_ SG_ 924 RFL_Obj06_PxVnce "Variance of object position in X direction. ISO 23150: Position  object level {x, y, z}  error (A.2.14)";
CM_ SG_ 924 RFL_Obj06_PyVnce "Variance of object position in Y direction. ISO 23150: Position  object level {x, y, z}  error (A.2.14)";
CM_ SG_ 924 RFL_Obj06_Vx "Object relative velocity in X direction. ISO 23150: Velocity {x, y, z}  object level (A.2.23)";
CM_ SG_ 924 RFL_Obj06_Vy "Object relative velocity in Y direction. ISO 23150: Velocity {x, y, z}  object level (A.2.23)";
CM_ SG_ 924 RFL_Obj06_Ax "Object relative acceleration in X direction. ISO 23150: Acceleration {x, y, z} (A.2.25)";
CM_ SG_ 924 RFL_Obj06_Ay "Object relative acceleration in Y direction. ISO 23150: Acceleration {x, y, z} (A.2.25)";
CM_ SG_ 924 RFL_Obj06_OrientationYaw "Object orientation yaw angle. ISO 23150: Orientation {yaw, pitch, roll} (A.2.15)";
CM_ SG_ 924 RFL_Obj06_ExistProb "Existence probability of object. ISO 23150: Existence probability  object level (A.2.1)";
CM_ SG_ 924 RFL_Obj06_VxVnce "Variance of object relative velocity in X direction. ISO 23150: Velocity {x, y, z}  object level  error (A.2.24)";
CM_ SG_ 924 RFL_Obj06_VyVnce "Variance of object relative velocity in Y direction. ISO 23150: Velocity {x, y, z}  object level  error (A.2.24)";
CM_ SG_ 924 RFL_Obj06_AxVnce "Variance of object relative acceleration in X direction. ISO 23150: Acceleration {x, y, z}  error (A.2.26)";
CM_ SG_ 924 RFL_Obj06_AyVnce "Variance of object relative acceleration in Y direction. ISO 23150: Acceleration {x, y, z}  error (A.2.26)";
CM_ SG_ 924 RFL_Obj06_OrientationYawVnce "Variance of object orientation yaw angle. ISO 23150: Orientation {yaw, pitch, roll}  error (A.2.16)";
CM_ SG_ 924 RFL_Obj06_MovingObserved "Object has been observed moving over the ground since it was first detected";
CM_ SG_ 924 RFL_Obj06_MovingProbability "Object has been observed moving over the ground";
CM_ SG_ 924 RFL_Obj06_Length "Object Length. ISO 23150: Bounding box extent {length, width, height} (A.2.19)";
CM_ SG_ 924 RFL_Obj06_Valid "Object is valid or not";
CM_ SG_ 924 RFL_Obj06_LengthVnce "Variance of object Length. ISO 23150: Bounding box extent {length, width, height}  error (A.2.20)";
CM_ SG_ 924 RFL_Obj06_WidthVnce "Variance of object Width. ISO 23150: Bounding box extent {length, width, height}  error (A.2.20)";
CM_ SG_ 924 RFL_Obj06_Width "Object Width. ISO 23150: Bounding box extent {length, width, height} (A.2.19)";
CM_ SG_ 924 RFL_Obj06_BehaviorType "Indicates that which behavior the object associated for";
CM_ SG_ 924 RFL_Obj06_ObstacleConf "Confidence of the object being an Obstacle. ISO 23150: Potentially moving object classification type  confidence (A.2.12)";
CM_ SG_ 924 RFL_Obj06_NonObstacleConf "Confidence of the object being a Non-Obstacle. ISO 23150: Potentially moving object classification type  confidence (A.2.12)";
CM_ SG_ 924 RFL_Obj06_PxPyCoVnce "Covariance of Px and Py";
CM_ SG_ 924 RFL_Obj06_PxVxCoVnce "Covariance of Px and Vx";
CM_ SG_ 924 RFL_Obj06_PxVyCoVnce "Covariance of Px and Vy";
CM_ SG_ 924 RFL_Obj06_PyVxCoVnce "Covariance of Py and Vx";
CM_ SG_ 924 RFL_Obj06_PyVyCoVnce "Covariance of Py and Vy";
CM_ SG_ 924 RFL_Obj06_VxVyCoVnce "Covariance of Vx and Vy";
CM_ SG_ 924 RFL_Obj06_PxAxCoVnce "Covariance of Px and Ax";
CM_ SG_ 924 RFL_Obj06_PxAyCoVnce "Covariance of Px and Ay";
CM_ SG_ 924 RFL_Obj06_PyAxCoVnce "Covariance of Py and Ax";
CM_ SG_ 924 RFL_Obj06_PyAyCoVnce "Covariance of Py and Ay";
CM_ SG_ 924 RFL_Obj06_VxAxCoVnce "Covariance of Vx and Ax";
CM_ SG_ 924 RFL_Obj06_VxAyCoVnce "Covariance of Vx and Ay";
CM_ SG_ 924 RFL_Obj06_VyAxCoVnce "Covariance of Vy and Ax";
CM_ SG_ 924 RFL_Obj06_VyAyCoVnce "Covariance of Vy and Ay";
CM_ SG_ 924 RFL_Obj06_AxAyCoVnce "Covariance of Ax and Ay";
CM_ SG_ 924 RFL_Obj06_MobileObstConf "Confidence of the object being a mobile obstacle. ISO 23150: Potentially moving object classification type  confidence (A.2.12)";
CM_ SG_ 924 RFL_Obj06_Mob4PlusWhlConf "Confidence of a mobile object which has 4 or more wheels. ISO 23150: Potentially moving object classification type  confidence (A.2.12)";
CM_ SG_ 924 RFL_Obj06_Mob2WhlConf "Confidence of a mobile object being 2-wheels vehicle. ISO 23150: Potentially moving object classification type  confidence (A.2.12)";
CM_ SG_ 924 RFL_Obj06_MobPedConf "Confidence of a mobile object being a pedestrian. ISO 23150: Potentially moving object classification type  confidence (A.2.12)";
CM_ SG_ 924 RFL_Obj06_FourPlusWhlCarConf "Confidence of a mobile object which has 4 or more wheels--passenger car. ISO 23150: Potentially moving object classification type  confidence (A.2.12)";
CM_ SG_ 924 RFL_Obj06_FourPlusWhlHGVConf "Confidence of a mobile object which has 4 or more wheels--commercial vehicle (Truck). ISO 23150: Potentially moving object classification type  confidence (A.2.12)";
CM_ SG_ 924 RFL_Obj06_GroundReflexConf "Confidence of the object being a ground reflex. ISO 23150: Potentially moving object classification type  confidence (A.2.12)";
CM_ SG_ 924 RFL_Obj06_StatObstConf "Confidence of the object being a stationary obstacle. ISO 23150: Potentially moving object classification type  confidence (A.2.12)";
CM_ SG_ 924 RFL_Obj06_StatBarrierConf "Confidence of the object being a stationary road barrier. ISO 23150: Potentially moving object classification type  confidence (A.2.12)";
BA_DEF_ BO_  "CANFD_BRS" ENUM  "0","1";
BA_DEF_ BO_  "GenMsgCycleTime" INT 0 65535;
BA_DEF_ BO_  "GenMsgSendType" ENUM  "Event","cyclic";
BA_DEF_ BO_  "VFrameFormat" ENUM  "StandardCAN","ExtendedCAN","reserved","reserved","reserved","reserved","reserved","reserved","reserved","reserved","reserved","reserved","reserved","reserved","StandardCAN_FD","ExtendedCAN_FD";
BA_DEF_ BO_  "E2Eprofile" STRING ;
BA_DEF_ BO_  "DataID" HEX 0 655535;
BA_DEF_ SG_  "GenSigStartValue" FLOAT 0 100000000000;
BA_DEF_DEF_  "CANFD_BRS" "1";
BA_DEF_DEF_  "GenMsgCycleTime" 0;
BA_DEF_DEF_  "GenMsgSendType" "";
BA_DEF_DEF_  "VFrameFormat" "";
BA_DEF_DEF_  "E2Eprofile" "None";
BA_DEF_DEF_  "DataID" 0;
BA_DEF_DEF_  "GenSigStartValue" 0;
BA_ "DataID" BO_ 432 8624;
BA_ "E2Eprofile" BO_ 432 "AUTOSAR Profile 5";
BA_ "GenMsgSendType" BO_ 432 0;
BA_ "VFrameFormat" BO_ 432 14;
BA_ "DataID" BO_ 433 8625;
BA_ "E2Eprofile" BO_ 433 "AUTOSAR Profile 5";
BA_ "GenMsgSendType" BO_ 433 0;
BA_ "VFrameFormat" BO_ 433 14;
BA_ "DataID" BO_ 434 8626;
BA_ "E2Eprofile" BO_ 434 "AUTOSAR Profile 5";
BA_ "GenMsgSendType" BO_ 434 0;
BA_ "VFrameFormat" BO_ 434 14;
BA_ "DataID" BO_ 435 8627;
BA_ "E2Eprofile" BO_ 435 "AUTOSAR Profile 5";
BA_ "GenMsgSendType" BO_ 435 0;
BA_ "VFrameFormat" BO_ 435 14;
BA_ "DataID" BO_ 436 8628;
BA_ "E2Eprofile" BO_ 436 "AUTOSAR Profile 5";
BA_ "GenMsgSendType" BO_ 436 0;
BA_ "VFrameFormat" BO_ 436 14;
BA_ "DataID" BO_ 437 8629;
BA_ "E2Eprofile" BO_ 437 "AUTOSAR Profile 5";
BA_ "GenMsgSendType" BO_ 437 0;
BA_ "VFrameFormat" BO_ 437 14;
BA_ "DataID" BO_ 916 9108;
BA_ "E2Eprofile" BO_ 916 "AUTOSAR Profile 5";
BA_ "GenMsgSendType" BO_ 916 0;
BA_ "VFrameFormat" BO_ 916 14;
BA_ "DataID" BO_ 918 9110;
BA_ "E2Eprofile" BO_ 918 "AUTOSAR Profile 5";
BA_ "GenMsgSendType" BO_ 918 0;
BA_ "VFrameFormat" BO_ 918 14;
BA_ "DataID" BO_ 919 9111;
BA_ "E2Eprofile" BO_ 919 "AUTOSAR Profile 5";
BA_ "GenMsgSendType" BO_ 919 0;
BA_ "VFrameFormat" BO_ 919 14;
BA_ "DataID" BO_ 920 9112;
BA_ "E2Eprofile" BO_ 920 "AUTOSAR Profile 5";
BA_ "GenMsgSendType" BO_ 920 0;
BA_ "VFrameFormat" BO_ 920 14;
BA_ "DataID" BO_ 921 9113;
BA_ "E2Eprofile" BO_ 921 "AUTOSAR Profile 5";
BA_ "GenMsgSendType" BO_ 921 0;
BA_ "VFrameFormat" BO_ 921 14;
BA_ "DataID" BO_ 922 9114;
BA_ "E2Eprofile" BO_ 922 "AUTOSAR Profile 5";
BA_ "GenMsgSendType" BO_ 922 0;
BA_ "VFrameFormat" BO_ 922 14;
BA_ "DataID" BO_ 923 9115;
BA_ "E2Eprofile" BO_ 923 "AUTOSAR Profile 5";
BA_ "GenMsgSendType" BO_ 923 0;
BA_ "VFrameFormat" BO_ 923 14;
BA_ "DataID" BO_ 924 9116;
BA_ "E2Eprofile" BO_ 924 "AUTOSAR Profile 5";
BA_ "GenMsgSendType" BO_ 924 0;
BA_ "VFrameFormat" BO_ 924 14;
BA_ "GenSigStartValue" SG_ 432 RFC_Obj26_Px 4096;
BA_ "GenSigStartValue" SG_ 432 RFC_Obj26_Py 1024;
BA_ "GenSigStartValue" SG_ 432 RFC_Obj26_Vx 2048;
BA_ "GenSigStartValue" SG_ 432 RFC_Obj26_Vy 512;
BA_ "GenSigStartValue" SG_ 432 RFC_Obj26_Ax 512;
BA_ "GenSigStartValue" SG_ 432 RFC_Obj26_Ay 256;
BA_ "GenSigStartValue" SG_ 432 RFC_Obj26_OrientationYaw 256;
BA_ "GenSigStartValue" SG_ 433 RFC_Obj27_Px 4096;
BA_ "GenSigStartValue" SG_ 433 RFC_Obj27_Py 1024;
BA_ "GenSigStartValue" SG_ 433 RFC_Obj27_Vx 2048;
BA_ "GenSigStartValue" SG_ 433 RFC_Obj27_Vy 512;
BA_ "GenSigStartValue" SG_ 433 RFC_Obj27_Ax 512;
BA_ "GenSigStartValue" SG_ 433 RFC_Obj27_Ay 256;
BA_ "GenSigStartValue" SG_ 433 RFC_Obj27_OrientationYaw 256;
BA_ "GenSigStartValue" SG_ 434 RFC_Obj28_Px 4096;
BA_ "GenSigStartValue" SG_ 434 RFC_Obj28_Py 1024;
BA_ "GenSigStartValue" SG_ 434 RFC_Obj28_Vx 2048;
BA_ "GenSigStartValue" SG_ 434 RFC_Obj28_Vy 512;
BA_ "GenSigStartValue" SG_ 434 RFC_Obj28_Ax 512;
BA_ "GenSigStartValue" SG_ 434 RFC_Obj28_Ay 256;
BA_ "GenSigStartValue" SG_ 434 RFC_Obj28_OrientationYaw 256;
BA_ "GenSigStartValue" SG_ 435 RFC_Obj29_Px 4096;
BA_ "GenSigStartValue" SG_ 435 RFC_Obj29_Py 1024;
BA_ "GenSigStartValue" SG_ 435 RFC_Obj29_Vx 2048;
BA_ "GenSigStartValue" SG_ 435 RFC_Obj29_Vy 512;
BA_ "GenSigStartValue" SG_ 435 RFC_Obj29_Ax 512;
BA_ "GenSigStartValue" SG_ 435 RFC_Obj29_Ay 256;
BA_ "GenSigStartValue" SG_ 435 RFC_Obj29_OrientationYaw 256;
BA_ "GenSigStartValue" SG_ 436 RFC_Obj30_Px 4096;
BA_ "GenSigStartValue" SG_ 436 RFC_Obj30_Py 1024;
BA_ "GenSigStartValue" SG_ 436 RFC_Obj30_Vx 2048;
BA_ "GenSigStartValue" SG_ 436 RFC_Obj30_Vy 512;
BA_ "GenSigStartValue" SG_ 436 RFC_Obj30_Ax 512;
BA_ "GenSigStartValue" SG_ 436 RFC_Obj30_Ay 256;
BA_ "GenSigStartValue" SG_ 436 RFC_Obj30_OrientationYaw 256;
BA_ "GenSigStartValue" SG_ 437 RFC_Obj31_Px 4096;
BA_ "GenSigStartValue" SG_ 437 RFC_Obj31_Py 1024;
BA_ "GenSigStartValue" SG_ 437 RFC_Obj31_Vx 2048;
BA_ "GenSigStartValue" SG_ 437 RFC_Obj31_Vy 512;
BA_ "GenSigStartValue" SG_ 437 RFC_Obj31_Ax 512;
BA_ "GenSigStartValue" SG_ 437 RFC_Obj31_Ay 256;
BA_ "GenSigStartValue" SG_ 437 RFC_Obj31_OrientationYaw 256;
BA_ "GenSigStartValue" SG_ 916 RFL_ObjHdr_IfVersionIdMajor 1;
BA_ "GenSigStartValue" SG_ 916 RFL_ObjHdr_IfVersionIdMinor 1;
BA_ "GenSigStartValue" SG_ 916 RFL_ObjHdr_SensorOriginPointY 128;
BA_ "GenSigStartValue" SG_ 916 RFL_ObjHdr_SensorOriginPointX 256;
BA_ "GenSigStartValue" SG_ 916 RFL_ObjHdr_SensorOrientYaw 32768;
BA_ "GenSigStartValue" SG_ 916 RFL_ObjHdr_SensorOrientPitch 2048;
BA_ "GenSigStartValue" SG_ 916 RFL_ObjHdr_SensorOrientRoll 2048;
BA_ "GenSigStartValue" SG_ 916 RFL_ObjHdr_FovAzimuthBegin 16384;
BA_ "GenSigStartValue" SG_ 916 RFL_ObjHdr_FovAzimuthEnd 16384;
BA_ "GenSigStartValue" SG_ 916 RFL_ObjHdr_FovElevationBegin 2048;
BA_ "GenSigStartValue" SG_ 916 RFL_ObjHdr_FovElevationEnd 2048;
BA_ "GenSigStartValue" SG_ 918 RFL_Obj00_Px 4096;
BA_ "GenSigStartValue" SG_ 918 RFL_Obj00_Py 1024;
BA_ "GenSigStartValue" SG_ 918 RFL_Obj00_Vx 2048;
BA_ "GenSigStartValue" SG_ 918 RFL_Obj00_Vy 512;
BA_ "GenSigStartValue" SG_ 918 RFL_Obj00_Ax 512;
BA_ "GenSigStartValue" SG_ 918 RFL_Obj00_Ay 256;
BA_ "GenSigStartValue" SG_ 918 RFL_Obj00_OrientationYaw 256;
BA_ "GenSigStartValue" SG_ 919 RFL_Obj01_Px 4096;
BA_ "GenSigStartValue" SG_ 919 RFL_Obj01_Py 1024;
BA_ "GenSigStartValue" SG_ 919 RFL_Obj01_Vx 2048;
BA_ "GenSigStartValue" SG_ 919 RFL_Obj01_Vy 512;
BA_ "GenSigStartValue" SG_ 919 RFL_Obj01_Ax 512;
BA_ "GenSigStartValue" SG_ 919 RFL_Obj01_Ay 256;
BA_ "GenSigStartValue" SG_ 919 RFL_Obj01_OrientationYaw 256;
BA_ "GenSigStartValue" SG_ 920 RFL_Obj02_Px 4096;
BA_ "GenSigStartValue" SG_ 920 RFL_Obj02_Py 1024;
BA_ "GenSigStartValue" SG_ 920 RFL_Obj02_Vx 2048;
BA_ "GenSigStartValue" SG_ 920 RFL_Obj02_Vy 512;
BA_ "GenSigStartValue" SG_ 920 RFL_Obj02_Ax 512;
BA_ "GenSigStartValue" SG_ 920 RFL_Obj02_Ay 256;
BA_ "GenSigStartValue" SG_ 920 RFL_Obj02_OrientationYaw 256;
BA_ "GenSigStartValue" SG_ 921 RFL_Obj03_Px 4096;
BA_ "GenSigStartValue" SG_ 921 RFL_Obj03_Py 1024;
BA_ "GenSigStartValue" SG_ 921 RFL_Obj03_Vx 2048;
BA_ "GenSigStartValue" SG_ 921 RFL_Obj03_Vy 512;
BA_ "GenSigStartValue" SG_ 921 RFL_Obj03_Ax 512;
BA_ "GenSigStartValue" SG_ 921 RFL_Obj03_Ay 256;
BA_ "GenSigStartValue" SG_ 921 RFL_Obj03_OrientationYaw 256;
BA_ "GenSigStartValue" SG_ 922 RFL_Obj04_Px 4096;
BA_ "GenSigStartValue" SG_ 922 RFL_Obj04_Py 1024;
BA_ "GenSigStartValue" SG_ 922 RFL_Obj04_Vx 2048;
BA_ "GenSigStartValue" SG_ 922 RFL_Obj04_Vy 512;
BA_ "GenSigStartValue" SG_ 922 RFL_Obj04_Ax 512;
BA_ "GenSigStartValue" SG_ 922 RFL_Obj04_Ay 256;
BA_ "GenSigStartValue" SG_ 922 RFL_Obj04_OrientationYaw 256;
BA_ "GenSigStartValue" SG_ 923 RFL_Obj05_Px 4096;
BA_ "GenSigStartValue" SG_ 923 RFL_Obj05_Py 1024;
BA_ "GenSigStartValue" SG_ 923 RFL_Obj05_Vx 2048;
BA_ "GenSigStartValue" SG_ 923 RFL_Obj05_Vy 512;
BA_ "GenSigStartValue" SG_ 923 RFL_Obj05_Ax 512;
BA_ "GenSigStartValue" SG_ 923 RFL_Obj05_Ay 256;
BA_ "GenSigStartValue" SG_ 923 RFL_Obj05_OrientationYaw 256;
BA_ "GenSigStartValue" SG_ 924 RFL_Obj06_Px 4096;
BA_ "GenSigStartValue" SG_ 924 RFL_Obj06_Py 1024;
BA_ "GenSigStartValue" SG_ 924 RFL_Obj06_Vx 2048;
BA_ "GenSigStartValue" SG_ 924 RFL_Obj06_Vy 512;
BA_ "GenSigStartValue" SG_ 924 RFL_Obj06_Ax 512;
BA_ "GenSigStartValue" SG_ 924 RFL_Obj06_Ay 256;
BA_ "GenSigStartValue" SG_ 924 RFL_Obj06_OrientationYaw 256;
VAL_ 432 RFC_Obj26_ReferencePoint 0 "Front corner left" 1 "Front center" 2 "Front corner right" 3 "Front wheelcase left" 4 "Front wheelcase right" 5 "Side middle left" 6 "Side middle right" 7 "Rear wheelcase left" 8 "Rear wheelcase right" 9 "Rear corner left" 10 "Rear center" 11 "Rear corner right" 12 "Object center" 13 "Rear wheelcase center" 14 "Front wheelcase center" 15 "Invalid" ;
VAL_ 432 RFC_Obj26_MeasurementStatus 0 "not measured" 1 "measured" ;
VAL_ 432 RFC_Obj26_Valid 0 "not valid" 1 "valid" ;
VAL_ 432 RFC_Obj26_BehaviorType 0 "No_Target" 1 "FCTA" 2 "RCTA" 3 "BSD" 4 "LCA" 5 "HWA" 6 "Reserved1" 7 "Reserved2" ;
VAL_ 433 RFC_Obj27_ReferencePoint 0 "Front corner left" 1 "Front center" 2 "Front corner right" 3 "Front wheelcase left" 4 "Front wheelcase right" 5 "Side middle left" 6 "Side middle right" 7 "Rear wheelcase left" 8 "Rear wheelcase right" 9 "Rear corner left" 10 "Rear center" 11 "Rear corner right" 12 "Object center" 13 "Rear wheelcase center" 14 "Front wheelcase center" 15 "Invalid" ;
VAL_ 433 RFC_Obj27_MeasurementStatus 0 "not measured" 1 "measured" ;
VAL_ 433 RFC_Obj27_Valid 0 "not valid" 1 "valid" ;
VAL_ 433 RFC_Obj27_BehaviorType 0 "No_Target" 1 "FCTA" 2 "RCTA" 3 "BSD" 4 "LCA" 5 "HWA" 6 "Reserved1" 7 "Reserved2" ;
VAL_ 434 RFC_Obj28_ReferencePoint 0 "Front corner left" 1 "Front center" 2 "Front corner right" 3 "Front wheelcase left" 4 "Front wheelcase right" 5 "Side middle left" 6 "Side middle right" 7 "Rear wheelcase left" 8 "Rear wheelcase right" 9 "Rear corner left" 10 "Rear center" 11 "Rear corner right" 12 "Object center" 13 "Rear wheelcase center" 14 "Front wheelcase center" 15 "Invalid" ;
VAL_ 434 RFC_Obj28_MeasurementStatus 0 "not measured" 1 "measured" ;
VAL_ 434 RFC_Obj28_Valid 0 "not valid" 1 "valid" ;
VAL_ 434 RFC_Obj28_BehaviorType 0 "No_Target" 1 "FCTA" 2 "RCTA" 3 "BSD" 4 "LCA" 5 "HWA" 6 "Reserved1" 7 "Reserved2" ;
VAL_ 435 RFC_Obj29_ReferencePoint 0 "Front corner left" 1 "Front center" 2 "Front corner right" 3 "Front wheelcase left" 4 "Front wheelcase right" 5 "Side middle left" 6 "Side middle right" 7 "Rear wheelcase left" 8 "Rear wheelcase right" 9 "Rear corner left" 10 "Rear center" 11 "Rear corner right" 12 "Object center" 13 "Rear wheelcase center" 14 "Front wheelcase center" 15 "Invalid" ;
VAL_ 435 RFC_Obj29_MeasurementStatus 0 "not measured" 1 "measured" ;
VAL_ 435 RFC_Obj29_Valid 0 "not valid" 1 "valid" ;
VAL_ 435 RFC_Obj29_BehaviorType 0 "No_Target" 1 "FCTA" 2 "RCTA" 3 "BSD" 4 "LCA" 5 "HWA" 6 "Reserved1" 7 "Reserved2" ;
VAL_ 436 RFC_Obj30_ReferencePoint 0 "Front corner left" 1 "Front center" 2 "Front corner right" 3 "Front wheelcase left" 4 "Front wheelcase right" 5 "Side middle left" 6 "Side middle right" 7 "Rear wheelcase left" 8 "Rear wheelcase right" 9 "Rear corner left" 10 "Rear center" 11 "Rear corner right" 12 "Object center" 13 "Rear wheelcase center" 14 "Front wheelcase center" 15 "Invalid" ;
VAL_ 436 RFC_Obj30_MeasurementStatus 0 "not measured" 1 "measured" ;
VAL_ 436 RFC_Obj30_Valid 0 "not valid" 1 "valid" ;
VAL_ 436 RFC_Obj30_BehaviorType 0 "No_Target" 1 "FCTA" 2 "RCTA" 3 "BSD" 4 "LCA" 5 "HWA" 6 "Reserved1" 7 "Reserved2" ;
VAL_ 437 RFC_Obj31_ReferencePoint 0 "Front corner left" 1 "Front center" 2 "Front corner right" 3 "Front wheelcase left" 4 "Front wheelcase right" 5 "Side middle left" 6 "Side middle right" 7 "Rear wheelcase left" 8 "Rear wheelcase right" 9 "Rear corner left" 10 "Rear center" 11 "Rear corner right" 12 "Object center" 13 "Rear wheelcase center" 14 "Front wheelcase center" 15 "Invalid" ;
VAL_ 437 RFC_Obj31_MeasurementStatus 0 "not measured" 1 "measured" ;
VAL_ 437 RFC_Obj31_Valid 0 "not valid" 1 "valid" ;
VAL_ 437 RFC_Obj31_BehaviorType 0 "No_Target" 1 "FCTA" 2 "RCTA" 3 "BSD" 4 "LCA" 5 "HWA" 6 "Reserved1" 7 "Reserved2" ;
VAL_ 916 RFL_ObjHdr_AziOutOfSpec 0 "In spec Azimuth Alignemdn" 1 "Out of spec Azimuth Alignement" ;
VAL_ 916 RFL_ObjHdr_ElevOutOfSpec 0 "In Spec Elevation Alignment" 1 "Out of spec Elevation Alignement" ;
VAL_ 916 RFL_ObjHdr_ObjectDownSel 0 "no downselection" 1 "downselected" ;
VAL_ 918 RFL_Obj00_ReferencePoint 0 "Front corner left" 1 "Front center" 2 "Front corner right" 3 "Front wheelcase left" 4 "Front wheelcase right" 5 "Side middle left" 6 "Side middle right" 7 "Rear wheelcase left" 8 "Rear wheelcase right" 9 "Rear corner left" 10 "Rear center" 11 "Rear corner right" 12 "Object center" 13 "Rear wheelcase center" 14 "Front wheelcase center" 15 "Invalid" ;
VAL_ 918 RFL_Obj00_MeasurementStatus 0 "not measured" 1 "measured" ;
VAL_ 918 RFL_Obj00_Valid 0 "not valid" 1 "valid" ;
VAL_ 918 RFL_Obj00_BehaviorType 0 "No_Target" 1 "FCTA" 2 "RCTA" 3 "BSD" 4 "LCA" 5 "HWA" 6 "Reserved1" 7 "Reserved2" ;
VAL_ 919 RFL_Obj01_ReferencePoint 0 "Front corner left" 1 "Front center" 2 "Front corner right" 3 "Front wheelcase left" 4 "Front wheelcase right" 5 "Side middle left" 6 "Side middle right" 7 "Rear wheelcase left" 8 "Rear wheelcase right" 9 "Rear corner left" 10 "Rear center" 11 "Rear corner right" 12 "Object center" 13 "Rear wheelcase center" 14 "Front wheelcase center" 15 "Invalid" ;
VAL_ 919 RFL_Obj01_MeasurementStatus 0 "not measured" 1 "measured" ;
VAL_ 919 RFL_Obj01_Valid 0 "not valid" 1 "valid" ;
VAL_ 919 RFL_Obj01_BehaviorType 0 "No_Target" 1 "FCTA" 2 "RCTA" 3 "BSD" 4 "LCA" 5 "HWA" 6 "Reserved1" 7 "Reserved2" ;
VAL_ 920 RFL_Obj02_ReferencePoint 0 "Front corner left" 1 "Front center" 2 "Front corner right" 3 "Front wheelcase left" 4 "Front wheelcase right" 5 "Side middle left" 6 "Side middle right" 7 "Rear wheelcase left" 8 "Rear wheelcase right" 9 "Rear corner left" 10 "Rear center" 11 "Rear corner right" 12 "Object center" 13 "Rear wheelcase center" 14 "Front wheelcase center" 15 "Invalid" ;
VAL_ 920 RFL_Obj02_MeasurementStatus 0 "not measured" 1 "measured" ;
VAL_ 920 RFL_Obj02_Valid 0 "not valid" 1 "valid" ;
VAL_ 920 RFL_Obj02_BehaviorType 0 "No_Target" 1 "FCTA" 2 "RCTA" 3 "BSD" 4 "LCA" 5 "HWA" 6 "Reserved1" 7 "Reserved2" ;
VAL_ 921 RFL_Obj03_ReferencePoint 0 "Front corner left" 1 "Front center" 2 "Front corner right" 3 "Front wheelcase left" 4 "Front wheelcase right" 5 "Side middle left" 6 "Side middle right" 7 "Rear wheelcase left" 8 "Rear wheelcase right" 9 "Rear corner left" 10 "Rear center" 11 "Rear corner right" 12 "Object center" 13 "Rear wheelcase center" 14 "Front wheelcase center" 15 "Invalid" ;
VAL_ 921 RFL_Obj03_MeasurementStatus 0 "not measured" 1 "measured" ;
VAL_ 921 RFL_Obj03_Valid 0 "not valid" 1 "valid" ;
VAL_ 921 RFL_Obj03_BehaviorType 0 "No_Target" 1 "FCTA" 2 "RCTA" 3 "BSD" 4 "LCA" 5 "HWA" 6 "Reserved1" 7 "Reserved2" ;
VAL_ 922 RFL_Obj04_ReferencePoint 0 "Front corner left" 1 "Front center" 2 "Front corner right" 3 "Front wheelcase left" 4 "Front wheelcase right" 5 "Side middle left" 6 "Side middle right" 7 "Rear wheelcase left" 8 "Rear wheelcase right" 9 "Rear corner left" 10 "Rear center" 11 "Rear corner right" 12 "Object center" 13 "Rear wheelcase center" 14 "Front wheelcase center" 15 "Invalid" ;
VAL_ 922 RFL_Obj04_MeasurementStatus 0 "not measured" 1 "measured" ;
VAL_ 922 RFL_Obj04_Valid 0 "not valid" 1 "valid" ;
VAL_ 922 RFL_Obj04_BehaviorType 0 "No_Target" 1 "FCTA" 2 "RCTA" 3 "BSD" 4 "LCA" 5 "HWA" 6 "Reserved1" 7 "Reserved2" ;
VAL_ 923 RFL_Obj05_ReferencePoint 0 "Front corner left" 1 "Front center" 2 "Front corner right" 3 "Front wheelcase left" 4 "Front wheelcase right" 5 "Side middle left" 6 "Side middle right" 7 "Rear wheelcase left" 8 "Rear wheelcase right" 9 "Rear corner left" 10 "Rear center" 11 "Rear corner right" 12 "Object center" 13 "Rear wheelcase center" 14 "Front wheelcase center" 15 "Invalid" ;
VAL_ 923 RFL_Obj05_MeasurementStatus 0 "not measured" 1 "measured" ;
VAL_ 923 RFL_Obj05_Valid 0 "not valid" 1 "valid" ;
VAL_ 923 RFL_Obj05_BehaviorType 0 "No_Target" 1 "FCTA" 2 "RCTA" 3 "BSD" 4 "LCA" 5 "HWA" 6 "Reserved1" 7 "Reserved2" ;
VAL_ 924 RFL_Obj06_ReferencePoint 0 "Front corner left" 1 "Front center" 2 "Front corner right" 3 "Front wheelcase left" 4 "Front wheelcase right" 5 "Side middle left" 6 "Side middle right" 7 "Rear wheelcase left" 8 "Rear wheelcase right" 9 "Rear corner left" 10 "Rear center" 11 "Rear corner right" 12 "Object center" 13 "Rear wheelcase center" 14 "Front wheelcase center" 15 "Invalid" ;
VAL_ 924 RFL_Obj06_MeasurementStatus 0 "not measured" 1 "measured" ;
VAL_ 924 RFL_Obj06_Valid 0 "not valid" 1 "valid" ;
VAL_ 924 RFL_Obj06_BehaviorType 0 "No_Target" 1 "FCTA" 2 "RCTA" 3 "BSD" 4 "LCA" 5 "HWA" 6 "Reserved1" 7 "Reserved2" ;
SIG_GROUP_ 432 SG_RFC_Obj26 1 : RFC_Obj26_CRC RFC_Obj26_AliveCtr RFC_Obj26_ProtBlockCtr RFC_Obj26_ReferencePoint RFC_Obj26_ObjId RFC_Obj26_MeasurementStatus RFC_Obj26_Px RFC_Obj26_Py RFC_Obj26_PxVnce RFC_Obj26_PyVnce RFC_Obj26_Vx RFC_Obj26_Vy RFC_Obj26_Ax RFC_Obj26_Ay RFC_Obj26_OrientationYaw RFC_Obj26_ExistProb RFC_Obj26_VxVnce RFC_Obj26_VyVnce RFC_Obj26_AxVnce RFC_Obj26_AyVnce RFC_Obj26_OrientationYawVnce RFC_Obj26_MovingObserved RFC_Obj26_MovingProbability RFC_Obj26_Length RFC_Obj26_Valid RFC_Obj26_LengthVnce RFC_Obj26_WidthVnce RFC_Obj26_Width RFC_Obj26_BehaviorType RFC_Obj26_ObstacleConf RFC_Obj26_NonObstacleConf RFC_Obj26_PxPyCoVnce RFC_Obj26_PxVxCoVnce RFC_Obj26_PxVyCoVnce RFC_Obj26_PyVxCoVnce RFC_Obj26_PyVyCoVnce RFC_Obj26_VxVyCoVnce RFC_Obj26_PxAxCoVnce RFC_Obj26_PxAyCoVnce RFC_Obj26_PyAxCoVnce RFC_Obj26_PyAyCoVnce RFC_Obj26_VxAxCoVnce RFC_Obj26_VxAyCoVnce RFC_Obj26_VyAxCoVnce RFC_Obj26_VyAyCoVnce RFC_Obj26_AxAyCoVnce RFC_Obj26_MobileObstConf RFC_Obj26_Mob4PlusWhlConf RFC_Obj26_Mob2WhlConf RFC_Obj26_MobPedConf RFC_Obj26_FourPlusWhlCarConf RFC_Obj26_FourPlusWhlHGVConf RFC_Obj26_GroundReflexConf RFC_Obj26_StatObstConf RFC_Obj26_StatBarrierConf;
SIG_GROUP_ 433 SG_RFC_Obj27 1 : RFC_Obj27_CRC RFC_Obj27_AliveCtr RFC_Obj27_ProtBlockCtr RFC_Obj27_ReferencePoint RFC_Obj27_ObjId RFC_Obj27_MeasurementStatus RFC_Obj27_Px RFC_Obj27_Py RFC_Obj27_PxVnce RFC_Obj27_PyVnce RFC_Obj27_Vx RFC_Obj27_Vy RFC_Obj27_Ax RFC_Obj27_Ay RFC_Obj27_OrientationYaw RFC_Obj27_ExistProb RFC_Obj27_VxVnce RFC_Obj27_VyVnce RFC_Obj27_AxVnce RFC_Obj27_AyVnce RFC_Obj27_OrientationYawVnce RFC_Obj27_MovingObserved RFC_Obj27_MovingProbability RFC_Obj27_Length RFC_Obj27_Valid RFC_Obj27_LengthVnce RFC_Obj27_WidthVnce RFC_Obj27_Width RFC_Obj27_BehaviorType RFC_Obj27_ObstacleConf RFC_Obj27_NonObstacleConf RFC_Obj27_PxPyCoVnce RFC_Obj27_PxVxCoVnce RFC_Obj27_PxVyCoVnce RFC_Obj27_PyVxCoVnce RFC_Obj27_PyVyCoVnce RFC_Obj27_VxVyCoVnce RFC_Obj27_PxAxCoVnce RFC_Obj27_PxAyCoVnce RFC_Obj27_PyAxCoVnce RFC_Obj27_PyAyCoVnce RFC_Obj27_VxAxCoVnce RFC_Obj27_VxAyCoVnce RFC_Obj27_VyAxCoVnce RFC_Obj27_VyAyCoVnce RFC_Obj27_AxAyCoVnce RFC_Obj27_MobileObstConf RFC_Obj27_Mob4PlusWhlConf RFC_Obj27_Mob2WhlConf RFC_Obj27_MobPedConf RFC_Obj27_FourPlusWhlCarConf RFC_Obj27_FourPlusWhlHGVConf RFC_Obj27_GroundReflexConf RFC_Obj27_StatObstConf RFC_Obj27_StatBarrierConf;
SIG_GROUP_ 434 SG_RFC_Obj28 1 : RFC_Obj28_CRC RFC_Obj28_AliveCtr RFC_Obj28_ProtBlockCtr RFC_Obj28_ReferencePoint RFC_Obj28_ObjId RFC_Obj28_MeasurementStatus RFC_Obj28_Px RFC_Obj28_Py RFC_Obj28_PxVnce RFC_Obj28_PyVnce RFC_Obj28_Vx RFC_Obj28_Vy RFC_Obj28_Ax RFC_Obj28_Ay RFC_Obj28_OrientationYaw RFC_Obj28_ExistProb RFC_Obj28_VxVnce RFC_Obj28_VyVnce RFC_Obj28_AxVnce RFC_Obj28_AyVnce RFC_Obj28_OrientationYawVnce RFC_Obj28_MovingObserved RFC_Obj28_MovingProbability RFC_Obj28_Length RFC_Obj28_Valid RFC_Obj28_LengthVnce RFC_Obj28_WidthVnce RFC_Obj28_Width RFC_Obj28_BehaviorType RFC_Obj28_ObstacleConf RFC_Obj28_NonObstacleConf RFC_Obj28_PxPyCoVnce RFC_Obj28_PxVxCoVnce RFC_Obj28_PxVyCoVnce RFC_Obj28_PyVxCoVnce RFC_Obj28_PyVyCoVnce RFC_Obj28_VxVyCoVnce RFC_Obj28_PxAxCoVnce RFC_Obj28_PxAyCoVnce RFC_Obj28_PyAxCoVnce RFC_Obj28_PyAyCoVnce RFC_Obj28_VxAxCoVnce RFC_Obj28_VxAyCoVnce RFC_Obj28_VyAxCoVnce RFC_Obj28_VyAyCoVnce RFC_Obj28_AxAyCoVnce RFC_Obj28_MobileObstConf RFC_Obj28_Mob4PlusWhlConf RFC_Obj28_Mob2WhlConf RFC_Obj28_MobPedConf RFC_Obj28_FourPlusWhlCarConf RFC_Obj28_FourPlusWhlHGVConf RFC_Obj28_GroundReflexConf RFC_Obj28_StatObstConf RFC_Obj28_StatBarrierConf;
SIG_GROUP_ 435 SG_RFC_Obj29 1 : RFC_Obj29_CRC RFC_Obj29_AliveCtr RFC_Obj29_ProtBlockCtr RFC_Obj29_ReferencePoint RFC_Obj29_ObjId RFC_Obj29_MeasurementStatus RFC_Obj29_Px RFC_Obj29_Py RFC_Obj29_PxVnce RFC_Obj29_PyVnce RFC_Obj29_Vx RFC_Obj29_Vy RFC_Obj29_Ax RFC_Obj29_Ay RFC_Obj29_OrientationYaw RFC_Obj29_ExistProb RFC_Obj29_VxVnce RFC_Obj29_VyVnce RFC_Obj29_AxVnce RFC_Obj29_AyVnce RFC_Obj29_OrientationYawVnce RFC_Obj29_MovingObserved RFC_Obj29_MovingProbability RFC_Obj29_Length RFC_Obj29_Valid RFC_Obj29_LengthVnce RFC_Obj29_WidthVnce RFC_Obj29_Width RFC_Obj29_BehaviorType RFC_Obj29_ObstacleConf RFC_Obj29_NonObstacleConf RFC_Obj29_PxPyCoVnce RFC_Obj29_PxVxCoVnce RFC_Obj29_PxVyCoVnce RFC_Obj29_PyVxCoVnce RFC_Obj29_PyVyCoVnce RFC_Obj29_VxVyCoVnce RFC_Obj29_PxAxCoVnce RFC_Obj29_PxAyCoVnce RFC_Obj29_PyAxCoVnce RFC_Obj29_PyAyCoVnce RFC_Obj29_VxAxCoVnce RFC_Obj29_VxAyCoVnce RFC_Obj29_VyAxCoVnce RFC_Obj29_VyAyCoVnce RFC_Obj29_AxAyCoVnce RFC_Obj29_MobileObstConf RFC_Obj29_Mob4PlusWhlConf RFC_Obj29_Mob2WhlConf RFC_Obj29_MobPedConf RFC_Obj29_FourPlusWhlCarConf RFC_Obj29_FourPlusWhlHGVConf RFC_Obj29_GroundReflexConf RFC_Obj29_StatObstConf RFC_Obj29_StatBarrierConf;
SIG_GROUP_ 436 SG_RFC_Obj30 1 : RFC_Obj30_CRC RFC_Obj30_AliveCtr RFC_Obj30_ProtBlockCtr RFC_Obj30_ReferencePoint RFC_Obj30_ObjId RFC_Obj30_MeasurementStatus RFC_Obj30_Px RFC_Obj30_Py RFC_Obj30_PxVnce RFC_Obj30_PyVnce RFC_Obj30_Vx RFC_Obj30_Vy RFC_Obj30_Ax RFC_Obj30_Ay RFC_Obj30_OrientationYaw RFC_Obj30_ExistProb RFC_Obj30_VxVnce RFC_Obj30_VyVnce RFC_Obj30_AxVnce RFC_Obj30_AyVnce RFC_Obj30_OrientationYawVnce RFC_Obj30_MovingObserved RFC_Obj30_MovingProbability RFC_Obj30_Length RFC_Obj30_Valid RFC_Obj30_LengthVnce RFC_Obj30_WidthVnce RFC_Obj30_Width RFC_Obj30_BehaviorType RFC_Obj30_ObstacleConf RFC_Obj30_NonObstacleConf RFC_Obj30_PxPyCoVnce RFC_Obj30_PxVxCoVnce RFC_Obj30_PxVyCoVnce RFC_Obj30_PyVxCoVnce RFC_Obj30_PyVyCoVnce RFC_Obj30_VxVyCoVnce RFC_Obj30_PxAxCoVnce RFC_Obj30_PxAyCoVnce RFC_Obj30_PyAxCoVnce RFC_Obj30_PyAyCoVnce RFC_Obj30_VxAxCoVnce RFC_Obj30_VxAyCoVnce RFC_Obj30_VyAxCoVnce RFC_Obj30_VyAyCoVnce RFC_Obj30_AxAyCoVnce RFC_Obj30_MobileObstConf RFC_Obj30_Mob4PlusWhlConf RFC_Obj30_Mob2WhlConf RFC_Obj30_MobPedConf RFC_Obj30_FourPlusWhlCarConf RFC_Obj30_FourPlusWhlHGVConf RFC_Obj30_GroundReflexConf RFC_Obj30_StatObstConf RFC_Obj30_StatBarrierConf;
SIG_GROUP_ 437 SG_RFC_Obj31 1 : RFC_Obj31_CRC RFC_Obj31_AliveCtr RFC_Obj31_ProtBlockCtr RFC_Obj31_ReferencePoint RFC_Obj31_ObjId RFC_Obj31_MeasurementStatus RFC_Obj31_Px RFC_Obj31_Py RFC_Obj31_PxVnce RFC_Obj31_PyVnce RFC_Obj31_Vx RFC_Obj31_Vy RFC_Obj31_Ax RFC_Obj31_Ay RFC_Obj31_OrientationYaw RFC_Obj31_ExistProb RFC_Obj31_VxVnce RFC_Obj31_VyVnce RFC_Obj31_AxVnce RFC_Obj31_AyVnce RFC_Obj31_OrientationYawVnce RFC_Obj31_MovingObserved RFC_Obj31_MovingProbability RFC_Obj31_Length RFC_Obj31_Valid RFC_Obj31_LengthVnce RFC_Obj31_WidthVnce RFC_Obj31_Width RFC_Obj31_BehaviorType RFC_Obj31_ObstacleConf RFC_Obj31_NonObstacleConf RFC_Obj31_PxPyCoVnce RFC_Obj31_PxVxCoVnce RFC_Obj31_PxVyCoVnce RFC_Obj31_PyVxCoVnce RFC_Obj31_PyVyCoVnce RFC_Obj31_VxVyCoVnce RFC_Obj31_PxAxCoVnce RFC_Obj31_PxAyCoVnce RFC_Obj31_PyAxCoVnce RFC_Obj31_PyAyCoVnce RFC_Obj31_VxAxCoVnce RFC_Obj31_VxAyCoVnce RFC_Obj31_VyAxCoVnce RFC_Obj31_VyAyCoVnce RFC_Obj31_AxAyCoVnce RFC_Obj31_MobileObstConf RFC_Obj31_Mob4PlusWhlConf RFC_Obj31_Mob2WhlConf RFC_Obj31_MobPedConf RFC_Obj31_FourPlusWhlCarConf RFC_Obj31_FourPlusWhlHGVConf RFC_Obj31_GroundReflexConf RFC_Obj31_StatObstConf RFC_Obj31_StatBarrierConf;
SIG_GROUP_ 916 SG_RFL_ObjHdr 1 : RFL_ObjHdr_CRC RFL_ObjHdr_AliveCtr RFL_ObjHdr_ProtBlockCtr RFL_ObjHdr_IfVersionIdMajor RFL_ObjHdr_IfVersionIdMinor RFL_ObjHdr_NumValidObjects RFL_ObjHdr_TimeStampStatus RFL_ObjHdr_TimeStamp RFL_ObjHdr_SensorState RFL_ObjHdr_AziOutOfSpec RFL_ObjHdr_ElevOutOfSpec RFL_ObjHdr_ObjectDownSel RFL_ObjHdr_SensorOriginPointY RFL_ObjHdr_SensorOriginPointX RFL_ObjHdr_SensorOriginPointZ RFL_ObjHdr_SensorOrientYaw RFL_ObjHdr_SensorOrientPitch RFL_ObjHdr_SensorOrientRoll RFL_ObjHdr_FovAzimuthBegin RFL_ObjHdr_FovAzimuthEnd RFL_ObjHdr_FovElevationBegin RFL_ObjHdr_FovElevationEnd RFL_ObjHdr_DetectionRange RFL_ObjHdr_TimeStampLocal;
SIG_GROUP_ 918 SG_RFL_Obj00 1 : RFL_Obj00_CRC RFL_Obj00_AliveCtr RFL_Obj00_ProtBlockCtr RFL_Obj00_ReferencePoint RFL_Obj00_ObjId RFL_Obj00_MeasurementStatus RFL_Obj00_Px RFL_Obj00_Py RFL_Obj00_PxVnce RFL_Obj00_PyVnce RFL_Obj00_Vx RFL_Obj00_Vy RFL_Obj00_Ax RFL_Obj00_Ay RFL_Obj00_OrientationYaw RFL_Obj00_ExistProb RFL_Obj00_VxVnce RFL_Obj00_VyVnce RFL_Obj00_AxVnce RFL_Obj00_AyVnce RFL_Obj00_OrientationYawVnce RFL_Obj00_MovingObserved RFL_Obj00_MovingProbability RFL_Obj00_Length RFL_Obj00_Valid RFL_Obj00_LengthVnce RFL_Obj00_WidthVnce RFL_Obj00_Width RFL_Obj00_BehaviorType RFL_Obj00_ObstacleConf RFL_Obj00_NonObstacleConf RFL_Obj00_PxPyCoVnce RFL_Obj00_PxVxCoVnce RFL_Obj00_PxVyCoVnce RFL_Obj00_PyVxCoVnce RFL_Obj00_PyVyCoVnce RFL_Obj00_VxVyCoVnce RFL_Obj00_PxAxCoVnce RFL_Obj00_PxAyCoVnce RFL_Obj00_PyAxCoVnce RFL_Obj00_PyAyCoVnce RFL_Obj00_VxAxCoVnce RFL_Obj00_VxAyCoVnce RFL_Obj00_VyAxCoVnce RFL_Obj00_VyAyCoVnce RFL_Obj00_AxAyCoVnce RFL_Obj00_MobileObstConf RFL_Obj00_Mob4PlusWhlConf RFL_Obj00_Mob2WhlConf RFL_Obj00_MobPedConf RFL_Obj00_FourPlusWhlCarConf RFL_Obj00_FourPlusWhlHGVConf RFL_Obj00_GroundReflexConf RFL_Obj00_StatObstConf RFL_Obj00_StatBarrierConf;
SIG_GROUP_ 919 SG_RFL_Obj01 1 : RFL_Obj01_CRC RFL_Obj01_AliveCtr RFL_Obj01_ProtBlockCtr RFL_Obj01_ReferencePoint RFL_Obj01_ObjId RFL_Obj01_MeasurementStatus RFL_Obj01_Px RFL_Obj01_Py RFL_Obj01_PxVnce RFL_Obj01_PyVnce RFL_Obj01_Vx RFL_Obj01_Vy RFL_Obj01_Ax RFL_Obj01_Ay RFL_Obj01_OrientationYaw RFL_Obj01_ExistProb RFL_Obj01_VxVnce RFL_Obj01_VyVnce RFL_Obj01_AxVnce RFL_Obj01_AyVnce RFL_Obj01_OrientationYawVnce RFL_Obj01_MovingObserved RFL_Obj01_MovingProbability RFL_Obj01_Length RFL_Obj01_Valid RFL_Obj01_LengthVnce RFL_Obj01_WidthVnce RFL_Obj01_Width RFL_Obj01_BehaviorType RFL_Obj01_ObstacleConf RFL_Obj01_NonObstacleConf RFL_Obj01_PxPyCoVnce RFL_Obj01_PxVxCoVnce RFL_Obj01_PxVyCoVnce RFL_Obj01_PyVxCoVnce RFL_Obj01_PyVyCoVnce RFL_Obj01_VxVyCoVnce RFL_Obj01_PxAxCoVnce RFL_Obj01_PxAyCoVnce RFL_Obj01_PyAxCoVnce RFL_Obj01_PyAyCoVnce RFL_Obj01_VxAxCoVnce RFL_Obj01_VxAyCoVnce RFL_Obj01_VyAxCoVnce RFL_Obj01_VyAyCoVnce RFL_Obj01_AxAyCoVnce RFL_Obj01_MobileObstConf RFL_Obj01_Mob4PlusWhlConf RFL_Obj01_Mob2WhlConf RFL_Obj01_MobPedConf RFL_Obj01_FourPlusWhlCarConf RFL_Obj01_FourPlusWhlHGVConf RFL_Obj01_GroundReflexConf RFL_Obj01_StatObstConf RFL_Obj01_StatBarrierConf;
SIG_GROUP_ 920 SG_RFL_Obj02 1 : RFL_Obj02_CRC RFL_Obj02_AliveCtr RFL_Obj02_ProtBlockCtr RFL_Obj02_ReferencePoint RFL_Obj02_ObjId RFL_Obj02_MeasurementStatus RFL_Obj02_Px RFL_Obj02_Py RFL_Obj02_PxVnce RFL_Obj02_PyVnce RFL_Obj02_Vx RFL_Obj02_Vy RFL_Obj02_Ax RFL_Obj02_Ay RFL_Obj02_OrientationYaw RFL_Obj02_ExistProb RFL_Obj02_VxVnce RFL_Obj02_VyVnce RFL_Obj02_AxVnce RFL_Obj02_AyVnce RFL_Obj02_OrientationYawVnce RFL_Obj02_MovingObserved RFL_Obj02_MovingProbability RFL_Obj02_Length RFL_Obj02_Valid RFL_Obj02_LengthVnce RFL_Obj02_WidthVnce RFL_Obj02_Width RFL_Obj02_BehaviorType RFL_Obj02_ObstacleConf RFL_Obj02_NonObstacleConf RFL_Obj02_PxPyCoVnce RFL_Obj02_PxVxCoVnce RFL_Obj02_PxVyCoVnce RFL_Obj02_PyVxCoVnce RFL_Obj02_PyVyCoVnce RFL_Obj02_VxVyCoVnce RFL_Obj02_PxAxCoVnce RFL_Obj02_PxAyCoVnce RFL_Obj02_PyAxCoVnce RFL_Obj02_PyAyCoVnce RFL_Obj02_VxAxCoVnce RFL_Obj02_VxAyCoVnce RFL_Obj02_VyAxCoVnce RFL_Obj02_VyAyCoVnce RFL_Obj02_AxAyCoVnce RFL_Obj02_MobileObstConf RFL_Obj02_Mob4PlusWhlConf RFL_Obj02_Mob2WhlConf RFL_Obj02_MobPedConf RFL_Obj02_FourPlusWhlCarConf RFL_Obj02_FourPlusWhlHGVConf RFL_Obj02_GroundReflexConf RFL_Obj02_StatObstConf RFL_Obj02_StatBarrierConf;
SIG_GROUP_ 921 SG_RFL_Obj03 1 : RFL_Obj03_CRC RFL_Obj03_AliveCtr RFL_Obj03_ProtBlockCtr RFL_Obj03_ReferencePoint RFL_Obj03_ObjId RFL_Obj03_MeasurementStatus RFL_Obj03_Px RFL_Obj03_Py RFL_Obj03_PxVnce RFL_Obj03_PyVnce RFL_Obj03_Vx RFL_Obj03_Vy RFL_Obj03_Ax RFL_Obj03_Ay RFL_Obj03_OrientationYaw RFL_Obj03_ExistProb RFL_Obj03_VxVnce RFL_Obj03_VyVnce RFL_Obj03_AxVnce RFL_Obj03_AyVnce RFL_Obj03_OrientationYawVnce RFL_Obj03_MovingObserved RFL_Obj03_MovingProbability RFL_Obj03_Length RFL_Obj03_Valid RFL_Obj03_LengthVnce RFL_Obj03_WidthVnce RFL_Obj03_Width RFL_Obj03_BehaviorType RFL_Obj03_ObstacleConf RFL_Obj03_NonObstacleConf RFL_Obj03_PxPyCoVnce RFL_Obj03_PxVxCoVnce RFL_Obj03_PxVyCoVnce RFL_Obj03_PyVxCoVnce RFL_Obj03_PyVyCoVnce RFL_Obj03_VxVyCoVnce RFL_Obj03_PxAxCoVnce RFL_Obj03_PxAyCoVnce RFL_Obj03_PyAxCoVnce RFL_Obj03_PyAyCoVnce RFL_Obj03_VxAxCoVnce RFL_Obj03_VxAyCoVnce RFL_Obj03_VyAxCoVnce RFL_Obj03_VyAyCoVnce RFL_Obj03_AxAyCoVnce RFL_Obj03_MobileObstConf RFL_Obj03_Mob4PlusWhlConf RFL_Obj03_Mob2WhlConf RFL_Obj03_MobPedConf RFL_Obj03_FourPlusWhlCarConf RFL_Obj03_FourPlusWhlHGVConf RFL_Obj03_GroundReflexConf RFL_Obj03_StatObstConf RFL_Obj03_StatBarrierConf;
SIG_GROUP_ 922 SG_RFL_Obj04 1 : RFL_Obj04_CRC RFL_Obj04_AliveCtr RFL_Obj04_ProtBlockCtr RFL_Obj04_ReferencePoint RFL_Obj04_ObjId RFL_Obj04_MeasurementStatus RFL_Obj04_Px RFL_Obj04_Py RFL_Obj04_PxVnce RFL_Obj04_PyVnce RFL_Obj04_Vx RFL_Obj04_Vy RFL_Obj04_Ax RFL_Obj04_Ay RFL_Obj04_OrientationYaw RFL_Obj04_ExistProb RFL_Obj04_VxVnce RFL_Obj04_VyVnce RFL_Obj04_AxVnce RFL_Obj04_AyVnce RFL_Obj04_OrientationYawVnce RFL_Obj04_MovingObserved RFL_Obj04_MovingProbability RFL_Obj04_Length RFL_Obj04_Valid RFL_Obj04_LengthVnce RFL_Obj04_WidthVnce RFL_Obj04_Width RFL_Obj04_BehaviorType RFL_Obj04_ObstacleConf RFL_Obj04_NonObstacleConf RFL_Obj04_PxPyCoVnce RFL_Obj04_PxVxCoVnce RFL_Obj04_PxVyCoVnce RFL_Obj04_PyVxCoVnce RFL_Obj04_PyVyCoVnce RFL_Obj04_VxVyCoVnce RFL_Obj04_PxAxCoVnce RFL_Obj04_PxAyCoVnce RFL_Obj04_PyAxCoVnce RFL_Obj04_PyAyCoVnce RFL_Obj04_VxAxCoVnce RFL_Obj04_VxAyCoVnce RFL_Obj04_VyAxCoVnce RFL_Obj04_VyAyCoVnce RFL_Obj04_AxAyCoVnce RFL_Obj04_MobileObstConf RFL_Obj04_Mob4PlusWhlConf RFL_Obj04_Mob2WhlConf RFL_Obj04_MobPedConf RFL_Obj04_FourPlusWhlCarConf RFL_Obj04_FourPlusWhlHGVConf RFL_Obj04_GroundReflexConf RFL_Obj04_StatObstConf RFL_Obj04_StatBarrierConf;
SIG_GROUP_ 923 SG_RFL_Obj05 1 : RFL_Obj05_CRC RFL_Obj05_AliveCtr RFL_Obj05_ProtBlockCtr RFL_Obj05_ReferencePoint RFL_Obj05_ObjId RFL_Obj05_MeasurementStatus RFL_Obj05_Px RFL_Obj05_Py RFL_Obj05_PxVnce RFL_Obj05_PyVnce RFL_Obj05_Vx RFL_Obj05_Vy RFL_Obj05_Ax RFL_Obj05_Ay RFL_Obj05_OrientationYaw RFL_Obj05_ExistProb RFL_Obj05_VxVnce RFL_Obj05_VyVnce RFL_Obj05_AxVnce RFL_Obj05_AyVnce RFL_Obj05_OrientationYawVnce RFL_Obj05_MovingObserved RFL_Obj05_MovingProbability RFL_Obj05_Length RFL_Obj05_Valid RFL_Obj05_LengthVnce RFL_Obj05_WidthVnce RFL_Obj05_Width RFL_Obj05_BehaviorType RFL_Obj05_ObstacleConf RFL_Obj05_NonObstacleConf RFL_Obj05_PxPyCoVnce RFL_Obj05_PxVxCoVnce RFL_Obj05_PxVyCoVnce RFL_Obj05_PyVxCoVnce RFL_Obj05_PyVyCoVnce RFL_Obj05_VxVyCoVnce RFL_Obj05_PxAxCoVnce RFL_Obj05_PxAyCoVnce RFL_Obj05_PyAxCoVnce RFL_Obj05_PyAyCoVnce RFL_Obj05_VxAxCoVnce RFL_Obj05_VxAyCoVnce RFL_Obj05_VyAxCoVnce RFL_Obj05_VyAyCoVnce RFL_Obj05_AxAyCoVnce RFL_Obj05_MobileObstConf RFL_Obj05_Mob4PlusWhlConf RFL_Obj05_Mob2WhlConf RFL_Obj05_MobPedConf RFL_Obj05_FourPlusWhlCarConf RFL_Obj05_FourPlusWhlHGVConf RFL_Obj05_GroundReflexConf RFL_Obj05_StatObstConf RFL_Obj05_StatBarrierConf;
SIG_GROUP_ 924 SG_RFL_Obj06 1 : RFL_Obj06_CRC RFL_Obj06_AliveCtr RFL_Obj06_ProtBlockCtr RFL_Obj06_ReferencePoint RFL_Obj06_ObjId RFL_Obj06_MeasurementStatus RFL_Obj06_Px RFL_Obj06_Py RFL_Obj06_PxVnce RFL_Obj06_PyVnce RFL_Obj06_Vx RFL_Obj06_Vy RFL_Obj06_Ax RFL_Obj06_Ay RFL_Obj06_OrientationYaw RFL_Obj06_ExistProb RFL_Obj06_VxVnce RFL_Obj06_VyVnce RFL_Obj06_AxVnce RFL_Obj06_AyVnce RFL_Obj06_OrientationYawVnce RFL_Obj06_MovingObserved RFL_Obj06_MovingProbability RFL_Obj06_Length RFL_Obj06_Valid RFL_Obj06_LengthVnce RFL_Obj06_WidthVnce RFL_Obj06_Width RFL_Obj06_BehaviorType RFL_Obj06_ObstacleConf RFL_Obj06_NonObstacleConf RFL_Obj06_PxPyCoVnce RFL_Obj06_PxVxCoVnce RFL_Obj06_PxVyCoVnce RFL_Obj06_PyVxCoVnce RFL_Obj06_PyVyCoVnce RFL_Obj06_VxVyCoVnce RFL_Obj06_PxAxCoVnce RFL_Obj06_PxAyCoVnce RFL_Obj06_PyAxCoVnce RFL_Obj06_PyAyCoVnce RFL_Obj06_VxAxCoVnce RFL_Obj06_VxAyCoVnce RFL_Obj06_VyAxCoVnce RFL_Obj06_VyAyCoVnce RFL_Obj06_AxAyCoVnce RFL_Obj06_MobileObstConf RFL_Obj06_Mob4PlusWhlConf RFL_Obj06_Mob2WhlConf RFL_Obj06_MobPedConf RFL_Obj06_FourPlusWhlCarConf RFL_Obj06_FourPlusWhlHGVConf RFL_Obj06_GroundReflexConf RFL_Obj06_StatObstConf RFL_Obj06_StatBarrierConf;
