VERSION "created by canmatrix"

NS_ :

BS_:

BU_: RadarFrontCenter VideoFrontCenter RadarFrontLeft RadarFrontRight ReceiveECU

BO_ 418 RFC_Obj12: 64 RadarFrontCenter
 SG_ RFC_Obj12_CRC : 0|16@1+ (1,0) [0|65535] ""  VideoFrontCenter
 SG_ RFC_Obj12_AliveCtr : 16|8@1+ (1,0) [0|255] ""  VideoFrontCenter
 SG_ RFC_Obj12_ProtBlockCtr : 24|4@1+ (1,0) [0|15] ""  VideoFrontCenter
 SG_ RFC_Obj12_ReferencePoint : 28|4@1+ (1,0) [0|15] ""  VideoFrontCenter
 SG_ RFC_Obj12_ObjId : 32|7@1+ (1,0) [0|127] ""  VideoFrontCenter
 SG_ RFC_Obj12_MeasurementStatus : 39|1@1+ (1,0) [0|1] ""  VideoFrontCenter
 SG_ RFC_Obj12_Px : 40|13@1+ (0.0625,-256) [-256|255.9375] "m"  VideoFrontCenter
 SG_ RFC_Obj12_Py : 53|11@1+ (0.125,-128) [-128|127.875] "m"  VideoFrontCenter
 SG_ RFC_Obj12_PxVnce : 64|12@1+ (0.01,0) [0|30] "m^2"  VideoFrontCenter
 SG_ RFC_Obj12_PyVnce : 76|12@1+ (0.01,0) [0|30] "m^2"  VideoFrontCenter
 SG_ RFC_Obj12_Vx : 88|12@1+ (0.0625,-128) [-128|127.9375] "m/s"  VideoFrontCenter
 SG_ RFC_Obj12_Vy : 100|10@1+ (0.125,-64) [-64|63.875] "m/s"  VideoFrontCenter
 SG_ RFC_Obj12_Ax : 110|10@1+ (0.03125,-16) [-16|15.96875] "m/s^2"  VideoFrontCenter
 SG_ RFC_Obj12_Ay : 120|9@1+ (0.0625,-16) [-16|15.9375] "m/s^2"  VideoFrontCenter
 SG_ RFC_Obj12_OrientationYaw : 129|9@1+ (0.0175,-4.48) [-3.15|3.15] "rad"  VideoFrontCenter
 SG_ RFC_Obj12_ExistProb : 138|6@1+ (2,0) [0|100] "%"  VideoFrontCenter
 SG_ RFC_Obj12_VxVnce : 144|12@1+ (0.01,0) [0|30] "m^2/s^2"  VideoFrontCenter
 SG_ RFC_Obj12_VyVnce : 156|12@1+ (0.01,0) [0|30] "m^2/s^2"  VideoFrontCenter
 SG_ RFC_Obj12_AxVnce : 168|12@1+ (0.01,0) [0|30] "m^2/s^4"  VideoFrontCenter
 SG_ RFC_Obj12_AyVnce : 180|12@1+ (0.01,0) [0|30] "m^2/s^4"  VideoFrontCenter
 SG_ RFC_Obj12_OrientationYawVnce : 192|12@1+ (0.0003,0) [0|1] "rad^2"  VideoFrontCenter
 SG_ RFC_Obj12_MovingObserved : 204|6@1+ (2,0) [0|100] "%"  VideoFrontCenter
 SG_ RFC_Obj12_MovingProbability : 210|6@1+ (2,0) [0|100] "%"  VideoFrontCenter
 SG_ RFC_Obj12_Length : 216|7@1+ (0.125,0) [0|15.875] "m"  VideoFrontCenter
 SG_ RFC_Obj12_Valid : 223|1@1+ (1,0) [0|1] ""  VideoFrontCenter
 SG_ RFC_Obj12_LengthVnce : 224|12@1+ (0.01,0) [0|30] "m^2"  VideoFrontCenter
 SG_ RFC_Obj12_WidthVnce : 236|12@1+ (0.01,0) [0|30] "m^2"  VideoFrontCenter
 SG_ RFC_Obj12_Width : 248|7@1+ (0.125,0) [0|15.875] "m"  VideoFrontCenter
 SG_ RFC_Obj12_BehaviorType : 255|3@1+ (1,0) [0|7] ""  VideoFrontCenter
 SG_ RFC_Obj12_ObstacleConf : 258|6@1+ (2,0) [0|100] "%"  VideoFrontCenter
 SG_ RFC_Obj12_NonObstacleConf : 264|6@1+ (2,0) [0|100] "%"  VideoFrontCenter
 SG_ RFC_Obj12_PxPyCoVnce : 272|12@1+ (0.01,0) [0|30] "m^2"  VideoFrontCenter
 SG_ RFC_Obj12_PxVxCoVnce : 284|12@1+ (0.01,0) [0|30] "m^2/s"  VideoFrontCenter
 SG_ RFC_Obj12_PxVyCoVnce : 296|12@1+ (0.01,0) [0|30] "m^2/s"  VideoFrontCenter
 SG_ RFC_Obj12_PyVxCoVnce : 308|12@1+ (0.01,0) [0|30] "m^2/s"  VideoFrontCenter
 SG_ RFC_Obj12_PyVyCoVnce : 320|12@1+ (0.01,0) [0|30] "m^2/s"  VideoFrontCenter
 SG_ RFC_Obj12_VxVyCoVnce : 332|12@1+ (0.01,0) [0|30] "m^2/s^2"  VideoFrontCenter
 SG_ RFC_Obj12_PxAxCoVnce : 344|12@1+ (0.01,0) [0|30] "m^2/s^2"  VideoFrontCenter
 SG_ RFC_Obj12_PxAyCoVnce : 356|12@1+ (0.01,0) [0|30] "m^2/s^2"  VideoFrontCenter
 SG_ RFC_Obj12_PyAxCoVnce : 368|12@1+ (0.01,0) [0|30] "m^2/s^2"  VideoFrontCenter
 SG_ RFC_Obj12_PyAyCoVnce : 380|12@1+ (0.01,0) [0|30] "m^2/s^2"  VideoFrontCenter
 SG_ RFC_Obj12_VxAxCoVnce : 392|12@1+ (0.01,0) [0|30] "m^2/s^3"  VideoFrontCenter
 SG_ RFC_Obj12_VxAyCoVnce : 404|12@1+ (0.01,0) [0|30] "m^2/s^3"  VideoFrontCenter
 SG_ RFC_Obj12_VyAxCoVnce : 416|12@1+ (0.01,0) [0|30] "m^2/s^3"  VideoFrontCenter
 SG_ RFC_Obj12_VyAyCoVnce : 428|12@1+ (0.01,0) [0|30] "m^2/s^3"  VideoFrontCenter
 SG_ RFC_Obj12_AxAyCoVnce : 440|12@1+ (0.01,0) [0|30] "m^2/s^4"  VideoFrontCenter
 SG_ RFC_Obj12_MobileObstConf : 452|6@1+ (2,0) [0|100] "%"  VideoFrontCenter
 SG_ RFC_Obj12_Mob4PlusWhlConf : 458|6@1+ (2,0) [0|100] "%"  VideoFrontCenter
 SG_ RFC_Obj12_Mob2WhlConf : 464|6@1+ (2,0) [0|100] "%"  VideoFrontCenter
 SG_ RFC_Obj12_MobPedConf : 470|6@1+ (2,0) [0|100] "%"  VideoFrontCenter
 SG_ RFC_Obj12_FourPlusWhlCarConf : 476|6@1+ (2,0) [0|100] "%"  VideoFrontCenter
 SG_ RFC_Obj12_FourPlusWhlHGVConf : 482|6@1+ (2,0) [0|100] "%"  VideoFrontCenter
 SG_ RFC_Obj12_GroundReflexConf : 488|6@1+ (2,0) [0|100] "%"  VideoFrontCenter
 SG_ RFC_Obj12_StatObstConf : 494|6@1+ (2,0) [0|100] "%"  VideoFrontCenter
 SG_ RFC_Obj12_StatBarrierConf : 500|6@1+ (2,0) [0|100] "%"  VideoFrontCenter

BO_ 419 RFC_Obj13: 64 RadarFrontCenter
 SG_ RFC_Obj13_CRC : 0|16@1+ (1,0) [0|65535] ""  VideoFrontCenter
 SG_ RFC_Obj13_AliveCtr : 16|8@1+ (1,0) [0|255] ""  VideoFrontCenter
 SG_ RFC_Obj13_ProtBlockCtr : 24|4@1+ (1,0) [0|15] ""  VideoFrontCenter
 SG_ RFC_Obj13_ReferencePoint : 28|4@1+ (1,0) [0|15] ""  VideoFrontCenter
 SG_ RFC_Obj13_ObjId : 32|7@1+ (1,0) [0|127] ""  VideoFrontCenter
 SG_ RFC_Obj13_MeasurementStatus : 39|1@1+ (1,0) [0|1] ""  VideoFrontCenter
 SG_ RFC_Obj13_Px : 40|13@1+ (0.0625,-256) [-256|255.9375] "m"  VideoFrontCenter
 SG_ RFC_Obj13_Py : 53|11@1+ (0.125,-128) [-128|127.875] "m"  VideoFrontCenter
 SG_ RFC_Obj13_PxVnce : 64|12@1+ (0.01,0) [0|30] "m^2"  VideoFrontCenter
 SG_ RFC_Obj13_PyVnce : 76|12@1+ (0.01,0) [0|30] "m^2"  VideoFrontCenter
 SG_ RFC_Obj13_Vx : 88|12@1+ (0.0625,-128) [-128|127.9375] "m/s"  VideoFrontCenter
 SG_ RFC_Obj13_Vy : 100|10@1+ (0.125,-64) [-64|63.875] "m/s"  VideoFrontCenter
 SG_ RFC_Obj13_Ax : 110|10@1+ (0.03125,-16) [-16|15.96875] "m/s^2"  VideoFrontCenter
 SG_ RFC_Obj13_Ay : 120|9@1+ (0.0625,-16) [-16|15.9375] "m/s^2"  VideoFrontCenter
 SG_ RFC_Obj13_OrientationYaw : 129|9@1+ (0.0175,-4.48) [-3.15|3.15] "rad"  VideoFrontCenter
 SG_ RFC_Obj13_ExistProb : 138|6@1+ (2,0) [0|100] "%"  VideoFrontCenter
 SG_ RFC_Obj13_VxVnce : 144|12@1+ (0.01,0) [0|30] "m^2/s^2"  VideoFrontCenter
 SG_ RFC_Obj13_VyVnce : 156|12@1+ (0.01,0) [0|30] "m^2/s^2"  VideoFrontCenter
 SG_ RFC_Obj13_AxVnce : 168|12@1+ (0.01,0) [0|30] "m^2/s^4"  VideoFrontCenter
 SG_ RFC_Obj13_AyVnce : 180|12@1+ (0.01,0) [0|30] "m^2/s^4"  VideoFrontCenter
 SG_ RFC_Obj13_OrientationYawVnce : 192|12@1+ (0.0003,0) [0|1] "rad^2"  VideoFrontCenter
 SG_ RFC_Obj13_MovingObserved : 204|6@1+ (2,0) [0|100] "%"  VideoFrontCenter
 SG_ RFC_Obj13_MovingProbability : 210|6@1+ (2,0) [0|100] "%"  VideoFrontCenter
 SG_ RFC_Obj13_Length : 216|7@1+ (0.125,0) [0|15.875] "m"  VideoFrontCenter
 SG_ RFC_Obj13_Valid : 223|1@1+ (1,0) [0|1] ""  VideoFrontCenter
 SG_ RFC_Obj13_LengthVnce : 224|12@1+ (0.01,0) [0|30] "m^2"  VideoFrontCenter
 SG_ RFC_Obj13_WidthVnce : 236|12@1+ (0.01,0) [0|30] "m^2"  VideoFrontCenter
 SG_ RFC_Obj13_Width : 248|7@1+ (0.125,0) [0|15.875] "m"  VideoFrontCenter
 SG_ RFC_Obj13_BehaviorType : 255|3@1+ (1,0) [0|7] ""  VideoFrontCenter
 SG_ RFC_Obj13_ObstacleConf : 258|6@1+ (2,0) [0|100] "%"  VideoFrontCenter
 SG_ RFC_Obj13_NonObstacleConf : 264|6@1+ (2,0) [0|100] "%"  VideoFrontCenter
 SG_ RFC_Obj13_PxPyCoVnce : 272|12@1+ (0.01,0) [0|30] "m^2"  VideoFrontCenter
 SG_ RFC_Obj13_PxVxCoVnce : 284|12@1+ (0.01,0) [0|30] "m^2/s"  VideoFrontCenter
 SG_ RFC_Obj13_PxVyCoVnce : 296|12@1+ (0.01,0) [0|30] "m^2/s"  VideoFrontCenter
 SG_ RFC_Obj13_PyVxCoVnce : 308|12@1+ (0.01,0) [0|30] "m^2/s"  VideoFrontCenter
 SG_ RFC_Obj13_PyVyCoVnce : 320|12@1+ (0.01,0) [0|30] "m^2/s"  VideoFrontCenter
 SG_ RFC_Obj13_VxVyCoVnce : 332|12@1+ (0.01,0) [0|30] "m^2/s^2"  VideoFrontCenter
 SG_ RFC_Obj13_PxAxCoVnce : 344|12@1+ (0.01,0) [0|30] "m^2/s^2"  VideoFrontCenter
 SG_ RFC_Obj13_PxAyCoVnce : 356|12@1+ (0.01,0) [0|30] "m^2/s^2"  VideoFrontCenter
 SG_ RFC_Obj13_PyAxCoVnce : 368|12@1+ (0.01,0) [0|30] "m^2/s^2"  VideoFrontCenter
 SG_ RFC_Obj13_PyAyCoVnce : 380|12@1+ (0.01,0) [0|30] "m^2/s^2"  VideoFrontCenter
 SG_ RFC_Obj13_VxAxCoVnce : 392|12@1+ (0.01,0) [0|30] "m^2/s^3"  VideoFrontCenter
 SG_ RFC_Obj13_VxAyCoVnce : 404|12@1+ (0.01,0) [0|30] "m^2/s^3"  VideoFrontCenter
 SG_ RFC_Obj13_VyAxCoVnce : 416|12@1+ (0.01,0) [0|30] "m^2/s^3"  VideoFrontCenter
 SG_ RFC_Obj13_VyAyCoVnce : 428|12@1+ (0.01,0) [0|30] "m^2/s^3"  VideoFrontCenter
 SG_ RFC_Obj13_AxAyCoVnce : 440|12@1+ (0.01,0) [0|30] "m^2/s^4"  VideoFrontCenter
 SG_ RFC_Obj13_MobileObstConf : 452|6@1+ (2,0) [0|100] "%"  VideoFrontCenter
 SG_ RFC_Obj13_Mob4PlusWhlConf : 458|6@1+ (2,0) [0|100] "%"  VideoFrontCenter
 SG_ RFC_Obj13_Mob2WhlConf : 464|6@1+ (2,0) [0|100] "%"  VideoFrontCenter
 SG_ RFC_Obj13_MobPedConf : 470|6@1+ (2,0) [0|100] "%"  VideoFrontCenter
 SG_ RFC_Obj13_FourPlusWhlCarConf : 476|6@1+ (2,0) [0|100] "%"  VideoFrontCenter
 SG_ RFC_Obj13_FourPlusWhlHGVConf : 482|6@1+ (2,0) [0|100] "%"  VideoFrontCenter
 SG_ RFC_Obj13_GroundReflexConf : 488|6@1+ (2,0) [0|100] "%"  VideoFrontCenter
 SG_ RFC_Obj13_StatObstConf : 494|6@1+ (2,0) [0|100] "%"  VideoFrontCenter
 SG_ RFC_Obj13_StatBarrierConf : 500|6@1+ (2,0) [0|100] "%"  VideoFrontCenter

BO_ 420 RFC_Obj14: 64 RadarFrontCenter
 SG_ RFC_Obj14_CRC : 0|16@1+ (1,0) [0|65535] ""  VideoFrontCenter
 SG_ RFC_Obj14_AliveCtr : 16|8@1+ (1,0) [0|255] ""  VideoFrontCenter
 SG_ RFC_Obj14_ProtBlockCtr : 24|4@1+ (1,0) [0|15] ""  VideoFrontCenter
 SG_ RFC_Obj14_ReferencePoint : 28|4@1+ (1,0) [0|15] ""  VideoFrontCenter
 SG_ RFC_Obj14_ObjId : 32|7@1+ (1,0) [0|127] ""  VideoFrontCenter
 SG_ RFC_Obj14_MeasurementStatus : 39|1@1+ (1,0) [0|1] ""  VideoFrontCenter
 SG_ RFC_Obj14_Px : 40|13@1+ (0.0625,-256) [-256|255.9375] "m"  VideoFrontCenter
 SG_ RFC_Obj14_Py : 53|11@1+ (0.125,-128) [-128|127.875] "m"  VideoFrontCenter
 SG_ RFC_Obj14_PxVnce : 64|12@1+ (0.01,0) [0|30] "m^2"  VideoFrontCenter
 SG_ RFC_Obj14_PyVnce : 76|12@1+ (0.01,0) [0|30] "m^2"  VideoFrontCenter
 SG_ RFC_Obj14_Vx : 88|12@1+ (0.0625,-128) [-128|127.9375] "m/s"  VideoFrontCenter
 SG_ RFC_Obj14_Vy : 100|10@1+ (0.125,-64) [-64|63.875] "m/s"  VideoFrontCenter
 SG_ RFC_Obj14_Ax : 110|10@1+ (0.03125,-16) [-16|15.96875] "m/s^2"  VideoFrontCenter
 SG_ RFC_Obj14_Ay : 120|9@1+ (0.0625,-16) [-16|15.9375] "m/s^2"  VideoFrontCenter
 SG_ RFC_Obj14_OrientationYaw : 129|9@1+ (0.0175,-4.48) [-3.15|3.15] "rad"  VideoFrontCenter
 SG_ RFC_Obj14_ExistProb : 138|6@1+ (2,0) [0|100] "%"  VideoFrontCenter
 SG_ RFC_Obj14_VxVnce : 144|12@1+ (0.01,0) [0|30] "m^2/s^2"  VideoFrontCenter
 SG_ RFC_Obj14_VyVnce : 156|12@1+ (0.01,0) [0|30] "m^2/s^2"  VideoFrontCenter
 SG_ RFC_Obj14_AxVnce : 168|12@1+ (0.01,0) [0|30] "m^2/s^4"  VideoFrontCenter
 SG_ RFC_Obj14_AyVnce : 180|12@1+ (0.01,0) [0|30] "m^2/s^4"  VideoFrontCenter
 SG_ RFC_Obj14_OrientationYawVnce : 192|12@1+ (0.0003,0) [0|1] "rad^2"  VideoFrontCenter
 SG_ RFC_Obj14_MovingObserved : 204|6@1+ (2,0) [0|100] "%"  VideoFrontCenter
 SG_ RFC_Obj14_MovingProbability : 210|6@1+ (2,0) [0|100] "%"  VideoFrontCenter
 SG_ RFC_Obj14_Length : 216|7@1+ (0.125,0) [0|15.875] "m"  VideoFrontCenter
 SG_ RFC_Obj14_Valid : 223|1@1+ (1,0) [0|1] ""  VideoFrontCenter
 SG_ RFC_Obj14_LengthVnce : 224|12@1+ (0.01,0) [0|30] "m^2"  VideoFrontCenter
 SG_ RFC_Obj14_WidthVnce : 236|12@1+ (0.01,0) [0|30] "m^2"  VideoFrontCenter
 SG_ RFC_Obj14_Width : 248|7@1+ (0.125,0) [0|15.875] "m"  VideoFrontCenter
 SG_ RFC_Obj14_BehaviorType : 255|3@1+ (1,0) [0|7] ""  VideoFrontCenter
 SG_ RFC_Obj14_ObstacleConf : 258|6@1+ (2,0) [0|100] "%"  VideoFrontCenter
 SG_ RFC_Obj14_NonObstacleConf : 264|6@1+ (2,0) [0|100] "%"  VideoFrontCenter
 SG_ RFC_Obj14_PxPyCoVnce : 272|12@1+ (0.01,0) [0|30] "m^2"  VideoFrontCenter
 SG_ RFC_Obj14_PxVxCoVnce : 284|12@1+ (0.01,0) [0|30] "m^2/s"  VideoFrontCenter
 SG_ RFC_Obj14_PxVyCoVnce : 296|12@1+ (0.01,0) [0|30] "m^2/s"  VideoFrontCenter
 SG_ RFC_Obj14_PyVxCoVnce : 308|12@1+ (0.01,0) [0|30] "m^2/s"  VideoFrontCenter
 SG_ RFC_Obj14_PyVyCoVnce : 320|12@1+ (0.01,0) [0|30] "m^2/s"  VideoFrontCenter
 SG_ RFC_Obj14_VxVyCoVnce : 332|12@1+ (0.01,0) [0|30] "m^2/s^2"  VideoFrontCenter
 SG_ RFC_Obj14_PxAxCoVnce : 344|12@1+ (0.01,0) [0|30] "m^2/s^2"  VideoFrontCenter
 SG_ RFC_Obj14_PxAyCoVnce : 356|12@1+ (0.01,0) [0|30] "m^2/s^2"  VideoFrontCenter
 SG_ RFC_Obj14_PyAxCoVnce : 368|12@1+ (0.01,0) [0|30] "m^2/s^2"  VideoFrontCenter
 SG_ RFC_Obj14_PyAyCoVnce : 380|12@1+ (0.01,0) [0|30] "m^2/s^2"  VideoFrontCenter
 SG_ RFC_Obj14_VxAxCoVnce : 392|12@1+ (0.01,0) [0|30] "m^2/s^3"  VideoFrontCenter
 SG_ RFC_Obj14_VxAyCoVnce : 404|12@1+ (0.01,0) [0|30] "m^2/s^3"  VideoFrontCenter
 SG_ RFC_Obj14_VyAxCoVnce : 416|12@1+ (0.01,0) [0|30] "m^2/s^3"  VideoFrontCenter
 SG_ RFC_Obj14_VyAyCoVnce : 428|12@1+ (0.01,0) [0|30] "m^2/s^3"  VideoFrontCenter
 SG_ RFC_Obj14_AxAyCoVnce : 440|12@1+ (0.01,0) [0|30] "m^2/s^4"  VideoFrontCenter
 SG_ RFC_Obj14_MobileObstConf : 452|6@1+ (2,0) [0|100] "%"  VideoFrontCenter
 SG_ RFC_Obj14_Mob4PlusWhlConf : 458|6@1+ (2,0) [0|100] "%"  VideoFrontCenter
 SG_ RFC_Obj14_Mob2WhlConf : 464|6@1+ (2,0) [0|100] "%"  VideoFrontCenter
 SG_ RFC_Obj14_MobPedConf : 470|6@1+ (2,0) [0|100] "%"  VideoFrontCenter
 SG_ RFC_Obj14_FourPlusWhlCarConf : 476|6@1+ (2,0) [0|100] "%"  VideoFrontCenter
 SG_ RFC_Obj14_FourPlusWhlHGVConf : 482|6@1+ (2,0) [0|100] "%"  VideoFrontCenter
 SG_ RFC_Obj14_GroundReflexConf : 488|6@1+ (2,0) [0|100] "%"  VideoFrontCenter
 SG_ RFC_Obj14_StatObstConf : 494|6@1+ (2,0) [0|100] "%"  VideoFrontCenter
 SG_ RFC_Obj14_StatBarrierConf : 500|6@1+ (2,0) [0|100] "%"  VideoFrontCenter

BO_ 421 RFC_Obj15: 64 RadarFrontCenter
 SG_ RFC_Obj15_CRC : 0|16@1+ (1,0) [0|65535] ""  VideoFrontCenter
 SG_ RFC_Obj15_AliveCtr : 16|8@1+ (1,0) [0|255] ""  VideoFrontCenter
 SG_ RFC_Obj15_ProtBlockCtr : 24|4@1+ (1,0) [0|15] ""  VideoFrontCenter
 SG_ RFC_Obj15_ReferencePoint : 28|4@1+ (1,0) [0|15] ""  VideoFrontCenter
 SG_ RFC_Obj15_ObjId : 32|7@1+ (1,0) [0|127] ""  VideoFrontCenter
 SG_ RFC_Obj15_MeasurementStatus : 39|1@1+ (1,0) [0|1] ""  VideoFrontCenter
 SG_ RFC_Obj15_Px : 40|13@1+ (0.0625,-256) [-256|255.9375] "m"  VideoFrontCenter
 SG_ RFC_Obj15_Py : 53|11@1+ (0.125,-128) [-128|127.875] "m"  VideoFrontCenter
 SG_ RFC_Obj15_PxVnce : 64|12@1+ (0.01,0) [0|30] "m^2"  VideoFrontCenter
 SG_ RFC_Obj15_PyVnce : 76|12@1+ (0.01,0) [0|30] "m^2"  VideoFrontCenter
 SG_ RFC_Obj15_Vx : 88|12@1+ (0.0625,-128) [-128|127.9375] "m/s"  VideoFrontCenter
 SG_ RFC_Obj15_Vy : 100|10@1+ (0.125,-64) [-64|63.875] "m/s"  VideoFrontCenter
 SG_ RFC_Obj15_Ax : 110|10@1+ (0.03125,-16) [-16|15.96875] "m/s^2"  VideoFrontCenter
 SG_ RFC_Obj15_Ay : 120|9@1+ (0.0625,-16) [-16|15.9375] "m/s^2"  VideoFrontCenter
 SG_ RFC_Obj15_OrientationYaw : 129|9@1+ (0.0175,-4.48) [-3.15|3.15] "rad"  VideoFrontCenter
 SG_ RFC_Obj15_ExistProb : 138|6@1+ (2,0) [0|100] "%"  VideoFrontCenter
 SG_ RFC_Obj15_VxVnce : 144|12@1+ (0.01,0) [0|30] "m^2/s^2"  VideoFrontCenter
 SG_ RFC_Obj15_VyVnce : 156|12@1+ (0.01,0) [0|30] "m^2/s^2"  VideoFrontCenter
 SG_ RFC_Obj15_AxVnce : 168|12@1+ (0.01,0) [0|30] "m^2/s^4"  VideoFrontCenter
 SG_ RFC_Obj15_AyVnce : 180|12@1+ (0.01,0) [0|30] "m^2/s^4"  VideoFrontCenter
 SG_ RFC_Obj15_OrientationYawVnce : 192|12@1+ (0.0003,0) [0|1] "rad^2"  VideoFrontCenter
 SG_ RFC_Obj15_MovingObserved : 204|6@1+ (2,0) [0|100] "%"  VideoFrontCenter
 SG_ RFC_Obj15_MovingProbability : 210|6@1+ (2,0) [0|100] "%"  VideoFrontCenter
 SG_ RFC_Obj15_Length : 216|7@1+ (0.125,0) [0|15.875] "m"  VideoFrontCenter
 SG_ RFC_Obj15_Valid : 223|1@1+ (1,0) [0|1] ""  VideoFrontCenter
 SG_ RFC_Obj15_LengthVnce : 224|12@1+ (0.01,0) [0|30] "m^2"  VideoFrontCenter
 SG_ RFC_Obj15_WidthVnce : 236|12@1+ (0.01,0) [0|30] "m^2"  VideoFrontCenter
 SG_ RFC_Obj15_Width : 248|7@1+ (0.125,0) [0|15.875] "m"  VideoFrontCenter
 SG_ RFC_Obj15_BehaviorType : 255|3@1+ (1,0) [0|7] ""  VideoFrontCenter
 SG_ RFC_Obj15_ObstacleConf : 258|6@1+ (2,0) [0|100] "%"  VideoFrontCenter
 SG_ RFC_Obj15_NonObstacleConf : 264|6@1+ (2,0) [0|100] "%"  VideoFrontCenter
 SG_ RFC_Obj15_PxPyCoVnce : 272|12@1+ (0.01,0) [0|30] "m^2"  VideoFrontCenter
 SG_ RFC_Obj15_PxVxCoVnce : 284|12@1+ (0.01,0) [0|30] "m^2/s"  VideoFrontCenter
 SG_ RFC_Obj15_PxVyCoVnce : 296|12@1+ (0.01,0) [0|30] "m^2/s"  VideoFrontCenter
 SG_ RFC_Obj15_PyVxCoVnce : 308|12@1+ (0.01,0) [0|30] "m^2/s"  VideoFrontCenter
 SG_ RFC_Obj15_PyVyCoVnce : 320|12@1+ (0.01,0) [0|30] "m^2/s"  VideoFrontCenter
 SG_ RFC_Obj15_VxVyCoVnce : 332|12@1+ (0.01,0) [0|30] "m^2/s^2"  VideoFrontCenter
 SG_ RFC_Obj15_PxAxCoVnce : 344|12@1+ (0.01,0) [0|30] "m^2/s^2"  VideoFrontCenter
 SG_ RFC_Obj15_PxAyCoVnce : 356|12@1+ (0.01,0) [0|30] "m^2/s^2"  VideoFrontCenter
 SG_ RFC_Obj15_PyAxCoVnce : 368|12@1+ (0.01,0) [0|30] "m^2/s^2"  VideoFrontCenter
 SG_ RFC_Obj15_PyAyCoVnce : 380|12@1+ (0.01,0) [0|30] "m^2/s^2"  VideoFrontCenter
 SG_ RFC_Obj15_VxAxCoVnce : 392|12@1+ (0.01,0) [0|30] "m^2/s^3"  VideoFrontCenter
 SG_ RFC_Obj15_VxAyCoVnce : 404|12@1+ (0.01,0) [0|30] "m^2/s^3"  VideoFrontCenter
 SG_ RFC_Obj15_VyAxCoVnce : 416|12@1+ (0.01,0) [0|30] "m^2/s^3"  VideoFrontCenter
 SG_ RFC_Obj15_VyAyCoVnce : 428|12@1+ (0.01,0) [0|30] "m^2/s^3"  VideoFrontCenter
 SG_ RFC_Obj15_AxAyCoVnce : 440|12@1+ (0.01,0) [0|30] "m^2/s^4"  VideoFrontCenter
 SG_ RFC_Obj15_MobileObstConf : 452|6@1+ (2,0) [0|100] "%"  VideoFrontCenter
 SG_ RFC_Obj15_Mob4PlusWhlConf : 458|6@1+ (2,0) [0|100] "%"  VideoFrontCenter
 SG_ RFC_Obj15_Mob2WhlConf : 464|6@1+ (2,0) [0|100] "%"  VideoFrontCenter
 SG_ RFC_Obj15_MobPedConf : 470|6@1+ (2,0) [0|100] "%"  VideoFrontCenter
 SG_ RFC_Obj15_FourPlusWhlCarConf : 476|6@1+ (2,0) [0|100] "%"  VideoFrontCenter
 SG_ RFC_Obj15_FourPlusWhlHGVConf : 482|6@1+ (2,0) [0|100] "%"  VideoFrontCenter
 SG_ RFC_Obj15_GroundReflexConf : 488|6@1+ (2,0) [0|100] "%"  VideoFrontCenter
 SG_ RFC_Obj15_StatObstConf : 494|6@1+ (2,0) [0|100] "%"  VideoFrontCenter
 SG_ RFC_Obj15_StatBarrierConf : 500|6@1+ (2,0) [0|100] "%"  VideoFrontCenter

BO_ 422 RFC_Obj16: 64 RadarFrontCenter
 SG_ RFC_Obj16_CRC : 0|16@1+ (1,0) [0|65535] ""  VideoFrontCenter
 SG_ RFC_Obj16_AliveCtr : 16|8@1+ (1,0) [0|255] ""  VideoFrontCenter
 SG_ RFC_Obj16_ProtBlockCtr : 24|4@1+ (1,0) [0|15] ""  VideoFrontCenter
 SG_ RFC_Obj16_ReferencePoint : 28|4@1+ (1,0) [0|15] ""  VideoFrontCenter
 SG_ RFC_Obj16_ObjId : 32|7@1+ (1,0) [0|127] ""  VideoFrontCenter
 SG_ RFC_Obj16_MeasurementStatus : 39|1@1+ (1,0) [0|1] ""  VideoFrontCenter
 SG_ RFC_Obj16_Px : 40|13@1+ (0.0625,-256) [-256|255.9375] "m"  VideoFrontCenter
 SG_ RFC_Obj16_Py : 53|11@1+ (0.125,-128) [-128|127.875] "m"  VideoFrontCenter
 SG_ RFC_Obj16_PxVnce : 64|12@1+ (0.01,0) [0|30] "m^2"  VideoFrontCenter
 SG_ RFC_Obj16_PyVnce : 76|12@1+ (0.01,0) [0|30] "m^2"  VideoFrontCenter
 SG_ RFC_Obj16_Vx : 88|12@1+ (0.0625,-128) [-128|127.9375] "m/s"  VideoFrontCenter
 SG_ RFC_Obj16_Vy : 100|10@1+ (0.125,-64) [-64|63.875] "m/s"  VideoFrontCenter
 SG_ RFC_Obj16_Ax : 110|10@1+ (0.03125,-16) [-16|15.96875] "m/s^2"  VideoFrontCenter
 SG_ RFC_Obj16_Ay : 120|9@1+ (0.0625,-16) [-16|15.9375] "m/s^2"  VideoFrontCenter
 SG_ RFC_Obj16_OrientationYaw : 129|9@1+ (0.0175,-4.48) [-3.15|3.15] "rad"  VideoFrontCenter
 SG_ RFC_Obj16_ExistProb : 138|6@1+ (2,0) [0|100] "%"  VideoFrontCenter
 SG_ RFC_Obj16_VxVnce : 144|12@1+ (0.01,0) [0|30] "m^2/s^2"  VideoFrontCenter
 SG_ RFC_Obj16_VyVnce : 156|12@1+ (0.01,0) [0|30] "m^2/s^2"  VideoFrontCenter
 SG_ RFC_Obj16_AxVnce : 168|12@1+ (0.01,0) [0|30] "m^2/s^4"  VideoFrontCenter
 SG_ RFC_Obj16_AyVnce : 180|12@1+ (0.01,0) [0|30] "m^2/s^4"  VideoFrontCenter
 SG_ RFC_Obj16_OrientationYawVnce : 192|12@1+ (0.0003,0) [0|1] "rad^2"  VideoFrontCenter
 SG_ RFC_Obj16_MovingObserved : 204|6@1+ (2,0) [0|100] "%"  VideoFrontCenter
 SG_ RFC_Obj16_MovingProbability : 210|6@1+ (2,0) [0|100] "%"  VideoFrontCenter
 SG_ RFC_Obj16_Length : 216|7@1+ (0.125,0) [0|15.875] "m"  VideoFrontCenter
 SG_ RFC_Obj16_Valid : 223|1@1+ (1,0) [0|1] ""  VideoFrontCenter
 SG_ RFC_Obj16_LengthVnce : 224|12@1+ (0.01,0) [0|30] "m^2"  VideoFrontCenter
 SG_ RFC_Obj16_WidthVnce : 236|12@1+ (0.01,0) [0|30] "m^2"  VideoFrontCenter
 SG_ RFC_Obj16_Width : 248|7@1+ (0.125,0) [0|15.875] "m"  VideoFrontCenter
 SG_ RFC_Obj16_BehaviorType : 255|3@1+ (1,0) [0|7] ""  VideoFrontCenter
 SG_ RFC_Obj16_ObstacleConf : 258|6@1+ (2,0) [0|100] "%"  VideoFrontCenter
 SG_ RFC_Obj16_NonObstacleConf : 264|6@1+ (2,0) [0|100] "%"  VideoFrontCenter
 SG_ RFC_Obj16_PxPyCoVnce : 272|12@1+ (0.01,0) [0|30] "m^2"  VideoFrontCenter
 SG_ RFC_Obj16_PxVxCoVnce : 284|12@1+ (0.01,0) [0|30] "m^2/s"  VideoFrontCenter
 SG_ RFC_Obj16_PxVyCoVnce : 296|12@1+ (0.01,0) [0|30] "m^2/s"  VideoFrontCenter
 SG_ RFC_Obj16_PyVxCoVnce : 308|12@1+ (0.01,0) [0|30] "m^2/s"  VideoFrontCenter
 SG_ RFC_Obj16_PyVyCoVnce : 320|12@1+ (0.01,0) [0|30] "m^2/s"  VideoFrontCenter
 SG_ RFC_Obj16_VxVyCoVnce : 332|12@1+ (0.01,0) [0|30] "m^2/s^2"  VideoFrontCenter
 SG_ RFC_Obj16_PxAxCoVnce : 344|12@1+ (0.01,0) [0|30] "m^2/s^2"  VideoFrontCenter
 SG_ RFC_Obj16_PxAyCoVnce : 356|12@1+ (0.01,0) [0|30] "m^2/s^2"  VideoFrontCenter
 SG_ RFC_Obj16_PyAxCoVnce : 368|12@1+ (0.01,0) [0|30] "m^2/s^2"  VideoFrontCenter
 SG_ RFC_Obj16_PyAyCoVnce : 380|12@1+ (0.01,0) [0|30] "m^2/s^2"  VideoFrontCenter
 SG_ RFC_Obj16_VxAxCoVnce : 392|12@1+ (0.01,0) [0|30] "m^2/s^3"  VideoFrontCenter
 SG_ RFC_Obj16_VxAyCoVnce : 404|12@1+ (0.01,0) [0|30] "m^2/s^3"  VideoFrontCenter
 SG_ RFC_Obj16_VyAxCoVnce : 416|12@1+ (0.01,0) [0|30] "m^2/s^3"  VideoFrontCenter
 SG_ RFC_Obj16_VyAyCoVnce : 428|12@1+ (0.01,0) [0|30] "m^2/s^3"  VideoFrontCenter
 SG_ RFC_Obj16_AxAyCoVnce : 440|12@1+ (0.01,0) [0|30] "m^2/s^4"  VideoFrontCenter
 SG_ RFC_Obj16_MobileObstConf : 452|6@1+ (2,0) [0|100] "%"  VideoFrontCenter
 SG_ RFC_Obj16_Mob4PlusWhlConf : 458|6@1+ (2,0) [0|100] "%"  VideoFrontCenter
 SG_ RFC_Obj16_Mob2WhlConf : 464|6@1+ (2,0) [0|100] "%"  VideoFrontCenter
 SG_ RFC_Obj16_MobPedConf : 470|6@1+ (2,0) [0|100] "%"  VideoFrontCenter
 SG_ RFC_Obj16_FourPlusWhlCarConf : 476|6@1+ (2,0) [0|100] "%"  VideoFrontCenter
 SG_ RFC_Obj16_FourPlusWhlHGVConf : 482|6@1+ (2,0) [0|100] "%"  VideoFrontCenter
 SG_ RFC_Obj16_GroundReflexConf : 488|6@1+ (2,0) [0|100] "%"  VideoFrontCenter
 SG_ RFC_Obj16_StatObstConf : 494|6@1+ (2,0) [0|100] "%"  VideoFrontCenter
 SG_ RFC_Obj16_StatBarrierConf : 500|6@1+ (2,0) [0|100] "%"  VideoFrontCenter

BO_ 423 RFC_Obj17: 64 RadarFrontCenter
 SG_ RFC_Obj17_CRC : 0|16@1+ (1,0) [0|65535] ""  VideoFrontCenter
 SG_ RFC_Obj17_AliveCtr : 16|8@1+ (1,0) [0|255] ""  VideoFrontCenter
 SG_ RFC_Obj17_ProtBlockCtr : 24|4@1+ (1,0) [0|15] ""  VideoFrontCenter
 SG_ RFC_Obj17_ReferencePoint : 28|4@1+ (1,0) [0|15] ""  VideoFrontCenter
 SG_ RFC_Obj17_ObjId : 32|7@1+ (1,0) [0|127] ""  VideoFrontCenter
 SG_ RFC_Obj17_MeasurementStatus : 39|1@1+ (1,0) [0|1] ""  VideoFrontCenter
 SG_ RFC_Obj17_Px : 40|13@1+ (0.0625,-256) [-256|255.9375] "m"  VideoFrontCenter
 SG_ RFC_Obj17_Py : 53|11@1+ (0.125,-128) [-128|127.875] "m"  VideoFrontCenter
 SG_ RFC_Obj17_PxVnce : 64|12@1+ (0.01,0) [0|30] "m^2"  VideoFrontCenter
 SG_ RFC_Obj17_PyVnce : 76|12@1+ (0.01,0) [0|30] "m^2"  VideoFrontCenter
 SG_ RFC_Obj17_Vx : 88|12@1+ (0.0625,-128) [-128|127.9375] "m/s"  VideoFrontCenter
 SG_ RFC_Obj17_Vy : 100|10@1+ (0.125,-64) [-64|63.875] "m/s"  VideoFrontCenter
 SG_ RFC_Obj17_Ax : 110|10@1+ (0.03125,-16) [-16|15.96875] "m/s^2"  VideoFrontCenter
 SG_ RFC_Obj17_Ay : 120|9@1+ (0.0625,-16) [-16|15.9375] "m/s^2"  VideoFrontCenter
 SG_ RFC_Obj17_OrientationYaw : 129|9@1+ (0.0175,-4.48) [-3.15|3.15] "rad"  VideoFrontCenter
 SG_ RFC_Obj17_ExistProb : 138|6@1+ (2,0) [0|100] "%"  VideoFrontCenter
 SG_ RFC_Obj17_VxVnce : 144|12@1+ (0.01,0) [0|30] "m^2/s^2"  VideoFrontCenter
 SG_ RFC_Obj17_VyVnce : 156|12@1+ (0.01,0) [0|30] "m^2/s^2"  VideoFrontCenter
 SG_ RFC_Obj17_AxVnce : 168|12@1+ (0.01,0) [0|30] "m^2/s^4"  VideoFrontCenter
 SG_ RFC_Obj17_AyVnce : 180|12@1+ (0.01,0) [0|30] "m^2/s^4"  VideoFrontCenter
 SG_ RFC_Obj17_OrientationYawVnce : 192|12@1+ (0.0003,0) [0|1] "rad^2"  VideoFrontCenter
 SG_ RFC_Obj17_MovingObserved : 204|6@1+ (2,0) [0|100] "%"  VideoFrontCenter
 SG_ RFC_Obj17_MovingProbability : 210|6@1+ (2,0) [0|100] "%"  VideoFrontCenter
 SG_ RFC_Obj17_Length : 216|7@1+ (0.125,0) [0|15.875] "m"  VideoFrontCenter
 SG_ RFC_Obj17_Valid : 223|1@1+ (1,0) [0|1] ""  VideoFrontCenter
 SG_ RFC_Obj17_LengthVnce : 224|12@1+ (0.01,0) [0|30] "m^2"  VideoFrontCenter
 SG_ RFC_Obj17_WidthVnce : 236|12@1+ (0.01,0) [0|30] "m^2"  VideoFrontCenter
 SG_ RFC_Obj17_Width : 248|7@1+ (0.125,0) [0|15.875] "m"  VideoFrontCenter
 SG_ RFC_Obj17_BehaviorType : 255|3@1+ (1,0) [0|7] ""  VideoFrontCenter
 SG_ RFC_Obj17_ObstacleConf : 258|6@1+ (2,0) [0|100] "%"  VideoFrontCenter
 SG_ RFC_Obj17_NonObstacleConf : 264|6@1+ (2,0) [0|100] "%"  VideoFrontCenter
 SG_ RFC_Obj17_PxPyCoVnce : 272|12@1+ (0.01,0) [0|30] "m^2"  VideoFrontCenter
 SG_ RFC_Obj17_PxVxCoVnce : 284|12@1+ (0.01,0) [0|30] "m^2/s"  VideoFrontCenter
 SG_ RFC_Obj17_PxVyCoVnce : 296|12@1+ (0.01,0) [0|30] "m^2/s"  VideoFrontCenter
 SG_ RFC_Obj17_PyVxCoVnce : 308|12@1+ (0.01,0) [0|30] "m^2/s"  VideoFrontCenter
 SG_ RFC_Obj17_PyVyCoVnce : 320|12@1+ (0.01,0) [0|30] "m^2/s"  VideoFrontCenter
 SG_ RFC_Obj17_VxVyCoVnce : 332|12@1+ (0.01,0) [0|30] "m^2/s^2"  VideoFrontCenter
 SG_ RFC_Obj17_PxAxCoVnce : 344|12@1+ (0.01,0) [0|30] "m^2/s^2"  VideoFrontCenter
 SG_ RFC_Obj17_PxAyCoVnce : 356|12@1+ (0.01,0) [0|30] "m^2/s^2"  VideoFrontCenter
 SG_ RFC_Obj17_PyAxCoVnce : 368|12@1+ (0.01,0) [0|30] "m^2/s^2"  VideoFrontCenter
 SG_ RFC_Obj17_PyAyCoVnce : 380|12@1+ (0.01,0) [0|30] "m^2/s^2"  VideoFrontCenter
 SG_ RFC_Obj17_VxAxCoVnce : 392|12@1+ (0.01,0) [0|30] "m^2/s^3"  VideoFrontCenter
 SG_ RFC_Obj17_VxAyCoVnce : 404|12@1+ (0.01,0) [0|30] "m^2/s^3"  VideoFrontCenter
 SG_ RFC_Obj17_VyAxCoVnce : 416|12@1+ (0.01,0) [0|30] "m^2/s^3"  VideoFrontCenter
 SG_ RFC_Obj17_VyAyCoVnce : 428|12@1+ (0.01,0) [0|30] "m^2/s^3"  VideoFrontCenter
 SG_ RFC_Obj17_AxAyCoVnce : 440|12@1+ (0.01,0) [0|30] "m^2/s^4"  VideoFrontCenter
 SG_ RFC_Obj17_MobileObstConf : 452|6@1+ (2,0) [0|100] "%"  VideoFrontCenter
 SG_ RFC_Obj17_Mob4PlusWhlConf : 458|6@1+ (2,0) [0|100] "%"  VideoFrontCenter
 SG_ RFC_Obj17_Mob2WhlConf : 464|6@1+ (2,0) [0|100] "%"  VideoFrontCenter
 SG_ RFC_Obj17_MobPedConf : 470|6@1+ (2,0) [0|100] "%"  VideoFrontCenter
 SG_ RFC_Obj17_FourPlusWhlCarConf : 476|6@1+ (2,0) [0|100] "%"  VideoFrontCenter
 SG_ RFC_Obj17_FourPlusWhlHGVConf : 482|6@1+ (2,0) [0|100] "%"  VideoFrontCenter
 SG_ RFC_Obj17_GroundReflexConf : 488|6@1+ (2,0) [0|100] "%"  VideoFrontCenter
 SG_ RFC_Obj17_StatObstConf : 494|6@1+ (2,0) [0|100] "%"  VideoFrontCenter
 SG_ RFC_Obj17_StatBarrierConf : 500|6@1+ (2,0) [0|100] "%"  VideoFrontCenter

BO_ 424 RFC_Obj18: 64 RadarFrontCenter
 SG_ RFC_Obj18_CRC : 0|16@1+ (1,0) [0|65535] ""  VideoFrontCenter
 SG_ RFC_Obj18_AliveCtr : 16|8@1+ (1,0) [0|255] ""  VideoFrontCenter
 SG_ RFC_Obj18_ProtBlockCtr : 24|4@1+ (1,0) [0|15] ""  VideoFrontCenter
 SG_ RFC_Obj18_ReferencePoint : 28|4@1+ (1,0) [0|15] ""  VideoFrontCenter
 SG_ RFC_Obj18_ObjId : 32|7@1+ (1,0) [0|127] ""  VideoFrontCenter
 SG_ RFC_Obj18_MeasurementStatus : 39|1@1+ (1,0) [0|1] ""  VideoFrontCenter
 SG_ RFC_Obj18_Px : 40|13@1+ (0.0625,-256) [-256|255.9375] "m"  VideoFrontCenter
 SG_ RFC_Obj18_Py : 53|11@1+ (0.125,-128) [-128|127.875] "m"  VideoFrontCenter
 SG_ RFC_Obj18_PxVnce : 64|12@1+ (0.01,0) [0|30] "m^2"  VideoFrontCenter
 SG_ RFC_Obj18_PyVnce : 76|12@1+ (0.01,0) [0|30] "m^2"  VideoFrontCenter
 SG_ RFC_Obj18_Vx : 88|12@1+ (0.0625,-128) [-128|127.9375] "m/s"  VideoFrontCenter
 SG_ RFC_Obj18_Vy : 100|10@1+ (0.125,-64) [-64|63.875] "m/s"  VideoFrontCenter
 SG_ RFC_Obj18_Ax : 110|10@1+ (0.03125,-16) [-16|15.96875] "m/s^2"  VideoFrontCenter
 SG_ RFC_Obj18_Ay : 120|9@1+ (0.0625,-16) [-16|15.9375] "m/s^2"  VideoFrontCenter
 SG_ RFC_Obj18_OrientationYaw : 129|9@1+ (0.0175,-4.48) [-3.15|3.15] "rad"  VideoFrontCenter
 SG_ RFC_Obj18_ExistProb : 138|6@1+ (2,0) [0|100] "%"  VideoFrontCenter
 SG_ RFC_Obj18_VxVnce : 144|12@1+ (0.01,0) [0|30] "m^2/s^2"  VideoFrontCenter
 SG_ RFC_Obj18_VyVnce : 156|12@1+ (0.01,0) [0|30] "m^2/s^2"  VideoFrontCenter
 SG_ RFC_Obj18_AxVnce : 168|12@1+ (0.01,0) [0|30] "m^2/s^4"  VideoFrontCenter
 SG_ RFC_Obj18_AyVnce : 180|12@1+ (0.01,0) [0|30] "m^2/s^4"  VideoFrontCenter
 SG_ RFC_Obj18_OrientationYawVnce : 192|12@1+ (0.0003,0) [0|1] "rad^2"  VideoFrontCenter
 SG_ RFC_Obj18_MovingObserved : 204|6@1+ (2,0) [0|100] "%"  VideoFrontCenter
 SG_ RFC_Obj18_MovingProbability : 210|6@1+ (2,0) [0|100] "%"  VideoFrontCenter
 SG_ RFC_Obj18_Length : 216|7@1+ (0.125,0) [0|15.875] "m"  VideoFrontCenter
 SG_ RFC_Obj18_Valid : 223|1@1+ (1,0) [0|1] ""  VideoFrontCenter
 SG_ RFC_Obj18_LengthVnce : 224|12@1+ (0.01,0) [0|30] "m^2"  VideoFrontCenter
 SG_ RFC_Obj18_WidthVnce : 236|12@1+ (0.01,0) [0|30] "m^2"  VideoFrontCenter
 SG_ RFC_Obj18_Width : 248|7@1+ (0.125,0) [0|15.875] "m"  VideoFrontCenter
 SG_ RFC_Obj18_BehaviorType : 255|3@1+ (1,0) [0|7] ""  VideoFrontCenter
 SG_ RFC_Obj18_ObstacleConf : 258|6@1+ (2,0) [0|100] "%"  VideoFrontCenter
 SG_ RFC_Obj18_NonObstacleConf : 264|6@1+ (2,0) [0|100] "%"  VideoFrontCenter
 SG_ RFC_Obj18_PxPyCoVnce : 272|12@1+ (0.01,0) [0|30] "m^2"  VideoFrontCenter
 SG_ RFC_Obj18_PxVxCoVnce : 284|12@1+ (0.01,0) [0|30] "m^2/s"  VideoFrontCenter
 SG_ RFC_Obj18_PxVyCoVnce : 296|12@1+ (0.01,0) [0|30] "m^2/s"  VideoFrontCenter
 SG_ RFC_Obj18_PyVxCoVnce : 308|12@1+ (0.01,0) [0|30] "m^2/s"  VideoFrontCenter
 SG_ RFC_Obj18_PyVyCoVnce : 320|12@1+ (0.01,0) [0|30] "m^2/s"  VideoFrontCenter
 SG_ RFC_Obj18_VxVyCoVnce : 332|12@1+ (0.01,0) [0|30] "m^2/s^2"  VideoFrontCenter
 SG_ RFC_Obj18_PxAxCoVnce : 344|12@1+ (0.01,0) [0|30] "m^2/s^2"  VideoFrontCenter
 SG_ RFC_Obj18_PxAyCoVnce : 356|12@1+ (0.01,0) [0|30] "m^2/s^2"  VideoFrontCenter
 SG_ RFC_Obj18_PyAxCoVnce : 368|12@1+ (0.01,0) [0|30] "m^2/s^2"  VideoFrontCenter
 SG_ RFC_Obj18_PyAyCoVnce : 380|12@1+ (0.01,0) [0|30] "m^2/s^2"  VideoFrontCenter
 SG_ RFC_Obj18_VxAxCoVnce : 392|12@1+ (0.01,0) [0|30] "m^2/s^3"  VideoFrontCenter
 SG_ RFC_Obj18_VxAyCoVnce : 404|12@1+ (0.01,0) [0|30] "m^2/s^3"  VideoFrontCenter
 SG_ RFC_Obj18_VyAxCoVnce : 416|12@1+ (0.01,0) [0|30] "m^2/s^3"  VideoFrontCenter
 SG_ RFC_Obj18_VyAyCoVnce : 428|12@1+ (0.01,0) [0|30] "m^2/s^3"  VideoFrontCenter
 SG_ RFC_Obj18_AxAyCoVnce : 440|12@1+ (0.01,0) [0|30] "m^2/s^4"  VideoFrontCenter
 SG_ RFC_Obj18_MobileObstConf : 452|6@1+ (2,0) [0|100] "%"  VideoFrontCenter
 SG_ RFC_Obj18_Mob4PlusWhlConf : 458|6@1+ (2,0) [0|100] "%"  VideoFrontCenter
 SG_ RFC_Obj18_Mob2WhlConf : 464|6@1+ (2,0) [0|100] "%"  VideoFrontCenter
 SG_ RFC_Obj18_MobPedConf : 470|6@1+ (2,0) [0|100] "%"  VideoFrontCenter
 SG_ RFC_Obj18_FourPlusWhlCarConf : 476|6@1+ (2,0) [0|100] "%"  VideoFrontCenter
 SG_ RFC_Obj18_FourPlusWhlHGVConf : 482|6@1+ (2,0) [0|100] "%"  VideoFrontCenter
 SG_ RFC_Obj18_GroundReflexConf : 488|6@1+ (2,0) [0|100] "%"  VideoFrontCenter
 SG_ RFC_Obj18_StatObstConf : 494|6@1+ (2,0) [0|100] "%"  VideoFrontCenter
 SG_ RFC_Obj18_StatBarrierConf : 500|6@1+ (2,0) [0|100] "%"  VideoFrontCenter

BO_ 425 RFC_Obj19: 64 RadarFrontCenter
 SG_ RFC_Obj19_CRC : 0|16@1+ (1,0) [0|65535] ""  VideoFrontCenter
 SG_ RFC_Obj19_AliveCtr : 16|8@1+ (1,0) [0|255] ""  VideoFrontCenter
 SG_ RFC_Obj19_ProtBlockCtr : 24|4@1+ (1,0) [0|15] ""  VideoFrontCenter
 SG_ RFC_Obj19_ReferencePoint : 28|4@1+ (1,0) [0|15] ""  VideoFrontCenter
 SG_ RFC_Obj19_ObjId : 32|7@1+ (1,0) [0|127] ""  VideoFrontCenter
 SG_ RFC_Obj19_MeasurementStatus : 39|1@1+ (1,0) [0|1] ""  VideoFrontCenter
 SG_ RFC_Obj19_Px : 40|13@1+ (0.0625,-256) [-256|255.9375] "m"  VideoFrontCenter
 SG_ RFC_Obj19_Py : 53|11@1+ (0.125,-128) [-128|127.875] "m"  VideoFrontCenter
 SG_ RFC_Obj19_PxVnce : 64|12@1+ (0.01,0) [0|30] "m^2"  VideoFrontCenter
 SG_ RFC_Obj19_PyVnce : 76|12@1+ (0.01,0) [0|30] "m^2"  VideoFrontCenter
 SG_ RFC_Obj19_Vx : 88|12@1+ (0.0625,-128) [-128|127.9375] "m/s"  VideoFrontCenter
 SG_ RFC_Obj19_Vy : 100|10@1+ (0.125,-64) [-64|63.875] "m/s"  VideoFrontCenter
 SG_ RFC_Obj19_Ax : 110|10@1+ (0.03125,-16) [-16|15.96875] "m/s^2"  VideoFrontCenter
 SG_ RFC_Obj19_Ay : 120|9@1+ (0.0625,-16) [-16|15.9375] "m/s^2"  VideoFrontCenter
 SG_ RFC_Obj19_OrientationYaw : 129|9@1+ (0.0175,-4.48) [-3.15|3.15] "rad"  VideoFrontCenter
 SG_ RFC_Obj19_ExistProb : 138|6@1+ (2,0) [0|100] "%"  VideoFrontCenter
 SG_ RFC_Obj19_VxVnce : 144|12@1+ (0.01,0) [0|30] "m^2/s^2"  VideoFrontCenter
 SG_ RFC_Obj19_VyVnce : 156|12@1+ (0.01,0) [0|30] "m^2/s^2"  VideoFrontCenter
 SG_ RFC_Obj19_AxVnce : 168|12@1+ (0.01,0) [0|30] "m^2/s^4"  VideoFrontCenter
 SG_ RFC_Obj19_AyVnce : 180|12@1+ (0.01,0) [0|30] "m^2/s^4"  VideoFrontCenter
 SG_ RFC_Obj19_OrientationYawVnce : 192|12@1+ (0.0003,0) [0|1] "rad^2"  VideoFrontCenter
 SG_ RFC_Obj19_MovingObserved : 204|6@1+ (2,0) [0|100] "%"  VideoFrontCenter
 SG_ RFC_Obj19_MovingProbability : 210|6@1+ (2,0) [0|100] "%"  VideoFrontCenter
 SG_ RFC_Obj19_Length : 216|7@1+ (0.125,0) [0|15.875] "m"  VideoFrontCenter
 SG_ RFC_Obj19_Valid : 223|1@1+ (1,0) [0|1] ""  VideoFrontCenter
 SG_ RFC_Obj19_LengthVnce : 224|12@1+ (0.01,0) [0|30] "m^2"  VideoFrontCenter
 SG_ RFC_Obj19_WidthVnce : 236|12@1+ (0.01,0) [0|30] "m^2"  VideoFrontCenter
 SG_ RFC_Obj19_Width : 248|7@1+ (0.125,0) [0|15.875] "m"  VideoFrontCenter
 SG_ RFC_Obj19_BehaviorType : 255|3@1+ (1,0) [0|7] ""  VideoFrontCenter
 SG_ RFC_Obj19_ObstacleConf : 258|6@1+ (2,0) [0|100] "%"  VideoFrontCenter
 SG_ RFC_Obj19_NonObstacleConf : 264|6@1+ (2,0) [0|100] "%"  VideoFrontCenter
 SG_ RFC_Obj19_PxPyCoVnce : 272|12@1+ (0.01,0) [0|30] "m^2"  VideoFrontCenter
 SG_ RFC_Obj19_PxVxCoVnce : 284|12@1+ (0.01,0) [0|30] "m^2/s"  VideoFrontCenter
 SG_ RFC_Obj19_PxVyCoVnce : 296|12@1+ (0.01,0) [0|30] "m^2/s"  VideoFrontCenter
 SG_ RFC_Obj19_PyVxCoVnce : 308|12@1+ (0.01,0) [0|30] "m^2/s"  VideoFrontCenter
 SG_ RFC_Obj19_PyVyCoVnce : 320|12@1+ (0.01,0) [0|30] "m^2/s"  VideoFrontCenter
 SG_ RFC_Obj19_VxVyCoVnce : 332|12@1+ (0.01,0) [0|30] "m^2/s^2"  VideoFrontCenter
 SG_ RFC_Obj19_PxAxCoVnce : 344|12@1+ (0.01,0) [0|30] "m^2/s^2"  VideoFrontCenter
 SG_ RFC_Obj19_PxAyCoVnce : 356|12@1+ (0.01,0) [0|30] "m^2/s^2"  VideoFrontCenter
 SG_ RFC_Obj19_PyAxCoVnce : 368|12@1+ (0.01,0) [0|30] "m^2/s^2"  VideoFrontCenter
 SG_ RFC_Obj19_PyAyCoVnce : 380|12@1+ (0.01,0) [0|30] "m^2/s^2"  VideoFrontCenter
 SG_ RFC_Obj19_VxAxCoVnce : 392|12@1+ (0.01,0) [0|30] "m^2/s^3"  VideoFrontCenter
 SG_ RFC_Obj19_VxAyCoVnce : 404|12@1+ (0.01,0) [0|30] "m^2/s^3"  VideoFrontCenter
 SG_ RFC_Obj19_VyAxCoVnce : 416|12@1+ (0.01,0) [0|30] "m^2/s^3"  VideoFrontCenter
 SG_ RFC_Obj19_VyAyCoVnce : 428|12@1+ (0.01,0) [0|30] "m^2/s^3"  VideoFrontCenter
 SG_ RFC_Obj19_AxAyCoVnce : 440|12@1+ (0.01,0) [0|30] "m^2/s^4"  VideoFrontCenter
 SG_ RFC_Obj19_MobileObstConf : 452|6@1+ (2,0) [0|100] "%"  VideoFrontCenter
 SG_ RFC_Obj19_Mob4PlusWhlConf : 458|6@1+ (2,0) [0|100] "%"  VideoFrontCenter
 SG_ RFC_Obj19_Mob2WhlConf : 464|6@1+ (2,0) [0|100] "%"  VideoFrontCenter
 SG_ RFC_Obj19_MobPedConf : 470|6@1+ (2,0) [0|100] "%"  VideoFrontCenter
 SG_ RFC_Obj19_FourPlusWhlCarConf : 476|6@1+ (2,0) [0|100] "%"  VideoFrontCenter
 SG_ RFC_Obj19_FourPlusWhlHGVConf : 482|6@1+ (2,0) [0|100] "%"  VideoFrontCenter
 SG_ RFC_Obj19_GroundReflexConf : 488|6@1+ (2,0) [0|100] "%"  VideoFrontCenter
 SG_ RFC_Obj19_StatObstConf : 494|6@1+ (2,0) [0|100] "%"  VideoFrontCenter
 SG_ RFC_Obj19_StatBarrierConf : 500|6@1+ (2,0) [0|100] "%"  VideoFrontCenter

BO_ 426 RFC_Obj20: 64 RadarFrontCenter
 SG_ RFC_Obj20_CRC : 0|16@1+ (1,0) [0|65535] ""  VideoFrontCenter
 SG_ RFC_Obj20_AliveCtr : 16|8@1+ (1,0) [0|255] ""  VideoFrontCenter
 SG_ RFC_Obj20_ProtBlockCtr : 24|4@1+ (1,0) [0|15] ""  VideoFrontCenter
 SG_ RFC_Obj20_ReferencePoint : 28|4@1+ (1,0) [0|15] ""  VideoFrontCenter
 SG_ RFC_Obj20_ObjId : 32|7@1+ (1,0) [0|127] ""  VideoFrontCenter
 SG_ RFC_Obj20_MeasurementStatus : 39|1@1+ (1,0) [0|1] ""  VideoFrontCenter
 SG_ RFC_Obj20_Px : 40|13@1+ (0.0625,-256) [-256|255.9375] "m"  VideoFrontCenter
 SG_ RFC_Obj20_Py : 53|11@1+ (0.125,-128) [-128|127.875] "m"  VideoFrontCenter
 SG_ RFC_Obj20_PxVnce : 64|12@1+ (0.01,0) [0|30] "m^2"  VideoFrontCenter
 SG_ RFC_Obj20_PyVnce : 76|12@1+ (0.01,0) [0|30] "m^2"  VideoFrontCenter
 SG_ RFC_Obj20_Vx : 88|12@1+ (0.0625,-128) [-128|127.9375] "m/s"  VideoFrontCenter
 SG_ RFC_Obj20_Vy : 100|10@1+ (0.125,-64) [-64|63.875] "m/s"  VideoFrontCenter
 SG_ RFC_Obj20_Ax : 110|10@1+ (0.03125,-16) [-16|15.96875] "m/s^2"  VideoFrontCenter
 SG_ RFC_Obj20_Ay : 120|9@1+ (0.0625,-16) [-16|15.9375] "m/s^2"  VideoFrontCenter
 SG_ RFC_Obj20_OrientationYaw : 129|9@1+ (0.0175,-4.48) [-3.15|3.15] "rad"  VideoFrontCenter
 SG_ RFC_Obj20_ExistProb : 138|6@1+ (2,0) [0|100] "%"  VideoFrontCenter
 SG_ RFC_Obj20_VxVnce : 144|12@1+ (0.01,0) [0|30] "m^2/s^2"  VideoFrontCenter
 SG_ RFC_Obj20_VyVnce : 156|12@1+ (0.01,0) [0|30] "m^2/s^2"  VideoFrontCenter
 SG_ RFC_Obj20_AxVnce : 168|12@1+ (0.01,0) [0|30] "m^2/s^4"  VideoFrontCenter
 SG_ RFC_Obj20_AyVnce : 180|12@1+ (0.01,0) [0|30] "m^2/s^4"  VideoFrontCenter
 SG_ RFC_Obj20_OrientationYawVnce : 192|12@1+ (0.0003,0) [0|1] "rad^2"  VideoFrontCenter
 SG_ RFC_Obj20_MovingObserved : 204|6@1+ (2,0) [0|100] "%"  VideoFrontCenter
 SG_ RFC_Obj20_MovingProbability : 210|6@1+ (2,0) [0|100] "%"  VideoFrontCenter
 SG_ RFC_Obj20_Length : 216|7@1+ (0.125,0) [0|15.875] "m"  VideoFrontCenter
 SG_ RFC_Obj20_Valid : 223|1@1+ (1,0) [0|1] ""  VideoFrontCenter
 SG_ RFC_Obj20_LengthVnce : 224|12@1+ (0.01,0) [0|30] "m^2"  VideoFrontCenter
 SG_ RFC_Obj20_WidthVnce : 236|12@1+ (0.01,0) [0|30] "m^2"  VideoFrontCenter
 SG_ RFC_Obj20_Width : 248|7@1+ (0.125,0) [0|15.875] "m"  VideoFrontCenter
 SG_ RFC_Obj20_BehaviorType : 255|3@1+ (1,0) [0|7] ""  VideoFrontCenter
 SG_ RFC_Obj20_ObstacleConf : 258|6@1+ (2,0) [0|100] "%"  VideoFrontCenter
 SG_ RFC_Obj20_NonObstacleConf : 264|6@1+ (2,0) [0|100] "%"  VideoFrontCenter
 SG_ RFC_Obj20_PxPyCoVnce : 272|12@1+ (0.01,0) [0|30] "m^2"  VideoFrontCenter
 SG_ RFC_Obj20_PxVxCoVnce : 284|12@1+ (0.01,0) [0|30] "m^2/s"  VideoFrontCenter
 SG_ RFC_Obj20_PxVyCoVnce : 296|12@1+ (0.01,0) [0|30] "m^2/s"  VideoFrontCenter
 SG_ RFC_Obj20_PyVxCoVnce : 308|12@1+ (0.01,0) [0|30] "m^2/s"  VideoFrontCenter
 SG_ RFC_Obj20_PyVyCoVnce : 320|12@1+ (0.01,0) [0|30] "m^2/s"  VideoFrontCenter
 SG_ RFC_Obj20_VxVyCoVnce : 332|12@1+ (0.01,0) [0|30] "m^2/s^2"  VideoFrontCenter
 SG_ RFC_Obj20_PxAxCoVnce : 344|12@1+ (0.01,0) [0|30] "m^2/s^2"  VideoFrontCenter
 SG_ RFC_Obj20_PxAyCoVnce : 356|12@1+ (0.01,0) [0|30] "m^2/s^2"  VideoFrontCenter
 SG_ RFC_Obj20_PyAxCoVnce : 368|12@1+ (0.01,0) [0|30] "m^2/s^2"  VideoFrontCenter
 SG_ RFC_Obj20_PyAyCoVnce : 380|12@1+ (0.01,0) [0|30] "m^2/s^2"  VideoFrontCenter
 SG_ RFC_Obj20_VxAxCoVnce : 392|12@1+ (0.01,0) [0|30] "m^2/s^3"  VideoFrontCenter
 SG_ RFC_Obj20_VxAyCoVnce : 404|12@1+ (0.01,0) [0|30] "m^2/s^3"  VideoFrontCenter
 SG_ RFC_Obj20_VyAxCoVnce : 416|12@1+ (0.01,0) [0|30] "m^2/s^3"  VideoFrontCenter
 SG_ RFC_Obj20_VyAyCoVnce : 428|12@1+ (0.01,0) [0|30] "m^2/s^3"  VideoFrontCenter
 SG_ RFC_Obj20_AxAyCoVnce : 440|12@1+ (0.01,0) [0|30] "m^2/s^4"  VideoFrontCenter
 SG_ RFC_Obj20_MobileObstConf : 452|6@1+ (2,0) [0|100] "%"  VideoFrontCenter
 SG_ RFC_Obj20_Mob4PlusWhlConf : 458|6@1+ (2,0) [0|100] "%"  VideoFrontCenter
 SG_ RFC_Obj20_Mob2WhlConf : 464|6@1+ (2,0) [0|100] "%"  VideoFrontCenter
 SG_ RFC_Obj20_MobPedConf : 470|6@1+ (2,0) [0|100] "%"  VideoFrontCenter
 SG_ RFC_Obj20_FourPlusWhlCarConf : 476|6@1+ (2,0) [0|100] "%"  VideoFrontCenter
 SG_ RFC_Obj20_FourPlusWhlHGVConf : 482|6@1+ (2,0) [0|100] "%"  VideoFrontCenter
 SG_ RFC_Obj20_GroundReflexConf : 488|6@1+ (2,0) [0|100] "%"  VideoFrontCenter
 SG_ RFC_Obj20_StatObstConf : 494|6@1+ (2,0) [0|100] "%"  VideoFrontCenter
 SG_ RFC_Obj20_StatBarrierConf : 500|6@1+ (2,0) [0|100] "%"  VideoFrontCenter

BO_ 427 RFC_Obj21: 64 RadarFrontCenter
 SG_ RFC_Obj21_CRC : 0|16@1+ (1,0) [0|65535] ""  VideoFrontCenter
 SG_ RFC_Obj21_AliveCtr : 16|8@1+ (1,0) [0|255] ""  VideoFrontCenter
 SG_ RFC_Obj21_ProtBlockCtr : 24|4@1+ (1,0) [0|15] ""  VideoFrontCenter
 SG_ RFC_Obj21_ReferencePoint : 28|4@1+ (1,0) [0|15] ""  VideoFrontCenter
 SG_ RFC_Obj21_ObjId : 32|7@1+ (1,0) [0|127] ""  VideoFrontCenter
 SG_ RFC_Obj21_MeasurementStatus : 39|1@1+ (1,0) [0|1] ""  VideoFrontCenter
 SG_ RFC_Obj21_Px : 40|13@1+ (0.0625,-256) [-256|255.9375] "m"  VideoFrontCenter
 SG_ RFC_Obj21_Py : 53|11@1+ (0.125,-128) [-128|127.875] "m"  VideoFrontCenter
 SG_ RFC_Obj21_PxVnce : 64|12@1+ (0.01,0) [0|30] "m^2"  VideoFrontCenter
 SG_ RFC_Obj21_PyVnce : 76|12@1+ (0.01,0) [0|30] "m^2"  VideoFrontCenter
 SG_ RFC_Obj21_Vx : 88|12@1+ (0.0625,-128) [-128|127.9375] "m/s"  VideoFrontCenter
 SG_ RFC_Obj21_Vy : 100|10@1+ (0.125,-64) [-64|63.875] "m/s"  VideoFrontCenter
 SG_ RFC_Obj21_Ax : 110|10@1+ (0.03125,-16) [-16|15.96875] "m/s^2"  VideoFrontCenter
 SG_ RFC_Obj21_Ay : 120|9@1+ (0.0625,-16) [-16|15.9375] "m/s^2"  VideoFrontCenter
 SG_ RFC_Obj21_OrientationYaw : 129|9@1+ (0.0175,-4.48) [-3.15|3.15] "rad"  VideoFrontCenter
 SG_ RFC_Obj21_ExistProb : 138|6@1+ (2,0) [0|100] "%"  VideoFrontCenter
 SG_ RFC_Obj21_VxVnce : 144|12@1+ (0.01,0) [0|30] "m^2/s^2"  VideoFrontCenter
 SG_ RFC_Obj21_VyVnce : 156|12@1+ (0.01,0) [0|30] "m^2/s^2"  VideoFrontCenter
 SG_ RFC_Obj21_AxVnce : 168|12@1+ (0.01,0) [0|30] "m^2/s^4"  VideoFrontCenter
 SG_ RFC_Obj21_AyVnce : 180|12@1+ (0.01,0) [0|30] "m^2/s^4"  VideoFrontCenter
 SG_ RFC_Obj21_OrientationYawVnce : 192|12@1+ (0.0003,0) [0|1] "rad^2"  VideoFrontCenter
 SG_ RFC_Obj21_MovingObserved : 204|6@1+ (2,0) [0|100] "%"  VideoFrontCenter
 SG_ RFC_Obj21_MovingProbability : 210|6@1+ (2,0) [0|100] "%"  VideoFrontCenter
 SG_ RFC_Obj21_Length : 216|7@1+ (0.125,0) [0|15.875] "m"  VideoFrontCenter
 SG_ RFC_Obj21_Valid : 223|1@1+ (1,0) [0|1] ""  VideoFrontCenter
 SG_ RFC_Obj21_LengthVnce : 224|12@1+ (0.01,0) [0|30] "m^2"  VideoFrontCenter
 SG_ RFC_Obj21_WidthVnce : 236|12@1+ (0.01,0) [0|30] "m^2"  VideoFrontCenter
 SG_ RFC_Obj21_Width : 248|7@1+ (0.125,0) [0|15.875] "m"  VideoFrontCenter
 SG_ RFC_Obj21_BehaviorType : 255|3@1+ (1,0) [0|7] ""  VideoFrontCenter
 SG_ RFC_Obj21_ObstacleConf : 258|6@1+ (2,0) [0|100] "%"  VideoFrontCenter
 SG_ RFC_Obj21_NonObstacleConf : 264|6@1+ (2,0) [0|100] "%"  VideoFrontCenter
 SG_ RFC_Obj21_PxPyCoVnce : 272|12@1+ (0.01,0) [0|30] "m^2"  VideoFrontCenter
 SG_ RFC_Obj21_PxVxCoVnce : 284|12@1+ (0.01,0) [0|30] "m^2/s"  VideoFrontCenter
 SG_ RFC_Obj21_PxVyCoVnce : 296|12@1+ (0.01,0) [0|30] "m^2/s"  VideoFrontCenter
 SG_ RFC_Obj21_PyVxCoVnce : 308|12@1+ (0.01,0) [0|30] "m^2/s"  VideoFrontCenter
 SG_ RFC_Obj21_PyVyCoVnce : 320|12@1+ (0.01,0) [0|30] "m^2/s"  VideoFrontCenter
 SG_ RFC_Obj21_VxVyCoVnce : 332|12@1+ (0.01,0) [0|30] "m^2/s^2"  VideoFrontCenter
 SG_ RFC_Obj21_PxAxCoVnce : 344|12@1+ (0.01,0) [0|30] "m^2/s^2"  VideoFrontCenter
 SG_ RFC_Obj21_PxAyCoVnce : 356|12@1+ (0.01,0) [0|30] "m^2/s^2"  VideoFrontCenter
 SG_ RFC_Obj21_PyAxCoVnce : 368|12@1+ (0.01,0) [0|30] "m^2/s^2"  VideoFrontCenter
 SG_ RFC_Obj21_PyAyCoVnce : 380|12@1+ (0.01,0) [0|30] "m^2/s^2"  VideoFrontCenter
 SG_ RFC_Obj21_VxAxCoVnce : 392|12@1+ (0.01,0) [0|30] "m^2/s^3"  VideoFrontCenter
 SG_ RFC_Obj21_VxAyCoVnce : 404|12@1+ (0.01,0) [0|30] "m^2/s^3"  VideoFrontCenter
 SG_ RFC_Obj21_VyAxCoVnce : 416|12@1+ (0.01,0) [0|30] "m^2/s^3"  VideoFrontCenter
 SG_ RFC_Obj21_VyAyCoVnce : 428|12@1+ (0.01,0) [0|30] "m^2/s^3"  VideoFrontCenter
 SG_ RFC_Obj21_AxAyCoVnce : 440|12@1+ (0.01,0) [0|30] "m^2/s^4"  VideoFrontCenter
 SG_ RFC_Obj21_MobileObstConf : 452|6@1+ (2,0) [0|100] "%"  VideoFrontCenter
 SG_ RFC_Obj21_Mob4PlusWhlConf : 458|6@1+ (2,0) [0|100] "%"  VideoFrontCenter
 SG_ RFC_Obj21_Mob2WhlConf : 464|6@1+ (2,0) [0|100] "%"  VideoFrontCenter
 SG_ RFC_Obj21_MobPedConf : 470|6@1+ (2,0) [0|100] "%"  VideoFrontCenter
 SG_ RFC_Obj21_FourPlusWhlCarConf : 476|6@1+ (2,0) [0|100] "%"  VideoFrontCenter
 SG_ RFC_Obj21_FourPlusWhlHGVConf : 482|6@1+ (2,0) [0|100] "%"  VideoFrontCenter
 SG_ RFC_Obj21_GroundReflexConf : 488|6@1+ (2,0) [0|100] "%"  VideoFrontCenter
 SG_ RFC_Obj21_StatObstConf : 494|6@1+ (2,0) [0|100] "%"  VideoFrontCenter
 SG_ RFC_Obj21_StatBarrierConf : 500|6@1+ (2,0) [0|100] "%"  VideoFrontCenter

BO_ 428 RFC_Obj22: 64 RadarFrontCenter
 SG_ RFC_Obj22_CRC : 0|16@1+ (1,0) [0|65535] ""  VideoFrontCenter
 SG_ RFC_Obj22_AliveCtr : 16|8@1+ (1,0) [0|255] ""  VideoFrontCenter
 SG_ RFC_Obj22_ProtBlockCtr : 24|4@1+ (1,0) [0|15] ""  VideoFrontCenter
 SG_ RFC_Obj22_ReferencePoint : 28|4@1+ (1,0) [0|15] ""  VideoFrontCenter
 SG_ RFC_Obj22_ObjId : 32|7@1+ (1,0) [0|127] ""  VideoFrontCenter
 SG_ RFC_Obj22_MeasurementStatus : 39|1@1+ (1,0) [0|1] ""  VideoFrontCenter
 SG_ RFC_Obj22_Px : 40|13@1+ (0.0625,-256) [-256|255.9375] "m"  VideoFrontCenter
 SG_ RFC_Obj22_Py : 53|11@1+ (0.125,-128) [-128|127.875] "m"  VideoFrontCenter
 SG_ RFC_Obj22_PxVnce : 64|12@1+ (0.01,0) [0|30] "m^2"  VideoFrontCenter
 SG_ RFC_Obj22_PyVnce : 76|12@1+ (0.01,0) [0|30] "m^2"  VideoFrontCenter
 SG_ RFC_Obj22_Vx : 88|12@1+ (0.0625,-128) [-128|127.9375] "m/s"  VideoFrontCenter
 SG_ RFC_Obj22_Vy : 100|10@1+ (0.125,-64) [-64|63.875] "m/s"  VideoFrontCenter
 SG_ RFC_Obj22_Ax : 110|10@1+ (0.03125,-16) [-16|15.96875] "m/s^2"  VideoFrontCenter
 SG_ RFC_Obj22_Ay : 120|9@1+ (0.0625,-16) [-16|15.9375] "m/s^2"  VideoFrontCenter
 SG_ RFC_Obj22_OrientationYaw : 129|9@1+ (0.0175,-4.48) [-3.15|3.15] "rad"  VideoFrontCenter
 SG_ RFC_Obj22_ExistProb : 138|6@1+ (2,0) [0|100] "%"  VideoFrontCenter
 SG_ RFC_Obj22_VxVnce : 144|12@1+ (0.01,0) [0|30] "m^2/s^2"  VideoFrontCenter
 SG_ RFC_Obj22_VyVnce : 156|12@1+ (0.01,0) [0|30] "m^2/s^2"  VideoFrontCenter
 SG_ RFC_Obj22_AxVnce : 168|12@1+ (0.01,0) [0|30] "m^2/s^4"  VideoFrontCenter
 SG_ RFC_Obj22_AyVnce : 180|12@1+ (0.01,0) [0|30] "m^2/s^4"  VideoFrontCenter
 SG_ RFC_Obj22_OrientationYawVnce : 192|12@1+ (0.0003,0) [0|1] "rad^2"  VideoFrontCenter
 SG_ RFC_Obj22_MovingObserved : 204|6@1+ (2,0) [0|100] "%"  VideoFrontCenter
 SG_ RFC_Obj22_MovingProbability : 210|6@1+ (2,0) [0|100] "%"  VideoFrontCenter
 SG_ RFC_Obj22_Length : 216|7@1+ (0.125,0) [0|15.875] "m"  VideoFrontCenter
 SG_ RFC_Obj22_Valid : 223|1@1+ (1,0) [0|1] ""  VideoFrontCenter
 SG_ RFC_Obj22_LengthVnce : 224|12@1+ (0.01,0) [0|30] "m^2"  VideoFrontCenter
 SG_ RFC_Obj22_WidthVnce : 236|12@1+ (0.01,0) [0|30] "m^2"  VideoFrontCenter
 SG_ RFC_Obj22_Width : 248|7@1+ (0.125,0) [0|15.875] "m"  VideoFrontCenter
 SG_ RFC_Obj22_BehaviorType : 255|3@1+ (1,0) [0|7] ""  VideoFrontCenter
 SG_ RFC_Obj22_ObstacleConf : 258|6@1+ (2,0) [0|100] "%"  VideoFrontCenter
 SG_ RFC_Obj22_NonObstacleConf : 264|6@1+ (2,0) [0|100] "%"  VideoFrontCenter
 SG_ RFC_Obj22_PxPyCoVnce : 272|12@1+ (0.01,0) [0|30] "m^2"  VideoFrontCenter
 SG_ RFC_Obj22_PxVxCoVnce : 284|12@1+ (0.01,0) [0|30] "m^2/s"  VideoFrontCenter
 SG_ RFC_Obj22_PxVyCoVnce : 296|12@1+ (0.01,0) [0|30] "m^2/s"  VideoFrontCenter
 SG_ RFC_Obj22_PyVxCoVnce : 308|12@1+ (0.01,0) [0|30] "m^2/s"  VideoFrontCenter
 SG_ RFC_Obj22_PyVyCoVnce : 320|12@1+ (0.01,0) [0|30] "m^2/s"  VideoFrontCenter
 SG_ RFC_Obj22_VxVyCoVnce : 332|12@1+ (0.01,0) [0|30] "m^2/s^2"  VideoFrontCenter
 SG_ RFC_Obj22_PxAxCoVnce : 344|12@1+ (0.01,0) [0|30] "m^2/s^2"  VideoFrontCenter
 SG_ RFC_Obj22_PxAyCoVnce : 356|12@1+ (0.01,0) [0|30] "m^2/s^2"  VideoFrontCenter
 SG_ RFC_Obj22_PyAxCoVnce : 368|12@1+ (0.01,0) [0|30] "m^2/s^2"  VideoFrontCenter
 SG_ RFC_Obj22_PyAyCoVnce : 380|12@1+ (0.01,0) [0|30] "m^2/s^2"  VideoFrontCenter
 SG_ RFC_Obj22_VxAxCoVnce : 392|12@1+ (0.01,0) [0|30] "m^2/s^3"  VideoFrontCenter
 SG_ RFC_Obj22_VxAyCoVnce : 404|12@1+ (0.01,0) [0|30] "m^2/s^3"  VideoFrontCenter
 SG_ RFC_Obj22_VyAxCoVnce : 416|12@1+ (0.01,0) [0|30] "m^2/s^3"  VideoFrontCenter
 SG_ RFC_Obj22_VyAyCoVnce : 428|12@1+ (0.01,0) [0|30] "m^2/s^3"  VideoFrontCenter
 SG_ RFC_Obj22_AxAyCoVnce : 440|12@1+ (0.01,0) [0|30] "m^2/s^4"  VideoFrontCenter
 SG_ RFC_Obj22_MobileObstConf : 452|6@1+ (2,0) [0|100] "%"  VideoFrontCenter
 SG_ RFC_Obj22_Mob4PlusWhlConf : 458|6@1+ (2,0) [0|100] "%"  VideoFrontCenter
 SG_ RFC_Obj22_Mob2WhlConf : 464|6@1+ (2,0) [0|100] "%"  VideoFrontCenter
 SG_ RFC_Obj22_MobPedConf : 470|6@1+ (2,0) [0|100] "%"  VideoFrontCenter
 SG_ RFC_Obj22_FourPlusWhlCarConf : 476|6@1+ (2,0) [0|100] "%"  VideoFrontCenter
 SG_ RFC_Obj22_FourPlusWhlHGVConf : 482|6@1+ (2,0) [0|100] "%"  VideoFrontCenter
 SG_ RFC_Obj22_GroundReflexConf : 488|6@1+ (2,0) [0|100] "%"  VideoFrontCenter
 SG_ RFC_Obj22_StatObstConf : 494|6@1+ (2,0) [0|100] "%"  VideoFrontCenter
 SG_ RFC_Obj22_StatBarrierConf : 500|6@1+ (2,0) [0|100] "%"  VideoFrontCenter

BO_ 429 RFC_Obj23: 64 RadarFrontCenter
 SG_ RFC_Obj23_CRC : 0|16@1+ (1,0) [0|65535] ""  VideoFrontCenter
 SG_ RFC_Obj23_AliveCtr : 16|8@1+ (1,0) [0|255] ""  VideoFrontCenter
 SG_ RFC_Obj23_ProtBlockCtr : 24|4@1+ (1,0) [0|15] ""  VideoFrontCenter
 SG_ RFC_Obj23_ReferencePoint : 28|4@1+ (1,0) [0|15] ""  VideoFrontCenter
 SG_ RFC_Obj23_ObjId : 32|7@1+ (1,0) [0|127] ""  VideoFrontCenter
 SG_ RFC_Obj23_MeasurementStatus : 39|1@1+ (1,0) [0|1] ""  VideoFrontCenter
 SG_ RFC_Obj23_Px : 40|13@1+ (0.0625,-256) [-256|255.9375] "m"  VideoFrontCenter
 SG_ RFC_Obj23_Py : 53|11@1+ (0.125,-128) [-128|127.875] "m"  VideoFrontCenter
 SG_ RFC_Obj23_PxVnce : 64|12@1+ (0.01,0) [0|30] "m^2"  VideoFrontCenter
 SG_ RFC_Obj23_PyVnce : 76|12@1+ (0.01,0) [0|30] "m^2"  VideoFrontCenter
 SG_ RFC_Obj23_Vx : 88|12@1+ (0.0625,-128) [-128|127.9375] "m/s"  VideoFrontCenter
 SG_ RFC_Obj23_Vy : 100|10@1+ (0.125,-64) [-64|63.875] "m/s"  VideoFrontCenter
 SG_ RFC_Obj23_Ax : 110|10@1+ (0.03125,-16) [-16|15.96875] "m/s^2"  VideoFrontCenter
 SG_ RFC_Obj23_Ay : 120|9@1+ (0.0625,-16) [-16|15.9375] "m/s^2"  VideoFrontCenter
 SG_ RFC_Obj23_OrientationYaw : 129|9@1+ (0.0175,-4.48) [-3.15|3.15] "rad"  VideoFrontCenter
 SG_ RFC_Obj23_ExistProb : 138|6@1+ (2,0) [0|100] "%"  VideoFrontCenter
 SG_ RFC_Obj23_VxVnce : 144|12@1+ (0.01,0) [0|30] "m^2/s^2"  VideoFrontCenter
 SG_ RFC_Obj23_VyVnce : 156|12@1+ (0.01,0) [0|30] "m^2/s^2"  VideoFrontCenter
 SG_ RFC_Obj23_AxVnce : 168|12@1+ (0.01,0) [0|30] "m^2/s^4"  VideoFrontCenter
 SG_ RFC_Obj23_AyVnce : 180|12@1+ (0.01,0) [0|30] "m^2/s^4"  VideoFrontCenter
 SG_ RFC_Obj23_OrientationYawVnce : 192|12@1+ (0.0003,0) [0|1] "rad^2"  VideoFrontCenter
 SG_ RFC_Obj23_MovingObserved : 204|6@1+ (2,0) [0|100] "%"  VideoFrontCenter
 SG_ RFC_Obj23_MovingProbability : 210|6@1+ (2,0) [0|100] "%"  VideoFrontCenter
 SG_ RFC_Obj23_Length : 216|7@1+ (0.125,0) [0|15.875] "m"  VideoFrontCenter
 SG_ RFC_Obj23_Valid : 223|1@1+ (1,0) [0|1] ""  VideoFrontCenter
 SG_ RFC_Obj23_LengthVnce : 224|12@1+ (0.01,0) [0|30] "m^2"  VideoFrontCenter
 SG_ RFC_Obj23_WidthVnce : 236|12@1+ (0.01,0) [0|30] "m^2"  VideoFrontCenter
 SG_ RFC_Obj23_Width : 248|7@1+ (0.125,0) [0|15.875] "m"  VideoFrontCenter
 SG_ RFC_Obj23_BehaviorType : 255|3@1+ (1,0) [0|7] ""  VideoFrontCenter
 SG_ RFC_Obj23_ObstacleConf : 258|6@1+ (2,0) [0|100] "%"  VideoFrontCenter
 SG_ RFC_Obj23_NonObstacleConf : 264|6@1+ (2,0) [0|100] "%"  VideoFrontCenter
 SG_ RFC_Obj23_PxPyCoVnce : 272|12@1+ (0.01,0) [0|30] "m^2"  VideoFrontCenter
 SG_ RFC_Obj23_PxVxCoVnce : 284|12@1+ (0.01,0) [0|30] "m^2/s"  VideoFrontCenter
 SG_ RFC_Obj23_PxVyCoVnce : 296|12@1+ (0.01,0) [0|30] "m^2/s"  VideoFrontCenter
 SG_ RFC_Obj23_PyVxCoVnce : 308|12@1+ (0.01,0) [0|30] "m^2/s"  VideoFrontCenter
 SG_ RFC_Obj23_PyVyCoVnce : 320|12@1+ (0.01,0) [0|30] "m^2/s"  VideoFrontCenter
 SG_ RFC_Obj23_VxVyCoVnce : 332|12@1+ (0.01,0) [0|30] "m^2/s^2"  VideoFrontCenter
 SG_ RFC_Obj23_PxAxCoVnce : 344|12@1+ (0.01,0) [0|30] "m^2/s^2"  VideoFrontCenter
 SG_ RFC_Obj23_PxAyCoVnce : 356|12@1+ (0.01,0) [0|30] "m^2/s^2"  VideoFrontCenter
 SG_ RFC_Obj23_PyAxCoVnce : 368|12@1+ (0.01,0) [0|30] "m^2/s^2"  VideoFrontCenter
 SG_ RFC_Obj23_PyAyCoVnce : 380|12@1+ (0.01,0) [0|30] "m^2/s^2"  VideoFrontCenter
 SG_ RFC_Obj23_VxAxCoVnce : 392|12@1+ (0.01,0) [0|30] "m^2/s^3"  VideoFrontCenter
 SG_ RFC_Obj23_VxAyCoVnce : 404|12@1+ (0.01,0) [0|30] "m^2/s^3"  VideoFrontCenter
 SG_ RFC_Obj23_VyAxCoVnce : 416|12@1+ (0.01,0) [0|30] "m^2/s^3"  VideoFrontCenter
 SG_ RFC_Obj23_VyAyCoVnce : 428|12@1+ (0.01,0) [0|30] "m^2/s^3"  VideoFrontCenter
 SG_ RFC_Obj23_AxAyCoVnce : 440|12@1+ (0.01,0) [0|30] "m^2/s^4"  VideoFrontCenter
 SG_ RFC_Obj23_MobileObstConf : 452|6@1+ (2,0) [0|100] "%"  VideoFrontCenter
 SG_ RFC_Obj23_Mob4PlusWhlConf : 458|6@1+ (2,0) [0|100] "%"  VideoFrontCenter
 SG_ RFC_Obj23_Mob2WhlConf : 464|6@1+ (2,0) [0|100] "%"  VideoFrontCenter
 SG_ RFC_Obj23_MobPedConf : 470|6@1+ (2,0) [0|100] "%"  VideoFrontCenter
 SG_ RFC_Obj23_FourPlusWhlCarConf : 476|6@1+ (2,0) [0|100] "%"  VideoFrontCenter
 SG_ RFC_Obj23_FourPlusWhlHGVConf : 482|6@1+ (2,0) [0|100] "%"  VideoFrontCenter
 SG_ RFC_Obj23_GroundReflexConf : 488|6@1+ (2,0) [0|100] "%"  VideoFrontCenter
 SG_ RFC_Obj23_StatObstConf : 494|6@1+ (2,0) [0|100] "%"  VideoFrontCenter
 SG_ RFC_Obj23_StatBarrierConf : 500|6@1+ (2,0) [0|100] "%"  VideoFrontCenter

BO_ 430 RFC_Obj24: 64 RadarFrontCenter
 SG_ RFC_Obj24_CRC : 0|16@1+ (1,0) [0|65535] ""  VideoFrontCenter
 SG_ RFC_Obj24_AliveCtr : 16|8@1+ (1,0) [0|255] ""  VideoFrontCenter
 SG_ RFC_Obj24_ProtBlockCtr : 24|4@1+ (1,0) [0|15] ""  VideoFrontCenter
 SG_ RFC_Obj24_ReferencePoint : 28|4@1+ (1,0) [0|15] ""  VideoFrontCenter
 SG_ RFC_Obj24_ObjId : 32|7@1+ (1,0) [0|127] ""  VideoFrontCenter
 SG_ RFC_Obj24_MeasurementStatus : 39|1@1+ (1,0) [0|1] ""  VideoFrontCenter
 SG_ RFC_Obj24_Px : 40|13@1+ (0.0625,-256) [-256|255.9375] "m"  VideoFrontCenter
 SG_ RFC_Obj24_Py : 53|11@1+ (0.125,-128) [-128|127.875] "m"  VideoFrontCenter
 SG_ RFC_Obj24_PxVnce : 64|12@1+ (0.01,0) [0|30] "m^2"  VideoFrontCenter
 SG_ RFC_Obj24_PyVnce : 76|12@1+ (0.01,0) [0|30] "m^2"  VideoFrontCenter
 SG_ RFC_Obj24_Vx : 88|12@1+ (0.0625,-128) [-128|127.9375] "m/s"  VideoFrontCenter
 SG_ RFC_Obj24_Vy : 100|10@1+ (0.125,-64) [-64|63.875] "m/s"  VideoFrontCenter
 SG_ RFC_Obj24_Ax : 110|10@1+ (0.03125,-16) [-16|15.96875] "m/s^2"  VideoFrontCenter
 SG_ RFC_Obj24_Ay : 120|9@1+ (0.0625,-16) [-16|15.9375] "m/s^2"  VideoFrontCenter
 SG_ RFC_Obj24_OrientationYaw : 129|9@1+ (0.0175,-4.48) [-3.15|3.15] "rad"  VideoFrontCenter
 SG_ RFC_Obj24_ExistProb : 138|6@1+ (2,0) [0|100] "%"  VideoFrontCenter
 SG_ RFC_Obj24_VxVnce : 144|12@1+ (0.01,0) [0|30] "m^2/s^2"  VideoFrontCenter
 SG_ RFC_Obj24_VyVnce : 156|12@1+ (0.01,0) [0|30] "m^2/s^2"  VideoFrontCenter
 SG_ RFC_Obj24_AxVnce : 168|12@1+ (0.01,0) [0|30] "m^2/s^4"  VideoFrontCenter
 SG_ RFC_Obj24_AyVnce : 180|12@1+ (0.01,0) [0|30] "m^2/s^4"  VideoFrontCenter
 SG_ RFC_Obj24_OrientationYawVnce : 192|12@1+ (0.0003,0) [0|1] "rad^2"  VideoFrontCenter
 SG_ RFC_Obj24_MovingObserved : 204|6@1+ (2,0) [0|100] "%"  VideoFrontCenter
 SG_ RFC_Obj24_MovingProbability : 210|6@1+ (2,0) [0|100] "%"  VideoFrontCenter
 SG_ RFC_Obj24_Length : 216|7@1+ (0.125,0) [0|15.875] "m"  VideoFrontCenter
 SG_ RFC_Obj24_Valid : 223|1@1+ (1,0) [0|1] ""  VideoFrontCenter
 SG_ RFC_Obj24_LengthVnce : 224|12@1+ (0.01,0) [0|30] "m^2"  VideoFrontCenter
 SG_ RFC_Obj24_WidthVnce : 236|12@1+ (0.01,0) [0|30] "m^2"  VideoFrontCenter
 SG_ RFC_Obj24_Width : 248|7@1+ (0.125,0) [0|15.875] "m"  VideoFrontCenter
 SG_ RFC_Obj24_BehaviorType : 255|3@1+ (1,0) [0|7] ""  VideoFrontCenter
 SG_ RFC_Obj24_ObstacleConf : 258|6@1+ (2,0) [0|100] "%"  VideoFrontCenter
 SG_ RFC_Obj24_NonObstacleConf : 264|6@1+ (2,0) [0|100] "%"  VideoFrontCenter
 SG_ RFC_Obj24_PxPyCoVnce : 272|12@1+ (0.01,0) [0|30] "m^2"  VideoFrontCenter
 SG_ RFC_Obj24_PxVxCoVnce : 284|12@1+ (0.01,0) [0|30] "m^2/s"  VideoFrontCenter
 SG_ RFC_Obj24_PxVyCoVnce : 296|12@1+ (0.01,0) [0|30] "m^2/s"  VideoFrontCenter
 SG_ RFC_Obj24_PyVxCoVnce : 308|12@1+ (0.01,0) [0|30] "m^2/s"  VideoFrontCenter
 SG_ RFC_Obj24_PyVyCoVnce : 320|12@1+ (0.01,0) [0|30] "m^2/s"  VideoFrontCenter
 SG_ RFC_Obj24_VxVyCoVnce : 332|12@1+ (0.01,0) [0|30] "m^2/s^2"  VideoFrontCenter
 SG_ RFC_Obj24_PxAxCoVnce : 344|12@1+ (0.01,0) [0|30] "m^2/s^2"  VideoFrontCenter
 SG_ RFC_Obj24_PxAyCoVnce : 356|12@1+ (0.01,0) [0|30] "m^2/s^2"  VideoFrontCenter
 SG_ RFC_Obj24_PyAxCoVnce : 368|12@1+ (0.01,0) [0|30] "m^2/s^2"  VideoFrontCenter
 SG_ RFC_Obj24_PyAyCoVnce : 380|12@1+ (0.01,0) [0|30] "m^2/s^2"  VideoFrontCenter
 SG_ RFC_Obj24_VxAxCoVnce : 392|12@1+ (0.01,0) [0|30] "m^2/s^3"  VideoFrontCenter
 SG_ RFC_Obj24_VxAyCoVnce : 404|12@1+ (0.01,0) [0|30] "m^2/s^3"  VideoFrontCenter
 SG_ RFC_Obj24_VyAxCoVnce : 416|12@1+ (0.01,0) [0|30] "m^2/s^3"  VideoFrontCenter
 SG_ RFC_Obj24_VyAyCoVnce : 428|12@1+ (0.01,0) [0|30] "m^2/s^3"  VideoFrontCenter
 SG_ RFC_Obj24_AxAyCoVnce : 440|12@1+ (0.01,0) [0|30] "m^2/s^4"  VideoFrontCenter
 SG_ RFC_Obj24_MobileObstConf : 452|6@1+ (2,0) [0|100] "%"  VideoFrontCenter
 SG_ RFC_Obj24_Mob4PlusWhlConf : 458|6@1+ (2,0) [0|100] "%"  VideoFrontCenter
 SG_ RFC_Obj24_Mob2WhlConf : 464|6@1+ (2,0) [0|100] "%"  VideoFrontCenter
 SG_ RFC_Obj24_MobPedConf : 470|6@1+ (2,0) [0|100] "%"  VideoFrontCenter
 SG_ RFC_Obj24_FourPlusWhlCarConf : 476|6@1+ (2,0) [0|100] "%"  VideoFrontCenter
 SG_ RFC_Obj24_FourPlusWhlHGVConf : 482|6@1+ (2,0) [0|100] "%"  VideoFrontCenter
 SG_ RFC_Obj24_GroundReflexConf : 488|6@1+ (2,0) [0|100] "%"  VideoFrontCenter
 SG_ RFC_Obj24_StatObstConf : 494|6@1+ (2,0) [0|100] "%"  VideoFrontCenter
 SG_ RFC_Obj24_StatBarrierConf : 500|6@1+ (2,0) [0|100] "%"  VideoFrontCenter

BO_ 431 RFC_Obj25: 64 RadarFrontCenter
 SG_ RFC_Obj25_CRC : 0|16@1+ (1,0) [0|65535] ""  VideoFrontCenter
 SG_ RFC_Obj25_AliveCtr : 16|8@1+ (1,0) [0|255] ""  VideoFrontCenter
 SG_ RFC_Obj25_ProtBlockCtr : 24|4@1+ (1,0) [0|15] ""  VideoFrontCenter
 SG_ RFC_Obj25_ReferencePoint : 28|4@1+ (1,0) [0|15] ""  VideoFrontCenter
 SG_ RFC_Obj25_ObjId : 32|7@1+ (1,0) [0|127] ""  VideoFrontCenter
 SG_ RFC_Obj25_MeasurementStatus : 39|1@1+ (1,0) [0|1] ""  VideoFrontCenter
 SG_ RFC_Obj25_Px : 40|13@1+ (0.0625,-256) [-256|255.9375] "m"  VideoFrontCenter
 SG_ RFC_Obj25_Py : 53|11@1+ (0.125,-128) [-128|127.875] "m"  VideoFrontCenter
 SG_ RFC_Obj25_PxVnce : 64|12@1+ (0.01,0) [0|30] "m^2"  VideoFrontCenter
 SG_ RFC_Obj25_PyVnce : 76|12@1+ (0.01,0) [0|30] "m^2"  VideoFrontCenter
 SG_ RFC_Obj25_Vx : 88|12@1+ (0.0625,-128) [-128|127.9375] "m/s"  VideoFrontCenter
 SG_ RFC_Obj25_Vy : 100|10@1+ (0.125,-64) [-64|63.875] "m/s"  VideoFrontCenter
 SG_ RFC_Obj25_Ax : 110|10@1+ (0.03125,-16) [-16|15.96875] "m/s^2"  VideoFrontCenter
 SG_ RFC_Obj25_Ay : 120|9@1+ (0.0625,-16) [-16|15.9375] "m/s^2"  VideoFrontCenter
 SG_ RFC_Obj25_OrientationYaw : 129|9@1+ (0.0175,-4.48) [-3.15|3.15] "rad"  VideoFrontCenter
 SG_ RFC_Obj25_ExistProb : 138|6@1+ (2,0) [0|100] "%"  VideoFrontCenter
 SG_ RFC_Obj25_VxVnce : 144|12@1+ (0.01,0) [0|30] "m^2/s^2"  VideoFrontCenter
 SG_ RFC_Obj25_VyVnce : 156|12@1+ (0.01,0) [0|30] "m^2/s^2"  VideoFrontCenter
 SG_ RFC_Obj25_AxVnce : 168|12@1+ (0.01,0) [0|30] "m^2/s^4"  VideoFrontCenter
 SG_ RFC_Obj25_AyVnce : 180|12@1+ (0.01,0) [0|30] "m^2/s^4"  VideoFrontCenter
 SG_ RFC_Obj25_OrientationYawVnce : 192|12@1+ (0.0003,0) [0|1] "rad^2"  VideoFrontCenter
 SG_ RFC_Obj25_MovingObserved : 204|6@1+ (2,0) [0|100] "%"  VideoFrontCenter
 SG_ RFC_Obj25_MovingProbability : 210|6@1+ (2,0) [0|100] "%"  VideoFrontCenter
 SG_ RFC_Obj25_Length : 216|7@1+ (0.125,0) [0|15.875] "m"  VideoFrontCenter
 SG_ RFC_Obj25_Valid : 223|1@1+ (1,0) [0|1] ""  VideoFrontCenter
 SG_ RFC_Obj25_LengthVnce : 224|12@1+ (0.01,0) [0|30] "m^2"  VideoFrontCenter
 SG_ RFC_Obj25_WidthVnce : 236|12@1+ (0.01,0) [0|30] "m^2"  VideoFrontCenter
 SG_ RFC_Obj25_Width : 248|7@1+ (0.125,0) [0|15.875] "m"  VideoFrontCenter
 SG_ RFC_Obj25_BehaviorType : 255|3@1+ (1,0) [0|7] ""  VideoFrontCenter
 SG_ RFC_Obj25_ObstacleConf : 258|6@1+ (2,0) [0|100] "%"  VideoFrontCenter
 SG_ RFC_Obj25_NonObstacleConf : 264|6@1+ (2,0) [0|100] "%"  VideoFrontCenter
 SG_ RFC_Obj25_PxPyCoVnce : 272|12@1+ (0.01,0) [0|30] "m^2"  VideoFrontCenter
 SG_ RFC_Obj25_PxVxCoVnce : 284|12@1+ (0.01,0) [0|30] "m^2/s"  VideoFrontCenter
 SG_ RFC_Obj25_PxVyCoVnce : 296|12@1+ (0.01,0) [0|30] "m^2/s"  VideoFrontCenter
 SG_ RFC_Obj25_PyVxCoVnce : 308|12@1+ (0.01,0) [0|30] "m^2/s"  VideoFrontCenter
 SG_ RFC_Obj25_PyVyCoVnce : 320|12@1+ (0.01,0) [0|30] "m^2/s"  VideoFrontCenter
 SG_ RFC_Obj25_VxVyCoVnce : 332|12@1+ (0.01,0) [0|30] "m^2/s^2"  VideoFrontCenter
 SG_ RFC_Obj25_PxAxCoVnce : 344|12@1+ (0.01,0) [0|30] "m^2/s^2"  VideoFrontCenter
 SG_ RFC_Obj25_PxAyCoVnce : 356|12@1+ (0.01,0) [0|30] "m^2/s^2"  VideoFrontCenter
 SG_ RFC_Obj25_PyAxCoVnce : 368|12@1+ (0.01,0) [0|30] "m^2/s^2"  VideoFrontCenter
 SG_ RFC_Obj25_PyAyCoVnce : 380|12@1+ (0.01,0) [0|30] "m^2/s^2"  VideoFrontCenter
 SG_ RFC_Obj25_VxAxCoVnce : 392|12@1+ (0.01,0) [0|30] "m^2/s^3"  VideoFrontCenter
 SG_ RFC_Obj25_VxAyCoVnce : 404|12@1+ (0.01,0) [0|30] "m^2/s^3"  VideoFrontCenter
 SG_ RFC_Obj25_VyAxCoVnce : 416|12@1+ (0.01,0) [0|30] "m^2/s^3"  VideoFrontCenter
 SG_ RFC_Obj25_VyAyCoVnce : 428|12@1+ (0.01,0) [0|30] "m^2/s^3"  VideoFrontCenter
 SG_ RFC_Obj25_AxAyCoVnce : 440|12@1+ (0.01,0) [0|30] "m^2/s^4"  VideoFrontCenter
 SG_ RFC_Obj25_MobileObstConf : 452|6@1+ (2,0) [0|100] "%"  VideoFrontCenter
 SG_ RFC_Obj25_Mob4PlusWhlConf : 458|6@1+ (2,0) [0|100] "%"  VideoFrontCenter
 SG_ RFC_Obj25_Mob2WhlConf : 464|6@1+ (2,0) [0|100] "%"  VideoFrontCenter
 SG_ RFC_Obj25_MobPedConf : 470|6@1+ (2,0) [0|100] "%"  VideoFrontCenter
 SG_ RFC_Obj25_FourPlusWhlCarConf : 476|6@1+ (2,0) [0|100] "%"  VideoFrontCenter
 SG_ RFC_Obj25_FourPlusWhlHGVConf : 482|6@1+ (2,0) [0|100] "%"  VideoFrontCenter
 SG_ RFC_Obj25_GroundReflexConf : 488|6@1+ (2,0) [0|100] "%"  VideoFrontCenter
 SG_ RFC_Obj25_StatObstConf : 494|6@1+ (2,0) [0|100] "%"  VideoFrontCenter
 SG_ RFC_Obj25_StatBarrierConf : 500|6@1+ (2,0) [0|100] "%"  VideoFrontCenter

CM_ SG_ 418 RFC_Obj12_CRC "CRC - Autosar E2E Profile 5";
CM_ SG_ 418 RFC_Obj12_AliveCtr "Alive counter - Autosar E2E Profile 5";
CM_ SG_ 418 RFC_Obj12_ProtBlockCtr "Protocol-Signal: Block-Counter";
CM_ SG_ 418 RFC_Obj12_ReferencePoint "Reference Point of the detected object. ISO 23150: Reference point (A.2.17)";
CM_ SG_ 418 RFC_Obj12_ObjId "Unique Object ID. ISO 23150: Object ID (A.2.2)";
CM_ SG_ 418 RFC_Obj12_MeasurementStatus "Object is measured or not. ISO 23150: Measurement status  object level (A.2.9)";
CM_ SG_ 418 RFC_Obj12_Px "Object position in X direction. ISO 23150: Position  object level {x, y, z} (A.2.13)";
CM_ SG_ 418 RFC_Obj12_Py "Object position in Y direction. ISO 23150: Position  object level {x, y, z} (A.2.13)";
CM_ SG_ 418 RFC_Obj12_PxVnce "Variance of object position in X direction. ISO 23150: Position  object level {x, y, z}  error (A.2.14)";
CM_ SG_ 418 RFC_Obj12_PyVnce "Variance of object position in Y direction. ISO 23150: Position  object level {x, y, z}  error (A.2.14)";
CM_ SG_ 418 RFC_Obj12_Vx "Object relative velocity in X direction. ISO 23150: Velocity {x, y, z}  object level (A.2.23)";
CM_ SG_ 418 RFC_Obj12_Vy "Object relative velocity in Y direction. ISO 23150: Velocity {x, y, z}  object level (A.2.23)";
CM_ SG_ 418 RFC_Obj12_Ax "Object relative acceleration in X direction. ISO 23150: Acceleration {x, y, z} (A.2.25)";
CM_ SG_ 418 RFC_Obj12_Ay "Object relative acceleration in Y direction. ISO 23150: Acceleration {x, y, z} (A.2.25)";
CM_ SG_ 418 RFC_Obj12_OrientationYaw "Object orientation yaw angle. ISO 23150: Orientation {yaw, pitch, roll} (A.2.15)";
CM_ SG_ 418 RFC_Obj12_ExistProb "Existence probability of object. ISO 23150: Existence probability  object level (A.2.1)";
CM_ SG_ 418 RFC_Obj12_VxVnce "Variance of object relative velocity in X direction. ISO 23150: Velocity {x, y, z}  object level  error (A.2.24)";
CM_ SG_ 418 RFC_Obj12_VyVnce "Variance of object relative velocity in Y direction. ISO 23150: Velocity {x, y, z}  object level  error (A.2.24)";
CM_ SG_ 418 RFC_Obj12_AxVnce "Variance of object relative acceleration in X direction. ISO 23150: Acceleration {x, y, z}  error (A.2.26)";
CM_ SG_ 418 RFC_Obj12_AyVnce "Variance of object relative acceleration in Y direction. ISO 23150: Acceleration {x, y, z}  error (A.2.26)";
CM_ SG_ 418 RFC_Obj12_OrientationYawVnce "Variance of object orientation yaw angle. ISO 23150: Orientation {yaw, pitch, roll}  error (A.2.16)";
CM_ SG_ 418 RFC_Obj12_MovingObserved "Object has been observed moving over the ground since it was first detected";
CM_ SG_ 418 RFC_Obj12_MovingProbability "Object has been observed moving over the ground";
CM_ SG_ 418 RFC_Obj12_Length "Object Length. ISO 23150: Bounding box extent {length, width, height} (A.2.19)";
CM_ SG_ 418 RFC_Obj12_Valid "Object is valid or not";
CM_ SG_ 418 RFC_Obj12_LengthVnce "Variance of object Length. ISO 23150: Bounding box extent {length, width, height}  error (A.2.20)";
CM_ SG_ 418 RFC_Obj12_WidthVnce "Variance of object Width. ISO 23150: Bounding box extent {length, width, height}  error (A.2.20)";
CM_ SG_ 418 RFC_Obj12_Width "Object Width. ISO 23150: Bounding box extent {length, width, height} (A.2.19)";
CM_ SG_ 418 RFC_Obj12_BehaviorType "Indicates that which behavior the object associated for";
CM_ SG_ 418 RFC_Obj12_ObstacleConf "Confidence of the object being an Obstacle. ISO 23150: Potentially moving object classification type  confidence (A.2.12)";
CM_ SG_ 418 RFC_Obj12_NonObstacleConf "Confidence of the object being a Non-Obstacle. ISO 23150: Potentially moving object classification type  confidence (A.2.12)";
CM_ SG_ 418 RFC_Obj12_PxPyCoVnce "Covariance of Px and Py";
CM_ SG_ 418 RFC_Obj12_PxVxCoVnce "Covariance of Px and Vx";
CM_ SG_ 418 RFC_Obj12_PxVyCoVnce "Covariance of Px and Vy";
CM_ SG_ 418 RFC_Obj12_PyVxCoVnce "Covariance of Py and Vx";
CM_ SG_ 418 RFC_Obj12_PyVyCoVnce "Covariance of Py and Vy";
CM_ SG_ 418 RFC_Obj12_VxVyCoVnce "Covariance of Vx and Vy";
CM_ SG_ 418 RFC_Obj12_PxAxCoVnce "Covariance of Px and Ax";
CM_ SG_ 418 RFC_Obj12_PxAyCoVnce "Covariance of Px and Ay";
CM_ SG_ 418 RFC_Obj12_PyAxCoVnce "Covariance of Py and Ax";
CM_ SG_ 418 RFC_Obj12_PyAyCoVnce "Covariance of Py and Ay";
CM_ SG_ 418 RFC_Obj12_VxAxCoVnce "Covariance of Vx and Ax";
CM_ SG_ 418 RFC_Obj12_VxAyCoVnce "Covariance of Vx and Ay";
CM_ SG_ 418 RFC_Obj12_VyAxCoVnce "Covariance of Vy and Ax";
CM_ SG_ 418 RFC_Obj12_VyAyCoVnce "Covariance of Vy and Ay";
CM_ SG_ 418 RFC_Obj12_AxAyCoVnce "Covariance of Ax and Ay";
CM_ SG_ 418 RFC_Obj12_MobileObstConf "Confidence of the object being a mobile obstacle. ISO 23150: Potentially moving object classification type  confidence (A.2.12)";
CM_ SG_ 418 RFC_Obj12_Mob4PlusWhlConf "Confidence of a mobile object which has 4 or more wheels. ISO 23150: Potentially moving object classification type  confidence (A.2.12)";
CM_ SG_ 418 RFC_Obj12_Mob2WhlConf "Confidence of a mobile object being 2-wheels vehicle. ISO 23150: Potentially moving object classification type  confidence (A.2.12)";
CM_ SG_ 418 RFC_Obj12_MobPedConf "Confidence of a mobile object being a pedestrian. ISO 23150: Potentially moving object classification type  confidence (A.2.12)";
CM_ SG_ 418 RFC_Obj12_FourPlusWhlCarConf "Confidence of a mobile object which has 4 or more wheels--passenger car. ISO 23150: Potentially moving object classification type  confidence (A.2.12)";
CM_ SG_ 418 RFC_Obj12_FourPlusWhlHGVConf "Confidence of a mobile object which has 4 or more wheels--commercial vehicle (Truck). ISO 23150: Potentially moving object classification type  confidence (A.2.12)";
CM_ SG_ 418 RFC_Obj12_GroundReflexConf "Confidence of the object being a ground reflex. ISO 23150: Potentially moving object classification type  confidence (A.2.12)";
CM_ SG_ 418 RFC_Obj12_StatObstConf "Confidence of the object being a stationary obstacle. ISO 23150: Potentially moving object classification type  confidence (A.2.12)";
CM_ SG_ 418 RFC_Obj12_StatBarrierConf "Confidence of the object being a stationary road barrier. ISO 23150: Potentially moving object classification type  confidence (A.2.12)";
CM_ SG_ 419 RFC_Obj13_CRC "CRC - Autosar E2E Profile 5";
CM_ SG_ 419 RFC_Obj13_AliveCtr "Alive counter - Autosar E2E Profile 5";
CM_ SG_ 419 RFC_Obj13_ProtBlockCtr "Protocol-Signal: Block-Counter";
CM_ SG_ 419 RFC_Obj13_ReferencePoint "Reference Point of the detected object. ISO 23150: Reference point (A.2.17)";
CM_ SG_ 419 RFC_Obj13_ObjId "Unique Object ID. ISO 23150: Object ID (A.2.2)";
CM_ SG_ 419 RFC_Obj13_MeasurementStatus "Object is measured or not. ISO 23150: Measurement status  object level (A.2.9)";
CM_ SG_ 419 RFC_Obj13_Px "Object position in X direction. ISO 23150: Position  object level {x, y, z} (A.2.13)";
CM_ SG_ 419 RFC_Obj13_Py "Object position in Y direction. ISO 23150: Position  object level {x, y, z} (A.2.13)";
CM_ SG_ 419 RFC_Obj13_PxVnce "Variance of object position in X direction. ISO 23150: Position  object level {x, y, z}  error (A.2.14)";
CM_ SG_ 419 RFC_Obj13_PyVnce "Variance of object position in Y direction. ISO 23150: Position  object level {x, y, z}  error (A.2.14)";
CM_ SG_ 419 RFC_Obj13_Vx "Object relative velocity in X direction. ISO 23150: Velocity {x, y, z}  object level (A.2.23)";
CM_ SG_ 419 RFC_Obj13_Vy "Object relative velocity in Y direction. ISO 23150: Velocity {x, y, z}  object level (A.2.23)";
CM_ SG_ 419 RFC_Obj13_Ax "Object relative acceleration in X direction. ISO 23150: Acceleration {x, y, z} (A.2.25)";
CM_ SG_ 419 RFC_Obj13_Ay "Object relative acceleration in Y direction. ISO 23150: Acceleration {x, y, z} (A.2.25)";
CM_ SG_ 419 RFC_Obj13_OrientationYaw "Object orientation yaw angle. ISO 23150: Orientation {yaw, pitch, roll} (A.2.15)";
CM_ SG_ 419 RFC_Obj13_ExistProb "Existence probability of object. ISO 23150: Existence probability  object level (A.2.1)";
CM_ SG_ 419 RFC_Obj13_VxVnce "Variance of object relative velocity in X direction. ISO 23150: Velocity {x, y, z}  object level  error (A.2.24)";
CM_ SG_ 419 RFC_Obj13_VyVnce "Variance of object relative velocity in Y direction. ISO 23150: Velocity {x, y, z}  object level  error (A.2.24)";
CM_ SG_ 419 RFC_Obj13_AxVnce "Variance of object relative acceleration in X direction. ISO 23150: Acceleration {x, y, z}  error (A.2.26)";
CM_ SG_ 419 RFC_Obj13_AyVnce "Variance of object relative acceleration in Y direction. ISO 23150: Acceleration {x, y, z}  error (A.2.26)";
CM_ SG_ 419 RFC_Obj13_OrientationYawVnce "Variance of object orientation yaw angle. ISO 23150: Orientation {yaw, pitch, roll}  error (A.2.16)";
CM_ SG_ 419 RFC_Obj13_MovingObserved "Object has been observed moving over the ground since it was first detected";
CM_ SG_ 419 RFC_Obj13_MovingProbability "Object has been observed moving over the ground";
CM_ SG_ 419 RFC_Obj13_Length "Object Length. ISO 23150: Bounding box extent {length, width, height} (A.2.19)";
CM_ SG_ 419 RFC_Obj13_Valid "Object is valid or not";
CM_ SG_ 419 RFC_Obj13_LengthVnce "Variance of object Length. ISO 23150: Bounding box extent {length, width, height}  error (A.2.20)";
CM_ SG_ 419 RFC_Obj13_WidthVnce "Variance of object Width. ISO 23150: Bounding box extent {length, width, height}  error (A.2.20)";
CM_ SG_ 419 RFC_Obj13_Width "Object Width. ISO 23150: Bounding box extent {length, width, height} (A.2.19)";
CM_ SG_ 419 RFC_Obj13_BehaviorType "Indicates that which behavior the object associated for";
CM_ SG_ 419 RFC_Obj13_ObstacleConf "Confidence of the object being an Obstacle. ISO 23150: Potentially moving object classification type  confidence (A.2.12)";
CM_ SG_ 419 RFC_Obj13_NonObstacleConf "Confidence of the object being a Non-Obstacle. ISO 23150: Potentially moving object classification type  confidence (A.2.12)";
CM_ SG_ 419 RFC_Obj13_PxPyCoVnce "Covariance of Px and Py";
CM_ SG_ 419 RFC_Obj13_PxVxCoVnce "Covariance of Px and Vx";
CM_ SG_ 419 RFC_Obj13_PxVyCoVnce "Covariance of Px and Vy";
CM_ SG_ 419 RFC_Obj13_PyVxCoVnce "Covariance of Py and Vx";
CM_ SG_ 419 RFC_Obj13_PyVyCoVnce "Covariance of Py and Vy";
CM_ SG_ 419 RFC_Obj13_VxVyCoVnce "Covariance of Vx and Vy";
CM_ SG_ 419 RFC_Obj13_PxAxCoVnce "Covariance of Px and Ax";
CM_ SG_ 419 RFC_Obj13_PxAyCoVnce "Covariance of Px and Ay";
CM_ SG_ 419 RFC_Obj13_PyAxCoVnce "Covariance of Py and Ax";
CM_ SG_ 419 RFC_Obj13_PyAyCoVnce "Covariance of Py and Ay";
CM_ SG_ 419 RFC_Obj13_VxAxCoVnce "Covariance of Vx and Ax";
CM_ SG_ 419 RFC_Obj13_VxAyCoVnce "Covariance of Vx and Ay";
CM_ SG_ 419 RFC_Obj13_VyAxCoVnce "Covariance of Vy and Ax";
CM_ SG_ 419 RFC_Obj13_VyAyCoVnce "Covariance of Vy and Ay";
CM_ SG_ 419 RFC_Obj13_AxAyCoVnce "Covariance of Ax and Ay";
CM_ SG_ 419 RFC_Obj13_MobileObstConf "Confidence of the object being a mobile obstacle. ISO 23150: Potentially moving object classification type  confidence (A.2.12)";
CM_ SG_ 419 RFC_Obj13_Mob4PlusWhlConf "Confidence of a mobile object which has 4 or more wheels. ISO 23150: Potentially moving object classification type  confidence (A.2.12)";
CM_ SG_ 419 RFC_Obj13_Mob2WhlConf "Confidence of a mobile object being 2-wheels vehicle. ISO 23150: Potentially moving object classification type  confidence (A.2.12)";
CM_ SG_ 419 RFC_Obj13_MobPedConf "Confidence of a mobile object being a pedestrian. ISO 23150: Potentially moving object classification type  confidence (A.2.12)";
CM_ SG_ 419 RFC_Obj13_FourPlusWhlCarConf "Confidence of a mobile object which has 4 or more wheels--passenger car. ISO 23150: Potentially moving object classification type  confidence (A.2.12)";
CM_ SG_ 419 RFC_Obj13_FourPlusWhlHGVConf "Confidence of a mobile object which has 4 or more wheels--commercial vehicle (Truck). ISO 23150: Potentially moving object classification type  confidence (A.2.12)";
CM_ SG_ 419 RFC_Obj13_GroundReflexConf "Confidence of the object being a ground reflex. ISO 23150: Potentially moving object classification type  confidence (A.2.12)";
CM_ SG_ 419 RFC_Obj13_StatObstConf "Confidence of the object being a stationary obstacle. ISO 23150: Potentially moving object classification type  confidence (A.2.12)";
CM_ SG_ 419 RFC_Obj13_StatBarrierConf "Confidence of the object being a stationary road barrier. ISO 23150: Potentially moving object classification type  confidence (A.2.12)";
CM_ SG_ 420 RFC_Obj14_CRC "CRC - Autosar E2E Profile 5";
CM_ SG_ 420 RFC_Obj14_AliveCtr "Alive counter - Autosar E2E Profile 5";
CM_ SG_ 420 RFC_Obj14_ProtBlockCtr "Protocol-Signal: Block-Counter";
CM_ SG_ 420 RFC_Obj14_ReferencePoint "Reference Point of the detected object. ISO 23150: Reference point (A.2.17)";
CM_ SG_ 420 RFC_Obj14_ObjId "Unique Object ID. ISO 23150: Object ID (A.2.2)";
CM_ SG_ 420 RFC_Obj14_MeasurementStatus "Object is measured or not. ISO 23150: Measurement status  object level (A.2.9)";
CM_ SG_ 420 RFC_Obj14_Px "Object position in X direction. ISO 23150: Position  object level {x, y, z} (A.2.13)";
CM_ SG_ 420 RFC_Obj14_Py "Object position in Y direction. ISO 23150: Position  object level {x, y, z} (A.2.13)";
CM_ SG_ 420 RFC_Obj14_PxVnce "Variance of object position in X direction. ISO 23150: Position  object level {x, y, z}  error (A.2.14)";
CM_ SG_ 420 RFC_Obj14_PyVnce "Variance of object position in Y direction. ISO 23150: Position  object level {x, y, z}  error (A.2.14)";
CM_ SG_ 420 RFC_Obj14_Vx "Object relative velocity in X direction. ISO 23150: Velocity {x, y, z}  object level (A.2.23)";
CM_ SG_ 420 RFC_Obj14_Vy "Object relative velocity in Y direction. ISO 23150: Velocity {x, y, z}  object level (A.2.23)";
CM_ SG_ 420 RFC_Obj14_Ax "Object relative acceleration in X direction. ISO 23150: Acceleration {x, y, z} (A.2.25)";
CM_ SG_ 420 RFC_Obj14_Ay "Object relative acceleration in Y direction. ISO 23150: Acceleration {x, y, z} (A.2.25)";
CM_ SG_ 420 RFC_Obj14_OrientationYaw "Object orientation yaw angle. ISO 23150: Orientation {yaw, pitch, roll} (A.2.15)";
CM_ SG_ 420 RFC_Obj14_ExistProb "Existence probability of object. ISO 23150: Existence probability  object level (A.2.1)";
CM_ SG_ 420 RFC_Obj14_VxVnce "Variance of object relative velocity in X direction. ISO 23150: Velocity {x, y, z}  object level  error (A.2.24)";
CM_ SG_ 420 RFC_Obj14_VyVnce "Variance of object relative velocity in Y direction. ISO 23150: Velocity {x, y, z}  object level  error (A.2.24)";
CM_ SG_ 420 RFC_Obj14_AxVnce "Variance of object relative acceleration in X direction. ISO 23150: Acceleration {x, y, z}  error (A.2.26)";
CM_ SG_ 420 RFC_Obj14_AyVnce "Variance of object relative acceleration in Y direction. ISO 23150: Acceleration {x, y, z}  error (A.2.26)";
CM_ SG_ 420 RFC_Obj14_OrientationYawVnce "Variance of object orientation yaw angle. ISO 23150: Orientation {yaw, pitch, roll}  error (A.2.16)";
CM_ SG_ 420 RFC_Obj14_MovingObserved "Object has been observed moving over the ground since it was first detected";
CM_ SG_ 420 RFC_Obj14_MovingProbability "Object has been observed moving over the ground";
CM_ SG_ 420 RFC_Obj14_Length "Object Length. ISO 23150: Bounding box extent {length, width, height} (A.2.19)";
CM_ SG_ 420 RFC_Obj14_Valid "Object is valid or not";
CM_ SG_ 420 RFC_Obj14_LengthVnce "Variance of object Length. ISO 23150: Bounding box extent {length, width, height}  error (A.2.20)";
CM_ SG_ 420 RFC_Obj14_WidthVnce "Variance of object Width. ISO 23150: Bounding box extent {length, width, height}  error (A.2.20)";
CM_ SG_ 420 RFC_Obj14_Width "Object Width. ISO 23150: Bounding box extent {length, width, height} (A.2.19)";
CM_ SG_ 420 RFC_Obj14_BehaviorType "Indicates that which behavior the object associated for";
CM_ SG_ 420 RFC_Obj14_ObstacleConf "Confidence of the object being an Obstacle. ISO 23150: Potentially moving object classification type  confidence (A.2.12)";
CM_ SG_ 420 RFC_Obj14_NonObstacleConf "Confidence of the object being a Non-Obstacle. ISO 23150: Potentially moving object classification type  confidence (A.2.12)";
CM_ SG_ 420 RFC_Obj14_PxPyCoVnce "Covariance of Px and Py";
CM_ SG_ 420 RFC_Obj14_PxVxCoVnce "Covariance of Px and Vx";
CM_ SG_ 420 RFC_Obj14_PxVyCoVnce "Covariance of Px and Vy";
CM_ SG_ 420 RFC_Obj14_PyVxCoVnce "Covariance of Py and Vx";
CM_ SG_ 420 RFC_Obj14_PyVyCoVnce "Covariance of Py and Vy";
CM_ SG_ 420 RFC_Obj14_VxVyCoVnce "Covariance of Vx and Vy";
CM_ SG_ 420 RFC_Obj14_PxAxCoVnce "Covariance of Px and Ax";
CM_ SG_ 420 RFC_Obj14_PxAyCoVnce "Covariance of Px and Ay";
CM_ SG_ 420 RFC_Obj14_PyAxCoVnce "Covariance of Py and Ax";
CM_ SG_ 420 RFC_Obj14_PyAyCoVnce "Covariance of Py and Ay";
CM_ SG_ 420 RFC_Obj14_VxAxCoVnce "Covariance of Vx and Ax";
CM_ SG_ 420 RFC_Obj14_VxAyCoVnce "Covariance of Vx and Ay";
CM_ SG_ 420 RFC_Obj14_VyAxCoVnce "Covariance of Vy and Ax";
CM_ SG_ 420 RFC_Obj14_VyAyCoVnce "Covariance of Vy and Ay";
CM_ SG_ 420 RFC_Obj14_AxAyCoVnce "Covariance of Ax and Ay";
CM_ SG_ 420 RFC_Obj14_MobileObstConf "Confidence of the object being a mobile obstacle. ISO 23150: Potentially moving object classification type  confidence (A.2.12)";
CM_ SG_ 420 RFC_Obj14_Mob4PlusWhlConf "Confidence of a mobile object which has 4 or more wheels. ISO 23150: Potentially moving object classification type  confidence (A.2.12)";
CM_ SG_ 420 RFC_Obj14_Mob2WhlConf "Confidence of a mobile object being 2-wheels vehicle. ISO 23150: Potentially moving object classification type  confidence (A.2.12)";
CM_ SG_ 420 RFC_Obj14_MobPedConf "Confidence of a mobile object being a pedestrian. ISO 23150: Potentially moving object classification type  confidence (A.2.12)";
CM_ SG_ 420 RFC_Obj14_FourPlusWhlCarConf "Confidence of a mobile object which has 4 or more wheels--passenger car. ISO 23150: Potentially moving object classification type  confidence (A.2.12)";
CM_ SG_ 420 RFC_Obj14_FourPlusWhlHGVConf "Confidence of a mobile object which has 4 or more wheels--commercial vehicle (Truck). ISO 23150: Potentially moving object classification type  confidence (A.2.12)";
CM_ SG_ 420 RFC_Obj14_GroundReflexConf "Confidence of the object being a ground reflex. ISO 23150: Potentially moving object classification type  confidence (A.2.12)";
CM_ SG_ 420 RFC_Obj14_StatObstConf "Confidence of the object being a stationary obstacle. ISO 23150: Potentially moving object classification type  confidence (A.2.12)";
CM_ SG_ 420 RFC_Obj14_StatBarrierConf "Confidence of the object being a stationary road barrier. ISO 23150: Potentially moving object classification type  confidence (A.2.12)";
CM_ SG_ 421 RFC_Obj15_CRC "CRC - Autosar E2E Profile 5";
CM_ SG_ 421 RFC_Obj15_AliveCtr "Alive counter - Autosar E2E Profile 5";
CM_ SG_ 421 RFC_Obj15_ProtBlockCtr "Protocol-Signal: Block-Counter";
CM_ SG_ 421 RFC_Obj15_ReferencePoint "Reference Point of the detected object. ISO 23150: Reference point (A.2.17)";
CM_ SG_ 421 RFC_Obj15_ObjId "Unique Object ID. ISO 23150: Object ID (A.2.2)";
CM_ SG_ 421 RFC_Obj15_MeasurementStatus "Object is measured or not. ISO 23150: Measurement status  object level (A.2.9)";
CM_ SG_ 421 RFC_Obj15_Px "Object position in X direction. ISO 23150: Position  object level {x, y, z} (A.2.13)";
CM_ SG_ 421 RFC_Obj15_Py "Object position in Y direction. ISO 23150: Position  object level {x, y, z} (A.2.13)";
CM_ SG_ 421 RFC_Obj15_PxVnce "Variance of object position in X direction. ISO 23150: Position  object level {x, y, z}  error (A.2.14)";
CM_ SG_ 421 RFC_Obj15_PyVnce "Variance of object position in Y direction. ISO 23150: Position  object level {x, y, z}  error (A.2.14)";
CM_ SG_ 421 RFC_Obj15_Vx "Object relative velocity in X direction. ISO 23150: Velocity {x, y, z}  object level (A.2.23)";
CM_ SG_ 421 RFC_Obj15_Vy "Object relative velocity in Y direction. ISO 23150: Velocity {x, y, z}  object level (A.2.23)";
CM_ SG_ 421 RFC_Obj15_Ax "Object relative acceleration in X direction. ISO 23150: Acceleration {x, y, z} (A.2.25)";
CM_ SG_ 421 RFC_Obj15_Ay "Object relative acceleration in Y direction. ISO 23150: Acceleration {x, y, z} (A.2.25)";
CM_ SG_ 421 RFC_Obj15_OrientationYaw "Object orientation yaw angle. ISO 23150: Orientation {yaw, pitch, roll} (A.2.15)";
CM_ SG_ 421 RFC_Obj15_ExistProb "Existence probability of object. ISO 23150: Existence probability  object level (A.2.1)";
CM_ SG_ 421 RFC_Obj15_VxVnce "Variance of object relative velocity in X direction. ISO 23150: Velocity {x, y, z}  object level  error (A.2.24)";
CM_ SG_ 421 RFC_Obj15_VyVnce "Variance of object relative velocity in Y direction. ISO 23150: Velocity {x, y, z}  object level  error (A.2.24)";
CM_ SG_ 421 RFC_Obj15_AxVnce "Variance of object relative acceleration in X direction. ISO 23150: Acceleration {x, y, z}  error (A.2.26)";
CM_ SG_ 421 RFC_Obj15_AyVnce "Variance of object relative acceleration in Y direction. ISO 23150: Acceleration {x, y, z}  error (A.2.26)";
CM_ SG_ 421 RFC_Obj15_OrientationYawVnce "Variance of object orientation yaw angle. ISO 23150: Orientation {yaw, pitch, roll}  error (A.2.16)";
CM_ SG_ 421 RFC_Obj15_MovingObserved "Object has been observed moving over the ground since it was first detected";
CM_ SG_ 421 RFC_Obj15_MovingProbability "Object has been observed moving over the ground";
CM_ SG_ 421 RFC_Obj15_Length "Object Length. ISO 23150: Bounding box extent {length, width, height} (A.2.19)";
CM_ SG_ 421 RFC_Obj15_Valid "Object is valid or not";
CM_ SG_ 421 RFC_Obj15_LengthVnce "Variance of object Length. ISO 23150: Bounding box extent {length, width, height}  error (A.2.20)";
CM_ SG_ 421 RFC_Obj15_WidthVnce "Variance of object Width. ISO 23150: Bounding box extent {length, width, height}  error (A.2.20)";
CM_ SG_ 421 RFC_Obj15_Width "Object Width. ISO 23150: Bounding box extent {length, width, height} (A.2.19)";
CM_ SG_ 421 RFC_Obj15_BehaviorType "Indicates that which behavior the object associated for";
CM_ SG_ 421 RFC_Obj15_ObstacleConf "Confidence of the object being an Obstacle. ISO 23150: Potentially moving object classification type  confidence (A.2.12)";
CM_ SG_ 421 RFC_Obj15_NonObstacleConf "Confidence of the object being a Non-Obstacle. ISO 23150: Potentially moving object classification type  confidence (A.2.12)";
CM_ SG_ 421 RFC_Obj15_PxPyCoVnce "Covariance of Px and Py";
CM_ SG_ 421 RFC_Obj15_PxVxCoVnce "Covariance of Px and Vx";
CM_ SG_ 421 RFC_Obj15_PxVyCoVnce "Covariance of Px and Vy";
CM_ SG_ 421 RFC_Obj15_PyVxCoVnce "Covariance of Py and Vx";
CM_ SG_ 421 RFC_Obj15_PyVyCoVnce "Covariance of Py and Vy";
CM_ SG_ 421 RFC_Obj15_VxVyCoVnce "Covariance of Vx and Vy";
CM_ SG_ 421 RFC_Obj15_PxAxCoVnce "Covariance of Px and Ax";
CM_ SG_ 421 RFC_Obj15_PxAyCoVnce "Covariance of Px and Ay";
CM_ SG_ 421 RFC_Obj15_PyAxCoVnce "Covariance of Py and Ax";
CM_ SG_ 421 RFC_Obj15_PyAyCoVnce "Covariance of Py and Ay";
CM_ SG_ 421 RFC_Obj15_VxAxCoVnce "Covariance of Vx and Ax";
CM_ SG_ 421 RFC_Obj15_VxAyCoVnce "Covariance of Vx and Ay";
CM_ SG_ 421 RFC_Obj15_VyAxCoVnce "Covariance of Vy and Ax";
CM_ SG_ 421 RFC_Obj15_VyAyCoVnce "Covariance of Vy and Ay";
CM_ SG_ 421 RFC_Obj15_AxAyCoVnce "Covariance of Ax and Ay";
CM_ SG_ 421 RFC_Obj15_MobileObstConf "Confidence of the object being a mobile obstacle. ISO 23150: Potentially moving object classification type  confidence (A.2.12)";
CM_ SG_ 421 RFC_Obj15_Mob4PlusWhlConf "Confidence of a mobile object which has 4 or more wheels. ISO 23150: Potentially moving object classification type  confidence (A.2.12)";
CM_ SG_ 421 RFC_Obj15_Mob2WhlConf "Confidence of a mobile object being 2-wheels vehicle. ISO 23150: Potentially moving object classification type  confidence (A.2.12)";
CM_ SG_ 421 RFC_Obj15_MobPedConf "Confidence of a mobile object being a pedestrian. ISO 23150: Potentially moving object classification type  confidence (A.2.12)";
CM_ SG_ 421 RFC_Obj15_FourPlusWhlCarConf "Confidence of a mobile object which has 4 or more wheels--passenger car. ISO 23150: Potentially moving object classification type  confidence (A.2.12)";
CM_ SG_ 421 RFC_Obj15_FourPlusWhlHGVConf "Confidence of a mobile object which has 4 or more wheels--commercial vehicle (Truck). ISO 23150: Potentially moving object classification type  confidence (A.2.12)";
CM_ SG_ 421 RFC_Obj15_GroundReflexConf "Confidence of the object being a ground reflex. ISO 23150: Potentially moving object classification type  confidence (A.2.12)";
CM_ SG_ 421 RFC_Obj15_StatObstConf "Confidence of the object being a stationary obstacle. ISO 23150: Potentially moving object classification type  confidence (A.2.12)";
CM_ SG_ 421 RFC_Obj15_StatBarrierConf "Confidence of the object being a stationary road barrier. ISO 23150: Potentially moving object classification type  confidence (A.2.12)";
CM_ SG_ 422 RFC_Obj16_CRC "CRC - Autosar E2E Profile 5";
CM_ SG_ 422 RFC_Obj16_AliveCtr "Alive counter - Autosar E2E Profile 5";
CM_ SG_ 422 RFC_Obj16_ProtBlockCtr "Protocol-Signal: Block-Counter";
CM_ SG_ 422 RFC_Obj16_ReferencePoint "Reference Point of the detected object. ISO 23150: Reference point (A.2.17)";
CM_ SG_ 422 RFC_Obj16_ObjId "Unique Object ID. ISO 23150: Object ID (A.2.2)";
CM_ SG_ 422 RFC_Obj16_MeasurementStatus "Object is measured or not. ISO 23150: Measurement status  object level (A.2.9)";
CM_ SG_ 422 RFC_Obj16_Px "Object position in X direction. ISO 23150: Position  object level {x, y, z} (A.2.13)";
CM_ SG_ 422 RFC_Obj16_Py "Object position in Y direction. ISO 23150: Position  object level {x, y, z} (A.2.13)";
CM_ SG_ 422 RFC_Obj16_PxVnce "Variance of object position in X direction. ISO 23150: Position  object level {x, y, z}  error (A.2.14)";
CM_ SG_ 422 RFC_Obj16_PyVnce "Variance of object position in Y direction. ISO 23150: Position  object level {x, y, z}  error (A.2.14)";
CM_ SG_ 422 RFC_Obj16_Vx "Object relative velocity in X direction. ISO 23150: Velocity {x, y, z}  object level (A.2.23)";
CM_ SG_ 422 RFC_Obj16_Vy "Object relative velocity in Y direction. ISO 23150: Velocity {x, y, z}  object level (A.2.23)";
CM_ SG_ 422 RFC_Obj16_Ax "Object relative acceleration in X direction. ISO 23150: Acceleration {x, y, z} (A.2.25)";
CM_ SG_ 422 RFC_Obj16_Ay "Object relative acceleration in Y direction. ISO 23150: Acceleration {x, y, z} (A.2.25)";
CM_ SG_ 422 RFC_Obj16_OrientationYaw "Object orientation yaw angle. ISO 23150: Orientation {yaw, pitch, roll} (A.2.15)";
CM_ SG_ 422 RFC_Obj16_ExistProb "Existence probability of object. ISO 23150: Existence probability  object level (A.2.1)";
CM_ SG_ 422 RFC_Obj16_VxVnce "Variance of object relative velocity in X direction. ISO 23150: Velocity {x, y, z}  object level  error (A.2.24)";
CM_ SG_ 422 RFC_Obj16_VyVnce "Variance of object relative velocity in Y direction. ISO 23150: Velocity {x, y, z}  object level  error (A.2.24)";
CM_ SG_ 422 RFC_Obj16_AxVnce "Variance of object relative acceleration in X direction. ISO 23150: Acceleration {x, y, z}  error (A.2.26)";
CM_ SG_ 422 RFC_Obj16_AyVnce "Variance of object relative acceleration in Y direction. ISO 23150: Acceleration {x, y, z}  error (A.2.26)";
CM_ SG_ 422 RFC_Obj16_OrientationYawVnce "Variance of object orientation yaw angle. ISO 23150: Orientation {yaw, pitch, roll}  error (A.2.16)";
CM_ SG_ 422 RFC_Obj16_MovingObserved "Object has been observed moving over the ground since it was first detected";
CM_ SG_ 422 RFC_Obj16_MovingProbability "Object has been observed moving over the ground";
CM_ SG_ 422 RFC_Obj16_Length "Object Length. ISO 23150: Bounding box extent {length, width, height} (A.2.19)";
CM_ SG_ 422 RFC_Obj16_Valid "Object is valid or not";
CM_ SG_ 422 RFC_Obj16_LengthVnce "Variance of object Length. ISO 23150: Bounding box extent {length, width, height}  error (A.2.20)";
CM_ SG_ 422 RFC_Obj16_WidthVnce "Variance of object Width. ISO 23150: Bounding box extent {length, width, height}  error (A.2.20)";
CM_ SG_ 422 RFC_Obj16_Width "Object Width. ISO 23150: Bounding box extent {length, width, height} (A.2.19)";
CM_ SG_ 422 RFC_Obj16_BehaviorType "Indicates that which behavior the object associated for";
CM_ SG_ 422 RFC_Obj16_ObstacleConf "Confidence of the object being an Obstacle. ISO 23150: Potentially moving object classification type  confidence (A.2.12)";
CM_ SG_ 422 RFC_Obj16_NonObstacleConf "Confidence of the object being a Non-Obstacle. ISO 23150: Potentially moving object classification type  confidence (A.2.12)";
CM_ SG_ 422 RFC_Obj16_PxPyCoVnce "Covariance of Px and Py";
CM_ SG_ 422 RFC_Obj16_PxVxCoVnce "Covariance of Px and Vx";
CM_ SG_ 422 RFC_Obj16_PxVyCoVnce "Covariance of Px and Vy";
CM_ SG_ 422 RFC_Obj16_PyVxCoVnce "Covariance of Py and Vx";
CM_ SG_ 422 RFC_Obj16_PyVyCoVnce "Covariance of Py and Vy";
CM_ SG_ 422 RFC_Obj16_VxVyCoVnce "Covariance of Vx and Vy";
CM_ SG_ 422 RFC_Obj16_PxAxCoVnce "Covariance of Px and Ax";
CM_ SG_ 422 RFC_Obj16_PxAyCoVnce "Covariance of Px and Ay";
CM_ SG_ 422 RFC_Obj16_PyAxCoVnce "Covariance of Py and Ax";
CM_ SG_ 422 RFC_Obj16_PyAyCoVnce "Covariance of Py and Ay";
CM_ SG_ 422 RFC_Obj16_VxAxCoVnce "Covariance of Vx and Ax";
CM_ SG_ 422 RFC_Obj16_VxAyCoVnce "Covariance of Vx and Ay";
CM_ SG_ 422 RFC_Obj16_VyAxCoVnce "Covariance of Vy and Ax";
CM_ SG_ 422 RFC_Obj16_VyAyCoVnce "Covariance of Vy and Ay";
CM_ SG_ 422 RFC_Obj16_AxAyCoVnce "Covariance of Ax and Ay";
CM_ SG_ 422 RFC_Obj16_MobileObstConf "Confidence of the object being a mobile obstacle. ISO 23150: Potentially moving object classification type  confidence (A.2.12)";
CM_ SG_ 422 RFC_Obj16_Mob4PlusWhlConf "Confidence of a mobile object which has 4 or more wheels. ISO 23150: Potentially moving object classification type  confidence (A.2.12)";
CM_ SG_ 422 RFC_Obj16_Mob2WhlConf "Confidence of a mobile object being 2-wheels vehicle. ISO 23150: Potentially moving object classification type  confidence (A.2.12)";
CM_ SG_ 422 RFC_Obj16_MobPedConf "Confidence of a mobile object being a pedestrian. ISO 23150: Potentially moving object classification type  confidence (A.2.12)";
CM_ SG_ 422 RFC_Obj16_FourPlusWhlCarConf "Confidence of a mobile object which has 4 or more wheels--passenger car. ISO 23150: Potentially moving object classification type  confidence (A.2.12)";
CM_ SG_ 422 RFC_Obj16_FourPlusWhlHGVConf "Confidence of a mobile object which has 4 or more wheels--commercial vehicle (Truck). ISO 23150: Potentially moving object classification type  confidence (A.2.12)";
CM_ SG_ 422 RFC_Obj16_GroundReflexConf "Confidence of the object being a ground reflex. ISO 23150: Potentially moving object classification type  confidence (A.2.12)";
CM_ SG_ 422 RFC_Obj16_StatObstConf "Confidence of the object being a stationary obstacle. ISO 23150: Potentially moving object classification type  confidence (A.2.12)";
CM_ SG_ 422 RFC_Obj16_StatBarrierConf "Confidence of the object being a stationary road barrier. ISO 23150: Potentially moving object classification type  confidence (A.2.12)";
CM_ SG_ 423 RFC_Obj17_CRC "CRC - Autosar E2E Profile 5";
CM_ SG_ 423 RFC_Obj17_AliveCtr "Alive counter - Autosar E2E Profile 5";
CM_ SG_ 423 RFC_Obj17_ProtBlockCtr "Protocol-Signal: Block-Counter";
CM_ SG_ 423 RFC_Obj17_ReferencePoint "Reference Point of the detected object. ISO 23150: Reference point (A.2.17)";
CM_ SG_ 423 RFC_Obj17_ObjId "Unique Object ID. ISO 23150: Object ID (A.2.2)";
CM_ SG_ 423 RFC_Obj17_MeasurementStatus "Object is measured or not. ISO 23150: Measurement status  object level (A.2.9)";
CM_ SG_ 423 RFC_Obj17_Px "Object position in X direction. ISO 23150: Position  object level {x, y, z} (A.2.13)";
CM_ SG_ 423 RFC_Obj17_Py "Object position in Y direction. ISO 23150: Position  object level {x, y, z} (A.2.13)";
CM_ SG_ 423 RFC_Obj17_PxVnce "Variance of object position in X direction. ISO 23150: Position  object level {x, y, z}  error (A.2.14)";
CM_ SG_ 423 RFC_Obj17_PyVnce "Variance of object position in Y direction. ISO 23150: Position  object level {x, y, z}  error (A.2.14)";
CM_ SG_ 423 RFC_Obj17_Vx "Object relative velocity in X direction. ISO 23150: Velocity {x, y, z}  object level (A.2.23)";
CM_ SG_ 423 RFC_Obj17_Vy "Object relative velocity in Y direction. ISO 23150: Velocity {x, y, z}  object level (A.2.23)";
CM_ SG_ 423 RFC_Obj17_Ax "Object relative acceleration in X direction. ISO 23150: Acceleration {x, y, z} (A.2.25)";
CM_ SG_ 423 RFC_Obj17_Ay "Object relative acceleration in Y direction. ISO 23150: Acceleration {x, y, z} (A.2.25)";
CM_ SG_ 423 RFC_Obj17_OrientationYaw "Object orientation yaw angle. ISO 23150: Orientation {yaw, pitch, roll} (A.2.15)";
CM_ SG_ 423 RFC_Obj17_ExistProb "Existence probability of object. ISO 23150: Existence probability  object level (A.2.1)";
CM_ SG_ 423 RFC_Obj17_VxVnce "Variance of object relative velocity in X direction. ISO 23150: Velocity {x, y, z}  object level  error (A.2.24)";
CM_ SG_ 423 RFC_Obj17_VyVnce "Variance of object relative velocity in Y direction. ISO 23150: Velocity {x, y, z}  object level  error (A.2.24)";
CM_ SG_ 423 RFC_Obj17_AxVnce "Variance of object relative acceleration in X direction. ISO 23150: Acceleration {x, y, z}  error (A.2.26)";
CM_ SG_ 423 RFC_Obj17_AyVnce "Variance of object relative acceleration in Y direction. ISO 23150: Acceleration {x, y, z}  error (A.2.26)";
CM_ SG_ 423 RFC_Obj17_OrientationYawVnce "Variance of object orientation yaw angle. ISO 23150: Orientation {yaw, pitch, roll}  error (A.2.16)";
CM_ SG_ 423 RFC_Obj17_MovingObserved "Object has been observed moving over the ground since it was first detected";
CM_ SG_ 423 RFC_Obj17_MovingProbability "Object has been observed moving over the ground";
CM_ SG_ 423 RFC_Obj17_Length "Object Length. ISO 23150: Bounding box extent {length, width, height} (A.2.19)";
CM_ SG_ 423 RFC_Obj17_Valid "Object is valid or not";
CM_ SG_ 423 RFC_Obj17_LengthVnce "Variance of object Length. ISO 23150: Bounding box extent {length, width, height}  error (A.2.20)";
CM_ SG_ 423 RFC_Obj17_WidthVnce "Variance of object Width. ISO 23150: Bounding box extent {length, width, height}  error (A.2.20)";
CM_ SG_ 423 RFC_Obj17_Width "Object Width. ISO 23150: Bounding box extent {length, width, height} (A.2.19)";
CM_ SG_ 423 RFC_Obj17_BehaviorType "Indicates that which behavior the object associated for";
CM_ SG_ 423 RFC_Obj17_ObstacleConf "Confidence of the object being an Obstacle. ISO 23150: Potentially moving object classification type  confidence (A.2.12)";
CM_ SG_ 423 RFC_Obj17_NonObstacleConf "Confidence of the object being a Non-Obstacle. ISO 23150: Potentially moving object classification type  confidence (A.2.12)";
CM_ SG_ 423 RFC_Obj17_PxPyCoVnce "Covariance of Px and Py";
CM_ SG_ 423 RFC_Obj17_PxVxCoVnce "Covariance of Px and Vx";
CM_ SG_ 423 RFC_Obj17_PxVyCoVnce "Covariance of Px and Vy";
CM_ SG_ 423 RFC_Obj17_PyVxCoVnce "Covariance of Py and Vx";
CM_ SG_ 423 RFC_Obj17_PyVyCoVnce "Covariance of Py and Vy";
CM_ SG_ 423 RFC_Obj17_VxVyCoVnce "Covariance of Vx and Vy";
CM_ SG_ 423 RFC_Obj17_PxAxCoVnce "Covariance of Px and Ax";
CM_ SG_ 423 RFC_Obj17_PxAyCoVnce "Covariance of Px and Ay";
CM_ SG_ 423 RFC_Obj17_PyAxCoVnce "Covariance of Py and Ax";
CM_ SG_ 423 RFC_Obj17_PyAyCoVnce "Covariance of Py and Ay";
CM_ SG_ 423 RFC_Obj17_VxAxCoVnce "Covariance of Vx and Ax";
CM_ SG_ 423 RFC_Obj17_VxAyCoVnce "Covariance of Vx and Ay";
CM_ SG_ 423 RFC_Obj17_VyAxCoVnce "Covariance of Vy and Ax";
CM_ SG_ 423 RFC_Obj17_VyAyCoVnce "Covariance of Vy and Ay";
CM_ SG_ 423 RFC_Obj17_AxAyCoVnce "Covariance of Ax and Ay";
CM_ SG_ 423 RFC_Obj17_MobileObstConf "Confidence of the object being a mobile obstacle. ISO 23150: Potentially moving object classification type  confidence (A.2.12)";
CM_ SG_ 423 RFC_Obj17_Mob4PlusWhlConf "Confidence of a mobile object which has 4 or more wheels. ISO 23150: Potentially moving object classification type  confidence (A.2.12)";
CM_ SG_ 423 RFC_Obj17_Mob2WhlConf "Confidence of a mobile object being 2-wheels vehicle. ISO 23150: Potentially moving object classification type  confidence (A.2.12)";
CM_ SG_ 423 RFC_Obj17_MobPedConf "Confidence of a mobile object being a pedestrian. ISO 23150: Potentially moving object classification type  confidence (A.2.12)";
CM_ SG_ 423 RFC_Obj17_FourPlusWhlCarConf "Confidence of a mobile object which has 4 or more wheels--passenger car. ISO 23150: Potentially moving object classification type  confidence (A.2.12)";
CM_ SG_ 423 RFC_Obj17_FourPlusWhlHGVConf "Confidence of a mobile object which has 4 or more wheels--commercial vehicle (Truck). ISO 23150: Potentially moving object classification type  confidence (A.2.12)";
CM_ SG_ 423 RFC_Obj17_GroundReflexConf "Confidence of the object being a ground reflex. ISO 23150: Potentially moving object classification type  confidence (A.2.12)";
CM_ SG_ 423 RFC_Obj17_StatObstConf "Confidence of the object being a stationary obstacle. ISO 23150: Potentially moving object classification type  confidence (A.2.12)";
CM_ SG_ 423 RFC_Obj17_StatBarrierConf "Confidence of the object being a stationary road barrier. ISO 23150: Potentially moving object classification type  confidence (A.2.12)";
CM_ SG_ 424 RFC_Obj18_CRC "CRC - Autosar E2E Profile 5";
CM_ SG_ 424 RFC_Obj18_AliveCtr "Alive counter - Autosar E2E Profile 5";
CM_ SG_ 424 RFC_Obj18_ProtBlockCtr "Protocol-Signal: Block-Counter";
CM_ SG_ 424 RFC_Obj18_ReferencePoint "Reference Point of the detected object. ISO 23150: Reference point (A.2.17)";
CM_ SG_ 424 RFC_Obj18_ObjId "Unique Object ID. ISO 23150: Object ID (A.2.2)";
CM_ SG_ 424 RFC_Obj18_MeasurementStatus "Object is measured or not. ISO 23150: Measurement status  object level (A.2.9)";
CM_ SG_ 424 RFC_Obj18_Px "Object position in X direction. ISO 23150: Position  object level {x, y, z} (A.2.13)";
CM_ SG_ 424 RFC_Obj18_Py "Object position in Y direction. ISO 23150: Position  object level {x, y, z} (A.2.13)";
CM_ SG_ 424 RFC_Obj18_PxVnce "Variance of object position in X direction. ISO 23150: Position  object level {x, y, z}  error (A.2.14)";
CM_ SG_ 424 RFC_Obj18_PyVnce "Variance of object position in Y direction. ISO 23150: Position  object level {x, y, z}  error (A.2.14)";
CM_ SG_ 424 RFC_Obj18_Vx "Object relative velocity in X direction. ISO 23150: Velocity {x, y, z}  object level (A.2.23)";
CM_ SG_ 424 RFC_Obj18_Vy "Object relative velocity in Y direction. ISO 23150: Velocity {x, y, z}  object level (A.2.23)";
CM_ SG_ 424 RFC_Obj18_Ax "Object relative acceleration in X direction. ISO 23150: Acceleration {x, y, z} (A.2.25)";
CM_ SG_ 424 RFC_Obj18_Ay "Object relative acceleration in Y direction. ISO 23150: Acceleration {x, y, z} (A.2.25)";
CM_ SG_ 424 RFC_Obj18_OrientationYaw "Object orientation yaw angle. ISO 23150: Orientation {yaw, pitch, roll} (A.2.15)";
CM_ SG_ 424 RFC_Obj18_ExistProb "Existence probability of object. ISO 23150: Existence probability  object level (A.2.1)";
CM_ SG_ 424 RFC_Obj18_VxVnce "Variance of object relative velocity in X direction. ISO 23150: Velocity {x, y, z}  object level  error (A.2.24)";
CM_ SG_ 424 RFC_Obj18_VyVnce "Variance of object relative velocity in Y direction. ISO 23150: Velocity {x, y, z}  object level  error (A.2.24)";
CM_ SG_ 424 RFC_Obj18_AxVnce "Variance of object relative acceleration in X direction. ISO 23150: Acceleration {x, y, z}  error (A.2.26)";
CM_ SG_ 424 RFC_Obj18_AyVnce "Variance of object relative acceleration in Y direction. ISO 23150: Acceleration {x, y, z}  error (A.2.26)";
CM_ SG_ 424 RFC_Obj18_OrientationYawVnce "Variance of object orientation yaw angle. ISO 23150: Orientation {yaw, pitch, roll}  error (A.2.16)";
CM_ SG_ 424 RFC_Obj18_MovingObserved "Object has been observed moving over the ground since it was first detected";
CM_ SG_ 424 RFC_Obj18_MovingProbability "Object has been observed moving over the ground";
CM_ SG_ 424 RFC_Obj18_Length "Object Length. ISO 23150: Bounding box extent {length, width, height} (A.2.19)";
CM_ SG_ 424 RFC_Obj18_Valid "Object is valid or not";
CM_ SG_ 424 RFC_Obj18_LengthVnce "Variance of object Length. ISO 23150: Bounding box extent {length, width, height}  error (A.2.20)";
CM_ SG_ 424 RFC_Obj18_WidthVnce "Variance of object Width. ISO 23150: Bounding box extent {length, width, height}  error (A.2.20)";
CM_ SG_ 424 RFC_Obj18_Width "Object Width. ISO 23150: Bounding box extent {length, width, height} (A.2.19)";
CM_ SG_ 424 RFC_Obj18_BehaviorType "Indicates that which behavior the object associated for";
CM_ SG_ 424 RFC_Obj18_ObstacleConf "Confidence of the object being an Obstacle. ISO 23150: Potentially moving object classification type  confidence (A.2.12)";
CM_ SG_ 424 RFC_Obj18_NonObstacleConf "Confidence of the object being a Non-Obstacle. ISO 23150: Potentially moving object classification type  confidence (A.2.12)";
CM_ SG_ 424 RFC_Obj18_PxPyCoVnce "Covariance of Px and Py";
CM_ SG_ 424 RFC_Obj18_PxVxCoVnce "Covariance of Px and Vx";
CM_ SG_ 424 RFC_Obj18_PxVyCoVnce "Covariance of Px and Vy";
CM_ SG_ 424 RFC_Obj18_PyVxCoVnce "Covariance of Py and Vx";
CM_ SG_ 424 RFC_Obj18_PyVyCoVnce "Covariance of Py and Vy";
CM_ SG_ 424 RFC_Obj18_VxVyCoVnce "Covariance of Vx and Vy";
CM_ SG_ 424 RFC_Obj18_PxAxCoVnce "Covariance of Px and Ax";
CM_ SG_ 424 RFC_Obj18_PxAyCoVnce "Covariance of Px and Ay";
CM_ SG_ 424 RFC_Obj18_PyAxCoVnce "Covariance of Py and Ax";
CM_ SG_ 424 RFC_Obj18_PyAyCoVnce "Covariance of Py and Ay";
CM_ SG_ 424 RFC_Obj18_VxAxCoVnce "Covariance of Vx and Ax";
CM_ SG_ 424 RFC_Obj18_VxAyCoVnce "Covariance of Vx and Ay";
CM_ SG_ 424 RFC_Obj18_VyAxCoVnce "Covariance of Vy and Ax";
CM_ SG_ 424 RFC_Obj18_VyAyCoVnce "Covariance of Vy and Ay";
CM_ SG_ 424 RFC_Obj18_AxAyCoVnce "Covariance of Ax and Ay";
CM_ SG_ 424 RFC_Obj18_MobileObstConf "Confidence of the object being a mobile obstacle. ISO 23150: Potentially moving object classification type  confidence (A.2.12)";
CM_ SG_ 424 RFC_Obj18_Mob4PlusWhlConf "Confidence of a mobile object which has 4 or more wheels. ISO 23150: Potentially moving object classification type  confidence (A.2.12)";
CM_ SG_ 424 RFC_Obj18_Mob2WhlConf "Confidence of a mobile object being 2-wheels vehicle. ISO 23150: Potentially moving object classification type  confidence (A.2.12)";
CM_ SG_ 424 RFC_Obj18_MobPedConf "Confidence of a mobile object being a pedestrian. ISO 23150: Potentially moving object classification type  confidence (A.2.12)";
CM_ SG_ 424 RFC_Obj18_FourPlusWhlCarConf "Confidence of a mobile object which has 4 or more wheels--passenger car. ISO 23150: Potentially moving object classification type  confidence (A.2.12)";
CM_ SG_ 424 RFC_Obj18_FourPlusWhlHGVConf "Confidence of a mobile object which has 4 or more wheels--commercial vehicle (Truck). ISO 23150: Potentially moving object classification type  confidence (A.2.12)";
CM_ SG_ 424 RFC_Obj18_GroundReflexConf "Confidence of the object being a ground reflex. ISO 23150: Potentially moving object classification type  confidence (A.2.12)";
CM_ SG_ 424 RFC_Obj18_StatObstConf "Confidence of the object being a stationary obstacle. ISO 23150: Potentially moving object classification type  confidence (A.2.12)";
CM_ SG_ 424 RFC_Obj18_StatBarrierConf "Confidence of the object being a stationary road barrier. ISO 23150: Potentially moving object classification type  confidence (A.2.12)";
CM_ SG_ 425 RFC_Obj19_CRC "CRC - Autosar E2E Profile 5";
CM_ SG_ 425 RFC_Obj19_AliveCtr "Alive counter - Autosar E2E Profile 5";
CM_ SG_ 425 RFC_Obj19_ProtBlockCtr "Protocol-Signal: Block-Counter";
CM_ SG_ 425 RFC_Obj19_ReferencePoint "Reference Point of the detected object. ISO 23150: Reference point (A.2.17)";
CM_ SG_ 425 RFC_Obj19_ObjId "Unique Object ID. ISO 23150: Object ID (A.2.2)";
CM_ SG_ 425 RFC_Obj19_MeasurementStatus "Object is measured or not. ISO 23150: Measurement status  object level (A.2.9)";
CM_ SG_ 425 RFC_Obj19_Px "Object position in X direction. ISO 23150: Position  object level {x, y, z} (A.2.13)";
CM_ SG_ 425 RFC_Obj19_Py "Object position in Y direction. ISO 23150: Position  object level {x, y, z} (A.2.13)";
CM_ SG_ 425 RFC_Obj19_PxVnce "Variance of object position in X direction. ISO 23150: Position  object level {x, y, z}  error (A.2.14)";
CM_ SG_ 425 RFC_Obj19_PyVnce "Variance of object position in Y direction. ISO 23150: Position  object level {x, y, z}  error (A.2.14)";
CM_ SG_ 425 RFC_Obj19_Vx "Object relative velocity in X direction. ISO 23150: Velocity {x, y, z}  object level (A.2.23)";
CM_ SG_ 425 RFC_Obj19_Vy "Object relative velocity in Y direction. ISO 23150: Velocity {x, y, z}  object level (A.2.23)";
CM_ SG_ 425 RFC_Obj19_Ax "Object relative acceleration in X direction. ISO 23150: Acceleration {x, y, z} (A.2.25)";
CM_ SG_ 425 RFC_Obj19_Ay "Object relative acceleration in Y direction. ISO 23150: Acceleration {x, y, z} (A.2.25)";
CM_ SG_ 425 RFC_Obj19_OrientationYaw "Object orientation yaw angle. ISO 23150: Orientation {yaw, pitch, roll} (A.2.15)";
CM_ SG_ 425 RFC_Obj19_ExistProb "Existence probability of object. ISO 23150: Existence probability  object level (A.2.1)";
CM_ SG_ 425 RFC_Obj19_VxVnce "Variance of object relative velocity in X direction. ISO 23150: Velocity {x, y, z}  object level  error (A.2.24)";
CM_ SG_ 425 RFC_Obj19_VyVnce "Variance of object relative velocity in Y direction. ISO 23150: Velocity {x, y, z}  object level  error (A.2.24)";
CM_ SG_ 425 RFC_Obj19_AxVnce "Variance of object relative acceleration in X direction. ISO 23150: Acceleration {x, y, z}  error (A.2.26)";
CM_ SG_ 425 RFC_Obj19_AyVnce "Variance of object relative acceleration in Y direction. ISO 23150: Acceleration {x, y, z}  error (A.2.26)";
CM_ SG_ 425 RFC_Obj19_OrientationYawVnce "Variance of object orientation yaw angle. ISO 23150: Orientation {yaw, pitch, roll}  error (A.2.16)";
CM_ SG_ 425 RFC_Obj19_MovingObserved "Object has been observed moving over the ground since it was first detected";
CM_ SG_ 425 RFC_Obj19_MovingProbability "Object has been observed moving over the ground";
CM_ SG_ 425 RFC_Obj19_Length "Object Length. ISO 23150: Bounding box extent {length, width, height} (A.2.19)";
CM_ SG_ 425 RFC_Obj19_Valid "Object is valid or not";
CM_ SG_ 425 RFC_Obj19_LengthVnce "Variance of object Length. ISO 23150: Bounding box extent {length, width, height}  error (A.2.20)";
CM_ SG_ 425 RFC_Obj19_WidthVnce "Variance of object Width. ISO 23150: Bounding box extent {length, width, height}  error (A.2.20)";
CM_ SG_ 425 RFC_Obj19_Width "Object Width. ISO 23150: Bounding box extent {length, width, height} (A.2.19)";
CM_ SG_ 425 RFC_Obj19_BehaviorType "Indicates that which behavior the object associated for";
CM_ SG_ 425 RFC_Obj19_ObstacleConf "Confidence of the object being an Obstacle. ISO 23150: Potentially moving object classification type  confidence (A.2.12)";
CM_ SG_ 425 RFC_Obj19_NonObstacleConf "Confidence of the object being a Non-Obstacle. ISO 23150: Potentially moving object classification type  confidence (A.2.12)";
CM_ SG_ 425 RFC_Obj19_PxPyCoVnce "Covariance of Px and Py";
CM_ SG_ 425 RFC_Obj19_PxVxCoVnce "Covariance of Px and Vx";
CM_ SG_ 425 RFC_Obj19_PxVyCoVnce "Covariance of Px and Vy";
CM_ SG_ 425 RFC_Obj19_PyVxCoVnce "Covariance of Py and Vx";
CM_ SG_ 425 RFC_Obj19_PyVyCoVnce "Covariance of Py and Vy";
CM_ SG_ 425 RFC_Obj19_VxVyCoVnce "Covariance of Vx and Vy";
CM_ SG_ 425 RFC_Obj19_PxAxCoVnce "Covariance of Px and Ax";
CM_ SG_ 425 RFC_Obj19_PxAyCoVnce "Covariance of Px and Ay";
CM_ SG_ 425 RFC_Obj19_PyAxCoVnce "Covariance of Py and Ax";
CM_ SG_ 425 RFC_Obj19_PyAyCoVnce "Covariance of Py and Ay";
CM_ SG_ 425 RFC_Obj19_VxAxCoVnce "Covariance of Vx and Ax";
CM_ SG_ 425 RFC_Obj19_VxAyCoVnce "Covariance of Vx and Ay";
CM_ SG_ 425 RFC_Obj19_VyAxCoVnce "Covariance of Vy and Ax";
CM_ SG_ 425 RFC_Obj19_VyAyCoVnce "Covariance of Vy and Ay";
CM_ SG_ 425 RFC_Obj19_AxAyCoVnce "Covariance of Ax and Ay";
CM_ SG_ 425 RFC_Obj19_MobileObstConf "Confidence of the object being a mobile obstacle. ISO 23150: Potentially moving object classification type  confidence (A.2.12)";
CM_ SG_ 425 RFC_Obj19_Mob4PlusWhlConf "Confidence of a mobile object which has 4 or more wheels. ISO 23150: Potentially moving object classification type  confidence (A.2.12)";
CM_ SG_ 425 RFC_Obj19_Mob2WhlConf "Confidence of a mobile object being 2-wheels vehicle. ISO 23150: Potentially moving object classification type  confidence (A.2.12)";
CM_ SG_ 425 RFC_Obj19_MobPedConf "Confidence of a mobile object being a pedestrian. ISO 23150: Potentially moving object classification type  confidence (A.2.12)";
CM_ SG_ 425 RFC_Obj19_FourPlusWhlCarConf "Confidence of a mobile object which has 4 or more wheels--passenger car. ISO 23150: Potentially moving object classification type  confidence (A.2.12)";
CM_ SG_ 425 RFC_Obj19_FourPlusWhlHGVConf "Confidence of a mobile object which has 4 or more wheels--commercial vehicle (Truck). ISO 23150: Potentially moving object classification type  confidence (A.2.12)";
CM_ SG_ 425 RFC_Obj19_GroundReflexConf "Confidence of the object being a ground reflex. ISO 23150: Potentially moving object classification type  confidence (A.2.12)";
CM_ SG_ 425 RFC_Obj19_StatObstConf "Confidence of the object being a stationary obstacle. ISO 23150: Potentially moving object classification type  confidence (A.2.12)";
CM_ SG_ 425 RFC_Obj19_StatBarrierConf "Confidence of the object being a stationary road barrier. ISO 23150: Potentially moving object classification type  confidence (A.2.12)";
CM_ SG_ 426 RFC_Obj20_CRC "CRC - Autosar E2E Profile 5";
CM_ SG_ 426 RFC_Obj20_AliveCtr "Alive counter - Autosar E2E Profile 5";
CM_ SG_ 426 RFC_Obj20_ProtBlockCtr "Protocol-Signal: Block-Counter";
CM_ SG_ 426 RFC_Obj20_ReferencePoint "Reference Point of the detected object. ISO 23150: Reference point (A.2.17)";
CM_ SG_ 426 RFC_Obj20_ObjId "Unique Object ID. ISO 23150: Object ID (A.2.2)";
CM_ SG_ 426 RFC_Obj20_MeasurementStatus "Object is measured or not. ISO 23150: Measurement status  object level (A.2.9)";
CM_ SG_ 426 RFC_Obj20_Px "Object position in X direction. ISO 23150: Position  object level {x, y, z} (A.2.13)";
CM_ SG_ 426 RFC_Obj20_Py "Object position in Y direction. ISO 23150: Position  object level {x, y, z} (A.2.13)";
CM_ SG_ 426 RFC_Obj20_PxVnce "Variance of object position in X direction. ISO 23150: Position  object level {x, y, z}  error (A.2.14)";
CM_ SG_ 426 RFC_Obj20_PyVnce "Variance of object position in Y direction. ISO 23150: Position  object level {x, y, z}  error (A.2.14)";
CM_ SG_ 426 RFC_Obj20_Vx "Object relative velocity in X direction. ISO 23150: Velocity {x, y, z}  object level (A.2.23)";
CM_ SG_ 426 RFC_Obj20_Vy "Object relative velocity in Y direction. ISO 23150: Velocity {x, y, z}  object level (A.2.23)";
CM_ SG_ 426 RFC_Obj20_Ax "Object relative acceleration in X direction. ISO 23150: Acceleration {x, y, z} (A.2.25)";
CM_ SG_ 426 RFC_Obj20_Ay "Object relative acceleration in Y direction. ISO 23150: Acceleration {x, y, z} (A.2.25)";
CM_ SG_ 426 RFC_Obj20_OrientationYaw "Object orientation yaw angle. ISO 23150: Orientation {yaw, pitch, roll} (A.2.15)";
CM_ SG_ 426 RFC_Obj20_ExistProb "Existence probability of object. ISO 23150: Existence probability  object level (A.2.1)";
CM_ SG_ 426 RFC_Obj20_VxVnce "Variance of object relative velocity in X direction. ISO 23150: Velocity {x, y, z}  object level  error (A.2.24)";
CM_ SG_ 426 RFC_Obj20_VyVnce "Variance of object relative velocity in Y direction. ISO 23150: Velocity {x, y, z}  object level  error (A.2.24)";
CM_ SG_ 426 RFC_Obj20_AxVnce "Variance of object relative acceleration in X direction. ISO 23150: Acceleration {x, y, z}  error (A.2.26)";
CM_ SG_ 426 RFC_Obj20_AyVnce "Variance of object relative acceleration in Y direction. ISO 23150: Acceleration {x, y, z}  error (A.2.26)";
CM_ SG_ 426 RFC_Obj20_OrientationYawVnce "Variance of object orientation yaw angle. ISO 23150: Orientation {yaw, pitch, roll}  error (A.2.16)";
CM_ SG_ 426 RFC_Obj20_MovingObserved "Object has been observed moving over the ground since it was first detected";
CM_ SG_ 426 RFC_Obj20_MovingProbability "Object has been observed moving over the ground";
CM_ SG_ 426 RFC_Obj20_Length "Object Length. ISO 23150: Bounding box extent {length, width, height} (A.2.19)";
CM_ SG_ 426 RFC_Obj20_Valid "Object is valid or not";
CM_ SG_ 426 RFC_Obj20_LengthVnce "Variance of object Length. ISO 23150: Bounding box extent {length, width, height}  error (A.2.20)";
CM_ SG_ 426 RFC_Obj20_WidthVnce "Variance of object Width. ISO 23150: Bounding box extent {length, width, height}  error (A.2.20)";
CM_ SG_ 426 RFC_Obj20_Width "Object Width. ISO 23150: Bounding box extent {length, width, height} (A.2.19)";
CM_ SG_ 426 RFC_Obj20_BehaviorType "Indicates that which behavior the object associated for";
CM_ SG_ 426 RFC_Obj20_ObstacleConf "Confidence of the object being an Obstacle. ISO 23150: Potentially moving object classification type  confidence (A.2.12)";
CM_ SG_ 426 RFC_Obj20_NonObstacleConf "Confidence of the object being a Non-Obstacle. ISO 23150: Potentially moving object classification type  confidence (A.2.12)";
CM_ SG_ 426 RFC_Obj20_PxPyCoVnce "Covariance of Px and Py";
CM_ SG_ 426 RFC_Obj20_PxVxCoVnce "Covariance of Px and Vx";
CM_ SG_ 426 RFC_Obj20_PxVyCoVnce "Covariance of Px and Vy";
CM_ SG_ 426 RFC_Obj20_PyVxCoVnce "Covariance of Py and Vx";
CM_ SG_ 426 RFC_Obj20_PyVyCoVnce "Covariance of Py and Vy";
CM_ SG_ 426 RFC_Obj20_VxVyCoVnce "Covariance of Vx and Vy";
CM_ SG_ 426 RFC_Obj20_PxAxCoVnce "Covariance of Px and Ax";
CM_ SG_ 426 RFC_Obj20_PxAyCoVnce "Covariance of Px and Ay";
CM_ SG_ 426 RFC_Obj20_PyAxCoVnce "Covariance of Py and Ax";
CM_ SG_ 426 RFC_Obj20_PyAyCoVnce "Covariance of Py and Ay";
CM_ SG_ 426 RFC_Obj20_VxAxCoVnce "Covariance of Vx and Ax";
CM_ SG_ 426 RFC_Obj20_VxAyCoVnce "Covariance of Vx and Ay";
CM_ SG_ 426 RFC_Obj20_VyAxCoVnce "Covariance of Vy and Ax";
CM_ SG_ 426 RFC_Obj20_VyAyCoVnce "Covariance of Vy and Ay";
CM_ SG_ 426 RFC_Obj20_AxAyCoVnce "Covariance of Ax and Ay";
CM_ SG_ 426 RFC_Obj20_MobileObstConf "Confidence of the object being a mobile obstacle. ISO 23150: Potentially moving object classification type  confidence (A.2.12)";
CM_ SG_ 426 RFC_Obj20_Mob4PlusWhlConf "Confidence of a mobile object which has 4 or more wheels. ISO 23150: Potentially moving object classification type  confidence (A.2.12)";
CM_ SG_ 426 RFC_Obj20_Mob2WhlConf "Confidence of a mobile object being 2-wheels vehicle. ISO 23150: Potentially moving object classification type  confidence (A.2.12)";
CM_ SG_ 426 RFC_Obj20_MobPedConf "Confidence of a mobile object being a pedestrian. ISO 23150: Potentially moving object classification type  confidence (A.2.12)";
CM_ SG_ 426 RFC_Obj20_FourPlusWhlCarConf "Confidence of a mobile object which has 4 or more wheels--passenger car. ISO 23150: Potentially moving object classification type  confidence (A.2.12)";
CM_ SG_ 426 RFC_Obj20_FourPlusWhlHGVConf "Confidence of a mobile object which has 4 or more wheels--commercial vehicle (Truck). ISO 23150: Potentially moving object classification type  confidence (A.2.12)";
CM_ SG_ 426 RFC_Obj20_GroundReflexConf "Confidence of the object being a ground reflex. ISO 23150: Potentially moving object classification type  confidence (A.2.12)";
CM_ SG_ 426 RFC_Obj20_StatObstConf "Confidence of the object being a stationary obstacle. ISO 23150: Potentially moving object classification type  confidence (A.2.12)";
CM_ SG_ 426 RFC_Obj20_StatBarrierConf "Confidence of the object being a stationary road barrier. ISO 23150: Potentially moving object classification type  confidence (A.2.12)";
CM_ SG_ 427 RFC_Obj21_CRC "CRC - Autosar E2E Profile 5";
CM_ SG_ 427 RFC_Obj21_AliveCtr "Alive counter - Autosar E2E Profile 5";
CM_ SG_ 427 RFC_Obj21_ProtBlockCtr "Protocol-Signal: Block-Counter";
CM_ SG_ 427 RFC_Obj21_ReferencePoint "Reference Point of the detected object. ISO 23150: Reference point (A.2.17)";
CM_ SG_ 427 RFC_Obj21_ObjId "Unique Object ID. ISO 23150: Object ID (A.2.2)";
CM_ SG_ 427 RFC_Obj21_MeasurementStatus "Object is measured or not. ISO 23150: Measurement status  object level (A.2.9)";
CM_ SG_ 427 RFC_Obj21_Px "Object position in X direction. ISO 23150: Position  object level {x, y, z} (A.2.13)";
CM_ SG_ 427 RFC_Obj21_Py "Object position in Y direction. ISO 23150: Position  object level {x, y, z} (A.2.13)";
CM_ SG_ 427 RFC_Obj21_PxVnce "Variance of object position in X direction. ISO 23150: Position  object level {x, y, z}  error (A.2.14)";
CM_ SG_ 427 RFC_Obj21_PyVnce "Variance of object position in Y direction. ISO 23150: Position  object level {x, y, z}  error (A.2.14)";
CM_ SG_ 427 RFC_Obj21_Vx "Object relative velocity in X direction. ISO 23150: Velocity {x, y, z}  object level (A.2.23)";
CM_ SG_ 427 RFC_Obj21_Vy "Object relative velocity in Y direction. ISO 23150: Velocity {x, y, z}  object level (A.2.23)";
CM_ SG_ 427 RFC_Obj21_Ax "Object relative acceleration in X direction. ISO 23150: Acceleration {x, y, z} (A.2.25)";
CM_ SG_ 427 RFC_Obj21_Ay "Object relative acceleration in Y direction. ISO 23150: Acceleration {x, y, z} (A.2.25)";
CM_ SG_ 427 RFC_Obj21_OrientationYaw "Object orientation yaw angle. ISO 23150: Orientation {yaw, pitch, roll} (A.2.15)";
CM_ SG_ 427 RFC_Obj21_ExistProb "Existence probability of object. ISO 23150: Existence probability  object level (A.2.1)";
CM_ SG_ 427 RFC_Obj21_VxVnce "Variance of object relative velocity in X direction. ISO 23150: Velocity {x, y, z}  object level  error (A.2.24)";
CM_ SG_ 427 RFC_Obj21_VyVnce "Variance of object relative velocity in Y direction. ISO 23150: Velocity {x, y, z}  object level  error (A.2.24)";
CM_ SG_ 427 RFC_Obj21_AxVnce "Variance of object relative acceleration in X direction. ISO 23150: Acceleration {x, y, z}  error (A.2.26)";
CM_ SG_ 427 RFC_Obj21_AyVnce "Variance of object relative acceleration in Y direction. ISO 23150: Acceleration {x, y, z}  error (A.2.26)";
CM_ SG_ 427 RFC_Obj21_OrientationYawVnce "Variance of object orientation yaw angle. ISO 23150: Orientation {yaw, pitch, roll}  error (A.2.16)";
CM_ SG_ 427 RFC_Obj21_MovingObserved "Object has been observed moving over the ground since it was first detected";
CM_ SG_ 427 RFC_Obj21_MovingProbability "Object has been observed moving over the ground";
CM_ SG_ 427 RFC_Obj21_Length "Object Length. ISO 23150: Bounding box extent {length, width, height} (A.2.19)";
CM_ SG_ 427 RFC_Obj21_Valid "Object is valid or not";
CM_ SG_ 427 RFC_Obj21_LengthVnce "Variance of object Length. ISO 23150: Bounding box extent {length, width, height}  error (A.2.20)";
CM_ SG_ 427 RFC_Obj21_WidthVnce "Variance of object Width. ISO 23150: Bounding box extent {length, width, height}  error (A.2.20)";
CM_ SG_ 427 RFC_Obj21_Width "Object Width. ISO 23150: Bounding box extent {length, width, height} (A.2.19)";
CM_ SG_ 427 RFC_Obj21_BehaviorType "Indicates that which behavior the object associated for";
CM_ SG_ 427 RFC_Obj21_ObstacleConf "Confidence of the object being an Obstacle. ISO 23150: Potentially moving object classification type  confidence (A.2.12)";
CM_ SG_ 427 RFC_Obj21_NonObstacleConf "Confidence of the object being a Non-Obstacle. ISO 23150: Potentially moving object classification type  confidence (A.2.12)";
CM_ SG_ 427 RFC_Obj21_PxPyCoVnce "Covariance of Px and Py";
CM_ SG_ 427 RFC_Obj21_PxVxCoVnce "Covariance of Px and Vx";
CM_ SG_ 427 RFC_Obj21_PxVyCoVnce "Covariance of Px and Vy";
CM_ SG_ 427 RFC_Obj21_PyVxCoVnce "Covariance of Py and Vx";
CM_ SG_ 427 RFC_Obj21_PyVyCoVnce "Covariance of Py and Vy";
CM_ SG_ 427 RFC_Obj21_VxVyCoVnce "Covariance of Vx and Vy";
CM_ SG_ 427 RFC_Obj21_PxAxCoVnce "Covariance of Px and Ax";
CM_ SG_ 427 RFC_Obj21_PxAyCoVnce "Covariance of Px and Ay";
CM_ SG_ 427 RFC_Obj21_PyAxCoVnce "Covariance of Py and Ax";
CM_ SG_ 427 RFC_Obj21_PyAyCoVnce "Covariance of Py and Ay";
CM_ SG_ 427 RFC_Obj21_VxAxCoVnce "Covariance of Vx and Ax";
CM_ SG_ 427 RFC_Obj21_VxAyCoVnce "Covariance of Vx and Ay";
CM_ SG_ 427 RFC_Obj21_VyAxCoVnce "Covariance of Vy and Ax";
CM_ SG_ 427 RFC_Obj21_VyAyCoVnce "Covariance of Vy and Ay";
CM_ SG_ 427 RFC_Obj21_AxAyCoVnce "Covariance of Ax and Ay";
CM_ SG_ 427 RFC_Obj21_MobileObstConf "Confidence of the object being a mobile obstacle. ISO 23150: Potentially moving object classification type  confidence (A.2.12)";
CM_ SG_ 427 RFC_Obj21_Mob4PlusWhlConf "Confidence of a mobile object which has 4 or more wheels. ISO 23150: Potentially moving object classification type  confidence (A.2.12)";
CM_ SG_ 427 RFC_Obj21_Mob2WhlConf "Confidence of a mobile object being 2-wheels vehicle. ISO 23150: Potentially moving object classification type  confidence (A.2.12)";
CM_ SG_ 427 RFC_Obj21_MobPedConf "Confidence of a mobile object being a pedestrian. ISO 23150: Potentially moving object classification type  confidence (A.2.12)";
CM_ SG_ 427 RFC_Obj21_FourPlusWhlCarConf "Confidence of a mobile object which has 4 or more wheels--passenger car. ISO 23150: Potentially moving object classification type  confidence (A.2.12)";
CM_ SG_ 427 RFC_Obj21_FourPlusWhlHGVConf "Confidence of a mobile object which has 4 or more wheels--commercial vehicle (Truck). ISO 23150: Potentially moving object classification type  confidence (A.2.12)";
CM_ SG_ 427 RFC_Obj21_GroundReflexConf "Confidence of the object being a ground reflex. ISO 23150: Potentially moving object classification type  confidence (A.2.12)";
CM_ SG_ 427 RFC_Obj21_StatObstConf "Confidence of the object being a stationary obstacle. ISO 23150: Potentially moving object classification type  confidence (A.2.12)";
CM_ SG_ 427 RFC_Obj21_StatBarrierConf "Confidence of the object being a stationary road barrier. ISO 23150: Potentially moving object classification type  confidence (A.2.12)";
CM_ SG_ 428 RFC_Obj22_CRC "CRC - Autosar E2E Profile 5";
CM_ SG_ 428 RFC_Obj22_AliveCtr "Alive counter - Autosar E2E Profile 5";
CM_ SG_ 428 RFC_Obj22_ProtBlockCtr "Protocol-Signal: Block-Counter";
CM_ SG_ 428 RFC_Obj22_ReferencePoint "Reference Point of the detected object. ISO 23150: Reference point (A.2.17)";
CM_ SG_ 428 RFC_Obj22_ObjId "Unique Object ID. ISO 23150: Object ID (A.2.2)";
CM_ SG_ 428 RFC_Obj22_MeasurementStatus "Object is measured or not. ISO 23150: Measurement status  object level (A.2.9)";
CM_ SG_ 428 RFC_Obj22_Px "Object position in X direction. ISO 23150: Position  object level {x, y, z} (A.2.13)";
CM_ SG_ 428 RFC_Obj22_Py "Object position in Y direction. ISO 23150: Position  object level {x, y, z} (A.2.13)";
CM_ SG_ 428 RFC_Obj22_PxVnce "Variance of object position in X direction. ISO 23150: Position  object level {x, y, z}  error (A.2.14)";
CM_ SG_ 428 RFC_Obj22_PyVnce "Variance of object position in Y direction. ISO 23150: Position  object level {x, y, z}  error (A.2.14)";
CM_ SG_ 428 RFC_Obj22_Vx "Object relative velocity in X direction. ISO 23150: Velocity {x, y, z}  object level (A.2.23)";
CM_ SG_ 428 RFC_Obj22_Vy "Object relative velocity in Y direction. ISO 23150: Velocity {x, y, z}  object level (A.2.23)";
CM_ SG_ 428 RFC_Obj22_Ax "Object relative acceleration in X direction. ISO 23150: Acceleration {x, y, z} (A.2.25)";
CM_ SG_ 428 RFC_Obj22_Ay "Object relative acceleration in Y direction. ISO 23150: Acceleration {x, y, z} (A.2.25)";
CM_ SG_ 428 RFC_Obj22_OrientationYaw "Object orientation yaw angle. ISO 23150: Orientation {yaw, pitch, roll} (A.2.15)";
CM_ SG_ 428 RFC_Obj22_ExistProb "Existence probability of object. ISO 23150: Existence probability  object level (A.2.1)";
CM_ SG_ 428 RFC_Obj22_VxVnce "Variance of object relative velocity in X direction. ISO 23150: Velocity {x, y, z}  object level  error (A.2.24)";
CM_ SG_ 428 RFC_Obj22_VyVnce "Variance of object relative velocity in Y direction. ISO 23150: Velocity {x, y, z}  object level  error (A.2.24)";
CM_ SG_ 428 RFC_Obj22_AxVnce "Variance of object relative acceleration in X direction. ISO 23150: Acceleration {x, y, z}  error (A.2.26)";
CM_ SG_ 428 RFC_Obj22_AyVnce "Variance of object relative acceleration in Y direction. ISO 23150: Acceleration {x, y, z}  error (A.2.26)";
CM_ SG_ 428 RFC_Obj22_OrientationYawVnce "Variance of object orientation yaw angle. ISO 23150: Orientation {yaw, pitch, roll}  error (A.2.16)";
CM_ SG_ 428 RFC_Obj22_MovingObserved "Object has been observed moving over the ground since it was first detected";
CM_ SG_ 428 RFC_Obj22_MovingProbability "Object has been observed moving over the ground";
CM_ SG_ 428 RFC_Obj22_Length "Object Length. ISO 23150: Bounding box extent {length, width, height} (A.2.19)";
CM_ SG_ 428 RFC_Obj22_Valid "Object is valid or not";
CM_ SG_ 428 RFC_Obj22_LengthVnce "Variance of object Length. ISO 23150: Bounding box extent {length, width, height}  error (A.2.20)";
CM_ SG_ 428 RFC_Obj22_WidthVnce "Variance of object Width. ISO 23150: Bounding box extent {length, width, height}  error (A.2.20)";
CM_ SG_ 428 RFC_Obj22_Width "Object Width. ISO 23150: Bounding box extent {length, width, height} (A.2.19)";
CM_ SG_ 428 RFC_Obj22_BehaviorType "Indicates that which behavior the object associated for";
CM_ SG_ 428 RFC_Obj22_ObstacleConf "Confidence of the object being an Obstacle. ISO 23150: Potentially moving object classification type  confidence (A.2.12)";
CM_ SG_ 428 RFC_Obj22_NonObstacleConf "Confidence of the object being a Non-Obstacle. ISO 23150: Potentially moving object classification type  confidence (A.2.12)";
CM_ SG_ 428 RFC_Obj22_PxPyCoVnce "Covariance of Px and Py";
CM_ SG_ 428 RFC_Obj22_PxVxCoVnce "Covariance of Px and Vx";
CM_ SG_ 428 RFC_Obj22_PxVyCoVnce "Covariance of Px and Vy";
CM_ SG_ 428 RFC_Obj22_PyVxCoVnce "Covariance of Py and Vx";
CM_ SG_ 428 RFC_Obj22_PyVyCoVnce "Covariance of Py and Vy";
CM_ SG_ 428 RFC_Obj22_VxVyCoVnce "Covariance of Vx and Vy";
CM_ SG_ 428 RFC_Obj22_PxAxCoVnce "Covariance of Px and Ax";
CM_ SG_ 428 RFC_Obj22_PxAyCoVnce "Covariance of Px and Ay";
CM_ SG_ 428 RFC_Obj22_PyAxCoVnce "Covariance of Py and Ax";
CM_ SG_ 428 RFC_Obj22_PyAyCoVnce "Covariance of Py and Ay";
CM_ SG_ 428 RFC_Obj22_VxAxCoVnce "Covariance of Vx and Ax";
CM_ SG_ 428 RFC_Obj22_VxAyCoVnce "Covariance of Vx and Ay";
CM_ SG_ 428 RFC_Obj22_VyAxCoVnce "Covariance of Vy and Ax";
CM_ SG_ 428 RFC_Obj22_VyAyCoVnce "Covariance of Vy and Ay";
CM_ SG_ 428 RFC_Obj22_AxAyCoVnce "Covariance of Ax and Ay";
CM_ SG_ 428 RFC_Obj22_MobileObstConf "Confidence of the object being a mobile obstacle. ISO 23150: Potentially moving object classification type  confidence (A.2.12)";
CM_ SG_ 428 RFC_Obj22_Mob4PlusWhlConf "Confidence of a mobile object which has 4 or more wheels. ISO 23150: Potentially moving object classification type  confidence (A.2.12)";
CM_ SG_ 428 RFC_Obj22_Mob2WhlConf "Confidence of a mobile object being 2-wheels vehicle. ISO 23150: Potentially moving object classification type  confidence (A.2.12)";
CM_ SG_ 428 RFC_Obj22_MobPedConf "Confidence of a mobile object being a pedestrian. ISO 23150: Potentially moving object classification type  confidence (A.2.12)";
CM_ SG_ 428 RFC_Obj22_FourPlusWhlCarConf "Confidence of a mobile object which has 4 or more wheels--passenger car. ISO 23150: Potentially moving object classification type  confidence (A.2.12)";
CM_ SG_ 428 RFC_Obj22_FourPlusWhlHGVConf "Confidence of a mobile object which has 4 or more wheels--commercial vehicle (Truck). ISO 23150: Potentially moving object classification type  confidence (A.2.12)";
CM_ SG_ 428 RFC_Obj22_GroundReflexConf "Confidence of the object being a ground reflex. ISO 23150: Potentially moving object classification type  confidence (A.2.12)";
CM_ SG_ 428 RFC_Obj22_StatObstConf "Confidence of the object being a stationary obstacle. ISO 23150: Potentially moving object classification type  confidence (A.2.12)";
CM_ SG_ 428 RFC_Obj22_StatBarrierConf "Confidence of the object being a stationary road barrier. ISO 23150: Potentially moving object classification type  confidence (A.2.12)";
CM_ SG_ 429 RFC_Obj23_CRC "CRC - Autosar E2E Profile 5";
CM_ SG_ 429 RFC_Obj23_AliveCtr "Alive counter - Autosar E2E Profile 5";
CM_ SG_ 429 RFC_Obj23_ProtBlockCtr "Protocol-Signal: Block-Counter";
CM_ SG_ 429 RFC_Obj23_ReferencePoint "Reference Point of the detected object. ISO 23150: Reference point (A.2.17)";
CM_ SG_ 429 RFC_Obj23_ObjId "Unique Object ID. ISO 23150: Object ID (A.2.2)";
CM_ SG_ 429 RFC_Obj23_MeasurementStatus "Object is measured or not. ISO 23150: Measurement status  object level (A.2.9)";
CM_ SG_ 429 RFC_Obj23_Px "Object position in X direction. ISO 23150: Position  object level {x, y, z} (A.2.13)";
CM_ SG_ 429 RFC_Obj23_Py "Object position in Y direction. ISO 23150: Position  object level {x, y, z} (A.2.13)";
CM_ SG_ 429 RFC_Obj23_PxVnce "Variance of object position in X direction. ISO 23150: Position  object level {x, y, z}  error (A.2.14)";
CM_ SG_ 429 RFC_Obj23_PyVnce "Variance of object position in Y direction. ISO 23150: Position  object level {x, y, z}  error (A.2.14)";
CM_ SG_ 429 RFC_Obj23_Vx "Object relative velocity in X direction. ISO 23150: Velocity {x, y, z}  object level (A.2.23)";
CM_ SG_ 429 RFC_Obj23_Vy "Object relative velocity in Y direction. ISO 23150: Velocity {x, y, z}  object level (A.2.23)";
CM_ SG_ 429 RFC_Obj23_Ax "Object relative acceleration in X direction. ISO 23150: Acceleration {x, y, z} (A.2.25)";
CM_ SG_ 429 RFC_Obj23_Ay "Object relative acceleration in Y direction. ISO 23150: Acceleration {x, y, z} (A.2.25)";
CM_ SG_ 429 RFC_Obj23_OrientationYaw "Object orientation yaw angle. ISO 23150: Orientation {yaw, pitch, roll} (A.2.15)";
CM_ SG_ 429 RFC_Obj23_ExistProb "Existence probability of object. ISO 23150: Existence probability  object level (A.2.1)";
CM_ SG_ 429 RFC_Obj23_VxVnce "Variance of object relative velocity in X direction. ISO 23150: Velocity {x, y, z}  object level  error (A.2.24)";
CM_ SG_ 429 RFC_Obj23_VyVnce "Variance of object relative velocity in Y direction. ISO 23150: Velocity {x, y, z}  object level  error (A.2.24)";
CM_ SG_ 429 RFC_Obj23_AxVnce "Variance of object relative acceleration in X direction. ISO 23150: Acceleration {x, y, z}  error (A.2.26)";
CM_ SG_ 429 RFC_Obj23_AyVnce "Variance of object relative acceleration in Y direction. ISO 23150: Acceleration {x, y, z}  error (A.2.26)";
CM_ SG_ 429 RFC_Obj23_OrientationYawVnce "Variance of object orientation yaw angle. ISO 23150: Orientation {yaw, pitch, roll}  error (A.2.16)";
CM_ SG_ 429 RFC_Obj23_MovingObserved "Object has been observed moving over the ground since it was first detected";
CM_ SG_ 429 RFC_Obj23_MovingProbability "Object has been observed moving over the ground";
CM_ SG_ 429 RFC_Obj23_Length "Object Length. ISO 23150: Bounding box extent {length, width, height} (A.2.19)";
CM_ SG_ 429 RFC_Obj23_Valid "Object is valid or not";
CM_ SG_ 429 RFC_Obj23_LengthVnce "Variance of object Length. ISO 23150: Bounding box extent {length, width, height}  error (A.2.20)";
CM_ SG_ 429 RFC_Obj23_WidthVnce "Variance of object Width. ISO 23150: Bounding box extent {length, width, height}  error (A.2.20)";
CM_ SG_ 429 RFC_Obj23_Width "Object Width. ISO 23150: Bounding box extent {length, width, height} (A.2.19)";
CM_ SG_ 429 RFC_Obj23_BehaviorType "Indicates that which behavior the object associated for";
CM_ SG_ 429 RFC_Obj23_ObstacleConf "Confidence of the object being an Obstacle. ISO 23150: Potentially moving object classification type  confidence (A.2.12)";
CM_ SG_ 429 RFC_Obj23_NonObstacleConf "Confidence of the object being a Non-Obstacle. ISO 23150: Potentially moving object classification type  confidence (A.2.12)";
CM_ SG_ 429 RFC_Obj23_PxPyCoVnce "Covariance of Px and Py";
CM_ SG_ 429 RFC_Obj23_PxVxCoVnce "Covariance of Px and Vx";
CM_ SG_ 429 RFC_Obj23_PxVyCoVnce "Covariance of Px and Vy";
CM_ SG_ 429 RFC_Obj23_PyVxCoVnce "Covariance of Py and Vx";
CM_ SG_ 429 RFC_Obj23_PyVyCoVnce "Covariance of Py and Vy";
CM_ SG_ 429 RFC_Obj23_VxVyCoVnce "Covariance of Vx and Vy";
CM_ SG_ 429 RFC_Obj23_PxAxCoVnce "Covariance of Px and Ax";
CM_ SG_ 429 RFC_Obj23_PxAyCoVnce "Covariance of Px and Ay";
CM_ SG_ 429 RFC_Obj23_PyAxCoVnce "Covariance of Py and Ax";
CM_ SG_ 429 RFC_Obj23_PyAyCoVnce "Covariance of Py and Ay";
CM_ SG_ 429 RFC_Obj23_VxAxCoVnce "Covariance of Vx and Ax";
CM_ SG_ 429 RFC_Obj23_VxAyCoVnce "Covariance of Vx and Ay";
CM_ SG_ 429 RFC_Obj23_VyAxCoVnce "Covariance of Vy and Ax";
CM_ SG_ 429 RFC_Obj23_VyAyCoVnce "Covariance of Vy and Ay";
CM_ SG_ 429 RFC_Obj23_AxAyCoVnce "Covariance of Ax and Ay";
CM_ SG_ 429 RFC_Obj23_MobileObstConf "Confidence of the object being a mobile obstacle. ISO 23150: Potentially moving object classification type  confidence (A.2.12)";
CM_ SG_ 429 RFC_Obj23_Mob4PlusWhlConf "Confidence of a mobile object which has 4 or more wheels. ISO 23150: Potentially moving object classification type  confidence (A.2.12)";
CM_ SG_ 429 RFC_Obj23_Mob2WhlConf "Confidence of a mobile object being 2-wheels vehicle. ISO 23150: Potentially moving object classification type  confidence (A.2.12)";
CM_ SG_ 429 RFC_Obj23_MobPedConf "Confidence of a mobile object being a pedestrian. ISO 23150: Potentially moving object classification type  confidence (A.2.12)";
CM_ SG_ 429 RFC_Obj23_FourPlusWhlCarConf "Confidence of a mobile object which has 4 or more wheels--passenger car. ISO 23150: Potentially moving object classification type  confidence (A.2.12)";
CM_ SG_ 429 RFC_Obj23_FourPlusWhlHGVConf "Confidence of a mobile object which has 4 or more wheels--commercial vehicle (Truck). ISO 23150: Potentially moving object classification type  confidence (A.2.12)";
CM_ SG_ 429 RFC_Obj23_GroundReflexConf "Confidence of the object being a ground reflex. ISO 23150: Potentially moving object classification type  confidence (A.2.12)";
CM_ SG_ 429 RFC_Obj23_StatObstConf "Confidence of the object being a stationary obstacle. ISO 23150: Potentially moving object classification type  confidence (A.2.12)";
CM_ SG_ 429 RFC_Obj23_StatBarrierConf "Confidence of the object being a stationary road barrier. ISO 23150: Potentially moving object classification type  confidence (A.2.12)";
CM_ SG_ 430 RFC_Obj24_CRC "CRC - Autosar E2E Profile 5";
CM_ SG_ 430 RFC_Obj24_AliveCtr "Alive counter - Autosar E2E Profile 5";
CM_ SG_ 430 RFC_Obj24_ProtBlockCtr "Protocol-Signal: Block-Counter";
CM_ SG_ 430 RFC_Obj24_ReferencePoint "Reference Point of the detected object. ISO 23150: Reference point (A.2.17)";
CM_ SG_ 430 RFC_Obj24_ObjId "Unique Object ID. ISO 23150: Object ID (A.2.2)";
CM_ SG_ 430 RFC_Obj24_MeasurementStatus "Object is measured or not. ISO 23150: Measurement status  object level (A.2.9)";
CM_ SG_ 430 RFC_Obj24_Px "Object position in X direction. ISO 23150: Position  object level {x, y, z} (A.2.13)";
CM_ SG_ 430 RFC_Obj24_Py "Object position in Y direction. ISO 23150: Position  object level {x, y, z} (A.2.13)";
CM_ SG_ 430 RFC_Obj24_PxVnce "Variance of object position in X direction. ISO 23150: Position  object level {x, y, z}  error (A.2.14)";
CM_ SG_ 430 RFC_Obj24_PyVnce "Variance of object position in Y direction. ISO 23150: Position  object level {x, y, z}  error (A.2.14)";
CM_ SG_ 430 RFC_Obj24_Vx "Object relative velocity in X direction. ISO 23150: Velocity {x, y, z}  object level (A.2.23)";
CM_ SG_ 430 RFC_Obj24_Vy "Object relative velocity in Y direction. ISO 23150: Velocity {x, y, z}  object level (A.2.23)";
CM_ SG_ 430 RFC_Obj24_Ax "Object relative acceleration in X direction. ISO 23150: Acceleration {x, y, z} (A.2.25)";
CM_ SG_ 430 RFC_Obj24_Ay "Object relative acceleration in Y direction. ISO 23150: Acceleration {x, y, z} (A.2.25)";
CM_ SG_ 430 RFC_Obj24_OrientationYaw "Object orientation yaw angle. ISO 23150: Orientation {yaw, pitch, roll} (A.2.15)";
CM_ SG_ 430 RFC_Obj24_ExistProb "Existence probability of object. ISO 23150: Existence probability  object level (A.2.1)";
CM_ SG_ 430 RFC_Obj24_VxVnce "Variance of object relative velocity in X direction. ISO 23150: Velocity {x, y, z}  object level  error (A.2.24)";
CM_ SG_ 430 RFC_Obj24_VyVnce "Variance of object relative velocity in Y direction. ISO 23150: Velocity {x, y, z}  object level  error (A.2.24)";
CM_ SG_ 430 RFC_Obj24_AxVnce "Variance of object relative acceleration in X direction. ISO 23150: Acceleration {x, y, z}  error (A.2.26)";
CM_ SG_ 430 RFC_Obj24_AyVnce "Variance of object relative acceleration in Y direction. ISO 23150: Acceleration {x, y, z}  error (A.2.26)";
CM_ SG_ 430 RFC_Obj24_OrientationYawVnce "Variance of object orientation yaw angle. ISO 23150: Orientation {yaw, pitch, roll}  error (A.2.16)";
CM_ SG_ 430 RFC_Obj24_MovingObserved "Object has been observed moving over the ground since it was first detected";
CM_ SG_ 430 RFC_Obj24_MovingProbability "Object has been observed moving over the ground";
CM_ SG_ 430 RFC_Obj24_Length "Object Length. ISO 23150: Bounding box extent {length, width, height} (A.2.19)";
CM_ SG_ 430 RFC_Obj24_Valid "Object is valid or not";
CM_ SG_ 430 RFC_Obj24_LengthVnce "Variance of object Length. ISO 23150: Bounding box extent {length, width, height}  error (A.2.20)";
CM_ SG_ 430 RFC_Obj24_WidthVnce "Variance of object Width. ISO 23150: Bounding box extent {length, width, height}  error (A.2.20)";
CM_ SG_ 430 RFC_Obj24_Width "Object Width. ISO 23150: Bounding box extent {length, width, height} (A.2.19)";
CM_ SG_ 430 RFC_Obj24_BehaviorType "Indicates that which behavior the object associated for";
CM_ SG_ 430 RFC_Obj24_ObstacleConf "Confidence of the object being an Obstacle. ISO 23150: Potentially moving object classification type  confidence (A.2.12)";
CM_ SG_ 430 RFC_Obj24_NonObstacleConf "Confidence of the object being a Non-Obstacle. ISO 23150: Potentially moving object classification type  confidence (A.2.12)";
CM_ SG_ 430 RFC_Obj24_PxPyCoVnce "Covariance of Px and Py";
CM_ SG_ 430 RFC_Obj24_PxVxCoVnce "Covariance of Px and Vx";
CM_ SG_ 430 RFC_Obj24_PxVyCoVnce "Covariance of Px and Vy";
CM_ SG_ 430 RFC_Obj24_PyVxCoVnce "Covariance of Py and Vx";
CM_ SG_ 430 RFC_Obj24_PyVyCoVnce "Covariance of Py and Vy";
CM_ SG_ 430 RFC_Obj24_VxVyCoVnce "Covariance of Vx and Vy";
CM_ SG_ 430 RFC_Obj24_PxAxCoVnce "Covariance of Px and Ax";
CM_ SG_ 430 RFC_Obj24_PxAyCoVnce "Covariance of Px and Ay";
CM_ SG_ 430 RFC_Obj24_PyAxCoVnce "Covariance of Py and Ax";
CM_ SG_ 430 RFC_Obj24_PyAyCoVnce "Covariance of Py and Ay";
CM_ SG_ 430 RFC_Obj24_VxAxCoVnce "Covariance of Vx and Ax";
CM_ SG_ 430 RFC_Obj24_VxAyCoVnce "Covariance of Vx and Ay";
CM_ SG_ 430 RFC_Obj24_VyAxCoVnce "Covariance of Vy and Ax";
CM_ SG_ 430 RFC_Obj24_VyAyCoVnce "Covariance of Vy and Ay";
CM_ SG_ 430 RFC_Obj24_AxAyCoVnce "Covariance of Ax and Ay";
CM_ SG_ 430 RFC_Obj24_MobileObstConf "Confidence of the object being a mobile obstacle. ISO 23150: Potentially moving object classification type  confidence (A.2.12)";
CM_ SG_ 430 RFC_Obj24_Mob4PlusWhlConf "Confidence of a mobile object which has 4 or more wheels. ISO 23150: Potentially moving object classification type  confidence (A.2.12)";
CM_ SG_ 430 RFC_Obj24_Mob2WhlConf "Confidence of a mobile object being 2-wheels vehicle. ISO 23150: Potentially moving object classification type  confidence (A.2.12)";
CM_ SG_ 430 RFC_Obj24_MobPedConf "Confidence of a mobile object being a pedestrian. ISO 23150: Potentially moving object classification type  confidence (A.2.12)";
CM_ SG_ 430 RFC_Obj24_FourPlusWhlCarConf "Confidence of a mobile object which has 4 or more wheels--passenger car. ISO 23150: Potentially moving object classification type  confidence (A.2.12)";
CM_ SG_ 430 RFC_Obj24_FourPlusWhlHGVConf "Confidence of a mobile object which has 4 or more wheels--commercial vehicle (Truck). ISO 23150: Potentially moving object classification type  confidence (A.2.12)";
CM_ SG_ 430 RFC_Obj24_GroundReflexConf "Confidence of the object being a ground reflex. ISO 23150: Potentially moving object classification type  confidence (A.2.12)";
CM_ SG_ 430 RFC_Obj24_StatObstConf "Confidence of the object being a stationary obstacle. ISO 23150: Potentially moving object classification type  confidence (A.2.12)";
CM_ SG_ 430 RFC_Obj24_StatBarrierConf "Confidence of the object being a stationary road barrier. ISO 23150: Potentially moving object classification type  confidence (A.2.12)";
CM_ SG_ 431 RFC_Obj25_CRC "CRC - Autosar E2E Profile 5";
CM_ SG_ 431 RFC_Obj25_AliveCtr "Alive counter - Autosar E2E Profile 5";
CM_ SG_ 431 RFC_Obj25_ProtBlockCtr "Protocol-Signal: Block-Counter";
CM_ SG_ 431 RFC_Obj25_ReferencePoint "Reference Point of the detected object. ISO 23150: Reference point (A.2.17)";
CM_ SG_ 431 RFC_Obj25_ObjId "Unique Object ID. ISO 23150: Object ID (A.2.2)";
CM_ SG_ 431 RFC_Obj25_MeasurementStatus "Object is measured or not. ISO 23150: Measurement status  object level (A.2.9)";
CM_ SG_ 431 RFC_Obj25_Px "Object position in X direction. ISO 23150: Position  object level {x, y, z} (A.2.13)";
CM_ SG_ 431 RFC_Obj25_Py "Object position in Y direction. ISO 23150: Position  object level {x, y, z} (A.2.13)";
CM_ SG_ 431 RFC_Obj25_PxVnce "Variance of object position in X direction. ISO 23150: Position  object level {x, y, z}  error (A.2.14)";
CM_ SG_ 431 RFC_Obj25_PyVnce "Variance of object position in Y direction. ISO 23150: Position  object level {x, y, z}  error (A.2.14)";
CM_ SG_ 431 RFC_Obj25_Vx "Object relative velocity in X direction. ISO 23150: Velocity {x, y, z}  object level (A.2.23)";
CM_ SG_ 431 RFC_Obj25_Vy "Object relative velocity in Y direction. ISO 23150: Velocity {x, y, z}  object level (A.2.23)";
CM_ SG_ 431 RFC_Obj25_Ax "Object relative acceleration in X direction. ISO 23150: Acceleration {x, y, z} (A.2.25)";
CM_ SG_ 431 RFC_Obj25_Ay "Object relative acceleration in Y direction. ISO 23150: Acceleration {x, y, z} (A.2.25)";
CM_ SG_ 431 RFC_Obj25_OrientationYaw "Object orientation yaw angle. ISO 23150: Orientation {yaw, pitch, roll} (A.2.15)";
CM_ SG_ 431 RFC_Obj25_ExistProb "Existence probability of object. ISO 23150: Existence probability  object level (A.2.1)";
CM_ SG_ 431 RFC_Obj25_VxVnce "Variance of object relative velocity in X direction. ISO 23150: Velocity {x, y, z}  object level  error (A.2.24)";
CM_ SG_ 431 RFC_Obj25_VyVnce "Variance of object relative velocity in Y direction. ISO 23150: Velocity {x, y, z}  object level  error (A.2.24)";
CM_ SG_ 431 RFC_Obj25_AxVnce "Variance of object relative acceleration in X direction. ISO 23150: Acceleration {x, y, z}  error (A.2.26)";
CM_ SG_ 431 RFC_Obj25_AyVnce "Variance of object relative acceleration in Y direction. ISO 23150: Acceleration {x, y, z}  error (A.2.26)";
CM_ SG_ 431 RFC_Obj25_OrientationYawVnce "Variance of object orientation yaw angle. ISO 23150: Orientation {yaw, pitch, roll}  error (A.2.16)";
CM_ SG_ 431 RFC_Obj25_MovingObserved "Object has been observed moving over the ground since it was first detected";
CM_ SG_ 431 RFC_Obj25_MovingProbability "Object has been observed moving over the ground";
CM_ SG_ 431 RFC_Obj25_Length "Object Length. ISO 23150: Bounding box extent {length, width, height} (A.2.19)";
CM_ SG_ 431 RFC_Obj25_Valid "Object is valid or not";
CM_ SG_ 431 RFC_Obj25_LengthVnce "Variance of object Length. ISO 23150: Bounding box extent {length, width, height}  error (A.2.20)";
CM_ SG_ 431 RFC_Obj25_WidthVnce "Variance of object Width. ISO 23150: Bounding box extent {length, width, height}  error (A.2.20)";
CM_ SG_ 431 RFC_Obj25_Width "Object Width. ISO 23150: Bounding box extent {length, width, height} (A.2.19)";
CM_ SG_ 431 RFC_Obj25_BehaviorType "Indicates that which behavior the object associated for";
CM_ SG_ 431 RFC_Obj25_ObstacleConf "Confidence of the object being an Obstacle. ISO 23150: Potentially moving object classification type  confidence (A.2.12)";
CM_ SG_ 431 RFC_Obj25_NonObstacleConf "Confidence of the object being a Non-Obstacle. ISO 23150: Potentially moving object classification type  confidence (A.2.12)";
CM_ SG_ 431 RFC_Obj25_PxPyCoVnce "Covariance of Px and Py";
CM_ SG_ 431 RFC_Obj25_PxVxCoVnce "Covariance of Px and Vx";
CM_ SG_ 431 RFC_Obj25_PxVyCoVnce "Covariance of Px and Vy";
CM_ SG_ 431 RFC_Obj25_PyVxCoVnce "Covariance of Py and Vx";
CM_ SG_ 431 RFC_Obj25_PyVyCoVnce "Covariance of Py and Vy";
CM_ SG_ 431 RFC_Obj25_VxVyCoVnce "Covariance of Vx and Vy";
CM_ SG_ 431 RFC_Obj25_PxAxCoVnce "Covariance of Px and Ax";
CM_ SG_ 431 RFC_Obj25_PxAyCoVnce "Covariance of Px and Ay";
CM_ SG_ 431 RFC_Obj25_PyAxCoVnce "Covariance of Py and Ax";
CM_ SG_ 431 RFC_Obj25_PyAyCoVnce "Covariance of Py and Ay";
CM_ SG_ 431 RFC_Obj25_VxAxCoVnce "Covariance of Vx and Ax";
CM_ SG_ 431 RFC_Obj25_VxAyCoVnce "Covariance of Vx and Ay";
CM_ SG_ 431 RFC_Obj25_VyAxCoVnce "Covariance of Vy and Ax";
CM_ SG_ 431 RFC_Obj25_VyAyCoVnce "Covariance of Vy and Ay";
CM_ SG_ 431 RFC_Obj25_AxAyCoVnce "Covariance of Ax and Ay";
CM_ SG_ 431 RFC_Obj25_MobileObstConf "Confidence of the object being a mobile obstacle. ISO 23150: Potentially moving object classification type  confidence (A.2.12)";
CM_ SG_ 431 RFC_Obj25_Mob4PlusWhlConf "Confidence of a mobile object which has 4 or more wheels. ISO 23150: Potentially moving object classification type  confidence (A.2.12)";
CM_ SG_ 431 RFC_Obj25_Mob2WhlConf "Confidence of a mobile object being 2-wheels vehicle. ISO 23150: Potentially moving object classification type  confidence (A.2.12)";
CM_ SG_ 431 RFC_Obj25_MobPedConf "Confidence of a mobile object being a pedestrian. ISO 23150: Potentially moving object classification type  confidence (A.2.12)";
CM_ SG_ 431 RFC_Obj25_FourPlusWhlCarConf "Confidence of a mobile object which has 4 or more wheels--passenger car. ISO 23150: Potentially moving object classification type  confidence (A.2.12)";
CM_ SG_ 431 RFC_Obj25_FourPlusWhlHGVConf "Confidence of a mobile object which has 4 or more wheels--commercial vehicle (Truck). ISO 23150: Potentially moving object classification type  confidence (A.2.12)";
CM_ SG_ 431 RFC_Obj25_GroundReflexConf "Confidence of the object being a ground reflex. ISO 23150: Potentially moving object classification type  confidence (A.2.12)";
CM_ SG_ 431 RFC_Obj25_StatObstConf "Confidence of the object being a stationary obstacle. ISO 23150: Potentially moving object classification type  confidence (A.2.12)";
CM_ SG_ 431 RFC_Obj25_StatBarrierConf "Confidence of the object being a stationary road barrier. ISO 23150: Potentially moving object classification type  confidence (A.2.12)";
BA_DEF_ BO_  "CANFD_BRS" ENUM  "0","1";
BA_DEF_ BO_  "GenMsgCycleTime" INT 0 65535;
BA_DEF_ BO_  "GenMsgSendType" ENUM  "Event","cyclic";
BA_DEF_ BO_  "VFrameFormat" ENUM  "StandardCAN","ExtendedCAN","reserved","reserved","reserved","reserved","reserved","reserved","reserved","reserved","reserved","reserved","reserved","reserved","StandardCAN_FD","ExtendedCAN_FD";
BA_DEF_ BO_  "E2Eprofile" STRING ;
BA_DEF_ BO_  "DataID" HEX 0 655535;
BA_DEF_ SG_  "GenSigStartValue" FLOAT 0 100000000000;
BA_DEF_DEF_  "CANFD_BRS" "1";
BA_DEF_DEF_  "GenMsgCycleTime" 0;
BA_DEF_DEF_  "GenMsgSendType" "";
BA_DEF_DEF_  "VFrameFormat" "";
BA_DEF_DEF_  "E2Eprofile" "None";
BA_DEF_DEF_  "DataID" 0;
BA_DEF_DEF_  "GenSigStartValue" 0;
BA_ "DataID" BO_ 418 8610;
BA_ "E2Eprofile" BO_ 418 "AUTOSAR Profile 5";
BA_ "GenMsgSendType" BO_ 418 0;
BA_ "VFrameFormat" BO_ 418 14;
BA_ "DataID" BO_ 419 8611;
BA_ "E2Eprofile" BO_ 419 "AUTOSAR Profile 5";
BA_ "GenMsgSendType" BO_ 419 0;
BA_ "VFrameFormat" BO_ 419 14;
BA_ "DataID" BO_ 420 8612;
BA_ "E2Eprofile" BO_ 420 "AUTOSAR Profile 5";
BA_ "GenMsgSendType" BO_ 420 0;
BA_ "VFrameFormat" BO_ 420 14;
BA_ "DataID" BO_ 421 8613;
BA_ "E2Eprofile" BO_ 421 "AUTOSAR Profile 5";
BA_ "GenMsgSendType" BO_ 421 0;
BA_ "VFrameFormat" BO_ 421 14;
BA_ "DataID" BO_ 422 8614;
BA_ "E2Eprofile" BO_ 422 "AUTOSAR Profile 5";
BA_ "GenMsgSendType" BO_ 422 0;
BA_ "VFrameFormat" BO_ 422 14;
BA_ "DataID" BO_ 423 8615;
BA_ "E2Eprofile" BO_ 423 "AUTOSAR Profile 5";
BA_ "GenMsgSendType" BO_ 423 0;
BA_ "VFrameFormat" BO_ 423 14;
BA_ "DataID" BO_ 424 8616;
BA_ "E2Eprofile" BO_ 424 "AUTOSAR Profile 5";
BA_ "GenMsgSendType" BO_ 424 0;
BA_ "VFrameFormat" BO_ 424 14;
BA_ "DataID" BO_ 425 8617;
BA_ "E2Eprofile" BO_ 425 "AUTOSAR Profile 5";
BA_ "GenMsgSendType" BO_ 425 0;
BA_ "VFrameFormat" BO_ 425 14;
BA_ "DataID" BO_ 426 8618;
BA_ "E2Eprofile" BO_ 426 "AUTOSAR Profile 5";
BA_ "GenMsgSendType" BO_ 426 0;
BA_ "VFrameFormat" BO_ 426 14;
BA_ "DataID" BO_ 427 8619;
BA_ "E2Eprofile" BO_ 427 "AUTOSAR Profile 5";
BA_ "GenMsgSendType" BO_ 427 0;
BA_ "VFrameFormat" BO_ 427 14;
BA_ "DataID" BO_ 428 8620;
BA_ "E2Eprofile" BO_ 428 "AUTOSAR Profile 5";
BA_ "GenMsgSendType" BO_ 428 0;
BA_ "VFrameFormat" BO_ 428 14;
BA_ "DataID" BO_ 429 8621;
BA_ "E2Eprofile" BO_ 429 "AUTOSAR Profile 5";
BA_ "GenMsgSendType" BO_ 429 0;
BA_ "VFrameFormat" BO_ 429 14;
BA_ "DataID" BO_ 430 8622;
BA_ "E2Eprofile" BO_ 430 "AUTOSAR Profile 5";
BA_ "GenMsgSendType" BO_ 430 0;
BA_ "VFrameFormat" BO_ 430 14;
BA_ "DataID" BO_ 431 8623;
BA_ "E2Eprofile" BO_ 431 "AUTOSAR Profile 5";
BA_ "GenMsgSendType" BO_ 431 0;
BA_ "VFrameFormat" BO_ 431 14;
BA_ "GenSigStartValue" SG_ 418 RFC_Obj12_Px 4096;
BA_ "GenSigStartValue" SG_ 418 RFC_Obj12_Py 1024;
BA_ "GenSigStartValue" SG_ 418 RFC_Obj12_Vx 2048;
BA_ "GenSigStartValue" SG_ 418 RFC_Obj12_Vy 512;
BA_ "GenSigStartValue" SG_ 418 RFC_Obj12_Ax 512;
BA_ "GenSigStartValue" SG_ 418 RFC_Obj12_Ay 256;
BA_ "GenSigStartValue" SG_ 418 RFC_Obj12_OrientationYaw 256;
BA_ "GenSigStartValue" SG_ 419 RFC_Obj13_Px 4096;
BA_ "GenSigStartValue" SG_ 419 RFC_Obj13_Py 1024;
BA_ "GenSigStartValue" SG_ 419 RFC_Obj13_Vx 2048;
BA_ "GenSigStartValue" SG_ 419 RFC_Obj13_Vy 512;
BA_ "GenSigStartValue" SG_ 419 RFC_Obj13_Ax 512;
BA_ "GenSigStartValue" SG_ 419 RFC_Obj13_Ay 256;
BA_ "GenSigStartValue" SG_ 419 RFC_Obj13_OrientationYaw 256;
BA_ "GenSigStartValue" SG_ 420 RFC_Obj14_Px 4096;
BA_ "GenSigStartValue" SG_ 420 RFC_Obj14_Py 1024;
BA_ "GenSigStartValue" SG_ 420 RFC_Obj14_Vx 2048;
BA_ "GenSigStartValue" SG_ 420 RFC_Obj14_Vy 512;
BA_ "GenSigStartValue" SG_ 420 RFC_Obj14_Ax 512;
BA_ "GenSigStartValue" SG_ 420 RFC_Obj14_Ay 256;
BA_ "GenSigStartValue" SG_ 420 RFC_Obj14_OrientationYaw 256;
BA_ "GenSigStartValue" SG_ 421 RFC_Obj15_Px 4096;
BA_ "GenSigStartValue" SG_ 421 RFC_Obj15_Py 1024;
BA_ "GenSigStartValue" SG_ 421 RFC_Obj15_Vx 2048;
BA_ "GenSigStartValue" SG_ 421 RFC_Obj15_Vy 512;
BA_ "GenSigStartValue" SG_ 421 RFC_Obj15_Ax 512;
BA_ "GenSigStartValue" SG_ 421 RFC_Obj15_Ay 256;
BA_ "GenSigStartValue" SG_ 421 RFC_Obj15_OrientationYaw 256;
BA_ "GenSigStartValue" SG_ 422 RFC_Obj16_Px 4096;
BA_ "GenSigStartValue" SG_ 422 RFC_Obj16_Py 1024;
BA_ "GenSigStartValue" SG_ 422 RFC_Obj16_Vx 2048;
BA_ "GenSigStartValue" SG_ 422 RFC_Obj16_Vy 512;
BA_ "GenSigStartValue" SG_ 422 RFC_Obj16_Ax 512;
BA_ "GenSigStartValue" SG_ 422 RFC_Obj16_Ay 256;
BA_ "GenSigStartValue" SG_ 422 RFC_Obj16_OrientationYaw 256;
BA_ "GenSigStartValue" SG_ 423 RFC_Obj17_Px 4096;
BA_ "GenSigStartValue" SG_ 423 RFC_Obj17_Py 1024;
BA_ "GenSigStartValue" SG_ 423 RFC_Obj17_Vx 2048;
BA_ "GenSigStartValue" SG_ 423 RFC_Obj17_Vy 512;
BA_ "GenSigStartValue" SG_ 423 RFC_Obj17_Ax 512;
BA_ "GenSigStartValue" SG_ 423 RFC_Obj17_Ay 256;
BA_ "GenSigStartValue" SG_ 423 RFC_Obj17_OrientationYaw 256;
BA_ "GenSigStartValue" SG_ 424 RFC_Obj18_Px 4096;
BA_ "GenSigStartValue" SG_ 424 RFC_Obj18_Py 1024;
BA_ "GenSigStartValue" SG_ 424 RFC_Obj18_Vx 2048;
BA_ "GenSigStartValue" SG_ 424 RFC_Obj18_Vy 512;
BA_ "GenSigStartValue" SG_ 424 RFC_Obj18_Ax 512;
BA_ "GenSigStartValue" SG_ 424 RFC_Obj18_Ay 256;
BA_ "GenSigStartValue" SG_ 424 RFC_Obj18_OrientationYaw 256;
BA_ "GenSigStartValue" SG_ 425 RFC_Obj19_Px 4096;
BA_ "GenSigStartValue" SG_ 425 RFC_Obj19_Py 1024;
BA_ "GenSigStartValue" SG_ 425 RFC_Obj19_Vx 2048;
BA_ "GenSigStartValue" SG_ 425 RFC_Obj19_Vy 512;
BA_ "GenSigStartValue" SG_ 425 RFC_Obj19_Ax 512;
BA_ "GenSigStartValue" SG_ 425 RFC_Obj19_Ay 256;
BA_ "GenSigStartValue" SG_ 425 RFC_Obj19_OrientationYaw 256;
BA_ "GenSigStartValue" SG_ 426 RFC_Obj20_Px 4096;
BA_ "GenSigStartValue" SG_ 426 RFC_Obj20_Py 1024;
BA_ "GenSigStartValue" SG_ 426 RFC_Obj20_Vx 2048;
BA_ "GenSigStartValue" SG_ 426 RFC_Obj20_Vy 512;
BA_ "GenSigStartValue" SG_ 426 RFC_Obj20_Ax 512;
BA_ "GenSigStartValue" SG_ 426 RFC_Obj20_Ay 256;
BA_ "GenSigStartValue" SG_ 426 RFC_Obj20_OrientationYaw 256;
BA_ "GenSigStartValue" SG_ 427 RFC_Obj21_Px 4096;
BA_ "GenSigStartValue" SG_ 427 RFC_Obj21_Py 1024;
BA_ "GenSigStartValue" SG_ 427 RFC_Obj21_Vx 2048;
BA_ "GenSigStartValue" SG_ 427 RFC_Obj21_Vy 512;
BA_ "GenSigStartValue" SG_ 427 RFC_Obj21_Ax 512;
BA_ "GenSigStartValue" SG_ 427 RFC_Obj21_Ay 256;
BA_ "GenSigStartValue" SG_ 427 RFC_Obj21_OrientationYaw 256;
BA_ "GenSigStartValue" SG_ 428 RFC_Obj22_Px 4096;
BA_ "GenSigStartValue" SG_ 428 RFC_Obj22_Py 1024;
BA_ "GenSigStartValue" SG_ 428 RFC_Obj22_Vx 2048;
BA_ "GenSigStartValue" SG_ 428 RFC_Obj22_Vy 512;
BA_ "GenSigStartValue" SG_ 428 RFC_Obj22_Ax 512;
BA_ "GenSigStartValue" SG_ 428 RFC_Obj22_Ay 256;
BA_ "GenSigStartValue" SG_ 428 RFC_Obj22_OrientationYaw 256;
BA_ "GenSigStartValue" SG_ 429 RFC_Obj23_Px 4096;
BA_ "GenSigStartValue" SG_ 429 RFC_Obj23_Py 1024;
BA_ "GenSigStartValue" SG_ 429 RFC_Obj23_Vx 2048;
BA_ "GenSigStartValue" SG_ 429 RFC_Obj23_Vy 512;
BA_ "GenSigStartValue" SG_ 429 RFC_Obj23_Ax 512;
BA_ "GenSigStartValue" SG_ 429 RFC_Obj23_Ay 256;
BA_ "GenSigStartValue" SG_ 429 RFC_Obj23_OrientationYaw 256;
BA_ "GenSigStartValue" SG_ 430 RFC_Obj24_Px 4096;
BA_ "GenSigStartValue" SG_ 430 RFC_Obj24_Py 1024;
BA_ "GenSigStartValue" SG_ 430 RFC_Obj24_Vx 2048;
BA_ "GenSigStartValue" SG_ 430 RFC_Obj24_Vy 512;
BA_ "GenSigStartValue" SG_ 430 RFC_Obj24_Ax 512;
BA_ "GenSigStartValue" SG_ 430 RFC_Obj24_Ay 256;
BA_ "GenSigStartValue" SG_ 430 RFC_Obj24_OrientationYaw 256;
BA_ "GenSigStartValue" SG_ 431 RFC_Obj25_Px 4096;
BA_ "GenSigStartValue" SG_ 431 RFC_Obj25_Py 1024;
BA_ "GenSigStartValue" SG_ 431 RFC_Obj25_Vx 2048;
BA_ "GenSigStartValue" SG_ 431 RFC_Obj25_Vy 512;
BA_ "GenSigStartValue" SG_ 431 RFC_Obj25_Ax 512;
BA_ "GenSigStartValue" SG_ 431 RFC_Obj25_Ay 256;
BA_ "GenSigStartValue" SG_ 431 RFC_Obj25_OrientationYaw 256;
VAL_ 418 RFC_Obj12_ReferencePoint 0 "Front corner left" 1 "Front center" 2 "Front corner right" 3 "Front wheelcase left" 4 "Front wheelcase right" 5 "Side middle left" 6 "Side middle right" 7 "Rear wheelcase left" 8 "Rear wheelcase right" 9 "Rear corner left" 10 "Rear center" 11 "Rear corner right" 12 "Object center" 13 "Rear wheelcase center" 14 "Front wheelcase center" 15 "Invalid" ;
VAL_ 418 RFC_Obj12_MeasurementStatus 0 "not measured" 1 "measured" ;
VAL_ 418 RFC_Obj12_Valid 0 "not valid" 1 "valid" ;
VAL_ 418 RFC_Obj12_BehaviorType 0 "No_Target" 1 "FCTA" 2 "RCTA" 3 "BSD" 4 "LCA" 5 "HWA" 6 "Reserved1" 7 "Reserved2" ;
VAL_ 419 RFC_Obj13_ReferencePoint 0 "Front corner left" 1 "Front center" 2 "Front corner right" 3 "Front wheelcase left" 4 "Front wheelcase right" 5 "Side middle left" 6 "Side middle right" 7 "Rear wheelcase left" 8 "Rear wheelcase right" 9 "Rear corner left" 10 "Rear center" 11 "Rear corner right" 12 "Object center" 13 "Rear wheelcase center" 14 "Front wheelcase center" 15 "Invalid" ;
VAL_ 419 RFC_Obj13_MeasurementStatus 0 "not measured" 1 "measured" ;
VAL_ 419 RFC_Obj13_Valid 0 "not valid" 1 "valid" ;
VAL_ 419 RFC_Obj13_BehaviorType 0 "No_Target" 1 "FCTA" 2 "RCTA" 3 "BSD" 4 "LCA" 5 "HWA" 6 "Reserved1" 7 "Reserved2" ;
VAL_ 420 RFC_Obj14_ReferencePoint 0 "Front corner left" 1 "Front center" 2 "Front corner right" 3 "Front wheelcase left" 4 "Front wheelcase right" 5 "Side middle left" 6 "Side middle right" 7 "Rear wheelcase left" 8 "Rear wheelcase right" 9 "Rear corner left" 10 "Rear center" 11 "Rear corner right" 12 "Object center" 13 "Rear wheelcase center" 14 "Front wheelcase center" 15 "Invalid" ;
VAL_ 420 RFC_Obj14_MeasurementStatus 0 "not measured" 1 "measured" ;
VAL_ 420 RFC_Obj14_Valid 0 "not valid" 1 "valid" ;
VAL_ 420 RFC_Obj14_BehaviorType 0 "No_Target" 1 "FCTA" 2 "RCTA" 3 "BSD" 4 "LCA" 5 "HWA" 6 "Reserved1" 7 "Reserved2" ;
VAL_ 421 RFC_Obj15_ReferencePoint 0 "Front corner left" 1 "Front center" 2 "Front corner right" 3 "Front wheelcase left" 4 "Front wheelcase right" 5 "Side middle left" 6 "Side middle right" 7 "Rear wheelcase left" 8 "Rear wheelcase right" 9 "Rear corner left" 10 "Rear center" 11 "Rear corner right" 12 "Object center" 13 "Rear wheelcase center" 14 "Front wheelcase center" 15 "Invalid" ;
VAL_ 421 RFC_Obj15_MeasurementStatus 0 "not measured" 1 "measured" ;
VAL_ 421 RFC_Obj15_Valid 0 "not valid" 1 "valid" ;
VAL_ 421 RFC_Obj15_BehaviorType 0 "No_Target" 1 "FCTA" 2 "RCTA" 3 "BSD" 4 "LCA" 5 "HWA" 6 "Reserved1" 7 "Reserved2" ;
VAL_ 422 RFC_Obj16_ReferencePoint 0 "Front corner left" 1 "Front center" 2 "Front corner right" 3 "Front wheelcase left" 4 "Front wheelcase right" 5 "Side middle left" 6 "Side middle right" 7 "Rear wheelcase left" 8 "Rear wheelcase right" 9 "Rear corner left" 10 "Rear center" 11 "Rear corner right" 12 "Object center" 13 "Rear wheelcase center" 14 "Front wheelcase center" 15 "Invalid" ;
VAL_ 422 RFC_Obj16_MeasurementStatus 0 "not measured" 1 "measured" ;
VAL_ 422 RFC_Obj16_Valid 0 "not valid" 1 "valid" ;
VAL_ 422 RFC_Obj16_BehaviorType 0 "No_Target" 1 "FCTA" 2 "RCTA" 3 "BSD" 4 "LCA" 5 "HWA" 6 "Reserved1" 7 "Reserved2" ;
VAL_ 423 RFC_Obj17_ReferencePoint 0 "Front corner left" 1 "Front center" 2 "Front corner right" 3 "Front wheelcase left" 4 "Front wheelcase right" 5 "Side middle left" 6 "Side middle right" 7 "Rear wheelcase left" 8 "Rear wheelcase right" 9 "Rear corner left" 10 "Rear center" 11 "Rear corner right" 12 "Object center" 13 "Rear wheelcase center" 14 "Front wheelcase center" 15 "Invalid" ;
VAL_ 423 RFC_Obj17_MeasurementStatus 0 "not measured" 1 "measured" ;
VAL_ 423 RFC_Obj17_Valid 0 "not valid" 1 "valid" ;
VAL_ 423 RFC_Obj17_BehaviorType 0 "No_Target" 1 "FCTA" 2 "RCTA" 3 "BSD" 4 "LCA" 5 "HWA" 6 "Reserved1" 7 "Reserved2" ;
VAL_ 424 RFC_Obj18_ReferencePoint 0 "Front corner left" 1 "Front center" 2 "Front corner right" 3 "Front wheelcase left" 4 "Front wheelcase right" 5 "Side middle left" 6 "Side middle right" 7 "Rear wheelcase left" 8 "Rear wheelcase right" 9 "Rear corner left" 10 "Rear center" 11 "Rear corner right" 12 "Object center" 13 "Rear wheelcase center" 14 "Front wheelcase center" 15 "Invalid" ;
VAL_ 424 RFC_Obj18_MeasurementStatus 0 "not measured" 1 "measured" ;
VAL_ 424 RFC_Obj18_Valid 0 "not valid" 1 "valid" ;
VAL_ 424 RFC_Obj18_BehaviorType 0 "No_Target" 1 "FCTA" 2 "RCTA" 3 "BSD" 4 "LCA" 5 "HWA" 6 "Reserved1" 7 "Reserved2" ;
VAL_ 425 RFC_Obj19_ReferencePoint 0 "Front corner left" 1 "Front center" 2 "Front corner right" 3 "Front wheelcase left" 4 "Front wheelcase right" 5 "Side middle left" 6 "Side middle right" 7 "Rear wheelcase left" 8 "Rear wheelcase right" 9 "Rear corner left" 10 "Rear center" 11 "Rear corner right" 12 "Object center" 13 "Rear wheelcase center" 14 "Front wheelcase center" 15 "Invalid" ;
VAL_ 425 RFC_Obj19_MeasurementStatus 0 "not measured" 1 "measured" ;
VAL_ 425 RFC_Obj19_Valid 0 "not valid" 1 "valid" ;
VAL_ 425 RFC_Obj19_BehaviorType 0 "No_Target" 1 "FCTA" 2 "RCTA" 3 "BSD" 4 "LCA" 5 "HWA" 6 "Reserved1" 7 "Reserved2" ;
VAL_ 426 RFC_Obj20_ReferencePoint 0 "Front corner left" 1 "Front center" 2 "Front corner right" 3 "Front wheelcase left" 4 "Front wheelcase right" 5 "Side middle left" 6 "Side middle right" 7 "Rear wheelcase left" 8 "Rear wheelcase right" 9 "Rear corner left" 10 "Rear center" 11 "Rear corner right" 12 "Object center" 13 "Rear wheelcase center" 14 "Front wheelcase center" 15 "Invalid" ;
VAL_ 426 RFC_Obj20_MeasurementStatus 0 "not measured" 1 "measured" ;
VAL_ 426 RFC_Obj20_Valid 0 "not valid" 1 "valid" ;
VAL_ 426 RFC_Obj20_BehaviorType 0 "No_Target" 1 "FCTA" 2 "RCTA" 3 "BSD" 4 "LCA" 5 "HWA" 6 "Reserved1" 7 "Reserved2" ;
VAL_ 427 RFC_Obj21_ReferencePoint 0 "Front corner left" 1 "Front center" 2 "Front corner right" 3 "Front wheelcase left" 4 "Front wheelcase right" 5 "Side middle left" 6 "Side middle right" 7 "Rear wheelcase left" 8 "Rear wheelcase right" 9 "Rear corner left" 10 "Rear center" 11 "Rear corner right" 12 "Object center" 13 "Rear wheelcase center" 14 "Front wheelcase center" 15 "Invalid" ;
VAL_ 427 RFC_Obj21_MeasurementStatus 0 "not measured" 1 "measured" ;
VAL_ 427 RFC_Obj21_Valid 0 "not valid" 1 "valid" ;
VAL_ 427 RFC_Obj21_BehaviorType 0 "No_Target" 1 "FCTA" 2 "RCTA" 3 "BSD" 4 "LCA" 5 "HWA" 6 "Reserved1" 7 "Reserved2" ;
VAL_ 428 RFC_Obj22_ReferencePoint 0 "Front corner left" 1 "Front center" 2 "Front corner right" 3 "Front wheelcase left" 4 "Front wheelcase right" 5 "Side middle left" 6 "Side middle right" 7 "Rear wheelcase left" 8 "Rear wheelcase right" 9 "Rear corner left" 10 "Rear center" 11 "Rear corner right" 12 "Object center" 13 "Rear wheelcase center" 14 "Front wheelcase center" 15 "Invalid" ;
VAL_ 428 RFC_Obj22_MeasurementStatus 0 "not measured" 1 "measured" ;
VAL_ 428 RFC_Obj22_Valid 0 "not valid" 1 "valid" ;
VAL_ 428 RFC_Obj22_BehaviorType 0 "No_Target" 1 "FCTA" 2 "RCTA" 3 "BSD" 4 "LCA" 5 "HWA" 6 "Reserved1" 7 "Reserved2" ;
VAL_ 429 RFC_Obj23_ReferencePoint 0 "Front corner left" 1 "Front center" 2 "Front corner right" 3 "Front wheelcase left" 4 "Front wheelcase right" 5 "Side middle left" 6 "Side middle right" 7 "Rear wheelcase left" 8 "Rear wheelcase right" 9 "Rear corner left" 10 "Rear center" 11 "Rear corner right" 12 "Object center" 13 "Rear wheelcase center" 14 "Front wheelcase center" 15 "Invalid" ;
VAL_ 429 RFC_Obj23_MeasurementStatus 0 "not measured" 1 "measured" ;
VAL_ 429 RFC_Obj23_Valid 0 "not valid" 1 "valid" ;
VAL_ 429 RFC_Obj23_BehaviorType 0 "No_Target" 1 "FCTA" 2 "RCTA" 3 "BSD" 4 "LCA" 5 "HWA" 6 "Reserved1" 7 "Reserved2" ;
VAL_ 430 RFC_Obj24_ReferencePoint 0 "Front corner left" 1 "Front center" 2 "Front corner right" 3 "Front wheelcase left" 4 "Front wheelcase right" 5 "Side middle left" 6 "Side middle right" 7 "Rear wheelcase left" 8 "Rear wheelcase right" 9 "Rear corner left" 10 "Rear center" 11 "Rear corner right" 12 "Object center" 13 "Rear wheelcase center" 14 "Front wheelcase center" 15 "Invalid" ;
VAL_ 430 RFC_Obj24_MeasurementStatus 0 "not measured" 1 "measured" ;
VAL_ 430 RFC_Obj24_Valid 0 "not valid" 1 "valid" ;
VAL_ 430 RFC_Obj24_BehaviorType 0 "No_Target" 1 "FCTA" 2 "RCTA" 3 "BSD" 4 "LCA" 5 "HWA" 6 "Reserved1" 7 "Reserved2" ;
VAL_ 431 RFC_Obj25_ReferencePoint 0 "Front corner left" 1 "Front center" 2 "Front corner right" 3 "Front wheelcase left" 4 "Front wheelcase right" 5 "Side middle left" 6 "Side middle right" 7 "Rear wheelcase left" 8 "Rear wheelcase right" 9 "Rear corner left" 10 "Rear center" 11 "Rear corner right" 12 "Object center" 13 "Rear wheelcase center" 14 "Front wheelcase center" 15 "Invalid" ;
VAL_ 431 RFC_Obj25_MeasurementStatus 0 "not measured" 1 "measured" ;
VAL_ 431 RFC_Obj25_Valid 0 "not valid" 1 "valid" ;
VAL_ 431 RFC_Obj25_BehaviorType 0 "No_Target" 1 "FCTA" 2 "RCTA" 3 "BSD" 4 "LCA" 5 "HWA" 6 "Reserved1" 7 "Reserved2" ;
SIG_GROUP_ 418 SG_RFC_Obj12 1 : RFC_Obj12_CRC RFC_Obj12_AliveCtr RFC_Obj12_ProtBlockCtr RFC_Obj12_ReferencePoint RFC_Obj12_ObjId RFC_Obj12_MeasurementStatus RFC_Obj12_Px RFC_Obj12_Py RFC_Obj12_PxVnce RFC_Obj12_PyVnce RFC_Obj12_Vx RFC_Obj12_Vy RFC_Obj12_Ax RFC_Obj12_Ay RFC_Obj12_OrientationYaw RFC_Obj12_ExistProb RFC_Obj12_VxVnce RFC_Obj12_VyVnce RFC_Obj12_AxVnce RFC_Obj12_AyVnce RFC_Obj12_OrientationYawVnce RFC_Obj12_MovingObserved RFC_Obj12_MovingProbability RFC_Obj12_Length RFC_Obj12_Valid RFC_Obj12_LengthVnce RFC_Obj12_WidthVnce RFC_Obj12_Width RFC_Obj12_BehaviorType RFC_Obj12_ObstacleConf RFC_Obj12_NonObstacleConf RFC_Obj12_PxPyCoVnce RFC_Obj12_PxVxCoVnce RFC_Obj12_PxVyCoVnce RFC_Obj12_PyVxCoVnce RFC_Obj12_PyVyCoVnce RFC_Obj12_VxVyCoVnce RFC_Obj12_PxAxCoVnce RFC_Obj12_PxAyCoVnce RFC_Obj12_PyAxCoVnce RFC_Obj12_PyAyCoVnce RFC_Obj12_VxAxCoVnce RFC_Obj12_VxAyCoVnce RFC_Obj12_VyAxCoVnce RFC_Obj12_VyAyCoVnce RFC_Obj12_AxAyCoVnce RFC_Obj12_MobileObstConf RFC_Obj12_Mob4PlusWhlConf RFC_Obj12_Mob2WhlConf RFC_Obj12_MobPedConf RFC_Obj12_FourPlusWhlCarConf RFC_Obj12_FourPlusWhlHGVConf RFC_Obj12_GroundReflexConf RFC_Obj12_StatObstConf RFC_Obj12_StatBarrierConf;
SIG_GROUP_ 419 SG_RFC_Obj13 1 : RFC_Obj13_CRC RFC_Obj13_AliveCtr RFC_Obj13_ProtBlockCtr RFC_Obj13_ReferencePoint RFC_Obj13_ObjId RFC_Obj13_MeasurementStatus RFC_Obj13_Px RFC_Obj13_Py RFC_Obj13_PxVnce RFC_Obj13_PyVnce RFC_Obj13_Vx RFC_Obj13_Vy RFC_Obj13_Ax RFC_Obj13_Ay RFC_Obj13_OrientationYaw RFC_Obj13_ExistProb RFC_Obj13_VxVnce RFC_Obj13_VyVnce RFC_Obj13_AxVnce RFC_Obj13_AyVnce RFC_Obj13_OrientationYawVnce RFC_Obj13_MovingObserved RFC_Obj13_MovingProbability RFC_Obj13_Length RFC_Obj13_Valid RFC_Obj13_LengthVnce RFC_Obj13_WidthVnce RFC_Obj13_Width RFC_Obj13_BehaviorType RFC_Obj13_ObstacleConf RFC_Obj13_NonObstacleConf RFC_Obj13_PxPyCoVnce RFC_Obj13_PxVxCoVnce RFC_Obj13_PxVyCoVnce RFC_Obj13_PyVxCoVnce RFC_Obj13_PyVyCoVnce RFC_Obj13_VxVyCoVnce RFC_Obj13_PxAxCoVnce RFC_Obj13_PxAyCoVnce RFC_Obj13_PyAxCoVnce RFC_Obj13_PyAyCoVnce RFC_Obj13_VxAxCoVnce RFC_Obj13_VxAyCoVnce RFC_Obj13_VyAxCoVnce RFC_Obj13_VyAyCoVnce RFC_Obj13_AxAyCoVnce RFC_Obj13_MobileObstConf RFC_Obj13_Mob4PlusWhlConf RFC_Obj13_Mob2WhlConf RFC_Obj13_MobPedConf RFC_Obj13_FourPlusWhlCarConf RFC_Obj13_FourPlusWhlHGVConf RFC_Obj13_GroundReflexConf RFC_Obj13_StatObstConf RFC_Obj13_StatBarrierConf;
SIG_GROUP_ 420 SG_RFC_Obj14 1 : RFC_Obj14_CRC RFC_Obj14_AliveCtr RFC_Obj14_ProtBlockCtr RFC_Obj14_ReferencePoint RFC_Obj14_ObjId RFC_Obj14_MeasurementStatus RFC_Obj14_Px RFC_Obj14_Py RFC_Obj14_PxVnce RFC_Obj14_PyVnce RFC_Obj14_Vx RFC_Obj14_Vy RFC_Obj14_Ax RFC_Obj14_Ay RFC_Obj14_OrientationYaw RFC_Obj14_ExistProb RFC_Obj14_VxVnce RFC_Obj14_VyVnce RFC_Obj14_AxVnce RFC_Obj14_AyVnce RFC_Obj14_OrientationYawVnce RFC_Obj14_MovingObserved RFC_Obj14_MovingProbability RFC_Obj14_Length RFC_Obj14_Valid RFC_Obj14_LengthVnce RFC_Obj14_WidthVnce RFC_Obj14_Width RFC_Obj14_BehaviorType RFC_Obj14_ObstacleConf RFC_Obj14_NonObstacleConf RFC_Obj14_PxPyCoVnce RFC_Obj14_PxVxCoVnce RFC_Obj14_PxVyCoVnce RFC_Obj14_PyVxCoVnce RFC_Obj14_PyVyCoVnce RFC_Obj14_VxVyCoVnce RFC_Obj14_PxAxCoVnce RFC_Obj14_PxAyCoVnce RFC_Obj14_PyAxCoVnce RFC_Obj14_PyAyCoVnce RFC_Obj14_VxAxCoVnce RFC_Obj14_VxAyCoVnce RFC_Obj14_VyAxCoVnce RFC_Obj14_VyAyCoVnce RFC_Obj14_AxAyCoVnce RFC_Obj14_MobileObstConf RFC_Obj14_Mob4PlusWhlConf RFC_Obj14_Mob2WhlConf RFC_Obj14_MobPedConf RFC_Obj14_FourPlusWhlCarConf RFC_Obj14_FourPlusWhlHGVConf RFC_Obj14_GroundReflexConf RFC_Obj14_StatObstConf RFC_Obj14_StatBarrierConf;
SIG_GROUP_ 421 SG_RFC_Obj15 1 : RFC_Obj15_CRC RFC_Obj15_AliveCtr RFC_Obj15_ProtBlockCtr RFC_Obj15_ReferencePoint RFC_Obj15_ObjId RFC_Obj15_MeasurementStatus RFC_Obj15_Px RFC_Obj15_Py RFC_Obj15_PxVnce RFC_Obj15_PyVnce RFC_Obj15_Vx RFC_Obj15_Vy RFC_Obj15_Ax RFC_Obj15_Ay RFC_Obj15_OrientationYaw RFC_Obj15_ExistProb RFC_Obj15_VxVnce RFC_Obj15_VyVnce RFC_Obj15_AxVnce RFC_Obj15_AyVnce RFC_Obj15_OrientationYawVnce RFC_Obj15_MovingObserved RFC_Obj15_MovingProbability RFC_Obj15_Length RFC_Obj15_Valid RFC_Obj15_LengthVnce RFC_Obj15_WidthVnce RFC_Obj15_Width RFC_Obj15_BehaviorType RFC_Obj15_ObstacleConf RFC_Obj15_NonObstacleConf RFC_Obj15_PxPyCoVnce RFC_Obj15_PxVxCoVnce RFC_Obj15_PxVyCoVnce RFC_Obj15_PyVxCoVnce RFC_Obj15_PyVyCoVnce RFC_Obj15_VxVyCoVnce RFC_Obj15_PxAxCoVnce RFC_Obj15_PxAyCoVnce RFC_Obj15_PyAxCoVnce RFC_Obj15_PyAyCoVnce RFC_Obj15_VxAxCoVnce RFC_Obj15_VxAyCoVnce RFC_Obj15_VyAxCoVnce RFC_Obj15_VyAyCoVnce RFC_Obj15_AxAyCoVnce RFC_Obj15_MobileObstConf RFC_Obj15_Mob4PlusWhlConf RFC_Obj15_Mob2WhlConf RFC_Obj15_MobPedConf RFC_Obj15_FourPlusWhlCarConf RFC_Obj15_FourPlusWhlHGVConf RFC_Obj15_GroundReflexConf RFC_Obj15_StatObstConf RFC_Obj15_StatBarrierConf;
SIG_GROUP_ 422 SG_RFC_Obj16 1 : RFC_Obj16_CRC RFC_Obj16_AliveCtr RFC_Obj16_ProtBlockCtr RFC_Obj16_ReferencePoint RFC_Obj16_ObjId RFC_Obj16_MeasurementStatus RFC_Obj16_Px RFC_Obj16_Py RFC_Obj16_PxVnce RFC_Obj16_PyVnce RFC_Obj16_Vx RFC_Obj16_Vy RFC_Obj16_Ax RFC_Obj16_Ay RFC_Obj16_OrientationYaw RFC_Obj16_ExistProb RFC_Obj16_VxVnce RFC_Obj16_VyVnce RFC_Obj16_AxVnce RFC_Obj16_AyVnce RFC_Obj16_OrientationYawVnce RFC_Obj16_MovingObserved RFC_Obj16_MovingProbability RFC_Obj16_Length RFC_Obj16_Valid RFC_Obj16_LengthVnce RFC_Obj16_WidthVnce RFC_Obj16_Width RFC_Obj16_BehaviorType RFC_Obj16_ObstacleConf RFC_Obj16_NonObstacleConf RFC_Obj16_PxPyCoVnce RFC_Obj16_PxVxCoVnce RFC_Obj16_PxVyCoVnce RFC_Obj16_PyVxCoVnce RFC_Obj16_PyVyCoVnce RFC_Obj16_VxVyCoVnce RFC_Obj16_PxAxCoVnce RFC_Obj16_PxAyCoVnce RFC_Obj16_PyAxCoVnce RFC_Obj16_PyAyCoVnce RFC_Obj16_VxAxCoVnce RFC_Obj16_VxAyCoVnce RFC_Obj16_VyAxCoVnce RFC_Obj16_VyAyCoVnce RFC_Obj16_AxAyCoVnce RFC_Obj16_MobileObstConf RFC_Obj16_Mob4PlusWhlConf RFC_Obj16_Mob2WhlConf RFC_Obj16_MobPedConf RFC_Obj16_FourPlusWhlCarConf RFC_Obj16_FourPlusWhlHGVConf RFC_Obj16_GroundReflexConf RFC_Obj16_StatObstConf RFC_Obj16_StatBarrierConf;
SIG_GROUP_ 423 SG_RFC_Obj17 1 : RFC_Obj17_CRC RFC_Obj17_AliveCtr RFC_Obj17_ProtBlockCtr RFC_Obj17_ReferencePoint RFC_Obj17_ObjId RFC_Obj17_MeasurementStatus RFC_Obj17_Px RFC_Obj17_Py RFC_Obj17_PxVnce RFC_Obj17_PyVnce RFC_Obj17_Vx RFC_Obj17_Vy RFC_Obj17_Ax RFC_Obj17_Ay RFC_Obj17_OrientationYaw RFC_Obj17_ExistProb RFC_Obj17_VxVnce RFC_Obj17_VyVnce RFC_Obj17_AxVnce RFC_Obj17_AyVnce RFC_Obj17_OrientationYawVnce RFC_Obj17_MovingObserved RFC_Obj17_MovingProbability RFC_Obj17_Length RFC_Obj17_Valid RFC_Obj17_LengthVnce RFC_Obj17_WidthVnce RFC_Obj17_Width RFC_Obj17_BehaviorType RFC_Obj17_ObstacleConf RFC_Obj17_NonObstacleConf RFC_Obj17_PxPyCoVnce RFC_Obj17_PxVxCoVnce RFC_Obj17_PxVyCoVnce RFC_Obj17_PyVxCoVnce RFC_Obj17_PyVyCoVnce RFC_Obj17_VxVyCoVnce RFC_Obj17_PxAxCoVnce RFC_Obj17_PxAyCoVnce RFC_Obj17_PyAxCoVnce RFC_Obj17_PyAyCoVnce RFC_Obj17_VxAxCoVnce RFC_Obj17_VxAyCoVnce RFC_Obj17_VyAxCoVnce RFC_Obj17_VyAyCoVnce RFC_Obj17_AxAyCoVnce RFC_Obj17_MobileObstConf RFC_Obj17_Mob4PlusWhlConf RFC_Obj17_Mob2WhlConf RFC_Obj17_MobPedConf RFC_Obj17_FourPlusWhlCarConf RFC_Obj17_FourPlusWhlHGVConf RFC_Obj17_GroundReflexConf RFC_Obj17_StatObstConf RFC_Obj17_StatBarrierConf;
SIG_GROUP_ 424 SG_RFC_Obj18 1 : RFC_Obj18_CRC RFC_Obj18_AliveCtr RFC_Obj18_ProtBlockCtr RFC_Obj18_ReferencePoint RFC_Obj18_ObjId RFC_Obj18_MeasurementStatus RFC_Obj18_Px RFC_Obj18_Py RFC_Obj18_PxVnce RFC_Obj18_PyVnce RFC_Obj18_Vx RFC_Obj18_Vy RFC_Obj18_Ax RFC_Obj18_Ay RFC_Obj18_OrientationYaw RFC_Obj18_ExistProb RFC_Obj18_VxVnce RFC_Obj18_VyVnce RFC_Obj18_AxVnce RFC_Obj18_AyVnce RFC_Obj18_OrientationYawVnce RFC_Obj18_MovingObserved RFC_Obj18_MovingProbability RFC_Obj18_Length RFC_Obj18_Valid RFC_Obj18_LengthVnce RFC_Obj18_WidthVnce RFC_Obj18_Width RFC_Obj18_BehaviorType RFC_Obj18_ObstacleConf RFC_Obj18_NonObstacleConf RFC_Obj18_PxPyCoVnce RFC_Obj18_PxVxCoVnce RFC_Obj18_PxVyCoVnce RFC_Obj18_PyVxCoVnce RFC_Obj18_PyVyCoVnce RFC_Obj18_VxVyCoVnce RFC_Obj18_PxAxCoVnce RFC_Obj18_PxAyCoVnce RFC_Obj18_PyAxCoVnce RFC_Obj18_PyAyCoVnce RFC_Obj18_VxAxCoVnce RFC_Obj18_VxAyCoVnce RFC_Obj18_VyAxCoVnce RFC_Obj18_VyAyCoVnce RFC_Obj18_AxAyCoVnce RFC_Obj18_MobileObstConf RFC_Obj18_Mob4PlusWhlConf RFC_Obj18_Mob2WhlConf RFC_Obj18_MobPedConf RFC_Obj18_FourPlusWhlCarConf RFC_Obj18_FourPlusWhlHGVConf RFC_Obj18_GroundReflexConf RFC_Obj18_StatObstConf RFC_Obj18_StatBarrierConf;
SIG_GROUP_ 425 SG_RFC_Obj19 1 : RFC_Obj19_CRC RFC_Obj19_AliveCtr RFC_Obj19_ProtBlockCtr RFC_Obj19_ReferencePoint RFC_Obj19_ObjId RFC_Obj19_MeasurementStatus RFC_Obj19_Px RFC_Obj19_Py RFC_Obj19_PxVnce RFC_Obj19_PyVnce RFC_Obj19_Vx RFC_Obj19_Vy RFC_Obj19_Ax RFC_Obj19_Ay RFC_Obj19_OrientationYaw RFC_Obj19_ExistProb RFC_Obj19_VxVnce RFC_Obj19_VyVnce RFC_Obj19_AxVnce RFC_Obj19_AyVnce RFC_Obj19_OrientationYawVnce RFC_Obj19_MovingObserved RFC_Obj19_MovingProbability RFC_Obj19_Length RFC_Obj19_Valid RFC_Obj19_LengthVnce RFC_Obj19_WidthVnce RFC_Obj19_Width RFC_Obj19_BehaviorType RFC_Obj19_ObstacleConf RFC_Obj19_NonObstacleConf RFC_Obj19_PxPyCoVnce RFC_Obj19_PxVxCoVnce RFC_Obj19_PxVyCoVnce RFC_Obj19_PyVxCoVnce RFC_Obj19_PyVyCoVnce RFC_Obj19_VxVyCoVnce RFC_Obj19_PxAxCoVnce RFC_Obj19_PxAyCoVnce RFC_Obj19_PyAxCoVnce RFC_Obj19_PyAyCoVnce RFC_Obj19_VxAxCoVnce RFC_Obj19_VxAyCoVnce RFC_Obj19_VyAxCoVnce RFC_Obj19_VyAyCoVnce RFC_Obj19_AxAyCoVnce RFC_Obj19_MobileObstConf RFC_Obj19_Mob4PlusWhlConf RFC_Obj19_Mob2WhlConf RFC_Obj19_MobPedConf RFC_Obj19_FourPlusWhlCarConf RFC_Obj19_FourPlusWhlHGVConf RFC_Obj19_GroundReflexConf RFC_Obj19_StatObstConf RFC_Obj19_StatBarrierConf;
SIG_GROUP_ 426 SG_RFC_Obj20 1 : RFC_Obj20_CRC RFC_Obj20_AliveCtr RFC_Obj20_ProtBlockCtr RFC_Obj20_ReferencePoint RFC_Obj20_ObjId RFC_Obj20_MeasurementStatus RFC_Obj20_Px RFC_Obj20_Py RFC_Obj20_PxVnce RFC_Obj20_PyVnce RFC_Obj20_Vx RFC_Obj20_Vy RFC_Obj20_Ax RFC_Obj20_Ay RFC_Obj20_OrientationYaw RFC_Obj20_ExistProb RFC_Obj20_VxVnce RFC_Obj20_VyVnce RFC_Obj20_AxVnce RFC_Obj20_AyVnce RFC_Obj20_OrientationYawVnce RFC_Obj20_MovingObserved RFC_Obj20_MovingProbability RFC_Obj20_Length RFC_Obj20_Valid RFC_Obj20_LengthVnce RFC_Obj20_WidthVnce RFC_Obj20_Width RFC_Obj20_BehaviorType RFC_Obj20_ObstacleConf RFC_Obj20_NonObstacleConf RFC_Obj20_PxPyCoVnce RFC_Obj20_PxVxCoVnce RFC_Obj20_PxVyCoVnce RFC_Obj20_PyVxCoVnce RFC_Obj20_PyVyCoVnce RFC_Obj20_VxVyCoVnce RFC_Obj20_PxAxCoVnce RFC_Obj20_PxAyCoVnce RFC_Obj20_PyAxCoVnce RFC_Obj20_PyAyCoVnce RFC_Obj20_VxAxCoVnce RFC_Obj20_VxAyCoVnce RFC_Obj20_VyAxCoVnce RFC_Obj20_VyAyCoVnce RFC_Obj20_AxAyCoVnce RFC_Obj20_MobileObstConf RFC_Obj20_Mob4PlusWhlConf RFC_Obj20_Mob2WhlConf RFC_Obj20_MobPedConf RFC_Obj20_FourPlusWhlCarConf RFC_Obj20_FourPlusWhlHGVConf RFC_Obj20_GroundReflexConf RFC_Obj20_StatObstConf RFC_Obj20_StatBarrierConf;
SIG_GROUP_ 427 SG_RFC_Obj21 1 : RFC_Obj21_CRC RFC_Obj21_AliveCtr RFC_Obj21_ProtBlockCtr RFC_Obj21_ReferencePoint RFC_Obj21_ObjId RFC_Obj21_MeasurementStatus RFC_Obj21_Px RFC_Obj21_Py RFC_Obj21_PxVnce RFC_Obj21_PyVnce RFC_Obj21_Vx RFC_Obj21_Vy RFC_Obj21_Ax RFC_Obj21_Ay RFC_Obj21_OrientationYaw RFC_Obj21_ExistProb RFC_Obj21_VxVnce RFC_Obj21_VyVnce RFC_Obj21_AxVnce RFC_Obj21_AyVnce RFC_Obj21_OrientationYawVnce RFC_Obj21_MovingObserved RFC_Obj21_MovingProbability RFC_Obj21_Length RFC_Obj21_Valid RFC_Obj21_LengthVnce RFC_Obj21_WidthVnce RFC_Obj21_Width RFC_Obj21_BehaviorType RFC_Obj21_ObstacleConf RFC_Obj21_NonObstacleConf RFC_Obj21_PxPyCoVnce RFC_Obj21_PxVxCoVnce RFC_Obj21_PxVyCoVnce RFC_Obj21_PyVxCoVnce RFC_Obj21_PyVyCoVnce RFC_Obj21_VxVyCoVnce RFC_Obj21_PxAxCoVnce RFC_Obj21_PxAyCoVnce RFC_Obj21_PyAxCoVnce RFC_Obj21_PyAyCoVnce RFC_Obj21_VxAxCoVnce RFC_Obj21_VxAyCoVnce RFC_Obj21_VyAxCoVnce RFC_Obj21_VyAyCoVnce RFC_Obj21_AxAyCoVnce RFC_Obj21_MobileObstConf RFC_Obj21_Mob4PlusWhlConf RFC_Obj21_Mob2WhlConf RFC_Obj21_MobPedConf RFC_Obj21_FourPlusWhlCarConf RFC_Obj21_FourPlusWhlHGVConf RFC_Obj21_GroundReflexConf RFC_Obj21_StatObstConf RFC_Obj21_StatBarrierConf;
SIG_GROUP_ 428 SG_RFC_Obj22 1 : RFC_Obj22_CRC RFC_Obj22_AliveCtr RFC_Obj22_ProtBlockCtr RFC_Obj22_ReferencePoint RFC_Obj22_ObjId RFC_Obj22_MeasurementStatus RFC_Obj22_Px RFC_Obj22_Py RFC_Obj22_PxVnce RFC_Obj22_PyVnce RFC_Obj22_Vx RFC_Obj22_Vy RFC_Obj22_Ax RFC_Obj22_Ay RFC_Obj22_OrientationYaw RFC_Obj22_ExistProb RFC_Obj22_VxVnce RFC_Obj22_VyVnce RFC_Obj22_AxVnce RFC_Obj22_AyVnce RFC_Obj22_OrientationYawVnce RFC_Obj22_MovingObserved RFC_Obj22_MovingProbability RFC_Obj22_Length RFC_Obj22_Valid RFC_Obj22_LengthVnce RFC_Obj22_WidthVnce RFC_Obj22_Width RFC_Obj22_BehaviorType RFC_Obj22_ObstacleConf RFC_Obj22_NonObstacleConf RFC_Obj22_PxPyCoVnce RFC_Obj22_PxVxCoVnce RFC_Obj22_PxVyCoVnce RFC_Obj22_PyVxCoVnce RFC_Obj22_PyVyCoVnce RFC_Obj22_VxVyCoVnce RFC_Obj22_PxAxCoVnce RFC_Obj22_PxAyCoVnce RFC_Obj22_PyAxCoVnce RFC_Obj22_PyAyCoVnce RFC_Obj22_VxAxCoVnce RFC_Obj22_VxAyCoVnce RFC_Obj22_VyAxCoVnce RFC_Obj22_VyAyCoVnce RFC_Obj22_AxAyCoVnce RFC_Obj22_MobileObstConf RFC_Obj22_Mob4PlusWhlConf RFC_Obj22_Mob2WhlConf RFC_Obj22_MobPedConf RFC_Obj22_FourPlusWhlCarConf RFC_Obj22_FourPlusWhlHGVConf RFC_Obj22_GroundReflexConf RFC_Obj22_StatObstConf RFC_Obj22_StatBarrierConf;
SIG_GROUP_ 429 SG_RFC_Obj23 1 : RFC_Obj23_CRC RFC_Obj23_AliveCtr RFC_Obj23_ProtBlockCtr RFC_Obj23_ReferencePoint RFC_Obj23_ObjId RFC_Obj23_MeasurementStatus RFC_Obj23_Px RFC_Obj23_Py RFC_Obj23_PxVnce RFC_Obj23_PyVnce RFC_Obj23_Vx RFC_Obj23_Vy RFC_Obj23_Ax RFC_Obj23_Ay RFC_Obj23_OrientationYaw RFC_Obj23_ExistProb RFC_Obj23_VxVnce RFC_Obj23_VyVnce RFC_Obj23_AxVnce RFC_Obj23_AyVnce RFC_Obj23_OrientationYawVnce RFC_Obj23_MovingObserved RFC_Obj23_MovingProbability RFC_Obj23_Length RFC_Obj23_Valid RFC_Obj23_LengthVnce RFC_Obj23_WidthVnce RFC_Obj23_Width RFC_Obj23_BehaviorType RFC_Obj23_ObstacleConf RFC_Obj23_NonObstacleConf RFC_Obj23_PxPyCoVnce RFC_Obj23_PxVxCoVnce RFC_Obj23_PxVyCoVnce RFC_Obj23_PyVxCoVnce RFC_Obj23_PyVyCoVnce RFC_Obj23_VxVyCoVnce RFC_Obj23_PxAxCoVnce RFC_Obj23_PxAyCoVnce RFC_Obj23_PyAxCoVnce RFC_Obj23_PyAyCoVnce RFC_Obj23_VxAxCoVnce RFC_Obj23_VxAyCoVnce RFC_Obj23_VyAxCoVnce RFC_Obj23_VyAyCoVnce RFC_Obj23_AxAyCoVnce RFC_Obj23_MobileObstConf RFC_Obj23_Mob4PlusWhlConf RFC_Obj23_Mob2WhlConf RFC_Obj23_MobPedConf RFC_Obj23_FourPlusWhlCarConf RFC_Obj23_FourPlusWhlHGVConf RFC_Obj23_GroundReflexConf RFC_Obj23_StatObstConf RFC_Obj23_StatBarrierConf;
SIG_GROUP_ 430 SG_RFC_Obj24 1 : RFC_Obj24_CRC RFC_Obj24_AliveCtr RFC_Obj24_ProtBlockCtr RFC_Obj24_ReferencePoint RFC_Obj24_ObjId RFC_Obj24_MeasurementStatus RFC_Obj24_Px RFC_Obj24_Py RFC_Obj24_PxVnce RFC_Obj24_PyVnce RFC_Obj24_Vx RFC_Obj24_Vy RFC_Obj24_Ax RFC_Obj24_Ay RFC_Obj24_OrientationYaw RFC_Obj24_ExistProb RFC_Obj24_VxVnce RFC_Obj24_VyVnce RFC_Obj24_AxVnce RFC_Obj24_AyVnce RFC_Obj24_OrientationYawVnce RFC_Obj24_MovingObserved RFC_Obj24_MovingProbability RFC_Obj24_Length RFC_Obj24_Valid RFC_Obj24_LengthVnce RFC_Obj24_WidthVnce RFC_Obj24_Width RFC_Obj24_BehaviorType RFC_Obj24_ObstacleConf RFC_Obj24_NonObstacleConf RFC_Obj24_PxPyCoVnce RFC_Obj24_PxVxCoVnce RFC_Obj24_PxVyCoVnce RFC_Obj24_PyVxCoVnce RFC_Obj24_PyVyCoVnce RFC_Obj24_VxVyCoVnce RFC_Obj24_PxAxCoVnce RFC_Obj24_PxAyCoVnce RFC_Obj24_PyAxCoVnce RFC_Obj24_PyAyCoVnce RFC_Obj24_VxAxCoVnce RFC_Obj24_VxAyCoVnce RFC_Obj24_VyAxCoVnce RFC_Obj24_VyAyCoVnce RFC_Obj24_AxAyCoVnce RFC_Obj24_MobileObstConf RFC_Obj24_Mob4PlusWhlConf RFC_Obj24_Mob2WhlConf RFC_Obj24_MobPedConf RFC_Obj24_FourPlusWhlCarConf RFC_Obj24_FourPlusWhlHGVConf RFC_Obj24_GroundReflexConf RFC_Obj24_StatObstConf RFC_Obj24_StatBarrierConf;
SIG_GROUP_ 431 SG_RFC_Obj25 1 : RFC_Obj25_CRC RFC_Obj25_AliveCtr RFC_Obj25_ProtBlockCtr RFC_Obj25_ReferencePoint RFC_Obj25_ObjId RFC_Obj25_MeasurementStatus RFC_Obj25_Px RFC_Obj25_Py RFC_Obj25_PxVnce RFC_Obj25_PyVnce RFC_Obj25_Vx RFC_Obj25_Vy RFC_Obj25_Ax RFC_Obj25_Ay RFC_Obj25_OrientationYaw RFC_Obj25_ExistProb RFC_Obj25_VxVnce RFC_Obj25_VyVnce RFC_Obj25_AxVnce RFC_Obj25_AyVnce RFC_Obj25_OrientationYawVnce RFC_Obj25_MovingObserved RFC_Obj25_MovingProbability RFC_Obj25_Length RFC_Obj25_Valid RFC_Obj25_LengthVnce RFC_Obj25_WidthVnce RFC_Obj25_Width RFC_Obj25_BehaviorType RFC_Obj25_ObstacleConf RFC_Obj25_NonObstacleConf RFC_Obj25_PxPyCoVnce RFC_Obj25_PxVxCoVnce RFC_Obj25_PxVyCoVnce RFC_Obj25_PyVxCoVnce RFC_Obj25_PyVyCoVnce RFC_Obj25_VxVyCoVnce RFC_Obj25_PxAxCoVnce RFC_Obj25_PxAyCoVnce RFC_Obj25_PyAxCoVnce RFC_Obj25_PyAyCoVnce RFC_Obj25_VxAxCoVnce RFC_Obj25_VxAyCoVnce RFC_Obj25_VyAxCoVnce RFC_Obj25_VyAyCoVnce RFC_Obj25_AxAyCoVnce RFC_Obj25_MobileObstConf RFC_Obj25_Mob4PlusWhlConf RFC_Obj25_Mob2WhlConf RFC_Obj25_MobPedConf RFC_Obj25_FourPlusWhlCarConf RFC_Obj25_FourPlusWhlHGVConf RFC_Obj25_GroundReflexConf RFC_Obj25_StatObstConf RFC_Obj25_StatBarrierConf;
