VERSION "created by canmatrix"

NS_ :

BS_:

BU_: RadarFrontCenter VideoFrontCenter DASy ReceiveECU

BO_ 307 RFC_Location_129_131: 64 RadarFrontCenter
 SG_ RFC_Loc129_131_CRC : 0|16@1+ (1,0) [0|65535] ""  DASy
 SG_ RFC_Loc129_131_AliveCtr : 16|8@1+ (1,0) [0|255] ""  DASy
 SG_ RFC_Loc129_131_ProtBlockCtr : 24|4@1+ (1,0) [0|15] ""  DASy
 SG_ RFC_Loc129_RadialDistance : 32|15@1+ (0.01,0) [0|327.67] "m"  DASy
 SG_ RFC_Loc129_RadialVelocity : 47|15@1+ (0.01,-163.84) [-110|55] "m/s"  DASy
 SG_ RFC_Loc129_Elevation : 62|10@1+ (0.1,-51.2) [-45|45] "deg"  DASy
 SG_ RFC_Loc129_Azimuth : 72|11@1+ (0.1,-102.4) [-90|90] "deg"  DASy
 SG_ RFC_Loc129_DistVelocityCoVnce : 83|11@1+ (0.0001,-0.1024) [-0.1024|0.1023] "m^2/s"  DASy
 SG_ RFC_Loc129_RadialDistanceVnce : 94|10@1+ (5E-005,0) [0|0.05115] "m^2"  DASy
 SG_ RFC_Loc129_RadialVelocityVnce : 104|10@1+ (0.0001,0) [0|0.1023] "m^2/s^2"  DASy
 SG_ RFC_Loc129_ElevationVnce : 114|10@1+ (0.001,0) [0|1.023] "deg^2"  DASy
 SG_ RFC_Loc129_AzimuthVnce : 124|10@1+ (0.001,0) [0|1.023] "deg^2"  DASy
 SG_ RFC_Loc129_RadarCrossSection : 134|10@1+ (0.2,-102.4) [-50|70] "dBsm"  DASy
 SG_ RFC_Loc129_DistVelocityQuality : 144|8@1+ (1,0) [0|255] "unitless"  DASy
 SG_ RFC_Loc129_ElevationQuality : 152|8@1+ (1,0) [0|255] "unitless"  DASy
 SG_ RFC_Loc129_AzimuthQuality : 160|8@1+ (1,0) [0|255] "unitless"  DASy
 SG_ RFC_Loc129_RSSI : 168|10@1+ (0.1,0) [0|100] "unitless"  DASy
 SG_ RFC_Loc129_AzimuthalPartnerId : 178|10@1+ (1,0) [0|1023] "unitless"  DASy
 SG_ RFC_Loc130_RadialDistance : 192|15@1+ (0.01,0) [0|327.67] "m"  DASy
 SG_ RFC_Loc130_RadialVelocity : 207|15@1+ (0.01,-163.84) [-110|55] "m/s"  DASy
 SG_ RFC_Loc130_Elevation : 222|10@1+ (0.1,-51.2) [-45|45] "deg"  DASy
 SG_ RFC_Loc130_Azimuth : 232|11@1+ (0.1,-102.4) [-90|90] "deg"  DASy
 SG_ RFC_Loc130_DistVelocityCoVnce : 243|11@1+ (0.0001,-0.1024) [-0.1024|0.1023] "m^2/s"  DASy
 SG_ RFC_Loc130_RadialDistanceVnce : 254|10@1+ (5E-005,0) [0|0.05115] "m^2"  DASy
 SG_ RFC_Loc130_RadialVelocityVnce : 264|10@1+ (0.0001,0) [0|0.1023] "m^2/s^2"  DASy
 SG_ RFC_Loc130_ElevationVnce : 274|10@1+ (0.001,0) [0|1.023] "deg^2"  DASy
 SG_ RFC_Loc130_AzimuthVnce : 284|10@1+ (0.001,0) [0|1.023] "deg^2"  DASy
 SG_ RFC_Loc130_RadarCrossSection : 294|10@1+ (0.2,-102.4) [-50|70] "dBsm"  DASy
 SG_ RFC_Loc130_DistVelocityQuality : 304|8@1+ (1,0) [0|255] "unitless"  DASy
 SG_ RFC_Loc130_ElevationQuality : 312|8@1+ (1,0) [0|255] "unitless"  DASy
 SG_ RFC_Loc130_AzimuthQuality : 320|8@1+ (1,0) [0|255] "unitless"  DASy
 SG_ RFC_Loc130_RSSI : 328|10@1+ (0.1,0) [0|100] "unitless"  DASy
 SG_ RFC_Loc130_AzimuthalPartnerId : 338|10@1+ (1,0) [0|1023] "unitless"  DASy
 SG_ RFC_Loc131_RadialDistance : 352|15@1+ (0.01,0) [0|327.67] "m"  DASy
 SG_ RFC_Loc131_RadialVelocity : 367|15@1+ (0.01,-163.84) [-110|55] "m/s"  DASy
 SG_ RFC_Loc131_Elevation : 382|10@1+ (0.1,-51.2) [-45|45] "deg"  DASy
 SG_ RFC_Loc131_Azimuth : 392|11@1+ (0.1,-102.4) [-90|90] "deg"  DASy
 SG_ RFC_Loc131_DistVelocityCoVnce : 403|11@1+ (0.0001,-0.1024) [-0.1024|0.1023] "m^2/s"  DASy
 SG_ RFC_Loc131_RadialDistanceVnce : 414|10@1+ (5E-005,0) [0|0.05115] "m^2"  DASy
 SG_ RFC_Loc131_RadialVelocityVnce : 424|10@1+ (0.0001,0) [0|0.1023] "m^2/s^2"  DASy
 SG_ RFC_Loc131_ElevationVnce : 434|10@1+ (0.001,0) [0|1.023] "deg^2"  DASy
 SG_ RFC_Loc131_AzimuthVnce : 444|10@1+ (0.001,0) [0|1.023] "deg^2"  DASy
 SG_ RFC_Loc131_RadarCrossSection : 454|10@1+ (0.2,-102.4) [-50|70] "dBsm"  DASy
 SG_ RFC_Loc131_DistVelocityQuality : 464|8@1+ (1,0) [0|255] "unitless"  DASy
 SG_ RFC_Loc131_ElevationQuality : 472|8@1+ (1,0) [0|255] "unitless"  DASy
 SG_ RFC_Loc131_AzimuthQuality : 480|8@1+ (1,0) [0|255] "unitless"  DASy
 SG_ RFC_Loc131_RSSI : 488|10@1+ (0.1,0) [0|100] "unitless"  DASy
 SG_ RFC_Loc131_AzimuthalPartnerId : 498|10@1+ (1,0) [0|1023] "unitless"  DASy

BO_ 308 RFC_Location_132_134: 64 RadarFrontCenter
 SG_ RFC_Loc132_134_CRC : 0|16@1+ (1,0) [0|65535] ""  DASy
 SG_ RFC_Loc132_134_AliveCtr : 16|8@1+ (1,0) [0|255] ""  DASy
 SG_ RFC_Loc132_134_ProtBlockCtr : 24|4@1+ (1,0) [0|15] ""  DASy
 SG_ RFC_Loc132_RadialDistance : 32|15@1+ (0.01,0) [0|327.67] "m"  DASy
 SG_ RFC_Loc132_RadialVelocity : 47|15@1+ (0.01,-163.84) [-110|55] "m/s"  DASy
 SG_ RFC_Loc132_Elevation : 62|10@1+ (0.1,-51.2) [-45|45] "deg"  DASy
 SG_ RFC_Loc132_Azimuth : 72|11@1+ (0.1,-102.4) [-90|90] "deg"  DASy
 SG_ RFC_Loc132_DistVelocityCoVnce : 83|11@1+ (0.0001,-0.1024) [-0.1024|0.1023] "m^2/s"  DASy
 SG_ RFC_Loc132_RadialDistanceVnce : 94|10@1+ (5E-005,0) [0|0.05115] "m^2"  DASy
 SG_ RFC_Loc132_RadialVelocityVnce : 104|10@1+ (0.0001,0) [0|0.1023] "m^2/s^2"  DASy
 SG_ RFC_Loc132_ElevationVnce : 114|10@1+ (0.001,0) [0|1.023] "deg^2"  DASy
 SG_ RFC_Loc132_AzimuthVnce : 124|10@1+ (0.001,0) [0|1.023] "deg^2"  DASy
 SG_ RFC_Loc132_RadarCrossSection : 134|10@1+ (0.2,-102.4) [-50|70] "dBsm"  DASy
 SG_ RFC_Loc132_DistVelocityQuality : 144|8@1+ (1,0) [0|255] "unitless"  DASy
 SG_ RFC_Loc132_ElevationQuality : 152|8@1+ (1,0) [0|255] "unitless"  DASy
 SG_ RFC_Loc132_AzimuthQuality : 160|8@1+ (1,0) [0|255] "unitless"  DASy
 SG_ RFC_Loc132_RSSI : 168|10@1+ (0.1,0) [0|100] "unitless"  DASy
 SG_ RFC_Loc132_AzimuthalPartnerId : 178|10@1+ (1,0) [0|1023] "unitless"  DASy
 SG_ RFC_Loc133_RadialDistance : 192|15@1+ (0.01,0) [0|327.67] "m"  DASy
 SG_ RFC_Loc133_RadialVelocity : 207|15@1+ (0.01,-163.84) [-110|55] "m/s"  DASy
 SG_ RFC_Loc133_Elevation : 222|10@1+ (0.1,-51.2) [-45|45] "deg"  DASy
 SG_ RFC_Loc133_Azimuth : 232|11@1+ (0.1,-102.4) [-90|90] "deg"  DASy
 SG_ RFC_Loc133_DistVelocityCoVnce : 243|11@1+ (0.0001,-0.1024) [-0.1024|0.1023] "m^2/s"  DASy
 SG_ RFC_Loc133_RadialDistanceVnce : 254|10@1+ (5E-005,0) [0|0.05115] "m^2"  DASy
 SG_ RFC_Loc133_RadialVelocityVnce : 264|10@1+ (0.0001,0) [0|0.1023] "m^2/s^2"  DASy
 SG_ RFC_Loc133_ElevationVnce : 274|10@1+ (0.001,0) [0|1.023] "deg^2"  DASy
 SG_ RFC_Loc133_AzimuthVnce : 284|10@1+ (0.001,0) [0|1.023] "deg^2"  DASy
 SG_ RFC_Loc133_RadarCrossSection : 294|10@1+ (0.2,-102.4) [-50|70] "dBsm"  DASy
 SG_ RFC_Loc133_DistVelocityQuality : 304|8@1+ (1,0) [0|255] "unitless"  DASy
 SG_ RFC_Loc133_ElevationQuality : 312|8@1+ (1,0) [0|255] "unitless"  DASy
 SG_ RFC_Loc133_AzimuthQuality : 320|8@1+ (1,0) [0|255] "unitless"  DASy
 SG_ RFC_Loc133_RSSI : 328|10@1+ (0.1,0) [0|100] "unitless"  DASy
 SG_ RFC_Loc133_AzimuthalPartnerId : 338|10@1+ (1,0) [0|1023] "unitless"  DASy
 SG_ RFC_Loc134_RadialDistance : 352|15@1+ (0.01,0) [0|327.67] "m"  DASy
 SG_ RFC_Loc134_RadialVelocity : 367|15@1+ (0.01,-163.84) [-110|55] "m/s"  DASy
 SG_ RFC_Loc134_Elevation : 382|10@1+ (0.1,-51.2) [-45|45] "deg"  DASy
 SG_ RFC_Loc134_Azimuth : 392|11@1+ (0.1,-102.4) [-90|90] "deg"  DASy
 SG_ RFC_Loc134_DistVelocityCoVnce : 403|11@1+ (0.0001,-0.1024) [-0.1024|0.1023] "m^2/s"  DASy
 SG_ RFC_Loc134_RadialDistanceVnce : 414|10@1+ (5E-005,0) [0|0.05115] "m^2"  DASy
 SG_ RFC_Loc134_RadialVelocityVnce : 424|10@1+ (0.0001,0) [0|0.1023] "m^2/s^2"  DASy
 SG_ RFC_Loc134_ElevationVnce : 434|10@1+ (0.001,0) [0|1.023] "deg^2"  DASy
 SG_ RFC_Loc134_AzimuthVnce : 444|10@1+ (0.001,0) [0|1.023] "deg^2"  DASy
 SG_ RFC_Loc134_RadarCrossSection : 454|10@1+ (0.2,-102.4) [-50|70] "dBsm"  DASy
 SG_ RFC_Loc134_DistVelocityQuality : 464|8@1+ (1,0) [0|255] "unitless"  DASy
 SG_ RFC_Loc134_ElevationQuality : 472|8@1+ (1,0) [0|255] "unitless"  DASy
 SG_ RFC_Loc134_AzimuthQuality : 480|8@1+ (1,0) [0|255] "unitless"  DASy
 SG_ RFC_Loc134_RSSI : 488|10@1+ (0.1,0) [0|100] "unitless"  DASy
 SG_ RFC_Loc134_AzimuthalPartnerId : 498|10@1+ (1,0) [0|1023] "unitless"  DASy

BO_ 309 RFC_Location_135_137: 64 RadarFrontCenter
 SG_ RFC_Loc135_137_CRC : 0|16@1+ (1,0) [0|65535] ""  DASy
 SG_ RFC_Loc135_137_AliveCtr : 16|8@1+ (1,0) [0|255] ""  DASy
 SG_ RFC_Loc135_137_ProtBlockCtr : 24|4@1+ (1,0) [0|15] ""  DASy
 SG_ RFC_Loc135_RadialDistance : 32|15@1+ (0.01,0) [0|327.67] "m"  DASy
 SG_ RFC_Loc135_RadialVelocity : 47|15@1+ (0.01,-163.84) [-110|55] "m/s"  DASy
 SG_ RFC_Loc135_Elevation : 62|10@1+ (0.1,-51.2) [-45|45] "deg"  DASy
 SG_ RFC_Loc135_Azimuth : 72|11@1+ (0.1,-102.4) [-90|90] "deg"  DASy
 SG_ RFC_Loc135_DistVelocityCoVnce : 83|11@1+ (0.0001,-0.1024) [-0.1024|0.1023] "m^2/s"  DASy
 SG_ RFC_Loc135_RadialDistanceVnce : 94|10@1+ (5E-005,0) [0|0.05115] "m^2"  DASy
 SG_ RFC_Loc135_RadialVelocityVnce : 104|10@1+ (0.0001,0) [0|0.1023] "m^2/s^2"  DASy
 SG_ RFC_Loc135_ElevationVnce : 114|10@1+ (0.001,0) [0|1.023] "deg^2"  DASy
 SG_ RFC_Loc135_AzimuthVnce : 124|10@1+ (0.001,0) [0|1.023] "deg^2"  DASy
 SG_ RFC_Loc135_RadarCrossSection : 134|10@1+ (0.2,-102.4) [-50|70] "dBsm"  DASy
 SG_ RFC_Loc135_DistVelocityQuality : 144|8@1+ (1,0) [0|255] "unitless"  DASy
 SG_ RFC_Loc135_ElevationQuality : 152|8@1+ (1,0) [0|255] "unitless"  DASy
 SG_ RFC_Loc135_AzimuthQuality : 160|8@1+ (1,0) [0|255] "unitless"  DASy
 SG_ RFC_Loc135_RSSI : 168|10@1+ (0.1,0) [0|100] "unitless"  DASy
 SG_ RFC_Loc135_AzimuthalPartnerId : 178|10@1+ (1,0) [0|1023] "unitless"  DASy
 SG_ RFC_Loc136_RadialDistance : 192|15@1+ (0.01,0) [0|327.67] "m"  DASy
 SG_ RFC_Loc136_RadialVelocity : 207|15@1+ (0.01,-163.84) [-110|55] "m/s"  DASy
 SG_ RFC_Loc136_Elevation : 222|10@1+ (0.1,-51.2) [-45|45] "deg"  DASy
 SG_ RFC_Loc136_Azimuth : 232|11@1+ (0.1,-102.4) [-90|90] "deg"  DASy
 SG_ RFC_Loc136_DistVelocityCoVnce : 243|11@1+ (0.0001,-0.1024) [-0.1024|0.1023] "m^2/s"  DASy
 SG_ RFC_Loc136_RadialDistanceVnce : 254|10@1+ (5E-005,0) [0|0.05115] "m^2"  DASy
 SG_ RFC_Loc136_RadialVelocityVnce : 264|10@1+ (0.0001,0) [0|0.1023] "m^2/s^2"  DASy
 SG_ RFC_Loc136_ElevationVnce : 274|10@1+ (0.001,0) [0|1.023] "deg^2"  DASy
 SG_ RFC_Loc136_AzimuthVnce : 284|10@1+ (0.001,0) [0|1.023] "deg^2"  DASy
 SG_ RFC_Loc136_RadarCrossSection : 294|10@1+ (0.2,-102.4) [-50|70] "dBsm"  DASy
 SG_ RFC_Loc136_DistVelocityQuality : 304|8@1+ (1,0) [0|255] "unitless"  DASy
 SG_ RFC_Loc136_ElevationQuality : 312|8@1+ (1,0) [0|255] "unitless"  DASy
 SG_ RFC_Loc136_AzimuthQuality : 320|8@1+ (1,0) [0|255] "unitless"  DASy
 SG_ RFC_Loc136_RSSI : 328|10@1+ (0.1,0) [0|100] "unitless"  DASy
 SG_ RFC_Loc136_AzimuthalPartnerId : 338|10@1+ (1,0) [0|1023] "unitless"  DASy
 SG_ RFC_Loc137_RadialDistance : 352|15@1+ (0.01,0) [0|327.67] "m"  DASy
 SG_ RFC_Loc137_RadialVelocity : 367|15@1+ (0.01,-163.84) [-110|55] "m/s"  DASy
 SG_ RFC_Loc137_Elevation : 382|10@1+ (0.1,-51.2) [-45|45] "deg"  DASy
 SG_ RFC_Loc137_Azimuth : 392|11@1+ (0.1,-102.4) [-90|90] "deg"  DASy
 SG_ RFC_Loc137_DistVelocityCoVnce : 403|11@1+ (0.0001,-0.1024) [-0.1024|0.1023] "m^2/s"  DASy
 SG_ RFC_Loc137_RadialDistanceVnce : 414|10@1+ (5E-005,0) [0|0.05115] "m^2"  DASy
 SG_ RFC_Loc137_RadialVelocityVnce : 424|10@1+ (0.0001,0) [0|0.1023] "m^2/s^2"  DASy
 SG_ RFC_Loc137_ElevationVnce : 434|10@1+ (0.001,0) [0|1.023] "deg^2"  DASy
 SG_ RFC_Loc137_AzimuthVnce : 444|10@1+ (0.001,0) [0|1.023] "deg^2"  DASy
 SG_ RFC_Loc137_RadarCrossSection : 454|10@1+ (0.2,-102.4) [-50|70] "dBsm"  DASy
 SG_ RFC_Loc137_DistVelocityQuality : 464|8@1+ (1,0) [0|255] "unitless"  DASy
 SG_ RFC_Loc137_ElevationQuality : 472|8@1+ (1,0) [0|255] "unitless"  DASy
 SG_ RFC_Loc137_AzimuthQuality : 480|8@1+ (1,0) [0|255] "unitless"  DASy
 SG_ RFC_Loc137_RSSI : 488|10@1+ (0.1,0) [0|100] "unitless"  DASy
 SG_ RFC_Loc137_AzimuthalPartnerId : 498|10@1+ (1,0) [0|1023] "unitless"  DASy

BO_ 310 RFC_Location_138_140: 64 RadarFrontCenter
 SG_ RFC_Loc138_140_CRC : 0|16@1+ (1,0) [0|65535] ""  DASy
 SG_ RFC_Loc138_140_AliveCtr : 16|8@1+ (1,0) [0|255] ""  DASy
 SG_ RFC_Loc138_140_ProtBlockCtr : 24|4@1+ (1,0) [0|15] ""  DASy
 SG_ RFC_Loc138_RadialDistance : 32|15@1+ (0.01,0) [0|327.67] "m"  DASy
 SG_ RFC_Loc138_RadialVelocity : 47|15@1+ (0.01,-163.84) [-110|55] "m/s"  DASy
 SG_ RFC_Loc138_Elevation : 62|10@1+ (0.1,-51.2) [-45|45] "deg"  DASy
 SG_ RFC_Loc138_Azimuth : 72|11@1+ (0.1,-102.4) [-90|90] "deg"  DASy
 SG_ RFC_Loc138_DistVelocityCoVnce : 83|11@1+ (0.0001,-0.1024) [-0.1024|0.1023] "m^2/s"  DASy
 SG_ RFC_Loc138_RadialDistanceVnce : 94|10@1+ (5E-005,0) [0|0.05115] "m^2"  DASy
 SG_ RFC_Loc138_RadialVelocityVnce : 104|10@1+ (0.0001,0) [0|0.1023] "m^2/s^2"  DASy
 SG_ RFC_Loc138_ElevationVnce : 114|10@1+ (0.001,0) [0|1.023] "deg^2"  DASy
 SG_ RFC_Loc138_AzimuthVnce : 124|10@1+ (0.001,0) [0|1.023] "deg^2"  DASy
 SG_ RFC_Loc138_RadarCrossSection : 134|10@1+ (0.2,-102.4) [-50|70] "dBsm"  DASy
 SG_ RFC_Loc138_DistVelocityQuality : 144|8@1+ (1,0) [0|255] "unitless"  DASy
 SG_ RFC_Loc138_ElevationQuality : 152|8@1+ (1,0) [0|255] "unitless"  DASy
 SG_ RFC_Loc138_AzimuthQuality : 160|8@1+ (1,0) [0|255] "unitless"  DASy
 SG_ RFC_Loc138_RSSI : 168|10@1+ (0.1,0) [0|100] "unitless"  DASy
 SG_ RFC_Loc138_AzimuthalPartnerId : 178|10@1+ (1,0) [0|1023] "unitless"  DASy
 SG_ RFC_Loc139_RadialDistance : 192|15@1+ (0.01,0) [0|327.67] "m"  DASy
 SG_ RFC_Loc139_RadialVelocity : 207|15@1+ (0.01,-163.84) [-110|55] "m/s"  DASy
 SG_ RFC_Loc139_Elevation : 222|10@1+ (0.1,-51.2) [-45|45] "deg"  DASy
 SG_ RFC_Loc139_Azimuth : 232|11@1+ (0.1,-102.4) [-90|90] "deg"  DASy
 SG_ RFC_Loc139_DistVelocityCoVnce : 243|11@1+ (0.0001,-0.1024) [-0.1024|0.1023] "m^2/s"  DASy
 SG_ RFC_Loc139_RadialDistanceVnce : 254|10@1+ (5E-005,0) [0|0.05115] "m^2"  DASy
 SG_ RFC_Loc139_RadialVelocityVnce : 264|10@1+ (0.0001,0) [0|0.1023] "m^2/s^2"  DASy
 SG_ RFC_Loc139_ElevationVnce : 274|10@1+ (0.001,0) [0|1.023] "deg^2"  DASy
 SG_ RFC_Loc139_AzimuthVnce : 284|10@1+ (0.001,0) [0|1.023] "deg^2"  DASy
 SG_ RFC_Loc139_RadarCrossSection : 294|10@1+ (0.2,-102.4) [-50|70] "dBsm"  DASy
 SG_ RFC_Loc139_DistVelocityQuality : 304|8@1+ (1,0) [0|255] "unitless"  DASy
 SG_ RFC_Loc139_ElevationQuality : 312|8@1+ (1,0) [0|255] "unitless"  DASy
 SG_ RFC_Loc139_AzimuthQuality : 320|8@1+ (1,0) [0|255] "unitless"  DASy
 SG_ RFC_Loc139_RSSI : 328|10@1+ (0.1,0) [0|100] "unitless"  DASy
 SG_ RFC_Loc139_AzimuthalPartnerId : 338|10@1+ (1,0) [0|1023] "unitless"  DASy
 SG_ RFC_Loc140_RadialDistance : 352|15@1+ (0.01,0) [0|327.67] "m"  DASy
 SG_ RFC_Loc140_RadialVelocity : 367|15@1+ (0.01,-163.84) [-110|55] "m/s"  DASy
 SG_ RFC_Loc140_Elevation : 382|10@1+ (0.1,-51.2) [-45|45] "deg"  DASy
 SG_ RFC_Loc140_Azimuth : 392|11@1+ (0.1,-102.4) [-90|90] "deg"  DASy
 SG_ RFC_Loc140_DistVelocityCoVnce : 403|11@1+ (0.0001,-0.1024) [-0.1024|0.1023] "m^2/s"  DASy
 SG_ RFC_Loc140_RadialDistanceVnce : 414|10@1+ (5E-005,0) [0|0.05115] "m^2"  DASy
 SG_ RFC_Loc140_RadialVelocityVnce : 424|10@1+ (0.0001,0) [0|0.1023] "m^2/s^2"  DASy
 SG_ RFC_Loc140_ElevationVnce : 434|10@1+ (0.001,0) [0|1.023] "deg^2"  DASy
 SG_ RFC_Loc140_AzimuthVnce : 444|10@1+ (0.001,0) [0|1.023] "deg^2"  DASy
 SG_ RFC_Loc140_RadarCrossSection : 454|10@1+ (0.2,-102.4) [-50|70] "dBsm"  DASy
 SG_ RFC_Loc140_DistVelocityQuality : 464|8@1+ (1,0) [0|255] "unitless"  DASy
 SG_ RFC_Loc140_ElevationQuality : 472|8@1+ (1,0) [0|255] "unitless"  DASy
 SG_ RFC_Loc140_AzimuthQuality : 480|8@1+ (1,0) [0|255] "unitless"  DASy
 SG_ RFC_Loc140_RSSI : 488|10@1+ (0.1,0) [0|100] "unitless"  DASy
 SG_ RFC_Loc140_AzimuthalPartnerId : 498|10@1+ (1,0) [0|1023] "unitless"  DASy

BO_ 311 RFC_Location_141_143: 64 RadarFrontCenter
 SG_ RFC_Loc141_143_CRC : 0|16@1+ (1,0) [0|65535] ""  DASy
 SG_ RFC_Loc141_143_AliveCtr : 16|8@1+ (1,0) [0|255] ""  DASy
 SG_ RFC_Loc141_143_ProtBlockCtr : 24|4@1+ (1,0) [0|15] ""  DASy
 SG_ RFC_Loc141_RadialDistance : 32|15@1+ (0.01,0) [0|327.67] "m"  DASy
 SG_ RFC_Loc141_RadialVelocity : 47|15@1+ (0.01,-163.84) [-110|55] "m/s"  DASy
 SG_ RFC_Loc141_Elevation : 62|10@1+ (0.1,-51.2) [-45|45] "deg"  DASy
 SG_ RFC_Loc141_Azimuth : 72|11@1+ (0.1,-102.4) [-90|90] "deg"  DASy
 SG_ RFC_Loc141_DistVelocityCoVnce : 83|11@1+ (0.0001,-0.1024) [-0.1024|0.1023] "m^2/s"  DASy
 SG_ RFC_Loc141_RadialDistanceVnce : 94|10@1+ (5E-005,0) [0|0.05115] "m^2"  DASy
 SG_ RFC_Loc141_RadialVelocityVnce : 104|10@1+ (0.0001,0) [0|0.1023] "m^2/s^2"  DASy
 SG_ RFC_Loc141_ElevationVnce : 114|10@1+ (0.001,0) [0|1.023] "deg^2"  DASy
 SG_ RFC_Loc141_AzimuthVnce : 124|10@1+ (0.001,0) [0|1.023] "deg^2"  DASy
 SG_ RFC_Loc141_RadarCrossSection : 134|10@1+ (0.2,-102.4) [-50|70] "dBsm"  DASy
 SG_ RFC_Loc141_DistVelocityQuality : 144|8@1+ (1,0) [0|255] "unitless"  DASy
 SG_ RFC_Loc141_ElevationQuality : 152|8@1+ (1,0) [0|255] "unitless"  DASy
 SG_ RFC_Loc141_AzimuthQuality : 160|8@1+ (1,0) [0|255] "unitless"  DASy
 SG_ RFC_Loc141_RSSI : 168|10@1+ (0.1,0) [0|100] "unitless"  DASy
 SG_ RFC_Loc141_AzimuthalPartnerId : 178|10@1+ (1,0) [0|1023] "unitless"  DASy
 SG_ RFC_Loc142_RadialDistance : 192|15@1+ (0.01,0) [0|327.67] "m"  DASy
 SG_ RFC_Loc142_RadialVelocity : 207|15@1+ (0.01,-163.84) [-110|55] "m/s"  DASy
 SG_ RFC_Loc142_Elevation : 222|10@1+ (0.1,-51.2) [-45|45] "deg"  DASy
 SG_ RFC_Loc142_Azimuth : 232|11@1+ (0.1,-102.4) [-90|90] "deg"  DASy
 SG_ RFC_Loc142_DistVelocityCoVnce : 243|11@1+ (0.0001,-0.1024) [-0.1024|0.1023] "m^2/s"  DASy
 SG_ RFC_Loc142_RadialDistanceVnce : 254|10@1+ (5E-005,0) [0|0.05115] "m^2"  DASy
 SG_ RFC_Loc142_RadialVelocityVnce : 264|10@1+ (0.0001,0) [0|0.1023] "m^2/s^2"  DASy
 SG_ RFC_Loc142_ElevationVnce : 274|10@1+ (0.001,0) [0|1.023] "deg^2"  DASy
 SG_ RFC_Loc142_AzimuthVnce : 284|10@1+ (0.001,0) [0|1.023] "deg^2"  DASy
 SG_ RFC_Loc142_RadarCrossSection : 294|10@1+ (0.2,-102.4) [-50|70] "dBsm"  DASy
 SG_ RFC_Loc142_DistVelocityQuality : 304|8@1+ (1,0) [0|255] "unitless"  DASy
 SG_ RFC_Loc142_ElevationQuality : 312|8@1+ (1,0) [0|255] "unitless"  DASy
 SG_ RFC_Loc142_AzimuthQuality : 320|8@1+ (1,0) [0|255] "unitless"  DASy
 SG_ RFC_Loc142_RSSI : 328|10@1+ (0.1,0) [0|100] "unitless"  DASy
 SG_ RFC_Loc142_AzimuthalPartnerId : 338|10@1+ (1,0) [0|1023] "unitless"  DASy
 SG_ RFC_Loc143_RadialDistance : 352|15@1+ (0.01,0) [0|327.67] "m"  DASy
 SG_ RFC_Loc143_RadialVelocity : 367|15@1+ (0.01,-163.84) [-110|55] "m/s"  DASy
 SG_ RFC_Loc143_Elevation : 382|10@1+ (0.1,-51.2) [-45|45] "deg"  DASy
 SG_ RFC_Loc143_Azimuth : 392|11@1+ (0.1,-102.4) [-90|90] "deg"  DASy
 SG_ RFC_Loc143_DistVelocityCoVnce : 403|11@1+ (0.0001,-0.1024) [-0.1024|0.1023] "m^2/s"  DASy
 SG_ RFC_Loc143_RadialDistanceVnce : 414|10@1+ (5E-005,0) [0|0.05115] "m^2"  DASy
 SG_ RFC_Loc143_RadialVelocityVnce : 424|10@1+ (0.0001,0) [0|0.1023] "m^2/s^2"  DASy
 SG_ RFC_Loc143_ElevationVnce : 434|10@1+ (0.001,0) [0|1.023] "deg^2"  DASy
 SG_ RFC_Loc143_AzimuthVnce : 444|10@1+ (0.001,0) [0|1.023] "deg^2"  DASy
 SG_ RFC_Loc143_RadarCrossSection : 454|10@1+ (0.2,-102.4) [-50|70] "dBsm"  DASy
 SG_ RFC_Loc143_DistVelocityQuality : 464|8@1+ (1,0) [0|255] "unitless"  DASy
 SG_ RFC_Loc143_ElevationQuality : 472|8@1+ (1,0) [0|255] "unitless"  DASy
 SG_ RFC_Loc143_AzimuthQuality : 480|8@1+ (1,0) [0|255] "unitless"  DASy
 SG_ RFC_Loc143_RSSI : 488|10@1+ (0.1,0) [0|100] "unitless"  DASy
 SG_ RFC_Loc143_AzimuthalPartnerId : 498|10@1+ (1,0) [0|1023] "unitless"  DASy

BO_ 312 RFC_Location_144_146: 64 RadarFrontCenter
 SG_ RFC_Loc144_146_CRC : 0|16@1+ (1,0) [0|65535] ""  DASy
 SG_ RFC_Loc144_146_AliveCtr : 16|8@1+ (1,0) [0|255] ""  DASy
 SG_ RFC_Loc144_146_ProtBlockCtr : 24|4@1+ (1,0) [0|15] ""  DASy
 SG_ RFC_Loc144_RadialDistance : 32|15@1+ (0.01,0) [0|327.67] "m"  DASy
 SG_ RFC_Loc144_RadialVelocity : 47|15@1+ (0.01,-163.84) [-110|55] "m/s"  DASy
 SG_ RFC_Loc144_Elevation : 62|10@1+ (0.1,-51.2) [-45|45] "deg"  DASy
 SG_ RFC_Loc144_Azimuth : 72|11@1+ (0.1,-102.4) [-90|90] "deg"  DASy
 SG_ RFC_Loc144_DistVelocityCoVnce : 83|11@1+ (0.0001,-0.1024) [-0.1024|0.1023] "m^2/s"  DASy
 SG_ RFC_Loc144_RadialDistanceVnce : 94|10@1+ (5E-005,0) [0|0.05115] "m^2"  DASy
 SG_ RFC_Loc144_RadialVelocityVnce : 104|10@1+ (0.0001,0) [0|0.1023] "m^2/s^2"  DASy
 SG_ RFC_Loc144_ElevationVnce : 114|10@1+ (0.001,0) [0|1.023] "deg^2"  DASy
 SG_ RFC_Loc144_AzimuthVnce : 124|10@1+ (0.001,0) [0|1.023] "deg^2"  DASy
 SG_ RFC_Loc144_RadarCrossSection : 134|10@1+ (0.2,-102.4) [-50|70] "dBsm"  DASy
 SG_ RFC_Loc144_DistVelocityQuality : 144|8@1+ (1,0) [0|255] "unitless"  DASy
 SG_ RFC_Loc144_ElevationQuality : 152|8@1+ (1,0) [0|255] "unitless"  DASy
 SG_ RFC_Loc144_AzimuthQuality : 160|8@1+ (1,0) [0|255] "unitless"  DASy
 SG_ RFC_Loc144_RSSI : 168|10@1+ (0.1,0) [0|100] "unitless"  DASy
 SG_ RFC_Loc144_AzimuthalPartnerId : 178|10@1+ (1,0) [0|1023] "unitless"  DASy
 SG_ RFC_Loc145_RadialDistance : 192|15@1+ (0.01,0) [0|327.67] "m"  DASy
 SG_ RFC_Loc145_RadialVelocity : 207|15@1+ (0.01,-163.84) [-110|55] "m/s"  DASy
 SG_ RFC_Loc145_Elevation : 222|10@1+ (0.1,-51.2) [-45|45] "deg"  DASy
 SG_ RFC_Loc145_Azimuth : 232|11@1+ (0.1,-102.4) [-90|90] "deg"  DASy
 SG_ RFC_Loc145_DistVelocityCoVnce : 243|11@1+ (0.0001,-0.1024) [-0.1024|0.1023] "m^2/s"  DASy
 SG_ RFC_Loc145_RadialDistanceVnce : 254|10@1+ (5E-005,0) [0|0.05115] "m^2"  DASy
 SG_ RFC_Loc145_RadialVelocityVnce : 264|10@1+ (0.0001,0) [0|0.1023] "m^2/s^2"  DASy
 SG_ RFC_Loc145_ElevationVnce : 274|10@1+ (0.001,0) [0|1.023] "deg^2"  DASy
 SG_ RFC_Loc145_AzimuthVnce : 284|10@1+ (0.001,0) [0|1.023] "deg^2"  DASy
 SG_ RFC_Loc145_RadarCrossSection : 294|10@1+ (0.2,-102.4) [-50|70] "dBsm"  DASy
 SG_ RFC_Loc145_DistVelocityQuality : 304|8@1+ (1,0) [0|255] "unitless"  DASy
 SG_ RFC_Loc145_ElevationQuality : 312|8@1+ (1,0) [0|255] "unitless"  DASy
 SG_ RFC_Loc145_AzimuthQuality : 320|8@1+ (1,0) [0|255] "unitless"  DASy
 SG_ RFC_Loc145_RSSI : 328|10@1+ (0.1,0) [0|100] "unitless"  DASy
 SG_ RFC_Loc145_AzimuthalPartnerId : 338|10@1+ (1,0) [0|1023] "unitless"  DASy
 SG_ RFC_Loc146_RadialDistance : 352|15@1+ (0.01,0) [0|327.67] "m"  DASy
 SG_ RFC_Loc146_RadialVelocity : 367|15@1+ (0.01,-163.84) [-110|55] "m/s"  DASy
 SG_ RFC_Loc146_Elevation : 382|10@1+ (0.1,-51.2) [-45|45] "deg"  DASy
 SG_ RFC_Loc146_Azimuth : 392|11@1+ (0.1,-102.4) [-90|90] "deg"  DASy
 SG_ RFC_Loc146_DistVelocityCoVnce : 403|11@1+ (0.0001,-0.1024) [-0.1024|0.1023] "m^2/s"  DASy
 SG_ RFC_Loc146_RadialDistanceVnce : 414|10@1+ (5E-005,0) [0|0.05115] "m^2"  DASy
 SG_ RFC_Loc146_RadialVelocityVnce : 424|10@1+ (0.0001,0) [0|0.1023] "m^2/s^2"  DASy
 SG_ RFC_Loc146_ElevationVnce : 434|10@1+ (0.001,0) [0|1.023] "deg^2"  DASy
 SG_ RFC_Loc146_AzimuthVnce : 444|10@1+ (0.001,0) [0|1.023] "deg^2"  DASy
 SG_ RFC_Loc146_RadarCrossSection : 454|10@1+ (0.2,-102.4) [-50|70] "dBsm"  DASy
 SG_ RFC_Loc146_DistVelocityQuality : 464|8@1+ (1,0) [0|255] "unitless"  DASy
 SG_ RFC_Loc146_ElevationQuality : 472|8@1+ (1,0) [0|255] "unitless"  DASy
 SG_ RFC_Loc146_AzimuthQuality : 480|8@1+ (1,0) [0|255] "unitless"  DASy
 SG_ RFC_Loc146_RSSI : 488|10@1+ (0.1,0) [0|100] "unitless"  DASy
 SG_ RFC_Loc146_AzimuthalPartnerId : 498|10@1+ (1,0) [0|1023] "unitless"  DASy

BO_ 313 RFC_Location_147_149: 64 RadarFrontCenter
 SG_ RFC_Loc147_149_CRC : 0|16@1+ (1,0) [0|65535] ""  DASy
 SG_ RFC_Loc147_149_AliveCtr : 16|8@1+ (1,0) [0|255] ""  DASy
 SG_ RFC_Loc147_149_ProtBlockCtr : 24|4@1+ (1,0) [0|15] ""  DASy
 SG_ RFC_Loc147_RadialDistance : 32|15@1+ (0.01,0) [0|327.67] "m"  DASy
 SG_ RFC_Loc147_RadialVelocity : 47|15@1+ (0.01,-163.84) [-110|55] "m/s"  DASy
 SG_ RFC_Loc147_Elevation : 62|10@1+ (0.1,-51.2) [-45|45] "deg"  DASy
 SG_ RFC_Loc147_Azimuth : 72|11@1+ (0.1,-102.4) [-90|90] "deg"  DASy
 SG_ RFC_Loc147_DistVelocityCoVnce : 83|11@1+ (0.0001,-0.1024) [-0.1024|0.1023] "m^2/s"  DASy
 SG_ RFC_Loc147_RadialDistanceVnce : 94|10@1+ (5E-005,0) [0|0.05115] "m^2"  DASy
 SG_ RFC_Loc147_RadialVelocityVnce : 104|10@1+ (0.0001,0) [0|0.1023] "m^2/s^2"  DASy
 SG_ RFC_Loc147_ElevationVnce : 114|10@1+ (0.001,0) [0|1.023] "deg^2"  DASy
 SG_ RFC_Loc147_AzimuthVnce : 124|10@1+ (0.001,0) [0|1.023] "deg^2"  DASy
 SG_ RFC_Loc147_RadarCrossSection : 134|10@1+ (0.2,-102.4) [-50|70] "dBsm"  DASy
 SG_ RFC_Loc147_DistVelocityQuality : 144|8@1+ (1,0) [0|255] "unitless"  DASy
 SG_ RFC_Loc147_ElevationQuality : 152|8@1+ (1,0) [0|255] "unitless"  DASy
 SG_ RFC_Loc147_AzimuthQuality : 160|8@1+ (1,0) [0|255] "unitless"  DASy
 SG_ RFC_Loc147_RSSI : 168|10@1+ (0.1,0) [0|100] "unitless"  DASy
 SG_ RFC_Loc147_AzimuthalPartnerId : 178|10@1+ (1,0) [0|1023] "unitless"  DASy
 SG_ RFC_Loc148_RadialDistance : 192|15@1+ (0.01,0) [0|327.67] "m"  DASy
 SG_ RFC_Loc148_RadialVelocity : 207|15@1+ (0.01,-163.84) [-110|55] "m/s"  DASy
 SG_ RFC_Loc148_Elevation : 222|10@1+ (0.1,-51.2) [-45|45] "deg"  DASy
 SG_ RFC_Loc148_Azimuth : 232|11@1+ (0.1,-102.4) [-90|90] "deg"  DASy
 SG_ RFC_Loc148_DistVelocityCoVnce : 243|11@1+ (0.0001,-0.1024) [-0.1024|0.1023] "m^2/s"  DASy
 SG_ RFC_Loc148_RadialDistanceVnce : 254|10@1+ (5E-005,0) [0|0.05115] "m^2"  DASy
 SG_ RFC_Loc148_RadialVelocityVnce : 264|10@1+ (0.0001,0) [0|0.1023] "m^2/s^2"  DASy
 SG_ RFC_Loc148_ElevationVnce : 274|10@1+ (0.001,0) [0|1.023] "deg^2"  DASy
 SG_ RFC_Loc148_AzimuthVnce : 284|10@1+ (0.001,0) [0|1.023] "deg^2"  DASy
 SG_ RFC_Loc148_RadarCrossSection : 294|10@1+ (0.2,-102.4) [-50|70] "dBsm"  DASy
 SG_ RFC_Loc148_DistVelocityQuality : 304|8@1+ (1,0) [0|255] "unitless"  DASy
 SG_ RFC_Loc148_ElevationQuality : 312|8@1+ (1,0) [0|255] "unitless"  DASy
 SG_ RFC_Loc148_AzimuthQuality : 320|8@1+ (1,0) [0|255] "unitless"  DASy
 SG_ RFC_Loc148_RSSI : 328|10@1+ (0.1,0) [0|100] "unitless"  DASy
 SG_ RFC_Loc148_AzimuthalPartnerId : 338|10@1+ (1,0) [0|1023] "unitless"  DASy
 SG_ RFC_Loc149_RadialDistance : 352|15@1+ (0.01,0) [0|327.67] "m"  DASy
 SG_ RFC_Loc149_RadialVelocity : 367|15@1+ (0.01,-163.84) [-110|55] "m/s"  DASy
 SG_ RFC_Loc149_Elevation : 382|10@1+ (0.1,-51.2) [-45|45] "deg"  DASy
 SG_ RFC_Loc149_Azimuth : 392|11@1+ (0.1,-102.4) [-90|90] "deg"  DASy
 SG_ RFC_Loc149_DistVelocityCoVnce : 403|11@1+ (0.0001,-0.1024) [-0.1024|0.1023] "m^2/s"  DASy
 SG_ RFC_Loc149_RadialDistanceVnce : 414|10@1+ (5E-005,0) [0|0.05115] "m^2"  DASy
 SG_ RFC_Loc149_RadialVelocityVnce : 424|10@1+ (0.0001,0) [0|0.1023] "m^2/s^2"  DASy
 SG_ RFC_Loc149_ElevationVnce : 434|10@1+ (0.001,0) [0|1.023] "deg^2"  DASy
 SG_ RFC_Loc149_AzimuthVnce : 444|10@1+ (0.001,0) [0|1.023] "deg^2"  DASy
 SG_ RFC_Loc149_RadarCrossSection : 454|10@1+ (0.2,-102.4) [-50|70] "dBsm"  DASy
 SG_ RFC_Loc149_DistVelocityQuality : 464|8@1+ (1,0) [0|255] "unitless"  DASy
 SG_ RFC_Loc149_ElevationQuality : 472|8@1+ (1,0) [0|255] "unitless"  DASy
 SG_ RFC_Loc149_AzimuthQuality : 480|8@1+ (1,0) [0|255] "unitless"  DASy
 SG_ RFC_Loc149_RSSI : 488|10@1+ (0.1,0) [0|100] "unitless"  DASy
 SG_ RFC_Loc149_AzimuthalPartnerId : 498|10@1+ (1,0) [0|1023] "unitless"  DASy

BO_ 314 RFC_Location_150_152: 64 RadarFrontCenter
 SG_ RFC_Loc150_152_CRC : 0|16@1+ (1,0) [0|65535] ""  DASy
 SG_ RFC_Loc150_152_AliveCtr : 16|8@1+ (1,0) [0|255] ""  DASy
 SG_ RFC_Loc150_152_ProtBlockCtr : 24|4@1+ (1,0) [0|15] ""  DASy
 SG_ RFC_Loc150_RadialDistance : 32|15@1+ (0.01,0) [0|327.67] "m"  DASy
 SG_ RFC_Loc150_RadialVelocity : 47|15@1+ (0.01,-163.84) [-110|55] "m/s"  DASy
 SG_ RFC_Loc150_Elevation : 62|10@1+ (0.1,-51.2) [-45|45] "deg"  DASy
 SG_ RFC_Loc150_Azimuth : 72|11@1+ (0.1,-102.4) [-90|90] "deg"  DASy
 SG_ RFC_Loc150_DistVelocityCoVnce : 83|11@1+ (0.0001,-0.1024) [-0.1024|0.1023] "m^2/s"  DASy
 SG_ RFC_Loc150_RadialDistanceVnce : 94|10@1+ (5E-005,0) [0|0.05115] "m^2"  DASy
 SG_ RFC_Loc150_RadialVelocityVnce : 104|10@1+ (0.0001,0) [0|0.1023] "m^2/s^2"  DASy
 SG_ RFC_Loc150_ElevationVnce : 114|10@1+ (0.001,0) [0|1.023] "deg^2"  DASy
 SG_ RFC_Loc150_AzimuthVnce : 124|10@1+ (0.001,0) [0|1.023] "deg^2"  DASy
 SG_ RFC_Loc150_RadarCrossSection : 134|10@1+ (0.2,-102.4) [-50|70] "dBsm"  DASy
 SG_ RFC_Loc150_DistVelocityQuality : 144|8@1+ (1,0) [0|255] "unitless"  DASy
 SG_ RFC_Loc150_ElevationQuality : 152|8@1+ (1,0) [0|255] "unitless"  DASy
 SG_ RFC_Loc150_AzimuthQuality : 160|8@1+ (1,0) [0|255] "unitless"  DASy
 SG_ RFC_Loc150_RSSI : 168|10@1+ (0.1,0) [0|100] "unitless"  DASy
 SG_ RFC_Loc150_AzimuthalPartnerId : 178|10@1+ (1,0) [0|1023] "unitless"  DASy
 SG_ RFC_Loc151_RadialDistance : 192|15@1+ (0.01,0) [0|327.67] "m"  DASy
 SG_ RFC_Loc151_RadialVelocity : 207|15@1+ (0.01,-163.84) [-110|55] "m/s"  DASy
 SG_ RFC_Loc151_Elevation : 222|10@1+ (0.1,-51.2) [-45|45] "deg"  DASy
 SG_ RFC_Loc151_Azimuth : 232|11@1+ (0.1,-102.4) [-90|90] "deg"  DASy
 SG_ RFC_Loc151_DistVelocityCoVnce : 243|11@1+ (0.0001,-0.1024) [-0.1024|0.1023] "m^2/s"  DASy
 SG_ RFC_Loc151_RadialDistanceVnce : 254|10@1+ (5E-005,0) [0|0.05115] "m^2"  DASy
 SG_ RFC_Loc151_RadialVelocityVnce : 264|10@1+ (0.0001,0) [0|0.1023] "m^2/s^2"  DASy
 SG_ RFC_Loc151_ElevationVnce : 274|10@1+ (0.001,0) [0|1.023] "deg^2"  DASy
 SG_ RFC_Loc151_AzimuthVnce : 284|10@1+ (0.001,0) [0|1.023] "deg^2"  DASy
 SG_ RFC_Loc151_RadarCrossSection : 294|10@1+ (0.2,-102.4) [-50|70] "dBsm"  DASy
 SG_ RFC_Loc151_DistVelocityQuality : 304|8@1+ (1,0) [0|255] "unitless"  DASy
 SG_ RFC_Loc151_ElevationQuality : 312|8@1+ (1,0) [0|255] "unitless"  DASy
 SG_ RFC_Loc151_AzimuthQuality : 320|8@1+ (1,0) [0|255] "unitless"  DASy
 SG_ RFC_Loc151_RSSI : 328|10@1+ (0.1,0) [0|100] "unitless"  DASy
 SG_ RFC_Loc151_AzimuthalPartnerId : 338|10@1+ (1,0) [0|1023] "unitless"  DASy
 SG_ RFC_Loc152_RadialDistance : 352|15@1+ (0.01,0) [0|327.67] "m"  DASy
 SG_ RFC_Loc152_RadialVelocity : 367|15@1+ (0.01,-163.84) [-110|55] "m/s"  DASy
 SG_ RFC_Loc152_Elevation : 382|10@1+ (0.1,-51.2) [-45|45] "deg"  DASy
 SG_ RFC_Loc152_Azimuth : 392|11@1+ (0.1,-102.4) [-90|90] "deg"  DASy
 SG_ RFC_Loc152_DistVelocityCoVnce : 403|11@1+ (0.0001,-0.1024) [-0.1024|0.1023] "m^2/s"  DASy
 SG_ RFC_Loc152_RadialDistanceVnce : 414|10@1+ (5E-005,0) [0|0.05115] "m^2"  DASy
 SG_ RFC_Loc152_RadialVelocityVnce : 424|10@1+ (0.0001,0) [0|0.1023] "m^2/s^2"  DASy
 SG_ RFC_Loc152_ElevationVnce : 434|10@1+ (0.001,0) [0|1.023] "deg^2"  DASy
 SG_ RFC_Loc152_AzimuthVnce : 444|10@1+ (0.001,0) [0|1.023] "deg^2"  DASy
 SG_ RFC_Loc152_RadarCrossSection : 454|10@1+ (0.2,-102.4) [-50|70] "dBsm"  DASy
 SG_ RFC_Loc152_DistVelocityQuality : 464|8@1+ (1,0) [0|255] "unitless"  DASy
 SG_ RFC_Loc152_ElevationQuality : 472|8@1+ (1,0) [0|255] "unitless"  DASy
 SG_ RFC_Loc152_AzimuthQuality : 480|8@1+ (1,0) [0|255] "unitless"  DASy
 SG_ RFC_Loc152_RSSI : 488|10@1+ (0.1,0) [0|100] "unitless"  DASy
 SG_ RFC_Loc152_AzimuthalPartnerId : 498|10@1+ (1,0) [0|1023] "unitless"  DASy

BO_ 315 RFC_Location_153_155: 64 RadarFrontCenter
 SG_ RFC_Loc153_155_CRC : 0|16@1+ (1,0) [0|65535] ""  DASy
 SG_ RFC_Loc153_155_AliveCtr : 16|8@1+ (1,0) [0|255] ""  DASy
 SG_ RFC_Loc153_155_ProtBlockCtr : 24|4@1+ (1,0) [0|15] ""  DASy
 SG_ RFC_Loc153_RadialDistance : 32|15@1+ (0.01,0) [0|327.67] "m"  DASy
 SG_ RFC_Loc153_RadialVelocity : 47|15@1+ (0.01,-163.84) [-110|55] "m/s"  DASy
 SG_ RFC_Loc153_Elevation : 62|10@1+ (0.1,-51.2) [-45|45] "deg"  DASy
 SG_ RFC_Loc153_Azimuth : 72|11@1+ (0.1,-102.4) [-90|90] "deg"  DASy
 SG_ RFC_Loc153_DistVelocityCoVnce : 83|11@1+ (0.0001,-0.1024) [-0.1024|0.1023] "m^2/s"  DASy
 SG_ RFC_Loc153_RadialDistanceVnce : 94|10@1+ (5E-005,0) [0|0.05115] "m^2"  DASy
 SG_ RFC_Loc153_RadialVelocityVnce : 104|10@1+ (0.0001,0) [0|0.1023] "m^2/s^2"  DASy
 SG_ RFC_Loc153_ElevationVnce : 114|10@1+ (0.001,0) [0|1.023] "deg^2"  DASy
 SG_ RFC_Loc153_AzimuthVnce : 124|10@1+ (0.001,0) [0|1.023] "deg^2"  DASy
 SG_ RFC_Loc153_RadarCrossSection : 134|10@1+ (0.2,-102.4) [-50|70] "dBsm"  DASy
 SG_ RFC_Loc153_DistVelocityQuality : 144|8@1+ (1,0) [0|255] "unitless"  DASy
 SG_ RFC_Loc153_ElevationQuality : 152|8@1+ (1,0) [0|255] "unitless"  DASy
 SG_ RFC_Loc153_AzimuthQuality : 160|8@1+ (1,0) [0|255] "unitless"  DASy
 SG_ RFC_Loc153_RSSI : 168|10@1+ (0.1,0) [0|100] "unitless"  DASy
 SG_ RFC_Loc153_AzimuthalPartnerId : 178|10@1+ (1,0) [0|1023] "unitless"  DASy
 SG_ RFC_Loc154_RadialDistance : 192|15@1+ (0.01,0) [0|327.67] "m"  DASy
 SG_ RFC_Loc154_RadialVelocity : 207|15@1+ (0.01,-163.84) [-110|55] "m/s"  DASy
 SG_ RFC_Loc154_Elevation : 222|10@1+ (0.1,-51.2) [-45|45] "deg"  DASy
 SG_ RFC_Loc154_Azimuth : 232|11@1+ (0.1,-102.4) [-90|90] "deg"  DASy
 SG_ RFC_Loc154_DistVelocityCoVnce : 243|11@1+ (0.0001,-0.1024) [-0.1024|0.1023] "m^2/s"  DASy
 SG_ RFC_Loc154_RadialDistanceVnce : 254|10@1+ (5E-005,0) [0|0.05115] "m^2"  DASy
 SG_ RFC_Loc154_RadialVelocityVnce : 264|10@1+ (0.0001,0) [0|0.1023] "m^2/s^2"  DASy
 SG_ RFC_Loc154_ElevationVnce : 274|10@1+ (0.001,0) [0|1.023] "deg^2"  DASy
 SG_ RFC_Loc154_AzimuthVnce : 284|10@1+ (0.001,0) [0|1.023] "deg^2"  DASy
 SG_ RFC_Loc154_RadarCrossSection : 294|10@1+ (0.2,-102.4) [-50|70] "dBsm"  DASy
 SG_ RFC_Loc154_DistVelocityQuality : 304|8@1+ (1,0) [0|255] "unitless"  DASy
 SG_ RFC_Loc154_ElevationQuality : 312|8@1+ (1,0) [0|255] "unitless"  DASy
 SG_ RFC_Loc154_AzimuthQuality : 320|8@1+ (1,0) [0|255] "unitless"  DASy
 SG_ RFC_Loc154_RSSI : 328|10@1+ (0.1,0) [0|100] "unitless"  DASy
 SG_ RFC_Loc154_AzimuthalPartnerId : 338|10@1+ (1,0) [0|1023] "unitless"  DASy
 SG_ RFC_Loc155_RadialDistance : 352|15@1+ (0.01,0) [0|327.67] "m"  DASy
 SG_ RFC_Loc155_RadialVelocity : 367|15@1+ (0.01,-163.84) [-110|55] "m/s"  DASy
 SG_ RFC_Loc155_Elevation : 382|10@1+ (0.1,-51.2) [-45|45] "deg"  DASy
 SG_ RFC_Loc155_Azimuth : 392|11@1+ (0.1,-102.4) [-90|90] "deg"  DASy
 SG_ RFC_Loc155_DistVelocityCoVnce : 403|11@1+ (0.0001,-0.1024) [-0.1024|0.1023] "m^2/s"  DASy
 SG_ RFC_Loc155_RadialDistanceVnce : 414|10@1+ (5E-005,0) [0|0.05115] "m^2"  DASy
 SG_ RFC_Loc155_RadialVelocityVnce : 424|10@1+ (0.0001,0) [0|0.1023] "m^2/s^2"  DASy
 SG_ RFC_Loc155_ElevationVnce : 434|10@1+ (0.001,0) [0|1.023] "deg^2"  DASy
 SG_ RFC_Loc155_AzimuthVnce : 444|10@1+ (0.001,0) [0|1.023] "deg^2"  DASy
 SG_ RFC_Loc155_RadarCrossSection : 454|10@1+ (0.2,-102.4) [-50|70] "dBsm"  DASy
 SG_ RFC_Loc155_DistVelocityQuality : 464|8@1+ (1,0) [0|255] "unitless"  DASy
 SG_ RFC_Loc155_ElevationQuality : 472|8@1+ (1,0) [0|255] "unitless"  DASy
 SG_ RFC_Loc155_AzimuthQuality : 480|8@1+ (1,0) [0|255] "unitless"  DASy
 SG_ RFC_Loc155_RSSI : 488|10@1+ (0.1,0) [0|100] "unitless"  DASy
 SG_ RFC_Loc155_AzimuthalPartnerId : 498|10@1+ (1,0) [0|1023] "unitless"  DASy

BO_ 316 RFC_Location_156_158: 64 RadarFrontCenter
 SG_ RFC_Loc156_158_CRC : 0|16@1+ (1,0) [0|65535] ""  DASy
 SG_ RFC_Loc156_158_AliveCtr : 16|8@1+ (1,0) [0|255] ""  DASy
 SG_ RFC_Loc156_158_ProtBlockCtr : 24|4@1+ (1,0) [0|15] ""  DASy
 SG_ RFC_Loc156_RadialDistance : 32|15@1+ (0.01,0) [0|327.67] "m"  DASy
 SG_ RFC_Loc156_RadialVelocity : 47|15@1+ (0.01,-163.84) [-110|55] "m/s"  DASy
 SG_ RFC_Loc156_Elevation : 62|10@1+ (0.1,-51.2) [-45|45] "deg"  DASy
 SG_ RFC_Loc156_Azimuth : 72|11@1+ (0.1,-102.4) [-90|90] "deg"  DASy
 SG_ RFC_Loc156_DistVelocityCoVnce : 83|11@1+ (0.0001,-0.1024) [-0.1024|0.1023] "m^2/s"  DASy
 SG_ RFC_Loc156_RadialDistanceVnce : 94|10@1+ (5E-005,0) [0|0.05115] "m^2"  DASy
 SG_ RFC_Loc156_RadialVelocityVnce : 104|10@1+ (0.0001,0) [0|0.1023] "m^2/s^2"  DASy
 SG_ RFC_Loc156_ElevationVnce : 114|10@1+ (0.001,0) [0|1.023] "deg^2"  DASy
 SG_ RFC_Loc156_AzimuthVnce : 124|10@1+ (0.001,0) [0|1.023] "deg^2"  DASy
 SG_ RFC_Loc156_RadarCrossSection : 134|10@1+ (0.2,-102.4) [-50|70] "dBsm"  DASy
 SG_ RFC_Loc156_DistVelocityQuality : 144|8@1+ (1,0) [0|255] "unitless"  DASy
 SG_ RFC_Loc156_ElevationQuality : 152|8@1+ (1,0) [0|255] "unitless"  DASy
 SG_ RFC_Loc156_AzimuthQuality : 160|8@1+ (1,0) [0|255] "unitless"  DASy
 SG_ RFC_Loc156_RSSI : 168|10@1+ (0.1,0) [0|100] "unitless"  DASy
 SG_ RFC_Loc156_AzimuthalPartnerId : 178|10@1+ (1,0) [0|1023] "unitless"  DASy
 SG_ RFC_Loc157_RadialDistance : 192|15@1+ (0.01,0) [0|327.67] "m"  DASy
 SG_ RFC_Loc157_RadialVelocity : 207|15@1+ (0.01,-163.84) [-110|55] "m/s"  DASy
 SG_ RFC_Loc157_Elevation : 222|10@1+ (0.1,-51.2) [-45|45] "deg"  DASy
 SG_ RFC_Loc157_Azimuth : 232|11@1+ (0.1,-102.4) [-90|90] "deg"  DASy
 SG_ RFC_Loc157_DistVelocityCoVnce : 243|11@1+ (0.0001,-0.1024) [-0.1024|0.1023] "m^2/s"  DASy
 SG_ RFC_Loc157_RadialDistanceVnce : 254|10@1+ (5E-005,0) [0|0.05115] "m^2"  DASy
 SG_ RFC_Loc157_RadialVelocityVnce : 264|10@1+ (0.0001,0) [0|0.1023] "m^2/s^2"  DASy
 SG_ RFC_Loc157_ElevationVnce : 274|10@1+ (0.001,0) [0|1.023] "deg^2"  DASy
 SG_ RFC_Loc157_AzimuthVnce : 284|10@1+ (0.001,0) [0|1.023] "deg^2"  DASy
 SG_ RFC_Loc157_RadarCrossSection : 294|10@1+ (0.2,-102.4) [-50|70] "dBsm"  DASy
 SG_ RFC_Loc157_DistVelocityQuality : 304|8@1+ (1,0) [0|255] "unitless"  DASy
 SG_ RFC_Loc157_ElevationQuality : 312|8@1+ (1,0) [0|255] "unitless"  DASy
 SG_ RFC_Loc157_AzimuthQuality : 320|8@1+ (1,0) [0|255] "unitless"  DASy
 SG_ RFC_Loc157_RSSI : 328|10@1+ (0.1,0) [0|100] "unitless"  DASy
 SG_ RFC_Loc157_AzimuthalPartnerId : 338|10@1+ (1,0) [0|1023] "unitless"  DASy
 SG_ RFC_Loc158_RadialDistance : 352|15@1+ (0.01,0) [0|327.67] "m"  DASy
 SG_ RFC_Loc158_RadialVelocity : 367|15@1+ (0.01,-163.84) [-110|55] "m/s"  DASy
 SG_ RFC_Loc158_Elevation : 382|10@1+ (0.1,-51.2) [-45|45] "deg"  DASy
 SG_ RFC_Loc158_Azimuth : 392|11@1+ (0.1,-102.4) [-90|90] "deg"  DASy
 SG_ RFC_Loc158_DistVelocityCoVnce : 403|11@1+ (0.0001,-0.1024) [-0.1024|0.1023] "m^2/s"  DASy
 SG_ RFC_Loc158_RadialDistanceVnce : 414|10@1+ (5E-005,0) [0|0.05115] "m^2"  DASy
 SG_ RFC_Loc158_RadialVelocityVnce : 424|10@1+ (0.0001,0) [0|0.1023] "m^2/s^2"  DASy
 SG_ RFC_Loc158_ElevationVnce : 434|10@1+ (0.001,0) [0|1.023] "deg^2"  DASy
 SG_ RFC_Loc158_AzimuthVnce : 444|10@1+ (0.001,0) [0|1.023] "deg^2"  DASy
 SG_ RFC_Loc158_RadarCrossSection : 454|10@1+ (0.2,-102.4) [-50|70] "dBsm"  DASy
 SG_ RFC_Loc158_DistVelocityQuality : 464|8@1+ (1,0) [0|255] "unitless"  DASy
 SG_ RFC_Loc158_ElevationQuality : 472|8@1+ (1,0) [0|255] "unitless"  DASy
 SG_ RFC_Loc158_AzimuthQuality : 480|8@1+ (1,0) [0|255] "unitless"  DASy
 SG_ RFC_Loc158_RSSI : 488|10@1+ (0.1,0) [0|100] "unitless"  DASy
 SG_ RFC_Loc158_AzimuthalPartnerId : 498|10@1+ (1,0) [0|1023] "unitless"  DASy

BO_ 317 RFC_Location_159_161: 64 RadarFrontCenter
 SG_ RFC_Loc159_161_CRC : 0|16@1+ (1,0) [0|65535] ""  DASy
 SG_ RFC_Loc159_161_AliveCtr : 16|8@1+ (1,0) [0|255] ""  DASy
 SG_ RFC_Loc159_161_ProtBlockCtr : 24|4@1+ (1,0) [0|15] ""  DASy
 SG_ RFC_Loc159_RadialDistance : 32|15@1+ (0.01,0) [0|327.67] "m"  DASy
 SG_ RFC_Loc159_RadialVelocity : 47|15@1+ (0.01,-163.84) [-110|55] "m/s"  DASy
 SG_ RFC_Loc159_Elevation : 62|10@1+ (0.1,-51.2) [-45|45] "deg"  DASy
 SG_ RFC_Loc159_Azimuth : 72|11@1+ (0.1,-102.4) [-90|90] "deg"  DASy
 SG_ RFC_Loc159_DistVelocityCoVnce : 83|11@1+ (0.0001,-0.1024) [-0.1024|0.1023] "m^2/s"  DASy
 SG_ RFC_Loc159_RadialDistanceVnce : 94|10@1+ (5E-005,0) [0|0.05115] "m^2"  DASy
 SG_ RFC_Loc159_RadialVelocityVnce : 104|10@1+ (0.0001,0) [0|0.1023] "m^2/s^2"  DASy
 SG_ RFC_Loc159_ElevationVnce : 114|10@1+ (0.001,0) [0|1.023] "deg^2"  DASy
 SG_ RFC_Loc159_AzimuthVnce : 124|10@1+ (0.001,0) [0|1.023] "deg^2"  DASy
 SG_ RFC_Loc159_RadarCrossSection : 134|10@1+ (0.2,-102.4) [-50|70] "dBsm"  DASy
 SG_ RFC_Loc159_DistVelocityQuality : 144|8@1+ (1,0) [0|255] "unitless"  DASy
 SG_ RFC_Loc159_ElevationQuality : 152|8@1+ (1,0) [0|255] "unitless"  DASy
 SG_ RFC_Loc159_AzimuthQuality : 160|8@1+ (1,0) [0|255] "unitless"  DASy
 SG_ RFC_Loc159_RSSI : 168|10@1+ (0.1,0) [0|100] "unitless"  DASy
 SG_ RFC_Loc159_AzimuthalPartnerId : 178|10@1+ (1,0) [0|1023] "unitless"  DASy
 SG_ RFC_Loc160_RadialDistance : 192|15@1+ (0.01,0) [0|327.67] "m"  DASy
 SG_ RFC_Loc160_RadialVelocity : 207|15@1+ (0.01,-163.84) [-110|55] "m/s"  DASy
 SG_ RFC_Loc160_Elevation : 222|10@1+ (0.1,-51.2) [-45|45] "deg"  DASy
 SG_ RFC_Loc160_Azimuth : 232|11@1+ (0.1,-102.4) [-90|90] "deg"  DASy
 SG_ RFC_Loc160_DistVelocityCoVnce : 243|11@1+ (0.0001,-0.1024) [-0.1024|0.1023] "m^2/s"  DASy
 SG_ RFC_Loc160_RadialDistanceVnce : 254|10@1+ (5E-005,0) [0|0.05115] "m^2"  DASy
 SG_ RFC_Loc160_RadialVelocityVnce : 264|10@1+ (0.0001,0) [0|0.1023] "m^2/s^2"  DASy
 SG_ RFC_Loc160_ElevationVnce : 274|10@1+ (0.001,0) [0|1.023] "deg^2"  DASy
 SG_ RFC_Loc160_AzimuthVnce : 284|10@1+ (0.001,0) [0|1.023] "deg^2"  DASy
 SG_ RFC_Loc160_RadarCrossSection : 294|10@1+ (0.2,-102.4) [-50|70] "dBsm"  DASy
 SG_ RFC_Loc160_DistVelocityQuality : 304|8@1+ (1,0) [0|255] "unitless"  DASy
 SG_ RFC_Loc160_ElevationQuality : 312|8@1+ (1,0) [0|255] "unitless"  DASy
 SG_ RFC_Loc160_AzimuthQuality : 320|8@1+ (1,0) [0|255] "unitless"  DASy
 SG_ RFC_Loc160_RSSI : 328|10@1+ (0.1,0) [0|100] "unitless"  DASy
 SG_ RFC_Loc160_AzimuthalPartnerId : 338|10@1+ (1,0) [0|1023] "unitless"  DASy
 SG_ RFC_Loc161_RadialDistance : 352|15@1+ (0.01,0) [0|327.67] "m"  DASy
 SG_ RFC_Loc161_RadialVelocity : 367|15@1+ (0.01,-163.84) [-110|55] "m/s"  DASy
 SG_ RFC_Loc161_Elevation : 382|10@1+ (0.1,-51.2) [-45|45] "deg"  DASy
 SG_ RFC_Loc161_Azimuth : 392|11@1+ (0.1,-102.4) [-90|90] "deg"  DASy
 SG_ RFC_Loc161_DistVelocityCoVnce : 403|11@1+ (0.0001,-0.1024) [-0.1024|0.1023] "m^2/s"  DASy
 SG_ RFC_Loc161_RadialDistanceVnce : 414|10@1+ (5E-005,0) [0|0.05115] "m^2"  DASy
 SG_ RFC_Loc161_RadialVelocityVnce : 424|10@1+ (0.0001,0) [0|0.1023] "m^2/s^2"  DASy
 SG_ RFC_Loc161_ElevationVnce : 434|10@1+ (0.001,0) [0|1.023] "deg^2"  DASy
 SG_ RFC_Loc161_AzimuthVnce : 444|10@1+ (0.001,0) [0|1.023] "deg^2"  DASy
 SG_ RFC_Loc161_RadarCrossSection : 454|10@1+ (0.2,-102.4) [-50|70] "dBsm"  DASy
 SG_ RFC_Loc161_DistVelocityQuality : 464|8@1+ (1,0) [0|255] "unitless"  DASy
 SG_ RFC_Loc161_ElevationQuality : 472|8@1+ (1,0) [0|255] "unitless"  DASy
 SG_ RFC_Loc161_AzimuthQuality : 480|8@1+ (1,0) [0|255] "unitless"  DASy
 SG_ RFC_Loc161_RSSI : 488|10@1+ (0.1,0) [0|100] "unitless"  DASy
 SG_ RFC_Loc161_AzimuthalPartnerId : 498|10@1+ (1,0) [0|1023] "unitless"  DASy

BO_ 318 RFC_Location_162_164: 64 RadarFrontCenter
 SG_ RFC_Loc162_164_CRC : 0|16@1+ (1,0) [0|65535] ""  DASy
 SG_ RFC_Loc162_164_AliveCtr : 16|8@1+ (1,0) [0|255] ""  DASy
 SG_ RFC_Loc162_164_ProtBlockCtr : 24|4@1+ (1,0) [0|15] ""  DASy
 SG_ RFC_Loc162_RadialDistance : 32|15@1+ (0.01,0) [0|327.67] "m"  DASy
 SG_ RFC_Loc162_RadialVelocity : 47|15@1+ (0.01,-163.84) [-110|55] "m/s"  DASy
 SG_ RFC_Loc162_Elevation : 62|10@1+ (0.1,-51.2) [-45|45] "deg"  DASy
 SG_ RFC_Loc162_Azimuth : 72|11@1+ (0.1,-102.4) [-90|90] "deg"  DASy
 SG_ RFC_Loc162_DistVelocityCoVnce : 83|11@1+ (0.0001,-0.1024) [-0.1024|0.1023] "m^2/s"  DASy
 SG_ RFC_Loc162_RadialDistanceVnce : 94|10@1+ (5E-005,0) [0|0.05115] "m^2"  DASy
 SG_ RFC_Loc162_RadialVelocityVnce : 104|10@1+ (0.0001,0) [0|0.1023] "m^2/s^2"  DASy
 SG_ RFC_Loc162_ElevationVnce : 114|10@1+ (0.001,0) [0|1.023] "deg^2"  DASy
 SG_ RFC_Loc162_AzimuthVnce : 124|10@1+ (0.001,0) [0|1.023] "deg^2"  DASy
 SG_ RFC_Loc162_RadarCrossSection : 134|10@1+ (0.2,-102.4) [-50|70] "dBsm"  DASy
 SG_ RFC_Loc162_DistVelocityQuality : 144|8@1+ (1,0) [0|255] "unitless"  DASy
 SG_ RFC_Loc162_ElevationQuality : 152|8@1+ (1,0) [0|255] "unitless"  DASy
 SG_ RFC_Loc162_AzimuthQuality : 160|8@1+ (1,0) [0|255] "unitless"  DASy
 SG_ RFC_Loc162_RSSI : 168|10@1+ (0.1,0) [0|100] "unitless"  DASy
 SG_ RFC_Loc162_AzimuthalPartnerId : 178|10@1+ (1,0) [0|1023] "unitless"  DASy
 SG_ RFC_Loc163_RadialDistance : 192|15@1+ (0.01,0) [0|327.67] "m"  DASy
 SG_ RFC_Loc163_RadialVelocity : 207|15@1+ (0.01,-163.84) [-110|55] "m/s"  DASy
 SG_ RFC_Loc163_Elevation : 222|10@1+ (0.1,-51.2) [-45|45] "deg"  DASy
 SG_ RFC_Loc163_Azimuth : 232|11@1+ (0.1,-102.4) [-90|90] "deg"  DASy
 SG_ RFC_Loc163_DistVelocityCoVnce : 243|11@1+ (0.0001,-0.1024) [-0.1024|0.1023] "m^2/s"  DASy
 SG_ RFC_Loc163_RadialDistanceVnce : 254|10@1+ (5E-005,0) [0|0.05115] "m^2"  DASy
 SG_ RFC_Loc163_RadialVelocityVnce : 264|10@1+ (0.0001,0) [0|0.1023] "m^2/s^2"  DASy
 SG_ RFC_Loc163_ElevationVnce : 274|10@1+ (0.001,0) [0|1.023] "deg^2"  DASy
 SG_ RFC_Loc163_AzimuthVnce : 284|10@1+ (0.001,0) [0|1.023] "deg^2"  DASy
 SG_ RFC_Loc163_RadarCrossSection : 294|10@1+ (0.2,-102.4) [-50|70] "dBsm"  DASy
 SG_ RFC_Loc163_DistVelocityQuality : 304|8@1+ (1,0) [0|255] "unitless"  DASy
 SG_ RFC_Loc163_ElevationQuality : 312|8@1+ (1,0) [0|255] "unitless"  DASy
 SG_ RFC_Loc163_AzimuthQuality : 320|8@1+ (1,0) [0|255] "unitless"  DASy
 SG_ RFC_Loc163_RSSI : 328|10@1+ (0.1,0) [0|100] "unitless"  DASy
 SG_ RFC_Loc163_AzimuthalPartnerId : 338|10@1+ (1,0) [0|1023] "unitless"  DASy
 SG_ RFC_Loc164_RadialDistance : 352|15@1+ (0.01,0) [0|327.67] "m"  DASy
 SG_ RFC_Loc164_RadialVelocity : 367|15@1+ (0.01,-163.84) [-110|55] "m/s"  DASy
 SG_ RFC_Loc164_Elevation : 382|10@1+ (0.1,-51.2) [-45|45] "deg"  DASy
 SG_ RFC_Loc164_Azimuth : 392|11@1+ (0.1,-102.4) [-90|90] "deg"  DASy
 SG_ RFC_Loc164_DistVelocityCoVnce : 403|11@1+ (0.0001,-0.1024) [-0.1024|0.1023] "m^2/s"  DASy
 SG_ RFC_Loc164_RadialDistanceVnce : 414|10@1+ (5E-005,0) [0|0.05115] "m^2"  DASy
 SG_ RFC_Loc164_RadialVelocityVnce : 424|10@1+ (0.0001,0) [0|0.1023] "m^2/s^2"  DASy
 SG_ RFC_Loc164_ElevationVnce : 434|10@1+ (0.001,0) [0|1.023] "deg^2"  DASy
 SG_ RFC_Loc164_AzimuthVnce : 444|10@1+ (0.001,0) [0|1.023] "deg^2"  DASy
 SG_ RFC_Loc164_RadarCrossSection : 454|10@1+ (0.2,-102.4) [-50|70] "dBsm"  DASy
 SG_ RFC_Loc164_DistVelocityQuality : 464|8@1+ (1,0) [0|255] "unitless"  DASy
 SG_ RFC_Loc164_ElevationQuality : 472|8@1+ (1,0) [0|255] "unitless"  DASy
 SG_ RFC_Loc164_AzimuthQuality : 480|8@1+ (1,0) [0|255] "unitless"  DASy
 SG_ RFC_Loc164_RSSI : 488|10@1+ (0.1,0) [0|100] "unitless"  DASy
 SG_ RFC_Loc164_AzimuthalPartnerId : 498|10@1+ (1,0) [0|1023] "unitless"  DASy

BO_ 319 RFC_Location_165_167: 64 RadarFrontCenter
 SG_ RFC_Loc165_167_CRC : 0|16@1+ (1,0) [0|65535] ""  DASy
 SG_ RFC_Loc165_167_AliveCtr : 16|8@1+ (1,0) [0|255] ""  DASy
 SG_ RFC_Loc165_167_ProtBlockCtr : 24|4@1+ (1,0) [0|15] ""  DASy
 SG_ RFC_Loc165_RadialDistance : 32|15@1+ (0.01,0) [0|327.67] "m"  DASy
 SG_ RFC_Loc165_RadialVelocity : 47|15@1+ (0.01,-163.84) [-110|55] "m/s"  DASy
 SG_ RFC_Loc165_Elevation : 62|10@1+ (0.1,-51.2) [-45|45] "deg"  DASy
 SG_ RFC_Loc165_Azimuth : 72|11@1+ (0.1,-102.4) [-90|90] "deg"  DASy
 SG_ RFC_Loc165_DistVelocityCoVnce : 83|11@1+ (0.0001,-0.1024) [-0.1024|0.1023] "m^2/s"  DASy
 SG_ RFC_Loc165_RadialDistanceVnce : 94|10@1+ (5E-005,0) [0|0.05115] "m^2"  DASy
 SG_ RFC_Loc165_RadialVelocityVnce : 104|10@1+ (0.0001,0) [0|0.1023] "m^2/s^2"  DASy
 SG_ RFC_Loc165_ElevationVnce : 114|10@1+ (0.001,0) [0|1.023] "deg^2"  DASy
 SG_ RFC_Loc165_AzimuthVnce : 124|10@1+ (0.001,0) [0|1.023] "deg^2"  DASy
 SG_ RFC_Loc165_RadarCrossSection : 134|10@1+ (0.2,-102.4) [-50|70] "dBsm"  DASy
 SG_ RFC_Loc165_DistVelocityQuality : 144|8@1+ (1,0) [0|255] "unitless"  DASy
 SG_ RFC_Loc165_ElevationQuality : 152|8@1+ (1,0) [0|255] "unitless"  DASy
 SG_ RFC_Loc165_AzimuthQuality : 160|8@1+ (1,0) [0|255] "unitless"  DASy
 SG_ RFC_Loc165_RSSI : 168|10@1+ (0.1,0) [0|100] "unitless"  DASy
 SG_ RFC_Loc165_AzimuthalPartnerId : 178|10@1+ (1,0) [0|1023] "unitless"  DASy
 SG_ RFC_Loc166_RadialDistance : 192|15@1+ (0.01,0) [0|327.67] "m"  DASy
 SG_ RFC_Loc166_RadialVelocity : 207|15@1+ (0.01,-163.84) [-110|55] "m/s"  DASy
 SG_ RFC_Loc166_Elevation : 222|10@1+ (0.1,-51.2) [-45|45] "deg"  DASy
 SG_ RFC_Loc166_Azimuth : 232|11@1+ (0.1,-102.4) [-90|90] "deg"  DASy
 SG_ RFC_Loc166_DistVelocityCoVnce : 243|11@1+ (0.0001,-0.1024) [-0.1024|0.1023] "m^2/s"  DASy
 SG_ RFC_Loc166_RadialDistanceVnce : 254|10@1+ (5E-005,0) [0|0.05115] "m^2"  DASy
 SG_ RFC_Loc166_RadialVelocityVnce : 264|10@1+ (0.0001,0) [0|0.1023] "m^2/s^2"  DASy
 SG_ RFC_Loc166_ElevationVnce : 274|10@1+ (0.001,0) [0|1.023] "deg^2"  DASy
 SG_ RFC_Loc166_AzimuthVnce : 284|10@1+ (0.001,0) [0|1.023] "deg^2"  DASy
 SG_ RFC_Loc166_RadarCrossSection : 294|10@1+ (0.2,-102.4) [-50|70] "dBsm"  DASy
 SG_ RFC_Loc166_DistVelocityQuality : 304|8@1+ (1,0) [0|255] "unitless"  DASy
 SG_ RFC_Loc166_ElevationQuality : 312|8@1+ (1,0) [0|255] "unitless"  DASy
 SG_ RFC_Loc166_AzimuthQuality : 320|8@1+ (1,0) [0|255] "unitless"  DASy
 SG_ RFC_Loc166_RSSI : 328|10@1+ (0.1,0) [0|100] "unitless"  DASy
 SG_ RFC_Loc166_AzimuthalPartnerId : 338|10@1+ (1,0) [0|1023] "unitless"  DASy
 SG_ RFC_Loc167_RadialDistance : 352|15@1+ (0.01,0) [0|327.67] "m"  DASy
 SG_ RFC_Loc167_RadialVelocity : 367|15@1+ (0.01,-163.84) [-110|55] "m/s"  DASy
 SG_ RFC_Loc167_Elevation : 382|10@1+ (0.1,-51.2) [-45|45] "deg"  DASy
 SG_ RFC_Loc167_Azimuth : 392|11@1+ (0.1,-102.4) [-90|90] "deg"  DASy
 SG_ RFC_Loc167_DistVelocityCoVnce : 403|11@1+ (0.0001,-0.1024) [-0.1024|0.1023] "m^2/s"  DASy
 SG_ RFC_Loc167_RadialDistanceVnce : 414|10@1+ (5E-005,0) [0|0.05115] "m^2"  DASy
 SG_ RFC_Loc167_RadialVelocityVnce : 424|10@1+ (0.0001,0) [0|0.1023] "m^2/s^2"  DASy
 SG_ RFC_Loc167_ElevationVnce : 434|10@1+ (0.001,0) [0|1.023] "deg^2"  DASy
 SG_ RFC_Loc167_AzimuthVnce : 444|10@1+ (0.001,0) [0|1.023] "deg^2"  DASy
 SG_ RFC_Loc167_RadarCrossSection : 454|10@1+ (0.2,-102.4) [-50|70] "dBsm"  DASy
 SG_ RFC_Loc167_DistVelocityQuality : 464|8@1+ (1,0) [0|255] "unitless"  DASy
 SG_ RFC_Loc167_ElevationQuality : 472|8@1+ (1,0) [0|255] "unitless"  DASy
 SG_ RFC_Loc167_AzimuthQuality : 480|8@1+ (1,0) [0|255] "unitless"  DASy
 SG_ RFC_Loc167_RSSI : 488|10@1+ (0.1,0) [0|100] "unitless"  DASy
 SG_ RFC_Loc167_AzimuthalPartnerId : 498|10@1+ (1,0) [0|1023] "unitless"  DASy

BO_ 320 RFC_Location_168_170: 64 RadarFrontCenter
 SG_ RFC_Loc168_170_CRC : 0|16@1+ (1,0) [0|65535] ""  DASy
 SG_ RFC_Loc168_170_AliveCtr : 16|8@1+ (1,0) [0|255] ""  DASy
 SG_ RFC_Loc168_170_ProtBlockCtr : 24|4@1+ (1,0) [0|15] ""  DASy
 SG_ RFC_Loc168_RadialDistance : 32|15@1+ (0.01,0) [0|327.67] "m"  DASy
 SG_ RFC_Loc168_RadialVelocity : 47|15@1+ (0.01,-163.84) [-110|55] "m/s"  DASy
 SG_ RFC_Loc168_Elevation : 62|10@1+ (0.1,-51.2) [-45|45] "deg"  DASy
 SG_ RFC_Loc168_Azimuth : 72|11@1+ (0.1,-102.4) [-90|90] "deg"  DASy
 SG_ RFC_Loc168_DistVelocityCoVnce : 83|11@1+ (0.0001,-0.1024) [-0.1024|0.1023] "m^2/s"  DASy
 SG_ RFC_Loc168_RadialDistanceVnce : 94|10@1+ (5E-005,0) [0|0.05115] "m^2"  DASy
 SG_ RFC_Loc168_RadialVelocityVnce : 104|10@1+ (0.0001,0) [0|0.1023] "m^2/s^2"  DASy
 SG_ RFC_Loc168_ElevationVnce : 114|10@1+ (0.001,0) [0|1.023] "deg^2"  DASy
 SG_ RFC_Loc168_AzimuthVnce : 124|10@1+ (0.001,0) [0|1.023] "deg^2"  DASy
 SG_ RFC_Loc168_RadarCrossSection : 134|10@1+ (0.2,-102.4) [-50|70] "dBsm"  DASy
 SG_ RFC_Loc168_DistVelocityQuality : 144|8@1+ (1,0) [0|255] "unitless"  DASy
 SG_ RFC_Loc168_ElevationQuality : 152|8@1+ (1,0) [0|255] "unitless"  DASy
 SG_ RFC_Loc168_AzimuthQuality : 160|8@1+ (1,0) [0|255] "unitless"  DASy
 SG_ RFC_Loc168_RSSI : 168|10@1+ (0.1,0) [0|100] "unitless"  DASy
 SG_ RFC_Loc168_AzimuthalPartnerId : 178|10@1+ (1,0) [0|1023] "unitless"  DASy
 SG_ RFC_Loc169_RadialDistance : 192|15@1+ (0.01,0) [0|327.67] "m"  DASy
 SG_ RFC_Loc169_RadialVelocity : 207|15@1+ (0.01,-163.84) [-110|55] "m/s"  DASy
 SG_ RFC_Loc169_Elevation : 222|10@1+ (0.1,-51.2) [-45|45] "deg"  DASy
 SG_ RFC_Loc169_Azimuth : 232|11@1+ (0.1,-102.4) [-90|90] "deg"  DASy
 SG_ RFC_Loc169_DistVelocityCoVnce : 243|11@1+ (0.0001,-0.1024) [-0.1024|0.1023] "m^2/s"  DASy
 SG_ RFC_Loc169_RadialDistanceVnce : 254|10@1+ (5E-005,0) [0|0.05115] "m^2"  DASy
 SG_ RFC_Loc169_RadialVelocityVnce : 264|10@1+ (0.0001,0) [0|0.1023] "m^2/s^2"  DASy
 SG_ RFC_Loc169_ElevationVnce : 274|10@1+ (0.001,0) [0|1.023] "deg^2"  DASy
 SG_ RFC_Loc169_AzimuthVnce : 284|10@1+ (0.001,0) [0|1.023] "deg^2"  DASy
 SG_ RFC_Loc169_RadarCrossSection : 294|10@1+ (0.2,-102.4) [-50|70] "dBsm"  DASy
 SG_ RFC_Loc169_DistVelocityQuality : 304|8@1+ (1,0) [0|255] "unitless"  DASy
 SG_ RFC_Loc169_ElevationQuality : 312|8@1+ (1,0) [0|255] "unitless"  DASy
 SG_ RFC_Loc169_AzimuthQuality : 320|8@1+ (1,0) [0|255] "unitless"  DASy
 SG_ RFC_Loc169_RSSI : 328|10@1+ (0.1,0) [0|100] "unitless"  DASy
 SG_ RFC_Loc169_AzimuthalPartnerId : 338|10@1+ (1,0) [0|1023] "unitless"  DASy
 SG_ RFC_Loc170_RadialDistance : 352|15@1+ (0.01,0) [0|327.67] "m"  DASy
 SG_ RFC_Loc170_RadialVelocity : 367|15@1+ (0.01,-163.84) [-110|55] "m/s"  DASy
 SG_ RFC_Loc170_Elevation : 382|10@1+ (0.1,-51.2) [-45|45] "deg"  DASy
 SG_ RFC_Loc170_Azimuth : 392|11@1+ (0.1,-102.4) [-90|90] "deg"  DASy
 SG_ RFC_Loc170_DistVelocityCoVnce : 403|11@1+ (0.0001,-0.1024) [-0.1024|0.1023] "m^2/s"  DASy
 SG_ RFC_Loc170_RadialDistanceVnce : 414|10@1+ (5E-005,0) [0|0.05115] "m^2"  DASy
 SG_ RFC_Loc170_RadialVelocityVnce : 424|10@1+ (0.0001,0) [0|0.1023] "m^2/s^2"  DASy
 SG_ RFC_Loc170_ElevationVnce : 434|10@1+ (0.001,0) [0|1.023] "deg^2"  DASy
 SG_ RFC_Loc170_AzimuthVnce : 444|10@1+ (0.001,0) [0|1.023] "deg^2"  DASy
 SG_ RFC_Loc170_RadarCrossSection : 454|10@1+ (0.2,-102.4) [-50|70] "dBsm"  DASy
 SG_ RFC_Loc170_DistVelocityQuality : 464|8@1+ (1,0) [0|255] "unitless"  DASy
 SG_ RFC_Loc170_ElevationQuality : 472|8@1+ (1,0) [0|255] "unitless"  DASy
 SG_ RFC_Loc170_AzimuthQuality : 480|8@1+ (1,0) [0|255] "unitless"  DASy
 SG_ RFC_Loc170_RSSI : 488|10@1+ (0.1,0) [0|100] "unitless"  DASy
 SG_ RFC_Loc170_AzimuthalPartnerId : 498|10@1+ (1,0) [0|1023] "unitless"  DASy

CM_ SG_ 307 RFC_Loc129_131_CRC "CRC - Autosar E2E Profile 5";
CM_ SG_ 307 RFC_Loc129_131_AliveCtr "Alive counter - Autosar E2E Profile 5";
CM_ SG_ 307 RFC_Loc129_131_ProtBlockCtr "Protocol-Signal: Block-Counter";
CM_ SG_ 307 RFC_Loc129_RadialDistance "Location radial distance. Represented in conical coordinate system. Same as ISO 23150:2021(E): Position radial distance (A.4.16)";
CM_ SG_ 307 RFC_Loc129_RadialVelocity "Location radial relative velocity ISO 23150:2021(E): Relative velocity {radial distance} (A.4.18)";
CM_ SG_ 307 RFC_Loc129_Elevation "Location elevation angle. Represented in conical coordinate system. Same as ISO 23150:2021(E): Position elevation (A.4.16)";
CM_ SG_ 307 RFC_Loc129_Azimuth "Location azimuth angle. Represented in conical coordinate system. Deviation from ISO 23150:2021(E): Position azimuth (A.4.16). Further details refers to DSP Location Interface definition";
CM_ SG_ 307 RFC_Loc129_DistVelocityCoVnce "Covariance of radial distance and radial velocity";
CM_ SG_ 307 RFC_Loc129_RadialDistanceVnce "Variance of Location radial distance ISO 23150:2021(E): Position radial distance - error (A.4.17)";
CM_ SG_ 307 RFC_Loc129_RadialVelocityVnce "Variance of Location radial relative velocity ISO 23150:2021(E): Relative velocity {radial distance} - error (A.4.19)";
CM_ SG_ 307 RFC_Loc129_ElevationVnce "Variance of Location elevation angle ISO 23150:2021(E): Position elevation - error (A.4.17)";
CM_ SG_ 307 RFC_Loc129_AzimuthVnce "Variance of Location azimuth angle ISO 23150:2021(E): Position azimuth - error (A.4.17)";
CM_ SG_ 307 RFC_Loc129_RadarCrossSection "Radar Cross Section (RCS) estimation ISO 23150:2021(E): Radar cross section (A.4.5)";
CM_ SG_ 307 RFC_Loc129_DistVelocityQuality "Quality of radial distance and velocity resolution processing. Physical range [0..1]";
CM_ SG_ 307 RFC_Loc129_ElevationQuality "Probability for correct signal model (elevation angle). Physical range [0..1]";
CM_ SG_ 307 RFC_Loc129_AzimuthQuality "Probability for correct signal model (azimuth angle). Physical range [0..1]";
CM_ SG_ 307 RFC_Loc129_RSSI "Received Signal Strength Indication (RSSI). This signal is not exactly ISO 23150:2021(E): Signal to noise ratio - detection level (A.4.7), but SNR can be calculated from this signal. Further detail please refer to the DSP Location Interface definition";
CM_ SG_ 307 RFC_Loc129_AzimuthalPartnerId "Id of the azimuthal partner location";
CM_ SG_ 307 RFC_Loc130_RadialDistance "Location radial distance. Represented in conical coordinate system. Same as ISO 23150:2021(E): Position radial distance (A.4.16)";
CM_ SG_ 307 RFC_Loc130_RadialVelocity "Location radial relative velocity ISO 23150:2021(E): Relative velocity {radial distance} (A.4.18)";
CM_ SG_ 307 RFC_Loc130_Elevation "Location elevation angle. Represented in conical coordinate system. Same as ISO 23150:2021(E): Position elevation (A.4.16)";
CM_ SG_ 307 RFC_Loc130_Azimuth "Location azimuth angle. Represented in conical coordinate system. Deviation from ISO 23150:2021(E): Position azimuth (A.4.16). Further details refers to DSP Location Interface definition";
CM_ SG_ 307 RFC_Loc130_DistVelocityCoVnce "Covariance of radial distance and radial velocity";
CM_ SG_ 307 RFC_Loc130_RadialDistanceVnce "Variance of Location radial distance ISO 23150:2021(E): Position radial distance - error (A.4.17)";
CM_ SG_ 307 RFC_Loc130_RadialVelocityVnce "Variance of Location radial relative velocity ISO 23150:2021(E): Relative velocity {radial distance} - error (A.4.19)";
CM_ SG_ 307 RFC_Loc130_ElevationVnce "Variance of Location elevation angle ISO 23150:2021(E): Position elevation - error (A.4.17)";
CM_ SG_ 307 RFC_Loc130_AzimuthVnce "Variance of Location azimuth angle ISO 23150:2021(E): Position azimuth - error (A.4.17)";
CM_ SG_ 307 RFC_Loc130_RadarCrossSection "Radar Cross Section (RCS) estimation ISO 23150:2021(E): Radar cross section (A.4.5)";
CM_ SG_ 307 RFC_Loc130_DistVelocityQuality "Quality of radial distance and velocity resolution processing. Physical range [0..1]";
CM_ SG_ 307 RFC_Loc130_ElevationQuality "Probability for correct signal model (elevation angle). Physical range [0..1]";
CM_ SG_ 307 RFC_Loc130_AzimuthQuality "Probability for correct signal model (azimuth angle). Physical range [0..1]";
CM_ SG_ 307 RFC_Loc130_RSSI "Received Signal Strength Indication (RSSI). This signal is not exactly ISO 23150:2021(E): Signal to noise ratio - detection level (A.4.7), but SNR can be calculated from this signal. Further detail please refer to the DSP Location Interface definition";
CM_ SG_ 307 RFC_Loc130_AzimuthalPartnerId "Id of the azimuthal partner location";
CM_ SG_ 307 RFC_Loc131_RadialDistance "Location radial distance. Represented in conical coordinate system. Same as ISO 23150:2021(E): Position radial distance (A.4.16)";
CM_ SG_ 307 RFC_Loc131_RadialVelocity "Location radial relative velocity ISO 23150:2021(E): Relative velocity {radial distance} (A.4.18)";
CM_ SG_ 307 RFC_Loc131_Elevation "Location elevation angle. Represented in conical coordinate system. Same as ISO 23150:2021(E): Position elevation (A.4.16)";
CM_ SG_ 307 RFC_Loc131_Azimuth "Location azimuth angle. Represented in conical coordinate system. Deviation from ISO 23150:2021(E): Position azimuth (A.4.16). Further details refers to DSP Location Interface definition";
CM_ SG_ 307 RFC_Loc131_DistVelocityCoVnce "Covariance of radial distance and radial velocity";
CM_ SG_ 307 RFC_Loc131_RadialDistanceVnce "Variance of Location radial distance ISO 23150:2021(E): Position radial distance - error (A.4.17)";
CM_ SG_ 307 RFC_Loc131_RadialVelocityVnce "Variance of Location radial relative velocity ISO 23150:2021(E): Relative velocity {radial distance} - error (A.4.19)";
CM_ SG_ 307 RFC_Loc131_ElevationVnce "Variance of Location elevation angle ISO 23150:2021(E): Position elevation - error (A.4.17)";
CM_ SG_ 307 RFC_Loc131_AzimuthVnce "Variance of Location azimuth angle ISO 23150:2021(E): Position azimuth - error (A.4.17)";
CM_ SG_ 307 RFC_Loc131_RadarCrossSection "Radar Cross Section (RCS) estimation ISO 23150:2021(E): Radar cross section (A.4.5)";
CM_ SG_ 307 RFC_Loc131_DistVelocityQuality "Quality of radial distance and velocity resolution processing. Physical range [0..1]";
CM_ SG_ 307 RFC_Loc131_ElevationQuality "Probability for correct signal model (elevation angle). Physical range [0..1]";
CM_ SG_ 307 RFC_Loc131_AzimuthQuality "Probability for correct signal model (azimuth angle). Physical range [0..1]";
CM_ SG_ 307 RFC_Loc131_RSSI "Received Signal Strength Indication (RSSI). This signal is not exactly ISO 23150:2021(E): Signal to noise ratio - detection level (A.4.7), but SNR can be calculated from this signal. Further detail please refer to the DSP Location Interface definition";
CM_ SG_ 307 RFC_Loc131_AzimuthalPartnerId "Id of the azimuthal partner location";
CM_ SG_ 308 RFC_Loc132_134_CRC "CRC - Autosar E2E Profile 5";
CM_ SG_ 308 RFC_Loc132_134_AliveCtr "Alive counter - Autosar E2E Profile 5";
CM_ SG_ 308 RFC_Loc132_134_ProtBlockCtr "Protocol-Signal: Block-Counter";
CM_ SG_ 308 RFC_Loc132_RadialDistance "Location radial distance. Represented in conical coordinate system. Same as ISO 23150:2021(E): Position radial distance (A.4.16)";
CM_ SG_ 308 RFC_Loc132_RadialVelocity "Location radial relative velocity ISO 23150:2021(E): Relative velocity {radial distance} (A.4.18)";
CM_ SG_ 308 RFC_Loc132_Elevation "Location elevation angle. Represented in conical coordinate system. Same as ISO 23150:2021(E): Position elevation (A.4.16)";
CM_ SG_ 308 RFC_Loc132_Azimuth "Location azimuth angle. Represented in conical coordinate system. Deviation from ISO 23150:2021(E): Position azimuth (A.4.16). Further details refers to DSP Location Interface definition";
CM_ SG_ 308 RFC_Loc132_DistVelocityCoVnce "Covariance of radial distance and radial velocity";
CM_ SG_ 308 RFC_Loc132_RadialDistanceVnce "Variance of Location radial distance ISO 23150:2021(E): Position radial distance - error (A.4.17)";
CM_ SG_ 308 RFC_Loc132_RadialVelocityVnce "Variance of Location radial relative velocity ISO 23150:2021(E): Relative velocity {radial distance} - error (A.4.19)";
CM_ SG_ 308 RFC_Loc132_ElevationVnce "Variance of Location elevation angle ISO 23150:2021(E): Position elevation - error (A.4.17)";
CM_ SG_ 308 RFC_Loc132_AzimuthVnce "Variance of Location azimuth angle ISO 23150:2021(E): Position azimuth - error (A.4.17)";
CM_ SG_ 308 RFC_Loc132_RadarCrossSection "Radar Cross Section (RCS) estimation ISO 23150:2021(E): Radar cross section (A.4.5)";
CM_ SG_ 308 RFC_Loc132_DistVelocityQuality "Quality of radial distance and velocity resolution processing. Physical range [0..1]";
CM_ SG_ 308 RFC_Loc132_ElevationQuality "Probability for correct signal model (elevation angle). Physical range [0..1]";
CM_ SG_ 308 RFC_Loc132_AzimuthQuality "Probability for correct signal model (azimuth angle). Physical range [0..1]";
CM_ SG_ 308 RFC_Loc132_RSSI "Received Signal Strength Indication (RSSI). This signal is not exactly ISO 23150:2021(E): Signal to noise ratio - detection level (A.4.7), but SNR can be calculated from this signal. Further detail please refer to the DSP Location Interface definition";
CM_ SG_ 308 RFC_Loc132_AzimuthalPartnerId "Id of the azimuthal partner location";
CM_ SG_ 308 RFC_Loc133_RadialDistance "Location radial distance. Represented in conical coordinate system. Same as ISO 23150:2021(E): Position radial distance (A.4.16)";
CM_ SG_ 308 RFC_Loc133_RadialVelocity "Location radial relative velocity ISO 23150:2021(E): Relative velocity {radial distance} (A.4.18)";
CM_ SG_ 308 RFC_Loc133_Elevation "Location elevation angle. Represented in conical coordinate system. Same as ISO 23150:2021(E): Position elevation (A.4.16)";
CM_ SG_ 308 RFC_Loc133_Azimuth "Location azimuth angle. Represented in conical coordinate system. Deviation from ISO 23150:2021(E): Position azimuth (A.4.16). Further details refers to DSP Location Interface definition";
CM_ SG_ 308 RFC_Loc133_DistVelocityCoVnce "Covariance of radial distance and radial velocity";
CM_ SG_ 308 RFC_Loc133_RadialDistanceVnce "Variance of Location radial distance ISO 23150:2021(E): Position radial distance - error (A.4.17)";
CM_ SG_ 308 RFC_Loc133_RadialVelocityVnce "Variance of Location radial relative velocity ISO 23150:2021(E): Relative velocity {radial distance} - error (A.4.19)";
CM_ SG_ 308 RFC_Loc133_ElevationVnce "Variance of Location elevation angle ISO 23150:2021(E): Position elevation - error (A.4.17)";
CM_ SG_ 308 RFC_Loc133_AzimuthVnce "Variance of Location azimuth angle ISO 23150:2021(E): Position azimuth - error (A.4.17)";
CM_ SG_ 308 RFC_Loc133_RadarCrossSection "Radar Cross Section (RCS) estimation ISO 23150:2021(E): Radar cross section (A.4.5)";
CM_ SG_ 308 RFC_Loc133_DistVelocityQuality "Quality of radial distance and velocity resolution processing. Physical range [0..1]";
CM_ SG_ 308 RFC_Loc133_ElevationQuality "Probability for correct signal model (elevation angle). Physical range [0..1]";
CM_ SG_ 308 RFC_Loc133_AzimuthQuality "Probability for correct signal model (azimuth angle). Physical range [0..1]";
CM_ SG_ 308 RFC_Loc133_RSSI "Received Signal Strength Indication (RSSI). This signal is not exactly ISO 23150:2021(E): Signal to noise ratio - detection level (A.4.7), but SNR can be calculated from this signal. Further detail please refer to the DSP Location Interface definition";
CM_ SG_ 308 RFC_Loc133_AzimuthalPartnerId "Id of the azimuthal partner location";
CM_ SG_ 308 RFC_Loc134_RadialDistance "Location radial distance. Represented in conical coordinate system. Same as ISO 23150:2021(E): Position radial distance (A.4.16)";
CM_ SG_ 308 RFC_Loc134_RadialVelocity "Location radial relative velocity ISO 23150:2021(E): Relative velocity {radial distance} (A.4.18)";
CM_ SG_ 308 RFC_Loc134_Elevation "Location elevation angle. Represented in conical coordinate system. Same as ISO 23150:2021(E): Position elevation (A.4.16)";
CM_ SG_ 308 RFC_Loc134_Azimuth "Location azimuth angle. Represented in conical coordinate system. Deviation from ISO 23150:2021(E): Position azimuth (A.4.16). Further details refers to DSP Location Interface definition";
CM_ SG_ 308 RFC_Loc134_DistVelocityCoVnce "Covariance of radial distance and radial velocity";
CM_ SG_ 308 RFC_Loc134_RadialDistanceVnce "Variance of Location radial distance ISO 23150:2021(E): Position radial distance - error (A.4.17)";
CM_ SG_ 308 RFC_Loc134_RadialVelocityVnce "Variance of Location radial relative velocity ISO 23150:2021(E): Relative velocity {radial distance} - error (A.4.19)";
CM_ SG_ 308 RFC_Loc134_ElevationVnce "Variance of Location elevation angle ISO 23150:2021(E): Position elevation - error (A.4.17)";
CM_ SG_ 308 RFC_Loc134_AzimuthVnce "Variance of Location azimuth angle ISO 23150:2021(E): Position azimuth - error (A.4.17)";
CM_ SG_ 308 RFC_Loc134_RadarCrossSection "Radar Cross Section (RCS) estimation ISO 23150:2021(E): Radar cross section (A.4.5)";
CM_ SG_ 308 RFC_Loc134_DistVelocityQuality "Quality of radial distance and velocity resolution processing. Physical range [0..1]";
CM_ SG_ 308 RFC_Loc134_ElevationQuality "Probability for correct signal model (elevation angle). Physical range [0..1]";
CM_ SG_ 308 RFC_Loc134_AzimuthQuality "Probability for correct signal model (azimuth angle). Physical range [0..1]";
CM_ SG_ 308 RFC_Loc134_RSSI "Received Signal Strength Indication (RSSI). This signal is not exactly ISO 23150:2021(E): Signal to noise ratio - detection level (A.4.7), but SNR can be calculated from this signal. Further detail please refer to the DSP Location Interface definition";
CM_ SG_ 308 RFC_Loc134_AzimuthalPartnerId "Id of the azimuthal partner location";
CM_ SG_ 309 RFC_Loc135_137_CRC "CRC - Autosar E2E Profile 5";
CM_ SG_ 309 RFC_Loc135_137_AliveCtr "Alive counter - Autosar E2E Profile 5";
CM_ SG_ 309 RFC_Loc135_137_ProtBlockCtr "Protocol-Signal: Block-Counter";
CM_ SG_ 309 RFC_Loc135_RadialDistance "Location radial distance. Represented in conical coordinate system. Same as ISO 23150:2021(E): Position radial distance (A.4.16)";
CM_ SG_ 309 RFC_Loc135_RadialVelocity "Location radial relative velocity ISO 23150:2021(E): Relative velocity {radial distance} (A.4.18)";
CM_ SG_ 309 RFC_Loc135_Elevation "Location elevation angle. Represented in conical coordinate system. Same as ISO 23150:2021(E): Position elevation (A.4.16)";
CM_ SG_ 309 RFC_Loc135_Azimuth "Location azimuth angle. Represented in conical coordinate system. Deviation from ISO 23150:2021(E): Position azimuth (A.4.16). Further details refers to DSP Location Interface definition";
CM_ SG_ 309 RFC_Loc135_DistVelocityCoVnce "Covariance of radial distance and radial velocity";
CM_ SG_ 309 RFC_Loc135_RadialDistanceVnce "Variance of Location radial distance ISO 23150:2021(E): Position radial distance - error (A.4.17)";
CM_ SG_ 309 RFC_Loc135_RadialVelocityVnce "Variance of Location radial relative velocity ISO 23150:2021(E): Relative velocity {radial distance} - error (A.4.19)";
CM_ SG_ 309 RFC_Loc135_ElevationVnce "Variance of Location elevation angle ISO 23150:2021(E): Position elevation - error (A.4.17)";
CM_ SG_ 309 RFC_Loc135_AzimuthVnce "Variance of Location azimuth angle ISO 23150:2021(E): Position azimuth - error (A.4.17)";
CM_ SG_ 309 RFC_Loc135_RadarCrossSection "Radar Cross Section (RCS) estimation ISO 23150:2021(E): Radar cross section (A.4.5)";
CM_ SG_ 309 RFC_Loc135_DistVelocityQuality "Quality of radial distance and velocity resolution processing. Physical range [0..1]";
CM_ SG_ 309 RFC_Loc135_ElevationQuality "Probability for correct signal model (elevation angle). Physical range [0..1]";
CM_ SG_ 309 RFC_Loc135_AzimuthQuality "Probability for correct signal model (azimuth angle). Physical range [0..1]";
CM_ SG_ 309 RFC_Loc135_RSSI "Received Signal Strength Indication (RSSI). This signal is not exactly ISO 23150:2021(E): Signal to noise ratio - detection level (A.4.7), but SNR can be calculated from this signal. Further detail please refer to the DSP Location Interface definition";
CM_ SG_ 309 RFC_Loc135_AzimuthalPartnerId "Id of the azimuthal partner location";
CM_ SG_ 309 RFC_Loc136_RadialDistance "Location radial distance. Represented in conical coordinate system. Same as ISO 23150:2021(E): Position radial distance (A.4.16)";
CM_ SG_ 309 RFC_Loc136_RadialVelocity "Location radial relative velocity ISO 23150:2021(E): Relative velocity {radial distance} (A.4.18)";
CM_ SG_ 309 RFC_Loc136_Elevation "Location elevation angle. Represented in conical coordinate system. Same as ISO 23150:2021(E): Position elevation (A.4.16)";
CM_ SG_ 309 RFC_Loc136_Azimuth "Location azimuth angle. Represented in conical coordinate system. Deviation from ISO 23150:2021(E): Position azimuth (A.4.16). Further details refers to DSP Location Interface definition";
CM_ SG_ 309 RFC_Loc136_DistVelocityCoVnce "Covariance of radial distance and radial velocity";
CM_ SG_ 309 RFC_Loc136_RadialDistanceVnce "Variance of Location radial distance ISO 23150:2021(E): Position radial distance - error (A.4.17)";
CM_ SG_ 309 RFC_Loc136_RadialVelocityVnce "Variance of Location radial relative velocity ISO 23150:2021(E): Relative velocity {radial distance} - error (A.4.19)";
CM_ SG_ 309 RFC_Loc136_ElevationVnce "Variance of Location elevation angle ISO 23150:2021(E): Position elevation - error (A.4.17)";
CM_ SG_ 309 RFC_Loc136_AzimuthVnce "Variance of Location azimuth angle ISO 23150:2021(E): Position azimuth - error (A.4.17)";
CM_ SG_ 309 RFC_Loc136_RadarCrossSection "Radar Cross Section (RCS) estimation ISO 23150:2021(E): Radar cross section (A.4.5)";
CM_ SG_ 309 RFC_Loc136_DistVelocityQuality "Quality of radial distance and velocity resolution processing. Physical range [0..1]";
CM_ SG_ 309 RFC_Loc136_ElevationQuality "Probability for correct signal model (elevation angle). Physical range [0..1]";
CM_ SG_ 309 RFC_Loc136_AzimuthQuality "Probability for correct signal model (azimuth angle). Physical range [0..1]";
CM_ SG_ 309 RFC_Loc136_RSSI "Received Signal Strength Indication (RSSI). This signal is not exactly ISO 23150:2021(E): Signal to noise ratio - detection level (A.4.7), but SNR can be calculated from this signal. Further detail please refer to the DSP Location Interface definition";
CM_ SG_ 309 RFC_Loc136_AzimuthalPartnerId "Id of the azimuthal partner location";
CM_ SG_ 309 RFC_Loc137_RadialDistance "Location radial distance. Represented in conical coordinate system. Same as ISO 23150:2021(E): Position radial distance (A.4.16)";
CM_ SG_ 309 RFC_Loc137_RadialVelocity "Location radial relative velocity ISO 23150:2021(E): Relative velocity {radial distance} (A.4.18)";
CM_ SG_ 309 RFC_Loc137_Elevation "Location elevation angle. Represented in conical coordinate system. Same as ISO 23150:2021(E): Position elevation (A.4.16)";
CM_ SG_ 309 RFC_Loc137_Azimuth "Location azimuth angle. Represented in conical coordinate system. Deviation from ISO 23150:2021(E): Position azimuth (A.4.16). Further details refers to DSP Location Interface definition";
CM_ SG_ 309 RFC_Loc137_DistVelocityCoVnce "Covariance of radial distance and radial velocity";
CM_ SG_ 309 RFC_Loc137_RadialDistanceVnce "Variance of Location radial distance ISO 23150:2021(E): Position radial distance - error (A.4.17)";
CM_ SG_ 309 RFC_Loc137_RadialVelocityVnce "Variance of Location radial relative velocity ISO 23150:2021(E): Relative velocity {radial distance} - error (A.4.19)";
CM_ SG_ 309 RFC_Loc137_ElevationVnce "Variance of Location elevation angle ISO 23150:2021(E): Position elevation - error (A.4.17)";
CM_ SG_ 309 RFC_Loc137_AzimuthVnce "Variance of Location azimuth angle ISO 23150:2021(E): Position azimuth - error (A.4.17)";
CM_ SG_ 309 RFC_Loc137_RadarCrossSection "Radar Cross Section (RCS) estimation ISO 23150:2021(E): Radar cross section (A.4.5)";
CM_ SG_ 309 RFC_Loc137_DistVelocityQuality "Quality of radial distance and velocity resolution processing. Physical range [0..1]";
CM_ SG_ 309 RFC_Loc137_ElevationQuality "Probability for correct signal model (elevation angle). Physical range [0..1]";
CM_ SG_ 309 RFC_Loc137_AzimuthQuality "Probability for correct signal model (azimuth angle). Physical range [0..1]";
CM_ SG_ 309 RFC_Loc137_RSSI "Received Signal Strength Indication (RSSI). This signal is not exactly ISO 23150:2021(E): Signal to noise ratio - detection level (A.4.7), but SNR can be calculated from this signal. Further detail please refer to the DSP Location Interface definition";
CM_ SG_ 309 RFC_Loc137_AzimuthalPartnerId "Id of the azimuthal partner location";
CM_ SG_ 310 RFC_Loc138_140_CRC "CRC - Autosar E2E Profile 5";
CM_ SG_ 310 RFC_Loc138_140_AliveCtr "Alive counter - Autosar E2E Profile 5";
CM_ SG_ 310 RFC_Loc138_140_ProtBlockCtr "Protocol-Signal: Block-Counter";
CM_ SG_ 310 RFC_Loc138_RadialDistance "Location radial distance. Represented in conical coordinate system. Same as ISO 23150:2021(E): Position radial distance (A.4.16)";
CM_ SG_ 310 RFC_Loc138_RadialVelocity "Location radial relative velocity ISO 23150:2021(E): Relative velocity {radial distance} (A.4.18)";
CM_ SG_ 310 RFC_Loc138_Elevation "Location elevation angle. Represented in conical coordinate system. Same as ISO 23150:2021(E): Position elevation (A.4.16)";
CM_ SG_ 310 RFC_Loc138_Azimuth "Location azimuth angle. Represented in conical coordinate system. Deviation from ISO 23150:2021(E): Position azimuth (A.4.16). Further details refers to DSP Location Interface definition";
CM_ SG_ 310 RFC_Loc138_DistVelocityCoVnce "Covariance of radial distance and radial velocity";
CM_ SG_ 310 RFC_Loc138_RadialDistanceVnce "Variance of Location radial distance ISO 23150:2021(E): Position radial distance - error (A.4.17)";
CM_ SG_ 310 RFC_Loc138_RadialVelocityVnce "Variance of Location radial relative velocity ISO 23150:2021(E): Relative velocity {radial distance} - error (A.4.19)";
CM_ SG_ 310 RFC_Loc138_ElevationVnce "Variance of Location elevation angle ISO 23150:2021(E): Position elevation - error (A.4.17)";
CM_ SG_ 310 RFC_Loc138_AzimuthVnce "Variance of Location azimuth angle ISO 23150:2021(E): Position azimuth - error (A.4.17)";
CM_ SG_ 310 RFC_Loc138_RadarCrossSection "Radar Cross Section (RCS) estimation ISO 23150:2021(E): Radar cross section (A.4.5)";
CM_ SG_ 310 RFC_Loc138_DistVelocityQuality "Quality of radial distance and velocity resolution processing. Physical range [0..1]";
CM_ SG_ 310 RFC_Loc138_ElevationQuality "Probability for correct signal model (elevation angle). Physical range [0..1]";
CM_ SG_ 310 RFC_Loc138_AzimuthQuality "Probability for correct signal model (azimuth angle). Physical range [0..1]";
CM_ SG_ 310 RFC_Loc138_RSSI "Received Signal Strength Indication (RSSI). This signal is not exactly ISO 23150:2021(E): Signal to noise ratio - detection level (A.4.7), but SNR can be calculated from this signal. Further detail please refer to the DSP Location Interface definition";
CM_ SG_ 310 RFC_Loc138_AzimuthalPartnerId "Id of the azimuthal partner location";
CM_ SG_ 310 RFC_Loc139_RadialDistance "Location radial distance. Represented in conical coordinate system. Same as ISO 23150:2021(E): Position radial distance (A.4.16)";
CM_ SG_ 310 RFC_Loc139_RadialVelocity "Location radial relative velocity ISO 23150:2021(E): Relative velocity {radial distance} (A.4.18)";
CM_ SG_ 310 RFC_Loc139_Elevation "Location elevation angle. Represented in conical coordinate system. Same as ISO 23150:2021(E): Position elevation (A.4.16)";
CM_ SG_ 310 RFC_Loc139_Azimuth "Location azimuth angle. Represented in conical coordinate system. Deviation from ISO 23150:2021(E): Position azimuth (A.4.16). Further details refers to DSP Location Interface definition";
CM_ SG_ 310 RFC_Loc139_DistVelocityCoVnce "Covariance of radial distance and radial velocity";
CM_ SG_ 310 RFC_Loc139_RadialDistanceVnce "Variance of Location radial distance ISO 23150:2021(E): Position radial distance - error (A.4.17)";
CM_ SG_ 310 RFC_Loc139_RadialVelocityVnce "Variance of Location radial relative velocity ISO 23150:2021(E): Relative velocity {radial distance} - error (A.4.19)";
CM_ SG_ 310 RFC_Loc139_ElevationVnce "Variance of Location elevation angle ISO 23150:2021(E): Position elevation - error (A.4.17)";
CM_ SG_ 310 RFC_Loc139_AzimuthVnce "Variance of Location azimuth angle ISO 23150:2021(E): Position azimuth - error (A.4.17)";
CM_ SG_ 310 RFC_Loc139_RadarCrossSection "Radar Cross Section (RCS) estimation ISO 23150:2021(E): Radar cross section (A.4.5)";
CM_ SG_ 310 RFC_Loc139_DistVelocityQuality "Quality of radial distance and velocity resolution processing. Physical range [0..1]";
CM_ SG_ 310 RFC_Loc139_ElevationQuality "Probability for correct signal model (elevation angle). Physical range [0..1]";
CM_ SG_ 310 RFC_Loc139_AzimuthQuality "Probability for correct signal model (azimuth angle). Physical range [0..1]";
CM_ SG_ 310 RFC_Loc139_RSSI "Received Signal Strength Indication (RSSI). This signal is not exactly ISO 23150:2021(E): Signal to noise ratio - detection level (A.4.7), but SNR can be calculated from this signal. Further detail please refer to the DSP Location Interface definition";
CM_ SG_ 310 RFC_Loc139_AzimuthalPartnerId "Id of the azimuthal partner location";
CM_ SG_ 310 RFC_Loc140_RadialDistance "Location radial distance. Represented in conical coordinate system. Same as ISO 23150:2021(E): Position radial distance (A.4.16)";
CM_ SG_ 310 RFC_Loc140_RadialVelocity "Location radial relative velocity ISO 23150:2021(E): Relative velocity {radial distance} (A.4.18)";
CM_ SG_ 310 RFC_Loc140_Elevation "Location elevation angle. Represented in conical coordinate system. Same as ISO 23150:2021(E): Position elevation (A.4.16)";
CM_ SG_ 310 RFC_Loc140_Azimuth "Location azimuth angle. Represented in conical coordinate system. Deviation from ISO 23150:2021(E): Position azimuth (A.4.16). Further details refers to DSP Location Interface definition";
CM_ SG_ 310 RFC_Loc140_DistVelocityCoVnce "Covariance of radial distance and radial velocity";
CM_ SG_ 310 RFC_Loc140_RadialDistanceVnce "Variance of Location radial distance ISO 23150:2021(E): Position radial distance - error (A.4.17)";
CM_ SG_ 310 RFC_Loc140_RadialVelocityVnce "Variance of Location radial relative velocity ISO 23150:2021(E): Relative velocity {radial distance} - error (A.4.19)";
CM_ SG_ 310 RFC_Loc140_ElevationVnce "Variance of Location elevation angle ISO 23150:2021(E): Position elevation - error (A.4.17)";
CM_ SG_ 310 RFC_Loc140_AzimuthVnce "Variance of Location azimuth angle ISO 23150:2021(E): Position azimuth - error (A.4.17)";
CM_ SG_ 310 RFC_Loc140_RadarCrossSection "Radar Cross Section (RCS) estimation ISO 23150:2021(E): Radar cross section (A.4.5)";
CM_ SG_ 310 RFC_Loc140_DistVelocityQuality "Quality of radial distance and velocity resolution processing. Physical range [0..1]";
CM_ SG_ 310 RFC_Loc140_ElevationQuality "Probability for correct signal model (elevation angle). Physical range [0..1]";
CM_ SG_ 310 RFC_Loc140_AzimuthQuality "Probability for correct signal model (azimuth angle). Physical range [0..1]";
CM_ SG_ 310 RFC_Loc140_RSSI "Received Signal Strength Indication (RSSI). This signal is not exactly ISO 23150:2021(E): Signal to noise ratio - detection level (A.4.7), but SNR can be calculated from this signal. Further detail please refer to the DSP Location Interface definition";
CM_ SG_ 310 RFC_Loc140_AzimuthalPartnerId "Id of the azimuthal partner location";
CM_ SG_ 311 RFC_Loc141_143_CRC "CRC - Autosar E2E Profile 5";
CM_ SG_ 311 RFC_Loc141_143_AliveCtr "Alive counter - Autosar E2E Profile 5";
CM_ SG_ 311 RFC_Loc141_143_ProtBlockCtr "Protocol-Signal: Block-Counter";
CM_ SG_ 311 RFC_Loc141_RadialDistance "Location radial distance. Represented in conical coordinate system. Same as ISO 23150:2021(E): Position radial distance (A.4.16)";
CM_ SG_ 311 RFC_Loc141_RadialVelocity "Location radial relative velocity ISO 23150:2021(E): Relative velocity {radial distance} (A.4.18)";
CM_ SG_ 311 RFC_Loc141_Elevation "Location elevation angle. Represented in conical coordinate system. Same as ISO 23150:2021(E): Position elevation (A.4.16)";
CM_ SG_ 311 RFC_Loc141_Azimuth "Location azimuth angle. Represented in conical coordinate system. Deviation from ISO 23150:2021(E): Position azimuth (A.4.16). Further details refers to DSP Location Interface definition";
CM_ SG_ 311 RFC_Loc141_DistVelocityCoVnce "Covariance of radial distance and radial velocity";
CM_ SG_ 311 RFC_Loc141_RadialDistanceVnce "Variance of Location radial distance ISO 23150:2021(E): Position radial distance - error (A.4.17)";
CM_ SG_ 311 RFC_Loc141_RadialVelocityVnce "Variance of Location radial relative velocity ISO 23150:2021(E): Relative velocity {radial distance} - error (A.4.19)";
CM_ SG_ 311 RFC_Loc141_ElevationVnce "Variance of Location elevation angle ISO 23150:2021(E): Position elevation - error (A.4.17)";
CM_ SG_ 311 RFC_Loc141_AzimuthVnce "Variance of Location azimuth angle ISO 23150:2021(E): Position azimuth - error (A.4.17)";
CM_ SG_ 311 RFC_Loc141_RadarCrossSection "Radar Cross Section (RCS) estimation ISO 23150:2021(E): Radar cross section (A.4.5)";
CM_ SG_ 311 RFC_Loc141_DistVelocityQuality "Quality of radial distance and velocity resolution processing. Physical range [0..1]";
CM_ SG_ 311 RFC_Loc141_ElevationQuality "Probability for correct signal model (elevation angle). Physical range [0..1]";
CM_ SG_ 311 RFC_Loc141_AzimuthQuality "Probability for correct signal model (azimuth angle). Physical range [0..1]";
CM_ SG_ 311 RFC_Loc141_RSSI "Received Signal Strength Indication (RSSI). This signal is not exactly ISO 23150:2021(E): Signal to noise ratio - detection level (A.4.7), but SNR can be calculated from this signal. Further detail please refer to the DSP Location Interface definition";
CM_ SG_ 311 RFC_Loc141_AzimuthalPartnerId "Id of the azimuthal partner location";
CM_ SG_ 311 RFC_Loc142_RadialDistance "Location radial distance. Represented in conical coordinate system. Same as ISO 23150:2021(E): Position radial distance (A.4.16)";
CM_ SG_ 311 RFC_Loc142_RadialVelocity "Location radial relative velocity ISO 23150:2021(E): Relative velocity {radial distance} (A.4.18)";
CM_ SG_ 311 RFC_Loc142_Elevation "Location elevation angle. Represented in conical coordinate system. Same as ISO 23150:2021(E): Position elevation (A.4.16)";
CM_ SG_ 311 RFC_Loc142_Azimuth "Location azimuth angle. Represented in conical coordinate system. Deviation from ISO 23150:2021(E): Position azimuth (A.4.16). Further details refers to DSP Location Interface definition";
CM_ SG_ 311 RFC_Loc142_DistVelocityCoVnce "Covariance of radial distance and radial velocity";
CM_ SG_ 311 RFC_Loc142_RadialDistanceVnce "Variance of Location radial distance ISO 23150:2021(E): Position radial distance - error (A.4.17)";
CM_ SG_ 311 RFC_Loc142_RadialVelocityVnce "Variance of Location radial relative velocity ISO 23150:2021(E): Relative velocity {radial distance} - error (A.4.19)";
CM_ SG_ 311 RFC_Loc142_ElevationVnce "Variance of Location elevation angle ISO 23150:2021(E): Position elevation - error (A.4.17)";
CM_ SG_ 311 RFC_Loc142_AzimuthVnce "Variance of Location azimuth angle ISO 23150:2021(E): Position azimuth - error (A.4.17)";
CM_ SG_ 311 RFC_Loc142_RadarCrossSection "Radar Cross Section (RCS) estimation ISO 23150:2021(E): Radar cross section (A.4.5)";
CM_ SG_ 311 RFC_Loc142_DistVelocityQuality "Quality of radial distance and velocity resolution processing. Physical range [0..1]";
CM_ SG_ 311 RFC_Loc142_ElevationQuality "Probability for correct signal model (elevation angle). Physical range [0..1]";
CM_ SG_ 311 RFC_Loc142_AzimuthQuality "Probability for correct signal model (azimuth angle). Physical range [0..1]";
CM_ SG_ 311 RFC_Loc142_RSSI "Received Signal Strength Indication (RSSI). This signal is not exactly ISO 23150:2021(E): Signal to noise ratio - detection level (A.4.7), but SNR can be calculated from this signal. Further detail please refer to the DSP Location Interface definition";
CM_ SG_ 311 RFC_Loc142_AzimuthalPartnerId "Id of the azimuthal partner location";
CM_ SG_ 311 RFC_Loc143_RadialDistance "Location radial distance. Represented in conical coordinate system. Same as ISO 23150:2021(E): Position radial distance (A.4.16)";
CM_ SG_ 311 RFC_Loc143_RadialVelocity "Location radial relative velocity ISO 23150:2021(E): Relative velocity {radial distance} (A.4.18)";
CM_ SG_ 311 RFC_Loc143_Elevation "Location elevation angle. Represented in conical coordinate system. Same as ISO 23150:2021(E): Position elevation (A.4.16)";
CM_ SG_ 311 RFC_Loc143_Azimuth "Location azimuth angle. Represented in conical coordinate system. Deviation from ISO 23150:2021(E): Position azimuth (A.4.16). Further details refers to DSP Location Interface definition";
CM_ SG_ 311 RFC_Loc143_DistVelocityCoVnce "Covariance of radial distance and radial velocity";
CM_ SG_ 311 RFC_Loc143_RadialDistanceVnce "Variance of Location radial distance ISO 23150:2021(E): Position radial distance - error (A.4.17)";
CM_ SG_ 311 RFC_Loc143_RadialVelocityVnce "Variance of Location radial relative velocity ISO 23150:2021(E): Relative velocity {radial distance} - error (A.4.19)";
CM_ SG_ 311 RFC_Loc143_ElevationVnce "Variance of Location elevation angle ISO 23150:2021(E): Position elevation - error (A.4.17)";
CM_ SG_ 311 RFC_Loc143_AzimuthVnce "Variance of Location azimuth angle ISO 23150:2021(E): Position azimuth - error (A.4.17)";
CM_ SG_ 311 RFC_Loc143_RadarCrossSection "Radar Cross Section (RCS) estimation ISO 23150:2021(E): Radar cross section (A.4.5)";
CM_ SG_ 311 RFC_Loc143_DistVelocityQuality "Quality of radial distance and velocity resolution processing. Physical range [0..1]";
CM_ SG_ 311 RFC_Loc143_ElevationQuality "Probability for correct signal model (elevation angle). Physical range [0..1]";
CM_ SG_ 311 RFC_Loc143_AzimuthQuality "Probability for correct signal model (azimuth angle). Physical range [0..1]";
CM_ SG_ 311 RFC_Loc143_RSSI "Received Signal Strength Indication (RSSI). This signal is not exactly ISO 23150:2021(E): Signal to noise ratio - detection level (A.4.7), but SNR can be calculated from this signal. Further detail please refer to the DSP Location Interface definition";
CM_ SG_ 311 RFC_Loc143_AzimuthalPartnerId "Id of the azimuthal partner location";
CM_ SG_ 312 RFC_Loc144_146_CRC "CRC - Autosar E2E Profile 5";
CM_ SG_ 312 RFC_Loc144_146_AliveCtr "Alive counter - Autosar E2E Profile 5";
CM_ SG_ 312 RFC_Loc144_146_ProtBlockCtr "Protocol-Signal: Block-Counter";
CM_ SG_ 312 RFC_Loc144_RadialDistance "Location radial distance. Represented in conical coordinate system. Same as ISO 23150:2021(E): Position radial distance (A.4.16)";
CM_ SG_ 312 RFC_Loc144_RadialVelocity "Location radial relative velocity ISO 23150:2021(E): Relative velocity {radial distance} (A.4.18)";
CM_ SG_ 312 RFC_Loc144_Elevation "Location elevation angle. Represented in conical coordinate system. Same as ISO 23150:2021(E): Position elevation (A.4.16)";
CM_ SG_ 312 RFC_Loc144_Azimuth "Location azimuth angle. Represented in conical coordinate system. Deviation from ISO 23150:2021(E): Position azimuth (A.4.16). Further details refers to DSP Location Interface definition";
CM_ SG_ 312 RFC_Loc144_DistVelocityCoVnce "Covariance of radial distance and radial velocity";
CM_ SG_ 312 RFC_Loc144_RadialDistanceVnce "Variance of Location radial distance ISO 23150:2021(E): Position radial distance - error (A.4.17)";
CM_ SG_ 312 RFC_Loc144_RadialVelocityVnce "Variance of Location radial relative velocity ISO 23150:2021(E): Relative velocity {radial distance} - error (A.4.19)";
CM_ SG_ 312 RFC_Loc144_ElevationVnce "Variance of Location elevation angle ISO 23150:2021(E): Position elevation - error (A.4.17)";
CM_ SG_ 312 RFC_Loc144_AzimuthVnce "Variance of Location azimuth angle ISO 23150:2021(E): Position azimuth - error (A.4.17)";
CM_ SG_ 312 RFC_Loc144_RadarCrossSection "Radar Cross Section (RCS) estimation ISO 23150:2021(E): Radar cross section (A.4.5)";
CM_ SG_ 312 RFC_Loc144_DistVelocityQuality "Quality of radial distance and velocity resolution processing. Physical range [0..1]";
CM_ SG_ 312 RFC_Loc144_ElevationQuality "Probability for correct signal model (elevation angle). Physical range [0..1]";
CM_ SG_ 312 RFC_Loc144_AzimuthQuality "Probability for correct signal model (azimuth angle). Physical range [0..1]";
CM_ SG_ 312 RFC_Loc144_RSSI "Received Signal Strength Indication (RSSI). This signal is not exactly ISO 23150:2021(E): Signal to noise ratio - detection level (A.4.7), but SNR can be calculated from this signal. Further detail please refer to the DSP Location Interface definition";
CM_ SG_ 312 RFC_Loc144_AzimuthalPartnerId "Id of the azimuthal partner location";
CM_ SG_ 312 RFC_Loc145_RadialDistance "Location radial distance. Represented in conical coordinate system. Same as ISO 23150:2021(E): Position radial distance (A.4.16)";
CM_ SG_ 312 RFC_Loc145_RadialVelocity "Location radial relative velocity ISO 23150:2021(E): Relative velocity {radial distance} (A.4.18)";
CM_ SG_ 312 RFC_Loc145_Elevation "Location elevation angle. Represented in conical coordinate system. Same as ISO 23150:2021(E): Position elevation (A.4.16)";
CM_ SG_ 312 RFC_Loc145_Azimuth "Location azimuth angle. Represented in conical coordinate system. Deviation from ISO 23150:2021(E): Position azimuth (A.4.16). Further details refers to DSP Location Interface definition";
CM_ SG_ 312 RFC_Loc145_DistVelocityCoVnce "Covariance of radial distance and radial velocity";
CM_ SG_ 312 RFC_Loc145_RadialDistanceVnce "Variance of Location radial distance ISO 23150:2021(E): Position radial distance - error (A.4.17)";
CM_ SG_ 312 RFC_Loc145_RadialVelocityVnce "Variance of Location radial relative velocity ISO 23150:2021(E): Relative velocity {radial distance} - error (A.4.19)";
CM_ SG_ 312 RFC_Loc145_ElevationVnce "Variance of Location elevation angle ISO 23150:2021(E): Position elevation - error (A.4.17)";
CM_ SG_ 312 RFC_Loc145_AzimuthVnce "Variance of Location azimuth angle ISO 23150:2021(E): Position azimuth - error (A.4.17)";
CM_ SG_ 312 RFC_Loc145_RadarCrossSection "Radar Cross Section (RCS) estimation ISO 23150:2021(E): Radar cross section (A.4.5)";
CM_ SG_ 312 RFC_Loc145_DistVelocityQuality "Quality of radial distance and velocity resolution processing. Physical range [0..1]";
CM_ SG_ 312 RFC_Loc145_ElevationQuality "Probability for correct signal model (elevation angle). Physical range [0..1]";
CM_ SG_ 312 RFC_Loc145_AzimuthQuality "Probability for correct signal model (azimuth angle). Physical range [0..1]";
CM_ SG_ 312 RFC_Loc145_RSSI "Received Signal Strength Indication (RSSI). This signal is not exactly ISO 23150:2021(E): Signal to noise ratio - detection level (A.4.7), but SNR can be calculated from this signal. Further detail please refer to the DSP Location Interface definition";
CM_ SG_ 312 RFC_Loc145_AzimuthalPartnerId "Id of the azimuthal partner location";
CM_ SG_ 312 RFC_Loc146_RadialDistance "Location radial distance. Represented in conical coordinate system. Same as ISO 23150:2021(E): Position radial distance (A.4.16)";
CM_ SG_ 312 RFC_Loc146_RadialVelocity "Location radial relative velocity ISO 23150:2021(E): Relative velocity {radial distance} (A.4.18)";
CM_ SG_ 312 RFC_Loc146_Elevation "Location elevation angle. Represented in conical coordinate system. Same as ISO 23150:2021(E): Position elevation (A.4.16)";
CM_ SG_ 312 RFC_Loc146_Azimuth "Location azimuth angle. Represented in conical coordinate system. Deviation from ISO 23150:2021(E): Position azimuth (A.4.16). Further details refers to DSP Location Interface definition";
CM_ SG_ 312 RFC_Loc146_DistVelocityCoVnce "Covariance of radial distance and radial velocity";
CM_ SG_ 312 RFC_Loc146_RadialDistanceVnce "Variance of Location radial distance ISO 23150:2021(E): Position radial distance - error (A.4.17)";
CM_ SG_ 312 RFC_Loc146_RadialVelocityVnce "Variance of Location radial relative velocity ISO 23150:2021(E): Relative velocity {radial distance} - error (A.4.19)";
CM_ SG_ 312 RFC_Loc146_ElevationVnce "Variance of Location elevation angle ISO 23150:2021(E): Position elevation - error (A.4.17)";
CM_ SG_ 312 RFC_Loc146_AzimuthVnce "Variance of Location azimuth angle ISO 23150:2021(E): Position azimuth - error (A.4.17)";
CM_ SG_ 312 RFC_Loc146_RadarCrossSection "Radar Cross Section (RCS) estimation ISO 23150:2021(E): Radar cross section (A.4.5)";
CM_ SG_ 312 RFC_Loc146_DistVelocityQuality "Quality of radial distance and velocity resolution processing. Physical range [0..1]";
CM_ SG_ 312 RFC_Loc146_ElevationQuality "Probability for correct signal model (elevation angle). Physical range [0..1]";
CM_ SG_ 312 RFC_Loc146_AzimuthQuality "Probability for correct signal model (azimuth angle). Physical range [0..1]";
CM_ SG_ 312 RFC_Loc146_RSSI "Received Signal Strength Indication (RSSI). This signal is not exactly ISO 23150:2021(E): Signal to noise ratio - detection level (A.4.7), but SNR can be calculated from this signal. Further detail please refer to the DSP Location Interface definition";
CM_ SG_ 312 RFC_Loc146_AzimuthalPartnerId "Id of the azimuthal partner location";
CM_ SG_ 313 RFC_Loc147_149_CRC "CRC - Autosar E2E Profile 5";
CM_ SG_ 313 RFC_Loc147_149_AliveCtr "Alive counter - Autosar E2E Profile 5";
CM_ SG_ 313 RFC_Loc147_149_ProtBlockCtr "Protocol-Signal: Block-Counter";
CM_ SG_ 313 RFC_Loc147_RadialDistance "Location radial distance. Represented in conical coordinate system. Same as ISO 23150:2021(E): Position radial distance (A.4.16)";
CM_ SG_ 313 RFC_Loc147_RadialVelocity "Location radial relative velocity ISO 23150:2021(E): Relative velocity {radial distance} (A.4.18)";
CM_ SG_ 313 RFC_Loc147_Elevation "Location elevation angle. Represented in conical coordinate system. Same as ISO 23150:2021(E): Position elevation (A.4.16)";
CM_ SG_ 313 RFC_Loc147_Azimuth "Location azimuth angle. Represented in conical coordinate system. Deviation from ISO 23150:2021(E): Position azimuth (A.4.16). Further details refers to DSP Location Interface definition";
CM_ SG_ 313 RFC_Loc147_DistVelocityCoVnce "Covariance of radial distance and radial velocity";
CM_ SG_ 313 RFC_Loc147_RadialDistanceVnce "Variance of Location radial distance ISO 23150:2021(E): Position radial distance - error (A.4.17)";
CM_ SG_ 313 RFC_Loc147_RadialVelocityVnce "Variance of Location radial relative velocity ISO 23150:2021(E): Relative velocity {radial distance} - error (A.4.19)";
CM_ SG_ 313 RFC_Loc147_ElevationVnce "Variance of Location elevation angle ISO 23150:2021(E): Position elevation - error (A.4.17)";
CM_ SG_ 313 RFC_Loc147_AzimuthVnce "Variance of Location azimuth angle ISO 23150:2021(E): Position azimuth - error (A.4.17)";
CM_ SG_ 313 RFC_Loc147_RadarCrossSection "Radar Cross Section (RCS) estimation ISO 23150:2021(E): Radar cross section (A.4.5)";
CM_ SG_ 313 RFC_Loc147_DistVelocityQuality "Quality of radial distance and velocity resolution processing. Physical range [0..1]";
CM_ SG_ 313 RFC_Loc147_ElevationQuality "Probability for correct signal model (elevation angle). Physical range [0..1]";
CM_ SG_ 313 RFC_Loc147_AzimuthQuality "Probability for correct signal model (azimuth angle). Physical range [0..1]";
CM_ SG_ 313 RFC_Loc147_RSSI "Received Signal Strength Indication (RSSI). This signal is not exactly ISO 23150:2021(E): Signal to noise ratio - detection level (A.4.7), but SNR can be calculated from this signal. Further detail please refer to the DSP Location Interface definition";
CM_ SG_ 313 RFC_Loc147_AzimuthalPartnerId "Id of the azimuthal partner location";
CM_ SG_ 313 RFC_Loc148_RadialDistance "Location radial distance. Represented in conical coordinate system. Same as ISO 23150:2021(E): Position radial distance (A.4.16)";
CM_ SG_ 313 RFC_Loc148_RadialVelocity "Location radial relative velocity ISO 23150:2021(E): Relative velocity {radial distance} (A.4.18)";
CM_ SG_ 313 RFC_Loc148_Elevation "Location elevation angle. Represented in conical coordinate system. Same as ISO 23150:2021(E): Position elevation (A.4.16)";
CM_ SG_ 313 RFC_Loc148_Azimuth "Location azimuth angle. Represented in conical coordinate system. Deviation from ISO 23150:2021(E): Position azimuth (A.4.16). Further details refers to DSP Location Interface definition";
CM_ SG_ 313 RFC_Loc148_DistVelocityCoVnce "Covariance of radial distance and radial velocity";
CM_ SG_ 313 RFC_Loc148_RadialDistanceVnce "Variance of Location radial distance ISO 23150:2021(E): Position radial distance - error (A.4.17)";
CM_ SG_ 313 RFC_Loc148_RadialVelocityVnce "Variance of Location radial relative velocity ISO 23150:2021(E): Relative velocity {radial distance} - error (A.4.19)";
CM_ SG_ 313 RFC_Loc148_ElevationVnce "Variance of Location elevation angle ISO 23150:2021(E): Position elevation - error (A.4.17)";
CM_ SG_ 313 RFC_Loc148_AzimuthVnce "Variance of Location azimuth angle ISO 23150:2021(E): Position azimuth - error (A.4.17)";
CM_ SG_ 313 RFC_Loc148_RadarCrossSection "Radar Cross Section (RCS) estimation ISO 23150:2021(E): Radar cross section (A.4.5)";
CM_ SG_ 313 RFC_Loc148_DistVelocityQuality "Quality of radial distance and velocity resolution processing. Physical range [0..1]";
CM_ SG_ 313 RFC_Loc148_ElevationQuality "Probability for correct signal model (elevation angle). Physical range [0..1]";
CM_ SG_ 313 RFC_Loc148_AzimuthQuality "Probability for correct signal model (azimuth angle). Physical range [0..1]";
CM_ SG_ 313 RFC_Loc148_RSSI "Received Signal Strength Indication (RSSI). This signal is not exactly ISO 23150:2021(E): Signal to noise ratio - detection level (A.4.7), but SNR can be calculated from this signal. Further detail please refer to the DSP Location Interface definition";
CM_ SG_ 313 RFC_Loc148_AzimuthalPartnerId "Id of the azimuthal partner location";
CM_ SG_ 313 RFC_Loc149_RadialDistance "Location radial distance. Represented in conical coordinate system. Same as ISO 23150:2021(E): Position radial distance (A.4.16)";
CM_ SG_ 313 RFC_Loc149_RadialVelocity "Location radial relative velocity ISO 23150:2021(E): Relative velocity {radial distance} (A.4.18)";
CM_ SG_ 313 RFC_Loc149_Elevation "Location elevation angle. Represented in conical coordinate system. Same as ISO 23150:2021(E): Position elevation (A.4.16)";
CM_ SG_ 313 RFC_Loc149_Azimuth "Location azimuth angle. Represented in conical coordinate system. Deviation from ISO 23150:2021(E): Position azimuth (A.4.16). Further details refers to DSP Location Interface definition";
CM_ SG_ 313 RFC_Loc149_DistVelocityCoVnce "Covariance of radial distance and radial velocity";
CM_ SG_ 313 RFC_Loc149_RadialDistanceVnce "Variance of Location radial distance ISO 23150:2021(E): Position radial distance - error (A.4.17)";
CM_ SG_ 313 RFC_Loc149_RadialVelocityVnce "Variance of Location radial relative velocity ISO 23150:2021(E): Relative velocity {radial distance} - error (A.4.19)";
CM_ SG_ 313 RFC_Loc149_ElevationVnce "Variance of Location elevation angle ISO 23150:2021(E): Position elevation - error (A.4.17)";
CM_ SG_ 313 RFC_Loc149_AzimuthVnce "Variance of Location azimuth angle ISO 23150:2021(E): Position azimuth - error (A.4.17)";
CM_ SG_ 313 RFC_Loc149_RadarCrossSection "Radar Cross Section (RCS) estimation ISO 23150:2021(E): Radar cross section (A.4.5)";
CM_ SG_ 313 RFC_Loc149_DistVelocityQuality "Quality of radial distance and velocity resolution processing. Physical range [0..1]";
CM_ SG_ 313 RFC_Loc149_ElevationQuality "Probability for correct signal model (elevation angle). Physical range [0..1]";
CM_ SG_ 313 RFC_Loc149_AzimuthQuality "Probability for correct signal model (azimuth angle). Physical range [0..1]";
CM_ SG_ 313 RFC_Loc149_RSSI "Received Signal Strength Indication (RSSI). This signal is not exactly ISO 23150:2021(E): Signal to noise ratio - detection level (A.4.7), but SNR can be calculated from this signal. Further detail please refer to the DSP Location Interface definition";
CM_ SG_ 313 RFC_Loc149_AzimuthalPartnerId "Id of the azimuthal partner location";
CM_ SG_ 314 RFC_Loc150_152_CRC "CRC - Autosar E2E Profile 5";
CM_ SG_ 314 RFC_Loc150_152_AliveCtr "Alive counter - Autosar E2E Profile 5";
CM_ SG_ 314 RFC_Loc150_152_ProtBlockCtr "Protocol-Signal: Block-Counter";
CM_ SG_ 314 RFC_Loc150_RadialDistance "Location radial distance. Represented in conical coordinate system. Same as ISO 23150:2021(E): Position radial distance (A.4.16)";
CM_ SG_ 314 RFC_Loc150_RadialVelocity "Location radial relative velocity ISO 23150:2021(E): Relative velocity {radial distance} (A.4.18)";
CM_ SG_ 314 RFC_Loc150_Elevation "Location elevation angle. Represented in conical coordinate system. Same as ISO 23150:2021(E): Position elevation (A.4.16)";
CM_ SG_ 314 RFC_Loc150_Azimuth "Location azimuth angle. Represented in conical coordinate system. Deviation from ISO 23150:2021(E): Position azimuth (A.4.16). Further details refers to DSP Location Interface definition";
CM_ SG_ 314 RFC_Loc150_DistVelocityCoVnce "Covariance of radial distance and radial velocity";
CM_ SG_ 314 RFC_Loc150_RadialDistanceVnce "Variance of Location radial distance ISO 23150:2021(E): Position radial distance - error (A.4.17)";
CM_ SG_ 314 RFC_Loc150_RadialVelocityVnce "Variance of Location radial relative velocity ISO 23150:2021(E): Relative velocity {radial distance} - error (A.4.19)";
CM_ SG_ 314 RFC_Loc150_ElevationVnce "Variance of Location elevation angle ISO 23150:2021(E): Position elevation - error (A.4.17)";
CM_ SG_ 314 RFC_Loc150_AzimuthVnce "Variance of Location azimuth angle ISO 23150:2021(E): Position azimuth - error (A.4.17)";
CM_ SG_ 314 RFC_Loc150_RadarCrossSection "Radar Cross Section (RCS) estimation ISO 23150:2021(E): Radar cross section (A.4.5)";
CM_ SG_ 314 RFC_Loc150_DistVelocityQuality "Quality of radial distance and velocity resolution processing. Physical range [0..1]";
CM_ SG_ 314 RFC_Loc150_ElevationQuality "Probability for correct signal model (elevation angle). Physical range [0..1]";
CM_ SG_ 314 RFC_Loc150_AzimuthQuality "Probability for correct signal model (azimuth angle). Physical range [0..1]";
CM_ SG_ 314 RFC_Loc150_RSSI "Received Signal Strength Indication (RSSI). This signal is not exactly ISO 23150:2021(E): Signal to noise ratio - detection level (A.4.7), but SNR can be calculated from this signal. Further detail please refer to the DSP Location Interface definition";
CM_ SG_ 314 RFC_Loc150_AzimuthalPartnerId "Id of the azimuthal partner location";
CM_ SG_ 314 RFC_Loc151_RadialDistance "Location radial distance. Represented in conical coordinate system. Same as ISO 23150:2021(E): Position radial distance (A.4.16)";
CM_ SG_ 314 RFC_Loc151_RadialVelocity "Location radial relative velocity ISO 23150:2021(E): Relative velocity {radial distance} (A.4.18)";
CM_ SG_ 314 RFC_Loc151_Elevation "Location elevation angle. Represented in conical coordinate system. Same as ISO 23150:2021(E): Position elevation (A.4.16)";
CM_ SG_ 314 RFC_Loc151_Azimuth "Location azimuth angle. Represented in conical coordinate system. Deviation from ISO 23150:2021(E): Position azimuth (A.4.16). Further details refers to DSP Location Interface definition";
CM_ SG_ 314 RFC_Loc151_DistVelocityCoVnce "Covariance of radial distance and radial velocity";
CM_ SG_ 314 RFC_Loc151_RadialDistanceVnce "Variance of Location radial distance ISO 23150:2021(E): Position radial distance - error (A.4.17)";
CM_ SG_ 314 RFC_Loc151_RadialVelocityVnce "Variance of Location radial relative velocity ISO 23150:2021(E): Relative velocity {radial distance} - error (A.4.19)";
CM_ SG_ 314 RFC_Loc151_ElevationVnce "Variance of Location elevation angle ISO 23150:2021(E): Position elevation - error (A.4.17)";
CM_ SG_ 314 RFC_Loc151_AzimuthVnce "Variance of Location azimuth angle ISO 23150:2021(E): Position azimuth - error (A.4.17)";
CM_ SG_ 314 RFC_Loc151_RadarCrossSection "Radar Cross Section (RCS) estimation ISO 23150:2021(E): Radar cross section (A.4.5)";
CM_ SG_ 314 RFC_Loc151_DistVelocityQuality "Quality of radial distance and velocity resolution processing. Physical range [0..1]";
CM_ SG_ 314 RFC_Loc151_ElevationQuality "Probability for correct signal model (elevation angle). Physical range [0..1]";
CM_ SG_ 314 RFC_Loc151_AzimuthQuality "Probability for correct signal model (azimuth angle). Physical range [0..1]";
CM_ SG_ 314 RFC_Loc151_RSSI "Received Signal Strength Indication (RSSI). This signal is not exactly ISO 23150:2021(E): Signal to noise ratio - detection level (A.4.7), but SNR can be calculated from this signal. Further detail please refer to the DSP Location Interface definition";
CM_ SG_ 314 RFC_Loc151_AzimuthalPartnerId "Id of the azimuthal partner location";
CM_ SG_ 314 RFC_Loc152_RadialDistance "Location radial distance. Represented in conical coordinate system. Same as ISO 23150:2021(E): Position radial distance (A.4.16)";
CM_ SG_ 314 RFC_Loc152_RadialVelocity "Location radial relative velocity ISO 23150:2021(E): Relative velocity {radial distance} (A.4.18)";
CM_ SG_ 314 RFC_Loc152_Elevation "Location elevation angle. Represented in conical coordinate system. Same as ISO 23150:2021(E): Position elevation (A.4.16)";
CM_ SG_ 314 RFC_Loc152_Azimuth "Location azimuth angle. Represented in conical coordinate system. Deviation from ISO 23150:2021(E): Position azimuth (A.4.16). Further details refers to DSP Location Interface definition";
CM_ SG_ 314 RFC_Loc152_DistVelocityCoVnce "Covariance of radial distance and radial velocity";
CM_ SG_ 314 RFC_Loc152_RadialDistanceVnce "Variance of Location radial distance ISO 23150:2021(E): Position radial distance - error (A.4.17)";
CM_ SG_ 314 RFC_Loc152_RadialVelocityVnce "Variance of Location radial relative velocity ISO 23150:2021(E): Relative velocity {radial distance} - error (A.4.19)";
CM_ SG_ 314 RFC_Loc152_ElevationVnce "Variance of Location elevation angle ISO 23150:2021(E): Position elevation - error (A.4.17)";
CM_ SG_ 314 RFC_Loc152_AzimuthVnce "Variance of Location azimuth angle ISO 23150:2021(E): Position azimuth - error (A.4.17)";
CM_ SG_ 314 RFC_Loc152_RadarCrossSection "Radar Cross Section (RCS) estimation ISO 23150:2021(E): Radar cross section (A.4.5)";
CM_ SG_ 314 RFC_Loc152_DistVelocityQuality "Quality of radial distance and velocity resolution processing. Physical range [0..1]";
CM_ SG_ 314 RFC_Loc152_ElevationQuality "Probability for correct signal model (elevation angle). Physical range [0..1]";
CM_ SG_ 314 RFC_Loc152_AzimuthQuality "Probability for correct signal model (azimuth angle). Physical range [0..1]";
CM_ SG_ 314 RFC_Loc152_RSSI "Received Signal Strength Indication (RSSI). This signal is not exactly ISO 23150:2021(E): Signal to noise ratio - detection level (A.4.7), but SNR can be calculated from this signal. Further detail please refer to the DSP Location Interface definition";
CM_ SG_ 314 RFC_Loc152_AzimuthalPartnerId "Id of the azimuthal partner location";
CM_ SG_ 315 RFC_Loc153_155_CRC "CRC - Autosar E2E Profile 5";
CM_ SG_ 315 RFC_Loc153_155_AliveCtr "Alive counter - Autosar E2E Profile 5";
CM_ SG_ 315 RFC_Loc153_155_ProtBlockCtr "Protocol-Signal: Block-Counter";
CM_ SG_ 315 RFC_Loc153_RadialDistance "Location radial distance. Represented in conical coordinate system. Same as ISO 23150:2021(E): Position radial distance (A.4.16)";
CM_ SG_ 315 RFC_Loc153_RadialVelocity "Location radial relative velocity ISO 23150:2021(E): Relative velocity {radial distance} (A.4.18)";
CM_ SG_ 315 RFC_Loc153_Elevation "Location elevation angle. Represented in conical coordinate system. Same as ISO 23150:2021(E): Position elevation (A.4.16)";
CM_ SG_ 315 RFC_Loc153_Azimuth "Location azimuth angle. Represented in conical coordinate system. Deviation from ISO 23150:2021(E): Position azimuth (A.4.16). Further details refers to DSP Location Interface definition";
CM_ SG_ 315 RFC_Loc153_DistVelocityCoVnce "Covariance of radial distance and radial velocity";
CM_ SG_ 315 RFC_Loc153_RadialDistanceVnce "Variance of Location radial distance ISO 23150:2021(E): Position radial distance - error (A.4.17)";
CM_ SG_ 315 RFC_Loc153_RadialVelocityVnce "Variance of Location radial relative velocity ISO 23150:2021(E): Relative velocity {radial distance} - error (A.4.19)";
CM_ SG_ 315 RFC_Loc153_ElevationVnce "Variance of Location elevation angle ISO 23150:2021(E): Position elevation - error (A.4.17)";
CM_ SG_ 315 RFC_Loc153_AzimuthVnce "Variance of Location azimuth angle ISO 23150:2021(E): Position azimuth - error (A.4.17)";
CM_ SG_ 315 RFC_Loc153_RadarCrossSection "Radar Cross Section (RCS) estimation ISO 23150:2021(E): Radar cross section (A.4.5)";
CM_ SG_ 315 RFC_Loc153_DistVelocityQuality "Quality of radial distance and velocity resolution processing. Physical range [0..1]";
CM_ SG_ 315 RFC_Loc153_ElevationQuality "Probability for correct signal model (elevation angle). Physical range [0..1]";
CM_ SG_ 315 RFC_Loc153_AzimuthQuality "Probability for correct signal model (azimuth angle). Physical range [0..1]";
CM_ SG_ 315 RFC_Loc153_RSSI "Received Signal Strength Indication (RSSI). This signal is not exactly ISO 23150:2021(E): Signal to noise ratio - detection level (A.4.7), but SNR can be calculated from this signal. Further detail please refer to the DSP Location Interface definition";
CM_ SG_ 315 RFC_Loc153_AzimuthalPartnerId "Id of the azimuthal partner location";
CM_ SG_ 315 RFC_Loc154_RadialDistance "Location radial distance. Represented in conical coordinate system. Same as ISO 23150:2021(E): Position radial distance (A.4.16)";
CM_ SG_ 315 RFC_Loc154_RadialVelocity "Location radial relative velocity ISO 23150:2021(E): Relative velocity {radial distance} (A.4.18)";
CM_ SG_ 315 RFC_Loc154_Elevation "Location elevation angle. Represented in conical coordinate system. Same as ISO 23150:2021(E): Position elevation (A.4.16)";
CM_ SG_ 315 RFC_Loc154_Azimuth "Location azimuth angle. Represented in conical coordinate system. Deviation from ISO 23150:2021(E): Position azimuth (A.4.16). Further details refers to DSP Location Interface definition";
CM_ SG_ 315 RFC_Loc154_DistVelocityCoVnce "Covariance of radial distance and radial velocity";
CM_ SG_ 315 RFC_Loc154_RadialDistanceVnce "Variance of Location radial distance ISO 23150:2021(E): Position radial distance - error (A.4.17)";
CM_ SG_ 315 RFC_Loc154_RadialVelocityVnce "Variance of Location radial relative velocity ISO 23150:2021(E): Relative velocity {radial distance} - error (A.4.19)";
CM_ SG_ 315 RFC_Loc154_ElevationVnce "Variance of Location elevation angle ISO 23150:2021(E): Position elevation - error (A.4.17)";
CM_ SG_ 315 RFC_Loc154_AzimuthVnce "Variance of Location azimuth angle ISO 23150:2021(E): Position azimuth - error (A.4.17)";
CM_ SG_ 315 RFC_Loc154_RadarCrossSection "Radar Cross Section (RCS) estimation ISO 23150:2021(E): Radar cross section (A.4.5)";
CM_ SG_ 315 RFC_Loc154_DistVelocityQuality "Quality of radial distance and velocity resolution processing. Physical range [0..1]";
CM_ SG_ 315 RFC_Loc154_ElevationQuality "Probability for correct signal model (elevation angle). Physical range [0..1]";
CM_ SG_ 315 RFC_Loc154_AzimuthQuality "Probability for correct signal model (azimuth angle). Physical range [0..1]";
CM_ SG_ 315 RFC_Loc154_RSSI "Received Signal Strength Indication (RSSI). This signal is not exactly ISO 23150:2021(E): Signal to noise ratio - detection level (A.4.7), but SNR can be calculated from this signal. Further detail please refer to the DSP Location Interface definition";
CM_ SG_ 315 RFC_Loc154_AzimuthalPartnerId "Id of the azimuthal partner location";
CM_ SG_ 315 RFC_Loc155_RadialDistance "Location radial distance. Represented in conical coordinate system. Same as ISO 23150:2021(E): Position radial distance (A.4.16)";
CM_ SG_ 315 RFC_Loc155_RadialVelocity "Location radial relative velocity ISO 23150:2021(E): Relative velocity {radial distance} (A.4.18)";
CM_ SG_ 315 RFC_Loc155_Elevation "Location elevation angle. Represented in conical coordinate system. Same as ISO 23150:2021(E): Position elevation (A.4.16)";
CM_ SG_ 315 RFC_Loc155_Azimuth "Location azimuth angle. Represented in conical coordinate system. Deviation from ISO 23150:2021(E): Position azimuth (A.4.16). Further details refers to DSP Location Interface definition";
CM_ SG_ 315 RFC_Loc155_DistVelocityCoVnce "Covariance of radial distance and radial velocity";
CM_ SG_ 315 RFC_Loc155_RadialDistanceVnce "Variance of Location radial distance ISO 23150:2021(E): Position radial distance - error (A.4.17)";
CM_ SG_ 315 RFC_Loc155_RadialVelocityVnce "Variance of Location radial relative velocity ISO 23150:2021(E): Relative velocity {radial distance} - error (A.4.19)";
CM_ SG_ 315 RFC_Loc155_ElevationVnce "Variance of Location elevation angle ISO 23150:2021(E): Position elevation - error (A.4.17)";
CM_ SG_ 315 RFC_Loc155_AzimuthVnce "Variance of Location azimuth angle ISO 23150:2021(E): Position azimuth - error (A.4.17)";
CM_ SG_ 315 RFC_Loc155_RadarCrossSection "Radar Cross Section (RCS) estimation ISO 23150:2021(E): Radar cross section (A.4.5)";
CM_ SG_ 315 RFC_Loc155_DistVelocityQuality "Quality of radial distance and velocity resolution processing. Physical range [0..1]";
CM_ SG_ 315 RFC_Loc155_ElevationQuality "Probability for correct signal model (elevation angle). Physical range [0..1]";
CM_ SG_ 315 RFC_Loc155_AzimuthQuality "Probability for correct signal model (azimuth angle). Physical range [0..1]";
CM_ SG_ 315 RFC_Loc155_RSSI "Received Signal Strength Indication (RSSI). This signal is not exactly ISO 23150:2021(E): Signal to noise ratio - detection level (A.4.7), but SNR can be calculated from this signal. Further detail please refer to the DSP Location Interface definition";
CM_ SG_ 315 RFC_Loc155_AzimuthalPartnerId "Id of the azimuthal partner location";
CM_ SG_ 316 RFC_Loc156_158_CRC "CRC - Autosar E2E Profile 5";
CM_ SG_ 316 RFC_Loc156_158_AliveCtr "Alive counter - Autosar E2E Profile 5";
CM_ SG_ 316 RFC_Loc156_158_ProtBlockCtr "Protocol-Signal: Block-Counter";
CM_ SG_ 316 RFC_Loc156_RadialDistance "Location radial distance. Represented in conical coordinate system. Same as ISO 23150:2021(E): Position radial distance (A.4.16)";
CM_ SG_ 316 RFC_Loc156_RadialVelocity "Location radial relative velocity ISO 23150:2021(E): Relative velocity {radial distance} (A.4.18)";
CM_ SG_ 316 RFC_Loc156_Elevation "Location elevation angle. Represented in conical coordinate system. Same as ISO 23150:2021(E): Position elevation (A.4.16)";
CM_ SG_ 316 RFC_Loc156_Azimuth "Location azimuth angle. Represented in conical coordinate system. Deviation from ISO 23150:2021(E): Position azimuth (A.4.16). Further details refers to DSP Location Interface definition";
CM_ SG_ 316 RFC_Loc156_DistVelocityCoVnce "Covariance of radial distance and radial velocity";
CM_ SG_ 316 RFC_Loc156_RadialDistanceVnce "Variance of Location radial distance ISO 23150:2021(E): Position radial distance - error (A.4.17)";
CM_ SG_ 316 RFC_Loc156_RadialVelocityVnce "Variance of Location radial relative velocity ISO 23150:2021(E): Relative velocity {radial distance} - error (A.4.19)";
CM_ SG_ 316 RFC_Loc156_ElevationVnce "Variance of Location elevation angle ISO 23150:2021(E): Position elevation - error (A.4.17)";
CM_ SG_ 316 RFC_Loc156_AzimuthVnce "Variance of Location azimuth angle ISO 23150:2021(E): Position azimuth - error (A.4.17)";
CM_ SG_ 316 RFC_Loc156_RadarCrossSection "Radar Cross Section (RCS) estimation ISO 23150:2021(E): Radar cross section (A.4.5)";
CM_ SG_ 316 RFC_Loc156_DistVelocityQuality "Quality of radial distance and velocity resolution processing. Physical range [0..1]";
CM_ SG_ 316 RFC_Loc156_ElevationQuality "Probability for correct signal model (elevation angle). Physical range [0..1]";
CM_ SG_ 316 RFC_Loc156_AzimuthQuality "Probability for correct signal model (azimuth angle). Physical range [0..1]";
CM_ SG_ 316 RFC_Loc156_RSSI "Received Signal Strength Indication (RSSI). This signal is not exactly ISO 23150:2021(E): Signal to noise ratio - detection level (A.4.7), but SNR can be calculated from this signal. Further detail please refer to the DSP Location Interface definition";
CM_ SG_ 316 RFC_Loc156_AzimuthalPartnerId "Id of the azimuthal partner location";
CM_ SG_ 316 RFC_Loc157_RadialDistance "Location radial distance. Represented in conical coordinate system. Same as ISO 23150:2021(E): Position radial distance (A.4.16)";
CM_ SG_ 316 RFC_Loc157_RadialVelocity "Location radial relative velocity ISO 23150:2021(E): Relative velocity {radial distance} (A.4.18)";
CM_ SG_ 316 RFC_Loc157_Elevation "Location elevation angle. Represented in conical coordinate system. Same as ISO 23150:2021(E): Position elevation (A.4.16)";
CM_ SG_ 316 RFC_Loc157_Azimuth "Location azimuth angle. Represented in conical coordinate system. Deviation from ISO 23150:2021(E): Position azimuth (A.4.16). Further details refers to DSP Location Interface definition";
CM_ SG_ 316 RFC_Loc157_DistVelocityCoVnce "Covariance of radial distance and radial velocity";
CM_ SG_ 316 RFC_Loc157_RadialDistanceVnce "Variance of Location radial distance ISO 23150:2021(E): Position radial distance - error (A.4.17)";
CM_ SG_ 316 RFC_Loc157_RadialVelocityVnce "Variance of Location radial relative velocity ISO 23150:2021(E): Relative velocity {radial distance} - error (A.4.19)";
CM_ SG_ 316 RFC_Loc157_ElevationVnce "Variance of Location elevation angle ISO 23150:2021(E): Position elevation - error (A.4.17)";
CM_ SG_ 316 RFC_Loc157_AzimuthVnce "Variance of Location azimuth angle ISO 23150:2021(E): Position azimuth - error (A.4.17)";
CM_ SG_ 316 RFC_Loc157_RadarCrossSection "Radar Cross Section (RCS) estimation ISO 23150:2021(E): Radar cross section (A.4.5)";
CM_ SG_ 316 RFC_Loc157_DistVelocityQuality "Quality of radial distance and velocity resolution processing. Physical range [0..1]";
CM_ SG_ 316 RFC_Loc157_ElevationQuality "Probability for correct signal model (elevation angle). Physical range [0..1]";
CM_ SG_ 316 RFC_Loc157_AzimuthQuality "Probability for correct signal model (azimuth angle). Physical range [0..1]";
CM_ SG_ 316 RFC_Loc157_RSSI "Received Signal Strength Indication (RSSI). This signal is not exactly ISO 23150:2021(E): Signal to noise ratio - detection level (A.4.7), but SNR can be calculated from this signal. Further detail please refer to the DSP Location Interface definition";
CM_ SG_ 316 RFC_Loc157_AzimuthalPartnerId "Id of the azimuthal partner location";
CM_ SG_ 316 RFC_Loc158_RadialDistance "Location radial distance. Represented in conical coordinate system. Same as ISO 23150:2021(E): Position radial distance (A.4.16)";
CM_ SG_ 316 RFC_Loc158_RadialVelocity "Location radial relative velocity ISO 23150:2021(E): Relative velocity {radial distance} (A.4.18)";
CM_ SG_ 316 RFC_Loc158_Elevation "Location elevation angle. Represented in conical coordinate system. Same as ISO 23150:2021(E): Position elevation (A.4.16)";
CM_ SG_ 316 RFC_Loc158_Azimuth "Location azimuth angle. Represented in conical coordinate system. Deviation from ISO 23150:2021(E): Position azimuth (A.4.16). Further details refers to DSP Location Interface definition";
CM_ SG_ 316 RFC_Loc158_DistVelocityCoVnce "Covariance of radial distance and radial velocity";
CM_ SG_ 316 RFC_Loc158_RadialDistanceVnce "Variance of Location radial distance ISO 23150:2021(E): Position radial distance - error (A.4.17)";
CM_ SG_ 316 RFC_Loc158_RadialVelocityVnce "Variance of Location radial relative velocity ISO 23150:2021(E): Relative velocity {radial distance} - error (A.4.19)";
CM_ SG_ 316 RFC_Loc158_ElevationVnce "Variance of Location elevation angle ISO 23150:2021(E): Position elevation - error (A.4.17)";
CM_ SG_ 316 RFC_Loc158_AzimuthVnce "Variance of Location azimuth angle ISO 23150:2021(E): Position azimuth - error (A.4.17)";
CM_ SG_ 316 RFC_Loc158_RadarCrossSection "Radar Cross Section (RCS) estimation ISO 23150:2021(E): Radar cross section (A.4.5)";
CM_ SG_ 316 RFC_Loc158_DistVelocityQuality "Quality of radial distance and velocity resolution processing. Physical range [0..1]";
CM_ SG_ 316 RFC_Loc158_ElevationQuality "Probability for correct signal model (elevation angle). Physical range [0..1]";
CM_ SG_ 316 RFC_Loc158_AzimuthQuality "Probability for correct signal model (azimuth angle). Physical range [0..1]";
CM_ SG_ 316 RFC_Loc158_RSSI "Received Signal Strength Indication (RSSI). This signal is not exactly ISO 23150:2021(E): Signal to noise ratio - detection level (A.4.7), but SNR can be calculated from this signal. Further detail please refer to the DSP Location Interface definition";
CM_ SG_ 316 RFC_Loc158_AzimuthalPartnerId "Id of the azimuthal partner location";
CM_ SG_ 317 RFC_Loc159_161_CRC "CRC - Autosar E2E Profile 5";
CM_ SG_ 317 RFC_Loc159_161_AliveCtr "Alive counter - Autosar E2E Profile 5";
CM_ SG_ 317 RFC_Loc159_161_ProtBlockCtr "Protocol-Signal: Block-Counter";
CM_ SG_ 317 RFC_Loc159_RadialDistance "Location radial distance. Represented in conical coordinate system. Same as ISO 23150:2021(E): Position radial distance (A.4.16)";
CM_ SG_ 317 RFC_Loc159_RadialVelocity "Location radial relative velocity ISO 23150:2021(E): Relative velocity {radial distance} (A.4.18)";
CM_ SG_ 317 RFC_Loc159_Elevation "Location elevation angle. Represented in conical coordinate system. Same as ISO 23150:2021(E): Position elevation (A.4.16)";
CM_ SG_ 317 RFC_Loc159_Azimuth "Location azimuth angle. Represented in conical coordinate system. Deviation from ISO 23150:2021(E): Position azimuth (A.4.16). Further details refers to DSP Location Interface definition";
CM_ SG_ 317 RFC_Loc159_DistVelocityCoVnce "Covariance of radial distance and radial velocity";
CM_ SG_ 317 RFC_Loc159_RadialDistanceVnce "Variance of Location radial distance ISO 23150:2021(E): Position radial distance - error (A.4.17)";
CM_ SG_ 317 RFC_Loc159_RadialVelocityVnce "Variance of Location radial relative velocity ISO 23150:2021(E): Relative velocity {radial distance} - error (A.4.19)";
CM_ SG_ 317 RFC_Loc159_ElevationVnce "Variance of Location elevation angle ISO 23150:2021(E): Position elevation - error (A.4.17)";
CM_ SG_ 317 RFC_Loc159_AzimuthVnce "Variance of Location azimuth angle ISO 23150:2021(E): Position azimuth - error (A.4.17)";
CM_ SG_ 317 RFC_Loc159_RadarCrossSection "Radar Cross Section (RCS) estimation ISO 23150:2021(E): Radar cross section (A.4.5)";
CM_ SG_ 317 RFC_Loc159_DistVelocityQuality "Quality of radial distance and velocity resolution processing. Physical range [0..1]";
CM_ SG_ 317 RFC_Loc159_ElevationQuality "Probability for correct signal model (elevation angle). Physical range [0..1]";
CM_ SG_ 317 RFC_Loc159_AzimuthQuality "Probability for correct signal model (azimuth angle). Physical range [0..1]";
CM_ SG_ 317 RFC_Loc159_RSSI "Received Signal Strength Indication (RSSI). This signal is not exactly ISO 23150:2021(E): Signal to noise ratio - detection level (A.4.7), but SNR can be calculated from this signal. Further detail please refer to the DSP Location Interface definition";
CM_ SG_ 317 RFC_Loc159_AzimuthalPartnerId "Id of the azimuthal partner location";
CM_ SG_ 317 RFC_Loc160_RadialDistance "Location radial distance. Represented in conical coordinate system. Same as ISO 23150:2021(E): Position radial distance (A.4.16)";
CM_ SG_ 317 RFC_Loc160_RadialVelocity "Location radial relative velocity ISO 23150:2021(E): Relative velocity {radial distance} (A.4.18)";
CM_ SG_ 317 RFC_Loc160_Elevation "Location elevation angle. Represented in conical coordinate system. Same as ISO 23150:2021(E): Position elevation (A.4.16)";
CM_ SG_ 317 RFC_Loc160_Azimuth "Location azimuth angle. Represented in conical coordinate system. Deviation from ISO 23150:2021(E): Position azimuth (A.4.16). Further details refers to DSP Location Interface definition";
CM_ SG_ 317 RFC_Loc160_DistVelocityCoVnce "Covariance of radial distance and radial velocity";
CM_ SG_ 317 RFC_Loc160_RadialDistanceVnce "Variance of Location radial distance ISO 23150:2021(E): Position radial distance - error (A.4.17)";
CM_ SG_ 317 RFC_Loc160_RadialVelocityVnce "Variance of Location radial relative velocity ISO 23150:2021(E): Relative velocity {radial distance} - error (A.4.19)";
CM_ SG_ 317 RFC_Loc160_ElevationVnce "Variance of Location elevation angle ISO 23150:2021(E): Position elevation - error (A.4.17)";
CM_ SG_ 317 RFC_Loc160_AzimuthVnce "Variance of Location azimuth angle ISO 23150:2021(E): Position azimuth - error (A.4.17)";
CM_ SG_ 317 RFC_Loc160_RadarCrossSection "Radar Cross Section (RCS) estimation ISO 23150:2021(E): Radar cross section (A.4.5)";
CM_ SG_ 317 RFC_Loc160_DistVelocityQuality "Quality of radial distance and velocity resolution processing. Physical range [0..1]";
CM_ SG_ 317 RFC_Loc160_ElevationQuality "Probability for correct signal model (elevation angle). Physical range [0..1]";
CM_ SG_ 317 RFC_Loc160_AzimuthQuality "Probability for correct signal model (azimuth angle). Physical range [0..1]";
CM_ SG_ 317 RFC_Loc160_RSSI "Received Signal Strength Indication (RSSI). This signal is not exactly ISO 23150:2021(E): Signal to noise ratio - detection level (A.4.7), but SNR can be calculated from this signal. Further detail please refer to the DSP Location Interface definition";
CM_ SG_ 317 RFC_Loc160_AzimuthalPartnerId "Id of the azimuthal partner location";
CM_ SG_ 317 RFC_Loc161_RadialDistance "Location radial distance. Represented in conical coordinate system. Same as ISO 23150:2021(E): Position radial distance (A.4.16)";
CM_ SG_ 317 RFC_Loc161_RadialVelocity "Location radial relative velocity ISO 23150:2021(E): Relative velocity {radial distance} (A.4.18)";
CM_ SG_ 317 RFC_Loc161_Elevation "Location elevation angle. Represented in conical coordinate system. Same as ISO 23150:2021(E): Position elevation (A.4.16)";
CM_ SG_ 317 RFC_Loc161_Azimuth "Location azimuth angle. Represented in conical coordinate system. Deviation from ISO 23150:2021(E): Position azimuth (A.4.16). Further details refers to DSP Location Interface definition";
CM_ SG_ 317 RFC_Loc161_DistVelocityCoVnce "Covariance of radial distance and radial velocity";
CM_ SG_ 317 RFC_Loc161_RadialDistanceVnce "Variance of Location radial distance ISO 23150:2021(E): Position radial distance - error (A.4.17)";
CM_ SG_ 317 RFC_Loc161_RadialVelocityVnce "Variance of Location radial relative velocity ISO 23150:2021(E): Relative velocity {radial distance} - error (A.4.19)";
CM_ SG_ 317 RFC_Loc161_ElevationVnce "Variance of Location elevation angle ISO 23150:2021(E): Position elevation - error (A.4.17)";
CM_ SG_ 317 RFC_Loc161_AzimuthVnce "Variance of Location azimuth angle ISO 23150:2021(E): Position azimuth - error (A.4.17)";
CM_ SG_ 317 RFC_Loc161_RadarCrossSection "Radar Cross Section (RCS) estimation ISO 23150:2021(E): Radar cross section (A.4.5)";
CM_ SG_ 317 RFC_Loc161_DistVelocityQuality "Quality of radial distance and velocity resolution processing. Physical range [0..1]";
CM_ SG_ 317 RFC_Loc161_ElevationQuality "Probability for correct signal model (elevation angle). Physical range [0..1]";
CM_ SG_ 317 RFC_Loc161_AzimuthQuality "Probability for correct signal model (azimuth angle). Physical range [0..1]";
CM_ SG_ 317 RFC_Loc161_RSSI "Received Signal Strength Indication (RSSI). This signal is not exactly ISO 23150:2021(E): Signal to noise ratio - detection level (A.4.7), but SNR can be calculated from this signal. Further detail please refer to the DSP Location Interface definition";
CM_ SG_ 317 RFC_Loc161_AzimuthalPartnerId "Id of the azimuthal partner location";
CM_ SG_ 318 RFC_Loc162_164_CRC "CRC - Autosar E2E Profile 5";
CM_ SG_ 318 RFC_Loc162_164_AliveCtr "Alive counter - Autosar E2E Profile 5";
CM_ SG_ 318 RFC_Loc162_164_ProtBlockCtr "Protocol-Signal: Block-Counter";
CM_ SG_ 318 RFC_Loc162_RadialDistance "Location radial distance. Represented in conical coordinate system. Same as ISO 23150:2021(E): Position radial distance (A.4.16)";
CM_ SG_ 318 RFC_Loc162_RadialVelocity "Location radial relative velocity ISO 23150:2021(E): Relative velocity {radial distance} (A.4.18)";
CM_ SG_ 318 RFC_Loc162_Elevation "Location elevation angle. Represented in conical coordinate system. Same as ISO 23150:2021(E): Position elevation (A.4.16)";
CM_ SG_ 318 RFC_Loc162_Azimuth "Location azimuth angle. Represented in conical coordinate system. Deviation from ISO 23150:2021(E): Position azimuth (A.4.16). Further details refers to DSP Location Interface definition";
CM_ SG_ 318 RFC_Loc162_DistVelocityCoVnce "Covariance of radial distance and radial velocity";
CM_ SG_ 318 RFC_Loc162_RadialDistanceVnce "Variance of Location radial distance ISO 23150:2021(E): Position radial distance - error (A.4.17)";
CM_ SG_ 318 RFC_Loc162_RadialVelocityVnce "Variance of Location radial relative velocity ISO 23150:2021(E): Relative velocity {radial distance} - error (A.4.19)";
CM_ SG_ 318 RFC_Loc162_ElevationVnce "Variance of Location elevation angle ISO 23150:2021(E): Position elevation - error (A.4.17)";
CM_ SG_ 318 RFC_Loc162_AzimuthVnce "Variance of Location azimuth angle ISO 23150:2021(E): Position azimuth - error (A.4.17)";
CM_ SG_ 318 RFC_Loc162_RadarCrossSection "Radar Cross Section (RCS) estimation ISO 23150:2021(E): Radar cross section (A.4.5)";
CM_ SG_ 318 RFC_Loc162_DistVelocityQuality "Quality of radial distance and velocity resolution processing. Physical range [0..1]";
CM_ SG_ 318 RFC_Loc162_ElevationQuality "Probability for correct signal model (elevation angle). Physical range [0..1]";
CM_ SG_ 318 RFC_Loc162_AzimuthQuality "Probability for correct signal model (azimuth angle). Physical range [0..1]";
CM_ SG_ 318 RFC_Loc162_RSSI "Received Signal Strength Indication (RSSI). This signal is not exactly ISO 23150:2021(E): Signal to noise ratio - detection level (A.4.7), but SNR can be calculated from this signal. Further detail please refer to the DSP Location Interface definition";
CM_ SG_ 318 RFC_Loc162_AzimuthalPartnerId "Id of the azimuthal partner location";
CM_ SG_ 318 RFC_Loc163_RadialDistance "Location radial distance. Represented in conical coordinate system. Same as ISO 23150:2021(E): Position radial distance (A.4.16)";
CM_ SG_ 318 RFC_Loc163_RadialVelocity "Location radial relative velocity ISO 23150:2021(E): Relative velocity {radial distance} (A.4.18)";
CM_ SG_ 318 RFC_Loc163_Elevation "Location elevation angle. Represented in conical coordinate system. Same as ISO 23150:2021(E): Position elevation (A.4.16)";
CM_ SG_ 318 RFC_Loc163_Azimuth "Location azimuth angle. Represented in conical coordinate system. Deviation from ISO 23150:2021(E): Position azimuth (A.4.16). Further details refers to DSP Location Interface definition";
CM_ SG_ 318 RFC_Loc163_DistVelocityCoVnce "Covariance of radial distance and radial velocity";
CM_ SG_ 318 RFC_Loc163_RadialDistanceVnce "Variance of Location radial distance ISO 23150:2021(E): Position radial distance - error (A.4.17)";
CM_ SG_ 318 RFC_Loc163_RadialVelocityVnce "Variance of Location radial relative velocity ISO 23150:2021(E): Relative velocity {radial distance} - error (A.4.19)";
CM_ SG_ 318 RFC_Loc163_ElevationVnce "Variance of Location elevation angle ISO 23150:2021(E): Position elevation - error (A.4.17)";
CM_ SG_ 318 RFC_Loc163_AzimuthVnce "Variance of Location azimuth angle ISO 23150:2021(E): Position azimuth - error (A.4.17)";
CM_ SG_ 318 RFC_Loc163_RadarCrossSection "Radar Cross Section (RCS) estimation ISO 23150:2021(E): Radar cross section (A.4.5)";
CM_ SG_ 318 RFC_Loc163_DistVelocityQuality "Quality of radial distance and velocity resolution processing. Physical range [0..1]";
CM_ SG_ 318 RFC_Loc163_ElevationQuality "Probability for correct signal model (elevation angle). Physical range [0..1]";
CM_ SG_ 318 RFC_Loc163_AzimuthQuality "Probability for correct signal model (azimuth angle). Physical range [0..1]";
CM_ SG_ 318 RFC_Loc163_RSSI "Received Signal Strength Indication (RSSI). This signal is not exactly ISO 23150:2021(E): Signal to noise ratio - detection level (A.4.7), but SNR can be calculated from this signal. Further detail please refer to the DSP Location Interface definition";
CM_ SG_ 318 RFC_Loc163_AzimuthalPartnerId "Id of the azimuthal partner location";
CM_ SG_ 318 RFC_Loc164_RadialDistance "Location radial distance. Represented in conical coordinate system. Same as ISO 23150:2021(E): Position radial distance (A.4.16)";
CM_ SG_ 318 RFC_Loc164_RadialVelocity "Location radial relative velocity ISO 23150:2021(E): Relative velocity {radial distance} (A.4.18)";
CM_ SG_ 318 RFC_Loc164_Elevation "Location elevation angle. Represented in conical coordinate system. Same as ISO 23150:2021(E): Position elevation (A.4.16)";
CM_ SG_ 318 RFC_Loc164_Azimuth "Location azimuth angle. Represented in conical coordinate system. Deviation from ISO 23150:2021(E): Position azimuth (A.4.16). Further details refers to DSP Location Interface definition";
CM_ SG_ 318 RFC_Loc164_DistVelocityCoVnce "Covariance of radial distance and radial velocity";
CM_ SG_ 318 RFC_Loc164_RadialDistanceVnce "Variance of Location radial distance ISO 23150:2021(E): Position radial distance - error (A.4.17)";
CM_ SG_ 318 RFC_Loc164_RadialVelocityVnce "Variance of Location radial relative velocity ISO 23150:2021(E): Relative velocity {radial distance} - error (A.4.19)";
CM_ SG_ 318 RFC_Loc164_ElevationVnce "Variance of Location elevation angle ISO 23150:2021(E): Position elevation - error (A.4.17)";
CM_ SG_ 318 RFC_Loc164_AzimuthVnce "Variance of Location azimuth angle ISO 23150:2021(E): Position azimuth - error (A.4.17)";
CM_ SG_ 318 RFC_Loc164_RadarCrossSection "Radar Cross Section (RCS) estimation ISO 23150:2021(E): Radar cross section (A.4.5)";
CM_ SG_ 318 RFC_Loc164_DistVelocityQuality "Quality of radial distance and velocity resolution processing. Physical range [0..1]";
CM_ SG_ 318 RFC_Loc164_ElevationQuality "Probability for correct signal model (elevation angle). Physical range [0..1]";
CM_ SG_ 318 RFC_Loc164_AzimuthQuality "Probability for correct signal model (azimuth angle). Physical range [0..1]";
CM_ SG_ 318 RFC_Loc164_RSSI "Received Signal Strength Indication (RSSI). This signal is not exactly ISO 23150:2021(E): Signal to noise ratio - detection level (A.4.7), but SNR can be calculated from this signal. Further detail please refer to the DSP Location Interface definition";
CM_ SG_ 318 RFC_Loc164_AzimuthalPartnerId "Id of the azimuthal partner location";
CM_ SG_ 319 RFC_Loc165_167_CRC "CRC - Autosar E2E Profile 5";
CM_ SG_ 319 RFC_Loc165_167_AliveCtr "Alive counter - Autosar E2E Profile 5";
CM_ SG_ 319 RFC_Loc165_167_ProtBlockCtr "Protocol-Signal: Block-Counter";
CM_ SG_ 319 RFC_Loc165_RadialDistance "Location radial distance. Represented in conical coordinate system. Same as ISO 23150:2021(E): Position radial distance (A.4.16)";
CM_ SG_ 319 RFC_Loc165_RadialVelocity "Location radial relative velocity ISO 23150:2021(E): Relative velocity {radial distance} (A.4.18)";
CM_ SG_ 319 RFC_Loc165_Elevation "Location elevation angle. Represented in conical coordinate system. Same as ISO 23150:2021(E): Position elevation (A.4.16)";
CM_ SG_ 319 RFC_Loc165_Azimuth "Location azimuth angle. Represented in conical coordinate system. Deviation from ISO 23150:2021(E): Position azimuth (A.4.16). Further details refers to DSP Location Interface definition";
CM_ SG_ 319 RFC_Loc165_DistVelocityCoVnce "Covariance of radial distance and radial velocity";
CM_ SG_ 319 RFC_Loc165_RadialDistanceVnce "Variance of Location radial distance ISO 23150:2021(E): Position radial distance - error (A.4.17)";
CM_ SG_ 319 RFC_Loc165_RadialVelocityVnce "Variance of Location radial relative velocity ISO 23150:2021(E): Relative velocity {radial distance} - error (A.4.19)";
CM_ SG_ 319 RFC_Loc165_ElevationVnce "Variance of Location elevation angle ISO 23150:2021(E): Position elevation - error (A.4.17)";
CM_ SG_ 319 RFC_Loc165_AzimuthVnce "Variance of Location azimuth angle ISO 23150:2021(E): Position azimuth - error (A.4.17)";
CM_ SG_ 319 RFC_Loc165_RadarCrossSection "Radar Cross Section (RCS) estimation ISO 23150:2021(E): Radar cross section (A.4.5)";
CM_ SG_ 319 RFC_Loc165_DistVelocityQuality "Quality of radial distance and velocity resolution processing. Physical range [0..1]";
CM_ SG_ 319 RFC_Loc165_ElevationQuality "Probability for correct signal model (elevation angle). Physical range [0..1]";
CM_ SG_ 319 RFC_Loc165_AzimuthQuality "Probability for correct signal model (azimuth angle). Physical range [0..1]";
CM_ SG_ 319 RFC_Loc165_RSSI "Received Signal Strength Indication (RSSI). This signal is not exactly ISO 23150:2021(E): Signal to noise ratio - detection level (A.4.7), but SNR can be calculated from this signal. Further detail please refer to the DSP Location Interface definition";
CM_ SG_ 319 RFC_Loc165_AzimuthalPartnerId "Id of the azimuthal partner location";
CM_ SG_ 319 RFC_Loc166_RadialDistance "Location radial distance. Represented in conical coordinate system. Same as ISO 23150:2021(E): Position radial distance (A.4.16)";
CM_ SG_ 319 RFC_Loc166_RadialVelocity "Location radial relative velocity ISO 23150:2021(E): Relative velocity {radial distance} (A.4.18)";
CM_ SG_ 319 RFC_Loc166_Elevation "Location elevation angle. Represented in conical coordinate system. Same as ISO 23150:2021(E): Position elevation (A.4.16)";
CM_ SG_ 319 RFC_Loc166_Azimuth "Location azimuth angle. Represented in conical coordinate system. Deviation from ISO 23150:2021(E): Position azimuth (A.4.16). Further details refers to DSP Location Interface definition";
CM_ SG_ 319 RFC_Loc166_DistVelocityCoVnce "Covariance of radial distance and radial velocity";
CM_ SG_ 319 RFC_Loc166_RadialDistanceVnce "Variance of Location radial distance ISO 23150:2021(E): Position radial distance - error (A.4.17)";
CM_ SG_ 319 RFC_Loc166_RadialVelocityVnce "Variance of Location radial relative velocity ISO 23150:2021(E): Relative velocity {radial distance} - error (A.4.19)";
CM_ SG_ 319 RFC_Loc166_ElevationVnce "Variance of Location elevation angle ISO 23150:2021(E): Position elevation - error (A.4.17)";
CM_ SG_ 319 RFC_Loc166_AzimuthVnce "Variance of Location azimuth angle ISO 23150:2021(E): Position azimuth - error (A.4.17)";
CM_ SG_ 319 RFC_Loc166_RadarCrossSection "Radar Cross Section (RCS) estimation ISO 23150:2021(E): Radar cross section (A.4.5)";
CM_ SG_ 319 RFC_Loc166_DistVelocityQuality "Quality of radial distance and velocity resolution processing. Physical range [0..1]";
CM_ SG_ 319 RFC_Loc166_ElevationQuality "Probability for correct signal model (elevation angle). Physical range [0..1]";
CM_ SG_ 319 RFC_Loc166_AzimuthQuality "Probability for correct signal model (azimuth angle). Physical range [0..1]";
CM_ SG_ 319 RFC_Loc166_RSSI "Received Signal Strength Indication (RSSI). This signal is not exactly ISO 23150:2021(E): Signal to noise ratio - detection level (A.4.7), but SNR can be calculated from this signal. Further detail please refer to the DSP Location Interface definition";
CM_ SG_ 319 RFC_Loc166_AzimuthalPartnerId "Id of the azimuthal partner location";
CM_ SG_ 319 RFC_Loc167_RadialDistance "Location radial distance. Represented in conical coordinate system. Same as ISO 23150:2021(E): Position radial distance (A.4.16)";
CM_ SG_ 319 RFC_Loc167_RadialVelocity "Location radial relative velocity ISO 23150:2021(E): Relative velocity {radial distance} (A.4.18)";
CM_ SG_ 319 RFC_Loc167_Elevation "Location elevation angle. Represented in conical coordinate system. Same as ISO 23150:2021(E): Position elevation (A.4.16)";
CM_ SG_ 319 RFC_Loc167_Azimuth "Location azimuth angle. Represented in conical coordinate system. Deviation from ISO 23150:2021(E): Position azimuth (A.4.16). Further details refers to DSP Location Interface definition";
CM_ SG_ 319 RFC_Loc167_DistVelocityCoVnce "Covariance of radial distance and radial velocity";
CM_ SG_ 319 RFC_Loc167_RadialDistanceVnce "Variance of Location radial distance ISO 23150:2021(E): Position radial distance - error (A.4.17)";
CM_ SG_ 319 RFC_Loc167_RadialVelocityVnce "Variance of Location radial relative velocity ISO 23150:2021(E): Relative velocity {radial distance} - error (A.4.19)";
CM_ SG_ 319 RFC_Loc167_ElevationVnce "Variance of Location elevation angle ISO 23150:2021(E): Position elevation - error (A.4.17)";
CM_ SG_ 319 RFC_Loc167_AzimuthVnce "Variance of Location azimuth angle ISO 23150:2021(E): Position azimuth - error (A.4.17)";
CM_ SG_ 319 RFC_Loc167_RadarCrossSection "Radar Cross Section (RCS) estimation ISO 23150:2021(E): Radar cross section (A.4.5)";
CM_ SG_ 319 RFC_Loc167_DistVelocityQuality "Quality of radial distance and velocity resolution processing. Physical range [0..1]";
CM_ SG_ 319 RFC_Loc167_ElevationQuality "Probability for correct signal model (elevation angle). Physical range [0..1]";
CM_ SG_ 319 RFC_Loc167_AzimuthQuality "Probability for correct signal model (azimuth angle). Physical range [0..1]";
CM_ SG_ 319 RFC_Loc167_RSSI "Received Signal Strength Indication (RSSI). This signal is not exactly ISO 23150:2021(E): Signal to noise ratio - detection level (A.4.7), but SNR can be calculated from this signal. Further detail please refer to the DSP Location Interface definition";
CM_ SG_ 319 RFC_Loc167_AzimuthalPartnerId "Id of the azimuthal partner location";
CM_ SG_ 320 RFC_Loc168_170_CRC "CRC - Autosar E2E Profile 5";
CM_ SG_ 320 RFC_Loc168_170_AliveCtr "Alive counter - Autosar E2E Profile 5";
CM_ SG_ 320 RFC_Loc168_170_ProtBlockCtr "Protocol-Signal: Block-Counter";
CM_ SG_ 320 RFC_Loc168_RadialDistance "Location radial distance. Represented in conical coordinate system. Same as ISO 23150:2021(E): Position radial distance (A.4.16)";
CM_ SG_ 320 RFC_Loc168_RadialVelocity "Location radial relative velocity ISO 23150:2021(E): Relative velocity {radial distance} (A.4.18)";
CM_ SG_ 320 RFC_Loc168_Elevation "Location elevation angle. Represented in conical coordinate system. Same as ISO 23150:2021(E): Position elevation (A.4.16)";
CM_ SG_ 320 RFC_Loc168_Azimuth "Location azimuth angle. Represented in conical coordinate system. Deviation from ISO 23150:2021(E): Position azimuth (A.4.16). Further details refers to DSP Location Interface definition";
CM_ SG_ 320 RFC_Loc168_DistVelocityCoVnce "Covariance of radial distance and radial velocity";
CM_ SG_ 320 RFC_Loc168_RadialDistanceVnce "Variance of Location radial distance ISO 23150:2021(E): Position radial distance - error (A.4.17)";
CM_ SG_ 320 RFC_Loc168_RadialVelocityVnce "Variance of Location radial relative velocity ISO 23150:2021(E): Relative velocity {radial distance} - error (A.4.19)";
CM_ SG_ 320 RFC_Loc168_ElevationVnce "Variance of Location elevation angle ISO 23150:2021(E): Position elevation - error (A.4.17)";
CM_ SG_ 320 RFC_Loc168_AzimuthVnce "Variance of Location azimuth angle ISO 23150:2021(E): Position azimuth - error (A.4.17)";
CM_ SG_ 320 RFC_Loc168_RadarCrossSection "Radar Cross Section (RCS) estimation ISO 23150:2021(E): Radar cross section (A.4.5)";
CM_ SG_ 320 RFC_Loc168_DistVelocityQuality "Quality of radial distance and velocity resolution processing. Physical range [0..1]";
CM_ SG_ 320 RFC_Loc168_ElevationQuality "Probability for correct signal model (elevation angle). Physical range [0..1]";
CM_ SG_ 320 RFC_Loc168_AzimuthQuality "Probability for correct signal model (azimuth angle). Physical range [0..1]";
CM_ SG_ 320 RFC_Loc168_RSSI "Received Signal Strength Indication (RSSI). This signal is not exactly ISO 23150:2021(E): Signal to noise ratio - detection level (A.4.7), but SNR can be calculated from this signal. Further detail please refer to the DSP Location Interface definition";
CM_ SG_ 320 RFC_Loc168_AzimuthalPartnerId "Id of the azimuthal partner location";
CM_ SG_ 320 RFC_Loc169_RadialDistance "Location radial distance. Represented in conical coordinate system. Same as ISO 23150:2021(E): Position radial distance (A.4.16)";
CM_ SG_ 320 RFC_Loc169_RadialVelocity "Location radial relative velocity ISO 23150:2021(E): Relative velocity {radial distance} (A.4.18)";
CM_ SG_ 320 RFC_Loc169_Elevation "Location elevation angle. Represented in conical coordinate system. Same as ISO 23150:2021(E): Position elevation (A.4.16)";
CM_ SG_ 320 RFC_Loc169_Azimuth "Location azimuth angle. Represented in conical coordinate system. Deviation from ISO 23150:2021(E): Position azimuth (A.4.16). Further details refers to DSP Location Interface definition";
CM_ SG_ 320 RFC_Loc169_DistVelocityCoVnce "Covariance of radial distance and radial velocity";
CM_ SG_ 320 RFC_Loc169_RadialDistanceVnce "Variance of Location radial distance ISO 23150:2021(E): Position radial distance - error (A.4.17)";
CM_ SG_ 320 RFC_Loc169_RadialVelocityVnce "Variance of Location radial relative velocity ISO 23150:2021(E): Relative velocity {radial distance} - error (A.4.19)";
CM_ SG_ 320 RFC_Loc169_ElevationVnce "Variance of Location elevation angle ISO 23150:2021(E): Position elevation - error (A.4.17)";
CM_ SG_ 320 RFC_Loc169_AzimuthVnce "Variance of Location azimuth angle ISO 23150:2021(E): Position azimuth - error (A.4.17)";
CM_ SG_ 320 RFC_Loc169_RadarCrossSection "Radar Cross Section (RCS) estimation ISO 23150:2021(E): Radar cross section (A.4.5)";
CM_ SG_ 320 RFC_Loc169_DistVelocityQuality "Quality of radial distance and velocity resolution processing. Physical range [0..1]";
CM_ SG_ 320 RFC_Loc169_ElevationQuality "Probability for correct signal model (elevation angle). Physical range [0..1]";
CM_ SG_ 320 RFC_Loc169_AzimuthQuality "Probability for correct signal model (azimuth angle). Physical range [0..1]";
CM_ SG_ 320 RFC_Loc169_RSSI "Received Signal Strength Indication (RSSI). This signal is not exactly ISO 23150:2021(E): Signal to noise ratio - detection level (A.4.7), but SNR can be calculated from this signal. Further detail please refer to the DSP Location Interface definition";
CM_ SG_ 320 RFC_Loc169_AzimuthalPartnerId "Id of the azimuthal partner location";
CM_ SG_ 320 RFC_Loc170_RadialDistance "Location radial distance. Represented in conical coordinate system. Same as ISO 23150:2021(E): Position radial distance (A.4.16)";
CM_ SG_ 320 RFC_Loc170_RadialVelocity "Location radial relative velocity ISO 23150:2021(E): Relative velocity {radial distance} (A.4.18)";
CM_ SG_ 320 RFC_Loc170_Elevation "Location elevation angle. Represented in conical coordinate system. Same as ISO 23150:2021(E): Position elevation (A.4.16)";
CM_ SG_ 320 RFC_Loc170_Azimuth "Location azimuth angle. Represented in conical coordinate system. Deviation from ISO 23150:2021(E): Position azimuth (A.4.16). Further details refers to DSP Location Interface definition";
CM_ SG_ 320 RFC_Loc170_DistVelocityCoVnce "Covariance of radial distance and radial velocity";
CM_ SG_ 320 RFC_Loc170_RadialDistanceVnce "Variance of Location radial distance ISO 23150:2021(E): Position radial distance - error (A.4.17)";
CM_ SG_ 320 RFC_Loc170_RadialVelocityVnce "Variance of Location radial relative velocity ISO 23150:2021(E): Relative velocity {radial distance} - error (A.4.19)";
CM_ SG_ 320 RFC_Loc170_ElevationVnce "Variance of Location elevation angle ISO 23150:2021(E): Position elevation - error (A.4.17)";
CM_ SG_ 320 RFC_Loc170_AzimuthVnce "Variance of Location azimuth angle ISO 23150:2021(E): Position azimuth - error (A.4.17)";
CM_ SG_ 320 RFC_Loc170_RadarCrossSection "Radar Cross Section (RCS) estimation ISO 23150:2021(E): Radar cross section (A.4.5)";
CM_ SG_ 320 RFC_Loc170_DistVelocityQuality "Quality of radial distance and velocity resolution processing. Physical range [0..1]";
CM_ SG_ 320 RFC_Loc170_ElevationQuality "Probability for correct signal model (elevation angle). Physical range [0..1]";
CM_ SG_ 320 RFC_Loc170_AzimuthQuality "Probability for correct signal model (azimuth angle). Physical range [0..1]";
CM_ SG_ 320 RFC_Loc170_RSSI "Received Signal Strength Indication (RSSI). This signal is not exactly ISO 23150:2021(E): Signal to noise ratio - detection level (A.4.7), but SNR can be calculated from this signal. Further detail please refer to the DSP Location Interface definition";
CM_ SG_ 320 RFC_Loc170_AzimuthalPartnerId "Id of the azimuthal partner location";
BA_DEF_ SG_  "GenSigEnvVarType" ENUM  "int","float","undef";
BA_DEF_ SG_  "GenSigSendType" ENUM  "Cyclic","OnWrite","OnWriteWithRepetition","OnChange","OnChangeWithRepetition","IfActive","IfActiveWithRepetition";
BA_DEF_ BO_  "GenMsgCycleTimeFast" INT 2 50000;
BA_DEF_ BO_  "GenMsgILSupport" ENUM  "No","Yes";
BA_DEF_ BO_  "CANFD_BRS" ENUM  "0","1";
BA_DEF_ BO_  "GenMsgCycleTime" INT 0 65535;
BA_DEF_ BO_  "GenMsgSendType" ENUM  "Event","cyclic";
BA_DEF_ BO_  "VFrameFormat" ENUM  "StandardCAN","ExtendedCAN","reserved","reserved","reserved","reserved","reserved","reserved","reserved","reserved","reserved","reserved","reserved","reserved","StandardCAN_FD","ExtendedCAN_FD";
BA_DEF_ SG_  "GenSigStartValue" FLOAT 0 100000000000;
BA_DEF_DEF_  "GenSigEnvVarType" "undef";
BA_DEF_DEF_  "GenSigSendType" "Cyclic";
BA_DEF_DEF_  "GenMsgCycleTimeFast" 100;
BA_DEF_DEF_  "GenMsgILSupport" "Yes";
BA_DEF_DEF_  "CANFD_BRS" "1";
BA_DEF_DEF_  "GenMsgCycleTime" 0;
BA_DEF_DEF_  "GenMsgSendType" "";
BA_DEF_DEF_  "VFrameFormat" "";
BA_DEF_DEF_  "GenSigStartValue" 0;
BA_ "GenMsgSendType" BO_ 307 0;
BA_ "VFrameFormat" BO_ 307 14;
BA_ "GenMsgSendType" BO_ 308 0;
BA_ "VFrameFormat" BO_ 308 14;
BA_ "GenMsgSendType" BO_ 309 0;
BA_ "VFrameFormat" BO_ 309 14;
BA_ "GenMsgSendType" BO_ 310 0;
BA_ "VFrameFormat" BO_ 310 14;
BA_ "GenMsgSendType" BO_ 311 0;
BA_ "VFrameFormat" BO_ 311 14;
BA_ "GenMsgSendType" BO_ 312 0;
BA_ "VFrameFormat" BO_ 312 14;
BA_ "GenMsgSendType" BO_ 313 0;
BA_ "VFrameFormat" BO_ 313 14;
BA_ "GenMsgSendType" BO_ 314 0;
BA_ "VFrameFormat" BO_ 314 14;
BA_ "GenMsgSendType" BO_ 315 0;
BA_ "VFrameFormat" BO_ 315 14;
BA_ "GenMsgSendType" BO_ 316 0;
BA_ "VFrameFormat" BO_ 316 14;
BA_ "GenMsgSendType" BO_ 317 0;
BA_ "VFrameFormat" BO_ 317 14;
BA_ "GenMsgSendType" BO_ 318 0;
BA_ "VFrameFormat" BO_ 318 14;
BA_ "GenMsgSendType" BO_ 319 0;
BA_ "VFrameFormat" BO_ 319 14;
BA_ "GenMsgSendType" BO_ 320 0;
BA_ "VFrameFormat" BO_ 320 14;
BA_ "GenSigStartValue" SG_ 307 RFC_Loc129_RadialVelocity 16384;
BA_ "GenSigStartValue" SG_ 307 RFC_Loc129_Elevation 512;
BA_ "GenSigStartValue" SG_ 307 RFC_Loc129_Azimuth 1024;
BA_ "GenSigStartValue" SG_ 307 RFC_Loc129_DistVelocityCoVnce 1024;
BA_ "GenSigStartValue" SG_ 307 RFC_Loc129_RadarCrossSection 512;
BA_ "GenSigStartValue" SG_ 307 RFC_Loc130_RadialVelocity 16384;
BA_ "GenSigStartValue" SG_ 307 RFC_Loc130_Elevation 512;
BA_ "GenSigStartValue" SG_ 307 RFC_Loc130_Azimuth 1024;
BA_ "GenSigStartValue" SG_ 307 RFC_Loc130_DistVelocityCoVnce 1024;
BA_ "GenSigStartValue" SG_ 307 RFC_Loc130_RadarCrossSection 512;
BA_ "GenSigStartValue" SG_ 307 RFC_Loc131_RadialVelocity 16384;
BA_ "GenSigStartValue" SG_ 307 RFC_Loc131_Elevation 512;
BA_ "GenSigStartValue" SG_ 307 RFC_Loc131_Azimuth 1024;
BA_ "GenSigStartValue" SG_ 307 RFC_Loc131_DistVelocityCoVnce 1024;
BA_ "GenSigStartValue" SG_ 307 RFC_Loc131_RadarCrossSection 512;
BA_ "GenSigStartValue" SG_ 308 RFC_Loc132_RadialVelocity 16384;
BA_ "GenSigStartValue" SG_ 308 RFC_Loc132_Elevation 512;
BA_ "GenSigStartValue" SG_ 308 RFC_Loc132_Azimuth 1024;
BA_ "GenSigStartValue" SG_ 308 RFC_Loc132_DistVelocityCoVnce 1024;
BA_ "GenSigStartValue" SG_ 308 RFC_Loc132_RadarCrossSection 512;
BA_ "GenSigStartValue" SG_ 308 RFC_Loc133_RadialVelocity 16384;
BA_ "GenSigStartValue" SG_ 308 RFC_Loc133_Elevation 512;
BA_ "GenSigStartValue" SG_ 308 RFC_Loc133_Azimuth 1024;
BA_ "GenSigStartValue" SG_ 308 RFC_Loc133_DistVelocityCoVnce 1024;
BA_ "GenSigStartValue" SG_ 308 RFC_Loc133_RadarCrossSection 512;
BA_ "GenSigStartValue" SG_ 308 RFC_Loc134_RadialVelocity 16384;
BA_ "GenSigStartValue" SG_ 308 RFC_Loc134_Elevation 512;
BA_ "GenSigStartValue" SG_ 308 RFC_Loc134_Azimuth 1024;
BA_ "GenSigStartValue" SG_ 308 RFC_Loc134_DistVelocityCoVnce 1024;
BA_ "GenSigStartValue" SG_ 308 RFC_Loc134_RadarCrossSection 512;
BA_ "GenSigStartValue" SG_ 309 RFC_Loc135_RadialVelocity 16384;
BA_ "GenSigStartValue" SG_ 309 RFC_Loc135_Elevation 512;
BA_ "GenSigStartValue" SG_ 309 RFC_Loc135_Azimuth 1024;
BA_ "GenSigStartValue" SG_ 309 RFC_Loc135_DistVelocityCoVnce 1024;
BA_ "GenSigStartValue" SG_ 309 RFC_Loc135_RadarCrossSection 512;
BA_ "GenSigStartValue" SG_ 309 RFC_Loc136_RadialVelocity 16384;
BA_ "GenSigStartValue" SG_ 309 RFC_Loc136_Elevation 512;
BA_ "GenSigStartValue" SG_ 309 RFC_Loc136_Azimuth 1024;
BA_ "GenSigStartValue" SG_ 309 RFC_Loc136_DistVelocityCoVnce 1024;
BA_ "GenSigStartValue" SG_ 309 RFC_Loc136_RadarCrossSection 512;
BA_ "GenSigStartValue" SG_ 309 RFC_Loc137_RadialVelocity 16384;
BA_ "GenSigStartValue" SG_ 309 RFC_Loc137_Elevation 512;
BA_ "GenSigStartValue" SG_ 309 RFC_Loc137_Azimuth 1024;
BA_ "GenSigStartValue" SG_ 309 RFC_Loc137_DistVelocityCoVnce 1024;
BA_ "GenSigStartValue" SG_ 309 RFC_Loc137_RadarCrossSection 512;
BA_ "GenSigStartValue" SG_ 310 RFC_Loc138_RadialVelocity 16384;
BA_ "GenSigStartValue" SG_ 310 RFC_Loc138_Elevation 512;
BA_ "GenSigStartValue" SG_ 310 RFC_Loc138_Azimuth 1024;
BA_ "GenSigStartValue" SG_ 310 RFC_Loc138_DistVelocityCoVnce 1024;
BA_ "GenSigStartValue" SG_ 310 RFC_Loc138_RadarCrossSection 512;
BA_ "GenSigStartValue" SG_ 310 RFC_Loc139_RadialVelocity 16384;
BA_ "GenSigStartValue" SG_ 310 RFC_Loc139_Elevation 512;
BA_ "GenSigStartValue" SG_ 310 RFC_Loc139_Azimuth 1024;
BA_ "GenSigStartValue" SG_ 310 RFC_Loc139_DistVelocityCoVnce 1024;
BA_ "GenSigStartValue" SG_ 310 RFC_Loc139_RadarCrossSection 512;
BA_ "GenSigStartValue" SG_ 310 RFC_Loc140_RadialVelocity 16384;
BA_ "GenSigStartValue" SG_ 310 RFC_Loc140_Elevation 512;
BA_ "GenSigStartValue" SG_ 310 RFC_Loc140_Azimuth 1024;
BA_ "GenSigStartValue" SG_ 310 RFC_Loc140_DistVelocityCoVnce 1024;
BA_ "GenSigStartValue" SG_ 310 RFC_Loc140_RadarCrossSection 512;
BA_ "GenSigStartValue" SG_ 311 RFC_Loc141_RadialVelocity 16384;
BA_ "GenSigStartValue" SG_ 311 RFC_Loc141_Elevation 512;
BA_ "GenSigStartValue" SG_ 311 RFC_Loc141_Azimuth 1024;
BA_ "GenSigStartValue" SG_ 311 RFC_Loc141_DistVelocityCoVnce 1024;
BA_ "GenSigStartValue" SG_ 311 RFC_Loc141_RadarCrossSection 512;
BA_ "GenSigStartValue" SG_ 311 RFC_Loc142_RadialVelocity 16384;
BA_ "GenSigStartValue" SG_ 311 RFC_Loc142_Elevation 512;
BA_ "GenSigStartValue" SG_ 311 RFC_Loc142_Azimuth 1024;
BA_ "GenSigStartValue" SG_ 311 RFC_Loc142_DistVelocityCoVnce 1024;
BA_ "GenSigStartValue" SG_ 311 RFC_Loc142_RadarCrossSection 512;
BA_ "GenSigStartValue" SG_ 311 RFC_Loc143_RadialVelocity 16384;
BA_ "GenSigStartValue" SG_ 311 RFC_Loc143_Elevation 512;
BA_ "GenSigStartValue" SG_ 311 RFC_Loc143_Azimuth 1024;
BA_ "GenSigStartValue" SG_ 311 RFC_Loc143_DistVelocityCoVnce 1024;
BA_ "GenSigStartValue" SG_ 311 RFC_Loc143_RadarCrossSection 512;
BA_ "GenSigStartValue" SG_ 312 RFC_Loc144_RadialVelocity 16384;
BA_ "GenSigStartValue" SG_ 312 RFC_Loc144_Elevation 512;
BA_ "GenSigStartValue" SG_ 312 RFC_Loc144_Azimuth 1024;
BA_ "GenSigStartValue" SG_ 312 RFC_Loc144_DistVelocityCoVnce 1024;
BA_ "GenSigStartValue" SG_ 312 RFC_Loc144_RadarCrossSection 512;
BA_ "GenSigStartValue" SG_ 312 RFC_Loc145_RadialVelocity 16384;
BA_ "GenSigStartValue" SG_ 312 RFC_Loc145_Elevation 512;
BA_ "GenSigStartValue" SG_ 312 RFC_Loc145_Azimuth 1024;
BA_ "GenSigStartValue" SG_ 312 RFC_Loc145_DistVelocityCoVnce 1024;
BA_ "GenSigStartValue" SG_ 312 RFC_Loc145_RadarCrossSection 512;
BA_ "GenSigStartValue" SG_ 312 RFC_Loc146_RadialVelocity 16384;
BA_ "GenSigStartValue" SG_ 312 RFC_Loc146_Elevation 512;
BA_ "GenSigStartValue" SG_ 312 RFC_Loc146_Azimuth 1024;
BA_ "GenSigStartValue" SG_ 312 RFC_Loc146_DistVelocityCoVnce 1024;
BA_ "GenSigStartValue" SG_ 312 RFC_Loc146_RadarCrossSection 512;
BA_ "GenSigStartValue" SG_ 313 RFC_Loc147_RadialVelocity 16384;
BA_ "GenSigStartValue" SG_ 313 RFC_Loc147_Elevation 512;
BA_ "GenSigStartValue" SG_ 313 RFC_Loc147_Azimuth 1024;
BA_ "GenSigStartValue" SG_ 313 RFC_Loc147_DistVelocityCoVnce 1024;
BA_ "GenSigStartValue" SG_ 313 RFC_Loc147_RadarCrossSection 512;
BA_ "GenSigStartValue" SG_ 313 RFC_Loc148_RadialVelocity 16384;
BA_ "GenSigStartValue" SG_ 313 RFC_Loc148_Elevation 512;
BA_ "GenSigStartValue" SG_ 313 RFC_Loc148_Azimuth 1024;
BA_ "GenSigStartValue" SG_ 313 RFC_Loc148_DistVelocityCoVnce 1024;
BA_ "GenSigStartValue" SG_ 313 RFC_Loc148_RadarCrossSection 512;
BA_ "GenSigStartValue" SG_ 313 RFC_Loc149_RadialVelocity 16384;
BA_ "GenSigStartValue" SG_ 313 RFC_Loc149_Elevation 512;
BA_ "GenSigStartValue" SG_ 313 RFC_Loc149_Azimuth 1024;
BA_ "GenSigStartValue" SG_ 313 RFC_Loc149_DistVelocityCoVnce 1024;
BA_ "GenSigStartValue" SG_ 313 RFC_Loc149_RadarCrossSection 512;
BA_ "GenSigStartValue" SG_ 314 RFC_Loc150_RadialVelocity 16384;
BA_ "GenSigStartValue" SG_ 314 RFC_Loc150_Elevation 512;
BA_ "GenSigStartValue" SG_ 314 RFC_Loc150_Azimuth 1024;
BA_ "GenSigStartValue" SG_ 314 RFC_Loc150_DistVelocityCoVnce 1024;
BA_ "GenSigStartValue" SG_ 314 RFC_Loc150_RadarCrossSection 512;
BA_ "GenSigStartValue" SG_ 314 RFC_Loc151_RadialVelocity 16384;
BA_ "GenSigStartValue" SG_ 314 RFC_Loc151_Elevation 512;
BA_ "GenSigStartValue" SG_ 314 RFC_Loc151_Azimuth 1024;
BA_ "GenSigStartValue" SG_ 314 RFC_Loc151_DistVelocityCoVnce 1024;
BA_ "GenSigStartValue" SG_ 314 RFC_Loc151_RadarCrossSection 512;
BA_ "GenSigStartValue" SG_ 314 RFC_Loc152_RadialVelocity 16384;
BA_ "GenSigStartValue" SG_ 314 RFC_Loc152_Elevation 512;
BA_ "GenSigStartValue" SG_ 314 RFC_Loc152_Azimuth 1024;
BA_ "GenSigStartValue" SG_ 314 RFC_Loc152_DistVelocityCoVnce 1024;
BA_ "GenSigStartValue" SG_ 314 RFC_Loc152_RadarCrossSection 512;
BA_ "GenSigStartValue" SG_ 315 RFC_Loc153_RadialVelocity 16384;
BA_ "GenSigStartValue" SG_ 315 RFC_Loc153_Elevation 512;
BA_ "GenSigStartValue" SG_ 315 RFC_Loc153_Azimuth 1024;
BA_ "GenSigStartValue" SG_ 315 RFC_Loc153_DistVelocityCoVnce 1024;
BA_ "GenSigStartValue" SG_ 315 RFC_Loc153_RadarCrossSection 512;
BA_ "GenSigStartValue" SG_ 315 RFC_Loc154_RadialVelocity 16384;
BA_ "GenSigStartValue" SG_ 315 RFC_Loc154_Elevation 512;
BA_ "GenSigStartValue" SG_ 315 RFC_Loc154_Azimuth 1024;
BA_ "GenSigStartValue" SG_ 315 RFC_Loc154_DistVelocityCoVnce 1024;
BA_ "GenSigStartValue" SG_ 315 RFC_Loc154_RadarCrossSection 512;
BA_ "GenSigStartValue" SG_ 315 RFC_Loc155_RadialVelocity 16384;
BA_ "GenSigStartValue" SG_ 315 RFC_Loc155_Elevation 512;
BA_ "GenSigStartValue" SG_ 315 RFC_Loc155_Azimuth 1024;
BA_ "GenSigStartValue" SG_ 315 RFC_Loc155_DistVelocityCoVnce 1024;
BA_ "GenSigStartValue" SG_ 315 RFC_Loc155_RadarCrossSection 512;
BA_ "GenSigStartValue" SG_ 316 RFC_Loc156_RadialVelocity 16384;
BA_ "GenSigStartValue" SG_ 316 RFC_Loc156_Elevation 512;
BA_ "GenSigStartValue" SG_ 316 RFC_Loc156_Azimuth 1024;
BA_ "GenSigStartValue" SG_ 316 RFC_Loc156_DistVelocityCoVnce 1024;
BA_ "GenSigStartValue" SG_ 316 RFC_Loc156_RadarCrossSection 512;
BA_ "GenSigStartValue" SG_ 316 RFC_Loc157_RadialVelocity 16384;
BA_ "GenSigStartValue" SG_ 316 RFC_Loc157_Elevation 512;
BA_ "GenSigStartValue" SG_ 316 RFC_Loc157_Azimuth 1024;
BA_ "GenSigStartValue" SG_ 316 RFC_Loc157_DistVelocityCoVnce 1024;
BA_ "GenSigStartValue" SG_ 316 RFC_Loc157_RadarCrossSection 512;
BA_ "GenSigStartValue" SG_ 316 RFC_Loc158_RadialVelocity 16384;
BA_ "GenSigStartValue" SG_ 316 RFC_Loc158_Elevation 512;
BA_ "GenSigStartValue" SG_ 316 RFC_Loc158_Azimuth 1024;
BA_ "GenSigStartValue" SG_ 316 RFC_Loc158_DistVelocityCoVnce 1024;
BA_ "GenSigStartValue" SG_ 316 RFC_Loc158_RadarCrossSection 512;
BA_ "GenSigStartValue" SG_ 317 RFC_Loc159_RadialVelocity 16384;
BA_ "GenSigStartValue" SG_ 317 RFC_Loc159_Elevation 512;
BA_ "GenSigStartValue" SG_ 317 RFC_Loc159_Azimuth 1024;
BA_ "GenSigStartValue" SG_ 317 RFC_Loc159_DistVelocityCoVnce 1024;
BA_ "GenSigStartValue" SG_ 317 RFC_Loc159_RadarCrossSection 512;
BA_ "GenSigStartValue" SG_ 317 RFC_Loc160_RadialVelocity 16384;
BA_ "GenSigStartValue" SG_ 317 RFC_Loc160_Elevation 512;
BA_ "GenSigStartValue" SG_ 317 RFC_Loc160_Azimuth 1024;
BA_ "GenSigStartValue" SG_ 317 RFC_Loc160_DistVelocityCoVnce 1024;
BA_ "GenSigStartValue" SG_ 317 RFC_Loc160_RadarCrossSection 512;
BA_ "GenSigStartValue" SG_ 317 RFC_Loc161_RadialVelocity 16384;
BA_ "GenSigStartValue" SG_ 317 RFC_Loc161_Elevation 512;
BA_ "GenSigStartValue" SG_ 317 RFC_Loc161_Azimuth 1024;
BA_ "GenSigStartValue" SG_ 317 RFC_Loc161_DistVelocityCoVnce 1024;
BA_ "GenSigStartValue" SG_ 317 RFC_Loc161_RadarCrossSection 512;
BA_ "GenSigStartValue" SG_ 318 RFC_Loc162_RadialVelocity 16384;
BA_ "GenSigStartValue" SG_ 318 RFC_Loc162_Elevation 512;
BA_ "GenSigStartValue" SG_ 318 RFC_Loc162_Azimuth 1024;
BA_ "GenSigStartValue" SG_ 318 RFC_Loc162_DistVelocityCoVnce 1024;
BA_ "GenSigStartValue" SG_ 318 RFC_Loc162_RadarCrossSection 512;
BA_ "GenSigStartValue" SG_ 318 RFC_Loc163_RadialVelocity 16384;
BA_ "GenSigStartValue" SG_ 318 RFC_Loc163_Elevation 512;
BA_ "GenSigStartValue" SG_ 318 RFC_Loc163_Azimuth 1024;
BA_ "GenSigStartValue" SG_ 318 RFC_Loc163_DistVelocityCoVnce 1024;
BA_ "GenSigStartValue" SG_ 318 RFC_Loc163_RadarCrossSection 512;
BA_ "GenSigStartValue" SG_ 318 RFC_Loc164_RadialVelocity 16384;
BA_ "GenSigStartValue" SG_ 318 RFC_Loc164_Elevation 512;
BA_ "GenSigStartValue" SG_ 318 RFC_Loc164_Azimuth 1024;
BA_ "GenSigStartValue" SG_ 318 RFC_Loc164_DistVelocityCoVnce 1024;
BA_ "GenSigStartValue" SG_ 318 RFC_Loc164_RadarCrossSection 512;
BA_ "GenSigStartValue" SG_ 319 RFC_Loc165_RadialVelocity 16384;
BA_ "GenSigStartValue" SG_ 319 RFC_Loc165_Elevation 512;
BA_ "GenSigStartValue" SG_ 319 RFC_Loc165_Azimuth 1024;
BA_ "GenSigStartValue" SG_ 319 RFC_Loc165_DistVelocityCoVnce 1024;
BA_ "GenSigStartValue" SG_ 319 RFC_Loc165_RadarCrossSection 512;
BA_ "GenSigStartValue" SG_ 319 RFC_Loc166_RadialVelocity 16384;
BA_ "GenSigStartValue" SG_ 319 RFC_Loc166_Elevation 512;
BA_ "GenSigStartValue" SG_ 319 RFC_Loc166_Azimuth 1024;
BA_ "GenSigStartValue" SG_ 319 RFC_Loc166_DistVelocityCoVnce 1024;
BA_ "GenSigStartValue" SG_ 319 RFC_Loc166_RadarCrossSection 512;
BA_ "GenSigStartValue" SG_ 319 RFC_Loc167_RadialVelocity 16384;
BA_ "GenSigStartValue" SG_ 319 RFC_Loc167_Elevation 512;
BA_ "GenSigStartValue" SG_ 319 RFC_Loc167_Azimuth 1024;
BA_ "GenSigStartValue" SG_ 319 RFC_Loc167_DistVelocityCoVnce 1024;
BA_ "GenSigStartValue" SG_ 319 RFC_Loc167_RadarCrossSection 512;
BA_ "GenSigStartValue" SG_ 320 RFC_Loc168_RadialVelocity 16384;
BA_ "GenSigStartValue" SG_ 320 RFC_Loc168_Elevation 512;
BA_ "GenSigStartValue" SG_ 320 RFC_Loc168_Azimuth 1024;
BA_ "GenSigStartValue" SG_ 320 RFC_Loc168_DistVelocityCoVnce 1024;
BA_ "GenSigStartValue" SG_ 320 RFC_Loc168_RadarCrossSection 512;
BA_ "GenSigStartValue" SG_ 320 RFC_Loc169_RadialVelocity 16384;
BA_ "GenSigStartValue" SG_ 320 RFC_Loc169_Elevation 512;
BA_ "GenSigStartValue" SG_ 320 RFC_Loc169_Azimuth 1024;
BA_ "GenSigStartValue" SG_ 320 RFC_Loc169_DistVelocityCoVnce 1024;
BA_ "GenSigStartValue" SG_ 320 RFC_Loc169_RadarCrossSection 512;
BA_ "GenSigStartValue" SG_ 320 RFC_Loc170_RadialVelocity 16384;
BA_ "GenSigStartValue" SG_ 320 RFC_Loc170_Elevation 512;
BA_ "GenSigStartValue" SG_ 320 RFC_Loc170_Azimuth 1024;
BA_ "GenSigStartValue" SG_ 320 RFC_Loc170_DistVelocityCoVnce 1024;
BA_ "GenSigStartValue" SG_ 320 RFC_Loc170_RadarCrossSection 512;
SIG_GROUP_ 307 SG_RFC_Location_129_131 1 : RFC_Loc129_131_CRC RFC_Loc129_131_AliveCtr RFC_Loc129_131_ProtBlockCtr RFC_Loc129_RadialDistance RFC_Loc129_RadialVelocity RFC_Loc129_Elevation RFC_Loc129_Azimuth RFC_Loc129_DistVelocityCoVnce RFC_Loc129_RadialDistanceVnce RFC_Loc129_RadialVelocityVnce RFC_Loc129_ElevationVnce RFC_Loc129_AzimuthVnce RFC_Loc129_RadarCrossSection RFC_Loc129_DistVelocityQuality RFC_Loc129_ElevationQuality RFC_Loc129_AzimuthQuality RFC_Loc129_RSSI RFC_Loc129_AzimuthalPartnerId RFC_Loc130_RadialDistance RFC_Loc130_RadialVelocity RFC_Loc130_Elevation RFC_Loc130_Azimuth RFC_Loc130_DistVelocityCoVnce RFC_Loc130_RadialDistanceVnce RFC_Loc130_RadialVelocityVnce RFC_Loc130_ElevationVnce RFC_Loc130_AzimuthVnce RFC_Loc130_RadarCrossSection RFC_Loc130_DistVelocityQuality RFC_Loc130_ElevationQuality RFC_Loc130_AzimuthQuality RFC_Loc130_RSSI RFC_Loc130_AzimuthalPartnerId RFC_Loc131_RadialDistance RFC_Loc131_RadialVelocity RFC_Loc131_Elevation RFC_Loc131_Azimuth RFC_Loc131_DistVelocityCoVnce RFC_Loc131_RadialDistanceVnce RFC_Loc131_RadialVelocityVnce RFC_Loc131_ElevationVnce RFC_Loc131_AzimuthVnce RFC_Loc131_RadarCrossSection RFC_Loc131_DistVelocityQuality RFC_Loc131_ElevationQuality RFC_Loc131_AzimuthQuality RFC_Loc131_RSSI RFC_Loc131_AzimuthalPartnerId;
SIG_GROUP_ 308 SG_RFC_Location_132_134 1 : RFC_Loc132_134_CRC RFC_Loc132_134_AliveCtr RFC_Loc132_134_ProtBlockCtr RFC_Loc132_RadialDistance RFC_Loc132_RadialVelocity RFC_Loc132_Elevation RFC_Loc132_Azimuth RFC_Loc132_DistVelocityCoVnce RFC_Loc132_RadialDistanceVnce RFC_Loc132_RadialVelocityVnce RFC_Loc132_ElevationVnce RFC_Loc132_AzimuthVnce RFC_Loc132_RadarCrossSection RFC_Loc132_DistVelocityQuality RFC_Loc132_ElevationQuality RFC_Loc132_AzimuthQuality RFC_Loc132_RSSI RFC_Loc132_AzimuthalPartnerId RFC_Loc133_RadialDistance RFC_Loc133_RadialVelocity RFC_Loc133_Elevation RFC_Loc133_Azimuth RFC_Loc133_DistVelocityCoVnce RFC_Loc133_RadialDistanceVnce RFC_Loc133_RadialVelocityVnce RFC_Loc133_ElevationVnce RFC_Loc133_AzimuthVnce RFC_Loc133_RadarCrossSection RFC_Loc133_DistVelocityQuality RFC_Loc133_ElevationQuality RFC_Loc133_AzimuthQuality RFC_Loc133_RSSI RFC_Loc133_AzimuthalPartnerId RFC_Loc134_RadialDistance RFC_Loc134_RadialVelocity RFC_Loc134_Elevation RFC_Loc134_Azimuth RFC_Loc134_DistVelocityCoVnce RFC_Loc134_RadialDistanceVnce RFC_Loc134_RadialVelocityVnce RFC_Loc134_ElevationVnce RFC_Loc134_AzimuthVnce RFC_Loc134_RadarCrossSection RFC_Loc134_DistVelocityQuality RFC_Loc134_ElevationQuality RFC_Loc134_AzimuthQuality RFC_Loc134_RSSI RFC_Loc134_AzimuthalPartnerId;
SIG_GROUP_ 309 SG_RFC_Location_135_137 1 : RFC_Loc135_137_CRC RFC_Loc135_137_AliveCtr RFC_Loc135_137_ProtBlockCtr RFC_Loc135_RadialDistance RFC_Loc135_RadialVelocity RFC_Loc135_Elevation RFC_Loc135_Azimuth RFC_Loc135_DistVelocityCoVnce RFC_Loc135_RadialDistanceVnce RFC_Loc135_RadialVelocityVnce RFC_Loc135_ElevationVnce RFC_Loc135_AzimuthVnce RFC_Loc135_RadarCrossSection RFC_Loc135_DistVelocityQuality RFC_Loc135_ElevationQuality RFC_Loc135_AzimuthQuality RFC_Loc135_RSSI RFC_Loc135_AzimuthalPartnerId RFC_Loc136_RadialDistance RFC_Loc136_RadialVelocity RFC_Loc136_Elevation RFC_Loc136_Azimuth RFC_Loc136_DistVelocityCoVnce RFC_Loc136_RadialDistanceVnce RFC_Loc136_RadialVelocityVnce RFC_Loc136_ElevationVnce RFC_Loc136_AzimuthVnce RFC_Loc136_RadarCrossSection RFC_Loc136_DistVelocityQuality RFC_Loc136_ElevationQuality RFC_Loc136_AzimuthQuality RFC_Loc136_RSSI RFC_Loc136_AzimuthalPartnerId RFC_Loc137_RadialDistance RFC_Loc137_RadialVelocity RFC_Loc137_Elevation RFC_Loc137_Azimuth RFC_Loc137_DistVelocityCoVnce RFC_Loc137_RadialDistanceVnce RFC_Loc137_RadialVelocityVnce RFC_Loc137_ElevationVnce RFC_Loc137_AzimuthVnce RFC_Loc137_RadarCrossSection RFC_Loc137_DistVelocityQuality RFC_Loc137_ElevationQuality RFC_Loc137_AzimuthQuality RFC_Loc137_RSSI RFC_Loc137_AzimuthalPartnerId;
SIG_GROUP_ 310 SG_RFC_Location_138_140 1 : RFC_Loc138_140_CRC RFC_Loc138_140_AliveCtr RFC_Loc138_140_ProtBlockCtr RFC_Loc138_RadialDistance RFC_Loc138_RadialVelocity RFC_Loc138_Elevation RFC_Loc138_Azimuth RFC_Loc138_DistVelocityCoVnce RFC_Loc138_RadialDistanceVnce RFC_Loc138_RadialVelocityVnce RFC_Loc138_ElevationVnce RFC_Loc138_AzimuthVnce RFC_Loc138_RadarCrossSection RFC_Loc138_DistVelocityQuality RFC_Loc138_ElevationQuality RFC_Loc138_AzimuthQuality RFC_Loc138_RSSI RFC_Loc138_AzimuthalPartnerId RFC_Loc139_RadialDistance RFC_Loc139_RadialVelocity RFC_Loc139_Elevation RFC_Loc139_Azimuth RFC_Loc139_DistVelocityCoVnce RFC_Loc139_RadialDistanceVnce RFC_Loc139_RadialVelocityVnce RFC_Loc139_ElevationVnce RFC_Loc139_AzimuthVnce RFC_Loc139_RadarCrossSection RFC_Loc139_DistVelocityQuality RFC_Loc139_ElevationQuality RFC_Loc139_AzimuthQuality RFC_Loc139_RSSI RFC_Loc139_AzimuthalPartnerId RFC_Loc140_RadialDistance RFC_Loc140_RadialVelocity RFC_Loc140_Elevation RFC_Loc140_Azimuth RFC_Loc140_DistVelocityCoVnce RFC_Loc140_RadialDistanceVnce RFC_Loc140_RadialVelocityVnce RFC_Loc140_ElevationVnce RFC_Loc140_AzimuthVnce RFC_Loc140_RadarCrossSection RFC_Loc140_DistVelocityQuality RFC_Loc140_ElevationQuality RFC_Loc140_AzimuthQuality RFC_Loc140_RSSI RFC_Loc140_AzimuthalPartnerId;
SIG_GROUP_ 311 SG_RFC_Location_141_143 1 : RFC_Loc141_143_CRC RFC_Loc141_143_AliveCtr RFC_Loc141_143_ProtBlockCtr RFC_Loc141_RadialDistance RFC_Loc141_RadialVelocity RFC_Loc141_Elevation RFC_Loc141_Azimuth RFC_Loc141_DistVelocityCoVnce RFC_Loc141_RadialDistanceVnce RFC_Loc141_RadialVelocityVnce RFC_Loc141_ElevationVnce RFC_Loc141_AzimuthVnce RFC_Loc141_RadarCrossSection RFC_Loc141_DistVelocityQuality RFC_Loc141_ElevationQuality RFC_Loc141_AzimuthQuality RFC_Loc141_RSSI RFC_Loc141_AzimuthalPartnerId RFC_Loc142_RadialDistance RFC_Loc142_RadialVelocity RFC_Loc142_Elevation RFC_Loc142_Azimuth RFC_Loc142_DistVelocityCoVnce RFC_Loc142_RadialDistanceVnce RFC_Loc142_RadialVelocityVnce RFC_Loc142_ElevationVnce RFC_Loc142_AzimuthVnce RFC_Loc142_RadarCrossSection RFC_Loc142_DistVelocityQuality RFC_Loc142_ElevationQuality RFC_Loc142_AzimuthQuality RFC_Loc142_RSSI RFC_Loc142_AzimuthalPartnerId RFC_Loc143_RadialDistance RFC_Loc143_RadialVelocity RFC_Loc143_Elevation RFC_Loc143_Azimuth RFC_Loc143_DistVelocityCoVnce RFC_Loc143_RadialDistanceVnce RFC_Loc143_RadialVelocityVnce RFC_Loc143_ElevationVnce RFC_Loc143_AzimuthVnce RFC_Loc143_RadarCrossSection RFC_Loc143_DistVelocityQuality RFC_Loc143_ElevationQuality RFC_Loc143_AzimuthQuality RFC_Loc143_RSSI RFC_Loc143_AzimuthalPartnerId;
SIG_GROUP_ 312 SG_RFC_Location_144_146 1 : RFC_Loc144_146_CRC RFC_Loc144_146_AliveCtr RFC_Loc144_146_ProtBlockCtr RFC_Loc144_RadialDistance RFC_Loc144_RadialVelocity RFC_Loc144_Elevation RFC_Loc144_Azimuth RFC_Loc144_DistVelocityCoVnce RFC_Loc144_RadialDistanceVnce RFC_Loc144_RadialVelocityVnce RFC_Loc144_ElevationVnce RFC_Loc144_AzimuthVnce RFC_Loc144_RadarCrossSection RFC_Loc144_DistVelocityQuality RFC_Loc144_ElevationQuality RFC_Loc144_AzimuthQuality RFC_Loc144_RSSI RFC_Loc144_AzimuthalPartnerId RFC_Loc145_RadialDistance RFC_Loc145_RadialVelocity RFC_Loc145_Elevation RFC_Loc145_Azimuth RFC_Loc145_DistVelocityCoVnce RFC_Loc145_RadialDistanceVnce RFC_Loc145_RadialVelocityVnce RFC_Loc145_ElevationVnce RFC_Loc145_AzimuthVnce RFC_Loc145_RadarCrossSection RFC_Loc145_DistVelocityQuality RFC_Loc145_ElevationQuality RFC_Loc145_AzimuthQuality RFC_Loc145_RSSI RFC_Loc145_AzimuthalPartnerId RFC_Loc146_RadialDistance RFC_Loc146_RadialVelocity RFC_Loc146_Elevation RFC_Loc146_Azimuth RFC_Loc146_DistVelocityCoVnce RFC_Loc146_RadialDistanceVnce RFC_Loc146_RadialVelocityVnce RFC_Loc146_ElevationVnce RFC_Loc146_AzimuthVnce RFC_Loc146_RadarCrossSection RFC_Loc146_DistVelocityQuality RFC_Loc146_ElevationQuality RFC_Loc146_AzimuthQuality RFC_Loc146_RSSI RFC_Loc146_AzimuthalPartnerId;
SIG_GROUP_ 313 SG_RFC_Location_147_149 1 : RFC_Loc147_149_CRC RFC_Loc147_149_AliveCtr RFC_Loc147_149_ProtBlockCtr RFC_Loc147_RadialDistance RFC_Loc147_RadialVelocity RFC_Loc147_Elevation RFC_Loc147_Azimuth RFC_Loc147_DistVelocityCoVnce RFC_Loc147_RadialDistanceVnce RFC_Loc147_RadialVelocityVnce RFC_Loc147_ElevationVnce RFC_Loc147_AzimuthVnce RFC_Loc147_RadarCrossSection RFC_Loc147_DistVelocityQuality RFC_Loc147_ElevationQuality RFC_Loc147_AzimuthQuality RFC_Loc147_RSSI RFC_Loc147_AzimuthalPartnerId RFC_Loc148_RadialDistance RFC_Loc148_RadialVelocity RFC_Loc148_Elevation RFC_Loc148_Azimuth RFC_Loc148_DistVelocityCoVnce RFC_Loc148_RadialDistanceVnce RFC_Loc148_RadialVelocityVnce RFC_Loc148_ElevationVnce RFC_Loc148_AzimuthVnce RFC_Loc148_RadarCrossSection RFC_Loc148_DistVelocityQuality RFC_Loc148_ElevationQuality RFC_Loc148_AzimuthQuality RFC_Loc148_RSSI RFC_Loc148_AzimuthalPartnerId RFC_Loc149_RadialDistance RFC_Loc149_RadialVelocity RFC_Loc149_Elevation RFC_Loc149_Azimuth RFC_Loc149_DistVelocityCoVnce RFC_Loc149_RadialDistanceVnce RFC_Loc149_RadialVelocityVnce RFC_Loc149_ElevationVnce RFC_Loc149_AzimuthVnce RFC_Loc149_RadarCrossSection RFC_Loc149_DistVelocityQuality RFC_Loc149_ElevationQuality RFC_Loc149_AzimuthQuality RFC_Loc149_RSSI RFC_Loc149_AzimuthalPartnerId;
SIG_GROUP_ 314 SG_RFC_Location_150_152 1 : RFC_Loc150_152_CRC RFC_Loc150_152_AliveCtr RFC_Loc150_152_ProtBlockCtr RFC_Loc150_RadialDistance RFC_Loc150_RadialVelocity RFC_Loc150_Elevation RFC_Loc150_Azimuth RFC_Loc150_DistVelocityCoVnce RFC_Loc150_RadialDistanceVnce RFC_Loc150_RadialVelocityVnce RFC_Loc150_ElevationVnce RFC_Loc150_AzimuthVnce RFC_Loc150_RadarCrossSection RFC_Loc150_DistVelocityQuality RFC_Loc150_ElevationQuality RFC_Loc150_AzimuthQuality RFC_Loc150_RSSI RFC_Loc150_AzimuthalPartnerId RFC_Loc151_RadialDistance RFC_Loc151_RadialVelocity RFC_Loc151_Elevation RFC_Loc151_Azimuth RFC_Loc151_DistVelocityCoVnce RFC_Loc151_RadialDistanceVnce RFC_Loc151_RadialVelocityVnce RFC_Loc151_ElevationVnce RFC_Loc151_AzimuthVnce RFC_Loc151_RadarCrossSection RFC_Loc151_DistVelocityQuality RFC_Loc151_ElevationQuality RFC_Loc151_AzimuthQuality RFC_Loc151_RSSI RFC_Loc151_AzimuthalPartnerId RFC_Loc152_RadialDistance RFC_Loc152_RadialVelocity RFC_Loc152_Elevation RFC_Loc152_Azimuth RFC_Loc152_DistVelocityCoVnce RFC_Loc152_RadialDistanceVnce RFC_Loc152_RadialVelocityVnce RFC_Loc152_ElevationVnce RFC_Loc152_AzimuthVnce RFC_Loc152_RadarCrossSection RFC_Loc152_DistVelocityQuality RFC_Loc152_ElevationQuality RFC_Loc152_AzimuthQuality RFC_Loc152_RSSI RFC_Loc152_AzimuthalPartnerId;
SIG_GROUP_ 315 SG_RFC_Location_153_155 1 : RFC_Loc153_155_CRC RFC_Loc153_155_AliveCtr RFC_Loc153_155_ProtBlockCtr RFC_Loc153_RadialDistance RFC_Loc153_RadialVelocity RFC_Loc153_Elevation RFC_Loc153_Azimuth RFC_Loc153_DistVelocityCoVnce RFC_Loc153_RadialDistanceVnce RFC_Loc153_RadialVelocityVnce RFC_Loc153_ElevationVnce RFC_Loc153_AzimuthVnce RFC_Loc153_RadarCrossSection RFC_Loc153_DistVelocityQuality RFC_Loc153_ElevationQuality RFC_Loc153_AzimuthQuality RFC_Loc153_RSSI RFC_Loc153_AzimuthalPartnerId RFC_Loc154_RadialDistance RFC_Loc154_RadialVelocity RFC_Loc154_Elevation RFC_Loc154_Azimuth RFC_Loc154_DistVelocityCoVnce RFC_Loc154_RadialDistanceVnce RFC_Loc154_RadialVelocityVnce RFC_Loc154_ElevationVnce RFC_Loc154_AzimuthVnce RFC_Loc154_RadarCrossSection RFC_Loc154_DistVelocityQuality RFC_Loc154_ElevationQuality RFC_Loc154_AzimuthQuality RFC_Loc154_RSSI RFC_Loc154_AzimuthalPartnerId RFC_Loc155_RadialDistance RFC_Loc155_RadialVelocity RFC_Loc155_Elevation RFC_Loc155_Azimuth RFC_Loc155_DistVelocityCoVnce RFC_Loc155_RadialDistanceVnce RFC_Loc155_RadialVelocityVnce RFC_Loc155_ElevationVnce RFC_Loc155_AzimuthVnce RFC_Loc155_RadarCrossSection RFC_Loc155_DistVelocityQuality RFC_Loc155_ElevationQuality RFC_Loc155_AzimuthQuality RFC_Loc155_RSSI RFC_Loc155_AzimuthalPartnerId;
SIG_GROUP_ 316 SG_RFC_Location_156_158 1 : RFC_Loc156_158_CRC RFC_Loc156_158_AliveCtr RFC_Loc156_158_ProtBlockCtr RFC_Loc156_RadialDistance RFC_Loc156_RadialVelocity RFC_Loc156_Elevation RFC_Loc156_Azimuth RFC_Loc156_DistVelocityCoVnce RFC_Loc156_RadialDistanceVnce RFC_Loc156_RadialVelocityVnce RFC_Loc156_ElevationVnce RFC_Loc156_AzimuthVnce RFC_Loc156_RadarCrossSection RFC_Loc156_DistVelocityQuality RFC_Loc156_ElevationQuality RFC_Loc156_AzimuthQuality RFC_Loc156_RSSI RFC_Loc156_AzimuthalPartnerId RFC_Loc157_RadialDistance RFC_Loc157_RadialVelocity RFC_Loc157_Elevation RFC_Loc157_Azimuth RFC_Loc157_DistVelocityCoVnce RFC_Loc157_RadialDistanceVnce RFC_Loc157_RadialVelocityVnce RFC_Loc157_ElevationVnce RFC_Loc157_AzimuthVnce RFC_Loc157_RadarCrossSection RFC_Loc157_DistVelocityQuality RFC_Loc157_ElevationQuality RFC_Loc157_AzimuthQuality RFC_Loc157_RSSI RFC_Loc157_AzimuthalPartnerId RFC_Loc158_RadialDistance RFC_Loc158_RadialVelocity RFC_Loc158_Elevation RFC_Loc158_Azimuth RFC_Loc158_DistVelocityCoVnce RFC_Loc158_RadialDistanceVnce RFC_Loc158_RadialVelocityVnce RFC_Loc158_ElevationVnce RFC_Loc158_AzimuthVnce RFC_Loc158_RadarCrossSection RFC_Loc158_DistVelocityQuality RFC_Loc158_ElevationQuality RFC_Loc158_AzimuthQuality RFC_Loc158_RSSI RFC_Loc158_AzimuthalPartnerId;
SIG_GROUP_ 317 SG_RFC_Location_159_161 1 : RFC_Loc159_161_CRC RFC_Loc159_161_AliveCtr RFC_Loc159_161_ProtBlockCtr RFC_Loc159_RadialDistance RFC_Loc159_RadialVelocity RFC_Loc159_Elevation RFC_Loc159_Azimuth RFC_Loc159_DistVelocityCoVnce RFC_Loc159_RadialDistanceVnce RFC_Loc159_RadialVelocityVnce RFC_Loc159_ElevationVnce RFC_Loc159_AzimuthVnce RFC_Loc159_RadarCrossSection RFC_Loc159_DistVelocityQuality RFC_Loc159_ElevationQuality RFC_Loc159_AzimuthQuality RFC_Loc159_RSSI RFC_Loc159_AzimuthalPartnerId RFC_Loc160_RadialDistance RFC_Loc160_RadialVelocity RFC_Loc160_Elevation RFC_Loc160_Azimuth RFC_Loc160_DistVelocityCoVnce RFC_Loc160_RadialDistanceVnce RFC_Loc160_RadialVelocityVnce RFC_Loc160_ElevationVnce RFC_Loc160_AzimuthVnce RFC_Loc160_RadarCrossSection RFC_Loc160_DistVelocityQuality RFC_Loc160_ElevationQuality RFC_Loc160_AzimuthQuality RFC_Loc160_RSSI RFC_Loc160_AzimuthalPartnerId RFC_Loc161_RadialDistance RFC_Loc161_RadialVelocity RFC_Loc161_Elevation RFC_Loc161_Azimuth RFC_Loc161_DistVelocityCoVnce RFC_Loc161_RadialDistanceVnce RFC_Loc161_RadialVelocityVnce RFC_Loc161_ElevationVnce RFC_Loc161_AzimuthVnce RFC_Loc161_RadarCrossSection RFC_Loc161_DistVelocityQuality RFC_Loc161_ElevationQuality RFC_Loc161_AzimuthQuality RFC_Loc161_RSSI RFC_Loc161_AzimuthalPartnerId;
SIG_GROUP_ 318 SG_RFC_Location_162_164 1 : RFC_Loc162_164_CRC RFC_Loc162_164_AliveCtr RFC_Loc162_164_ProtBlockCtr RFC_Loc162_RadialDistance RFC_Loc162_RadialVelocity RFC_Loc162_Elevation RFC_Loc162_Azimuth RFC_Loc162_DistVelocityCoVnce RFC_Loc162_RadialDistanceVnce RFC_Loc162_RadialVelocityVnce RFC_Loc162_ElevationVnce RFC_Loc162_AzimuthVnce RFC_Loc162_RadarCrossSection RFC_Loc162_DistVelocityQuality RFC_Loc162_ElevationQuality RFC_Loc162_AzimuthQuality RFC_Loc162_RSSI RFC_Loc162_AzimuthalPartnerId RFC_Loc163_RadialDistance RFC_Loc163_RadialVelocity RFC_Loc163_Elevation RFC_Loc163_Azimuth RFC_Loc163_DistVelocityCoVnce RFC_Loc163_RadialDistanceVnce RFC_Loc163_RadialVelocityVnce RFC_Loc163_ElevationVnce RFC_Loc163_AzimuthVnce RFC_Loc163_RadarCrossSection RFC_Loc163_DistVelocityQuality RFC_Loc163_ElevationQuality RFC_Loc163_AzimuthQuality RFC_Loc163_RSSI RFC_Loc163_AzimuthalPartnerId RFC_Loc164_RadialDistance RFC_Loc164_RadialVelocity RFC_Loc164_Elevation RFC_Loc164_Azimuth RFC_Loc164_DistVelocityCoVnce RFC_Loc164_RadialDistanceVnce RFC_Loc164_RadialVelocityVnce RFC_Loc164_ElevationVnce RFC_Loc164_AzimuthVnce RFC_Loc164_RadarCrossSection RFC_Loc164_DistVelocityQuality RFC_Loc164_ElevationQuality RFC_Loc164_AzimuthQuality RFC_Loc164_RSSI RFC_Loc164_AzimuthalPartnerId;
SIG_GROUP_ 319 SG_RFC_Location_165_167 1 : RFC_Loc165_167_CRC RFC_Loc165_167_AliveCtr RFC_Loc165_167_ProtBlockCtr RFC_Loc165_RadialDistance RFC_Loc165_RadialVelocity RFC_Loc165_Elevation RFC_Loc165_Azimuth RFC_Loc165_DistVelocityCoVnce RFC_Loc165_RadialDistanceVnce RFC_Loc165_RadialVelocityVnce RFC_Loc165_ElevationVnce RFC_Loc165_AzimuthVnce RFC_Loc165_RadarCrossSection RFC_Loc165_DistVelocityQuality RFC_Loc165_ElevationQuality RFC_Loc165_AzimuthQuality RFC_Loc165_RSSI RFC_Loc165_AzimuthalPartnerId RFC_Loc166_RadialDistance RFC_Loc166_RadialVelocity RFC_Loc166_Elevation RFC_Loc166_Azimuth RFC_Loc166_DistVelocityCoVnce RFC_Loc166_RadialDistanceVnce RFC_Loc166_RadialVelocityVnce RFC_Loc166_ElevationVnce RFC_Loc166_AzimuthVnce RFC_Loc166_RadarCrossSection RFC_Loc166_DistVelocityQuality RFC_Loc166_ElevationQuality RFC_Loc166_AzimuthQuality RFC_Loc166_RSSI RFC_Loc166_AzimuthalPartnerId RFC_Loc167_RadialDistance RFC_Loc167_RadialVelocity RFC_Loc167_Elevation RFC_Loc167_Azimuth RFC_Loc167_DistVelocityCoVnce RFC_Loc167_RadialDistanceVnce RFC_Loc167_RadialVelocityVnce RFC_Loc167_ElevationVnce RFC_Loc167_AzimuthVnce RFC_Loc167_RadarCrossSection RFC_Loc167_DistVelocityQuality RFC_Loc167_ElevationQuality RFC_Loc167_AzimuthQuality RFC_Loc167_RSSI RFC_Loc167_AzimuthalPartnerId;
SIG_GROUP_ 320 SG_RFC_Location_168_170 1 : RFC_Loc168_170_CRC RFC_Loc168_170_AliveCtr RFC_Loc168_170_ProtBlockCtr RFC_Loc168_RadialDistance RFC_Loc168_RadialVelocity RFC_Loc168_Elevation RFC_Loc168_Azimuth RFC_Loc168_DistVelocityCoVnce RFC_Loc168_RadialDistanceVnce RFC_Loc168_RadialVelocityVnce RFC_Loc168_ElevationVnce RFC_Loc168_AzimuthVnce RFC_Loc168_RadarCrossSection RFC_Loc168_DistVelocityQuality RFC_Loc168_ElevationQuality RFC_Loc168_AzimuthQuality RFC_Loc168_RSSI RFC_Loc168_AzimuthalPartnerId RFC_Loc169_RadialDistance RFC_Loc169_RadialVelocity RFC_Loc169_Elevation RFC_Loc169_Azimuth RFC_Loc169_DistVelocityCoVnce RFC_Loc169_RadialDistanceVnce RFC_Loc169_RadialVelocityVnce RFC_Loc169_ElevationVnce RFC_Loc169_AzimuthVnce RFC_Loc169_RadarCrossSection RFC_Loc169_DistVelocityQuality RFC_Loc169_ElevationQuality RFC_Loc169_AzimuthQuality RFC_Loc169_RSSI RFC_Loc169_AzimuthalPartnerId RFC_Loc170_RadialDistance RFC_Loc170_RadialVelocity RFC_Loc170_Elevation RFC_Loc170_Azimuth RFC_Loc170_DistVelocityCoVnce RFC_Loc170_RadialDistanceVnce RFC_Loc170_RadialVelocityVnce RFC_Loc170_ElevationVnce RFC_Loc170_AzimuthVnce RFC_Loc170_RadarCrossSection RFC_Loc170_DistVelocityQuality RFC_Loc170_ElevationQuality RFC_Loc170_AzimuthQuality RFC_Loc170_RSSI RFC_Loc170_AzimuthalPartnerId;
