VERSION "created by canmatrix"

NS_ :

BS_:

BU_: RadarFrontCenter VideoFrontCenter DASy ReceiveECU

BO_ 335 RFC_Location_213_215: 64 RadarFrontCenter
 SG_ RFC_Loc213_215_CRC : 0|16@1+ (1,0) [0|65535] ""  DASy
 SG_ RFC_Loc213_215_AliveCtr : 16|8@1+ (1,0) [0|255] ""  DASy
 SG_ RFC_Loc213_215_ProtBlockCtr : 24|4@1+ (1,0) [0|15] ""  DASy
 SG_ RFC_Loc213_RadialDistance : 32|15@1+ (0.01,0) [0|327.67] "m"  DASy
 SG_ RFC_Loc213_RadialVelocity : 47|15@1+ (0.01,-163.84) [-110|55] "m/s"  DASy
 SG_ RFC_Loc213_Elevation : 62|10@1+ (0.1,-51.2) [-45|45] "deg"  DASy
 SG_ RFC_Loc213_Azimuth : 72|11@1+ (0.1,-102.4) [-90|90] "deg"  DASy
 SG_ RFC_Loc213_DistVelocityCoVnce : 83|11@1+ (0.0001,-0.1024) [-0.1024|0.1023] "m^2/s"  DASy
 SG_ RFC_Loc213_RadialDistanceVnce : 94|10@1+ (5E-005,0) [0|0.05115] "m^2"  DASy
 SG_ RFC_Loc213_RadialVelocityVnce : 104|10@1+ (0.0001,0) [0|0.1023] "m^2/s^2"  DASy
 SG_ RFC_Loc213_ElevationVnce : 114|10@1+ (0.001,0) [0|1.023] "deg^2"  DASy
 SG_ RFC_Loc213_AzimuthVnce : 124|10@1+ (0.001,0) [0|1.023] "deg^2"  DASy
 SG_ RFC_Loc213_RadarCrossSection : 134|10@1+ (0.2,-102.4) [-50|70] "dBsm"  DASy
 SG_ RFC_Loc213_DistVelocityQuality : 144|8@1+ (1,0) [0|255] "unitless"  DASy
 SG_ RFC_Loc213_ElevationQuality : 152|8@1+ (1,0) [0|255] "unitless"  DASy
 SG_ RFC_Loc213_AzimuthQuality : 160|8@1+ (1,0) [0|255] "unitless"  DASy
 SG_ RFC_Loc213_RSSI : 168|10@1+ (0.1,0) [0|100] "unitless"  DASy
 SG_ RFC_Loc213_AzimuthalPartnerId : 178|10@1+ (1,0) [0|1023] "unitless"  DASy
 SG_ RFC_Loc214_RadialDistance : 192|15@1+ (0.01,0) [0|327.67] "m"  DASy
 SG_ RFC_Loc214_RadialVelocity : 207|15@1+ (0.01,-163.84) [-110|55] "m/s"  DASy
 SG_ RFC_Loc214_Elevation : 222|10@1+ (0.1,-51.2) [-45|45] "deg"  DASy
 SG_ RFC_Loc214_Azimuth : 232|11@1+ (0.1,-102.4) [-90|90] "deg"  DASy
 SG_ RFC_Loc214_DistVelocityCoVnce : 243|11@1+ (0.0001,-0.1024) [-0.1024|0.1023] "m^2/s"  DASy
 SG_ RFC_Loc214_RadialDistanceVnce : 254|10@1+ (5E-005,0) [0|0.05115] "m^2"  DASy
 SG_ RFC_Loc214_RadialVelocityVnce : 264|10@1+ (0.0001,0) [0|0.1023] "m^2/s^2"  DASy
 SG_ RFC_Loc214_ElevationVnce : 274|10@1+ (0.001,0) [0|1.023] "deg^2"  DASy
 SG_ RFC_Loc214_AzimuthVnce : 284|10@1+ (0.001,0) [0|1.023] "deg^2"  DASy
 SG_ RFC_Loc214_RadarCrossSection : 294|10@1+ (0.2,-102.4) [-50|70] "dBsm"  DASy
 SG_ RFC_Loc214_DistVelocityQuality : 304|8@1+ (1,0) [0|255] "unitless"  DASy
 SG_ RFC_Loc214_ElevationQuality : 312|8@1+ (1,0) [0|255] "unitless"  DASy
 SG_ RFC_Loc214_AzimuthQuality : 320|8@1+ (1,0) [0|255] "unitless"  DASy
 SG_ RFC_Loc214_RSSI : 328|10@1+ (0.1,0) [0|100] "unitless"  DASy
 SG_ RFC_Loc214_AzimuthalPartnerId : 338|10@1+ (1,0) [0|1023] "unitless"  DASy
 SG_ RFC_Loc215_RadialDistance : 352|15@1+ (0.01,0) [0|327.67] "m"  DASy
 SG_ RFC_Loc215_RadialVelocity : 367|15@1+ (0.01,-163.84) [-110|55] "m/s"  DASy
 SG_ RFC_Loc215_Elevation : 382|10@1+ (0.1,-51.2) [-45|45] "deg"  DASy
 SG_ RFC_Loc215_Azimuth : 392|11@1+ (0.1,-102.4) [-90|90] "deg"  DASy
 SG_ RFC_Loc215_DistVelocityCoVnce : 403|11@1+ (0.0001,-0.1024) [-0.1024|0.1023] "m^2/s"  DASy
 SG_ RFC_Loc215_RadialDistanceVnce : 414|10@1+ (5E-005,0) [0|0.05115] "m^2"  DASy
 SG_ RFC_Loc215_RadialVelocityVnce : 424|10@1+ (0.0001,0) [0|0.1023] "m^2/s^2"  DASy
 SG_ RFC_Loc215_ElevationVnce : 434|10@1+ (0.001,0) [0|1.023] "deg^2"  DASy
 SG_ RFC_Loc215_AzimuthVnce : 444|10@1+ (0.001,0) [0|1.023] "deg^2"  DASy
 SG_ RFC_Loc215_RadarCrossSection : 454|10@1+ (0.2,-102.4) [-50|70] "dBsm"  DASy
 SG_ RFC_Loc215_DistVelocityQuality : 464|8@1+ (1,0) [0|255] "unitless"  DASy
 SG_ RFC_Loc215_ElevationQuality : 472|8@1+ (1,0) [0|255] "unitless"  DASy
 SG_ RFC_Loc215_AzimuthQuality : 480|8@1+ (1,0) [0|255] "unitless"  DASy
 SG_ RFC_Loc215_RSSI : 488|10@1+ (0.1,0) [0|100] "unitless"  DASy
 SG_ RFC_Loc215_AzimuthalPartnerId : 498|10@1+ (1,0) [0|1023] "unitless"  DASy

BO_ 336 RFC_Location_216_218: 64 RadarFrontCenter
 SG_ RFC_Loc216_218_CRC : 0|16@1+ (1,0) [0|65535] ""  DASy
 SG_ RFC_Loc216_218_AliveCtr : 16|8@1+ (1,0) [0|255] ""  DASy
 SG_ RFC_Loc216_218_ProtBlockCtr : 24|4@1+ (1,0) [0|15] ""  DASy
 SG_ RFC_Loc216_RadialDistance : 32|15@1+ (0.01,0) [0|327.67] "m"  DASy
 SG_ RFC_Loc216_RadialVelocity : 47|15@1+ (0.01,-163.84) [-110|55] "m/s"  DASy
 SG_ RFC_Loc216_Elevation : 62|10@1+ (0.1,-51.2) [-45|45] "deg"  DASy
 SG_ RFC_Loc216_Azimuth : 72|11@1+ (0.1,-102.4) [-90|90] "deg"  DASy
 SG_ RFC_Loc216_DistVelocityCoVnce : 83|11@1+ (0.0001,-0.1024) [-0.1024|0.1023] "m^2/s"  DASy
 SG_ RFC_Loc216_RadialDistanceVnce : 94|10@1+ (5E-005,0) [0|0.05115] "m^2"  DASy
 SG_ RFC_Loc216_RadialVelocityVnce : 104|10@1+ (0.0001,0) [0|0.1023] "m^2/s^2"  DASy
 SG_ RFC_Loc216_ElevationVnce : 114|10@1+ (0.001,0) [0|1.023] "deg^2"  DASy
 SG_ RFC_Loc216_AzimuthVnce : 124|10@1+ (0.001,0) [0|1.023] "deg^2"  DASy
 SG_ RFC_Loc216_RadarCrossSection : 134|10@1+ (0.2,-102.4) [-50|70] "dBsm"  DASy
 SG_ RFC_Loc216_DistVelocityQuality : 144|8@1+ (1,0) [0|255] "unitless"  DASy
 SG_ RFC_Loc216_ElevationQuality : 152|8@1+ (1,0) [0|255] "unitless"  DASy
 SG_ RFC_Loc216_AzimuthQuality : 160|8@1+ (1,0) [0|255] "unitless"  DASy
 SG_ RFC_Loc216_RSSI : 168|10@1+ (0.1,0) [0|100] "unitless"  DASy
 SG_ RFC_Loc216_AzimuthalPartnerId : 178|10@1+ (1,0) [0|1023] "unitless"  DASy
 SG_ RFC_Loc217_RadialDistance : 192|15@1+ (0.01,0) [0|327.67] "m"  DASy
 SG_ RFC_Loc217_RadialVelocity : 207|15@1+ (0.01,-163.84) [-110|55] "m/s"  DASy
 SG_ RFC_Loc217_Elevation : 222|10@1+ (0.1,-51.2) [-45|45] "deg"  DASy
 SG_ RFC_Loc217_Azimuth : 232|11@1+ (0.1,-102.4) [-90|90] "deg"  DASy
 SG_ RFC_Loc217_DistVelocityCoVnce : 243|11@1+ (0.0001,-0.1024) [-0.1024|0.1023] "m^2/s"  DASy
 SG_ RFC_Loc217_RadialDistanceVnce : 254|10@1+ (5E-005,0) [0|0.05115] "m^2"  DASy
 SG_ RFC_Loc217_RadialVelocityVnce : 264|10@1+ (0.0001,0) [0|0.1023] "m^2/s^2"  DASy
 SG_ RFC_Loc217_ElevationVnce : 274|10@1+ (0.001,0) [0|1.023] "deg^2"  DASy
 SG_ RFC_Loc217_AzimuthVnce : 284|10@1+ (0.001,0) [0|1.023] "deg^2"  DASy
 SG_ RFC_Loc217_RadarCrossSection : 294|10@1+ (0.2,-102.4) [-50|70] "dBsm"  DASy
 SG_ RFC_Loc217_DistVelocityQuality : 304|8@1+ (1,0) [0|255] "unitless"  DASy
 SG_ RFC_Loc217_ElevationQuality : 312|8@1+ (1,0) [0|255] "unitless"  DASy
 SG_ RFC_Loc217_AzimuthQuality : 320|8@1+ (1,0) [0|255] "unitless"  DASy
 SG_ RFC_Loc217_RSSI : 328|10@1+ (0.1,0) [0|100] "unitless"  DASy
 SG_ RFC_Loc217_AzimuthalPartnerId : 338|10@1+ (1,0) [0|1023] "unitless"  DASy
 SG_ RFC_Loc218_RadialDistance : 352|15@1+ (0.01,0) [0|327.67] "m"  DASy
 SG_ RFC_Loc218_RadialVelocity : 367|15@1+ (0.01,-163.84) [-110|55] "m/s"  DASy
 SG_ RFC_Loc218_Elevation : 382|10@1+ (0.1,-51.2) [-45|45] "deg"  DASy
 SG_ RFC_Loc218_Azimuth : 392|11@1+ (0.1,-102.4) [-90|90] "deg"  DASy
 SG_ RFC_Loc218_DistVelocityCoVnce : 403|11@1+ (0.0001,-0.1024) [-0.1024|0.1023] "m^2/s"  DASy
 SG_ RFC_Loc218_RadialDistanceVnce : 414|10@1+ (5E-005,0) [0|0.05115] "m^2"  DASy
 SG_ RFC_Loc218_RadialVelocityVnce : 424|10@1+ (0.0001,0) [0|0.1023] "m^2/s^2"  DASy
 SG_ RFC_Loc218_ElevationVnce : 434|10@1+ (0.001,0) [0|1.023] "deg^2"  DASy
 SG_ RFC_Loc218_AzimuthVnce : 444|10@1+ (0.001,0) [0|1.023] "deg^2"  DASy
 SG_ RFC_Loc218_RadarCrossSection : 454|10@1+ (0.2,-102.4) [-50|70] "dBsm"  DASy
 SG_ RFC_Loc218_DistVelocityQuality : 464|8@1+ (1,0) [0|255] "unitless"  DASy
 SG_ RFC_Loc218_ElevationQuality : 472|8@1+ (1,0) [0|255] "unitless"  DASy
 SG_ RFC_Loc218_AzimuthQuality : 480|8@1+ (1,0) [0|255] "unitless"  DASy
 SG_ RFC_Loc218_RSSI : 488|10@1+ (0.1,0) [0|100] "unitless"  DASy
 SG_ RFC_Loc218_AzimuthalPartnerId : 498|10@1+ (1,0) [0|1023] "unitless"  DASy

BO_ 337 RFC_Location_219_221: 64 RadarFrontCenter
 SG_ RFC_Loc219_221_CRC : 0|16@1+ (1,0) [0|65535] ""  DASy
 SG_ RFC_Loc219_221_AliveCtr : 16|8@1+ (1,0) [0|255] ""  DASy
 SG_ RFC_Loc219_221_ProtBlockCtr : 24|4@1+ (1,0) [0|15] ""  DASy
 SG_ RFC_Loc219_RadialDistance : 32|15@1+ (0.01,0) [0|327.67] "m"  DASy
 SG_ RFC_Loc219_RadialVelocity : 47|15@1+ (0.01,-163.84) [-110|55] "m/s"  DASy
 SG_ RFC_Loc219_Elevation : 62|10@1+ (0.1,-51.2) [-45|45] "deg"  DASy
 SG_ RFC_Loc219_Azimuth : 72|11@1+ (0.1,-102.4) [-90|90] "deg"  DASy
 SG_ RFC_Loc219_DistVelocityCoVnce : 83|11@1+ (0.0001,-0.1024) [-0.1024|0.1023] "m^2/s"  DASy
 SG_ RFC_Loc219_RadialDistanceVnce : 94|10@1+ (5E-005,0) [0|0.05115] "m^2"  DASy
 SG_ RFC_Loc219_RadialVelocityVnce : 104|10@1+ (0.0001,0) [0|0.1023] "m^2/s^2"  DASy
 SG_ RFC_Loc219_ElevationVnce : 114|10@1+ (0.001,0) [0|1.023] "deg^2"  DASy
 SG_ RFC_Loc219_AzimuthVnce : 124|10@1+ (0.001,0) [0|1.023] "deg^2"  DASy
 SG_ RFC_Loc219_RadarCrossSection : 134|10@1+ (0.2,-102.4) [-50|70] "dBsm"  DASy
 SG_ RFC_Loc219_DistVelocityQuality : 144|8@1+ (1,0) [0|255] "unitless"  DASy
 SG_ RFC_Loc219_ElevationQuality : 152|8@1+ (1,0) [0|255] "unitless"  DASy
 SG_ RFC_Loc219_AzimuthQuality : 160|8@1+ (1,0) [0|255] "unitless"  DASy
 SG_ RFC_Loc219_RSSI : 168|10@1+ (0.1,0) [0|100] "unitless"  DASy
 SG_ RFC_Loc219_AzimuthalPartnerId : 178|10@1+ (1,0) [0|1023] "unitless"  DASy
 SG_ RFC_Loc220_RadialDistance : 192|15@1+ (0.01,0) [0|327.67] "m"  DASy
 SG_ RFC_Loc220_RadialVelocity : 207|15@1+ (0.01,-163.84) [-110|55] "m/s"  DASy
 SG_ RFC_Loc220_Elevation : 222|10@1+ (0.1,-51.2) [-45|45] "deg"  DASy
 SG_ RFC_Loc220_Azimuth : 232|11@1+ (0.1,-102.4) [-90|90] "deg"  DASy
 SG_ RFC_Loc220_DistVelocityCoVnce : 243|11@1+ (0.0001,-0.1024) [-0.1024|0.1023] "m^2/s"  DASy
 SG_ RFC_Loc220_RadialDistanceVnce : 254|10@1+ (5E-005,0) [0|0.05115] "m^2"  DASy
 SG_ RFC_Loc220_RadialVelocityVnce : 264|10@1+ (0.0001,0) [0|0.1023] "m^2/s^2"  DASy
 SG_ RFC_Loc220_ElevationVnce : 274|10@1+ (0.001,0) [0|1.023] "deg^2"  DASy
 SG_ RFC_Loc220_AzimuthVnce : 284|10@1+ (0.001,0) [0|1.023] "deg^2"  DASy
 SG_ RFC_Loc220_RadarCrossSection : 294|10@1+ (0.2,-102.4) [-50|70] "dBsm"  DASy
 SG_ RFC_Loc220_DistVelocityQuality : 304|8@1+ (1,0) [0|255] "unitless"  DASy
 SG_ RFC_Loc220_ElevationQuality : 312|8@1+ (1,0) [0|255] "unitless"  DASy
 SG_ RFC_Loc220_AzimuthQuality : 320|8@1+ (1,0) [0|255] "unitless"  DASy
 SG_ RFC_Loc220_RSSI : 328|10@1+ (0.1,0) [0|100] "unitless"  DASy
 SG_ RFC_Loc220_AzimuthalPartnerId : 338|10@1+ (1,0) [0|1023] "unitless"  DASy
 SG_ RFC_Loc221_RadialDistance : 352|15@1+ (0.01,0) [0|327.67] "m"  DASy
 SG_ RFC_Loc221_RadialVelocity : 367|15@1+ (0.01,-163.84) [-110|55] "m/s"  DASy
 SG_ RFC_Loc221_Elevation : 382|10@1+ (0.1,-51.2) [-45|45] "deg"  DASy
 SG_ RFC_Loc221_Azimuth : 392|11@1+ (0.1,-102.4) [-90|90] "deg"  DASy
 SG_ RFC_Loc221_DistVelocityCoVnce : 403|11@1+ (0.0001,-0.1024) [-0.1024|0.1023] "m^2/s"  DASy
 SG_ RFC_Loc221_RadialDistanceVnce : 414|10@1+ (5E-005,0) [0|0.05115] "m^2"  DASy
 SG_ RFC_Loc221_RadialVelocityVnce : 424|10@1+ (0.0001,0) [0|0.1023] "m^2/s^2"  DASy
 SG_ RFC_Loc221_ElevationVnce : 434|10@1+ (0.001,0) [0|1.023] "deg^2"  DASy
 SG_ RFC_Loc221_AzimuthVnce : 444|10@1+ (0.001,0) [0|1.023] "deg^2"  DASy
 SG_ RFC_Loc221_RadarCrossSection : 454|10@1+ (0.2,-102.4) [-50|70] "dBsm"  DASy
 SG_ RFC_Loc221_DistVelocityQuality : 464|8@1+ (1,0) [0|255] "unitless"  DASy
 SG_ RFC_Loc221_ElevationQuality : 472|8@1+ (1,0) [0|255] "unitless"  DASy
 SG_ RFC_Loc221_AzimuthQuality : 480|8@1+ (1,0) [0|255] "unitless"  DASy
 SG_ RFC_Loc221_RSSI : 488|10@1+ (0.1,0) [0|100] "unitless"  DASy
 SG_ RFC_Loc221_AzimuthalPartnerId : 498|10@1+ (1,0) [0|1023] "unitless"  DASy

BO_ 338 RFC_Location_222_224: 64 RadarFrontCenter
 SG_ RFC_Loc222_224_CRC : 0|16@1+ (1,0) [0|65535] ""  DASy
 SG_ RFC_Loc222_224_AliveCtr : 16|8@1+ (1,0) [0|255] ""  DASy
 SG_ RFC_Loc222_224_ProtBlockCtr : 24|4@1+ (1,0) [0|15] ""  DASy
 SG_ RFC_Loc222_RadialDistance : 32|15@1+ (0.01,0) [0|327.67] "m"  DASy
 SG_ RFC_Loc222_RadialVelocity : 47|15@1+ (0.01,-163.84) [-110|55] "m/s"  DASy
 SG_ RFC_Loc222_Elevation : 62|10@1+ (0.1,-51.2) [-45|45] "deg"  DASy
 SG_ RFC_Loc222_Azimuth : 72|11@1+ (0.1,-102.4) [-90|90] "deg"  DASy
 SG_ RFC_Loc222_DistVelocityCoVnce : 83|11@1+ (0.0001,-0.1024) [-0.1024|0.1023] "m^2/s"  DASy
 SG_ RFC_Loc222_RadialDistanceVnce : 94|10@1+ (5E-005,0) [0|0.05115] "m^2"  DASy
 SG_ RFC_Loc222_RadialVelocityVnce : 104|10@1+ (0.0001,0) [0|0.1023] "m^2/s^2"  DASy
 SG_ RFC_Loc222_ElevationVnce : 114|10@1+ (0.001,0) [0|1.023] "deg^2"  DASy
 SG_ RFC_Loc222_AzimuthVnce : 124|10@1+ (0.001,0) [0|1.023] "deg^2"  DASy
 SG_ RFC_Loc222_RadarCrossSection : 134|10@1+ (0.2,-102.4) [-50|70] "dBsm"  DASy
 SG_ RFC_Loc222_DistVelocityQuality : 144|8@1+ (1,0) [0|255] "unitless"  DASy
 SG_ RFC_Loc222_ElevationQuality : 152|8@1+ (1,0) [0|255] "unitless"  DASy
 SG_ RFC_Loc222_AzimuthQuality : 160|8@1+ (1,0) [0|255] "unitless"  DASy
 SG_ RFC_Loc222_RSSI : 168|10@1+ (0.1,0) [0|100] "unitless"  DASy
 SG_ RFC_Loc222_AzimuthalPartnerId : 178|10@1+ (1,0) [0|1023] "unitless"  DASy
 SG_ RFC_Loc223_RadialDistance : 192|15@1+ (0.01,0) [0|327.67] "m"  DASy
 SG_ RFC_Loc223_RadialVelocity : 207|15@1+ (0.01,-163.84) [-110|55] "m/s"  DASy
 SG_ RFC_Loc223_Elevation : 222|10@1+ (0.1,-51.2) [-45|45] "deg"  DASy
 SG_ RFC_Loc223_Azimuth : 232|11@1+ (0.1,-102.4) [-90|90] "deg"  DASy
 SG_ RFC_Loc223_DistVelocityCoVnce : 243|11@1+ (0.0001,-0.1024) [-0.1024|0.1023] "m^2/s"  DASy
 SG_ RFC_Loc223_RadialDistanceVnce : 254|10@1+ (5E-005,0) [0|0.05115] "m^2"  DASy
 SG_ RFC_Loc223_RadialVelocityVnce : 264|10@1+ (0.0001,0) [0|0.1023] "m^2/s^2"  DASy
 SG_ RFC_Loc223_ElevationVnce : 274|10@1+ (0.001,0) [0|1.023] "deg^2"  DASy
 SG_ RFC_Loc223_AzimuthVnce : 284|10@1+ (0.001,0) [0|1.023] "deg^2"  DASy
 SG_ RFC_Loc223_RadarCrossSection : 294|10@1+ (0.2,-102.4) [-50|70] "dBsm"  DASy
 SG_ RFC_Loc223_DistVelocityQuality : 304|8@1+ (1,0) [0|255] "unitless"  DASy
 SG_ RFC_Loc223_ElevationQuality : 312|8@1+ (1,0) [0|255] "unitless"  DASy
 SG_ RFC_Loc223_AzimuthQuality : 320|8@1+ (1,0) [0|255] "unitless"  DASy
 SG_ RFC_Loc223_RSSI : 328|10@1+ (0.1,0) [0|100] "unitless"  DASy
 SG_ RFC_Loc223_AzimuthalPartnerId : 338|10@1+ (1,0) [0|1023] "unitless"  DASy
 SG_ RFC_Loc224_RadialDistance : 352|15@1+ (0.01,0) [0|327.67] "m"  DASy
 SG_ RFC_Loc224_RadialVelocity : 367|15@1+ (0.01,-163.84) [-110|55] "m/s"  DASy
 SG_ RFC_Loc224_Elevation : 382|10@1+ (0.1,-51.2) [-45|45] "deg"  DASy
 SG_ RFC_Loc224_Azimuth : 392|11@1+ (0.1,-102.4) [-90|90] "deg"  DASy
 SG_ RFC_Loc224_DistVelocityCoVnce : 403|11@1+ (0.0001,-0.1024) [-0.1024|0.1023] "m^2/s"  DASy
 SG_ RFC_Loc224_RadialDistanceVnce : 414|10@1+ (5E-005,0) [0|0.05115] "m^2"  DASy
 SG_ RFC_Loc224_RadialVelocityVnce : 424|10@1+ (0.0001,0) [0|0.1023] "m^2/s^2"  DASy
 SG_ RFC_Loc224_ElevationVnce : 434|10@1+ (0.001,0) [0|1.023] "deg^2"  DASy
 SG_ RFC_Loc224_AzimuthVnce : 444|10@1+ (0.001,0) [0|1.023] "deg^2"  DASy
 SG_ RFC_Loc224_RadarCrossSection : 454|10@1+ (0.2,-102.4) [-50|70] "dBsm"  DASy
 SG_ RFC_Loc224_DistVelocityQuality : 464|8@1+ (1,0) [0|255] "unitless"  DASy
 SG_ RFC_Loc224_ElevationQuality : 472|8@1+ (1,0) [0|255] "unitless"  DASy
 SG_ RFC_Loc224_AzimuthQuality : 480|8@1+ (1,0) [0|255] "unitless"  DASy
 SG_ RFC_Loc224_RSSI : 488|10@1+ (0.1,0) [0|100] "unitless"  DASy
 SG_ RFC_Loc224_AzimuthalPartnerId : 498|10@1+ (1,0) [0|1023] "unitless"  DASy

BO_ 339 RFC_Location_225_227: 64 RadarFrontCenter
 SG_ RFC_Loc225_227_CRC : 0|16@1+ (1,0) [0|65535] ""  DASy
 SG_ RFC_Loc225_227_AliveCtr : 16|8@1+ (1,0) [0|255] ""  DASy
 SG_ RFC_Loc225_227_ProtBlockCtr : 24|4@1+ (1,0) [0|15] ""  DASy
 SG_ RFC_Loc225_RadialDistance : 32|15@1+ (0.01,0) [0|327.67] "m"  DASy
 SG_ RFC_Loc225_RadialVelocity : 47|15@1+ (0.01,-163.84) [-110|55] "m/s"  DASy
 SG_ RFC_Loc225_Elevation : 62|10@1+ (0.1,-51.2) [-45|45] "deg"  DASy
 SG_ RFC_Loc225_Azimuth : 72|11@1+ (0.1,-102.4) [-90|90] "deg"  DASy
 SG_ RFC_Loc225_DistVelocityCoVnce : 83|11@1+ (0.0001,-0.1024) [-0.1024|0.1023] "m^2/s"  DASy
 SG_ RFC_Loc225_RadialDistanceVnce : 94|10@1+ (5E-005,0) [0|0.05115] "m^2"  DASy
 SG_ RFC_Loc225_RadialVelocityVnce : 104|10@1+ (0.0001,0) [0|0.1023] "m^2/s^2"  DASy
 SG_ RFC_Loc225_ElevationVnce : 114|10@1+ (0.001,0) [0|1.023] "deg^2"  DASy
 SG_ RFC_Loc225_AzimuthVnce : 124|10@1+ (0.001,0) [0|1.023] "deg^2"  DASy
 SG_ RFC_Loc225_RadarCrossSection : 134|10@1+ (0.2,-102.4) [-50|70] "dBsm"  DASy
 SG_ RFC_Loc225_DistVelocityQuality : 144|8@1+ (1,0) [0|255] "unitless"  DASy
 SG_ RFC_Loc225_ElevationQuality : 152|8@1+ (1,0) [0|255] "unitless"  DASy
 SG_ RFC_Loc225_AzimuthQuality : 160|8@1+ (1,0) [0|255] "unitless"  DASy
 SG_ RFC_Loc225_RSSI : 168|10@1+ (0.1,0) [0|100] "unitless"  DASy
 SG_ RFC_Loc225_AzimuthalPartnerId : 178|10@1+ (1,0) [0|1023] "unitless"  DASy
 SG_ RFC_Loc226_RadialDistance : 192|15@1+ (0.01,0) [0|327.67] "m"  DASy
 SG_ RFC_Loc226_RadialVelocity : 207|15@1+ (0.01,-163.84) [-110|55] "m/s"  DASy
 SG_ RFC_Loc226_Elevation : 222|10@1+ (0.1,-51.2) [-45|45] "deg"  DASy
 SG_ RFC_Loc226_Azimuth : 232|11@1+ (0.1,-102.4) [-90|90] "deg"  DASy
 SG_ RFC_Loc226_DistVelocityCoVnce : 243|11@1+ (0.0001,-0.1024) [-0.1024|0.1023] "m^2/s"  DASy
 SG_ RFC_Loc226_RadialDistanceVnce : 254|10@1+ (5E-005,0) [0|0.05115] "m^2"  DASy
 SG_ RFC_Loc226_RadialVelocityVnce : 264|10@1+ (0.0001,0) [0|0.1023] "m^2/s^2"  DASy
 SG_ RFC_Loc226_ElevationVnce : 274|10@1+ (0.001,0) [0|1.023] "deg^2"  DASy
 SG_ RFC_Loc226_AzimuthVnce : 284|10@1+ (0.001,0) [0|1.023] "deg^2"  DASy
 SG_ RFC_Loc226_RadarCrossSection : 294|10@1+ (0.2,-102.4) [-50|70] "dBsm"  DASy
 SG_ RFC_Loc226_DistVelocityQuality : 304|8@1+ (1,0) [0|255] "unitless"  DASy
 SG_ RFC_Loc226_ElevationQuality : 312|8@1+ (1,0) [0|255] "unitless"  DASy
 SG_ RFC_Loc226_AzimuthQuality : 320|8@1+ (1,0) [0|255] "unitless"  DASy
 SG_ RFC_Loc226_RSSI : 328|10@1+ (0.1,0) [0|100] "unitless"  DASy
 SG_ RFC_Loc226_AzimuthalPartnerId : 338|10@1+ (1,0) [0|1023] "unitless"  DASy
 SG_ RFC_Loc227_RadialDistance : 352|15@1+ (0.01,0) [0|327.67] "m"  DASy
 SG_ RFC_Loc227_RadialVelocity : 367|15@1+ (0.01,-163.84) [-110|55] "m/s"  DASy
 SG_ RFC_Loc227_Elevation : 382|10@1+ (0.1,-51.2) [-45|45] "deg"  DASy
 SG_ RFC_Loc227_Azimuth : 392|11@1+ (0.1,-102.4) [-90|90] "deg"  DASy
 SG_ RFC_Loc227_DistVelocityCoVnce : 403|11@1+ (0.0001,-0.1024) [-0.1024|0.1023] "m^2/s"  DASy
 SG_ RFC_Loc227_RadialDistanceVnce : 414|10@1+ (5E-005,0) [0|0.05115] "m^2"  DASy
 SG_ RFC_Loc227_RadialVelocityVnce : 424|10@1+ (0.0001,0) [0|0.1023] "m^2/s^2"  DASy
 SG_ RFC_Loc227_ElevationVnce : 434|10@1+ (0.001,0) [0|1.023] "deg^2"  DASy
 SG_ RFC_Loc227_AzimuthVnce : 444|10@1+ (0.001,0) [0|1.023] "deg^2"  DASy
 SG_ RFC_Loc227_RadarCrossSection : 454|10@1+ (0.2,-102.4) [-50|70] "dBsm"  DASy
 SG_ RFC_Loc227_DistVelocityQuality : 464|8@1+ (1,0) [0|255] "unitless"  DASy
 SG_ RFC_Loc227_ElevationQuality : 472|8@1+ (1,0) [0|255] "unitless"  DASy
 SG_ RFC_Loc227_AzimuthQuality : 480|8@1+ (1,0) [0|255] "unitless"  DASy
 SG_ RFC_Loc227_RSSI : 488|10@1+ (0.1,0) [0|100] "unitless"  DASy
 SG_ RFC_Loc227_AzimuthalPartnerId : 498|10@1+ (1,0) [0|1023] "unitless"  DASy

BO_ 340 RFC_Location_228_230: 64 RadarFrontCenter
 SG_ RFC_Loc228_230_CRC : 0|16@1+ (1,0) [0|65535] ""  DASy
 SG_ RFC_Loc228_230_AliveCtr : 16|8@1+ (1,0) [0|255] ""  DASy
 SG_ RFC_Loc228_230_ProtBlockCtr : 24|4@1+ (1,0) [0|15] ""  DASy
 SG_ RFC_Loc228_RadialDistance : 32|15@1+ (0.01,0) [0|327.67] "m"  DASy
 SG_ RFC_Loc228_RadialVelocity : 47|15@1+ (0.01,-163.84) [-110|55] "m/s"  DASy
 SG_ RFC_Loc228_Elevation : 62|10@1+ (0.1,-51.2) [-45|45] "deg"  DASy
 SG_ RFC_Loc228_Azimuth : 72|11@1+ (0.1,-102.4) [-90|90] "deg"  DASy
 SG_ RFC_Loc228_DistVelocityCoVnce : 83|11@1+ (0.0001,-0.1024) [-0.1024|0.1023] "m^2/s"  DASy
 SG_ RFC_Loc228_RadialDistanceVnce : 94|10@1+ (5E-005,0) [0|0.05115] "m^2"  DASy
 SG_ RFC_Loc228_RadialVelocityVnce : 104|10@1+ (0.0001,0) [0|0.1023] "m^2/s^2"  DASy
 SG_ RFC_Loc228_ElevationVnce : 114|10@1+ (0.001,0) [0|1.023] "deg^2"  DASy
 SG_ RFC_Loc228_AzimuthVnce : 124|10@1+ (0.001,0) [0|1.023] "deg^2"  DASy
 SG_ RFC_Loc228_RadarCrossSection : 134|10@1+ (0.2,-102.4) [-50|70] "dBsm"  DASy
 SG_ RFC_Loc228_DistVelocityQuality : 144|8@1+ (1,0) [0|255] "unitless"  DASy
 SG_ RFC_Loc228_ElevationQuality : 152|8@1+ (1,0) [0|255] "unitless"  DASy
 SG_ RFC_Loc228_AzimuthQuality : 160|8@1+ (1,0) [0|255] "unitless"  DASy
 SG_ RFC_Loc228_RSSI : 168|10@1+ (0.1,0) [0|100] "unitless"  DASy
 SG_ RFC_Loc228_AzimuthalPartnerId : 178|10@1+ (1,0) [0|1023] "unitless"  DASy
 SG_ RFC_Loc229_RadialDistance : 192|15@1+ (0.01,0) [0|327.67] "m"  DASy
 SG_ RFC_Loc229_RadialVelocity : 207|15@1+ (0.01,-163.84) [-110|55] "m/s"  DASy
 SG_ RFC_Loc229_Elevation : 222|10@1+ (0.1,-51.2) [-45|45] "deg"  DASy
 SG_ RFC_Loc229_Azimuth : 232|11@1+ (0.1,-102.4) [-90|90] "deg"  DASy
 SG_ RFC_Loc229_DistVelocityCoVnce : 243|11@1+ (0.0001,-0.1024) [-0.1024|0.1023] "m^2/s"  DASy
 SG_ RFC_Loc229_RadialDistanceVnce : 254|10@1+ (5E-005,0) [0|0.05115] "m^2"  DASy
 SG_ RFC_Loc229_RadialVelocityVnce : 264|10@1+ (0.0001,0) [0|0.1023] "m^2/s^2"  DASy
 SG_ RFC_Loc229_ElevationVnce : 274|10@1+ (0.001,0) [0|1.023] "deg^2"  DASy
 SG_ RFC_Loc229_AzimuthVnce : 284|10@1+ (0.001,0) [0|1.023] "deg^2"  DASy
 SG_ RFC_Loc229_RadarCrossSection : 294|10@1+ (0.2,-102.4) [-50|70] "dBsm"  DASy
 SG_ RFC_Loc229_DistVelocityQuality : 304|8@1+ (1,0) [0|255] "unitless"  DASy
 SG_ RFC_Loc229_ElevationQuality : 312|8@1+ (1,0) [0|255] "unitless"  DASy
 SG_ RFC_Loc229_AzimuthQuality : 320|8@1+ (1,0) [0|255] "unitless"  DASy
 SG_ RFC_Loc229_RSSI : 328|10@1+ (0.1,0) [0|100] "unitless"  DASy
 SG_ RFC_Loc229_AzimuthalPartnerId : 338|10@1+ (1,0) [0|1023] "unitless"  DASy
 SG_ RFC_Loc230_RadialDistance : 352|15@1+ (0.01,0) [0|327.67] "m"  DASy
 SG_ RFC_Loc230_RadialVelocity : 367|15@1+ (0.01,-163.84) [-110|55] "m/s"  DASy
 SG_ RFC_Loc230_Elevation : 382|10@1+ (0.1,-51.2) [-45|45] "deg"  DASy
 SG_ RFC_Loc230_Azimuth : 392|11@1+ (0.1,-102.4) [-90|90] "deg"  DASy
 SG_ RFC_Loc230_DistVelocityCoVnce : 403|11@1+ (0.0001,-0.1024) [-0.1024|0.1023] "m^2/s"  DASy
 SG_ RFC_Loc230_RadialDistanceVnce : 414|10@1+ (5E-005,0) [0|0.05115] "m^2"  DASy
 SG_ RFC_Loc230_RadialVelocityVnce : 424|10@1+ (0.0001,0) [0|0.1023] "m^2/s^2"  DASy
 SG_ RFC_Loc230_ElevationVnce : 434|10@1+ (0.001,0) [0|1.023] "deg^2"  DASy
 SG_ RFC_Loc230_AzimuthVnce : 444|10@1+ (0.001,0) [0|1.023] "deg^2"  DASy
 SG_ RFC_Loc230_RadarCrossSection : 454|10@1+ (0.2,-102.4) [-50|70] "dBsm"  DASy
 SG_ RFC_Loc230_DistVelocityQuality : 464|8@1+ (1,0) [0|255] "unitless"  DASy
 SG_ RFC_Loc230_ElevationQuality : 472|8@1+ (1,0) [0|255] "unitless"  DASy
 SG_ RFC_Loc230_AzimuthQuality : 480|8@1+ (1,0) [0|255] "unitless"  DASy
 SG_ RFC_Loc230_RSSI : 488|10@1+ (0.1,0) [0|100] "unitless"  DASy
 SG_ RFC_Loc230_AzimuthalPartnerId : 498|10@1+ (1,0) [0|1023] "unitless"  DASy

BO_ 341 RFC_Location_231_233: 64 RadarFrontCenter
 SG_ RFC_Loc231_233_CRC : 0|16@1+ (1,0) [0|65535] ""  DASy
 SG_ RFC_Loc231_233_AliveCtr : 16|8@1+ (1,0) [0|255] ""  DASy
 SG_ RFC_Loc231_233_ProtBlockCtr : 24|4@1+ (1,0) [0|15] ""  DASy
 SG_ RFC_Loc231_RadialDistance : 32|15@1+ (0.01,0) [0|327.67] "m"  DASy
 SG_ RFC_Loc231_RadialVelocity : 47|15@1+ (0.01,-163.84) [-110|55] "m/s"  DASy
 SG_ RFC_Loc231_Elevation : 62|10@1+ (0.1,-51.2) [-45|45] "deg"  DASy
 SG_ RFC_Loc231_Azimuth : 72|11@1+ (0.1,-102.4) [-90|90] "deg"  DASy
 SG_ RFC_Loc231_DistVelocityCoVnce : 83|11@1+ (0.0001,-0.1024) [-0.1024|0.1023] "m^2/s"  DASy
 SG_ RFC_Loc231_RadialDistanceVnce : 94|10@1+ (5E-005,0) [0|0.05115] "m^2"  DASy
 SG_ RFC_Loc231_RadialVelocityVnce : 104|10@1+ (0.0001,0) [0|0.1023] "m^2/s^2"  DASy
 SG_ RFC_Loc231_ElevationVnce : 114|10@1+ (0.001,0) [0|1.023] "deg^2"  DASy
 SG_ RFC_Loc231_AzimuthVnce : 124|10@1+ (0.001,0) [0|1.023] "deg^2"  DASy
 SG_ RFC_Loc231_RadarCrossSection : 134|10@1+ (0.2,-102.4) [-50|70] "dBsm"  DASy
 SG_ RFC_Loc231_DistVelocityQuality : 144|8@1+ (1,0) [0|255] "unitless"  DASy
 SG_ RFC_Loc231_ElevationQuality : 152|8@1+ (1,0) [0|255] "unitless"  DASy
 SG_ RFC_Loc231_AzimuthQuality : 160|8@1+ (1,0) [0|255] "unitless"  DASy
 SG_ RFC_Loc231_RSSI : 168|10@1+ (0.1,0) [0|100] "unitless"  DASy
 SG_ RFC_Loc231_AzimuthalPartnerId : 178|10@1+ (1,0) [0|1023] "unitless"  DASy
 SG_ RFC_Loc232_RadialDistance : 192|15@1+ (0.01,0) [0|327.67] "m"  DASy
 SG_ RFC_Loc232_RadialVelocity : 207|15@1+ (0.01,-163.84) [-110|55] "m/s"  DASy
 SG_ RFC_Loc232_Elevation : 222|10@1+ (0.1,-51.2) [-45|45] "deg"  DASy
 SG_ RFC_Loc232_Azimuth : 232|11@1+ (0.1,-102.4) [-90|90] "deg"  DASy
 SG_ RFC_Loc232_DistVelocityCoVnce : 243|11@1+ (0.0001,-0.1024) [-0.1024|0.1023] "m^2/s"  DASy
 SG_ RFC_Loc232_RadialDistanceVnce : 254|10@1+ (5E-005,0) [0|0.05115] "m^2"  DASy
 SG_ RFC_Loc232_RadialVelocityVnce : 264|10@1+ (0.0001,0) [0|0.1023] "m^2/s^2"  DASy
 SG_ RFC_Loc232_ElevationVnce : 274|10@1+ (0.001,0) [0|1.023] "deg^2"  DASy
 SG_ RFC_Loc232_AzimuthVnce : 284|10@1+ (0.001,0) [0|1.023] "deg^2"  DASy
 SG_ RFC_Loc232_RadarCrossSection : 294|10@1+ (0.2,-102.4) [-50|70] "dBsm"  DASy
 SG_ RFC_Loc232_DistVelocityQuality : 304|8@1+ (1,0) [0|255] "unitless"  DASy
 SG_ RFC_Loc232_ElevationQuality : 312|8@1+ (1,0) [0|255] "unitless"  DASy
 SG_ RFC_Loc232_AzimuthQuality : 320|8@1+ (1,0) [0|255] "unitless"  DASy
 SG_ RFC_Loc232_RSSI : 328|10@1+ (0.1,0) [0|100] "unitless"  DASy
 SG_ RFC_Loc232_AzimuthalPartnerId : 338|10@1+ (1,0) [0|1023] "unitless"  DASy
 SG_ RFC_Loc233_RadialDistance : 352|15@1+ (0.01,0) [0|327.67] "m"  DASy
 SG_ RFC_Loc233_RadialVelocity : 367|15@1+ (0.01,-163.84) [-110|55] "m/s"  DASy
 SG_ RFC_Loc233_Elevation : 382|10@1+ (0.1,-51.2) [-45|45] "deg"  DASy
 SG_ RFC_Loc233_Azimuth : 392|11@1+ (0.1,-102.4) [-90|90] "deg"  DASy
 SG_ RFC_Loc233_DistVelocityCoVnce : 403|11@1+ (0.0001,-0.1024) [-0.1024|0.1023] "m^2/s"  DASy
 SG_ RFC_Loc233_RadialDistanceVnce : 414|10@1+ (5E-005,0) [0|0.05115] "m^2"  DASy
 SG_ RFC_Loc233_RadialVelocityVnce : 424|10@1+ (0.0001,0) [0|0.1023] "m^2/s^2"  DASy
 SG_ RFC_Loc233_ElevationVnce : 434|10@1+ (0.001,0) [0|1.023] "deg^2"  DASy
 SG_ RFC_Loc233_AzimuthVnce : 444|10@1+ (0.001,0) [0|1.023] "deg^2"  DASy
 SG_ RFC_Loc233_RadarCrossSection : 454|10@1+ (0.2,-102.4) [-50|70] "dBsm"  DASy
 SG_ RFC_Loc233_DistVelocityQuality : 464|8@1+ (1,0) [0|255] "unitless"  DASy
 SG_ RFC_Loc233_ElevationQuality : 472|8@1+ (1,0) [0|255] "unitless"  DASy
 SG_ RFC_Loc233_AzimuthQuality : 480|8@1+ (1,0) [0|255] "unitless"  DASy
 SG_ RFC_Loc233_RSSI : 488|10@1+ (0.1,0) [0|100] "unitless"  DASy
 SG_ RFC_Loc233_AzimuthalPartnerId : 498|10@1+ (1,0) [0|1023] "unitless"  DASy

BO_ 342 RFC_Location_234_236: 64 RadarFrontCenter
 SG_ RFC_Loc234_236_CRC : 0|16@1+ (1,0) [0|65535] ""  DASy
 SG_ RFC_Loc234_236_AliveCtr : 16|8@1+ (1,0) [0|255] ""  DASy
 SG_ RFC_Loc234_236_ProtBlockCtr : 24|4@1+ (1,0) [0|15] ""  DASy
 SG_ RFC_Loc234_RadialDistance : 32|15@1+ (0.01,0) [0|327.67] "m"  DASy
 SG_ RFC_Loc234_RadialVelocity : 47|15@1+ (0.01,-163.84) [-110|55] "m/s"  DASy
 SG_ RFC_Loc234_Elevation : 62|10@1+ (0.1,-51.2) [-45|45] "deg"  DASy
 SG_ RFC_Loc234_Azimuth : 72|11@1+ (0.1,-102.4) [-90|90] "deg"  DASy
 SG_ RFC_Loc234_DistVelocityCoVnce : 83|11@1+ (0.0001,-0.1024) [-0.1024|0.1023] "m^2/s"  DASy
 SG_ RFC_Loc234_RadialDistanceVnce : 94|10@1+ (5E-005,0) [0|0.05115] "m^2"  DASy
 SG_ RFC_Loc234_RadialVelocityVnce : 104|10@1+ (0.0001,0) [0|0.1023] "m^2/s^2"  DASy
 SG_ RFC_Loc234_ElevationVnce : 114|10@1+ (0.001,0) [0|1.023] "deg^2"  DASy
 SG_ RFC_Loc234_AzimuthVnce : 124|10@1+ (0.001,0) [0|1.023] "deg^2"  DASy
 SG_ RFC_Loc234_RadarCrossSection : 134|10@1+ (0.2,-102.4) [-50|70] "dBsm"  DASy
 SG_ RFC_Loc234_DistVelocityQuality : 144|8@1+ (1,0) [0|255] "unitless"  DASy
 SG_ RFC_Loc234_ElevationQuality : 152|8@1+ (1,0) [0|255] "unitless"  DASy
 SG_ RFC_Loc234_AzimuthQuality : 160|8@1+ (1,0) [0|255] "unitless"  DASy
 SG_ RFC_Loc234_RSSI : 168|10@1+ (0.1,0) [0|100] "unitless"  DASy
 SG_ RFC_Loc234_AzimuthalPartnerId : 178|10@1+ (1,0) [0|1023] "unitless"  DASy
 SG_ RFC_Loc235_RadialDistance : 192|15@1+ (0.01,0) [0|327.67] "m"  DASy
 SG_ RFC_Loc235_RadialVelocity : 207|15@1+ (0.01,-163.84) [-110|55] "m/s"  DASy
 SG_ RFC_Loc235_Elevation : 222|10@1+ (0.1,-51.2) [-45|45] "deg"  DASy
 SG_ RFC_Loc235_Azimuth : 232|11@1+ (0.1,-102.4) [-90|90] "deg"  DASy
 SG_ RFC_Loc235_DistVelocityCoVnce : 243|11@1+ (0.0001,-0.1024) [-0.1024|0.1023] "m^2/s"  DASy
 SG_ RFC_Loc235_RadialDistanceVnce : 254|10@1+ (5E-005,0) [0|0.05115] "m^2"  DASy
 SG_ RFC_Loc235_RadialVelocityVnce : 264|10@1+ (0.0001,0) [0|0.1023] "m^2/s^2"  DASy
 SG_ RFC_Loc235_ElevationVnce : 274|10@1+ (0.001,0) [0|1.023] "deg^2"  DASy
 SG_ RFC_Loc235_AzimuthVnce : 284|10@1+ (0.001,0) [0|1.023] "deg^2"  DASy
 SG_ RFC_Loc235_RadarCrossSection : 294|10@1+ (0.2,-102.4) [-50|70] "dBsm"  DASy
 SG_ RFC_Loc235_DistVelocityQuality : 304|8@1+ (1,0) [0|255] "unitless"  DASy
 SG_ RFC_Loc235_ElevationQuality : 312|8@1+ (1,0) [0|255] "unitless"  DASy
 SG_ RFC_Loc235_AzimuthQuality : 320|8@1+ (1,0) [0|255] "unitless"  DASy
 SG_ RFC_Loc235_RSSI : 328|10@1+ (0.1,0) [0|100] "unitless"  DASy
 SG_ RFC_Loc235_AzimuthalPartnerId : 338|10@1+ (1,0) [0|1023] "unitless"  DASy
 SG_ RFC_Loc236_RadialDistance : 352|15@1+ (0.01,0) [0|327.67] "m"  DASy
 SG_ RFC_Loc236_RadialVelocity : 367|15@1+ (0.01,-163.84) [-110|55] "m/s"  DASy
 SG_ RFC_Loc236_Elevation : 382|10@1+ (0.1,-51.2) [-45|45] "deg"  DASy
 SG_ RFC_Loc236_Azimuth : 392|11@1+ (0.1,-102.4) [-90|90] "deg"  DASy
 SG_ RFC_Loc236_DistVelocityCoVnce : 403|11@1+ (0.0001,-0.1024) [-0.1024|0.1023] "m^2/s"  DASy
 SG_ RFC_Loc236_RadialDistanceVnce : 414|10@1+ (5E-005,0) [0|0.05115] "m^2"  DASy
 SG_ RFC_Loc236_RadialVelocityVnce : 424|10@1+ (0.0001,0) [0|0.1023] "m^2/s^2"  DASy
 SG_ RFC_Loc236_ElevationVnce : 434|10@1+ (0.001,0) [0|1.023] "deg^2"  DASy
 SG_ RFC_Loc236_AzimuthVnce : 444|10@1+ (0.001,0) [0|1.023] "deg^2"  DASy
 SG_ RFC_Loc236_RadarCrossSection : 454|10@1+ (0.2,-102.4) [-50|70] "dBsm"  DASy
 SG_ RFC_Loc236_DistVelocityQuality : 464|8@1+ (1,0) [0|255] "unitless"  DASy
 SG_ RFC_Loc236_ElevationQuality : 472|8@1+ (1,0) [0|255] "unitless"  DASy
 SG_ RFC_Loc236_AzimuthQuality : 480|8@1+ (1,0) [0|255] "unitless"  DASy
 SG_ RFC_Loc236_RSSI : 488|10@1+ (0.1,0) [0|100] "unitless"  DASy
 SG_ RFC_Loc236_AzimuthalPartnerId : 498|10@1+ (1,0) [0|1023] "unitless"  DASy

BO_ 343 RFC_Location_237_239: 64 RadarFrontCenter
 SG_ RFC_Loc237_239_CRC : 0|16@1+ (1,0) [0|65535] ""  DASy
 SG_ RFC_Loc237_239_AliveCtr : 16|8@1+ (1,0) [0|255] ""  DASy
 SG_ RFC_Loc237_239_ProtBlockCtr : 24|4@1+ (1,0) [0|15] ""  DASy
 SG_ RFC_Loc237_RadialDistance : 32|15@1+ (0.01,0) [0|327.67] "m"  DASy
 SG_ RFC_Loc237_RadialVelocity : 47|15@1+ (0.01,-163.84) [-110|55] "m/s"  DASy
 SG_ RFC_Loc237_Elevation : 62|10@1+ (0.1,-51.2) [-45|45] "deg"  DASy
 SG_ RFC_Loc237_Azimuth : 72|11@1+ (0.1,-102.4) [-90|90] "deg"  DASy
 SG_ RFC_Loc237_DistVelocityCoVnce : 83|11@1+ (0.0001,-0.1024) [-0.1024|0.1023] "m^2/s"  DASy
 SG_ RFC_Loc237_RadialDistanceVnce : 94|10@1+ (5E-005,0) [0|0.05115] "m^2"  DASy
 SG_ RFC_Loc237_RadialVelocityVnce : 104|10@1+ (0.0001,0) [0|0.1023] "m^2/s^2"  DASy
 SG_ RFC_Loc237_ElevationVnce : 114|10@1+ (0.001,0) [0|1.023] "deg^2"  DASy
 SG_ RFC_Loc237_AzimuthVnce : 124|10@1+ (0.001,0) [0|1.023] "deg^2"  DASy
 SG_ RFC_Loc237_RadarCrossSection : 134|10@1+ (0.2,-102.4) [-50|70] "dBsm"  DASy
 SG_ RFC_Loc237_DistVelocityQuality : 144|8@1+ (1,0) [0|255] "unitless"  DASy
 SG_ RFC_Loc237_ElevationQuality : 152|8@1+ (1,0) [0|255] "unitless"  DASy
 SG_ RFC_Loc237_AzimuthQuality : 160|8@1+ (1,0) [0|255] "unitless"  DASy
 SG_ RFC_Loc237_RSSI : 168|10@1+ (0.1,0) [0|100] "unitless"  DASy
 SG_ RFC_Loc237_AzimuthalPartnerId : 178|10@1+ (1,0) [0|1023] "unitless"  DASy
 SG_ RFC_Loc238_RadialDistance : 192|15@1+ (0.01,0) [0|327.67] "m"  DASy
 SG_ RFC_Loc238_RadialVelocity : 207|15@1+ (0.01,-163.84) [-110|55] "m/s"  DASy
 SG_ RFC_Loc238_Elevation : 222|10@1+ (0.1,-51.2) [-45|45] "deg"  DASy
 SG_ RFC_Loc238_Azimuth : 232|11@1+ (0.1,-102.4) [-90|90] "deg"  DASy
 SG_ RFC_Loc238_DistVelocityCoVnce : 243|11@1+ (0.0001,-0.1024) [-0.1024|0.1023] "m^2/s"  DASy
 SG_ RFC_Loc238_RadialDistanceVnce : 254|10@1+ (5E-005,0) [0|0.05115] "m^2"  DASy
 SG_ RFC_Loc238_RadialVelocityVnce : 264|10@1+ (0.0001,0) [0|0.1023] "m^2/s^2"  DASy
 SG_ RFC_Loc238_ElevationVnce : 274|10@1+ (0.001,0) [0|1.023] "deg^2"  DASy
 SG_ RFC_Loc238_AzimuthVnce : 284|10@1+ (0.001,0) [0|1.023] "deg^2"  DASy
 SG_ RFC_Loc238_RadarCrossSection : 294|10@1+ (0.2,-102.4) [-50|70] "dBsm"  DASy
 SG_ RFC_Loc238_DistVelocityQuality : 304|8@1+ (1,0) [0|255] "unitless"  DASy
 SG_ RFC_Loc238_ElevationQuality : 312|8@1+ (1,0) [0|255] "unitless"  DASy
 SG_ RFC_Loc238_AzimuthQuality : 320|8@1+ (1,0) [0|255] "unitless"  DASy
 SG_ RFC_Loc238_RSSI : 328|10@1+ (0.1,0) [0|100] "unitless"  DASy
 SG_ RFC_Loc238_AzimuthalPartnerId : 338|10@1+ (1,0) [0|1023] "unitless"  DASy
 SG_ RFC_Loc239_RadialDistance : 352|15@1+ (0.01,0) [0|327.67] "m"  DASy
 SG_ RFC_Loc239_RadialVelocity : 367|15@1+ (0.01,-163.84) [-110|55] "m/s"  DASy
 SG_ RFC_Loc239_Elevation : 382|10@1+ (0.1,-51.2) [-45|45] "deg"  DASy
 SG_ RFC_Loc239_Azimuth : 392|11@1+ (0.1,-102.4) [-90|90] "deg"  DASy
 SG_ RFC_Loc239_DistVelocityCoVnce : 403|11@1+ (0.0001,-0.1024) [-0.1024|0.1023] "m^2/s"  DASy
 SG_ RFC_Loc239_RadialDistanceVnce : 414|10@1+ (5E-005,0) [0|0.05115] "m^2"  DASy
 SG_ RFC_Loc239_RadialVelocityVnce : 424|10@1+ (0.0001,0) [0|0.1023] "m^2/s^2"  DASy
 SG_ RFC_Loc239_ElevationVnce : 434|10@1+ (0.001,0) [0|1.023] "deg^2"  DASy
 SG_ RFC_Loc239_AzimuthVnce : 444|10@1+ (0.001,0) [0|1.023] "deg^2"  DASy
 SG_ RFC_Loc239_RadarCrossSection : 454|10@1+ (0.2,-102.4) [-50|70] "dBsm"  DASy
 SG_ RFC_Loc239_DistVelocityQuality : 464|8@1+ (1,0) [0|255] "unitless"  DASy
 SG_ RFC_Loc239_ElevationQuality : 472|8@1+ (1,0) [0|255] "unitless"  DASy
 SG_ RFC_Loc239_AzimuthQuality : 480|8@1+ (1,0) [0|255] "unitless"  DASy
 SG_ RFC_Loc239_RSSI : 488|10@1+ (0.1,0) [0|100] "unitless"  DASy
 SG_ RFC_Loc239_AzimuthalPartnerId : 498|10@1+ (1,0) [0|1023] "unitless"  DASy

BO_ 344 RFC_Location_240_242: 64 RadarFrontCenter
 SG_ RFC_Loc240_242_CRC : 0|16@1+ (1,0) [0|65535] ""  DASy
 SG_ RFC_Loc240_242_AliveCtr : 16|8@1+ (1,0) [0|255] ""  DASy
 SG_ RFC_Loc240_242_ProtBlockCtr : 24|4@1+ (1,0) [0|15] ""  DASy
 SG_ RFC_Loc240_RadialDistance : 32|15@1+ (0.01,0) [0|327.67] "m"  DASy
 SG_ RFC_Loc240_RadialVelocity : 47|15@1+ (0.01,-163.84) [-110|55] "m/s"  DASy
 SG_ RFC_Loc240_Elevation : 62|10@1+ (0.1,-51.2) [-45|45] "deg"  DASy
 SG_ RFC_Loc240_Azimuth : 72|11@1+ (0.1,-102.4) [-90|90] "deg"  DASy
 SG_ RFC_Loc240_DistVelocityCoVnce : 83|11@1+ (0.0001,-0.1024) [-0.1024|0.1023] "m^2/s"  DASy
 SG_ RFC_Loc240_RadialDistanceVnce : 94|10@1+ (5E-005,0) [0|0.05115] "m^2"  DASy
 SG_ RFC_Loc240_RadialVelocityVnce : 104|10@1+ (0.0001,0) [0|0.1023] "m^2/s^2"  DASy
 SG_ RFC_Loc240_ElevationVnce : 114|10@1+ (0.001,0) [0|1.023] "deg^2"  DASy
 SG_ RFC_Loc240_AzimuthVnce : 124|10@1+ (0.001,0) [0|1.023] "deg^2"  DASy
 SG_ RFC_Loc240_RadarCrossSection : 134|10@1+ (0.2,-102.4) [-50|70] "dBsm"  DASy
 SG_ RFC_Loc240_DistVelocityQuality : 144|8@1+ (1,0) [0|255] "unitless"  DASy
 SG_ RFC_Loc240_ElevationQuality : 152|8@1+ (1,0) [0|255] "unitless"  DASy
 SG_ RFC_Loc240_AzimuthQuality : 160|8@1+ (1,0) [0|255] "unitless"  DASy
 SG_ RFC_Loc240_RSSI : 168|10@1+ (0.1,0) [0|100] "unitless"  DASy
 SG_ RFC_Loc240_AzimuthalPartnerId : 178|10@1+ (1,0) [0|1023] "unitless"  DASy
 SG_ RFC_Loc241_RadialDistance : 192|15@1+ (0.01,0) [0|327.67] "m"  DASy
 SG_ RFC_Loc241_RadialVelocity : 207|15@1+ (0.01,-163.84) [-110|55] "m/s"  DASy
 SG_ RFC_Loc241_Elevation : 222|10@1+ (0.1,-51.2) [-45|45] "deg"  DASy
 SG_ RFC_Loc241_Azimuth : 232|11@1+ (0.1,-102.4) [-90|90] "deg"  DASy
 SG_ RFC_Loc241_DistVelocityCoVnce : 243|11@1+ (0.0001,-0.1024) [-0.1024|0.1023] "m^2/s"  DASy
 SG_ RFC_Loc241_RadialDistanceVnce : 254|10@1+ (5E-005,0) [0|0.05115] "m^2"  DASy
 SG_ RFC_Loc241_RadialVelocityVnce : 264|10@1+ (0.0001,0) [0|0.1023] "m^2/s^2"  DASy
 SG_ RFC_Loc241_ElevationVnce : 274|10@1+ (0.001,0) [0|1.023] "deg^2"  DASy
 SG_ RFC_Loc241_AzimuthVnce : 284|10@1+ (0.001,0) [0|1.023] "deg^2"  DASy
 SG_ RFC_Loc241_RadarCrossSection : 294|10@1+ (0.2,-102.4) [-50|70] "dBsm"  DASy
 SG_ RFC_Loc241_DistVelocityQuality : 304|8@1+ (1,0) [0|255] "unitless"  DASy
 SG_ RFC_Loc241_ElevationQuality : 312|8@1+ (1,0) [0|255] "unitless"  DASy
 SG_ RFC_Loc241_AzimuthQuality : 320|8@1+ (1,0) [0|255] "unitless"  DASy
 SG_ RFC_Loc241_RSSI : 328|10@1+ (0.1,0) [0|100] "unitless"  DASy
 SG_ RFC_Loc241_AzimuthalPartnerId : 338|10@1+ (1,0) [0|1023] "unitless"  DASy
 SG_ RFC_Loc242_RadialDistance : 352|15@1+ (0.01,0) [0|327.67] "m"  DASy
 SG_ RFC_Loc242_RadialVelocity : 367|15@1+ (0.01,-163.84) [-110|55] "m/s"  DASy
 SG_ RFC_Loc242_Elevation : 382|10@1+ (0.1,-51.2) [-45|45] "deg"  DASy
 SG_ RFC_Loc242_Azimuth : 392|11@1+ (0.1,-102.4) [-90|90] "deg"  DASy
 SG_ RFC_Loc242_DistVelocityCoVnce : 403|11@1+ (0.0001,-0.1024) [-0.1024|0.1023] "m^2/s"  DASy
 SG_ RFC_Loc242_RadialDistanceVnce : 414|10@1+ (5E-005,0) [0|0.05115] "m^2"  DASy
 SG_ RFC_Loc242_RadialVelocityVnce : 424|10@1+ (0.0001,0) [0|0.1023] "m^2/s^2"  DASy
 SG_ RFC_Loc242_ElevationVnce : 434|10@1+ (0.001,0) [0|1.023] "deg^2"  DASy
 SG_ RFC_Loc242_AzimuthVnce : 444|10@1+ (0.001,0) [0|1.023] "deg^2"  DASy
 SG_ RFC_Loc242_RadarCrossSection : 454|10@1+ (0.2,-102.4) [-50|70] "dBsm"  DASy
 SG_ RFC_Loc242_DistVelocityQuality : 464|8@1+ (1,0) [0|255] "unitless"  DASy
 SG_ RFC_Loc242_ElevationQuality : 472|8@1+ (1,0) [0|255] "unitless"  DASy
 SG_ RFC_Loc242_AzimuthQuality : 480|8@1+ (1,0) [0|255] "unitless"  DASy
 SG_ RFC_Loc242_RSSI : 488|10@1+ (0.1,0) [0|100] "unitless"  DASy
 SG_ RFC_Loc242_AzimuthalPartnerId : 498|10@1+ (1,0) [0|1023] "unitless"  DASy

BO_ 345 RFC_Location_243_245: 64 RadarFrontCenter
 SG_ RFC_Loc243_245_CRC : 0|16@1+ (1,0) [0|65535] ""  DASy
 SG_ RFC_Loc243_245_AliveCtr : 16|8@1+ (1,0) [0|255] ""  DASy
 SG_ RFC_Loc243_245_ProtBlockCtr : 24|4@1+ (1,0) [0|15] ""  DASy
 SG_ RFC_Loc243_RadialDistance : 32|15@1+ (0.01,0) [0|327.67] "m"  DASy
 SG_ RFC_Loc243_RadialVelocity : 47|15@1+ (0.01,-163.84) [-110|55] "m/s"  DASy
 SG_ RFC_Loc243_Elevation : 62|10@1+ (0.1,-51.2) [-45|45] "deg"  DASy
 SG_ RFC_Loc243_Azimuth : 72|11@1+ (0.1,-102.4) [-90|90] "deg"  DASy
 SG_ RFC_Loc243_DistVelocityCoVnce : 83|11@1+ (0.0001,-0.1024) [-0.1024|0.1023] "m^2/s"  DASy
 SG_ RFC_Loc243_RadialDistanceVnce : 94|10@1+ (5E-005,0) [0|0.05115] "m^2"  DASy
 SG_ RFC_Loc243_RadialVelocityVnce : 104|10@1+ (0.0001,0) [0|0.1023] "m^2/s^2"  DASy
 SG_ RFC_Loc243_ElevationVnce : 114|10@1+ (0.001,0) [0|1.023] "deg^2"  DASy
 SG_ RFC_Loc243_AzimuthVnce : 124|10@1+ (0.001,0) [0|1.023] "deg^2"  DASy
 SG_ RFC_Loc243_RadarCrossSection : 134|10@1+ (0.2,-102.4) [-50|70] "dBsm"  DASy
 SG_ RFC_Loc243_DistVelocityQuality : 144|8@1+ (1,0) [0|255] "unitless"  DASy
 SG_ RFC_Loc243_ElevationQuality : 152|8@1+ (1,0) [0|255] "unitless"  DASy
 SG_ RFC_Loc243_AzimuthQuality : 160|8@1+ (1,0) [0|255] "unitless"  DASy
 SG_ RFC_Loc243_RSSI : 168|10@1+ (0.1,0) [0|100] "unitless"  DASy
 SG_ RFC_Loc243_AzimuthalPartnerId : 178|10@1+ (1,0) [0|1023] "unitless"  DASy
 SG_ RFC_Loc244_RadialDistance : 192|15@1+ (0.01,0) [0|327.67] "m"  DASy
 SG_ RFC_Loc244_RadialVelocity : 207|15@1+ (0.01,-163.84) [-110|55] "m/s"  DASy
 SG_ RFC_Loc244_Elevation : 222|10@1+ (0.1,-51.2) [-45|45] "deg"  DASy
 SG_ RFC_Loc244_Azimuth : 232|11@1+ (0.1,-102.4) [-90|90] "deg"  DASy
 SG_ RFC_Loc244_DistVelocityCoVnce : 243|11@1+ (0.0001,-0.1024) [-0.1024|0.1023] "m^2/s"  DASy
 SG_ RFC_Loc244_RadialDistanceVnce : 254|10@1+ (5E-005,0) [0|0.05115] "m^2"  DASy
 SG_ RFC_Loc244_RadialVelocityVnce : 264|10@1+ (0.0001,0) [0|0.1023] "m^2/s^2"  DASy
 SG_ RFC_Loc244_ElevationVnce : 274|10@1+ (0.001,0) [0|1.023] "deg^2"  DASy
 SG_ RFC_Loc244_AzimuthVnce : 284|10@1+ (0.001,0) [0|1.023] "deg^2"  DASy
 SG_ RFC_Loc244_RadarCrossSection : 294|10@1+ (0.2,-102.4) [-50|70] "dBsm"  DASy
 SG_ RFC_Loc244_DistVelocityQuality : 304|8@1+ (1,0) [0|255] "unitless"  DASy
 SG_ RFC_Loc244_ElevationQuality : 312|8@1+ (1,0) [0|255] "unitless"  DASy
 SG_ RFC_Loc244_AzimuthQuality : 320|8@1+ (1,0) [0|255] "unitless"  DASy
 SG_ RFC_Loc244_RSSI : 328|10@1+ (0.1,0) [0|100] "unitless"  DASy
 SG_ RFC_Loc244_AzimuthalPartnerId : 338|10@1+ (1,0) [0|1023] "unitless"  DASy
 SG_ RFC_Loc245_RadialDistance : 352|15@1+ (0.01,0) [0|327.67] "m"  DASy
 SG_ RFC_Loc245_RadialVelocity : 367|15@1+ (0.01,-163.84) [-110|55] "m/s"  DASy
 SG_ RFC_Loc245_Elevation : 382|10@1+ (0.1,-51.2) [-45|45] "deg"  DASy
 SG_ RFC_Loc245_Azimuth : 392|11@1+ (0.1,-102.4) [-90|90] "deg"  DASy
 SG_ RFC_Loc245_DistVelocityCoVnce : 403|11@1+ (0.0001,-0.1024) [-0.1024|0.1023] "m^2/s"  DASy
 SG_ RFC_Loc245_RadialDistanceVnce : 414|10@1+ (5E-005,0) [0|0.05115] "m^2"  DASy
 SG_ RFC_Loc245_RadialVelocityVnce : 424|10@1+ (0.0001,0) [0|0.1023] "m^2/s^2"  DASy
 SG_ RFC_Loc245_ElevationVnce : 434|10@1+ (0.001,0) [0|1.023] "deg^2"  DASy
 SG_ RFC_Loc245_AzimuthVnce : 444|10@1+ (0.001,0) [0|1.023] "deg^2"  DASy
 SG_ RFC_Loc245_RadarCrossSection : 454|10@1+ (0.2,-102.4) [-50|70] "dBsm"  DASy
 SG_ RFC_Loc245_DistVelocityQuality : 464|8@1+ (1,0) [0|255] "unitless"  DASy
 SG_ RFC_Loc245_ElevationQuality : 472|8@1+ (1,0) [0|255] "unitless"  DASy
 SG_ RFC_Loc245_AzimuthQuality : 480|8@1+ (1,0) [0|255] "unitless"  DASy
 SG_ RFC_Loc245_RSSI : 488|10@1+ (0.1,0) [0|100] "unitless"  DASy
 SG_ RFC_Loc245_AzimuthalPartnerId : 498|10@1+ (1,0) [0|1023] "unitless"  DASy

BO_ 346 RFC_Location_246_248: 64 RadarFrontCenter
 SG_ RFC_Loc246_248_CRC : 0|16@1+ (1,0) [0|65535] ""  DASy
 SG_ RFC_Loc246_248_AliveCtr : 16|8@1+ (1,0) [0|255] ""  DASy
 SG_ RFC_Loc246_248_ProtBlockCtr : 24|4@1+ (1,0) [0|15] ""  DASy
 SG_ RFC_Loc246_RadialDistance : 32|15@1+ (0.01,0) [0|327.67] "m"  DASy
 SG_ RFC_Loc246_RadialVelocity : 47|15@1+ (0.01,-163.84) [-110|55] "m/s"  DASy
 SG_ RFC_Loc246_Elevation : 62|10@1+ (0.1,-51.2) [-45|45] "deg"  DASy
 SG_ RFC_Loc246_Azimuth : 72|11@1+ (0.1,-102.4) [-90|90] "deg"  DASy
 SG_ RFC_Loc246_DistVelocityCoVnce : 83|11@1+ (0.0001,-0.1024) [-0.1024|0.1023] "m^2/s"  DASy
 SG_ RFC_Loc246_RadialDistanceVnce : 94|10@1+ (5E-005,0) [0|0.05115] "m^2"  DASy
 SG_ RFC_Loc246_RadialVelocityVnce : 104|10@1+ (0.0001,0) [0|0.1023] "m^2/s^2"  DASy
 SG_ RFC_Loc246_ElevationVnce : 114|10@1+ (0.001,0) [0|1.023] "deg^2"  DASy
 SG_ RFC_Loc246_AzimuthVnce : 124|10@1+ (0.001,0) [0|1.023] "deg^2"  DASy
 SG_ RFC_Loc246_RadarCrossSection : 134|10@1+ (0.2,-102.4) [-50|70] "dBsm"  DASy
 SG_ RFC_Loc246_DistVelocityQuality : 144|8@1+ (1,0) [0|255] "unitless"  DASy
 SG_ RFC_Loc246_ElevationQuality : 152|8@1+ (1,0) [0|255] "unitless"  DASy
 SG_ RFC_Loc246_AzimuthQuality : 160|8@1+ (1,0) [0|255] "unitless"  DASy
 SG_ RFC_Loc246_RSSI : 168|10@1+ (0.1,0) [0|100] "unitless"  DASy
 SG_ RFC_Loc246_AzimuthalPartnerId : 178|10@1+ (1,0) [0|1023] "unitless"  DASy
 SG_ RFC_Loc247_RadialDistance : 192|15@1+ (0.01,0) [0|327.67] "m"  DASy
 SG_ RFC_Loc247_RadialVelocity : 207|15@1+ (0.01,-163.84) [-110|55] "m/s"  DASy
 SG_ RFC_Loc247_Elevation : 222|10@1+ (0.1,-51.2) [-45|45] "deg"  DASy
 SG_ RFC_Loc247_Azimuth : 232|11@1+ (0.1,-102.4) [-90|90] "deg"  DASy
 SG_ RFC_Loc247_DistVelocityCoVnce : 243|11@1+ (0.0001,-0.1024) [-0.1024|0.1023] "m^2/s"  DASy
 SG_ RFC_Loc247_RadialDistanceVnce : 254|10@1+ (5E-005,0) [0|0.05115] "m^2"  DASy
 SG_ RFC_Loc247_RadialVelocityVnce : 264|10@1+ (0.0001,0) [0|0.1023] "m^2/s^2"  DASy
 SG_ RFC_Loc247_ElevationVnce : 274|10@1+ (0.001,0) [0|1.023] "deg^2"  DASy
 SG_ RFC_Loc247_AzimuthVnce : 284|10@1+ (0.001,0) [0|1.023] "deg^2"  DASy
 SG_ RFC_Loc247_RadarCrossSection : 294|10@1+ (0.2,-102.4) [-50|70] "dBsm"  DASy
 SG_ RFC_Loc247_DistVelocityQuality : 304|8@1+ (1,0) [0|255] "unitless"  DASy
 SG_ RFC_Loc247_ElevationQuality : 312|8@1+ (1,0) [0|255] "unitless"  DASy
 SG_ RFC_Loc247_AzimuthQuality : 320|8@1+ (1,0) [0|255] "unitless"  DASy
 SG_ RFC_Loc247_RSSI : 328|10@1+ (0.1,0) [0|100] "unitless"  DASy
 SG_ RFC_Loc247_AzimuthalPartnerId : 338|10@1+ (1,0) [0|1023] "unitless"  DASy
 SG_ RFC_Loc248_RadialDistance : 352|15@1+ (0.01,0) [0|327.67] "m"  DASy
 SG_ RFC_Loc248_RadialVelocity : 367|15@1+ (0.01,-163.84) [-110|55] "m/s"  DASy
 SG_ RFC_Loc248_Elevation : 382|10@1+ (0.1,-51.2) [-45|45] "deg"  DASy
 SG_ RFC_Loc248_Azimuth : 392|11@1+ (0.1,-102.4) [-90|90] "deg"  DASy
 SG_ RFC_Loc248_DistVelocityCoVnce : 403|11@1+ (0.0001,-0.1024) [-0.1024|0.1023] "m^2/s"  DASy
 SG_ RFC_Loc248_RadialDistanceVnce : 414|10@1+ (5E-005,0) [0|0.05115] "m^2"  DASy
 SG_ RFC_Loc248_RadialVelocityVnce : 424|10@1+ (0.0001,0) [0|0.1023] "m^2/s^2"  DASy
 SG_ RFC_Loc248_ElevationVnce : 434|10@1+ (0.001,0) [0|1.023] "deg^2"  DASy
 SG_ RFC_Loc248_AzimuthVnce : 444|10@1+ (0.001,0) [0|1.023] "deg^2"  DASy
 SG_ RFC_Loc248_RadarCrossSection : 454|10@1+ (0.2,-102.4) [-50|70] "dBsm"  DASy
 SG_ RFC_Loc248_DistVelocityQuality : 464|8@1+ (1,0) [0|255] "unitless"  DASy
 SG_ RFC_Loc248_ElevationQuality : 472|8@1+ (1,0) [0|255] "unitless"  DASy
 SG_ RFC_Loc248_AzimuthQuality : 480|8@1+ (1,0) [0|255] "unitless"  DASy
 SG_ RFC_Loc248_RSSI : 488|10@1+ (0.1,0) [0|100] "unitless"  DASy
 SG_ RFC_Loc248_AzimuthalPartnerId : 498|10@1+ (1,0) [0|1023] "unitless"  DASy

BO_ 347 RFC_Location_249_251: 64 RadarFrontCenter
 SG_ RFC_Loc249_251_CRC : 0|16@1+ (1,0) [0|65535] ""  DASy
 SG_ RFC_Loc249_251_AliveCtr : 16|8@1+ (1,0) [0|255] ""  DASy
 SG_ RFC_Loc249_251_ProtBlockCtr : 24|4@1+ (1,0) [0|15] ""  DASy
 SG_ RFC_Loc249_RadialDistance : 32|15@1+ (0.01,0) [0|327.67] "m"  DASy
 SG_ RFC_Loc249_RadialVelocity : 47|15@1+ (0.01,-163.84) [-110|55] "m/s"  DASy
 SG_ RFC_Loc249_Elevation : 62|10@1+ (0.1,-51.2) [-45|45] "deg"  DASy
 SG_ RFC_Loc249_Azimuth : 72|11@1+ (0.1,-102.4) [-90|90] "deg"  DASy
 SG_ RFC_Loc249_DistVelocityCoVnce : 83|11@1+ (0.0001,-0.1024) [-0.1024|0.1023] "m^2/s"  DASy
 SG_ RFC_Loc249_RadialDistanceVnce : 94|10@1+ (5E-005,0) [0|0.05115] "m^2"  DASy
 SG_ RFC_Loc249_RadialVelocityVnce : 104|10@1+ (0.0001,0) [0|0.1023] "m^2/s^2"  DASy
 SG_ RFC_Loc249_ElevationVnce : 114|10@1+ (0.001,0) [0|1.023] "deg^2"  DASy
 SG_ RFC_Loc249_AzimuthVnce : 124|10@1+ (0.001,0) [0|1.023] "deg^2"  DASy
 SG_ RFC_Loc249_RadarCrossSection : 134|10@1+ (0.2,-102.4) [-50|70] "dBsm"  DASy
 SG_ RFC_Loc249_DistVelocityQuality : 144|8@1+ (1,0) [0|255] "unitless"  DASy
 SG_ RFC_Loc249_ElevationQuality : 152|8@1+ (1,0) [0|255] "unitless"  DASy
 SG_ RFC_Loc249_AzimuthQuality : 160|8@1+ (1,0) [0|255] "unitless"  DASy
 SG_ RFC_Loc249_RSSI : 168|10@1+ (0.1,0) [0|100] "unitless"  DASy
 SG_ RFC_Loc249_AzimuthalPartnerId : 178|10@1+ (1,0) [0|1023] "unitless"  DASy
 SG_ RFC_Loc250_RadialDistance : 192|15@1+ (0.01,0) [0|327.67] "m"  DASy
 SG_ RFC_Loc250_RadialVelocity : 207|15@1+ (0.01,-163.84) [-110|55] "m/s"  DASy
 SG_ RFC_Loc250_Elevation : 222|10@1+ (0.1,-51.2) [-45|45] "deg"  DASy
 SG_ RFC_Loc250_Azimuth : 232|11@1+ (0.1,-102.4) [-90|90] "deg"  DASy
 SG_ RFC_Loc250_DistVelocityCoVnce : 243|11@1+ (0.0001,-0.1024) [-0.1024|0.1023] "m^2/s"  DASy
 SG_ RFC_Loc250_RadialDistanceVnce : 254|10@1+ (5E-005,0) [0|0.05115] "m^2"  DASy
 SG_ RFC_Loc250_RadialVelocityVnce : 264|10@1+ (0.0001,0) [0|0.1023] "m^2/s^2"  DASy
 SG_ RFC_Loc250_ElevationVnce : 274|10@1+ (0.001,0) [0|1.023] "deg^2"  DASy
 SG_ RFC_Loc250_AzimuthVnce : 284|10@1+ (0.001,0) [0|1.023] "deg^2"  DASy
 SG_ RFC_Loc250_RadarCrossSection : 294|10@1+ (0.2,-102.4) [-50|70] "dBsm"  DASy
 SG_ RFC_Loc250_DistVelocityQuality : 304|8@1+ (1,0) [0|255] "unitless"  DASy
 SG_ RFC_Loc250_ElevationQuality : 312|8@1+ (1,0) [0|255] "unitless"  DASy
 SG_ RFC_Loc250_AzimuthQuality : 320|8@1+ (1,0) [0|255] "unitless"  DASy
 SG_ RFC_Loc250_RSSI : 328|10@1+ (0.1,0) [0|100] "unitless"  DASy
 SG_ RFC_Loc250_AzimuthalPartnerId : 338|10@1+ (1,0) [0|1023] "unitless"  DASy
 SG_ RFC_Loc251_RadialDistance : 352|15@1+ (0.01,0) [0|327.67] "m"  DASy
 SG_ RFC_Loc251_RadialVelocity : 367|15@1+ (0.01,-163.84) [-110|55] "m/s"  DASy
 SG_ RFC_Loc251_Elevation : 382|10@1+ (0.1,-51.2) [-45|45] "deg"  DASy
 SG_ RFC_Loc251_Azimuth : 392|11@1+ (0.1,-102.4) [-90|90] "deg"  DASy
 SG_ RFC_Loc251_DistVelocityCoVnce : 403|11@1+ (0.0001,-0.1024) [-0.1024|0.1023] "m^2/s"  DASy
 SG_ RFC_Loc251_RadialDistanceVnce : 414|10@1+ (5E-005,0) [0|0.05115] "m^2"  DASy
 SG_ RFC_Loc251_RadialVelocityVnce : 424|10@1+ (0.0001,0) [0|0.1023] "m^2/s^2"  DASy
 SG_ RFC_Loc251_ElevationVnce : 434|10@1+ (0.001,0) [0|1.023] "deg^2"  DASy
 SG_ RFC_Loc251_AzimuthVnce : 444|10@1+ (0.001,0) [0|1.023] "deg^2"  DASy
 SG_ RFC_Loc251_RadarCrossSection : 454|10@1+ (0.2,-102.4) [-50|70] "dBsm"  DASy
 SG_ RFC_Loc251_DistVelocityQuality : 464|8@1+ (1,0) [0|255] "unitless"  DASy
 SG_ RFC_Loc251_ElevationQuality : 472|8@1+ (1,0) [0|255] "unitless"  DASy
 SG_ RFC_Loc251_AzimuthQuality : 480|8@1+ (1,0) [0|255] "unitless"  DASy
 SG_ RFC_Loc251_RSSI : 488|10@1+ (0.1,0) [0|100] "unitless"  DASy
 SG_ RFC_Loc251_AzimuthalPartnerId : 498|10@1+ (1,0) [0|1023] "unitless"  DASy

BO_ 348 RFC_Location_252_254: 64 RadarFrontCenter
 SG_ RFC_Loc252_254_CRC : 0|16@1+ (1,0) [0|65535] ""  DASy
 SG_ RFC_Loc252_254_AliveCtr : 16|8@1+ (1,0) [0|255] ""  DASy
 SG_ RFC_Loc252_254_ProtBlockCtr : 24|4@1+ (1,0) [0|15] ""  DASy
 SG_ RFC_Loc252_RadialDistance : 32|15@1+ (0.01,0) [0|327.67] "m"  DASy
 SG_ RFC_Loc252_RadialVelocity : 47|15@1+ (0.01,-163.84) [-110|55] "m/s"  DASy
 SG_ RFC_Loc252_Elevation : 62|10@1+ (0.1,-51.2) [-45|45] "deg"  DASy
 SG_ RFC_Loc252_Azimuth : 72|11@1+ (0.1,-102.4) [-90|90] "deg"  DASy
 SG_ RFC_Loc252_DistVelocityCoVnce : 83|11@1+ (0.0001,-0.1024) [-0.1024|0.1023] "m^2/s"  DASy
 SG_ RFC_Loc252_RadialDistanceVnce : 94|10@1+ (5E-005,0) [0|0.05115] "m^2"  DASy
 SG_ RFC_Loc252_RadialVelocityVnce : 104|10@1+ (0.0001,0) [0|0.1023] "m^2/s^2"  DASy
 SG_ RFC_Loc252_ElevationVnce : 114|10@1+ (0.001,0) [0|1.023] "deg^2"  DASy
 SG_ RFC_Loc252_AzimuthVnce : 124|10@1+ (0.001,0) [0|1.023] "deg^2"  DASy
 SG_ RFC_Loc252_RadarCrossSection : 134|10@1+ (0.2,-102.4) [-50|70] "dBsm"  DASy
 SG_ RFC_Loc252_DistVelocityQuality : 144|8@1+ (1,0) [0|255] "unitless"  DASy
 SG_ RFC_Loc252_ElevationQuality : 152|8@1+ (1,0) [0|255] "unitless"  DASy
 SG_ RFC_Loc252_AzimuthQuality : 160|8@1+ (1,0) [0|255] "unitless"  DASy
 SG_ RFC_Loc252_RSSI : 168|10@1+ (0.1,0) [0|100] "unitless"  DASy
 SG_ RFC_Loc252_AzimuthalPartnerId : 178|10@1+ (1,0) [0|1023] "unitless"  DASy
 SG_ RFC_Loc253_RadialDistance : 192|15@1+ (0.01,0) [0|327.67] "m"  DASy
 SG_ RFC_Loc253_RadialVelocity : 207|15@1+ (0.01,-163.84) [-110|55] "m/s"  DASy
 SG_ RFC_Loc253_Elevation : 222|10@1+ (0.1,-51.2) [-45|45] "deg"  DASy
 SG_ RFC_Loc253_Azimuth : 232|11@1+ (0.1,-102.4) [-90|90] "deg"  DASy
 SG_ RFC_Loc253_DistVelocityCoVnce : 243|11@1+ (0.0001,-0.1024) [-0.1024|0.1023] "m^2/s"  DASy
 SG_ RFC_Loc253_RadialDistanceVnce : 254|10@1+ (5E-005,0) [0|0.05115] "m^2"  DASy
 SG_ RFC_Loc253_RadialVelocityVnce : 264|10@1+ (0.0001,0) [0|0.1023] "m^2/s^2"  DASy
 SG_ RFC_Loc253_ElevationVnce : 274|10@1+ (0.001,0) [0|1.023] "deg^2"  DASy
 SG_ RFC_Loc253_AzimuthVnce : 284|10@1+ (0.001,0) [0|1.023] "deg^2"  DASy
 SG_ RFC_Loc253_RadarCrossSection : 294|10@1+ (0.2,-102.4) [-50|70] "dBsm"  DASy
 SG_ RFC_Loc253_DistVelocityQuality : 304|8@1+ (1,0) [0|255] "unitless"  DASy
 SG_ RFC_Loc253_ElevationQuality : 312|8@1+ (1,0) [0|255] "unitless"  DASy
 SG_ RFC_Loc253_AzimuthQuality : 320|8@1+ (1,0) [0|255] "unitless"  DASy
 SG_ RFC_Loc253_RSSI : 328|10@1+ (0.1,0) [0|100] "unitless"  DASy
 SG_ RFC_Loc253_AzimuthalPartnerId : 338|10@1+ (1,0) [0|1023] "unitless"  DASy
 SG_ RFC_Loc254_RadialDistance : 352|15@1+ (0.01,0) [0|327.67] "m"  DASy
 SG_ RFC_Loc254_RadialVelocity : 367|15@1+ (0.01,-163.84) [-110|55] "m/s"  DASy
 SG_ RFC_Loc254_Elevation : 382|10@1+ (0.1,-51.2) [-45|45] "deg"  DASy
 SG_ RFC_Loc254_Azimuth : 392|11@1+ (0.1,-102.4) [-90|90] "deg"  DASy
 SG_ RFC_Loc254_DistVelocityCoVnce : 403|11@1+ (0.0001,-0.1024) [-0.1024|0.1023] "m^2/s"  DASy
 SG_ RFC_Loc254_RadialDistanceVnce : 414|10@1+ (5E-005,0) [0|0.05115] "m^2"  DASy
 SG_ RFC_Loc254_RadialVelocityVnce : 424|10@1+ (0.0001,0) [0|0.1023] "m^2/s^2"  DASy
 SG_ RFC_Loc254_ElevationVnce : 434|10@1+ (0.001,0) [0|1.023] "deg^2"  DASy
 SG_ RFC_Loc254_AzimuthVnce : 444|10@1+ (0.001,0) [0|1.023] "deg^2"  DASy
 SG_ RFC_Loc254_RadarCrossSection : 454|10@1+ (0.2,-102.4) [-50|70] "dBsm"  DASy
 SG_ RFC_Loc254_DistVelocityQuality : 464|8@1+ (1,0) [0|255] "unitless"  DASy
 SG_ RFC_Loc254_ElevationQuality : 472|8@1+ (1,0) [0|255] "unitless"  DASy
 SG_ RFC_Loc254_AzimuthQuality : 480|8@1+ (1,0) [0|255] "unitless"  DASy
 SG_ RFC_Loc254_RSSI : 488|10@1+ (0.1,0) [0|100] "unitless"  DASy
 SG_ RFC_Loc254_AzimuthalPartnerId : 498|10@1+ (1,0) [0|1023] "unitless"  DASy

BO_ 2281601536 Dev_Video_SyncVisor_TX: 8 VideoFrontCenter
 SG_ ImgFrameCounter : 7|32@0+ (1,0) [0|4294967295] ""  ReceiveECU
 SG_ ImgReceptionTimer : 39|32@0+ (1,0) [0|4294967295] ""  ReceiveECU

CM_ SG_ 335 RFC_Loc213_215_CRC "CRC - Autosar E2E Profile 5";
CM_ SG_ 335 RFC_Loc213_215_AliveCtr "Alive counter - Autosar E2E Profile 5";
CM_ SG_ 335 RFC_Loc213_215_ProtBlockCtr "Protocol-Signal: Block-Counter";
CM_ SG_ 335 RFC_Loc213_RadialDistance "Location radial distance. Represented in conical coordinate system. Same as ISO 23150:2021(E): Position radial distance (A.4.16)";
CM_ SG_ 335 RFC_Loc213_RadialVelocity "Location radial relative velocity ISO 23150:2021(E): Relative velocity {radial distance} (A.4.18)";
CM_ SG_ 335 RFC_Loc213_Elevation "Location elevation angle. Represented in conical coordinate system. Same as ISO 23150:2021(E): Position elevation (A.4.16)";
CM_ SG_ 335 RFC_Loc213_Azimuth "Location azimuth angle. Represented in conical coordinate system. Deviation from ISO 23150:2021(E): Position azimuth (A.4.16). Further details refers to DSP Location Interface definition";
CM_ SG_ 335 RFC_Loc213_DistVelocityCoVnce "Covariance of radial distance and radial velocity";
CM_ SG_ 335 RFC_Loc213_RadialDistanceVnce "Variance of Location radial distance ISO 23150:2021(E): Position radial distance - error (A.4.17)";
CM_ SG_ 335 RFC_Loc213_RadialVelocityVnce "Variance of Location radial relative velocity ISO 23150:2021(E): Relative velocity {radial distance} - error (A.4.19)";
CM_ SG_ 335 RFC_Loc213_ElevationVnce "Variance of Location elevation angle ISO 23150:2021(E): Position elevation - error (A.4.17)";
CM_ SG_ 335 RFC_Loc213_AzimuthVnce "Variance of Location azimuth angle ISO 23150:2021(E): Position azimuth - error (A.4.17)";
CM_ SG_ 335 RFC_Loc213_RadarCrossSection "Radar Cross Section (RCS) estimation ISO 23150:2021(E): Radar cross section (A.4.5)";
CM_ SG_ 335 RFC_Loc213_DistVelocityQuality "Quality of radial distance and velocity resolution processing. Physical range [0..1]";
CM_ SG_ 335 RFC_Loc213_ElevationQuality "Probability for correct signal model (elevation angle). Physical range [0..1]";
CM_ SG_ 335 RFC_Loc213_AzimuthQuality "Probability for correct signal model (azimuth angle). Physical range [0..1]";
CM_ SG_ 335 RFC_Loc213_RSSI "Received Signal Strength Indication (RSSI). This signal is not exactly ISO 23150:2021(E): Signal to noise ratio - detection level (A.4.7), but SNR can be calculated from this signal. Further detail please refer to the DSP Location Interface definition";
CM_ SG_ 335 RFC_Loc213_AzimuthalPartnerId "Id of the azimuthal partner location";
CM_ SG_ 335 RFC_Loc214_RadialDistance "Location radial distance. Represented in conical coordinate system. Same as ISO 23150:2021(E): Position radial distance (A.4.16)";
CM_ SG_ 335 RFC_Loc214_RadialVelocity "Location radial relative velocity ISO 23150:2021(E): Relative velocity {radial distance} (A.4.18)";
CM_ SG_ 335 RFC_Loc214_Elevation "Location elevation angle. Represented in conical coordinate system. Same as ISO 23150:2021(E): Position elevation (A.4.16)";
CM_ SG_ 335 RFC_Loc214_Azimuth "Location azimuth angle. Represented in conical coordinate system. Deviation from ISO 23150:2021(E): Position azimuth (A.4.16). Further details refers to DSP Location Interface definition";
CM_ SG_ 335 RFC_Loc214_DistVelocityCoVnce "Covariance of radial distance and radial velocity";
CM_ SG_ 335 RFC_Loc214_RadialDistanceVnce "Variance of Location radial distance ISO 23150:2021(E): Position radial distance - error (A.4.17)";
CM_ SG_ 335 RFC_Loc214_RadialVelocityVnce "Variance of Location radial relative velocity ISO 23150:2021(E): Relative velocity {radial distance} - error (A.4.19)";
CM_ SG_ 335 RFC_Loc214_ElevationVnce "Variance of Location elevation angle ISO 23150:2021(E): Position elevation - error (A.4.17)";
CM_ SG_ 335 RFC_Loc214_AzimuthVnce "Variance of Location azimuth angle ISO 23150:2021(E): Position azimuth - error (A.4.17)";
CM_ SG_ 335 RFC_Loc214_RadarCrossSection "Radar Cross Section (RCS) estimation ISO 23150:2021(E): Radar cross section (A.4.5)";
CM_ SG_ 335 RFC_Loc214_DistVelocityQuality "Quality of radial distance and velocity resolution processing. Physical range [0..1]";
CM_ SG_ 335 RFC_Loc214_ElevationQuality "Probability for correct signal model (elevation angle). Physical range [0..1]";
CM_ SG_ 335 RFC_Loc214_AzimuthQuality "Probability for correct signal model (azimuth angle). Physical range [0..1]";
CM_ SG_ 335 RFC_Loc214_RSSI "Received Signal Strength Indication (RSSI). This signal is not exactly ISO 23150:2021(E): Signal to noise ratio - detection level (A.4.7), but SNR can be calculated from this signal. Further detail please refer to the DSP Location Interface definition";
CM_ SG_ 335 RFC_Loc214_AzimuthalPartnerId "Id of the azimuthal partner location";
CM_ SG_ 335 RFC_Loc215_RadialDistance "Location radial distance. Represented in conical coordinate system. Same as ISO 23150:2021(E): Position radial distance (A.4.16)";
CM_ SG_ 335 RFC_Loc215_RadialVelocity "Location radial relative velocity ISO 23150:2021(E): Relative velocity {radial distance} (A.4.18)";
CM_ SG_ 335 RFC_Loc215_Elevation "Location elevation angle. Represented in conical coordinate system. Same as ISO 23150:2021(E): Position elevation (A.4.16)";
CM_ SG_ 335 RFC_Loc215_Azimuth "Location azimuth angle. Represented in conical coordinate system. Deviation from ISO 23150:2021(E): Position azimuth (A.4.16). Further details refers to DSP Location Interface definition";
CM_ SG_ 335 RFC_Loc215_DistVelocityCoVnce "Covariance of radial distance and radial velocity";
CM_ SG_ 335 RFC_Loc215_RadialDistanceVnce "Variance of Location radial distance ISO 23150:2021(E): Position radial distance - error (A.4.17)";
CM_ SG_ 335 RFC_Loc215_RadialVelocityVnce "Variance of Location radial relative velocity ISO 23150:2021(E): Relative velocity {radial distance} - error (A.4.19)";
CM_ SG_ 335 RFC_Loc215_ElevationVnce "Variance of Location elevation angle ISO 23150:2021(E): Position elevation - error (A.4.17)";
CM_ SG_ 335 RFC_Loc215_AzimuthVnce "Variance of Location azimuth angle ISO 23150:2021(E): Position azimuth - error (A.4.17)";
CM_ SG_ 335 RFC_Loc215_RadarCrossSection "Radar Cross Section (RCS) estimation ISO 23150:2021(E): Radar cross section (A.4.5)";
CM_ SG_ 335 RFC_Loc215_DistVelocityQuality "Quality of radial distance and velocity resolution processing. Physical range [0..1]";
CM_ SG_ 335 RFC_Loc215_ElevationQuality "Probability for correct signal model (elevation angle). Physical range [0..1]";
CM_ SG_ 335 RFC_Loc215_AzimuthQuality "Probability for correct signal model (azimuth angle). Physical range [0..1]";
CM_ SG_ 335 RFC_Loc215_RSSI "Received Signal Strength Indication (RSSI). This signal is not exactly ISO 23150:2021(E): Signal to noise ratio - detection level (A.4.7), but SNR can be calculated from this signal. Further detail please refer to the DSP Location Interface definition";
CM_ SG_ 335 RFC_Loc215_AzimuthalPartnerId "Id of the azimuthal partner location";
CM_ SG_ 336 RFC_Loc216_218_CRC "CRC - Autosar E2E Profile 5";
CM_ SG_ 336 RFC_Loc216_218_AliveCtr "Alive counter - Autosar E2E Profile 5";
CM_ SG_ 336 RFC_Loc216_218_ProtBlockCtr "Protocol-Signal: Block-Counter";
CM_ SG_ 336 RFC_Loc216_RadialDistance "Location radial distance. Represented in conical coordinate system. Same as ISO 23150:2021(E): Position radial distance (A.4.16)";
CM_ SG_ 336 RFC_Loc216_RadialVelocity "Location radial relative velocity ISO 23150:2021(E): Relative velocity {radial distance} (A.4.18)";
CM_ SG_ 336 RFC_Loc216_Elevation "Location elevation angle. Represented in conical coordinate system. Same as ISO 23150:2021(E): Position elevation (A.4.16)";
CM_ SG_ 336 RFC_Loc216_Azimuth "Location azimuth angle. Represented in conical coordinate system. Deviation from ISO 23150:2021(E): Position azimuth (A.4.16). Further details refers to DSP Location Interface definition";
CM_ SG_ 336 RFC_Loc216_DistVelocityCoVnce "Covariance of radial distance and radial velocity";
CM_ SG_ 336 RFC_Loc216_RadialDistanceVnce "Variance of Location radial distance ISO 23150:2021(E): Position radial distance - error (A.4.17)";
CM_ SG_ 336 RFC_Loc216_RadialVelocityVnce "Variance of Location radial relative velocity ISO 23150:2021(E): Relative velocity {radial distance} - error (A.4.19)";
CM_ SG_ 336 RFC_Loc216_ElevationVnce "Variance of Location elevation angle ISO 23150:2021(E): Position elevation - error (A.4.17)";
CM_ SG_ 336 RFC_Loc216_AzimuthVnce "Variance of Location azimuth angle ISO 23150:2021(E): Position azimuth - error (A.4.17)";
CM_ SG_ 336 RFC_Loc216_RadarCrossSection "Radar Cross Section (RCS) estimation ISO 23150:2021(E): Radar cross section (A.4.5)";
CM_ SG_ 336 RFC_Loc216_DistVelocityQuality "Quality of radial distance and velocity resolution processing. Physical range [0..1]";
CM_ SG_ 336 RFC_Loc216_ElevationQuality "Probability for correct signal model (elevation angle). Physical range [0..1]";
CM_ SG_ 336 RFC_Loc216_AzimuthQuality "Probability for correct signal model (azimuth angle). Physical range [0..1]";
CM_ SG_ 336 RFC_Loc216_RSSI "Received Signal Strength Indication (RSSI). This signal is not exactly ISO 23150:2021(E): Signal to noise ratio - detection level (A.4.7), but SNR can be calculated from this signal. Further detail please refer to the DSP Location Interface definition";
CM_ SG_ 336 RFC_Loc216_AzimuthalPartnerId "Id of the azimuthal partner location";
CM_ SG_ 336 RFC_Loc217_RadialDistance "Location radial distance. Represented in conical coordinate system. Same as ISO 23150:2021(E): Position radial distance (A.4.16)";
CM_ SG_ 336 RFC_Loc217_RadialVelocity "Location radial relative velocity ISO 23150:2021(E): Relative velocity {radial distance} (A.4.18)";
CM_ SG_ 336 RFC_Loc217_Elevation "Location elevation angle. Represented in conical coordinate system. Same as ISO 23150:2021(E): Position elevation (A.4.16)";
CM_ SG_ 336 RFC_Loc217_Azimuth "Location azimuth angle. Represented in conical coordinate system. Deviation from ISO 23150:2021(E): Position azimuth (A.4.16). Further details refers to DSP Location Interface definition";
CM_ SG_ 336 RFC_Loc217_DistVelocityCoVnce "Covariance of radial distance and radial velocity";
CM_ SG_ 336 RFC_Loc217_RadialDistanceVnce "Variance of Location radial distance ISO 23150:2021(E): Position radial distance - error (A.4.17)";
CM_ SG_ 336 RFC_Loc217_RadialVelocityVnce "Variance of Location radial relative velocity ISO 23150:2021(E): Relative velocity {radial distance} - error (A.4.19)";
CM_ SG_ 336 RFC_Loc217_ElevationVnce "Variance of Location elevation angle ISO 23150:2021(E): Position elevation - error (A.4.17)";
CM_ SG_ 336 RFC_Loc217_AzimuthVnce "Variance of Location azimuth angle ISO 23150:2021(E): Position azimuth - error (A.4.17)";
CM_ SG_ 336 RFC_Loc217_RadarCrossSection "Radar Cross Section (RCS) estimation ISO 23150:2021(E): Radar cross section (A.4.5)";
CM_ SG_ 336 RFC_Loc217_DistVelocityQuality "Quality of radial distance and velocity resolution processing. Physical range [0..1]";
CM_ SG_ 336 RFC_Loc217_ElevationQuality "Probability for correct signal model (elevation angle). Physical range [0..1]";
CM_ SG_ 336 RFC_Loc217_AzimuthQuality "Probability for correct signal model (azimuth angle). Physical range [0..1]";
CM_ SG_ 336 RFC_Loc217_RSSI "Received Signal Strength Indication (RSSI). This signal is not exactly ISO 23150:2021(E): Signal to noise ratio - detection level (A.4.7), but SNR can be calculated from this signal. Further detail please refer to the DSP Location Interface definition";
CM_ SG_ 336 RFC_Loc217_AzimuthalPartnerId "Id of the azimuthal partner location";
CM_ SG_ 336 RFC_Loc218_RadialDistance "Location radial distance. Represented in conical coordinate system. Same as ISO 23150:2021(E): Position radial distance (A.4.16)";
CM_ SG_ 336 RFC_Loc218_RadialVelocity "Location radial relative velocity ISO 23150:2021(E): Relative velocity {radial distance} (A.4.18)";
CM_ SG_ 336 RFC_Loc218_Elevation "Location elevation angle. Represented in conical coordinate system. Same as ISO 23150:2021(E): Position elevation (A.4.16)";
CM_ SG_ 336 RFC_Loc218_Azimuth "Location azimuth angle. Represented in conical coordinate system. Deviation from ISO 23150:2021(E): Position azimuth (A.4.16). Further details refers to DSP Location Interface definition";
CM_ SG_ 336 RFC_Loc218_DistVelocityCoVnce "Covariance of radial distance and radial velocity";
CM_ SG_ 336 RFC_Loc218_RadialDistanceVnce "Variance of Location radial distance ISO 23150:2021(E): Position radial distance - error (A.4.17)";
CM_ SG_ 336 RFC_Loc218_RadialVelocityVnce "Variance of Location radial relative velocity ISO 23150:2021(E): Relative velocity {radial distance} - error (A.4.19)";
CM_ SG_ 336 RFC_Loc218_ElevationVnce "Variance of Location elevation angle ISO 23150:2021(E): Position elevation - error (A.4.17)";
CM_ SG_ 336 RFC_Loc218_AzimuthVnce "Variance of Location azimuth angle ISO 23150:2021(E): Position azimuth - error (A.4.17)";
CM_ SG_ 336 RFC_Loc218_RadarCrossSection "Radar Cross Section (RCS) estimation ISO 23150:2021(E): Radar cross section (A.4.5)";
CM_ SG_ 336 RFC_Loc218_DistVelocityQuality "Quality of radial distance and velocity resolution processing. Physical range [0..1]";
CM_ SG_ 336 RFC_Loc218_ElevationQuality "Probability for correct signal model (elevation angle). Physical range [0..1]";
CM_ SG_ 336 RFC_Loc218_AzimuthQuality "Probability for correct signal model (azimuth angle). Physical range [0..1]";
CM_ SG_ 336 RFC_Loc218_RSSI "Received Signal Strength Indication (RSSI). This signal is not exactly ISO 23150:2021(E): Signal to noise ratio - detection level (A.4.7), but SNR can be calculated from this signal. Further detail please refer to the DSP Location Interface definition";
CM_ SG_ 336 RFC_Loc218_AzimuthalPartnerId "Id of the azimuthal partner location";
CM_ SG_ 337 RFC_Loc219_221_CRC "CRC - Autosar E2E Profile 5";
CM_ SG_ 337 RFC_Loc219_221_AliveCtr "Alive counter - Autosar E2E Profile 5";
CM_ SG_ 337 RFC_Loc219_221_ProtBlockCtr "Protocol-Signal: Block-Counter";
CM_ SG_ 337 RFC_Loc219_RadialDistance "Location radial distance. Represented in conical coordinate system. Same as ISO 23150:2021(E): Position radial distance (A.4.16)";
CM_ SG_ 337 RFC_Loc219_RadialVelocity "Location radial relative velocity ISO 23150:2021(E): Relative velocity {radial distance} (A.4.18)";
CM_ SG_ 337 RFC_Loc219_Elevation "Location elevation angle. Represented in conical coordinate system. Same as ISO 23150:2021(E): Position elevation (A.4.16)";
CM_ SG_ 337 RFC_Loc219_Azimuth "Location azimuth angle. Represented in conical coordinate system. Deviation from ISO 23150:2021(E): Position azimuth (A.4.16). Further details refers to DSP Location Interface definition";
CM_ SG_ 337 RFC_Loc219_DistVelocityCoVnce "Covariance of radial distance and radial velocity";
CM_ SG_ 337 RFC_Loc219_RadialDistanceVnce "Variance of Location radial distance ISO 23150:2021(E): Position radial distance - error (A.4.17)";
CM_ SG_ 337 RFC_Loc219_RadialVelocityVnce "Variance of Location radial relative velocity ISO 23150:2021(E): Relative velocity {radial distance} - error (A.4.19)";
CM_ SG_ 337 RFC_Loc219_ElevationVnce "Variance of Location elevation angle ISO 23150:2021(E): Position elevation - error (A.4.17)";
CM_ SG_ 337 RFC_Loc219_AzimuthVnce "Variance of Location azimuth angle ISO 23150:2021(E): Position azimuth - error (A.4.17)";
CM_ SG_ 337 RFC_Loc219_RadarCrossSection "Radar Cross Section (RCS) estimation ISO 23150:2021(E): Radar cross section (A.4.5)";
CM_ SG_ 337 RFC_Loc219_DistVelocityQuality "Quality of radial distance and velocity resolution processing. Physical range [0..1]";
CM_ SG_ 337 RFC_Loc219_ElevationQuality "Probability for correct signal model (elevation angle). Physical range [0..1]";
CM_ SG_ 337 RFC_Loc219_AzimuthQuality "Probability for correct signal model (azimuth angle). Physical range [0..1]";
CM_ SG_ 337 RFC_Loc219_RSSI "Received Signal Strength Indication (RSSI). This signal is not exactly ISO 23150:2021(E): Signal to noise ratio - detection level (A.4.7), but SNR can be calculated from this signal. Further detail please refer to the DSP Location Interface definition";
CM_ SG_ 337 RFC_Loc219_AzimuthalPartnerId "Id of the azimuthal partner location";
CM_ SG_ 337 RFC_Loc220_RadialDistance "Location radial distance. Represented in conical coordinate system. Same as ISO 23150:2021(E): Position radial distance (A.4.16)";
CM_ SG_ 337 RFC_Loc220_RadialVelocity "Location radial relative velocity ISO 23150:2021(E): Relative velocity {radial distance} (A.4.18)";
CM_ SG_ 337 RFC_Loc220_Elevation "Location elevation angle. Represented in conical coordinate system. Same as ISO 23150:2021(E): Position elevation (A.4.16)";
CM_ SG_ 337 RFC_Loc220_Azimuth "Location azimuth angle. Represented in conical coordinate system. Deviation from ISO 23150:2021(E): Position azimuth (A.4.16). Further details refers to DSP Location Interface definition";
CM_ SG_ 337 RFC_Loc220_DistVelocityCoVnce "Covariance of radial distance and radial velocity";
CM_ SG_ 337 RFC_Loc220_RadialDistanceVnce "Variance of Location radial distance ISO 23150:2021(E): Position radial distance - error (A.4.17)";
CM_ SG_ 337 RFC_Loc220_RadialVelocityVnce "Variance of Location radial relative velocity ISO 23150:2021(E): Relative velocity {radial distance} - error (A.4.19)";
CM_ SG_ 337 RFC_Loc220_ElevationVnce "Variance of Location elevation angle ISO 23150:2021(E): Position elevation - error (A.4.17)";
CM_ SG_ 337 RFC_Loc220_AzimuthVnce "Variance of Location azimuth angle ISO 23150:2021(E): Position azimuth - error (A.4.17)";
CM_ SG_ 337 RFC_Loc220_RadarCrossSection "Radar Cross Section (RCS) estimation ISO 23150:2021(E): Radar cross section (A.4.5)";
CM_ SG_ 337 RFC_Loc220_DistVelocityQuality "Quality of radial distance and velocity resolution processing. Physical range [0..1]";
CM_ SG_ 337 RFC_Loc220_ElevationQuality "Probability for correct signal model (elevation angle). Physical range [0..1]";
CM_ SG_ 337 RFC_Loc220_AzimuthQuality "Probability for correct signal model (azimuth angle). Physical range [0..1]";
CM_ SG_ 337 RFC_Loc220_RSSI "Received Signal Strength Indication (RSSI). This signal is not exactly ISO 23150:2021(E): Signal to noise ratio - detection level (A.4.7), but SNR can be calculated from this signal. Further detail please refer to the DSP Location Interface definition";
CM_ SG_ 337 RFC_Loc220_AzimuthalPartnerId "Id of the azimuthal partner location";
CM_ SG_ 337 RFC_Loc221_RadialDistance "Location radial distance. Represented in conical coordinate system. Same as ISO 23150:2021(E): Position radial distance (A.4.16)";
CM_ SG_ 337 RFC_Loc221_RadialVelocity "Location radial relative velocity ISO 23150:2021(E): Relative velocity {radial distance} (A.4.18)";
CM_ SG_ 337 RFC_Loc221_Elevation "Location elevation angle. Represented in conical coordinate system. Same as ISO 23150:2021(E): Position elevation (A.4.16)";
CM_ SG_ 337 RFC_Loc221_Azimuth "Location azimuth angle. Represented in conical coordinate system. Deviation from ISO 23150:2021(E): Position azimuth (A.4.16). Further details refers to DSP Location Interface definition";
CM_ SG_ 337 RFC_Loc221_DistVelocityCoVnce "Covariance of radial distance and radial velocity";
CM_ SG_ 337 RFC_Loc221_RadialDistanceVnce "Variance of Location radial distance ISO 23150:2021(E): Position radial distance - error (A.4.17)";
CM_ SG_ 337 RFC_Loc221_RadialVelocityVnce "Variance of Location radial relative velocity ISO 23150:2021(E): Relative velocity {radial distance} - error (A.4.19)";
CM_ SG_ 337 RFC_Loc221_ElevationVnce "Variance of Location elevation angle ISO 23150:2021(E): Position elevation - error (A.4.17)";
CM_ SG_ 337 RFC_Loc221_AzimuthVnce "Variance of Location azimuth angle ISO 23150:2021(E): Position azimuth - error (A.4.17)";
CM_ SG_ 337 RFC_Loc221_RadarCrossSection "Radar Cross Section (RCS) estimation ISO 23150:2021(E): Radar cross section (A.4.5)";
CM_ SG_ 337 RFC_Loc221_DistVelocityQuality "Quality of radial distance and velocity resolution processing. Physical range [0..1]";
CM_ SG_ 337 RFC_Loc221_ElevationQuality "Probability for correct signal model (elevation angle). Physical range [0..1]";
CM_ SG_ 337 RFC_Loc221_AzimuthQuality "Probability for correct signal model (azimuth angle). Physical range [0..1]";
CM_ SG_ 337 RFC_Loc221_RSSI "Received Signal Strength Indication (RSSI). This signal is not exactly ISO 23150:2021(E): Signal to noise ratio - detection level (A.4.7), but SNR can be calculated from this signal. Further detail please refer to the DSP Location Interface definition";
CM_ SG_ 337 RFC_Loc221_AzimuthalPartnerId "Id of the azimuthal partner location";
CM_ SG_ 338 RFC_Loc222_224_CRC "CRC - Autosar E2E Profile 5";
CM_ SG_ 338 RFC_Loc222_224_AliveCtr "Alive counter - Autosar E2E Profile 5";
CM_ SG_ 338 RFC_Loc222_224_ProtBlockCtr "Protocol-Signal: Block-Counter";
CM_ SG_ 338 RFC_Loc222_RadialDistance "Location radial distance. Represented in conical coordinate system. Same as ISO 23150:2021(E): Position radial distance (A.4.16)";
CM_ SG_ 338 RFC_Loc222_RadialVelocity "Location radial relative velocity ISO 23150:2021(E): Relative velocity {radial distance} (A.4.18)";
CM_ SG_ 338 RFC_Loc222_Elevation "Location elevation angle. Represented in conical coordinate system. Same as ISO 23150:2021(E): Position elevation (A.4.16)";
CM_ SG_ 338 RFC_Loc222_Azimuth "Location azimuth angle. Represented in conical coordinate system. Deviation from ISO 23150:2021(E): Position azimuth (A.4.16). Further details refers to DSP Location Interface definition";
CM_ SG_ 338 RFC_Loc222_DistVelocityCoVnce "Covariance of radial distance and radial velocity";
CM_ SG_ 338 RFC_Loc222_RadialDistanceVnce "Variance of Location radial distance ISO 23150:2021(E): Position radial distance - error (A.4.17)";
CM_ SG_ 338 RFC_Loc222_RadialVelocityVnce "Variance of Location radial relative velocity ISO 23150:2021(E): Relative velocity {radial distance} - error (A.4.19)";
CM_ SG_ 338 RFC_Loc222_ElevationVnce "Variance of Location elevation angle ISO 23150:2021(E): Position elevation - error (A.4.17)";
CM_ SG_ 338 RFC_Loc222_AzimuthVnce "Variance of Location azimuth angle ISO 23150:2021(E): Position azimuth - error (A.4.17)";
CM_ SG_ 338 RFC_Loc222_RadarCrossSection "Radar Cross Section (RCS) estimation ISO 23150:2021(E): Radar cross section (A.4.5)";
CM_ SG_ 338 RFC_Loc222_DistVelocityQuality "Quality of radial distance and velocity resolution processing. Physical range [0..1]";
CM_ SG_ 338 RFC_Loc222_ElevationQuality "Probability for correct signal model (elevation angle). Physical range [0..1]";
CM_ SG_ 338 RFC_Loc222_AzimuthQuality "Probability for correct signal model (azimuth angle). Physical range [0..1]";
CM_ SG_ 338 RFC_Loc222_RSSI "Received Signal Strength Indication (RSSI). This signal is not exactly ISO 23150:2021(E): Signal to noise ratio - detection level (A.4.7), but SNR can be calculated from this signal. Further detail please refer to the DSP Location Interface definition";
CM_ SG_ 338 RFC_Loc222_AzimuthalPartnerId "Id of the azimuthal partner location";
CM_ SG_ 338 RFC_Loc223_RadialDistance "Location radial distance. Represented in conical coordinate system. Same as ISO 23150:2021(E): Position radial distance (A.4.16)";
CM_ SG_ 338 RFC_Loc223_RadialVelocity "Location radial relative velocity ISO 23150:2021(E): Relative velocity {radial distance} (A.4.18)";
CM_ SG_ 338 RFC_Loc223_Elevation "Location elevation angle. Represented in conical coordinate system. Same as ISO 23150:2021(E): Position elevation (A.4.16)";
CM_ SG_ 338 RFC_Loc223_Azimuth "Location azimuth angle. Represented in conical coordinate system. Deviation from ISO 23150:2021(E): Position azimuth (A.4.16). Further details refers to DSP Location Interface definition";
CM_ SG_ 338 RFC_Loc223_DistVelocityCoVnce "Covariance of radial distance and radial velocity";
CM_ SG_ 338 RFC_Loc223_RadialDistanceVnce "Variance of Location radial distance ISO 23150:2021(E): Position radial distance - error (A.4.17)";
CM_ SG_ 338 RFC_Loc223_RadialVelocityVnce "Variance of Location radial relative velocity ISO 23150:2021(E): Relative velocity {radial distance} - error (A.4.19)";
CM_ SG_ 338 RFC_Loc223_ElevationVnce "Variance of Location elevation angle ISO 23150:2021(E): Position elevation - error (A.4.17)";
CM_ SG_ 338 RFC_Loc223_AzimuthVnce "Variance of Location azimuth angle ISO 23150:2021(E): Position azimuth - error (A.4.17)";
CM_ SG_ 338 RFC_Loc223_RadarCrossSection "Radar Cross Section (RCS) estimation ISO 23150:2021(E): Radar cross section (A.4.5)";
CM_ SG_ 338 RFC_Loc223_DistVelocityQuality "Quality of radial distance and velocity resolution processing. Physical range [0..1]";
CM_ SG_ 338 RFC_Loc223_ElevationQuality "Probability for correct signal model (elevation angle). Physical range [0..1]";
CM_ SG_ 338 RFC_Loc223_AzimuthQuality "Probability for correct signal model (azimuth angle). Physical range [0..1]";
CM_ SG_ 338 RFC_Loc223_RSSI "Received Signal Strength Indication (RSSI). This signal is not exactly ISO 23150:2021(E): Signal to noise ratio - detection level (A.4.7), but SNR can be calculated from this signal. Further detail please refer to the DSP Location Interface definition";
CM_ SG_ 338 RFC_Loc223_AzimuthalPartnerId "Id of the azimuthal partner location";
CM_ SG_ 338 RFC_Loc224_RadialDistance "Location radial distance. Represented in conical coordinate system. Same as ISO 23150:2021(E): Position radial distance (A.4.16)";
CM_ SG_ 338 RFC_Loc224_RadialVelocity "Location radial relative velocity ISO 23150:2021(E): Relative velocity {radial distance} (A.4.18)";
CM_ SG_ 338 RFC_Loc224_Elevation "Location elevation angle. Represented in conical coordinate system. Same as ISO 23150:2021(E): Position elevation (A.4.16)";
CM_ SG_ 338 RFC_Loc224_Azimuth "Location azimuth angle. Represented in conical coordinate system. Deviation from ISO 23150:2021(E): Position azimuth (A.4.16). Further details refers to DSP Location Interface definition";
CM_ SG_ 338 RFC_Loc224_DistVelocityCoVnce "Covariance of radial distance and radial velocity";
CM_ SG_ 338 RFC_Loc224_RadialDistanceVnce "Variance of Location radial distance ISO 23150:2021(E): Position radial distance - error (A.4.17)";
CM_ SG_ 338 RFC_Loc224_RadialVelocityVnce "Variance of Location radial relative velocity ISO 23150:2021(E): Relative velocity {radial distance} - error (A.4.19)";
CM_ SG_ 338 RFC_Loc224_ElevationVnce "Variance of Location elevation angle ISO 23150:2021(E): Position elevation - error (A.4.17)";
CM_ SG_ 338 RFC_Loc224_AzimuthVnce "Variance of Location azimuth angle ISO 23150:2021(E): Position azimuth - error (A.4.17)";
CM_ SG_ 338 RFC_Loc224_RadarCrossSection "Radar Cross Section (RCS) estimation ISO 23150:2021(E): Radar cross section (A.4.5)";
CM_ SG_ 338 RFC_Loc224_DistVelocityQuality "Quality of radial distance and velocity resolution processing. Physical range [0..1]";
CM_ SG_ 338 RFC_Loc224_ElevationQuality "Probability for correct signal model (elevation angle). Physical range [0..1]";
CM_ SG_ 338 RFC_Loc224_AzimuthQuality "Probability for correct signal model (azimuth angle). Physical range [0..1]";
CM_ SG_ 338 RFC_Loc224_RSSI "Received Signal Strength Indication (RSSI). This signal is not exactly ISO 23150:2021(E): Signal to noise ratio - detection level (A.4.7), but SNR can be calculated from this signal. Further detail please refer to the DSP Location Interface definition";
CM_ SG_ 338 RFC_Loc224_AzimuthalPartnerId "Id of the azimuthal partner location";
CM_ SG_ 339 RFC_Loc225_227_CRC "CRC - Autosar E2E Profile 5";
CM_ SG_ 339 RFC_Loc225_227_AliveCtr "Alive counter - Autosar E2E Profile 5";
CM_ SG_ 339 RFC_Loc225_227_ProtBlockCtr "Protocol-Signal: Block-Counter";
CM_ SG_ 339 RFC_Loc225_RadialDistance "Location radial distance. Represented in conical coordinate system. Same as ISO 23150:2021(E): Position radial distance (A.4.16)";
CM_ SG_ 339 RFC_Loc225_RadialVelocity "Location radial relative velocity ISO 23150:2021(E): Relative velocity {radial distance} (A.4.18)";
CM_ SG_ 339 RFC_Loc225_Elevation "Location elevation angle. Represented in conical coordinate system. Same as ISO 23150:2021(E): Position elevation (A.4.16)";
CM_ SG_ 339 RFC_Loc225_Azimuth "Location azimuth angle. Represented in conical coordinate system. Deviation from ISO 23150:2021(E): Position azimuth (A.4.16). Further details refers to DSP Location Interface definition";
CM_ SG_ 339 RFC_Loc225_DistVelocityCoVnce "Covariance of radial distance and radial velocity";
CM_ SG_ 339 RFC_Loc225_RadialDistanceVnce "Variance of Location radial distance ISO 23150:2021(E): Position radial distance - error (A.4.17)";
CM_ SG_ 339 RFC_Loc225_RadialVelocityVnce "Variance of Location radial relative velocity ISO 23150:2021(E): Relative velocity {radial distance} - error (A.4.19)";
CM_ SG_ 339 RFC_Loc225_ElevationVnce "Variance of Location elevation angle ISO 23150:2021(E): Position elevation - error (A.4.17)";
CM_ SG_ 339 RFC_Loc225_AzimuthVnce "Variance of Location azimuth angle ISO 23150:2021(E): Position azimuth - error (A.4.17)";
CM_ SG_ 339 RFC_Loc225_RadarCrossSection "Radar Cross Section (RCS) estimation ISO 23150:2021(E): Radar cross section (A.4.5)";
CM_ SG_ 339 RFC_Loc225_DistVelocityQuality "Quality of radial distance and velocity resolution processing. Physical range [0..1]";
CM_ SG_ 339 RFC_Loc225_ElevationQuality "Probability for correct signal model (elevation angle). Physical range [0..1]";
CM_ SG_ 339 RFC_Loc225_AzimuthQuality "Probability for correct signal model (azimuth angle). Physical range [0..1]";
CM_ SG_ 339 RFC_Loc225_RSSI "Received Signal Strength Indication (RSSI). This signal is not exactly ISO 23150:2021(E): Signal to noise ratio - detection level (A.4.7), but SNR can be calculated from this signal. Further detail please refer to the DSP Location Interface definition";
CM_ SG_ 339 RFC_Loc225_AzimuthalPartnerId "Id of the azimuthal partner location";
CM_ SG_ 339 RFC_Loc226_RadialDistance "Location radial distance. Represented in conical coordinate system. Same as ISO 23150:2021(E): Position radial distance (A.4.16)";
CM_ SG_ 339 RFC_Loc226_RadialVelocity "Location radial relative velocity ISO 23150:2021(E): Relative velocity {radial distance} (A.4.18)";
CM_ SG_ 339 RFC_Loc226_Elevation "Location elevation angle. Represented in conical coordinate system. Same as ISO 23150:2021(E): Position elevation (A.4.16)";
CM_ SG_ 339 RFC_Loc226_Azimuth "Location azimuth angle. Represented in conical coordinate system. Deviation from ISO 23150:2021(E): Position azimuth (A.4.16). Further details refers to DSP Location Interface definition";
CM_ SG_ 339 RFC_Loc226_DistVelocityCoVnce "Covariance of radial distance and radial velocity";
CM_ SG_ 339 RFC_Loc226_RadialDistanceVnce "Variance of Location radial distance ISO 23150:2021(E): Position radial distance - error (A.4.17)";
CM_ SG_ 339 RFC_Loc226_RadialVelocityVnce "Variance of Location radial relative velocity ISO 23150:2021(E): Relative velocity {radial distance} - error (A.4.19)";
CM_ SG_ 339 RFC_Loc226_ElevationVnce "Variance of Location elevation angle ISO 23150:2021(E): Position elevation - error (A.4.17)";
CM_ SG_ 339 RFC_Loc226_AzimuthVnce "Variance of Location azimuth angle ISO 23150:2021(E): Position azimuth - error (A.4.17)";
CM_ SG_ 339 RFC_Loc226_RadarCrossSection "Radar Cross Section (RCS) estimation ISO 23150:2021(E): Radar cross section (A.4.5)";
CM_ SG_ 339 RFC_Loc226_DistVelocityQuality "Quality of radial distance and velocity resolution processing. Physical range [0..1]";
CM_ SG_ 339 RFC_Loc226_ElevationQuality "Probability for correct signal model (elevation angle). Physical range [0..1]";
CM_ SG_ 339 RFC_Loc226_AzimuthQuality "Probability for correct signal model (azimuth angle). Physical range [0..1]";
CM_ SG_ 339 RFC_Loc226_RSSI "Received Signal Strength Indication (RSSI). This signal is not exactly ISO 23150:2021(E): Signal to noise ratio - detection level (A.4.7), but SNR can be calculated from this signal. Further detail please refer to the DSP Location Interface definition";
CM_ SG_ 339 RFC_Loc226_AzimuthalPartnerId "Id of the azimuthal partner location";
CM_ SG_ 339 RFC_Loc227_RadialDistance "Location radial distance. Represented in conical coordinate system. Same as ISO 23150:2021(E): Position radial distance (A.4.16)";
CM_ SG_ 339 RFC_Loc227_RadialVelocity "Location radial relative velocity ISO 23150:2021(E): Relative velocity {radial distance} (A.4.18)";
CM_ SG_ 339 RFC_Loc227_Elevation "Location elevation angle. Represented in conical coordinate system. Same as ISO 23150:2021(E): Position elevation (A.4.16)";
CM_ SG_ 339 RFC_Loc227_Azimuth "Location azimuth angle. Represented in conical coordinate system. Deviation from ISO 23150:2021(E): Position azimuth (A.4.16). Further details refers to DSP Location Interface definition";
CM_ SG_ 339 RFC_Loc227_DistVelocityCoVnce "Covariance of radial distance and radial velocity";
CM_ SG_ 339 RFC_Loc227_RadialDistanceVnce "Variance of Location radial distance ISO 23150:2021(E): Position radial distance - error (A.4.17)";
CM_ SG_ 339 RFC_Loc227_RadialVelocityVnce "Variance of Location radial relative velocity ISO 23150:2021(E): Relative velocity {radial distance} - error (A.4.19)";
CM_ SG_ 339 RFC_Loc227_ElevationVnce "Variance of Location elevation angle ISO 23150:2021(E): Position elevation - error (A.4.17)";
CM_ SG_ 339 RFC_Loc227_AzimuthVnce "Variance of Location azimuth angle ISO 23150:2021(E): Position azimuth - error (A.4.17)";
CM_ SG_ 339 RFC_Loc227_RadarCrossSection "Radar Cross Section (RCS) estimation ISO 23150:2021(E): Radar cross section (A.4.5)";
CM_ SG_ 339 RFC_Loc227_DistVelocityQuality "Quality of radial distance and velocity resolution processing. Physical range [0..1]";
CM_ SG_ 339 RFC_Loc227_ElevationQuality "Probability for correct signal model (elevation angle). Physical range [0..1]";
CM_ SG_ 339 RFC_Loc227_AzimuthQuality "Probability for correct signal model (azimuth angle). Physical range [0..1]";
CM_ SG_ 339 RFC_Loc227_RSSI "Received Signal Strength Indication (RSSI). This signal is not exactly ISO 23150:2021(E): Signal to noise ratio - detection level (A.4.7), but SNR can be calculated from this signal. Further detail please refer to the DSP Location Interface definition";
CM_ SG_ 339 RFC_Loc227_AzimuthalPartnerId "Id of the azimuthal partner location";
CM_ SG_ 340 RFC_Loc228_230_CRC "CRC - Autosar E2E Profile 5";
CM_ SG_ 340 RFC_Loc228_230_AliveCtr "Alive counter - Autosar E2E Profile 5";
CM_ SG_ 340 RFC_Loc228_230_ProtBlockCtr "Protocol-Signal: Block-Counter";
CM_ SG_ 340 RFC_Loc228_RadialDistance "Location radial distance. Represented in conical coordinate system. Same as ISO 23150:2021(E): Position radial distance (A.4.16)";
CM_ SG_ 340 RFC_Loc228_RadialVelocity "Location radial relative velocity ISO 23150:2021(E): Relative velocity {radial distance} (A.4.18)";
CM_ SG_ 340 RFC_Loc228_Elevation "Location elevation angle. Represented in conical coordinate system. Same as ISO 23150:2021(E): Position elevation (A.4.16)";
CM_ SG_ 340 RFC_Loc228_Azimuth "Location azimuth angle. Represented in conical coordinate system. Deviation from ISO 23150:2021(E): Position azimuth (A.4.16). Further details refers to DSP Location Interface definition";
CM_ SG_ 340 RFC_Loc228_DistVelocityCoVnce "Covariance of radial distance and radial velocity";
CM_ SG_ 340 RFC_Loc228_RadialDistanceVnce "Variance of Location radial distance ISO 23150:2021(E): Position radial distance - error (A.4.17)";
CM_ SG_ 340 RFC_Loc228_RadialVelocityVnce "Variance of Location radial relative velocity ISO 23150:2021(E): Relative velocity {radial distance} - error (A.4.19)";
CM_ SG_ 340 RFC_Loc228_ElevationVnce "Variance of Location elevation angle ISO 23150:2021(E): Position elevation - error (A.4.17)";
CM_ SG_ 340 RFC_Loc228_AzimuthVnce "Variance of Location azimuth angle ISO 23150:2021(E): Position azimuth - error (A.4.17)";
CM_ SG_ 340 RFC_Loc228_RadarCrossSection "Radar Cross Section (RCS) estimation ISO 23150:2021(E): Radar cross section (A.4.5)";
CM_ SG_ 340 RFC_Loc228_DistVelocityQuality "Quality of radial distance and velocity resolution processing. Physical range [0..1]";
CM_ SG_ 340 RFC_Loc228_ElevationQuality "Probability for correct signal model (elevation angle). Physical range [0..1]";
CM_ SG_ 340 RFC_Loc228_AzimuthQuality "Probability for correct signal model (azimuth angle). Physical range [0..1]";
CM_ SG_ 340 RFC_Loc228_RSSI "Received Signal Strength Indication (RSSI). This signal is not exactly ISO 23150:2021(E): Signal to noise ratio - detection level (A.4.7), but SNR can be calculated from this signal. Further detail please refer to the DSP Location Interface definition";
CM_ SG_ 340 RFC_Loc228_AzimuthalPartnerId "Id of the azimuthal partner location";
CM_ SG_ 340 RFC_Loc229_RadialDistance "Location radial distance. Represented in conical coordinate system. Same as ISO 23150:2021(E): Position radial distance (A.4.16)";
CM_ SG_ 340 RFC_Loc229_RadialVelocity "Location radial relative velocity ISO 23150:2021(E): Relative velocity {radial distance} (A.4.18)";
CM_ SG_ 340 RFC_Loc229_Elevation "Location elevation angle. Represented in conical coordinate system. Same as ISO 23150:2021(E): Position elevation (A.4.16)";
CM_ SG_ 340 RFC_Loc229_Azimuth "Location azimuth angle. Represented in conical coordinate system. Deviation from ISO 23150:2021(E): Position azimuth (A.4.16). Further details refers to DSP Location Interface definition";
CM_ SG_ 340 RFC_Loc229_DistVelocityCoVnce "Covariance of radial distance and radial velocity";
CM_ SG_ 340 RFC_Loc229_RadialDistanceVnce "Variance of Location radial distance ISO 23150:2021(E): Position radial distance - error (A.4.17)";
CM_ SG_ 340 RFC_Loc229_RadialVelocityVnce "Variance of Location radial relative velocity ISO 23150:2021(E): Relative velocity {radial distance} - error (A.4.19)";
CM_ SG_ 340 RFC_Loc229_ElevationVnce "Variance of Location elevation angle ISO 23150:2021(E): Position elevation - error (A.4.17)";
CM_ SG_ 340 RFC_Loc229_AzimuthVnce "Variance of Location azimuth angle ISO 23150:2021(E): Position azimuth - error (A.4.17)";
CM_ SG_ 340 RFC_Loc229_RadarCrossSection "Radar Cross Section (RCS) estimation ISO 23150:2021(E): Radar cross section (A.4.5)";
CM_ SG_ 340 RFC_Loc229_DistVelocityQuality "Quality of radial distance and velocity resolution processing. Physical range [0..1]";
CM_ SG_ 340 RFC_Loc229_ElevationQuality "Probability for correct signal model (elevation angle). Physical range [0..1]";
CM_ SG_ 340 RFC_Loc229_AzimuthQuality "Probability for correct signal model (azimuth angle). Physical range [0..1]";
CM_ SG_ 340 RFC_Loc229_RSSI "Received Signal Strength Indication (RSSI). This signal is not exactly ISO 23150:2021(E): Signal to noise ratio - detection level (A.4.7), but SNR can be calculated from this signal. Further detail please refer to the DSP Location Interface definition";
CM_ SG_ 340 RFC_Loc229_AzimuthalPartnerId "Id of the azimuthal partner location";
CM_ SG_ 340 RFC_Loc230_RadialDistance "Location radial distance. Represented in conical coordinate system. Same as ISO 23150:2021(E): Position radial distance (A.4.16)";
CM_ SG_ 340 RFC_Loc230_RadialVelocity "Location radial relative velocity ISO 23150:2021(E): Relative velocity {radial distance} (A.4.18)";
CM_ SG_ 340 RFC_Loc230_Elevation "Location elevation angle. Represented in conical coordinate system. Same as ISO 23150:2021(E): Position elevation (A.4.16)";
CM_ SG_ 340 RFC_Loc230_Azimuth "Location azimuth angle. Represented in conical coordinate system. Deviation from ISO 23150:2021(E): Position azimuth (A.4.16). Further details refers to DSP Location Interface definition";
CM_ SG_ 340 RFC_Loc230_DistVelocityCoVnce "Covariance of radial distance and radial velocity";
CM_ SG_ 340 RFC_Loc230_RadialDistanceVnce "Variance of Location radial distance ISO 23150:2021(E): Position radial distance - error (A.4.17)";
CM_ SG_ 340 RFC_Loc230_RadialVelocityVnce "Variance of Location radial relative velocity ISO 23150:2021(E): Relative velocity {radial distance} - error (A.4.19)";
CM_ SG_ 340 RFC_Loc230_ElevationVnce "Variance of Location elevation angle ISO 23150:2021(E): Position elevation - error (A.4.17)";
CM_ SG_ 340 RFC_Loc230_AzimuthVnce "Variance of Location azimuth angle ISO 23150:2021(E): Position azimuth - error (A.4.17)";
CM_ SG_ 340 RFC_Loc230_RadarCrossSection "Radar Cross Section (RCS) estimation ISO 23150:2021(E): Radar cross section (A.4.5)";
CM_ SG_ 340 RFC_Loc230_DistVelocityQuality "Quality of radial distance and velocity resolution processing. Physical range [0..1]";
CM_ SG_ 340 RFC_Loc230_ElevationQuality "Probability for correct signal model (elevation angle). Physical range [0..1]";
CM_ SG_ 340 RFC_Loc230_AzimuthQuality "Probability for correct signal model (azimuth angle). Physical range [0..1]";
CM_ SG_ 340 RFC_Loc230_RSSI "Received Signal Strength Indication (RSSI). This signal is not exactly ISO 23150:2021(E): Signal to noise ratio - detection level (A.4.7), but SNR can be calculated from this signal. Further detail please refer to the DSP Location Interface definition";
CM_ SG_ 340 RFC_Loc230_AzimuthalPartnerId "Id of the azimuthal partner location";
CM_ SG_ 341 RFC_Loc231_233_CRC "CRC - Autosar E2E Profile 5";
CM_ SG_ 341 RFC_Loc231_233_AliveCtr "Alive counter - Autosar E2E Profile 5";
CM_ SG_ 341 RFC_Loc231_233_ProtBlockCtr "Protocol-Signal: Block-Counter";
CM_ SG_ 341 RFC_Loc231_RadialDistance "Location radial distance. Represented in conical coordinate system. Same as ISO 23150:2021(E): Position radial distance (A.4.16)";
CM_ SG_ 341 RFC_Loc231_RadialVelocity "Location radial relative velocity ISO 23150:2021(E): Relative velocity {radial distance} (A.4.18)";
CM_ SG_ 341 RFC_Loc231_Elevation "Location elevation angle. Represented in conical coordinate system. Same as ISO 23150:2021(E): Position elevation (A.4.16)";
CM_ SG_ 341 RFC_Loc231_Azimuth "Location azimuth angle. Represented in conical coordinate system. Deviation from ISO 23150:2021(E): Position azimuth (A.4.16). Further details refers to DSP Location Interface definition";
CM_ SG_ 341 RFC_Loc231_DistVelocityCoVnce "Covariance of radial distance and radial velocity";
CM_ SG_ 341 RFC_Loc231_RadialDistanceVnce "Variance of Location radial distance ISO 23150:2021(E): Position radial distance - error (A.4.17)";
CM_ SG_ 341 RFC_Loc231_RadialVelocityVnce "Variance of Location radial relative velocity ISO 23150:2021(E): Relative velocity {radial distance} - error (A.4.19)";
CM_ SG_ 341 RFC_Loc231_ElevationVnce "Variance of Location elevation angle ISO 23150:2021(E): Position elevation - error (A.4.17)";
CM_ SG_ 341 RFC_Loc231_AzimuthVnce "Variance of Location azimuth angle ISO 23150:2021(E): Position azimuth - error (A.4.17)";
CM_ SG_ 341 RFC_Loc231_RadarCrossSection "Radar Cross Section (RCS) estimation ISO 23150:2021(E): Radar cross section (A.4.5)";
CM_ SG_ 341 RFC_Loc231_DistVelocityQuality "Quality of radial distance and velocity resolution processing. Physical range [0..1]";
CM_ SG_ 341 RFC_Loc231_ElevationQuality "Probability for correct signal model (elevation angle). Physical range [0..1]";
CM_ SG_ 341 RFC_Loc231_AzimuthQuality "Probability for correct signal model (azimuth angle). Physical range [0..1]";
CM_ SG_ 341 RFC_Loc231_RSSI "Received Signal Strength Indication (RSSI). This signal is not exactly ISO 23150:2021(E): Signal to noise ratio - detection level (A.4.7), but SNR can be calculated from this signal. Further detail please refer to the DSP Location Interface definition";
CM_ SG_ 341 RFC_Loc231_AzimuthalPartnerId "Id of the azimuthal partner location";
CM_ SG_ 341 RFC_Loc232_RadialDistance "Location radial distance. Represented in conical coordinate system. Same as ISO 23150:2021(E): Position radial distance (A.4.16)";
CM_ SG_ 341 RFC_Loc232_RadialVelocity "Location radial relative velocity ISO 23150:2021(E): Relative velocity {radial distance} (A.4.18)";
CM_ SG_ 341 RFC_Loc232_Elevation "Location elevation angle. Represented in conical coordinate system. Same as ISO 23150:2021(E): Position elevation (A.4.16)";
CM_ SG_ 341 RFC_Loc232_Azimuth "Location azimuth angle. Represented in conical coordinate system. Deviation from ISO 23150:2021(E): Position azimuth (A.4.16). Further details refers to DSP Location Interface definition";
CM_ SG_ 341 RFC_Loc232_DistVelocityCoVnce "Covariance of radial distance and radial velocity";
CM_ SG_ 341 RFC_Loc232_RadialDistanceVnce "Variance of Location radial distance ISO 23150:2021(E): Position radial distance - error (A.4.17)";
CM_ SG_ 341 RFC_Loc232_RadialVelocityVnce "Variance of Location radial relative velocity ISO 23150:2021(E): Relative velocity {radial distance} - error (A.4.19)";
CM_ SG_ 341 RFC_Loc232_ElevationVnce "Variance of Location elevation angle ISO 23150:2021(E): Position elevation - error (A.4.17)";
CM_ SG_ 341 RFC_Loc232_AzimuthVnce "Variance of Location azimuth angle ISO 23150:2021(E): Position azimuth - error (A.4.17)";
CM_ SG_ 341 RFC_Loc232_RadarCrossSection "Radar Cross Section (RCS) estimation ISO 23150:2021(E): Radar cross section (A.4.5)";
CM_ SG_ 341 RFC_Loc232_DistVelocityQuality "Quality of radial distance and velocity resolution processing. Physical range [0..1]";
CM_ SG_ 341 RFC_Loc232_ElevationQuality "Probability for correct signal model (elevation angle). Physical range [0..1]";
CM_ SG_ 341 RFC_Loc232_AzimuthQuality "Probability for correct signal model (azimuth angle). Physical range [0..1]";
CM_ SG_ 341 RFC_Loc232_RSSI "Received Signal Strength Indication (RSSI). This signal is not exactly ISO 23150:2021(E): Signal to noise ratio - detection level (A.4.7), but SNR can be calculated from this signal. Further detail please refer to the DSP Location Interface definition";
CM_ SG_ 341 RFC_Loc232_AzimuthalPartnerId "Id of the azimuthal partner location";
CM_ SG_ 341 RFC_Loc233_RadialDistance "Location radial distance. Represented in conical coordinate system. Same as ISO 23150:2021(E): Position radial distance (A.4.16)";
CM_ SG_ 341 RFC_Loc233_RadialVelocity "Location radial relative velocity ISO 23150:2021(E): Relative velocity {radial distance} (A.4.18)";
CM_ SG_ 341 RFC_Loc233_Elevation "Location elevation angle. Represented in conical coordinate system. Same as ISO 23150:2021(E): Position elevation (A.4.16)";
CM_ SG_ 341 RFC_Loc233_Azimuth "Location azimuth angle. Represented in conical coordinate system. Deviation from ISO 23150:2021(E): Position azimuth (A.4.16). Further details refers to DSP Location Interface definition";
CM_ SG_ 341 RFC_Loc233_DistVelocityCoVnce "Covariance of radial distance and radial velocity";
CM_ SG_ 341 RFC_Loc233_RadialDistanceVnce "Variance of Location radial distance ISO 23150:2021(E): Position radial distance - error (A.4.17)";
CM_ SG_ 341 RFC_Loc233_RadialVelocityVnce "Variance of Location radial relative velocity ISO 23150:2021(E): Relative velocity {radial distance} - error (A.4.19)";
CM_ SG_ 341 RFC_Loc233_ElevationVnce "Variance of Location elevation angle ISO 23150:2021(E): Position elevation - error (A.4.17)";
CM_ SG_ 341 RFC_Loc233_AzimuthVnce "Variance of Location azimuth angle ISO 23150:2021(E): Position azimuth - error (A.4.17)";
CM_ SG_ 341 RFC_Loc233_RadarCrossSection "Radar Cross Section (RCS) estimation ISO 23150:2021(E): Radar cross section (A.4.5)";
CM_ SG_ 341 RFC_Loc233_DistVelocityQuality "Quality of radial distance and velocity resolution processing. Physical range [0..1]";
CM_ SG_ 341 RFC_Loc233_ElevationQuality "Probability for correct signal model (elevation angle). Physical range [0..1]";
CM_ SG_ 341 RFC_Loc233_AzimuthQuality "Probability for correct signal model (azimuth angle). Physical range [0..1]";
CM_ SG_ 341 RFC_Loc233_RSSI "Received Signal Strength Indication (RSSI). This signal is not exactly ISO 23150:2021(E): Signal to noise ratio - detection level (A.4.7), but SNR can be calculated from this signal. Further detail please refer to the DSP Location Interface definition";
CM_ SG_ 341 RFC_Loc233_AzimuthalPartnerId "Id of the azimuthal partner location";
CM_ SG_ 342 RFC_Loc234_236_CRC "CRC - Autosar E2E Profile 5";
CM_ SG_ 342 RFC_Loc234_236_AliveCtr "Alive counter - Autosar E2E Profile 5";
CM_ SG_ 342 RFC_Loc234_236_ProtBlockCtr "Protocol-Signal: Block-Counter";
CM_ SG_ 342 RFC_Loc234_RadialDistance "Location radial distance. Represented in conical coordinate system. Same as ISO 23150:2021(E): Position radial distance (A.4.16)";
CM_ SG_ 342 RFC_Loc234_RadialVelocity "Location radial relative velocity ISO 23150:2021(E): Relative velocity {radial distance} (A.4.18)";
CM_ SG_ 342 RFC_Loc234_Elevation "Location elevation angle. Represented in conical coordinate system. Same as ISO 23150:2021(E): Position elevation (A.4.16)";
CM_ SG_ 342 RFC_Loc234_Azimuth "Location azimuth angle. Represented in conical coordinate system. Deviation from ISO 23150:2021(E): Position azimuth (A.4.16). Further details refers to DSP Location Interface definition";
CM_ SG_ 342 RFC_Loc234_DistVelocityCoVnce "Covariance of radial distance and radial velocity";
CM_ SG_ 342 RFC_Loc234_RadialDistanceVnce "Variance of Location radial distance ISO 23150:2021(E): Position radial distance - error (A.4.17)";
CM_ SG_ 342 RFC_Loc234_RadialVelocityVnce "Variance of Location radial relative velocity ISO 23150:2021(E): Relative velocity {radial distance} - error (A.4.19)";
CM_ SG_ 342 RFC_Loc234_ElevationVnce "Variance of Location elevation angle ISO 23150:2021(E): Position elevation - error (A.4.17)";
CM_ SG_ 342 RFC_Loc234_AzimuthVnce "Variance of Location azimuth angle ISO 23150:2021(E): Position azimuth - error (A.4.17)";
CM_ SG_ 342 RFC_Loc234_RadarCrossSection "Radar Cross Section (RCS) estimation ISO 23150:2021(E): Radar cross section (A.4.5)";
CM_ SG_ 342 RFC_Loc234_DistVelocityQuality "Quality of radial distance and velocity resolution processing. Physical range [0..1]";
CM_ SG_ 342 RFC_Loc234_ElevationQuality "Probability for correct signal model (elevation angle). Physical range [0..1]";
CM_ SG_ 342 RFC_Loc234_AzimuthQuality "Probability for correct signal model (azimuth angle). Physical range [0..1]";
CM_ SG_ 342 RFC_Loc234_RSSI "Received Signal Strength Indication (RSSI). This signal is not exactly ISO 23150:2021(E): Signal to noise ratio - detection level (A.4.7), but SNR can be calculated from this signal. Further detail please refer to the DSP Location Interface definition";
CM_ SG_ 342 RFC_Loc234_AzimuthalPartnerId "Id of the azimuthal partner location";
CM_ SG_ 342 RFC_Loc235_RadialDistance "Location radial distance. Represented in conical coordinate system. Same as ISO 23150:2021(E): Position radial distance (A.4.16)";
CM_ SG_ 342 RFC_Loc235_RadialVelocity "Location radial relative velocity ISO 23150:2021(E): Relative velocity {radial distance} (A.4.18)";
CM_ SG_ 342 RFC_Loc235_Elevation "Location elevation angle. Represented in conical coordinate system. Same as ISO 23150:2021(E): Position elevation (A.4.16)";
CM_ SG_ 342 RFC_Loc235_Azimuth "Location azimuth angle. Represented in conical coordinate system. Deviation from ISO 23150:2021(E): Position azimuth (A.4.16). Further details refers to DSP Location Interface definition";
CM_ SG_ 342 RFC_Loc235_DistVelocityCoVnce "Covariance of radial distance and radial velocity";
CM_ SG_ 342 RFC_Loc235_RadialDistanceVnce "Variance of Location radial distance ISO 23150:2021(E): Position radial distance - error (A.4.17)";
CM_ SG_ 342 RFC_Loc235_RadialVelocityVnce "Variance of Location radial relative velocity ISO 23150:2021(E): Relative velocity {radial distance} - error (A.4.19)";
CM_ SG_ 342 RFC_Loc235_ElevationVnce "Variance of Location elevation angle ISO 23150:2021(E): Position elevation - error (A.4.17)";
CM_ SG_ 342 RFC_Loc235_AzimuthVnce "Variance of Location azimuth angle ISO 23150:2021(E): Position azimuth - error (A.4.17)";
CM_ SG_ 342 RFC_Loc235_RadarCrossSection "Radar Cross Section (RCS) estimation ISO 23150:2021(E): Radar cross section (A.4.5)";
CM_ SG_ 342 RFC_Loc235_DistVelocityQuality "Quality of radial distance and velocity resolution processing. Physical range [0..1]";
CM_ SG_ 342 RFC_Loc235_ElevationQuality "Probability for correct signal model (elevation angle). Physical range [0..1]";
CM_ SG_ 342 RFC_Loc235_AzimuthQuality "Probability for correct signal model (azimuth angle). Physical range [0..1]";
CM_ SG_ 342 RFC_Loc235_RSSI "Received Signal Strength Indication (RSSI). This signal is not exactly ISO 23150:2021(E): Signal to noise ratio - detection level (A.4.7), but SNR can be calculated from this signal. Further detail please refer to the DSP Location Interface definition";
CM_ SG_ 342 RFC_Loc235_AzimuthalPartnerId "Id of the azimuthal partner location";
CM_ SG_ 342 RFC_Loc236_RadialDistance "Location radial distance. Represented in conical coordinate system. Same as ISO 23150:2021(E): Position radial distance (A.4.16)";
CM_ SG_ 342 RFC_Loc236_RadialVelocity "Location radial relative velocity ISO 23150:2021(E): Relative velocity {radial distance} (A.4.18)";
CM_ SG_ 342 RFC_Loc236_Elevation "Location elevation angle. Represented in conical coordinate system. Same as ISO 23150:2021(E): Position elevation (A.4.16)";
CM_ SG_ 342 RFC_Loc236_Azimuth "Location azimuth angle. Represented in conical coordinate system. Deviation from ISO 23150:2021(E): Position azimuth (A.4.16). Further details refers to DSP Location Interface definition";
CM_ SG_ 342 RFC_Loc236_DistVelocityCoVnce "Covariance of radial distance and radial velocity";
CM_ SG_ 342 RFC_Loc236_RadialDistanceVnce "Variance of Location radial distance ISO 23150:2021(E): Position radial distance - error (A.4.17)";
CM_ SG_ 342 RFC_Loc236_RadialVelocityVnce "Variance of Location radial relative velocity ISO 23150:2021(E): Relative velocity {radial distance} - error (A.4.19)";
CM_ SG_ 342 RFC_Loc236_ElevationVnce "Variance of Location elevation angle ISO 23150:2021(E): Position elevation - error (A.4.17)";
CM_ SG_ 342 RFC_Loc236_AzimuthVnce "Variance of Location azimuth angle ISO 23150:2021(E): Position azimuth - error (A.4.17)";
CM_ SG_ 342 RFC_Loc236_RadarCrossSection "Radar Cross Section (RCS) estimation ISO 23150:2021(E): Radar cross section (A.4.5)";
CM_ SG_ 342 RFC_Loc236_DistVelocityQuality "Quality of radial distance and velocity resolution processing. Physical range [0..1]";
CM_ SG_ 342 RFC_Loc236_ElevationQuality "Probability for correct signal model (elevation angle). Physical range [0..1]";
CM_ SG_ 342 RFC_Loc236_AzimuthQuality "Probability for correct signal model (azimuth angle). Physical range [0..1]";
CM_ SG_ 342 RFC_Loc236_RSSI "Received Signal Strength Indication (RSSI). This signal is not exactly ISO 23150:2021(E): Signal to noise ratio - detection level (A.4.7), but SNR can be calculated from this signal. Further detail please refer to the DSP Location Interface definition";
CM_ SG_ 342 RFC_Loc236_AzimuthalPartnerId "Id of the azimuthal partner location";
CM_ SG_ 343 RFC_Loc237_239_CRC "CRC - Autosar E2E Profile 5";
CM_ SG_ 343 RFC_Loc237_239_AliveCtr "Alive counter - Autosar E2E Profile 5";
CM_ SG_ 343 RFC_Loc237_239_ProtBlockCtr "Protocol-Signal: Block-Counter";
CM_ SG_ 343 RFC_Loc237_RadialDistance "Location radial distance. Represented in conical coordinate system. Same as ISO 23150:2021(E): Position radial distance (A.4.16)";
CM_ SG_ 343 RFC_Loc237_RadialVelocity "Location radial relative velocity ISO 23150:2021(E): Relative velocity {radial distance} (A.4.18)";
CM_ SG_ 343 RFC_Loc237_Elevation "Location elevation angle. Represented in conical coordinate system. Same as ISO 23150:2021(E): Position elevation (A.4.16)";
CM_ SG_ 343 RFC_Loc237_Azimuth "Location azimuth angle. Represented in conical coordinate system. Deviation from ISO 23150:2021(E): Position azimuth (A.4.16). Further details refers to DSP Location Interface definition";
CM_ SG_ 343 RFC_Loc237_DistVelocityCoVnce "Covariance of radial distance and radial velocity";
CM_ SG_ 343 RFC_Loc237_RadialDistanceVnce "Variance of Location radial distance ISO 23150:2021(E): Position radial distance - error (A.4.17)";
CM_ SG_ 343 RFC_Loc237_RadialVelocityVnce "Variance of Location radial relative velocity ISO 23150:2021(E): Relative velocity {radial distance} - error (A.4.19)";
CM_ SG_ 343 RFC_Loc237_ElevationVnce "Variance of Location elevation angle ISO 23150:2021(E): Position elevation - error (A.4.17)";
CM_ SG_ 343 RFC_Loc237_AzimuthVnce "Variance of Location azimuth angle ISO 23150:2021(E): Position azimuth - error (A.4.17)";
CM_ SG_ 343 RFC_Loc237_RadarCrossSection "Radar Cross Section (RCS) estimation ISO 23150:2021(E): Radar cross section (A.4.5)";
CM_ SG_ 343 RFC_Loc237_DistVelocityQuality "Quality of radial distance and velocity resolution processing. Physical range [0..1]";
CM_ SG_ 343 RFC_Loc237_ElevationQuality "Probability for correct signal model (elevation angle). Physical range [0..1]";
CM_ SG_ 343 RFC_Loc237_AzimuthQuality "Probability for correct signal model (azimuth angle). Physical range [0..1]";
CM_ SG_ 343 RFC_Loc237_RSSI "Received Signal Strength Indication (RSSI). This signal is not exactly ISO 23150:2021(E): Signal to noise ratio - detection level (A.4.7), but SNR can be calculated from this signal. Further detail please refer to the DSP Location Interface definition";
CM_ SG_ 343 RFC_Loc237_AzimuthalPartnerId "Id of the azimuthal partner location";
CM_ SG_ 343 RFC_Loc238_RadialDistance "Location radial distance. Represented in conical coordinate system. Same as ISO 23150:2021(E): Position radial distance (A.4.16)";
CM_ SG_ 343 RFC_Loc238_RadialVelocity "Location radial relative velocity ISO 23150:2021(E): Relative velocity {radial distance} (A.4.18)";
CM_ SG_ 343 RFC_Loc238_Elevation "Location elevation angle. Represented in conical coordinate system. Same as ISO 23150:2021(E): Position elevation (A.4.16)";
CM_ SG_ 343 RFC_Loc238_Azimuth "Location azimuth angle. Represented in conical coordinate system. Deviation from ISO 23150:2021(E): Position azimuth (A.4.16). Further details refers to DSP Location Interface definition";
CM_ SG_ 343 RFC_Loc238_DistVelocityCoVnce "Covariance of radial distance and radial velocity";
CM_ SG_ 343 RFC_Loc238_RadialDistanceVnce "Variance of Location radial distance ISO 23150:2021(E): Position radial distance - error (A.4.17)";
CM_ SG_ 343 RFC_Loc238_RadialVelocityVnce "Variance of Location radial relative velocity ISO 23150:2021(E): Relative velocity {radial distance} - error (A.4.19)";
CM_ SG_ 343 RFC_Loc238_ElevationVnce "Variance of Location elevation angle ISO 23150:2021(E): Position elevation - error (A.4.17)";
CM_ SG_ 343 RFC_Loc238_AzimuthVnce "Variance of Location azimuth angle ISO 23150:2021(E): Position azimuth - error (A.4.17)";
CM_ SG_ 343 RFC_Loc238_RadarCrossSection "Radar Cross Section (RCS) estimation ISO 23150:2021(E): Radar cross section (A.4.5)";
CM_ SG_ 343 RFC_Loc238_DistVelocityQuality "Quality of radial distance and velocity resolution processing. Physical range [0..1]";
CM_ SG_ 343 RFC_Loc238_ElevationQuality "Probability for correct signal model (elevation angle). Physical range [0..1]";
CM_ SG_ 343 RFC_Loc238_AzimuthQuality "Probability for correct signal model (azimuth angle). Physical range [0..1]";
CM_ SG_ 343 RFC_Loc238_RSSI "Received Signal Strength Indication (RSSI). This signal is not exactly ISO 23150:2021(E): Signal to noise ratio - detection level (A.4.7), but SNR can be calculated from this signal. Further detail please refer to the DSP Location Interface definition";
CM_ SG_ 343 RFC_Loc238_AzimuthalPartnerId "Id of the azimuthal partner location";
CM_ SG_ 343 RFC_Loc239_RadialDistance "Location radial distance. Represented in conical coordinate system. Same as ISO 23150:2021(E): Position radial distance (A.4.16)";
CM_ SG_ 343 RFC_Loc239_RadialVelocity "Location radial relative velocity ISO 23150:2021(E): Relative velocity {radial distance} (A.4.18)";
CM_ SG_ 343 RFC_Loc239_Elevation "Location elevation angle. Represented in conical coordinate system. Same as ISO 23150:2021(E): Position elevation (A.4.16)";
CM_ SG_ 343 RFC_Loc239_Azimuth "Location azimuth angle. Represented in conical coordinate system. Deviation from ISO 23150:2021(E): Position azimuth (A.4.16). Further details refers to DSP Location Interface definition";
CM_ SG_ 343 RFC_Loc239_DistVelocityCoVnce "Covariance of radial distance and radial velocity";
CM_ SG_ 343 RFC_Loc239_RadialDistanceVnce "Variance of Location radial distance ISO 23150:2021(E): Position radial distance - error (A.4.17)";
CM_ SG_ 343 RFC_Loc239_RadialVelocityVnce "Variance of Location radial relative velocity ISO 23150:2021(E): Relative velocity {radial distance} - error (A.4.19)";
CM_ SG_ 343 RFC_Loc239_ElevationVnce "Variance of Location elevation angle ISO 23150:2021(E): Position elevation - error (A.4.17)";
CM_ SG_ 343 RFC_Loc239_AzimuthVnce "Variance of Location azimuth angle ISO 23150:2021(E): Position azimuth - error (A.4.17)";
CM_ SG_ 343 RFC_Loc239_RadarCrossSection "Radar Cross Section (RCS) estimation ISO 23150:2021(E): Radar cross section (A.4.5)";
CM_ SG_ 343 RFC_Loc239_DistVelocityQuality "Quality of radial distance and velocity resolution processing. Physical range [0..1]";
CM_ SG_ 343 RFC_Loc239_ElevationQuality "Probability for correct signal model (elevation angle). Physical range [0..1]";
CM_ SG_ 343 RFC_Loc239_AzimuthQuality "Probability for correct signal model (azimuth angle). Physical range [0..1]";
CM_ SG_ 343 RFC_Loc239_RSSI "Received Signal Strength Indication (RSSI). This signal is not exactly ISO 23150:2021(E): Signal to noise ratio - detection level (A.4.7), but SNR can be calculated from this signal. Further detail please refer to the DSP Location Interface definition";
CM_ SG_ 343 RFC_Loc239_AzimuthalPartnerId "Id of the azimuthal partner location";
CM_ SG_ 344 RFC_Loc240_242_CRC "CRC - Autosar E2E Profile 5";
CM_ SG_ 344 RFC_Loc240_242_AliveCtr "Alive counter - Autosar E2E Profile 5";
CM_ SG_ 344 RFC_Loc240_242_ProtBlockCtr "Protocol-Signal: Block-Counter";
CM_ SG_ 344 RFC_Loc240_RadialDistance "Location radial distance. Represented in conical coordinate system. Same as ISO 23150:2021(E): Position radial distance (A.4.16)";
CM_ SG_ 344 RFC_Loc240_RadialVelocity "Location radial relative velocity ISO 23150:2021(E): Relative velocity {radial distance} (A.4.18)";
CM_ SG_ 344 RFC_Loc240_Elevation "Location elevation angle. Represented in conical coordinate system. Same as ISO 23150:2021(E): Position elevation (A.4.16)";
CM_ SG_ 344 RFC_Loc240_Azimuth "Location azimuth angle. Represented in conical coordinate system. Deviation from ISO 23150:2021(E): Position azimuth (A.4.16). Further details refers to DSP Location Interface definition";
CM_ SG_ 344 RFC_Loc240_DistVelocityCoVnce "Covariance of radial distance and radial velocity";
CM_ SG_ 344 RFC_Loc240_RadialDistanceVnce "Variance of Location radial distance ISO 23150:2021(E): Position radial distance - error (A.4.17)";
CM_ SG_ 344 RFC_Loc240_RadialVelocityVnce "Variance of Location radial relative velocity ISO 23150:2021(E): Relative velocity {radial distance} - error (A.4.19)";
CM_ SG_ 344 RFC_Loc240_ElevationVnce "Variance of Location elevation angle ISO 23150:2021(E): Position elevation - error (A.4.17)";
CM_ SG_ 344 RFC_Loc240_AzimuthVnce "Variance of Location azimuth angle ISO 23150:2021(E): Position azimuth - error (A.4.17)";
CM_ SG_ 344 RFC_Loc240_RadarCrossSection "Radar Cross Section (RCS) estimation ISO 23150:2021(E): Radar cross section (A.4.5)";
CM_ SG_ 344 RFC_Loc240_DistVelocityQuality "Quality of radial distance and velocity resolution processing. Physical range [0..1]";
CM_ SG_ 344 RFC_Loc240_ElevationQuality "Probability for correct signal model (elevation angle). Physical range [0..1]";
CM_ SG_ 344 RFC_Loc240_AzimuthQuality "Probability for correct signal model (azimuth angle). Physical range [0..1]";
CM_ SG_ 344 RFC_Loc240_RSSI "Received Signal Strength Indication (RSSI). This signal is not exactly ISO 23150:2021(E): Signal to noise ratio - detection level (A.4.7), but SNR can be calculated from this signal. Further detail please refer to the DSP Location Interface definition";
CM_ SG_ 344 RFC_Loc240_AzimuthalPartnerId "Id of the azimuthal partner location";
CM_ SG_ 344 RFC_Loc241_RadialDistance "Location radial distance. Represented in conical coordinate system. Same as ISO 23150:2021(E): Position radial distance (A.4.16)";
CM_ SG_ 344 RFC_Loc241_RadialVelocity "Location radial relative velocity ISO 23150:2021(E): Relative velocity {radial distance} (A.4.18)";
CM_ SG_ 344 RFC_Loc241_Elevation "Location elevation angle. Represented in conical coordinate system. Same as ISO 23150:2021(E): Position elevation (A.4.16)";
CM_ SG_ 344 RFC_Loc241_Azimuth "Location azimuth angle. Represented in conical coordinate system. Deviation from ISO 23150:2021(E): Position azimuth (A.4.16). Further details refers to DSP Location Interface definition";
CM_ SG_ 344 RFC_Loc241_DistVelocityCoVnce "Covariance of radial distance and radial velocity";
CM_ SG_ 344 RFC_Loc241_RadialDistanceVnce "Variance of Location radial distance ISO 23150:2021(E): Position radial distance - error (A.4.17)";
CM_ SG_ 344 RFC_Loc241_RadialVelocityVnce "Variance of Location radial relative velocity ISO 23150:2021(E): Relative velocity {radial distance} - error (A.4.19)";
CM_ SG_ 344 RFC_Loc241_ElevationVnce "Variance of Location elevation angle ISO 23150:2021(E): Position elevation - error (A.4.17)";
CM_ SG_ 344 RFC_Loc241_AzimuthVnce "Variance of Location azimuth angle ISO 23150:2021(E): Position azimuth - error (A.4.17)";
CM_ SG_ 344 RFC_Loc241_RadarCrossSection "Radar Cross Section (RCS) estimation ISO 23150:2021(E): Radar cross section (A.4.5)";
CM_ SG_ 344 RFC_Loc241_DistVelocityQuality "Quality of radial distance and velocity resolution processing. Physical range [0..1]";
CM_ SG_ 344 RFC_Loc241_ElevationQuality "Probability for correct signal model (elevation angle). Physical range [0..1]";
CM_ SG_ 344 RFC_Loc241_AzimuthQuality "Probability for correct signal model (azimuth angle). Physical range [0..1]";
CM_ SG_ 344 RFC_Loc241_RSSI "Received Signal Strength Indication (RSSI). This signal is not exactly ISO 23150:2021(E): Signal to noise ratio - detection level (A.4.7), but SNR can be calculated from this signal. Further detail please refer to the DSP Location Interface definition";
CM_ SG_ 344 RFC_Loc241_AzimuthalPartnerId "Id of the azimuthal partner location";
CM_ SG_ 344 RFC_Loc242_RadialDistance "Location radial distance. Represented in conical coordinate system. Same as ISO 23150:2021(E): Position radial distance (A.4.16)";
CM_ SG_ 344 RFC_Loc242_RadialVelocity "Location radial relative velocity ISO 23150:2021(E): Relative velocity {radial distance} (A.4.18)";
CM_ SG_ 344 RFC_Loc242_Elevation "Location elevation angle. Represented in conical coordinate system. Same as ISO 23150:2021(E): Position elevation (A.4.16)";
CM_ SG_ 344 RFC_Loc242_Azimuth "Location azimuth angle. Represented in conical coordinate system. Deviation from ISO 23150:2021(E): Position azimuth (A.4.16). Further details refers to DSP Location Interface definition";
CM_ SG_ 344 RFC_Loc242_DistVelocityCoVnce "Covariance of radial distance and radial velocity";
CM_ SG_ 344 RFC_Loc242_RadialDistanceVnce "Variance of Location radial distance ISO 23150:2021(E): Position radial distance - error (A.4.17)";
CM_ SG_ 344 RFC_Loc242_RadialVelocityVnce "Variance of Location radial relative velocity ISO 23150:2021(E): Relative velocity {radial distance} - error (A.4.19)";
CM_ SG_ 344 RFC_Loc242_ElevationVnce "Variance of Location elevation angle ISO 23150:2021(E): Position elevation - error (A.4.17)";
CM_ SG_ 344 RFC_Loc242_AzimuthVnce "Variance of Location azimuth angle ISO 23150:2021(E): Position azimuth - error (A.4.17)";
CM_ SG_ 344 RFC_Loc242_RadarCrossSection "Radar Cross Section (RCS) estimation ISO 23150:2021(E): Radar cross section (A.4.5)";
CM_ SG_ 344 RFC_Loc242_DistVelocityQuality "Quality of radial distance and velocity resolution processing. Physical range [0..1]";
CM_ SG_ 344 RFC_Loc242_ElevationQuality "Probability for correct signal model (elevation angle). Physical range [0..1]";
CM_ SG_ 344 RFC_Loc242_AzimuthQuality "Probability for correct signal model (azimuth angle). Physical range [0..1]";
CM_ SG_ 344 RFC_Loc242_RSSI "Received Signal Strength Indication (RSSI). This signal is not exactly ISO 23150:2021(E): Signal to noise ratio - detection level (A.4.7), but SNR can be calculated from this signal. Further detail please refer to the DSP Location Interface definition";
CM_ SG_ 344 RFC_Loc242_AzimuthalPartnerId "Id of the azimuthal partner location";
CM_ SG_ 345 RFC_Loc243_245_CRC "CRC - Autosar E2E Profile 5";
CM_ SG_ 345 RFC_Loc243_245_AliveCtr "Alive counter - Autosar E2E Profile 5";
CM_ SG_ 345 RFC_Loc243_245_ProtBlockCtr "Protocol-Signal: Block-Counter";
CM_ SG_ 345 RFC_Loc243_RadialDistance "Location radial distance. Represented in conical coordinate system. Same as ISO 23150:2021(E): Position radial distance (A.4.16)";
CM_ SG_ 345 RFC_Loc243_RadialVelocity "Location radial relative velocity ISO 23150:2021(E): Relative velocity {radial distance} (A.4.18)";
CM_ SG_ 345 RFC_Loc243_Elevation "Location elevation angle. Represented in conical coordinate system. Same as ISO 23150:2021(E): Position elevation (A.4.16)";
CM_ SG_ 345 RFC_Loc243_Azimuth "Location azimuth angle. Represented in conical coordinate system. Deviation from ISO 23150:2021(E): Position azimuth (A.4.16). Further details refers to DSP Location Interface definition";
CM_ SG_ 345 RFC_Loc243_DistVelocityCoVnce "Covariance of radial distance and radial velocity";
CM_ SG_ 345 RFC_Loc243_RadialDistanceVnce "Variance of Location radial distance ISO 23150:2021(E): Position radial distance - error (A.4.17)";
CM_ SG_ 345 RFC_Loc243_RadialVelocityVnce "Variance of Location radial relative velocity ISO 23150:2021(E): Relative velocity {radial distance} - error (A.4.19)";
CM_ SG_ 345 RFC_Loc243_ElevationVnce "Variance of Location elevation angle ISO 23150:2021(E): Position elevation - error (A.4.17)";
CM_ SG_ 345 RFC_Loc243_AzimuthVnce "Variance of Location azimuth angle ISO 23150:2021(E): Position azimuth - error (A.4.17)";
CM_ SG_ 345 RFC_Loc243_RadarCrossSection "Radar Cross Section (RCS) estimation ISO 23150:2021(E): Radar cross section (A.4.5)";
CM_ SG_ 345 RFC_Loc243_DistVelocityQuality "Quality of radial distance and velocity resolution processing. Physical range [0..1]";
CM_ SG_ 345 RFC_Loc243_ElevationQuality "Probability for correct signal model (elevation angle). Physical range [0..1]";
CM_ SG_ 345 RFC_Loc243_AzimuthQuality "Probability for correct signal model (azimuth angle). Physical range [0..1]";
CM_ SG_ 345 RFC_Loc243_RSSI "Received Signal Strength Indication (RSSI). This signal is not exactly ISO 23150:2021(E): Signal to noise ratio - detection level (A.4.7), but SNR can be calculated from this signal. Further detail please refer to the DSP Location Interface definition";
CM_ SG_ 345 RFC_Loc243_AzimuthalPartnerId "Id of the azimuthal partner location";
CM_ SG_ 345 RFC_Loc244_RadialDistance "Location radial distance. Represented in conical coordinate system. Same as ISO 23150:2021(E): Position radial distance (A.4.16)";
CM_ SG_ 345 RFC_Loc244_RadialVelocity "Location radial relative velocity ISO 23150:2021(E): Relative velocity {radial distance} (A.4.18)";
CM_ SG_ 345 RFC_Loc244_Elevation "Location elevation angle. Represented in conical coordinate system. Same as ISO 23150:2021(E): Position elevation (A.4.16)";
CM_ SG_ 345 RFC_Loc244_Azimuth "Location azimuth angle. Represented in conical coordinate system. Deviation from ISO 23150:2021(E): Position azimuth (A.4.16). Further details refers to DSP Location Interface definition";
CM_ SG_ 345 RFC_Loc244_DistVelocityCoVnce "Covariance of radial distance and radial velocity";
CM_ SG_ 345 RFC_Loc244_RadialDistanceVnce "Variance of Location radial distance ISO 23150:2021(E): Position radial distance - error (A.4.17)";
CM_ SG_ 345 RFC_Loc244_RadialVelocityVnce "Variance of Location radial relative velocity ISO 23150:2021(E): Relative velocity {radial distance} - error (A.4.19)";
CM_ SG_ 345 RFC_Loc244_ElevationVnce "Variance of Location elevation angle ISO 23150:2021(E): Position elevation - error (A.4.17)";
CM_ SG_ 345 RFC_Loc244_AzimuthVnce "Variance of Location azimuth angle ISO 23150:2021(E): Position azimuth - error (A.4.17)";
CM_ SG_ 345 RFC_Loc244_RadarCrossSection "Radar Cross Section (RCS) estimation ISO 23150:2021(E): Radar cross section (A.4.5)";
CM_ SG_ 345 RFC_Loc244_DistVelocityQuality "Quality of radial distance and velocity resolution processing. Physical range [0..1]";
CM_ SG_ 345 RFC_Loc244_ElevationQuality "Probability for correct signal model (elevation angle). Physical range [0..1]";
CM_ SG_ 345 RFC_Loc244_AzimuthQuality "Probability for correct signal model (azimuth angle). Physical range [0..1]";
CM_ SG_ 345 RFC_Loc244_RSSI "Received Signal Strength Indication (RSSI). This signal is not exactly ISO 23150:2021(E): Signal to noise ratio - detection level (A.4.7), but SNR can be calculated from this signal. Further detail please refer to the DSP Location Interface definition";
CM_ SG_ 345 RFC_Loc244_AzimuthalPartnerId "Id of the azimuthal partner location";
CM_ SG_ 345 RFC_Loc245_RadialDistance "Location radial distance. Represented in conical coordinate system. Same as ISO 23150:2021(E): Position radial distance (A.4.16)";
CM_ SG_ 345 RFC_Loc245_RadialVelocity "Location radial relative velocity ISO 23150:2021(E): Relative velocity {radial distance} (A.4.18)";
CM_ SG_ 345 RFC_Loc245_Elevation "Location elevation angle. Represented in conical coordinate system. Same as ISO 23150:2021(E): Position elevation (A.4.16)";
CM_ SG_ 345 RFC_Loc245_Azimuth "Location azimuth angle. Represented in conical coordinate system. Deviation from ISO 23150:2021(E): Position azimuth (A.4.16). Further details refers to DSP Location Interface definition";
CM_ SG_ 345 RFC_Loc245_DistVelocityCoVnce "Covariance of radial distance and radial velocity";
CM_ SG_ 345 RFC_Loc245_RadialDistanceVnce "Variance of Location radial distance ISO 23150:2021(E): Position radial distance - error (A.4.17)";
CM_ SG_ 345 RFC_Loc245_RadialVelocityVnce "Variance of Location radial relative velocity ISO 23150:2021(E): Relative velocity {radial distance} - error (A.4.19)";
CM_ SG_ 345 RFC_Loc245_ElevationVnce "Variance of Location elevation angle ISO 23150:2021(E): Position elevation - error (A.4.17)";
CM_ SG_ 345 RFC_Loc245_AzimuthVnce "Variance of Location azimuth angle ISO 23150:2021(E): Position azimuth - error (A.4.17)";
CM_ SG_ 345 RFC_Loc245_RadarCrossSection "Radar Cross Section (RCS) estimation ISO 23150:2021(E): Radar cross section (A.4.5)";
CM_ SG_ 345 RFC_Loc245_DistVelocityQuality "Quality of radial distance and velocity resolution processing. Physical range [0..1]";
CM_ SG_ 345 RFC_Loc245_ElevationQuality "Probability for correct signal model (elevation angle). Physical range [0..1]";
CM_ SG_ 345 RFC_Loc245_AzimuthQuality "Probability for correct signal model (azimuth angle). Physical range [0..1]";
CM_ SG_ 345 RFC_Loc245_RSSI "Received Signal Strength Indication (RSSI). This signal is not exactly ISO 23150:2021(E): Signal to noise ratio - detection level (A.4.7), but SNR can be calculated from this signal. Further detail please refer to the DSP Location Interface definition";
CM_ SG_ 345 RFC_Loc245_AzimuthalPartnerId "Id of the azimuthal partner location";
CM_ SG_ 346 RFC_Loc246_248_CRC "CRC - Autosar E2E Profile 5";
CM_ SG_ 346 RFC_Loc246_248_AliveCtr "Alive counter - Autosar E2E Profile 5";
CM_ SG_ 346 RFC_Loc246_248_ProtBlockCtr "Protocol-Signal: Block-Counter";
CM_ SG_ 346 RFC_Loc246_RadialDistance "Location radial distance. Represented in conical coordinate system. Same as ISO 23150:2021(E): Position radial distance (A.4.16)";
CM_ SG_ 346 RFC_Loc246_RadialVelocity "Location radial relative velocity ISO 23150:2021(E): Relative velocity {radial distance} (A.4.18)";
CM_ SG_ 346 RFC_Loc246_Elevation "Location elevation angle. Represented in conical coordinate system. Same as ISO 23150:2021(E): Position elevation (A.4.16)";
CM_ SG_ 346 RFC_Loc246_Azimuth "Location azimuth angle. Represented in conical coordinate system. Deviation from ISO 23150:2021(E): Position azimuth (A.4.16). Further details refers to DSP Location Interface definition";
CM_ SG_ 346 RFC_Loc246_DistVelocityCoVnce "Covariance of radial distance and radial velocity";
CM_ SG_ 346 RFC_Loc246_RadialDistanceVnce "Variance of Location radial distance ISO 23150:2021(E): Position radial distance - error (A.4.17)";
CM_ SG_ 346 RFC_Loc246_RadialVelocityVnce "Variance of Location radial relative velocity ISO 23150:2021(E): Relative velocity {radial distance} - error (A.4.19)";
CM_ SG_ 346 RFC_Loc246_ElevationVnce "Variance of Location elevation angle ISO 23150:2021(E): Position elevation - error (A.4.17)";
CM_ SG_ 346 RFC_Loc246_AzimuthVnce "Variance of Location azimuth angle ISO 23150:2021(E): Position azimuth - error (A.4.17)";
CM_ SG_ 346 RFC_Loc246_RadarCrossSection "Radar Cross Section (RCS) estimation ISO 23150:2021(E): Radar cross section (A.4.5)";
CM_ SG_ 346 RFC_Loc246_DistVelocityQuality "Quality of radial distance and velocity resolution processing. Physical range [0..1]";
CM_ SG_ 346 RFC_Loc246_ElevationQuality "Probability for correct signal model (elevation angle). Physical range [0..1]";
CM_ SG_ 346 RFC_Loc246_AzimuthQuality "Probability for correct signal model (azimuth angle). Physical range [0..1]";
CM_ SG_ 346 RFC_Loc246_RSSI "Received Signal Strength Indication (RSSI). This signal is not exactly ISO 23150:2021(E): Signal to noise ratio - detection level (A.4.7), but SNR can be calculated from this signal. Further detail please refer to the DSP Location Interface definition";
CM_ SG_ 346 RFC_Loc246_AzimuthalPartnerId "Id of the azimuthal partner location";
CM_ SG_ 346 RFC_Loc247_RadialDistance "Location radial distance. Represented in conical coordinate system. Same as ISO 23150:2021(E): Position radial distance (A.4.16)";
CM_ SG_ 346 RFC_Loc247_RadialVelocity "Location radial relative velocity ISO 23150:2021(E): Relative velocity {radial distance} (A.4.18)";
CM_ SG_ 346 RFC_Loc247_Elevation "Location elevation angle. Represented in conical coordinate system. Same as ISO 23150:2021(E): Position elevation (A.4.16)";
CM_ SG_ 346 RFC_Loc247_Azimuth "Location azimuth angle. Represented in conical coordinate system. Deviation from ISO 23150:2021(E): Position azimuth (A.4.16). Further details refers to DSP Location Interface definition";
CM_ SG_ 346 RFC_Loc247_DistVelocityCoVnce "Covariance of radial distance and radial velocity";
CM_ SG_ 346 RFC_Loc247_RadialDistanceVnce "Variance of Location radial distance ISO 23150:2021(E): Position radial distance - error (A.4.17)";
CM_ SG_ 346 RFC_Loc247_RadialVelocityVnce "Variance of Location radial relative velocity ISO 23150:2021(E): Relative velocity {radial distance} - error (A.4.19)";
CM_ SG_ 346 RFC_Loc247_ElevationVnce "Variance of Location elevation angle ISO 23150:2021(E): Position elevation - error (A.4.17)";
CM_ SG_ 346 RFC_Loc247_AzimuthVnce "Variance of Location azimuth angle ISO 23150:2021(E): Position azimuth - error (A.4.17)";
CM_ SG_ 346 RFC_Loc247_RadarCrossSection "Radar Cross Section (RCS) estimation ISO 23150:2021(E): Radar cross section (A.4.5)";
CM_ SG_ 346 RFC_Loc247_DistVelocityQuality "Quality of radial distance and velocity resolution processing. Physical range [0..1]";
CM_ SG_ 346 RFC_Loc247_ElevationQuality "Probability for correct signal model (elevation angle). Physical range [0..1]";
CM_ SG_ 346 RFC_Loc247_AzimuthQuality "Probability for correct signal model (azimuth angle). Physical range [0..1]";
CM_ SG_ 346 RFC_Loc247_RSSI "Received Signal Strength Indication (RSSI). This signal is not exactly ISO 23150:2021(E): Signal to noise ratio - detection level (A.4.7), but SNR can be calculated from this signal. Further detail please refer to the DSP Location Interface definition";
CM_ SG_ 346 RFC_Loc247_AzimuthalPartnerId "Id of the azimuthal partner location";
CM_ SG_ 346 RFC_Loc248_RadialDistance "Location radial distance. Represented in conical coordinate system. Same as ISO 23150:2021(E): Position radial distance (A.4.16)";
CM_ SG_ 346 RFC_Loc248_RadialVelocity "Location radial relative velocity ISO 23150:2021(E): Relative velocity {radial distance} (A.4.18)";
CM_ SG_ 346 RFC_Loc248_Elevation "Location elevation angle. Represented in conical coordinate system. Same as ISO 23150:2021(E): Position elevation (A.4.16)";
CM_ SG_ 346 RFC_Loc248_Azimuth "Location azimuth angle. Represented in conical coordinate system. Deviation from ISO 23150:2021(E): Position azimuth (A.4.16). Further details refers to DSP Location Interface definition";
CM_ SG_ 346 RFC_Loc248_DistVelocityCoVnce "Covariance of radial distance and radial velocity";
CM_ SG_ 346 RFC_Loc248_RadialDistanceVnce "Variance of Location radial distance ISO 23150:2021(E): Position radial distance - error (A.4.17)";
CM_ SG_ 346 RFC_Loc248_RadialVelocityVnce "Variance of Location radial relative velocity ISO 23150:2021(E): Relative velocity {radial distance} - error (A.4.19)";
CM_ SG_ 346 RFC_Loc248_ElevationVnce "Variance of Location elevation angle ISO 23150:2021(E): Position elevation - error (A.4.17)";
CM_ SG_ 346 RFC_Loc248_AzimuthVnce "Variance of Location azimuth angle ISO 23150:2021(E): Position azimuth - error (A.4.17)";
CM_ SG_ 346 RFC_Loc248_RadarCrossSection "Radar Cross Section (RCS) estimation ISO 23150:2021(E): Radar cross section (A.4.5)";
CM_ SG_ 346 RFC_Loc248_DistVelocityQuality "Quality of radial distance and velocity resolution processing. Physical range [0..1]";
CM_ SG_ 346 RFC_Loc248_ElevationQuality "Probability for correct signal model (elevation angle). Physical range [0..1]";
CM_ SG_ 346 RFC_Loc248_AzimuthQuality "Probability for correct signal model (azimuth angle). Physical range [0..1]";
CM_ SG_ 346 RFC_Loc248_RSSI "Received Signal Strength Indication (RSSI). This signal is not exactly ISO 23150:2021(E): Signal to noise ratio - detection level (A.4.7), but SNR can be calculated from this signal. Further detail please refer to the DSP Location Interface definition";
CM_ SG_ 346 RFC_Loc248_AzimuthalPartnerId "Id of the azimuthal partner location";
CM_ SG_ 347 RFC_Loc249_251_CRC "CRC - Autosar E2E Profile 5";
CM_ SG_ 347 RFC_Loc249_251_AliveCtr "Alive counter - Autosar E2E Profile 5";
CM_ SG_ 347 RFC_Loc249_251_ProtBlockCtr "Protocol-Signal: Block-Counter";
CM_ SG_ 347 RFC_Loc249_RadialDistance "Location radial distance. Represented in conical coordinate system. Same as ISO 23150:2021(E): Position radial distance (A.4.16)";
CM_ SG_ 347 RFC_Loc249_RadialVelocity "Location radial relative velocity ISO 23150:2021(E): Relative velocity {radial distance} (A.4.18)";
CM_ SG_ 347 RFC_Loc249_Elevation "Location elevation angle. Represented in conical coordinate system. Same as ISO 23150:2021(E): Position elevation (A.4.16)";
CM_ SG_ 347 RFC_Loc249_Azimuth "Location azimuth angle. Represented in conical coordinate system. Deviation from ISO 23150:2021(E): Position azimuth (A.4.16). Further details refers to DSP Location Interface definition";
CM_ SG_ 347 RFC_Loc249_DistVelocityCoVnce "Covariance of radial distance and radial velocity";
CM_ SG_ 347 RFC_Loc249_RadialDistanceVnce "Variance of Location radial distance ISO 23150:2021(E): Position radial distance - error (A.4.17)";
CM_ SG_ 347 RFC_Loc249_RadialVelocityVnce "Variance of Location radial relative velocity ISO 23150:2021(E): Relative velocity {radial distance} - error (A.4.19)";
CM_ SG_ 347 RFC_Loc249_ElevationVnce "Variance of Location elevation angle ISO 23150:2021(E): Position elevation - error (A.4.17)";
CM_ SG_ 347 RFC_Loc249_AzimuthVnce "Variance of Location azimuth angle ISO 23150:2021(E): Position azimuth - error (A.4.17)";
CM_ SG_ 347 RFC_Loc249_RadarCrossSection "Radar Cross Section (RCS) estimation ISO 23150:2021(E): Radar cross section (A.4.5)";
CM_ SG_ 347 RFC_Loc249_DistVelocityQuality "Quality of radial distance and velocity resolution processing. Physical range [0..1]";
CM_ SG_ 347 RFC_Loc249_ElevationQuality "Probability for correct signal model (elevation angle). Physical range [0..1]";
CM_ SG_ 347 RFC_Loc249_AzimuthQuality "Probability for correct signal model (azimuth angle). Physical range [0..1]";
CM_ SG_ 347 RFC_Loc249_RSSI "Received Signal Strength Indication (RSSI). This signal is not exactly ISO 23150:2021(E): Signal to noise ratio - detection level (A.4.7), but SNR can be calculated from this signal. Further detail please refer to the DSP Location Interface definition";
CM_ SG_ 347 RFC_Loc249_AzimuthalPartnerId "Id of the azimuthal partner location";
CM_ SG_ 347 RFC_Loc250_RadialDistance "Location radial distance. Represented in conical coordinate system. Same as ISO 23150:2021(E): Position radial distance (A.4.16)";
CM_ SG_ 347 RFC_Loc250_RadialVelocity "Location radial relative velocity ISO 23150:2021(E): Relative velocity {radial distance} (A.4.18)";
CM_ SG_ 347 RFC_Loc250_Elevation "Location elevation angle. Represented in conical coordinate system. Same as ISO 23150:2021(E): Position elevation (A.4.16)";
CM_ SG_ 347 RFC_Loc250_Azimuth "Location azimuth angle. Represented in conical coordinate system. Deviation from ISO 23150:2021(E): Position azimuth (A.4.16). Further details refers to DSP Location Interface definition";
CM_ SG_ 347 RFC_Loc250_DistVelocityCoVnce "Covariance of radial distance and radial velocity";
CM_ SG_ 347 RFC_Loc250_RadialDistanceVnce "Variance of Location radial distance ISO 23150:2021(E): Position radial distance - error (A.4.17)";
CM_ SG_ 347 RFC_Loc250_RadialVelocityVnce "Variance of Location radial relative velocity ISO 23150:2021(E): Relative velocity {radial distance} - error (A.4.19)";
CM_ SG_ 347 RFC_Loc250_ElevationVnce "Variance of Location elevation angle ISO 23150:2021(E): Position elevation - error (A.4.17)";
CM_ SG_ 347 RFC_Loc250_AzimuthVnce "Variance of Location azimuth angle ISO 23150:2021(E): Position azimuth - error (A.4.17)";
CM_ SG_ 347 RFC_Loc250_RadarCrossSection "Radar Cross Section (RCS) estimation ISO 23150:2021(E): Radar cross section (A.4.5)";
CM_ SG_ 347 RFC_Loc250_DistVelocityQuality "Quality of radial distance and velocity resolution processing. Physical range [0..1]";
CM_ SG_ 347 RFC_Loc250_ElevationQuality "Probability for correct signal model (elevation angle). Physical range [0..1]";
CM_ SG_ 347 RFC_Loc250_AzimuthQuality "Probability for correct signal model (azimuth angle). Physical range [0..1]";
CM_ SG_ 347 RFC_Loc250_RSSI "Received Signal Strength Indication (RSSI). This signal is not exactly ISO 23150:2021(E): Signal to noise ratio - detection level (A.4.7), but SNR can be calculated from this signal. Further detail please refer to the DSP Location Interface definition";
CM_ SG_ 347 RFC_Loc250_AzimuthalPartnerId "Id of the azimuthal partner location";
CM_ SG_ 347 RFC_Loc251_RadialDistance "Location radial distance. Represented in conical coordinate system. Same as ISO 23150:2021(E): Position radial distance (A.4.16)";
CM_ SG_ 347 RFC_Loc251_RadialVelocity "Location radial relative velocity ISO 23150:2021(E): Relative velocity {radial distance} (A.4.18)";
CM_ SG_ 347 RFC_Loc251_Elevation "Location elevation angle. Represented in conical coordinate system. Same as ISO 23150:2021(E): Position elevation (A.4.16)";
CM_ SG_ 347 RFC_Loc251_Azimuth "Location azimuth angle. Represented in conical coordinate system. Deviation from ISO 23150:2021(E): Position azimuth (A.4.16). Further details refers to DSP Location Interface definition";
CM_ SG_ 347 RFC_Loc251_DistVelocityCoVnce "Covariance of radial distance and radial velocity";
CM_ SG_ 347 RFC_Loc251_RadialDistanceVnce "Variance of Location radial distance ISO 23150:2021(E): Position radial distance - error (A.4.17)";
CM_ SG_ 347 RFC_Loc251_RadialVelocityVnce "Variance of Location radial relative velocity ISO 23150:2021(E): Relative velocity {radial distance} - error (A.4.19)";
CM_ SG_ 347 RFC_Loc251_ElevationVnce "Variance of Location elevation angle ISO 23150:2021(E): Position elevation - error (A.4.17)";
CM_ SG_ 347 RFC_Loc251_AzimuthVnce "Variance of Location azimuth angle ISO 23150:2021(E): Position azimuth - error (A.4.17)";
CM_ SG_ 347 RFC_Loc251_RadarCrossSection "Radar Cross Section (RCS) estimation ISO 23150:2021(E): Radar cross section (A.4.5)";
CM_ SG_ 347 RFC_Loc251_DistVelocityQuality "Quality of radial distance and velocity resolution processing. Physical range [0..1]";
CM_ SG_ 347 RFC_Loc251_ElevationQuality "Probability for correct signal model (elevation angle). Physical range [0..1]";
CM_ SG_ 347 RFC_Loc251_AzimuthQuality "Probability for correct signal model (azimuth angle). Physical range [0..1]";
CM_ SG_ 347 RFC_Loc251_RSSI "Received Signal Strength Indication (RSSI). This signal is not exactly ISO 23150:2021(E): Signal to noise ratio - detection level (A.4.7), but SNR can be calculated from this signal. Further detail please refer to the DSP Location Interface definition";
CM_ SG_ 347 RFC_Loc251_AzimuthalPartnerId "Id of the azimuthal partner location";
CM_ SG_ 348 RFC_Loc252_254_CRC "CRC - Autosar E2E Profile 5";
CM_ SG_ 348 RFC_Loc252_254_AliveCtr "Alive counter - Autosar E2E Profile 5";
CM_ SG_ 348 RFC_Loc252_254_ProtBlockCtr "Protocol-Signal: Block-Counter";
CM_ SG_ 348 RFC_Loc252_RadialDistance "Location radial distance. Represented in conical coordinate system. Same as ISO 23150:2021(E): Position radial distance (A.4.16)";
CM_ SG_ 348 RFC_Loc252_RadialVelocity "Location radial relative velocity ISO 23150:2021(E): Relative velocity {radial distance} (A.4.18)";
CM_ SG_ 348 RFC_Loc252_Elevation "Location elevation angle. Represented in conical coordinate system. Same as ISO 23150:2021(E): Position elevation (A.4.16)";
CM_ SG_ 348 RFC_Loc252_Azimuth "Location azimuth angle. Represented in conical coordinate system. Deviation from ISO 23150:2021(E): Position azimuth (A.4.16). Further details refers to DSP Location Interface definition";
CM_ SG_ 348 RFC_Loc252_DistVelocityCoVnce "Covariance of radial distance and radial velocity";
CM_ SG_ 348 RFC_Loc252_RadialDistanceVnce "Variance of Location radial distance ISO 23150:2021(E): Position radial distance - error (A.4.17)";
CM_ SG_ 348 RFC_Loc252_RadialVelocityVnce "Variance of Location radial relative velocity ISO 23150:2021(E): Relative velocity {radial distance} - error (A.4.19)";
CM_ SG_ 348 RFC_Loc252_ElevationVnce "Variance of Location elevation angle ISO 23150:2021(E): Position elevation - error (A.4.17)";
CM_ SG_ 348 RFC_Loc252_AzimuthVnce "Variance of Location azimuth angle ISO 23150:2021(E): Position azimuth - error (A.4.17)";
CM_ SG_ 348 RFC_Loc252_RadarCrossSection "Radar Cross Section (RCS) estimation ISO 23150:2021(E): Radar cross section (A.4.5)";
CM_ SG_ 348 RFC_Loc252_DistVelocityQuality "Quality of radial distance and velocity resolution processing. Physical range [0..1]";
CM_ SG_ 348 RFC_Loc252_ElevationQuality "Probability for correct signal model (elevation angle). Physical range [0..1]";
CM_ SG_ 348 RFC_Loc252_AzimuthQuality "Probability for correct signal model (azimuth angle). Physical range [0..1]";
CM_ SG_ 348 RFC_Loc252_RSSI "Received Signal Strength Indication (RSSI). This signal is not exactly ISO 23150:2021(E): Signal to noise ratio - detection level (A.4.7), but SNR can be calculated from this signal. Further detail please refer to the DSP Location Interface definition";
CM_ SG_ 348 RFC_Loc252_AzimuthalPartnerId "Id of the azimuthal partner location";
CM_ SG_ 348 RFC_Loc253_RadialDistance "Location radial distance. Represented in conical coordinate system. Same as ISO 23150:2021(E): Position radial distance (A.4.16)";
CM_ SG_ 348 RFC_Loc253_RadialVelocity "Location radial relative velocity ISO 23150:2021(E): Relative velocity {radial distance} (A.4.18)";
CM_ SG_ 348 RFC_Loc253_Elevation "Location elevation angle. Represented in conical coordinate system. Same as ISO 23150:2021(E): Position elevation (A.4.16)";
CM_ SG_ 348 RFC_Loc253_Azimuth "Location azimuth angle. Represented in conical coordinate system. Deviation from ISO 23150:2021(E): Position azimuth (A.4.16). Further details refers to DSP Location Interface definition";
CM_ SG_ 348 RFC_Loc253_DistVelocityCoVnce "Covariance of radial distance and radial velocity";
CM_ SG_ 348 RFC_Loc253_RadialDistanceVnce "Variance of Location radial distance ISO 23150:2021(E): Position radial distance - error (A.4.17)";
CM_ SG_ 348 RFC_Loc253_RadialVelocityVnce "Variance of Location radial relative velocity ISO 23150:2021(E): Relative velocity {radial distance} - error (A.4.19)";
CM_ SG_ 348 RFC_Loc253_ElevationVnce "Variance of Location elevation angle ISO 23150:2021(E): Position elevation - error (A.4.17)";
CM_ SG_ 348 RFC_Loc253_AzimuthVnce "Variance of Location azimuth angle ISO 23150:2021(E): Position azimuth - error (A.4.17)";
CM_ SG_ 348 RFC_Loc253_RadarCrossSection "Radar Cross Section (RCS) estimation ISO 23150:2021(E): Radar cross section (A.4.5)";
CM_ SG_ 348 RFC_Loc253_DistVelocityQuality "Quality of radial distance and velocity resolution processing. Physical range [0..1]";
CM_ SG_ 348 RFC_Loc253_ElevationQuality "Probability for correct signal model (elevation angle). Physical range [0..1]";
CM_ SG_ 348 RFC_Loc253_AzimuthQuality "Probability for correct signal model (azimuth angle). Physical range [0..1]";
CM_ SG_ 348 RFC_Loc253_RSSI "Received Signal Strength Indication (RSSI). This signal is not exactly ISO 23150:2021(E): Signal to noise ratio - detection level (A.4.7), but SNR can be calculated from this signal. Further detail please refer to the DSP Location Interface definition";
CM_ SG_ 348 RFC_Loc253_AzimuthalPartnerId "Id of the azimuthal partner location";
CM_ SG_ 348 RFC_Loc254_RadialDistance "Location radial distance. Represented in conical coordinate system. Same as ISO 23150:2021(E): Position radial distance (A.4.16)";
CM_ SG_ 348 RFC_Loc254_RadialVelocity "Location radial relative velocity ISO 23150:2021(E): Relative velocity {radial distance} (A.4.18)";
CM_ SG_ 348 RFC_Loc254_Elevation "Location elevation angle. Represented in conical coordinate system. Same as ISO 23150:2021(E): Position elevation (A.4.16)";
CM_ SG_ 348 RFC_Loc254_Azimuth "Location azimuth angle. Represented in conical coordinate system. Deviation from ISO 23150:2021(E): Position azimuth (A.4.16). Further details refers to DSP Location Interface definition";
CM_ SG_ 348 RFC_Loc254_DistVelocityCoVnce "Covariance of radial distance and radial velocity";
CM_ SG_ 348 RFC_Loc254_RadialDistanceVnce "Variance of Location radial distance ISO 23150:2021(E): Position radial distance - error (A.4.17)";
CM_ SG_ 348 RFC_Loc254_RadialVelocityVnce "Variance of Location radial relative velocity ISO 23150:2021(E): Relative velocity {radial distance} - error (A.4.19)";
CM_ SG_ 348 RFC_Loc254_ElevationVnce "Variance of Location elevation angle ISO 23150:2021(E): Position elevation - error (A.4.17)";
CM_ SG_ 348 RFC_Loc254_AzimuthVnce "Variance of Location azimuth angle ISO 23150:2021(E): Position azimuth - error (A.4.17)";
CM_ SG_ 348 RFC_Loc254_RadarCrossSection "Radar Cross Section (RCS) estimation ISO 23150:2021(E): Radar cross section (A.4.5)";
CM_ SG_ 348 RFC_Loc254_DistVelocityQuality "Quality of radial distance and velocity resolution processing. Physical range [0..1]";
CM_ SG_ 348 RFC_Loc254_ElevationQuality "Probability for correct signal model (elevation angle). Physical range [0..1]";
CM_ SG_ 348 RFC_Loc254_AzimuthQuality "Probability for correct signal model (azimuth angle). Physical range [0..1]";
CM_ SG_ 348 RFC_Loc254_RSSI "Received Signal Strength Indication (RSSI). This signal is not exactly ISO 23150:2021(E): Signal to noise ratio - detection level (A.4.7), but SNR can be calculated from this signal. Further detail please refer to the DSP Location Interface definition";
CM_ SG_ 348 RFC_Loc254_AzimuthalPartnerId "Id of the azimuthal partner location";
CM_ SG_ 2281601536 ImgFrameCounter "Signal for development purpose only!";
CM_ SG_ 2281601536 ImgReceptionTimer "Signal for development purpose only!";
BA_DEF_ SG_  "GenSigEnvVarType" ENUM  "int","float","undef";
BA_DEF_ SG_  "GenSigSendType" ENUM  "Cyclic","OnWrite","OnWriteWithRepetition","OnChange","OnChangeWithRepetition","IfActive","IfActiveWithRepetition";
BA_DEF_ BO_  "GenMsgCycleTimeFast" INT 2 50000;
BA_DEF_ BO_  "GenMsgILSupport" ENUM  "No","Yes";
BA_DEF_ BO_  "CANFD_BRS" ENUM  "0","1";
BA_DEF_ BO_  "GenMsgCycleTime" INT 0 65535;
BA_DEF_ BO_  "GenMsgSendType" ENUM  "Event","cyclic";
BA_DEF_ BO_  "VFrameFormat" ENUM  "StandardCAN","ExtendedCAN","reserved","reserved","reserved","reserved","reserved","reserved","reserved","reserved","reserved","reserved","reserved","reserved","StandardCAN_FD","ExtendedCAN_FD";
BA_DEF_ SG_  "GenSigStartValue" FLOAT 0 100000000000;
BA_DEF_DEF_  "GenSigEnvVarType" "undef";
BA_DEF_DEF_  "GenSigSendType" "Cyclic";
BA_DEF_DEF_  "GenMsgCycleTimeFast" 100;
BA_DEF_DEF_  "GenMsgILSupport" "Yes";
BA_DEF_DEF_  "CANFD_BRS" "1";
BA_DEF_DEF_  "GenMsgCycleTime" 0;
BA_DEF_DEF_  "GenMsgSendType" "";
BA_DEF_DEF_  "VFrameFormat" "";
BA_DEF_DEF_  "GenSigStartValue" 0;
BA_ "GenMsgSendType" BO_ 335 0;
BA_ "VFrameFormat" BO_ 335 14;
BA_ "GenMsgSendType" BO_ 336 0;
BA_ "VFrameFormat" BO_ 336 14;
BA_ "GenMsgSendType" BO_ 337 0;
BA_ "VFrameFormat" BO_ 337 14;
BA_ "GenMsgSendType" BO_ 338 0;
BA_ "VFrameFormat" BO_ 338 14;
BA_ "GenMsgSendType" BO_ 339 0;
BA_ "VFrameFormat" BO_ 339 14;
BA_ "GenMsgSendType" BO_ 340 0;
BA_ "VFrameFormat" BO_ 340 14;
BA_ "GenMsgSendType" BO_ 341 0;
BA_ "VFrameFormat" BO_ 341 14;
BA_ "GenMsgSendType" BO_ 342 0;
BA_ "VFrameFormat" BO_ 342 14;
BA_ "GenMsgSendType" BO_ 343 0;
BA_ "VFrameFormat" BO_ 343 14;
BA_ "GenMsgSendType" BO_ 344 0;
BA_ "VFrameFormat" BO_ 344 14;
BA_ "GenMsgSendType" BO_ 345 0;
BA_ "VFrameFormat" BO_ 345 14;
BA_ "GenMsgSendType" BO_ 346 0;
BA_ "VFrameFormat" BO_ 346 14;
BA_ "GenMsgSendType" BO_ 347 0;
BA_ "VFrameFormat" BO_ 347 14;
BA_ "GenMsgSendType" BO_ 348 0;
BA_ "VFrameFormat" BO_ 348 14;
BA_ "GenMsgSendType" BO_ 2281601536 1;
BA_ "GenMsgCycleTime" BO_ 2281601536 10;
BA_ "VFrameFormat" BO_ 2281601536 15;
BA_ "GenSigStartValue" SG_ 335 RFC_Loc213_RadialVelocity 16384;
BA_ "GenSigStartValue" SG_ 335 RFC_Loc213_Elevation 512;
BA_ "GenSigStartValue" SG_ 335 RFC_Loc213_Azimuth 1024;
BA_ "GenSigStartValue" SG_ 335 RFC_Loc213_DistVelocityCoVnce 1024;
BA_ "GenSigStartValue" SG_ 335 RFC_Loc213_RadarCrossSection 512;
BA_ "GenSigStartValue" SG_ 335 RFC_Loc214_RadialVelocity 16384;
BA_ "GenSigStartValue" SG_ 335 RFC_Loc214_Elevation 512;
BA_ "GenSigStartValue" SG_ 335 RFC_Loc214_Azimuth 1024;
BA_ "GenSigStartValue" SG_ 335 RFC_Loc214_DistVelocityCoVnce 1024;
BA_ "GenSigStartValue" SG_ 335 RFC_Loc214_RadarCrossSection 512;
BA_ "GenSigStartValue" SG_ 335 RFC_Loc215_RadialVelocity 16384;
BA_ "GenSigStartValue" SG_ 335 RFC_Loc215_Elevation 512;
BA_ "GenSigStartValue" SG_ 335 RFC_Loc215_Azimuth 1024;
BA_ "GenSigStartValue" SG_ 335 RFC_Loc215_DistVelocityCoVnce 1024;
BA_ "GenSigStartValue" SG_ 335 RFC_Loc215_RadarCrossSection 512;
BA_ "GenSigStartValue" SG_ 336 RFC_Loc216_RadialVelocity 16384;
BA_ "GenSigStartValue" SG_ 336 RFC_Loc216_Elevation 512;
BA_ "GenSigStartValue" SG_ 336 RFC_Loc216_Azimuth 1024;
BA_ "GenSigStartValue" SG_ 336 RFC_Loc216_DistVelocityCoVnce 1024;
BA_ "GenSigStartValue" SG_ 336 RFC_Loc216_RadarCrossSection 512;
BA_ "GenSigStartValue" SG_ 336 RFC_Loc217_RadialVelocity 16384;
BA_ "GenSigStartValue" SG_ 336 RFC_Loc217_Elevation 512;
BA_ "GenSigStartValue" SG_ 336 RFC_Loc217_Azimuth 1024;
BA_ "GenSigStartValue" SG_ 336 RFC_Loc217_DistVelocityCoVnce 1024;
BA_ "GenSigStartValue" SG_ 336 RFC_Loc217_RadarCrossSection 512;
BA_ "GenSigStartValue" SG_ 336 RFC_Loc218_RadialVelocity 16384;
BA_ "GenSigStartValue" SG_ 336 RFC_Loc218_Elevation 512;
BA_ "GenSigStartValue" SG_ 336 RFC_Loc218_Azimuth 1024;
BA_ "GenSigStartValue" SG_ 336 RFC_Loc218_DistVelocityCoVnce 1024;
BA_ "GenSigStartValue" SG_ 336 RFC_Loc218_RadarCrossSection 512;
BA_ "GenSigStartValue" SG_ 337 RFC_Loc219_RadialVelocity 16384;
BA_ "GenSigStartValue" SG_ 337 RFC_Loc219_Elevation 512;
BA_ "GenSigStartValue" SG_ 337 RFC_Loc219_Azimuth 1024;
BA_ "GenSigStartValue" SG_ 337 RFC_Loc219_DistVelocityCoVnce 1024;
BA_ "GenSigStartValue" SG_ 337 RFC_Loc219_RadarCrossSection 512;
BA_ "GenSigStartValue" SG_ 337 RFC_Loc220_RadialVelocity 16384;
BA_ "GenSigStartValue" SG_ 337 RFC_Loc220_Elevation 512;
BA_ "GenSigStartValue" SG_ 337 RFC_Loc220_Azimuth 1024;
BA_ "GenSigStartValue" SG_ 337 RFC_Loc220_DistVelocityCoVnce 1024;
BA_ "GenSigStartValue" SG_ 337 RFC_Loc220_RadarCrossSection 512;
BA_ "GenSigStartValue" SG_ 337 RFC_Loc221_RadialVelocity 16384;
BA_ "GenSigStartValue" SG_ 337 RFC_Loc221_Elevation 512;
BA_ "GenSigStartValue" SG_ 337 RFC_Loc221_Azimuth 1024;
BA_ "GenSigStartValue" SG_ 337 RFC_Loc221_DistVelocityCoVnce 1024;
BA_ "GenSigStartValue" SG_ 337 RFC_Loc221_RadarCrossSection 512;
BA_ "GenSigStartValue" SG_ 338 RFC_Loc222_RadialVelocity 16384;
BA_ "GenSigStartValue" SG_ 338 RFC_Loc222_Elevation 512;
BA_ "GenSigStartValue" SG_ 338 RFC_Loc222_Azimuth 1024;
BA_ "GenSigStartValue" SG_ 338 RFC_Loc222_DistVelocityCoVnce 1024;
BA_ "GenSigStartValue" SG_ 338 RFC_Loc222_RadarCrossSection 512;
BA_ "GenSigStartValue" SG_ 338 RFC_Loc223_RadialVelocity 16384;
BA_ "GenSigStartValue" SG_ 338 RFC_Loc223_Elevation 512;
BA_ "GenSigStartValue" SG_ 338 RFC_Loc223_Azimuth 1024;
BA_ "GenSigStartValue" SG_ 338 RFC_Loc223_DistVelocityCoVnce 1024;
BA_ "GenSigStartValue" SG_ 338 RFC_Loc223_RadarCrossSection 512;
BA_ "GenSigStartValue" SG_ 338 RFC_Loc224_RadialVelocity 16384;
BA_ "GenSigStartValue" SG_ 338 RFC_Loc224_Elevation 512;
BA_ "GenSigStartValue" SG_ 338 RFC_Loc224_Azimuth 1024;
BA_ "GenSigStartValue" SG_ 338 RFC_Loc224_DistVelocityCoVnce 1024;
BA_ "GenSigStartValue" SG_ 338 RFC_Loc224_RadarCrossSection 512;
BA_ "GenSigStartValue" SG_ 339 RFC_Loc225_RadialVelocity 16384;
BA_ "GenSigStartValue" SG_ 339 RFC_Loc225_Elevation 512;
BA_ "GenSigStartValue" SG_ 339 RFC_Loc225_Azimuth 1024;
BA_ "GenSigStartValue" SG_ 339 RFC_Loc225_DistVelocityCoVnce 1024;
BA_ "GenSigStartValue" SG_ 339 RFC_Loc225_RadarCrossSection 512;
BA_ "GenSigStartValue" SG_ 339 RFC_Loc226_RadialVelocity 16384;
BA_ "GenSigStartValue" SG_ 339 RFC_Loc226_Elevation 512;
BA_ "GenSigStartValue" SG_ 339 RFC_Loc226_Azimuth 1024;
BA_ "GenSigStartValue" SG_ 339 RFC_Loc226_DistVelocityCoVnce 1024;
BA_ "GenSigStartValue" SG_ 339 RFC_Loc226_RadarCrossSection 512;
BA_ "GenSigStartValue" SG_ 339 RFC_Loc227_RadialVelocity 16384;
BA_ "GenSigStartValue" SG_ 339 RFC_Loc227_Elevation 512;
BA_ "GenSigStartValue" SG_ 339 RFC_Loc227_Azimuth 1024;
BA_ "GenSigStartValue" SG_ 339 RFC_Loc227_DistVelocityCoVnce 1024;
BA_ "GenSigStartValue" SG_ 339 RFC_Loc227_RadarCrossSection 512;
BA_ "GenSigStartValue" SG_ 340 RFC_Loc228_RadialVelocity 16384;
BA_ "GenSigStartValue" SG_ 340 RFC_Loc228_Elevation 512;
BA_ "GenSigStartValue" SG_ 340 RFC_Loc228_Azimuth 1024;
BA_ "GenSigStartValue" SG_ 340 RFC_Loc228_DistVelocityCoVnce 1024;
BA_ "GenSigStartValue" SG_ 340 RFC_Loc228_RadarCrossSection 512;
BA_ "GenSigStartValue" SG_ 340 RFC_Loc229_RadialVelocity 16384;
BA_ "GenSigStartValue" SG_ 340 RFC_Loc229_Elevation 512;
BA_ "GenSigStartValue" SG_ 340 RFC_Loc229_Azimuth 1024;
BA_ "GenSigStartValue" SG_ 340 RFC_Loc229_DistVelocityCoVnce 1024;
BA_ "GenSigStartValue" SG_ 340 RFC_Loc229_RadarCrossSection 512;
BA_ "GenSigStartValue" SG_ 340 RFC_Loc230_RadialVelocity 16384;
BA_ "GenSigStartValue" SG_ 340 RFC_Loc230_Elevation 512;
BA_ "GenSigStartValue" SG_ 340 RFC_Loc230_Azimuth 1024;
BA_ "GenSigStartValue" SG_ 340 RFC_Loc230_DistVelocityCoVnce 1024;
BA_ "GenSigStartValue" SG_ 340 RFC_Loc230_RadarCrossSection 512;
BA_ "GenSigStartValue" SG_ 341 RFC_Loc231_RadialVelocity 16384;
BA_ "GenSigStartValue" SG_ 341 RFC_Loc231_Elevation 512;
BA_ "GenSigStartValue" SG_ 341 RFC_Loc231_Azimuth 1024;
BA_ "GenSigStartValue" SG_ 341 RFC_Loc231_DistVelocityCoVnce 1024;
BA_ "GenSigStartValue" SG_ 341 RFC_Loc231_RadarCrossSection 512;
BA_ "GenSigStartValue" SG_ 341 RFC_Loc232_RadialVelocity 16384;
BA_ "GenSigStartValue" SG_ 341 RFC_Loc232_Elevation 512;
BA_ "GenSigStartValue" SG_ 341 RFC_Loc232_Azimuth 1024;
BA_ "GenSigStartValue" SG_ 341 RFC_Loc232_DistVelocityCoVnce 1024;
BA_ "GenSigStartValue" SG_ 341 RFC_Loc232_RadarCrossSection 512;
BA_ "GenSigStartValue" SG_ 341 RFC_Loc233_RadialVelocity 16384;
BA_ "GenSigStartValue" SG_ 341 RFC_Loc233_Elevation 512;
BA_ "GenSigStartValue" SG_ 341 RFC_Loc233_Azimuth 1024;
BA_ "GenSigStartValue" SG_ 341 RFC_Loc233_DistVelocityCoVnce 1024;
BA_ "GenSigStartValue" SG_ 341 RFC_Loc233_RadarCrossSection 512;
BA_ "GenSigStartValue" SG_ 342 RFC_Loc234_RadialVelocity 16384;
BA_ "GenSigStartValue" SG_ 342 RFC_Loc234_Elevation 512;
BA_ "GenSigStartValue" SG_ 342 RFC_Loc234_Azimuth 1024;
BA_ "GenSigStartValue" SG_ 342 RFC_Loc234_DistVelocityCoVnce 1024;
BA_ "GenSigStartValue" SG_ 342 RFC_Loc234_RadarCrossSection 512;
BA_ "GenSigStartValue" SG_ 342 RFC_Loc235_RadialVelocity 16384;
BA_ "GenSigStartValue" SG_ 342 RFC_Loc235_Elevation 512;
BA_ "GenSigStartValue" SG_ 342 RFC_Loc235_Azimuth 1024;
BA_ "GenSigStartValue" SG_ 342 RFC_Loc235_DistVelocityCoVnce 1024;
BA_ "GenSigStartValue" SG_ 342 RFC_Loc235_RadarCrossSection 512;
BA_ "GenSigStartValue" SG_ 342 RFC_Loc236_RadialVelocity 16384;
BA_ "GenSigStartValue" SG_ 342 RFC_Loc236_Elevation 512;
BA_ "GenSigStartValue" SG_ 342 RFC_Loc236_Azimuth 1024;
BA_ "GenSigStartValue" SG_ 342 RFC_Loc236_DistVelocityCoVnce 1024;
BA_ "GenSigStartValue" SG_ 342 RFC_Loc236_RadarCrossSection 512;
BA_ "GenSigStartValue" SG_ 343 RFC_Loc237_RadialVelocity 16384;
BA_ "GenSigStartValue" SG_ 343 RFC_Loc237_Elevation 512;
BA_ "GenSigStartValue" SG_ 343 RFC_Loc237_Azimuth 1024;
BA_ "GenSigStartValue" SG_ 343 RFC_Loc237_DistVelocityCoVnce 1024;
BA_ "GenSigStartValue" SG_ 343 RFC_Loc237_RadarCrossSection 512;
BA_ "GenSigStartValue" SG_ 343 RFC_Loc238_RadialVelocity 16384;
BA_ "GenSigStartValue" SG_ 343 RFC_Loc238_Elevation 512;
BA_ "GenSigStartValue" SG_ 343 RFC_Loc238_Azimuth 1024;
BA_ "GenSigStartValue" SG_ 343 RFC_Loc238_DistVelocityCoVnce 1024;
BA_ "GenSigStartValue" SG_ 343 RFC_Loc238_RadarCrossSection 512;
BA_ "GenSigStartValue" SG_ 343 RFC_Loc239_RadialVelocity 16384;
BA_ "GenSigStartValue" SG_ 343 RFC_Loc239_Elevation 512;
BA_ "GenSigStartValue" SG_ 343 RFC_Loc239_Azimuth 1024;
BA_ "GenSigStartValue" SG_ 343 RFC_Loc239_DistVelocityCoVnce 1024;
BA_ "GenSigStartValue" SG_ 343 RFC_Loc239_RadarCrossSection 512;
BA_ "GenSigStartValue" SG_ 344 RFC_Loc240_RadialVelocity 16384;
BA_ "GenSigStartValue" SG_ 344 RFC_Loc240_Elevation 512;
BA_ "GenSigStartValue" SG_ 344 RFC_Loc240_Azimuth 1024;
BA_ "GenSigStartValue" SG_ 344 RFC_Loc240_DistVelocityCoVnce 1024;
BA_ "GenSigStartValue" SG_ 344 RFC_Loc240_RadarCrossSection 512;
BA_ "GenSigStartValue" SG_ 344 RFC_Loc241_RadialVelocity 16384;
BA_ "GenSigStartValue" SG_ 344 RFC_Loc241_Elevation 512;
BA_ "GenSigStartValue" SG_ 344 RFC_Loc241_Azimuth 1024;
BA_ "GenSigStartValue" SG_ 344 RFC_Loc241_DistVelocityCoVnce 1024;
BA_ "GenSigStartValue" SG_ 344 RFC_Loc241_RadarCrossSection 512;
BA_ "GenSigStartValue" SG_ 344 RFC_Loc242_RadialVelocity 16384;
BA_ "GenSigStartValue" SG_ 344 RFC_Loc242_Elevation 512;
BA_ "GenSigStartValue" SG_ 344 RFC_Loc242_Azimuth 1024;
BA_ "GenSigStartValue" SG_ 344 RFC_Loc242_DistVelocityCoVnce 1024;
BA_ "GenSigStartValue" SG_ 344 RFC_Loc242_RadarCrossSection 512;
BA_ "GenSigStartValue" SG_ 345 RFC_Loc243_RadialVelocity 16384;
BA_ "GenSigStartValue" SG_ 345 RFC_Loc243_Elevation 512;
BA_ "GenSigStartValue" SG_ 345 RFC_Loc243_Azimuth 1024;
BA_ "GenSigStartValue" SG_ 345 RFC_Loc243_DistVelocityCoVnce 1024;
BA_ "GenSigStartValue" SG_ 345 RFC_Loc243_RadarCrossSection 512;
BA_ "GenSigStartValue" SG_ 345 RFC_Loc244_RadialVelocity 16384;
BA_ "GenSigStartValue" SG_ 345 RFC_Loc244_Elevation 512;
BA_ "GenSigStartValue" SG_ 345 RFC_Loc244_Azimuth 1024;
BA_ "GenSigStartValue" SG_ 345 RFC_Loc244_DistVelocityCoVnce 1024;
BA_ "GenSigStartValue" SG_ 345 RFC_Loc244_RadarCrossSection 512;
BA_ "GenSigStartValue" SG_ 345 RFC_Loc245_RadialVelocity 16384;
BA_ "GenSigStartValue" SG_ 345 RFC_Loc245_Elevation 512;
BA_ "GenSigStartValue" SG_ 345 RFC_Loc245_Azimuth 1024;
BA_ "GenSigStartValue" SG_ 345 RFC_Loc245_DistVelocityCoVnce 1024;
BA_ "GenSigStartValue" SG_ 345 RFC_Loc245_RadarCrossSection 512;
BA_ "GenSigStartValue" SG_ 346 RFC_Loc246_RadialVelocity 16384;
BA_ "GenSigStartValue" SG_ 346 RFC_Loc246_Elevation 512;
BA_ "GenSigStartValue" SG_ 346 RFC_Loc246_Azimuth 1024;
BA_ "GenSigStartValue" SG_ 346 RFC_Loc246_DistVelocityCoVnce 1024;
BA_ "GenSigStartValue" SG_ 346 RFC_Loc246_RadarCrossSection 512;
BA_ "GenSigStartValue" SG_ 346 RFC_Loc247_RadialVelocity 16384;
BA_ "GenSigStartValue" SG_ 346 RFC_Loc247_Elevation 512;
BA_ "GenSigStartValue" SG_ 346 RFC_Loc247_Azimuth 1024;
BA_ "GenSigStartValue" SG_ 346 RFC_Loc247_DistVelocityCoVnce 1024;
BA_ "GenSigStartValue" SG_ 346 RFC_Loc247_RadarCrossSection 512;
BA_ "GenSigStartValue" SG_ 346 RFC_Loc248_RadialVelocity 16384;
BA_ "GenSigStartValue" SG_ 346 RFC_Loc248_Elevation 512;
BA_ "GenSigStartValue" SG_ 346 RFC_Loc248_Azimuth 1024;
BA_ "GenSigStartValue" SG_ 346 RFC_Loc248_DistVelocityCoVnce 1024;
BA_ "GenSigStartValue" SG_ 346 RFC_Loc248_RadarCrossSection 512;
BA_ "GenSigStartValue" SG_ 347 RFC_Loc249_RadialVelocity 16384;
BA_ "GenSigStartValue" SG_ 347 RFC_Loc249_Elevation 512;
BA_ "GenSigStartValue" SG_ 347 RFC_Loc249_Azimuth 1024;
BA_ "GenSigStartValue" SG_ 347 RFC_Loc249_DistVelocityCoVnce 1024;
BA_ "GenSigStartValue" SG_ 347 RFC_Loc249_RadarCrossSection 512;
BA_ "GenSigStartValue" SG_ 347 RFC_Loc250_RadialVelocity 16384;
BA_ "GenSigStartValue" SG_ 347 RFC_Loc250_Elevation 512;
BA_ "GenSigStartValue" SG_ 347 RFC_Loc250_Azimuth 1024;
BA_ "GenSigStartValue" SG_ 347 RFC_Loc250_DistVelocityCoVnce 1024;
BA_ "GenSigStartValue" SG_ 347 RFC_Loc250_RadarCrossSection 512;
BA_ "GenSigStartValue" SG_ 347 RFC_Loc251_RadialVelocity 16384;
BA_ "GenSigStartValue" SG_ 347 RFC_Loc251_Elevation 512;
BA_ "GenSigStartValue" SG_ 347 RFC_Loc251_Azimuth 1024;
BA_ "GenSigStartValue" SG_ 347 RFC_Loc251_DistVelocityCoVnce 1024;
BA_ "GenSigStartValue" SG_ 347 RFC_Loc251_RadarCrossSection 512;
BA_ "GenSigStartValue" SG_ 348 RFC_Loc252_RadialVelocity 16384;
BA_ "GenSigStartValue" SG_ 348 RFC_Loc252_Elevation 512;
BA_ "GenSigStartValue" SG_ 348 RFC_Loc252_Azimuth 1024;
BA_ "GenSigStartValue" SG_ 348 RFC_Loc252_DistVelocityCoVnce 1024;
BA_ "GenSigStartValue" SG_ 348 RFC_Loc252_RadarCrossSection 512;
BA_ "GenSigStartValue" SG_ 348 RFC_Loc253_RadialVelocity 16384;
BA_ "GenSigStartValue" SG_ 348 RFC_Loc253_Elevation 512;
BA_ "GenSigStartValue" SG_ 348 RFC_Loc253_Azimuth 1024;
BA_ "GenSigStartValue" SG_ 348 RFC_Loc253_DistVelocityCoVnce 1024;
BA_ "GenSigStartValue" SG_ 348 RFC_Loc253_RadarCrossSection 512;
BA_ "GenSigStartValue" SG_ 348 RFC_Loc254_RadialVelocity 16384;
BA_ "GenSigStartValue" SG_ 348 RFC_Loc254_Elevation 512;
BA_ "GenSigStartValue" SG_ 348 RFC_Loc254_Azimuth 1024;
BA_ "GenSigStartValue" SG_ 348 RFC_Loc254_DistVelocityCoVnce 1024;
BA_ "GenSigStartValue" SG_ 348 RFC_Loc254_RadarCrossSection 512;
SIG_GROUP_ 335 SG_RFC_Location_213_215 1 : RFC_Loc213_215_CRC RFC_Loc213_215_AliveCtr RFC_Loc213_215_ProtBlockCtr RFC_Loc213_RadialDistance RFC_Loc213_RadialVelocity RFC_Loc213_Elevation RFC_Loc213_Azimuth RFC_Loc213_DistVelocityCoVnce RFC_Loc213_RadialDistanceVnce RFC_Loc213_RadialVelocityVnce RFC_Loc213_ElevationVnce RFC_Loc213_AzimuthVnce RFC_Loc213_RadarCrossSection RFC_Loc213_DistVelocityQuality RFC_Loc213_ElevationQuality RFC_Loc213_AzimuthQuality RFC_Loc213_RSSI RFC_Loc213_AzimuthalPartnerId RFC_Loc214_RadialDistance RFC_Loc214_RadialVelocity RFC_Loc214_Elevation RFC_Loc214_Azimuth RFC_Loc214_DistVelocityCoVnce RFC_Loc214_RadialDistanceVnce RFC_Loc214_RadialVelocityVnce RFC_Loc214_ElevationVnce RFC_Loc214_AzimuthVnce RFC_Loc214_RadarCrossSection RFC_Loc214_DistVelocityQuality RFC_Loc214_ElevationQuality RFC_Loc214_AzimuthQuality RFC_Loc214_RSSI RFC_Loc214_AzimuthalPartnerId RFC_Loc215_RadialDistance RFC_Loc215_RadialVelocity RFC_Loc215_Elevation RFC_Loc215_Azimuth RFC_Loc215_DistVelocityCoVnce RFC_Loc215_RadialDistanceVnce RFC_Loc215_RadialVelocityVnce RFC_Loc215_ElevationVnce RFC_Loc215_AzimuthVnce RFC_Loc215_RadarCrossSection RFC_Loc215_DistVelocityQuality RFC_Loc215_ElevationQuality RFC_Loc215_AzimuthQuality RFC_Loc215_RSSI RFC_Loc215_AzimuthalPartnerId;
SIG_GROUP_ 336 SG_RFC_Location_216_218 1 : RFC_Loc216_218_CRC RFC_Loc216_218_AliveCtr RFC_Loc216_218_ProtBlockCtr RFC_Loc216_RadialDistance RFC_Loc216_RadialVelocity RFC_Loc216_Elevation RFC_Loc216_Azimuth RFC_Loc216_DistVelocityCoVnce RFC_Loc216_RadialDistanceVnce RFC_Loc216_RadialVelocityVnce RFC_Loc216_ElevationVnce RFC_Loc216_AzimuthVnce RFC_Loc216_RadarCrossSection RFC_Loc216_DistVelocityQuality RFC_Loc216_ElevationQuality RFC_Loc216_AzimuthQuality RFC_Loc216_RSSI RFC_Loc216_AzimuthalPartnerId RFC_Loc217_RadialDistance RFC_Loc217_RadialVelocity RFC_Loc217_Elevation RFC_Loc217_Azimuth RFC_Loc217_DistVelocityCoVnce RFC_Loc217_RadialDistanceVnce RFC_Loc217_RadialVelocityVnce RFC_Loc217_ElevationVnce RFC_Loc217_AzimuthVnce RFC_Loc217_RadarCrossSection RFC_Loc217_DistVelocityQuality RFC_Loc217_ElevationQuality RFC_Loc217_AzimuthQuality RFC_Loc217_RSSI RFC_Loc217_AzimuthalPartnerId RFC_Loc218_RadialDistance RFC_Loc218_RadialVelocity RFC_Loc218_Elevation RFC_Loc218_Azimuth RFC_Loc218_DistVelocityCoVnce RFC_Loc218_RadialDistanceVnce RFC_Loc218_RadialVelocityVnce RFC_Loc218_ElevationVnce RFC_Loc218_AzimuthVnce RFC_Loc218_RadarCrossSection RFC_Loc218_DistVelocityQuality RFC_Loc218_ElevationQuality RFC_Loc218_AzimuthQuality RFC_Loc218_RSSI RFC_Loc218_AzimuthalPartnerId;
SIG_GROUP_ 337 SG_RFC_Location_219_221 1 : RFC_Loc219_221_CRC RFC_Loc219_221_AliveCtr RFC_Loc219_221_ProtBlockCtr RFC_Loc219_RadialDistance RFC_Loc219_RadialVelocity RFC_Loc219_Elevation RFC_Loc219_Azimuth RFC_Loc219_DistVelocityCoVnce RFC_Loc219_RadialDistanceVnce RFC_Loc219_RadialVelocityVnce RFC_Loc219_ElevationVnce RFC_Loc219_AzimuthVnce RFC_Loc219_RadarCrossSection RFC_Loc219_DistVelocityQuality RFC_Loc219_ElevationQuality RFC_Loc219_AzimuthQuality RFC_Loc219_RSSI RFC_Loc219_AzimuthalPartnerId RFC_Loc220_RadialDistance RFC_Loc220_RadialVelocity RFC_Loc220_Elevation RFC_Loc220_Azimuth RFC_Loc220_DistVelocityCoVnce RFC_Loc220_RadialDistanceVnce RFC_Loc220_RadialVelocityVnce RFC_Loc220_ElevationVnce RFC_Loc220_AzimuthVnce RFC_Loc220_RadarCrossSection RFC_Loc220_DistVelocityQuality RFC_Loc220_ElevationQuality RFC_Loc220_AzimuthQuality RFC_Loc220_RSSI RFC_Loc220_AzimuthalPartnerId RFC_Loc221_RadialDistance RFC_Loc221_RadialVelocity RFC_Loc221_Elevation RFC_Loc221_Azimuth RFC_Loc221_DistVelocityCoVnce RFC_Loc221_RadialDistanceVnce RFC_Loc221_RadialVelocityVnce RFC_Loc221_ElevationVnce RFC_Loc221_AzimuthVnce RFC_Loc221_RadarCrossSection RFC_Loc221_DistVelocityQuality RFC_Loc221_ElevationQuality RFC_Loc221_AzimuthQuality RFC_Loc221_RSSI RFC_Loc221_AzimuthalPartnerId;
SIG_GROUP_ 338 SG_RFC_Location_222_224 1 : RFC_Loc222_224_CRC RFC_Loc222_224_AliveCtr RFC_Loc222_224_ProtBlockCtr RFC_Loc222_RadialDistance RFC_Loc222_RadialVelocity RFC_Loc222_Elevation RFC_Loc222_Azimuth RFC_Loc222_DistVelocityCoVnce RFC_Loc222_RadialDistanceVnce RFC_Loc222_RadialVelocityVnce RFC_Loc222_ElevationVnce RFC_Loc222_AzimuthVnce RFC_Loc222_RadarCrossSection RFC_Loc222_DistVelocityQuality RFC_Loc222_ElevationQuality RFC_Loc222_AzimuthQuality RFC_Loc222_RSSI RFC_Loc222_AzimuthalPartnerId RFC_Loc223_RadialDistance RFC_Loc223_RadialVelocity RFC_Loc223_Elevation RFC_Loc223_Azimuth RFC_Loc223_DistVelocityCoVnce RFC_Loc223_RadialDistanceVnce RFC_Loc223_RadialVelocityVnce RFC_Loc223_ElevationVnce RFC_Loc223_AzimuthVnce RFC_Loc223_RadarCrossSection RFC_Loc223_DistVelocityQuality RFC_Loc223_ElevationQuality RFC_Loc223_AzimuthQuality RFC_Loc223_RSSI RFC_Loc223_AzimuthalPartnerId RFC_Loc224_RadialDistance RFC_Loc224_RadialVelocity RFC_Loc224_Elevation RFC_Loc224_Azimuth RFC_Loc224_DistVelocityCoVnce RFC_Loc224_RadialDistanceVnce RFC_Loc224_RadialVelocityVnce RFC_Loc224_ElevationVnce RFC_Loc224_AzimuthVnce RFC_Loc224_RadarCrossSection RFC_Loc224_DistVelocityQuality RFC_Loc224_ElevationQuality RFC_Loc224_AzimuthQuality RFC_Loc224_RSSI RFC_Loc224_AzimuthalPartnerId;
SIG_GROUP_ 339 SG_RFC_Location_225_227 1 : RFC_Loc225_227_CRC RFC_Loc225_227_AliveCtr RFC_Loc225_227_ProtBlockCtr RFC_Loc225_RadialDistance RFC_Loc225_RadialVelocity RFC_Loc225_Elevation RFC_Loc225_Azimuth RFC_Loc225_DistVelocityCoVnce RFC_Loc225_RadialDistanceVnce RFC_Loc225_RadialVelocityVnce RFC_Loc225_ElevationVnce RFC_Loc225_AzimuthVnce RFC_Loc225_RadarCrossSection RFC_Loc225_DistVelocityQuality RFC_Loc225_ElevationQuality RFC_Loc225_AzimuthQuality RFC_Loc225_RSSI RFC_Loc225_AzimuthalPartnerId RFC_Loc226_RadialDistance RFC_Loc226_RadialVelocity RFC_Loc226_Elevation RFC_Loc226_Azimuth RFC_Loc226_DistVelocityCoVnce RFC_Loc226_RadialDistanceVnce RFC_Loc226_RadialVelocityVnce RFC_Loc226_ElevationVnce RFC_Loc226_AzimuthVnce RFC_Loc226_RadarCrossSection RFC_Loc226_DistVelocityQuality RFC_Loc226_ElevationQuality RFC_Loc226_AzimuthQuality RFC_Loc226_RSSI RFC_Loc226_AzimuthalPartnerId RFC_Loc227_RadialDistance RFC_Loc227_RadialVelocity RFC_Loc227_Elevation RFC_Loc227_Azimuth RFC_Loc227_DistVelocityCoVnce RFC_Loc227_RadialDistanceVnce RFC_Loc227_RadialVelocityVnce RFC_Loc227_ElevationVnce RFC_Loc227_AzimuthVnce RFC_Loc227_RadarCrossSection RFC_Loc227_DistVelocityQuality RFC_Loc227_ElevationQuality RFC_Loc227_AzimuthQuality RFC_Loc227_RSSI RFC_Loc227_AzimuthalPartnerId;
SIG_GROUP_ 340 SG_RFC_Location_228_230 1 : RFC_Loc228_230_CRC RFC_Loc228_230_AliveCtr RFC_Loc228_230_ProtBlockCtr RFC_Loc228_RadialDistance RFC_Loc228_RadialVelocity RFC_Loc228_Elevation RFC_Loc228_Azimuth RFC_Loc228_DistVelocityCoVnce RFC_Loc228_RadialDistanceVnce RFC_Loc228_RadialVelocityVnce RFC_Loc228_ElevationVnce RFC_Loc228_AzimuthVnce RFC_Loc228_RadarCrossSection RFC_Loc228_DistVelocityQuality RFC_Loc228_ElevationQuality RFC_Loc228_AzimuthQuality RFC_Loc228_RSSI RFC_Loc228_AzimuthalPartnerId RFC_Loc229_RadialDistance RFC_Loc229_RadialVelocity RFC_Loc229_Elevation RFC_Loc229_Azimuth RFC_Loc229_DistVelocityCoVnce RFC_Loc229_RadialDistanceVnce RFC_Loc229_RadialVelocityVnce RFC_Loc229_ElevationVnce RFC_Loc229_AzimuthVnce RFC_Loc229_RadarCrossSection RFC_Loc229_DistVelocityQuality RFC_Loc229_ElevationQuality RFC_Loc229_AzimuthQuality RFC_Loc229_RSSI RFC_Loc229_AzimuthalPartnerId RFC_Loc230_RadialDistance RFC_Loc230_RadialVelocity RFC_Loc230_Elevation RFC_Loc230_Azimuth RFC_Loc230_DistVelocityCoVnce RFC_Loc230_RadialDistanceVnce RFC_Loc230_RadialVelocityVnce RFC_Loc230_ElevationVnce RFC_Loc230_AzimuthVnce RFC_Loc230_RadarCrossSection RFC_Loc230_DistVelocityQuality RFC_Loc230_ElevationQuality RFC_Loc230_AzimuthQuality RFC_Loc230_RSSI RFC_Loc230_AzimuthalPartnerId;
SIG_GROUP_ 341 SG_RFC_Location_231_233 1 : RFC_Loc231_233_CRC RFC_Loc231_233_AliveCtr RFC_Loc231_233_ProtBlockCtr RFC_Loc231_RadialDistance RFC_Loc231_RadialVelocity RFC_Loc231_Elevation RFC_Loc231_Azimuth RFC_Loc231_DistVelocityCoVnce RFC_Loc231_RadialDistanceVnce RFC_Loc231_RadialVelocityVnce RFC_Loc231_ElevationVnce RFC_Loc231_AzimuthVnce RFC_Loc231_RadarCrossSection RFC_Loc231_DistVelocityQuality RFC_Loc231_ElevationQuality RFC_Loc231_AzimuthQuality RFC_Loc231_RSSI RFC_Loc231_AzimuthalPartnerId RFC_Loc232_RadialDistance RFC_Loc232_RadialVelocity RFC_Loc232_Elevation RFC_Loc232_Azimuth RFC_Loc232_DistVelocityCoVnce RFC_Loc232_RadialDistanceVnce RFC_Loc232_RadialVelocityVnce RFC_Loc232_ElevationVnce RFC_Loc232_AzimuthVnce RFC_Loc232_RadarCrossSection RFC_Loc232_DistVelocityQuality RFC_Loc232_ElevationQuality RFC_Loc232_AzimuthQuality RFC_Loc232_RSSI RFC_Loc232_AzimuthalPartnerId RFC_Loc233_RadialDistance RFC_Loc233_RadialVelocity RFC_Loc233_Elevation RFC_Loc233_Azimuth RFC_Loc233_DistVelocityCoVnce RFC_Loc233_RadialDistanceVnce RFC_Loc233_RadialVelocityVnce RFC_Loc233_ElevationVnce RFC_Loc233_AzimuthVnce RFC_Loc233_RadarCrossSection RFC_Loc233_DistVelocityQuality RFC_Loc233_ElevationQuality RFC_Loc233_AzimuthQuality RFC_Loc233_RSSI RFC_Loc233_AzimuthalPartnerId;
SIG_GROUP_ 342 SG_RFC_Location_234_236 1 : RFC_Loc234_236_CRC RFC_Loc234_236_AliveCtr RFC_Loc234_236_ProtBlockCtr RFC_Loc234_RadialDistance RFC_Loc234_RadialVelocity RFC_Loc234_Elevation RFC_Loc234_Azimuth RFC_Loc234_DistVelocityCoVnce RFC_Loc234_RadialDistanceVnce RFC_Loc234_RadialVelocityVnce RFC_Loc234_ElevationVnce RFC_Loc234_AzimuthVnce RFC_Loc234_RadarCrossSection RFC_Loc234_DistVelocityQuality RFC_Loc234_ElevationQuality RFC_Loc234_AzimuthQuality RFC_Loc234_RSSI RFC_Loc234_AzimuthalPartnerId RFC_Loc235_RadialDistance RFC_Loc235_RadialVelocity RFC_Loc235_Elevation RFC_Loc235_Azimuth RFC_Loc235_DistVelocityCoVnce RFC_Loc235_RadialDistanceVnce RFC_Loc235_RadialVelocityVnce RFC_Loc235_ElevationVnce RFC_Loc235_AzimuthVnce RFC_Loc235_RadarCrossSection RFC_Loc235_DistVelocityQuality RFC_Loc235_ElevationQuality RFC_Loc235_AzimuthQuality RFC_Loc235_RSSI RFC_Loc235_AzimuthalPartnerId RFC_Loc236_RadialDistance RFC_Loc236_RadialVelocity RFC_Loc236_Elevation RFC_Loc236_Azimuth RFC_Loc236_DistVelocityCoVnce RFC_Loc236_RadialDistanceVnce RFC_Loc236_RadialVelocityVnce RFC_Loc236_ElevationVnce RFC_Loc236_AzimuthVnce RFC_Loc236_RadarCrossSection RFC_Loc236_DistVelocityQuality RFC_Loc236_ElevationQuality RFC_Loc236_AzimuthQuality RFC_Loc236_RSSI RFC_Loc236_AzimuthalPartnerId;
SIG_GROUP_ 343 SG_RFC_Location_237_239 1 : RFC_Loc237_239_CRC RFC_Loc237_239_AliveCtr RFC_Loc237_239_ProtBlockCtr RFC_Loc237_RadialDistance RFC_Loc237_RadialVelocity RFC_Loc237_Elevation RFC_Loc237_Azimuth RFC_Loc237_DistVelocityCoVnce RFC_Loc237_RadialDistanceVnce RFC_Loc237_RadialVelocityVnce RFC_Loc237_ElevationVnce RFC_Loc237_AzimuthVnce RFC_Loc237_RadarCrossSection RFC_Loc237_DistVelocityQuality RFC_Loc237_ElevationQuality RFC_Loc237_AzimuthQuality RFC_Loc237_RSSI RFC_Loc237_AzimuthalPartnerId RFC_Loc238_RadialDistance RFC_Loc238_RadialVelocity RFC_Loc238_Elevation RFC_Loc238_Azimuth RFC_Loc238_DistVelocityCoVnce RFC_Loc238_RadialDistanceVnce RFC_Loc238_RadialVelocityVnce RFC_Loc238_ElevationVnce RFC_Loc238_AzimuthVnce RFC_Loc238_RadarCrossSection RFC_Loc238_DistVelocityQuality RFC_Loc238_ElevationQuality RFC_Loc238_AzimuthQuality RFC_Loc238_RSSI RFC_Loc238_AzimuthalPartnerId RFC_Loc239_RadialDistance RFC_Loc239_RadialVelocity RFC_Loc239_Elevation RFC_Loc239_Azimuth RFC_Loc239_DistVelocityCoVnce RFC_Loc239_RadialDistanceVnce RFC_Loc239_RadialVelocityVnce RFC_Loc239_ElevationVnce RFC_Loc239_AzimuthVnce RFC_Loc239_RadarCrossSection RFC_Loc239_DistVelocityQuality RFC_Loc239_ElevationQuality RFC_Loc239_AzimuthQuality RFC_Loc239_RSSI RFC_Loc239_AzimuthalPartnerId;
SIG_GROUP_ 344 SG_RFC_Location_240_242 1 : RFC_Loc240_242_CRC RFC_Loc240_242_AliveCtr RFC_Loc240_242_ProtBlockCtr RFC_Loc240_RadialDistance RFC_Loc240_RadialVelocity RFC_Loc240_Elevation RFC_Loc240_Azimuth RFC_Loc240_DistVelocityCoVnce RFC_Loc240_RadialDistanceVnce RFC_Loc240_RadialVelocityVnce RFC_Loc240_ElevationVnce RFC_Loc240_AzimuthVnce RFC_Loc240_RadarCrossSection RFC_Loc240_DistVelocityQuality RFC_Loc240_ElevationQuality RFC_Loc240_AzimuthQuality RFC_Loc240_RSSI RFC_Loc240_AzimuthalPartnerId RFC_Loc241_RadialDistance RFC_Loc241_RadialVelocity RFC_Loc241_Elevation RFC_Loc241_Azimuth RFC_Loc241_DistVelocityCoVnce RFC_Loc241_RadialDistanceVnce RFC_Loc241_RadialVelocityVnce RFC_Loc241_ElevationVnce RFC_Loc241_AzimuthVnce RFC_Loc241_RadarCrossSection RFC_Loc241_DistVelocityQuality RFC_Loc241_ElevationQuality RFC_Loc241_AzimuthQuality RFC_Loc241_RSSI RFC_Loc241_AzimuthalPartnerId RFC_Loc242_RadialDistance RFC_Loc242_RadialVelocity RFC_Loc242_Elevation RFC_Loc242_Azimuth RFC_Loc242_DistVelocityCoVnce RFC_Loc242_RadialDistanceVnce RFC_Loc242_RadialVelocityVnce RFC_Loc242_ElevationVnce RFC_Loc242_AzimuthVnce RFC_Loc242_RadarCrossSection RFC_Loc242_DistVelocityQuality RFC_Loc242_ElevationQuality RFC_Loc242_AzimuthQuality RFC_Loc242_RSSI RFC_Loc242_AzimuthalPartnerId;
SIG_GROUP_ 345 SG_RFC_Location_243_245 1 : RFC_Loc243_245_CRC RFC_Loc243_245_AliveCtr RFC_Loc243_245_ProtBlockCtr RFC_Loc243_RadialDistance RFC_Loc243_RadialVelocity RFC_Loc243_Elevation RFC_Loc243_Azimuth RFC_Loc243_DistVelocityCoVnce RFC_Loc243_RadialDistanceVnce RFC_Loc243_RadialVelocityVnce RFC_Loc243_ElevationVnce RFC_Loc243_AzimuthVnce RFC_Loc243_RadarCrossSection RFC_Loc243_DistVelocityQuality RFC_Loc243_ElevationQuality RFC_Loc243_AzimuthQuality RFC_Loc243_RSSI RFC_Loc243_AzimuthalPartnerId RFC_Loc244_RadialDistance RFC_Loc244_RadialVelocity RFC_Loc244_Elevation RFC_Loc244_Azimuth RFC_Loc244_DistVelocityCoVnce RFC_Loc244_RadialDistanceVnce RFC_Loc244_RadialVelocityVnce RFC_Loc244_ElevationVnce RFC_Loc244_AzimuthVnce RFC_Loc244_RadarCrossSection RFC_Loc244_DistVelocityQuality RFC_Loc244_ElevationQuality RFC_Loc244_AzimuthQuality RFC_Loc244_RSSI RFC_Loc244_AzimuthalPartnerId RFC_Loc245_RadialDistance RFC_Loc245_RadialVelocity RFC_Loc245_Elevation RFC_Loc245_Azimuth RFC_Loc245_DistVelocityCoVnce RFC_Loc245_RadialDistanceVnce RFC_Loc245_RadialVelocityVnce RFC_Loc245_ElevationVnce RFC_Loc245_AzimuthVnce RFC_Loc245_RadarCrossSection RFC_Loc245_DistVelocityQuality RFC_Loc245_ElevationQuality RFC_Loc245_AzimuthQuality RFC_Loc245_RSSI RFC_Loc245_AzimuthalPartnerId;
SIG_GROUP_ 346 SG_RFC_Location_246_248 1 : RFC_Loc246_248_CRC RFC_Loc246_248_AliveCtr RFC_Loc246_248_ProtBlockCtr RFC_Loc246_RadialDistance RFC_Loc246_RadialVelocity RFC_Loc246_Elevation RFC_Loc246_Azimuth RFC_Loc246_DistVelocityCoVnce RFC_Loc246_RadialDistanceVnce RFC_Loc246_RadialVelocityVnce RFC_Loc246_ElevationVnce RFC_Loc246_AzimuthVnce RFC_Loc246_RadarCrossSection RFC_Loc246_DistVelocityQuality RFC_Loc246_ElevationQuality RFC_Loc246_AzimuthQuality RFC_Loc246_RSSI RFC_Loc246_AzimuthalPartnerId RFC_Loc247_RadialDistance RFC_Loc247_RadialVelocity RFC_Loc247_Elevation RFC_Loc247_Azimuth RFC_Loc247_DistVelocityCoVnce RFC_Loc247_RadialDistanceVnce RFC_Loc247_RadialVelocityVnce RFC_Loc247_ElevationVnce RFC_Loc247_AzimuthVnce RFC_Loc247_RadarCrossSection RFC_Loc247_DistVelocityQuality RFC_Loc247_ElevationQuality RFC_Loc247_AzimuthQuality RFC_Loc247_RSSI RFC_Loc247_AzimuthalPartnerId RFC_Loc248_RadialDistance RFC_Loc248_RadialVelocity RFC_Loc248_Elevation RFC_Loc248_Azimuth RFC_Loc248_DistVelocityCoVnce RFC_Loc248_RadialDistanceVnce RFC_Loc248_RadialVelocityVnce RFC_Loc248_ElevationVnce RFC_Loc248_AzimuthVnce RFC_Loc248_RadarCrossSection RFC_Loc248_DistVelocityQuality RFC_Loc248_ElevationQuality RFC_Loc248_AzimuthQuality RFC_Loc248_RSSI RFC_Loc248_AzimuthalPartnerId;
SIG_GROUP_ 347 SG_RFC_Location_249_251 1 : RFC_Loc249_251_CRC RFC_Loc249_251_AliveCtr RFC_Loc249_251_ProtBlockCtr RFC_Loc249_RadialDistance RFC_Loc249_RadialVelocity RFC_Loc249_Elevation RFC_Loc249_Azimuth RFC_Loc249_DistVelocityCoVnce RFC_Loc249_RadialDistanceVnce RFC_Loc249_RadialVelocityVnce RFC_Loc249_ElevationVnce RFC_Loc249_AzimuthVnce RFC_Loc249_RadarCrossSection RFC_Loc249_DistVelocityQuality RFC_Loc249_ElevationQuality RFC_Loc249_AzimuthQuality RFC_Loc249_RSSI RFC_Loc249_AzimuthalPartnerId RFC_Loc250_RadialDistance RFC_Loc250_RadialVelocity RFC_Loc250_Elevation RFC_Loc250_Azimuth RFC_Loc250_DistVelocityCoVnce RFC_Loc250_RadialDistanceVnce RFC_Loc250_RadialVelocityVnce RFC_Loc250_ElevationVnce RFC_Loc250_AzimuthVnce RFC_Loc250_RadarCrossSection RFC_Loc250_DistVelocityQuality RFC_Loc250_ElevationQuality RFC_Loc250_AzimuthQuality RFC_Loc250_RSSI RFC_Loc250_AzimuthalPartnerId RFC_Loc251_RadialDistance RFC_Loc251_RadialVelocity RFC_Loc251_Elevation RFC_Loc251_Azimuth RFC_Loc251_DistVelocityCoVnce RFC_Loc251_RadialDistanceVnce RFC_Loc251_RadialVelocityVnce RFC_Loc251_ElevationVnce RFC_Loc251_AzimuthVnce RFC_Loc251_RadarCrossSection RFC_Loc251_DistVelocityQuality RFC_Loc251_ElevationQuality RFC_Loc251_AzimuthQuality RFC_Loc251_RSSI RFC_Loc251_AzimuthalPartnerId;
SIG_GROUP_ 348 SG_RFC_Location_252_254 1 : RFC_Loc252_254_CRC RFC_Loc252_254_AliveCtr RFC_Loc252_254_ProtBlockCtr RFC_Loc252_RadialDistance RFC_Loc252_RadialVelocity RFC_Loc252_Elevation RFC_Loc252_Azimuth RFC_Loc252_DistVelocityCoVnce RFC_Loc252_RadialDistanceVnce RFC_Loc252_RadialVelocityVnce RFC_Loc252_ElevationVnce RFC_Loc252_AzimuthVnce RFC_Loc252_RadarCrossSection RFC_Loc252_DistVelocityQuality RFC_Loc252_ElevationQuality RFC_Loc252_AzimuthQuality RFC_Loc252_RSSI RFC_Loc252_AzimuthalPartnerId RFC_Loc253_RadialDistance RFC_Loc253_RadialVelocity RFC_Loc253_Elevation RFC_Loc253_Azimuth RFC_Loc253_DistVelocityCoVnce RFC_Loc253_RadialDistanceVnce RFC_Loc253_RadialVelocityVnce RFC_Loc253_ElevationVnce RFC_Loc253_AzimuthVnce RFC_Loc253_RadarCrossSection RFC_Loc253_DistVelocityQuality RFC_Loc253_ElevationQuality RFC_Loc253_AzimuthQuality RFC_Loc253_RSSI RFC_Loc253_AzimuthalPartnerId RFC_Loc254_RadialDistance RFC_Loc254_RadialVelocity RFC_Loc254_Elevation RFC_Loc254_Azimuth RFC_Loc254_DistVelocityCoVnce RFC_Loc254_RadialDistanceVnce RFC_Loc254_RadialVelocityVnce RFC_Loc254_ElevationVnce RFC_Loc254_AzimuthVnce RFC_Loc254_RadarCrossSection RFC_Loc254_DistVelocityQuality RFC_Loc254_ElevationQuality RFC_Loc254_AzimuthQuality RFC_Loc254_RSSI RFC_Loc254_AzimuthalPartnerId;
