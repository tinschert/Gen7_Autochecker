VERSION "created by canmatrix"

NS_ :

BS_:

BU_: RadarFrontCenter VideoFrontCenter DASy ReceiveECU

BO_ 321 RFC_Location_171_173: 64 RadarFrontCenter
 SG_ RFC_Loc171_173_CRC : 0|16@1+ (1,0) [0|65535] ""  DASy
 SG_ RFC_Loc171_173_AliveCtr : 16|8@1+ (1,0) [0|255] ""  DASy
 SG_ RFC_Loc171_173_ProtBlockCtr : 24|4@1+ (1,0) [0|15] ""  DASy
 SG_ RFC_Loc171_RadialDistance : 32|15@1+ (0.01,0) [0|327.67] "m"  DASy
 SG_ RFC_Loc171_RadialVelocity : 47|15@1+ (0.01,-163.84) [-110|55] "m/s"  DASy
 SG_ RFC_Loc171_Elevation : 62|10@1+ (0.1,-51.2) [-45|45] "deg"  DASy
 SG_ RFC_Loc171_Azimuth : 72|11@1+ (0.1,-102.4) [-90|90] "deg"  DASy
 SG_ RFC_Loc171_DistVelocityCoVnce : 83|11@1+ (0.0001,-0.1024) [-0.1024|0.1023] "m^2/s"  DASy
 SG_ RFC_Loc171_RadialDistanceVnce : 94|10@1+ (5E-005,0) [0|0.05115] "m^2"  DASy
 SG_ RFC_Loc171_RadialVelocityVnce : 104|10@1+ (0.0001,0) [0|0.1023] "m^2/s^2"  DASy
 SG_ RFC_Loc171_ElevationVnce : 114|10@1+ (0.001,0) [0|1.023] "deg^2"  DASy
 SG_ RFC_Loc171_AzimuthVnce : 124|10@1+ (0.001,0) [0|1.023] "deg^2"  DASy
 SG_ RFC_Loc171_RadarCrossSection : 134|10@1+ (0.2,-102.4) [-50|70] "dBsm"  DASy
 SG_ RFC_Loc171_DistVelocityQuality : 144|8@1+ (1,0) [0|255] "unitless"  DASy
 SG_ RFC_Loc171_ElevationQuality : 152|8@1+ (1,0) [0|255] "unitless"  DASy
 SG_ RFC_Loc171_AzimuthQuality : 160|8@1+ (1,0) [0|255] "unitless"  DASy
 SG_ RFC_Loc171_RSSI : 168|10@1+ (0.1,0) [0|100] "unitless"  DASy
 SG_ RFC_Loc171_AzimuthalPartnerId : 178|10@1+ (1,0) [0|1023] "unitless"  DASy
 SG_ RFC_Loc172_RadialDistance : 192|15@1+ (0.01,0) [0|327.67] "m"  DASy
 SG_ RFC_Loc172_RadialVelocity : 207|15@1+ (0.01,-163.84) [-110|55] "m/s"  DASy
 SG_ RFC_Loc172_Elevation : 222|10@1+ (0.1,-51.2) [-45|45] "deg"  DASy
 SG_ RFC_Loc172_Azimuth : 232|11@1+ (0.1,-102.4) [-90|90] "deg"  DASy
 SG_ RFC_Loc172_DistVelocityCoVnce : 243|11@1+ (0.0001,-0.1024) [-0.1024|0.1023] "m^2/s"  DASy
 SG_ RFC_Loc172_RadialDistanceVnce : 254|10@1+ (5E-005,0) [0|0.05115] "m^2"  DASy
 SG_ RFC_Loc172_RadialVelocityVnce : 264|10@1+ (0.0001,0) [0|0.1023] "m^2/s^2"  DASy
 SG_ RFC_Loc172_ElevationVnce : 274|10@1+ (0.001,0) [0|1.023] "deg^2"  DASy
 SG_ RFC_Loc172_AzimuthVnce : 284|10@1+ (0.001,0) [0|1.023] "deg^2"  DASy
 SG_ RFC_Loc172_RadarCrossSection : 294|10@1+ (0.2,-102.4) [-50|70] "dBsm"  DASy
 SG_ RFC_Loc172_DistVelocityQuality : 304|8@1+ (1,0) [0|255] "unitless"  DASy
 SG_ RFC_Loc172_ElevationQuality : 312|8@1+ (1,0) [0|255] "unitless"  DASy
 SG_ RFC_Loc172_AzimuthQuality : 320|8@1+ (1,0) [0|255] "unitless"  DASy
 SG_ RFC_Loc172_RSSI : 328|10@1+ (0.1,0) [0|100] "unitless"  DASy
 SG_ RFC_Loc172_AzimuthalPartnerId : 338|10@1+ (1,0) [0|1023] "unitless"  DASy
 SG_ RFC_Loc173_RadialDistance : 352|15@1+ (0.01,0) [0|327.67] "m"  DASy
 SG_ RFC_Loc173_RadialVelocity : 367|15@1+ (0.01,-163.84) [-110|55] "m/s"  DASy
 SG_ RFC_Loc173_Elevation : 382|10@1+ (0.1,-51.2) [-45|45] "deg"  DASy
 SG_ RFC_Loc173_Azimuth : 392|11@1+ (0.1,-102.4) [-90|90] "deg"  DASy
 SG_ RFC_Loc173_DistVelocityCoVnce : 403|11@1+ (0.0001,-0.1024) [-0.1024|0.1023] "m^2/s"  DASy
 SG_ RFC_Loc173_RadialDistanceVnce : 414|10@1+ (5E-005,0) [0|0.05115] "m^2"  DASy
 SG_ RFC_Loc173_RadialVelocityVnce : 424|10@1+ (0.0001,0) [0|0.1023] "m^2/s^2"  DASy
 SG_ RFC_Loc173_ElevationVnce : 434|10@1+ (0.001,0) [0|1.023] "deg^2"  DASy
 SG_ RFC_Loc173_AzimuthVnce : 444|10@1+ (0.001,0) [0|1.023] "deg^2"  DASy
 SG_ RFC_Loc173_RadarCrossSection : 454|10@1+ (0.2,-102.4) [-50|70] "dBsm"  DASy
 SG_ RFC_Loc173_DistVelocityQuality : 464|8@1+ (1,0) [0|255] "unitless"  DASy
 SG_ RFC_Loc173_ElevationQuality : 472|8@1+ (1,0) [0|255] "unitless"  DASy
 SG_ RFC_Loc173_AzimuthQuality : 480|8@1+ (1,0) [0|255] "unitless"  DASy
 SG_ RFC_Loc173_RSSI : 488|10@1+ (0.1,0) [0|100] "unitless"  DASy
 SG_ RFC_Loc173_AzimuthalPartnerId : 498|10@1+ (1,0) [0|1023] "unitless"  DASy

BO_ 322 RFC_Location_174_176: 64 RadarFrontCenter
 SG_ RFC_Loc174_176_CRC : 0|16@1+ (1,0) [0|65535] ""  DASy
 SG_ RFC_Loc174_176_AliveCtr : 16|8@1+ (1,0) [0|255] ""  DASy
 SG_ RFC_Loc174_176_ProtBlockCtr : 24|4@1+ (1,0) [0|15] ""  DASy
 SG_ RFC_Loc174_RadialDistance : 32|15@1+ (0.01,0) [0|327.67] "m"  DASy
 SG_ RFC_Loc174_RadialVelocity : 47|15@1+ (0.01,-163.84) [-110|55] "m/s"  DASy
 SG_ RFC_Loc174_Elevation : 62|10@1+ (0.1,-51.2) [-45|45] "deg"  DASy
 SG_ RFC_Loc174_Azimuth : 72|11@1+ (0.1,-102.4) [-90|90] "deg"  DASy
 SG_ RFC_Loc174_DistVelocityCoVnce : 83|11@1+ (0.0001,-0.1024) [-0.1024|0.1023] "m^2/s"  DASy
 SG_ RFC_Loc174_RadialDistanceVnce : 94|10@1+ (5E-005,0) [0|0.05115] "m^2"  DASy
 SG_ RFC_Loc174_RadialVelocityVnce : 104|10@1+ (0.0001,0) [0|0.1023] "m^2/s^2"  DASy
 SG_ RFC_Loc174_ElevationVnce : 114|10@1+ (0.001,0) [0|1.023] "deg^2"  DASy
 SG_ RFC_Loc174_AzimuthVnce : 124|10@1+ (0.001,0) [0|1.023] "deg^2"  DASy
 SG_ RFC_Loc174_RadarCrossSection : 134|10@1+ (0.2,-102.4) [-50|70] "dBsm"  DASy
 SG_ RFC_Loc174_DistVelocityQuality : 144|8@1+ (1,0) [0|255] "unitless"  DASy
 SG_ RFC_Loc174_ElevationQuality : 152|8@1+ (1,0) [0|255] "unitless"  DASy
 SG_ RFC_Loc174_AzimuthQuality : 160|8@1+ (1,0) [0|255] "unitless"  DASy
 SG_ RFC_Loc174_RSSI : 168|10@1+ (0.1,0) [0|100] "unitless"  DASy
 SG_ RFC_Loc174_AzimuthalPartnerId : 178|10@1+ (1,0) [0|1023] "unitless"  DASy
 SG_ RFC_Loc175_RadialDistance : 192|15@1+ (0.01,0) [0|327.67] "m"  DASy
 SG_ RFC_Loc175_RadialVelocity : 207|15@1+ (0.01,-163.84) [-110|55] "m/s"  DASy
 SG_ RFC_Loc175_Elevation : 222|10@1+ (0.1,-51.2) [-45|45] "deg"  DASy
 SG_ RFC_Loc175_Azimuth : 232|11@1+ (0.1,-102.4) [-90|90] "deg"  DASy
 SG_ RFC_Loc175_DistVelocityCoVnce : 243|11@1+ (0.0001,-0.1024) [-0.1024|0.1023] "m^2/s"  DASy
 SG_ RFC_Loc175_RadialDistanceVnce : 254|10@1+ (5E-005,0) [0|0.05115] "m^2"  DASy
 SG_ RFC_Loc175_RadialVelocityVnce : 264|10@1+ (0.0001,0) [0|0.1023] "m^2/s^2"  DASy
 SG_ RFC_Loc175_ElevationVnce : 274|10@1+ (0.001,0) [0|1.023] "deg^2"  DASy
 SG_ RFC_Loc175_AzimuthVnce : 284|10@1+ (0.001,0) [0|1.023] "deg^2"  DASy
 SG_ RFC_Loc175_RadarCrossSection : 294|10@1+ (0.2,-102.4) [-50|70] "dBsm"  DASy
 SG_ RFC_Loc175_DistVelocityQuality : 304|8@1+ (1,0) [0|255] "unitless"  DASy
 SG_ RFC_Loc175_ElevationQuality : 312|8@1+ (1,0) [0|255] "unitless"  DASy
 SG_ RFC_Loc175_AzimuthQuality : 320|8@1+ (1,0) [0|255] "unitless"  DASy
 SG_ RFC_Loc175_RSSI : 328|10@1+ (0.1,0) [0|100] "unitless"  DASy
 SG_ RFC_Loc175_AzimuthalPartnerId : 338|10@1+ (1,0) [0|1023] "unitless"  DASy
 SG_ RFC_Loc176_RadialDistance : 352|15@1+ (0.01,0) [0|327.67] "m"  DASy
 SG_ RFC_Loc176_RadialVelocity : 367|15@1+ (0.01,-163.84) [-110|55] "m/s"  DASy
 SG_ RFC_Loc176_Elevation : 382|10@1+ (0.1,-51.2) [-45|45] "deg"  DASy
 SG_ RFC_Loc176_Azimuth : 392|11@1+ (0.1,-102.4) [-90|90] "deg"  DASy
 SG_ RFC_Loc176_DistVelocityCoVnce : 403|11@1+ (0.0001,-0.1024) [-0.1024|0.1023] "m^2/s"  DASy
 SG_ RFC_Loc176_RadialDistanceVnce : 414|10@1+ (5E-005,0) [0|0.05115] "m^2"  DASy
 SG_ RFC_Loc176_RadialVelocityVnce : 424|10@1+ (0.0001,0) [0|0.1023] "m^2/s^2"  DASy
 SG_ RFC_Loc176_ElevationVnce : 434|10@1+ (0.001,0) [0|1.023] "deg^2"  DASy
 SG_ RFC_Loc176_AzimuthVnce : 444|10@1+ (0.001,0) [0|1.023] "deg^2"  DASy
 SG_ RFC_Loc176_RadarCrossSection : 454|10@1+ (0.2,-102.4) [-50|70] "dBsm"  DASy
 SG_ RFC_Loc176_DistVelocityQuality : 464|8@1+ (1,0) [0|255] "unitless"  DASy
 SG_ RFC_Loc176_ElevationQuality : 472|8@1+ (1,0) [0|255] "unitless"  DASy
 SG_ RFC_Loc176_AzimuthQuality : 480|8@1+ (1,0) [0|255] "unitless"  DASy
 SG_ RFC_Loc176_RSSI : 488|10@1+ (0.1,0) [0|100] "unitless"  DASy
 SG_ RFC_Loc176_AzimuthalPartnerId : 498|10@1+ (1,0) [0|1023] "unitless"  DASy

BO_ 323 RFC_Location_177_179: 64 RadarFrontCenter
 SG_ RFC_Loc177_179_CRC : 0|16@1+ (1,0) [0|65535] ""  DASy
 SG_ RFC_Loc177_179_AliveCtr : 16|8@1+ (1,0) [0|255] ""  DASy
 SG_ RFC_Loc177_179_ProtBlockCtr : 24|4@1+ (1,0) [0|15] ""  DASy
 SG_ RFC_Loc177_RadialDistance : 32|15@1+ (0.01,0) [0|327.67] "m"  DASy
 SG_ RFC_Loc177_RadialVelocity : 47|15@1+ (0.01,-163.84) [-110|55] "m/s"  DASy
 SG_ RFC_Loc177_Elevation : 62|10@1+ (0.1,-51.2) [-45|45] "deg"  DASy
 SG_ RFC_Loc177_Azimuth : 72|11@1+ (0.1,-102.4) [-90|90] "deg"  DASy
 SG_ RFC_Loc177_DistVelocityCoVnce : 83|11@1+ (0.0001,-0.1024) [-0.1024|0.1023] "m^2/s"  DASy
 SG_ RFC_Loc177_RadialDistanceVnce : 94|10@1+ (5E-005,0) [0|0.05115] "m^2"  DASy
 SG_ RFC_Loc177_RadialVelocityVnce : 104|10@1+ (0.0001,0) [0|0.1023] "m^2/s^2"  DASy
 SG_ RFC_Loc177_ElevationVnce : 114|10@1+ (0.001,0) [0|1.023] "deg^2"  DASy
 SG_ RFC_Loc177_AzimuthVnce : 124|10@1+ (0.001,0) [0|1.023] "deg^2"  DASy
 SG_ RFC_Loc177_RadarCrossSection : 134|10@1+ (0.2,-102.4) [-50|70] "dBsm"  DASy
 SG_ RFC_Loc177_DistVelocityQuality : 144|8@1+ (1,0) [0|255] "unitless"  DASy
 SG_ RFC_Loc177_ElevationQuality : 152|8@1+ (1,0) [0|255] "unitless"  DASy
 SG_ RFC_Loc177_AzimuthQuality : 160|8@1+ (1,0) [0|255] "unitless"  DASy
 SG_ RFC_Loc177_RSSI : 168|10@1+ (0.1,0) [0|100] "unitless"  DASy
 SG_ RFC_Loc177_AzimuthalPartnerId : 178|10@1+ (1,0) [0|1023] "unitless"  DASy
 SG_ RFC_Loc178_RadialDistance : 192|15@1+ (0.01,0) [0|327.67] "m"  DASy
 SG_ RFC_Loc178_RadialVelocity : 207|15@1+ (0.01,-163.84) [-110|55] "m/s"  DASy
 SG_ RFC_Loc178_Elevation : 222|10@1+ (0.1,-51.2) [-45|45] "deg"  DASy
 SG_ RFC_Loc178_Azimuth : 232|11@1+ (0.1,-102.4) [-90|90] "deg"  DASy
 SG_ RFC_Loc178_DistVelocityCoVnce : 243|11@1+ (0.0001,-0.1024) [-0.1024|0.1023] "m^2/s"  DASy
 SG_ RFC_Loc178_RadialDistanceVnce : 254|10@1+ (5E-005,0) [0|0.05115] "m^2"  DASy
 SG_ RFC_Loc178_RadialVelocityVnce : 264|10@1+ (0.0001,0) [0|0.1023] "m^2/s^2"  DASy
 SG_ RFC_Loc178_ElevationVnce : 274|10@1+ (0.001,0) [0|1.023] "deg^2"  DASy
 SG_ RFC_Loc178_AzimuthVnce : 284|10@1+ (0.001,0) [0|1.023] "deg^2"  DASy
 SG_ RFC_Loc178_RadarCrossSection : 294|10@1+ (0.2,-102.4) [-50|70] "dBsm"  DASy
 SG_ RFC_Loc178_DistVelocityQuality : 304|8@1+ (1,0) [0|255] "unitless"  DASy
 SG_ RFC_Loc178_ElevationQuality : 312|8@1+ (1,0) [0|255] "unitless"  DASy
 SG_ RFC_Loc178_AzimuthQuality : 320|8@1+ (1,0) [0|255] "unitless"  DASy
 SG_ RFC_Loc178_RSSI : 328|10@1+ (0.1,0) [0|100] "unitless"  DASy
 SG_ RFC_Loc178_AzimuthalPartnerId : 338|10@1+ (1,0) [0|1023] "unitless"  DASy
 SG_ RFC_Loc179_RadialDistance : 352|15@1+ (0.01,0) [0|327.67] "m"  DASy
 SG_ RFC_Loc179_RadialVelocity : 367|15@1+ (0.01,-163.84) [-110|55] "m/s"  DASy
 SG_ RFC_Loc179_Elevation : 382|10@1+ (0.1,-51.2) [-45|45] "deg"  DASy
 SG_ RFC_Loc179_Azimuth : 392|11@1+ (0.1,-102.4) [-90|90] "deg"  DASy
 SG_ RFC_Loc179_DistVelocityCoVnce : 403|11@1+ (0.0001,-0.1024) [-0.1024|0.1023] "m^2/s"  DASy
 SG_ RFC_Loc179_RadialDistanceVnce : 414|10@1+ (5E-005,0) [0|0.05115] "m^2"  DASy
 SG_ RFC_Loc179_RadialVelocityVnce : 424|10@1+ (0.0001,0) [0|0.1023] "m^2/s^2"  DASy
 SG_ RFC_Loc179_ElevationVnce : 434|10@1+ (0.001,0) [0|1.023] "deg^2"  DASy
 SG_ RFC_Loc179_AzimuthVnce : 444|10@1+ (0.001,0) [0|1.023] "deg^2"  DASy
 SG_ RFC_Loc179_RadarCrossSection : 454|10@1+ (0.2,-102.4) [-50|70] "dBsm"  DASy
 SG_ RFC_Loc179_DistVelocityQuality : 464|8@1+ (1,0) [0|255] "unitless"  DASy
 SG_ RFC_Loc179_ElevationQuality : 472|8@1+ (1,0) [0|255] "unitless"  DASy
 SG_ RFC_Loc179_AzimuthQuality : 480|8@1+ (1,0) [0|255] "unitless"  DASy
 SG_ RFC_Loc179_RSSI : 488|10@1+ (0.1,0) [0|100] "unitless"  DASy
 SG_ RFC_Loc179_AzimuthalPartnerId : 498|10@1+ (1,0) [0|1023] "unitless"  DASy

BO_ 324 RFC_Location_180_182: 64 RadarFrontCenter
 SG_ RFC_Loc180_182_CRC : 0|16@1+ (1,0) [0|65535] ""  DASy
 SG_ RFC_Loc180_182_AliveCtr : 16|8@1+ (1,0) [0|255] ""  DASy
 SG_ RFC_Loc180_182_ProtBlockCtr : 24|4@1+ (1,0) [0|15] ""  DASy
 SG_ RFC_Loc180_RadialDistance : 32|15@1+ (0.01,0) [0|327.67] "m"  DASy
 SG_ RFC_Loc180_RadialVelocity : 47|15@1+ (0.01,-163.84) [-110|55] "m/s"  DASy
 SG_ RFC_Loc180_Elevation : 62|10@1+ (0.1,-51.2) [-45|45] "deg"  DASy
 SG_ RFC_Loc180_Azimuth : 72|11@1+ (0.1,-102.4) [-90|90] "deg"  DASy
 SG_ RFC_Loc180_DistVelocityCoVnce : 83|11@1+ (0.0001,-0.1024) [-0.1024|0.1023] "m^2/s"  DASy
 SG_ RFC_Loc180_RadialDistanceVnce : 94|10@1+ (5E-005,0) [0|0.05115] "m^2"  DASy
 SG_ RFC_Loc180_RadialVelocityVnce : 104|10@1+ (0.0001,0) [0|0.1023] "m^2/s^2"  DASy
 SG_ RFC_Loc180_ElevationVnce : 114|10@1+ (0.001,0) [0|1.023] "deg^2"  DASy
 SG_ RFC_Loc180_AzimuthVnce : 124|10@1+ (0.001,0) [0|1.023] "deg^2"  DASy
 SG_ RFC_Loc180_RadarCrossSection : 134|10@1+ (0.2,-102.4) [-50|70] "dBsm"  DASy
 SG_ RFC_Loc180_DistVelocityQuality : 144|8@1+ (1,0) [0|255] "unitless"  DASy
 SG_ RFC_Loc180_ElevationQuality : 152|8@1+ (1,0) [0|255] "unitless"  DASy
 SG_ RFC_Loc180_AzimuthQuality : 160|8@1+ (1,0) [0|255] "unitless"  DASy
 SG_ RFC_Loc180_RSSI : 168|10@1+ (0.1,0) [0|100] "unitless"  DASy
 SG_ RFC_Loc180_AzimuthalPartnerId : 178|10@1+ (1,0) [0|1023] "unitless"  DASy
 SG_ RFC_Loc181_RadialDistance : 192|15@1+ (0.01,0) [0|327.67] "m"  DASy
 SG_ RFC_Loc181_RadialVelocity : 207|15@1+ (0.01,-163.84) [-110|55] "m/s"  DASy
 SG_ RFC_Loc181_Elevation : 222|10@1+ (0.1,-51.2) [-45|45] "deg"  DASy
 SG_ RFC_Loc181_Azimuth : 232|11@1+ (0.1,-102.4) [-90|90] "deg"  DASy
 SG_ RFC_Loc181_DistVelocityCoVnce : 243|11@1+ (0.0001,-0.1024) [-0.1024|0.1023] "m^2/s"  DASy
 SG_ RFC_Loc181_RadialDistanceVnce : 254|10@1+ (5E-005,0) [0|0.05115] "m^2"  DASy
 SG_ RFC_Loc181_RadialVelocityVnce : 264|10@1+ (0.0001,0) [0|0.1023] "m^2/s^2"  DASy
 SG_ RFC_Loc181_ElevationVnce : 274|10@1+ (0.001,0) [0|1.023] "deg^2"  DASy
 SG_ RFC_Loc181_AzimuthVnce : 284|10@1+ (0.001,0) [0|1.023] "deg^2"  DASy
 SG_ RFC_Loc181_RadarCrossSection : 294|10@1+ (0.2,-102.4) [-50|70] "dBsm"  DASy
 SG_ RFC_Loc181_DistVelocityQuality : 304|8@1+ (1,0) [0|255] "unitless"  DASy
 SG_ RFC_Loc181_ElevationQuality : 312|8@1+ (1,0) [0|255] "unitless"  DASy
 SG_ RFC_Loc181_AzimuthQuality : 320|8@1+ (1,0) [0|255] "unitless"  DASy
 SG_ RFC_Loc181_RSSI : 328|10@1+ (0.1,0) [0|100] "unitless"  DASy
 SG_ RFC_Loc181_AzimuthalPartnerId : 338|10@1+ (1,0) [0|1023] "unitless"  DASy
 SG_ RFC_Loc182_RadialDistance : 352|15@1+ (0.01,0) [0|327.67] "m"  DASy
 SG_ RFC_Loc182_RadialVelocity : 367|15@1+ (0.01,-163.84) [-110|55] "m/s"  DASy
 SG_ RFC_Loc182_Elevation : 382|10@1+ (0.1,-51.2) [-45|45] "deg"  DASy
 SG_ RFC_Loc182_Azimuth : 392|11@1+ (0.1,-102.4) [-90|90] "deg"  DASy
 SG_ RFC_Loc182_DistVelocityCoVnce : 403|11@1+ (0.0001,-0.1024) [-0.1024|0.1023] "m^2/s"  DASy
 SG_ RFC_Loc182_RadialDistanceVnce : 414|10@1+ (5E-005,0) [0|0.05115] "m^2"  DASy
 SG_ RFC_Loc182_RadialVelocityVnce : 424|10@1+ (0.0001,0) [0|0.1023] "m^2/s^2"  DASy
 SG_ RFC_Loc182_ElevationVnce : 434|10@1+ (0.001,0) [0|1.023] "deg^2"  DASy
 SG_ RFC_Loc182_AzimuthVnce : 444|10@1+ (0.001,0) [0|1.023] "deg^2"  DASy
 SG_ RFC_Loc182_RadarCrossSection : 454|10@1+ (0.2,-102.4) [-50|70] "dBsm"  DASy
 SG_ RFC_Loc182_DistVelocityQuality : 464|8@1+ (1,0) [0|255] "unitless"  DASy
 SG_ RFC_Loc182_ElevationQuality : 472|8@1+ (1,0) [0|255] "unitless"  DASy
 SG_ RFC_Loc182_AzimuthQuality : 480|8@1+ (1,0) [0|255] "unitless"  DASy
 SG_ RFC_Loc182_RSSI : 488|10@1+ (0.1,0) [0|100] "unitless"  DASy
 SG_ RFC_Loc182_AzimuthalPartnerId : 498|10@1+ (1,0) [0|1023] "unitless"  DASy

BO_ 325 RFC_Location_183_185: 64 RadarFrontCenter
 SG_ RFC_Loc183_185_CRC : 0|16@1+ (1,0) [0|65535] ""  DASy
 SG_ RFC_Loc183_185_AliveCtr : 16|8@1+ (1,0) [0|255] ""  DASy
 SG_ RFC_Loc183_185_ProtBlockCtr : 24|4@1+ (1,0) [0|15] ""  DASy
 SG_ RFC_Loc183_RadialDistance : 32|15@1+ (0.01,0) [0|327.67] "m"  DASy
 SG_ RFC_Loc183_RadialVelocity : 47|15@1+ (0.01,-163.84) [-110|55] "m/s"  DASy
 SG_ RFC_Loc183_Elevation : 62|10@1+ (0.1,-51.2) [-45|45] "deg"  DASy
 SG_ RFC_Loc183_Azimuth : 72|11@1+ (0.1,-102.4) [-90|90] "deg"  DASy
 SG_ RFC_Loc183_DistVelocityCoVnce : 83|11@1+ (0.0001,-0.1024) [-0.1024|0.1023] "m^2/s"  DASy
 SG_ RFC_Loc183_RadialDistanceVnce : 94|10@1+ (5E-005,0) [0|0.05115] "m^2"  DASy
 SG_ RFC_Loc183_RadialVelocityVnce : 104|10@1+ (0.0001,0) [0|0.1023] "m^2/s^2"  DASy
 SG_ RFC_Loc183_ElevationVnce : 114|10@1+ (0.001,0) [0|1.023] "deg^2"  DASy
 SG_ RFC_Loc183_AzimuthVnce : 124|10@1+ (0.001,0) [0|1.023] "deg^2"  DASy
 SG_ RFC_Loc183_RadarCrossSection : 134|10@1+ (0.2,-102.4) [-50|70] "dBsm"  DASy
 SG_ RFC_Loc183_DistVelocityQuality : 144|8@1+ (1,0) [0|255] "unitless"  DASy
 SG_ RFC_Loc183_ElevationQuality : 152|8@1+ (1,0) [0|255] "unitless"  DASy
 SG_ RFC_Loc183_AzimuthQuality : 160|8@1+ (1,0) [0|255] "unitless"  DASy
 SG_ RFC_Loc183_RSSI : 168|10@1+ (0.1,0) [0|100] "unitless"  DASy
 SG_ RFC_Loc183_AzimuthalPartnerId : 178|10@1+ (1,0) [0|1023] "unitless"  DASy
 SG_ RFC_Loc184_RadialDistance : 192|15@1+ (0.01,0) [0|327.67] "m"  DASy
 SG_ RFC_Loc184_RadialVelocity : 207|15@1+ (0.01,-163.84) [-110|55] "m/s"  DASy
 SG_ RFC_Loc184_Elevation : 222|10@1+ (0.1,-51.2) [-45|45] "deg"  DASy
 SG_ RFC_Loc184_Azimuth : 232|11@1+ (0.1,-102.4) [-90|90] "deg"  DASy
 SG_ RFC_Loc184_DistVelocityCoVnce : 243|11@1+ (0.0001,-0.1024) [-0.1024|0.1023] "m^2/s"  DASy
 SG_ RFC_Loc184_RadialDistanceVnce : 254|10@1+ (5E-005,0) [0|0.05115] "m^2"  DASy
 SG_ RFC_Loc184_RadialVelocityVnce : 264|10@1+ (0.0001,0) [0|0.1023] "m^2/s^2"  DASy
 SG_ RFC_Loc184_ElevationVnce : 274|10@1+ (0.001,0) [0|1.023] "deg^2"  DASy
 SG_ RFC_Loc184_AzimuthVnce : 284|10@1+ (0.001,0) [0|1.023] "deg^2"  DASy
 SG_ RFC_Loc184_RadarCrossSection : 294|10@1+ (0.2,-102.4) [-50|70] "dBsm"  DASy
 SG_ RFC_Loc184_DistVelocityQuality : 304|8@1+ (1,0) [0|255] "unitless"  DASy
 SG_ RFC_Loc184_ElevationQuality : 312|8@1+ (1,0) [0|255] "unitless"  DASy
 SG_ RFC_Loc184_AzimuthQuality : 320|8@1+ (1,0) [0|255] "unitless"  DASy
 SG_ RFC_Loc184_RSSI : 328|10@1+ (0.1,0) [0|100] "unitless"  DASy
 SG_ RFC_Loc184_AzimuthalPartnerId : 338|10@1+ (1,0) [0|1023] "unitless"  DASy
 SG_ RFC_Loc185_RadialDistance : 352|15@1+ (0.01,0) [0|327.67] "m"  DASy
 SG_ RFC_Loc185_RadialVelocity : 367|15@1+ (0.01,-163.84) [-110|55] "m/s"  DASy
 SG_ RFC_Loc185_Elevation : 382|10@1+ (0.1,-51.2) [-45|45] "deg"  DASy
 SG_ RFC_Loc185_Azimuth : 392|11@1+ (0.1,-102.4) [-90|90] "deg"  DASy
 SG_ RFC_Loc185_DistVelocityCoVnce : 403|11@1+ (0.0001,-0.1024) [-0.1024|0.1023] "m^2/s"  DASy
 SG_ RFC_Loc185_RadialDistanceVnce : 414|10@1+ (5E-005,0) [0|0.05115] "m^2"  DASy
 SG_ RFC_Loc185_RadialVelocityVnce : 424|10@1+ (0.0001,0) [0|0.1023] "m^2/s^2"  DASy
 SG_ RFC_Loc185_ElevationVnce : 434|10@1+ (0.001,0) [0|1.023] "deg^2"  DASy
 SG_ RFC_Loc185_AzimuthVnce : 444|10@1+ (0.001,0) [0|1.023] "deg^2"  DASy
 SG_ RFC_Loc185_RadarCrossSection : 454|10@1+ (0.2,-102.4) [-50|70] "dBsm"  DASy
 SG_ RFC_Loc185_DistVelocityQuality : 464|8@1+ (1,0) [0|255] "unitless"  DASy
 SG_ RFC_Loc185_ElevationQuality : 472|8@1+ (1,0) [0|255] "unitless"  DASy
 SG_ RFC_Loc185_AzimuthQuality : 480|8@1+ (1,0) [0|255] "unitless"  DASy
 SG_ RFC_Loc185_RSSI : 488|10@1+ (0.1,0) [0|100] "unitless"  DASy
 SG_ RFC_Loc185_AzimuthalPartnerId : 498|10@1+ (1,0) [0|1023] "unitless"  DASy

BO_ 326 RFC_Location_186_188: 64 RadarFrontCenter
 SG_ RFC_Loc186_188_CRC : 0|16@1+ (1,0) [0|65535] ""  DASy
 SG_ RFC_Loc186_188_AliveCtr : 16|8@1+ (1,0) [0|255] ""  DASy
 SG_ RFC_Loc186_188_ProtBlockCtr : 24|4@1+ (1,0) [0|15] ""  DASy
 SG_ RFC_Loc186_RadialDistance : 32|15@1+ (0.01,0) [0|327.67] "m"  DASy
 SG_ RFC_Loc186_RadialVelocity : 47|15@1+ (0.01,-163.84) [-110|55] "m/s"  DASy
 SG_ RFC_Loc186_Elevation : 62|10@1+ (0.1,-51.2) [-45|45] "deg"  DASy
 SG_ RFC_Loc186_Azimuth : 72|11@1+ (0.1,-102.4) [-90|90] "deg"  DASy
 SG_ RFC_Loc186_DistVelocityCoVnce : 83|11@1+ (0.0001,-0.1024) [-0.1024|0.1023] "m^2/s"  DASy
 SG_ RFC_Loc186_RadialDistanceVnce : 94|10@1+ (5E-005,0) [0|0.05115] "m^2"  DASy
 SG_ RFC_Loc186_RadialVelocityVnce : 104|10@1+ (0.0001,0) [0|0.1023] "m^2/s^2"  DASy
 SG_ RFC_Loc186_ElevationVnce : 114|10@1+ (0.001,0) [0|1.023] "deg^2"  DASy
 SG_ RFC_Loc186_AzimuthVnce : 124|10@1+ (0.001,0) [0|1.023] "deg^2"  DASy
 SG_ RFC_Loc186_RadarCrossSection : 134|10@1+ (0.2,-102.4) [-50|70] "dBsm"  DASy
 SG_ RFC_Loc186_DistVelocityQuality : 144|8@1+ (1,0) [0|255] "unitless"  DASy
 SG_ RFC_Loc186_ElevationQuality : 152|8@1+ (1,0) [0|255] "unitless"  DASy
 SG_ RFC_Loc186_AzimuthQuality : 160|8@1+ (1,0) [0|255] "unitless"  DASy
 SG_ RFC_Loc186_RSSI : 168|10@1+ (0.1,0) [0|100] "unitless"  DASy
 SG_ RFC_Loc186_AzimuthalPartnerId : 178|10@1+ (1,0) [0|1023] "unitless"  DASy
 SG_ RFC_Loc187_RadialDistance : 192|15@1+ (0.01,0) [0|327.67] "m"  DASy
 SG_ RFC_Loc187_RadialVelocity : 207|15@1+ (0.01,-163.84) [-110|55] "m/s"  DASy
 SG_ RFC_Loc187_Elevation : 222|10@1+ (0.1,-51.2) [-45|45] "deg"  DASy
 SG_ RFC_Loc187_Azimuth : 232|11@1+ (0.1,-102.4) [-90|90] "deg"  DASy
 SG_ RFC_Loc187_DistVelocityCoVnce : 243|11@1+ (0.0001,-0.1024) [-0.1024|0.1023] "m^2/s"  DASy
 SG_ RFC_Loc187_RadialDistanceVnce : 254|10@1+ (5E-005,0) [0|0.05115] "m^2"  DASy
 SG_ RFC_Loc187_RadialVelocityVnce : 264|10@1+ (0.0001,0) [0|0.1023] "m^2/s^2"  DASy
 SG_ RFC_Loc187_ElevationVnce : 274|10@1+ (0.001,0) [0|1.023] "deg^2"  DASy
 SG_ RFC_Loc187_AzimuthVnce : 284|10@1+ (0.001,0) [0|1.023] "deg^2"  DASy
 SG_ RFC_Loc187_RadarCrossSection : 294|10@1+ (0.2,-102.4) [-50|70] "dBsm"  DASy
 SG_ RFC_Loc187_DistVelocityQuality : 304|8@1+ (1,0) [0|255] "unitless"  DASy
 SG_ RFC_Loc187_ElevationQuality : 312|8@1+ (1,0) [0|255] "unitless"  DASy
 SG_ RFC_Loc187_AzimuthQuality : 320|8@1+ (1,0) [0|255] "unitless"  DASy
 SG_ RFC_Loc187_RSSI : 328|10@1+ (0.1,0) [0|100] "unitless"  DASy
 SG_ RFC_Loc187_AzimuthalPartnerId : 338|10@1+ (1,0) [0|1023] "unitless"  DASy
 SG_ RFC_Loc188_RadialDistance : 352|15@1+ (0.01,0) [0|327.67] "m"  DASy
 SG_ RFC_Loc188_RadialVelocity : 367|15@1+ (0.01,-163.84) [-110|55] "m/s"  DASy
 SG_ RFC_Loc188_Elevation : 382|10@1+ (0.1,-51.2) [-45|45] "deg"  DASy
 SG_ RFC_Loc188_Azimuth : 392|11@1+ (0.1,-102.4) [-90|90] "deg"  DASy
 SG_ RFC_Loc188_DistVelocityCoVnce : 403|11@1+ (0.0001,-0.1024) [-0.1024|0.1023] "m^2/s"  DASy
 SG_ RFC_Loc188_RadialDistanceVnce : 414|10@1+ (5E-005,0) [0|0.05115] "m^2"  DASy
 SG_ RFC_Loc188_RadialVelocityVnce : 424|10@1+ (0.0001,0) [0|0.1023] "m^2/s^2"  DASy
 SG_ RFC_Loc188_ElevationVnce : 434|10@1+ (0.001,0) [0|1.023] "deg^2"  DASy
 SG_ RFC_Loc188_AzimuthVnce : 444|10@1+ (0.001,0) [0|1.023] "deg^2"  DASy
 SG_ RFC_Loc188_RadarCrossSection : 454|10@1+ (0.2,-102.4) [-50|70] "dBsm"  DASy
 SG_ RFC_Loc188_DistVelocityQuality : 464|8@1+ (1,0) [0|255] "unitless"  DASy
 SG_ RFC_Loc188_ElevationQuality : 472|8@1+ (1,0) [0|255] "unitless"  DASy
 SG_ RFC_Loc188_AzimuthQuality : 480|8@1+ (1,0) [0|255] "unitless"  DASy
 SG_ RFC_Loc188_RSSI : 488|10@1+ (0.1,0) [0|100] "unitless"  DASy
 SG_ RFC_Loc188_AzimuthalPartnerId : 498|10@1+ (1,0) [0|1023] "unitless"  DASy

BO_ 327 RFC_Location_189_191: 64 RadarFrontCenter
 SG_ RFC_Loc189_191_CRC : 0|16@1+ (1,0) [0|65535] ""  DASy
 SG_ RFC_Loc189_191_AliveCtr : 16|8@1+ (1,0) [0|255] ""  DASy
 SG_ RFC_Loc189_191_ProtBlockCtr : 24|4@1+ (1,0) [0|15] ""  DASy
 SG_ RFC_Loc189_RadialDistance : 32|15@1+ (0.01,0) [0|327.67] "m"  DASy
 SG_ RFC_Loc189_RadialVelocity : 47|15@1+ (0.01,-163.84) [-110|55] "m/s"  DASy
 SG_ RFC_Loc189_Elevation : 62|10@1+ (0.1,-51.2) [-45|45] "deg"  DASy
 SG_ RFC_Loc189_Azimuth : 72|11@1+ (0.1,-102.4) [-90|90] "deg"  DASy
 SG_ RFC_Loc189_DistVelocityCoVnce : 83|11@1+ (0.0001,-0.1024) [-0.1024|0.1023] "m^2/s"  DASy
 SG_ RFC_Loc189_RadialDistanceVnce : 94|10@1+ (5E-005,0) [0|0.05115] "m^2"  DASy
 SG_ RFC_Loc189_RadialVelocityVnce : 104|10@1+ (0.0001,0) [0|0.1023] "m^2/s^2"  DASy
 SG_ RFC_Loc189_ElevationVnce : 114|10@1+ (0.001,0) [0|1.023] "deg^2"  DASy
 SG_ RFC_Loc189_AzimuthVnce : 124|10@1+ (0.001,0) [0|1.023] "deg^2"  DASy
 SG_ RFC_Loc189_RadarCrossSection : 134|10@1+ (0.2,-102.4) [-50|70] "dBsm"  DASy
 SG_ RFC_Loc189_DistVelocityQuality : 144|8@1+ (1,0) [0|255] "unitless"  DASy
 SG_ RFC_Loc189_ElevationQuality : 152|8@1+ (1,0) [0|255] "unitless"  DASy
 SG_ RFC_Loc189_AzimuthQuality : 160|8@1+ (1,0) [0|255] "unitless"  DASy
 SG_ RFC_Loc189_RSSI : 168|10@1+ (0.1,0) [0|100] "unitless"  DASy
 SG_ RFC_Loc189_AzimuthalPartnerId : 178|10@1+ (1,0) [0|1023] "unitless"  DASy
 SG_ RFC_Loc190_RadialDistance : 192|15@1+ (0.01,0) [0|327.67] "m"  DASy
 SG_ RFC_Loc190_RadialVelocity : 207|15@1+ (0.01,-163.84) [-110|55] "m/s"  DASy
 SG_ RFC_Loc190_Elevation : 222|10@1+ (0.1,-51.2) [-45|45] "deg"  DASy
 SG_ RFC_Loc190_Azimuth : 232|11@1+ (0.1,-102.4) [-90|90] "deg"  DASy
 SG_ RFC_Loc190_DistVelocityCoVnce : 243|11@1+ (0.0001,-0.1024) [-0.1024|0.1023] "m^2/s"  DASy
 SG_ RFC_Loc190_RadialDistanceVnce : 254|10@1+ (5E-005,0) [0|0.05115] "m^2"  DASy
 SG_ RFC_Loc190_RadialVelocityVnce : 264|10@1+ (0.0001,0) [0|0.1023] "m^2/s^2"  DASy
 SG_ RFC_Loc190_ElevationVnce : 274|10@1+ (0.001,0) [0|1.023] "deg^2"  DASy
 SG_ RFC_Loc190_AzimuthVnce : 284|10@1+ (0.001,0) [0|1.023] "deg^2"  DASy
 SG_ RFC_Loc190_RadarCrossSection : 294|10@1+ (0.2,-102.4) [-50|70] "dBsm"  DASy
 SG_ RFC_Loc190_DistVelocityQuality : 304|8@1+ (1,0) [0|255] "unitless"  DASy
 SG_ RFC_Loc190_ElevationQuality : 312|8@1+ (1,0) [0|255] "unitless"  DASy
 SG_ RFC_Loc190_AzimuthQuality : 320|8@1+ (1,0) [0|255] "unitless"  DASy
 SG_ RFC_Loc190_RSSI : 328|10@1+ (0.1,0) [0|100] "unitless"  DASy
 SG_ RFC_Loc190_AzimuthalPartnerId : 338|10@1+ (1,0) [0|1023] "unitless"  DASy
 SG_ RFC_Loc191_RadialDistance : 352|15@1+ (0.01,0) [0|327.67] "m"  DASy
 SG_ RFC_Loc191_RadialVelocity : 367|15@1+ (0.01,-163.84) [-110|55] "m/s"  DASy
 SG_ RFC_Loc191_Elevation : 382|10@1+ (0.1,-51.2) [-45|45] "deg"  DASy
 SG_ RFC_Loc191_Azimuth : 392|11@1+ (0.1,-102.4) [-90|90] "deg"  DASy
 SG_ RFC_Loc191_DistVelocityCoVnce : 403|11@1+ (0.0001,-0.1024) [-0.1024|0.1023] "m^2/s"  DASy
 SG_ RFC_Loc191_RadialDistanceVnce : 414|10@1+ (5E-005,0) [0|0.05115] "m^2"  DASy
 SG_ RFC_Loc191_RadialVelocityVnce : 424|10@1+ (0.0001,0) [0|0.1023] "m^2/s^2"  DASy
 SG_ RFC_Loc191_ElevationVnce : 434|10@1+ (0.001,0) [0|1.023] "deg^2"  DASy
 SG_ RFC_Loc191_AzimuthVnce : 444|10@1+ (0.001,0) [0|1.023] "deg^2"  DASy
 SG_ RFC_Loc191_RadarCrossSection : 454|10@1+ (0.2,-102.4) [-50|70] "dBsm"  DASy
 SG_ RFC_Loc191_DistVelocityQuality : 464|8@1+ (1,0) [0|255] "unitless"  DASy
 SG_ RFC_Loc191_ElevationQuality : 472|8@1+ (1,0) [0|255] "unitless"  DASy
 SG_ RFC_Loc191_AzimuthQuality : 480|8@1+ (1,0) [0|255] "unitless"  DASy
 SG_ RFC_Loc191_RSSI : 488|10@1+ (0.1,0) [0|100] "unitless"  DASy
 SG_ RFC_Loc191_AzimuthalPartnerId : 498|10@1+ (1,0) [0|1023] "unitless"  DASy

BO_ 328 RFC_Location_192_194: 64 RadarFrontCenter
 SG_ RFC_Loc192_194_CRC : 0|16@1+ (1,0) [0|65535] ""  DASy
 SG_ RFC_Loc192_194_AliveCtr : 16|8@1+ (1,0) [0|255] ""  DASy
 SG_ RFC_Loc192_194_ProtBlockCtr : 24|4@1+ (1,0) [0|15] ""  DASy
 SG_ RFC_Loc192_RadialDistance : 32|15@1+ (0.01,0) [0|327.67] "m"  DASy
 SG_ RFC_Loc192_RadialVelocity : 47|15@1+ (0.01,-163.84) [-110|55] "m/s"  DASy
 SG_ RFC_Loc192_Elevation : 62|10@1+ (0.1,-51.2) [-45|45] "deg"  DASy
 SG_ RFC_Loc192_Azimuth : 72|11@1+ (0.1,-102.4) [-90|90] "deg"  DASy
 SG_ RFC_Loc192_DistVelocityCoVnce : 83|11@1+ (0.0001,-0.1024) [-0.1024|0.1023] "m^2/s"  DASy
 SG_ RFC_Loc192_RadialDistanceVnce : 94|10@1+ (5E-005,0) [0|0.05115] "m^2"  DASy
 SG_ RFC_Loc192_RadialVelocityVnce : 104|10@1+ (0.0001,0) [0|0.1023] "m^2/s^2"  DASy
 SG_ RFC_Loc192_ElevationVnce : 114|10@1+ (0.001,0) [0|1.023] "deg^2"  DASy
 SG_ RFC_Loc192_AzimuthVnce : 124|10@1+ (0.001,0) [0|1.023] "deg^2"  DASy
 SG_ RFC_Loc192_RadarCrossSection : 134|10@1+ (0.2,-102.4) [-50|70] "dBsm"  DASy
 SG_ RFC_Loc192_DistVelocityQuality : 144|8@1+ (1,0) [0|255] "unitless"  DASy
 SG_ RFC_Loc192_ElevationQuality : 152|8@1+ (1,0) [0|255] "unitless"  DASy
 SG_ RFC_Loc192_AzimuthQuality : 160|8@1+ (1,0) [0|255] "unitless"  DASy
 SG_ RFC_Loc192_RSSI : 168|10@1+ (0.1,0) [0|100] "unitless"  DASy
 SG_ RFC_Loc192_AzimuthalPartnerId : 178|10@1+ (1,0) [0|1023] "unitless"  DASy
 SG_ RFC_Loc193_RadialDistance : 192|15@1+ (0.01,0) [0|327.67] "m"  DASy
 SG_ RFC_Loc193_RadialVelocity : 207|15@1+ (0.01,-163.84) [-110|55] "m/s"  DASy
 SG_ RFC_Loc193_Elevation : 222|10@1+ (0.1,-51.2) [-45|45] "deg"  DASy
 SG_ RFC_Loc193_Azimuth : 232|11@1+ (0.1,-102.4) [-90|90] "deg"  DASy
 SG_ RFC_Loc193_DistVelocityCoVnce : 243|11@1+ (0.0001,-0.1024) [-0.1024|0.1023] "m^2/s"  DASy
 SG_ RFC_Loc193_RadialDistanceVnce : 254|10@1+ (5E-005,0) [0|0.05115] "m^2"  DASy
 SG_ RFC_Loc193_RadialVelocityVnce : 264|10@1+ (0.0001,0) [0|0.1023] "m^2/s^2"  DASy
 SG_ RFC_Loc193_ElevationVnce : 274|10@1+ (0.001,0) [0|1.023] "deg^2"  DASy
 SG_ RFC_Loc193_AzimuthVnce : 284|10@1+ (0.001,0) [0|1.023] "deg^2"  DASy
 SG_ RFC_Loc193_RadarCrossSection : 294|10@1+ (0.2,-102.4) [-50|70] "dBsm"  DASy
 SG_ RFC_Loc193_DistVelocityQuality : 304|8@1+ (1,0) [0|255] "unitless"  DASy
 SG_ RFC_Loc193_ElevationQuality : 312|8@1+ (1,0) [0|255] "unitless"  DASy
 SG_ RFC_Loc193_AzimuthQuality : 320|8@1+ (1,0) [0|255] "unitless"  DASy
 SG_ RFC_Loc193_RSSI : 328|10@1+ (0.1,0) [0|100] "unitless"  DASy
 SG_ RFC_Loc193_AzimuthalPartnerId : 338|10@1+ (1,0) [0|1023] "unitless"  DASy
 SG_ RFC_Loc194_RadialDistance : 352|15@1+ (0.01,0) [0|327.67] "m"  DASy
 SG_ RFC_Loc194_RadialVelocity : 367|15@1+ (0.01,-163.84) [-110|55] "m/s"  DASy
 SG_ RFC_Loc194_Elevation : 382|10@1+ (0.1,-51.2) [-45|45] "deg"  DASy
 SG_ RFC_Loc194_Azimuth : 392|11@1+ (0.1,-102.4) [-90|90] "deg"  DASy
 SG_ RFC_Loc194_DistVelocityCoVnce : 403|11@1+ (0.0001,-0.1024) [-0.1024|0.1023] "m^2/s"  DASy
 SG_ RFC_Loc194_RadialDistanceVnce : 414|10@1+ (5E-005,0) [0|0.05115] "m^2"  DASy
 SG_ RFC_Loc194_RadialVelocityVnce : 424|10@1+ (0.0001,0) [0|0.1023] "m^2/s^2"  DASy
 SG_ RFC_Loc194_ElevationVnce : 434|10@1+ (0.001,0) [0|1.023] "deg^2"  DASy
 SG_ RFC_Loc194_AzimuthVnce : 444|10@1+ (0.001,0) [0|1.023] "deg^2"  DASy
 SG_ RFC_Loc194_RadarCrossSection : 454|10@1+ (0.2,-102.4) [-50|70] "dBsm"  DASy
 SG_ RFC_Loc194_DistVelocityQuality : 464|8@1+ (1,0) [0|255] "unitless"  DASy
 SG_ RFC_Loc194_ElevationQuality : 472|8@1+ (1,0) [0|255] "unitless"  DASy
 SG_ RFC_Loc194_AzimuthQuality : 480|8@1+ (1,0) [0|255] "unitless"  DASy
 SG_ RFC_Loc194_RSSI : 488|10@1+ (0.1,0) [0|100] "unitless"  DASy
 SG_ RFC_Loc194_AzimuthalPartnerId : 498|10@1+ (1,0) [0|1023] "unitless"  DASy

BO_ 329 RFC_Location_195_197: 64 RadarFrontCenter
 SG_ RFC_Loc195_197_CRC : 0|16@1+ (1,0) [0|65535] ""  DASy
 SG_ RFC_Loc195_197_AliveCtr : 16|8@1+ (1,0) [0|255] ""  DASy
 SG_ RFC_Loc195_197_ProtBlockCtr : 24|4@1+ (1,0) [0|15] ""  DASy
 SG_ RFC_Loc195_RadialDistance : 32|15@1+ (0.01,0) [0|327.67] "m"  DASy
 SG_ RFC_Loc195_RadialVelocity : 47|15@1+ (0.01,-163.84) [-110|55] "m/s"  DASy
 SG_ RFC_Loc195_Elevation : 62|10@1+ (0.1,-51.2) [-45|45] "deg"  DASy
 SG_ RFC_Loc195_Azimuth : 72|11@1+ (0.1,-102.4) [-90|90] "deg"  DASy
 SG_ RFC_Loc195_DistVelocityCoVnce : 83|11@1+ (0.0001,-0.1024) [-0.1024|0.1023] "m^2/s"  DASy
 SG_ RFC_Loc195_RadialDistanceVnce : 94|10@1+ (5E-005,0) [0|0.05115] "m^2"  DASy
 SG_ RFC_Loc195_RadialVelocityVnce : 104|10@1+ (0.0001,0) [0|0.1023] "m^2/s^2"  DASy
 SG_ RFC_Loc195_ElevationVnce : 114|10@1+ (0.001,0) [0|1.023] "deg^2"  DASy
 SG_ RFC_Loc195_AzimuthVnce : 124|10@1+ (0.001,0) [0|1.023] "deg^2"  DASy
 SG_ RFC_Loc195_RadarCrossSection : 134|10@1+ (0.2,-102.4) [-50|70] "dBsm"  DASy
 SG_ RFC_Loc195_DistVelocityQuality : 144|8@1+ (1,0) [0|255] "unitless"  DASy
 SG_ RFC_Loc195_ElevationQuality : 152|8@1+ (1,0) [0|255] "unitless"  DASy
 SG_ RFC_Loc195_AzimuthQuality : 160|8@1+ (1,0) [0|255] "unitless"  DASy
 SG_ RFC_Loc195_RSSI : 168|10@1+ (0.1,0) [0|100] "unitless"  DASy
 SG_ RFC_Loc195_AzimuthalPartnerId : 178|10@1+ (1,0) [0|1023] "unitless"  DASy
 SG_ RFC_Loc196_RadialDistance : 192|15@1+ (0.01,0) [0|327.67] "m"  DASy
 SG_ RFC_Loc196_RadialVelocity : 207|15@1+ (0.01,-163.84) [-110|55] "m/s"  DASy
 SG_ RFC_Loc196_Elevation : 222|10@1+ (0.1,-51.2) [-45|45] "deg"  DASy
 SG_ RFC_Loc196_Azimuth : 232|11@1+ (0.1,-102.4) [-90|90] "deg"  DASy
 SG_ RFC_Loc196_DistVelocityCoVnce : 243|11@1+ (0.0001,-0.1024) [-0.1024|0.1023] "m^2/s"  DASy
 SG_ RFC_Loc196_RadialDistanceVnce : 254|10@1+ (5E-005,0) [0|0.05115] "m^2"  DASy
 SG_ RFC_Loc196_RadialVelocityVnce : 264|10@1+ (0.0001,0) [0|0.1023] "m^2/s^2"  DASy
 SG_ RFC_Loc196_ElevationVnce : 274|10@1+ (0.001,0) [0|1.023] "deg^2"  DASy
 SG_ RFC_Loc196_AzimuthVnce : 284|10@1+ (0.001,0) [0|1.023] "deg^2"  DASy
 SG_ RFC_Loc196_RadarCrossSection : 294|10@1+ (0.2,-102.4) [-50|70] "dBsm"  DASy
 SG_ RFC_Loc196_DistVelocityQuality : 304|8@1+ (1,0) [0|255] "unitless"  DASy
 SG_ RFC_Loc196_ElevationQuality : 312|8@1+ (1,0) [0|255] "unitless"  DASy
 SG_ RFC_Loc196_AzimuthQuality : 320|8@1+ (1,0) [0|255] "unitless"  DASy
 SG_ RFC_Loc196_RSSI : 328|10@1+ (0.1,0) [0|100] "unitless"  DASy
 SG_ RFC_Loc196_AzimuthalPartnerId : 338|10@1+ (1,0) [0|1023] "unitless"  DASy
 SG_ RFC_Loc197_RadialDistance : 352|15@1+ (0.01,0) [0|327.67] "m"  DASy
 SG_ RFC_Loc197_RadialVelocity : 367|15@1+ (0.01,-163.84) [-110|55] "m/s"  DASy
 SG_ RFC_Loc197_Elevation : 382|10@1+ (0.1,-51.2) [-45|45] "deg"  DASy
 SG_ RFC_Loc197_Azimuth : 392|11@1+ (0.1,-102.4) [-90|90] "deg"  DASy
 SG_ RFC_Loc197_DistVelocityCoVnce : 403|11@1+ (0.0001,-0.1024) [-0.1024|0.1023] "m^2/s"  DASy
 SG_ RFC_Loc197_RadialDistanceVnce : 414|10@1+ (5E-005,0) [0|0.05115] "m^2"  DASy
 SG_ RFC_Loc197_RadialVelocityVnce : 424|10@1+ (0.0001,0) [0|0.1023] "m^2/s^2"  DASy
 SG_ RFC_Loc197_ElevationVnce : 434|10@1+ (0.001,0) [0|1.023] "deg^2"  DASy
 SG_ RFC_Loc197_AzimuthVnce : 444|10@1+ (0.001,0) [0|1.023] "deg^2"  DASy
 SG_ RFC_Loc197_RadarCrossSection : 454|10@1+ (0.2,-102.4) [-50|70] "dBsm"  DASy
 SG_ RFC_Loc197_DistVelocityQuality : 464|8@1+ (1,0) [0|255] "unitless"  DASy
 SG_ RFC_Loc197_ElevationQuality : 472|8@1+ (1,0) [0|255] "unitless"  DASy
 SG_ RFC_Loc197_AzimuthQuality : 480|8@1+ (1,0) [0|255] "unitless"  DASy
 SG_ RFC_Loc197_RSSI : 488|10@1+ (0.1,0) [0|100] "unitless"  DASy
 SG_ RFC_Loc197_AzimuthalPartnerId : 498|10@1+ (1,0) [0|1023] "unitless"  DASy

BO_ 330 RFC_Location_198_200: 64 RadarFrontCenter
 SG_ RFC_Loc198_200_CRC : 0|16@1+ (1,0) [0|65535] ""  DASy
 SG_ RFC_Loc198_200_AliveCtr : 16|8@1+ (1,0) [0|255] ""  DASy
 SG_ RFC_Loc198_200_ProtBlockCtr : 24|4@1+ (1,0) [0|15] ""  DASy
 SG_ RFC_Loc198_RadialDistance : 32|15@1+ (0.01,0) [0|327.67] "m"  DASy
 SG_ RFC_Loc198_RadialVelocity : 47|15@1+ (0.01,-163.84) [-110|55] "m/s"  DASy
 SG_ RFC_Loc198_Elevation : 62|10@1+ (0.1,-51.2) [-45|45] "deg"  DASy
 SG_ RFC_Loc198_Azimuth : 72|11@1+ (0.1,-102.4) [-90|90] "deg"  DASy
 SG_ RFC_Loc198_DistVelocityCoVnce : 83|11@1+ (0.0001,-0.1024) [-0.1024|0.1023] "m^2/s"  DASy
 SG_ RFC_Loc198_RadialDistanceVnce : 94|10@1+ (5E-005,0) [0|0.05115] "m^2"  DASy
 SG_ RFC_Loc198_RadialVelocityVnce : 104|10@1+ (0.0001,0) [0|0.1023] "m^2/s^2"  DASy
 SG_ RFC_Loc198_ElevationVnce : 114|10@1+ (0.001,0) [0|1.023] "deg^2"  DASy
 SG_ RFC_Loc198_AzimuthVnce : 124|10@1+ (0.001,0) [0|1.023] "deg^2"  DASy
 SG_ RFC_Loc198_RadarCrossSection : 134|10@1+ (0.2,-102.4) [-50|70] "dBsm"  DASy
 SG_ RFC_Loc198_DistVelocityQuality : 144|8@1+ (1,0) [0|255] "unitless"  DASy
 SG_ RFC_Loc198_ElevationQuality : 152|8@1+ (1,0) [0|255] "unitless"  DASy
 SG_ RFC_Loc198_AzimuthQuality : 160|8@1+ (1,0) [0|255] "unitless"  DASy
 SG_ RFC_Loc198_RSSI : 168|10@1+ (0.1,0) [0|100] "unitless"  DASy
 SG_ RFC_Loc198_AzimuthalPartnerId : 178|10@1+ (1,0) [0|1023] "unitless"  DASy
 SG_ RFC_Loc199_RadialDistance : 192|15@1+ (0.01,0) [0|327.67] "m"  DASy
 SG_ RFC_Loc199_RadialVelocity : 207|15@1+ (0.01,-163.84) [-110|55] "m/s"  DASy
 SG_ RFC_Loc199_Elevation : 222|10@1+ (0.1,-51.2) [-45|45] "deg"  DASy
 SG_ RFC_Loc199_Azimuth : 232|11@1+ (0.1,-102.4) [-90|90] "deg"  DASy
 SG_ RFC_Loc199_DistVelocityCoVnce : 243|11@1+ (0.0001,-0.1024) [-0.1024|0.1023] "m^2/s"  DASy
 SG_ RFC_Loc199_RadialDistanceVnce : 254|10@1+ (5E-005,0) [0|0.05115] "m^2"  DASy
 SG_ RFC_Loc199_RadialVelocityVnce : 264|10@1+ (0.0001,0) [0|0.1023] "m^2/s^2"  DASy
 SG_ RFC_Loc199_ElevationVnce : 274|10@1+ (0.001,0) [0|1.023] "deg^2"  DASy
 SG_ RFC_Loc199_AzimuthVnce : 284|10@1+ (0.001,0) [0|1.023] "deg^2"  DASy
 SG_ RFC_Loc199_RadarCrossSection : 294|10@1+ (0.2,-102.4) [-50|70] "dBsm"  DASy
 SG_ RFC_Loc199_DistVelocityQuality : 304|8@1+ (1,0) [0|255] "unitless"  DASy
 SG_ RFC_Loc199_ElevationQuality : 312|8@1+ (1,0) [0|255] "unitless"  DASy
 SG_ RFC_Loc199_AzimuthQuality : 320|8@1+ (1,0) [0|255] "unitless"  DASy
 SG_ RFC_Loc199_RSSI : 328|10@1+ (0.1,0) [0|100] "unitless"  DASy
 SG_ RFC_Loc199_AzimuthalPartnerId : 338|10@1+ (1,0) [0|1023] "unitless"  DASy
 SG_ RFC_Loc200_RadialDistance : 352|15@1+ (0.01,0) [0|327.67] "m"  DASy
 SG_ RFC_Loc200_RadialVelocity : 367|15@1+ (0.01,-163.84) [-110|55] "m/s"  DASy
 SG_ RFC_Loc200_Elevation : 382|10@1+ (0.1,-51.2) [-45|45] "deg"  DASy
 SG_ RFC_Loc200_Azimuth : 392|11@1+ (0.1,-102.4) [-90|90] "deg"  DASy
 SG_ RFC_Loc200_DistVelocityCoVnce : 403|11@1+ (0.0001,-0.1024) [-0.1024|0.1023] "m^2/s"  DASy
 SG_ RFC_Loc200_RadialDistanceVnce : 414|10@1+ (5E-005,0) [0|0.05115] "m^2"  DASy
 SG_ RFC_Loc200_RadialVelocityVnce : 424|10@1+ (0.0001,0) [0|0.1023] "m^2/s^2"  DASy
 SG_ RFC_Loc200_ElevationVnce : 434|10@1+ (0.001,0) [0|1.023] "deg^2"  DASy
 SG_ RFC_Loc200_AzimuthVnce : 444|10@1+ (0.001,0) [0|1.023] "deg^2"  DASy
 SG_ RFC_Loc200_RadarCrossSection : 454|10@1+ (0.2,-102.4) [-50|70] "dBsm"  DASy
 SG_ RFC_Loc200_DistVelocityQuality : 464|8@1+ (1,0) [0|255] "unitless"  DASy
 SG_ RFC_Loc200_ElevationQuality : 472|8@1+ (1,0) [0|255] "unitless"  DASy
 SG_ RFC_Loc200_AzimuthQuality : 480|8@1+ (1,0) [0|255] "unitless"  DASy
 SG_ RFC_Loc200_RSSI : 488|10@1+ (0.1,0) [0|100] "unitless"  DASy
 SG_ RFC_Loc200_AzimuthalPartnerId : 498|10@1+ (1,0) [0|1023] "unitless"  DASy

BO_ 331 RFC_Location_201_203: 64 RadarFrontCenter
 SG_ RFC_Loc201_203_CRC : 0|16@1+ (1,0) [0|65535] ""  DASy
 SG_ RFC_Loc201_203_AliveCtr : 16|8@1+ (1,0) [0|255] ""  DASy
 SG_ RFC_Loc201_203_ProtBlockCtr : 24|4@1+ (1,0) [0|15] ""  DASy
 SG_ RFC_Loc201_RadialDistance : 32|15@1+ (0.01,0) [0|327.67] "m"  DASy
 SG_ RFC_Loc201_RadialVelocity : 47|15@1+ (0.01,-163.84) [-110|55] "m/s"  DASy
 SG_ RFC_Loc201_Elevation : 62|10@1+ (0.1,-51.2) [-45|45] "deg"  DASy
 SG_ RFC_Loc201_Azimuth : 72|11@1+ (0.1,-102.4) [-90|90] "deg"  DASy
 SG_ RFC_Loc201_DistVelocityCoVnce : 83|11@1+ (0.0001,-0.1024) [-0.1024|0.1023] "m^2/s"  DASy
 SG_ RFC_Loc201_RadialDistanceVnce : 94|10@1+ (5E-005,0) [0|0.05115] "m^2"  DASy
 SG_ RFC_Loc201_RadialVelocityVnce : 104|10@1+ (0.0001,0) [0|0.1023] "m^2/s^2"  DASy
 SG_ RFC_Loc201_ElevationVnce : 114|10@1+ (0.001,0) [0|1.023] "deg^2"  DASy
 SG_ RFC_Loc201_AzimuthVnce : 124|10@1+ (0.001,0) [0|1.023] "deg^2"  DASy
 SG_ RFC_Loc201_RadarCrossSection : 134|10@1+ (0.2,-102.4) [-50|70] "dBsm"  DASy
 SG_ RFC_Loc201_DistVelocityQuality : 144|8@1+ (1,0) [0|255] "unitless"  DASy
 SG_ RFC_Loc201_ElevationQuality : 152|8@1+ (1,0) [0|255] "unitless"  DASy
 SG_ RFC_Loc201_AzimuthQuality : 160|8@1+ (1,0) [0|255] "unitless"  DASy
 SG_ RFC_Loc201_RSSI : 168|10@1+ (0.1,0) [0|100] "unitless"  DASy
 SG_ RFC_Loc201_AzimuthalPartnerId : 178|10@1+ (1,0) [0|1023] "unitless"  DASy
 SG_ RFC_Loc202_RadialDistance : 192|15@1+ (0.01,0) [0|327.67] "m"  DASy
 SG_ RFC_Loc202_RadialVelocity : 207|15@1+ (0.01,-163.84) [-110|55] "m/s"  DASy
 SG_ RFC_Loc202_Elevation : 222|10@1+ (0.1,-51.2) [-45|45] "deg"  DASy
 SG_ RFC_Loc202_Azimuth : 232|11@1+ (0.1,-102.4) [-90|90] "deg"  DASy
 SG_ RFC_Loc202_DistVelocityCoVnce : 243|11@1+ (0.0001,-0.1024) [-0.1024|0.1023] "m^2/s"  DASy
 SG_ RFC_Loc202_RadialDistanceVnce : 254|10@1+ (5E-005,0) [0|0.05115] "m^2"  DASy
 SG_ RFC_Loc202_RadialVelocityVnce : 264|10@1+ (0.0001,0) [0|0.1023] "m^2/s^2"  DASy
 SG_ RFC_Loc202_ElevationVnce : 274|10@1+ (0.001,0) [0|1.023] "deg^2"  DASy
 SG_ RFC_Loc202_AzimuthVnce : 284|10@1+ (0.001,0) [0|1.023] "deg^2"  DASy
 SG_ RFC_Loc202_RadarCrossSection : 294|10@1+ (0.2,-102.4) [-50|70] "dBsm"  DASy
 SG_ RFC_Loc202_DistVelocityQuality : 304|8@1+ (1,0) [0|255] "unitless"  DASy
 SG_ RFC_Loc202_ElevationQuality : 312|8@1+ (1,0) [0|255] "unitless"  DASy
 SG_ RFC_Loc202_AzimuthQuality : 320|8@1+ (1,0) [0|255] "unitless"  DASy
 SG_ RFC_Loc202_RSSI : 328|10@1+ (0.1,0) [0|100] "unitless"  DASy
 SG_ RFC_Loc202_AzimuthalPartnerId : 338|10@1+ (1,0) [0|1023] "unitless"  DASy
 SG_ RFC_Loc203_RadialDistance : 352|15@1+ (0.01,0) [0|327.67] "m"  DASy
 SG_ RFC_Loc203_RadialVelocity : 367|15@1+ (0.01,-163.84) [-110|55] "m/s"  DASy
 SG_ RFC_Loc203_Elevation : 382|10@1+ (0.1,-51.2) [-45|45] "deg"  DASy
 SG_ RFC_Loc203_Azimuth : 392|11@1+ (0.1,-102.4) [-90|90] "deg"  DASy
 SG_ RFC_Loc203_DistVelocityCoVnce : 403|11@1+ (0.0001,-0.1024) [-0.1024|0.1023] "m^2/s"  DASy
 SG_ RFC_Loc203_RadialDistanceVnce : 414|10@1+ (5E-005,0) [0|0.05115] "m^2"  DASy
 SG_ RFC_Loc203_RadialVelocityVnce : 424|10@1+ (0.0001,0) [0|0.1023] "m^2/s^2"  DASy
 SG_ RFC_Loc203_ElevationVnce : 434|10@1+ (0.001,0) [0|1.023] "deg^2"  DASy
 SG_ RFC_Loc203_AzimuthVnce : 444|10@1+ (0.001,0) [0|1.023] "deg^2"  DASy
 SG_ RFC_Loc203_RadarCrossSection : 454|10@1+ (0.2,-102.4) [-50|70] "dBsm"  DASy
 SG_ RFC_Loc203_DistVelocityQuality : 464|8@1+ (1,0) [0|255] "unitless"  DASy
 SG_ RFC_Loc203_ElevationQuality : 472|8@1+ (1,0) [0|255] "unitless"  DASy
 SG_ RFC_Loc203_AzimuthQuality : 480|8@1+ (1,0) [0|255] "unitless"  DASy
 SG_ RFC_Loc203_RSSI : 488|10@1+ (0.1,0) [0|100] "unitless"  DASy
 SG_ RFC_Loc203_AzimuthalPartnerId : 498|10@1+ (1,0) [0|1023] "unitless"  DASy

BO_ 332 RFC_Location_204_206: 64 RadarFrontCenter
 SG_ RFC_Loc204_206_CRC : 0|16@1+ (1,0) [0|65535] ""  DASy
 SG_ RFC_Loc204_206_AliveCtr : 16|8@1+ (1,0) [0|255] ""  DASy
 SG_ RFC_Loc204_206_ProtBlockCtr : 24|4@1+ (1,0) [0|15] ""  DASy
 SG_ RFC_Loc204_RadialDistance : 32|15@1+ (0.01,0) [0|327.67] "m"  DASy
 SG_ RFC_Loc204_RadialVelocity : 47|15@1+ (0.01,-163.84) [-110|55] "m/s"  DASy
 SG_ RFC_Loc204_Elevation : 62|10@1+ (0.1,-51.2) [-45|45] "deg"  DASy
 SG_ RFC_Loc204_Azimuth : 72|11@1+ (0.1,-102.4) [-90|90] "deg"  DASy
 SG_ RFC_Loc204_DistVelocityCoVnce : 83|11@1+ (0.0001,-0.1024) [-0.1024|0.1023] "m^2/s"  DASy
 SG_ RFC_Loc204_RadialDistanceVnce : 94|10@1+ (5E-005,0) [0|0.05115] "m^2"  DASy
 SG_ RFC_Loc204_RadialVelocityVnce : 104|10@1+ (0.0001,0) [0|0.1023] "m^2/s^2"  DASy
 SG_ RFC_Loc204_ElevationVnce : 114|10@1+ (0.001,0) [0|1.023] "deg^2"  DASy
 SG_ RFC_Loc204_AzimuthVnce : 124|10@1+ (0.001,0) [0|1.023] "deg^2"  DASy
 SG_ RFC_Loc204_RadarCrossSection : 134|10@1+ (0.2,-102.4) [-50|70] "dBsm"  DASy
 SG_ RFC_Loc204_DistVelocityQuality : 144|8@1+ (1,0) [0|255] "unitless"  DASy
 SG_ RFC_Loc204_ElevationQuality : 152|8@1+ (1,0) [0|255] "unitless"  DASy
 SG_ RFC_Loc204_AzimuthQuality : 160|8@1+ (1,0) [0|255] "unitless"  DASy
 SG_ RFC_Loc204_RSSI : 168|10@1+ (0.1,0) [0|100] "unitless"  DASy
 SG_ RFC_Loc204_AzimuthalPartnerId : 178|10@1+ (1,0) [0|1023] "unitless"  DASy
 SG_ RFC_Loc205_RadialDistance : 192|15@1+ (0.01,0) [0|327.67] "m"  DASy
 SG_ RFC_Loc205_RadialVelocity : 207|15@1+ (0.01,-163.84) [-110|55] "m/s"  DASy
 SG_ RFC_Loc205_Elevation : 222|10@1+ (0.1,-51.2) [-45|45] "deg"  DASy
 SG_ RFC_Loc205_Azimuth : 232|11@1+ (0.1,-102.4) [-90|90] "deg"  DASy
 SG_ RFC_Loc205_DistVelocityCoVnce : 243|11@1+ (0.0001,-0.1024) [-0.1024|0.1023] "m^2/s"  DASy
 SG_ RFC_Loc205_RadialDistanceVnce : 254|10@1+ (5E-005,0) [0|0.05115] "m^2"  DASy
 SG_ RFC_Loc205_RadialVelocityVnce : 264|10@1+ (0.0001,0) [0|0.1023] "m^2/s^2"  DASy
 SG_ RFC_Loc205_ElevationVnce : 274|10@1+ (0.001,0) [0|1.023] "deg^2"  DASy
 SG_ RFC_Loc205_AzimuthVnce : 284|10@1+ (0.001,0) [0|1.023] "deg^2"  DASy
 SG_ RFC_Loc205_RadarCrossSection : 294|10@1+ (0.2,-102.4) [-50|70] "dBsm"  DASy
 SG_ RFC_Loc205_DistVelocityQuality : 304|8@1+ (1,0) [0|255] "unitless"  DASy
 SG_ RFC_Loc205_ElevationQuality : 312|8@1+ (1,0) [0|255] "unitless"  DASy
 SG_ RFC_Loc205_AzimuthQuality : 320|8@1+ (1,0) [0|255] "unitless"  DASy
 SG_ RFC_Loc205_RSSI : 328|10@1+ (0.1,0) [0|100] "unitless"  DASy
 SG_ RFC_Loc205_AzimuthalPartnerId : 338|10@1+ (1,0) [0|1023] "unitless"  DASy
 SG_ RFC_Loc206_RadialDistance : 352|15@1+ (0.01,0) [0|327.67] "m"  DASy
 SG_ RFC_Loc206_RadialVelocity : 367|15@1+ (0.01,-163.84) [-110|55] "m/s"  DASy
 SG_ RFC_Loc206_Elevation : 382|10@1+ (0.1,-51.2) [-45|45] "deg"  DASy
 SG_ RFC_Loc206_Azimuth : 392|11@1+ (0.1,-102.4) [-90|90] "deg"  DASy
 SG_ RFC_Loc206_DistVelocityCoVnce : 403|11@1+ (0.0001,-0.1024) [-0.1024|0.1023] "m^2/s"  DASy
 SG_ RFC_Loc206_RadialDistanceVnce : 414|10@1+ (5E-005,0) [0|0.05115] "m^2"  DASy
 SG_ RFC_Loc206_RadialVelocityVnce : 424|10@1+ (0.0001,0) [0|0.1023] "m^2/s^2"  DASy
 SG_ RFC_Loc206_ElevationVnce : 434|10@1+ (0.001,0) [0|1.023] "deg^2"  DASy
 SG_ RFC_Loc206_AzimuthVnce : 444|10@1+ (0.001,0) [0|1.023] "deg^2"  DASy
 SG_ RFC_Loc206_RadarCrossSection : 454|10@1+ (0.2,-102.4) [-50|70] "dBsm"  DASy
 SG_ RFC_Loc206_DistVelocityQuality : 464|8@1+ (1,0) [0|255] "unitless"  DASy
 SG_ RFC_Loc206_ElevationQuality : 472|8@1+ (1,0) [0|255] "unitless"  DASy
 SG_ RFC_Loc206_AzimuthQuality : 480|8@1+ (1,0) [0|255] "unitless"  DASy
 SG_ RFC_Loc206_RSSI : 488|10@1+ (0.1,0) [0|100] "unitless"  DASy
 SG_ RFC_Loc206_AzimuthalPartnerId : 498|10@1+ (1,0) [0|1023] "unitless"  DASy

BO_ 333 RFC_Location_207_209: 64 RadarFrontCenter
 SG_ RFC_Loc207_209_CRC : 0|16@1+ (1,0) [0|65535] ""  DASy
 SG_ RFC_Loc207_209_AliveCtr : 16|8@1+ (1,0) [0|255] ""  DASy
 SG_ RFC_Loc207_209_ProtBlockCtr : 24|4@1+ (1,0) [0|15] ""  DASy
 SG_ RFC_Loc207_RadialDistance : 32|15@1+ (0.01,0) [0|327.67] "m"  DASy
 SG_ RFC_Loc207_RadialVelocity : 47|15@1+ (0.01,-163.84) [-110|55] "m/s"  DASy
 SG_ RFC_Loc207_Elevation : 62|10@1+ (0.1,-51.2) [-45|45] "deg"  DASy
 SG_ RFC_Loc207_Azimuth : 72|11@1+ (0.1,-102.4) [-90|90] "deg"  DASy
 SG_ RFC_Loc207_DistVelocityCoVnce : 83|11@1+ (0.0001,-0.1024) [-0.1024|0.1023] "m^2/s"  DASy
 SG_ RFC_Loc207_RadialDistanceVnce : 94|10@1+ (5E-005,0) [0|0.05115] "m^2"  DASy
 SG_ RFC_Loc207_RadialVelocityVnce : 104|10@1+ (0.0001,0) [0|0.1023] "m^2/s^2"  DASy
 SG_ RFC_Loc207_ElevationVnce : 114|10@1+ (0.001,0) [0|1.023] "deg^2"  DASy
 SG_ RFC_Loc207_AzimuthVnce : 124|10@1+ (0.001,0) [0|1.023] "deg^2"  DASy
 SG_ RFC_Loc207_RadarCrossSection : 134|10@1+ (0.2,-102.4) [-50|70] "dBsm"  DASy
 SG_ RFC_Loc207_DistVelocityQuality : 144|8@1+ (1,0) [0|255] "unitless"  DASy
 SG_ RFC_Loc207_ElevationQuality : 152|8@1+ (1,0) [0|255] "unitless"  DASy
 SG_ RFC_Loc207_AzimuthQuality : 160|8@1+ (1,0) [0|255] "unitless"  DASy
 SG_ RFC_Loc207_RSSI : 168|10@1+ (0.1,0) [0|100] "unitless"  DASy
 SG_ RFC_Loc207_AzimuthalPartnerId : 178|10@1+ (1,0) [0|1023] "unitless"  DASy
 SG_ RFC_Loc208_RadialDistance : 192|15@1+ (0.01,0) [0|327.67] "m"  DASy
 SG_ RFC_Loc208_RadialVelocity : 207|15@1+ (0.01,-163.84) [-110|55] "m/s"  DASy
 SG_ RFC_Loc208_Elevation : 222|10@1+ (0.1,-51.2) [-45|45] "deg"  DASy
 SG_ RFC_Loc208_Azimuth : 232|11@1+ (0.1,-102.4) [-90|90] "deg"  DASy
 SG_ RFC_Loc208_DistVelocityCoVnce : 243|11@1+ (0.0001,-0.1024) [-0.1024|0.1023] "m^2/s"  DASy
 SG_ RFC_Loc208_RadialDistanceVnce : 254|10@1+ (5E-005,0) [0|0.05115] "m^2"  DASy
 SG_ RFC_Loc208_RadialVelocityVnce : 264|10@1+ (0.0001,0) [0|0.1023] "m^2/s^2"  DASy
 SG_ RFC_Loc208_ElevationVnce : 274|10@1+ (0.001,0) [0|1.023] "deg^2"  DASy
 SG_ RFC_Loc208_AzimuthVnce : 284|10@1+ (0.001,0) [0|1.023] "deg^2"  DASy
 SG_ RFC_Loc208_RadarCrossSection : 294|10@1+ (0.2,-102.4) [-50|70] "dBsm"  DASy
 SG_ RFC_Loc208_DistVelocityQuality : 304|8@1+ (1,0) [0|255] "unitless"  DASy
 SG_ RFC_Loc208_ElevationQuality : 312|8@1+ (1,0) [0|255] "unitless"  DASy
 SG_ RFC_Loc208_AzimuthQuality : 320|8@1+ (1,0) [0|255] "unitless"  DASy
 SG_ RFC_Loc208_RSSI : 328|10@1+ (0.1,0) [0|100] "unitless"  DASy
 SG_ RFC_Loc208_AzimuthalPartnerId : 338|10@1+ (1,0) [0|1023] "unitless"  DASy
 SG_ RFC_Loc209_RadialDistance : 352|15@1+ (0.01,0) [0|327.67] "m"  DASy
 SG_ RFC_Loc209_RadialVelocity : 367|15@1+ (0.01,-163.84) [-110|55] "m/s"  DASy
 SG_ RFC_Loc209_Elevation : 382|10@1+ (0.1,-51.2) [-45|45] "deg"  DASy
 SG_ RFC_Loc209_Azimuth : 392|11@1+ (0.1,-102.4) [-90|90] "deg"  DASy
 SG_ RFC_Loc209_DistVelocityCoVnce : 403|11@1+ (0.0001,-0.1024) [-0.1024|0.1023] "m^2/s"  DASy
 SG_ RFC_Loc209_RadialDistanceVnce : 414|10@1+ (5E-005,0) [0|0.05115] "m^2"  DASy
 SG_ RFC_Loc209_RadialVelocityVnce : 424|10@1+ (0.0001,0) [0|0.1023] "m^2/s^2"  DASy
 SG_ RFC_Loc209_ElevationVnce : 434|10@1+ (0.001,0) [0|1.023] "deg^2"  DASy
 SG_ RFC_Loc209_AzimuthVnce : 444|10@1+ (0.001,0) [0|1.023] "deg^2"  DASy
 SG_ RFC_Loc209_RadarCrossSection : 454|10@1+ (0.2,-102.4) [-50|70] "dBsm"  DASy
 SG_ RFC_Loc209_DistVelocityQuality : 464|8@1+ (1,0) [0|255] "unitless"  DASy
 SG_ RFC_Loc209_ElevationQuality : 472|8@1+ (1,0) [0|255] "unitless"  DASy
 SG_ RFC_Loc209_AzimuthQuality : 480|8@1+ (1,0) [0|255] "unitless"  DASy
 SG_ RFC_Loc209_RSSI : 488|10@1+ (0.1,0) [0|100] "unitless"  DASy
 SG_ RFC_Loc209_AzimuthalPartnerId : 498|10@1+ (1,0) [0|1023] "unitless"  DASy

BO_ 334 RFC_Location_210_212: 64 RadarFrontCenter
 SG_ RFC_Loc210_212_CRC : 0|16@1+ (1,0) [0|65535] ""  DASy
 SG_ RFC_Loc210_212_AliveCtr : 16|8@1+ (1,0) [0|255] ""  DASy
 SG_ RFC_Loc210_212_ProtBlockCtr : 24|4@1+ (1,0) [0|15] ""  DASy
 SG_ RFC_Loc210_RadialDistance : 32|15@1+ (0.01,0) [0|327.67] "m"  DASy
 SG_ RFC_Loc210_RadialVelocity : 47|15@1+ (0.01,-163.84) [-110|55] "m/s"  DASy
 SG_ RFC_Loc210_Elevation : 62|10@1+ (0.1,-51.2) [-45|45] "deg"  DASy
 SG_ RFC_Loc210_Azimuth : 72|11@1+ (0.1,-102.4) [-90|90] "deg"  DASy
 SG_ RFC_Loc210_DistVelocityCoVnce : 83|11@1+ (0.0001,-0.1024) [-0.1024|0.1023] "m^2/s"  DASy
 SG_ RFC_Loc210_RadialDistanceVnce : 94|10@1+ (5E-005,0) [0|0.05115] "m^2"  DASy
 SG_ RFC_Loc210_RadialVelocityVnce : 104|10@1+ (0.0001,0) [0|0.1023] "m^2/s^2"  DASy
 SG_ RFC_Loc210_ElevationVnce : 114|10@1+ (0.001,0) [0|1.023] "deg^2"  DASy
 SG_ RFC_Loc210_AzimuthVnce : 124|10@1+ (0.001,0) [0|1.023] "deg^2"  DASy
 SG_ RFC_Loc210_RadarCrossSection : 134|10@1+ (0.2,-102.4) [-50|70] "dBsm"  DASy
 SG_ RFC_Loc210_DistVelocityQuality : 144|8@1+ (1,0) [0|255] "unitless"  DASy
 SG_ RFC_Loc210_ElevationQuality : 152|8@1+ (1,0) [0|255] "unitless"  DASy
 SG_ RFC_Loc210_AzimuthQuality : 160|8@1+ (1,0) [0|255] "unitless"  DASy
 SG_ RFC_Loc210_RSSI : 168|10@1+ (0.1,0) [0|100] "unitless"  DASy
 SG_ RFC_Loc210_AzimuthalPartnerId : 178|10@1+ (1,0) [0|1023] "unitless"  DASy
 SG_ RFC_Loc211_RadialDistance : 192|15@1+ (0.01,0) [0|327.67] "m"  DASy
 SG_ RFC_Loc211_RadialVelocity : 207|15@1+ (0.01,-163.84) [-110|55] "m/s"  DASy
 SG_ RFC_Loc211_Elevation : 222|10@1+ (0.1,-51.2) [-45|45] "deg"  DASy
 SG_ RFC_Loc211_Azimuth : 232|11@1+ (0.1,-102.4) [-90|90] "deg"  DASy
 SG_ RFC_Loc211_DistVelocityCoVnce : 243|11@1+ (0.0001,-0.1024) [-0.1024|0.1023] "m^2/s"  DASy
 SG_ RFC_Loc211_RadialDistanceVnce : 254|10@1+ (5E-005,0) [0|0.05115] "m^2"  DASy
 SG_ RFC_Loc211_RadialVelocityVnce : 264|10@1+ (0.0001,0) [0|0.1023] "m^2/s^2"  DASy
 SG_ RFC_Loc211_ElevationVnce : 274|10@1+ (0.001,0) [0|1.023] "deg^2"  DASy
 SG_ RFC_Loc211_AzimuthVnce : 284|10@1+ (0.001,0) [0|1.023] "deg^2"  DASy
 SG_ RFC_Loc211_RadarCrossSection : 294|10@1+ (0.2,-102.4) [-50|70] "dBsm"  DASy
 SG_ RFC_Loc211_DistVelocityQuality : 304|8@1+ (1,0) [0|255] "unitless"  DASy
 SG_ RFC_Loc211_ElevationQuality : 312|8@1+ (1,0) [0|255] "unitless"  DASy
 SG_ RFC_Loc211_AzimuthQuality : 320|8@1+ (1,0) [0|255] "unitless"  DASy
 SG_ RFC_Loc211_RSSI : 328|10@1+ (0.1,0) [0|100] "unitless"  DASy
 SG_ RFC_Loc211_AzimuthalPartnerId : 338|10@1+ (1,0) [0|1023] "unitless"  DASy
 SG_ RFC_Loc212_RadialDistance : 352|15@1+ (0.01,0) [0|327.67] "m"  DASy
 SG_ RFC_Loc212_RadialVelocity : 367|15@1+ (0.01,-163.84) [-110|55] "m/s"  DASy
 SG_ RFC_Loc212_Elevation : 382|10@1+ (0.1,-51.2) [-45|45] "deg"  DASy
 SG_ RFC_Loc212_Azimuth : 392|11@1+ (0.1,-102.4) [-90|90] "deg"  DASy
 SG_ RFC_Loc212_DistVelocityCoVnce : 403|11@1+ (0.0001,-0.1024) [-0.1024|0.1023] "m^2/s"  DASy
 SG_ RFC_Loc212_RadialDistanceVnce : 414|10@1+ (5E-005,0) [0|0.05115] "m^2"  DASy
 SG_ RFC_Loc212_RadialVelocityVnce : 424|10@1+ (0.0001,0) [0|0.1023] "m^2/s^2"  DASy
 SG_ RFC_Loc212_ElevationVnce : 434|10@1+ (0.001,0) [0|1.023] "deg^2"  DASy
 SG_ RFC_Loc212_AzimuthVnce : 444|10@1+ (0.001,0) [0|1.023] "deg^2"  DASy
 SG_ RFC_Loc212_RadarCrossSection : 454|10@1+ (0.2,-102.4) [-50|70] "dBsm"  DASy
 SG_ RFC_Loc212_DistVelocityQuality : 464|8@1+ (1,0) [0|255] "unitless"  DASy
 SG_ RFC_Loc212_ElevationQuality : 472|8@1+ (1,0) [0|255] "unitless"  DASy
 SG_ RFC_Loc212_AzimuthQuality : 480|8@1+ (1,0) [0|255] "unitless"  DASy
 SG_ RFC_Loc212_RSSI : 488|10@1+ (0.1,0) [0|100] "unitless"  DASy
 SG_ RFC_Loc212_AzimuthalPartnerId : 498|10@1+ (1,0) [0|1023] "unitless"  DASy

CM_ SG_ 321 RFC_Loc171_173_CRC "CRC - Autosar E2E Profile 5";
CM_ SG_ 321 RFC_Loc171_173_AliveCtr "Alive counter - Autosar E2E Profile 5";
CM_ SG_ 321 RFC_Loc171_173_ProtBlockCtr "Protocol-Signal: Block-Counter";
CM_ SG_ 321 RFC_Loc171_RadialDistance "Location radial distance. Represented in conical coordinate system. Same as ISO 23150:2021(E): Position radial distance (A.4.16)";
CM_ SG_ 321 RFC_Loc171_RadialVelocity "Location radial relative velocity ISO 23150:2021(E): Relative velocity {radial distance} (A.4.18)";
CM_ SG_ 321 RFC_Loc171_Elevation "Location elevation angle. Represented in conical coordinate system. Same as ISO 23150:2021(E): Position elevation (A.4.16)";
CM_ SG_ 321 RFC_Loc171_Azimuth "Location azimuth angle. Represented in conical coordinate system. Deviation from ISO 23150:2021(E): Position azimuth (A.4.16). Further details refers to DSP Location Interface definition";
CM_ SG_ 321 RFC_Loc171_DistVelocityCoVnce "Covariance of radial distance and radial velocity";
CM_ SG_ 321 RFC_Loc171_RadialDistanceVnce "Variance of Location radial distance ISO 23150:2021(E): Position radial distance - error (A.4.17)";
CM_ SG_ 321 RFC_Loc171_RadialVelocityVnce "Variance of Location radial relative velocity ISO 23150:2021(E): Relative velocity {radial distance} - error (A.4.19)";
CM_ SG_ 321 RFC_Loc171_ElevationVnce "Variance of Location elevation angle ISO 23150:2021(E): Position elevation - error (A.4.17)";
CM_ SG_ 321 RFC_Loc171_AzimuthVnce "Variance of Location azimuth angle ISO 23150:2021(E): Position azimuth - error (A.4.17)";
CM_ SG_ 321 RFC_Loc171_RadarCrossSection "Radar Cross Section (RCS) estimation ISO 23150:2021(E): Radar cross section (A.4.5)";
CM_ SG_ 321 RFC_Loc171_DistVelocityQuality "Quality of radial distance and velocity resolution processing. Physical range [0..1]";
CM_ SG_ 321 RFC_Loc171_ElevationQuality "Probability for correct signal model (elevation angle). Physical range [0..1]";
CM_ SG_ 321 RFC_Loc171_AzimuthQuality "Probability for correct signal model (azimuth angle). Physical range [0..1]";
CM_ SG_ 321 RFC_Loc171_RSSI "Received Signal Strength Indication (RSSI). This signal is not exactly ISO 23150:2021(E): Signal to noise ratio - detection level (A.4.7), but SNR can be calculated from this signal. Further detail please refer to the DSP Location Interface definition";
CM_ SG_ 321 RFC_Loc171_AzimuthalPartnerId "Id of the azimuthal partner location";
CM_ SG_ 321 RFC_Loc172_RadialDistance "Location radial distance. Represented in conical coordinate system. Same as ISO 23150:2021(E): Position radial distance (A.4.16)";
CM_ SG_ 321 RFC_Loc172_RadialVelocity "Location radial relative velocity ISO 23150:2021(E): Relative velocity {radial distance} (A.4.18)";
CM_ SG_ 321 RFC_Loc172_Elevation "Location elevation angle. Represented in conical coordinate system. Same as ISO 23150:2021(E): Position elevation (A.4.16)";
CM_ SG_ 321 RFC_Loc172_Azimuth "Location azimuth angle. Represented in conical coordinate system. Deviation from ISO 23150:2021(E): Position azimuth (A.4.16). Further details refers to DSP Location Interface definition";
CM_ SG_ 321 RFC_Loc172_DistVelocityCoVnce "Covariance of radial distance and radial velocity";
CM_ SG_ 321 RFC_Loc172_RadialDistanceVnce "Variance of Location radial distance ISO 23150:2021(E): Position radial distance - error (A.4.17)";
CM_ SG_ 321 RFC_Loc172_RadialVelocityVnce "Variance of Location radial relative velocity ISO 23150:2021(E): Relative velocity {radial distance} - error (A.4.19)";
CM_ SG_ 321 RFC_Loc172_ElevationVnce "Variance of Location elevation angle ISO 23150:2021(E): Position elevation - error (A.4.17)";
CM_ SG_ 321 RFC_Loc172_AzimuthVnce "Variance of Location azimuth angle ISO 23150:2021(E): Position azimuth - error (A.4.17)";
CM_ SG_ 321 RFC_Loc172_RadarCrossSection "Radar Cross Section (RCS) estimation ISO 23150:2021(E): Radar cross section (A.4.5)";
CM_ SG_ 321 RFC_Loc172_DistVelocityQuality "Quality of radial distance and velocity resolution processing. Physical range [0..1]";
CM_ SG_ 321 RFC_Loc172_ElevationQuality "Probability for correct signal model (elevation angle). Physical range [0..1]";
CM_ SG_ 321 RFC_Loc172_AzimuthQuality "Probability for correct signal model (azimuth angle). Physical range [0..1]";
CM_ SG_ 321 RFC_Loc172_RSSI "Received Signal Strength Indication (RSSI). This signal is not exactly ISO 23150:2021(E): Signal to noise ratio - detection level (A.4.7), but SNR can be calculated from this signal. Further detail please refer to the DSP Location Interface definition";
CM_ SG_ 321 RFC_Loc172_AzimuthalPartnerId "Id of the azimuthal partner location";
CM_ SG_ 321 RFC_Loc173_RadialDistance "Location radial distance. Represented in conical coordinate system. Same as ISO 23150:2021(E): Position radial distance (A.4.16)";
CM_ SG_ 321 RFC_Loc173_RadialVelocity "Location radial relative velocity ISO 23150:2021(E): Relative velocity {radial distance} (A.4.18)";
CM_ SG_ 321 RFC_Loc173_Elevation "Location elevation angle. Represented in conical coordinate system. Same as ISO 23150:2021(E): Position elevation (A.4.16)";
CM_ SG_ 321 RFC_Loc173_Azimuth "Location azimuth angle. Represented in conical coordinate system. Deviation from ISO 23150:2021(E): Position azimuth (A.4.16). Further details refers to DSP Location Interface definition";
CM_ SG_ 321 RFC_Loc173_DistVelocityCoVnce "Covariance of radial distance and radial velocity";
CM_ SG_ 321 RFC_Loc173_RadialDistanceVnce "Variance of Location radial distance ISO 23150:2021(E): Position radial distance - error (A.4.17)";
CM_ SG_ 321 RFC_Loc173_RadialVelocityVnce "Variance of Location radial relative velocity ISO 23150:2021(E): Relative velocity {radial distance} - error (A.4.19)";
CM_ SG_ 321 RFC_Loc173_ElevationVnce "Variance of Location elevation angle ISO 23150:2021(E): Position elevation - error (A.4.17)";
CM_ SG_ 321 RFC_Loc173_AzimuthVnce "Variance of Location azimuth angle ISO 23150:2021(E): Position azimuth - error (A.4.17)";
CM_ SG_ 321 RFC_Loc173_RadarCrossSection "Radar Cross Section (RCS) estimation ISO 23150:2021(E): Radar cross section (A.4.5)";
CM_ SG_ 321 RFC_Loc173_DistVelocityQuality "Quality of radial distance and velocity resolution processing. Physical range [0..1]";
CM_ SG_ 321 RFC_Loc173_ElevationQuality "Probability for correct signal model (elevation angle). Physical range [0..1]";
CM_ SG_ 321 RFC_Loc173_AzimuthQuality "Probability for correct signal model (azimuth angle). Physical range [0..1]";
CM_ SG_ 321 RFC_Loc173_RSSI "Received Signal Strength Indication (RSSI). This signal is not exactly ISO 23150:2021(E): Signal to noise ratio - detection level (A.4.7), but SNR can be calculated from this signal. Further detail please refer to the DSP Location Interface definition";
CM_ SG_ 321 RFC_Loc173_AzimuthalPartnerId "Id of the azimuthal partner location";
CM_ SG_ 322 RFC_Loc174_176_CRC "CRC - Autosar E2E Profile 5";
CM_ SG_ 322 RFC_Loc174_176_AliveCtr "Alive counter - Autosar E2E Profile 5";
CM_ SG_ 322 RFC_Loc174_176_ProtBlockCtr "Protocol-Signal: Block-Counter";
CM_ SG_ 322 RFC_Loc174_RadialDistance "Location radial distance. Represented in conical coordinate system. Same as ISO 23150:2021(E): Position radial distance (A.4.16)";
CM_ SG_ 322 RFC_Loc174_RadialVelocity "Location radial relative velocity ISO 23150:2021(E): Relative velocity {radial distance} (A.4.18)";
CM_ SG_ 322 RFC_Loc174_Elevation "Location elevation angle. Represented in conical coordinate system. Same as ISO 23150:2021(E): Position elevation (A.4.16)";
CM_ SG_ 322 RFC_Loc174_Azimuth "Location azimuth angle. Represented in conical coordinate system. Deviation from ISO 23150:2021(E): Position azimuth (A.4.16). Further details refers to DSP Location Interface definition";
CM_ SG_ 322 RFC_Loc174_DistVelocityCoVnce "Covariance of radial distance and radial velocity";
CM_ SG_ 322 RFC_Loc174_RadialDistanceVnce "Variance of Location radial distance ISO 23150:2021(E): Position radial distance - error (A.4.17)";
CM_ SG_ 322 RFC_Loc174_RadialVelocityVnce "Variance of Location radial relative velocity ISO 23150:2021(E): Relative velocity {radial distance} - error (A.4.19)";
CM_ SG_ 322 RFC_Loc174_ElevationVnce "Variance of Location elevation angle ISO 23150:2021(E): Position elevation - error (A.4.17)";
CM_ SG_ 322 RFC_Loc174_AzimuthVnce "Variance of Location azimuth angle ISO 23150:2021(E): Position azimuth - error (A.4.17)";
CM_ SG_ 322 RFC_Loc174_RadarCrossSection "Radar Cross Section (RCS) estimation ISO 23150:2021(E): Radar cross section (A.4.5)";
CM_ SG_ 322 RFC_Loc174_DistVelocityQuality "Quality of radial distance and velocity resolution processing. Physical range [0..1]";
CM_ SG_ 322 RFC_Loc174_ElevationQuality "Probability for correct signal model (elevation angle). Physical range [0..1]";
CM_ SG_ 322 RFC_Loc174_AzimuthQuality "Probability for correct signal model (azimuth angle). Physical range [0..1]";
CM_ SG_ 322 RFC_Loc174_RSSI "Received Signal Strength Indication (RSSI). This signal is not exactly ISO 23150:2021(E): Signal to noise ratio - detection level (A.4.7), but SNR can be calculated from this signal. Further detail please refer to the DSP Location Interface definition";
CM_ SG_ 322 RFC_Loc174_AzimuthalPartnerId "Id of the azimuthal partner location";
CM_ SG_ 322 RFC_Loc175_RadialDistance "Location radial distance. Represented in conical coordinate system. Same as ISO 23150:2021(E): Position radial distance (A.4.16)";
CM_ SG_ 322 RFC_Loc175_RadialVelocity "Location radial relative velocity ISO 23150:2021(E): Relative velocity {radial distance} (A.4.18)";
CM_ SG_ 322 RFC_Loc175_Elevation "Location elevation angle. Represented in conical coordinate system. Same as ISO 23150:2021(E): Position elevation (A.4.16)";
CM_ SG_ 322 RFC_Loc175_Azimuth "Location azimuth angle. Represented in conical coordinate system. Deviation from ISO 23150:2021(E): Position azimuth (A.4.16). Further details refers to DSP Location Interface definition";
CM_ SG_ 322 RFC_Loc175_DistVelocityCoVnce "Covariance of radial distance and radial velocity";
CM_ SG_ 322 RFC_Loc175_RadialDistanceVnce "Variance of Location radial distance ISO 23150:2021(E): Position radial distance - error (A.4.17)";
CM_ SG_ 322 RFC_Loc175_RadialVelocityVnce "Variance of Location radial relative velocity ISO 23150:2021(E): Relative velocity {radial distance} - error (A.4.19)";
CM_ SG_ 322 RFC_Loc175_ElevationVnce "Variance of Location elevation angle ISO 23150:2021(E): Position elevation - error (A.4.17)";
CM_ SG_ 322 RFC_Loc175_AzimuthVnce "Variance of Location azimuth angle ISO 23150:2021(E): Position azimuth - error (A.4.17)";
CM_ SG_ 322 RFC_Loc175_RadarCrossSection "Radar Cross Section (RCS) estimation ISO 23150:2021(E): Radar cross section (A.4.5)";
CM_ SG_ 322 RFC_Loc175_DistVelocityQuality "Quality of radial distance and velocity resolution processing. Physical range [0..1]";
CM_ SG_ 322 RFC_Loc175_ElevationQuality "Probability for correct signal model (elevation angle). Physical range [0..1]";
CM_ SG_ 322 RFC_Loc175_AzimuthQuality "Probability for correct signal model (azimuth angle). Physical range [0..1]";
CM_ SG_ 322 RFC_Loc175_RSSI "Received Signal Strength Indication (RSSI). This signal is not exactly ISO 23150:2021(E): Signal to noise ratio - detection level (A.4.7), but SNR can be calculated from this signal. Further detail please refer to the DSP Location Interface definition";
CM_ SG_ 322 RFC_Loc175_AzimuthalPartnerId "Id of the azimuthal partner location";
CM_ SG_ 322 RFC_Loc176_RadialDistance "Location radial distance. Represented in conical coordinate system. Same as ISO 23150:2021(E): Position radial distance (A.4.16)";
CM_ SG_ 322 RFC_Loc176_RadialVelocity "Location radial relative velocity ISO 23150:2021(E): Relative velocity {radial distance} (A.4.18)";
CM_ SG_ 322 RFC_Loc176_Elevation "Location elevation angle. Represented in conical coordinate system. Same as ISO 23150:2021(E): Position elevation (A.4.16)";
CM_ SG_ 322 RFC_Loc176_Azimuth "Location azimuth angle. Represented in conical coordinate system. Deviation from ISO 23150:2021(E): Position azimuth (A.4.16). Further details refers to DSP Location Interface definition";
CM_ SG_ 322 RFC_Loc176_DistVelocityCoVnce "Covariance of radial distance and radial velocity";
CM_ SG_ 322 RFC_Loc176_RadialDistanceVnce "Variance of Location radial distance ISO 23150:2021(E): Position radial distance - error (A.4.17)";
CM_ SG_ 322 RFC_Loc176_RadialVelocityVnce "Variance of Location radial relative velocity ISO 23150:2021(E): Relative velocity {radial distance} - error (A.4.19)";
CM_ SG_ 322 RFC_Loc176_ElevationVnce "Variance of Location elevation angle ISO 23150:2021(E): Position elevation - error (A.4.17)";
CM_ SG_ 322 RFC_Loc176_AzimuthVnce "Variance of Location azimuth angle ISO 23150:2021(E): Position azimuth - error (A.4.17)";
CM_ SG_ 322 RFC_Loc176_RadarCrossSection "Radar Cross Section (RCS) estimation ISO 23150:2021(E): Radar cross section (A.4.5)";
CM_ SG_ 322 RFC_Loc176_DistVelocityQuality "Quality of radial distance and velocity resolution processing. Physical range [0..1]";
CM_ SG_ 322 RFC_Loc176_ElevationQuality "Probability for correct signal model (elevation angle). Physical range [0..1]";
CM_ SG_ 322 RFC_Loc176_AzimuthQuality "Probability for correct signal model (azimuth angle). Physical range [0..1]";
CM_ SG_ 322 RFC_Loc176_RSSI "Received Signal Strength Indication (RSSI). This signal is not exactly ISO 23150:2021(E): Signal to noise ratio - detection level (A.4.7), but SNR can be calculated from this signal. Further detail please refer to the DSP Location Interface definition";
CM_ SG_ 322 RFC_Loc176_AzimuthalPartnerId "Id of the azimuthal partner location";
CM_ SG_ 323 RFC_Loc177_179_CRC "CRC - Autosar E2E Profile 5";
CM_ SG_ 323 RFC_Loc177_179_AliveCtr "Alive counter - Autosar E2E Profile 5";
CM_ SG_ 323 RFC_Loc177_179_ProtBlockCtr "Protocol-Signal: Block-Counter";
CM_ SG_ 323 RFC_Loc177_RadialDistance "Location radial distance. Represented in conical coordinate system. Same as ISO 23150:2021(E): Position radial distance (A.4.16)";
CM_ SG_ 323 RFC_Loc177_RadialVelocity "Location radial relative velocity ISO 23150:2021(E): Relative velocity {radial distance} (A.4.18)";
CM_ SG_ 323 RFC_Loc177_Elevation "Location elevation angle. Represented in conical coordinate system. Same as ISO 23150:2021(E): Position elevation (A.4.16)";
CM_ SG_ 323 RFC_Loc177_Azimuth "Location azimuth angle. Represented in conical coordinate system. Deviation from ISO 23150:2021(E): Position azimuth (A.4.16). Further details refers to DSP Location Interface definition";
CM_ SG_ 323 RFC_Loc177_DistVelocityCoVnce "Covariance of radial distance and radial velocity";
CM_ SG_ 323 RFC_Loc177_RadialDistanceVnce "Variance of Location radial distance ISO 23150:2021(E): Position radial distance - error (A.4.17)";
CM_ SG_ 323 RFC_Loc177_RadialVelocityVnce "Variance of Location radial relative velocity ISO 23150:2021(E): Relative velocity {radial distance} - error (A.4.19)";
CM_ SG_ 323 RFC_Loc177_ElevationVnce "Variance of Location elevation angle ISO 23150:2021(E): Position elevation - error (A.4.17)";
CM_ SG_ 323 RFC_Loc177_AzimuthVnce "Variance of Location azimuth angle ISO 23150:2021(E): Position azimuth - error (A.4.17)";
CM_ SG_ 323 RFC_Loc177_RadarCrossSection "Radar Cross Section (RCS) estimation ISO 23150:2021(E): Radar cross section (A.4.5)";
CM_ SG_ 323 RFC_Loc177_DistVelocityQuality "Quality of radial distance and velocity resolution processing. Physical range [0..1]";
CM_ SG_ 323 RFC_Loc177_ElevationQuality "Probability for correct signal model (elevation angle). Physical range [0..1]";
CM_ SG_ 323 RFC_Loc177_AzimuthQuality "Probability for correct signal model (azimuth angle). Physical range [0..1]";
CM_ SG_ 323 RFC_Loc177_RSSI "Received Signal Strength Indication (RSSI). This signal is not exactly ISO 23150:2021(E): Signal to noise ratio - detection level (A.4.7), but SNR can be calculated from this signal. Further detail please refer to the DSP Location Interface definition";
CM_ SG_ 323 RFC_Loc177_AzimuthalPartnerId "Id of the azimuthal partner location";
CM_ SG_ 323 RFC_Loc178_RadialDistance "Location radial distance. Represented in conical coordinate system. Same as ISO 23150:2021(E): Position radial distance (A.4.16)";
CM_ SG_ 323 RFC_Loc178_RadialVelocity "Location radial relative velocity ISO 23150:2021(E): Relative velocity {radial distance} (A.4.18)";
CM_ SG_ 323 RFC_Loc178_Elevation "Location elevation angle. Represented in conical coordinate system. Same as ISO 23150:2021(E): Position elevation (A.4.16)";
CM_ SG_ 323 RFC_Loc178_Azimuth "Location azimuth angle. Represented in conical coordinate system. Deviation from ISO 23150:2021(E): Position azimuth (A.4.16). Further details refers to DSP Location Interface definition";
CM_ SG_ 323 RFC_Loc178_DistVelocityCoVnce "Covariance of radial distance and radial velocity";
CM_ SG_ 323 RFC_Loc178_RadialDistanceVnce "Variance of Location radial distance ISO 23150:2021(E): Position radial distance - error (A.4.17)";
CM_ SG_ 323 RFC_Loc178_RadialVelocityVnce "Variance of Location radial relative velocity ISO 23150:2021(E): Relative velocity {radial distance} - error (A.4.19)";
CM_ SG_ 323 RFC_Loc178_ElevationVnce "Variance of Location elevation angle ISO 23150:2021(E): Position elevation - error (A.4.17)";
CM_ SG_ 323 RFC_Loc178_AzimuthVnce "Variance of Location azimuth angle ISO 23150:2021(E): Position azimuth - error (A.4.17)";
CM_ SG_ 323 RFC_Loc178_RadarCrossSection "Radar Cross Section (RCS) estimation ISO 23150:2021(E): Radar cross section (A.4.5)";
CM_ SG_ 323 RFC_Loc178_DistVelocityQuality "Quality of radial distance and velocity resolution processing. Physical range [0..1]";
CM_ SG_ 323 RFC_Loc178_ElevationQuality "Probability for correct signal model (elevation angle). Physical range [0..1]";
CM_ SG_ 323 RFC_Loc178_AzimuthQuality "Probability for correct signal model (azimuth angle). Physical range [0..1]";
CM_ SG_ 323 RFC_Loc178_RSSI "Received Signal Strength Indication (RSSI). This signal is not exactly ISO 23150:2021(E): Signal to noise ratio - detection level (A.4.7), but SNR can be calculated from this signal. Further detail please refer to the DSP Location Interface definition";
CM_ SG_ 323 RFC_Loc178_AzimuthalPartnerId "Id of the azimuthal partner location";
CM_ SG_ 323 RFC_Loc179_RadialDistance "Location radial distance. Represented in conical coordinate system. Same as ISO 23150:2021(E): Position radial distance (A.4.16)";
CM_ SG_ 323 RFC_Loc179_RadialVelocity "Location radial relative velocity ISO 23150:2021(E): Relative velocity {radial distance} (A.4.18)";
CM_ SG_ 323 RFC_Loc179_Elevation "Location elevation angle. Represented in conical coordinate system. Same as ISO 23150:2021(E): Position elevation (A.4.16)";
CM_ SG_ 323 RFC_Loc179_Azimuth "Location azimuth angle. Represented in conical coordinate system. Deviation from ISO 23150:2021(E): Position azimuth (A.4.16). Further details refers to DSP Location Interface definition";
CM_ SG_ 323 RFC_Loc179_DistVelocityCoVnce "Covariance of radial distance and radial velocity";
CM_ SG_ 323 RFC_Loc179_RadialDistanceVnce "Variance of Location radial distance ISO 23150:2021(E): Position radial distance - error (A.4.17)";
CM_ SG_ 323 RFC_Loc179_RadialVelocityVnce "Variance of Location radial relative velocity ISO 23150:2021(E): Relative velocity {radial distance} - error (A.4.19)";
CM_ SG_ 323 RFC_Loc179_ElevationVnce "Variance of Location elevation angle ISO 23150:2021(E): Position elevation - error (A.4.17)";
CM_ SG_ 323 RFC_Loc179_AzimuthVnce "Variance of Location azimuth angle ISO 23150:2021(E): Position azimuth - error (A.4.17)";
CM_ SG_ 323 RFC_Loc179_RadarCrossSection "Radar Cross Section (RCS) estimation ISO 23150:2021(E): Radar cross section (A.4.5)";
CM_ SG_ 323 RFC_Loc179_DistVelocityQuality "Quality of radial distance and velocity resolution processing. Physical range [0..1]";
CM_ SG_ 323 RFC_Loc179_ElevationQuality "Probability for correct signal model (elevation angle). Physical range [0..1]";
CM_ SG_ 323 RFC_Loc179_AzimuthQuality "Probability for correct signal model (azimuth angle). Physical range [0..1]";
CM_ SG_ 323 RFC_Loc179_RSSI "Received Signal Strength Indication (RSSI). This signal is not exactly ISO 23150:2021(E): Signal to noise ratio - detection level (A.4.7), but SNR can be calculated from this signal. Further detail please refer to the DSP Location Interface definition";
CM_ SG_ 323 RFC_Loc179_AzimuthalPartnerId "Id of the azimuthal partner location";
CM_ SG_ 324 RFC_Loc180_182_CRC "CRC - Autosar E2E Profile 5";
CM_ SG_ 324 RFC_Loc180_182_AliveCtr "Alive counter - Autosar E2E Profile 5";
CM_ SG_ 324 RFC_Loc180_182_ProtBlockCtr "Protocol-Signal: Block-Counter";
CM_ SG_ 324 RFC_Loc180_RadialDistance "Location radial distance. Represented in conical coordinate system. Same as ISO 23150:2021(E): Position radial distance (A.4.16)";
CM_ SG_ 324 RFC_Loc180_RadialVelocity "Location radial relative velocity ISO 23150:2021(E): Relative velocity {radial distance} (A.4.18)";
CM_ SG_ 324 RFC_Loc180_Elevation "Location elevation angle. Represented in conical coordinate system. Same as ISO 23150:2021(E): Position elevation (A.4.16)";
CM_ SG_ 324 RFC_Loc180_Azimuth "Location azimuth angle. Represented in conical coordinate system. Deviation from ISO 23150:2021(E): Position azimuth (A.4.16). Further details refers to DSP Location Interface definition";
CM_ SG_ 324 RFC_Loc180_DistVelocityCoVnce "Covariance of radial distance and radial velocity";
CM_ SG_ 324 RFC_Loc180_RadialDistanceVnce "Variance of Location radial distance ISO 23150:2021(E): Position radial distance - error (A.4.17)";
CM_ SG_ 324 RFC_Loc180_RadialVelocityVnce "Variance of Location radial relative velocity ISO 23150:2021(E): Relative velocity {radial distance} - error (A.4.19)";
CM_ SG_ 324 RFC_Loc180_ElevationVnce "Variance of Location elevation angle ISO 23150:2021(E): Position elevation - error (A.4.17)";
CM_ SG_ 324 RFC_Loc180_AzimuthVnce "Variance of Location azimuth angle ISO 23150:2021(E): Position azimuth - error (A.4.17)";
CM_ SG_ 324 RFC_Loc180_RadarCrossSection "Radar Cross Section (RCS) estimation ISO 23150:2021(E): Radar cross section (A.4.5)";
CM_ SG_ 324 RFC_Loc180_DistVelocityQuality "Quality of radial distance and velocity resolution processing. Physical range [0..1]";
CM_ SG_ 324 RFC_Loc180_ElevationQuality "Probability for correct signal model (elevation angle). Physical range [0..1]";
CM_ SG_ 324 RFC_Loc180_AzimuthQuality "Probability for correct signal model (azimuth angle). Physical range [0..1]";
CM_ SG_ 324 RFC_Loc180_RSSI "Received Signal Strength Indication (RSSI). This signal is not exactly ISO 23150:2021(E): Signal to noise ratio - detection level (A.4.7), but SNR can be calculated from this signal. Further detail please refer to the DSP Location Interface definition";
CM_ SG_ 324 RFC_Loc180_AzimuthalPartnerId "Id of the azimuthal partner location";
CM_ SG_ 324 RFC_Loc181_RadialDistance "Location radial distance. Represented in conical coordinate system. Same as ISO 23150:2021(E): Position radial distance (A.4.16)";
CM_ SG_ 324 RFC_Loc181_RadialVelocity "Location radial relative velocity ISO 23150:2021(E): Relative velocity {radial distance} (A.4.18)";
CM_ SG_ 324 RFC_Loc181_Elevation "Location elevation angle. Represented in conical coordinate system. Same as ISO 23150:2021(E): Position elevation (A.4.16)";
CM_ SG_ 324 RFC_Loc181_Azimuth "Location azimuth angle. Represented in conical coordinate system. Deviation from ISO 23150:2021(E): Position azimuth (A.4.16). Further details refers to DSP Location Interface definition";
CM_ SG_ 324 RFC_Loc181_DistVelocityCoVnce "Covariance of radial distance and radial velocity";
CM_ SG_ 324 RFC_Loc181_RadialDistanceVnce "Variance of Location radial distance ISO 23150:2021(E): Position radial distance - error (A.4.17)";
CM_ SG_ 324 RFC_Loc181_RadialVelocityVnce "Variance of Location radial relative velocity ISO 23150:2021(E): Relative velocity {radial distance} - error (A.4.19)";
CM_ SG_ 324 RFC_Loc181_ElevationVnce "Variance of Location elevation angle ISO 23150:2021(E): Position elevation - error (A.4.17)";
CM_ SG_ 324 RFC_Loc181_AzimuthVnce "Variance of Location azimuth angle ISO 23150:2021(E): Position azimuth - error (A.4.17)";
CM_ SG_ 324 RFC_Loc181_RadarCrossSection "Radar Cross Section (RCS) estimation ISO 23150:2021(E): Radar cross section (A.4.5)";
CM_ SG_ 324 RFC_Loc181_DistVelocityQuality "Quality of radial distance and velocity resolution processing. Physical range [0..1]";
CM_ SG_ 324 RFC_Loc181_ElevationQuality "Probability for correct signal model (elevation angle). Physical range [0..1]";
CM_ SG_ 324 RFC_Loc181_AzimuthQuality "Probability for correct signal model (azimuth angle). Physical range [0..1]";
CM_ SG_ 324 RFC_Loc181_RSSI "Received Signal Strength Indication (RSSI). This signal is not exactly ISO 23150:2021(E): Signal to noise ratio - detection level (A.4.7), but SNR can be calculated from this signal. Further detail please refer to the DSP Location Interface definition";
CM_ SG_ 324 RFC_Loc181_AzimuthalPartnerId "Id of the azimuthal partner location";
CM_ SG_ 324 RFC_Loc182_RadialDistance "Location radial distance. Represented in conical coordinate system. Same as ISO 23150:2021(E): Position radial distance (A.4.16)";
CM_ SG_ 324 RFC_Loc182_RadialVelocity "Location radial relative velocity ISO 23150:2021(E): Relative velocity {radial distance} (A.4.18)";
CM_ SG_ 324 RFC_Loc182_Elevation "Location elevation angle. Represented in conical coordinate system. Same as ISO 23150:2021(E): Position elevation (A.4.16)";
CM_ SG_ 324 RFC_Loc182_Azimuth "Location azimuth angle. Represented in conical coordinate system. Deviation from ISO 23150:2021(E): Position azimuth (A.4.16). Further details refers to DSP Location Interface definition";
CM_ SG_ 324 RFC_Loc182_DistVelocityCoVnce "Covariance of radial distance and radial velocity";
CM_ SG_ 324 RFC_Loc182_RadialDistanceVnce "Variance of Location radial distance ISO 23150:2021(E): Position radial distance - error (A.4.17)";
CM_ SG_ 324 RFC_Loc182_RadialVelocityVnce "Variance of Location radial relative velocity ISO 23150:2021(E): Relative velocity {radial distance} - error (A.4.19)";
CM_ SG_ 324 RFC_Loc182_ElevationVnce "Variance of Location elevation angle ISO 23150:2021(E): Position elevation - error (A.4.17)";
CM_ SG_ 324 RFC_Loc182_AzimuthVnce "Variance of Location azimuth angle ISO 23150:2021(E): Position azimuth - error (A.4.17)";
CM_ SG_ 324 RFC_Loc182_RadarCrossSection "Radar Cross Section (RCS) estimation ISO 23150:2021(E): Radar cross section (A.4.5)";
CM_ SG_ 324 RFC_Loc182_DistVelocityQuality "Quality of radial distance and velocity resolution processing. Physical range [0..1]";
CM_ SG_ 324 RFC_Loc182_ElevationQuality "Probability for correct signal model (elevation angle). Physical range [0..1]";
CM_ SG_ 324 RFC_Loc182_AzimuthQuality "Probability for correct signal model (azimuth angle). Physical range [0..1]";
CM_ SG_ 324 RFC_Loc182_RSSI "Received Signal Strength Indication (RSSI). This signal is not exactly ISO 23150:2021(E): Signal to noise ratio - detection level (A.4.7), but SNR can be calculated from this signal. Further detail please refer to the DSP Location Interface definition";
CM_ SG_ 324 RFC_Loc182_AzimuthalPartnerId "Id of the azimuthal partner location";
CM_ SG_ 325 RFC_Loc183_185_CRC "CRC - Autosar E2E Profile 5";
CM_ SG_ 325 RFC_Loc183_185_AliveCtr "Alive counter - Autosar E2E Profile 5";
CM_ SG_ 325 RFC_Loc183_185_ProtBlockCtr "Protocol-Signal: Block-Counter";
CM_ SG_ 325 RFC_Loc183_RadialDistance "Location radial distance. Represented in conical coordinate system. Same as ISO 23150:2021(E): Position radial distance (A.4.16)";
CM_ SG_ 325 RFC_Loc183_RadialVelocity "Location radial relative velocity ISO 23150:2021(E): Relative velocity {radial distance} (A.4.18)";
CM_ SG_ 325 RFC_Loc183_Elevation "Location elevation angle. Represented in conical coordinate system. Same as ISO 23150:2021(E): Position elevation (A.4.16)";
CM_ SG_ 325 RFC_Loc183_Azimuth "Location azimuth angle. Represented in conical coordinate system. Deviation from ISO 23150:2021(E): Position azimuth (A.4.16). Further details refers to DSP Location Interface definition";
CM_ SG_ 325 RFC_Loc183_DistVelocityCoVnce "Covariance of radial distance and radial velocity";
CM_ SG_ 325 RFC_Loc183_RadialDistanceVnce "Variance of Location radial distance ISO 23150:2021(E): Position radial distance - error (A.4.17)";
CM_ SG_ 325 RFC_Loc183_RadialVelocityVnce "Variance of Location radial relative velocity ISO 23150:2021(E): Relative velocity {radial distance} - error (A.4.19)";
CM_ SG_ 325 RFC_Loc183_ElevationVnce "Variance of Location elevation angle ISO 23150:2021(E): Position elevation - error (A.4.17)";
CM_ SG_ 325 RFC_Loc183_AzimuthVnce "Variance of Location azimuth angle ISO 23150:2021(E): Position azimuth - error (A.4.17)";
CM_ SG_ 325 RFC_Loc183_RadarCrossSection "Radar Cross Section (RCS) estimation ISO 23150:2021(E): Radar cross section (A.4.5)";
CM_ SG_ 325 RFC_Loc183_DistVelocityQuality "Quality of radial distance and velocity resolution processing. Physical range [0..1]";
CM_ SG_ 325 RFC_Loc183_ElevationQuality "Probability for correct signal model (elevation angle). Physical range [0..1]";
CM_ SG_ 325 RFC_Loc183_AzimuthQuality "Probability for correct signal model (azimuth angle). Physical range [0..1]";
CM_ SG_ 325 RFC_Loc183_RSSI "Received Signal Strength Indication (RSSI). This signal is not exactly ISO 23150:2021(E): Signal to noise ratio - detection level (A.4.7), but SNR can be calculated from this signal. Further detail please refer to the DSP Location Interface definition";
CM_ SG_ 325 RFC_Loc183_AzimuthalPartnerId "Id of the azimuthal partner location";
CM_ SG_ 325 RFC_Loc184_RadialDistance "Location radial distance. Represented in conical coordinate system. Same as ISO 23150:2021(E): Position radial distance (A.4.16)";
CM_ SG_ 325 RFC_Loc184_RadialVelocity "Location radial relative velocity ISO 23150:2021(E): Relative velocity {radial distance} (A.4.18)";
CM_ SG_ 325 RFC_Loc184_Elevation "Location elevation angle. Represented in conical coordinate system. Same as ISO 23150:2021(E): Position elevation (A.4.16)";
CM_ SG_ 325 RFC_Loc184_Azimuth "Location azimuth angle. Represented in conical coordinate system. Deviation from ISO 23150:2021(E): Position azimuth (A.4.16). Further details refers to DSP Location Interface definition";
CM_ SG_ 325 RFC_Loc184_DistVelocityCoVnce "Covariance of radial distance and radial velocity";
CM_ SG_ 325 RFC_Loc184_RadialDistanceVnce "Variance of Location radial distance ISO 23150:2021(E): Position radial distance - error (A.4.17)";
CM_ SG_ 325 RFC_Loc184_RadialVelocityVnce "Variance of Location radial relative velocity ISO 23150:2021(E): Relative velocity {radial distance} - error (A.4.19)";
CM_ SG_ 325 RFC_Loc184_ElevationVnce "Variance of Location elevation angle ISO 23150:2021(E): Position elevation - error (A.4.17)";
CM_ SG_ 325 RFC_Loc184_AzimuthVnce "Variance of Location azimuth angle ISO 23150:2021(E): Position azimuth - error (A.4.17)";
CM_ SG_ 325 RFC_Loc184_RadarCrossSection "Radar Cross Section (RCS) estimation ISO 23150:2021(E): Radar cross section (A.4.5)";
CM_ SG_ 325 RFC_Loc184_DistVelocityQuality "Quality of radial distance and velocity resolution processing. Physical range [0..1]";
CM_ SG_ 325 RFC_Loc184_ElevationQuality "Probability for correct signal model (elevation angle). Physical range [0..1]";
CM_ SG_ 325 RFC_Loc184_AzimuthQuality "Probability for correct signal model (azimuth angle). Physical range [0..1]";
CM_ SG_ 325 RFC_Loc184_RSSI "Received Signal Strength Indication (RSSI). This signal is not exactly ISO 23150:2021(E): Signal to noise ratio - detection level (A.4.7), but SNR can be calculated from this signal. Further detail please refer to the DSP Location Interface definition";
CM_ SG_ 325 RFC_Loc184_AzimuthalPartnerId "Id of the azimuthal partner location";
CM_ SG_ 325 RFC_Loc185_RadialDistance "Location radial distance. Represented in conical coordinate system. Same as ISO 23150:2021(E): Position radial distance (A.4.16)";
CM_ SG_ 325 RFC_Loc185_RadialVelocity "Location radial relative velocity ISO 23150:2021(E): Relative velocity {radial distance} (A.4.18)";
CM_ SG_ 325 RFC_Loc185_Elevation "Location elevation angle. Represented in conical coordinate system. Same as ISO 23150:2021(E): Position elevation (A.4.16)";
CM_ SG_ 325 RFC_Loc185_Azimuth "Location azimuth angle. Represented in conical coordinate system. Deviation from ISO 23150:2021(E): Position azimuth (A.4.16). Further details refers to DSP Location Interface definition";
CM_ SG_ 325 RFC_Loc185_DistVelocityCoVnce "Covariance of radial distance and radial velocity";
CM_ SG_ 325 RFC_Loc185_RadialDistanceVnce "Variance of Location radial distance ISO 23150:2021(E): Position radial distance - error (A.4.17)";
CM_ SG_ 325 RFC_Loc185_RadialVelocityVnce "Variance of Location radial relative velocity ISO 23150:2021(E): Relative velocity {radial distance} - error (A.4.19)";
CM_ SG_ 325 RFC_Loc185_ElevationVnce "Variance of Location elevation angle ISO 23150:2021(E): Position elevation - error (A.4.17)";
CM_ SG_ 325 RFC_Loc185_AzimuthVnce "Variance of Location azimuth angle ISO 23150:2021(E): Position azimuth - error (A.4.17)";
CM_ SG_ 325 RFC_Loc185_RadarCrossSection "Radar Cross Section (RCS) estimation ISO 23150:2021(E): Radar cross section (A.4.5)";
CM_ SG_ 325 RFC_Loc185_DistVelocityQuality "Quality of radial distance and velocity resolution processing. Physical range [0..1]";
CM_ SG_ 325 RFC_Loc185_ElevationQuality "Probability for correct signal model (elevation angle). Physical range [0..1]";
CM_ SG_ 325 RFC_Loc185_AzimuthQuality "Probability for correct signal model (azimuth angle). Physical range [0..1]";
CM_ SG_ 325 RFC_Loc185_RSSI "Received Signal Strength Indication (RSSI). This signal is not exactly ISO 23150:2021(E): Signal to noise ratio - detection level (A.4.7), but SNR can be calculated from this signal. Further detail please refer to the DSP Location Interface definition";
CM_ SG_ 325 RFC_Loc185_AzimuthalPartnerId "Id of the azimuthal partner location";
CM_ SG_ 326 RFC_Loc186_188_CRC "CRC - Autosar E2E Profile 5";
CM_ SG_ 326 RFC_Loc186_188_AliveCtr "Alive counter - Autosar E2E Profile 5";
CM_ SG_ 326 RFC_Loc186_188_ProtBlockCtr "Protocol-Signal: Block-Counter";
CM_ SG_ 326 RFC_Loc186_RadialDistance "Location radial distance. Represented in conical coordinate system. Same as ISO 23150:2021(E): Position radial distance (A.4.16)";
CM_ SG_ 326 RFC_Loc186_RadialVelocity "Location radial relative velocity ISO 23150:2021(E): Relative velocity {radial distance} (A.4.18)";
CM_ SG_ 326 RFC_Loc186_Elevation "Location elevation angle. Represented in conical coordinate system. Same as ISO 23150:2021(E): Position elevation (A.4.16)";
CM_ SG_ 326 RFC_Loc186_Azimuth "Location azimuth angle. Represented in conical coordinate system. Deviation from ISO 23150:2021(E): Position azimuth (A.4.16). Further details refers to DSP Location Interface definition";
CM_ SG_ 326 RFC_Loc186_DistVelocityCoVnce "Covariance of radial distance and radial velocity";
CM_ SG_ 326 RFC_Loc186_RadialDistanceVnce "Variance of Location radial distance ISO 23150:2021(E): Position radial distance - error (A.4.17)";
CM_ SG_ 326 RFC_Loc186_RadialVelocityVnce "Variance of Location radial relative velocity ISO 23150:2021(E): Relative velocity {radial distance} - error (A.4.19)";
CM_ SG_ 326 RFC_Loc186_ElevationVnce "Variance of Location elevation angle ISO 23150:2021(E): Position elevation - error (A.4.17)";
CM_ SG_ 326 RFC_Loc186_AzimuthVnce "Variance of Location azimuth angle ISO 23150:2021(E): Position azimuth - error (A.4.17)";
CM_ SG_ 326 RFC_Loc186_RadarCrossSection "Radar Cross Section (RCS) estimation ISO 23150:2021(E): Radar cross section (A.4.5)";
CM_ SG_ 326 RFC_Loc186_DistVelocityQuality "Quality of radial distance and velocity resolution processing. Physical range [0..1]";
CM_ SG_ 326 RFC_Loc186_ElevationQuality "Probability for correct signal model (elevation angle). Physical range [0..1]";
CM_ SG_ 326 RFC_Loc186_AzimuthQuality "Probability for correct signal model (azimuth angle). Physical range [0..1]";
CM_ SG_ 326 RFC_Loc186_RSSI "Received Signal Strength Indication (RSSI). This signal is not exactly ISO 23150:2021(E): Signal to noise ratio - detection level (A.4.7), but SNR can be calculated from this signal. Further detail please refer to the DSP Location Interface definition";
CM_ SG_ 326 RFC_Loc186_AzimuthalPartnerId "Id of the azimuthal partner location";
CM_ SG_ 326 RFC_Loc187_RadialDistance "Location radial distance. Represented in conical coordinate system. Same as ISO 23150:2021(E): Position radial distance (A.4.16)";
CM_ SG_ 326 RFC_Loc187_RadialVelocity "Location radial relative velocity ISO 23150:2021(E): Relative velocity {radial distance} (A.4.18)";
CM_ SG_ 326 RFC_Loc187_Elevation "Location elevation angle. Represented in conical coordinate system. Same as ISO 23150:2021(E): Position elevation (A.4.16)";
CM_ SG_ 326 RFC_Loc187_Azimuth "Location azimuth angle. Represented in conical coordinate system. Deviation from ISO 23150:2021(E): Position azimuth (A.4.16). Further details refers to DSP Location Interface definition";
CM_ SG_ 326 RFC_Loc187_DistVelocityCoVnce "Covariance of radial distance and radial velocity";
CM_ SG_ 326 RFC_Loc187_RadialDistanceVnce "Variance of Location radial distance ISO 23150:2021(E): Position radial distance - error (A.4.17)";
CM_ SG_ 326 RFC_Loc187_RadialVelocityVnce "Variance of Location radial relative velocity ISO 23150:2021(E): Relative velocity {radial distance} - error (A.4.19)";
CM_ SG_ 326 RFC_Loc187_ElevationVnce "Variance of Location elevation angle ISO 23150:2021(E): Position elevation - error (A.4.17)";
CM_ SG_ 326 RFC_Loc187_AzimuthVnce "Variance of Location azimuth angle ISO 23150:2021(E): Position azimuth - error (A.4.17)";
CM_ SG_ 326 RFC_Loc187_RadarCrossSection "Radar Cross Section (RCS) estimation ISO 23150:2021(E): Radar cross section (A.4.5)";
CM_ SG_ 326 RFC_Loc187_DistVelocityQuality "Quality of radial distance and velocity resolution processing. Physical range [0..1]";
CM_ SG_ 326 RFC_Loc187_ElevationQuality "Probability for correct signal model (elevation angle). Physical range [0..1]";
CM_ SG_ 326 RFC_Loc187_AzimuthQuality "Probability for correct signal model (azimuth angle). Physical range [0..1]";
CM_ SG_ 326 RFC_Loc187_RSSI "Received Signal Strength Indication (RSSI). This signal is not exactly ISO 23150:2021(E): Signal to noise ratio - detection level (A.4.7), but SNR can be calculated from this signal. Further detail please refer to the DSP Location Interface definition";
CM_ SG_ 326 RFC_Loc187_AzimuthalPartnerId "Id of the azimuthal partner location";
CM_ SG_ 326 RFC_Loc188_RadialDistance "Location radial distance. Represented in conical coordinate system. Same as ISO 23150:2021(E): Position radial distance (A.4.16)";
CM_ SG_ 326 RFC_Loc188_RadialVelocity "Location radial relative velocity ISO 23150:2021(E): Relative velocity {radial distance} (A.4.18)";
CM_ SG_ 326 RFC_Loc188_Elevation "Location elevation angle. Represented in conical coordinate system. Same as ISO 23150:2021(E): Position elevation (A.4.16)";
CM_ SG_ 326 RFC_Loc188_Azimuth "Location azimuth angle. Represented in conical coordinate system. Deviation from ISO 23150:2021(E): Position azimuth (A.4.16). Further details refers to DSP Location Interface definition";
CM_ SG_ 326 RFC_Loc188_DistVelocityCoVnce "Covariance of radial distance and radial velocity";
CM_ SG_ 326 RFC_Loc188_RadialDistanceVnce "Variance of Location radial distance ISO 23150:2021(E): Position radial distance - error (A.4.17)";
CM_ SG_ 326 RFC_Loc188_RadialVelocityVnce "Variance of Location radial relative velocity ISO 23150:2021(E): Relative velocity {radial distance} - error (A.4.19)";
CM_ SG_ 326 RFC_Loc188_ElevationVnce "Variance of Location elevation angle ISO 23150:2021(E): Position elevation - error (A.4.17)";
CM_ SG_ 326 RFC_Loc188_AzimuthVnce "Variance of Location azimuth angle ISO 23150:2021(E): Position azimuth - error (A.4.17)";
CM_ SG_ 326 RFC_Loc188_RadarCrossSection "Radar Cross Section (RCS) estimation ISO 23150:2021(E): Radar cross section (A.4.5)";
CM_ SG_ 326 RFC_Loc188_DistVelocityQuality "Quality of radial distance and velocity resolution processing. Physical range [0..1]";
CM_ SG_ 326 RFC_Loc188_ElevationQuality "Probability for correct signal model (elevation angle). Physical range [0..1]";
CM_ SG_ 326 RFC_Loc188_AzimuthQuality "Probability for correct signal model (azimuth angle). Physical range [0..1]";
CM_ SG_ 326 RFC_Loc188_RSSI "Received Signal Strength Indication (RSSI). This signal is not exactly ISO 23150:2021(E): Signal to noise ratio - detection level (A.4.7), but SNR can be calculated from this signal. Further detail please refer to the DSP Location Interface definition";
CM_ SG_ 326 RFC_Loc188_AzimuthalPartnerId "Id of the azimuthal partner location";
CM_ SG_ 327 RFC_Loc189_191_CRC "CRC - Autosar E2E Profile 5";
CM_ SG_ 327 RFC_Loc189_191_AliveCtr "Alive counter - Autosar E2E Profile 5";
CM_ SG_ 327 RFC_Loc189_191_ProtBlockCtr "Protocol-Signal: Block-Counter";
CM_ SG_ 327 RFC_Loc189_RadialDistance "Location radial distance. Represented in conical coordinate system. Same as ISO 23150:2021(E): Position radial distance (A.4.16)";
CM_ SG_ 327 RFC_Loc189_RadialVelocity "Location radial relative velocity ISO 23150:2021(E): Relative velocity {radial distance} (A.4.18)";
CM_ SG_ 327 RFC_Loc189_Elevation "Location elevation angle. Represented in conical coordinate system. Same as ISO 23150:2021(E): Position elevation (A.4.16)";
CM_ SG_ 327 RFC_Loc189_Azimuth "Location azimuth angle. Represented in conical coordinate system. Deviation from ISO 23150:2021(E): Position azimuth (A.4.16). Further details refers to DSP Location Interface definition";
CM_ SG_ 327 RFC_Loc189_DistVelocityCoVnce "Covariance of radial distance and radial velocity";
CM_ SG_ 327 RFC_Loc189_RadialDistanceVnce "Variance of Location radial distance ISO 23150:2021(E): Position radial distance - error (A.4.17)";
CM_ SG_ 327 RFC_Loc189_RadialVelocityVnce "Variance of Location radial relative velocity ISO 23150:2021(E): Relative velocity {radial distance} - error (A.4.19)";
CM_ SG_ 327 RFC_Loc189_ElevationVnce "Variance of Location elevation angle ISO 23150:2021(E): Position elevation - error (A.4.17)";
CM_ SG_ 327 RFC_Loc189_AzimuthVnce "Variance of Location azimuth angle ISO 23150:2021(E): Position azimuth - error (A.4.17)";
CM_ SG_ 327 RFC_Loc189_RadarCrossSection "Radar Cross Section (RCS) estimation ISO 23150:2021(E): Radar cross section (A.4.5)";
CM_ SG_ 327 RFC_Loc189_DistVelocityQuality "Quality of radial distance and velocity resolution processing. Physical range [0..1]";
CM_ SG_ 327 RFC_Loc189_ElevationQuality "Probability for correct signal model (elevation angle). Physical range [0..1]";
CM_ SG_ 327 RFC_Loc189_AzimuthQuality "Probability for correct signal model (azimuth angle). Physical range [0..1]";
CM_ SG_ 327 RFC_Loc189_RSSI "Received Signal Strength Indication (RSSI). This signal is not exactly ISO 23150:2021(E): Signal to noise ratio - detection level (A.4.7), but SNR can be calculated from this signal. Further detail please refer to the DSP Location Interface definition";
CM_ SG_ 327 RFC_Loc189_AzimuthalPartnerId "Id of the azimuthal partner location";
CM_ SG_ 327 RFC_Loc190_RadialDistance "Location radial distance. Represented in conical coordinate system. Same as ISO 23150:2021(E): Position radial distance (A.4.16)";
CM_ SG_ 327 RFC_Loc190_RadialVelocity "Location radial relative velocity ISO 23150:2021(E): Relative velocity {radial distance} (A.4.18)";
CM_ SG_ 327 RFC_Loc190_Elevation "Location elevation angle. Represented in conical coordinate system. Same as ISO 23150:2021(E): Position elevation (A.4.16)";
CM_ SG_ 327 RFC_Loc190_Azimuth "Location azimuth angle. Represented in conical coordinate system. Deviation from ISO 23150:2021(E): Position azimuth (A.4.16). Further details refers to DSP Location Interface definition";
CM_ SG_ 327 RFC_Loc190_DistVelocityCoVnce "Covariance of radial distance and radial velocity";
CM_ SG_ 327 RFC_Loc190_RadialDistanceVnce "Variance of Location radial distance ISO 23150:2021(E): Position radial distance - error (A.4.17)";
CM_ SG_ 327 RFC_Loc190_RadialVelocityVnce "Variance of Location radial relative velocity ISO 23150:2021(E): Relative velocity {radial distance} - error (A.4.19)";
CM_ SG_ 327 RFC_Loc190_ElevationVnce "Variance of Location elevation angle ISO 23150:2021(E): Position elevation - error (A.4.17)";
CM_ SG_ 327 RFC_Loc190_AzimuthVnce "Variance of Location azimuth angle ISO 23150:2021(E): Position azimuth - error (A.4.17)";
CM_ SG_ 327 RFC_Loc190_RadarCrossSection "Radar Cross Section (RCS) estimation ISO 23150:2021(E): Radar cross section (A.4.5)";
CM_ SG_ 327 RFC_Loc190_DistVelocityQuality "Quality of radial distance and velocity resolution processing. Physical range [0..1]";
CM_ SG_ 327 RFC_Loc190_ElevationQuality "Probability for correct signal model (elevation angle). Physical range [0..1]";
CM_ SG_ 327 RFC_Loc190_AzimuthQuality "Probability for correct signal model (azimuth angle). Physical range [0..1]";
CM_ SG_ 327 RFC_Loc190_RSSI "Received Signal Strength Indication (RSSI). This signal is not exactly ISO 23150:2021(E): Signal to noise ratio - detection level (A.4.7), but SNR can be calculated from this signal. Further detail please refer to the DSP Location Interface definition";
CM_ SG_ 327 RFC_Loc190_AzimuthalPartnerId "Id of the azimuthal partner location";
CM_ SG_ 327 RFC_Loc191_RadialDistance "Location radial distance. Represented in conical coordinate system. Same as ISO 23150:2021(E): Position radial distance (A.4.16)";
CM_ SG_ 327 RFC_Loc191_RadialVelocity "Location radial relative velocity ISO 23150:2021(E): Relative velocity {radial distance} (A.4.18)";
CM_ SG_ 327 RFC_Loc191_Elevation "Location elevation angle. Represented in conical coordinate system. Same as ISO 23150:2021(E): Position elevation (A.4.16)";
CM_ SG_ 327 RFC_Loc191_Azimuth "Location azimuth angle. Represented in conical coordinate system. Deviation from ISO 23150:2021(E): Position azimuth (A.4.16). Further details refers to DSP Location Interface definition";
CM_ SG_ 327 RFC_Loc191_DistVelocityCoVnce "Covariance of radial distance and radial velocity";
CM_ SG_ 327 RFC_Loc191_RadialDistanceVnce "Variance of Location radial distance ISO 23150:2021(E): Position radial distance - error (A.4.17)";
CM_ SG_ 327 RFC_Loc191_RadialVelocityVnce "Variance of Location radial relative velocity ISO 23150:2021(E): Relative velocity {radial distance} - error (A.4.19)";
CM_ SG_ 327 RFC_Loc191_ElevationVnce "Variance of Location elevation angle ISO 23150:2021(E): Position elevation - error (A.4.17)";
CM_ SG_ 327 RFC_Loc191_AzimuthVnce "Variance of Location azimuth angle ISO 23150:2021(E): Position azimuth - error (A.4.17)";
CM_ SG_ 327 RFC_Loc191_RadarCrossSection "Radar Cross Section (RCS) estimation ISO 23150:2021(E): Radar cross section (A.4.5)";
CM_ SG_ 327 RFC_Loc191_DistVelocityQuality "Quality of radial distance and velocity resolution processing. Physical range [0..1]";
CM_ SG_ 327 RFC_Loc191_ElevationQuality "Probability for correct signal model (elevation angle). Physical range [0..1]";
CM_ SG_ 327 RFC_Loc191_AzimuthQuality "Probability for correct signal model (azimuth angle). Physical range [0..1]";
CM_ SG_ 327 RFC_Loc191_RSSI "Received Signal Strength Indication (RSSI). This signal is not exactly ISO 23150:2021(E): Signal to noise ratio - detection level (A.4.7), but SNR can be calculated from this signal. Further detail please refer to the DSP Location Interface definition";
CM_ SG_ 327 RFC_Loc191_AzimuthalPartnerId "Id of the azimuthal partner location";
CM_ SG_ 328 RFC_Loc192_194_CRC "CRC - Autosar E2E Profile 5";
CM_ SG_ 328 RFC_Loc192_194_AliveCtr "Alive counter - Autosar E2E Profile 5";
CM_ SG_ 328 RFC_Loc192_194_ProtBlockCtr "Protocol-Signal: Block-Counter";
CM_ SG_ 328 RFC_Loc192_RadialDistance "Location radial distance. Represented in conical coordinate system. Same as ISO 23150:2021(E): Position radial distance (A.4.16)";
CM_ SG_ 328 RFC_Loc192_RadialVelocity "Location radial relative velocity ISO 23150:2021(E): Relative velocity {radial distance} (A.4.18)";
CM_ SG_ 328 RFC_Loc192_Elevation "Location elevation angle. Represented in conical coordinate system. Same as ISO 23150:2021(E): Position elevation (A.4.16)";
CM_ SG_ 328 RFC_Loc192_Azimuth "Location azimuth angle. Represented in conical coordinate system. Deviation from ISO 23150:2021(E): Position azimuth (A.4.16). Further details refers to DSP Location Interface definition";
CM_ SG_ 328 RFC_Loc192_DistVelocityCoVnce "Covariance of radial distance and radial velocity";
CM_ SG_ 328 RFC_Loc192_RadialDistanceVnce "Variance of Location radial distance ISO 23150:2021(E): Position radial distance - error (A.4.17)";
CM_ SG_ 328 RFC_Loc192_RadialVelocityVnce "Variance of Location radial relative velocity ISO 23150:2021(E): Relative velocity {radial distance} - error (A.4.19)";
CM_ SG_ 328 RFC_Loc192_ElevationVnce "Variance of Location elevation angle ISO 23150:2021(E): Position elevation - error (A.4.17)";
CM_ SG_ 328 RFC_Loc192_AzimuthVnce "Variance of Location azimuth angle ISO 23150:2021(E): Position azimuth - error (A.4.17)";
CM_ SG_ 328 RFC_Loc192_RadarCrossSection "Radar Cross Section (RCS) estimation ISO 23150:2021(E): Radar cross section (A.4.5)";
CM_ SG_ 328 RFC_Loc192_DistVelocityQuality "Quality of radial distance and velocity resolution processing. Physical range [0..1]";
CM_ SG_ 328 RFC_Loc192_ElevationQuality "Probability for correct signal model (elevation angle). Physical range [0..1]";
CM_ SG_ 328 RFC_Loc192_AzimuthQuality "Probability for correct signal model (azimuth angle). Physical range [0..1]";
CM_ SG_ 328 RFC_Loc192_RSSI "Received Signal Strength Indication (RSSI). This signal is not exactly ISO 23150:2021(E): Signal to noise ratio - detection level (A.4.7), but SNR can be calculated from this signal. Further detail please refer to the DSP Location Interface definition";
CM_ SG_ 328 RFC_Loc192_AzimuthalPartnerId "Id of the azimuthal partner location";
CM_ SG_ 328 RFC_Loc193_RadialDistance "Location radial distance. Represented in conical coordinate system. Same as ISO 23150:2021(E): Position radial distance (A.4.16)";
CM_ SG_ 328 RFC_Loc193_RadialVelocity "Location radial relative velocity ISO 23150:2021(E): Relative velocity {radial distance} (A.4.18)";
CM_ SG_ 328 RFC_Loc193_Elevation "Location elevation angle. Represented in conical coordinate system. Same as ISO 23150:2021(E): Position elevation (A.4.16)";
CM_ SG_ 328 RFC_Loc193_Azimuth "Location azimuth angle. Represented in conical coordinate system. Deviation from ISO 23150:2021(E): Position azimuth (A.4.16). Further details refers to DSP Location Interface definition";
CM_ SG_ 328 RFC_Loc193_DistVelocityCoVnce "Covariance of radial distance and radial velocity";
CM_ SG_ 328 RFC_Loc193_RadialDistanceVnce "Variance of Location radial distance ISO 23150:2021(E): Position radial distance - error (A.4.17)";
CM_ SG_ 328 RFC_Loc193_RadialVelocityVnce "Variance of Location radial relative velocity ISO 23150:2021(E): Relative velocity {radial distance} - error (A.4.19)";
CM_ SG_ 328 RFC_Loc193_ElevationVnce "Variance of Location elevation angle ISO 23150:2021(E): Position elevation - error (A.4.17)";
CM_ SG_ 328 RFC_Loc193_AzimuthVnce "Variance of Location azimuth angle ISO 23150:2021(E): Position azimuth - error (A.4.17)";
CM_ SG_ 328 RFC_Loc193_RadarCrossSection "Radar Cross Section (RCS) estimation ISO 23150:2021(E): Radar cross section (A.4.5)";
CM_ SG_ 328 RFC_Loc193_DistVelocityQuality "Quality of radial distance and velocity resolution processing. Physical range [0..1]";
CM_ SG_ 328 RFC_Loc193_ElevationQuality "Probability for correct signal model (elevation angle). Physical range [0..1]";
CM_ SG_ 328 RFC_Loc193_AzimuthQuality "Probability for correct signal model (azimuth angle). Physical range [0..1]";
CM_ SG_ 328 RFC_Loc193_RSSI "Received Signal Strength Indication (RSSI). This signal is not exactly ISO 23150:2021(E): Signal to noise ratio - detection level (A.4.7), but SNR can be calculated from this signal. Further detail please refer to the DSP Location Interface definition";
CM_ SG_ 328 RFC_Loc193_AzimuthalPartnerId "Id of the azimuthal partner location";
CM_ SG_ 328 RFC_Loc194_RadialDistance "Location radial distance. Represented in conical coordinate system. Same as ISO 23150:2021(E): Position radial distance (A.4.16)";
CM_ SG_ 328 RFC_Loc194_RadialVelocity "Location radial relative velocity ISO 23150:2021(E): Relative velocity {radial distance} (A.4.18)";
CM_ SG_ 328 RFC_Loc194_Elevation "Location elevation angle. Represented in conical coordinate system. Same as ISO 23150:2021(E): Position elevation (A.4.16)";
CM_ SG_ 328 RFC_Loc194_Azimuth "Location azimuth angle. Represented in conical coordinate system. Deviation from ISO 23150:2021(E): Position azimuth (A.4.16). Further details refers to DSP Location Interface definition";
CM_ SG_ 328 RFC_Loc194_DistVelocityCoVnce "Covariance of radial distance and radial velocity";
CM_ SG_ 328 RFC_Loc194_RadialDistanceVnce "Variance of Location radial distance ISO 23150:2021(E): Position radial distance - error (A.4.17)";
CM_ SG_ 328 RFC_Loc194_RadialVelocityVnce "Variance of Location radial relative velocity ISO 23150:2021(E): Relative velocity {radial distance} - error (A.4.19)";
CM_ SG_ 328 RFC_Loc194_ElevationVnce "Variance of Location elevation angle ISO 23150:2021(E): Position elevation - error (A.4.17)";
CM_ SG_ 328 RFC_Loc194_AzimuthVnce "Variance of Location azimuth angle ISO 23150:2021(E): Position azimuth - error (A.4.17)";
CM_ SG_ 328 RFC_Loc194_RadarCrossSection "Radar Cross Section (RCS) estimation ISO 23150:2021(E): Radar cross section (A.4.5)";
CM_ SG_ 328 RFC_Loc194_DistVelocityQuality "Quality of radial distance and velocity resolution processing. Physical range [0..1]";
CM_ SG_ 328 RFC_Loc194_ElevationQuality "Probability for correct signal model (elevation angle). Physical range [0..1]";
CM_ SG_ 328 RFC_Loc194_AzimuthQuality "Probability for correct signal model (azimuth angle). Physical range [0..1]";
CM_ SG_ 328 RFC_Loc194_RSSI "Received Signal Strength Indication (RSSI). This signal is not exactly ISO 23150:2021(E): Signal to noise ratio - detection level (A.4.7), but SNR can be calculated from this signal. Further detail please refer to the DSP Location Interface definition";
CM_ SG_ 328 RFC_Loc194_AzimuthalPartnerId "Id of the azimuthal partner location";
CM_ SG_ 329 RFC_Loc195_197_CRC "CRC - Autosar E2E Profile 5";
CM_ SG_ 329 RFC_Loc195_197_AliveCtr "Alive counter - Autosar E2E Profile 5";
CM_ SG_ 329 RFC_Loc195_197_ProtBlockCtr "Protocol-Signal: Block-Counter";
CM_ SG_ 329 RFC_Loc195_RadialDistance "Location radial distance. Represented in conical coordinate system. Same as ISO 23150:2021(E): Position radial distance (A.4.16)";
CM_ SG_ 329 RFC_Loc195_RadialVelocity "Location radial relative velocity ISO 23150:2021(E): Relative velocity {radial distance} (A.4.18)";
CM_ SG_ 329 RFC_Loc195_Elevation "Location elevation angle. Represented in conical coordinate system. Same as ISO 23150:2021(E): Position elevation (A.4.16)";
CM_ SG_ 329 RFC_Loc195_Azimuth "Location azimuth angle. Represented in conical coordinate system. Deviation from ISO 23150:2021(E): Position azimuth (A.4.16). Further details refers to DSP Location Interface definition";
CM_ SG_ 329 RFC_Loc195_DistVelocityCoVnce "Covariance of radial distance and radial velocity";
CM_ SG_ 329 RFC_Loc195_RadialDistanceVnce "Variance of Location radial distance ISO 23150:2021(E): Position radial distance - error (A.4.17)";
CM_ SG_ 329 RFC_Loc195_RadialVelocityVnce "Variance of Location radial relative velocity ISO 23150:2021(E): Relative velocity {radial distance} - error (A.4.19)";
CM_ SG_ 329 RFC_Loc195_ElevationVnce "Variance of Location elevation angle ISO 23150:2021(E): Position elevation - error (A.4.17)";
CM_ SG_ 329 RFC_Loc195_AzimuthVnce "Variance of Location azimuth angle ISO 23150:2021(E): Position azimuth - error (A.4.17)";
CM_ SG_ 329 RFC_Loc195_RadarCrossSection "Radar Cross Section (RCS) estimation ISO 23150:2021(E): Radar cross section (A.4.5)";
CM_ SG_ 329 RFC_Loc195_DistVelocityQuality "Quality of radial distance and velocity resolution processing. Physical range [0..1]";
CM_ SG_ 329 RFC_Loc195_ElevationQuality "Probability for correct signal model (elevation angle). Physical range [0..1]";
CM_ SG_ 329 RFC_Loc195_AzimuthQuality "Probability for correct signal model (azimuth angle). Physical range [0..1]";
CM_ SG_ 329 RFC_Loc195_RSSI "Received Signal Strength Indication (RSSI). This signal is not exactly ISO 23150:2021(E): Signal to noise ratio - detection level (A.4.7), but SNR can be calculated from this signal. Further detail please refer to the DSP Location Interface definition";
CM_ SG_ 329 RFC_Loc195_AzimuthalPartnerId "Id of the azimuthal partner location";
CM_ SG_ 329 RFC_Loc196_RadialDistance "Location radial distance. Represented in conical coordinate system. Same as ISO 23150:2021(E): Position radial distance (A.4.16)";
CM_ SG_ 329 RFC_Loc196_RadialVelocity "Location radial relative velocity ISO 23150:2021(E): Relative velocity {radial distance} (A.4.18)";
CM_ SG_ 329 RFC_Loc196_Elevation "Location elevation angle. Represented in conical coordinate system. Same as ISO 23150:2021(E): Position elevation (A.4.16)";
CM_ SG_ 329 RFC_Loc196_Azimuth "Location azimuth angle. Represented in conical coordinate system. Deviation from ISO 23150:2021(E): Position azimuth (A.4.16). Further details refers to DSP Location Interface definition";
CM_ SG_ 329 RFC_Loc196_DistVelocityCoVnce "Covariance of radial distance and radial velocity";
CM_ SG_ 329 RFC_Loc196_RadialDistanceVnce "Variance of Location radial distance ISO 23150:2021(E): Position radial distance - error (A.4.17)";
CM_ SG_ 329 RFC_Loc196_RadialVelocityVnce "Variance of Location radial relative velocity ISO 23150:2021(E): Relative velocity {radial distance} - error (A.4.19)";
CM_ SG_ 329 RFC_Loc196_ElevationVnce "Variance of Location elevation angle ISO 23150:2021(E): Position elevation - error (A.4.17)";
CM_ SG_ 329 RFC_Loc196_AzimuthVnce "Variance of Location azimuth angle ISO 23150:2021(E): Position azimuth - error (A.4.17)";
CM_ SG_ 329 RFC_Loc196_RadarCrossSection "Radar Cross Section (RCS) estimation ISO 23150:2021(E): Radar cross section (A.4.5)";
CM_ SG_ 329 RFC_Loc196_DistVelocityQuality "Quality of radial distance and velocity resolution processing. Physical range [0..1]";
CM_ SG_ 329 RFC_Loc196_ElevationQuality "Probability for correct signal model (elevation angle). Physical range [0..1]";
CM_ SG_ 329 RFC_Loc196_AzimuthQuality "Probability for correct signal model (azimuth angle). Physical range [0..1]";
CM_ SG_ 329 RFC_Loc196_RSSI "Received Signal Strength Indication (RSSI). This signal is not exactly ISO 23150:2021(E): Signal to noise ratio - detection level (A.4.7), but SNR can be calculated from this signal. Further detail please refer to the DSP Location Interface definition";
CM_ SG_ 329 RFC_Loc196_AzimuthalPartnerId "Id of the azimuthal partner location";
CM_ SG_ 329 RFC_Loc197_RadialDistance "Location radial distance. Represented in conical coordinate system. Same as ISO 23150:2021(E): Position radial distance (A.4.16)";
CM_ SG_ 329 RFC_Loc197_RadialVelocity "Location radial relative velocity ISO 23150:2021(E): Relative velocity {radial distance} (A.4.18)";
CM_ SG_ 329 RFC_Loc197_Elevation "Location elevation angle. Represented in conical coordinate system. Same as ISO 23150:2021(E): Position elevation (A.4.16)";
CM_ SG_ 329 RFC_Loc197_Azimuth "Location azimuth angle. Represented in conical coordinate system. Deviation from ISO 23150:2021(E): Position azimuth (A.4.16). Further details refers to DSP Location Interface definition";
CM_ SG_ 329 RFC_Loc197_DistVelocityCoVnce "Covariance of radial distance and radial velocity";
CM_ SG_ 329 RFC_Loc197_RadialDistanceVnce "Variance of Location radial distance ISO 23150:2021(E): Position radial distance - error (A.4.17)";
CM_ SG_ 329 RFC_Loc197_RadialVelocityVnce "Variance of Location radial relative velocity ISO 23150:2021(E): Relative velocity {radial distance} - error (A.4.19)";
CM_ SG_ 329 RFC_Loc197_ElevationVnce "Variance of Location elevation angle ISO 23150:2021(E): Position elevation - error (A.4.17)";
CM_ SG_ 329 RFC_Loc197_AzimuthVnce "Variance of Location azimuth angle ISO 23150:2021(E): Position azimuth - error (A.4.17)";
CM_ SG_ 329 RFC_Loc197_RadarCrossSection "Radar Cross Section (RCS) estimation ISO 23150:2021(E): Radar cross section (A.4.5)";
CM_ SG_ 329 RFC_Loc197_DistVelocityQuality "Quality of radial distance and velocity resolution processing. Physical range [0..1]";
CM_ SG_ 329 RFC_Loc197_ElevationQuality "Probability for correct signal model (elevation angle). Physical range [0..1]";
CM_ SG_ 329 RFC_Loc197_AzimuthQuality "Probability for correct signal model (azimuth angle). Physical range [0..1]";
CM_ SG_ 329 RFC_Loc197_RSSI "Received Signal Strength Indication (RSSI). This signal is not exactly ISO 23150:2021(E): Signal to noise ratio - detection level (A.4.7), but SNR can be calculated from this signal. Further detail please refer to the DSP Location Interface definition";
CM_ SG_ 329 RFC_Loc197_AzimuthalPartnerId "Id of the azimuthal partner location";
CM_ SG_ 330 RFC_Loc198_200_CRC "CRC - Autosar E2E Profile 5";
CM_ SG_ 330 RFC_Loc198_200_AliveCtr "Alive counter - Autosar E2E Profile 5";
CM_ SG_ 330 RFC_Loc198_200_ProtBlockCtr "Protocol-Signal: Block-Counter";
CM_ SG_ 330 RFC_Loc198_RadialDistance "Location radial distance. Represented in conical coordinate system. Same as ISO 23150:2021(E): Position radial distance (A.4.16)";
CM_ SG_ 330 RFC_Loc198_RadialVelocity "Location radial relative velocity ISO 23150:2021(E): Relative velocity {radial distance} (A.4.18)";
CM_ SG_ 330 RFC_Loc198_Elevation "Location elevation angle. Represented in conical coordinate system. Same as ISO 23150:2021(E): Position elevation (A.4.16)";
CM_ SG_ 330 RFC_Loc198_Azimuth "Location azimuth angle. Represented in conical coordinate system. Deviation from ISO 23150:2021(E): Position azimuth (A.4.16). Further details refers to DSP Location Interface definition";
CM_ SG_ 330 RFC_Loc198_DistVelocityCoVnce "Covariance of radial distance and radial velocity";
CM_ SG_ 330 RFC_Loc198_RadialDistanceVnce "Variance of Location radial distance ISO 23150:2021(E): Position radial distance - error (A.4.17)";
CM_ SG_ 330 RFC_Loc198_RadialVelocityVnce "Variance of Location radial relative velocity ISO 23150:2021(E): Relative velocity {radial distance} - error (A.4.19)";
CM_ SG_ 330 RFC_Loc198_ElevationVnce "Variance of Location elevation angle ISO 23150:2021(E): Position elevation - error (A.4.17)";
CM_ SG_ 330 RFC_Loc198_AzimuthVnce "Variance of Location azimuth angle ISO 23150:2021(E): Position azimuth - error (A.4.17)";
CM_ SG_ 330 RFC_Loc198_RadarCrossSection "Radar Cross Section (RCS) estimation ISO 23150:2021(E): Radar cross section (A.4.5)";
CM_ SG_ 330 RFC_Loc198_DistVelocityQuality "Quality of radial distance and velocity resolution processing. Physical range [0..1]";
CM_ SG_ 330 RFC_Loc198_ElevationQuality "Probability for correct signal model (elevation angle). Physical range [0..1]";
CM_ SG_ 330 RFC_Loc198_AzimuthQuality "Probability for correct signal model (azimuth angle). Physical range [0..1]";
CM_ SG_ 330 RFC_Loc198_RSSI "Received Signal Strength Indication (RSSI). This signal is not exactly ISO 23150:2021(E): Signal to noise ratio - detection level (A.4.7), but SNR can be calculated from this signal. Further detail please refer to the DSP Location Interface definition";
CM_ SG_ 330 RFC_Loc198_AzimuthalPartnerId "Id of the azimuthal partner location";
CM_ SG_ 330 RFC_Loc199_RadialDistance "Location radial distance. Represented in conical coordinate system. Same as ISO 23150:2021(E): Position radial distance (A.4.16)";
CM_ SG_ 330 RFC_Loc199_RadialVelocity "Location radial relative velocity ISO 23150:2021(E): Relative velocity {radial distance} (A.4.18)";
CM_ SG_ 330 RFC_Loc199_Elevation "Location elevation angle. Represented in conical coordinate system. Same as ISO 23150:2021(E): Position elevation (A.4.16)";
CM_ SG_ 330 RFC_Loc199_Azimuth "Location azimuth angle. Represented in conical coordinate system. Deviation from ISO 23150:2021(E): Position azimuth (A.4.16). Further details refers to DSP Location Interface definition";
CM_ SG_ 330 RFC_Loc199_DistVelocityCoVnce "Covariance of radial distance and radial velocity";
CM_ SG_ 330 RFC_Loc199_RadialDistanceVnce "Variance of Location radial distance ISO 23150:2021(E): Position radial distance - error (A.4.17)";
CM_ SG_ 330 RFC_Loc199_RadialVelocityVnce "Variance of Location radial relative velocity ISO 23150:2021(E): Relative velocity {radial distance} - error (A.4.19)";
CM_ SG_ 330 RFC_Loc199_ElevationVnce "Variance of Location elevation angle ISO 23150:2021(E): Position elevation - error (A.4.17)";
CM_ SG_ 330 RFC_Loc199_AzimuthVnce "Variance of Location azimuth angle ISO 23150:2021(E): Position azimuth - error (A.4.17)";
CM_ SG_ 330 RFC_Loc199_RadarCrossSection "Radar Cross Section (RCS) estimation ISO 23150:2021(E): Radar cross section (A.4.5)";
CM_ SG_ 330 RFC_Loc199_DistVelocityQuality "Quality of radial distance and velocity resolution processing. Physical range [0..1]";
CM_ SG_ 330 RFC_Loc199_ElevationQuality "Probability for correct signal model (elevation angle). Physical range [0..1]";
CM_ SG_ 330 RFC_Loc199_AzimuthQuality "Probability for correct signal model (azimuth angle). Physical range [0..1]";
CM_ SG_ 330 RFC_Loc199_RSSI "Received Signal Strength Indication (RSSI). This signal is not exactly ISO 23150:2021(E): Signal to noise ratio - detection level (A.4.7), but SNR can be calculated from this signal. Further detail please refer to the DSP Location Interface definition";
CM_ SG_ 330 RFC_Loc199_AzimuthalPartnerId "Id of the azimuthal partner location";
CM_ SG_ 330 RFC_Loc200_RadialDistance "Location radial distance. Represented in conical coordinate system. Same as ISO 23150:2021(E): Position radial distance (A.4.16)";
CM_ SG_ 330 RFC_Loc200_RadialVelocity "Location radial relative velocity ISO 23150:2021(E): Relative velocity {radial distance} (A.4.18)";
CM_ SG_ 330 RFC_Loc200_Elevation "Location elevation angle. Represented in conical coordinate system. Same as ISO 23150:2021(E): Position elevation (A.4.16)";
CM_ SG_ 330 RFC_Loc200_Azimuth "Location azimuth angle. Represented in conical coordinate system. Deviation from ISO 23150:2021(E): Position azimuth (A.4.16). Further details refers to DSP Location Interface definition";
CM_ SG_ 330 RFC_Loc200_DistVelocityCoVnce "Covariance of radial distance and radial velocity";
CM_ SG_ 330 RFC_Loc200_RadialDistanceVnce "Variance of Location radial distance ISO 23150:2021(E): Position radial distance - error (A.4.17)";
CM_ SG_ 330 RFC_Loc200_RadialVelocityVnce "Variance of Location radial relative velocity ISO 23150:2021(E): Relative velocity {radial distance} - error (A.4.19)";
CM_ SG_ 330 RFC_Loc200_ElevationVnce "Variance of Location elevation angle ISO 23150:2021(E): Position elevation - error (A.4.17)";
CM_ SG_ 330 RFC_Loc200_AzimuthVnce "Variance of Location azimuth angle ISO 23150:2021(E): Position azimuth - error (A.4.17)";
CM_ SG_ 330 RFC_Loc200_RadarCrossSection "Radar Cross Section (RCS) estimation ISO 23150:2021(E): Radar cross section (A.4.5)";
CM_ SG_ 330 RFC_Loc200_DistVelocityQuality "Quality of radial distance and velocity resolution processing. Physical range [0..1]";
CM_ SG_ 330 RFC_Loc200_ElevationQuality "Probability for correct signal model (elevation angle). Physical range [0..1]";
CM_ SG_ 330 RFC_Loc200_AzimuthQuality "Probability for correct signal model (azimuth angle). Physical range [0..1]";
CM_ SG_ 330 RFC_Loc200_RSSI "Received Signal Strength Indication (RSSI). This signal is not exactly ISO 23150:2021(E): Signal to noise ratio - detection level (A.4.7), but SNR can be calculated from this signal. Further detail please refer to the DSP Location Interface definition";
CM_ SG_ 330 RFC_Loc200_AzimuthalPartnerId "Id of the azimuthal partner location";
CM_ SG_ 331 RFC_Loc201_203_CRC "CRC - Autosar E2E Profile 5";
CM_ SG_ 331 RFC_Loc201_203_AliveCtr "Alive counter - Autosar E2E Profile 5";
CM_ SG_ 331 RFC_Loc201_203_ProtBlockCtr "Protocol-Signal: Block-Counter";
CM_ SG_ 331 RFC_Loc201_RadialDistance "Location radial distance. Represented in conical coordinate system. Same as ISO 23150:2021(E): Position radial distance (A.4.16)";
CM_ SG_ 331 RFC_Loc201_RadialVelocity "Location radial relative velocity ISO 23150:2021(E): Relative velocity {radial distance} (A.4.18)";
CM_ SG_ 331 RFC_Loc201_Elevation "Location elevation angle. Represented in conical coordinate system. Same as ISO 23150:2021(E): Position elevation (A.4.16)";
CM_ SG_ 331 RFC_Loc201_Azimuth "Location azimuth angle. Represented in conical coordinate system. Deviation from ISO 23150:2021(E): Position azimuth (A.4.16). Further details refers to DSP Location Interface definition";
CM_ SG_ 331 RFC_Loc201_DistVelocityCoVnce "Covariance of radial distance and radial velocity";
CM_ SG_ 331 RFC_Loc201_RadialDistanceVnce "Variance of Location radial distance ISO 23150:2021(E): Position radial distance - error (A.4.17)";
CM_ SG_ 331 RFC_Loc201_RadialVelocityVnce "Variance of Location radial relative velocity ISO 23150:2021(E): Relative velocity {radial distance} - error (A.4.19)";
CM_ SG_ 331 RFC_Loc201_ElevationVnce "Variance of Location elevation angle ISO 23150:2021(E): Position elevation - error (A.4.17)";
CM_ SG_ 331 RFC_Loc201_AzimuthVnce "Variance of Location azimuth angle ISO 23150:2021(E): Position azimuth - error (A.4.17)";
CM_ SG_ 331 RFC_Loc201_RadarCrossSection "Radar Cross Section (RCS) estimation ISO 23150:2021(E): Radar cross section (A.4.5)";
CM_ SG_ 331 RFC_Loc201_DistVelocityQuality "Quality of radial distance and velocity resolution processing. Physical range [0..1]";
CM_ SG_ 331 RFC_Loc201_ElevationQuality "Probability for correct signal model (elevation angle). Physical range [0..1]";
CM_ SG_ 331 RFC_Loc201_AzimuthQuality "Probability for correct signal model (azimuth angle). Physical range [0..1]";
CM_ SG_ 331 RFC_Loc201_RSSI "Received Signal Strength Indication (RSSI). This signal is not exactly ISO 23150:2021(E): Signal to noise ratio - detection level (A.4.7), but SNR can be calculated from this signal. Further detail please refer to the DSP Location Interface definition";
CM_ SG_ 331 RFC_Loc201_AzimuthalPartnerId "Id of the azimuthal partner location";
CM_ SG_ 331 RFC_Loc202_RadialDistance "Location radial distance. Represented in conical coordinate system. Same as ISO 23150:2021(E): Position radial distance (A.4.16)";
CM_ SG_ 331 RFC_Loc202_RadialVelocity "Location radial relative velocity ISO 23150:2021(E): Relative velocity {radial distance} (A.4.18)";
CM_ SG_ 331 RFC_Loc202_Elevation "Location elevation angle. Represented in conical coordinate system. Same as ISO 23150:2021(E): Position elevation (A.4.16)";
CM_ SG_ 331 RFC_Loc202_Azimuth "Location azimuth angle. Represented in conical coordinate system. Deviation from ISO 23150:2021(E): Position azimuth (A.4.16). Further details refers to DSP Location Interface definition";
CM_ SG_ 331 RFC_Loc202_DistVelocityCoVnce "Covariance of radial distance and radial velocity";
CM_ SG_ 331 RFC_Loc202_RadialDistanceVnce "Variance of Location radial distance ISO 23150:2021(E): Position radial distance - error (A.4.17)";
CM_ SG_ 331 RFC_Loc202_RadialVelocityVnce "Variance of Location radial relative velocity ISO 23150:2021(E): Relative velocity {radial distance} - error (A.4.19)";
CM_ SG_ 331 RFC_Loc202_ElevationVnce "Variance of Location elevation angle ISO 23150:2021(E): Position elevation - error (A.4.17)";
CM_ SG_ 331 RFC_Loc202_AzimuthVnce "Variance of Location azimuth angle ISO 23150:2021(E): Position azimuth - error (A.4.17)";
CM_ SG_ 331 RFC_Loc202_RadarCrossSection "Radar Cross Section (RCS) estimation ISO 23150:2021(E): Radar cross section (A.4.5)";
CM_ SG_ 331 RFC_Loc202_DistVelocityQuality "Quality of radial distance and velocity resolution processing. Physical range [0..1]";
CM_ SG_ 331 RFC_Loc202_ElevationQuality "Probability for correct signal model (elevation angle). Physical range [0..1]";
CM_ SG_ 331 RFC_Loc202_AzimuthQuality "Probability for correct signal model (azimuth angle). Physical range [0..1]";
CM_ SG_ 331 RFC_Loc202_RSSI "Received Signal Strength Indication (RSSI). This signal is not exactly ISO 23150:2021(E): Signal to noise ratio - detection level (A.4.7), but SNR can be calculated from this signal. Further detail please refer to the DSP Location Interface definition";
CM_ SG_ 331 RFC_Loc202_AzimuthalPartnerId "Id of the azimuthal partner location";
CM_ SG_ 331 RFC_Loc203_RadialDistance "Location radial distance. Represented in conical coordinate system. Same as ISO 23150:2021(E): Position radial distance (A.4.16)";
CM_ SG_ 331 RFC_Loc203_RadialVelocity "Location radial relative velocity ISO 23150:2021(E): Relative velocity {radial distance} (A.4.18)";
CM_ SG_ 331 RFC_Loc203_Elevation "Location elevation angle. Represented in conical coordinate system. Same as ISO 23150:2021(E): Position elevation (A.4.16)";
CM_ SG_ 331 RFC_Loc203_Azimuth "Location azimuth angle. Represented in conical coordinate system. Deviation from ISO 23150:2021(E): Position azimuth (A.4.16). Further details refers to DSP Location Interface definition";
CM_ SG_ 331 RFC_Loc203_DistVelocityCoVnce "Covariance of radial distance and radial velocity";
CM_ SG_ 331 RFC_Loc203_RadialDistanceVnce "Variance of Location radial distance ISO 23150:2021(E): Position radial distance - error (A.4.17)";
CM_ SG_ 331 RFC_Loc203_RadialVelocityVnce "Variance of Location radial relative velocity ISO 23150:2021(E): Relative velocity {radial distance} - error (A.4.19)";
CM_ SG_ 331 RFC_Loc203_ElevationVnce "Variance of Location elevation angle ISO 23150:2021(E): Position elevation - error (A.4.17)";
CM_ SG_ 331 RFC_Loc203_AzimuthVnce "Variance of Location azimuth angle ISO 23150:2021(E): Position azimuth - error (A.4.17)";
CM_ SG_ 331 RFC_Loc203_RadarCrossSection "Radar Cross Section (RCS) estimation ISO 23150:2021(E): Radar cross section (A.4.5)";
CM_ SG_ 331 RFC_Loc203_DistVelocityQuality "Quality of radial distance and velocity resolution processing. Physical range [0..1]";
CM_ SG_ 331 RFC_Loc203_ElevationQuality "Probability for correct signal model (elevation angle). Physical range [0..1]";
CM_ SG_ 331 RFC_Loc203_AzimuthQuality "Probability for correct signal model (azimuth angle). Physical range [0..1]";
CM_ SG_ 331 RFC_Loc203_RSSI "Received Signal Strength Indication (RSSI). This signal is not exactly ISO 23150:2021(E): Signal to noise ratio - detection level (A.4.7), but SNR can be calculated from this signal. Further detail please refer to the DSP Location Interface definition";
CM_ SG_ 331 RFC_Loc203_AzimuthalPartnerId "Id of the azimuthal partner location";
CM_ SG_ 332 RFC_Loc204_206_CRC "CRC - Autosar E2E Profile 5";
CM_ SG_ 332 RFC_Loc204_206_AliveCtr "Alive counter - Autosar E2E Profile 5";
CM_ SG_ 332 RFC_Loc204_206_ProtBlockCtr "Protocol-Signal: Block-Counter";
CM_ SG_ 332 RFC_Loc204_RadialDistance "Location radial distance. Represented in conical coordinate system. Same as ISO 23150:2021(E): Position radial distance (A.4.16)";
CM_ SG_ 332 RFC_Loc204_RadialVelocity "Location radial relative velocity ISO 23150:2021(E): Relative velocity {radial distance} (A.4.18)";
CM_ SG_ 332 RFC_Loc204_Elevation "Location elevation angle. Represented in conical coordinate system. Same as ISO 23150:2021(E): Position elevation (A.4.16)";
CM_ SG_ 332 RFC_Loc204_Azimuth "Location azimuth angle. Represented in conical coordinate system. Deviation from ISO 23150:2021(E): Position azimuth (A.4.16). Further details refers to DSP Location Interface definition";
CM_ SG_ 332 RFC_Loc204_DistVelocityCoVnce "Covariance of radial distance and radial velocity";
CM_ SG_ 332 RFC_Loc204_RadialDistanceVnce "Variance of Location radial distance ISO 23150:2021(E): Position radial distance - error (A.4.17)";
CM_ SG_ 332 RFC_Loc204_RadialVelocityVnce "Variance of Location radial relative velocity ISO 23150:2021(E): Relative velocity {radial distance} - error (A.4.19)";
CM_ SG_ 332 RFC_Loc204_ElevationVnce "Variance of Location elevation angle ISO 23150:2021(E): Position elevation - error (A.4.17)";
CM_ SG_ 332 RFC_Loc204_AzimuthVnce "Variance of Location azimuth angle ISO 23150:2021(E): Position azimuth - error (A.4.17)";
CM_ SG_ 332 RFC_Loc204_RadarCrossSection "Radar Cross Section (RCS) estimation ISO 23150:2021(E): Radar cross section (A.4.5)";
CM_ SG_ 332 RFC_Loc204_DistVelocityQuality "Quality of radial distance and velocity resolution processing. Physical range [0..1]";
CM_ SG_ 332 RFC_Loc204_ElevationQuality "Probability for correct signal model (elevation angle). Physical range [0..1]";
CM_ SG_ 332 RFC_Loc204_AzimuthQuality "Probability for correct signal model (azimuth angle). Physical range [0..1]";
CM_ SG_ 332 RFC_Loc204_RSSI "Received Signal Strength Indication (RSSI). This signal is not exactly ISO 23150:2021(E): Signal to noise ratio - detection level (A.4.7), but SNR can be calculated from this signal. Further detail please refer to the DSP Location Interface definition";
CM_ SG_ 332 RFC_Loc204_AzimuthalPartnerId "Id of the azimuthal partner location";
CM_ SG_ 332 RFC_Loc205_RadialDistance "Location radial distance. Represented in conical coordinate system. Same as ISO 23150:2021(E): Position radial distance (A.4.16)";
CM_ SG_ 332 RFC_Loc205_RadialVelocity "Location radial relative velocity ISO 23150:2021(E): Relative velocity {radial distance} (A.4.18)";
CM_ SG_ 332 RFC_Loc205_Elevation "Location elevation angle. Represented in conical coordinate system. Same as ISO 23150:2021(E): Position elevation (A.4.16)";
CM_ SG_ 332 RFC_Loc205_Azimuth "Location azimuth angle. Represented in conical coordinate system. Deviation from ISO 23150:2021(E): Position azimuth (A.4.16). Further details refers to DSP Location Interface definition";
CM_ SG_ 332 RFC_Loc205_DistVelocityCoVnce "Covariance of radial distance and radial velocity";
CM_ SG_ 332 RFC_Loc205_RadialDistanceVnce "Variance of Location radial distance ISO 23150:2021(E): Position radial distance - error (A.4.17)";
CM_ SG_ 332 RFC_Loc205_RadialVelocityVnce "Variance of Location radial relative velocity ISO 23150:2021(E): Relative velocity {radial distance} - error (A.4.19)";
CM_ SG_ 332 RFC_Loc205_ElevationVnce "Variance of Location elevation angle ISO 23150:2021(E): Position elevation - error (A.4.17)";
CM_ SG_ 332 RFC_Loc205_AzimuthVnce "Variance of Location azimuth angle ISO 23150:2021(E): Position azimuth - error (A.4.17)";
CM_ SG_ 332 RFC_Loc205_RadarCrossSection "Radar Cross Section (RCS) estimation ISO 23150:2021(E): Radar cross section (A.4.5)";
CM_ SG_ 332 RFC_Loc205_DistVelocityQuality "Quality of radial distance and velocity resolution processing. Physical range [0..1]";
CM_ SG_ 332 RFC_Loc205_ElevationQuality "Probability for correct signal model (elevation angle). Physical range [0..1]";
CM_ SG_ 332 RFC_Loc205_AzimuthQuality "Probability for correct signal model (azimuth angle). Physical range [0..1]";
CM_ SG_ 332 RFC_Loc205_RSSI "Received Signal Strength Indication (RSSI). This signal is not exactly ISO 23150:2021(E): Signal to noise ratio - detection level (A.4.7), but SNR can be calculated from this signal. Further detail please refer to the DSP Location Interface definition";
CM_ SG_ 332 RFC_Loc205_AzimuthalPartnerId "Id of the azimuthal partner location";
CM_ SG_ 332 RFC_Loc206_RadialDistance "Location radial distance. Represented in conical coordinate system. Same as ISO 23150:2021(E): Position radial distance (A.4.16)";
CM_ SG_ 332 RFC_Loc206_RadialVelocity "Location radial relative velocity ISO 23150:2021(E): Relative velocity {radial distance} (A.4.18)";
CM_ SG_ 332 RFC_Loc206_Elevation "Location elevation angle. Represented in conical coordinate system. Same as ISO 23150:2021(E): Position elevation (A.4.16)";
CM_ SG_ 332 RFC_Loc206_Azimuth "Location azimuth angle. Represented in conical coordinate system. Deviation from ISO 23150:2021(E): Position azimuth (A.4.16). Further details refers to DSP Location Interface definition";
CM_ SG_ 332 RFC_Loc206_DistVelocityCoVnce "Covariance of radial distance and radial velocity";
CM_ SG_ 332 RFC_Loc206_RadialDistanceVnce "Variance of Location radial distance ISO 23150:2021(E): Position radial distance - error (A.4.17)";
CM_ SG_ 332 RFC_Loc206_RadialVelocityVnce "Variance of Location radial relative velocity ISO 23150:2021(E): Relative velocity {radial distance} - error (A.4.19)";
CM_ SG_ 332 RFC_Loc206_ElevationVnce "Variance of Location elevation angle ISO 23150:2021(E): Position elevation - error (A.4.17)";
CM_ SG_ 332 RFC_Loc206_AzimuthVnce "Variance of Location azimuth angle ISO 23150:2021(E): Position azimuth - error (A.4.17)";
CM_ SG_ 332 RFC_Loc206_RadarCrossSection "Radar Cross Section (RCS) estimation ISO 23150:2021(E): Radar cross section (A.4.5)";
CM_ SG_ 332 RFC_Loc206_DistVelocityQuality "Quality of radial distance and velocity resolution processing. Physical range [0..1]";
CM_ SG_ 332 RFC_Loc206_ElevationQuality "Probability for correct signal model (elevation angle). Physical range [0..1]";
CM_ SG_ 332 RFC_Loc206_AzimuthQuality "Probability for correct signal model (azimuth angle). Physical range [0..1]";
CM_ SG_ 332 RFC_Loc206_RSSI "Received Signal Strength Indication (RSSI). This signal is not exactly ISO 23150:2021(E): Signal to noise ratio - detection level (A.4.7), but SNR can be calculated from this signal. Further detail please refer to the DSP Location Interface definition";
CM_ SG_ 332 RFC_Loc206_AzimuthalPartnerId "Id of the azimuthal partner location";
CM_ SG_ 333 RFC_Loc207_209_CRC "CRC - Autosar E2E Profile 5";
CM_ SG_ 333 RFC_Loc207_209_AliveCtr "Alive counter - Autosar E2E Profile 5";
CM_ SG_ 333 RFC_Loc207_209_ProtBlockCtr "Protocol-Signal: Block-Counter";
CM_ SG_ 333 RFC_Loc207_RadialDistance "Location radial distance. Represented in conical coordinate system. Same as ISO 23150:2021(E): Position radial distance (A.4.16)";
CM_ SG_ 333 RFC_Loc207_RadialVelocity "Location radial relative velocity ISO 23150:2021(E): Relative velocity {radial distance} (A.4.18)";
CM_ SG_ 333 RFC_Loc207_Elevation "Location elevation angle. Represented in conical coordinate system. Same as ISO 23150:2021(E): Position elevation (A.4.16)";
CM_ SG_ 333 RFC_Loc207_Azimuth "Location azimuth angle. Represented in conical coordinate system. Deviation from ISO 23150:2021(E): Position azimuth (A.4.16). Further details refers to DSP Location Interface definition";
CM_ SG_ 333 RFC_Loc207_DistVelocityCoVnce "Covariance of radial distance and radial velocity";
CM_ SG_ 333 RFC_Loc207_RadialDistanceVnce "Variance of Location radial distance ISO 23150:2021(E): Position radial distance - error (A.4.17)";
CM_ SG_ 333 RFC_Loc207_RadialVelocityVnce "Variance of Location radial relative velocity ISO 23150:2021(E): Relative velocity {radial distance} - error (A.4.19)";
CM_ SG_ 333 RFC_Loc207_ElevationVnce "Variance of Location elevation angle ISO 23150:2021(E): Position elevation - error (A.4.17)";
CM_ SG_ 333 RFC_Loc207_AzimuthVnce "Variance of Location azimuth angle ISO 23150:2021(E): Position azimuth - error (A.4.17)";
CM_ SG_ 333 RFC_Loc207_RadarCrossSection "Radar Cross Section (RCS) estimation ISO 23150:2021(E): Radar cross section (A.4.5)";
CM_ SG_ 333 RFC_Loc207_DistVelocityQuality "Quality of radial distance and velocity resolution processing. Physical range [0..1]";
CM_ SG_ 333 RFC_Loc207_ElevationQuality "Probability for correct signal model (elevation angle). Physical range [0..1]";
CM_ SG_ 333 RFC_Loc207_AzimuthQuality "Probability for correct signal model (azimuth angle). Physical range [0..1]";
CM_ SG_ 333 RFC_Loc207_RSSI "Received Signal Strength Indication (RSSI). This signal is not exactly ISO 23150:2021(E): Signal to noise ratio - detection level (A.4.7), but SNR can be calculated from this signal. Further detail please refer to the DSP Location Interface definition";
CM_ SG_ 333 RFC_Loc207_AzimuthalPartnerId "Id of the azimuthal partner location";
CM_ SG_ 333 RFC_Loc208_RadialDistance "Location radial distance. Represented in conical coordinate system. Same as ISO 23150:2021(E): Position radial distance (A.4.16)";
CM_ SG_ 333 RFC_Loc208_RadialVelocity "Location radial relative velocity ISO 23150:2021(E): Relative velocity {radial distance} (A.4.18)";
CM_ SG_ 333 RFC_Loc208_Elevation "Location elevation angle. Represented in conical coordinate system. Same as ISO 23150:2021(E): Position elevation (A.4.16)";
CM_ SG_ 333 RFC_Loc208_Azimuth "Location azimuth angle. Represented in conical coordinate system. Deviation from ISO 23150:2021(E): Position azimuth (A.4.16). Further details refers to DSP Location Interface definition";
CM_ SG_ 333 RFC_Loc208_DistVelocityCoVnce "Covariance of radial distance and radial velocity";
CM_ SG_ 333 RFC_Loc208_RadialDistanceVnce "Variance of Location radial distance ISO 23150:2021(E): Position radial distance - error (A.4.17)";
CM_ SG_ 333 RFC_Loc208_RadialVelocityVnce "Variance of Location radial relative velocity ISO 23150:2021(E): Relative velocity {radial distance} - error (A.4.19)";
CM_ SG_ 333 RFC_Loc208_ElevationVnce "Variance of Location elevation angle ISO 23150:2021(E): Position elevation - error (A.4.17)";
CM_ SG_ 333 RFC_Loc208_AzimuthVnce "Variance of Location azimuth angle ISO 23150:2021(E): Position azimuth - error (A.4.17)";
CM_ SG_ 333 RFC_Loc208_RadarCrossSection "Radar Cross Section (RCS) estimation ISO 23150:2021(E): Radar cross section (A.4.5)";
CM_ SG_ 333 RFC_Loc208_DistVelocityQuality "Quality of radial distance and velocity resolution processing. Physical range [0..1]";
CM_ SG_ 333 RFC_Loc208_ElevationQuality "Probability for correct signal model (elevation angle). Physical range [0..1]";
CM_ SG_ 333 RFC_Loc208_AzimuthQuality "Probability for correct signal model (azimuth angle). Physical range [0..1]";
CM_ SG_ 333 RFC_Loc208_RSSI "Received Signal Strength Indication (RSSI). This signal is not exactly ISO 23150:2021(E): Signal to noise ratio - detection level (A.4.7), but SNR can be calculated from this signal. Further detail please refer to the DSP Location Interface definition";
CM_ SG_ 333 RFC_Loc208_AzimuthalPartnerId "Id of the azimuthal partner location";
CM_ SG_ 333 RFC_Loc209_RadialDistance "Location radial distance. Represented in conical coordinate system. Same as ISO 23150:2021(E): Position radial distance (A.4.16)";
CM_ SG_ 333 RFC_Loc209_RadialVelocity "Location radial relative velocity ISO 23150:2021(E): Relative velocity {radial distance} (A.4.18)";
CM_ SG_ 333 RFC_Loc209_Elevation "Location elevation angle. Represented in conical coordinate system. Same as ISO 23150:2021(E): Position elevation (A.4.16)";
CM_ SG_ 333 RFC_Loc209_Azimuth "Location azimuth angle. Represented in conical coordinate system. Deviation from ISO 23150:2021(E): Position azimuth (A.4.16). Further details refers to DSP Location Interface definition";
CM_ SG_ 333 RFC_Loc209_DistVelocityCoVnce "Covariance of radial distance and radial velocity";
CM_ SG_ 333 RFC_Loc209_RadialDistanceVnce "Variance of Location radial distance ISO 23150:2021(E): Position radial distance - error (A.4.17)";
CM_ SG_ 333 RFC_Loc209_RadialVelocityVnce "Variance of Location radial relative velocity ISO 23150:2021(E): Relative velocity {radial distance} - error (A.4.19)";
CM_ SG_ 333 RFC_Loc209_ElevationVnce "Variance of Location elevation angle ISO 23150:2021(E): Position elevation - error (A.4.17)";
CM_ SG_ 333 RFC_Loc209_AzimuthVnce "Variance of Location azimuth angle ISO 23150:2021(E): Position azimuth - error (A.4.17)";
CM_ SG_ 333 RFC_Loc209_RadarCrossSection "Radar Cross Section (RCS) estimation ISO 23150:2021(E): Radar cross section (A.4.5)";
CM_ SG_ 333 RFC_Loc209_DistVelocityQuality "Quality of radial distance and velocity resolution processing. Physical range [0..1]";
CM_ SG_ 333 RFC_Loc209_ElevationQuality "Probability for correct signal model (elevation angle). Physical range [0..1]";
CM_ SG_ 333 RFC_Loc209_AzimuthQuality "Probability for correct signal model (azimuth angle). Physical range [0..1]";
CM_ SG_ 333 RFC_Loc209_RSSI "Received Signal Strength Indication (RSSI). This signal is not exactly ISO 23150:2021(E): Signal to noise ratio - detection level (A.4.7), but SNR can be calculated from this signal. Further detail please refer to the DSP Location Interface definition";
CM_ SG_ 333 RFC_Loc209_AzimuthalPartnerId "Id of the azimuthal partner location";
CM_ SG_ 334 RFC_Loc210_212_CRC "CRC - Autosar E2E Profile 5";
CM_ SG_ 334 RFC_Loc210_212_AliveCtr "Alive counter - Autosar E2E Profile 5";
CM_ SG_ 334 RFC_Loc210_212_ProtBlockCtr "Protocol-Signal: Block-Counter";
CM_ SG_ 334 RFC_Loc210_RadialDistance "Location radial distance. Represented in conical coordinate system. Same as ISO 23150:2021(E): Position radial distance (A.4.16)";
CM_ SG_ 334 RFC_Loc210_RadialVelocity "Location radial relative velocity ISO 23150:2021(E): Relative velocity {radial distance} (A.4.18)";
CM_ SG_ 334 RFC_Loc210_Elevation "Location elevation angle. Represented in conical coordinate system. Same as ISO 23150:2021(E): Position elevation (A.4.16)";
CM_ SG_ 334 RFC_Loc210_Azimuth "Location azimuth angle. Represented in conical coordinate system. Deviation from ISO 23150:2021(E): Position azimuth (A.4.16). Further details refers to DSP Location Interface definition";
CM_ SG_ 334 RFC_Loc210_DistVelocityCoVnce "Covariance of radial distance and radial velocity";
CM_ SG_ 334 RFC_Loc210_RadialDistanceVnce "Variance of Location radial distance ISO 23150:2021(E): Position radial distance - error (A.4.17)";
CM_ SG_ 334 RFC_Loc210_RadialVelocityVnce "Variance of Location radial relative velocity ISO 23150:2021(E): Relative velocity {radial distance} - error (A.4.19)";
CM_ SG_ 334 RFC_Loc210_ElevationVnce "Variance of Location elevation angle ISO 23150:2021(E): Position elevation - error (A.4.17)";
CM_ SG_ 334 RFC_Loc210_AzimuthVnce "Variance of Location azimuth angle ISO 23150:2021(E): Position azimuth - error (A.4.17)";
CM_ SG_ 334 RFC_Loc210_RadarCrossSection "Radar Cross Section (RCS) estimation ISO 23150:2021(E): Radar cross section (A.4.5)";
CM_ SG_ 334 RFC_Loc210_DistVelocityQuality "Quality of radial distance and velocity resolution processing. Physical range [0..1]";
CM_ SG_ 334 RFC_Loc210_ElevationQuality "Probability for correct signal model (elevation angle). Physical range [0..1]";
CM_ SG_ 334 RFC_Loc210_AzimuthQuality "Probability for correct signal model (azimuth angle). Physical range [0..1]";
CM_ SG_ 334 RFC_Loc210_RSSI "Received Signal Strength Indication (RSSI). This signal is not exactly ISO 23150:2021(E): Signal to noise ratio - detection level (A.4.7), but SNR can be calculated from this signal. Further detail please refer to the DSP Location Interface definition";
CM_ SG_ 334 RFC_Loc210_AzimuthalPartnerId "Id of the azimuthal partner location";
CM_ SG_ 334 RFC_Loc211_RadialDistance "Location radial distance. Represented in conical coordinate system. Same as ISO 23150:2021(E): Position radial distance (A.4.16)";
CM_ SG_ 334 RFC_Loc211_RadialVelocity "Location radial relative velocity ISO 23150:2021(E): Relative velocity {radial distance} (A.4.18)";
CM_ SG_ 334 RFC_Loc211_Elevation "Location elevation angle. Represented in conical coordinate system. Same as ISO 23150:2021(E): Position elevation (A.4.16)";
CM_ SG_ 334 RFC_Loc211_Azimuth "Location azimuth angle. Represented in conical coordinate system. Deviation from ISO 23150:2021(E): Position azimuth (A.4.16). Further details refers to DSP Location Interface definition";
CM_ SG_ 334 RFC_Loc211_DistVelocityCoVnce "Covariance of radial distance and radial velocity";
CM_ SG_ 334 RFC_Loc211_RadialDistanceVnce "Variance of Location radial distance ISO 23150:2021(E): Position radial distance - error (A.4.17)";
CM_ SG_ 334 RFC_Loc211_RadialVelocityVnce "Variance of Location radial relative velocity ISO 23150:2021(E): Relative velocity {radial distance} - error (A.4.19)";
CM_ SG_ 334 RFC_Loc211_ElevationVnce "Variance of Location elevation angle ISO 23150:2021(E): Position elevation - error (A.4.17)";
CM_ SG_ 334 RFC_Loc211_AzimuthVnce "Variance of Location azimuth angle ISO 23150:2021(E): Position azimuth - error (A.4.17)";
CM_ SG_ 334 RFC_Loc211_RadarCrossSection "Radar Cross Section (RCS) estimation ISO 23150:2021(E): Radar cross section (A.4.5)";
CM_ SG_ 334 RFC_Loc211_DistVelocityQuality "Quality of radial distance and velocity resolution processing. Physical range [0..1]";
CM_ SG_ 334 RFC_Loc211_ElevationQuality "Probability for correct signal model (elevation angle). Physical range [0..1]";
CM_ SG_ 334 RFC_Loc211_AzimuthQuality "Probability for correct signal model (azimuth angle). Physical range [0..1]";
CM_ SG_ 334 RFC_Loc211_RSSI "Received Signal Strength Indication (RSSI). This signal is not exactly ISO 23150:2021(E): Signal to noise ratio - detection level (A.4.7), but SNR can be calculated from this signal. Further detail please refer to the DSP Location Interface definition";
CM_ SG_ 334 RFC_Loc211_AzimuthalPartnerId "Id of the azimuthal partner location";
CM_ SG_ 334 RFC_Loc212_RadialDistance "Location radial distance. Represented in conical coordinate system. Same as ISO 23150:2021(E): Position radial distance (A.4.16)";
CM_ SG_ 334 RFC_Loc212_RadialVelocity "Location radial relative velocity ISO 23150:2021(E): Relative velocity {radial distance} (A.4.18)";
CM_ SG_ 334 RFC_Loc212_Elevation "Location elevation angle. Represented in conical coordinate system. Same as ISO 23150:2021(E): Position elevation (A.4.16)";
CM_ SG_ 334 RFC_Loc212_Azimuth "Location azimuth angle. Represented in conical coordinate system. Deviation from ISO 23150:2021(E): Position azimuth (A.4.16). Further details refers to DSP Location Interface definition";
CM_ SG_ 334 RFC_Loc212_DistVelocityCoVnce "Covariance of radial distance and radial velocity";
CM_ SG_ 334 RFC_Loc212_RadialDistanceVnce "Variance of Location radial distance ISO 23150:2021(E): Position radial distance - error (A.4.17)";
CM_ SG_ 334 RFC_Loc212_RadialVelocityVnce "Variance of Location radial relative velocity ISO 23150:2021(E): Relative velocity {radial distance} - error (A.4.19)";
CM_ SG_ 334 RFC_Loc212_ElevationVnce "Variance of Location elevation angle ISO 23150:2021(E): Position elevation - error (A.4.17)";
CM_ SG_ 334 RFC_Loc212_AzimuthVnce "Variance of Location azimuth angle ISO 23150:2021(E): Position azimuth - error (A.4.17)";
CM_ SG_ 334 RFC_Loc212_RadarCrossSection "Radar Cross Section (RCS) estimation ISO 23150:2021(E): Radar cross section (A.4.5)";
CM_ SG_ 334 RFC_Loc212_DistVelocityQuality "Quality of radial distance and velocity resolution processing. Physical range [0..1]";
CM_ SG_ 334 RFC_Loc212_ElevationQuality "Probability for correct signal model (elevation angle). Physical range [0..1]";
CM_ SG_ 334 RFC_Loc212_AzimuthQuality "Probability for correct signal model (azimuth angle). Physical range [0..1]";
CM_ SG_ 334 RFC_Loc212_RSSI "Received Signal Strength Indication (RSSI). This signal is not exactly ISO 23150:2021(E): Signal to noise ratio - detection level (A.4.7), but SNR can be calculated from this signal. Further detail please refer to the DSP Location Interface definition";
CM_ SG_ 334 RFC_Loc212_AzimuthalPartnerId "Id of the azimuthal partner location";
BA_DEF_ SG_  "GenSigEnvVarType" ENUM  "int","float","undef";
BA_DEF_ SG_  "GenSigSendType" ENUM  "Cyclic","OnWrite","OnWriteWithRepetition","OnChange","OnChangeWithRepetition","IfActive","IfActiveWithRepetition";
BA_DEF_ BO_  "GenMsgCycleTimeFast" INT 2 50000;
BA_DEF_ BO_  "GenMsgILSupport" ENUM  "No","Yes";
BA_DEF_ BO_  "CANFD_BRS" ENUM  "0","1";
BA_DEF_ BO_  "GenMsgCycleTime" INT 0 65535;
BA_DEF_ BO_  "GenMsgSendType" ENUM  "Event","cyclic";
BA_DEF_ BO_  "VFrameFormat" ENUM  "StandardCAN","ExtendedCAN","reserved","reserved","reserved","reserved","reserved","reserved","reserved","reserved","reserved","reserved","reserved","reserved","StandardCAN_FD","ExtendedCAN_FD";
BA_DEF_ SG_  "GenSigStartValue" FLOAT 0 100000000000;
BA_DEF_DEF_  "GenSigEnvVarType" "undef";
BA_DEF_DEF_  "GenSigSendType" "Cyclic";
BA_DEF_DEF_  "GenMsgCycleTimeFast" 100;
BA_DEF_DEF_  "GenMsgILSupport" "Yes";
BA_DEF_DEF_  "CANFD_BRS" "1";
BA_DEF_DEF_  "GenMsgCycleTime" 0;
BA_DEF_DEF_  "GenMsgSendType" "";
BA_DEF_DEF_  "VFrameFormat" "";
BA_DEF_DEF_  "GenSigStartValue" 0;
BA_ "GenMsgSendType" BO_ 321 0;
BA_ "VFrameFormat" BO_ 321 14;
BA_ "GenMsgSendType" BO_ 322 0;
BA_ "VFrameFormat" BO_ 322 14;
BA_ "GenMsgSendType" BO_ 323 0;
BA_ "VFrameFormat" BO_ 323 14;
BA_ "GenMsgSendType" BO_ 324 0;
BA_ "VFrameFormat" BO_ 324 14;
BA_ "GenMsgSendType" BO_ 325 0;
BA_ "VFrameFormat" BO_ 325 14;
BA_ "GenMsgSendType" BO_ 326 0;
BA_ "VFrameFormat" BO_ 326 14;
BA_ "GenMsgSendType" BO_ 327 0;
BA_ "VFrameFormat" BO_ 327 14;
BA_ "GenMsgSendType" BO_ 328 0;
BA_ "VFrameFormat" BO_ 328 14;
BA_ "GenMsgSendType" BO_ 329 0;
BA_ "VFrameFormat" BO_ 329 14;
BA_ "GenMsgSendType" BO_ 330 0;
BA_ "VFrameFormat" BO_ 330 14;
BA_ "GenMsgSendType" BO_ 331 0;
BA_ "VFrameFormat" BO_ 331 14;
BA_ "GenMsgSendType" BO_ 332 0;
BA_ "VFrameFormat" BO_ 332 14;
BA_ "GenMsgSendType" BO_ 333 0;
BA_ "VFrameFormat" BO_ 333 14;
BA_ "GenMsgSendType" BO_ 334 0;
BA_ "VFrameFormat" BO_ 334 14;
BA_ "GenSigStartValue" SG_ 321 RFC_Loc171_RadialVelocity 16384;
BA_ "GenSigStartValue" SG_ 321 RFC_Loc171_Elevation 512;
BA_ "GenSigStartValue" SG_ 321 RFC_Loc171_Azimuth 1024;
BA_ "GenSigStartValue" SG_ 321 RFC_Loc171_DistVelocityCoVnce 1024;
BA_ "GenSigStartValue" SG_ 321 RFC_Loc171_RadarCrossSection 512;
BA_ "GenSigStartValue" SG_ 321 RFC_Loc172_RadialVelocity 16384;
BA_ "GenSigStartValue" SG_ 321 RFC_Loc172_Elevation 512;
BA_ "GenSigStartValue" SG_ 321 RFC_Loc172_Azimuth 1024;
BA_ "GenSigStartValue" SG_ 321 RFC_Loc172_DistVelocityCoVnce 1024;
BA_ "GenSigStartValue" SG_ 321 RFC_Loc172_RadarCrossSection 512;
BA_ "GenSigStartValue" SG_ 321 RFC_Loc173_RadialVelocity 16384;
BA_ "GenSigStartValue" SG_ 321 RFC_Loc173_Elevation 512;
BA_ "GenSigStartValue" SG_ 321 RFC_Loc173_Azimuth 1024;
BA_ "GenSigStartValue" SG_ 321 RFC_Loc173_DistVelocityCoVnce 1024;
BA_ "GenSigStartValue" SG_ 321 RFC_Loc173_RadarCrossSection 512;
BA_ "GenSigStartValue" SG_ 322 RFC_Loc174_RadialVelocity 16384;
BA_ "GenSigStartValue" SG_ 322 RFC_Loc174_Elevation 512;
BA_ "GenSigStartValue" SG_ 322 RFC_Loc174_Azimuth 1024;
BA_ "GenSigStartValue" SG_ 322 RFC_Loc174_DistVelocityCoVnce 1024;
BA_ "GenSigStartValue" SG_ 322 RFC_Loc174_RadarCrossSection 512;
BA_ "GenSigStartValue" SG_ 322 RFC_Loc175_RadialVelocity 16384;
BA_ "GenSigStartValue" SG_ 322 RFC_Loc175_Elevation 512;
BA_ "GenSigStartValue" SG_ 322 RFC_Loc175_Azimuth 1024;
BA_ "GenSigStartValue" SG_ 322 RFC_Loc175_DistVelocityCoVnce 1024;
BA_ "GenSigStartValue" SG_ 322 RFC_Loc175_RadarCrossSection 512;
BA_ "GenSigStartValue" SG_ 322 RFC_Loc176_RadialVelocity 16384;
BA_ "GenSigStartValue" SG_ 322 RFC_Loc176_Elevation 512;
BA_ "GenSigStartValue" SG_ 322 RFC_Loc176_Azimuth 1024;
BA_ "GenSigStartValue" SG_ 322 RFC_Loc176_DistVelocityCoVnce 1024;
BA_ "GenSigStartValue" SG_ 322 RFC_Loc176_RadarCrossSection 512;
BA_ "GenSigStartValue" SG_ 323 RFC_Loc177_RadialVelocity 16384;
BA_ "GenSigStartValue" SG_ 323 RFC_Loc177_Elevation 512;
BA_ "GenSigStartValue" SG_ 323 RFC_Loc177_Azimuth 1024;
BA_ "GenSigStartValue" SG_ 323 RFC_Loc177_DistVelocityCoVnce 1024;
BA_ "GenSigStartValue" SG_ 323 RFC_Loc177_RadarCrossSection 512;
BA_ "GenSigStartValue" SG_ 323 RFC_Loc178_RadialVelocity 16384;
BA_ "GenSigStartValue" SG_ 323 RFC_Loc178_Elevation 512;
BA_ "GenSigStartValue" SG_ 323 RFC_Loc178_Azimuth 1024;
BA_ "GenSigStartValue" SG_ 323 RFC_Loc178_DistVelocityCoVnce 1024;
BA_ "GenSigStartValue" SG_ 323 RFC_Loc178_RadarCrossSection 512;
BA_ "GenSigStartValue" SG_ 323 RFC_Loc179_RadialVelocity 16384;
BA_ "GenSigStartValue" SG_ 323 RFC_Loc179_Elevation 512;
BA_ "GenSigStartValue" SG_ 323 RFC_Loc179_Azimuth 1024;
BA_ "GenSigStartValue" SG_ 323 RFC_Loc179_DistVelocityCoVnce 1024;
BA_ "GenSigStartValue" SG_ 323 RFC_Loc179_RadarCrossSection 512;
BA_ "GenSigStartValue" SG_ 324 RFC_Loc180_RadialVelocity 16384;
BA_ "GenSigStartValue" SG_ 324 RFC_Loc180_Elevation 512;
BA_ "GenSigStartValue" SG_ 324 RFC_Loc180_Azimuth 1024;
BA_ "GenSigStartValue" SG_ 324 RFC_Loc180_DistVelocityCoVnce 1024;
BA_ "GenSigStartValue" SG_ 324 RFC_Loc180_RadarCrossSection 512;
BA_ "GenSigStartValue" SG_ 324 RFC_Loc181_RadialVelocity 16384;
BA_ "GenSigStartValue" SG_ 324 RFC_Loc181_Elevation 512;
BA_ "GenSigStartValue" SG_ 324 RFC_Loc181_Azimuth 1024;
BA_ "GenSigStartValue" SG_ 324 RFC_Loc181_DistVelocityCoVnce 1024;
BA_ "GenSigStartValue" SG_ 324 RFC_Loc181_RadarCrossSection 512;
BA_ "GenSigStartValue" SG_ 324 RFC_Loc182_RadialVelocity 16384;
BA_ "GenSigStartValue" SG_ 324 RFC_Loc182_Elevation 512;
BA_ "GenSigStartValue" SG_ 324 RFC_Loc182_Azimuth 1024;
BA_ "GenSigStartValue" SG_ 324 RFC_Loc182_DistVelocityCoVnce 1024;
BA_ "GenSigStartValue" SG_ 324 RFC_Loc182_RadarCrossSection 512;
BA_ "GenSigStartValue" SG_ 325 RFC_Loc183_RadialVelocity 16384;
BA_ "GenSigStartValue" SG_ 325 RFC_Loc183_Elevation 512;
BA_ "GenSigStartValue" SG_ 325 RFC_Loc183_Azimuth 1024;
BA_ "GenSigStartValue" SG_ 325 RFC_Loc183_DistVelocityCoVnce 1024;
BA_ "GenSigStartValue" SG_ 325 RFC_Loc183_RadarCrossSection 512;
BA_ "GenSigStartValue" SG_ 325 RFC_Loc184_RadialVelocity 16384;
BA_ "GenSigStartValue" SG_ 325 RFC_Loc184_Elevation 512;
BA_ "GenSigStartValue" SG_ 325 RFC_Loc184_Azimuth 1024;
BA_ "GenSigStartValue" SG_ 325 RFC_Loc184_DistVelocityCoVnce 1024;
BA_ "GenSigStartValue" SG_ 325 RFC_Loc184_RadarCrossSection 512;
BA_ "GenSigStartValue" SG_ 325 RFC_Loc185_RadialVelocity 16384;
BA_ "GenSigStartValue" SG_ 325 RFC_Loc185_Elevation 512;
BA_ "GenSigStartValue" SG_ 325 RFC_Loc185_Azimuth 1024;
BA_ "GenSigStartValue" SG_ 325 RFC_Loc185_DistVelocityCoVnce 1024;
BA_ "GenSigStartValue" SG_ 325 RFC_Loc185_RadarCrossSection 512;
BA_ "GenSigStartValue" SG_ 326 RFC_Loc186_RadialVelocity 16384;
BA_ "GenSigStartValue" SG_ 326 RFC_Loc186_Elevation 512;
BA_ "GenSigStartValue" SG_ 326 RFC_Loc186_Azimuth 1024;
BA_ "GenSigStartValue" SG_ 326 RFC_Loc186_DistVelocityCoVnce 1024;
BA_ "GenSigStartValue" SG_ 326 RFC_Loc186_RadarCrossSection 512;
BA_ "GenSigStartValue" SG_ 326 RFC_Loc187_RadialVelocity 16384;
BA_ "GenSigStartValue" SG_ 326 RFC_Loc187_Elevation 512;
BA_ "GenSigStartValue" SG_ 326 RFC_Loc187_Azimuth 1024;
BA_ "GenSigStartValue" SG_ 326 RFC_Loc187_DistVelocityCoVnce 1024;
BA_ "GenSigStartValue" SG_ 326 RFC_Loc187_RadarCrossSection 512;
BA_ "GenSigStartValue" SG_ 326 RFC_Loc188_RadialVelocity 16384;
BA_ "GenSigStartValue" SG_ 326 RFC_Loc188_Elevation 512;
BA_ "GenSigStartValue" SG_ 326 RFC_Loc188_Azimuth 1024;
BA_ "GenSigStartValue" SG_ 326 RFC_Loc188_DistVelocityCoVnce 1024;
BA_ "GenSigStartValue" SG_ 326 RFC_Loc188_RadarCrossSection 512;
BA_ "GenSigStartValue" SG_ 327 RFC_Loc189_RadialVelocity 16384;
BA_ "GenSigStartValue" SG_ 327 RFC_Loc189_Elevation 512;
BA_ "GenSigStartValue" SG_ 327 RFC_Loc189_Azimuth 1024;
BA_ "GenSigStartValue" SG_ 327 RFC_Loc189_DistVelocityCoVnce 1024;
BA_ "GenSigStartValue" SG_ 327 RFC_Loc189_RadarCrossSection 512;
BA_ "GenSigStartValue" SG_ 327 RFC_Loc190_RadialVelocity 16384;
BA_ "GenSigStartValue" SG_ 327 RFC_Loc190_Elevation 512;
BA_ "GenSigStartValue" SG_ 327 RFC_Loc190_Azimuth 1024;
BA_ "GenSigStartValue" SG_ 327 RFC_Loc190_DistVelocityCoVnce 1024;
BA_ "GenSigStartValue" SG_ 327 RFC_Loc190_RadarCrossSection 512;
BA_ "GenSigStartValue" SG_ 327 RFC_Loc191_RadialVelocity 16384;
BA_ "GenSigStartValue" SG_ 327 RFC_Loc191_Elevation 512;
BA_ "GenSigStartValue" SG_ 327 RFC_Loc191_Azimuth 1024;
BA_ "GenSigStartValue" SG_ 327 RFC_Loc191_DistVelocityCoVnce 1024;
BA_ "GenSigStartValue" SG_ 327 RFC_Loc191_RadarCrossSection 512;
BA_ "GenSigStartValue" SG_ 328 RFC_Loc192_RadialVelocity 16384;
BA_ "GenSigStartValue" SG_ 328 RFC_Loc192_Elevation 512;
BA_ "GenSigStartValue" SG_ 328 RFC_Loc192_Azimuth 1024;
BA_ "GenSigStartValue" SG_ 328 RFC_Loc192_DistVelocityCoVnce 1024;
BA_ "GenSigStartValue" SG_ 328 RFC_Loc192_RadarCrossSection 512;
BA_ "GenSigStartValue" SG_ 328 RFC_Loc193_RadialVelocity 16384;
BA_ "GenSigStartValue" SG_ 328 RFC_Loc193_Elevation 512;
BA_ "GenSigStartValue" SG_ 328 RFC_Loc193_Azimuth 1024;
BA_ "GenSigStartValue" SG_ 328 RFC_Loc193_DistVelocityCoVnce 1024;
BA_ "GenSigStartValue" SG_ 328 RFC_Loc193_RadarCrossSection 512;
BA_ "GenSigStartValue" SG_ 328 RFC_Loc194_RadialVelocity 16384;
BA_ "GenSigStartValue" SG_ 328 RFC_Loc194_Elevation 512;
BA_ "GenSigStartValue" SG_ 328 RFC_Loc194_Azimuth 1024;
BA_ "GenSigStartValue" SG_ 328 RFC_Loc194_DistVelocityCoVnce 1024;
BA_ "GenSigStartValue" SG_ 328 RFC_Loc194_RadarCrossSection 512;
BA_ "GenSigStartValue" SG_ 329 RFC_Loc195_RadialVelocity 16384;
BA_ "GenSigStartValue" SG_ 329 RFC_Loc195_Elevation 512;
BA_ "GenSigStartValue" SG_ 329 RFC_Loc195_Azimuth 1024;
BA_ "GenSigStartValue" SG_ 329 RFC_Loc195_DistVelocityCoVnce 1024;
BA_ "GenSigStartValue" SG_ 329 RFC_Loc195_RadarCrossSection 512;
BA_ "GenSigStartValue" SG_ 329 RFC_Loc196_RadialVelocity 16384;
BA_ "GenSigStartValue" SG_ 329 RFC_Loc196_Elevation 512;
BA_ "GenSigStartValue" SG_ 329 RFC_Loc196_Azimuth 1024;
BA_ "GenSigStartValue" SG_ 329 RFC_Loc196_DistVelocityCoVnce 1024;
BA_ "GenSigStartValue" SG_ 329 RFC_Loc196_RadarCrossSection 512;
BA_ "GenSigStartValue" SG_ 329 RFC_Loc197_RadialVelocity 16384;
BA_ "GenSigStartValue" SG_ 329 RFC_Loc197_Elevation 512;
BA_ "GenSigStartValue" SG_ 329 RFC_Loc197_Azimuth 1024;
BA_ "GenSigStartValue" SG_ 329 RFC_Loc197_DistVelocityCoVnce 1024;
BA_ "GenSigStartValue" SG_ 329 RFC_Loc197_RadarCrossSection 512;
BA_ "GenSigStartValue" SG_ 330 RFC_Loc198_RadialVelocity 16384;
BA_ "GenSigStartValue" SG_ 330 RFC_Loc198_Elevation 512;
BA_ "GenSigStartValue" SG_ 330 RFC_Loc198_Azimuth 1024;
BA_ "GenSigStartValue" SG_ 330 RFC_Loc198_DistVelocityCoVnce 1024;
BA_ "GenSigStartValue" SG_ 330 RFC_Loc198_RadarCrossSection 512;
BA_ "GenSigStartValue" SG_ 330 RFC_Loc199_RadialVelocity 16384;
BA_ "GenSigStartValue" SG_ 330 RFC_Loc199_Elevation 512;
BA_ "GenSigStartValue" SG_ 330 RFC_Loc199_Azimuth 1024;
BA_ "GenSigStartValue" SG_ 330 RFC_Loc199_DistVelocityCoVnce 1024;
BA_ "GenSigStartValue" SG_ 330 RFC_Loc199_RadarCrossSection 512;
BA_ "GenSigStartValue" SG_ 330 RFC_Loc200_RadialVelocity 16384;
BA_ "GenSigStartValue" SG_ 330 RFC_Loc200_Elevation 512;
BA_ "GenSigStartValue" SG_ 330 RFC_Loc200_Azimuth 1024;
BA_ "GenSigStartValue" SG_ 330 RFC_Loc200_DistVelocityCoVnce 1024;
BA_ "GenSigStartValue" SG_ 330 RFC_Loc200_RadarCrossSection 512;
BA_ "GenSigStartValue" SG_ 331 RFC_Loc201_RadialVelocity 16384;
BA_ "GenSigStartValue" SG_ 331 RFC_Loc201_Elevation 512;
BA_ "GenSigStartValue" SG_ 331 RFC_Loc201_Azimuth 1024;
BA_ "GenSigStartValue" SG_ 331 RFC_Loc201_DistVelocityCoVnce 1024;
BA_ "GenSigStartValue" SG_ 331 RFC_Loc201_RadarCrossSection 512;
BA_ "GenSigStartValue" SG_ 331 RFC_Loc202_RadialVelocity 16384;
BA_ "GenSigStartValue" SG_ 331 RFC_Loc202_Elevation 512;
BA_ "GenSigStartValue" SG_ 331 RFC_Loc202_Azimuth 1024;
BA_ "GenSigStartValue" SG_ 331 RFC_Loc202_DistVelocityCoVnce 1024;
BA_ "GenSigStartValue" SG_ 331 RFC_Loc202_RadarCrossSection 512;
BA_ "GenSigStartValue" SG_ 331 RFC_Loc203_RadialVelocity 16384;
BA_ "GenSigStartValue" SG_ 331 RFC_Loc203_Elevation 512;
BA_ "GenSigStartValue" SG_ 331 RFC_Loc203_Azimuth 1024;
BA_ "GenSigStartValue" SG_ 331 RFC_Loc203_DistVelocityCoVnce 1024;
BA_ "GenSigStartValue" SG_ 331 RFC_Loc203_RadarCrossSection 512;
BA_ "GenSigStartValue" SG_ 332 RFC_Loc204_RadialVelocity 16384;
BA_ "GenSigStartValue" SG_ 332 RFC_Loc204_Elevation 512;
BA_ "GenSigStartValue" SG_ 332 RFC_Loc204_Azimuth 1024;
BA_ "GenSigStartValue" SG_ 332 RFC_Loc204_DistVelocityCoVnce 1024;
BA_ "GenSigStartValue" SG_ 332 RFC_Loc204_RadarCrossSection 512;
BA_ "GenSigStartValue" SG_ 332 RFC_Loc205_RadialVelocity 16384;
BA_ "GenSigStartValue" SG_ 332 RFC_Loc205_Elevation 512;
BA_ "GenSigStartValue" SG_ 332 RFC_Loc205_Azimuth 1024;
BA_ "GenSigStartValue" SG_ 332 RFC_Loc205_DistVelocityCoVnce 1024;
BA_ "GenSigStartValue" SG_ 332 RFC_Loc205_RadarCrossSection 512;
BA_ "GenSigStartValue" SG_ 332 RFC_Loc206_RadialVelocity 16384;
BA_ "GenSigStartValue" SG_ 332 RFC_Loc206_Elevation 512;
BA_ "GenSigStartValue" SG_ 332 RFC_Loc206_Azimuth 1024;
BA_ "GenSigStartValue" SG_ 332 RFC_Loc206_DistVelocityCoVnce 1024;
BA_ "GenSigStartValue" SG_ 332 RFC_Loc206_RadarCrossSection 512;
BA_ "GenSigStartValue" SG_ 333 RFC_Loc207_RadialVelocity 16384;
BA_ "GenSigStartValue" SG_ 333 RFC_Loc207_Elevation 512;
BA_ "GenSigStartValue" SG_ 333 RFC_Loc207_Azimuth 1024;
BA_ "GenSigStartValue" SG_ 333 RFC_Loc207_DistVelocityCoVnce 1024;
BA_ "GenSigStartValue" SG_ 333 RFC_Loc207_RadarCrossSection 512;
BA_ "GenSigStartValue" SG_ 333 RFC_Loc208_RadialVelocity 16384;
BA_ "GenSigStartValue" SG_ 333 RFC_Loc208_Elevation 512;
BA_ "GenSigStartValue" SG_ 333 RFC_Loc208_Azimuth 1024;
BA_ "GenSigStartValue" SG_ 333 RFC_Loc208_DistVelocityCoVnce 1024;
BA_ "GenSigStartValue" SG_ 333 RFC_Loc208_RadarCrossSection 512;
BA_ "GenSigStartValue" SG_ 333 RFC_Loc209_RadialVelocity 16384;
BA_ "GenSigStartValue" SG_ 333 RFC_Loc209_Elevation 512;
BA_ "GenSigStartValue" SG_ 333 RFC_Loc209_Azimuth 1024;
BA_ "GenSigStartValue" SG_ 333 RFC_Loc209_DistVelocityCoVnce 1024;
BA_ "GenSigStartValue" SG_ 333 RFC_Loc209_RadarCrossSection 512;
BA_ "GenSigStartValue" SG_ 334 RFC_Loc210_RadialVelocity 16384;
BA_ "GenSigStartValue" SG_ 334 RFC_Loc210_Elevation 512;
BA_ "GenSigStartValue" SG_ 334 RFC_Loc210_Azimuth 1024;
BA_ "GenSigStartValue" SG_ 334 RFC_Loc210_DistVelocityCoVnce 1024;
BA_ "GenSigStartValue" SG_ 334 RFC_Loc210_RadarCrossSection 512;
BA_ "GenSigStartValue" SG_ 334 RFC_Loc211_RadialVelocity 16384;
BA_ "GenSigStartValue" SG_ 334 RFC_Loc211_Elevation 512;
BA_ "GenSigStartValue" SG_ 334 RFC_Loc211_Azimuth 1024;
BA_ "GenSigStartValue" SG_ 334 RFC_Loc211_DistVelocityCoVnce 1024;
BA_ "GenSigStartValue" SG_ 334 RFC_Loc211_RadarCrossSection 512;
BA_ "GenSigStartValue" SG_ 334 RFC_Loc212_RadialVelocity 16384;
BA_ "GenSigStartValue" SG_ 334 RFC_Loc212_Elevation 512;
BA_ "GenSigStartValue" SG_ 334 RFC_Loc212_Azimuth 1024;
BA_ "GenSigStartValue" SG_ 334 RFC_Loc212_DistVelocityCoVnce 1024;
BA_ "GenSigStartValue" SG_ 334 RFC_Loc212_RadarCrossSection 512;
SIG_GROUP_ 321 SG_RFC_Location_171_173 1 : RFC_Loc171_173_CRC RFC_Loc171_173_AliveCtr RFC_Loc171_173_ProtBlockCtr RFC_Loc171_RadialDistance RFC_Loc171_RadialVelocity RFC_Loc171_Elevation RFC_Loc171_Azimuth RFC_Loc171_DistVelocityCoVnce RFC_Loc171_RadialDistanceVnce RFC_Loc171_RadialVelocityVnce RFC_Loc171_ElevationVnce RFC_Loc171_AzimuthVnce RFC_Loc171_RadarCrossSection RFC_Loc171_DistVelocityQuality RFC_Loc171_ElevationQuality RFC_Loc171_AzimuthQuality RFC_Loc171_RSSI RFC_Loc171_AzimuthalPartnerId RFC_Loc172_RadialDistance RFC_Loc172_RadialVelocity RFC_Loc172_Elevation RFC_Loc172_Azimuth RFC_Loc172_DistVelocityCoVnce RFC_Loc172_RadialDistanceVnce RFC_Loc172_RadialVelocityVnce RFC_Loc172_ElevationVnce RFC_Loc172_AzimuthVnce RFC_Loc172_RadarCrossSection RFC_Loc172_DistVelocityQuality RFC_Loc172_ElevationQuality RFC_Loc172_AzimuthQuality RFC_Loc172_RSSI RFC_Loc172_AzimuthalPartnerId RFC_Loc173_RadialDistance RFC_Loc173_RadialVelocity RFC_Loc173_Elevation RFC_Loc173_Azimuth RFC_Loc173_DistVelocityCoVnce RFC_Loc173_RadialDistanceVnce RFC_Loc173_RadialVelocityVnce RFC_Loc173_ElevationVnce RFC_Loc173_AzimuthVnce RFC_Loc173_RadarCrossSection RFC_Loc173_DistVelocityQuality RFC_Loc173_ElevationQuality RFC_Loc173_AzimuthQuality RFC_Loc173_RSSI RFC_Loc173_AzimuthalPartnerId;
SIG_GROUP_ 322 SG_RFC_Location_174_176 1 : RFC_Loc174_176_CRC RFC_Loc174_176_AliveCtr RFC_Loc174_176_ProtBlockCtr RFC_Loc174_RadialDistance RFC_Loc174_RadialVelocity RFC_Loc174_Elevation RFC_Loc174_Azimuth RFC_Loc174_DistVelocityCoVnce RFC_Loc174_RadialDistanceVnce RFC_Loc174_RadialVelocityVnce RFC_Loc174_ElevationVnce RFC_Loc174_AzimuthVnce RFC_Loc174_RadarCrossSection RFC_Loc174_DistVelocityQuality RFC_Loc174_ElevationQuality RFC_Loc174_AzimuthQuality RFC_Loc174_RSSI RFC_Loc174_AzimuthalPartnerId RFC_Loc175_RadialDistance RFC_Loc175_RadialVelocity RFC_Loc175_Elevation RFC_Loc175_Azimuth RFC_Loc175_DistVelocityCoVnce RFC_Loc175_RadialDistanceVnce RFC_Loc175_RadialVelocityVnce RFC_Loc175_ElevationVnce RFC_Loc175_AzimuthVnce RFC_Loc175_RadarCrossSection RFC_Loc175_DistVelocityQuality RFC_Loc175_ElevationQuality RFC_Loc175_AzimuthQuality RFC_Loc175_RSSI RFC_Loc175_AzimuthalPartnerId RFC_Loc176_RadialDistance RFC_Loc176_RadialVelocity RFC_Loc176_Elevation RFC_Loc176_Azimuth RFC_Loc176_DistVelocityCoVnce RFC_Loc176_RadialDistanceVnce RFC_Loc176_RadialVelocityVnce RFC_Loc176_ElevationVnce RFC_Loc176_AzimuthVnce RFC_Loc176_RadarCrossSection RFC_Loc176_DistVelocityQuality RFC_Loc176_ElevationQuality RFC_Loc176_AzimuthQuality RFC_Loc176_RSSI RFC_Loc176_AzimuthalPartnerId;
SIG_GROUP_ 323 SG_RFC_Location_177_179 1 : RFC_Loc177_179_CRC RFC_Loc177_179_AliveCtr RFC_Loc177_179_ProtBlockCtr RFC_Loc177_RadialDistance RFC_Loc177_RadialVelocity RFC_Loc177_Elevation RFC_Loc177_Azimuth RFC_Loc177_DistVelocityCoVnce RFC_Loc177_RadialDistanceVnce RFC_Loc177_RadialVelocityVnce RFC_Loc177_ElevationVnce RFC_Loc177_AzimuthVnce RFC_Loc177_RadarCrossSection RFC_Loc177_DistVelocityQuality RFC_Loc177_ElevationQuality RFC_Loc177_AzimuthQuality RFC_Loc177_RSSI RFC_Loc177_AzimuthalPartnerId RFC_Loc178_RadialDistance RFC_Loc178_RadialVelocity RFC_Loc178_Elevation RFC_Loc178_Azimuth RFC_Loc178_DistVelocityCoVnce RFC_Loc178_RadialDistanceVnce RFC_Loc178_RadialVelocityVnce RFC_Loc178_ElevationVnce RFC_Loc178_AzimuthVnce RFC_Loc178_RadarCrossSection RFC_Loc178_DistVelocityQuality RFC_Loc178_ElevationQuality RFC_Loc178_AzimuthQuality RFC_Loc178_RSSI RFC_Loc178_AzimuthalPartnerId RFC_Loc179_RadialDistance RFC_Loc179_RadialVelocity RFC_Loc179_Elevation RFC_Loc179_Azimuth RFC_Loc179_DistVelocityCoVnce RFC_Loc179_RadialDistanceVnce RFC_Loc179_RadialVelocityVnce RFC_Loc179_ElevationVnce RFC_Loc179_AzimuthVnce RFC_Loc179_RadarCrossSection RFC_Loc179_DistVelocityQuality RFC_Loc179_ElevationQuality RFC_Loc179_AzimuthQuality RFC_Loc179_RSSI RFC_Loc179_AzimuthalPartnerId;
SIG_GROUP_ 324 SG_RFC_Location_180_182 1 : RFC_Loc180_182_CRC RFC_Loc180_182_AliveCtr RFC_Loc180_182_ProtBlockCtr RFC_Loc180_RadialDistance RFC_Loc180_RadialVelocity RFC_Loc180_Elevation RFC_Loc180_Azimuth RFC_Loc180_DistVelocityCoVnce RFC_Loc180_RadialDistanceVnce RFC_Loc180_RadialVelocityVnce RFC_Loc180_ElevationVnce RFC_Loc180_AzimuthVnce RFC_Loc180_RadarCrossSection RFC_Loc180_DistVelocityQuality RFC_Loc180_ElevationQuality RFC_Loc180_AzimuthQuality RFC_Loc180_RSSI RFC_Loc180_AzimuthalPartnerId RFC_Loc181_RadialDistance RFC_Loc181_RadialVelocity RFC_Loc181_Elevation RFC_Loc181_Azimuth RFC_Loc181_DistVelocityCoVnce RFC_Loc181_RadialDistanceVnce RFC_Loc181_RadialVelocityVnce RFC_Loc181_ElevationVnce RFC_Loc181_AzimuthVnce RFC_Loc181_RadarCrossSection RFC_Loc181_DistVelocityQuality RFC_Loc181_ElevationQuality RFC_Loc181_AzimuthQuality RFC_Loc181_RSSI RFC_Loc181_AzimuthalPartnerId RFC_Loc182_RadialDistance RFC_Loc182_RadialVelocity RFC_Loc182_Elevation RFC_Loc182_Azimuth RFC_Loc182_DistVelocityCoVnce RFC_Loc182_RadialDistanceVnce RFC_Loc182_RadialVelocityVnce RFC_Loc182_ElevationVnce RFC_Loc182_AzimuthVnce RFC_Loc182_RadarCrossSection RFC_Loc182_DistVelocityQuality RFC_Loc182_ElevationQuality RFC_Loc182_AzimuthQuality RFC_Loc182_RSSI RFC_Loc182_AzimuthalPartnerId;
SIG_GROUP_ 325 SG_RFC_Location_183_185 1 : RFC_Loc183_185_CRC RFC_Loc183_185_AliveCtr RFC_Loc183_185_ProtBlockCtr RFC_Loc183_RadialDistance RFC_Loc183_RadialVelocity RFC_Loc183_Elevation RFC_Loc183_Azimuth RFC_Loc183_DistVelocityCoVnce RFC_Loc183_RadialDistanceVnce RFC_Loc183_RadialVelocityVnce RFC_Loc183_ElevationVnce RFC_Loc183_AzimuthVnce RFC_Loc183_RadarCrossSection RFC_Loc183_DistVelocityQuality RFC_Loc183_ElevationQuality RFC_Loc183_AzimuthQuality RFC_Loc183_RSSI RFC_Loc183_AzimuthalPartnerId RFC_Loc184_RadialDistance RFC_Loc184_RadialVelocity RFC_Loc184_Elevation RFC_Loc184_Azimuth RFC_Loc184_DistVelocityCoVnce RFC_Loc184_RadialDistanceVnce RFC_Loc184_RadialVelocityVnce RFC_Loc184_ElevationVnce RFC_Loc184_AzimuthVnce RFC_Loc184_RadarCrossSection RFC_Loc184_DistVelocityQuality RFC_Loc184_ElevationQuality RFC_Loc184_AzimuthQuality RFC_Loc184_RSSI RFC_Loc184_AzimuthalPartnerId RFC_Loc185_RadialDistance RFC_Loc185_RadialVelocity RFC_Loc185_Elevation RFC_Loc185_Azimuth RFC_Loc185_DistVelocityCoVnce RFC_Loc185_RadialDistanceVnce RFC_Loc185_RadialVelocityVnce RFC_Loc185_ElevationVnce RFC_Loc185_AzimuthVnce RFC_Loc185_RadarCrossSection RFC_Loc185_DistVelocityQuality RFC_Loc185_ElevationQuality RFC_Loc185_AzimuthQuality RFC_Loc185_RSSI RFC_Loc185_AzimuthalPartnerId;
SIG_GROUP_ 326 SG_RFC_Location_186_188 1 : RFC_Loc186_188_CRC RFC_Loc186_188_AliveCtr RFC_Loc186_188_ProtBlockCtr RFC_Loc186_RadialDistance RFC_Loc186_RadialVelocity RFC_Loc186_Elevation RFC_Loc186_Azimuth RFC_Loc186_DistVelocityCoVnce RFC_Loc186_RadialDistanceVnce RFC_Loc186_RadialVelocityVnce RFC_Loc186_ElevationVnce RFC_Loc186_AzimuthVnce RFC_Loc186_RadarCrossSection RFC_Loc186_DistVelocityQuality RFC_Loc186_ElevationQuality RFC_Loc186_AzimuthQuality RFC_Loc186_RSSI RFC_Loc186_AzimuthalPartnerId RFC_Loc187_RadialDistance RFC_Loc187_RadialVelocity RFC_Loc187_Elevation RFC_Loc187_Azimuth RFC_Loc187_DistVelocityCoVnce RFC_Loc187_RadialDistanceVnce RFC_Loc187_RadialVelocityVnce RFC_Loc187_ElevationVnce RFC_Loc187_AzimuthVnce RFC_Loc187_RadarCrossSection RFC_Loc187_DistVelocityQuality RFC_Loc187_ElevationQuality RFC_Loc187_AzimuthQuality RFC_Loc187_RSSI RFC_Loc187_AzimuthalPartnerId RFC_Loc188_RadialDistance RFC_Loc188_RadialVelocity RFC_Loc188_Elevation RFC_Loc188_Azimuth RFC_Loc188_DistVelocityCoVnce RFC_Loc188_RadialDistanceVnce RFC_Loc188_RadialVelocityVnce RFC_Loc188_ElevationVnce RFC_Loc188_AzimuthVnce RFC_Loc188_RadarCrossSection RFC_Loc188_DistVelocityQuality RFC_Loc188_ElevationQuality RFC_Loc188_AzimuthQuality RFC_Loc188_RSSI RFC_Loc188_AzimuthalPartnerId;
SIG_GROUP_ 327 SG_RFC_Location_189_191 1 : RFC_Loc189_191_CRC RFC_Loc189_191_AliveCtr RFC_Loc189_191_ProtBlockCtr RFC_Loc189_RadialDistance RFC_Loc189_RadialVelocity RFC_Loc189_Elevation RFC_Loc189_Azimuth RFC_Loc189_DistVelocityCoVnce RFC_Loc189_RadialDistanceVnce RFC_Loc189_RadialVelocityVnce RFC_Loc189_ElevationVnce RFC_Loc189_AzimuthVnce RFC_Loc189_RadarCrossSection RFC_Loc189_DistVelocityQuality RFC_Loc189_ElevationQuality RFC_Loc189_AzimuthQuality RFC_Loc189_RSSI RFC_Loc189_AzimuthalPartnerId RFC_Loc190_RadialDistance RFC_Loc190_RadialVelocity RFC_Loc190_Elevation RFC_Loc190_Azimuth RFC_Loc190_DistVelocityCoVnce RFC_Loc190_RadialDistanceVnce RFC_Loc190_RadialVelocityVnce RFC_Loc190_ElevationVnce RFC_Loc190_AzimuthVnce RFC_Loc190_RadarCrossSection RFC_Loc190_DistVelocityQuality RFC_Loc190_ElevationQuality RFC_Loc190_AzimuthQuality RFC_Loc190_RSSI RFC_Loc190_AzimuthalPartnerId RFC_Loc191_RadialDistance RFC_Loc191_RadialVelocity RFC_Loc191_Elevation RFC_Loc191_Azimuth RFC_Loc191_DistVelocityCoVnce RFC_Loc191_RadialDistanceVnce RFC_Loc191_RadialVelocityVnce RFC_Loc191_ElevationVnce RFC_Loc191_AzimuthVnce RFC_Loc191_RadarCrossSection RFC_Loc191_DistVelocityQuality RFC_Loc191_ElevationQuality RFC_Loc191_AzimuthQuality RFC_Loc191_RSSI RFC_Loc191_AzimuthalPartnerId;
SIG_GROUP_ 328 SG_RFC_Location_192_194 1 : RFC_Loc192_194_CRC RFC_Loc192_194_AliveCtr RFC_Loc192_194_ProtBlockCtr RFC_Loc192_RadialDistance RFC_Loc192_RadialVelocity RFC_Loc192_Elevation RFC_Loc192_Azimuth RFC_Loc192_DistVelocityCoVnce RFC_Loc192_RadialDistanceVnce RFC_Loc192_RadialVelocityVnce RFC_Loc192_ElevationVnce RFC_Loc192_AzimuthVnce RFC_Loc192_RadarCrossSection RFC_Loc192_DistVelocityQuality RFC_Loc192_ElevationQuality RFC_Loc192_AzimuthQuality RFC_Loc192_RSSI RFC_Loc192_AzimuthalPartnerId RFC_Loc193_RadialDistance RFC_Loc193_RadialVelocity RFC_Loc193_Elevation RFC_Loc193_Azimuth RFC_Loc193_DistVelocityCoVnce RFC_Loc193_RadialDistanceVnce RFC_Loc193_RadialVelocityVnce RFC_Loc193_ElevationVnce RFC_Loc193_AzimuthVnce RFC_Loc193_RadarCrossSection RFC_Loc193_DistVelocityQuality RFC_Loc193_ElevationQuality RFC_Loc193_AzimuthQuality RFC_Loc193_RSSI RFC_Loc193_AzimuthalPartnerId RFC_Loc194_RadialDistance RFC_Loc194_RadialVelocity RFC_Loc194_Elevation RFC_Loc194_Azimuth RFC_Loc194_DistVelocityCoVnce RFC_Loc194_RadialDistanceVnce RFC_Loc194_RadialVelocityVnce RFC_Loc194_ElevationVnce RFC_Loc194_AzimuthVnce RFC_Loc194_RadarCrossSection RFC_Loc194_DistVelocityQuality RFC_Loc194_ElevationQuality RFC_Loc194_AzimuthQuality RFC_Loc194_RSSI RFC_Loc194_AzimuthalPartnerId;
SIG_GROUP_ 329 SG_RFC_Location_195_197 1 : RFC_Loc195_197_CRC RFC_Loc195_197_AliveCtr RFC_Loc195_197_ProtBlockCtr RFC_Loc195_RadialDistance RFC_Loc195_RadialVelocity RFC_Loc195_Elevation RFC_Loc195_Azimuth RFC_Loc195_DistVelocityCoVnce RFC_Loc195_RadialDistanceVnce RFC_Loc195_RadialVelocityVnce RFC_Loc195_ElevationVnce RFC_Loc195_AzimuthVnce RFC_Loc195_RadarCrossSection RFC_Loc195_DistVelocityQuality RFC_Loc195_ElevationQuality RFC_Loc195_AzimuthQuality RFC_Loc195_RSSI RFC_Loc195_AzimuthalPartnerId RFC_Loc196_RadialDistance RFC_Loc196_RadialVelocity RFC_Loc196_Elevation RFC_Loc196_Azimuth RFC_Loc196_DistVelocityCoVnce RFC_Loc196_RadialDistanceVnce RFC_Loc196_RadialVelocityVnce RFC_Loc196_ElevationVnce RFC_Loc196_AzimuthVnce RFC_Loc196_RadarCrossSection RFC_Loc196_DistVelocityQuality RFC_Loc196_ElevationQuality RFC_Loc196_AzimuthQuality RFC_Loc196_RSSI RFC_Loc196_AzimuthalPartnerId RFC_Loc197_RadialDistance RFC_Loc197_RadialVelocity RFC_Loc197_Elevation RFC_Loc197_Azimuth RFC_Loc197_DistVelocityCoVnce RFC_Loc197_RadialDistanceVnce RFC_Loc197_RadialVelocityVnce RFC_Loc197_ElevationVnce RFC_Loc197_AzimuthVnce RFC_Loc197_RadarCrossSection RFC_Loc197_DistVelocityQuality RFC_Loc197_ElevationQuality RFC_Loc197_AzimuthQuality RFC_Loc197_RSSI RFC_Loc197_AzimuthalPartnerId;
SIG_GROUP_ 330 SG_RFC_Location_198_200 1 : RFC_Loc198_200_CRC RFC_Loc198_200_AliveCtr RFC_Loc198_200_ProtBlockCtr RFC_Loc198_RadialDistance RFC_Loc198_RadialVelocity RFC_Loc198_Elevation RFC_Loc198_Azimuth RFC_Loc198_DistVelocityCoVnce RFC_Loc198_RadialDistanceVnce RFC_Loc198_RadialVelocityVnce RFC_Loc198_ElevationVnce RFC_Loc198_AzimuthVnce RFC_Loc198_RadarCrossSection RFC_Loc198_DistVelocityQuality RFC_Loc198_ElevationQuality RFC_Loc198_AzimuthQuality RFC_Loc198_RSSI RFC_Loc198_AzimuthalPartnerId RFC_Loc199_RadialDistance RFC_Loc199_RadialVelocity RFC_Loc199_Elevation RFC_Loc199_Azimuth RFC_Loc199_DistVelocityCoVnce RFC_Loc199_RadialDistanceVnce RFC_Loc199_RadialVelocityVnce RFC_Loc199_ElevationVnce RFC_Loc199_AzimuthVnce RFC_Loc199_RadarCrossSection RFC_Loc199_DistVelocityQuality RFC_Loc199_ElevationQuality RFC_Loc199_AzimuthQuality RFC_Loc199_RSSI RFC_Loc199_AzimuthalPartnerId RFC_Loc200_RadialDistance RFC_Loc200_RadialVelocity RFC_Loc200_Elevation RFC_Loc200_Azimuth RFC_Loc200_DistVelocityCoVnce RFC_Loc200_RadialDistanceVnce RFC_Loc200_RadialVelocityVnce RFC_Loc200_ElevationVnce RFC_Loc200_AzimuthVnce RFC_Loc200_RadarCrossSection RFC_Loc200_DistVelocityQuality RFC_Loc200_ElevationQuality RFC_Loc200_AzimuthQuality RFC_Loc200_RSSI RFC_Loc200_AzimuthalPartnerId;
SIG_GROUP_ 331 SG_RFC_Location_201_203 1 : RFC_Loc201_203_CRC RFC_Loc201_203_AliveCtr RFC_Loc201_203_ProtBlockCtr RFC_Loc201_RadialDistance RFC_Loc201_RadialVelocity RFC_Loc201_Elevation RFC_Loc201_Azimuth RFC_Loc201_DistVelocityCoVnce RFC_Loc201_RadialDistanceVnce RFC_Loc201_RadialVelocityVnce RFC_Loc201_ElevationVnce RFC_Loc201_AzimuthVnce RFC_Loc201_RadarCrossSection RFC_Loc201_DistVelocityQuality RFC_Loc201_ElevationQuality RFC_Loc201_AzimuthQuality RFC_Loc201_RSSI RFC_Loc201_AzimuthalPartnerId RFC_Loc202_RadialDistance RFC_Loc202_RadialVelocity RFC_Loc202_Elevation RFC_Loc202_Azimuth RFC_Loc202_DistVelocityCoVnce RFC_Loc202_RadialDistanceVnce RFC_Loc202_RadialVelocityVnce RFC_Loc202_ElevationVnce RFC_Loc202_AzimuthVnce RFC_Loc202_RadarCrossSection RFC_Loc202_DistVelocityQuality RFC_Loc202_ElevationQuality RFC_Loc202_AzimuthQuality RFC_Loc202_RSSI RFC_Loc202_AzimuthalPartnerId RFC_Loc203_RadialDistance RFC_Loc203_RadialVelocity RFC_Loc203_Elevation RFC_Loc203_Azimuth RFC_Loc203_DistVelocityCoVnce RFC_Loc203_RadialDistanceVnce RFC_Loc203_RadialVelocityVnce RFC_Loc203_ElevationVnce RFC_Loc203_AzimuthVnce RFC_Loc203_RadarCrossSection RFC_Loc203_DistVelocityQuality RFC_Loc203_ElevationQuality RFC_Loc203_AzimuthQuality RFC_Loc203_RSSI RFC_Loc203_AzimuthalPartnerId;
SIG_GROUP_ 332 SG_RFC_Location_204_206 1 : RFC_Loc204_206_CRC RFC_Loc204_206_AliveCtr RFC_Loc204_206_ProtBlockCtr RFC_Loc204_RadialDistance RFC_Loc204_RadialVelocity RFC_Loc204_Elevation RFC_Loc204_Azimuth RFC_Loc204_DistVelocityCoVnce RFC_Loc204_RadialDistanceVnce RFC_Loc204_RadialVelocityVnce RFC_Loc204_ElevationVnce RFC_Loc204_AzimuthVnce RFC_Loc204_RadarCrossSection RFC_Loc204_DistVelocityQuality RFC_Loc204_ElevationQuality RFC_Loc204_AzimuthQuality RFC_Loc204_RSSI RFC_Loc204_AzimuthalPartnerId RFC_Loc205_RadialDistance RFC_Loc205_RadialVelocity RFC_Loc205_Elevation RFC_Loc205_Azimuth RFC_Loc205_DistVelocityCoVnce RFC_Loc205_RadialDistanceVnce RFC_Loc205_RadialVelocityVnce RFC_Loc205_ElevationVnce RFC_Loc205_AzimuthVnce RFC_Loc205_RadarCrossSection RFC_Loc205_DistVelocityQuality RFC_Loc205_ElevationQuality RFC_Loc205_AzimuthQuality RFC_Loc205_RSSI RFC_Loc205_AzimuthalPartnerId RFC_Loc206_RadialDistance RFC_Loc206_RadialVelocity RFC_Loc206_Elevation RFC_Loc206_Azimuth RFC_Loc206_DistVelocityCoVnce RFC_Loc206_RadialDistanceVnce RFC_Loc206_RadialVelocityVnce RFC_Loc206_ElevationVnce RFC_Loc206_AzimuthVnce RFC_Loc206_RadarCrossSection RFC_Loc206_DistVelocityQuality RFC_Loc206_ElevationQuality RFC_Loc206_AzimuthQuality RFC_Loc206_RSSI RFC_Loc206_AzimuthalPartnerId;
SIG_GROUP_ 333 SG_RFC_Location_207_209 1 : RFC_Loc207_209_CRC RFC_Loc207_209_AliveCtr RFC_Loc207_209_ProtBlockCtr RFC_Loc207_RadialDistance RFC_Loc207_RadialVelocity RFC_Loc207_Elevation RFC_Loc207_Azimuth RFC_Loc207_DistVelocityCoVnce RFC_Loc207_RadialDistanceVnce RFC_Loc207_RadialVelocityVnce RFC_Loc207_ElevationVnce RFC_Loc207_AzimuthVnce RFC_Loc207_RadarCrossSection RFC_Loc207_DistVelocityQuality RFC_Loc207_ElevationQuality RFC_Loc207_AzimuthQuality RFC_Loc207_RSSI RFC_Loc207_AzimuthalPartnerId RFC_Loc208_RadialDistance RFC_Loc208_RadialVelocity RFC_Loc208_Elevation RFC_Loc208_Azimuth RFC_Loc208_DistVelocityCoVnce RFC_Loc208_RadialDistanceVnce RFC_Loc208_RadialVelocityVnce RFC_Loc208_ElevationVnce RFC_Loc208_AzimuthVnce RFC_Loc208_RadarCrossSection RFC_Loc208_DistVelocityQuality RFC_Loc208_ElevationQuality RFC_Loc208_AzimuthQuality RFC_Loc208_RSSI RFC_Loc208_AzimuthalPartnerId RFC_Loc209_RadialDistance RFC_Loc209_RadialVelocity RFC_Loc209_Elevation RFC_Loc209_Azimuth RFC_Loc209_DistVelocityCoVnce RFC_Loc209_RadialDistanceVnce RFC_Loc209_RadialVelocityVnce RFC_Loc209_ElevationVnce RFC_Loc209_AzimuthVnce RFC_Loc209_RadarCrossSection RFC_Loc209_DistVelocityQuality RFC_Loc209_ElevationQuality RFC_Loc209_AzimuthQuality RFC_Loc209_RSSI RFC_Loc209_AzimuthalPartnerId;
SIG_GROUP_ 334 SG_RFC_Location_210_212 1 : RFC_Loc210_212_CRC RFC_Loc210_212_AliveCtr RFC_Loc210_212_ProtBlockCtr RFC_Loc210_RadialDistance RFC_Loc210_RadialVelocity RFC_Loc210_Elevation RFC_Loc210_Azimuth RFC_Loc210_DistVelocityCoVnce RFC_Loc210_RadialDistanceVnce RFC_Loc210_RadialVelocityVnce RFC_Loc210_ElevationVnce RFC_Loc210_AzimuthVnce RFC_Loc210_RadarCrossSection RFC_Loc210_DistVelocityQuality RFC_Loc210_ElevationQuality RFC_Loc210_AzimuthQuality RFC_Loc210_RSSI RFC_Loc210_AzimuthalPartnerId RFC_Loc211_RadialDistance RFC_Loc211_RadialVelocity RFC_Loc211_Elevation RFC_Loc211_Azimuth RFC_Loc211_DistVelocityCoVnce RFC_Loc211_RadialDistanceVnce RFC_Loc211_RadialVelocityVnce RFC_Loc211_ElevationVnce RFC_Loc211_AzimuthVnce RFC_Loc211_RadarCrossSection RFC_Loc211_DistVelocityQuality RFC_Loc211_ElevationQuality RFC_Loc211_AzimuthQuality RFC_Loc211_RSSI RFC_Loc211_AzimuthalPartnerId RFC_Loc212_RadialDistance RFC_Loc212_RadialVelocity RFC_Loc212_Elevation RFC_Loc212_Azimuth RFC_Loc212_DistVelocityCoVnce RFC_Loc212_RadialDistanceVnce RFC_Loc212_RadialVelocityVnce RFC_Loc212_ElevationVnce RFC_Loc212_AzimuthVnce RFC_Loc212_RadarCrossSection RFC_Loc212_DistVelocityQuality RFC_Loc212_ElevationQuality RFC_Loc212_AzimuthQuality RFC_Loc212_RSSI RFC_Loc212_AzimuthalPartnerId;
