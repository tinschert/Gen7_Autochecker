VERSION "created by canmatrix"

NS_ :

BS_:

BU_: RadarFrontCenter DASy MPC3

BO_ 240 VFC_TrafficSign02: 48 MPC3
 SG_ VFC_TS02_CRC : 0|16@1+ (1,0) [0|65535] ""  DASy
 SG_ VFC_TS02_AliveCtr : 16|8@1+ (1,0) [0|255] ""  DASy
 SG_ VFC_TS02_ProtBlockCtr : 24|4@1+ (1,0) [0|15] ""  DASy
 SG_ VFC_TS02_ProtOrderIndex : 32|4@1+ (1,0) [0|15] ""  DASy
 SG_ VFC_TS02_ID : 40|8@1+ (1,0) [1|255] ""  DASy
 SG_ VFC_TS02_Class : 48|8@1+ (1,0) [0|206] ""  DASy
 SG_ VFC_TS02_TSProb : 56|6@1+ (2,0) [0|100] "%"  DASy
 SG_ VFC_TS02_Dx : 64|9@1+ (0.2,0) [0|102.2] "m"  DASy
 SG_ VFC_TS02_Dy : 80|8@1+ (0.2,-25.6) [-25.6|25.4] "m"  DASy
 SG_ VFC_TS02_Dz : 88|6@1+ (0.2,0) [0|12.6] "m"  DASy
 SG_ VFC_TS02_DxStdDev : 96|8@1+ (0.25,0) [0|63.75] "m"  DASy
 SG_ VFC_TS02_DyStdDev : 104|7@1+ (0.1,0) [0|12.7] "m"  DASy
 SG_ VFC_TS02_DzStdDev : 112|6@1+ (0.1,0) [0|6.3] "m"  DASy
 SG_ VFC_TS02_Width : 120|7@1+ (0.1,0) [0|12.7] "m"  DASy
 SG_ VFC_TS02_Height : 128|6@1+ (0.1,0) [0|6.3] "m"  DASy
 SG_ VFC_TS02_EmbedFlag : 136|3@1+ (1,0) [0|7] ""  DASy
 SG_ VFC_TS02_Quality : 139|1@1+ (1,0) [0|1] ""  DASy
 SG_ VFC_TS02_VMS : 140|1@1+ (1,0) [0|1] ""  DASy
 SG_ VFC_TS02_Stable : 141|1@1+ (1,0) [0|1] ""  DASy
 SG_ VFC_TS02_VehicleSticker : 142|1@1+ (1,0) [0|1] ""  DASy
 SG_ VFC_TS02_InternalTrack : 143|1@1+ (1,0) [0|1] ""  DASy
 SG_ VFC_TS02_ValidLanes : 144|5@1+ (1,0) [0|31] ""  DASy
 SG_ VFC_TS02_ValidDay : 152|7@1+ (1,0) [0|127] ""  DASy
 SG_ VFC_TS02_ValidTimeRange1Start : 160|7@1+ (15,0) [0|1440] "min"  DASy
 SG_ VFC_TS02_ValidTimeRange1End : 168|7@1+ (15,0) [0|1440] "min"  DASy
 SG_ VFC_TS02_ValidTimeRange2Start : 176|7@1+ (15,0) [0|1440] "min"  DASy
 SG_ VFC_TS02_ValidTimeRange2End : 184|7@1+ (15,0) [0|1440] "min"  DASy
 SG_ VFC_TS02_ValidInDist : 192|10@1+ (10,0) [0|10230] "m"  DASy
 SG_ VFC_TS02_ValidDist : 208|10@1+ (10,0) [0|10230] "m"  DASy
 SG_ VFC_TS02_AddTSCount : 232|3@1+ (1,0) [0|6] ""  DASy
 SG_ VFC_TS02_AddTS1Class : 240|8@1+ (1,0) [0|68] ""  DASy
 SG_ VFC_TS02_AddTS1Prob : 248|6@1+ (2,0) [0|100] "%"  DASy
 SG_ VFC_TS02_AddTS1Quality : 254|1@1+ (1,0) [0|1] ""  DASy
 SG_ VFC_TS02_AddTS1VMS : 255|1@1+ (1,0) [0|1] ""  DASy
 SG_ VFC_TS02_AddTS2Class : 256|8@1+ (1,0) [0|68] ""  DASy
 SG_ VFC_TS02_AddTS2Prob : 264|6@1+ (2,0) [0|100] "%"  DASy
 SG_ VFC_TS02_AddTS2Quality : 270|1@1+ (1,0) [0|1] ""  DASy
 SG_ VFC_TS02_AddTS2VMS : 271|1@1+ (1,0) [0|1] ""  DASy
 SG_ VFC_TS02_AddTS3Class : 272|8@1+ (1,0) [0|68] ""  DASy
 SG_ VFC_TS02_AddTS3Prob : 280|6@1+ (2,0) [0|100] "%"  DASy
 SG_ VFC_TS02_AddTS3Quality : 286|1@1+ (1,0) [0|1] ""  DASy
 SG_ VFC_TS02_AddTS3VMS : 287|1@1+ (1,0) [0|1] ""  DASy
 SG_ VFC_TS02_AddTS4Class : 288|8@1+ (1,0) [0|68] ""  DASy
 SG_ VFC_TS02_AddTS4Prob : 296|6@1+ (2,0) [0|100] "%"  DASy
 SG_ VFC_TS02_AddTS4Quality : 302|1@1+ (1,0) [0|1] ""  DASy
 SG_ VFC_TS02_AddTS4VMS : 303|1@1+ (1,0) [0|1] ""  DASy
 SG_ VFC_TS02_AddTS5Class : 304|8@1+ (1,0) [0|68] ""  DASy
 SG_ VFC_TS02_AddTS5Prob : 312|6@1+ (2,0) [0|100] "%"  DASy
 SG_ VFC_TS02_AddTS5Quality : 318|1@1+ (1,0) [0|1] ""  DASy
 SG_ VFC_TS02_AddTS5VMS : 319|1@1+ (1,0) [0|1] ""  DASy
 SG_ VFC_TS02_AddTS6Class : 320|8@1+ (1,0) [0|68] ""  DASy
 SG_ VFC_TS02_AddTS6Prob : 328|6@1+ (2,0) [0|100] "%"  DASy
 SG_ VFC_TS02_AddTS6Quality : 334|1@1+ (1,0) [0|1] ""  DASy
 SG_ VFC_TS02_AddTS6VMS : 335|1@1+ (1,0) [0|1] ""  DASy
 SG_ VFC_TS02_FV : 359|8@0+ (1,0) [0|255] ""  DASy
 SG_ VFC_TS02_MAC : 367|24@0+ (1,0) [0|16777215] ""  DASy

BO_ 241 VFC_TrafficSign03: 48 MPC3
 SG_ VFC_TS03_CRC : 0|16@1+ (1,0) [0|65535] ""  DASy
 SG_ VFC_TS03_AliveCtr : 16|8@1+ (1,0) [0|255] ""  DASy
 SG_ VFC_TS03_ProtBlockCtr : 24|4@1+ (1,0) [0|15] ""  DASy
 SG_ VFC_TS03_ProtOrderIndex : 32|4@1+ (1,0) [0|15] ""  DASy
 SG_ VFC_TS03_ID : 40|8@1+ (1,0) [1|255] ""  DASy
 SG_ VFC_TS03_Class : 48|8@1+ (1,0) [0|206] ""  DASy
 SG_ VFC_TS03_TSProb : 56|6@1+ (2,0) [0|100] "%"  DASy
 SG_ VFC_TS03_Dx : 64|9@1+ (0.2,0) [0|102.2] "m"  DASy
 SG_ VFC_TS03_Dy : 80|8@1+ (0.2,-25.6) [-25.6|25.4] "m"  DASy
 SG_ VFC_TS03_Dz : 88|6@1+ (0.2,0) [0|12.6] "m"  DASy
 SG_ VFC_TS03_DxStdDev : 96|8@1+ (0.25,0) [0|63.75] "m"  DASy
 SG_ VFC_TS03_DyStdDev : 104|7@1+ (0.1,0) [0|12.7] "m"  DASy
 SG_ VFC_TS03_DzStdDev : 112|6@1+ (0.1,0) [0|6.3] "m"  DASy
 SG_ VFC_TS03_Width : 120|7@1+ (0.1,0) [0|12.7] "m"  DASy
 SG_ VFC_TS03_Height : 128|6@1+ (0.1,0) [0|6.3] "m"  DASy
 SG_ VFC_TS03_EmbedFlag : 136|3@1+ (1,0) [0|7] ""  DASy
 SG_ VFC_TS03_Quality : 139|1@1+ (1,0) [0|1] ""  DASy
 SG_ VFC_TS03_VMS : 140|1@1+ (1,0) [0|1] ""  DASy
 SG_ VFC_TS03_Stable : 141|1@1+ (1,0) [0|1] ""  DASy
 SG_ VFC_TS03_VehicleSticker : 142|1@1+ (1,0) [0|1] ""  DASy
 SG_ VFC_TS03_InternalTrack : 143|1@1+ (1,0) [0|1] ""  DASy
 SG_ VFC_TS03_ValidLanes : 144|5@1+ (1,0) [0|31] ""  DASy
 SG_ VFC_TS03_ValidDay : 152|7@1+ (1,0) [0|127] ""  DASy
 SG_ VFC_TS03_ValidTimeRange1Start : 160|7@1+ (15,0) [0|1440] "min"  DASy
 SG_ VFC_TS03_ValidTimeRange1End : 168|7@1+ (15,0) [0|1440] "min"  DASy
 SG_ VFC_TS03_ValidTimeRange2Start : 176|7@1+ (15,0) [0|1440] "min"  DASy
 SG_ VFC_TS03_ValidTimeRange2End : 184|7@1+ (15,0) [0|1440] "min"  DASy
 SG_ VFC_TS03_ValidInDist : 192|10@1+ (10,0) [0|10230] "m"  DASy
 SG_ VFC_TS03_ValidDist : 208|10@1+ (10,0) [0|10230] "m"  DASy
 SG_ VFC_TS03_AddTSCount : 232|3@1+ (1,0) [0|6] ""  DASy
 SG_ VFC_TS03_AddTS1Class : 240|8@1+ (1,0) [0|68] ""  DASy
 SG_ VFC_TS03_AddTS1Prob : 248|6@1+ (2,0) [0|100] "%"  DASy
 SG_ VFC_TS03_AddTS1Quality : 254|1@1+ (1,0) [0|1] ""  DASy
 SG_ VFC_TS03_AddTS1VMS : 255|1@1+ (1,0) [0|1] ""  DASy
 SG_ VFC_TS03_AddTS2Class : 256|8@1+ (1,0) [0|68] ""  DASy
 SG_ VFC_TS03_AddTS2Prob : 264|6@1+ (2,0) [0|100] "%"  DASy
 SG_ VFC_TS03_AddTS2Quality : 270|1@1+ (1,0) [0|1] ""  DASy
 SG_ VFC_TS03_AddTS2VMS : 271|1@1+ (1,0) [0|1] ""  DASy
 SG_ VFC_TS03_AddTS3Class : 272|8@1+ (1,0) [0|68] ""  DASy
 SG_ VFC_TS03_AddTS3Prob : 280|6@1+ (2,0) [0|100] "%"  DASy
 SG_ VFC_TS03_AddTS3Quality : 286|1@1+ (1,0) [0|1] ""  DASy
 SG_ VFC_TS03_AddTS3VMS : 287|1@1+ (1,0) [0|1] ""  DASy
 SG_ VFC_TS03_AddTS4Class : 288|8@1+ (1,0) [0|68] ""  DASy
 SG_ VFC_TS03_AddTS4Prob : 296|6@1+ (2,0) [0|100] "%"  DASy
 SG_ VFC_TS03_AddTS4Quality : 302|1@1+ (1,0) [0|1] ""  DASy
 SG_ VFC_TS03_AddTS4VMS : 303|1@1+ (1,0) [0|1] ""  DASy
 SG_ VFC_TS03_AddTS5Class : 304|8@1+ (1,0) [0|68] ""  DASy
 SG_ VFC_TS03_AddTS5Prob : 312|6@1+ (2,0) [0|100] "%"  DASy
 SG_ VFC_TS03_AddTS5Quality : 318|1@1+ (1,0) [0|1] ""  DASy
 SG_ VFC_TS03_AddTS5VMS : 319|1@1+ (1,0) [0|1] ""  DASy
 SG_ VFC_TS03_AddTS6Class : 320|8@1+ (1,0) [0|68] ""  DASy
 SG_ VFC_TS03_AddTS6Prob : 328|6@1+ (2,0) [0|100] "%"  DASy
 SG_ VFC_TS03_AddTS6Quality : 334|1@1+ (1,0) [0|1] ""  DASy
 SG_ VFC_TS03_AddTS6VMS : 335|1@1+ (1,0) [0|1] ""  DASy
 SG_ VFC_TS03_FV : 359|8@0+ (1,0) [0|255] ""  DASy
 SG_ VFC_TS03_MAC : 367|24@0+ (1,0) [0|16777215] ""  DASy

BO_ 242 VFC_TrafficSign04: 48 MPC3
 SG_ VFC_TS04_CRC : 0|16@1+ (1,0) [0|65535] ""  DASy
 SG_ VFC_TS04_AliveCtr : 16|8@1+ (1,0) [0|255] ""  DASy
 SG_ VFC_TS04_ProtBlockCtr : 24|4@1+ (1,0) [0|15] ""  DASy
 SG_ VFC_TS04_ProtOrderIndex : 32|4@1+ (1,0) [0|15] ""  DASy
 SG_ VFC_TS04_ID : 40|8@1+ (1,0) [1|255] ""  DASy
 SG_ VFC_TS04_Class : 48|8@1+ (1,0) [0|206] ""  DASy
 SG_ VFC_TS04_TSProb : 56|6@1+ (2,0) [0|100] "%"  DASy
 SG_ VFC_TS04_Dx : 64|9@1+ (0.2,0) [0|102.2] "m"  DASy
 SG_ VFC_TS04_Dy : 80|8@1+ (0.2,-25.6) [-25.6|25.4] "m"  DASy
 SG_ VFC_TS04_Dz : 88|6@1+ (0.2,0) [0|12.6] "m"  DASy
 SG_ VFC_TS04_DxStdDev : 96|8@1+ (0.25,0) [0|63.75] "m"  DASy
 SG_ VFC_TS04_DyStdDev : 104|7@1+ (0.1,0) [0|12.7] "m"  DASy
 SG_ VFC_TS04_DzStdDev : 112|6@1+ (0.1,0) [0|6.3] "m"  DASy
 SG_ VFC_TS04_Width : 120|7@1+ (0.1,0) [0|12.7] "m"  DASy
 SG_ VFC_TS04_Height : 128|6@1+ (0.1,0) [0|6.3] "m"  DASy
 SG_ VFC_TS04_EmbedFlag : 136|3@1+ (1,0) [0|7] ""  DASy
 SG_ VFC_TS04_Quality : 139|1@1+ (1,0) [0|1] ""  DASy
 SG_ VFC_TS04_VMS : 140|1@1+ (1,0) [0|1] ""  DASy
 SG_ VFC_TS04_Stable : 141|1@1+ (1,0) [0|1] ""  DASy
 SG_ VFC_TS04_VehicleSticker : 142|1@1+ (1,0) [0|1] ""  DASy
 SG_ VFC_TS04_InternalTrack : 143|1@1+ (1,0) [0|1] ""  DASy
 SG_ VFC_TS04_ValidLanes : 144|5@1+ (1,0) [0|31] ""  DASy
 SG_ VFC_TS04_ValidDay : 152|7@1+ (1,0) [0|127] ""  DASy
 SG_ VFC_TS04_ValidTimeRange1Start : 160|7@1+ (15,0) [0|1440] "min"  DASy
 SG_ VFC_TS04_ValidTimeRange1End : 168|7@1+ (15,0) [0|1440] "min"  DASy
 SG_ VFC_TS04_ValidTimeRange2Start : 176|7@1+ (15,0) [0|1440] "min"  DASy
 SG_ VFC_TS04_ValidTimeRange2End : 184|7@1+ (15,0) [0|1440] "min"  DASy
 SG_ VFC_TS04_ValidInDist : 192|10@1+ (10,0) [0|10230] "m"  DASy
 SG_ VFC_TS04_ValidDist : 208|10@1+ (10,0) [0|10230] "m"  DASy
 SG_ VFC_TS04_AddTSCount : 232|3@1+ (1,0) [0|6] ""  DASy
 SG_ VFC_TS04_AddTS1Class : 240|8@1+ (1,0) [0|68] ""  DASy
 SG_ VFC_TS04_AddTS1Prob : 248|6@1+ (2,0) [0|100] "%"  DASy
 SG_ VFC_TS04_AddTS1Quality : 254|1@1+ (1,0) [0|1] ""  DASy
 SG_ VFC_TS04_AddTS1VMS : 255|1@1+ (1,0) [0|1] ""  DASy
 SG_ VFC_TS04_AddTS2Class : 256|8@1+ (1,0) [0|68] ""  DASy
 SG_ VFC_TS04_AddTS2Prob : 264|6@1+ (2,0) [0|100] "%"  DASy
 SG_ VFC_TS04_AddTS2Quality : 270|1@1+ (1,0) [0|1] ""  DASy
 SG_ VFC_TS04_AddTS2VMS : 271|1@1+ (1,0) [0|1] ""  DASy
 SG_ VFC_TS04_AddTS3Class : 272|8@1+ (1,0) [0|68] ""  DASy
 SG_ VFC_TS04_AddTS3Prob : 280|6@1+ (2,0) [0|100] "%"  DASy
 SG_ VFC_TS04_AddTS3Quality : 286|1@1+ (1,0) [0|1] ""  DASy
 SG_ VFC_TS04_AddTS3VMS : 287|1@1+ (1,0) [0|1] ""  DASy
 SG_ VFC_TS04_AddTS4Class : 288|8@1+ (1,0) [0|68] ""  DASy
 SG_ VFC_TS04_AddTS4Prob : 296|6@1+ (2,0) [0|100] "%"  DASy
 SG_ VFC_TS04_AddTS4Quality : 302|1@1+ (1,0) [0|1] ""  DASy
 SG_ VFC_TS04_AddTS4VMS : 303|1@1+ (1,0) [0|1] ""  DASy
 SG_ VFC_TS04_AddTS5Class : 304|8@1+ (1,0) [0|68] ""  DASy
 SG_ VFC_TS04_AddTS5Prob : 312|6@1+ (2,0) [0|100] "%"  DASy
 SG_ VFC_TS04_AddTS5Quality : 318|1@1+ (1,0) [0|1] ""  DASy
 SG_ VFC_TS04_AddTS5VMS : 319|1@1+ (1,0) [0|1] ""  DASy
 SG_ VFC_TS04_AddTS6Class : 320|8@1+ (1,0) [0|68] ""  DASy
 SG_ VFC_TS04_AddTS6Prob : 328|6@1+ (2,0) [0|100] "%"  DASy
 SG_ VFC_TS04_AddTS6Quality : 334|1@1+ (1,0) [0|1] ""  DASy
 SG_ VFC_TS04_AddTS6VMS : 335|1@1+ (1,0) [0|1] ""  DASy
 SG_ VFC_TS04_FV : 359|8@0+ (1,0) [0|255] ""  DASy
 SG_ VFC_TS04_MAC : 367|24@0+ (1,0) [0|16777215] ""  DASy

BO_ 243 VFC_TrafficSign05: 48 MPC3
 SG_ VFC_TS05_CRC : 0|16@1+ (1,0) [0|65535] ""  DASy
 SG_ VFC_TS05_AliveCtr : 16|8@1+ (1,0) [0|255] ""  DASy
 SG_ VFC_TS05_ProtBlockCtr : 24|4@1+ (1,0) [0|15] ""  DASy
 SG_ VFC_TS05_ProtOrderIndex : 32|4@1+ (1,0) [0|15] ""  DASy
 SG_ VFC_TS05_ID : 40|8@1+ (1,0) [1|255] ""  DASy
 SG_ VFC_TS05_Class : 48|8@1+ (1,0) [0|206] ""  DASy
 SG_ VFC_TS05_TSProb : 56|6@1+ (2,0) [0|100] "%"  DASy
 SG_ VFC_TS05_Dx : 64|9@1+ (0.2,0) [0|102.2] "m"  DASy
 SG_ VFC_TS05_Dy : 80|8@1+ (0.2,-25.6) [-25.6|25.4] "m"  DASy
 SG_ VFC_TS05_Dz : 88|6@1+ (0.2,0) [0|12.6] "m"  DASy
 SG_ VFC_TS05_DxStdDev : 96|8@1+ (0.25,0) [0|63.75] "m"  DASy
 SG_ VFC_TS05_DyStdDev : 104|7@1+ (0.1,0) [0|12.7] "m"  DASy
 SG_ VFC_TS05_DzStdDev : 112|6@1+ (0.1,0) [0|6.3] "m"  DASy
 SG_ VFC_TS05_Width : 120|7@1+ (0.1,0) [0|12.7] "m"  DASy
 SG_ VFC_TS05_Height : 128|6@1+ (0.1,0) [0|6.3] "m"  DASy
 SG_ VFC_TS05_EmbedFlag : 136|3@1+ (1,0) [0|7] ""  DASy
 SG_ VFC_TS05_Quality : 139|1@1+ (1,0) [0|1] ""  DASy
 SG_ VFC_TS05_VMS : 140|1@1+ (1,0) [0|1] ""  DASy
 SG_ VFC_TS05_Stable : 141|1@1+ (1,0) [0|1] ""  DASy
 SG_ VFC_TS05_VehicleSticker : 142|1@1+ (1,0) [0|1] ""  DASy
 SG_ VFC_TS05_InternalTrack : 143|1@1+ (1,0) [0|1] ""  DASy
 SG_ VFC_TS05_ValidLanes : 144|5@1+ (1,0) [0|31] ""  DASy
 SG_ VFC_TS05_ValidDay : 152|7@1+ (1,0) [0|127] ""  DASy
 SG_ VFC_TS05_ValidTimeRange1Start : 160|7@1+ (15,0) [0|1440] "min"  DASy
 SG_ VFC_TS05_ValidTimeRange1End : 168|7@1+ (15,0) [0|1440] "min"  DASy
 SG_ VFC_TS05_ValidTimeRange2Start : 176|7@1+ (15,0) [0|1440] "min"  DASy
 SG_ VFC_TS05_ValidTimeRange2End : 184|7@1+ (15,0) [0|1440] "min"  DASy
 SG_ VFC_TS05_ValidInDist : 192|10@1+ (10,0) [0|10230] "m"  DASy
 SG_ VFC_TS05_ValidDist : 208|10@1+ (10,0) [0|10230] "m"  DASy
 SG_ VFC_TS05_AddTSCount : 232|3@1+ (1,0) [0|6] ""  DASy
 SG_ VFC_TS05_AddTS1Class : 240|8@1+ (1,0) [0|68] ""  DASy
 SG_ VFC_TS05_AddTS1Prob : 248|6@1+ (2,0) [0|100] "%"  DASy
 SG_ VFC_TS05_AddTS1Quality : 254|1@1+ (1,0) [0|1] ""  DASy
 SG_ VFC_TS05_AddTS1VMS : 255|1@1+ (1,0) [0|1] ""  DASy
 SG_ VFC_TS05_AddTS2Class : 256|8@1+ (1,0) [0|68] ""  DASy
 SG_ VFC_TS05_AddTS2Prob : 264|6@1+ (2,0) [0|100] "%"  DASy
 SG_ VFC_TS05_AddTS2Quality : 270|1@1+ (1,0) [0|1] ""  DASy
 SG_ VFC_TS05_AddTS2VMS : 271|1@1+ (1,0) [0|1] ""  DASy
 SG_ VFC_TS05_AddTS3Class : 272|8@1+ (1,0) [0|68] ""  DASy
 SG_ VFC_TS05_AddTS3Prob : 280|6@1+ (2,0) [0|100] "%"  DASy
 SG_ VFC_TS05_AddTS3Quality : 286|1@1+ (1,0) [0|1] ""  DASy
 SG_ VFC_TS05_AddTS3VMS : 287|1@1+ (1,0) [0|1] ""  DASy
 SG_ VFC_TS05_AddTS4Class : 288|8@1+ (1,0) [0|68] ""  DASy
 SG_ VFC_TS05_AddTS4Prob : 296|6@1+ (2,0) [0|100] "%"  DASy
 SG_ VFC_TS05_AddTS4Quality : 302|1@1+ (1,0) [0|1] ""  DASy
 SG_ VFC_TS05_AddTS4VMS : 303|1@1+ (1,0) [0|1] ""  DASy
 SG_ VFC_TS05_AddTS5Class : 304|8@1+ (1,0) [0|68] ""  DASy
 SG_ VFC_TS05_AddTS5Prob : 312|6@1+ (2,0) [0|100] "%"  DASy
 SG_ VFC_TS05_AddTS5Quality : 318|1@1+ (1,0) [0|1] ""  DASy
 SG_ VFC_TS05_AddTS5VMS : 319|1@1+ (1,0) [0|1] ""  DASy
 SG_ VFC_TS05_AddTS6Class : 320|8@1+ (1,0) [0|68] ""  DASy
 SG_ VFC_TS05_AddTS6Prob : 328|6@1+ (2,0) [0|100] "%"  DASy
 SG_ VFC_TS05_AddTS6Quality : 334|1@1+ (1,0) [0|1] ""  DASy
 SG_ VFC_TS05_AddTS6VMS : 335|1@1+ (1,0) [0|1] ""  DASy
 SG_ VFC_TS05_FV : 359|8@0+ (1,0) [0|255] ""  DASy
 SG_ VFC_TS05_MAC : 367|24@0+ (1,0) [0|16777215] ""  DASy

BO_ 244 VFC_TrafficSign06: 48 MPC3
 SG_ VFC_TS06_CRC : 0|16@1+ (1,0) [0|65535] ""  DASy
 SG_ VFC_TS06_AliveCtr : 16|8@1+ (1,0) [0|255] ""  DASy
 SG_ VFC_TS06_ProtBlockCtr : 24|4@1+ (1,0) [0|15] ""  DASy
 SG_ VFC_TS06_ProtOrderIndex : 32|4@1+ (1,0) [0|15] ""  DASy
 SG_ VFC_TS06_ID : 40|8@1+ (1,0) [1|255] ""  DASy
 SG_ VFC_TS06_Class : 48|8@1+ (1,0) [0|206] ""  DASy
 SG_ VFC_TS06_TSProb : 56|6@1+ (2,0) [0|100] "%"  DASy
 SG_ VFC_TS06_Dx : 64|9@1+ (0.2,0) [0|102.2] "m"  DASy
 SG_ VFC_TS06_Dy : 80|8@1+ (0.2,-25.6) [-25.6|25.4] "m"  DASy
 SG_ VFC_TS06_Dz : 88|6@1+ (0.2,0) [0|12.6] "m"  DASy
 SG_ VFC_TS06_DxStdDev : 96|8@1+ (0.25,0) [0|63.75] "m"  DASy
 SG_ VFC_TS06_DyStdDev : 104|7@1+ (0.1,0) [0|12.7] "m"  DASy
 SG_ VFC_TS06_DzStdDev : 112|6@1+ (0.1,0) [0|6.3] "m"  DASy
 SG_ VFC_TS06_Width : 120|7@1+ (0.1,0) [0|12.7] "m"  DASy
 SG_ VFC_TS06_Height : 128|6@1+ (0.1,0) [0|6.3] "m"  DASy
 SG_ VFC_TS06_EmbedFlag : 136|3@1+ (1,0) [0|7] ""  DASy
 SG_ VFC_TS06_Quality : 139|1@1+ (1,0) [0|1] ""  DASy
 SG_ VFC_TS06_VMS : 140|1@1+ (1,0) [0|1] ""  DASy
 SG_ VFC_TS06_Stable : 141|1@1+ (1,0) [0|1] ""  DASy
 SG_ VFC_TS06_VehicleSticker : 142|1@1+ (1,0) [0|1] ""  DASy
 SG_ VFC_TS06_InternalTrack : 143|1@1+ (1,0) [0|1] ""  DASy
 SG_ VFC_TS06_ValidLanes : 144|5@1+ (1,0) [0|31] ""  DASy
 SG_ VFC_TS06_ValidDay : 152|7@1+ (1,0) [0|127] ""  DASy
 SG_ VFC_TS06_ValidTimeRange1Start : 160|7@1+ (15,0) [0|1440] "min"  DASy
 SG_ VFC_TS06_ValidTimeRange1End : 168|7@1+ (15,0) [0|1440] "min"  DASy
 SG_ VFC_TS06_ValidTimeRange2Start : 176|7@1+ (15,0) [0|1440] "min"  DASy
 SG_ VFC_TS06_ValidTimeRange2End : 184|7@1+ (15,0) [0|1440] "min"  DASy
 SG_ VFC_TS06_ValidInDist : 192|10@1+ (10,0) [0|10230] "m"  DASy
 SG_ VFC_TS06_ValidDist : 208|10@1+ (10,0) [0|10230] "m"  DASy
 SG_ VFC_TS06_AddTSCount : 232|3@1+ (1,0) [0|6] ""  DASy
 SG_ VFC_TS06_AddTS1Class : 240|8@1+ (1,0) [0|68] ""  DASy
 SG_ VFC_TS06_AddTS1Prob : 248|6@1+ (2,0) [0|100] "%"  DASy
 SG_ VFC_TS06_AddTS1Quality : 254|1@1+ (1,0) [0|1] ""  DASy
 SG_ VFC_TS06_AddTS1VMS : 255|1@1+ (1,0) [0|1] ""  DASy
 SG_ VFC_TS06_AddTS2Class : 256|8@1+ (1,0) [0|68] ""  DASy
 SG_ VFC_TS06_AddTS2Prob : 264|6@1+ (2,0) [0|100] "%"  DASy
 SG_ VFC_TS06_AddTS2Quality : 270|1@1+ (1,0) [0|1] ""  DASy
 SG_ VFC_TS06_AddTS2VMS : 271|1@1+ (1,0) [0|1] ""  DASy
 SG_ VFC_TS06_AddTS3Class : 272|8@1+ (1,0) [0|68] ""  DASy
 SG_ VFC_TS06_AddTS3Prob : 280|6@1+ (2,0) [0|100] "%"  DASy
 SG_ VFC_TS06_AddTS3Quality : 286|1@1+ (1,0) [0|1] ""  DASy
 SG_ VFC_TS06_AddTS3VMS : 287|1@1+ (1,0) [0|1] ""  DASy
 SG_ VFC_TS06_AddTS4Class : 288|8@1+ (1,0) [0|68] ""  DASy
 SG_ VFC_TS06_AddTS4Prob : 296|6@1+ (2,0) [0|100] "%"  DASy
 SG_ VFC_TS06_AddTS4Quality : 302|1@1+ (1,0) [0|1] ""  DASy
 SG_ VFC_TS06_AddTS4VMS : 303|1@1+ (1,0) [0|1] ""  DASy
 SG_ VFC_TS06_AddTS5Class : 304|8@1+ (1,0) [0|68] ""  DASy
 SG_ VFC_TS06_AddTS5Prob : 312|6@1+ (2,0) [0|100] "%"  DASy
 SG_ VFC_TS06_AddTS5Quality : 318|1@1+ (1,0) [0|1] ""  DASy
 SG_ VFC_TS06_AddTS5VMS : 319|1@1+ (1,0) [0|1] ""  DASy
 SG_ VFC_TS06_AddTS6Class : 320|8@1+ (1,0) [0|68] ""  DASy
 SG_ VFC_TS06_AddTS6Prob : 328|6@1+ (2,0) [0|100] "%"  DASy
 SG_ VFC_TS06_AddTS6Quality : 334|1@1+ (1,0) [0|1] ""  DASy
 SG_ VFC_TS06_AddTS6VMS : 335|1@1+ (1,0) [0|1] ""  DASy
 SG_ VFC_TS06_FV : 359|8@0+ (1,0) [0|255] ""  DASy
 SG_ VFC_TS06_MAC : 367|24@0+ (1,0) [0|16777215] ""  DASy

BO_ 245 VFC_TrafficSign07: 48 MPC3
 SG_ VFC_TS07_CRC : 0|16@1+ (1,0) [0|65535] ""  DASy
 SG_ VFC_TS07_AliveCtr : 16|8@1+ (1,0) [0|255] ""  DASy
 SG_ VFC_TS07_ProtBlockCtr : 24|4@1+ (1,0) [0|15] ""  DASy
 SG_ VFC_TS07_ProtOrderIndex : 32|4@1+ (1,0) [0|15] ""  DASy
 SG_ VFC_TS07_ID : 40|8@1+ (1,0) [1|255] ""  DASy
 SG_ VFC_TS07_Class : 48|8@1+ (1,0) [0|206] ""  DASy
 SG_ VFC_TS07_TSProb : 56|6@1+ (2,0) [0|100] "%"  DASy
 SG_ VFC_TS07_Dx : 64|9@1+ (0.2,0) [0|102.2] "m"  DASy
 SG_ VFC_TS07_Dy : 80|8@1+ (0.2,-25.6) [-25.6|25.4] "m"  DASy
 SG_ VFC_TS07_Dz : 88|6@1+ (0.2,0) [0|12.6] "m"  DASy
 SG_ VFC_TS07_DxStdDev : 96|8@1+ (0.25,0) [0|63.75] "m"  DASy
 SG_ VFC_TS07_DyStdDev : 104|7@1+ (0.1,0) [0|12.7] "m"  DASy
 SG_ VFC_TS07_DzStdDev : 112|6@1+ (0.1,0) [0|6.3] "m"  DASy
 SG_ VFC_TS07_Width : 120|7@1+ (0.1,0) [0|12.7] "m"  DASy
 SG_ VFC_TS07_Height : 128|6@1+ (0.1,0) [0|6.3] "m"  DASy
 SG_ VFC_TS07_EmbedFlag : 136|3@1+ (1,0) [0|7] ""  DASy
 SG_ VFC_TS07_Quality : 139|1@1+ (1,0) [0|1] ""  DASy
 SG_ VFC_TS07_VMS : 140|1@1+ (1,0) [0|1] ""  DASy
 SG_ VFC_TS07_Stable : 141|1@1+ (1,0) [0|1] ""  DASy
 SG_ VFC_TS07_VehicleSticker : 142|1@1+ (1,0) [0|1] ""  DASy
 SG_ VFC_TS07_InternalTrack : 143|1@1+ (1,0) [0|1] ""  DASy
 SG_ VFC_TS07_ValidLanes : 144|5@1+ (1,0) [0|31] ""  DASy
 SG_ VFC_TS07_ValidDay : 152|7@1+ (1,0) [0|127] ""  DASy
 SG_ VFC_TS07_ValidTimeRange1Start : 160|7@1+ (15,0) [0|1440] "min"  DASy
 SG_ VFC_TS07_ValidTimeRange1End : 168|7@1+ (15,0) [0|1440] "min"  DASy
 SG_ VFC_TS07_ValidTimeRange2Start : 176|7@1+ (15,0) [0|1440] "min"  DASy
 SG_ VFC_TS07_ValidTimeRange2End : 184|7@1+ (15,0) [0|1440] "min"  DASy
 SG_ VFC_TS07_ValidInDist : 192|10@1+ (10,0) [0|10230] "m"  DASy
 SG_ VFC_TS07_ValidDist : 208|10@1+ (10,0) [0|10230] "m"  DASy
 SG_ VFC_TS07_AddTSCount : 232|3@1+ (1,0) [0|6] ""  DASy
 SG_ VFC_TS07_AddTS1Class : 240|8@1+ (1,0) [0|68] ""  DASy
 SG_ VFC_TS07_AddTS1Prob : 248|6@1+ (2,0) [0|100] "%"  DASy
 SG_ VFC_TS07_AddTS1Quality : 254|1@1+ (1,0) [0|1] ""  DASy
 SG_ VFC_TS07_AddTS1VMS : 255|1@1+ (1,0) [0|1] ""  DASy
 SG_ VFC_TS07_AddTS2Class : 256|8@1+ (1,0) [0|68] ""  DASy
 SG_ VFC_TS07_AddTS2Prob : 264|6@1+ (2,0) [0|100] "%"  DASy
 SG_ VFC_TS07_AddTS2Quality : 270|1@1+ (1,0) [0|1] ""  DASy
 SG_ VFC_TS07_AddTS2VMS : 271|1@1+ (1,0) [0|1] ""  DASy
 SG_ VFC_TS07_AddTS3Class : 272|8@1+ (1,0) [0|68] ""  DASy
 SG_ VFC_TS07_AddTS3Prob : 280|6@1+ (2,0) [0|100] "%"  DASy
 SG_ VFC_TS07_AddTS3Quality : 286|1@1+ (1,0) [0|1] ""  DASy
 SG_ VFC_TS07_AddTS3VMS : 287|1@1+ (1,0) [0|1] ""  DASy
 SG_ VFC_TS07_AddTS4Class : 288|8@1+ (1,0) [0|68] ""  DASy
 SG_ VFC_TS07_AddTS4Prob : 296|6@1+ (2,0) [0|100] "%"  DASy
 SG_ VFC_TS07_AddTS4Quality : 302|1@1+ (1,0) [0|1] ""  DASy
 SG_ VFC_TS07_AddTS4VMS : 303|1@1+ (1,0) [0|1] ""  DASy
 SG_ VFC_TS07_AddTS5Class : 304|8@1+ (1,0) [0|68] ""  DASy
 SG_ VFC_TS07_AddTS5Prob : 312|6@1+ (2,0) [0|100] "%"  DASy
 SG_ VFC_TS07_AddTS5Quality : 318|1@1+ (1,0) [0|1] ""  DASy
 SG_ VFC_TS07_AddTS5VMS : 319|1@1+ (1,0) [0|1] ""  DASy
 SG_ VFC_TS07_AddTS6Class : 320|8@1+ (1,0) [0|68] ""  DASy
 SG_ VFC_TS07_AddTS6Prob : 328|6@1+ (2,0) [0|100] "%"  DASy
 SG_ VFC_TS07_AddTS6Quality : 334|1@1+ (1,0) [0|1] ""  DASy
 SG_ VFC_TS07_AddTS6VMS : 335|1@1+ (1,0) [0|1] ""  DASy
 SG_ VFC_TS07_FV : 359|8@0+ (1,0) [0|255] ""  DASy
 SG_ VFC_TS07_MAC : 367|24@0+ (1,0) [0|16777215] ""  DASy

BO_ 246 VFC_TrafficSign08: 48 MPC3
 SG_ VFC_TS08_CRC : 0|16@1+ (1,0) [0|65535] ""  DASy
 SG_ VFC_TS08_AliveCtr : 16|8@1+ (1,0) [0|255] ""  DASy
 SG_ VFC_TS08_ProtBlockCtr : 24|4@1+ (1,0) [0|15] ""  DASy
 SG_ VFC_TS08_ProtOrderIndex : 32|4@1+ (1,0) [0|15] ""  DASy
 SG_ VFC_TS08_ID : 40|8@1+ (1,0) [1|255] ""  DASy
 SG_ VFC_TS08_Class : 48|8@1+ (1,0) [0|206] ""  DASy
 SG_ VFC_TS08_TSProb : 56|6@1+ (2,0) [0|100] "%"  DASy
 SG_ VFC_TS08_Dx : 64|9@1+ (0.2,0) [0|102.2] "m"  DASy
 SG_ VFC_TS08_Dy : 80|8@1+ (0.2,-25.6) [-25.6|25.4] "m"  DASy
 SG_ VFC_TS08_Dz : 88|6@1+ (0.2,0) [0|12.6] "m"  DASy
 SG_ VFC_TS08_DxStdDev : 96|8@1+ (0.25,0) [0|63.75] "m"  DASy
 SG_ VFC_TS08_DyStdDev : 104|7@1+ (0.1,0) [0|12.7] "m"  DASy
 SG_ VFC_TS08_DzStdDev : 112|6@1+ (0.1,0) [0|6.3] "m"  DASy
 SG_ VFC_TS08_Width : 120|7@1+ (0.1,0) [0|12.7] "m"  DASy
 SG_ VFC_TS08_Height : 128|6@1+ (0.1,0) [0|6.3] "m"  DASy
 SG_ VFC_TS08_EmbedFlag : 136|3@1+ (1,0) [0|7] ""  DASy
 SG_ VFC_TS08_Quality : 139|1@1+ (1,0) [0|1] ""  DASy
 SG_ VFC_TS08_VMS : 140|1@1+ (1,0) [0|1] ""  DASy
 SG_ VFC_TS08_Stable : 141|1@1+ (1,0) [0|1] ""  DASy
 SG_ VFC_TS08_VehicleSticker : 142|1@1+ (1,0) [0|1] ""  DASy
 SG_ VFC_TS08_InternalTrack : 143|1@1+ (1,0) [0|1] ""  DASy
 SG_ VFC_TS08_ValidLanes : 144|5@1+ (1,0) [0|31] ""  DASy
 SG_ VFC_TS08_ValidDay : 152|7@1+ (1,0) [0|127] ""  DASy
 SG_ VFC_TS08_ValidTimeRange1Start : 160|7@1+ (15,0) [0|1440] "min"  DASy
 SG_ VFC_TS08_ValidTimeRange1End : 168|7@1+ (15,0) [0|1440] "min"  DASy
 SG_ VFC_TS08_ValidTimeRange2Start : 176|7@1+ (15,0) [0|1440] "min"  DASy
 SG_ VFC_TS08_ValidTimeRange2End : 184|7@1+ (15,0) [0|1440] "min"  DASy
 SG_ VFC_TS08_ValidInDist : 192|10@1+ (10,0) [0|10230] "m"  DASy
 SG_ VFC_TS08_ValidDist : 208|10@1+ (10,0) [0|10230] "m"  DASy
 SG_ VFC_TS08_AddTSCount : 232|3@1+ (1,0) [0|6] ""  DASy
 SG_ VFC_TS08_AddTS1Class : 240|8@1+ (1,0) [0|68] ""  DASy
 SG_ VFC_TS08_AddTS1Prob : 248|6@1+ (2,0) [0|100] "%"  DASy
 SG_ VFC_TS08_AddTS1Quality : 254|1@1+ (1,0) [0|1] ""  DASy
 SG_ VFC_TS08_AddTS1VMS : 255|1@1+ (1,0) [0|1] ""  DASy
 SG_ VFC_TS08_AddTS2Class : 256|8@1+ (1,0) [0|68] ""  DASy
 SG_ VFC_TS08_AddTS2Prob : 264|6@1+ (2,0) [0|100] "%"  DASy
 SG_ VFC_TS08_AddTS2Quality : 270|1@1+ (1,0) [0|1] ""  DASy
 SG_ VFC_TS08_AddTS2VMS : 271|1@1+ (1,0) [0|1] ""  DASy
 SG_ VFC_TS08_AddTS3Class : 272|8@1+ (1,0) [0|68] ""  DASy
 SG_ VFC_TS08_AddTS3Prob : 280|6@1+ (2,0) [0|100] "%"  DASy
 SG_ VFC_TS08_AddTS3Quality : 286|1@1+ (1,0) [0|1] ""  DASy
 SG_ VFC_TS08_AddTS3VMS : 287|1@1+ (1,0) [0|1] ""  DASy
 SG_ VFC_TS08_AddTS4Class : 288|8@1+ (1,0) [0|68] ""  DASy
 SG_ VFC_TS08_AddTS4Prob : 296|6@1+ (2,0) [0|100] "%"  DASy
 SG_ VFC_TS08_AddTS4Quality : 302|1@1+ (1,0) [0|1] ""  DASy
 SG_ VFC_TS08_AddTS4VMS : 303|1@1+ (1,0) [0|1] ""  DASy
 SG_ VFC_TS08_AddTS5Class : 304|8@1+ (1,0) [0|68] ""  DASy
 SG_ VFC_TS08_AddTS5Prob : 312|6@1+ (2,0) [0|100] "%"  DASy
 SG_ VFC_TS08_AddTS5Quality : 318|1@1+ (1,0) [0|1] ""  DASy
 SG_ VFC_TS08_AddTS5VMS : 319|1@1+ (1,0) [0|1] ""  DASy
 SG_ VFC_TS08_AddTS6Class : 320|8@1+ (1,0) [0|68] ""  DASy
 SG_ VFC_TS08_AddTS6Prob : 328|6@1+ (2,0) [0|100] "%"  DASy
 SG_ VFC_TS08_AddTS6Quality : 334|1@1+ (1,0) [0|1] ""  DASy
 SG_ VFC_TS08_AddTS6VMS : 335|1@1+ (1,0) [0|1] ""  DASy
 SG_ VFC_TS08_FV : 359|8@0+ (1,0) [0|255] ""  DASy
 SG_ VFC_TS08_MAC : 367|24@0+ (1,0) [0|16777215] ""  DASy

BO_ 247 VFC_TrafficSign09: 48 MPC3
 SG_ VFC_TS09_CRC : 0|16@1+ (1,0) [0|65535] ""  DASy
 SG_ VFC_TS09_AliveCtr : 16|8@1+ (1,0) [0|255] ""  DASy
 SG_ VFC_TS09_ProtBlockCtr : 24|4@1+ (1,0) [0|15] ""  DASy
 SG_ VFC_TS09_ProtOrderIndex : 32|4@1+ (1,0) [0|15] ""  DASy
 SG_ VFC_TS09_ID : 40|8@1+ (1,0) [1|255] ""  DASy
 SG_ VFC_TS09_Class : 48|8@1+ (1,0) [0|206] ""  DASy
 SG_ VFC_TS09_TSProb : 56|6@1+ (2,0) [0|100] "%"  DASy
 SG_ VFC_TS09_Dx : 64|9@1+ (0.2,0) [0|102.2] "m"  DASy
 SG_ VFC_TS09_Dy : 80|8@1+ (0.2,-25.6) [-25.6|25.4] "m"  DASy
 SG_ VFC_TS09_Dz : 88|6@1+ (0.2,0) [0|12.6] "m"  DASy
 SG_ VFC_TS09_DxStdDev : 96|8@1+ (0.25,0) [0|63.75] "m"  DASy
 SG_ VFC_TS09_DyStdDev : 104|7@1+ (0.1,0) [0|12.7] "m"  DASy
 SG_ VFC_TS09_DzStdDev : 112|6@1+ (0.1,0) [0|6.3] "m"  DASy
 SG_ VFC_TS09_Width : 120|7@1+ (0.1,0) [0|12.7] "m"  DASy
 SG_ VFC_TS09_Height : 128|6@1+ (0.1,0) [0|6.3] "m"  DASy
 SG_ VFC_TS09_EmbedFlag : 136|3@1+ (1,0) [0|7] ""  DASy
 SG_ VFC_TS09_Quality : 139|1@1+ (1,0) [0|1] ""  DASy
 SG_ VFC_TS09_VMS : 140|1@1+ (1,0) [0|1] ""  DASy
 SG_ VFC_TS09_Stable : 141|1@1+ (1,0) [0|1] ""  DASy
 SG_ VFC_TS09_VehicleSticker : 142|1@1+ (1,0) [0|1] ""  DASy
 SG_ VFC_TS09_InternalTrack : 143|1@1+ (1,0) [0|1] ""  DASy
 SG_ VFC_TS09_ValidLanes : 144|5@1+ (1,0) [0|31] ""  DASy
 SG_ VFC_TS09_ValidDay : 152|7@1+ (1,0) [0|127] ""  DASy
 SG_ VFC_TS09_ValidTimeRange1Start : 160|7@1+ (15,0) [0|1440] "min"  DASy
 SG_ VFC_TS09_ValidTimeRange1End : 168|7@1+ (15,0) [0|1440] "min"  DASy
 SG_ VFC_TS09_ValidTimeRange2Start : 176|7@1+ (15,0) [0|1440] "min"  DASy
 SG_ VFC_TS09_ValidTimeRange2End : 184|7@1+ (15,0) [0|1440] "min"  DASy
 SG_ VFC_TS09_ValidInDist : 192|10@1+ (10,0) [0|10230] "m"  DASy
 SG_ VFC_TS09_ValidDist : 208|10@1+ (10,0) [0|10230] "m"  DASy
 SG_ VFC_TS09_AddTSCount : 232|3@1+ (1,0) [0|6] ""  DASy
 SG_ VFC_TS09_AddTS1Class : 240|8@1+ (1,0) [0|68] ""  DASy
 SG_ VFC_TS09_AddTS1Prob : 248|6@1+ (2,0) [0|100] "%"  DASy
 SG_ VFC_TS09_AddTS1Quality : 254|1@1+ (1,0) [0|1] ""  DASy
 SG_ VFC_TS09_AddTS1VMS : 255|1@1+ (1,0) [0|1] ""  DASy
 SG_ VFC_TS09_AddTS2Class : 256|8@1+ (1,0) [0|68] ""  DASy
 SG_ VFC_TS09_AddTS2Prob : 264|6@1+ (2,0) [0|100] "%"  DASy
 SG_ VFC_TS09_AddTS2Quality : 270|1@1+ (1,0) [0|1] ""  DASy
 SG_ VFC_TS09_AddTS2VMS : 271|1@1+ (1,0) [0|1] ""  DASy
 SG_ VFC_TS09_AddTS3Class : 272|8@1+ (1,0) [0|68] ""  DASy
 SG_ VFC_TS09_AddTS3Prob : 280|6@1+ (2,0) [0|100] "%"  DASy
 SG_ VFC_TS09_AddTS3Quality : 286|1@1+ (1,0) [0|1] ""  DASy
 SG_ VFC_TS09_AddTS3VMS : 287|1@1+ (1,0) [0|1] ""  DASy
 SG_ VFC_TS09_AddTS4Class : 288|8@1+ (1,0) [0|68] ""  DASy
 SG_ VFC_TS09_AddTS4Prob : 296|6@1+ (2,0) [0|100] "%"  DASy
 SG_ VFC_TS09_AddTS4Quality : 302|1@1+ (1,0) [0|1] ""  DASy
 SG_ VFC_TS09_AddTS4VMS : 303|1@1+ (1,0) [0|1] ""  DASy
 SG_ VFC_TS09_AddTS5Class : 304|8@1+ (1,0) [0|68] ""  DASy
 SG_ VFC_TS09_AddTS5Prob : 312|6@1+ (2,0) [0|100] "%"  DASy
 SG_ VFC_TS09_AddTS5Quality : 318|1@1+ (1,0) [0|1] ""  DASy
 SG_ VFC_TS09_AddTS5VMS : 319|1@1+ (1,0) [0|1] ""  DASy
 SG_ VFC_TS09_AddTS6Class : 320|8@1+ (1,0) [0|68] ""  DASy
 SG_ VFC_TS09_AddTS6Prob : 328|6@1+ (2,0) [0|100] "%"  DASy
 SG_ VFC_TS09_AddTS6Quality : 334|1@1+ (1,0) [0|1] ""  DASy
 SG_ VFC_TS09_AddTS6VMS : 335|1@1+ (1,0) [0|1] ""  DASy
 SG_ VFC_TS09_FV : 359|8@0+ (1,0) [0|255] ""  DASy
 SG_ VFC_TS09_MAC : 367|24@0+ (1,0) [0|16777215] ""  DASy

BO_ 248 VFC_TrafficSign10: 48 MPC3
 SG_ VFC_TS10_CRC : 0|16@1+ (1,0) [0|65535] ""  DASy
 SG_ VFC_TS10_AliveCtr : 16|8@1+ (1,0) [0|255] ""  DASy
 SG_ VFC_TS10_ProtBlockCtr : 24|4@1+ (1,0) [0|15] ""  DASy
 SG_ VFC_TS10_ProtOrderIndex : 32|4@1+ (1,0) [0|15] ""  DASy
 SG_ VFC_TS10_ID : 40|8@1+ (1,0) [1|255] ""  DASy
 SG_ VFC_TS10_Class : 48|8@1+ (1,0) [0|206] ""  DASy
 SG_ VFC_TS10_TSProb : 56|6@1+ (2,0) [0|100] "%"  DASy
 SG_ VFC_TS10_Dx : 64|9@1+ (0.2,0) [0|102.2] "m"  DASy
 SG_ VFC_TS10_Dy : 80|8@1+ (0.2,-25.6) [-25.6|25.4] "m"  DASy
 SG_ VFC_TS10_Dz : 88|6@1+ (0.2,0) [0|12.6] "m"  DASy
 SG_ VFC_TS10_DxStdDev : 96|8@1+ (0.25,0) [0|63.75] "m"  DASy
 SG_ VFC_TS10_DyStdDev : 104|7@1+ (0.1,0) [0|12.7] "m"  DASy
 SG_ VFC_TS10_DzStdDev : 112|6@1+ (0.1,0) [0|6.3] "m"  DASy
 SG_ VFC_TS10_Width : 120|7@1+ (0.1,0) [0|12.7] "m"  DASy
 SG_ VFC_TS10_Height : 128|6@1+ (0.1,0) [0|6.3] "m"  DASy
 SG_ VFC_TS10_EmbedFlag : 136|3@1+ (1,0) [0|7] ""  DASy
 SG_ VFC_TS10_Quality : 139|1@1+ (1,0) [0|1] ""  DASy
 SG_ VFC_TS10_VMS : 140|1@1+ (1,0) [0|1] ""  DASy
 SG_ VFC_TS10_Stable : 141|1@1+ (1,0) [0|1] ""  DASy
 SG_ VFC_TS10_VehicleSticker : 142|1@1+ (1,0) [0|1] ""  DASy
 SG_ VFC_TS10_InternalTrack : 143|1@1+ (1,0) [0|1] ""  DASy
 SG_ VFC_TS10_ValidLanes : 144|5@1+ (1,0) [0|31] ""  DASy
 SG_ VFC_TS10_ValidDay : 152|7@1+ (1,0) [0|127] ""  DASy
 SG_ VFC_TS10_ValidTimeRange1Start : 160|7@1+ (15,0) [0|1440] "min"  DASy
 SG_ VFC_TS10_ValidTimeRange1End : 168|7@1+ (15,0) [0|1440] "min"  DASy
 SG_ VFC_TS10_ValidTimeRange2Start : 176|7@1+ (15,0) [0|1440] "min"  DASy
 SG_ VFC_TS10_ValidTimeRange2End : 184|7@1+ (15,0) [0|1440] "min"  DASy
 SG_ VFC_TS10_ValidInDist : 192|10@1+ (10,0) [0|10230] "m"  DASy
 SG_ VFC_TS10_ValidDist : 208|10@1+ (10,0) [0|10230] "m"  DASy
 SG_ VFC_TS10_AddTSCount : 232|3@1+ (1,0) [0|6] ""  DASy
 SG_ VFC_TS10_AddTS1Class : 240|8@1+ (1,0) [0|68] ""  DASy
 SG_ VFC_TS10_AddTS1Prob : 248|6@1+ (2,0) [0|100] "%"  DASy
 SG_ VFC_TS10_AddTS1Quality : 254|1@1+ (1,0) [0|1] ""  DASy
 SG_ VFC_TS10_AddTS1VMS : 255|1@1+ (1,0) [0|1] ""  DASy
 SG_ VFC_TS10_AddTS2Class : 256|8@1+ (1,0) [0|68] ""  DASy
 SG_ VFC_TS10_AddTS2Prob : 264|6@1+ (2,0) [0|100] "%"  DASy
 SG_ VFC_TS10_AddTS2Quality : 270|1@1+ (1,0) [0|1] ""  DASy
 SG_ VFC_TS10_AddTS2VMS : 271|1@1+ (1,0) [0|1] ""  DASy
 SG_ VFC_TS10_AddTS3Class : 272|8@1+ (1,0) [0|68] ""  DASy
 SG_ VFC_TS10_AddTS3Prob : 280|6@1+ (2,0) [0|100] "%"  DASy
 SG_ VFC_TS10_AddTS3Quality : 286|1@1+ (1,0) [0|1] ""  DASy
 SG_ VFC_TS10_AddTS3VMS : 287|1@1+ (1,0) [0|1] ""  DASy
 SG_ VFC_TS10_AddTS4Class : 288|8@1+ (1,0) [0|68] ""  DASy
 SG_ VFC_TS10_AddTS4Prob : 296|6@1+ (2,0) [0|100] "%"  DASy
 SG_ VFC_TS10_AddTS4Quality : 302|1@1+ (1,0) [0|1] ""  DASy
 SG_ VFC_TS10_AddTS4VMS : 303|1@1+ (1,0) [0|1] ""  DASy
 SG_ VFC_TS10_AddTS5Class : 304|8@1+ (1,0) [0|68] ""  DASy
 SG_ VFC_TS10_AddTS5Prob : 312|6@1+ (2,0) [0|100] "%"  DASy
 SG_ VFC_TS10_AddTS5Quality : 318|1@1+ (1,0) [0|1] ""  DASy
 SG_ VFC_TS10_AddTS5VMS : 319|1@1+ (1,0) [0|1] ""  DASy
 SG_ VFC_TS10_AddTS6Class : 320|8@1+ (1,0) [0|68] ""  DASy
 SG_ VFC_TS10_AddTS6Prob : 328|6@1+ (2,0) [0|100] "%"  DASy
 SG_ VFC_TS10_AddTS6Quality : 334|1@1+ (1,0) [0|1] ""  DASy
 SG_ VFC_TS10_AddTS6VMS : 335|1@1+ (1,0) [0|1] ""  DASy
 SG_ VFC_TS10_FV : 359|8@0+ (1,0) [0|255] ""  DASy
 SG_ VFC_TS10_MAC : 367|24@0+ (1,0) [0|16777215] ""  DASy

BO_ 249 VFC_TrafficSign11: 48 MPC3
 SG_ VFC_TS11_CRC : 0|16@1+ (1,0) [0|65535] ""  DASy
 SG_ VFC_TS11_AliveCtr : 16|8@1+ (1,0) [0|255] ""  DASy
 SG_ VFC_TS11_ProtBlockCtr : 24|4@1+ (1,0) [0|15] ""  DASy
 SG_ VFC_TS11_ProtOrderIndex : 32|4@1+ (1,0) [0|15] ""  DASy
 SG_ VFC_TS11_ID : 40|8@1+ (1,0) [1|255] ""  DASy
 SG_ VFC_TS11_Class : 48|8@1+ (1,0) [0|206] ""  DASy
 SG_ VFC_TS11_TSProb : 56|6@1+ (2,0) [0|100] "%"  DASy
 SG_ VFC_TS11_Dx : 64|9@1+ (0.2,0) [0|102.2] "m"  DASy
 SG_ VFC_TS11_Dy : 80|8@1+ (0.2,-25.6) [-25.6|25.4] "m"  DASy
 SG_ VFC_TS11_Dz : 88|6@1+ (0.2,0) [0|12.6] "m"  DASy
 SG_ VFC_TS11_DxStdDev : 96|8@1+ (0.25,0) [0|63.75] "m"  DASy
 SG_ VFC_TS11_DyStdDev : 104|7@1+ (0.1,0) [0|12.7] "m"  DASy
 SG_ VFC_TS11_DzStdDev : 112|6@1+ (0.1,0) [0|6.3] "m"  DASy
 SG_ VFC_TS11_Width : 120|7@1+ (0.1,0) [0|12.7] "m"  DASy
 SG_ VFC_TS11_Height : 128|6@1+ (0.1,0) [0|6.3] "m"  DASy
 SG_ VFC_TS11_EmbedFlag : 136|3@1+ (1,0) [0|7] ""  DASy
 SG_ VFC_TS11_Quality : 139|1@1+ (1,0) [0|1] ""  DASy
 SG_ VFC_TS11_VMS : 140|1@1+ (1,0) [0|1] ""  DASy
 SG_ VFC_TS11_Stable : 141|1@1+ (1,0) [0|1] ""  DASy
 SG_ VFC_TS11_VehicleSticker : 142|1@1+ (1,0) [0|1] ""  DASy
 SG_ VFC_TS11_InternalTrack : 143|1@1+ (1,0) [0|1] ""  DASy
 SG_ VFC_TS11_ValidLanes : 144|5@1+ (1,0) [0|31] ""  DASy
 SG_ VFC_TS11_ValidDay : 152|7@1+ (1,0) [0|127] ""  DASy
 SG_ VFC_TS11_ValidTimeRange1Start : 160|7@1+ (15,0) [0|1440] "min"  DASy
 SG_ VFC_TS11_ValidTimeRange1End : 168|7@1+ (15,0) [0|1440] "min"  DASy
 SG_ VFC_TS11_ValidTimeRange2Start : 176|7@1+ (15,0) [0|1440] "min"  DASy
 SG_ VFC_TS11_ValidTimeRange2End : 184|7@1+ (15,0) [0|1440] "min"  DASy
 SG_ VFC_TS11_ValidInDist : 192|10@1+ (10,0) [0|10230] "m"  DASy
 SG_ VFC_TS11_ValidDist : 208|10@1+ (10,0) [0|10230] "m"  DASy
 SG_ VFC_TS11_AddTSCount : 232|3@1+ (1,0) [0|6] ""  DASy
 SG_ VFC_TS11_AddTS1Class : 240|8@1+ (1,0) [0|68] ""  DASy
 SG_ VFC_TS11_AddTS1Prob : 248|6@1+ (2,0) [0|100] "%"  DASy
 SG_ VFC_TS11_AddTS1Quality : 254|1@1+ (1,0) [0|1] ""  DASy
 SG_ VFC_TS11_AddTS1VMS : 255|1@1+ (1,0) [0|1] ""  DASy
 SG_ VFC_TS11_AddTS2Class : 256|8@1+ (1,0) [0|68] ""  DASy
 SG_ VFC_TS11_AddTS2Prob : 264|6@1+ (2,0) [0|100] "%"  DASy
 SG_ VFC_TS11_AddTS2Quality : 270|1@1+ (1,0) [0|1] ""  DASy
 SG_ VFC_TS11_AddTS2VMS : 271|1@1+ (1,0) [0|1] ""  DASy
 SG_ VFC_TS11_AddTS3Class : 272|8@1+ (1,0) [0|68] ""  DASy
 SG_ VFC_TS11_AddTS3Prob : 280|6@1+ (2,0) [0|100] "%"  DASy
 SG_ VFC_TS11_AddTS3Quality : 286|1@1+ (1,0) [0|1] ""  DASy
 SG_ VFC_TS11_AddTS3VMS : 287|1@1+ (1,0) [0|1] ""  DASy
 SG_ VFC_TS11_AddTS4Class : 288|8@1+ (1,0) [0|68] ""  DASy
 SG_ VFC_TS11_AddTS4Prob : 296|6@1+ (2,0) [0|100] "%"  DASy
 SG_ VFC_TS11_AddTS4Quality : 302|1@1+ (1,0) [0|1] ""  DASy
 SG_ VFC_TS11_AddTS4VMS : 303|1@1+ (1,0) [0|1] ""  DASy
 SG_ VFC_TS11_AddTS5Class : 304|8@1+ (1,0) [0|68] ""  DASy
 SG_ VFC_TS11_AddTS5Prob : 312|6@1+ (2,0) [0|100] "%"  DASy
 SG_ VFC_TS11_AddTS5Quality : 318|1@1+ (1,0) [0|1] ""  DASy
 SG_ VFC_TS11_AddTS5VMS : 319|1@1+ (1,0) [0|1] ""  DASy
 SG_ VFC_TS11_AddTS6Class : 320|8@1+ (1,0) [0|68] ""  DASy
 SG_ VFC_TS11_AddTS6Prob : 328|6@1+ (2,0) [0|100] "%"  DASy
 SG_ VFC_TS11_AddTS6Quality : 334|1@1+ (1,0) [0|1] ""  DASy
 SG_ VFC_TS11_AddTS6VMS : 335|1@1+ (1,0) [0|1] ""  DASy
 SG_ VFC_TS11_FV : 359|8@0+ (1,0) [0|255] ""  DASy
 SG_ VFC_TS11_MAC : 367|24@0+ (1,0) [0|16777215] ""  DASy

CM_ SG_ 240 VFC_TS02_CRC "CRC - Autosar E2E Profile 5";
CM_ SG_ 240 VFC_TS02_AliveCtr "Alive counter - Autosar E2E Profile 5";
CM_ SG_ 240 VFC_TS02_ProtBlockCtr "Protocol-Signal: Block-Counter";
CM_ SG_ 240 VFC_TS02_ProtOrderIndex "Protocol-Signal: Index to ensure same order in Tx and Rx (Ethernet only)";
CM_ SG_ 240 VFC_TS02_ID "Unique Traffic Sign ID";
CM_ SG_ 240 VFC_TS02_Class "The type of main sign that has been detected by the vision system";
CM_ SG_ 240 VFC_TS02_TSProb "Probability that the sign is a traffic sign";
CM_ SG_ 240 VFC_TS02_Dx "Traffic sign distance in longitudinal direction";
CM_ SG_ 240 VFC_TS02_Dy "Traffic sign distance in lateral direction";
CM_ SG_ 240 VFC_TS02_Dz "Traffic sign distance in vertical direction";
CM_ SG_ 240 VFC_TS02_DxStdDev "Standard deviation of Traffic sign distance in longitudinal direction";
CM_ SG_ 240 VFC_TS02_DyStdDev "Standard deviation of Traffic sign distance in lateral direction";
CM_ SG_ 240 VFC_TS02_DzStdDev "Standard deviation of Traffic sign distance in vertical direction";
CM_ SG_ 240 VFC_TS02_Width "Width of the sign";
CM_ SG_ 240 VFC_TS02_Height "Height of the sign";
CM_ SG_ 240 VFC_TS02_EmbedFlag "Determines whether the sign is embedded or not";
CM_ SG_ 240 VFC_TS02_Quality "A flag that determines the quality of the sign";
CM_ SG_ 240 VFC_TS02_VMS "Variable-message sign: Determines whether the traffic sign is Variable or fixed";
CM_ SG_ 240 VFC_TS02_Stable "Determines whether the object is stable";
CM_ SG_ 240 VFC_TS02_VehicleSticker "Flag which indicates whether the detected traffic sign is a invalid sign on a vehicle or not";
CM_ SG_ 240 VFC_TS02_InternalTrack "Flag which indicates if this sign is an internal track, i.e. an sign hypothesis of low quality";
CM_ SG_ 240 VFC_TS02_ValidLanes "Indicates on which lane the detected sign is valid. Bitfield:

Bit 0: valid on first right hand lane

Bit 1: valid on second right hand lane

Bit 2: valid on third right hand lane

Bit 3: valid on fourth right hand lane

Bit 4: valid on fifth right hand lane";
CM_ SG_ 240 VFC_TS02_ValidDay "The MPC3 sensor shall provide the week days for which the main traffic sign is valid. Bitfield:

Bit 0: MONDAY

Bit 1: TUESDAY

Bit 2: WEDNESDAY

Bit 3: THURSDAY

Bit 4: FRIDAY

Bit 5: SATURDAY

Bit 6: SUNDAY";
CM_ SG_ 240 VFC_TS02_ValidTimeRange1Start "Start time for the first time range in which the main traffic sign is valid. Minutes since midnight.";
CM_ SG_ 240 VFC_TS02_ValidTimeRange1End "End time for the first time range in which the main traffic sign is valid. Minutes since midnight.";
CM_ SG_ 240 VFC_TS02_ValidTimeRange2Start "Start time for the first time range in which the main traffic sign is valid. Minutes since midnight.";
CM_ SG_ 240 VFC_TS02_ValidTimeRange2End "End time for the first time range in which the main traffic sign is valid. Minutes since midnight.";
CM_ SG_ 240 VFC_TS02_ValidInDist "Indicates the longitudinal distance in which the validity of the main TSR starts";
CM_ SG_ 240 VFC_TS02_ValidDist "Indicates the longitudinal distance for which the main traffic sign is valid";
CM_ SG_ 240 VFC_TS02_AddTSCount "Number of additional signs attached to the main sign. This can be a minimum of 0 and a maximum of 6.";
CM_ SG_ 240 VFC_TS02_AddTS1Class "The type of additonal sign that has been detected by the vision system";
CM_ SG_ 240 VFC_TS02_AddTS1Prob "Probability that the sign is a traffic sign";
CM_ SG_ 240 VFC_TS02_AddTS1Quality "A flag that determines the quality of the signal";
CM_ SG_ 240 VFC_TS02_AddTS1VMS "Variable-message sign: Determines whether the traffic sign is Variable or fixed";
CM_ SG_ 240 VFC_TS02_AddTS2Class "The type of additonal sign that has been detected by the vision system";
CM_ SG_ 240 VFC_TS02_AddTS2Prob "Probability that the sign is a traffic sign";
CM_ SG_ 240 VFC_TS02_AddTS2Quality "A flag that determines the quality of the signal";
CM_ SG_ 240 VFC_TS02_AddTS2VMS "Variable-message sign: Determines whether the traffic sign is Variable or fixed";
CM_ SG_ 240 VFC_TS02_AddTS3Class "The type of additonal sign that has been detected by the vision system";
CM_ SG_ 240 VFC_TS02_AddTS3Prob "Probability that the sign is a traffic sign";
CM_ SG_ 240 VFC_TS02_AddTS3Quality "A flag that determines the quality of the signal";
CM_ SG_ 240 VFC_TS02_AddTS3VMS "Variable-message sign: Determines whether the traffic sign is Variable or fixed";
CM_ SG_ 240 VFC_TS02_AddTS4Class "The type of additonal sign that has been detected by the vision system";
CM_ SG_ 240 VFC_TS02_AddTS4Prob "Probability that the sign is a traffic sign";
CM_ SG_ 240 VFC_TS02_AddTS4Quality "A flag that determines the quality of the signal";
CM_ SG_ 240 VFC_TS02_AddTS4VMS "Variable-message sign: Determines whether the traffic sign is Variable or fixed";
CM_ SG_ 240 VFC_TS02_AddTS5Class "The type of additonal sign that has been detected by the vision system";
CM_ SG_ 240 VFC_TS02_AddTS5Prob "Probability that the sign is a traffic sign";
CM_ SG_ 240 VFC_TS02_AddTS5Quality "A flag that determines the quality of the signal";
CM_ SG_ 240 VFC_TS02_AddTS5VMS "Variable-message sign: Determines whether the traffic sign is Variable or fixed";
CM_ SG_ 240 VFC_TS02_AddTS6Class "The type of additonal sign that has been detected by the vision system";
CM_ SG_ 240 VFC_TS02_AddTS6Prob "Probability that the sign is a traffic sign";
CM_ SG_ 240 VFC_TS02_AddTS6Quality "A flag that determines the quality of the signal";
CM_ SG_ 240 VFC_TS02_AddTS6VMS "Variable-message sign: Determines whether the traffic sign is Variable or fixed";
CM_ SG_ 240 VFC_TS02_FV "SecOC Freshness Value (Profile 1)";
CM_ SG_ 240 VFC_TS02_MAC "SecOC MAC (Profile 1)";
CM_ SG_ 241 VFC_TS03_CRC "CRC - Autosar E2E Profile 5";
CM_ SG_ 241 VFC_TS03_AliveCtr "Alive counter - Autosar E2E Profile 5";
CM_ SG_ 241 VFC_TS03_ProtBlockCtr "Protocol-Signal: Block-Counter";
CM_ SG_ 241 VFC_TS03_ProtOrderIndex "Protocol-Signal: Index to ensure same order in Tx and Rx (Ethernet only)";
CM_ SG_ 241 VFC_TS03_ID "Unique Traffic Sign ID";
CM_ SG_ 241 VFC_TS03_Class "The type of main sign that has been detected by the vision system";
CM_ SG_ 241 VFC_TS03_TSProb "Probability that the sign is a traffic sign";
CM_ SG_ 241 VFC_TS03_Dx "Traffic sign distance in longitudinal direction";
CM_ SG_ 241 VFC_TS03_Dy "Traffic sign distance in lateral direction";
CM_ SG_ 241 VFC_TS03_Dz "Traffic sign distance in vertical direction";
CM_ SG_ 241 VFC_TS03_DxStdDev "Standard deviation of Traffic sign distance in longitudinal direction";
CM_ SG_ 241 VFC_TS03_DyStdDev "Standard deviation of Traffic sign distance in lateral direction";
CM_ SG_ 241 VFC_TS03_DzStdDev "Standard deviation of Traffic sign distance in vertical direction";
CM_ SG_ 241 VFC_TS03_Width "Width of the sign";
CM_ SG_ 241 VFC_TS03_Height "Height of the sign";
CM_ SG_ 241 VFC_TS03_EmbedFlag "Determines whether the sign is embedded or not";
CM_ SG_ 241 VFC_TS03_Quality "A flag that determines the quality of the sign";
CM_ SG_ 241 VFC_TS03_VMS "Variable-message sign: Determines whether the traffic sign is Variable or fixed";
CM_ SG_ 241 VFC_TS03_Stable "Determines whether the object is stable";
CM_ SG_ 241 VFC_TS03_VehicleSticker "Flag which indicates whether the detected traffic sign is a invalid sign on a vehicle or not";
CM_ SG_ 241 VFC_TS03_InternalTrack "Flag which indicates if this sign is an internal track, i.e. an sign hypothesis of low quality";
CM_ SG_ 241 VFC_TS03_ValidLanes "Indicates on which lane the detected sign is valid. Bitfield:

Bit 0: valid on first right hand lane

Bit 1: valid on second right hand lane

Bit 2: valid on third right hand lane

Bit 3: valid on fourth right hand lane

Bit 4: valid on fifth right hand lane";
CM_ SG_ 241 VFC_TS03_ValidDay "The MPC3 sensor shall provide the week days for which the main traffic sign is valid. Bitfield:

Bit 0: MONDAY

Bit 1: TUESDAY

Bit 2: WEDNESDAY

Bit 3: THURSDAY

Bit 4: FRIDAY

Bit 5: SATURDAY

Bit 6: SUNDAY";
CM_ SG_ 241 VFC_TS03_ValidTimeRange1Start "Start time for the first time range in which the main traffic sign is valid. Minutes since midnight.";
CM_ SG_ 241 VFC_TS03_ValidTimeRange1End "End time for the first time range in which the main traffic sign is valid. Minutes since midnight.";
CM_ SG_ 241 VFC_TS03_ValidTimeRange2Start "Start time for the first time range in which the main traffic sign is valid. Minutes since midnight.";
CM_ SG_ 241 VFC_TS03_ValidTimeRange2End "End time for the first time range in which the main traffic sign is valid. Minutes since midnight.";
CM_ SG_ 241 VFC_TS03_ValidInDist "Indicates the longitudinal distance in which the validity of the main TSR starts";
CM_ SG_ 241 VFC_TS03_ValidDist "Indicates the longitudinal distance for which the main traffic sign is valid";
CM_ SG_ 241 VFC_TS03_AddTSCount "Number of additional signs attached to the main sign. This can be a minimum of 0 and a maximum of 6.";
CM_ SG_ 241 VFC_TS03_AddTS1Class "The type of additonal sign that has been detected by the vision system";
CM_ SG_ 241 VFC_TS03_AddTS1Prob "Probability that the sign is a traffic sign";
CM_ SG_ 241 VFC_TS03_AddTS1Quality "A flag that determines the quality of the signal";
CM_ SG_ 241 VFC_TS03_AddTS1VMS "Variable-message sign: Determines whether the traffic sign is Variable or fixed";
CM_ SG_ 241 VFC_TS03_AddTS2Class "The type of additonal sign that has been detected by the vision system";
CM_ SG_ 241 VFC_TS03_AddTS2Prob "Probability that the sign is a traffic sign";
CM_ SG_ 241 VFC_TS03_AddTS2Quality "A flag that determines the quality of the signal";
CM_ SG_ 241 VFC_TS03_AddTS2VMS "Variable-message sign: Determines whether the traffic sign is Variable or fixed";
CM_ SG_ 241 VFC_TS03_AddTS3Class "The type of additonal sign that has been detected by the vision system";
CM_ SG_ 241 VFC_TS03_AddTS3Prob "Probability that the sign is a traffic sign";
CM_ SG_ 241 VFC_TS03_AddTS3Quality "A flag that determines the quality of the signal";
CM_ SG_ 241 VFC_TS03_AddTS3VMS "Variable-message sign: Determines whether the traffic sign is Variable or fixed";
CM_ SG_ 241 VFC_TS03_AddTS4Class "The type of additonal sign that has been detected by the vision system";
CM_ SG_ 241 VFC_TS03_AddTS4Prob "Probability that the sign is a traffic sign";
CM_ SG_ 241 VFC_TS03_AddTS4Quality "A flag that determines the quality of the signal";
CM_ SG_ 241 VFC_TS03_AddTS4VMS "Variable-message sign: Determines whether the traffic sign is Variable or fixed";
CM_ SG_ 241 VFC_TS03_AddTS5Class "The type of additonal sign that has been detected by the vision system";
CM_ SG_ 241 VFC_TS03_AddTS5Prob "Probability that the sign is a traffic sign";
CM_ SG_ 241 VFC_TS03_AddTS5Quality "A flag that determines the quality of the signal";
CM_ SG_ 241 VFC_TS03_AddTS5VMS "Variable-message sign: Determines whether the traffic sign is Variable or fixed";
CM_ SG_ 241 VFC_TS03_AddTS6Class "The type of additonal sign that has been detected by the vision system";
CM_ SG_ 241 VFC_TS03_AddTS6Prob "Probability that the sign is a traffic sign";
CM_ SG_ 241 VFC_TS03_AddTS6Quality "A flag that determines the quality of the signal";
CM_ SG_ 241 VFC_TS03_AddTS6VMS "Variable-message sign: Determines whether the traffic sign is Variable or fixed";
CM_ SG_ 241 VFC_TS03_FV "SecOC Freshness Value (Profile 1)";
CM_ SG_ 241 VFC_TS03_MAC "SecOC MAC (Profile 1)";
CM_ SG_ 242 VFC_TS04_CRC "CRC - Autosar E2E Profile 5";
CM_ SG_ 242 VFC_TS04_AliveCtr "Alive counter - Autosar E2E Profile 5";
CM_ SG_ 242 VFC_TS04_ProtBlockCtr "Protocol-Signal: Block-Counter";
CM_ SG_ 242 VFC_TS04_ProtOrderIndex "Protocol-Signal: Index to ensure same order in Tx and Rx (Ethernet only)";
CM_ SG_ 242 VFC_TS04_ID "Unique Traffic Sign ID";
CM_ SG_ 242 VFC_TS04_Class "The type of main sign that has been detected by the vision system";
CM_ SG_ 242 VFC_TS04_TSProb "Probability that the sign is a traffic sign";
CM_ SG_ 242 VFC_TS04_Dx "Traffic sign distance in longitudinal direction";
CM_ SG_ 242 VFC_TS04_Dy "Traffic sign distance in lateral direction";
CM_ SG_ 242 VFC_TS04_Dz "Traffic sign distance in vertical direction";
CM_ SG_ 242 VFC_TS04_DxStdDev "Standard deviation of Traffic sign distance in longitudinal direction";
CM_ SG_ 242 VFC_TS04_DyStdDev "Standard deviation of Traffic sign distance in lateral direction";
CM_ SG_ 242 VFC_TS04_DzStdDev "Standard deviation of Traffic sign distance in vertical direction";
CM_ SG_ 242 VFC_TS04_Width "Width of the sign";
CM_ SG_ 242 VFC_TS04_Height "Height of the sign";
CM_ SG_ 242 VFC_TS04_EmbedFlag "Determines whether the sign is embedded or not";
CM_ SG_ 242 VFC_TS04_Quality "A flag that determines the quality of the sign";
CM_ SG_ 242 VFC_TS04_VMS "Variable-message sign: Determines whether the traffic sign is Variable or fixed";
CM_ SG_ 242 VFC_TS04_Stable "Determines whether the object is stable";
CM_ SG_ 242 VFC_TS04_VehicleSticker "Flag which indicates whether the detected traffic sign is a invalid sign on a vehicle or not";
CM_ SG_ 242 VFC_TS04_InternalTrack "Flag which indicates if this sign is an internal track, i.e. an sign hypothesis of low quality";
CM_ SG_ 242 VFC_TS04_ValidLanes "Indicates on which lane the detected sign is valid. Bitfield:

Bit 0: valid on first right hand lane

Bit 1: valid on second right hand lane

Bit 2: valid on third right hand lane

Bit 3: valid on fourth right hand lane

Bit 4: valid on fifth right hand lane";
CM_ SG_ 242 VFC_TS04_ValidDay "The MPC3 sensor shall provide the week days for which the main traffic sign is valid. Bitfield:

Bit 0: MONDAY

Bit 1: TUESDAY

Bit 2: WEDNESDAY

Bit 3: THURSDAY

Bit 4: FRIDAY

Bit 5: SATURDAY

Bit 6: SUNDAY";
CM_ SG_ 242 VFC_TS04_ValidTimeRange1Start "Start time for the first time range in which the main traffic sign is valid. Minutes since midnight.";
CM_ SG_ 242 VFC_TS04_ValidTimeRange1End "End time for the first time range in which the main traffic sign is valid. Minutes since midnight.";
CM_ SG_ 242 VFC_TS04_ValidTimeRange2Start "Start time for the first time range in which the main traffic sign is valid. Minutes since midnight.";
CM_ SG_ 242 VFC_TS04_ValidTimeRange2End "End time for the first time range in which the main traffic sign is valid. Minutes since midnight.";
CM_ SG_ 242 VFC_TS04_ValidInDist "Indicates the longitudinal distance in which the validity of the main TSR starts";
CM_ SG_ 242 VFC_TS04_ValidDist "Indicates the longitudinal distance for which the main traffic sign is valid";
CM_ SG_ 242 VFC_TS04_AddTSCount "Number of additional signs attached to the main sign. This can be a minimum of 0 and a maximum of 6.";
CM_ SG_ 242 VFC_TS04_AddTS1Class "The type of additonal sign that has been detected by the vision system";
CM_ SG_ 242 VFC_TS04_AddTS1Prob "Probability that the sign is a traffic sign";
CM_ SG_ 242 VFC_TS04_AddTS1Quality "A flag that determines the quality of the signal";
CM_ SG_ 242 VFC_TS04_AddTS1VMS "Variable-message sign: Determines whether the traffic sign is Variable or fixed";
CM_ SG_ 242 VFC_TS04_AddTS2Class "The type of additonal sign that has been detected by the vision system";
CM_ SG_ 242 VFC_TS04_AddTS2Prob "Probability that the sign is a traffic sign";
CM_ SG_ 242 VFC_TS04_AddTS2Quality "A flag that determines the quality of the signal";
CM_ SG_ 242 VFC_TS04_AddTS2VMS "Variable-message sign: Determines whether the traffic sign is Variable or fixed";
CM_ SG_ 242 VFC_TS04_AddTS3Class "The type of additonal sign that has been detected by the vision system";
CM_ SG_ 242 VFC_TS04_AddTS3Prob "Probability that the sign is a traffic sign";
CM_ SG_ 242 VFC_TS04_AddTS3Quality "A flag that determines the quality of the signal";
CM_ SG_ 242 VFC_TS04_AddTS3VMS "Variable-message sign: Determines whether the traffic sign is Variable or fixed";
CM_ SG_ 242 VFC_TS04_AddTS4Class "The type of additonal sign that has been detected by the vision system";
CM_ SG_ 242 VFC_TS04_AddTS4Prob "Probability that the sign is a traffic sign";
CM_ SG_ 242 VFC_TS04_AddTS4Quality "A flag that determines the quality of the signal";
CM_ SG_ 242 VFC_TS04_AddTS4VMS "Variable-message sign: Determines whether the traffic sign is Variable or fixed";
CM_ SG_ 242 VFC_TS04_AddTS5Class "The type of additonal sign that has been detected by the vision system";
CM_ SG_ 242 VFC_TS04_AddTS5Prob "Probability that the sign is a traffic sign";
CM_ SG_ 242 VFC_TS04_AddTS5Quality "A flag that determines the quality of the signal";
CM_ SG_ 242 VFC_TS04_AddTS5VMS "Variable-message sign: Determines whether the traffic sign is Variable or fixed";
CM_ SG_ 242 VFC_TS04_AddTS6Class "The type of additonal sign that has been detected by the vision system";
CM_ SG_ 242 VFC_TS04_AddTS6Prob "Probability that the sign is a traffic sign";
CM_ SG_ 242 VFC_TS04_AddTS6Quality "A flag that determines the quality of the signal";
CM_ SG_ 242 VFC_TS04_AddTS6VMS "Variable-message sign: Determines whether the traffic sign is Variable or fixed";
CM_ SG_ 242 VFC_TS04_FV "SecOC Freshness Value (Profile 1)";
CM_ SG_ 242 VFC_TS04_MAC "SecOC MAC (Profile 1)";
CM_ SG_ 243 VFC_TS05_CRC "CRC - Autosar E2E Profile 5";
CM_ SG_ 243 VFC_TS05_AliveCtr "Alive counter - Autosar E2E Profile 5";
CM_ SG_ 243 VFC_TS05_ProtBlockCtr "Protocol-Signal: Block-Counter";
CM_ SG_ 243 VFC_TS05_ProtOrderIndex "Protocol-Signal: Index to ensure same order in Tx and Rx (Ethernet only)";
CM_ SG_ 243 VFC_TS05_ID "Unique Traffic Sign ID";
CM_ SG_ 243 VFC_TS05_Class "The type of main sign that has been detected by the vision system";
CM_ SG_ 243 VFC_TS05_TSProb "Probability that the sign is a traffic sign";
CM_ SG_ 243 VFC_TS05_Dx "Traffic sign distance in longitudinal direction";
CM_ SG_ 243 VFC_TS05_Dy "Traffic sign distance in lateral direction";
CM_ SG_ 243 VFC_TS05_Dz "Traffic sign distance in vertical direction";
CM_ SG_ 243 VFC_TS05_DxStdDev "Standard deviation of Traffic sign distance in longitudinal direction";
CM_ SG_ 243 VFC_TS05_DyStdDev "Standard deviation of Traffic sign distance in lateral direction";
CM_ SG_ 243 VFC_TS05_DzStdDev "Standard deviation of Traffic sign distance in vertical direction";
CM_ SG_ 243 VFC_TS05_Width "Width of the sign";
CM_ SG_ 243 VFC_TS05_Height "Height of the sign";
CM_ SG_ 243 VFC_TS05_EmbedFlag "Determines whether the sign is embedded or not";
CM_ SG_ 243 VFC_TS05_Quality "A flag that determines the quality of the sign";
CM_ SG_ 243 VFC_TS05_VMS "Variable-message sign: Determines whether the traffic sign is Variable or fixed";
CM_ SG_ 243 VFC_TS05_Stable "Determines whether the object is stable";
CM_ SG_ 243 VFC_TS05_VehicleSticker "Flag which indicates whether the detected traffic sign is a invalid sign on a vehicle or not";
CM_ SG_ 243 VFC_TS05_InternalTrack "Flag which indicates if this sign is an internal track, i.e. an sign hypothesis of low quality";
CM_ SG_ 243 VFC_TS05_ValidLanes "Indicates on which lane the detected sign is valid. Bitfield:

Bit 0: valid on first right hand lane

Bit 1: valid on second right hand lane

Bit 2: valid on third right hand lane

Bit 3: valid on fourth right hand lane

Bit 4: valid on fifth right hand lane";
CM_ SG_ 243 VFC_TS05_ValidDay "The MPC3 sensor shall provide the week days for which the main traffic sign is valid. Bitfield:

Bit 0: MONDAY

Bit 1: TUESDAY

Bit 2: WEDNESDAY

Bit 3: THURSDAY

Bit 4: FRIDAY

Bit 5: SATURDAY

Bit 6: SUNDAY";
CM_ SG_ 243 VFC_TS05_ValidTimeRange1Start "Start time for the first time range in which the main traffic sign is valid. Minutes since midnight.";
CM_ SG_ 243 VFC_TS05_ValidTimeRange1End "End time for the first time range in which the main traffic sign is valid. Minutes since midnight.";
CM_ SG_ 243 VFC_TS05_ValidTimeRange2Start "Start time for the first time range in which the main traffic sign is valid. Minutes since midnight.";
CM_ SG_ 243 VFC_TS05_ValidTimeRange2End "End time for the first time range in which the main traffic sign is valid. Minutes since midnight.";
CM_ SG_ 243 VFC_TS05_ValidInDist "Indicates the longitudinal distance in which the validity of the main TSR starts";
CM_ SG_ 243 VFC_TS05_ValidDist "Indicates the longitudinal distance for which the main traffic sign is valid";
CM_ SG_ 243 VFC_TS05_AddTSCount "Number of additional signs attached to the main sign. This can be a minimum of 0 and a maximum of 6.";
CM_ SG_ 243 VFC_TS05_AddTS1Class "The type of additonal sign that has been detected by the vision system";
CM_ SG_ 243 VFC_TS05_AddTS1Prob "Probability that the sign is a traffic sign";
CM_ SG_ 243 VFC_TS05_AddTS1Quality "A flag that determines the quality of the signal";
CM_ SG_ 243 VFC_TS05_AddTS1VMS "Variable-message sign: Determines whether the traffic sign is Variable or fixed";
CM_ SG_ 243 VFC_TS05_AddTS2Class "The type of additonal sign that has been detected by the vision system";
CM_ SG_ 243 VFC_TS05_AddTS2Prob "Probability that the sign is a traffic sign";
CM_ SG_ 243 VFC_TS05_AddTS2Quality "A flag that determines the quality of the signal";
CM_ SG_ 243 VFC_TS05_AddTS2VMS "Variable-message sign: Determines whether the traffic sign is Variable or fixed";
CM_ SG_ 243 VFC_TS05_AddTS3Class "The type of additonal sign that has been detected by the vision system";
CM_ SG_ 243 VFC_TS05_AddTS3Prob "Probability that the sign is a traffic sign";
CM_ SG_ 243 VFC_TS05_AddTS3Quality "A flag that determines the quality of the signal";
CM_ SG_ 243 VFC_TS05_AddTS3VMS "Variable-message sign: Determines whether the traffic sign is Variable or fixed";
CM_ SG_ 243 VFC_TS05_AddTS4Class "The type of additonal sign that has been detected by the vision system";
CM_ SG_ 243 VFC_TS05_AddTS4Prob "Probability that the sign is a traffic sign";
CM_ SG_ 243 VFC_TS05_AddTS4Quality "A flag that determines the quality of the signal";
CM_ SG_ 243 VFC_TS05_AddTS4VMS "Variable-message sign: Determines whether the traffic sign is Variable or fixed";
CM_ SG_ 243 VFC_TS05_AddTS5Class "The type of additonal sign that has been detected by the vision system";
CM_ SG_ 243 VFC_TS05_AddTS5Prob "Probability that the sign is a traffic sign";
CM_ SG_ 243 VFC_TS05_AddTS5Quality "A flag that determines the quality of the signal";
CM_ SG_ 243 VFC_TS05_AddTS5VMS "Variable-message sign: Determines whether the traffic sign is Variable or fixed";
CM_ SG_ 243 VFC_TS05_AddTS6Class "The type of additonal sign that has been detected by the vision system";
CM_ SG_ 243 VFC_TS05_AddTS6Prob "Probability that the sign is a traffic sign";
CM_ SG_ 243 VFC_TS05_AddTS6Quality "A flag that determines the quality of the signal";
CM_ SG_ 243 VFC_TS05_AddTS6VMS "Variable-message sign: Determines whether the traffic sign is Variable or fixed";
CM_ SG_ 243 VFC_TS05_FV "SecOC Freshness Value (Profile 1)";
CM_ SG_ 243 VFC_TS05_MAC "SecOC MAC (Profile 1)";
CM_ SG_ 244 VFC_TS06_CRC "CRC - Autosar E2E Profile 5";
CM_ SG_ 244 VFC_TS06_AliveCtr "Alive counter - Autosar E2E Profile 5";
CM_ SG_ 244 VFC_TS06_ProtBlockCtr "Protocol-Signal: Block-Counter";
CM_ SG_ 244 VFC_TS06_ProtOrderIndex "Protocol-Signal: Index to ensure same order in Tx and Rx (Ethernet only)";
CM_ SG_ 244 VFC_TS06_ID "Unique Traffic Sign ID";
CM_ SG_ 244 VFC_TS06_Class "The type of main sign that has been detected by the vision system";
CM_ SG_ 244 VFC_TS06_TSProb "Probability that the sign is a traffic sign";
CM_ SG_ 244 VFC_TS06_Dx "Traffic sign distance in longitudinal direction";
CM_ SG_ 244 VFC_TS06_Dy "Traffic sign distance in lateral direction";
CM_ SG_ 244 VFC_TS06_Dz "Traffic sign distance in vertical direction";
CM_ SG_ 244 VFC_TS06_DxStdDev "Standard deviation of Traffic sign distance in longitudinal direction";
CM_ SG_ 244 VFC_TS06_DyStdDev "Standard deviation of Traffic sign distance in lateral direction";
CM_ SG_ 244 VFC_TS06_DzStdDev "Standard deviation of Traffic sign distance in vertical direction";
CM_ SG_ 244 VFC_TS06_Width "Width of the sign";
CM_ SG_ 244 VFC_TS06_Height "Height of the sign";
CM_ SG_ 244 VFC_TS06_EmbedFlag "Determines whether the sign is embedded or not";
CM_ SG_ 244 VFC_TS06_Quality "A flag that determines the quality of the sign";
CM_ SG_ 244 VFC_TS06_VMS "Variable-message sign: Determines whether the traffic sign is Variable or fixed";
CM_ SG_ 244 VFC_TS06_Stable "Determines whether the object is stable";
CM_ SG_ 244 VFC_TS06_VehicleSticker "Flag which indicates whether the detected traffic sign is a invalid sign on a vehicle or not";
CM_ SG_ 244 VFC_TS06_InternalTrack "Flag which indicates if this sign is an internal track, i.e. an sign hypothesis of low quality";
CM_ SG_ 244 VFC_TS06_ValidLanes "Indicates on which lane the detected sign is valid. Bitfield:

Bit 0: valid on first right hand lane

Bit 1: valid on second right hand lane

Bit 2: valid on third right hand lane

Bit 3: valid on fourth right hand lane

Bit 4: valid on fifth right hand lane";
CM_ SG_ 244 VFC_TS06_ValidDay "The MPC3 sensor shall provide the week days for which the main traffic sign is valid. Bitfield:

Bit 0: MONDAY

Bit 1: TUESDAY

Bit 2: WEDNESDAY

Bit 3: THURSDAY

Bit 4: FRIDAY

Bit 5: SATURDAY

Bit 6: SUNDAY";
CM_ SG_ 244 VFC_TS06_ValidTimeRange1Start "Start time for the first time range in which the main traffic sign is valid. Minutes since midnight.";
CM_ SG_ 244 VFC_TS06_ValidTimeRange1End "End time for the first time range in which the main traffic sign is valid. Minutes since midnight.";
CM_ SG_ 244 VFC_TS06_ValidTimeRange2Start "Start time for the first time range in which the main traffic sign is valid. Minutes since midnight.";
CM_ SG_ 244 VFC_TS06_ValidTimeRange2End "End time for the first time range in which the main traffic sign is valid. Minutes since midnight.";
CM_ SG_ 244 VFC_TS06_ValidInDist "Indicates the longitudinal distance in which the validity of the main TSR starts";
CM_ SG_ 244 VFC_TS06_ValidDist "Indicates the longitudinal distance for which the main traffic sign is valid";
CM_ SG_ 244 VFC_TS06_AddTSCount "Number of additional signs attached to the main sign. This can be a minimum of 0 and a maximum of 6.";
CM_ SG_ 244 VFC_TS06_AddTS1Class "The type of additonal sign that has been detected by the vision system";
CM_ SG_ 244 VFC_TS06_AddTS1Prob "Probability that the sign is a traffic sign";
CM_ SG_ 244 VFC_TS06_AddTS1Quality "A flag that determines the quality of the signal";
CM_ SG_ 244 VFC_TS06_AddTS1VMS "Variable-message sign: Determines whether the traffic sign is Variable or fixed";
CM_ SG_ 244 VFC_TS06_AddTS2Class "The type of additonal sign that has been detected by the vision system";
CM_ SG_ 244 VFC_TS06_AddTS2Prob "Probability that the sign is a traffic sign";
CM_ SG_ 244 VFC_TS06_AddTS2Quality "A flag that determines the quality of the signal";
CM_ SG_ 244 VFC_TS06_AddTS2VMS "Variable-message sign: Determines whether the traffic sign is Variable or fixed";
CM_ SG_ 244 VFC_TS06_AddTS3Class "The type of additonal sign that has been detected by the vision system";
CM_ SG_ 244 VFC_TS06_AddTS3Prob "Probability that the sign is a traffic sign";
CM_ SG_ 244 VFC_TS06_AddTS3Quality "A flag that determines the quality of the signal";
CM_ SG_ 244 VFC_TS06_AddTS3VMS "Variable-message sign: Determines whether the traffic sign is Variable or fixed";
CM_ SG_ 244 VFC_TS06_AddTS4Class "The type of additonal sign that has been detected by the vision system";
CM_ SG_ 244 VFC_TS06_AddTS4Prob "Probability that the sign is a traffic sign";
CM_ SG_ 244 VFC_TS06_AddTS4Quality "A flag that determines the quality of the signal";
CM_ SG_ 244 VFC_TS06_AddTS4VMS "Variable-message sign: Determines whether the traffic sign is Variable or fixed";
CM_ SG_ 244 VFC_TS06_AddTS5Class "The type of additonal sign that has been detected by the vision system";
CM_ SG_ 244 VFC_TS06_AddTS5Prob "Probability that the sign is a traffic sign";
CM_ SG_ 244 VFC_TS06_AddTS5Quality "A flag that determines the quality of the signal";
CM_ SG_ 244 VFC_TS06_AddTS5VMS "Variable-message sign: Determines whether the traffic sign is Variable or fixed";
CM_ SG_ 244 VFC_TS06_AddTS6Class "The type of additonal sign that has been detected by the vision system";
CM_ SG_ 244 VFC_TS06_AddTS6Prob "Probability that the sign is a traffic sign";
CM_ SG_ 244 VFC_TS06_AddTS6Quality "A flag that determines the quality of the signal";
CM_ SG_ 244 VFC_TS06_AddTS6VMS "Variable-message sign: Determines whether the traffic sign is Variable or fixed";
CM_ SG_ 244 VFC_TS06_FV "SecOC Freshness Value (Profile 1)";
CM_ SG_ 244 VFC_TS06_MAC "SecOC MAC (Profile 1)";
CM_ SG_ 245 VFC_TS07_CRC "CRC - Autosar E2E Profile 5";
CM_ SG_ 245 VFC_TS07_AliveCtr "Alive counter - Autosar E2E Profile 5";
CM_ SG_ 245 VFC_TS07_ProtBlockCtr "Protocol-Signal: Block-Counter";
CM_ SG_ 245 VFC_TS07_ProtOrderIndex "Protocol-Signal: Index to ensure same order in Tx and Rx (Ethernet only)";
CM_ SG_ 245 VFC_TS07_ID "Unique Traffic Sign ID";
CM_ SG_ 245 VFC_TS07_Class "The type of main sign that has been detected by the vision system";
CM_ SG_ 245 VFC_TS07_TSProb "Probability that the sign is a traffic sign";
CM_ SG_ 245 VFC_TS07_Dx "Traffic sign distance in longitudinal direction";
CM_ SG_ 245 VFC_TS07_Dy "Traffic sign distance in lateral direction";
CM_ SG_ 245 VFC_TS07_Dz "Traffic sign distance in vertical direction";
CM_ SG_ 245 VFC_TS07_DxStdDev "Standard deviation of Traffic sign distance in longitudinal direction";
CM_ SG_ 245 VFC_TS07_DyStdDev "Standard deviation of Traffic sign distance in lateral direction";
CM_ SG_ 245 VFC_TS07_DzStdDev "Standard deviation of Traffic sign distance in vertical direction";
CM_ SG_ 245 VFC_TS07_Width "Width of the sign";
CM_ SG_ 245 VFC_TS07_Height "Height of the sign";
CM_ SG_ 245 VFC_TS07_EmbedFlag "Determines whether the sign is embedded or not";
CM_ SG_ 245 VFC_TS07_Quality "A flag that determines the quality of the sign";
CM_ SG_ 245 VFC_TS07_VMS "Variable-message sign: Determines whether the traffic sign is Variable or fixed";
CM_ SG_ 245 VFC_TS07_Stable "Determines whether the object is stable";
CM_ SG_ 245 VFC_TS07_VehicleSticker "Flag which indicates whether the detected traffic sign is a invalid sign on a vehicle or not";
CM_ SG_ 245 VFC_TS07_InternalTrack "Flag which indicates if this sign is an internal track, i.e. an sign hypothesis of low quality";
CM_ SG_ 245 VFC_TS07_ValidLanes "Indicates on which lane the detected sign is valid. Bitfield:

Bit 0: valid on first right hand lane

Bit 1: valid on second right hand lane

Bit 2: valid on third right hand lane

Bit 3: valid on fourth right hand lane

Bit 4: valid on fifth right hand lane";
CM_ SG_ 245 VFC_TS07_ValidDay "The MPC3 sensor shall provide the week days for which the main traffic sign is valid. Bitfield:

Bit 0: MONDAY

Bit 1: TUESDAY

Bit 2: WEDNESDAY

Bit 3: THURSDAY

Bit 4: FRIDAY

Bit 5: SATURDAY

Bit 6: SUNDAY";
CM_ SG_ 245 VFC_TS07_ValidTimeRange1Start "Start time for the first time range in which the main traffic sign is valid. Minutes since midnight.";
CM_ SG_ 245 VFC_TS07_ValidTimeRange1End "End time for the first time range in which the main traffic sign is valid. Minutes since midnight.";
CM_ SG_ 245 VFC_TS07_ValidTimeRange2Start "Start time for the first time range in which the main traffic sign is valid. Minutes since midnight.";
CM_ SG_ 245 VFC_TS07_ValidTimeRange2End "End time for the first time range in which the main traffic sign is valid. Minutes since midnight.";
CM_ SG_ 245 VFC_TS07_ValidInDist "Indicates the longitudinal distance in which the validity of the main TSR starts";
CM_ SG_ 245 VFC_TS07_ValidDist "Indicates the longitudinal distance for which the main traffic sign is valid";
CM_ SG_ 245 VFC_TS07_AddTSCount "Number of additional signs attached to the main sign. This can be a minimum of 0 and a maximum of 6.";
CM_ SG_ 245 VFC_TS07_AddTS1Class "The type of additonal sign that has been detected by the vision system";
CM_ SG_ 245 VFC_TS07_AddTS1Prob "Probability that the sign is a traffic sign";
CM_ SG_ 245 VFC_TS07_AddTS1Quality "A flag that determines the quality of the signal";
CM_ SG_ 245 VFC_TS07_AddTS1VMS "Variable-message sign: Determines whether the traffic sign is Variable or fixed";
CM_ SG_ 245 VFC_TS07_AddTS2Class "The type of additonal sign that has been detected by the vision system";
CM_ SG_ 245 VFC_TS07_AddTS2Prob "Probability that the sign is a traffic sign";
CM_ SG_ 245 VFC_TS07_AddTS2Quality "A flag that determines the quality of the signal";
CM_ SG_ 245 VFC_TS07_AddTS2VMS "Variable-message sign: Determines whether the traffic sign is Variable or fixed";
CM_ SG_ 245 VFC_TS07_AddTS3Class "The type of additonal sign that has been detected by the vision system";
CM_ SG_ 245 VFC_TS07_AddTS3Prob "Probability that the sign is a traffic sign";
CM_ SG_ 245 VFC_TS07_AddTS3Quality "A flag that determines the quality of the signal";
CM_ SG_ 245 VFC_TS07_AddTS3VMS "Variable-message sign: Determines whether the traffic sign is Variable or fixed";
CM_ SG_ 245 VFC_TS07_AddTS4Class "The type of additonal sign that has been detected by the vision system";
CM_ SG_ 245 VFC_TS07_AddTS4Prob "Probability that the sign is a traffic sign";
CM_ SG_ 245 VFC_TS07_AddTS4Quality "A flag that determines the quality of the signal";
CM_ SG_ 245 VFC_TS07_AddTS4VMS "Variable-message sign: Determines whether the traffic sign is Variable or fixed";
CM_ SG_ 245 VFC_TS07_AddTS5Class "The type of additonal sign that has been detected by the vision system";
CM_ SG_ 245 VFC_TS07_AddTS5Prob "Probability that the sign is a traffic sign";
CM_ SG_ 245 VFC_TS07_AddTS5Quality "A flag that determines the quality of the signal";
CM_ SG_ 245 VFC_TS07_AddTS5VMS "Variable-message sign: Determines whether the traffic sign is Variable or fixed";
CM_ SG_ 245 VFC_TS07_AddTS6Class "The type of additonal sign that has been detected by the vision system";
CM_ SG_ 245 VFC_TS07_AddTS6Prob "Probability that the sign is a traffic sign";
CM_ SG_ 245 VFC_TS07_AddTS6Quality "A flag that determines the quality of the signal";
CM_ SG_ 245 VFC_TS07_AddTS6VMS "Variable-message sign: Determines whether the traffic sign is Variable or fixed";
CM_ SG_ 245 VFC_TS07_FV "SecOC Freshness Value (Profile 1)";
CM_ SG_ 245 VFC_TS07_MAC "SecOC MAC (Profile 1)";
CM_ SG_ 246 VFC_TS08_CRC "CRC - Autosar E2E Profile 5";
CM_ SG_ 246 VFC_TS08_AliveCtr "Alive counter - Autosar E2E Profile 5";
CM_ SG_ 246 VFC_TS08_ProtBlockCtr "Protocol-Signal: Block-Counter";
CM_ SG_ 246 VFC_TS08_ProtOrderIndex "Protocol-Signal: Index to ensure same order in Tx and Rx (Ethernet only)";
CM_ SG_ 246 VFC_TS08_ID "Unique Traffic Sign ID";
CM_ SG_ 246 VFC_TS08_Class "The type of main sign that has been detected by the vision system";
CM_ SG_ 246 VFC_TS08_TSProb "Probability that the sign is a traffic sign";
CM_ SG_ 246 VFC_TS08_Dx "Traffic sign distance in longitudinal direction";
CM_ SG_ 246 VFC_TS08_Dy "Traffic sign distance in lateral direction";
CM_ SG_ 246 VFC_TS08_Dz "Traffic sign distance in vertical direction";
CM_ SG_ 246 VFC_TS08_DxStdDev "Standard deviation of Traffic sign distance in longitudinal direction";
CM_ SG_ 246 VFC_TS08_DyStdDev "Standard deviation of Traffic sign distance in lateral direction";
CM_ SG_ 246 VFC_TS08_DzStdDev "Standard deviation of Traffic sign distance in vertical direction";
CM_ SG_ 246 VFC_TS08_Width "Width of the sign";
CM_ SG_ 246 VFC_TS08_Height "Height of the sign";
CM_ SG_ 246 VFC_TS08_EmbedFlag "Determines whether the sign is embedded or not";
CM_ SG_ 246 VFC_TS08_Quality "A flag that determines the quality of the sign";
CM_ SG_ 246 VFC_TS08_VMS "Variable-message sign: Determines whether the traffic sign is Variable or fixed";
CM_ SG_ 246 VFC_TS08_Stable "Determines whether the object is stable";
CM_ SG_ 246 VFC_TS08_VehicleSticker "Flag which indicates whether the detected traffic sign is a invalid sign on a vehicle or not";
CM_ SG_ 246 VFC_TS08_InternalTrack "Flag which indicates if this sign is an internal track, i.e. an sign hypothesis of low quality";
CM_ SG_ 246 VFC_TS08_ValidLanes "Indicates on which lane the detected sign is valid. Bitfield:

Bit 0: valid on first right hand lane

Bit 1: valid on second right hand lane

Bit 2: valid on third right hand lane

Bit 3: valid on fourth right hand lane

Bit 4: valid on fifth right hand lane";
CM_ SG_ 246 VFC_TS08_ValidDay "The MPC3 sensor shall provide the week days for which the main traffic sign is valid. Bitfield:

Bit 0: MONDAY

Bit 1: TUESDAY

Bit 2: WEDNESDAY

Bit 3: THURSDAY

Bit 4: FRIDAY

Bit 5: SATURDAY

Bit 6: SUNDAY";
CM_ SG_ 246 VFC_TS08_ValidTimeRange1Start "Start time for the first time range in which the main traffic sign is valid. Minutes since midnight.";
CM_ SG_ 246 VFC_TS08_ValidTimeRange1End "End time for the first time range in which the main traffic sign is valid. Minutes since midnight.";
CM_ SG_ 246 VFC_TS08_ValidTimeRange2Start "Start time for the first time range in which the main traffic sign is valid. Minutes since midnight.";
CM_ SG_ 246 VFC_TS08_ValidTimeRange2End "End time for the first time range in which the main traffic sign is valid. Minutes since midnight.";
CM_ SG_ 246 VFC_TS08_ValidInDist "Indicates the longitudinal distance in which the validity of the main TSR starts";
CM_ SG_ 246 VFC_TS08_ValidDist "Indicates the longitudinal distance for which the main traffic sign is valid";
CM_ SG_ 246 VFC_TS08_AddTSCount "Number of additional signs attached to the main sign. This can be a minimum of 0 and a maximum of 6.";
CM_ SG_ 246 VFC_TS08_AddTS1Class "The type of additonal sign that has been detected by the vision system";
CM_ SG_ 246 VFC_TS08_AddTS1Prob "Probability that the sign is a traffic sign";
CM_ SG_ 246 VFC_TS08_AddTS1Quality "A flag that determines the quality of the signal";
CM_ SG_ 246 VFC_TS08_AddTS1VMS "Variable-message sign: Determines whether the traffic sign is Variable or fixed";
CM_ SG_ 246 VFC_TS08_AddTS2Class "The type of additonal sign that has been detected by the vision system";
CM_ SG_ 246 VFC_TS08_AddTS2Prob "Probability that the sign is a traffic sign";
CM_ SG_ 246 VFC_TS08_AddTS2Quality "A flag that determines the quality of the signal";
CM_ SG_ 246 VFC_TS08_AddTS2VMS "Variable-message sign: Determines whether the traffic sign is Variable or fixed";
CM_ SG_ 246 VFC_TS08_AddTS3Class "The type of additonal sign that has been detected by the vision system";
CM_ SG_ 246 VFC_TS08_AddTS3Prob "Probability that the sign is a traffic sign";
CM_ SG_ 246 VFC_TS08_AddTS3Quality "A flag that determines the quality of the signal";
CM_ SG_ 246 VFC_TS08_AddTS3VMS "Variable-message sign: Determines whether the traffic sign is Variable or fixed";
CM_ SG_ 246 VFC_TS08_AddTS4Class "The type of additonal sign that has been detected by the vision system";
CM_ SG_ 246 VFC_TS08_AddTS4Prob "Probability that the sign is a traffic sign";
CM_ SG_ 246 VFC_TS08_AddTS4Quality "A flag that determines the quality of the signal";
CM_ SG_ 246 VFC_TS08_AddTS4VMS "Variable-message sign: Determines whether the traffic sign is Variable or fixed";
CM_ SG_ 246 VFC_TS08_AddTS5Class "The type of additonal sign that has been detected by the vision system";
CM_ SG_ 246 VFC_TS08_AddTS5Prob "Probability that the sign is a traffic sign";
CM_ SG_ 246 VFC_TS08_AddTS5Quality "A flag that determines the quality of the signal";
CM_ SG_ 246 VFC_TS08_AddTS5VMS "Variable-message sign: Determines whether the traffic sign is Variable or fixed";
CM_ SG_ 246 VFC_TS08_AddTS6Class "The type of additonal sign that has been detected by the vision system";
CM_ SG_ 246 VFC_TS08_AddTS6Prob "Probability that the sign is a traffic sign";
CM_ SG_ 246 VFC_TS08_AddTS6Quality "A flag that determines the quality of the signal";
CM_ SG_ 246 VFC_TS08_AddTS6VMS "Variable-message sign: Determines whether the traffic sign is Variable or fixed";
CM_ SG_ 246 VFC_TS08_FV "SecOC Freshness Value (Profile 1)";
CM_ SG_ 246 VFC_TS08_MAC "SecOC MAC (Profile 1)";
CM_ SG_ 247 VFC_TS09_CRC "CRC - Autosar E2E Profile 5";
CM_ SG_ 247 VFC_TS09_AliveCtr "Alive counter - Autosar E2E Profile 5";
CM_ SG_ 247 VFC_TS09_ProtBlockCtr "Protocol-Signal: Block-Counter";
CM_ SG_ 247 VFC_TS09_ProtOrderIndex "Protocol-Signal: Index to ensure same order in Tx and Rx (Ethernet only)";
CM_ SG_ 247 VFC_TS09_ID "Unique Traffic Sign ID";
CM_ SG_ 247 VFC_TS09_Class "The type of main sign that has been detected by the vision system";
CM_ SG_ 247 VFC_TS09_TSProb "Probability that the sign is a traffic sign";
CM_ SG_ 247 VFC_TS09_Dx "Traffic sign distance in longitudinal direction";
CM_ SG_ 247 VFC_TS09_Dy "Traffic sign distance in lateral direction";
CM_ SG_ 247 VFC_TS09_Dz "Traffic sign distance in vertical direction";
CM_ SG_ 247 VFC_TS09_DxStdDev "Standard deviation of Traffic sign distance in longitudinal direction";
CM_ SG_ 247 VFC_TS09_DyStdDev "Standard deviation of Traffic sign distance in lateral direction";
CM_ SG_ 247 VFC_TS09_DzStdDev "Standard deviation of Traffic sign distance in vertical direction";
CM_ SG_ 247 VFC_TS09_Width "Width of the sign";
CM_ SG_ 247 VFC_TS09_Height "Height of the sign";
CM_ SG_ 247 VFC_TS09_EmbedFlag "Determines whether the sign is embedded or not";
CM_ SG_ 247 VFC_TS09_Quality "A flag that determines the quality of the sign";
CM_ SG_ 247 VFC_TS09_VMS "Variable-message sign: Determines whether the traffic sign is Variable or fixed";
CM_ SG_ 247 VFC_TS09_Stable "Determines whether the object is stable";
CM_ SG_ 247 VFC_TS09_VehicleSticker "Flag which indicates whether the detected traffic sign is a invalid sign on a vehicle or not";
CM_ SG_ 247 VFC_TS09_InternalTrack "Flag which indicates if this sign is an internal track, i.e. an sign hypothesis of low quality";
CM_ SG_ 247 VFC_TS09_ValidLanes "Indicates on which lane the detected sign is valid. Bitfield:

Bit 0: valid on first right hand lane

Bit 1: valid on second right hand lane

Bit 2: valid on third right hand lane

Bit 3: valid on fourth right hand lane

Bit 4: valid on fifth right hand lane";
CM_ SG_ 247 VFC_TS09_ValidDay "The MPC3 sensor shall provide the week days for which the main traffic sign is valid. Bitfield:

Bit 0: MONDAY

Bit 1: TUESDAY

Bit 2: WEDNESDAY

Bit 3: THURSDAY

Bit 4: FRIDAY

Bit 5: SATURDAY

Bit 6: SUNDAY";
CM_ SG_ 247 VFC_TS09_ValidTimeRange1Start "Start time for the first time range in which the main traffic sign is valid. Minutes since midnight.";
CM_ SG_ 247 VFC_TS09_ValidTimeRange1End "End time for the first time range in which the main traffic sign is valid. Minutes since midnight.";
CM_ SG_ 247 VFC_TS09_ValidTimeRange2Start "Start time for the first time range in which the main traffic sign is valid. Minutes since midnight.";
CM_ SG_ 247 VFC_TS09_ValidTimeRange2End "End time for the first time range in which the main traffic sign is valid. Minutes since midnight.";
CM_ SG_ 247 VFC_TS09_ValidInDist "Indicates the longitudinal distance in which the validity of the main TSR starts";
CM_ SG_ 247 VFC_TS09_ValidDist "Indicates the longitudinal distance for which the main traffic sign is valid";
CM_ SG_ 247 VFC_TS09_AddTSCount "Number of additional signs attached to the main sign. This can be a minimum of 0 and a maximum of 6.";
CM_ SG_ 247 VFC_TS09_AddTS1Class "The type of additonal sign that has been detected by the vision system";
CM_ SG_ 247 VFC_TS09_AddTS1Prob "Probability that the sign is a traffic sign";
CM_ SG_ 247 VFC_TS09_AddTS1Quality "A flag that determines the quality of the signal";
CM_ SG_ 247 VFC_TS09_AddTS1VMS "Variable-message sign: Determines whether the traffic sign is Variable or fixed";
CM_ SG_ 247 VFC_TS09_AddTS2Class "The type of additonal sign that has been detected by the vision system";
CM_ SG_ 247 VFC_TS09_AddTS2Prob "Probability that the sign is a traffic sign";
CM_ SG_ 247 VFC_TS09_AddTS2Quality "A flag that determines the quality of the signal";
CM_ SG_ 247 VFC_TS09_AddTS2VMS "Variable-message sign: Determines whether the traffic sign is Variable or fixed";
CM_ SG_ 247 VFC_TS09_AddTS3Class "The type of additonal sign that has been detected by the vision system";
CM_ SG_ 247 VFC_TS09_AddTS3Prob "Probability that the sign is a traffic sign";
CM_ SG_ 247 VFC_TS09_AddTS3Quality "A flag that determines the quality of the signal";
CM_ SG_ 247 VFC_TS09_AddTS3VMS "Variable-message sign: Determines whether the traffic sign is Variable or fixed";
CM_ SG_ 247 VFC_TS09_AddTS4Class "The type of additonal sign that has been detected by the vision system";
CM_ SG_ 247 VFC_TS09_AddTS4Prob "Probability that the sign is a traffic sign";
CM_ SG_ 247 VFC_TS09_AddTS4Quality "A flag that determines the quality of the signal";
CM_ SG_ 247 VFC_TS09_AddTS4VMS "Variable-message sign: Determines whether the traffic sign is Variable or fixed";
CM_ SG_ 247 VFC_TS09_AddTS5Class "The type of additonal sign that has been detected by the vision system";
CM_ SG_ 247 VFC_TS09_AddTS5Prob "Probability that the sign is a traffic sign";
CM_ SG_ 247 VFC_TS09_AddTS5Quality "A flag that determines the quality of the signal";
CM_ SG_ 247 VFC_TS09_AddTS5VMS "Variable-message sign: Determines whether the traffic sign is Variable or fixed";
CM_ SG_ 247 VFC_TS09_AddTS6Class "The type of additonal sign that has been detected by the vision system";
CM_ SG_ 247 VFC_TS09_AddTS6Prob "Probability that the sign is a traffic sign";
CM_ SG_ 247 VFC_TS09_AddTS6Quality "A flag that determines the quality of the signal";
CM_ SG_ 247 VFC_TS09_AddTS6VMS "Variable-message sign: Determines whether the traffic sign is Variable or fixed";
CM_ SG_ 247 VFC_TS09_FV "SecOC Freshness Value (Profile 1)";
CM_ SG_ 247 VFC_TS09_MAC "SecOC MAC (Profile 1)";
CM_ SG_ 248 VFC_TS10_CRC "CRC - Autosar E2E Profile 5";
CM_ SG_ 248 VFC_TS10_AliveCtr "Alive counter - Autosar E2E Profile 5";
CM_ SG_ 248 VFC_TS10_ProtBlockCtr "Protocol-Signal: Block-Counter";
CM_ SG_ 248 VFC_TS10_ProtOrderIndex "Protocol-Signal: Index to ensure same order in Tx and Rx (Ethernet only)";
CM_ SG_ 248 VFC_TS10_ID "Unique Traffic Sign ID";
CM_ SG_ 248 VFC_TS10_Class "The type of main sign that has been detected by the vision system";
CM_ SG_ 248 VFC_TS10_TSProb "Probability that the sign is a traffic sign";
CM_ SG_ 248 VFC_TS10_Dx "Traffic sign distance in longitudinal direction";
CM_ SG_ 248 VFC_TS10_Dy "Traffic sign distance in lateral direction";
CM_ SG_ 248 VFC_TS10_Dz "Traffic sign distance in vertical direction";
CM_ SG_ 248 VFC_TS10_DxStdDev "Standard deviation of Traffic sign distance in longitudinal direction";
CM_ SG_ 248 VFC_TS10_DyStdDev "Standard deviation of Traffic sign distance in lateral direction";
CM_ SG_ 248 VFC_TS10_DzStdDev "Standard deviation of Traffic sign distance in vertical direction";
CM_ SG_ 248 VFC_TS10_Width "Width of the sign";
CM_ SG_ 248 VFC_TS10_Height "Height of the sign";
CM_ SG_ 248 VFC_TS10_EmbedFlag "Determines whether the sign is embedded or not";
CM_ SG_ 248 VFC_TS10_Quality "A flag that determines the quality of the sign";
CM_ SG_ 248 VFC_TS10_VMS "Variable-message sign: Determines whether the traffic sign is Variable or fixed";
CM_ SG_ 248 VFC_TS10_Stable "Determines whether the object is stable";
CM_ SG_ 248 VFC_TS10_VehicleSticker "Flag which indicates whether the detected traffic sign is a invalid sign on a vehicle or not";
CM_ SG_ 248 VFC_TS10_InternalTrack "Flag which indicates if this sign is an internal track, i.e. an sign hypothesis of low quality";
CM_ SG_ 248 VFC_TS10_ValidLanes "Indicates on which lane the detected sign is valid. Bitfield:

Bit 0: valid on first right hand lane

Bit 1: valid on second right hand lane

Bit 2: valid on third right hand lane

Bit 3: valid on fourth right hand lane

Bit 4: valid on fifth right hand lane";
CM_ SG_ 248 VFC_TS10_ValidDay "The MPC3 sensor shall provide the week days for which the main traffic sign is valid. Bitfield:

Bit 0: MONDAY

Bit 1: TUESDAY

Bit 2: WEDNESDAY

Bit 3: THURSDAY

Bit 4: FRIDAY

Bit 5: SATURDAY

Bit 6: SUNDAY";
CM_ SG_ 248 VFC_TS10_ValidTimeRange1Start "Start time for the first time range in which the main traffic sign is valid. Minutes since midnight.";
CM_ SG_ 248 VFC_TS10_ValidTimeRange1End "End time for the first time range in which the main traffic sign is valid. Minutes since midnight.";
CM_ SG_ 248 VFC_TS10_ValidTimeRange2Start "Start time for the first time range in which the main traffic sign is valid. Minutes since midnight.";
CM_ SG_ 248 VFC_TS10_ValidTimeRange2End "End time for the first time range in which the main traffic sign is valid. Minutes since midnight.";
CM_ SG_ 248 VFC_TS10_ValidInDist "Indicates the longitudinal distance in which the validity of the main TSR starts";
CM_ SG_ 248 VFC_TS10_ValidDist "Indicates the longitudinal distance for which the main traffic sign is valid";
CM_ SG_ 248 VFC_TS10_AddTSCount "Number of additional signs attached to the main sign. This can be a minimum of 0 and a maximum of 6.";
CM_ SG_ 248 VFC_TS10_AddTS1Class "The type of additonal sign that has been detected by the vision system";
CM_ SG_ 248 VFC_TS10_AddTS1Prob "Probability that the sign is a traffic sign";
CM_ SG_ 248 VFC_TS10_AddTS1Quality "A flag that determines the quality of the signal";
CM_ SG_ 248 VFC_TS10_AddTS1VMS "Variable-message sign: Determines whether the traffic sign is Variable or fixed";
CM_ SG_ 248 VFC_TS10_AddTS2Class "The type of additonal sign that has been detected by the vision system";
CM_ SG_ 248 VFC_TS10_AddTS2Prob "Probability that the sign is a traffic sign";
CM_ SG_ 248 VFC_TS10_AddTS2Quality "A flag that determines the quality of the signal";
CM_ SG_ 248 VFC_TS10_AddTS2VMS "Variable-message sign: Determines whether the traffic sign is Variable or fixed";
CM_ SG_ 248 VFC_TS10_AddTS3Class "The type of additonal sign that has been detected by the vision system";
CM_ SG_ 248 VFC_TS10_AddTS3Prob "Probability that the sign is a traffic sign";
CM_ SG_ 248 VFC_TS10_AddTS3Quality "A flag that determines the quality of the signal";
CM_ SG_ 248 VFC_TS10_AddTS3VMS "Variable-message sign: Determines whether the traffic sign is Variable or fixed";
CM_ SG_ 248 VFC_TS10_AddTS4Class "The type of additonal sign that has been detected by the vision system";
CM_ SG_ 248 VFC_TS10_AddTS4Prob "Probability that the sign is a traffic sign";
CM_ SG_ 248 VFC_TS10_AddTS4Quality "A flag that determines the quality of the signal";
CM_ SG_ 248 VFC_TS10_AddTS4VMS "Variable-message sign: Determines whether the traffic sign is Variable or fixed";
CM_ SG_ 248 VFC_TS10_AddTS5Class "The type of additonal sign that has been detected by the vision system";
CM_ SG_ 248 VFC_TS10_AddTS5Prob "Probability that the sign is a traffic sign";
CM_ SG_ 248 VFC_TS10_AddTS5Quality "A flag that determines the quality of the signal";
CM_ SG_ 248 VFC_TS10_AddTS5VMS "Variable-message sign: Determines whether the traffic sign is Variable or fixed";
CM_ SG_ 248 VFC_TS10_AddTS6Class "The type of additonal sign that has been detected by the vision system";
CM_ SG_ 248 VFC_TS10_AddTS6Prob "Probability that the sign is a traffic sign";
CM_ SG_ 248 VFC_TS10_AddTS6Quality "A flag that determines the quality of the signal";
CM_ SG_ 248 VFC_TS10_AddTS6VMS "Variable-message sign: Determines whether the traffic sign is Variable or fixed";
CM_ SG_ 248 VFC_TS10_FV "SecOC Freshness Value (Profile 1)";
CM_ SG_ 248 VFC_TS10_MAC "SecOC MAC (Profile 1)";
CM_ SG_ 249 VFC_TS11_CRC "CRC - Autosar E2E Profile 5";
CM_ SG_ 249 VFC_TS11_AliveCtr "Alive counter - Autosar E2E Profile 5";
CM_ SG_ 249 VFC_TS11_ProtBlockCtr "Protocol-Signal: Block-Counter";
CM_ SG_ 249 VFC_TS11_ProtOrderIndex "Protocol-Signal: Index to ensure same order in Tx and Rx (Ethernet only)";
CM_ SG_ 249 VFC_TS11_ID "Unique Traffic Sign ID";
CM_ SG_ 249 VFC_TS11_Class "The type of main sign that has been detected by the vision system";
CM_ SG_ 249 VFC_TS11_TSProb "Probability that the sign is a traffic sign";
CM_ SG_ 249 VFC_TS11_Dx "Traffic sign distance in longitudinal direction";
CM_ SG_ 249 VFC_TS11_Dy "Traffic sign distance in lateral direction";
CM_ SG_ 249 VFC_TS11_Dz "Traffic sign distance in vertical direction";
CM_ SG_ 249 VFC_TS11_DxStdDev "Standard deviation of Traffic sign distance in longitudinal direction";
CM_ SG_ 249 VFC_TS11_DyStdDev "Standard deviation of Traffic sign distance in lateral direction";
CM_ SG_ 249 VFC_TS11_DzStdDev "Standard deviation of Traffic sign distance in vertical direction";
CM_ SG_ 249 VFC_TS11_Width "Width of the sign";
CM_ SG_ 249 VFC_TS11_Height "Height of the sign";
CM_ SG_ 249 VFC_TS11_EmbedFlag "Determines whether the sign is embedded or not";
CM_ SG_ 249 VFC_TS11_Quality "A flag that determines the quality of the sign";
CM_ SG_ 249 VFC_TS11_VMS "Variable-message sign: Determines whether the traffic sign is Variable or fixed";
CM_ SG_ 249 VFC_TS11_Stable "Determines whether the object is stable";
CM_ SG_ 249 VFC_TS11_VehicleSticker "Flag which indicates whether the detected traffic sign is a invalid sign on a vehicle or not";
CM_ SG_ 249 VFC_TS11_InternalTrack "Flag which indicates if this sign is an internal track, i.e. an sign hypothesis of low quality";
CM_ SG_ 249 VFC_TS11_ValidLanes "Indicates on which lane the detected sign is valid. Bitfield:

Bit 0: valid on first right hand lane

Bit 1: valid on second right hand lane

Bit 2: valid on third right hand lane

Bit 3: valid on fourth right hand lane

Bit 4: valid on fifth right hand lane";
CM_ SG_ 249 VFC_TS11_ValidDay "The MPC3 sensor shall provide the week days for which the main traffic sign is valid. Bitfield:

Bit 0: MONDAY

Bit 1: TUESDAY

Bit 2: WEDNESDAY

Bit 3: THURSDAY

Bit 4: FRIDAY

Bit 5: SATURDAY

Bit 6: SUNDAY";
CM_ SG_ 249 VFC_TS11_ValidTimeRange1Start "Start time for the first time range in which the main traffic sign is valid. Minutes since midnight.";
CM_ SG_ 249 VFC_TS11_ValidTimeRange1End "End time for the first time range in which the main traffic sign is valid. Minutes since midnight.";
CM_ SG_ 249 VFC_TS11_ValidTimeRange2Start "Start time for the first time range in which the main traffic sign is valid. Minutes since midnight.";
CM_ SG_ 249 VFC_TS11_ValidTimeRange2End "End time for the first time range in which the main traffic sign is valid. Minutes since midnight.";
CM_ SG_ 249 VFC_TS11_ValidInDist "Indicates the longitudinal distance in which the validity of the main TSR starts";
CM_ SG_ 249 VFC_TS11_ValidDist "Indicates the longitudinal distance for which the main traffic sign is valid";
CM_ SG_ 249 VFC_TS11_AddTSCount "Number of additional signs attached to the main sign. This can be a minimum of 0 and a maximum of 6.";
CM_ SG_ 249 VFC_TS11_AddTS1Class "The type of additonal sign that has been detected by the vision system";
CM_ SG_ 249 VFC_TS11_AddTS1Prob "Probability that the sign is a traffic sign";
CM_ SG_ 249 VFC_TS11_AddTS1Quality "A flag that determines the quality of the signal";
CM_ SG_ 249 VFC_TS11_AddTS1VMS "Variable-message sign: Determines whether the traffic sign is Variable or fixed";
CM_ SG_ 249 VFC_TS11_AddTS2Class "The type of additonal sign that has been detected by the vision system";
CM_ SG_ 249 VFC_TS11_AddTS2Prob "Probability that the sign is a traffic sign";
CM_ SG_ 249 VFC_TS11_AddTS2Quality "A flag that determines the quality of the signal";
CM_ SG_ 249 VFC_TS11_AddTS2VMS "Variable-message sign: Determines whether the traffic sign is Variable or fixed";
CM_ SG_ 249 VFC_TS11_AddTS3Class "The type of additonal sign that has been detected by the vision system";
CM_ SG_ 249 VFC_TS11_AddTS3Prob "Probability that the sign is a traffic sign";
CM_ SG_ 249 VFC_TS11_AddTS3Quality "A flag that determines the quality of the signal";
CM_ SG_ 249 VFC_TS11_AddTS3VMS "Variable-message sign: Determines whether the traffic sign is Variable or fixed";
CM_ SG_ 249 VFC_TS11_AddTS4Class "The type of additonal sign that has been detected by the vision system";
CM_ SG_ 249 VFC_TS11_AddTS4Prob "Probability that the sign is a traffic sign";
CM_ SG_ 249 VFC_TS11_AddTS4Quality "A flag that determines the quality of the signal";
CM_ SG_ 249 VFC_TS11_AddTS4VMS "Variable-message sign: Determines whether the traffic sign is Variable or fixed";
CM_ SG_ 249 VFC_TS11_AddTS5Class "The type of additonal sign that has been detected by the vision system";
CM_ SG_ 249 VFC_TS11_AddTS5Prob "Probability that the sign is a traffic sign";
CM_ SG_ 249 VFC_TS11_AddTS5Quality "A flag that determines the quality of the signal";
CM_ SG_ 249 VFC_TS11_AddTS5VMS "Variable-message sign: Determines whether the traffic sign is Variable or fixed";
CM_ SG_ 249 VFC_TS11_AddTS6Class "The type of additonal sign that has been detected by the vision system";
CM_ SG_ 249 VFC_TS11_AddTS6Prob "Probability that the sign is a traffic sign";
CM_ SG_ 249 VFC_TS11_AddTS6Quality "A flag that determines the quality of the signal";
CM_ SG_ 249 VFC_TS11_AddTS6VMS "Variable-message sign: Determines whether the traffic sign is Variable or fixed";
CM_ SG_ 249 VFC_TS11_FV "SecOC Freshness Value (Profile 1)";
CM_ SG_ 249 VFC_TS11_MAC "SecOC MAC (Profile 1)";
BA_DEF_ BO_  "GenMsgSendType" ENUM  "cyclic","NoMsgSendType","IfActive","Event","CA","CE";
BA_DEF_ BO_  "GenMsgCycleTime" INT 0 0;
BA_DEF_ SG_  "GenSigSendType" ENUM  "cyclic","OnChange","OnWrite","IfActive","OnChangeWithRepetition","OnWriteWithRepetition","IfActiveWithRepetition","CA","CE","Event";
BA_DEF_ SG_  "GenSigStartValue" INT 0 0;
BA_DEF_ BO_  "CANFD_BRS" ENUM  "0","1";
BA_DEF_ BO_  "VFrameFormat" ENUM  "StandardCAN","ExtendedCAN","reserved","reserved","reserved","reserved","reserved","reserved","reserved","reserved","reserved","reserved","reserved","reserved","StandardCAN_FD","ExtendedCAN_FD";
BA_DEF_ BO_  "GenMsgILSupport" ENUM  "No","Yes";
BA_DEF_ SG_  "sigDespEng" STRING ;
BA_DEF_ SG_  "sigSecLevel" STRING ;
BA_DEF_ SG_  "sigConfig" STRING ;
BA_DEF_ SG_  "sigExplanation" STRING ;
BA_DEF_DEF_  "GenMsgSendType" "cyclic";
BA_DEF_DEF_  "GenMsgCycleTime" 0;
BA_DEF_DEF_  "GenSigSendType" "cyclic";
BA_DEF_DEF_  "GenSigStartValue" 0;
BA_DEF_DEF_  "CANFD_BRS" "1";
BA_DEF_DEF_  "VFrameFormat" "";
BA_DEF_DEF_  "GenMsgILSupport" "Yes";
BA_DEF_DEF_  "sigDespEng" "";
BA_DEF_DEF_  "sigSecLevel" "";
BA_DEF_DEF_  "sigConfig" "";
BA_DEF_DEF_  "sigExplanation" "";
BA_ "GenMsgSendType" BO_ 240 3;
BA_ "VFrameFormat" BO_ 240 14;
BA_ "GenMsgSendType" BO_ 241 3;
BA_ "VFrameFormat" BO_ 241 14;
BA_ "GenMsgSendType" BO_ 242 3;
BA_ "VFrameFormat" BO_ 242 14;
BA_ "GenMsgSendType" BO_ 243 3;
BA_ "VFrameFormat" BO_ 243 14;
BA_ "GenMsgSendType" BO_ 244 3;
BA_ "VFrameFormat" BO_ 244 14;
BA_ "GenMsgSendType" BO_ 245 3;
BA_ "VFrameFormat" BO_ 245 14;
BA_ "GenMsgSendType" BO_ 246 3;
BA_ "VFrameFormat" BO_ 246 14;
BA_ "GenMsgSendType" BO_ 247 3;
BA_ "VFrameFormat" BO_ 247 14;
BA_ "GenMsgSendType" BO_ 248 3;
BA_ "VFrameFormat" BO_ 248 14;
BA_ "GenMsgSendType" BO_ 249 3;
BA_ "VFrameFormat" BO_ 249 14;
BA_ "GenSigStartValue" SG_ 240 VFC_TS02_Dy 128;
BA_ "GenSigStartValue" SG_ 241 VFC_TS03_Dy 128;
BA_ "GenSigStartValue" SG_ 242 VFC_TS04_Dy 128;
BA_ "GenSigStartValue" SG_ 243 VFC_TS05_Dy 128;
BA_ "GenSigStartValue" SG_ 244 VFC_TS06_Dy 128;
BA_ "GenSigStartValue" SG_ 245 VFC_TS07_Dy 128;
BA_ "GenSigStartValue" SG_ 246 VFC_TS08_Dy 128;
BA_ "GenSigStartValue" SG_ 247 VFC_TS09_Dy 128;
BA_ "GenSigStartValue" SG_ 248 VFC_TS10_Dy 128;
BA_ "GenSigStartValue" SG_ 249 VFC_TS11_Dy 128;
VAL_ 240 VFC_TS02_ID 0 "INVALID" ;
VAL_ 240 VFC_TS02_Class 0 "UNKNOWN" 1 "SL5" 2 "SL10" 3 "SL15" 4 "SL20" 5 "SL25" 6 "SL30" 7 "SL35" 8 "SL40" 9 "SL45" 10 "SL50" 11 "SL55" 12 "SL60" 13 "SL65" 14 "SL70" 15 "SL75" 16 "SL80" 17 "SL85" 18 "SL90" 19 "SL95" 20 "SL100" 21 "SL105" 22 "SL110" 23 "SL115" 24 "SL120" 25 "SL125" 26 "SL130" 27 "SL135" 28 "SL140" 29 "SL145" 30 "SL150" 31 "SL155" 32 "SL160" 33 "ESL" 34 "EA" 35 "OP" 36 "EOP" 37 "OL" 38 "EOL" 39 "GIVEWAY" 40 "PRIOCROSS" 41 "PRIOCROSSYIELDTORIGHT" 42 "PRIOSTREET" 43 "EPRIOSTREET" 44 "STOP" 45 "AXLEWEIGHT" 46 "CARDIST" 47 "HEIGHT" 48 "LENGTH" 49 "LORRYDIST" 50 "NOALL" 51 "NOBIKE" 52 "NOBUS" 53 "NOCAR" 54 "NOCARBIKE" 55 "NOCARRIAGE" 56 "NOENTRY" 57 "NOHAZMAT" 58 "NOHAZWATER" 59 "NOLORRY" 60 "NOLORRYTRAILER" 61 "NOLTURN" 62 "NOPED" 63 "NORIDER" 64 "NORTURN" 65 "NOTRACTOR" 66 "NOTWOWAY" 67 "NOUTURN" 68 "UMWELT" 69 "EUMWELT" 70 "WEIGHT" 71 "WIDTH" 72 "WARNBIKE" 73 "WARNBUS" 74 "WARNCATTLE" 75 "WARNCONST" 76 "WARNCONSTL" 77 "WARNCONSTR" 78 "WARNCURVEL" 79 "WARNCURVER" 80 "WARNDANGER" 81 "WARNDCURVEL" 82 "WARNDCURVER" 83 "WARNDRAWBRIDGE" 84 "WARNFROG" 85 "WARNGRAVEL" 86 "WARNHUMP" 87 "WARNJAM" 88 "WARNKIDS" 89 "WARNLIGHTS" 90 "WARNLOWTREE" 91 "WARNPCROSS" 92 "WARNPED" 93 "WARNPIER" 94 "WARNPLANE" 95 "WARNRIDER" 96 "WARNROCK" 97 "WARNROUND" 98 "WARNRWORKS" 99 "WARNSKID" 100 "WARNSLOPED" 101 "WARNSLOPEU" 102 "WARNSNOW" 103 "WARNTRAIN" 104 "WARNTWOWAY" 105 "WARNWILDANIMAL" 106 "WARNWIND" 107 "ASL" 108 "EASL" 109 "CALM" 110 "ECALM" 111 "DEADEND" 112 "DOUANE" 113 "FWAY" 114 "EFWAY" 115 "HWAY" 116 "EHWAY" 117 "MSL" 118 "EMSL" 119 "NOPARK" 120 "NOSTOP" 121 "ONEWAYS" 122 "ONEWAYU" 123 "SLOWDOWN" 124 "SCHOOL" 125 "ESCHOOL" 126 "TWN" 127 "ETWN" 128 "WBBENTLEFT" 129 "WBBENTLEFTRIGHT" 130 "WBBENTRIGHT" 131 "WBDIAGL" 132 "WBDIAGLR" 133 "WBDIAGR" 134 "WBHAZWATER" 135 "WBLEFT" 136 "WBRIGHT" 137 "WBROUND" 138 "WBUP" 139 "WBUPLEFT" 140 "WBUPRIGHT" 141 "ZEBRA" 142 "HAZMAT" 143 "EMERGENCYBAY" 144 "ENDOFLANEL" 145 "ENDOFLANER" 146 "ENOPARK" 147 "EONEWAY" 148 "EPARK" 149 "ETOLL" 150 "NOPARKL" 151 "NOPARKLR" 152 "NOPARKR" 153 "NOSTOPL" 154 "NOSTOPLR" 155 "NOSTOPR" 156 "NOTURNONRED" 157 "ONEWAYL" 158 "ONEWAYR" 159 "PARK" 160 "PRIOCROSSL" 161 "PRIOCROSSR" 162 "TOLL" 163 "TUNNEL" 164 "TWOWAY" 165 "WARNCROSS" 166 "WARNCROSSL" 167 "WARNCROSSLR" 168 "WARNCROSSR" 169 "WARNCROSSRL" 170 "WARNCROSST" 171 "WARNGIVEWAYAHEAD" 172 "WARNSLAHEAD" 173 "WARNSTOPAHEAD" 174 "WBBUS" 175 "WRONGWAY" 176 "HAZWATER" 177 "GIVEWAYROUND" 178 "WARNWINDINGL" 179 "WARNWINDINGR" 180 "WARNHAIRPINL" 181 "WARNHAIRPINR" 182 "WARNPEDBIKE" 183 "WARNCROSSY" 184 "WARNBRANCHL" 185 "WARNBRANCHR" 186 "WARNAXLEWEIGHT" 187 "WARNWEIGHT" 188 "WARNHEIGHT" 189 "WARNLENGTH" 190 "WARNWIDTH" 191 "WARNBLACKSPOT" 192 "WARNMERGEL" 193 "WARNMERGER" 194 "WARNTUNNEL" 195 "WARNTRACTOR" 196 "WARNRWORKSVEHICLE" 197 "WARNNARROWBRIDGE" 198 "WARNFLAGGER" 199 "LANES" 200 "LANESHIFTL" 201 "LANESHIFTR" 202 "NEWLANEL" 203 "NEWLANER" 204 "RIGHTTURNONRED" 205 "BORDERLIMIT" 206 "EMBEDDEDRAIN" ;
VAL_ 240 VFC_TS02_EmbedFlag 0 "Unknown" 1 "Not Embedded" 2 "Border Limit" 3 "Multi Lane" 4 "Rain" 5 "Vehicle Type" 6 "Plate" 7 "Error Value" ;
VAL_ 240 VFC_TS02_Quality 0 "Poor Quality" 1 "Good Quality" ;
VAL_ 240 VFC_TS02_VMS 0 "Fixed" 1 "Variable" ;
VAL_ 240 VFC_TS02_Stable 0 "Object Is Not Stable" 1 "Object Is Stable" ;
VAL_ 240 VFC_TS02_VehicleSticker 0 "not_sticker_on_vehicle" 1 "Sign is a sticker on a vehicle" ;
VAL_ 240 VFC_TS02_InternalTrack 0 "Sign is not an internal track" 1 "Sign is an internal track" ;
VAL_ 240 VFC_TS02_AddTS1Class 0 "UNKNOWN" 1 "DETECTED" 2 "ACCIDENT" 3 "ADVICE" 4 "BEGINS" 5 "BUS" 6 "CAMPER" 7 "CAR" 8 "CARAVAN" 9 "CRASHRISK" 10 "DIRT" 11 "DISTANCE" 12 "DISTANCEBARS" 13 "END" 14 "EXITL" 15 "EXITR" 16 "FOG" 17 "GRAVEL" 18 "HAZMAT" 19 "HUMP" 20 "JAM" 21 "LORRY" 22 "EXCEPTLORRY" 23 "LOWTREE" 24 "MCYCLE" 25 "MINIMUM" 26 "NIGHT" 27 "NOSTOPSHOULDER" 28 "OILTRAIL" 29 "PRIOTURN" 30 "RADAR" 31 "RAIN" 32 "RAINSNOW" 33 "REMINDER" 34 "ROADDAMAGE" 35 "RUTS" 36 "RWORKSACCESS" 37 "RWORKSENTRY" 38 "RWORKSEXIT" 39 "SCHOOL" 40 "SECTION" 41 "SMOKE" 42 "SNOW" 43 "SOFTSHOULDERCAR" 44 "SHOFTSHOULDERLORRY" 45 "TEXT" 46 "TIME" 47 "TOWING" 48 "TRACTOR" 49 "TRACTOR_OVER" 50 "TRAILER" 51 "WEIGHT" 52 "WET" 53 "WITHIN" 54 "ZONE" 55 "EXIT" 56 "ACCESS" 57 "ALLWAY" 58 "EXCEPTBUS" 59 "EXCEPTDELIVERY" 60 "EXCEPTLOCAL" 61 "FROG" 62 "PRIOTURNL" 63 "PRIOTURNR" 64 "START" 65 "STOPIN" 66 "HAZWATER" 67 "DAY" 68 "SL" ;
VAL_ 240 VFC_TS02_AddTS1Quality 0 "Poor Quality" 1 "Good Quality" ;
VAL_ 240 VFC_TS02_AddTS1VMS 0 "Fixed" 1 "Variable" ;
VAL_ 240 VFC_TS02_AddTS2Class 0 "UNKNOWN" 1 "DETECTED" 2 "ACCIDENT" 3 "ADVICE" 4 "BEGINS" 5 "BUS" 6 "CAMPER" 7 "CAR" 8 "CARAVAN" 9 "CRASHRISK" 10 "DIRT" 11 "DISTANCE" 12 "DISTANCEBARS" 13 "END" 14 "EXITL" 15 "EXITR" 16 "FOG" 17 "GRAVEL" 18 "HAZMAT" 19 "HUMP" 20 "JAM" 21 "LORRY" 22 "EXCEPTLORRY" 23 "LOWTREE" 24 "MCYCLE" 25 "MINIMUM" 26 "NIGHT" 27 "NOSTOPSHOULDER" 28 "OILTRAIL" 29 "PRIOTURN" 30 "RADAR" 31 "RAIN" 32 "RAINSNOW" 33 "REMINDER" 34 "ROADDAMAGE" 35 "RUTS" 36 "RWORKSACCESS" 37 "RWORKSENTRY" 38 "RWORKSEXIT" 39 "SCHOOL" 40 "SECTION" 41 "SMOKE" 42 "SNOW" 43 "SOFTSHOULDERCAR" 44 "SHOFTSHOULDERLORRY" 45 "TEXT" 46 "TIME" 47 "TOWING" 48 "TRACTOR" 49 "TRACTOR_OVER" 50 "TRAILER" 51 "WEIGHT" 52 "WET" 53 "WITHIN" 54 "ZONE" 55 "EXIT" 56 "ACCESS" 57 "ALLWAY" 58 "EXCEPTBUS" 59 "EXCEPTDELIVERY" 60 "EXCEPTLOCAL" 61 "FROG" 62 "PRIOTURNL" 63 "PRIOTURNR" 64 "START" 65 "STOPIN" 66 "HAZWATER" 67 "DAY" 68 "SL" ;
VAL_ 240 VFC_TS02_AddTS2Quality 0 "Poor Quality" 1 "Good Quality" ;
VAL_ 240 VFC_TS02_AddTS2VMS 0 "Fixed" 1 "Variable" ;
VAL_ 240 VFC_TS02_AddTS3Class 0 "UNKNOWN" 1 "DETECTED" 2 "ACCIDENT" 3 "ADVICE" 4 "BEGINS" 5 "BUS" 6 "CAMPER" 7 "CAR" 8 "CARAVAN" 9 "CRASHRISK" 10 "DIRT" 11 "DISTANCE" 12 "DISTANCEBARS" 13 "END" 14 "EXITL" 15 "EXITR" 16 "FOG" 17 "GRAVEL" 18 "HAZMAT" 19 "HUMP" 20 "JAM" 21 "LORRY" 22 "EXCEPTLORRY" 23 "LOWTREE" 24 "MCYCLE" 25 "MINIMUM" 26 "NIGHT" 27 "NOSTOPSHOULDER" 28 "OILTRAIL" 29 "PRIOTURN" 30 "RADAR" 31 "RAIN" 32 "RAINSNOW" 33 "REMINDER" 34 "ROADDAMAGE" 35 "RUTS" 36 "RWORKSACCESS" 37 "RWORKSENTRY" 38 "RWORKSEXIT" 39 "SCHOOL" 40 "SECTION" 41 "SMOKE" 42 "SNOW" 43 "SOFTSHOULDERCAR" 44 "SHOFTSHOULDERLORRY" 45 "TEXT" 46 "TIME" 47 "TOWING" 48 "TRACTOR" 49 "TRACTOR_OVER" 50 "TRAILER" 51 "WEIGHT" 52 "WET" 53 "WITHIN" 54 "ZONE" 55 "EXIT" 56 "ACCESS" 57 "ALLWAY" 58 "EXCEPTBUS" 59 "EXCEPTDELIVERY" 60 "EXCEPTLOCAL" 61 "FROG" 62 "PRIOTURNL" 63 "PRIOTURNR" 64 "START" 65 "STOPIN" 66 "HAZWATER" 67 "DAY" 68 "SL" ;
VAL_ 240 VFC_TS02_AddTS3Quality 0 "Poor Quality" 1 "Good Quality" ;
VAL_ 240 VFC_TS02_AddTS3VMS 0 "Fixed" 1 "Variable" ;
VAL_ 240 VFC_TS02_AddTS4Class 0 "UNKNOWN" 1 "DETECTED" 2 "ACCIDENT" 3 "ADVICE" 4 "BEGINS" 5 "BUS" 6 "CAMPER" 7 "CAR" 8 "CARAVAN" 9 "CRASHRISK" 10 "DIRT" 11 "DISTANCE" 12 "DISTANCEBARS" 13 "END" 14 "EXITL" 15 "EXITR" 16 "FOG" 17 "GRAVEL" 18 "HAZMAT" 19 "HUMP" 20 "JAM" 21 "LORRY" 22 "EXCEPTLORRY" 23 "LOWTREE" 24 "MCYCLE" 25 "MINIMUM" 26 "NIGHT" 27 "NOSTOPSHOULDER" 28 "OILTRAIL" 29 "PRIOTURN" 30 "RADAR" 31 "RAIN" 32 "RAINSNOW" 33 "REMINDER" 34 "ROADDAMAGE" 35 "RUTS" 36 "RWORKSACCESS" 37 "RWORKSENTRY" 38 "RWORKSEXIT" 39 "SCHOOL" 40 "SECTION" 41 "SMOKE" 42 "SNOW" 43 "SOFTSHOULDERCAR" 44 "SHOFTSHOULDERLORRY" 45 "TEXT" 46 "TIME" 47 "TOWING" 48 "TRACTOR" 49 "TRACTOR_OVER" 50 "TRAILER" 51 "WEIGHT" 52 "WET" 53 "WITHIN" 54 "ZONE" 55 "EXIT" 56 "ACCESS" 57 "ALLWAY" 58 "EXCEPTBUS" 59 "EXCEPTDELIVERY" 60 "EXCEPTLOCAL" 61 "FROG" 62 "PRIOTURNL" 63 "PRIOTURNR" 64 "START" 65 "STOPIN" 66 "HAZWATER" 67 "DAY" 68 "SL" ;
VAL_ 240 VFC_TS02_AddTS4Quality 0 "Poor Quality" 1 "Good Quality" ;
VAL_ 240 VFC_TS02_AddTS4VMS 0 "Fixed" 1 "Variable" ;
VAL_ 240 VFC_TS02_AddTS5Class 0 "UNKNOWN" 1 "DETECTED" 2 "ACCIDENT" 3 "ADVICE" 4 "BEGINS" 5 "BUS" 6 "CAMPER" 7 "CAR" 8 "CARAVAN" 9 "CRASHRISK" 10 "DIRT" 11 "DISTANCE" 12 "DISTANCEBARS" 13 "END" 14 "EXITL" 15 "EXITR" 16 "FOG" 17 "GRAVEL" 18 "HAZMAT" 19 "HUMP" 20 "JAM" 21 "LORRY" 22 "EXCEPTLORRY" 23 "LOWTREE" 24 "MCYCLE" 25 "MINIMUM" 26 "NIGHT" 27 "NOSTOPSHOULDER" 28 "OILTRAIL" 29 "PRIOTURN" 30 "RADAR" 31 "RAIN" 32 "RAINSNOW" 33 "REMINDER" 34 "ROADDAMAGE" 35 "RUTS" 36 "RWORKSACCESS" 37 "RWORKSENTRY" 38 "RWORKSEXIT" 39 "SCHOOL" 40 "SECTION" 41 "SMOKE" 42 "SNOW" 43 "SOFTSHOULDERCAR" 44 "SHOFTSHOULDERLORRY" 45 "TEXT" 46 "TIME" 47 "TOWING" 48 "TRACTOR" 49 "TRACTOR_OVER" 50 "TRAILER" 51 "WEIGHT" 52 "WET" 53 "WITHIN" 54 "ZONE" 55 "EXIT" 56 "ACCESS" 57 "ALLWAY" 58 "EXCEPTBUS" 59 "EXCEPTDELIVERY" 60 "EXCEPTLOCAL" 61 "FROG" 62 "PRIOTURNL" 63 "PRIOTURNR" 64 "START" 65 "STOPIN" 66 "HAZWATER" 67 "DAY" 68 "SL" ;
VAL_ 240 VFC_TS02_AddTS5Quality 0 "Poor Quality" 1 "Good Quality" ;
VAL_ 240 VFC_TS02_AddTS5VMS 0 "Fixed" 1 "Variable" ;
VAL_ 240 VFC_TS02_AddTS6Class 0 "UNKNOWN" 1 "DETECTED" 2 "ACCIDENT" 3 "ADVICE" 4 "BEGINS" 5 "BUS" 6 "CAMPER" 7 "CAR" 8 "CARAVAN" 9 "CRASHRISK" 10 "DIRT" 11 "DISTANCE" 12 "DISTANCEBARS" 13 "END" 14 "EXITL" 15 "EXITR" 16 "FOG" 17 "GRAVEL" 18 "HAZMAT" 19 "HUMP" 20 "JAM" 21 "LORRY" 22 "EXCEPTLORRY" 23 "LOWTREE" 24 "MCYCLE" 25 "MINIMUM" 26 "NIGHT" 27 "NOSTOPSHOULDER" 28 "OILTRAIL" 29 "PRIOTURN" 30 "RADAR" 31 "RAIN" 32 "RAINSNOW" 33 "REMINDER" 34 "ROADDAMAGE" 35 "RUTS" 36 "RWORKSACCESS" 37 "RWORKSENTRY" 38 "RWORKSEXIT" 39 "SCHOOL" 40 "SECTION" 41 "SMOKE" 42 "SNOW" 43 "SOFTSHOULDERCAR" 44 "SHOFTSHOULDERLORRY" 45 "TEXT" 46 "TIME" 47 "TOWING" 48 "TRACTOR" 49 "TRACTOR_OVER" 50 "TRAILER" 51 "WEIGHT" 52 "WET" 53 "WITHIN" 54 "ZONE" 55 "EXIT" 56 "ACCESS" 57 "ALLWAY" 58 "EXCEPTBUS" 59 "EXCEPTDELIVERY" 60 "EXCEPTLOCAL" 61 "FROG" 62 "PRIOTURNL" 63 "PRIOTURNR" 64 "START" 65 "STOPIN" 66 "HAZWATER" 67 "DAY" 68 "SL" ;
VAL_ 240 VFC_TS02_AddTS6Quality 0 "Poor Quality" 1 "Good Quality" ;
VAL_ 240 VFC_TS02_AddTS6VMS 0 "Fixed" 1 "Variable" ;
VAL_ 241 VFC_TS03_ID 0 "INVALID" ;
VAL_ 241 VFC_TS03_Class 0 "UNKNOWN" 1 "SL5" 2 "SL10" 3 "SL15" 4 "SL20" 5 "SL25" 6 "SL30" 7 "SL35" 8 "SL40" 9 "SL45" 10 "SL50" 11 "SL55" 12 "SL60" 13 "SL65" 14 "SL70" 15 "SL75" 16 "SL80" 17 "SL85" 18 "SL90" 19 "SL95" 20 "SL100" 21 "SL105" 22 "SL110" 23 "SL115" 24 "SL120" 25 "SL125" 26 "SL130" 27 "SL135" 28 "SL140" 29 "SL145" 30 "SL150" 31 "SL155" 32 "SL160" 33 "ESL" 34 "EA" 35 "OP" 36 "EOP" 37 "OL" 38 "EOL" 39 "GIVEWAY" 40 "PRIOCROSS" 41 "PRIOCROSSYIELDTORIGHT" 42 "PRIOSTREET" 43 "EPRIOSTREET" 44 "STOP" 45 "AXLEWEIGHT" 46 "CARDIST" 47 "HEIGHT" 48 "LENGTH" 49 "LORRYDIST" 50 "NOALL" 51 "NOBIKE" 52 "NOBUS" 53 "NOCAR" 54 "NOCARBIKE" 55 "NOCARRIAGE" 56 "NOENTRY" 57 "NOHAZMAT" 58 "NOHAZWATER" 59 "NOLORRY" 60 "NOLORRYTRAILER" 61 "NOLTURN" 62 "NOPED" 63 "NORIDER" 64 "NORTURN" 65 "NOTRACTOR" 66 "NOTWOWAY" 67 "NOUTURN" 68 "UMWELT" 69 "EUMWELT" 70 "WEIGHT" 71 "WIDTH" 72 "WARNBIKE" 73 "WARNBUS" 74 "WARNCATTLE" 75 "WARNCONST" 76 "WARNCONSTL" 77 "WARNCONSTR" 78 "WARNCURVEL" 79 "WARNCURVER" 80 "WARNDANGER" 81 "WARNDCURVEL" 82 "WARNDCURVER" 83 "WARNDRAWBRIDGE" 84 "WARNFROG" 85 "WARNGRAVEL" 86 "WARNHUMP" 87 "WARNJAM" 88 "WARNKIDS" 89 "WARNLIGHTS" 90 "WARNLOWTREE" 91 "WARNPCROSS" 92 "WARNPED" 93 "WARNPIER" 94 "WARNPLANE" 95 "WARNRIDER" 96 "WARNROCK" 97 "WARNROUND" 98 "WARNRWORKS" 99 "WARNSKID" 100 "WARNSLOPED" 101 "WARNSLOPEU" 102 "WARNSNOW" 103 "WARNTRAIN" 104 "WARNTWOWAY" 105 "WARNWILDANIMAL" 106 "WARNWIND" 107 "ASL" 108 "EASL" 109 "CALM" 110 "ECALM" 111 "DEADEND" 112 "DOUANE" 113 "FWAY" 114 "EFWAY" 115 "HWAY" 116 "EHWAY" 117 "MSL" 118 "EMSL" 119 "NOPARK" 120 "NOSTOP" 121 "ONEWAYS" 122 "ONEWAYU" 123 "SLOWDOWN" 124 "SCHOOL" 125 "ESCHOOL" 126 "TWN" 127 "ETWN" 128 "WBBENTLEFT" 129 "WBBENTLEFTRIGHT" 130 "WBBENTRIGHT" 131 "WBDIAGL" 132 "WBDIAGLR" 133 "WBDIAGR" 134 "WBHAZWATER" 135 "WBLEFT" 136 "WBRIGHT" 137 "WBROUND" 138 "WBUP" 139 "WBUPLEFT" 140 "WBUPRIGHT" 141 "ZEBRA" 142 "HAZMAT" 143 "EMERGENCYBAY" 144 "ENDOFLANEL" 145 "ENDOFLANER" 146 "ENOPARK" 147 "EONEWAY" 148 "EPARK" 149 "ETOLL" 150 "NOPARKL" 151 "NOPARKLR" 152 "NOPARKR" 153 "NOSTOPL" 154 "NOSTOPLR" 155 "NOSTOPR" 156 "NOTURNONRED" 157 "ONEWAYL" 158 "ONEWAYR" 159 "PARK" 160 "PRIOCROSSL" 161 "PRIOCROSSR" 162 "TOLL" 163 "TUNNEL" 164 "TWOWAY" 165 "WARNCROSS" 166 "WARNCROSSL" 167 "WARNCROSSLR" 168 "WARNCROSSR" 169 "WARNCROSSRL" 170 "WARNCROSST" 171 "WARNGIVEWAYAHEAD" 172 "WARNSLAHEAD" 173 "WARNSTOPAHEAD" 174 "WBBUS" 175 "WRONGWAY" 176 "HAZWATER" 177 "GIVEWAYROUND" 178 "WARNWINDINGL" 179 "WARNWINDINGR" 180 "WARNHAIRPINL" 181 "WARNHAIRPINR" 182 "WARNPEDBIKE" 183 "WARNCROSSY" 184 "WARNBRANCHL" 185 "WARNBRANCHR" 186 "WARNAXLEWEIGHT" 187 "WARNWEIGHT" 188 "WARNHEIGHT" 189 "WARNLENGTH" 190 "WARNWIDTH" 191 "WARNBLACKSPOT" 192 "WARNMERGEL" 193 "WARNMERGER" 194 "WARNTUNNEL" 195 "WARNTRACTOR" 196 "WARNRWORKSVEHICLE" 197 "WARNNARROWBRIDGE" 198 "WARNFLAGGER" 199 "LANES" 200 "LANESHIFTL" 201 "LANESHIFTR" 202 "NEWLANEL" 203 "NEWLANER" 204 "RIGHTTURNONRED" 205 "BORDERLIMIT" 206 "EMBEDDEDRAIN" ;
VAL_ 241 VFC_TS03_EmbedFlag 0 "Unknown" 1 "Not Embedded" 2 "Border Limit" 3 "Multi Lane" 4 "Rain" 5 "Vehicle Type" 6 "Plate" 7 "Error Value" ;
VAL_ 241 VFC_TS03_Quality 0 "Poor Quality" 1 "Good Quality" ;
VAL_ 241 VFC_TS03_VMS 0 "Fixed" 1 "Variable" ;
VAL_ 241 VFC_TS03_Stable 0 "Object Is Not Stable" 1 "Object Is Stable" ;
VAL_ 241 VFC_TS03_VehicleSticker 0 "not_sticker_on_vehicle" 1 "Sign is a sticker on a vehicle" ;
VAL_ 241 VFC_TS03_InternalTrack 0 "Sign is not an internal track" 1 "Sign is an internal track" ;
VAL_ 241 VFC_TS03_AddTS1Class 0 "UNKNOWN" 1 "DETECTED" 2 "ACCIDENT" 3 "ADVICE" 4 "BEGINS" 5 "BUS" 6 "CAMPER" 7 "CAR" 8 "CARAVAN" 9 "CRASHRISK" 10 "DIRT" 11 "DISTANCE" 12 "DISTANCEBARS" 13 "END" 14 "EXITL" 15 "EXITR" 16 "FOG" 17 "GRAVEL" 18 "HAZMAT" 19 "HUMP" 20 "JAM" 21 "LORRY" 22 "EXCEPTLORRY" 23 "LOWTREE" 24 "MCYCLE" 25 "MINIMUM" 26 "NIGHT" 27 "NOSTOPSHOULDER" 28 "OILTRAIL" 29 "PRIOTURN" 30 "RADAR" 31 "RAIN" 32 "RAINSNOW" 33 "REMINDER" 34 "ROADDAMAGE" 35 "RUTS" 36 "RWORKSACCESS" 37 "RWORKSENTRY" 38 "RWORKSEXIT" 39 "SCHOOL" 40 "SECTION" 41 "SMOKE" 42 "SNOW" 43 "SOFTSHOULDERCAR" 44 "SHOFTSHOULDERLORRY" 45 "TEXT" 46 "TIME" 47 "TOWING" 48 "TRACTOR" 49 "TRACTOR_OVER" 50 "TRAILER" 51 "WEIGHT" 52 "WET" 53 "WITHIN" 54 "ZONE" 55 "EXIT" 56 "ACCESS" 57 "ALLWAY" 58 "EXCEPTBUS" 59 "EXCEPTDELIVERY" 60 "EXCEPTLOCAL" 61 "FROG" 62 "PRIOTURNL" 63 "PRIOTURNR" 64 "START" 65 "STOPIN" 66 "HAZWATER" 67 "DAY" 68 "SL" ;
VAL_ 241 VFC_TS03_AddTS1Quality 0 "Poor Quality" 1 "Good Quality" ;
VAL_ 241 VFC_TS03_AddTS1VMS 0 "Fixed" 1 "Variable" ;
VAL_ 241 VFC_TS03_AddTS2Class 0 "UNKNOWN" 1 "DETECTED" 2 "ACCIDENT" 3 "ADVICE" 4 "BEGINS" 5 "BUS" 6 "CAMPER" 7 "CAR" 8 "CARAVAN" 9 "CRASHRISK" 10 "DIRT" 11 "DISTANCE" 12 "DISTANCEBARS" 13 "END" 14 "EXITL" 15 "EXITR" 16 "FOG" 17 "GRAVEL" 18 "HAZMAT" 19 "HUMP" 20 "JAM" 21 "LORRY" 22 "EXCEPTLORRY" 23 "LOWTREE" 24 "MCYCLE" 25 "MINIMUM" 26 "NIGHT" 27 "NOSTOPSHOULDER" 28 "OILTRAIL" 29 "PRIOTURN" 30 "RADAR" 31 "RAIN" 32 "RAINSNOW" 33 "REMINDER" 34 "ROADDAMAGE" 35 "RUTS" 36 "RWORKSACCESS" 37 "RWORKSENTRY" 38 "RWORKSEXIT" 39 "SCHOOL" 40 "SECTION" 41 "SMOKE" 42 "SNOW" 43 "SOFTSHOULDERCAR" 44 "SHOFTSHOULDERLORRY" 45 "TEXT" 46 "TIME" 47 "TOWING" 48 "TRACTOR" 49 "TRACTOR_OVER" 50 "TRAILER" 51 "WEIGHT" 52 "WET" 53 "WITHIN" 54 "ZONE" 55 "EXIT" 56 "ACCESS" 57 "ALLWAY" 58 "EXCEPTBUS" 59 "EXCEPTDELIVERY" 60 "EXCEPTLOCAL" 61 "FROG" 62 "PRIOTURNL" 63 "PRIOTURNR" 64 "START" 65 "STOPIN" 66 "HAZWATER" 67 "DAY" 68 "SL" ;
VAL_ 241 VFC_TS03_AddTS2Quality 0 "Poor Quality" 1 "Good Quality" ;
VAL_ 241 VFC_TS03_AddTS2VMS 0 "Fixed" 1 "Variable" ;
VAL_ 241 VFC_TS03_AddTS3Class 0 "UNKNOWN" 1 "DETECTED" 2 "ACCIDENT" 3 "ADVICE" 4 "BEGINS" 5 "BUS" 6 "CAMPER" 7 "CAR" 8 "CARAVAN" 9 "CRASHRISK" 10 "DIRT" 11 "DISTANCE" 12 "DISTANCEBARS" 13 "END" 14 "EXITL" 15 "EXITR" 16 "FOG" 17 "GRAVEL" 18 "HAZMAT" 19 "HUMP" 20 "JAM" 21 "LORRY" 22 "EXCEPTLORRY" 23 "LOWTREE" 24 "MCYCLE" 25 "MINIMUM" 26 "NIGHT" 27 "NOSTOPSHOULDER" 28 "OILTRAIL" 29 "PRIOTURN" 30 "RADAR" 31 "RAIN" 32 "RAINSNOW" 33 "REMINDER" 34 "ROADDAMAGE" 35 "RUTS" 36 "RWORKSACCESS" 37 "RWORKSENTRY" 38 "RWORKSEXIT" 39 "SCHOOL" 40 "SECTION" 41 "SMOKE" 42 "SNOW" 43 "SOFTSHOULDERCAR" 44 "SHOFTSHOULDERLORRY" 45 "TEXT" 46 "TIME" 47 "TOWING" 48 "TRACTOR" 49 "TRACTOR_OVER" 50 "TRAILER" 51 "WEIGHT" 52 "WET" 53 "WITHIN" 54 "ZONE" 55 "EXIT" 56 "ACCESS" 57 "ALLWAY" 58 "EXCEPTBUS" 59 "EXCEPTDELIVERY" 60 "EXCEPTLOCAL" 61 "FROG" 62 "PRIOTURNL" 63 "PRIOTURNR" 64 "START" 65 "STOPIN" 66 "HAZWATER" 67 "DAY" 68 "SL" ;
VAL_ 241 VFC_TS03_AddTS3Quality 0 "Poor Quality" 1 "Good Quality" ;
VAL_ 241 VFC_TS03_AddTS3VMS 0 "Fixed" 1 "Variable" ;
VAL_ 241 VFC_TS03_AddTS4Class 0 "UNKNOWN" 1 "DETECTED" 2 "ACCIDENT" 3 "ADVICE" 4 "BEGINS" 5 "BUS" 6 "CAMPER" 7 "CAR" 8 "CARAVAN" 9 "CRASHRISK" 10 "DIRT" 11 "DISTANCE" 12 "DISTANCEBARS" 13 "END" 14 "EXITL" 15 "EXITR" 16 "FOG" 17 "GRAVEL" 18 "HAZMAT" 19 "HUMP" 20 "JAM" 21 "LORRY" 22 "EXCEPTLORRY" 23 "LOWTREE" 24 "MCYCLE" 25 "MINIMUM" 26 "NIGHT" 27 "NOSTOPSHOULDER" 28 "OILTRAIL" 29 "PRIOTURN" 30 "RADAR" 31 "RAIN" 32 "RAINSNOW" 33 "REMINDER" 34 "ROADDAMAGE" 35 "RUTS" 36 "RWORKSACCESS" 37 "RWORKSENTRY" 38 "RWORKSEXIT" 39 "SCHOOL" 40 "SECTION" 41 "SMOKE" 42 "SNOW" 43 "SOFTSHOULDERCAR" 44 "SHOFTSHOULDERLORRY" 45 "TEXT" 46 "TIME" 47 "TOWING" 48 "TRACTOR" 49 "TRACTOR_OVER" 50 "TRAILER" 51 "WEIGHT" 52 "WET" 53 "WITHIN" 54 "ZONE" 55 "EXIT" 56 "ACCESS" 57 "ALLWAY" 58 "EXCEPTBUS" 59 "EXCEPTDELIVERY" 60 "EXCEPTLOCAL" 61 "FROG" 62 "PRIOTURNL" 63 "PRIOTURNR" 64 "START" 65 "STOPIN" 66 "HAZWATER" 67 "DAY" 68 "SL" ;
VAL_ 241 VFC_TS03_AddTS4Quality 0 "Poor Quality" 1 "Good Quality" ;
VAL_ 241 VFC_TS03_AddTS4VMS 0 "Fixed" 1 "Variable" ;
VAL_ 241 VFC_TS03_AddTS5Class 0 "UNKNOWN" 1 "DETECTED" 2 "ACCIDENT" 3 "ADVICE" 4 "BEGINS" 5 "BUS" 6 "CAMPER" 7 "CAR" 8 "CARAVAN" 9 "CRASHRISK" 10 "DIRT" 11 "DISTANCE" 12 "DISTANCEBARS" 13 "END" 14 "EXITL" 15 "EXITR" 16 "FOG" 17 "GRAVEL" 18 "HAZMAT" 19 "HUMP" 20 "JAM" 21 "LORRY" 22 "EXCEPTLORRY" 23 "LOWTREE" 24 "MCYCLE" 25 "MINIMUM" 26 "NIGHT" 27 "NOSTOPSHOULDER" 28 "OILTRAIL" 29 "PRIOTURN" 30 "RADAR" 31 "RAIN" 32 "RAINSNOW" 33 "REMINDER" 34 "ROADDAMAGE" 35 "RUTS" 36 "RWORKSACCESS" 37 "RWORKSENTRY" 38 "RWORKSEXIT" 39 "SCHOOL" 40 "SECTION" 41 "SMOKE" 42 "SNOW" 43 "SOFTSHOULDERCAR" 44 "SHOFTSHOULDERLORRY" 45 "TEXT" 46 "TIME" 47 "TOWING" 48 "TRACTOR" 49 "TRACTOR_OVER" 50 "TRAILER" 51 "WEIGHT" 52 "WET" 53 "WITHIN" 54 "ZONE" 55 "EXIT" 56 "ACCESS" 57 "ALLWAY" 58 "EXCEPTBUS" 59 "EXCEPTDELIVERY" 60 "EXCEPTLOCAL" 61 "FROG" 62 "PRIOTURNL" 63 "PRIOTURNR" 64 "START" 65 "STOPIN" 66 "HAZWATER" 67 "DAY" 68 "SL" ;
VAL_ 241 VFC_TS03_AddTS5Quality 0 "Poor Quality" 1 "Good Quality" ;
VAL_ 241 VFC_TS03_AddTS5VMS 0 "Fixed" 1 "Variable" ;
VAL_ 241 VFC_TS03_AddTS6Class 0 "UNKNOWN" 1 "DETECTED" 2 "ACCIDENT" 3 "ADVICE" 4 "BEGINS" 5 "BUS" 6 "CAMPER" 7 "CAR" 8 "CARAVAN" 9 "CRASHRISK" 10 "DIRT" 11 "DISTANCE" 12 "DISTANCEBARS" 13 "END" 14 "EXITL" 15 "EXITR" 16 "FOG" 17 "GRAVEL" 18 "HAZMAT" 19 "HUMP" 20 "JAM" 21 "LORRY" 22 "EXCEPTLORRY" 23 "LOWTREE" 24 "MCYCLE" 25 "MINIMUM" 26 "NIGHT" 27 "NOSTOPSHOULDER" 28 "OILTRAIL" 29 "PRIOTURN" 30 "RADAR" 31 "RAIN" 32 "RAINSNOW" 33 "REMINDER" 34 "ROADDAMAGE" 35 "RUTS" 36 "RWORKSACCESS" 37 "RWORKSENTRY" 38 "RWORKSEXIT" 39 "SCHOOL" 40 "SECTION" 41 "SMOKE" 42 "SNOW" 43 "SOFTSHOULDERCAR" 44 "SHOFTSHOULDERLORRY" 45 "TEXT" 46 "TIME" 47 "TOWING" 48 "TRACTOR" 49 "TRACTOR_OVER" 50 "TRAILER" 51 "WEIGHT" 52 "WET" 53 "WITHIN" 54 "ZONE" 55 "EXIT" 56 "ACCESS" 57 "ALLWAY" 58 "EXCEPTBUS" 59 "EXCEPTDELIVERY" 60 "EXCEPTLOCAL" 61 "FROG" 62 "PRIOTURNL" 63 "PRIOTURNR" 64 "START" 65 "STOPIN" 66 "HAZWATER" 67 "DAY" 68 "SL" ;
VAL_ 241 VFC_TS03_AddTS6Quality 0 "Poor Quality" 1 "Good Quality" ;
VAL_ 241 VFC_TS03_AddTS6VMS 0 "Fixed" 1 "Variable" ;
VAL_ 242 VFC_TS04_ID 0 "INVALID" ;
VAL_ 242 VFC_TS04_Class 0 "UNKNOWN" 1 "SL5" 2 "SL10" 3 "SL15" 4 "SL20" 5 "SL25" 6 "SL30" 7 "SL35" 8 "SL40" 9 "SL45" 10 "SL50" 11 "SL55" 12 "SL60" 13 "SL65" 14 "SL70" 15 "SL75" 16 "SL80" 17 "SL85" 18 "SL90" 19 "SL95" 20 "SL100" 21 "SL105" 22 "SL110" 23 "SL115" 24 "SL120" 25 "SL125" 26 "SL130" 27 "SL135" 28 "SL140" 29 "SL145" 30 "SL150" 31 "SL155" 32 "SL160" 33 "ESL" 34 "EA" 35 "OP" 36 "EOP" 37 "OL" 38 "EOL" 39 "GIVEWAY" 40 "PRIOCROSS" 41 "PRIOCROSSYIELDTORIGHT" 42 "PRIOSTREET" 43 "EPRIOSTREET" 44 "STOP" 45 "AXLEWEIGHT" 46 "CARDIST" 47 "HEIGHT" 48 "LENGTH" 49 "LORRYDIST" 50 "NOALL" 51 "NOBIKE" 52 "NOBUS" 53 "NOCAR" 54 "NOCARBIKE" 55 "NOCARRIAGE" 56 "NOENTRY" 57 "NOHAZMAT" 58 "NOHAZWATER" 59 "NOLORRY" 60 "NOLORRYTRAILER" 61 "NOLTURN" 62 "NOPED" 63 "NORIDER" 64 "NORTURN" 65 "NOTRACTOR" 66 "NOTWOWAY" 67 "NOUTURN" 68 "UMWELT" 69 "EUMWELT" 70 "WEIGHT" 71 "WIDTH" 72 "WARNBIKE" 73 "WARNBUS" 74 "WARNCATTLE" 75 "WARNCONST" 76 "WARNCONSTL" 77 "WARNCONSTR" 78 "WARNCURVEL" 79 "WARNCURVER" 80 "WARNDANGER" 81 "WARNDCURVEL" 82 "WARNDCURVER" 83 "WARNDRAWBRIDGE" 84 "WARNFROG" 85 "WARNGRAVEL" 86 "WARNHUMP" 87 "WARNJAM" 88 "WARNKIDS" 89 "WARNLIGHTS" 90 "WARNLOWTREE" 91 "WARNPCROSS" 92 "WARNPED" 93 "WARNPIER" 94 "WARNPLANE" 95 "WARNRIDER" 96 "WARNROCK" 97 "WARNROUND" 98 "WARNRWORKS" 99 "WARNSKID" 100 "WARNSLOPED" 101 "WARNSLOPEU" 102 "WARNSNOW" 103 "WARNTRAIN" 104 "WARNTWOWAY" 105 "WARNWILDANIMAL" 106 "WARNWIND" 107 "ASL" 108 "EASL" 109 "CALM" 110 "ECALM" 111 "DEADEND" 112 "DOUANE" 113 "FWAY" 114 "EFWAY" 115 "HWAY" 116 "EHWAY" 117 "MSL" 118 "EMSL" 119 "NOPARK" 120 "NOSTOP" 121 "ONEWAYS" 122 "ONEWAYU" 123 "SLOWDOWN" 124 "SCHOOL" 125 "ESCHOOL" 126 "TWN" 127 "ETWN" 128 "WBBENTLEFT" 129 "WBBENTLEFTRIGHT" 130 "WBBENTRIGHT" 131 "WBDIAGL" 132 "WBDIAGLR" 133 "WBDIAGR" 134 "WBHAZWATER" 135 "WBLEFT" 136 "WBRIGHT" 137 "WBROUND" 138 "WBUP" 139 "WBUPLEFT" 140 "WBUPRIGHT" 141 "ZEBRA" 142 "HAZMAT" 143 "EMERGENCYBAY" 144 "ENDOFLANEL" 145 "ENDOFLANER" 146 "ENOPARK" 147 "EONEWAY" 148 "EPARK" 149 "ETOLL" 150 "NOPARKL" 151 "NOPARKLR" 152 "NOPARKR" 153 "NOSTOPL" 154 "NOSTOPLR" 155 "NOSTOPR" 156 "NOTURNONRED" 157 "ONEWAYL" 158 "ONEWAYR" 159 "PARK" 160 "PRIOCROSSL" 161 "PRIOCROSSR" 162 "TOLL" 163 "TUNNEL" 164 "TWOWAY" 165 "WARNCROSS" 166 "WARNCROSSL" 167 "WARNCROSSLR" 168 "WARNCROSSR" 169 "WARNCROSSRL" 170 "WARNCROSST" 171 "WARNGIVEWAYAHEAD" 172 "WARNSLAHEAD" 173 "WARNSTOPAHEAD" 174 "WBBUS" 175 "WRONGWAY" 176 "HAZWATER" 177 "GIVEWAYROUND" 178 "WARNWINDINGL" 179 "WARNWINDINGR" 180 "WARNHAIRPINL" 181 "WARNHAIRPINR" 182 "WARNPEDBIKE" 183 "WARNCROSSY" 184 "WARNBRANCHL" 185 "WARNBRANCHR" 186 "WARNAXLEWEIGHT" 187 "WARNWEIGHT" 188 "WARNHEIGHT" 189 "WARNLENGTH" 190 "WARNWIDTH" 191 "WARNBLACKSPOT" 192 "WARNMERGEL" 193 "WARNMERGER" 194 "WARNTUNNEL" 195 "WARNTRACTOR" 196 "WARNRWORKSVEHICLE" 197 "WARNNARROWBRIDGE" 198 "WARNFLAGGER" 199 "LANES" 200 "LANESHIFTL" 201 "LANESHIFTR" 202 "NEWLANEL" 203 "NEWLANER" 204 "RIGHTTURNONRED" 205 "BORDERLIMIT" 206 "EMBEDDEDRAIN" ;
VAL_ 242 VFC_TS04_EmbedFlag 0 "Unknown" 1 "Not Embedded" 2 "Border Limit" 3 "Multi Lane" 4 "Rain" 5 "Vehicle Type" 6 "Plate" 7 "Error Value" ;
VAL_ 242 VFC_TS04_Quality 0 "Poor Quality" 1 "Good Quality" ;
VAL_ 242 VFC_TS04_VMS 0 "Fixed" 1 "Variable" ;
VAL_ 242 VFC_TS04_Stable 0 "Object Is Not Stable" 1 "Object Is Stable" ;
VAL_ 242 VFC_TS04_VehicleSticker 0 "not_sticker_on_vehicle" 1 "Sign is a sticker on a vehicle" ;
VAL_ 242 VFC_TS04_InternalTrack 0 "Sign is not an internal track" 1 "Sign is an internal track" ;
VAL_ 242 VFC_TS04_AddTS1Class 0 "UNKNOWN" 1 "DETECTED" 2 "ACCIDENT" 3 "ADVICE" 4 "BEGINS" 5 "BUS" 6 "CAMPER" 7 "CAR" 8 "CARAVAN" 9 "CRASHRISK" 10 "DIRT" 11 "DISTANCE" 12 "DISTANCEBARS" 13 "END" 14 "EXITL" 15 "EXITR" 16 "FOG" 17 "GRAVEL" 18 "HAZMAT" 19 "HUMP" 20 "JAM" 21 "LORRY" 22 "EXCEPTLORRY" 23 "LOWTREE" 24 "MCYCLE" 25 "MINIMUM" 26 "NIGHT" 27 "NOSTOPSHOULDER" 28 "OILTRAIL" 29 "PRIOTURN" 30 "RADAR" 31 "RAIN" 32 "RAINSNOW" 33 "REMINDER" 34 "ROADDAMAGE" 35 "RUTS" 36 "RWORKSACCESS" 37 "RWORKSENTRY" 38 "RWORKSEXIT" 39 "SCHOOL" 40 "SECTION" 41 "SMOKE" 42 "SNOW" 43 "SOFTSHOULDERCAR" 44 "SHOFTSHOULDERLORRY" 45 "TEXT" 46 "TIME" 47 "TOWING" 48 "TRACTOR" 49 "TRACTOR_OVER" 50 "TRAILER" 51 "WEIGHT" 52 "WET" 53 "WITHIN" 54 "ZONE" 55 "EXIT" 56 "ACCESS" 57 "ALLWAY" 58 "EXCEPTBUS" 59 "EXCEPTDELIVERY" 60 "EXCEPTLOCAL" 61 "FROG" 62 "PRIOTURNL" 63 "PRIOTURNR" 64 "START" 65 "STOPIN" 66 "HAZWATER" 67 "DAY" 68 "SL" ;
VAL_ 242 VFC_TS04_AddTS1Quality 0 "Poor Quality" 1 "Good Quality" ;
VAL_ 242 VFC_TS04_AddTS1VMS 0 "Fixed" 1 "Variable" ;
VAL_ 242 VFC_TS04_AddTS2Class 0 "UNKNOWN" 1 "DETECTED" 2 "ACCIDENT" 3 "ADVICE" 4 "BEGINS" 5 "BUS" 6 "CAMPER" 7 "CAR" 8 "CARAVAN" 9 "CRASHRISK" 10 "DIRT" 11 "DISTANCE" 12 "DISTANCEBARS" 13 "END" 14 "EXITL" 15 "EXITR" 16 "FOG" 17 "GRAVEL" 18 "HAZMAT" 19 "HUMP" 20 "JAM" 21 "LORRY" 22 "EXCEPTLORRY" 23 "LOWTREE" 24 "MCYCLE" 25 "MINIMUM" 26 "NIGHT" 27 "NOSTOPSHOULDER" 28 "OILTRAIL" 29 "PRIOTURN" 30 "RADAR" 31 "RAIN" 32 "RAINSNOW" 33 "REMINDER" 34 "ROADDAMAGE" 35 "RUTS" 36 "RWORKSACCESS" 37 "RWORKSENTRY" 38 "RWORKSEXIT" 39 "SCHOOL" 40 "SECTION" 41 "SMOKE" 42 "SNOW" 43 "SOFTSHOULDERCAR" 44 "SHOFTSHOULDERLORRY" 45 "TEXT" 46 "TIME" 47 "TOWING" 48 "TRACTOR" 49 "TRACTOR_OVER" 50 "TRAILER" 51 "WEIGHT" 52 "WET" 53 "WITHIN" 54 "ZONE" 55 "EXIT" 56 "ACCESS" 57 "ALLWAY" 58 "EXCEPTBUS" 59 "EXCEPTDELIVERY" 60 "EXCEPTLOCAL" 61 "FROG" 62 "PRIOTURNL" 63 "PRIOTURNR" 64 "START" 65 "STOPIN" 66 "HAZWATER" 67 "DAY" 68 "SL" ;
VAL_ 242 VFC_TS04_AddTS2Quality 0 "Poor Quality" 1 "Good Quality" ;
VAL_ 242 VFC_TS04_AddTS2VMS 0 "Fixed" 1 "Variable" ;
VAL_ 242 VFC_TS04_AddTS3Class 0 "UNKNOWN" 1 "DETECTED" 2 "ACCIDENT" 3 "ADVICE" 4 "BEGINS" 5 "BUS" 6 "CAMPER" 7 "CAR" 8 "CARAVAN" 9 "CRASHRISK" 10 "DIRT" 11 "DISTANCE" 12 "DISTANCEBARS" 13 "END" 14 "EXITL" 15 "EXITR" 16 "FOG" 17 "GRAVEL" 18 "HAZMAT" 19 "HUMP" 20 "JAM" 21 "LORRY" 22 "EXCEPTLORRY" 23 "LOWTREE" 24 "MCYCLE" 25 "MINIMUM" 26 "NIGHT" 27 "NOSTOPSHOULDER" 28 "OILTRAIL" 29 "PRIOTURN" 30 "RADAR" 31 "RAIN" 32 "RAINSNOW" 33 "REMINDER" 34 "ROADDAMAGE" 35 "RUTS" 36 "RWORKSACCESS" 37 "RWORKSENTRY" 38 "RWORKSEXIT" 39 "SCHOOL" 40 "SECTION" 41 "SMOKE" 42 "SNOW" 43 "SOFTSHOULDERCAR" 44 "SHOFTSHOULDERLORRY" 45 "TEXT" 46 "TIME" 47 "TOWING" 48 "TRACTOR" 49 "TRACTOR_OVER" 50 "TRAILER" 51 "WEIGHT" 52 "WET" 53 "WITHIN" 54 "ZONE" 55 "EXIT" 56 "ACCESS" 57 "ALLWAY" 58 "EXCEPTBUS" 59 "EXCEPTDELIVERY" 60 "EXCEPTLOCAL" 61 "FROG" 62 "PRIOTURNL" 63 "PRIOTURNR" 64 "START" 65 "STOPIN" 66 "HAZWATER" 67 "DAY" 68 "SL" ;
VAL_ 242 VFC_TS04_AddTS3Quality 0 "Poor Quality" 1 "Good Quality" ;
VAL_ 242 VFC_TS04_AddTS3VMS 0 "Fixed" 1 "Variable" ;
VAL_ 242 VFC_TS04_AddTS4Class 0 "UNKNOWN" 1 "DETECTED" 2 "ACCIDENT" 3 "ADVICE" 4 "BEGINS" 5 "BUS" 6 "CAMPER" 7 "CAR" 8 "CARAVAN" 9 "CRASHRISK" 10 "DIRT" 11 "DISTANCE" 12 "DISTANCEBARS" 13 "END" 14 "EXITL" 15 "EXITR" 16 "FOG" 17 "GRAVEL" 18 "HAZMAT" 19 "HUMP" 20 "JAM" 21 "LORRY" 22 "EXCEPTLORRY" 23 "LOWTREE" 24 "MCYCLE" 25 "MINIMUM" 26 "NIGHT" 27 "NOSTOPSHOULDER" 28 "OILTRAIL" 29 "PRIOTURN" 30 "RADAR" 31 "RAIN" 32 "RAINSNOW" 33 "REMINDER" 34 "ROADDAMAGE" 35 "RUTS" 36 "RWORKSACCESS" 37 "RWORKSENTRY" 38 "RWORKSEXIT" 39 "SCHOOL" 40 "SECTION" 41 "SMOKE" 42 "SNOW" 43 "SOFTSHOULDERCAR" 44 "SHOFTSHOULDERLORRY" 45 "TEXT" 46 "TIME" 47 "TOWING" 48 "TRACTOR" 49 "TRACTOR_OVER" 50 "TRAILER" 51 "WEIGHT" 52 "WET" 53 "WITHIN" 54 "ZONE" 55 "EXIT" 56 "ACCESS" 57 "ALLWAY" 58 "EXCEPTBUS" 59 "EXCEPTDELIVERY" 60 "EXCEPTLOCAL" 61 "FROG" 62 "PRIOTURNL" 63 "PRIOTURNR" 64 "START" 65 "STOPIN" 66 "HAZWATER" 67 "DAY" 68 "SL" ;
VAL_ 242 VFC_TS04_AddTS4Quality 0 "Poor Quality" 1 "Good Quality" ;
VAL_ 242 VFC_TS04_AddTS4VMS 0 "Fixed" 1 "Variable" ;
VAL_ 242 VFC_TS04_AddTS5Class 0 "UNKNOWN" 1 "DETECTED" 2 "ACCIDENT" 3 "ADVICE" 4 "BEGINS" 5 "BUS" 6 "CAMPER" 7 "CAR" 8 "CARAVAN" 9 "CRASHRISK" 10 "DIRT" 11 "DISTANCE" 12 "DISTANCEBARS" 13 "END" 14 "EXITL" 15 "EXITR" 16 "FOG" 17 "GRAVEL" 18 "HAZMAT" 19 "HUMP" 20 "JAM" 21 "LORRY" 22 "EXCEPTLORRY" 23 "LOWTREE" 24 "MCYCLE" 25 "MINIMUM" 26 "NIGHT" 27 "NOSTOPSHOULDER" 28 "OILTRAIL" 29 "PRIOTURN" 30 "RADAR" 31 "RAIN" 32 "RAINSNOW" 33 "REMINDER" 34 "ROADDAMAGE" 35 "RUTS" 36 "RWORKSACCESS" 37 "RWORKSENTRY" 38 "RWORKSEXIT" 39 "SCHOOL" 40 "SECTION" 41 "SMOKE" 42 "SNOW" 43 "SOFTSHOULDERCAR" 44 "SHOFTSHOULDERLORRY" 45 "TEXT" 46 "TIME" 47 "TOWING" 48 "TRACTOR" 49 "TRACTOR_OVER" 50 "TRAILER" 51 "WEIGHT" 52 "WET" 53 "WITHIN" 54 "ZONE" 55 "EXIT" 56 "ACCESS" 57 "ALLWAY" 58 "EXCEPTBUS" 59 "EXCEPTDELIVERY" 60 "EXCEPTLOCAL" 61 "FROG" 62 "PRIOTURNL" 63 "PRIOTURNR" 64 "START" 65 "STOPIN" 66 "HAZWATER" 67 "DAY" 68 "SL" ;
VAL_ 242 VFC_TS04_AddTS5Quality 0 "Poor Quality" 1 "Good Quality" ;
VAL_ 242 VFC_TS04_AddTS5VMS 0 "Fixed" 1 "Variable" ;
VAL_ 242 VFC_TS04_AddTS6Class 0 "UNKNOWN" 1 "DETECTED" 2 "ACCIDENT" 3 "ADVICE" 4 "BEGINS" 5 "BUS" 6 "CAMPER" 7 "CAR" 8 "CARAVAN" 9 "CRASHRISK" 10 "DIRT" 11 "DISTANCE" 12 "DISTANCEBARS" 13 "END" 14 "EXITL" 15 "EXITR" 16 "FOG" 17 "GRAVEL" 18 "HAZMAT" 19 "HUMP" 20 "JAM" 21 "LORRY" 22 "EXCEPTLORRY" 23 "LOWTREE" 24 "MCYCLE" 25 "MINIMUM" 26 "NIGHT" 27 "NOSTOPSHOULDER" 28 "OILTRAIL" 29 "PRIOTURN" 30 "RADAR" 31 "RAIN" 32 "RAINSNOW" 33 "REMINDER" 34 "ROADDAMAGE" 35 "RUTS" 36 "RWORKSACCESS" 37 "RWORKSENTRY" 38 "RWORKSEXIT" 39 "SCHOOL" 40 "SECTION" 41 "SMOKE" 42 "SNOW" 43 "SOFTSHOULDERCAR" 44 "SHOFTSHOULDERLORRY" 45 "TEXT" 46 "TIME" 47 "TOWING" 48 "TRACTOR" 49 "TRACTOR_OVER" 50 "TRAILER" 51 "WEIGHT" 52 "WET" 53 "WITHIN" 54 "ZONE" 55 "EXIT" 56 "ACCESS" 57 "ALLWAY" 58 "EXCEPTBUS" 59 "EXCEPTDELIVERY" 60 "EXCEPTLOCAL" 61 "FROG" 62 "PRIOTURNL" 63 "PRIOTURNR" 64 "START" 65 "STOPIN" 66 "HAZWATER" 67 "DAY" 68 "SL" ;
VAL_ 242 VFC_TS04_AddTS6Quality 0 "Poor Quality" 1 "Good Quality" ;
VAL_ 242 VFC_TS04_AddTS6VMS 0 "Fixed" 1 "Variable" ;
VAL_ 243 VFC_TS05_ID 0 "INVALID" ;
VAL_ 243 VFC_TS05_Class 0 "UNKNOWN" 1 "SL5" 2 "SL10" 3 "SL15" 4 "SL20" 5 "SL25" 6 "SL30" 7 "SL35" 8 "SL40" 9 "SL45" 10 "SL50" 11 "SL55" 12 "SL60" 13 "SL65" 14 "SL70" 15 "SL75" 16 "SL80" 17 "SL85" 18 "SL90" 19 "SL95" 20 "SL100" 21 "SL105" 22 "SL110" 23 "SL115" 24 "SL120" 25 "SL125" 26 "SL130" 27 "SL135" 28 "SL140" 29 "SL145" 30 "SL150" 31 "SL155" 32 "SL160" 33 "ESL" 34 "EA" 35 "OP" 36 "EOP" 37 "OL" 38 "EOL" 39 "GIVEWAY" 40 "PRIOCROSS" 41 "PRIOCROSSYIELDTORIGHT" 42 "PRIOSTREET" 43 "EPRIOSTREET" 44 "STOP" 45 "AXLEWEIGHT" 46 "CARDIST" 47 "HEIGHT" 48 "LENGTH" 49 "LORRYDIST" 50 "NOALL" 51 "NOBIKE" 52 "NOBUS" 53 "NOCAR" 54 "NOCARBIKE" 55 "NOCARRIAGE" 56 "NOENTRY" 57 "NOHAZMAT" 58 "NOHAZWATER" 59 "NOLORRY" 60 "NOLORRYTRAILER" 61 "NOLTURN" 62 "NOPED" 63 "NORIDER" 64 "NORTURN" 65 "NOTRACTOR" 66 "NOTWOWAY" 67 "NOUTURN" 68 "UMWELT" 69 "EUMWELT" 70 "WEIGHT" 71 "WIDTH" 72 "WARNBIKE" 73 "WARNBUS" 74 "WARNCATTLE" 75 "WARNCONST" 76 "WARNCONSTL" 77 "WARNCONSTR" 78 "WARNCURVEL" 79 "WARNCURVER" 80 "WARNDANGER" 81 "WARNDCURVEL" 82 "WARNDCURVER" 83 "WARNDRAWBRIDGE" 84 "WARNFROG" 85 "WARNGRAVEL" 86 "WARNHUMP" 87 "WARNJAM" 88 "WARNKIDS" 89 "WARNLIGHTS" 90 "WARNLOWTREE" 91 "WARNPCROSS" 92 "WARNPED" 93 "WARNPIER" 94 "WARNPLANE" 95 "WARNRIDER" 96 "WARNROCK" 97 "WARNROUND" 98 "WARNRWORKS" 99 "WARNSKID" 100 "WARNSLOPED" 101 "WARNSLOPEU" 102 "WARNSNOW" 103 "WARNTRAIN" 104 "WARNTWOWAY" 105 "WARNWILDANIMAL" 106 "WARNWIND" 107 "ASL" 108 "EASL" 109 "CALM" 110 "ECALM" 111 "DEADEND" 112 "DOUANE" 113 "FWAY" 114 "EFWAY" 115 "HWAY" 116 "EHWAY" 117 "MSL" 118 "EMSL" 119 "NOPARK" 120 "NOSTOP" 121 "ONEWAYS" 122 "ONEWAYU" 123 "SLOWDOWN" 124 "SCHOOL" 125 "ESCHOOL" 126 "TWN" 127 "ETWN" 128 "WBBENTLEFT" 129 "WBBENTLEFTRIGHT" 130 "WBBENTRIGHT" 131 "WBDIAGL" 132 "WBDIAGLR" 133 "WBDIAGR" 134 "WBHAZWATER" 135 "WBLEFT" 136 "WBRIGHT" 137 "WBROUND" 138 "WBUP" 139 "WBUPLEFT" 140 "WBUPRIGHT" 141 "ZEBRA" 142 "HAZMAT" 143 "EMERGENCYBAY" 144 "ENDOFLANEL" 145 "ENDOFLANER" 146 "ENOPARK" 147 "EONEWAY" 148 "EPARK" 149 "ETOLL" 150 "NOPARKL" 151 "NOPARKLR" 152 "NOPARKR" 153 "NOSTOPL" 154 "NOSTOPLR" 155 "NOSTOPR" 156 "NOTURNONRED" 157 "ONEWAYL" 158 "ONEWAYR" 159 "PARK" 160 "PRIOCROSSL" 161 "PRIOCROSSR" 162 "TOLL" 163 "TUNNEL" 164 "TWOWAY" 165 "WARNCROSS" 166 "WARNCROSSL" 167 "WARNCROSSLR" 168 "WARNCROSSR" 169 "WARNCROSSRL" 170 "WARNCROSST" 171 "WARNGIVEWAYAHEAD" 172 "WARNSLAHEAD" 173 "WARNSTOPAHEAD" 174 "WBBUS" 175 "WRONGWAY" 176 "HAZWATER" 177 "GIVEWAYROUND" 178 "WARNWINDINGL" 179 "WARNWINDINGR" 180 "WARNHAIRPINL" 181 "WARNHAIRPINR" 182 "WARNPEDBIKE" 183 "WARNCROSSY" 184 "WARNBRANCHL" 185 "WARNBRANCHR" 186 "WARNAXLEWEIGHT" 187 "WARNWEIGHT" 188 "WARNHEIGHT" 189 "WARNLENGTH" 190 "WARNWIDTH" 191 "WARNBLACKSPOT" 192 "WARNMERGEL" 193 "WARNMERGER" 194 "WARNTUNNEL" 195 "WARNTRACTOR" 196 "WARNRWORKSVEHICLE" 197 "WARNNARROWBRIDGE" 198 "WARNFLAGGER" 199 "LANES" 200 "LANESHIFTL" 201 "LANESHIFTR" 202 "NEWLANEL" 203 "NEWLANER" 204 "RIGHTTURNONRED" 205 "BORDERLIMIT" 206 "EMBEDDEDRAIN" ;
VAL_ 243 VFC_TS05_EmbedFlag 0 "Unknown" 1 "Not Embedded" 2 "Border Limit" 3 "Multi Lane" 4 "Rain" 5 "Vehicle Type" 6 "Plate" 7 "Error Value" ;
VAL_ 243 VFC_TS05_Quality 0 "Poor Quality" 1 "Good Quality" ;
VAL_ 243 VFC_TS05_VMS 0 "Fixed" 1 "Variable" ;
VAL_ 243 VFC_TS05_Stable 0 "Object Is Not Stable" 1 "Object Is Stable" ;
VAL_ 243 VFC_TS05_VehicleSticker 0 "not_sticker_on_vehicle" 1 "Sign is a sticker on a vehicle" ;
VAL_ 243 VFC_TS05_InternalTrack 0 "Sign is not an internal track" 1 "Sign is an internal track" ;
VAL_ 243 VFC_TS05_AddTS1Class 0 "UNKNOWN" 1 "DETECTED" 2 "ACCIDENT" 3 "ADVICE" 4 "BEGINS" 5 "BUS" 6 "CAMPER" 7 "CAR" 8 "CARAVAN" 9 "CRASHRISK" 10 "DIRT" 11 "DISTANCE" 12 "DISTANCEBARS" 13 "END" 14 "EXITL" 15 "EXITR" 16 "FOG" 17 "GRAVEL" 18 "HAZMAT" 19 "HUMP" 20 "JAM" 21 "LORRY" 22 "EXCEPTLORRY" 23 "LOWTREE" 24 "MCYCLE" 25 "MINIMUM" 26 "NIGHT" 27 "NOSTOPSHOULDER" 28 "OILTRAIL" 29 "PRIOTURN" 30 "RADAR" 31 "RAIN" 32 "RAINSNOW" 33 "REMINDER" 34 "ROADDAMAGE" 35 "RUTS" 36 "RWORKSACCESS" 37 "RWORKSENTRY" 38 "RWORKSEXIT" 39 "SCHOOL" 40 "SECTION" 41 "SMOKE" 42 "SNOW" 43 "SOFTSHOULDERCAR" 44 "SHOFTSHOULDERLORRY" 45 "TEXT" 46 "TIME" 47 "TOWING" 48 "TRACTOR" 49 "TRACTOR_OVER" 50 "TRAILER" 51 "WEIGHT" 52 "WET" 53 "WITHIN" 54 "ZONE" 55 "EXIT" 56 "ACCESS" 57 "ALLWAY" 58 "EXCEPTBUS" 59 "EXCEPTDELIVERY" 60 "EXCEPTLOCAL" 61 "FROG" 62 "PRIOTURNL" 63 "PRIOTURNR" 64 "START" 65 "STOPIN" 66 "HAZWATER" 67 "DAY" 68 "SL" ;
VAL_ 243 VFC_TS05_AddTS1Quality 0 "Poor Quality" 1 "Good Quality" ;
VAL_ 243 VFC_TS05_AddTS1VMS 0 "Fixed" 1 "Variable" ;
VAL_ 243 VFC_TS05_AddTS2Class 0 "UNKNOWN" 1 "DETECTED" 2 "ACCIDENT" 3 "ADVICE" 4 "BEGINS" 5 "BUS" 6 "CAMPER" 7 "CAR" 8 "CARAVAN" 9 "CRASHRISK" 10 "DIRT" 11 "DISTANCE" 12 "DISTANCEBARS" 13 "END" 14 "EXITL" 15 "EXITR" 16 "FOG" 17 "GRAVEL" 18 "HAZMAT" 19 "HUMP" 20 "JAM" 21 "LORRY" 22 "EXCEPTLORRY" 23 "LOWTREE" 24 "MCYCLE" 25 "MINIMUM" 26 "NIGHT" 27 "NOSTOPSHOULDER" 28 "OILTRAIL" 29 "PRIOTURN" 30 "RADAR" 31 "RAIN" 32 "RAINSNOW" 33 "REMINDER" 34 "ROADDAMAGE" 35 "RUTS" 36 "RWORKSACCESS" 37 "RWORKSENTRY" 38 "RWORKSEXIT" 39 "SCHOOL" 40 "SECTION" 41 "SMOKE" 42 "SNOW" 43 "SOFTSHOULDERCAR" 44 "SHOFTSHOULDERLORRY" 45 "TEXT" 46 "TIME" 47 "TOWING" 48 "TRACTOR" 49 "TRACTOR_OVER" 50 "TRAILER" 51 "WEIGHT" 52 "WET" 53 "WITHIN" 54 "ZONE" 55 "EXIT" 56 "ACCESS" 57 "ALLWAY" 58 "EXCEPTBUS" 59 "EXCEPTDELIVERY" 60 "EXCEPTLOCAL" 61 "FROG" 62 "PRIOTURNL" 63 "PRIOTURNR" 64 "START" 65 "STOPIN" 66 "HAZWATER" 67 "DAY" 68 "SL" ;
VAL_ 243 VFC_TS05_AddTS2Quality 0 "Poor Quality" 1 "Good Quality" ;
VAL_ 243 VFC_TS05_AddTS2VMS 0 "Fixed" 1 "Variable" ;
VAL_ 243 VFC_TS05_AddTS3Class 0 "UNKNOWN" 1 "DETECTED" 2 "ACCIDENT" 3 "ADVICE" 4 "BEGINS" 5 "BUS" 6 "CAMPER" 7 "CAR" 8 "CARAVAN" 9 "CRASHRISK" 10 "DIRT" 11 "DISTANCE" 12 "DISTANCEBARS" 13 "END" 14 "EXITL" 15 "EXITR" 16 "FOG" 17 "GRAVEL" 18 "HAZMAT" 19 "HUMP" 20 "JAM" 21 "LORRY" 22 "EXCEPTLORRY" 23 "LOWTREE" 24 "MCYCLE" 25 "MINIMUM" 26 "NIGHT" 27 "NOSTOPSHOULDER" 28 "OILTRAIL" 29 "PRIOTURN" 30 "RADAR" 31 "RAIN" 32 "RAINSNOW" 33 "REMINDER" 34 "ROADDAMAGE" 35 "RUTS" 36 "RWORKSACCESS" 37 "RWORKSENTRY" 38 "RWORKSEXIT" 39 "SCHOOL" 40 "SECTION" 41 "SMOKE" 42 "SNOW" 43 "SOFTSHOULDERCAR" 44 "SHOFTSHOULDERLORRY" 45 "TEXT" 46 "TIME" 47 "TOWING" 48 "TRACTOR" 49 "TRACTOR_OVER" 50 "TRAILER" 51 "WEIGHT" 52 "WET" 53 "WITHIN" 54 "ZONE" 55 "EXIT" 56 "ACCESS" 57 "ALLWAY" 58 "EXCEPTBUS" 59 "EXCEPTDELIVERY" 60 "EXCEPTLOCAL" 61 "FROG" 62 "PRIOTURNL" 63 "PRIOTURNR" 64 "START" 65 "STOPIN" 66 "HAZWATER" 67 "DAY" 68 "SL" ;
VAL_ 243 VFC_TS05_AddTS3Quality 0 "Poor Quality" 1 "Good Quality" ;
VAL_ 243 VFC_TS05_AddTS3VMS 0 "Fixed" 1 "Variable" ;
VAL_ 243 VFC_TS05_AddTS4Class 0 "UNKNOWN" 1 "DETECTED" 2 "ACCIDENT" 3 "ADVICE" 4 "BEGINS" 5 "BUS" 6 "CAMPER" 7 "CAR" 8 "CARAVAN" 9 "CRASHRISK" 10 "DIRT" 11 "DISTANCE" 12 "DISTANCEBARS" 13 "END" 14 "EXITL" 15 "EXITR" 16 "FOG" 17 "GRAVEL" 18 "HAZMAT" 19 "HUMP" 20 "JAM" 21 "LORRY" 22 "EXCEPTLORRY" 23 "LOWTREE" 24 "MCYCLE" 25 "MINIMUM" 26 "NIGHT" 27 "NOSTOPSHOULDER" 28 "OILTRAIL" 29 "PRIOTURN" 30 "RADAR" 31 "RAIN" 32 "RAINSNOW" 33 "REMINDER" 34 "ROADDAMAGE" 35 "RUTS" 36 "RWORKSACCESS" 37 "RWORKSENTRY" 38 "RWORKSEXIT" 39 "SCHOOL" 40 "SECTION" 41 "SMOKE" 42 "SNOW" 43 "SOFTSHOULDERCAR" 44 "SHOFTSHOULDERLORRY" 45 "TEXT" 46 "TIME" 47 "TOWING" 48 "TRACTOR" 49 "TRACTOR_OVER" 50 "TRAILER" 51 "WEIGHT" 52 "WET" 53 "WITHIN" 54 "ZONE" 55 "EXIT" 56 "ACCESS" 57 "ALLWAY" 58 "EXCEPTBUS" 59 "EXCEPTDELIVERY" 60 "EXCEPTLOCAL" 61 "FROG" 62 "PRIOTURNL" 63 "PRIOTURNR" 64 "START" 65 "STOPIN" 66 "HAZWATER" 67 "DAY" 68 "SL" ;
VAL_ 243 VFC_TS05_AddTS4Quality 0 "Poor Quality" 1 "Good Quality" ;
VAL_ 243 VFC_TS05_AddTS4VMS 0 "Fixed" 1 "Variable" ;
VAL_ 243 VFC_TS05_AddTS5Class 0 "UNKNOWN" 1 "DETECTED" 2 "ACCIDENT" 3 "ADVICE" 4 "BEGINS" 5 "BUS" 6 "CAMPER" 7 "CAR" 8 "CARAVAN" 9 "CRASHRISK" 10 "DIRT" 11 "DISTANCE" 12 "DISTANCEBARS" 13 "END" 14 "EXITL" 15 "EXITR" 16 "FOG" 17 "GRAVEL" 18 "HAZMAT" 19 "HUMP" 20 "JAM" 21 "LORRY" 22 "EXCEPTLORRY" 23 "LOWTREE" 24 "MCYCLE" 25 "MINIMUM" 26 "NIGHT" 27 "NOSTOPSHOULDER" 28 "OILTRAIL" 29 "PRIOTURN" 30 "RADAR" 31 "RAIN" 32 "RAINSNOW" 33 "REMINDER" 34 "ROADDAMAGE" 35 "RUTS" 36 "RWORKSACCESS" 37 "RWORKSENTRY" 38 "RWORKSEXIT" 39 "SCHOOL" 40 "SECTION" 41 "SMOKE" 42 "SNOW" 43 "SOFTSHOULDERCAR" 44 "SHOFTSHOULDERLORRY" 45 "TEXT" 46 "TIME" 47 "TOWING" 48 "TRACTOR" 49 "TRACTOR_OVER" 50 "TRAILER" 51 "WEIGHT" 52 "WET" 53 "WITHIN" 54 "ZONE" 55 "EXIT" 56 "ACCESS" 57 "ALLWAY" 58 "EXCEPTBUS" 59 "EXCEPTDELIVERY" 60 "EXCEPTLOCAL" 61 "FROG" 62 "PRIOTURNL" 63 "PRIOTURNR" 64 "START" 65 "STOPIN" 66 "HAZWATER" 67 "DAY" 68 "SL" ;
VAL_ 243 VFC_TS05_AddTS5Quality 0 "Poor Quality" 1 "Good Quality" ;
VAL_ 243 VFC_TS05_AddTS5VMS 0 "Fixed" 1 "Variable" ;
VAL_ 243 VFC_TS05_AddTS6Class 0 "UNKNOWN" 1 "DETECTED" 2 "ACCIDENT" 3 "ADVICE" 4 "BEGINS" 5 "BUS" 6 "CAMPER" 7 "CAR" 8 "CARAVAN" 9 "CRASHRISK" 10 "DIRT" 11 "DISTANCE" 12 "DISTANCEBARS" 13 "END" 14 "EXITL" 15 "EXITR" 16 "FOG" 17 "GRAVEL" 18 "HAZMAT" 19 "HUMP" 20 "JAM" 21 "LORRY" 22 "EXCEPTLORRY" 23 "LOWTREE" 24 "MCYCLE" 25 "MINIMUM" 26 "NIGHT" 27 "NOSTOPSHOULDER" 28 "OILTRAIL" 29 "PRIOTURN" 30 "RADAR" 31 "RAIN" 32 "RAINSNOW" 33 "REMINDER" 34 "ROADDAMAGE" 35 "RUTS" 36 "RWORKSACCESS" 37 "RWORKSENTRY" 38 "RWORKSEXIT" 39 "SCHOOL" 40 "SECTION" 41 "SMOKE" 42 "SNOW" 43 "SOFTSHOULDERCAR" 44 "SHOFTSHOULDERLORRY" 45 "TEXT" 46 "TIME" 47 "TOWING" 48 "TRACTOR" 49 "TRACTOR_OVER" 50 "TRAILER" 51 "WEIGHT" 52 "WET" 53 "WITHIN" 54 "ZONE" 55 "EXIT" 56 "ACCESS" 57 "ALLWAY" 58 "EXCEPTBUS" 59 "EXCEPTDELIVERY" 60 "EXCEPTLOCAL" 61 "FROG" 62 "PRIOTURNL" 63 "PRIOTURNR" 64 "START" 65 "STOPIN" 66 "HAZWATER" 67 "DAY" 68 "SL" ;
VAL_ 243 VFC_TS05_AddTS6Quality 0 "Poor Quality" 1 "Good Quality" ;
VAL_ 243 VFC_TS05_AddTS6VMS 0 "Fixed" 1 "Variable" ;
VAL_ 244 VFC_TS06_ID 0 "INVALID" ;
VAL_ 244 VFC_TS06_Class 0 "UNKNOWN" 1 "SL5" 2 "SL10" 3 "SL15" 4 "SL20" 5 "SL25" 6 "SL30" 7 "SL35" 8 "SL40" 9 "SL45" 10 "SL50" 11 "SL55" 12 "SL60" 13 "SL65" 14 "SL70" 15 "SL75" 16 "SL80" 17 "SL85" 18 "SL90" 19 "SL95" 20 "SL100" 21 "SL105" 22 "SL110" 23 "SL115" 24 "SL120" 25 "SL125" 26 "SL130" 27 "SL135" 28 "SL140" 29 "SL145" 30 "SL150" 31 "SL155" 32 "SL160" 33 "ESL" 34 "EA" 35 "OP" 36 "EOP" 37 "OL" 38 "EOL" 39 "GIVEWAY" 40 "PRIOCROSS" 41 "PRIOCROSSYIELDTORIGHT" 42 "PRIOSTREET" 43 "EPRIOSTREET" 44 "STOP" 45 "AXLEWEIGHT" 46 "CARDIST" 47 "HEIGHT" 48 "LENGTH" 49 "LORRYDIST" 50 "NOALL" 51 "NOBIKE" 52 "NOBUS" 53 "NOCAR" 54 "NOCARBIKE" 55 "NOCARRIAGE" 56 "NOENTRY" 57 "NOHAZMAT" 58 "NOHAZWATER" 59 "NOLORRY" 60 "NOLORRYTRAILER" 61 "NOLTURN" 62 "NOPED" 63 "NORIDER" 64 "NORTURN" 65 "NOTRACTOR" 66 "NOTWOWAY" 67 "NOUTURN" 68 "UMWELT" 69 "EUMWELT" 70 "WEIGHT" 71 "WIDTH" 72 "WARNBIKE" 73 "WARNBUS" 74 "WARNCATTLE" 75 "WARNCONST" 76 "WARNCONSTL" 77 "WARNCONSTR" 78 "WARNCURVEL" 79 "WARNCURVER" 80 "WARNDANGER" 81 "WARNDCURVEL" 82 "WARNDCURVER" 83 "WARNDRAWBRIDGE" 84 "WARNFROG" 85 "WARNGRAVEL" 86 "WARNHUMP" 87 "WARNJAM" 88 "WARNKIDS" 89 "WARNLIGHTS" 90 "WARNLOWTREE" 91 "WARNPCROSS" 92 "WARNPED" 93 "WARNPIER" 94 "WARNPLANE" 95 "WARNRIDER" 96 "WARNROCK" 97 "WARNROUND" 98 "WARNRWORKS" 99 "WARNSKID" 100 "WARNSLOPED" 101 "WARNSLOPEU" 102 "WARNSNOW" 103 "WARNTRAIN" 104 "WARNTWOWAY" 105 "WARNWILDANIMAL" 106 "WARNWIND" 107 "ASL" 108 "EASL" 109 "CALM" 110 "ECALM" 111 "DEADEND" 112 "DOUANE" 113 "FWAY" 114 "EFWAY" 115 "HWAY" 116 "EHWAY" 117 "MSL" 118 "EMSL" 119 "NOPARK" 120 "NOSTOP" 121 "ONEWAYS" 122 "ONEWAYU" 123 "SLOWDOWN" 124 "SCHOOL" 125 "ESCHOOL" 126 "TWN" 127 "ETWN" 128 "WBBENTLEFT" 129 "WBBENTLEFTRIGHT" 130 "WBBENTRIGHT" 131 "WBDIAGL" 132 "WBDIAGLR" 133 "WBDIAGR" 134 "WBHAZWATER" 135 "WBLEFT" 136 "WBRIGHT" 137 "WBROUND" 138 "WBUP" 139 "WBUPLEFT" 140 "WBUPRIGHT" 141 "ZEBRA" 142 "HAZMAT" 143 "EMERGENCYBAY" 144 "ENDOFLANEL" 145 "ENDOFLANER" 146 "ENOPARK" 147 "EONEWAY" 148 "EPARK" 149 "ETOLL" 150 "NOPARKL" 151 "NOPARKLR" 152 "NOPARKR" 153 "NOSTOPL" 154 "NOSTOPLR" 155 "NOSTOPR" 156 "NOTURNONRED" 157 "ONEWAYL" 158 "ONEWAYR" 159 "PARK" 160 "PRIOCROSSL" 161 "PRIOCROSSR" 162 "TOLL" 163 "TUNNEL" 164 "TWOWAY" 165 "WARNCROSS" 166 "WARNCROSSL" 167 "WARNCROSSLR" 168 "WARNCROSSR" 169 "WARNCROSSRL" 170 "WARNCROSST" 171 "WARNGIVEWAYAHEAD" 172 "WARNSLAHEAD" 173 "WARNSTOPAHEAD" 174 "WBBUS" 175 "WRONGWAY" 176 "HAZWATER" 177 "GIVEWAYROUND" 178 "WARNWINDINGL" 179 "WARNWINDINGR" 180 "WARNHAIRPINL" 181 "WARNHAIRPINR" 182 "WARNPEDBIKE" 183 "WARNCROSSY" 184 "WARNBRANCHL" 185 "WARNBRANCHR" 186 "WARNAXLEWEIGHT" 187 "WARNWEIGHT" 188 "WARNHEIGHT" 189 "WARNLENGTH" 190 "WARNWIDTH" 191 "WARNBLACKSPOT" 192 "WARNMERGEL" 193 "WARNMERGER" 194 "WARNTUNNEL" 195 "WARNTRACTOR" 196 "WARNRWORKSVEHICLE" 197 "WARNNARROWBRIDGE" 198 "WARNFLAGGER" 199 "LANES" 200 "LANESHIFTL" 201 "LANESHIFTR" 202 "NEWLANEL" 203 "NEWLANER" 204 "RIGHTTURNONRED" 205 "BORDERLIMIT" 206 "EMBEDDEDRAIN" ;
VAL_ 244 VFC_TS06_EmbedFlag 0 "Unknown" 1 "Not Embedded" 2 "Border Limit" 3 "Multi Lane" 4 "Rain" 5 "Vehicle Type" 6 "Plate" 7 "Error Value" ;
VAL_ 244 VFC_TS06_Quality 0 "Poor Quality" 1 "Good Quality" ;
VAL_ 244 VFC_TS06_VMS 0 "Fixed" 1 "Variable" ;
VAL_ 244 VFC_TS06_Stable 0 "Object Is Not Stable" 1 "Object Is Stable" ;
VAL_ 244 VFC_TS06_VehicleSticker 0 "not_sticker_on_vehicle" 1 "Sign is a sticker on a vehicle" ;
VAL_ 244 VFC_TS06_InternalTrack 0 "Sign is not an internal track" 1 "Sign is an internal track" ;
VAL_ 244 VFC_TS06_AddTS1Class 0 "UNKNOWN" 1 "DETECTED" 2 "ACCIDENT" 3 "ADVICE" 4 "BEGINS" 5 "BUS" 6 "CAMPER" 7 "CAR" 8 "CARAVAN" 9 "CRASHRISK" 10 "DIRT" 11 "DISTANCE" 12 "DISTANCEBARS" 13 "END" 14 "EXITL" 15 "EXITR" 16 "FOG" 17 "GRAVEL" 18 "HAZMAT" 19 "HUMP" 20 "JAM" 21 "LORRY" 22 "EXCEPTLORRY" 23 "LOWTREE" 24 "MCYCLE" 25 "MINIMUM" 26 "NIGHT" 27 "NOSTOPSHOULDER" 28 "OILTRAIL" 29 "PRIOTURN" 30 "RADAR" 31 "RAIN" 32 "RAINSNOW" 33 "REMINDER" 34 "ROADDAMAGE" 35 "RUTS" 36 "RWORKSACCESS" 37 "RWORKSENTRY" 38 "RWORKSEXIT" 39 "SCHOOL" 40 "SECTION" 41 "SMOKE" 42 "SNOW" 43 "SOFTSHOULDERCAR" 44 "SHOFTSHOULDERLORRY" 45 "TEXT" 46 "TIME" 47 "TOWING" 48 "TRACTOR" 49 "TRACTOR_OVER" 50 "TRAILER" 51 "WEIGHT" 52 "WET" 53 "WITHIN" 54 "ZONE" 55 "EXIT" 56 "ACCESS" 57 "ALLWAY" 58 "EXCEPTBUS" 59 "EXCEPTDELIVERY" 60 "EXCEPTLOCAL" 61 "FROG" 62 "PRIOTURNL" 63 "PRIOTURNR" 64 "START" 65 "STOPIN" 66 "HAZWATER" 67 "DAY" 68 "SL" ;
VAL_ 244 VFC_TS06_AddTS1Quality 0 "Poor Quality" 1 "Good Quality" ;
VAL_ 244 VFC_TS06_AddTS1VMS 0 "Fixed" 1 "Variable" ;
VAL_ 244 VFC_TS06_AddTS2Class 0 "UNKNOWN" 1 "DETECTED" 2 "ACCIDENT" 3 "ADVICE" 4 "BEGINS" 5 "BUS" 6 "CAMPER" 7 "CAR" 8 "CARAVAN" 9 "CRASHRISK" 10 "DIRT" 11 "DISTANCE" 12 "DISTANCEBARS" 13 "END" 14 "EXITL" 15 "EXITR" 16 "FOG" 17 "GRAVEL" 18 "HAZMAT" 19 "HUMP" 20 "JAM" 21 "LORRY" 22 "EXCEPTLORRY" 23 "LOWTREE" 24 "MCYCLE" 25 "MINIMUM" 26 "NIGHT" 27 "NOSTOPSHOULDER" 28 "OILTRAIL" 29 "PRIOTURN" 30 "RADAR" 31 "RAIN" 32 "RAINSNOW" 33 "REMINDER" 34 "ROADDAMAGE" 35 "RUTS" 36 "RWORKSACCESS" 37 "RWORKSENTRY" 38 "RWORKSEXIT" 39 "SCHOOL" 40 "SECTION" 41 "SMOKE" 42 "SNOW" 43 "SOFTSHOULDERCAR" 44 "SHOFTSHOULDERLORRY" 45 "TEXT" 46 "TIME" 47 "TOWING" 48 "TRACTOR" 49 "TRACTOR_OVER" 50 "TRAILER" 51 "WEIGHT" 52 "WET" 53 "WITHIN" 54 "ZONE" 55 "EXIT" 56 "ACCESS" 57 "ALLWAY" 58 "EXCEPTBUS" 59 "EXCEPTDELIVERY" 60 "EXCEPTLOCAL" 61 "FROG" 62 "PRIOTURNL" 63 "PRIOTURNR" 64 "START" 65 "STOPIN" 66 "HAZWATER" 67 "DAY" 68 "SL" ;
VAL_ 244 VFC_TS06_AddTS2Quality 0 "Poor Quality" 1 "Good Quality" ;
VAL_ 244 VFC_TS06_AddTS2VMS 0 "Fixed" 1 "Variable" ;
VAL_ 244 VFC_TS06_AddTS3Class 0 "UNKNOWN" 1 "DETECTED" 2 "ACCIDENT" 3 "ADVICE" 4 "BEGINS" 5 "BUS" 6 "CAMPER" 7 "CAR" 8 "CARAVAN" 9 "CRASHRISK" 10 "DIRT" 11 "DISTANCE" 12 "DISTANCEBARS" 13 "END" 14 "EXITL" 15 "EXITR" 16 "FOG" 17 "GRAVEL" 18 "HAZMAT" 19 "HUMP" 20 "JAM" 21 "LORRY" 22 "EXCEPTLORRY" 23 "LOWTREE" 24 "MCYCLE" 25 "MINIMUM" 26 "NIGHT" 27 "NOSTOPSHOULDER" 28 "OILTRAIL" 29 "PRIOTURN" 30 "RADAR" 31 "RAIN" 32 "RAINSNOW" 33 "REMINDER" 34 "ROADDAMAGE" 35 "RUTS" 36 "RWORKSACCESS" 37 "RWORKSENTRY" 38 "RWORKSEXIT" 39 "SCHOOL" 40 "SECTION" 41 "SMOKE" 42 "SNOW" 43 "SOFTSHOULDERCAR" 44 "SHOFTSHOULDERLORRY" 45 "TEXT" 46 "TIME" 47 "TOWING" 48 "TRACTOR" 49 "TRACTOR_OVER" 50 "TRAILER" 51 "WEIGHT" 52 "WET" 53 "WITHIN" 54 "ZONE" 55 "EXIT" 56 "ACCESS" 57 "ALLWAY" 58 "EXCEPTBUS" 59 "EXCEPTDELIVERY" 60 "EXCEPTLOCAL" 61 "FROG" 62 "PRIOTURNL" 63 "PRIOTURNR" 64 "START" 65 "STOPIN" 66 "HAZWATER" 67 "DAY" 68 "SL" ;
VAL_ 244 VFC_TS06_AddTS3Quality 0 "Poor Quality" 1 "Good Quality" ;
VAL_ 244 VFC_TS06_AddTS3VMS 0 "Fixed" 1 "Variable" ;
VAL_ 244 VFC_TS06_AddTS4Class 0 "UNKNOWN" 1 "DETECTED" 2 "ACCIDENT" 3 "ADVICE" 4 "BEGINS" 5 "BUS" 6 "CAMPER" 7 "CAR" 8 "CARAVAN" 9 "CRASHRISK" 10 "DIRT" 11 "DISTANCE" 12 "DISTANCEBARS" 13 "END" 14 "EXITL" 15 "EXITR" 16 "FOG" 17 "GRAVEL" 18 "HAZMAT" 19 "HUMP" 20 "JAM" 21 "LORRY" 22 "EXCEPTLORRY" 23 "LOWTREE" 24 "MCYCLE" 25 "MINIMUM" 26 "NIGHT" 27 "NOSTOPSHOULDER" 28 "OILTRAIL" 29 "PRIOTURN" 30 "RADAR" 31 "RAIN" 32 "RAINSNOW" 33 "REMINDER" 34 "ROADDAMAGE" 35 "RUTS" 36 "RWORKSACCESS" 37 "RWORKSENTRY" 38 "RWORKSEXIT" 39 "SCHOOL" 40 "SECTION" 41 "SMOKE" 42 "SNOW" 43 "SOFTSHOULDERCAR" 44 "SHOFTSHOULDERLORRY" 45 "TEXT" 46 "TIME" 47 "TOWING" 48 "TRACTOR" 49 "TRACTOR_OVER" 50 "TRAILER" 51 "WEIGHT" 52 "WET" 53 "WITHIN" 54 "ZONE" 55 "EXIT" 56 "ACCESS" 57 "ALLWAY" 58 "EXCEPTBUS" 59 "EXCEPTDELIVERY" 60 "EXCEPTLOCAL" 61 "FROG" 62 "PRIOTURNL" 63 "PRIOTURNR" 64 "START" 65 "STOPIN" 66 "HAZWATER" 67 "DAY" 68 "SL" ;
VAL_ 244 VFC_TS06_AddTS4Quality 0 "Poor Quality" 1 "Good Quality" ;
VAL_ 244 VFC_TS06_AddTS4VMS 0 "Fixed" 1 "Variable" ;
VAL_ 244 VFC_TS06_AddTS5Class 0 "UNKNOWN" 1 "DETECTED" 2 "ACCIDENT" 3 "ADVICE" 4 "BEGINS" 5 "BUS" 6 "CAMPER" 7 "CAR" 8 "CARAVAN" 9 "CRASHRISK" 10 "DIRT" 11 "DISTANCE" 12 "DISTANCEBARS" 13 "END" 14 "EXITL" 15 "EXITR" 16 "FOG" 17 "GRAVEL" 18 "HAZMAT" 19 "HUMP" 20 "JAM" 21 "LORRY" 22 "EXCEPTLORRY" 23 "LOWTREE" 24 "MCYCLE" 25 "MINIMUM" 26 "NIGHT" 27 "NOSTOPSHOULDER" 28 "OILTRAIL" 29 "PRIOTURN" 30 "RADAR" 31 "RAIN" 32 "RAINSNOW" 33 "REMINDER" 34 "ROADDAMAGE" 35 "RUTS" 36 "RWORKSACCESS" 37 "RWORKSENTRY" 38 "RWORKSEXIT" 39 "SCHOOL" 40 "SECTION" 41 "SMOKE" 42 "SNOW" 43 "SOFTSHOULDERCAR" 44 "SHOFTSHOULDERLORRY" 45 "TEXT" 46 "TIME" 47 "TOWING" 48 "TRACTOR" 49 "TRACTOR_OVER" 50 "TRAILER" 51 "WEIGHT" 52 "WET" 53 "WITHIN" 54 "ZONE" 55 "EXIT" 56 "ACCESS" 57 "ALLWAY" 58 "EXCEPTBUS" 59 "EXCEPTDELIVERY" 60 "EXCEPTLOCAL" 61 "FROG" 62 "PRIOTURNL" 63 "PRIOTURNR" 64 "START" 65 "STOPIN" 66 "HAZWATER" 67 "DAY" 68 "SL" ;
VAL_ 244 VFC_TS06_AddTS5Quality 0 "Poor Quality" 1 "Good Quality" ;
VAL_ 244 VFC_TS06_AddTS5VMS 0 "Fixed" 1 "Variable" ;
VAL_ 244 VFC_TS06_AddTS6Class 0 "UNKNOWN" 1 "DETECTED" 2 "ACCIDENT" 3 "ADVICE" 4 "BEGINS" 5 "BUS" 6 "CAMPER" 7 "CAR" 8 "CARAVAN" 9 "CRASHRISK" 10 "DIRT" 11 "DISTANCE" 12 "DISTANCEBARS" 13 "END" 14 "EXITL" 15 "EXITR" 16 "FOG" 17 "GRAVEL" 18 "HAZMAT" 19 "HUMP" 20 "JAM" 21 "LORRY" 22 "EXCEPTLORRY" 23 "LOWTREE" 24 "MCYCLE" 25 "MINIMUM" 26 "NIGHT" 27 "NOSTOPSHOULDER" 28 "OILTRAIL" 29 "PRIOTURN" 30 "RADAR" 31 "RAIN" 32 "RAINSNOW" 33 "REMINDER" 34 "ROADDAMAGE" 35 "RUTS" 36 "RWORKSACCESS" 37 "RWORKSENTRY" 38 "RWORKSEXIT" 39 "SCHOOL" 40 "SECTION" 41 "SMOKE" 42 "SNOW" 43 "SOFTSHOULDERCAR" 44 "SHOFTSHOULDERLORRY" 45 "TEXT" 46 "TIME" 47 "TOWING" 48 "TRACTOR" 49 "TRACTOR_OVER" 50 "TRAILER" 51 "WEIGHT" 52 "WET" 53 "WITHIN" 54 "ZONE" 55 "EXIT" 56 "ACCESS" 57 "ALLWAY" 58 "EXCEPTBUS" 59 "EXCEPTDELIVERY" 60 "EXCEPTLOCAL" 61 "FROG" 62 "PRIOTURNL" 63 "PRIOTURNR" 64 "START" 65 "STOPIN" 66 "HAZWATER" 67 "DAY" 68 "SL" ;
VAL_ 244 VFC_TS06_AddTS6Quality 0 "Poor Quality" 1 "Good Quality" ;
VAL_ 244 VFC_TS06_AddTS6VMS 0 "Fixed" 1 "Variable" ;
VAL_ 245 VFC_TS07_ID 0 "INVALID" ;
VAL_ 245 VFC_TS07_Class 0 "UNKNOWN" 1 "SL5" 2 "SL10" 3 "SL15" 4 "SL20" 5 "SL25" 6 "SL30" 7 "SL35" 8 "SL40" 9 "SL45" 10 "SL50" 11 "SL55" 12 "SL60" 13 "SL65" 14 "SL70" 15 "SL75" 16 "SL80" 17 "SL85" 18 "SL90" 19 "SL95" 20 "SL100" 21 "SL105" 22 "SL110" 23 "SL115" 24 "SL120" 25 "SL125" 26 "SL130" 27 "SL135" 28 "SL140" 29 "SL145" 30 "SL150" 31 "SL155" 32 "SL160" 33 "ESL" 34 "EA" 35 "OP" 36 "EOP" 37 "OL" 38 "EOL" 39 "GIVEWAY" 40 "PRIOCROSS" 41 "PRIOCROSSYIELDTORIGHT" 42 "PRIOSTREET" 43 "EPRIOSTREET" 44 "STOP" 45 "AXLEWEIGHT" 46 "CARDIST" 47 "HEIGHT" 48 "LENGTH" 49 "LORRYDIST" 50 "NOALL" 51 "NOBIKE" 52 "NOBUS" 53 "NOCAR" 54 "NOCARBIKE" 55 "NOCARRIAGE" 56 "NOENTRY" 57 "NOHAZMAT" 58 "NOHAZWATER" 59 "NOLORRY" 60 "NOLORRYTRAILER" 61 "NOLTURN" 62 "NOPED" 63 "NORIDER" 64 "NORTURN" 65 "NOTRACTOR" 66 "NOTWOWAY" 67 "NOUTURN" 68 "UMWELT" 69 "EUMWELT" 70 "WEIGHT" 71 "WIDTH" 72 "WARNBIKE" 73 "WARNBUS" 74 "WARNCATTLE" 75 "WARNCONST" 76 "WARNCONSTL" 77 "WARNCONSTR" 78 "WARNCURVEL" 79 "WARNCURVER" 80 "WARNDANGER" 81 "WARNDCURVEL" 82 "WARNDCURVER" 83 "WARNDRAWBRIDGE" 84 "WARNFROG" 85 "WARNGRAVEL" 86 "WARNHUMP" 87 "WARNJAM" 88 "WARNKIDS" 89 "WARNLIGHTS" 90 "WARNLOWTREE" 91 "WARNPCROSS" 92 "WARNPED" 93 "WARNPIER" 94 "WARNPLANE" 95 "WARNRIDER" 96 "WARNROCK" 97 "WARNROUND" 98 "WARNRWORKS" 99 "WARNSKID" 100 "WARNSLOPED" 101 "WARNSLOPEU" 102 "WARNSNOW" 103 "WARNTRAIN" 104 "WARNTWOWAY" 105 "WARNWILDANIMAL" 106 "WARNWIND" 107 "ASL" 108 "EASL" 109 "CALM" 110 "ECALM" 111 "DEADEND" 112 "DOUANE" 113 "FWAY" 114 "EFWAY" 115 "HWAY" 116 "EHWAY" 117 "MSL" 118 "EMSL" 119 "NOPARK" 120 "NOSTOP" 121 "ONEWAYS" 122 "ONEWAYU" 123 "SLOWDOWN" 124 "SCHOOL" 125 "ESCHOOL" 126 "TWN" 127 "ETWN" 128 "WBBENTLEFT" 129 "WBBENTLEFTRIGHT" 130 "WBBENTRIGHT" 131 "WBDIAGL" 132 "WBDIAGLR" 133 "WBDIAGR" 134 "WBHAZWATER" 135 "WBLEFT" 136 "WBRIGHT" 137 "WBROUND" 138 "WBUP" 139 "WBUPLEFT" 140 "WBUPRIGHT" 141 "ZEBRA" 142 "HAZMAT" 143 "EMERGENCYBAY" 144 "ENDOFLANEL" 145 "ENDOFLANER" 146 "ENOPARK" 147 "EONEWAY" 148 "EPARK" 149 "ETOLL" 150 "NOPARKL" 151 "NOPARKLR" 152 "NOPARKR" 153 "NOSTOPL" 154 "NOSTOPLR" 155 "NOSTOPR" 156 "NOTURNONRED" 157 "ONEWAYL" 158 "ONEWAYR" 159 "PARK" 160 "PRIOCROSSL" 161 "PRIOCROSSR" 162 "TOLL" 163 "TUNNEL" 164 "TWOWAY" 165 "WARNCROSS" 166 "WARNCROSSL" 167 "WARNCROSSLR" 168 "WARNCROSSR" 169 "WARNCROSSRL" 170 "WARNCROSST" 171 "WARNGIVEWAYAHEAD" 172 "WARNSLAHEAD" 173 "WARNSTOPAHEAD" 174 "WBBUS" 175 "WRONGWAY" 176 "HAZWATER" 177 "GIVEWAYROUND" 178 "WARNWINDINGL" 179 "WARNWINDINGR" 180 "WARNHAIRPINL" 181 "WARNHAIRPINR" 182 "WARNPEDBIKE" 183 "WARNCROSSY" 184 "WARNBRANCHL" 185 "WARNBRANCHR" 186 "WARNAXLEWEIGHT" 187 "WARNWEIGHT" 188 "WARNHEIGHT" 189 "WARNLENGTH" 190 "WARNWIDTH" 191 "WARNBLACKSPOT" 192 "WARNMERGEL" 193 "WARNMERGER" 194 "WARNTUNNEL" 195 "WARNTRACTOR" 196 "WARNRWORKSVEHICLE" 197 "WARNNARROWBRIDGE" 198 "WARNFLAGGER" 199 "LANES" 200 "LANESHIFTL" 201 "LANESHIFTR" 202 "NEWLANEL" 203 "NEWLANER" 204 "RIGHTTURNONRED" 205 "BORDERLIMIT" 206 "EMBEDDEDRAIN" ;
VAL_ 245 VFC_TS07_EmbedFlag 0 "Unknown" 1 "Not Embedded" 2 "Border Limit" 3 "Multi Lane" 4 "Rain" 5 "Vehicle Type" 6 "Plate" 7 "Error Value" ;
VAL_ 245 VFC_TS07_Quality 0 "Poor Quality" 1 "Good Quality" ;
VAL_ 245 VFC_TS07_VMS 0 "Fixed" 1 "Variable" ;
VAL_ 245 VFC_TS07_Stable 0 "Object Is Not Stable" 1 "Object Is Stable" ;
VAL_ 245 VFC_TS07_VehicleSticker 0 "not_sticker_on_vehicle" 1 "Sign is a sticker on a vehicle" ;
VAL_ 245 VFC_TS07_InternalTrack 0 "Sign is not an internal track" 1 "Sign is an internal track" ;
VAL_ 245 VFC_TS07_AddTS1Class 0 "UNKNOWN" 1 "DETECTED" 2 "ACCIDENT" 3 "ADVICE" 4 "BEGINS" 5 "BUS" 6 "CAMPER" 7 "CAR" 8 "CARAVAN" 9 "CRASHRISK" 10 "DIRT" 11 "DISTANCE" 12 "DISTANCEBARS" 13 "END" 14 "EXITL" 15 "EXITR" 16 "FOG" 17 "GRAVEL" 18 "HAZMAT" 19 "HUMP" 20 "JAM" 21 "LORRY" 22 "EXCEPTLORRY" 23 "LOWTREE" 24 "MCYCLE" 25 "MINIMUM" 26 "NIGHT" 27 "NOSTOPSHOULDER" 28 "OILTRAIL" 29 "PRIOTURN" 30 "RADAR" 31 "RAIN" 32 "RAINSNOW" 33 "REMINDER" 34 "ROADDAMAGE" 35 "RUTS" 36 "RWORKSACCESS" 37 "RWORKSENTRY" 38 "RWORKSEXIT" 39 "SCHOOL" 40 "SECTION" 41 "SMOKE" 42 "SNOW" 43 "SOFTSHOULDERCAR" 44 "SHOFTSHOULDERLORRY" 45 "TEXT" 46 "TIME" 47 "TOWING" 48 "TRACTOR" 49 "TRACTOR_OVER" 50 "TRAILER" 51 "WEIGHT" 52 "WET" 53 "WITHIN" 54 "ZONE" 55 "EXIT" 56 "ACCESS" 57 "ALLWAY" 58 "EXCEPTBUS" 59 "EXCEPTDELIVERY" 60 "EXCEPTLOCAL" 61 "FROG" 62 "PRIOTURNL" 63 "PRIOTURNR" 64 "START" 65 "STOPIN" 66 "HAZWATER" 67 "DAY" 68 "SL" ;
VAL_ 245 VFC_TS07_AddTS1Quality 0 "Poor Quality" 1 "Good Quality" ;
VAL_ 245 VFC_TS07_AddTS1VMS 0 "Fixed" 1 "Variable" ;
VAL_ 245 VFC_TS07_AddTS2Class 0 "UNKNOWN" 1 "DETECTED" 2 "ACCIDENT" 3 "ADVICE" 4 "BEGINS" 5 "BUS" 6 "CAMPER" 7 "CAR" 8 "CARAVAN" 9 "CRASHRISK" 10 "DIRT" 11 "DISTANCE" 12 "DISTANCEBARS" 13 "END" 14 "EXITL" 15 "EXITR" 16 "FOG" 17 "GRAVEL" 18 "HAZMAT" 19 "HUMP" 20 "JAM" 21 "LORRY" 22 "EXCEPTLORRY" 23 "LOWTREE" 24 "MCYCLE" 25 "MINIMUM" 26 "NIGHT" 27 "NOSTOPSHOULDER" 28 "OILTRAIL" 29 "PRIOTURN" 30 "RADAR" 31 "RAIN" 32 "RAINSNOW" 33 "REMINDER" 34 "ROADDAMAGE" 35 "RUTS" 36 "RWORKSACCESS" 37 "RWORKSENTRY" 38 "RWORKSEXIT" 39 "SCHOOL" 40 "SECTION" 41 "SMOKE" 42 "SNOW" 43 "SOFTSHOULDERCAR" 44 "SHOFTSHOULDERLORRY" 45 "TEXT" 46 "TIME" 47 "TOWING" 48 "TRACTOR" 49 "TRACTOR_OVER" 50 "TRAILER" 51 "WEIGHT" 52 "WET" 53 "WITHIN" 54 "ZONE" 55 "EXIT" 56 "ACCESS" 57 "ALLWAY" 58 "EXCEPTBUS" 59 "EXCEPTDELIVERY" 60 "EXCEPTLOCAL" 61 "FROG" 62 "PRIOTURNL" 63 "PRIOTURNR" 64 "START" 65 "STOPIN" 66 "HAZWATER" 67 "DAY" 68 "SL" ;
VAL_ 245 VFC_TS07_AddTS2Quality 0 "Poor Quality" 1 "Good Quality" ;
VAL_ 245 VFC_TS07_AddTS2VMS 0 "Fixed" 1 "Variable" ;
VAL_ 245 VFC_TS07_AddTS3Class 0 "UNKNOWN" 1 "DETECTED" 2 "ACCIDENT" 3 "ADVICE" 4 "BEGINS" 5 "BUS" 6 "CAMPER" 7 "CAR" 8 "CARAVAN" 9 "CRASHRISK" 10 "DIRT" 11 "DISTANCE" 12 "DISTANCEBARS" 13 "END" 14 "EXITL" 15 "EXITR" 16 "FOG" 17 "GRAVEL" 18 "HAZMAT" 19 "HUMP" 20 "JAM" 21 "LORRY" 22 "EXCEPTLORRY" 23 "LOWTREE" 24 "MCYCLE" 25 "MINIMUM" 26 "NIGHT" 27 "NOSTOPSHOULDER" 28 "OILTRAIL" 29 "PRIOTURN" 30 "RADAR" 31 "RAIN" 32 "RAINSNOW" 33 "REMINDER" 34 "ROADDAMAGE" 35 "RUTS" 36 "RWORKSACCESS" 37 "RWORKSENTRY" 38 "RWORKSEXIT" 39 "SCHOOL" 40 "SECTION" 41 "SMOKE" 42 "SNOW" 43 "SOFTSHOULDERCAR" 44 "SHOFTSHOULDERLORRY" 45 "TEXT" 46 "TIME" 47 "TOWING" 48 "TRACTOR" 49 "TRACTOR_OVER" 50 "TRAILER" 51 "WEIGHT" 52 "WET" 53 "WITHIN" 54 "ZONE" 55 "EXIT" 56 "ACCESS" 57 "ALLWAY" 58 "EXCEPTBUS" 59 "EXCEPTDELIVERY" 60 "EXCEPTLOCAL" 61 "FROG" 62 "PRIOTURNL" 63 "PRIOTURNR" 64 "START" 65 "STOPIN" 66 "HAZWATER" 67 "DAY" 68 "SL" ;
VAL_ 245 VFC_TS07_AddTS3Quality 0 "Poor Quality" 1 "Good Quality" ;
VAL_ 245 VFC_TS07_AddTS3VMS 0 "Fixed" 1 "Variable" ;
VAL_ 245 VFC_TS07_AddTS4Class 0 "UNKNOWN" 1 "DETECTED" 2 "ACCIDENT" 3 "ADVICE" 4 "BEGINS" 5 "BUS" 6 "CAMPER" 7 "CAR" 8 "CARAVAN" 9 "CRASHRISK" 10 "DIRT" 11 "DISTANCE" 12 "DISTANCEBARS" 13 "END" 14 "EXITL" 15 "EXITR" 16 "FOG" 17 "GRAVEL" 18 "HAZMAT" 19 "HUMP" 20 "JAM" 21 "LORRY" 22 "EXCEPTLORRY" 23 "LOWTREE" 24 "MCYCLE" 25 "MINIMUM" 26 "NIGHT" 27 "NOSTOPSHOULDER" 28 "OILTRAIL" 29 "PRIOTURN" 30 "RADAR" 31 "RAIN" 32 "RAINSNOW" 33 "REMINDER" 34 "ROADDAMAGE" 35 "RUTS" 36 "RWORKSACCESS" 37 "RWORKSENTRY" 38 "RWORKSEXIT" 39 "SCHOOL" 40 "SECTION" 41 "SMOKE" 42 "SNOW" 43 "SOFTSHOULDERCAR" 44 "SHOFTSHOULDERLORRY" 45 "TEXT" 46 "TIME" 47 "TOWING" 48 "TRACTOR" 49 "TRACTOR_OVER" 50 "TRAILER" 51 "WEIGHT" 52 "WET" 53 "WITHIN" 54 "ZONE" 55 "EXIT" 56 "ACCESS" 57 "ALLWAY" 58 "EXCEPTBUS" 59 "EXCEPTDELIVERY" 60 "EXCEPTLOCAL" 61 "FROG" 62 "PRIOTURNL" 63 "PRIOTURNR" 64 "START" 65 "STOPIN" 66 "HAZWATER" 67 "DAY" 68 "SL" ;
VAL_ 245 VFC_TS07_AddTS4Quality 0 "Poor Quality" 1 "Good Quality" ;
VAL_ 245 VFC_TS07_AddTS4VMS 0 "Fixed" 1 "Variable" ;
VAL_ 245 VFC_TS07_AddTS5Class 0 "UNKNOWN" 1 "DETECTED" 2 "ACCIDENT" 3 "ADVICE" 4 "BEGINS" 5 "BUS" 6 "CAMPER" 7 "CAR" 8 "CARAVAN" 9 "CRASHRISK" 10 "DIRT" 11 "DISTANCE" 12 "DISTANCEBARS" 13 "END" 14 "EXITL" 15 "EXITR" 16 "FOG" 17 "GRAVEL" 18 "HAZMAT" 19 "HUMP" 20 "JAM" 21 "LORRY" 22 "EXCEPTLORRY" 23 "LOWTREE" 24 "MCYCLE" 25 "MINIMUM" 26 "NIGHT" 27 "NOSTOPSHOULDER" 28 "OILTRAIL" 29 "PRIOTURN" 30 "RADAR" 31 "RAIN" 32 "RAINSNOW" 33 "REMINDER" 34 "ROADDAMAGE" 35 "RUTS" 36 "RWORKSACCESS" 37 "RWORKSENTRY" 38 "RWORKSEXIT" 39 "SCHOOL" 40 "SECTION" 41 "SMOKE" 42 "SNOW" 43 "SOFTSHOULDERCAR" 44 "SHOFTSHOULDERLORRY" 45 "TEXT" 46 "TIME" 47 "TOWING" 48 "TRACTOR" 49 "TRACTOR_OVER" 50 "TRAILER" 51 "WEIGHT" 52 "WET" 53 "WITHIN" 54 "ZONE" 55 "EXIT" 56 "ACCESS" 57 "ALLWAY" 58 "EXCEPTBUS" 59 "EXCEPTDELIVERY" 60 "EXCEPTLOCAL" 61 "FROG" 62 "PRIOTURNL" 63 "PRIOTURNR" 64 "START" 65 "STOPIN" 66 "HAZWATER" 67 "DAY" 68 "SL" ;
VAL_ 245 VFC_TS07_AddTS5Quality 0 "Poor Quality" 1 "Good Quality" ;
VAL_ 245 VFC_TS07_AddTS5VMS 0 "Fixed" 1 "Variable" ;
VAL_ 245 VFC_TS07_AddTS6Class 0 "UNKNOWN" 1 "DETECTED" 2 "ACCIDENT" 3 "ADVICE" 4 "BEGINS" 5 "BUS" 6 "CAMPER" 7 "CAR" 8 "CARAVAN" 9 "CRASHRISK" 10 "DIRT" 11 "DISTANCE" 12 "DISTANCEBARS" 13 "END" 14 "EXITL" 15 "EXITR" 16 "FOG" 17 "GRAVEL" 18 "HAZMAT" 19 "HUMP" 20 "JAM" 21 "LORRY" 22 "EXCEPTLORRY" 23 "LOWTREE" 24 "MCYCLE" 25 "MINIMUM" 26 "NIGHT" 27 "NOSTOPSHOULDER" 28 "OILTRAIL" 29 "PRIOTURN" 30 "RADAR" 31 "RAIN" 32 "RAINSNOW" 33 "REMINDER" 34 "ROADDAMAGE" 35 "RUTS" 36 "RWORKSACCESS" 37 "RWORKSENTRY" 38 "RWORKSEXIT" 39 "SCHOOL" 40 "SECTION" 41 "SMOKE" 42 "SNOW" 43 "SOFTSHOULDERCAR" 44 "SHOFTSHOULDERLORRY" 45 "TEXT" 46 "TIME" 47 "TOWING" 48 "TRACTOR" 49 "TRACTOR_OVER" 50 "TRAILER" 51 "WEIGHT" 52 "WET" 53 "WITHIN" 54 "ZONE" 55 "EXIT" 56 "ACCESS" 57 "ALLWAY" 58 "EXCEPTBUS" 59 "EXCEPTDELIVERY" 60 "EXCEPTLOCAL" 61 "FROG" 62 "PRIOTURNL" 63 "PRIOTURNR" 64 "START" 65 "STOPIN" 66 "HAZWATER" 67 "DAY" 68 "SL" ;
VAL_ 245 VFC_TS07_AddTS6Quality 0 "Poor Quality" 1 "Good Quality" ;
VAL_ 245 VFC_TS07_AddTS6VMS 0 "Fixed" 1 "Variable" ;
VAL_ 246 VFC_TS08_ID 0 "INVALID" ;
VAL_ 246 VFC_TS08_Class 0 "UNKNOWN" 1 "SL5" 2 "SL10" 3 "SL15" 4 "SL20" 5 "SL25" 6 "SL30" 7 "SL35" 8 "SL40" 9 "SL45" 10 "SL50" 11 "SL55" 12 "SL60" 13 "SL65" 14 "SL70" 15 "SL75" 16 "SL80" 17 "SL85" 18 "SL90" 19 "SL95" 20 "SL100" 21 "SL105" 22 "SL110" 23 "SL115" 24 "SL120" 25 "SL125" 26 "SL130" 27 "SL135" 28 "SL140" 29 "SL145" 30 "SL150" 31 "SL155" 32 "SL160" 33 "ESL" 34 "EA" 35 "OP" 36 "EOP" 37 "OL" 38 "EOL" 39 "GIVEWAY" 40 "PRIOCROSS" 41 "PRIOCROSSYIELDTORIGHT" 42 "PRIOSTREET" 43 "EPRIOSTREET" 44 "STOP" 45 "AXLEWEIGHT" 46 "CARDIST" 47 "HEIGHT" 48 "LENGTH" 49 "LORRYDIST" 50 "NOALL" 51 "NOBIKE" 52 "NOBUS" 53 "NOCAR" 54 "NOCARBIKE" 55 "NOCARRIAGE" 56 "NOENTRY" 57 "NOHAZMAT" 58 "NOHAZWATER" 59 "NOLORRY" 60 "NOLORRYTRAILER" 61 "NOLTURN" 62 "NOPED" 63 "NORIDER" 64 "NORTURN" 65 "NOTRACTOR" 66 "NOTWOWAY" 67 "NOUTURN" 68 "UMWELT" 69 "EUMWELT" 70 "WEIGHT" 71 "WIDTH" 72 "WARNBIKE" 73 "WARNBUS" 74 "WARNCATTLE" 75 "WARNCONST" 76 "WARNCONSTL" 77 "WARNCONSTR" 78 "WARNCURVEL" 79 "WARNCURVER" 80 "WARNDANGER" 81 "WARNDCURVEL" 82 "WARNDCURVER" 83 "WARNDRAWBRIDGE" 84 "WARNFROG" 85 "WARNGRAVEL" 86 "WARNHUMP" 87 "WARNJAM" 88 "WARNKIDS" 89 "WARNLIGHTS" 90 "WARNLOWTREE" 91 "WARNPCROSS" 92 "WARNPED" 93 "WARNPIER" 94 "WARNPLANE" 95 "WARNRIDER" 96 "WARNROCK" 97 "WARNROUND" 98 "WARNRWORKS" 99 "WARNSKID" 100 "WARNSLOPED" 101 "WARNSLOPEU" 102 "WARNSNOW" 103 "WARNTRAIN" 104 "WARNTWOWAY" 105 "WARNWILDANIMAL" 106 "WARNWIND" 107 "ASL" 108 "EASL" 109 "CALM" 110 "ECALM" 111 "DEADEND" 112 "DOUANE" 113 "FWAY" 114 "EFWAY" 115 "HWAY" 116 "EHWAY" 117 "MSL" 118 "EMSL" 119 "NOPARK" 120 "NOSTOP" 121 "ONEWAYS" 122 "ONEWAYU" 123 "SLOWDOWN" 124 "SCHOOL" 125 "ESCHOOL" 126 "TWN" 127 "ETWN" 128 "WBBENTLEFT" 129 "WBBENTLEFTRIGHT" 130 "WBBENTRIGHT" 131 "WBDIAGL" 132 "WBDIAGLR" 133 "WBDIAGR" 134 "WBHAZWATER" 135 "WBLEFT" 136 "WBRIGHT" 137 "WBROUND" 138 "WBUP" 139 "WBUPLEFT" 140 "WBUPRIGHT" 141 "ZEBRA" 142 "HAZMAT" 143 "EMERGENCYBAY" 144 "ENDOFLANEL" 145 "ENDOFLANER" 146 "ENOPARK" 147 "EONEWAY" 148 "EPARK" 149 "ETOLL" 150 "NOPARKL" 151 "NOPARKLR" 152 "NOPARKR" 153 "NOSTOPL" 154 "NOSTOPLR" 155 "NOSTOPR" 156 "NOTURNONRED" 157 "ONEWAYL" 158 "ONEWAYR" 159 "PARK" 160 "PRIOCROSSL" 161 "PRIOCROSSR" 162 "TOLL" 163 "TUNNEL" 164 "TWOWAY" 165 "WARNCROSS" 166 "WARNCROSSL" 167 "WARNCROSSLR" 168 "WARNCROSSR" 169 "WARNCROSSRL" 170 "WARNCROSST" 171 "WARNGIVEWAYAHEAD" 172 "WARNSLAHEAD" 173 "WARNSTOPAHEAD" 174 "WBBUS" 175 "WRONGWAY" 176 "HAZWATER" 177 "GIVEWAYROUND" 178 "WARNWINDINGL" 179 "WARNWINDINGR" 180 "WARNHAIRPINL" 181 "WARNHAIRPINR" 182 "WARNPEDBIKE" 183 "WARNCROSSY" 184 "WARNBRANCHL" 185 "WARNBRANCHR" 186 "WARNAXLEWEIGHT" 187 "WARNWEIGHT" 188 "WARNHEIGHT" 189 "WARNLENGTH" 190 "WARNWIDTH" 191 "WARNBLACKSPOT" 192 "WARNMERGEL" 193 "WARNMERGER" 194 "WARNTUNNEL" 195 "WARNTRACTOR" 196 "WARNRWORKSVEHICLE" 197 "WARNNARROWBRIDGE" 198 "WARNFLAGGER" 199 "LANES" 200 "LANESHIFTL" 201 "LANESHIFTR" 202 "NEWLANEL" 203 "NEWLANER" 204 "RIGHTTURNONRED" 205 "BORDERLIMIT" 206 "EMBEDDEDRAIN" ;
VAL_ 246 VFC_TS08_EmbedFlag 0 "Unknown" 1 "Not Embedded" 2 "Border Limit" 3 "Multi Lane" 4 "Rain" 5 "Vehicle Type" 6 "Plate" 7 "Error Value" ;
VAL_ 246 VFC_TS08_Quality 0 "Poor Quality" 1 "Good Quality" ;
VAL_ 246 VFC_TS08_VMS 0 "Fixed" 1 "Variable" ;
VAL_ 246 VFC_TS08_Stable 0 "Object Is Not Stable" 1 "Object Is Stable" ;
VAL_ 246 VFC_TS08_VehicleSticker 0 "not_sticker_on_vehicle" 1 "Sign is a sticker on a vehicle" ;
VAL_ 246 VFC_TS08_InternalTrack 0 "Sign is not an internal track" 1 "Sign is an internal track" ;
VAL_ 246 VFC_TS08_AddTS1Class 0 "UNKNOWN" 1 "DETECTED" 2 "ACCIDENT" 3 "ADVICE" 4 "BEGINS" 5 "BUS" 6 "CAMPER" 7 "CAR" 8 "CARAVAN" 9 "CRASHRISK" 10 "DIRT" 11 "DISTANCE" 12 "DISTANCEBARS" 13 "END" 14 "EXITL" 15 "EXITR" 16 "FOG" 17 "GRAVEL" 18 "HAZMAT" 19 "HUMP" 20 "JAM" 21 "LORRY" 22 "EXCEPTLORRY" 23 "LOWTREE" 24 "MCYCLE" 25 "MINIMUM" 26 "NIGHT" 27 "NOSTOPSHOULDER" 28 "OILTRAIL" 29 "PRIOTURN" 30 "RADAR" 31 "RAIN" 32 "RAINSNOW" 33 "REMINDER" 34 "ROADDAMAGE" 35 "RUTS" 36 "RWORKSACCESS" 37 "RWORKSENTRY" 38 "RWORKSEXIT" 39 "SCHOOL" 40 "SECTION" 41 "SMOKE" 42 "SNOW" 43 "SOFTSHOULDERCAR" 44 "SHOFTSHOULDERLORRY" 45 "TEXT" 46 "TIME" 47 "TOWING" 48 "TRACTOR" 49 "TRACTOR_OVER" 50 "TRAILER" 51 "WEIGHT" 52 "WET" 53 "WITHIN" 54 "ZONE" 55 "EXIT" 56 "ACCESS" 57 "ALLWAY" 58 "EXCEPTBUS" 59 "EXCEPTDELIVERY" 60 "EXCEPTLOCAL" 61 "FROG" 62 "PRIOTURNL" 63 "PRIOTURNR" 64 "START" 65 "STOPIN" 66 "HAZWATER" 67 "DAY" 68 "SL" ;
VAL_ 246 VFC_TS08_AddTS1Quality 0 "Poor Quality" 1 "Good Quality" ;
VAL_ 246 VFC_TS08_AddTS1VMS 0 "Fixed" 1 "Variable" ;
VAL_ 246 VFC_TS08_AddTS2Class 0 "UNKNOWN" 1 "DETECTED" 2 "ACCIDENT" 3 "ADVICE" 4 "BEGINS" 5 "BUS" 6 "CAMPER" 7 "CAR" 8 "CARAVAN" 9 "CRASHRISK" 10 "DIRT" 11 "DISTANCE" 12 "DISTANCEBARS" 13 "END" 14 "EXITL" 15 "EXITR" 16 "FOG" 17 "GRAVEL" 18 "HAZMAT" 19 "HUMP" 20 "JAM" 21 "LORRY" 22 "EXCEPTLORRY" 23 "LOWTREE" 24 "MCYCLE" 25 "MINIMUM" 26 "NIGHT" 27 "NOSTOPSHOULDER" 28 "OILTRAIL" 29 "PRIOTURN" 30 "RADAR" 31 "RAIN" 32 "RAINSNOW" 33 "REMINDER" 34 "ROADDAMAGE" 35 "RUTS" 36 "RWORKSACCESS" 37 "RWORKSENTRY" 38 "RWORKSEXIT" 39 "SCHOOL" 40 "SECTION" 41 "SMOKE" 42 "SNOW" 43 "SOFTSHOULDERCAR" 44 "SHOFTSHOULDERLORRY" 45 "TEXT" 46 "TIME" 47 "TOWING" 48 "TRACTOR" 49 "TRACTOR_OVER" 50 "TRAILER" 51 "WEIGHT" 52 "WET" 53 "WITHIN" 54 "ZONE" 55 "EXIT" 56 "ACCESS" 57 "ALLWAY" 58 "EXCEPTBUS" 59 "EXCEPTDELIVERY" 60 "EXCEPTLOCAL" 61 "FROG" 62 "PRIOTURNL" 63 "PRIOTURNR" 64 "START" 65 "STOPIN" 66 "HAZWATER" 67 "DAY" 68 "SL" ;
VAL_ 246 VFC_TS08_AddTS2Quality 0 "Poor Quality" 1 "Good Quality" ;
VAL_ 246 VFC_TS08_AddTS2VMS 0 "Fixed" 1 "Variable" ;
VAL_ 246 VFC_TS08_AddTS3Class 0 "UNKNOWN" 1 "DETECTED" 2 "ACCIDENT" 3 "ADVICE" 4 "BEGINS" 5 "BUS" 6 "CAMPER" 7 "CAR" 8 "CARAVAN" 9 "CRASHRISK" 10 "DIRT" 11 "DISTANCE" 12 "DISTANCEBARS" 13 "END" 14 "EXITL" 15 "EXITR" 16 "FOG" 17 "GRAVEL" 18 "HAZMAT" 19 "HUMP" 20 "JAM" 21 "LORRY" 22 "EXCEPTLORRY" 23 "LOWTREE" 24 "MCYCLE" 25 "MINIMUM" 26 "NIGHT" 27 "NOSTOPSHOULDER" 28 "OILTRAIL" 29 "PRIOTURN" 30 "RADAR" 31 "RAIN" 32 "RAINSNOW" 33 "REMINDER" 34 "ROADDAMAGE" 35 "RUTS" 36 "RWORKSACCESS" 37 "RWORKSENTRY" 38 "RWORKSEXIT" 39 "SCHOOL" 40 "SECTION" 41 "SMOKE" 42 "SNOW" 43 "SOFTSHOULDERCAR" 44 "SHOFTSHOULDERLORRY" 45 "TEXT" 46 "TIME" 47 "TOWING" 48 "TRACTOR" 49 "TRACTOR_OVER" 50 "TRAILER" 51 "WEIGHT" 52 "WET" 53 "WITHIN" 54 "ZONE" 55 "EXIT" 56 "ACCESS" 57 "ALLWAY" 58 "EXCEPTBUS" 59 "EXCEPTDELIVERY" 60 "EXCEPTLOCAL" 61 "FROG" 62 "PRIOTURNL" 63 "PRIOTURNR" 64 "START" 65 "STOPIN" 66 "HAZWATER" 67 "DAY" 68 "SL" ;
VAL_ 246 VFC_TS08_AddTS3Quality 0 "Poor Quality" 1 "Good Quality" ;
VAL_ 246 VFC_TS08_AddTS3VMS 0 "Fixed" 1 "Variable" ;
VAL_ 246 VFC_TS08_AddTS4Class 0 "UNKNOWN" 1 "DETECTED" 2 "ACCIDENT" 3 "ADVICE" 4 "BEGINS" 5 "BUS" 6 "CAMPER" 7 "CAR" 8 "CARAVAN" 9 "CRASHRISK" 10 "DIRT" 11 "DISTANCE" 12 "DISTANCEBARS" 13 "END" 14 "EXITL" 15 "EXITR" 16 "FOG" 17 "GRAVEL" 18 "HAZMAT" 19 "HUMP" 20 "JAM" 21 "LORRY" 22 "EXCEPTLORRY" 23 "LOWTREE" 24 "MCYCLE" 25 "MINIMUM" 26 "NIGHT" 27 "NOSTOPSHOULDER" 28 "OILTRAIL" 29 "PRIOTURN" 30 "RADAR" 31 "RAIN" 32 "RAINSNOW" 33 "REMINDER" 34 "ROADDAMAGE" 35 "RUTS" 36 "RWORKSACCESS" 37 "RWORKSENTRY" 38 "RWORKSEXIT" 39 "SCHOOL" 40 "SECTION" 41 "SMOKE" 42 "SNOW" 43 "SOFTSHOULDERCAR" 44 "SHOFTSHOULDERLORRY" 45 "TEXT" 46 "TIME" 47 "TOWING" 48 "TRACTOR" 49 "TRACTOR_OVER" 50 "TRAILER" 51 "WEIGHT" 52 "WET" 53 "WITHIN" 54 "ZONE" 55 "EXIT" 56 "ACCESS" 57 "ALLWAY" 58 "EXCEPTBUS" 59 "EXCEPTDELIVERY" 60 "EXCEPTLOCAL" 61 "FROG" 62 "PRIOTURNL" 63 "PRIOTURNR" 64 "START" 65 "STOPIN" 66 "HAZWATER" 67 "DAY" 68 "SL" ;
VAL_ 246 VFC_TS08_AddTS4Quality 0 "Poor Quality" 1 "Good Quality" ;
VAL_ 246 VFC_TS08_AddTS4VMS 0 "Fixed" 1 "Variable" ;
VAL_ 246 VFC_TS08_AddTS5Class 0 "UNKNOWN" 1 "DETECTED" 2 "ACCIDENT" 3 "ADVICE" 4 "BEGINS" 5 "BUS" 6 "CAMPER" 7 "CAR" 8 "CARAVAN" 9 "CRASHRISK" 10 "DIRT" 11 "DISTANCE" 12 "DISTANCEBARS" 13 "END" 14 "EXITL" 15 "EXITR" 16 "FOG" 17 "GRAVEL" 18 "HAZMAT" 19 "HUMP" 20 "JAM" 21 "LORRY" 22 "EXCEPTLORRY" 23 "LOWTREE" 24 "MCYCLE" 25 "MINIMUM" 26 "NIGHT" 27 "NOSTOPSHOULDER" 28 "OILTRAIL" 29 "PRIOTURN" 30 "RADAR" 31 "RAIN" 32 "RAINSNOW" 33 "REMINDER" 34 "ROADDAMAGE" 35 "RUTS" 36 "RWORKSACCESS" 37 "RWORKSENTRY" 38 "RWORKSEXIT" 39 "SCHOOL" 40 "SECTION" 41 "SMOKE" 42 "SNOW" 43 "SOFTSHOULDERCAR" 44 "SHOFTSHOULDERLORRY" 45 "TEXT" 46 "TIME" 47 "TOWING" 48 "TRACTOR" 49 "TRACTOR_OVER" 50 "TRAILER" 51 "WEIGHT" 52 "WET" 53 "WITHIN" 54 "ZONE" 55 "EXIT" 56 "ACCESS" 57 "ALLWAY" 58 "EXCEPTBUS" 59 "EXCEPTDELIVERY" 60 "EXCEPTLOCAL" 61 "FROG" 62 "PRIOTURNL" 63 "PRIOTURNR" 64 "START" 65 "STOPIN" 66 "HAZWATER" 67 "DAY" 68 "SL" ;
VAL_ 246 VFC_TS08_AddTS5Quality 0 "Poor Quality" 1 "Good Quality" ;
VAL_ 246 VFC_TS08_AddTS5VMS 0 "Fixed" 1 "Variable" ;
VAL_ 246 VFC_TS08_AddTS6Class 0 "UNKNOWN" 1 "DETECTED" 2 "ACCIDENT" 3 "ADVICE" 4 "BEGINS" 5 "BUS" 6 "CAMPER" 7 "CAR" 8 "CARAVAN" 9 "CRASHRISK" 10 "DIRT" 11 "DISTANCE" 12 "DISTANCEBARS" 13 "END" 14 "EXITL" 15 "EXITR" 16 "FOG" 17 "GRAVEL" 18 "HAZMAT" 19 "HUMP" 20 "JAM" 21 "LORRY" 22 "EXCEPTLORRY" 23 "LOWTREE" 24 "MCYCLE" 25 "MINIMUM" 26 "NIGHT" 27 "NOSTOPSHOULDER" 28 "OILTRAIL" 29 "PRIOTURN" 30 "RADAR" 31 "RAIN" 32 "RAINSNOW" 33 "REMINDER" 34 "ROADDAMAGE" 35 "RUTS" 36 "RWORKSACCESS" 37 "RWORKSENTRY" 38 "RWORKSEXIT" 39 "SCHOOL" 40 "SECTION" 41 "SMOKE" 42 "SNOW" 43 "SOFTSHOULDERCAR" 44 "SHOFTSHOULDERLORRY" 45 "TEXT" 46 "TIME" 47 "TOWING" 48 "TRACTOR" 49 "TRACTOR_OVER" 50 "TRAILER" 51 "WEIGHT" 52 "WET" 53 "WITHIN" 54 "ZONE" 55 "EXIT" 56 "ACCESS" 57 "ALLWAY" 58 "EXCEPTBUS" 59 "EXCEPTDELIVERY" 60 "EXCEPTLOCAL" 61 "FROG" 62 "PRIOTURNL" 63 "PRIOTURNR" 64 "START" 65 "STOPIN" 66 "HAZWATER" 67 "DAY" 68 "SL" ;
VAL_ 246 VFC_TS08_AddTS6Quality 0 "Poor Quality" 1 "Good Quality" ;
VAL_ 246 VFC_TS08_AddTS6VMS 0 "Fixed" 1 "Variable" ;
VAL_ 247 VFC_TS09_ID 0 "INVALID" ;
VAL_ 247 VFC_TS09_Class 0 "UNKNOWN" 1 "SL5" 2 "SL10" 3 "SL15" 4 "SL20" 5 "SL25" 6 "SL30" 7 "SL35" 8 "SL40" 9 "SL45" 10 "SL50" 11 "SL55" 12 "SL60" 13 "SL65" 14 "SL70" 15 "SL75" 16 "SL80" 17 "SL85" 18 "SL90" 19 "SL95" 20 "SL100" 21 "SL105" 22 "SL110" 23 "SL115" 24 "SL120" 25 "SL125" 26 "SL130" 27 "SL135" 28 "SL140" 29 "SL145" 30 "SL150" 31 "SL155" 32 "SL160" 33 "ESL" 34 "EA" 35 "OP" 36 "EOP" 37 "OL" 38 "EOL" 39 "GIVEWAY" 40 "PRIOCROSS" 41 "PRIOCROSSYIELDTORIGHT" 42 "PRIOSTREET" 43 "EPRIOSTREET" 44 "STOP" 45 "AXLEWEIGHT" 46 "CARDIST" 47 "HEIGHT" 48 "LENGTH" 49 "LORRYDIST" 50 "NOALL" 51 "NOBIKE" 52 "NOBUS" 53 "NOCAR" 54 "NOCARBIKE" 55 "NOCARRIAGE" 56 "NOENTRY" 57 "NOHAZMAT" 58 "NOHAZWATER" 59 "NOLORRY" 60 "NOLORRYTRAILER" 61 "NOLTURN" 62 "NOPED" 63 "NORIDER" 64 "NORTURN" 65 "NOTRACTOR" 66 "NOTWOWAY" 67 "NOUTURN" 68 "UMWELT" 69 "EUMWELT" 70 "WEIGHT" 71 "WIDTH" 72 "WARNBIKE" 73 "WARNBUS" 74 "WARNCATTLE" 75 "WARNCONST" 76 "WARNCONSTL" 77 "WARNCONSTR" 78 "WARNCURVEL" 79 "WARNCURVER" 80 "WARNDANGER" 81 "WARNDCURVEL" 82 "WARNDCURVER" 83 "WARNDRAWBRIDGE" 84 "WARNFROG" 85 "WARNGRAVEL" 86 "WARNHUMP" 87 "WARNJAM" 88 "WARNKIDS" 89 "WARNLIGHTS" 90 "WARNLOWTREE" 91 "WARNPCROSS" 92 "WARNPED" 93 "WARNPIER" 94 "WARNPLANE" 95 "WARNRIDER" 96 "WARNROCK" 97 "WARNROUND" 98 "WARNRWORKS" 99 "WARNSKID" 100 "WARNSLOPED" 101 "WARNSLOPEU" 102 "WARNSNOW" 103 "WARNTRAIN" 104 "WARNTWOWAY" 105 "WARNWILDANIMAL" 106 "WARNWIND" 107 "ASL" 108 "EASL" 109 "CALM" 110 "ECALM" 111 "DEADEND" 112 "DOUANE" 113 "FWAY" 114 "EFWAY" 115 "HWAY" 116 "EHWAY" 117 "MSL" 118 "EMSL" 119 "NOPARK" 120 "NOSTOP" 121 "ONEWAYS" 122 "ONEWAYU" 123 "SLOWDOWN" 124 "SCHOOL" 125 "ESCHOOL" 126 "TWN" 127 "ETWN" 128 "WBBENTLEFT" 129 "WBBENTLEFTRIGHT" 130 "WBBENTRIGHT" 131 "WBDIAGL" 132 "WBDIAGLR" 133 "WBDIAGR" 134 "WBHAZWATER" 135 "WBLEFT" 136 "WBRIGHT" 137 "WBROUND" 138 "WBUP" 139 "WBUPLEFT" 140 "WBUPRIGHT" 141 "ZEBRA" 142 "HAZMAT" 143 "EMERGENCYBAY" 144 "ENDOFLANEL" 145 "ENDOFLANER" 146 "ENOPARK" 147 "EONEWAY" 148 "EPARK" 149 "ETOLL" 150 "NOPARKL" 151 "NOPARKLR" 152 "NOPARKR" 153 "NOSTOPL" 154 "NOSTOPLR" 155 "NOSTOPR" 156 "NOTURNONRED" 157 "ONEWAYL" 158 "ONEWAYR" 159 "PARK" 160 "PRIOCROSSL" 161 "PRIOCROSSR" 162 "TOLL" 163 "TUNNEL" 164 "TWOWAY" 165 "WARNCROSS" 166 "WARNCROSSL" 167 "WARNCROSSLR" 168 "WARNCROSSR" 169 "WARNCROSSRL" 170 "WARNCROSST" 171 "WARNGIVEWAYAHEAD" 172 "WARNSLAHEAD" 173 "WARNSTOPAHEAD" 174 "WBBUS" 175 "WRONGWAY" 176 "HAZWATER" 177 "GIVEWAYROUND" 178 "WARNWINDINGL" 179 "WARNWINDINGR" 180 "WARNHAIRPINL" 181 "WARNHAIRPINR" 182 "WARNPEDBIKE" 183 "WARNCROSSY" 184 "WARNBRANCHL" 185 "WARNBRANCHR" 186 "WARNAXLEWEIGHT" 187 "WARNWEIGHT" 188 "WARNHEIGHT" 189 "WARNLENGTH" 190 "WARNWIDTH" 191 "WARNBLACKSPOT" 192 "WARNMERGEL" 193 "WARNMERGER" 194 "WARNTUNNEL" 195 "WARNTRACTOR" 196 "WARNRWORKSVEHICLE" 197 "WARNNARROWBRIDGE" 198 "WARNFLAGGER" 199 "LANES" 200 "LANESHIFTL" 201 "LANESHIFTR" 202 "NEWLANEL" 203 "NEWLANER" 204 "RIGHTTURNONRED" 205 "BORDERLIMIT" 206 "EMBEDDEDRAIN" ;
VAL_ 247 VFC_TS09_EmbedFlag 0 "Unknown" 1 "Not Embedded" 2 "Border Limit" 3 "Multi Lane" 4 "Rain" 5 "Vehicle Type" 6 "Plate" 7 "Error Value" ;
VAL_ 247 VFC_TS09_Quality 0 "Poor Quality" 1 "Good Quality" ;
VAL_ 247 VFC_TS09_VMS 0 "Fixed" 1 "Variable" ;
VAL_ 247 VFC_TS09_Stable 0 "Object Is Not Stable" 1 "Object Is Stable" ;
VAL_ 247 VFC_TS09_VehicleSticker 0 "not_sticker_on_vehicle" 1 "Sign is a sticker on a vehicle" ;
VAL_ 247 VFC_TS09_InternalTrack 0 "Sign is not an internal track" 1 "Sign is an internal track" ;
VAL_ 247 VFC_TS09_AddTS1Class 0 "UNKNOWN" 1 "DETECTED" 2 "ACCIDENT" 3 "ADVICE" 4 "BEGINS" 5 "BUS" 6 "CAMPER" 7 "CAR" 8 "CARAVAN" 9 "CRASHRISK" 10 "DIRT" 11 "DISTANCE" 12 "DISTANCEBARS" 13 "END" 14 "EXITL" 15 "EXITR" 16 "FOG" 17 "GRAVEL" 18 "HAZMAT" 19 "HUMP" 20 "JAM" 21 "LORRY" 22 "EXCEPTLORRY" 23 "LOWTREE" 24 "MCYCLE" 25 "MINIMUM" 26 "NIGHT" 27 "NOSTOPSHOULDER" 28 "OILTRAIL" 29 "PRIOTURN" 30 "RADAR" 31 "RAIN" 32 "RAINSNOW" 33 "REMINDER" 34 "ROADDAMAGE" 35 "RUTS" 36 "RWORKSACCESS" 37 "RWORKSENTRY" 38 "RWORKSEXIT" 39 "SCHOOL" 40 "SECTION" 41 "SMOKE" 42 "SNOW" 43 "SOFTSHOULDERCAR" 44 "SHOFTSHOULDERLORRY" 45 "TEXT" 46 "TIME" 47 "TOWING" 48 "TRACTOR" 49 "TRACTOR_OVER" 50 "TRAILER" 51 "WEIGHT" 52 "WET" 53 "WITHIN" 54 "ZONE" 55 "EXIT" 56 "ACCESS" 57 "ALLWAY" 58 "EXCEPTBUS" 59 "EXCEPTDELIVERY" 60 "EXCEPTLOCAL" 61 "FROG" 62 "PRIOTURNL" 63 "PRIOTURNR" 64 "START" 65 "STOPIN" 66 "HAZWATER" 67 "DAY" 68 "SL" ;
VAL_ 247 VFC_TS09_AddTS1Quality 0 "Poor Quality" 1 "Good Quality" ;
VAL_ 247 VFC_TS09_AddTS1VMS 0 "Fixed" 1 "Variable" ;
VAL_ 247 VFC_TS09_AddTS2Class 0 "UNKNOWN" 1 "DETECTED" 2 "ACCIDENT" 3 "ADVICE" 4 "BEGINS" 5 "BUS" 6 "CAMPER" 7 "CAR" 8 "CARAVAN" 9 "CRASHRISK" 10 "DIRT" 11 "DISTANCE" 12 "DISTANCEBARS" 13 "END" 14 "EXITL" 15 "EXITR" 16 "FOG" 17 "GRAVEL" 18 "HAZMAT" 19 "HUMP" 20 "JAM" 21 "LORRY" 22 "EXCEPTLORRY" 23 "LOWTREE" 24 "MCYCLE" 25 "MINIMUM" 26 "NIGHT" 27 "NOSTOPSHOULDER" 28 "OILTRAIL" 29 "PRIOTURN" 30 "RADAR" 31 "RAIN" 32 "RAINSNOW" 33 "REMINDER" 34 "ROADDAMAGE" 35 "RUTS" 36 "RWORKSACCESS" 37 "RWORKSENTRY" 38 "RWORKSEXIT" 39 "SCHOOL" 40 "SECTION" 41 "SMOKE" 42 "SNOW" 43 "SOFTSHOULDERCAR" 44 "SHOFTSHOULDERLORRY" 45 "TEXT" 46 "TIME" 47 "TOWING" 48 "TRACTOR" 49 "TRACTOR_OVER" 50 "TRAILER" 51 "WEIGHT" 52 "WET" 53 "WITHIN" 54 "ZONE" 55 "EXIT" 56 "ACCESS" 57 "ALLWAY" 58 "EXCEPTBUS" 59 "EXCEPTDELIVERY" 60 "EXCEPTLOCAL" 61 "FROG" 62 "PRIOTURNL" 63 "PRIOTURNR" 64 "START" 65 "STOPIN" 66 "HAZWATER" 67 "DAY" 68 "SL" ;
VAL_ 247 VFC_TS09_AddTS2Quality 0 "Poor Quality" 1 "Good Quality" ;
VAL_ 247 VFC_TS09_AddTS2VMS 0 "Fixed" 1 "Variable" ;
VAL_ 247 VFC_TS09_AddTS3Class 0 "UNKNOWN" 1 "DETECTED" 2 "ACCIDENT" 3 "ADVICE" 4 "BEGINS" 5 "BUS" 6 "CAMPER" 7 "CAR" 8 "CARAVAN" 9 "CRASHRISK" 10 "DIRT" 11 "DISTANCE" 12 "DISTANCEBARS" 13 "END" 14 "EXITL" 15 "EXITR" 16 "FOG" 17 "GRAVEL" 18 "HAZMAT" 19 "HUMP" 20 "JAM" 21 "LORRY" 22 "EXCEPTLORRY" 23 "LOWTREE" 24 "MCYCLE" 25 "MINIMUM" 26 "NIGHT" 27 "NOSTOPSHOULDER" 28 "OILTRAIL" 29 "PRIOTURN" 30 "RADAR" 31 "RAIN" 32 "RAINSNOW" 33 "REMINDER" 34 "ROADDAMAGE" 35 "RUTS" 36 "RWORKSACCESS" 37 "RWORKSENTRY" 38 "RWORKSEXIT" 39 "SCHOOL" 40 "SECTION" 41 "SMOKE" 42 "SNOW" 43 "SOFTSHOULDERCAR" 44 "SHOFTSHOULDERLORRY" 45 "TEXT" 46 "TIME" 47 "TOWING" 48 "TRACTOR" 49 "TRACTOR_OVER" 50 "TRAILER" 51 "WEIGHT" 52 "WET" 53 "WITHIN" 54 "ZONE" 55 "EXIT" 56 "ACCESS" 57 "ALLWAY" 58 "EXCEPTBUS" 59 "EXCEPTDELIVERY" 60 "EXCEPTLOCAL" 61 "FROG" 62 "PRIOTURNL" 63 "PRIOTURNR" 64 "START" 65 "STOPIN" 66 "HAZWATER" 67 "DAY" 68 "SL" ;
VAL_ 247 VFC_TS09_AddTS3Quality 0 "Poor Quality" 1 "Good Quality" ;
VAL_ 247 VFC_TS09_AddTS3VMS 0 "Fixed" 1 "Variable" ;
VAL_ 247 VFC_TS09_AddTS4Class 0 "UNKNOWN" 1 "DETECTED" 2 "ACCIDENT" 3 "ADVICE" 4 "BEGINS" 5 "BUS" 6 "CAMPER" 7 "CAR" 8 "CARAVAN" 9 "CRASHRISK" 10 "DIRT" 11 "DISTANCE" 12 "DISTANCEBARS" 13 "END" 14 "EXITL" 15 "EXITR" 16 "FOG" 17 "GRAVEL" 18 "HAZMAT" 19 "HUMP" 20 "JAM" 21 "LORRY" 22 "EXCEPTLORRY" 23 "LOWTREE" 24 "MCYCLE" 25 "MINIMUM" 26 "NIGHT" 27 "NOSTOPSHOULDER" 28 "OILTRAIL" 29 "PRIOTURN" 30 "RADAR" 31 "RAIN" 32 "RAINSNOW" 33 "REMINDER" 34 "ROADDAMAGE" 35 "RUTS" 36 "RWORKSACCESS" 37 "RWORKSENTRY" 38 "RWORKSEXIT" 39 "SCHOOL" 40 "SECTION" 41 "SMOKE" 42 "SNOW" 43 "SOFTSHOULDERCAR" 44 "SHOFTSHOULDERLORRY" 45 "TEXT" 46 "TIME" 47 "TOWING" 48 "TRACTOR" 49 "TRACTOR_OVER" 50 "TRAILER" 51 "WEIGHT" 52 "WET" 53 "WITHIN" 54 "ZONE" 55 "EXIT" 56 "ACCESS" 57 "ALLWAY" 58 "EXCEPTBUS" 59 "EXCEPTDELIVERY" 60 "EXCEPTLOCAL" 61 "FROG" 62 "PRIOTURNL" 63 "PRIOTURNR" 64 "START" 65 "STOPIN" 66 "HAZWATER" 67 "DAY" 68 "SL" ;
VAL_ 247 VFC_TS09_AddTS4Quality 0 "Poor Quality" 1 "Good Quality" ;
VAL_ 247 VFC_TS09_AddTS4VMS 0 "Fixed" 1 "Variable" ;
VAL_ 247 VFC_TS09_AddTS5Class 0 "UNKNOWN" 1 "DETECTED" 2 "ACCIDENT" 3 "ADVICE" 4 "BEGINS" 5 "BUS" 6 "CAMPER" 7 "CAR" 8 "CARAVAN" 9 "CRASHRISK" 10 "DIRT" 11 "DISTANCE" 12 "DISTANCEBARS" 13 "END" 14 "EXITL" 15 "EXITR" 16 "FOG" 17 "GRAVEL" 18 "HAZMAT" 19 "HUMP" 20 "JAM" 21 "LORRY" 22 "EXCEPTLORRY" 23 "LOWTREE" 24 "MCYCLE" 25 "MINIMUM" 26 "NIGHT" 27 "NOSTOPSHOULDER" 28 "OILTRAIL" 29 "PRIOTURN" 30 "RADAR" 31 "RAIN" 32 "RAINSNOW" 33 "REMINDER" 34 "ROADDAMAGE" 35 "RUTS" 36 "RWORKSACCESS" 37 "RWORKSENTRY" 38 "RWORKSEXIT" 39 "SCHOOL" 40 "SECTION" 41 "SMOKE" 42 "SNOW" 43 "SOFTSHOULDERCAR" 44 "SHOFTSHOULDERLORRY" 45 "TEXT" 46 "TIME" 47 "TOWING" 48 "TRACTOR" 49 "TRACTOR_OVER" 50 "TRAILER" 51 "WEIGHT" 52 "WET" 53 "WITHIN" 54 "ZONE" 55 "EXIT" 56 "ACCESS" 57 "ALLWAY" 58 "EXCEPTBUS" 59 "EXCEPTDELIVERY" 60 "EXCEPTLOCAL" 61 "FROG" 62 "PRIOTURNL" 63 "PRIOTURNR" 64 "START" 65 "STOPIN" 66 "HAZWATER" 67 "DAY" 68 "SL" ;
VAL_ 247 VFC_TS09_AddTS5Quality 0 "Poor Quality" 1 "Good Quality" ;
VAL_ 247 VFC_TS09_AddTS5VMS 0 "Fixed" 1 "Variable" ;
VAL_ 247 VFC_TS09_AddTS6Class 0 "UNKNOWN" 1 "DETECTED" 2 "ACCIDENT" 3 "ADVICE" 4 "BEGINS" 5 "BUS" 6 "CAMPER" 7 "CAR" 8 "CARAVAN" 9 "CRASHRISK" 10 "DIRT" 11 "DISTANCE" 12 "DISTANCEBARS" 13 "END" 14 "EXITL" 15 "EXITR" 16 "FOG" 17 "GRAVEL" 18 "HAZMAT" 19 "HUMP" 20 "JAM" 21 "LORRY" 22 "EXCEPTLORRY" 23 "LOWTREE" 24 "MCYCLE" 25 "MINIMUM" 26 "NIGHT" 27 "NOSTOPSHOULDER" 28 "OILTRAIL" 29 "PRIOTURN" 30 "RADAR" 31 "RAIN" 32 "RAINSNOW" 33 "REMINDER" 34 "ROADDAMAGE" 35 "RUTS" 36 "RWORKSACCESS" 37 "RWORKSENTRY" 38 "RWORKSEXIT" 39 "SCHOOL" 40 "SECTION" 41 "SMOKE" 42 "SNOW" 43 "SOFTSHOULDERCAR" 44 "SHOFTSHOULDERLORRY" 45 "TEXT" 46 "TIME" 47 "TOWING" 48 "TRACTOR" 49 "TRACTOR_OVER" 50 "TRAILER" 51 "WEIGHT" 52 "WET" 53 "WITHIN" 54 "ZONE" 55 "EXIT" 56 "ACCESS" 57 "ALLWAY" 58 "EXCEPTBUS" 59 "EXCEPTDELIVERY" 60 "EXCEPTLOCAL" 61 "FROG" 62 "PRIOTURNL" 63 "PRIOTURNR" 64 "START" 65 "STOPIN" 66 "HAZWATER" 67 "DAY" 68 "SL" ;
VAL_ 247 VFC_TS09_AddTS6Quality 0 "Poor Quality" 1 "Good Quality" ;
VAL_ 247 VFC_TS09_AddTS6VMS 0 "Fixed" 1 "Variable" ;
VAL_ 248 VFC_TS10_ID 0 "INVALID" ;
VAL_ 248 VFC_TS10_Class 0 "UNKNOWN" 1 "SL5" 2 "SL10" 3 "SL15" 4 "SL20" 5 "SL25" 6 "SL30" 7 "SL35" 8 "SL40" 9 "SL45" 10 "SL50" 11 "SL55" 12 "SL60" 13 "SL65" 14 "SL70" 15 "SL75" 16 "SL80" 17 "SL85" 18 "SL90" 19 "SL95" 20 "SL100" 21 "SL105" 22 "SL110" 23 "SL115" 24 "SL120" 25 "SL125" 26 "SL130" 27 "SL135" 28 "SL140" 29 "SL145" 30 "SL150" 31 "SL155" 32 "SL160" 33 "ESL" 34 "EA" 35 "OP" 36 "EOP" 37 "OL" 38 "EOL" 39 "GIVEWAY" 40 "PRIOCROSS" 41 "PRIOCROSSYIELDTORIGHT" 42 "PRIOSTREET" 43 "EPRIOSTREET" 44 "STOP" 45 "AXLEWEIGHT" 46 "CARDIST" 47 "HEIGHT" 48 "LENGTH" 49 "LORRYDIST" 50 "NOALL" 51 "NOBIKE" 52 "NOBUS" 53 "NOCAR" 54 "NOCARBIKE" 55 "NOCARRIAGE" 56 "NOENTRY" 57 "NOHAZMAT" 58 "NOHAZWATER" 59 "NOLORRY" 60 "NOLORRYTRAILER" 61 "NOLTURN" 62 "NOPED" 63 "NORIDER" 64 "NORTURN" 65 "NOTRACTOR" 66 "NOTWOWAY" 67 "NOUTURN" 68 "UMWELT" 69 "EUMWELT" 70 "WEIGHT" 71 "WIDTH" 72 "WARNBIKE" 73 "WARNBUS" 74 "WARNCATTLE" 75 "WARNCONST" 76 "WARNCONSTL" 77 "WARNCONSTR" 78 "WARNCURVEL" 79 "WARNCURVER" 80 "WARNDANGER" 81 "WARNDCURVEL" 82 "WARNDCURVER" 83 "WARNDRAWBRIDGE" 84 "WARNFROG" 85 "WARNGRAVEL" 86 "WARNHUMP" 87 "WARNJAM" 88 "WARNKIDS" 89 "WARNLIGHTS" 90 "WARNLOWTREE" 91 "WARNPCROSS" 92 "WARNPED" 93 "WARNPIER" 94 "WARNPLANE" 95 "WARNRIDER" 96 "WARNROCK" 97 "WARNROUND" 98 "WARNRWORKS" 99 "WARNSKID" 100 "WARNSLOPED" 101 "WARNSLOPEU" 102 "WARNSNOW" 103 "WARNTRAIN" 104 "WARNTWOWAY" 105 "WARNWILDANIMAL" 106 "WARNWIND" 107 "ASL" 108 "EASL" 109 "CALM" 110 "ECALM" 111 "DEADEND" 112 "DOUANE" 113 "FWAY" 114 "EFWAY" 115 "HWAY" 116 "EHWAY" 117 "MSL" 118 "EMSL" 119 "NOPARK" 120 "NOSTOP" 121 "ONEWAYS" 122 "ONEWAYU" 123 "SLOWDOWN" 124 "SCHOOL" 125 "ESCHOOL" 126 "TWN" 127 "ETWN" 128 "WBBENTLEFT" 129 "WBBENTLEFTRIGHT" 130 "WBBENTRIGHT" 131 "WBDIAGL" 132 "WBDIAGLR" 133 "WBDIAGR" 134 "WBHAZWATER" 135 "WBLEFT" 136 "WBRIGHT" 137 "WBROUND" 138 "WBUP" 139 "WBUPLEFT" 140 "WBUPRIGHT" 141 "ZEBRA" 142 "HAZMAT" 143 "EMERGENCYBAY" 144 "ENDOFLANEL" 145 "ENDOFLANER" 146 "ENOPARK" 147 "EONEWAY" 148 "EPARK" 149 "ETOLL" 150 "NOPARKL" 151 "NOPARKLR" 152 "NOPARKR" 153 "NOSTOPL" 154 "NOSTOPLR" 155 "NOSTOPR" 156 "NOTURNONRED" 157 "ONEWAYL" 158 "ONEWAYR" 159 "PARK" 160 "PRIOCROSSL" 161 "PRIOCROSSR" 162 "TOLL" 163 "TUNNEL" 164 "TWOWAY" 165 "WARNCROSS" 166 "WARNCROSSL" 167 "WARNCROSSLR" 168 "WARNCROSSR" 169 "WARNCROSSRL" 170 "WARNCROSST" 171 "WARNGIVEWAYAHEAD" 172 "WARNSLAHEAD" 173 "WARNSTOPAHEAD" 174 "WBBUS" 175 "WRONGWAY" 176 "HAZWATER" 177 "GIVEWAYROUND" 178 "WARNWINDINGL" 179 "WARNWINDINGR" 180 "WARNHAIRPINL" 181 "WARNHAIRPINR" 182 "WARNPEDBIKE" 183 "WARNCROSSY" 184 "WARNBRANCHL" 185 "WARNBRANCHR" 186 "WARNAXLEWEIGHT" 187 "WARNWEIGHT" 188 "WARNHEIGHT" 189 "WARNLENGTH" 190 "WARNWIDTH" 191 "WARNBLACKSPOT" 192 "WARNMERGEL" 193 "WARNMERGER" 194 "WARNTUNNEL" 195 "WARNTRACTOR" 196 "WARNRWORKSVEHICLE" 197 "WARNNARROWBRIDGE" 198 "WARNFLAGGER" 199 "LANES" 200 "LANESHIFTL" 201 "LANESHIFTR" 202 "NEWLANEL" 203 "NEWLANER" 204 "RIGHTTURNONRED" 205 "BORDERLIMIT" 206 "EMBEDDEDRAIN" ;
VAL_ 248 VFC_TS10_EmbedFlag 0 "Unknown" 1 "Not Embedded" 2 "Border Limit" 3 "Multi Lane" 4 "Rain" 5 "Vehicle Type" 6 "Plate" 7 "Error Value" ;
VAL_ 248 VFC_TS10_Quality 0 "Poor Quality" 1 "Good Quality" ;
VAL_ 248 VFC_TS10_VMS 0 "Fixed" 1 "Variable" ;
VAL_ 248 VFC_TS10_Stable 0 "Object Is Not Stable" 1 "Object Is Stable" ;
VAL_ 248 VFC_TS10_VehicleSticker 0 "not_sticker_on_vehicle" 1 "Sign is a sticker on a vehicle" ;
VAL_ 248 VFC_TS10_InternalTrack 0 "Sign is not an internal track" 1 "Sign is an internal track" ;
VAL_ 248 VFC_TS10_AddTS1Class 0 "UNKNOWN" 1 "DETECTED" 2 "ACCIDENT" 3 "ADVICE" 4 "BEGINS" 5 "BUS" 6 "CAMPER" 7 "CAR" 8 "CARAVAN" 9 "CRASHRISK" 10 "DIRT" 11 "DISTANCE" 12 "DISTANCEBARS" 13 "END" 14 "EXITL" 15 "EXITR" 16 "FOG" 17 "GRAVEL" 18 "HAZMAT" 19 "HUMP" 20 "JAM" 21 "LORRY" 22 "EXCEPTLORRY" 23 "LOWTREE" 24 "MCYCLE" 25 "MINIMUM" 26 "NIGHT" 27 "NOSTOPSHOULDER" 28 "OILTRAIL" 29 "PRIOTURN" 30 "RADAR" 31 "RAIN" 32 "RAINSNOW" 33 "REMINDER" 34 "ROADDAMAGE" 35 "RUTS" 36 "RWORKSACCESS" 37 "RWORKSENTRY" 38 "RWORKSEXIT" 39 "SCHOOL" 40 "SECTION" 41 "SMOKE" 42 "SNOW" 43 "SOFTSHOULDERCAR" 44 "SHOFTSHOULDERLORRY" 45 "TEXT" 46 "TIME" 47 "TOWING" 48 "TRACTOR" 49 "TRACTOR_OVER" 50 "TRAILER" 51 "WEIGHT" 52 "WET" 53 "WITHIN" 54 "ZONE" 55 "EXIT" 56 "ACCESS" 57 "ALLWAY" 58 "EXCEPTBUS" 59 "EXCEPTDELIVERY" 60 "EXCEPTLOCAL" 61 "FROG" 62 "PRIOTURNL" 63 "PRIOTURNR" 64 "START" 65 "STOPIN" 66 "HAZWATER" 67 "DAY" 68 "SL" ;
VAL_ 248 VFC_TS10_AddTS1Quality 0 "Poor Quality" 1 "Good Quality" ;
VAL_ 248 VFC_TS10_AddTS1VMS 0 "Fixed" 1 "Variable" ;
VAL_ 248 VFC_TS10_AddTS2Class 0 "UNKNOWN" 1 "DETECTED" 2 "ACCIDENT" 3 "ADVICE" 4 "BEGINS" 5 "BUS" 6 "CAMPER" 7 "CAR" 8 "CARAVAN" 9 "CRASHRISK" 10 "DIRT" 11 "DISTANCE" 12 "DISTANCEBARS" 13 "END" 14 "EXITL" 15 "EXITR" 16 "FOG" 17 "GRAVEL" 18 "HAZMAT" 19 "HUMP" 20 "JAM" 21 "LORRY" 22 "EXCEPTLORRY" 23 "LOWTREE" 24 "MCYCLE" 25 "MINIMUM" 26 "NIGHT" 27 "NOSTOPSHOULDER" 28 "OILTRAIL" 29 "PRIOTURN" 30 "RADAR" 31 "RAIN" 32 "RAINSNOW" 33 "REMINDER" 34 "ROADDAMAGE" 35 "RUTS" 36 "RWORKSACCESS" 37 "RWORKSENTRY" 38 "RWORKSEXIT" 39 "SCHOOL" 40 "SECTION" 41 "SMOKE" 42 "SNOW" 43 "SOFTSHOULDERCAR" 44 "SHOFTSHOULDERLORRY" 45 "TEXT" 46 "TIME" 47 "TOWING" 48 "TRACTOR" 49 "TRACTOR_OVER" 50 "TRAILER" 51 "WEIGHT" 52 "WET" 53 "WITHIN" 54 "ZONE" 55 "EXIT" 56 "ACCESS" 57 "ALLWAY" 58 "EXCEPTBUS" 59 "EXCEPTDELIVERY" 60 "EXCEPTLOCAL" 61 "FROG" 62 "PRIOTURNL" 63 "PRIOTURNR" 64 "START" 65 "STOPIN" 66 "HAZWATER" 67 "DAY" 68 "SL" ;
VAL_ 248 VFC_TS10_AddTS2Quality 0 "Poor Quality" 1 "Good Quality" ;
VAL_ 248 VFC_TS10_AddTS2VMS 0 "Fixed" 1 "Variable" ;
VAL_ 248 VFC_TS10_AddTS3Class 0 "UNKNOWN" 1 "DETECTED" 2 "ACCIDENT" 3 "ADVICE" 4 "BEGINS" 5 "BUS" 6 "CAMPER" 7 "CAR" 8 "CARAVAN" 9 "CRASHRISK" 10 "DIRT" 11 "DISTANCE" 12 "DISTANCEBARS" 13 "END" 14 "EXITL" 15 "EXITR" 16 "FOG" 17 "GRAVEL" 18 "HAZMAT" 19 "HUMP" 20 "JAM" 21 "LORRY" 22 "EXCEPTLORRY" 23 "LOWTREE" 24 "MCYCLE" 25 "MINIMUM" 26 "NIGHT" 27 "NOSTOPSHOULDER" 28 "OILTRAIL" 29 "PRIOTURN" 30 "RADAR" 31 "RAIN" 32 "RAINSNOW" 33 "REMINDER" 34 "ROADDAMAGE" 35 "RUTS" 36 "RWORKSACCESS" 37 "RWORKSENTRY" 38 "RWORKSEXIT" 39 "SCHOOL" 40 "SECTION" 41 "SMOKE" 42 "SNOW" 43 "SOFTSHOULDERCAR" 44 "SHOFTSHOULDERLORRY" 45 "TEXT" 46 "TIME" 47 "TOWING" 48 "TRACTOR" 49 "TRACTOR_OVER" 50 "TRAILER" 51 "WEIGHT" 52 "WET" 53 "WITHIN" 54 "ZONE" 55 "EXIT" 56 "ACCESS" 57 "ALLWAY" 58 "EXCEPTBUS" 59 "EXCEPTDELIVERY" 60 "EXCEPTLOCAL" 61 "FROG" 62 "PRIOTURNL" 63 "PRIOTURNR" 64 "START" 65 "STOPIN" 66 "HAZWATER" 67 "DAY" 68 "SL" ;
VAL_ 248 VFC_TS10_AddTS3Quality 0 "Poor Quality" 1 "Good Quality" ;
VAL_ 248 VFC_TS10_AddTS3VMS 0 "Fixed" 1 "Variable" ;
VAL_ 248 VFC_TS10_AddTS4Class 0 "UNKNOWN" 1 "DETECTED" 2 "ACCIDENT" 3 "ADVICE" 4 "BEGINS" 5 "BUS" 6 "CAMPER" 7 "CAR" 8 "CARAVAN" 9 "CRASHRISK" 10 "DIRT" 11 "DISTANCE" 12 "DISTANCEBARS" 13 "END" 14 "EXITL" 15 "EXITR" 16 "FOG" 17 "GRAVEL" 18 "HAZMAT" 19 "HUMP" 20 "JAM" 21 "LORRY" 22 "EXCEPTLORRY" 23 "LOWTREE" 24 "MCYCLE" 25 "MINIMUM" 26 "NIGHT" 27 "NOSTOPSHOULDER" 28 "OILTRAIL" 29 "PRIOTURN" 30 "RADAR" 31 "RAIN" 32 "RAINSNOW" 33 "REMINDER" 34 "ROADDAMAGE" 35 "RUTS" 36 "RWORKSACCESS" 37 "RWORKSENTRY" 38 "RWORKSEXIT" 39 "SCHOOL" 40 "SECTION" 41 "SMOKE" 42 "SNOW" 43 "SOFTSHOULDERCAR" 44 "SHOFTSHOULDERLORRY" 45 "TEXT" 46 "TIME" 47 "TOWING" 48 "TRACTOR" 49 "TRACTOR_OVER" 50 "TRAILER" 51 "WEIGHT" 52 "WET" 53 "WITHIN" 54 "ZONE" 55 "EXIT" 56 "ACCESS" 57 "ALLWAY" 58 "EXCEPTBUS" 59 "EXCEPTDELIVERY" 60 "EXCEPTLOCAL" 61 "FROG" 62 "PRIOTURNL" 63 "PRIOTURNR" 64 "START" 65 "STOPIN" 66 "HAZWATER" 67 "DAY" 68 "SL" ;
VAL_ 248 VFC_TS10_AddTS4Quality 0 "Poor Quality" 1 "Good Quality" ;
VAL_ 248 VFC_TS10_AddTS4VMS 0 "Fixed" 1 "Variable" ;
VAL_ 248 VFC_TS10_AddTS5Class 0 "UNKNOWN" 1 "DETECTED" 2 "ACCIDENT" 3 "ADVICE" 4 "BEGINS" 5 "BUS" 6 "CAMPER" 7 "CAR" 8 "CARAVAN" 9 "CRASHRISK" 10 "DIRT" 11 "DISTANCE" 12 "DISTANCEBARS" 13 "END" 14 "EXITL" 15 "EXITR" 16 "FOG" 17 "GRAVEL" 18 "HAZMAT" 19 "HUMP" 20 "JAM" 21 "LORRY" 22 "EXCEPTLORRY" 23 "LOWTREE" 24 "MCYCLE" 25 "MINIMUM" 26 "NIGHT" 27 "NOSTOPSHOULDER" 28 "OILTRAIL" 29 "PRIOTURN" 30 "RADAR" 31 "RAIN" 32 "RAINSNOW" 33 "REMINDER" 34 "ROADDAMAGE" 35 "RUTS" 36 "RWORKSACCESS" 37 "RWORKSENTRY" 38 "RWORKSEXIT" 39 "SCHOOL" 40 "SECTION" 41 "SMOKE" 42 "SNOW" 43 "SOFTSHOULDERCAR" 44 "SHOFTSHOULDERLORRY" 45 "TEXT" 46 "TIME" 47 "TOWING" 48 "TRACTOR" 49 "TRACTOR_OVER" 50 "TRAILER" 51 "WEIGHT" 52 "WET" 53 "WITHIN" 54 "ZONE" 55 "EXIT" 56 "ACCESS" 57 "ALLWAY" 58 "EXCEPTBUS" 59 "EXCEPTDELIVERY" 60 "EXCEPTLOCAL" 61 "FROG" 62 "PRIOTURNL" 63 "PRIOTURNR" 64 "START" 65 "STOPIN" 66 "HAZWATER" 67 "DAY" 68 "SL" ;
VAL_ 248 VFC_TS10_AddTS5Quality 0 "Poor Quality" 1 "Good Quality" ;
VAL_ 248 VFC_TS10_AddTS5VMS 0 "Fixed" 1 "Variable" ;
VAL_ 248 VFC_TS10_AddTS6Class 0 "UNKNOWN" 1 "DETECTED" 2 "ACCIDENT" 3 "ADVICE" 4 "BEGINS" 5 "BUS" 6 "CAMPER" 7 "CAR" 8 "CARAVAN" 9 "CRASHRISK" 10 "DIRT" 11 "DISTANCE" 12 "DISTANCEBARS" 13 "END" 14 "EXITL" 15 "EXITR" 16 "FOG" 17 "GRAVEL" 18 "HAZMAT" 19 "HUMP" 20 "JAM" 21 "LORRY" 22 "EXCEPTLORRY" 23 "LOWTREE" 24 "MCYCLE" 25 "MINIMUM" 26 "NIGHT" 27 "NOSTOPSHOULDER" 28 "OILTRAIL" 29 "PRIOTURN" 30 "RADAR" 31 "RAIN" 32 "RAINSNOW" 33 "REMINDER" 34 "ROADDAMAGE" 35 "RUTS" 36 "RWORKSACCESS" 37 "RWORKSENTRY" 38 "RWORKSEXIT" 39 "SCHOOL" 40 "SECTION" 41 "SMOKE" 42 "SNOW" 43 "SOFTSHOULDERCAR" 44 "SHOFTSHOULDERLORRY" 45 "TEXT" 46 "TIME" 47 "TOWING" 48 "TRACTOR" 49 "TRACTOR_OVER" 50 "TRAILER" 51 "WEIGHT" 52 "WET" 53 "WITHIN" 54 "ZONE" 55 "EXIT" 56 "ACCESS" 57 "ALLWAY" 58 "EXCEPTBUS" 59 "EXCEPTDELIVERY" 60 "EXCEPTLOCAL" 61 "FROG" 62 "PRIOTURNL" 63 "PRIOTURNR" 64 "START" 65 "STOPIN" 66 "HAZWATER" 67 "DAY" 68 "SL" ;
VAL_ 248 VFC_TS10_AddTS6Quality 0 "Poor Quality" 1 "Good Quality" ;
VAL_ 248 VFC_TS10_AddTS6VMS 0 "Fixed" 1 "Variable" ;
VAL_ 249 VFC_TS11_ID 0 "INVALID" ;
VAL_ 249 VFC_TS11_Class 0 "UNKNOWN" 1 "SL5" 2 "SL10" 3 "SL15" 4 "SL20" 5 "SL25" 6 "SL30" 7 "SL35" 8 "SL40" 9 "SL45" 10 "SL50" 11 "SL55" 12 "SL60" 13 "SL65" 14 "SL70" 15 "SL75" 16 "SL80" 17 "SL85" 18 "SL90" 19 "SL95" 20 "SL100" 21 "SL105" 22 "SL110" 23 "SL115" 24 "SL120" 25 "SL125" 26 "SL130" 27 "SL135" 28 "SL140" 29 "SL145" 30 "SL150" 31 "SL155" 32 "SL160" 33 "ESL" 34 "EA" 35 "OP" 36 "EOP" 37 "OL" 38 "EOL" 39 "GIVEWAY" 40 "PRIOCROSS" 41 "PRIOCROSSYIELDTORIGHT" 42 "PRIOSTREET" 43 "EPRIOSTREET" 44 "STOP" 45 "AXLEWEIGHT" 46 "CARDIST" 47 "HEIGHT" 48 "LENGTH" 49 "LORRYDIST" 50 "NOALL" 51 "NOBIKE" 52 "NOBUS" 53 "NOCAR" 54 "NOCARBIKE" 55 "NOCARRIAGE" 56 "NOENTRY" 57 "NOHAZMAT" 58 "NOHAZWATER" 59 "NOLORRY" 60 "NOLORRYTRAILER" 61 "NOLTURN" 62 "NOPED" 63 "NORIDER" 64 "NORTURN" 65 "NOTRACTOR" 66 "NOTWOWAY" 67 "NOUTURN" 68 "UMWELT" 69 "EUMWELT" 70 "WEIGHT" 71 "WIDTH" 72 "WARNBIKE" 73 "WARNBUS" 74 "WARNCATTLE" 75 "WARNCONST" 76 "WARNCONSTL" 77 "WARNCONSTR" 78 "WARNCURVEL" 79 "WARNCURVER" 80 "WARNDANGER" 81 "WARNDCURVEL" 82 "WARNDCURVER" 83 "WARNDRAWBRIDGE" 84 "WARNFROG" 85 "WARNGRAVEL" 86 "WARNHUMP" 87 "WARNJAM" 88 "WARNKIDS" 89 "WARNLIGHTS" 90 "WARNLOWTREE" 91 "WARNPCROSS" 92 "WARNPED" 93 "WARNPIER" 94 "WARNPLANE" 95 "WARNRIDER" 96 "WARNROCK" 97 "WARNROUND" 98 "WARNRWORKS" 99 "WARNSKID" 100 "WARNSLOPED" 101 "WARNSLOPEU" 102 "WARNSNOW" 103 "WARNTRAIN" 104 "WARNTWOWAY" 105 "WARNWILDANIMAL" 106 "WARNWIND" 107 "ASL" 108 "EASL" 109 "CALM" 110 "ECALM" 111 "DEADEND" 112 "DOUANE" 113 "FWAY" 114 "EFWAY" 115 "HWAY" 116 "EHWAY" 117 "MSL" 118 "EMSL" 119 "NOPARK" 120 "NOSTOP" 121 "ONEWAYS" 122 "ONEWAYU" 123 "SLOWDOWN" 124 "SCHOOL" 125 "ESCHOOL" 126 "TWN" 127 "ETWN" 128 "WBBENTLEFT" 129 "WBBENTLEFTRIGHT" 130 "WBBENTRIGHT" 131 "WBDIAGL" 132 "WBDIAGLR" 133 "WBDIAGR" 134 "WBHAZWATER" 135 "WBLEFT" 136 "WBRIGHT" 137 "WBROUND" 138 "WBUP" 139 "WBUPLEFT" 140 "WBUPRIGHT" 141 "ZEBRA" 142 "HAZMAT" 143 "EMERGENCYBAY" 144 "ENDOFLANEL" 145 "ENDOFLANER" 146 "ENOPARK" 147 "EONEWAY" 148 "EPARK" 149 "ETOLL" 150 "NOPARKL" 151 "NOPARKLR" 152 "NOPARKR" 153 "NOSTOPL" 154 "NOSTOPLR" 155 "NOSTOPR" 156 "NOTURNONRED" 157 "ONEWAYL" 158 "ONEWAYR" 159 "PARK" 160 "PRIOCROSSL" 161 "PRIOCROSSR" 162 "TOLL" 163 "TUNNEL" 164 "TWOWAY" 165 "WARNCROSS" 166 "WARNCROSSL" 167 "WARNCROSSLR" 168 "WARNCROSSR" 169 "WARNCROSSRL" 170 "WARNCROSST" 171 "WARNGIVEWAYAHEAD" 172 "WARNSLAHEAD" 173 "WARNSTOPAHEAD" 174 "WBBUS" 175 "WRONGWAY" 176 "HAZWATER" 177 "GIVEWAYROUND" 178 "WARNWINDINGL" 179 "WARNWINDINGR" 180 "WARNHAIRPINL" 181 "WARNHAIRPINR" 182 "WARNPEDBIKE" 183 "WARNCROSSY" 184 "WARNBRANCHL" 185 "WARNBRANCHR" 186 "WARNAXLEWEIGHT" 187 "WARNWEIGHT" 188 "WARNHEIGHT" 189 "WARNLENGTH" 190 "WARNWIDTH" 191 "WARNBLACKSPOT" 192 "WARNMERGEL" 193 "WARNMERGER" 194 "WARNTUNNEL" 195 "WARNTRACTOR" 196 "WARNRWORKSVEHICLE" 197 "WARNNARROWBRIDGE" 198 "WARNFLAGGER" 199 "LANES" 200 "LANESHIFTL" 201 "LANESHIFTR" 202 "NEWLANEL" 203 "NEWLANER" 204 "RIGHTTURNONRED" 205 "BORDERLIMIT" 206 "EMBEDDEDRAIN" ;
VAL_ 249 VFC_TS11_EmbedFlag 0 "Unknown" 1 "Not Embedded" 2 "Border Limit" 3 "Multi Lane" 4 "Rain" 5 "Vehicle Type" 6 "Plate" 7 "Error Value" ;
VAL_ 249 VFC_TS11_Quality 0 "Poor Quality" 1 "Good Quality" ;
VAL_ 249 VFC_TS11_VMS 0 "Fixed" 1 "Variable" ;
VAL_ 249 VFC_TS11_Stable 0 "Object Is Not Stable" 1 "Object Is Stable" ;
VAL_ 249 VFC_TS11_VehicleSticker 0 "not_sticker_on_vehicle" 1 "Sign is a sticker on a vehicle" ;
VAL_ 249 VFC_TS11_InternalTrack 0 "Sign is not an internal track" 1 "Sign is an internal track" ;
VAL_ 249 VFC_TS11_AddTS1Class 0 "UNKNOWN" 1 "DETECTED" 2 "ACCIDENT" 3 "ADVICE" 4 "BEGINS" 5 "BUS" 6 "CAMPER" 7 "CAR" 8 "CARAVAN" 9 "CRASHRISK" 10 "DIRT" 11 "DISTANCE" 12 "DISTANCEBARS" 13 "END" 14 "EXITL" 15 "EXITR" 16 "FOG" 17 "GRAVEL" 18 "HAZMAT" 19 "HUMP" 20 "JAM" 21 "LORRY" 22 "EXCEPTLORRY" 23 "LOWTREE" 24 "MCYCLE" 25 "MINIMUM" 26 "NIGHT" 27 "NOSTOPSHOULDER" 28 "OILTRAIL" 29 "PRIOTURN" 30 "RADAR" 31 "RAIN" 32 "RAINSNOW" 33 "REMINDER" 34 "ROADDAMAGE" 35 "RUTS" 36 "RWORKSACCESS" 37 "RWORKSENTRY" 38 "RWORKSEXIT" 39 "SCHOOL" 40 "SECTION" 41 "SMOKE" 42 "SNOW" 43 "SOFTSHOULDERCAR" 44 "SHOFTSHOULDERLORRY" 45 "TEXT" 46 "TIME" 47 "TOWING" 48 "TRACTOR" 49 "TRACTOR_OVER" 50 "TRAILER" 51 "WEIGHT" 52 "WET" 53 "WITHIN" 54 "ZONE" 55 "EXIT" 56 "ACCESS" 57 "ALLWAY" 58 "EXCEPTBUS" 59 "EXCEPTDELIVERY" 60 "EXCEPTLOCAL" 61 "FROG" 62 "PRIOTURNL" 63 "PRIOTURNR" 64 "START" 65 "STOPIN" 66 "HAZWATER" 67 "DAY" 68 "SL" ;
VAL_ 249 VFC_TS11_AddTS1Quality 0 "Poor Quality" 1 "Good Quality" ;
VAL_ 249 VFC_TS11_AddTS1VMS 0 "Fixed" 1 "Variable" ;
VAL_ 249 VFC_TS11_AddTS2Class 0 "UNKNOWN" 1 "DETECTED" 2 "ACCIDENT" 3 "ADVICE" 4 "BEGINS" 5 "BUS" 6 "CAMPER" 7 "CAR" 8 "CARAVAN" 9 "CRASHRISK" 10 "DIRT" 11 "DISTANCE" 12 "DISTANCEBARS" 13 "END" 14 "EXITL" 15 "EXITR" 16 "FOG" 17 "GRAVEL" 18 "HAZMAT" 19 "HUMP" 20 "JAM" 21 "LORRY" 22 "EXCEPTLORRY" 23 "LOWTREE" 24 "MCYCLE" 25 "MINIMUM" 26 "NIGHT" 27 "NOSTOPSHOULDER" 28 "OILTRAIL" 29 "PRIOTURN" 30 "RADAR" 31 "RAIN" 32 "RAINSNOW" 33 "REMINDER" 34 "ROADDAMAGE" 35 "RUTS" 36 "RWORKSACCESS" 37 "RWORKSENTRY" 38 "RWORKSEXIT" 39 "SCHOOL" 40 "SECTION" 41 "SMOKE" 42 "SNOW" 43 "SOFTSHOULDERCAR" 44 "SHOFTSHOULDERLORRY" 45 "TEXT" 46 "TIME" 47 "TOWING" 48 "TRACTOR" 49 "TRACTOR_OVER" 50 "TRAILER" 51 "WEIGHT" 52 "WET" 53 "WITHIN" 54 "ZONE" 55 "EXIT" 56 "ACCESS" 57 "ALLWAY" 58 "EXCEPTBUS" 59 "EXCEPTDELIVERY" 60 "EXCEPTLOCAL" 61 "FROG" 62 "PRIOTURNL" 63 "PRIOTURNR" 64 "START" 65 "STOPIN" 66 "HAZWATER" 67 "DAY" 68 "SL" ;
VAL_ 249 VFC_TS11_AddTS2Quality 0 "Poor Quality" 1 "Good Quality" ;
VAL_ 249 VFC_TS11_AddTS2VMS 0 "Fixed" 1 "Variable" ;
VAL_ 249 VFC_TS11_AddTS3Class 0 "UNKNOWN" 1 "DETECTED" 2 "ACCIDENT" 3 "ADVICE" 4 "BEGINS" 5 "BUS" 6 "CAMPER" 7 "CAR" 8 "CARAVAN" 9 "CRASHRISK" 10 "DIRT" 11 "DISTANCE" 12 "DISTANCEBARS" 13 "END" 14 "EXITL" 15 "EXITR" 16 "FOG" 17 "GRAVEL" 18 "HAZMAT" 19 "HUMP" 20 "JAM" 21 "LORRY" 22 "EXCEPTLORRY" 23 "LOWTREE" 24 "MCYCLE" 25 "MINIMUM" 26 "NIGHT" 27 "NOSTOPSHOULDER" 28 "OILTRAIL" 29 "PRIOTURN" 30 "RADAR" 31 "RAIN" 32 "RAINSNOW" 33 "REMINDER" 34 "ROADDAMAGE" 35 "RUTS" 36 "RWORKSACCESS" 37 "RWORKSENTRY" 38 "RWORKSEXIT" 39 "SCHOOL" 40 "SECTION" 41 "SMOKE" 42 "SNOW" 43 "SOFTSHOULDERCAR" 44 "SHOFTSHOULDERLORRY" 45 "TEXT" 46 "TIME" 47 "TOWING" 48 "TRACTOR" 49 "TRACTOR_OVER" 50 "TRAILER" 51 "WEIGHT" 52 "WET" 53 "WITHIN" 54 "ZONE" 55 "EXIT" 56 "ACCESS" 57 "ALLWAY" 58 "EXCEPTBUS" 59 "EXCEPTDELIVERY" 60 "EXCEPTLOCAL" 61 "FROG" 62 "PRIOTURNL" 63 "PRIOTURNR" 64 "START" 65 "STOPIN" 66 "HAZWATER" 67 "DAY" 68 "SL" ;
VAL_ 249 VFC_TS11_AddTS3Quality 0 "Poor Quality" 1 "Good Quality" ;
VAL_ 249 VFC_TS11_AddTS3VMS 0 "Fixed" 1 "Variable" ;
VAL_ 249 VFC_TS11_AddTS4Class 0 "UNKNOWN" 1 "DETECTED" 2 "ACCIDENT" 3 "ADVICE" 4 "BEGINS" 5 "BUS" 6 "CAMPER" 7 "CAR" 8 "CARAVAN" 9 "CRASHRISK" 10 "DIRT" 11 "DISTANCE" 12 "DISTANCEBARS" 13 "END" 14 "EXITL" 15 "EXITR" 16 "FOG" 17 "GRAVEL" 18 "HAZMAT" 19 "HUMP" 20 "JAM" 21 "LORRY" 22 "EXCEPTLORRY" 23 "LOWTREE" 24 "MCYCLE" 25 "MINIMUM" 26 "NIGHT" 27 "NOSTOPSHOULDER" 28 "OILTRAIL" 29 "PRIOTURN" 30 "RADAR" 31 "RAIN" 32 "RAINSNOW" 33 "REMINDER" 34 "ROADDAMAGE" 35 "RUTS" 36 "RWORKSACCESS" 37 "RWORKSENTRY" 38 "RWORKSEXIT" 39 "SCHOOL" 40 "SECTION" 41 "SMOKE" 42 "SNOW" 43 "SOFTSHOULDERCAR" 44 "SHOFTSHOULDERLORRY" 45 "TEXT" 46 "TIME" 47 "TOWING" 48 "TRACTOR" 49 "TRACTOR_OVER" 50 "TRAILER" 51 "WEIGHT" 52 "WET" 53 "WITHIN" 54 "ZONE" 55 "EXIT" 56 "ACCESS" 57 "ALLWAY" 58 "EXCEPTBUS" 59 "EXCEPTDELIVERY" 60 "EXCEPTLOCAL" 61 "FROG" 62 "PRIOTURNL" 63 "PRIOTURNR" 64 "START" 65 "STOPIN" 66 "HAZWATER" 67 "DAY" 68 "SL" ;
VAL_ 249 VFC_TS11_AddTS4Quality 0 "Poor Quality" 1 "Good Quality" ;
VAL_ 249 VFC_TS11_AddTS4VMS 0 "Fixed" 1 "Variable" ;
VAL_ 249 VFC_TS11_AddTS5Class 0 "UNKNOWN" 1 "DETECTED" 2 "ACCIDENT" 3 "ADVICE" 4 "BEGINS" 5 "BUS" 6 "CAMPER" 7 "CAR" 8 "CARAVAN" 9 "CRASHRISK" 10 "DIRT" 11 "DISTANCE" 12 "DISTANCEBARS" 13 "END" 14 "EXITL" 15 "EXITR" 16 "FOG" 17 "GRAVEL" 18 "HAZMAT" 19 "HUMP" 20 "JAM" 21 "LORRY" 22 "EXCEPTLORRY" 23 "LOWTREE" 24 "MCYCLE" 25 "MINIMUM" 26 "NIGHT" 27 "NOSTOPSHOULDER" 28 "OILTRAIL" 29 "PRIOTURN" 30 "RADAR" 31 "RAIN" 32 "RAINSNOW" 33 "REMINDER" 34 "ROADDAMAGE" 35 "RUTS" 36 "RWORKSACCESS" 37 "RWORKSENTRY" 38 "RWORKSEXIT" 39 "SCHOOL" 40 "SECTION" 41 "SMOKE" 42 "SNOW" 43 "SOFTSHOULDERCAR" 44 "SHOFTSHOULDERLORRY" 45 "TEXT" 46 "TIME" 47 "TOWING" 48 "TRACTOR" 49 "TRACTOR_OVER" 50 "TRAILER" 51 "WEIGHT" 52 "WET" 53 "WITHIN" 54 "ZONE" 55 "EXIT" 56 "ACCESS" 57 "ALLWAY" 58 "EXCEPTBUS" 59 "EXCEPTDELIVERY" 60 "EXCEPTLOCAL" 61 "FROG" 62 "PRIOTURNL" 63 "PRIOTURNR" 64 "START" 65 "STOPIN" 66 "HAZWATER" 67 "DAY" 68 "SL" ;
VAL_ 249 VFC_TS11_AddTS5Quality 0 "Poor Quality" 1 "Good Quality" ;
VAL_ 249 VFC_TS11_AddTS5VMS 0 "Fixed" 1 "Variable" ;
VAL_ 249 VFC_TS11_AddTS6Class 0 "UNKNOWN" 1 "DETECTED" 2 "ACCIDENT" 3 "ADVICE" 4 "BEGINS" 5 "BUS" 6 "CAMPER" 7 "CAR" 8 "CARAVAN" 9 "CRASHRISK" 10 "DIRT" 11 "DISTANCE" 12 "DISTANCEBARS" 13 "END" 14 "EXITL" 15 "EXITR" 16 "FOG" 17 "GRAVEL" 18 "HAZMAT" 19 "HUMP" 20 "JAM" 21 "LORRY" 22 "EXCEPTLORRY" 23 "LOWTREE" 24 "MCYCLE" 25 "MINIMUM" 26 "NIGHT" 27 "NOSTOPSHOULDER" 28 "OILTRAIL" 29 "PRIOTURN" 30 "RADAR" 31 "RAIN" 32 "RAINSNOW" 33 "REMINDER" 34 "ROADDAMAGE" 35 "RUTS" 36 "RWORKSACCESS" 37 "RWORKSENTRY" 38 "RWORKSEXIT" 39 "SCHOOL" 40 "SECTION" 41 "SMOKE" 42 "SNOW" 43 "SOFTSHOULDERCAR" 44 "SHOFTSHOULDERLORRY" 45 "TEXT" 46 "TIME" 47 "TOWING" 48 "TRACTOR" 49 "TRACTOR_OVER" 50 "TRAILER" 51 "WEIGHT" 52 "WET" 53 "WITHIN" 54 "ZONE" 55 "EXIT" 56 "ACCESS" 57 "ALLWAY" 58 "EXCEPTBUS" 59 "EXCEPTDELIVERY" 60 "EXCEPTLOCAL" 61 "FROG" 62 "PRIOTURNL" 63 "PRIOTURNR" 64 "START" 65 "STOPIN" 66 "HAZWATER" 67 "DAY" 68 "SL" ;
VAL_ 249 VFC_TS11_AddTS6Quality 0 "Poor Quality" 1 "Good Quality" ;
VAL_ 249 VFC_TS11_AddTS6VMS 0 "Fixed" 1 "Variable" ;
