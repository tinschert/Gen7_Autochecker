VERSION "created by canmatrix"

NS_ :

BS_:

BU_: RadarFrontCenter DASy MPC3

BO_ 409 RFC_Location_018_019: 64 RadarFrontCenter
 SG_ RFC_Loc018_CRC : 0|16@1+ (1,0) [0|65535] ""  DASy
 SG_ RFC_Loc018_AliveCtr : 16|8@1+ (1,0) [0|255] ""  DASy
 SG_ RFC_Loc018_ProtBlockCtr : 24|8@1+ (1,0) [0|255] ""  DASy
 SG_ RFC_Loc018_Dr : 32|16@1+ (0.0078125,0) [0|511.9921875] "m"  DASy
 SG_ RFC_Loc018_Vr : 48|16@1+ (0.00390625,-128) [-128|127.99609375] "m/s"  DASy
 SG_ RFC_Loc018_Theta : 64|16@1+ (0.01,-327.68) [-90|90] "deg"  DASy
 SG_ RFC_Loc018_Phi : 80|16@1+ (0.01,-327.68) [-30|30] "deg"  DASy
 SG_ RFC_Loc018_DrVnce : 96|16@1+ (1.52588E-005,0) [0|0.999984741210937] "m^2"  DASy
 SG_ RFC_Loc018_VrVnce : 112|16@1+ (1.52588E-005,0) [0|0.999984741210937] "m^2/s^2"  DASy
 SG_ RFC_Loc018_ThetaVnce : 128|16@1+ (0.00390625,0) [0|255.99609375] "deg^2"  DASy
 SG_ RFC_Loc018_PhiVnce : 144|16@1+ (0.00390625,0) [0|255.99609375] "deg^2"  DASy
 SG_ RFC_Loc018_DrVrCoVnce : 160|16@1+ (3.814697265625E-006,-0.125) [-0.125|0.124996185302734] "m^2/s"  DASy
 SG_ RFC_Loc018_RCS : 176|16@1+ (0.00390625,-128) [-128|127.99609375] "dBsm"  DASy
 SG_ RFC_Loc018_RSSI : 192|16@1+ (0.00195312,0) [0|127.998046875] "dimensionless"  DASy
 SG_ RFC_Loc018_DrVrQuality : 208|8@1+ (1,0) [0|255] "dimensionless"  DASy
 SG_ RFC_Loc018_ThetaQuality : 216|8@1+ (1,0) [0|255] "dimensionless"  DASy
 SG_ RFC_Loc018_PhiQuality : 224|8@1+ (1,0) [0|255] "dimensionless"  DASy
 SG_ RFC_Loc019_Dr : 256|16@1+ (0.0078125,0) [0|511.9921875] "m"  DASy
 SG_ RFC_Loc019_Vr : 272|16@1+ (0.00390625,-128) [-128|127.99609375] "m/s"  DASy
 SG_ RFC_Loc019_Theta : 288|16@1+ (0.01,-327.68) [-90|90] "deg"  DASy
 SG_ RFC_Loc019_Phi : 304|16@1+ (0.01,-327.68) [-30|30] "deg"  DASy
 SG_ RFC_Loc019_DrVnce : 320|16@1+ (1.52588E-005,0) [0|0.999984741210937] "m^2"  DASy
 SG_ RFC_Loc019_VrVnce : 336|16@1+ (1.52588E-005,0) [0|0.999984741210937] "m^2/s^2"  DASy
 SG_ RFC_Loc019_ThetaVnce : 352|16@1+ (0.00390625,0) [0|255.99609375] "deg^2"  DASy
 SG_ RFC_Loc019_PhiVnce : 368|16@1+ (0.00390625,0) [0|255.99609375] "deg^2"  DASy
 SG_ RFC_Loc019_DrVrCoVnce : 384|16@1+ (3.814697265625E-006,-0.125) [-0.125|0.124996185302734] "m^2/s"  DASy
 SG_ RFC_Loc019_RCS : 400|16@1+ (0.00390625,-128) [-128|127.99609375] "dBsm"  DASy
 SG_ RFC_Loc019_RSSI : 416|16@1+ (0.00195312,0) [0|127.998046875] "dimensionless"  DASy
 SG_ RFC_Loc019_DrVrQuality : 432|8@1+ (1,0) [0|255] "dimensionless"  DASy
 SG_ RFC_Loc019_ThetaQuality : 440|8@1+ (1,0) [0|255] "dimensionless"  DASy
 SG_ RFC_Loc019_PhiQuality : 448|8@1+ (1,0) [0|255] "dimensionless"  DASy

BO_ 410 RFC_Location_020_021: 64 RadarFrontCenter
 SG_ RFC_Loc020_CRC : 0|16@1+ (1,0) [0|65535] ""  DASy
 SG_ RFC_Loc020_AliveCtr : 16|8@1+ (1,0) [0|255] ""  DASy
 SG_ RFC_Loc020_ProtBlockCtr : 24|8@1+ (1,0) [0|255] ""  DASy
 SG_ RFC_Loc020_Dr : 32|16@1+ (0.0078125,0) [0|511.9921875] "m"  DASy
 SG_ RFC_Loc020_Vr : 48|16@1+ (0.00390625,-128) [-128|127.99609375] "m/s"  DASy
 SG_ RFC_Loc020_Theta : 64|16@1+ (0.01,-327.68) [-90|90] "deg"  DASy
 SG_ RFC_Loc020_Phi : 80|16@1+ (0.01,-327.68) [-30|30] "deg"  DASy
 SG_ RFC_Loc020_DrVnce : 96|16@1+ (1.52588E-005,0) [0|0.999984741210937] "m^2"  DASy
 SG_ RFC_Loc020_VrVnce : 112|16@1+ (1.52588E-005,0) [0|0.999984741210937] "m^2/s^2"  DASy
 SG_ RFC_Loc020_ThetaVnce : 128|16@1+ (0.00390625,0) [0|255.99609375] "deg^2"  DASy
 SG_ RFC_Loc020_PhiVnce : 144|16@1+ (0.00390625,0) [0|255.99609375] "deg^2"  DASy
 SG_ RFC_Loc020_DrVrCoVnce : 160|16@1+ (3.814697265625E-006,-0.125) [-0.125|0.124996185302734] "m^2/s"  DASy
 SG_ RFC_Loc020_RCS : 176|16@1+ (0.00390625,-128) [-128|127.99609375] "dBsm"  DASy
 SG_ RFC_Loc020_RSSI : 192|16@1+ (0.00195312,0) [0|127.998046875] "dimensionless"  DASy
 SG_ RFC_Loc020_DrVrQuality : 208|8@1+ (1,0) [0|255] "dimensionless"  DASy
 SG_ RFC_Loc020_ThetaQuality : 216|8@1+ (1,0) [0|255] "dimensionless"  DASy
 SG_ RFC_Loc020_PhiQuality : 224|8@1+ (1,0) [0|255] "dimensionless"  DASy
 SG_ RFC_Loc021_Dr : 256|16@1+ (0.0078125,0) [0|511.9921875] "m"  DASy
 SG_ RFC_Loc021_Vr : 272|16@1+ (0.00390625,-128) [-128|127.99609375] "m/s"  DASy
 SG_ RFC_Loc021_Theta : 288|16@1+ (0.01,-327.68) [-90|90] "deg"  DASy
 SG_ RFC_Loc021_Phi : 304|16@1+ (0.01,-327.68) [-30|30] "deg"  DASy
 SG_ RFC_Loc021_DrVnce : 320|16@1+ (1.52588E-005,0) [0|0.999984741210937] "m^2"  DASy
 SG_ RFC_Loc021_VrVnce : 336|16@1+ (1.52588E-005,0) [0|0.999984741210937] "m^2/s^2"  DASy
 SG_ RFC_Loc021_ThetaVnce : 352|16@1+ (0.00390625,0) [0|255.99609375] "deg^2"  DASy
 SG_ RFC_Loc021_PhiVnce : 368|16@1+ (0.00390625,0) [0|255.99609375] "deg^2"  DASy
 SG_ RFC_Loc021_DrVrCoVnce : 384|16@1+ (3.814697265625E-006,-0.125) [-0.125|0.124996185302734] "m^2/s"  DASy
 SG_ RFC_Loc021_RCS : 400|16@1+ (0.00390625,-128) [-128|127.99609375] "dBsm"  DASy
 SG_ RFC_Loc021_RSSI : 416|16@1+ (0.00195312,0) [0|127.998046875] "dimensionless"  DASy
 SG_ RFC_Loc021_DrVrQuality : 432|8@1+ (1,0) [0|255] "dimensionless"  DASy
 SG_ RFC_Loc021_ThetaQuality : 440|8@1+ (1,0) [0|255] "dimensionless"  DASy
 SG_ RFC_Loc021_PhiQuality : 448|8@1+ (1,0) [0|255] "dimensionless"  DASy

BO_ 411 RFC_Location_022_023: 64 RadarFrontCenter
 SG_ RFC_Loc022_CRC : 0|16@1+ (1,0) [0|65535] ""  DASy
 SG_ RFC_Loc022_AliveCtr : 16|8@1+ (1,0) [0|255] ""  DASy
 SG_ RFC_Loc022_ProtBlockCtr : 24|8@1+ (1,0) [0|255] ""  DASy
 SG_ RFC_Loc022_Dr : 32|16@1+ (0.0078125,0) [0|511.9921875] "m"  DASy
 SG_ RFC_Loc022_Vr : 48|16@1+ (0.00390625,-128) [-128|127.99609375] "m/s"  DASy
 SG_ RFC_Loc022_Theta : 64|16@1+ (0.01,-327.68) [-90|90] "deg"  DASy
 SG_ RFC_Loc022_Phi : 80|16@1+ (0.01,-327.68) [-30|30] "deg"  DASy
 SG_ RFC_Loc022_DrVnce : 96|16@1+ (1.52588E-005,0) [0|0.999984741210937] "m^2"  DASy
 SG_ RFC_Loc022_VrVnce : 112|16@1+ (1.52588E-005,0) [0|0.999984741210937] "m^2/s^2"  DASy
 SG_ RFC_Loc022_ThetaVnce : 128|16@1+ (0.00390625,0) [0|255.99609375] "deg^2"  DASy
 SG_ RFC_Loc022_PhiVnce : 144|16@1+ (0.00390625,0) [0|255.99609375] "deg^2"  DASy
 SG_ RFC_Loc022_DrVrCoVnce : 160|16@1+ (3.814697265625E-006,-0.125) [-0.125|0.124996185302734] "m^2/s"  DASy
 SG_ RFC_Loc022_RCS : 176|16@1+ (0.00390625,-128) [-128|127.99609375] "dBsm"  DASy
 SG_ RFC_Loc022_RSSI : 192|16@1+ (0.00195312,0) [0|127.998046875] "dimensionless"  DASy
 SG_ RFC_Loc022_DrVrQuality : 208|8@1+ (1,0) [0|255] "dimensionless"  DASy
 SG_ RFC_Loc022_ThetaQuality : 216|8@1+ (1,0) [0|255] "dimensionless"  DASy
 SG_ RFC_Loc022_PhiQuality : 224|8@1+ (1,0) [0|255] "dimensionless"  DASy
 SG_ RFC_Loc023_Dr : 256|16@1+ (0.0078125,0) [0|511.9921875] "m"  DASy
 SG_ RFC_Loc023_Vr : 272|16@1+ (0.00390625,-128) [-128|127.99609375] "m/s"  DASy
 SG_ RFC_Loc023_Theta : 288|16@1+ (0.01,-327.68) [-90|90] "deg"  DASy
 SG_ RFC_Loc023_Phi : 304|16@1+ (0.01,-327.68) [-30|30] "deg"  DASy
 SG_ RFC_Loc023_DrVnce : 320|16@1+ (1.52588E-005,0) [0|0.999984741210937] "m^2"  DASy
 SG_ RFC_Loc023_VrVnce : 336|16@1+ (1.52588E-005,0) [0|0.999984741210937] "m^2/s^2"  DASy
 SG_ RFC_Loc023_ThetaVnce : 352|16@1+ (0.00390625,0) [0|255.99609375] "deg^2"  DASy
 SG_ RFC_Loc023_PhiVnce : 368|16@1+ (0.00390625,0) [0|255.99609375] "deg^2"  DASy
 SG_ RFC_Loc023_DrVrCoVnce : 384|16@1+ (3.814697265625E-006,-0.125) [-0.125|0.124996185302734] "m^2/s"  DASy
 SG_ RFC_Loc023_RCS : 400|16@1+ (0.00390625,-128) [-128|127.99609375] "dBsm"  DASy
 SG_ RFC_Loc023_RSSI : 416|16@1+ (0.00195312,0) [0|127.998046875] "dimensionless"  DASy
 SG_ RFC_Loc023_DrVrQuality : 432|8@1+ (1,0) [0|255] "dimensionless"  DASy
 SG_ RFC_Loc023_ThetaQuality : 440|8@1+ (1,0) [0|255] "dimensionless"  DASy
 SG_ RFC_Loc023_PhiQuality : 448|8@1+ (1,0) [0|255] "dimensionless"  DASy

BO_ 412 RFC_Location_024_025: 64 RadarFrontCenter
 SG_ RFC_Loc024_CRC : 0|16@1+ (1,0) [0|65535] ""  DASy
 SG_ RFC_Loc024_AliveCtr : 16|8@1+ (1,0) [0|255] ""  DASy
 SG_ RFC_Loc024_ProtBlockCtr : 24|8@1+ (1,0) [0|255] ""  DASy
 SG_ RFC_Loc024_Dr : 32|16@1+ (0.0078125,0) [0|511.9921875] "m"  DASy
 SG_ RFC_Loc024_Vr : 48|16@1+ (0.00390625,-128) [-128|127.99609375] "m/s"  DASy
 SG_ RFC_Loc024_Theta : 64|16@1+ (0.01,-327.68) [-90|90] "deg"  DASy
 SG_ RFC_Loc024_Phi : 80|16@1+ (0.01,-327.68) [-30|30] "deg"  DASy
 SG_ RFC_Loc024_DrVnce : 96|16@1+ (1.52588E-005,0) [0|0.999984741210937] "m^2"  DASy
 SG_ RFC_Loc024_VrVnce : 112|16@1+ (1.52588E-005,0) [0|0.999984741210937] "m^2/s^2"  DASy
 SG_ RFC_Loc024_ThetaVnce : 128|16@1+ (0.00390625,0) [0|255.99609375] "deg^2"  DASy
 SG_ RFC_Loc024_PhiVnce : 144|16@1+ (0.00390625,0) [0|255.99609375] "deg^2"  DASy
 SG_ RFC_Loc024_DrVrCoVnce : 160|16@1+ (3.814697265625E-006,-0.125) [-0.125|0.124996185302734] "m^2/s"  DASy
 SG_ RFC_Loc024_RCS : 176|16@1+ (0.00390625,-128) [-128|127.99609375] "dBsm"  DASy
 SG_ RFC_Loc024_RSSI : 192|16@1+ (0.00195312,0) [0|127.998046875] "dimensionless"  DASy
 SG_ RFC_Loc024_DrVrQuality : 208|8@1+ (1,0) [0|255] "dimensionless"  DASy
 SG_ RFC_Loc024_ThetaQuality : 216|8@1+ (1,0) [0|255] "dimensionless"  DASy
 SG_ RFC_Loc024_PhiQuality : 224|8@1+ (1,0) [0|255] "dimensionless"  DASy
 SG_ RFC_Loc025_Dr : 256|16@1+ (0.0078125,0) [0|511.9921875] "m"  DASy
 SG_ RFC_Loc025_Vr : 272|16@1+ (0.00390625,-128) [-128|127.99609375] "m/s"  DASy
 SG_ RFC_Loc025_Theta : 288|16@1+ (0.01,-327.68) [-90|90] "deg"  DASy
 SG_ RFC_Loc025_Phi : 304|16@1+ (0.01,-327.68) [-30|30] "deg"  DASy
 SG_ RFC_Loc025_DrVnce : 320|16@1+ (1.52588E-005,0) [0|0.999984741210937] "m^2"  DASy
 SG_ RFC_Loc025_VrVnce : 336|16@1+ (1.52588E-005,0) [0|0.999984741210937] "m^2/s^2"  DASy
 SG_ RFC_Loc025_ThetaVnce : 352|16@1+ (0.00390625,0) [0|255.99609375] "deg^2"  DASy
 SG_ RFC_Loc025_PhiVnce : 368|16@1+ (0.00390625,0) [0|255.99609375] "deg^2"  DASy
 SG_ RFC_Loc025_DrVrCoVnce : 384|16@1+ (3.814697265625E-006,-0.125) [-0.125|0.124996185302734] "m^2/s"  DASy
 SG_ RFC_Loc025_RCS : 400|16@1+ (0.00390625,-128) [-128|127.99609375] "dBsm"  DASy
 SG_ RFC_Loc025_RSSI : 416|16@1+ (0.00195312,0) [0|127.998046875] "dimensionless"  DASy
 SG_ RFC_Loc025_DrVrQuality : 432|8@1+ (1,0) [0|255] "dimensionless"  DASy
 SG_ RFC_Loc025_ThetaQuality : 440|8@1+ (1,0) [0|255] "dimensionless"  DASy
 SG_ RFC_Loc025_PhiQuality : 448|8@1+ (1,0) [0|255] "dimensionless"  DASy

BO_ 413 RFC_Location_026_027: 64 RadarFrontCenter
 SG_ RFC_Loc026_CRC : 0|16@1+ (1,0) [0|65535] ""  DASy
 SG_ RFC_Loc026_AliveCtr : 16|8@1+ (1,0) [0|255] ""  DASy
 SG_ RFC_Loc026_ProtBlockCtr : 24|8@1+ (1,0) [0|255] ""  DASy
 SG_ RFC_Loc026_Dr : 32|16@1+ (0.0078125,0) [0|511.9921875] "m"  DASy
 SG_ RFC_Loc026_Vr : 48|16@1+ (0.00390625,-128) [-128|127.99609375] "m/s"  DASy
 SG_ RFC_Loc026_Theta : 64|16@1+ (0.01,-327.68) [-90|90] "deg"  DASy
 SG_ RFC_Loc026_Phi : 80|16@1+ (0.01,-327.68) [-30|30] "deg"  DASy
 SG_ RFC_Loc026_DrVnce : 96|16@1+ (1.52588E-005,0) [0|0.999984741210937] "m^2"  DASy
 SG_ RFC_Loc026_VrVnce : 112|16@1+ (1.52588E-005,0) [0|0.999984741210937] "m^2/s^2"  DASy
 SG_ RFC_Loc026_ThetaVnce : 128|16@1+ (0.00390625,0) [0|255.99609375] "deg^2"  DASy
 SG_ RFC_Loc026_PhiVnce : 144|16@1+ (0.00390625,0) [0|255.99609375] "deg^2"  DASy
 SG_ RFC_Loc026_DrVrCoVnce : 160|16@1+ (3.814697265625E-006,-0.125) [-0.125|0.124996185302734] "m^2/s"  DASy
 SG_ RFC_Loc026_RCS : 176|16@1+ (0.00390625,-128) [-128|127.99609375] "dBsm"  DASy
 SG_ RFC_Loc026_RSSI : 192|16@1+ (0.00195312,0) [0|127.998046875] "dimensionless"  DASy
 SG_ RFC_Loc026_DrVrQuality : 208|8@1+ (1,0) [0|255] "dimensionless"  DASy
 SG_ RFC_Loc026_ThetaQuality : 216|8@1+ (1,0) [0|255] "dimensionless"  DASy
 SG_ RFC_Loc026_PhiQuality : 224|8@1+ (1,0) [0|255] "dimensionless"  DASy
 SG_ RFC_Loc027_Dr : 256|16@1+ (0.0078125,0) [0|511.9921875] "m"  DASy
 SG_ RFC_Loc027_Vr : 272|16@1+ (0.00390625,-128) [-128|127.99609375] "m/s"  DASy
 SG_ RFC_Loc027_Theta : 288|16@1+ (0.01,-327.68) [-90|90] "deg"  DASy
 SG_ RFC_Loc027_Phi : 304|16@1+ (0.01,-327.68) [-30|30] "deg"  DASy
 SG_ RFC_Loc027_DrVnce : 320|16@1+ (1.52588E-005,0) [0|0.999984741210937] "m^2"  DASy
 SG_ RFC_Loc027_VrVnce : 336|16@1+ (1.52588E-005,0) [0|0.999984741210937] "m^2/s^2"  DASy
 SG_ RFC_Loc027_ThetaVnce : 352|16@1+ (0.00390625,0) [0|255.99609375] "deg^2"  DASy
 SG_ RFC_Loc027_PhiVnce : 368|16@1+ (0.00390625,0) [0|255.99609375] "deg^2"  DASy
 SG_ RFC_Loc027_DrVrCoVnce : 384|16@1+ (3.814697265625E-006,-0.125) [-0.125|0.124996185302734] "m^2/s"  DASy
 SG_ RFC_Loc027_RCS : 400|16@1+ (0.00390625,-128) [-128|127.99609375] "dBsm"  DASy
 SG_ RFC_Loc027_RSSI : 416|16@1+ (0.00195312,0) [0|127.998046875] "dimensionless"  DASy
 SG_ RFC_Loc027_DrVrQuality : 432|8@1+ (1,0) [0|255] "dimensionless"  DASy
 SG_ RFC_Loc027_ThetaQuality : 440|8@1+ (1,0) [0|255] "dimensionless"  DASy
 SG_ RFC_Loc027_PhiQuality : 448|8@1+ (1,0) [0|255] "dimensionless"  DASy

BO_ 414 RFC_Location_028_029: 64 RadarFrontCenter
 SG_ RFC_Loc028_CRC : 0|16@1+ (1,0) [0|65535] ""  DASy
 SG_ RFC_Loc028_AliveCtr : 16|8@1+ (1,0) [0|255] ""  DASy
 SG_ RFC_Loc028_ProtBlockCtr : 24|8@1+ (1,0) [0|255] ""  DASy
 SG_ RFC_Loc028_Dr : 32|16@1+ (0.0078125,0) [0|511.9921875] "m"  DASy
 SG_ RFC_Loc028_Vr : 48|16@1+ (0.00390625,-128) [-128|127.99609375] "m/s"  DASy
 SG_ RFC_Loc028_Theta : 64|16@1+ (0.01,-327.68) [-90|90] "deg"  DASy
 SG_ RFC_Loc028_Phi : 80|16@1+ (0.01,-327.68) [-30|30] "deg"  DASy
 SG_ RFC_Loc028_DrVnce : 96|16@1+ (1.52588E-005,0) [0|0.999984741210937] "m^2"  DASy
 SG_ RFC_Loc028_VrVnce : 112|16@1+ (1.52588E-005,0) [0|0.999984741210937] "m^2/s^2"  DASy
 SG_ RFC_Loc028_ThetaVnce : 128|16@1+ (0.00390625,0) [0|255.99609375] "deg^2"  DASy
 SG_ RFC_Loc028_PhiVnce : 144|16@1+ (0.00390625,0) [0|255.99609375] "deg^2"  DASy
 SG_ RFC_Loc028_DrVrCoVnce : 160|16@1+ (3.814697265625E-006,-0.125) [-0.125|0.124996185302734] "m^2/s"  DASy
 SG_ RFC_Loc028_RCS : 176|16@1+ (0.00390625,-128) [-128|127.99609375] "dBsm"  DASy
 SG_ RFC_Loc028_RSSI : 192|16@1+ (0.00195312,0) [0|127.998046875] "dimensionless"  DASy
 SG_ RFC_Loc028_DrVrQuality : 208|8@1+ (1,0) [0|255] "dimensionless"  DASy
 SG_ RFC_Loc028_ThetaQuality : 216|8@1+ (1,0) [0|255] "dimensionless"  DASy
 SG_ RFC_Loc028_PhiQuality : 224|8@1+ (1,0) [0|255] "dimensionless"  DASy
 SG_ RFC_Loc029_Dr : 256|16@1+ (0.0078125,0) [0|511.9921875] "m"  DASy
 SG_ RFC_Loc029_Vr : 272|16@1+ (0.00390625,-128) [-128|127.99609375] "m/s"  DASy
 SG_ RFC_Loc029_Theta : 288|16@1+ (0.01,-327.68) [-90|90] "deg"  DASy
 SG_ RFC_Loc029_Phi : 304|16@1+ (0.01,-327.68) [-30|30] "deg"  DASy
 SG_ RFC_Loc029_DrVnce : 320|16@1+ (1.52588E-005,0) [0|0.999984741210937] "m^2"  DASy
 SG_ RFC_Loc029_VrVnce : 336|16@1+ (1.52588E-005,0) [0|0.999984741210937] "m^2/s^2"  DASy
 SG_ RFC_Loc029_ThetaVnce : 352|16@1+ (0.00390625,0) [0|255.99609375] "deg^2"  DASy
 SG_ RFC_Loc029_PhiVnce : 368|16@1+ (0.00390625,0) [0|255.99609375] "deg^2"  DASy
 SG_ RFC_Loc029_DrVrCoVnce : 384|16@1+ (3.814697265625E-006,-0.125) [-0.125|0.124996185302734] "m^2/s"  DASy
 SG_ RFC_Loc029_RCS : 400|16@1+ (0.00390625,-128) [-128|127.99609375] "dBsm"  DASy
 SG_ RFC_Loc029_RSSI : 416|16@1+ (0.00195312,0) [0|127.998046875] "dimensionless"  DASy
 SG_ RFC_Loc029_DrVrQuality : 432|8@1+ (1,0) [0|255] "dimensionless"  DASy
 SG_ RFC_Loc029_ThetaQuality : 440|8@1+ (1,0) [0|255] "dimensionless"  DASy
 SG_ RFC_Loc029_PhiQuality : 448|8@1+ (1,0) [0|255] "dimensionless"  DASy

BO_ 415 RFC_Location_030_031: 64 RadarFrontCenter
 SG_ RFC_Loc030_CRC : 0|16@1+ (1,0) [0|65535] ""  DASy
 SG_ RFC_Loc030_AliveCtr : 16|8@1+ (1,0) [0|255] ""  DASy
 SG_ RFC_Loc030_ProtBlockCtr : 24|8@1+ (1,0) [0|255] ""  DASy
 SG_ RFC_Loc030_Dr : 32|16@1+ (0.0078125,0) [0|511.9921875] "m"  DASy
 SG_ RFC_Loc030_Vr : 48|16@1+ (0.00390625,-128) [-128|127.99609375] "m/s"  DASy
 SG_ RFC_Loc030_Theta : 64|16@1+ (0.01,-327.68) [-90|90] "deg"  DASy
 SG_ RFC_Loc030_Phi : 80|16@1+ (0.01,-327.68) [-30|30] "deg"  DASy
 SG_ RFC_Loc030_DrVnce : 96|16@1+ (1.52588E-005,0) [0|0.999984741210937] "m^2"  DASy
 SG_ RFC_Loc030_VrVnce : 112|16@1+ (1.52588E-005,0) [0|0.999984741210937] "m^2/s^2"  DASy
 SG_ RFC_Loc030_ThetaVnce : 128|16@1+ (0.00390625,0) [0|255.99609375] "deg^2"  DASy
 SG_ RFC_Loc030_PhiVnce : 144|16@1+ (0.00390625,0) [0|255.99609375] "deg^2"  DASy
 SG_ RFC_Loc030_DrVrCoVnce : 160|16@1+ (3.814697265625E-006,-0.125) [-0.125|0.124996185302734] "m^2/s"  DASy
 SG_ RFC_Loc030_RCS : 176|16@1+ (0.00390625,-128) [-128|127.99609375] "dBsm"  DASy
 SG_ RFC_Loc030_RSSI : 192|16@1+ (0.00195312,0) [0|127.998046875] "dimensionless"  DASy
 SG_ RFC_Loc030_DrVrQuality : 208|8@1+ (1,0) [0|255] "dimensionless"  DASy
 SG_ RFC_Loc030_ThetaQuality : 216|8@1+ (1,0) [0|255] "dimensionless"  DASy
 SG_ RFC_Loc030_PhiQuality : 224|8@1+ (1,0) [0|255] "dimensionless"  DASy
 SG_ RFC_Loc031_Dr : 256|16@1+ (0.0078125,0) [0|511.9921875] "m"  DASy
 SG_ RFC_Loc031_Vr : 272|16@1+ (0.00390625,-128) [-128|127.99609375] "m/s"  DASy
 SG_ RFC_Loc031_Theta : 288|16@1+ (0.01,-327.68) [-90|90] "deg"  DASy
 SG_ RFC_Loc031_Phi : 304|16@1+ (0.01,-327.68) [-30|30] "deg"  DASy
 SG_ RFC_Loc031_DrVnce : 320|16@1+ (1.52588E-005,0) [0|0.999984741210937] "m^2"  DASy
 SG_ RFC_Loc031_VrVnce : 336|16@1+ (1.52588E-005,0) [0|0.999984741210937] "m^2/s^2"  DASy
 SG_ RFC_Loc031_ThetaVnce : 352|16@1+ (0.00390625,0) [0|255.99609375] "deg^2"  DASy
 SG_ RFC_Loc031_PhiVnce : 368|16@1+ (0.00390625,0) [0|255.99609375] "deg^2"  DASy
 SG_ RFC_Loc031_DrVrCoVnce : 384|16@1+ (3.814697265625E-006,-0.125) [-0.125|0.124996185302734] "m^2/s"  DASy
 SG_ RFC_Loc031_RCS : 400|16@1+ (0.00390625,-128) [-128|127.99609375] "dBsm"  DASy
 SG_ RFC_Loc031_RSSI : 416|16@1+ (0.00195312,0) [0|127.998046875] "dimensionless"  DASy
 SG_ RFC_Loc031_DrVrQuality : 432|8@1+ (1,0) [0|255] "dimensionless"  DASy
 SG_ RFC_Loc031_ThetaQuality : 440|8@1+ (1,0) [0|255] "dimensionless"  DASy
 SG_ RFC_Loc031_PhiQuality : 448|8@1+ (1,0) [0|255] "dimensionless"  DASy

BO_ 416 RFC_Location_032_033: 64 RadarFrontCenter
 SG_ RFC_Loc032_CRC : 0|16@1+ (1,0) [0|65535] ""  DASy
 SG_ RFC_Loc032_AliveCtr : 16|8@1+ (1,0) [0|255] ""  DASy
 SG_ RFC_Loc032_ProtBlockCtr : 24|8@1+ (1,0) [0|255] ""  DASy
 SG_ RFC_Loc032_Dr : 32|16@1+ (0.0078125,0) [0|511.9921875] "m"  DASy
 SG_ RFC_Loc032_Vr : 48|16@1+ (0.00390625,-128) [-128|127.99609375] "m/s"  DASy
 SG_ RFC_Loc032_Theta : 64|16@1+ (0.01,-327.68) [-90|90] "deg"  DASy
 SG_ RFC_Loc032_Phi : 80|16@1+ (0.01,-327.68) [-30|30] "deg"  DASy
 SG_ RFC_Loc032_DrVnce : 96|16@1+ (1.52588E-005,0) [0|0.999984741210937] "m^2"  DASy
 SG_ RFC_Loc032_VrVnce : 112|16@1+ (1.52588E-005,0) [0|0.999984741210937] "m^2/s^2"  DASy
 SG_ RFC_Loc032_ThetaVnce : 128|16@1+ (0.00390625,0) [0|255.99609375] "deg^2"  DASy
 SG_ RFC_Loc032_PhiVnce : 144|16@1+ (0.00390625,0) [0|255.99609375] "deg^2"  DASy
 SG_ RFC_Loc032_DrVrCoVnce : 160|16@1+ (3.814697265625E-006,-0.125) [-0.125|0.124996185302734] "m^2/s"  DASy
 SG_ RFC_Loc032_RCS : 176|16@1+ (0.00390625,-128) [-128|127.99609375] "dBsm"  DASy
 SG_ RFC_Loc032_RSSI : 192|16@1+ (0.00195312,0) [0|127.998046875] "dimensionless"  DASy
 SG_ RFC_Loc032_DrVrQuality : 208|8@1+ (1,0) [0|255] "dimensionless"  DASy
 SG_ RFC_Loc032_ThetaQuality : 216|8@1+ (1,0) [0|255] "dimensionless"  DASy
 SG_ RFC_Loc032_PhiQuality : 224|8@1+ (1,0) [0|255] "dimensionless"  DASy
 SG_ RFC_Loc033_Dr : 256|16@1+ (0.0078125,0) [0|511.9921875] "m"  DASy
 SG_ RFC_Loc033_Vr : 272|16@1+ (0.00390625,-128) [-128|127.99609375] "m/s"  DASy
 SG_ RFC_Loc033_Theta : 288|16@1+ (0.01,-327.68) [-90|90] "deg"  DASy
 SG_ RFC_Loc033_Phi : 304|16@1+ (0.01,-327.68) [-30|30] "deg"  DASy
 SG_ RFC_Loc033_DrVnce : 320|16@1+ (1.52588E-005,0) [0|0.999984741210937] "m^2"  DASy
 SG_ RFC_Loc033_VrVnce : 336|16@1+ (1.52588E-005,0) [0|0.999984741210937] "m^2/s^2"  DASy
 SG_ RFC_Loc033_ThetaVnce : 352|16@1+ (0.00390625,0) [0|255.99609375] "deg^2"  DASy
 SG_ RFC_Loc033_PhiVnce : 368|16@1+ (0.00390625,0) [0|255.99609375] "deg^2"  DASy
 SG_ RFC_Loc033_DrVrCoVnce : 384|16@1+ (3.814697265625E-006,-0.125) [-0.125|0.124996185302734] "m^2/s"  DASy
 SG_ RFC_Loc033_RCS : 400|16@1+ (0.00390625,-128) [-128|127.99609375] "dBsm"  DASy
 SG_ RFC_Loc033_RSSI : 416|16@1+ (0.00195312,0) [0|127.998046875] "dimensionless"  DASy
 SG_ RFC_Loc033_DrVrQuality : 432|8@1+ (1,0) [0|255] "dimensionless"  DASy
 SG_ RFC_Loc033_ThetaQuality : 440|8@1+ (1,0) [0|255] "dimensionless"  DASy
 SG_ RFC_Loc033_PhiQuality : 448|8@1+ (1,0) [0|255] "dimensionless"  DASy

BO_ 417 RFC_Location_034_035: 64 RadarFrontCenter
 SG_ RFC_Loc034_CRC : 0|16@1+ (1,0) [0|65535] ""  DASy
 SG_ RFC_Loc034_AliveCtr : 16|8@1+ (1,0) [0|255] ""  DASy
 SG_ RFC_Loc034_ProtBlockCtr : 24|8@1+ (1,0) [0|255] ""  DASy
 SG_ RFC_Loc034_Dr : 32|16@1+ (0.0078125,0) [0|511.9921875] "m"  DASy
 SG_ RFC_Loc034_Vr : 48|16@1+ (0.00390625,-128) [-128|127.99609375] "m/s"  DASy
 SG_ RFC_Loc034_Theta : 64|16@1+ (0.01,-327.68) [-90|90] "deg"  DASy
 SG_ RFC_Loc034_Phi : 80|16@1+ (0.01,-327.68) [-30|30] "deg"  DASy
 SG_ RFC_Loc034_DrVnce : 96|16@1+ (1.52588E-005,0) [0|0.999984741210937] "m^2"  DASy
 SG_ RFC_Loc034_VrVnce : 112|16@1+ (1.52588E-005,0) [0|0.999984741210937] "m^2/s^2"  DASy
 SG_ RFC_Loc034_ThetaVnce : 128|16@1+ (0.00390625,0) [0|255.99609375] "deg^2"  DASy
 SG_ RFC_Loc034_PhiVnce : 144|16@1+ (0.00390625,0) [0|255.99609375] "deg^2"  DASy
 SG_ RFC_Loc034_DrVrCoVnce : 160|16@1+ (3.814697265625E-006,-0.125) [-0.125|0.124996185302734] "m^2/s"  DASy
 SG_ RFC_Loc034_RCS : 176|16@1+ (0.00390625,-128) [-128|127.99609375] "dBsm"  DASy
 SG_ RFC_Loc034_RSSI : 192|16@1+ (0.00195312,0) [0|127.998046875] "dimensionless"  DASy
 SG_ RFC_Loc034_DrVrQuality : 208|8@1+ (1,0) [0|255] "dimensionless"  DASy
 SG_ RFC_Loc034_ThetaQuality : 216|8@1+ (1,0) [0|255] "dimensionless"  DASy
 SG_ RFC_Loc034_PhiQuality : 224|8@1+ (1,0) [0|255] "dimensionless"  DASy
 SG_ RFC_Loc035_Dr : 256|16@1+ (0.0078125,0) [0|511.9921875] "m"  DASy
 SG_ RFC_Loc035_Vr : 272|16@1+ (0.00390625,-128) [-128|127.99609375] "m/s"  DASy
 SG_ RFC_Loc035_Theta : 288|16@1+ (0.01,-327.68) [-90|90] "deg"  DASy
 SG_ RFC_Loc035_Phi : 304|16@1+ (0.01,-327.68) [-30|30] "deg"  DASy
 SG_ RFC_Loc035_DrVnce : 320|16@1+ (1.52588E-005,0) [0|0.999984741210937] "m^2"  DASy
 SG_ RFC_Loc035_VrVnce : 336|16@1+ (1.52588E-005,0) [0|0.999984741210937] "m^2/s^2"  DASy
 SG_ RFC_Loc035_ThetaVnce : 352|16@1+ (0.00390625,0) [0|255.99609375] "deg^2"  DASy
 SG_ RFC_Loc035_PhiVnce : 368|16@1+ (0.00390625,0) [0|255.99609375] "deg^2"  DASy
 SG_ RFC_Loc035_DrVrCoVnce : 384|16@1+ (3.814697265625E-006,-0.125) [-0.125|0.124996185302734] "m^2/s"  DASy
 SG_ RFC_Loc035_RCS : 400|16@1+ (0.00390625,-128) [-128|127.99609375] "dBsm"  DASy
 SG_ RFC_Loc035_RSSI : 416|16@1+ (0.00195312,0) [0|127.998046875] "dimensionless"  DASy
 SG_ RFC_Loc035_DrVrQuality : 432|8@1+ (1,0) [0|255] "dimensionless"  DASy
 SG_ RFC_Loc035_ThetaQuality : 440|8@1+ (1,0) [0|255] "dimensionless"  DASy
 SG_ RFC_Loc035_PhiQuality : 448|8@1+ (1,0) [0|255] "dimensionless"  DASy

BO_ 418 RFC_Location_036_037: 64 RadarFrontCenter
 SG_ RFC_Loc036_CRC : 0|16@1+ (1,0) [0|65535] ""  DASy
 SG_ RFC_Loc036_AliveCtr : 16|8@1+ (1,0) [0|255] ""  DASy
 SG_ RFC_Loc036_ProtBlockCtr : 24|8@1+ (1,0) [0|255] ""  DASy
 SG_ RFC_Loc036_Dr : 32|16@1+ (0.0078125,0) [0|511.9921875] "m"  DASy
 SG_ RFC_Loc036_Vr : 48|16@1+ (0.00390625,-128) [-128|127.99609375] "m/s"  DASy
 SG_ RFC_Loc036_Theta : 64|16@1+ (0.01,-327.68) [-90|90] "deg"  DASy
 SG_ RFC_Loc036_Phi : 80|16@1+ (0.01,-327.68) [-30|30] "deg"  DASy
 SG_ RFC_Loc036_DrVnce : 96|16@1+ (1.52588E-005,0) [0|0.999984741210937] "m^2"  DASy
 SG_ RFC_Loc036_VrVnce : 112|16@1+ (1.52588E-005,0) [0|0.999984741210937] "m^2/s^2"  DASy
 SG_ RFC_Loc036_ThetaVnce : 128|16@1+ (0.00390625,0) [0|255.99609375] "deg^2"  DASy
 SG_ RFC_Loc036_PhiVnce : 144|16@1+ (0.00390625,0) [0|255.99609375] "deg^2"  DASy
 SG_ RFC_Loc036_DrVrCoVnce : 160|16@1+ (3.814697265625E-006,-0.125) [-0.125|0.124996185302734] "m^2/s"  DASy
 SG_ RFC_Loc036_RCS : 176|16@1+ (0.00390625,-128) [-128|127.99609375] "dBsm"  DASy
 SG_ RFC_Loc036_RSSI : 192|16@1+ (0.00195312,0) [0|127.998046875] "dimensionless"  DASy
 SG_ RFC_Loc036_DrVrQuality : 208|8@1+ (1,0) [0|255] "dimensionless"  DASy
 SG_ RFC_Loc036_ThetaQuality : 216|8@1+ (1,0) [0|255] "dimensionless"  DASy
 SG_ RFC_Loc036_PhiQuality : 224|8@1+ (1,0) [0|255] "dimensionless"  DASy
 SG_ RFC_Loc037_Dr : 256|16@1+ (0.0078125,0) [0|511.9921875] "m"  DASy
 SG_ RFC_Loc037_Vr : 272|16@1+ (0.00390625,-128) [-128|127.99609375] "m/s"  DASy
 SG_ RFC_Loc037_Theta : 288|16@1+ (0.01,-327.68) [-90|90] "deg"  DASy
 SG_ RFC_Loc037_Phi : 304|16@1+ (0.01,-327.68) [-30|30] "deg"  DASy
 SG_ RFC_Loc037_DrVnce : 320|16@1+ (1.52588E-005,0) [0|0.999984741210937] "m^2"  DASy
 SG_ RFC_Loc037_VrVnce : 336|16@1+ (1.52588E-005,0) [0|0.999984741210937] "m^2/s^2"  DASy
 SG_ RFC_Loc037_ThetaVnce : 352|16@1+ (0.00390625,0) [0|255.99609375] "deg^2"  DASy
 SG_ RFC_Loc037_PhiVnce : 368|16@1+ (0.00390625,0) [0|255.99609375] "deg^2"  DASy
 SG_ RFC_Loc037_DrVrCoVnce : 384|16@1+ (3.814697265625E-006,-0.125) [-0.125|0.124996185302734] "m^2/s"  DASy
 SG_ RFC_Loc037_RCS : 400|16@1+ (0.00390625,-128) [-128|127.99609375] "dBsm"  DASy
 SG_ RFC_Loc037_RSSI : 416|16@1+ (0.00195312,0) [0|127.998046875] "dimensionless"  DASy
 SG_ RFC_Loc037_DrVrQuality : 432|8@1+ (1,0) [0|255] "dimensionless"  DASy
 SG_ RFC_Loc037_ThetaQuality : 440|8@1+ (1,0) [0|255] "dimensionless"  DASy
 SG_ RFC_Loc037_PhiQuality : 448|8@1+ (1,0) [0|255] "dimensionless"  DASy

BO_ 419 RFC_Location_038_039: 64 RadarFrontCenter
 SG_ RFC_Loc038_CRC : 0|16@1+ (1,0) [0|65535] ""  DASy
 SG_ RFC_Loc038_AliveCtr : 16|8@1+ (1,0) [0|255] ""  DASy
 SG_ RFC_Loc038_ProtBlockCtr : 24|8@1+ (1,0) [0|255] ""  DASy
 SG_ RFC_Loc038_Dr : 32|16@1+ (0.0078125,0) [0|511.9921875] "m"  DASy
 SG_ RFC_Loc038_Vr : 48|16@1+ (0.00390625,-128) [-128|127.99609375] "m/s"  DASy
 SG_ RFC_Loc038_Theta : 64|16@1+ (0.01,-327.68) [-90|90] "deg"  DASy
 SG_ RFC_Loc038_Phi : 80|16@1+ (0.01,-327.68) [-30|30] "deg"  DASy
 SG_ RFC_Loc038_DrVnce : 96|16@1+ (1.52588E-005,0) [0|0.999984741210937] "m^2"  DASy
 SG_ RFC_Loc038_VrVnce : 112|16@1+ (1.52588E-005,0) [0|0.999984741210937] "m^2/s^2"  DASy
 SG_ RFC_Loc038_ThetaVnce : 128|16@1+ (0.00390625,0) [0|255.99609375] "deg^2"  DASy
 SG_ RFC_Loc038_PhiVnce : 144|16@1+ (0.00390625,0) [0|255.99609375] "deg^2"  DASy
 SG_ RFC_Loc038_DrVrCoVnce : 160|16@1+ (3.814697265625E-006,-0.125) [-0.125|0.124996185302734] "m^2/s"  DASy
 SG_ RFC_Loc038_RCS : 176|16@1+ (0.00390625,-128) [-128|127.99609375] "dBsm"  DASy
 SG_ RFC_Loc038_RSSI : 192|16@1+ (0.00195312,0) [0|127.998046875] "dimensionless"  DASy
 SG_ RFC_Loc038_DrVrQuality : 208|8@1+ (1,0) [0|255] "dimensionless"  DASy
 SG_ RFC_Loc038_ThetaQuality : 216|8@1+ (1,0) [0|255] "dimensionless"  DASy
 SG_ RFC_Loc038_PhiQuality : 224|8@1+ (1,0) [0|255] "dimensionless"  DASy
 SG_ RFC_Loc039_Dr : 256|16@1+ (0.0078125,0) [0|511.9921875] "m"  DASy
 SG_ RFC_Loc039_Vr : 272|16@1+ (0.00390625,-128) [-128|127.99609375] "m/s"  DASy
 SG_ RFC_Loc039_Theta : 288|16@1+ (0.01,-327.68) [-90|90] "deg"  DASy
 SG_ RFC_Loc039_Phi : 304|16@1+ (0.01,-327.68) [-30|30] "deg"  DASy
 SG_ RFC_Loc039_DrVnce : 320|16@1+ (1.52588E-005,0) [0|0.999984741210937] "m^2"  DASy
 SG_ RFC_Loc039_VrVnce : 336|16@1+ (1.52588E-005,0) [0|0.999984741210937] "m^2/s^2"  DASy
 SG_ RFC_Loc039_ThetaVnce : 352|16@1+ (0.00390625,0) [0|255.99609375] "deg^2"  DASy
 SG_ RFC_Loc039_PhiVnce : 368|16@1+ (0.00390625,0) [0|255.99609375] "deg^2"  DASy
 SG_ RFC_Loc039_DrVrCoVnce : 384|16@1+ (3.814697265625E-006,-0.125) [-0.125|0.124996185302734] "m^2/s"  DASy
 SG_ RFC_Loc039_RCS : 400|16@1+ (0.00390625,-128) [-128|127.99609375] "dBsm"  DASy
 SG_ RFC_Loc039_RSSI : 416|16@1+ (0.00195312,0) [0|127.998046875] "dimensionless"  DASy
 SG_ RFC_Loc039_DrVrQuality : 432|8@1+ (1,0) [0|255] "dimensionless"  DASy
 SG_ RFC_Loc039_ThetaQuality : 440|8@1+ (1,0) [0|255] "dimensionless"  DASy
 SG_ RFC_Loc039_PhiQuality : 448|8@1+ (1,0) [0|255] "dimensionless"  DASy

BO_ 420 RFC_Location_040_041: 64 RadarFrontCenter
 SG_ RFC_Loc040_CRC : 0|16@1+ (1,0) [0|65535] ""  DASy
 SG_ RFC_Loc040_AliveCtr : 16|8@1+ (1,0) [0|255] ""  DASy
 SG_ RFC_Loc040_ProtBlockCtr : 24|8@1+ (1,0) [0|255] ""  DASy
 SG_ RFC_Loc040_Dr : 32|16@1+ (0.0078125,0) [0|511.9921875] "m"  DASy
 SG_ RFC_Loc040_Vr : 48|16@1+ (0.00390625,-128) [-128|127.99609375] "m/s"  DASy
 SG_ RFC_Loc040_Theta : 64|16@1+ (0.01,-327.68) [-90|90] "deg"  DASy
 SG_ RFC_Loc040_Phi : 80|16@1+ (0.01,-327.68) [-30|30] "deg"  DASy
 SG_ RFC_Loc040_DrVnce : 96|16@1+ (1.52588E-005,0) [0|0.999984741210937] "m^2"  DASy
 SG_ RFC_Loc040_VrVnce : 112|16@1+ (1.52588E-005,0) [0|0.999984741210937] "m^2/s^2"  DASy
 SG_ RFC_Loc040_ThetaVnce : 128|16@1+ (0.00390625,0) [0|255.99609375] "deg^2"  DASy
 SG_ RFC_Loc040_PhiVnce : 144|16@1+ (0.00390625,0) [0|255.99609375] "deg^2"  DASy
 SG_ RFC_Loc040_DrVrCoVnce : 160|16@1+ (3.814697265625E-006,-0.125) [-0.125|0.124996185302734] "m^2/s"  DASy
 SG_ RFC_Loc040_RCS : 176|16@1+ (0.00390625,-128) [-128|127.99609375] "dBsm"  DASy
 SG_ RFC_Loc040_RSSI : 192|16@1+ (0.00195312,0) [0|127.998046875] "dimensionless"  DASy
 SG_ RFC_Loc040_DrVrQuality : 208|8@1+ (1,0) [0|255] "dimensionless"  DASy
 SG_ RFC_Loc040_ThetaQuality : 216|8@1+ (1,0) [0|255] "dimensionless"  DASy
 SG_ RFC_Loc040_PhiQuality : 224|8@1+ (1,0) [0|255] "dimensionless"  DASy
 SG_ RFC_Loc041_Dr : 256|16@1+ (0.0078125,0) [0|511.9921875] "m"  DASy
 SG_ RFC_Loc041_Vr : 272|16@1+ (0.00390625,-128) [-128|127.99609375] "m/s"  DASy
 SG_ RFC_Loc041_Theta : 288|16@1+ (0.01,-327.68) [-90|90] "deg"  DASy
 SG_ RFC_Loc041_Phi : 304|16@1+ (0.01,-327.68) [-30|30] "deg"  DASy
 SG_ RFC_Loc041_DrVnce : 320|16@1+ (1.52588E-005,0) [0|0.999984741210937] "m^2"  DASy
 SG_ RFC_Loc041_VrVnce : 336|16@1+ (1.52588E-005,0) [0|0.999984741210937] "m^2/s^2"  DASy
 SG_ RFC_Loc041_ThetaVnce : 352|16@1+ (0.00390625,0) [0|255.99609375] "deg^2"  DASy
 SG_ RFC_Loc041_PhiVnce : 368|16@1+ (0.00390625,0) [0|255.99609375] "deg^2"  DASy
 SG_ RFC_Loc041_DrVrCoVnce : 384|16@1+ (3.814697265625E-006,-0.125) [-0.125|0.124996185302734] "m^2/s"  DASy
 SG_ RFC_Loc041_RCS : 400|16@1+ (0.00390625,-128) [-128|127.99609375] "dBsm"  DASy
 SG_ RFC_Loc041_RSSI : 416|16@1+ (0.00195312,0) [0|127.998046875] "dimensionless"  DASy
 SG_ RFC_Loc041_DrVrQuality : 432|8@1+ (1,0) [0|255] "dimensionless"  DASy
 SG_ RFC_Loc041_ThetaQuality : 440|8@1+ (1,0) [0|255] "dimensionless"  DASy
 SG_ RFC_Loc041_PhiQuality : 448|8@1+ (1,0) [0|255] "dimensionless"  DASy

BO_ 421 RFC_Location_042_043: 64 RadarFrontCenter
 SG_ RFC_Loc042_CRC : 0|16@1+ (1,0) [0|65535] ""  DASy
 SG_ RFC_Loc042_AliveCtr : 16|8@1+ (1,0) [0|255] ""  DASy
 SG_ RFC_Loc042_ProtBlockCtr : 24|8@1+ (1,0) [0|255] ""  DASy
 SG_ RFC_Loc042_Dr : 32|16@1+ (0.0078125,0) [0|511.9921875] "m"  DASy
 SG_ RFC_Loc042_Vr : 48|16@1+ (0.00390625,-128) [-128|127.99609375] "m/s"  DASy
 SG_ RFC_Loc042_Theta : 64|16@1+ (0.01,-327.68) [-90|90] "deg"  DASy
 SG_ RFC_Loc042_Phi : 80|16@1+ (0.01,-327.68) [-30|30] "deg"  DASy
 SG_ RFC_Loc042_DrVnce : 96|16@1+ (1.52588E-005,0) [0|0.999984741210937] "m^2"  DASy
 SG_ RFC_Loc042_VrVnce : 112|16@1+ (1.52588E-005,0) [0|0.999984741210937] "m^2/s^2"  DASy
 SG_ RFC_Loc042_ThetaVnce : 128|16@1+ (0.00390625,0) [0|255.99609375] "deg^2"  DASy
 SG_ RFC_Loc042_PhiVnce : 144|16@1+ (0.00390625,0) [0|255.99609375] "deg^2"  DASy
 SG_ RFC_Loc042_DrVrCoVnce : 160|16@1+ (3.814697265625E-006,-0.125) [-0.125|0.124996185302734] "m^2/s"  DASy
 SG_ RFC_Loc042_RCS : 176|16@1+ (0.00390625,-128) [-128|127.99609375] "dBsm"  DASy
 SG_ RFC_Loc042_RSSI : 192|16@1+ (0.00195312,0) [0|127.998046875] "dimensionless"  DASy
 SG_ RFC_Loc042_DrVrQuality : 208|8@1+ (1,0) [0|255] "dimensionless"  DASy
 SG_ RFC_Loc042_ThetaQuality : 216|8@1+ (1,0) [0|255] "dimensionless"  DASy
 SG_ RFC_Loc042_PhiQuality : 224|8@1+ (1,0) [0|255] "dimensionless"  DASy
 SG_ RFC_Loc043_Dr : 256|16@1+ (0.0078125,0) [0|511.9921875] "m"  DASy
 SG_ RFC_Loc043_Vr : 272|16@1+ (0.00390625,-128) [-128|127.99609375] "m/s"  DASy
 SG_ RFC_Loc043_Theta : 288|16@1+ (0.01,-327.68) [-90|90] "deg"  DASy
 SG_ RFC_Loc043_Phi : 304|16@1+ (0.01,-327.68) [-30|30] "deg"  DASy
 SG_ RFC_Loc043_DrVnce : 320|16@1+ (1.52588E-005,0) [0|0.999984741210937] "m^2"  DASy
 SG_ RFC_Loc043_VrVnce : 336|16@1+ (1.52588E-005,0) [0|0.999984741210937] "m^2/s^2"  DASy
 SG_ RFC_Loc043_ThetaVnce : 352|16@1+ (0.00390625,0) [0|255.99609375] "deg^2"  DASy
 SG_ RFC_Loc043_PhiVnce : 368|16@1+ (0.00390625,0) [0|255.99609375] "deg^2"  DASy
 SG_ RFC_Loc043_DrVrCoVnce : 384|16@1+ (3.814697265625E-006,-0.125) [-0.125|0.124996185302734] "m^2/s"  DASy
 SG_ RFC_Loc043_RCS : 400|16@1+ (0.00390625,-128) [-128|127.99609375] "dBsm"  DASy
 SG_ RFC_Loc043_RSSI : 416|16@1+ (0.00195312,0) [0|127.998046875] "dimensionless"  DASy
 SG_ RFC_Loc043_DrVrQuality : 432|8@1+ (1,0) [0|255] "dimensionless"  DASy
 SG_ RFC_Loc043_ThetaQuality : 440|8@1+ (1,0) [0|255] "dimensionless"  DASy
 SG_ RFC_Loc043_PhiQuality : 448|8@1+ (1,0) [0|255] "dimensionless"  DASy

BO_ 422 RFC_Location_044_045: 64 RadarFrontCenter
 SG_ RFC_Loc044_CRC : 0|16@1+ (1,0) [0|65535] ""  DASy
 SG_ RFC_Loc044_AliveCtr : 16|8@1+ (1,0) [0|255] ""  DASy
 SG_ RFC_Loc044_ProtBlockCtr : 24|8@1+ (1,0) [0|255] ""  DASy
 SG_ RFC_Loc044_Dr : 32|16@1+ (0.0078125,0) [0|511.9921875] "m"  DASy
 SG_ RFC_Loc044_Vr : 48|16@1+ (0.00390625,-128) [-128|127.99609375] "m/s"  DASy
 SG_ RFC_Loc044_Theta : 64|16@1+ (0.01,-327.68) [-90|90] "deg"  DASy
 SG_ RFC_Loc044_Phi : 80|16@1+ (0.01,-327.68) [-30|30] "deg"  DASy
 SG_ RFC_Loc044_DrVnce : 96|16@1+ (1.52588E-005,0) [0|0.999984741210937] "m^2"  DASy
 SG_ RFC_Loc044_VrVnce : 112|16@1+ (1.52588E-005,0) [0|0.999984741210937] "m^2/s^2"  DASy
 SG_ RFC_Loc044_ThetaVnce : 128|16@1+ (0.00390625,0) [0|255.99609375] "deg^2"  DASy
 SG_ RFC_Loc044_PhiVnce : 144|16@1+ (0.00390625,0) [0|255.99609375] "deg^2"  DASy
 SG_ RFC_Loc044_DrVrCoVnce : 160|16@1+ (3.814697265625E-006,-0.125) [-0.125|0.124996185302734] "m^2/s"  DASy
 SG_ RFC_Loc044_RCS : 176|16@1+ (0.00390625,-128) [-128|127.99609375] "dBsm"  DASy
 SG_ RFC_Loc044_RSSI : 192|16@1+ (0.00195312,0) [0|127.998046875] "dimensionless"  DASy
 SG_ RFC_Loc044_DrVrQuality : 208|8@1+ (1,0) [0|255] "dimensionless"  DASy
 SG_ RFC_Loc044_ThetaQuality : 216|8@1+ (1,0) [0|255] "dimensionless"  DASy
 SG_ RFC_Loc044_PhiQuality : 224|8@1+ (1,0) [0|255] "dimensionless"  DASy
 SG_ RFC_Loc045_Dr : 256|16@1+ (0.0078125,0) [0|511.9921875] "m"  DASy
 SG_ RFC_Loc045_Vr : 272|16@1+ (0.00390625,-128) [-128|127.99609375] "m/s"  DASy
 SG_ RFC_Loc045_Theta : 288|16@1+ (0.01,-327.68) [-90|90] "deg"  DASy
 SG_ RFC_Loc045_Phi : 304|16@1+ (0.01,-327.68) [-30|30] "deg"  DASy
 SG_ RFC_Loc045_DrVnce : 320|16@1+ (1.52588E-005,0) [0|0.999984741210937] "m^2"  DASy
 SG_ RFC_Loc045_VrVnce : 336|16@1+ (1.52588E-005,0) [0|0.999984741210937] "m^2/s^2"  DASy
 SG_ RFC_Loc045_ThetaVnce : 352|16@1+ (0.00390625,0) [0|255.99609375] "deg^2"  DASy
 SG_ RFC_Loc045_PhiVnce : 368|16@1+ (0.00390625,0) [0|255.99609375] "deg^2"  DASy
 SG_ RFC_Loc045_DrVrCoVnce : 384|16@1+ (3.814697265625E-006,-0.125) [-0.125|0.124996185302734] "m^2/s"  DASy
 SG_ RFC_Loc045_RCS : 400|16@1+ (0.00390625,-128) [-128|127.99609375] "dBsm"  DASy
 SG_ RFC_Loc045_RSSI : 416|16@1+ (0.00195312,0) [0|127.998046875] "dimensionless"  DASy
 SG_ RFC_Loc045_DrVrQuality : 432|8@1+ (1,0) [0|255] "dimensionless"  DASy
 SG_ RFC_Loc045_ThetaQuality : 440|8@1+ (1,0) [0|255] "dimensionless"  DASy
 SG_ RFC_Loc045_PhiQuality : 448|8@1+ (1,0) [0|255] "dimensionless"  DASy

BO_ 423 RFC_Location_046_047: 64 RadarFrontCenter
 SG_ RFC_Loc046_CRC : 0|16@1+ (1,0) [0|65535] ""  DASy
 SG_ RFC_Loc046_AliveCtr : 16|8@1+ (1,0) [0|255] ""  DASy
 SG_ RFC_Loc046_ProtBlockCtr : 24|8@1+ (1,0) [0|255] ""  DASy
 SG_ RFC_Loc046_Dr : 32|16@1+ (0.0078125,0) [0|511.9921875] "m"  DASy
 SG_ RFC_Loc046_Vr : 48|16@1+ (0.00390625,-128) [-128|127.99609375] "m/s"  DASy
 SG_ RFC_Loc046_Theta : 64|16@1+ (0.01,-327.68) [-90|90] "deg"  DASy
 SG_ RFC_Loc046_Phi : 80|16@1+ (0.01,-327.68) [-30|30] "deg"  DASy
 SG_ RFC_Loc046_DrVnce : 96|16@1+ (1.52588E-005,0) [0|0.999984741210937] "m^2"  DASy
 SG_ RFC_Loc046_VrVnce : 112|16@1+ (1.52588E-005,0) [0|0.999984741210937] "m^2/s^2"  DASy
 SG_ RFC_Loc046_ThetaVnce : 128|16@1+ (0.00390625,0) [0|255.99609375] "deg^2"  DASy
 SG_ RFC_Loc046_PhiVnce : 144|16@1+ (0.00390625,0) [0|255.99609375] "deg^2"  DASy
 SG_ RFC_Loc046_DrVrCoVnce : 160|16@1+ (3.814697265625E-006,-0.125) [-0.125|0.124996185302734] "m^2/s"  DASy
 SG_ RFC_Loc046_RCS : 176|16@1+ (0.00390625,-128) [-128|127.99609375] "dBsm"  DASy
 SG_ RFC_Loc046_RSSI : 192|16@1+ (0.00195312,0) [0|127.998046875] "dimensionless"  DASy
 SG_ RFC_Loc046_DrVrQuality : 208|8@1+ (1,0) [0|255] "dimensionless"  DASy
 SG_ RFC_Loc046_ThetaQuality : 216|8@1+ (1,0) [0|255] "dimensionless"  DASy
 SG_ RFC_Loc046_PhiQuality : 224|8@1+ (1,0) [0|255] "dimensionless"  DASy
 SG_ RFC_Loc047_Dr : 256|16@1+ (0.0078125,0) [0|511.9921875] "m"  DASy
 SG_ RFC_Loc047_Vr : 272|16@1+ (0.00390625,-128) [-128|127.99609375] "m/s"  DASy
 SG_ RFC_Loc047_Theta : 288|16@1+ (0.01,-327.68) [-90|90] "deg"  DASy
 SG_ RFC_Loc047_Phi : 304|16@1+ (0.01,-327.68) [-30|30] "deg"  DASy
 SG_ RFC_Loc047_DrVnce : 320|16@1+ (1.52588E-005,0) [0|0.999984741210937] "m^2"  DASy
 SG_ RFC_Loc047_VrVnce : 336|16@1+ (1.52588E-005,0) [0|0.999984741210937] "m^2/s^2"  DASy
 SG_ RFC_Loc047_ThetaVnce : 352|16@1+ (0.00390625,0) [0|255.99609375] "deg^2"  DASy
 SG_ RFC_Loc047_PhiVnce : 368|16@1+ (0.00390625,0) [0|255.99609375] "deg^2"  DASy
 SG_ RFC_Loc047_DrVrCoVnce : 384|16@1+ (3.814697265625E-006,-0.125) [-0.125|0.124996185302734] "m^2/s"  DASy
 SG_ RFC_Loc047_RCS : 400|16@1+ (0.00390625,-128) [-128|127.99609375] "dBsm"  DASy
 SG_ RFC_Loc047_RSSI : 416|16@1+ (0.00195312,0) [0|127.998046875] "dimensionless"  DASy
 SG_ RFC_Loc047_DrVrQuality : 432|8@1+ (1,0) [0|255] "dimensionless"  DASy
 SG_ RFC_Loc047_ThetaQuality : 440|8@1+ (1,0) [0|255] "dimensionless"  DASy
 SG_ RFC_Loc047_PhiQuality : 448|8@1+ (1,0) [0|255] "dimensionless"  DASy

BO_ 424 RFC_Location_048_049: 64 RadarFrontCenter
 SG_ RFC_Loc048_CRC : 0|16@1+ (1,0) [0|65535] ""  DASy
 SG_ RFC_Loc048_AliveCtr : 16|8@1+ (1,0) [0|255] ""  DASy
 SG_ RFC_Loc048_ProtBlockCtr : 24|8@1+ (1,0) [0|255] ""  DASy
 SG_ RFC_Loc048_Dr : 32|16@1+ (0.0078125,0) [0|511.9921875] "m"  DASy
 SG_ RFC_Loc048_Vr : 48|16@1+ (0.00390625,-128) [-128|127.99609375] "m/s"  DASy
 SG_ RFC_Loc048_Theta : 64|16@1+ (0.01,-327.68) [-90|90] "deg"  DASy
 SG_ RFC_Loc048_Phi : 80|16@1+ (0.01,-327.68) [-30|30] "deg"  DASy
 SG_ RFC_Loc048_DrVnce : 96|16@1+ (1.52588E-005,0) [0|0.999984741210937] "m^2"  DASy
 SG_ RFC_Loc048_VrVnce : 112|16@1+ (1.52588E-005,0) [0|0.999984741210937] "m^2/s^2"  DASy
 SG_ RFC_Loc048_ThetaVnce : 128|16@1+ (0.00390625,0) [0|255.99609375] "deg^2"  DASy
 SG_ RFC_Loc048_PhiVnce : 144|16@1+ (0.00390625,0) [0|255.99609375] "deg^2"  DASy
 SG_ RFC_Loc048_DrVrCoVnce : 160|16@1+ (3.814697265625E-006,-0.125) [-0.125|0.124996185302734] "m^2/s"  DASy
 SG_ RFC_Loc048_RCS : 176|16@1+ (0.00390625,-128) [-128|127.99609375] "dBsm"  DASy
 SG_ RFC_Loc048_RSSI : 192|16@1+ (0.00195312,0) [0|127.998046875] "dimensionless"  DASy
 SG_ RFC_Loc048_DrVrQuality : 208|8@1+ (1,0) [0|255] "dimensionless"  DASy
 SG_ RFC_Loc048_ThetaQuality : 216|8@1+ (1,0) [0|255] "dimensionless"  DASy
 SG_ RFC_Loc048_PhiQuality : 224|8@1+ (1,0) [0|255] "dimensionless"  DASy
 SG_ RFC_Loc049_Dr : 256|16@1+ (0.0078125,0) [0|511.9921875] "m"  DASy
 SG_ RFC_Loc049_Vr : 272|16@1+ (0.00390625,-128) [-128|127.99609375] "m/s"  DASy
 SG_ RFC_Loc049_Theta : 288|16@1+ (0.01,-327.68) [-90|90] "deg"  DASy
 SG_ RFC_Loc049_Phi : 304|16@1+ (0.01,-327.68) [-30|30] "deg"  DASy
 SG_ RFC_Loc049_DrVnce : 320|16@1+ (1.52588E-005,0) [0|0.999984741210937] "m^2"  DASy
 SG_ RFC_Loc049_VrVnce : 336|16@1+ (1.52588E-005,0) [0|0.999984741210937] "m^2/s^2"  DASy
 SG_ RFC_Loc049_ThetaVnce : 352|16@1+ (0.00390625,0) [0|255.99609375] "deg^2"  DASy
 SG_ RFC_Loc049_PhiVnce : 368|16@1+ (0.00390625,0) [0|255.99609375] "deg^2"  DASy
 SG_ RFC_Loc049_DrVrCoVnce : 384|16@1+ (3.814697265625E-006,-0.125) [-0.125|0.124996185302734] "m^2/s"  DASy
 SG_ RFC_Loc049_RCS : 400|16@1+ (0.00390625,-128) [-128|127.99609375] "dBsm"  DASy
 SG_ RFC_Loc049_RSSI : 416|16@1+ (0.00195312,0) [0|127.998046875] "dimensionless"  DASy
 SG_ RFC_Loc049_DrVrQuality : 432|8@1+ (1,0) [0|255] "dimensionless"  DASy
 SG_ RFC_Loc049_ThetaQuality : 440|8@1+ (1,0) [0|255] "dimensionless"  DASy
 SG_ RFC_Loc049_PhiQuality : 448|8@1+ (1,0) [0|255] "dimensionless"  DASy

BO_ 425 RFC_Location_050_051: 64 RadarFrontCenter
 SG_ RFC_Loc050_CRC : 0|16@1+ (1,0) [0|65535] ""  DASy
 SG_ RFC_Loc050_AliveCtr : 16|8@1+ (1,0) [0|255] ""  DASy
 SG_ RFC_Loc050_ProtBlockCtr : 24|8@1+ (1,0) [0|255] ""  DASy
 SG_ RFC_Loc050_Dr : 32|16@1+ (0.0078125,0) [0|511.9921875] "m"  DASy
 SG_ RFC_Loc050_Vr : 48|16@1+ (0.00390625,-128) [-128|127.99609375] "m/s"  DASy
 SG_ RFC_Loc050_Theta : 64|16@1+ (0.01,-327.68) [-90|90] "deg"  DASy
 SG_ RFC_Loc050_Phi : 80|16@1+ (0.01,-327.68) [-30|30] "deg"  DASy
 SG_ RFC_Loc050_DrVnce : 96|16@1+ (1.52588E-005,0) [0|0.999984741210937] "m^2"  DASy
 SG_ RFC_Loc050_VrVnce : 112|16@1+ (1.52588E-005,0) [0|0.999984741210937] "m^2/s^2"  DASy
 SG_ RFC_Loc050_ThetaVnce : 128|16@1+ (0.00390625,0) [0|255.99609375] "deg^2"  DASy
 SG_ RFC_Loc050_PhiVnce : 144|16@1+ (0.00390625,0) [0|255.99609375] "deg^2"  DASy
 SG_ RFC_Loc050_DrVrCoVnce : 160|16@1+ (3.814697265625E-006,-0.125) [-0.125|0.124996185302734] "m^2/s"  DASy
 SG_ RFC_Loc050_RCS : 176|16@1+ (0.00390625,-128) [-128|127.99609375] "dBsm"  DASy
 SG_ RFC_Loc050_RSSI : 192|16@1+ (0.00195312,0) [0|127.998046875] "dimensionless"  DASy
 SG_ RFC_Loc050_DrVrQuality : 208|8@1+ (1,0) [0|255] "dimensionless"  DASy
 SG_ RFC_Loc050_ThetaQuality : 216|8@1+ (1,0) [0|255] "dimensionless"  DASy
 SG_ RFC_Loc050_PhiQuality : 224|8@1+ (1,0) [0|255] "dimensionless"  DASy
 SG_ RFC_Loc051_Dr : 256|16@1+ (0.0078125,0) [0|511.9921875] "m"  DASy
 SG_ RFC_Loc051_Vr : 272|16@1+ (0.00390625,-128) [-128|127.99609375] "m/s"  DASy
 SG_ RFC_Loc051_Theta : 288|16@1+ (0.01,-327.68) [-90|90] "deg"  DASy
 SG_ RFC_Loc051_Phi : 304|16@1+ (0.01,-327.68) [-30|30] "deg"  DASy
 SG_ RFC_Loc051_DrVnce : 320|16@1+ (1.52588E-005,0) [0|0.999984741210937] "m^2"  DASy
 SG_ RFC_Loc051_VrVnce : 336|16@1+ (1.52588E-005,0) [0|0.999984741210937] "m^2/s^2"  DASy
 SG_ RFC_Loc051_ThetaVnce : 352|16@1+ (0.00390625,0) [0|255.99609375] "deg^2"  DASy
 SG_ RFC_Loc051_PhiVnce : 368|16@1+ (0.00390625,0) [0|255.99609375] "deg^2"  DASy
 SG_ RFC_Loc051_DrVrCoVnce : 384|16@1+ (3.814697265625E-006,-0.125) [-0.125|0.124996185302734] "m^2/s"  DASy
 SG_ RFC_Loc051_RCS : 400|16@1+ (0.00390625,-128) [-128|127.99609375] "dBsm"  DASy
 SG_ RFC_Loc051_RSSI : 416|16@1+ (0.00195312,0) [0|127.998046875] "dimensionless"  DASy
 SG_ RFC_Loc051_DrVrQuality : 432|8@1+ (1,0) [0|255] "dimensionless"  DASy
 SG_ RFC_Loc051_ThetaQuality : 440|8@1+ (1,0) [0|255] "dimensionless"  DASy
 SG_ RFC_Loc051_PhiQuality : 448|8@1+ (1,0) [0|255] "dimensionless"  DASy

BO_ 426 RFC_Location_052_053: 64 RadarFrontCenter
 SG_ RFC_Loc052_CRC : 0|16@1+ (1,0) [0|65535] ""  DASy
 SG_ RFC_Loc052_AliveCtr : 16|8@1+ (1,0) [0|255] ""  DASy
 SG_ RFC_Loc052_ProtBlockCtr : 24|8@1+ (1,0) [0|255] ""  DASy
 SG_ RFC_Loc052_Dr : 32|16@1+ (0.0078125,0) [0|511.9921875] "m"  DASy
 SG_ RFC_Loc052_Vr : 48|16@1+ (0.00390625,-128) [-128|127.99609375] "m/s"  DASy
 SG_ RFC_Loc052_Theta : 64|16@1+ (0.01,-327.68) [-90|90] "deg"  DASy
 SG_ RFC_Loc052_Phi : 80|16@1+ (0.01,-327.68) [-30|30] "deg"  DASy
 SG_ RFC_Loc052_DrVnce : 96|16@1+ (1.52588E-005,0) [0|0.999984741210937] "m^2"  DASy
 SG_ RFC_Loc052_VrVnce : 112|16@1+ (1.52588E-005,0) [0|0.999984741210937] "m^2/s^2"  DASy
 SG_ RFC_Loc052_ThetaVnce : 128|16@1+ (0.00390625,0) [0|255.99609375] "deg^2"  DASy
 SG_ RFC_Loc052_PhiVnce : 144|16@1+ (0.00390625,0) [0|255.99609375] "deg^2"  DASy
 SG_ RFC_Loc052_DrVrCoVnce : 160|16@1+ (3.814697265625E-006,-0.125) [-0.125|0.124996185302734] "m^2/s"  DASy
 SG_ RFC_Loc052_RCS : 176|16@1+ (0.00390625,-128) [-128|127.99609375] "dBsm"  DASy
 SG_ RFC_Loc052_RSSI : 192|16@1+ (0.00195312,0) [0|127.998046875] "dimensionless"  DASy
 SG_ RFC_Loc052_DrVrQuality : 208|8@1+ (1,0) [0|255] "dimensionless"  DASy
 SG_ RFC_Loc052_ThetaQuality : 216|8@1+ (1,0) [0|255] "dimensionless"  DASy
 SG_ RFC_Loc052_PhiQuality : 224|8@1+ (1,0) [0|255] "dimensionless"  DASy
 SG_ RFC_Loc053_Dr : 256|16@1+ (0.0078125,0) [0|511.9921875] "m"  DASy
 SG_ RFC_Loc053_Vr : 272|16@1+ (0.00390625,-128) [-128|127.99609375] "m/s"  DASy
 SG_ RFC_Loc053_Theta : 288|16@1+ (0.01,-327.68) [-90|90] "deg"  DASy
 SG_ RFC_Loc053_Phi : 304|16@1+ (0.01,-327.68) [-30|30] "deg"  DASy
 SG_ RFC_Loc053_DrVnce : 320|16@1+ (1.52588E-005,0) [0|0.999984741210937] "m^2"  DASy
 SG_ RFC_Loc053_VrVnce : 336|16@1+ (1.52588E-005,0) [0|0.999984741210937] "m^2/s^2"  DASy
 SG_ RFC_Loc053_ThetaVnce : 352|16@1+ (0.00390625,0) [0|255.99609375] "deg^2"  DASy
 SG_ RFC_Loc053_PhiVnce : 368|16@1+ (0.00390625,0) [0|255.99609375] "deg^2"  DASy
 SG_ RFC_Loc053_DrVrCoVnce : 384|16@1+ (3.814697265625E-006,-0.125) [-0.125|0.124996185302734] "m^2/s"  DASy
 SG_ RFC_Loc053_RCS : 400|16@1+ (0.00390625,-128) [-128|127.99609375] "dBsm"  DASy
 SG_ RFC_Loc053_RSSI : 416|16@1+ (0.00195312,0) [0|127.998046875] "dimensionless"  DASy
 SG_ RFC_Loc053_DrVrQuality : 432|8@1+ (1,0) [0|255] "dimensionless"  DASy
 SG_ RFC_Loc053_ThetaQuality : 440|8@1+ (1,0) [0|255] "dimensionless"  DASy
 SG_ RFC_Loc053_PhiQuality : 448|8@1+ (1,0) [0|255] "dimensionless"  DASy

BO_ 427 RFC_Location_054_055: 64 RadarFrontCenter
 SG_ RFC_Loc054_CRC : 0|16@1+ (1,0) [0|65535] ""  DASy
 SG_ RFC_Loc054_AliveCtr : 16|8@1+ (1,0) [0|255] ""  DASy
 SG_ RFC_Loc054_ProtBlockCtr : 24|8@1+ (1,0) [0|255] ""  DASy
 SG_ RFC_Loc054_Dr : 32|16@1+ (0.0078125,0) [0|511.9921875] "m"  DASy
 SG_ RFC_Loc054_Vr : 48|16@1+ (0.00390625,-128) [-128|127.99609375] "m/s"  DASy
 SG_ RFC_Loc054_Theta : 64|16@1+ (0.01,-327.68) [-90|90] "deg"  DASy
 SG_ RFC_Loc054_Phi : 80|16@1+ (0.01,-327.68) [-30|30] "deg"  DASy
 SG_ RFC_Loc054_DrVnce : 96|16@1+ (1.52588E-005,0) [0|0.999984741210937] "m^2"  DASy
 SG_ RFC_Loc054_VrVnce : 112|16@1+ (1.52588E-005,0) [0|0.999984741210937] "m^2/s^2"  DASy
 SG_ RFC_Loc054_ThetaVnce : 128|16@1+ (0.00390625,0) [0|255.99609375] "deg^2"  DASy
 SG_ RFC_Loc054_PhiVnce : 144|16@1+ (0.00390625,0) [0|255.99609375] "deg^2"  DASy
 SG_ RFC_Loc054_DrVrCoVnce : 160|16@1+ (3.814697265625E-006,-0.125) [-0.125|0.124996185302734] "m^2/s"  DASy
 SG_ RFC_Loc054_RCS : 176|16@1+ (0.00390625,-128) [-128|127.99609375] "dBsm"  DASy
 SG_ RFC_Loc054_RSSI : 192|16@1+ (0.00195312,0) [0|127.998046875] "dimensionless"  DASy
 SG_ RFC_Loc054_DrVrQuality : 208|8@1+ (1,0) [0|255] "dimensionless"  DASy
 SG_ RFC_Loc054_ThetaQuality : 216|8@1+ (1,0) [0|255] "dimensionless"  DASy
 SG_ RFC_Loc054_PhiQuality : 224|8@1+ (1,0) [0|255] "dimensionless"  DASy
 SG_ RFC_Loc055_Dr : 256|16@1+ (0.0078125,0) [0|511.9921875] "m"  DASy
 SG_ RFC_Loc055_Vr : 272|16@1+ (0.00390625,-128) [-128|127.99609375] "m/s"  DASy
 SG_ RFC_Loc055_Theta : 288|16@1+ (0.01,-327.68) [-90|90] "deg"  DASy
 SG_ RFC_Loc055_Phi : 304|16@1+ (0.01,-327.68) [-30|30] "deg"  DASy
 SG_ RFC_Loc055_DrVnce : 320|16@1+ (1.52588E-005,0) [0|0.999984741210937] "m^2"  DASy
 SG_ RFC_Loc055_VrVnce : 336|16@1+ (1.52588E-005,0) [0|0.999984741210937] "m^2/s^2"  DASy
 SG_ RFC_Loc055_ThetaVnce : 352|16@1+ (0.00390625,0) [0|255.99609375] "deg^2"  DASy
 SG_ RFC_Loc055_PhiVnce : 368|16@1+ (0.00390625,0) [0|255.99609375] "deg^2"  DASy
 SG_ RFC_Loc055_DrVrCoVnce : 384|16@1+ (3.814697265625E-006,-0.125) [-0.125|0.124996185302734] "m^2/s"  DASy
 SG_ RFC_Loc055_RCS : 400|16@1+ (0.00390625,-128) [-128|127.99609375] "dBsm"  DASy
 SG_ RFC_Loc055_RSSI : 416|16@1+ (0.00195312,0) [0|127.998046875] "dimensionless"  DASy
 SG_ RFC_Loc055_DrVrQuality : 432|8@1+ (1,0) [0|255] "dimensionless"  DASy
 SG_ RFC_Loc055_ThetaQuality : 440|8@1+ (1,0) [0|255] "dimensionless"  DASy
 SG_ RFC_Loc055_PhiQuality : 448|8@1+ (1,0) [0|255] "dimensionless"  DASy

BO_ 428 RFC_Location_056_057: 64 RadarFrontCenter
 SG_ RFC_Loc056_CRC : 0|16@1+ (1,0) [0|65535] ""  DASy
 SG_ RFC_Loc056_AliveCtr : 16|8@1+ (1,0) [0|255] ""  DASy
 SG_ RFC_Loc056_ProtBlockCtr : 24|8@1+ (1,0) [0|255] ""  DASy
 SG_ RFC_Loc056_Dr : 32|16@1+ (0.0078125,0) [0|511.9921875] "m"  DASy
 SG_ RFC_Loc056_Vr : 48|16@1+ (0.00390625,-128) [-128|127.99609375] "m/s"  DASy
 SG_ RFC_Loc056_Theta : 64|16@1+ (0.01,-327.68) [-90|90] "deg"  DASy
 SG_ RFC_Loc056_Phi : 80|16@1+ (0.01,-327.68) [-30|30] "deg"  DASy
 SG_ RFC_Loc056_DrVnce : 96|16@1+ (1.52588E-005,0) [0|0.999984741210937] "m^2"  DASy
 SG_ RFC_Loc056_VrVnce : 112|16@1+ (1.52588E-005,0) [0|0.999984741210937] "m^2/s^2"  DASy
 SG_ RFC_Loc056_ThetaVnce : 128|16@1+ (0.00390625,0) [0|255.99609375] "deg^2"  DASy
 SG_ RFC_Loc056_PhiVnce : 144|16@1+ (0.00390625,0) [0|255.99609375] "deg^2"  DASy
 SG_ RFC_Loc056_DrVrCoVnce : 160|16@1+ (3.814697265625E-006,-0.125) [-0.125|0.124996185302734] "m^2/s"  DASy
 SG_ RFC_Loc056_RCS : 176|16@1+ (0.00390625,-128) [-128|127.99609375] "dBsm"  DASy
 SG_ RFC_Loc056_RSSI : 192|16@1+ (0.00195312,0) [0|127.998046875] "dimensionless"  DASy
 SG_ RFC_Loc056_DrVrQuality : 208|8@1+ (1,0) [0|255] "dimensionless"  DASy
 SG_ RFC_Loc056_ThetaQuality : 216|8@1+ (1,0) [0|255] "dimensionless"  DASy
 SG_ RFC_Loc056_PhiQuality : 224|8@1+ (1,0) [0|255] "dimensionless"  DASy
 SG_ RFC_Loc057_Dr : 256|16@1+ (0.0078125,0) [0|511.9921875] "m"  DASy
 SG_ RFC_Loc057_Vr : 272|16@1+ (0.00390625,-128) [-128|127.99609375] "m/s"  DASy
 SG_ RFC_Loc057_Theta : 288|16@1+ (0.01,-327.68) [-90|90] "deg"  DASy
 SG_ RFC_Loc057_Phi : 304|16@1+ (0.01,-327.68) [-30|30] "deg"  DASy
 SG_ RFC_Loc057_DrVnce : 320|16@1+ (1.52588E-005,0) [0|0.999984741210937] "m^2"  DASy
 SG_ RFC_Loc057_VrVnce : 336|16@1+ (1.52588E-005,0) [0|0.999984741210937] "m^2/s^2"  DASy
 SG_ RFC_Loc057_ThetaVnce : 352|16@1+ (0.00390625,0) [0|255.99609375] "deg^2"  DASy
 SG_ RFC_Loc057_PhiVnce : 368|16@1+ (0.00390625,0) [0|255.99609375] "deg^2"  DASy
 SG_ RFC_Loc057_DrVrCoVnce : 384|16@1+ (3.814697265625E-006,-0.125) [-0.125|0.124996185302734] "m^2/s"  DASy
 SG_ RFC_Loc057_RCS : 400|16@1+ (0.00390625,-128) [-128|127.99609375] "dBsm"  DASy
 SG_ RFC_Loc057_RSSI : 416|16@1+ (0.00195312,0) [0|127.998046875] "dimensionless"  DASy
 SG_ RFC_Loc057_DrVrQuality : 432|8@1+ (1,0) [0|255] "dimensionless"  DASy
 SG_ RFC_Loc057_ThetaQuality : 440|8@1+ (1,0) [0|255] "dimensionless"  DASy
 SG_ RFC_Loc057_PhiQuality : 448|8@1+ (1,0) [0|255] "dimensionless"  DASy

BO_ 429 RFC_Location_058_059: 64 RadarFrontCenter
 SG_ RFC_Loc058_CRC : 0|16@1+ (1,0) [0|65535] ""  DASy
 SG_ RFC_Loc058_AliveCtr : 16|8@1+ (1,0) [0|255] ""  DASy
 SG_ RFC_Loc058_ProtBlockCtr : 24|8@1+ (1,0) [0|255] ""  DASy
 SG_ RFC_Loc058_Dr : 32|16@1+ (0.0078125,0) [0|511.9921875] "m"  DASy
 SG_ RFC_Loc058_Vr : 48|16@1+ (0.00390625,-128) [-128|127.99609375] "m/s"  DASy
 SG_ RFC_Loc058_Theta : 64|16@1+ (0.01,-327.68) [-90|90] "deg"  DASy
 SG_ RFC_Loc058_Phi : 80|16@1+ (0.01,-327.68) [-30|30] "deg"  DASy
 SG_ RFC_Loc058_DrVnce : 96|16@1+ (1.52588E-005,0) [0|0.999984741210937] "m^2"  DASy
 SG_ RFC_Loc058_VrVnce : 112|16@1+ (1.52588E-005,0) [0|0.999984741210937] "m^2/s^2"  DASy
 SG_ RFC_Loc058_ThetaVnce : 128|16@1+ (0.00390625,0) [0|255.99609375] "deg^2"  DASy
 SG_ RFC_Loc058_PhiVnce : 144|16@1+ (0.00390625,0) [0|255.99609375] "deg^2"  DASy
 SG_ RFC_Loc058_DrVrCoVnce : 160|16@1+ (3.814697265625E-006,-0.125) [-0.125|0.124996185302734] "m^2/s"  DASy
 SG_ RFC_Loc058_RCS : 176|16@1+ (0.00390625,-128) [-128|127.99609375] "dBsm"  DASy
 SG_ RFC_Loc058_RSSI : 192|16@1+ (0.00195312,0) [0|127.998046875] "dimensionless"  DASy
 SG_ RFC_Loc058_DrVrQuality : 208|8@1+ (1,0) [0|255] "dimensionless"  DASy
 SG_ RFC_Loc058_ThetaQuality : 216|8@1+ (1,0) [0|255] "dimensionless"  DASy
 SG_ RFC_Loc058_PhiQuality : 224|8@1+ (1,0) [0|255] "dimensionless"  DASy
 SG_ RFC_Loc059_Dr : 256|16@1+ (0.0078125,0) [0|511.9921875] "m"  DASy
 SG_ RFC_Loc059_Vr : 272|16@1+ (0.00390625,-128) [-128|127.99609375] "m/s"  DASy
 SG_ RFC_Loc059_Theta : 288|16@1+ (0.01,-327.68) [-90|90] "deg"  DASy
 SG_ RFC_Loc059_Phi : 304|16@1+ (0.01,-327.68) [-30|30] "deg"  DASy
 SG_ RFC_Loc059_DrVnce : 320|16@1+ (1.52588E-005,0) [0|0.999984741210937] "m^2"  DASy
 SG_ RFC_Loc059_VrVnce : 336|16@1+ (1.52588E-005,0) [0|0.999984741210937] "m^2/s^2"  DASy
 SG_ RFC_Loc059_ThetaVnce : 352|16@1+ (0.00390625,0) [0|255.99609375] "deg^2"  DASy
 SG_ RFC_Loc059_PhiVnce : 368|16@1+ (0.00390625,0) [0|255.99609375] "deg^2"  DASy
 SG_ RFC_Loc059_DrVrCoVnce : 384|16@1+ (3.814697265625E-006,-0.125) [-0.125|0.124996185302734] "m^2/s"  DASy
 SG_ RFC_Loc059_RCS : 400|16@1+ (0.00390625,-128) [-128|127.99609375] "dBsm"  DASy
 SG_ RFC_Loc059_RSSI : 416|16@1+ (0.00195312,0) [0|127.998046875] "dimensionless"  DASy
 SG_ RFC_Loc059_DrVrQuality : 432|8@1+ (1,0) [0|255] "dimensionless"  DASy
 SG_ RFC_Loc059_ThetaQuality : 440|8@1+ (1,0) [0|255] "dimensionless"  DASy
 SG_ RFC_Loc059_PhiQuality : 448|8@1+ (1,0) [0|255] "dimensionless"  DASy

BO_ 430 RFC_Location_060_061: 64 RadarFrontCenter
 SG_ RFC_Loc060_CRC : 0|16@1+ (1,0) [0|65535] ""  DASy
 SG_ RFC_Loc060_AliveCtr : 16|8@1+ (1,0) [0|255] ""  DASy
 SG_ RFC_Loc060_ProtBlockCtr : 24|8@1+ (1,0) [0|255] ""  DASy
 SG_ RFC_Loc060_Dr : 32|16@1+ (0.0078125,0) [0|511.9921875] "m"  DASy
 SG_ RFC_Loc060_Vr : 48|16@1+ (0.00390625,-128) [-128|127.99609375] "m/s"  DASy
 SG_ RFC_Loc060_Theta : 64|16@1+ (0.01,-327.68) [-90|90] "deg"  DASy
 SG_ RFC_Loc060_Phi : 80|16@1+ (0.01,-327.68) [-30|30] "deg"  DASy
 SG_ RFC_Loc060_DrVnce : 96|16@1+ (1.52588E-005,0) [0|0.999984741210937] "m^2"  DASy
 SG_ RFC_Loc060_VrVnce : 112|16@1+ (1.52588E-005,0) [0|0.999984741210937] "m^2/s^2"  DASy
 SG_ RFC_Loc060_ThetaVnce : 128|16@1+ (0.00390625,0) [0|255.99609375] "deg^2"  DASy
 SG_ RFC_Loc060_PhiVnce : 144|16@1+ (0.00390625,0) [0|255.99609375] "deg^2"  DASy
 SG_ RFC_Loc060_DrVrCoVnce : 160|16@1+ (3.814697265625E-006,-0.125) [-0.125|0.124996185302734] "m^2/s"  DASy
 SG_ RFC_Loc060_RCS : 176|16@1+ (0.00390625,-128) [-128|127.99609375] "dBsm"  DASy
 SG_ RFC_Loc060_RSSI : 192|16@1+ (0.00195312,0) [0|127.998046875] "dimensionless"  DASy
 SG_ RFC_Loc060_DrVrQuality : 208|8@1+ (1,0) [0|255] "dimensionless"  DASy
 SG_ RFC_Loc060_ThetaQuality : 216|8@1+ (1,0) [0|255] "dimensionless"  DASy
 SG_ RFC_Loc060_PhiQuality : 224|8@1+ (1,0) [0|255] "dimensionless"  DASy
 SG_ RFC_Loc061_Dr : 256|16@1+ (0.0078125,0) [0|511.9921875] "m"  DASy
 SG_ RFC_Loc061_Vr : 272|16@1+ (0.00390625,-128) [-128|127.99609375] "m/s"  DASy
 SG_ RFC_Loc061_Theta : 288|16@1+ (0.01,-327.68) [-90|90] "deg"  DASy
 SG_ RFC_Loc061_Phi : 304|16@1+ (0.01,-327.68) [-30|30] "deg"  DASy
 SG_ RFC_Loc061_DrVnce : 320|16@1+ (1.52588E-005,0) [0|0.999984741210937] "m^2"  DASy
 SG_ RFC_Loc061_VrVnce : 336|16@1+ (1.52588E-005,0) [0|0.999984741210937] "m^2/s^2"  DASy
 SG_ RFC_Loc061_ThetaVnce : 352|16@1+ (0.00390625,0) [0|255.99609375] "deg^2"  DASy
 SG_ RFC_Loc061_PhiVnce : 368|16@1+ (0.00390625,0) [0|255.99609375] "deg^2"  DASy
 SG_ RFC_Loc061_DrVrCoVnce : 384|16@1+ (3.814697265625E-006,-0.125) [-0.125|0.124996185302734] "m^2/s"  DASy
 SG_ RFC_Loc061_RCS : 400|16@1+ (0.00390625,-128) [-128|127.99609375] "dBsm"  DASy
 SG_ RFC_Loc061_RSSI : 416|16@1+ (0.00195312,0) [0|127.998046875] "dimensionless"  DASy
 SG_ RFC_Loc061_DrVrQuality : 432|8@1+ (1,0) [0|255] "dimensionless"  DASy
 SG_ RFC_Loc061_ThetaQuality : 440|8@1+ (1,0) [0|255] "dimensionless"  DASy
 SG_ RFC_Loc061_PhiQuality : 448|8@1+ (1,0) [0|255] "dimensionless"  DASy

BO_ 431 RFC_Location_062_063: 64 RadarFrontCenter
 SG_ RFC_Loc062_CRC : 0|16@1+ (1,0) [0|65535] ""  DASy
 SG_ RFC_Loc062_AliveCtr : 16|8@1+ (1,0) [0|255] ""  DASy
 SG_ RFC_Loc062_ProtBlockCtr : 24|8@1+ (1,0) [0|255] ""  DASy
 SG_ RFC_Loc062_Dr : 32|16@1+ (0.0078125,0) [0|511.9921875] "m"  DASy
 SG_ RFC_Loc062_Vr : 48|16@1+ (0.00390625,-128) [-128|127.99609375] "m/s"  DASy
 SG_ RFC_Loc062_Theta : 64|16@1+ (0.01,-327.68) [-90|90] "deg"  DASy
 SG_ RFC_Loc062_Phi : 80|16@1+ (0.01,-327.68) [-30|30] "deg"  DASy
 SG_ RFC_Loc062_DrVnce : 96|16@1+ (1.52588E-005,0) [0|0.999984741210937] "m^2"  DASy
 SG_ RFC_Loc062_VrVnce : 112|16@1+ (1.52588E-005,0) [0|0.999984741210937] "m^2/s^2"  DASy
 SG_ RFC_Loc062_ThetaVnce : 128|16@1+ (0.00390625,0) [0|255.99609375] "deg^2"  DASy
 SG_ RFC_Loc062_PhiVnce : 144|16@1+ (0.00390625,0) [0|255.99609375] "deg^2"  DASy
 SG_ RFC_Loc062_DrVrCoVnce : 160|16@1+ (3.814697265625E-006,-0.125) [-0.125|0.124996185302734] "m^2/s"  DASy
 SG_ RFC_Loc062_RCS : 176|16@1+ (0.00390625,-128) [-128|127.99609375] "dBsm"  DASy
 SG_ RFC_Loc062_RSSI : 192|16@1+ (0.00195312,0) [0|127.998046875] "dimensionless"  DASy
 SG_ RFC_Loc062_DrVrQuality : 208|8@1+ (1,0) [0|255] "dimensionless"  DASy
 SG_ RFC_Loc062_ThetaQuality : 216|8@1+ (1,0) [0|255] "dimensionless"  DASy
 SG_ RFC_Loc062_PhiQuality : 224|8@1+ (1,0) [0|255] "dimensionless"  DASy
 SG_ RFC_Loc063_Dr : 256|16@1+ (0.0078125,0) [0|511.9921875] "m"  DASy
 SG_ RFC_Loc063_Vr : 272|16@1+ (0.00390625,-128) [-128|127.99609375] "m/s"  DASy
 SG_ RFC_Loc063_Theta : 288|16@1+ (0.01,-327.68) [-90|90] "deg"  DASy
 SG_ RFC_Loc063_Phi : 304|16@1+ (0.01,-327.68) [-30|30] "deg"  DASy
 SG_ RFC_Loc063_DrVnce : 320|16@1+ (1.52588E-005,0) [0|0.999984741210937] "m^2"  DASy
 SG_ RFC_Loc063_VrVnce : 336|16@1+ (1.52588E-005,0) [0|0.999984741210937] "m^2/s^2"  DASy
 SG_ RFC_Loc063_ThetaVnce : 352|16@1+ (0.00390625,0) [0|255.99609375] "deg^2"  DASy
 SG_ RFC_Loc063_PhiVnce : 368|16@1+ (0.00390625,0) [0|255.99609375] "deg^2"  DASy
 SG_ RFC_Loc063_DrVrCoVnce : 384|16@1+ (3.814697265625E-006,-0.125) [-0.125|0.124996185302734] "m^2/s"  DASy
 SG_ RFC_Loc063_RCS : 400|16@1+ (0.00390625,-128) [-128|127.99609375] "dBsm"  DASy
 SG_ RFC_Loc063_RSSI : 416|16@1+ (0.00195312,0) [0|127.998046875] "dimensionless"  DASy
 SG_ RFC_Loc063_DrVrQuality : 432|8@1+ (1,0) [0|255] "dimensionless"  DASy
 SG_ RFC_Loc063_ThetaQuality : 440|8@1+ (1,0) [0|255] "dimensionless"  DASy
 SG_ RFC_Loc063_PhiQuality : 448|8@1+ (1,0) [0|255] "dimensionless"  DASy

BO_ 432 RFC_Location_064_065: 64 RadarFrontCenter
 SG_ RFC_Loc064_CRC : 0|16@1+ (1,0) [0|65535] ""  DASy
 SG_ RFC_Loc064_AliveCtr : 16|8@1+ (1,0) [0|255] ""  DASy
 SG_ RFC_Loc064_ProtBlockCtr : 24|8@1+ (1,0) [0|255] ""  DASy
 SG_ RFC_Loc064_Dr : 32|16@1+ (0.0078125,0) [0|511.9921875] "m"  DASy
 SG_ RFC_Loc064_Vr : 48|16@1+ (0.00390625,-128) [-128|127.99609375] "m/s"  DASy
 SG_ RFC_Loc064_Theta : 64|16@1+ (0.01,-327.68) [-90|90] "deg"  DASy
 SG_ RFC_Loc064_Phi : 80|16@1+ (0.01,-327.68) [-30|30] "deg"  DASy
 SG_ RFC_Loc064_DrVnce : 96|16@1+ (1.52588E-005,0) [0|0.999984741210937] "m^2"  DASy
 SG_ RFC_Loc064_VrVnce : 112|16@1+ (1.52588E-005,0) [0|0.999984741210937] "m^2/s^2"  DASy
 SG_ RFC_Loc064_ThetaVnce : 128|16@1+ (0.00390625,0) [0|255.99609375] "deg^2"  DASy
 SG_ RFC_Loc064_PhiVnce : 144|16@1+ (0.00390625,0) [0|255.99609375] "deg^2"  DASy
 SG_ RFC_Loc064_DrVrCoVnce : 160|16@1+ (3.814697265625E-006,-0.125) [-0.125|0.124996185302734] "m^2/s"  DASy
 SG_ RFC_Loc064_RCS : 176|16@1+ (0.00390625,-128) [-128|127.99609375] "dBsm"  DASy
 SG_ RFC_Loc064_RSSI : 192|16@1+ (0.00195312,0) [0|127.998046875] "dimensionless"  DASy
 SG_ RFC_Loc064_DrVrQuality : 208|8@1+ (1,0) [0|255] "dimensionless"  DASy
 SG_ RFC_Loc064_ThetaQuality : 216|8@1+ (1,0) [0|255] "dimensionless"  DASy
 SG_ RFC_Loc064_PhiQuality : 224|8@1+ (1,0) [0|255] "dimensionless"  DASy
 SG_ RFC_Loc065_Dr : 256|16@1+ (0.0078125,0) [0|511.9921875] "m"  DASy
 SG_ RFC_Loc065_Vr : 272|16@1+ (0.00390625,-128) [-128|127.99609375] "m/s"  DASy
 SG_ RFC_Loc065_Theta : 288|16@1+ (0.01,-327.68) [-90|90] "deg"  DASy
 SG_ RFC_Loc065_Phi : 304|16@1+ (0.01,-327.68) [-30|30] "deg"  DASy
 SG_ RFC_Loc065_DrVnce : 320|16@1+ (1.52588E-005,0) [0|0.999984741210937] "m^2"  DASy
 SG_ RFC_Loc065_VrVnce : 336|16@1+ (1.52588E-005,0) [0|0.999984741210937] "m^2/s^2"  DASy
 SG_ RFC_Loc065_ThetaVnce : 352|16@1+ (0.00390625,0) [0|255.99609375] "deg^2"  DASy
 SG_ RFC_Loc065_PhiVnce : 368|16@1+ (0.00390625,0) [0|255.99609375] "deg^2"  DASy
 SG_ RFC_Loc065_DrVrCoVnce : 384|16@1+ (3.814697265625E-006,-0.125) [-0.125|0.124996185302734] "m^2/s"  DASy
 SG_ RFC_Loc065_RCS : 400|16@1+ (0.00390625,-128) [-128|127.99609375] "dBsm"  DASy
 SG_ RFC_Loc065_RSSI : 416|16@1+ (0.00195312,0) [0|127.998046875] "dimensionless"  DASy
 SG_ RFC_Loc065_DrVrQuality : 432|8@1+ (1,0) [0|255] "dimensionless"  DASy
 SG_ RFC_Loc065_ThetaQuality : 440|8@1+ (1,0) [0|255] "dimensionless"  DASy
 SG_ RFC_Loc065_PhiQuality : 448|8@1+ (1,0) [0|255] "dimensionless"  DASy

BO_ 433 RFC_Location_066_067: 64 RadarFrontCenter
 SG_ RFC_Loc066_CRC : 0|16@1+ (1,0) [0|65535] ""  DASy
 SG_ RFC_Loc066_AliveCtr : 16|8@1+ (1,0) [0|255] ""  DASy
 SG_ RFC_Loc066_ProtBlockCtr : 24|8@1+ (1,0) [0|255] ""  DASy
 SG_ RFC_Loc066_Dr : 32|16@1+ (0.0078125,0) [0|511.9921875] "m"  DASy
 SG_ RFC_Loc066_Vr : 48|16@1+ (0.00390625,-128) [-128|127.99609375] "m/s"  DASy
 SG_ RFC_Loc066_Theta : 64|16@1+ (0.01,-327.68) [-90|90] "deg"  DASy
 SG_ RFC_Loc066_Phi : 80|16@1+ (0.01,-327.68) [-30|30] "deg"  DASy
 SG_ RFC_Loc066_DrVnce : 96|16@1+ (1.52588E-005,0) [0|0.999984741210937] "m^2"  DASy
 SG_ RFC_Loc066_VrVnce : 112|16@1+ (1.52588E-005,0) [0|0.999984741210937] "m^2/s^2"  DASy
 SG_ RFC_Loc066_ThetaVnce : 128|16@1+ (0.00390625,0) [0|255.99609375] "deg^2"  DASy
 SG_ RFC_Loc066_PhiVnce : 144|16@1+ (0.00390625,0) [0|255.99609375] "deg^2"  DASy
 SG_ RFC_Loc066_DrVrCoVnce : 160|16@1+ (3.814697265625E-006,-0.125) [-0.125|0.124996185302734] "m^2/s"  DASy
 SG_ RFC_Loc066_RCS : 176|16@1+ (0.00390625,-128) [-128|127.99609375] "dBsm"  DASy
 SG_ RFC_Loc066_RSSI : 192|16@1+ (0.00195312,0) [0|127.998046875] "dimensionless"  DASy
 SG_ RFC_Loc066_DrVrQuality : 208|8@1+ (1,0) [0|255] "dimensionless"  DASy
 SG_ RFC_Loc066_ThetaQuality : 216|8@1+ (1,0) [0|255] "dimensionless"  DASy
 SG_ RFC_Loc066_PhiQuality : 224|8@1+ (1,0) [0|255] "dimensionless"  DASy
 SG_ RFC_Loc067_Dr : 256|16@1+ (0.0078125,0) [0|511.9921875] "m"  DASy
 SG_ RFC_Loc067_Vr : 272|16@1+ (0.00390625,-128) [-128|127.99609375] "m/s"  DASy
 SG_ RFC_Loc067_Theta : 288|16@1+ (0.01,-327.68) [-90|90] "deg"  DASy
 SG_ RFC_Loc067_Phi : 304|16@1+ (0.01,-327.68) [-30|30] "deg"  DASy
 SG_ RFC_Loc067_DrVnce : 320|16@1+ (1.52588E-005,0) [0|0.999984741210937] "m^2"  DASy
 SG_ RFC_Loc067_VrVnce : 336|16@1+ (1.52588E-005,0) [0|0.999984741210937] "m^2/s^2"  DASy
 SG_ RFC_Loc067_ThetaVnce : 352|16@1+ (0.00390625,0) [0|255.99609375] "deg^2"  DASy
 SG_ RFC_Loc067_PhiVnce : 368|16@1+ (0.00390625,0) [0|255.99609375] "deg^2"  DASy
 SG_ RFC_Loc067_DrVrCoVnce : 384|16@1+ (3.814697265625E-006,-0.125) [-0.125|0.124996185302734] "m^2/s"  DASy
 SG_ RFC_Loc067_RCS : 400|16@1+ (0.00390625,-128) [-128|127.99609375] "dBsm"  DASy
 SG_ RFC_Loc067_RSSI : 416|16@1+ (0.00195312,0) [0|127.998046875] "dimensionless"  DASy
 SG_ RFC_Loc067_DrVrQuality : 432|8@1+ (1,0) [0|255] "dimensionless"  DASy
 SG_ RFC_Loc067_ThetaQuality : 440|8@1+ (1,0) [0|255] "dimensionless"  DASy
 SG_ RFC_Loc067_PhiQuality : 448|8@1+ (1,0) [0|255] "dimensionless"  DASy

BO_ 434 RFC_Location_068_069: 64 RadarFrontCenter
 SG_ RFC_Loc068_CRC : 0|16@1+ (1,0) [0|65535] ""  DASy
 SG_ RFC_Loc068_AliveCtr : 16|8@1+ (1,0) [0|255] ""  DASy
 SG_ RFC_Loc068_ProtBlockCtr : 24|8@1+ (1,0) [0|255] ""  DASy
 SG_ RFC_Loc068_Dr : 32|16@1+ (0.0078125,0) [0|511.9921875] "m"  DASy
 SG_ RFC_Loc068_Vr : 48|16@1+ (0.00390625,-128) [-128|127.99609375] "m/s"  DASy
 SG_ RFC_Loc068_Theta : 64|16@1+ (0.01,-327.68) [-90|90] "deg"  DASy
 SG_ RFC_Loc068_Phi : 80|16@1+ (0.01,-327.68) [-30|30] "deg"  DASy
 SG_ RFC_Loc068_DrVnce : 96|16@1+ (1.52588E-005,0) [0|0.999984741210937] "m^2"  DASy
 SG_ RFC_Loc068_VrVnce : 112|16@1+ (1.52588E-005,0) [0|0.999984741210937] "m^2/s^2"  DASy
 SG_ RFC_Loc068_ThetaVnce : 128|16@1+ (0.00390625,0) [0|255.99609375] "deg^2"  DASy
 SG_ RFC_Loc068_PhiVnce : 144|16@1+ (0.00390625,0) [0|255.99609375] "deg^2"  DASy
 SG_ RFC_Loc068_DrVrCoVnce : 160|16@1+ (3.814697265625E-006,-0.125) [-0.125|0.124996185302734] "m^2/s"  DASy
 SG_ RFC_Loc068_RCS : 176|16@1+ (0.00390625,-128) [-128|127.99609375] "dBsm"  DASy
 SG_ RFC_Loc068_RSSI : 192|16@1+ (0.00195312,0) [0|127.998046875] "dimensionless"  DASy
 SG_ RFC_Loc068_DrVrQuality : 208|8@1+ (1,0) [0|255] "dimensionless"  DASy
 SG_ RFC_Loc068_ThetaQuality : 216|8@1+ (1,0) [0|255] "dimensionless"  DASy
 SG_ RFC_Loc068_PhiQuality : 224|8@1+ (1,0) [0|255] "dimensionless"  DASy
 SG_ RFC_Loc069_Dr : 256|16@1+ (0.0078125,0) [0|511.9921875] "m"  DASy
 SG_ RFC_Loc069_Vr : 272|16@1+ (0.00390625,-128) [-128|127.99609375] "m/s"  DASy
 SG_ RFC_Loc069_Theta : 288|16@1+ (0.01,-327.68) [-90|90] "deg"  DASy
 SG_ RFC_Loc069_Phi : 304|16@1+ (0.01,-327.68) [-30|30] "deg"  DASy
 SG_ RFC_Loc069_DrVnce : 320|16@1+ (1.52588E-005,0) [0|0.999984741210937] "m^2"  DASy
 SG_ RFC_Loc069_VrVnce : 336|16@1+ (1.52588E-005,0) [0|0.999984741210937] "m^2/s^2"  DASy
 SG_ RFC_Loc069_ThetaVnce : 352|16@1+ (0.00390625,0) [0|255.99609375] "deg^2"  DASy
 SG_ RFC_Loc069_PhiVnce : 368|16@1+ (0.00390625,0) [0|255.99609375] "deg^2"  DASy
 SG_ RFC_Loc069_DrVrCoVnce : 384|16@1+ (3.814697265625E-006,-0.125) [-0.125|0.124996185302734] "m^2/s"  DASy
 SG_ RFC_Loc069_RCS : 400|16@1+ (0.00390625,-128) [-128|127.99609375] "dBsm"  DASy
 SG_ RFC_Loc069_RSSI : 416|16@1+ (0.00195312,0) [0|127.998046875] "dimensionless"  DASy
 SG_ RFC_Loc069_DrVrQuality : 432|8@1+ (1,0) [0|255] "dimensionless"  DASy
 SG_ RFC_Loc069_ThetaQuality : 440|8@1+ (1,0) [0|255] "dimensionless"  DASy
 SG_ RFC_Loc069_PhiQuality : 448|8@1+ (1,0) [0|255] "dimensionless"  DASy

CM_ SG_ 409 RFC_Loc018_CRC "CRC - Autosar E2E Profile 5, DataID = TBD";
CM_ SG_ 409 RFC_Loc018_AliveCtr "Alive counter - Autosar E2E Profile 5";
CM_ SG_ 409 RFC_Loc018_ProtBlockCtr "Protocol-Signal: Block-Counter";
CM_ SG_ 409 RFC_Loc018_Dr "Location radial distance";
CM_ SG_ 409 RFC_Loc018_Vr "Location radial relative velocity";
CM_ SG_ 409 RFC_Loc018_Theta "Location azimuth angle. \"Not a number\" TBD";
CM_ SG_ 409 RFC_Loc018_Phi "Location elevation angle. \"Not a number\" TBD";
CM_ SG_ 409 RFC_Loc018_DrVnce "Variance of Location radial distance";
CM_ SG_ 409 RFC_Loc018_VrVnce "Variance of Location radial relative velocity";
CM_ SG_ 409 RFC_Loc018_ThetaVnce "Variance of Location azimuth angle";
CM_ SG_ 409 RFC_Loc018_PhiVnce "Variance of Location elevation angle";
CM_ SG_ 409 RFC_Loc018_DrVrCoVnce "Covariance of Dr and Vr";
CM_ SG_ 409 RFC_Loc018_RCS "Radar Cross Section (RCS) estimation";
CM_ SG_ 409 RFC_Loc018_RSSI "Received Signal Strength Indication (RSSI)";
CM_ SG_ 409 RFC_Loc018_DrVrQuality "Quality of radial distance and velocity resolution processing. Physical range [0..1]";
CM_ SG_ 409 RFC_Loc018_ThetaQuality "Probability for correct signal model (azimuth angle). Physical range [0..1]";
CM_ SG_ 409 RFC_Loc018_PhiQuality "Probability for correct signal model (elevation angle). Physical range [0..1]";
CM_ SG_ 409 RFC_Loc019_Dr "Location radial distance";
CM_ SG_ 409 RFC_Loc019_Vr "Location radial relative velocity";
CM_ SG_ 409 RFC_Loc019_Theta "Location azimuth angle. \"Not a number\" TBD";
CM_ SG_ 409 RFC_Loc019_Phi "Location elevation angle. \"Not a number\" TBD";
CM_ SG_ 409 RFC_Loc019_DrVnce "Variance of Location radial distance";
CM_ SG_ 409 RFC_Loc019_VrVnce "Variance of Location radial relative velocity";
CM_ SG_ 409 RFC_Loc019_ThetaVnce "Variance of Location azimuth angle";
CM_ SG_ 409 RFC_Loc019_PhiVnce "Variance of Location elevation angle";
CM_ SG_ 409 RFC_Loc019_DrVrCoVnce "Covariance of Dr and Vr";
CM_ SG_ 409 RFC_Loc019_RCS "Radar Cross Section (RCS) estimation";
CM_ SG_ 409 RFC_Loc019_RSSI "Received Signal Strength Indication (RSSI)";
CM_ SG_ 409 RFC_Loc019_DrVrQuality "Quality of radial distance and velocity resolution processing. Physical range [0..1]";
CM_ SG_ 409 RFC_Loc019_ThetaQuality "Probability for correct signal model (azimuth angle). Physical range [0..1]";
CM_ SG_ 409 RFC_Loc019_PhiQuality "Probability for correct signal model (elevation angle). Physical range [0..1]";
CM_ SG_ 410 RFC_Loc020_CRC "CRC - Autosar E2E Profile 5, DataID = TBD";
CM_ SG_ 410 RFC_Loc020_AliveCtr "Alive counter - Autosar E2E Profile 5";
CM_ SG_ 410 RFC_Loc020_ProtBlockCtr "Protocol-Signal: Block-Counter";
CM_ SG_ 410 RFC_Loc020_Dr "Location radial distance";
CM_ SG_ 410 RFC_Loc020_Vr "Location radial relative velocity";
CM_ SG_ 410 RFC_Loc020_Theta "Location azimuth angle. \"Not a number\" TBD";
CM_ SG_ 410 RFC_Loc020_Phi "Location elevation angle. \"Not a number\" TBD";
CM_ SG_ 410 RFC_Loc020_DrVnce "Variance of Location radial distance";
CM_ SG_ 410 RFC_Loc020_VrVnce "Variance of Location radial relative velocity";
CM_ SG_ 410 RFC_Loc020_ThetaVnce "Variance of Location azimuth angle";
CM_ SG_ 410 RFC_Loc020_PhiVnce "Variance of Location elevation angle";
CM_ SG_ 410 RFC_Loc020_DrVrCoVnce "Covariance of Dr and Vr";
CM_ SG_ 410 RFC_Loc020_RCS "Radar Cross Section (RCS) estimation";
CM_ SG_ 410 RFC_Loc020_RSSI "Received Signal Strength Indication (RSSI)";
CM_ SG_ 410 RFC_Loc020_DrVrQuality "Quality of radial distance and velocity resolution processing. Physical range [0..1]";
CM_ SG_ 410 RFC_Loc020_ThetaQuality "Probability for correct signal model (azimuth angle). Physical range [0..1]";
CM_ SG_ 410 RFC_Loc020_PhiQuality "Probability for correct signal model (elevation angle). Physical range [0..1]";
CM_ SG_ 410 RFC_Loc021_Dr "Location radial distance";
CM_ SG_ 410 RFC_Loc021_Vr "Location radial relative velocity";
CM_ SG_ 410 RFC_Loc021_Theta "Location azimuth angle. \"Not a number\" TBD";
CM_ SG_ 410 RFC_Loc021_Phi "Location elevation angle. \"Not a number\" TBD";
CM_ SG_ 410 RFC_Loc021_DrVnce "Variance of Location radial distance";
CM_ SG_ 410 RFC_Loc021_VrVnce "Variance of Location radial relative velocity";
CM_ SG_ 410 RFC_Loc021_ThetaVnce "Variance of Location azimuth angle";
CM_ SG_ 410 RFC_Loc021_PhiVnce "Variance of Location elevation angle";
CM_ SG_ 410 RFC_Loc021_DrVrCoVnce "Covariance of Dr and Vr";
CM_ SG_ 410 RFC_Loc021_RCS "Radar Cross Section (RCS) estimation";
CM_ SG_ 410 RFC_Loc021_RSSI "Received Signal Strength Indication (RSSI)";
CM_ SG_ 410 RFC_Loc021_DrVrQuality "Quality of radial distance and velocity resolution processing. Physical range [0..1]";
CM_ SG_ 410 RFC_Loc021_ThetaQuality "Probability for correct signal model (azimuth angle). Physical range [0..1]";
CM_ SG_ 410 RFC_Loc021_PhiQuality "Probability for correct signal model (elevation angle). Physical range [0..1]";
CM_ SG_ 411 RFC_Loc022_CRC "CRC - Autosar E2E Profile 5, DataID = TBD";
CM_ SG_ 411 RFC_Loc022_AliveCtr "Alive counter - Autosar E2E Profile 5";
CM_ SG_ 411 RFC_Loc022_ProtBlockCtr "Protocol-Signal: Block-Counter";
CM_ SG_ 411 RFC_Loc022_Dr "Location radial distance";
CM_ SG_ 411 RFC_Loc022_Vr "Location radial relative velocity";
CM_ SG_ 411 RFC_Loc022_Theta "Location azimuth angle. \"Not a number\" TBD";
CM_ SG_ 411 RFC_Loc022_Phi "Location elevation angle. \"Not a number\" TBD";
CM_ SG_ 411 RFC_Loc022_DrVnce "Variance of Location radial distance";
CM_ SG_ 411 RFC_Loc022_VrVnce "Variance of Location radial relative velocity";
CM_ SG_ 411 RFC_Loc022_ThetaVnce "Variance of Location azimuth angle";
CM_ SG_ 411 RFC_Loc022_PhiVnce "Variance of Location elevation angle";
CM_ SG_ 411 RFC_Loc022_DrVrCoVnce "Covariance of Dr and Vr";
CM_ SG_ 411 RFC_Loc022_RCS "Radar Cross Section (RCS) estimation";
CM_ SG_ 411 RFC_Loc022_RSSI "Received Signal Strength Indication (RSSI)";
CM_ SG_ 411 RFC_Loc022_DrVrQuality "Quality of radial distance and velocity resolution processing. Physical range [0..1]";
CM_ SG_ 411 RFC_Loc022_ThetaQuality "Probability for correct signal model (azimuth angle). Physical range [0..1]";
CM_ SG_ 411 RFC_Loc022_PhiQuality "Probability for correct signal model (elevation angle). Physical range [0..1]";
CM_ SG_ 411 RFC_Loc023_Dr "Location radial distance";
CM_ SG_ 411 RFC_Loc023_Vr "Location radial relative velocity";
CM_ SG_ 411 RFC_Loc023_Theta "Location azimuth angle. \"Not a number\" TBD";
CM_ SG_ 411 RFC_Loc023_Phi "Location elevation angle. \"Not a number\" TBD";
CM_ SG_ 411 RFC_Loc023_DrVnce "Variance of Location radial distance";
CM_ SG_ 411 RFC_Loc023_VrVnce "Variance of Location radial relative velocity";
CM_ SG_ 411 RFC_Loc023_ThetaVnce "Variance of Location azimuth angle";
CM_ SG_ 411 RFC_Loc023_PhiVnce "Variance of Location elevation angle";
CM_ SG_ 411 RFC_Loc023_DrVrCoVnce "Covariance of Dr and Vr";
CM_ SG_ 411 RFC_Loc023_RCS "Radar Cross Section (RCS) estimation";
CM_ SG_ 411 RFC_Loc023_RSSI "Received Signal Strength Indication (RSSI)";
CM_ SG_ 411 RFC_Loc023_DrVrQuality "Quality of radial distance and velocity resolution processing. Physical range [0..1]";
CM_ SG_ 411 RFC_Loc023_ThetaQuality "Probability for correct signal model (azimuth angle). Physical range [0..1]";
CM_ SG_ 411 RFC_Loc023_PhiQuality "Probability for correct signal model (elevation angle). Physical range [0..1]";
CM_ SG_ 412 RFC_Loc024_CRC "CRC - Autosar E2E Profile 5, DataID = TBD";
CM_ SG_ 412 RFC_Loc024_AliveCtr "Alive counter - Autosar E2E Profile 5";
CM_ SG_ 412 RFC_Loc024_ProtBlockCtr "Protocol-Signal: Block-Counter";
CM_ SG_ 412 RFC_Loc024_Dr "Location radial distance";
CM_ SG_ 412 RFC_Loc024_Vr "Location radial relative velocity";
CM_ SG_ 412 RFC_Loc024_Theta "Location azimuth angle. \"Not a number\" TBD";
CM_ SG_ 412 RFC_Loc024_Phi "Location elevation angle. \"Not a number\" TBD";
CM_ SG_ 412 RFC_Loc024_DrVnce "Variance of Location radial distance";
CM_ SG_ 412 RFC_Loc024_VrVnce "Variance of Location radial relative velocity";
CM_ SG_ 412 RFC_Loc024_ThetaVnce "Variance of Location azimuth angle";
CM_ SG_ 412 RFC_Loc024_PhiVnce "Variance of Location elevation angle";
CM_ SG_ 412 RFC_Loc024_DrVrCoVnce "Covariance of Dr and Vr";
CM_ SG_ 412 RFC_Loc024_RCS "Radar Cross Section (RCS) estimation";
CM_ SG_ 412 RFC_Loc024_RSSI "Received Signal Strength Indication (RSSI)";
CM_ SG_ 412 RFC_Loc024_DrVrQuality "Quality of radial distance and velocity resolution processing. Physical range [0..1]";
CM_ SG_ 412 RFC_Loc024_ThetaQuality "Probability for correct signal model (azimuth angle). Physical range [0..1]";
CM_ SG_ 412 RFC_Loc024_PhiQuality "Probability for correct signal model (elevation angle). Physical range [0..1]";
CM_ SG_ 412 RFC_Loc025_Dr "Location radial distance";
CM_ SG_ 412 RFC_Loc025_Vr "Location radial relative velocity";
CM_ SG_ 412 RFC_Loc025_Theta "Location azimuth angle. \"Not a number\" TBD";
CM_ SG_ 412 RFC_Loc025_Phi "Location elevation angle. \"Not a number\" TBD";
CM_ SG_ 412 RFC_Loc025_DrVnce "Variance of Location radial distance";
CM_ SG_ 412 RFC_Loc025_VrVnce "Variance of Location radial relative velocity";
CM_ SG_ 412 RFC_Loc025_ThetaVnce "Variance of Location azimuth angle";
CM_ SG_ 412 RFC_Loc025_PhiVnce "Variance of Location elevation angle";
CM_ SG_ 412 RFC_Loc025_DrVrCoVnce "Covariance of Dr and Vr";
CM_ SG_ 412 RFC_Loc025_RCS "Radar Cross Section (RCS) estimation";
CM_ SG_ 412 RFC_Loc025_RSSI "Received Signal Strength Indication (RSSI)";
CM_ SG_ 412 RFC_Loc025_DrVrQuality "Quality of radial distance and velocity resolution processing. Physical range [0..1]";
CM_ SG_ 412 RFC_Loc025_ThetaQuality "Probability for correct signal model (azimuth angle). Physical range [0..1]";
CM_ SG_ 412 RFC_Loc025_PhiQuality "Probability for correct signal model (elevation angle). Physical range [0..1]";
CM_ SG_ 413 RFC_Loc026_CRC "CRC - Autosar E2E Profile 5, DataID = TBD";
CM_ SG_ 413 RFC_Loc026_AliveCtr "Alive counter - Autosar E2E Profile 5";
CM_ SG_ 413 RFC_Loc026_ProtBlockCtr "Protocol-Signal: Block-Counter";
CM_ SG_ 413 RFC_Loc026_Dr "Location radial distance";
CM_ SG_ 413 RFC_Loc026_Vr "Location radial relative velocity";
CM_ SG_ 413 RFC_Loc026_Theta "Location azimuth angle. \"Not a number\" TBD";
CM_ SG_ 413 RFC_Loc026_Phi "Location elevation angle. \"Not a number\" TBD";
CM_ SG_ 413 RFC_Loc026_DrVnce "Variance of Location radial distance";
CM_ SG_ 413 RFC_Loc026_VrVnce "Variance of Location radial relative velocity";
CM_ SG_ 413 RFC_Loc026_ThetaVnce "Variance of Location azimuth angle";
CM_ SG_ 413 RFC_Loc026_PhiVnce "Variance of Location elevation angle";
CM_ SG_ 413 RFC_Loc026_DrVrCoVnce "Covariance of Dr and Vr";
CM_ SG_ 413 RFC_Loc026_RCS "Radar Cross Section (RCS) estimation";
CM_ SG_ 413 RFC_Loc026_RSSI "Received Signal Strength Indication (RSSI)";
CM_ SG_ 413 RFC_Loc026_DrVrQuality "Quality of radial distance and velocity resolution processing. Physical range [0..1]";
CM_ SG_ 413 RFC_Loc026_ThetaQuality "Probability for correct signal model (azimuth angle). Physical range [0..1]";
CM_ SG_ 413 RFC_Loc026_PhiQuality "Probability for correct signal model (elevation angle). Physical range [0..1]";
CM_ SG_ 413 RFC_Loc027_Dr "Location radial distance";
CM_ SG_ 413 RFC_Loc027_Vr "Location radial relative velocity";
CM_ SG_ 413 RFC_Loc027_Theta "Location azimuth angle. \"Not a number\" TBD";
CM_ SG_ 413 RFC_Loc027_Phi "Location elevation angle. \"Not a number\" TBD";
CM_ SG_ 413 RFC_Loc027_DrVnce "Variance of Location radial distance";
CM_ SG_ 413 RFC_Loc027_VrVnce "Variance of Location radial relative velocity";
CM_ SG_ 413 RFC_Loc027_ThetaVnce "Variance of Location azimuth angle";
CM_ SG_ 413 RFC_Loc027_PhiVnce "Variance of Location elevation angle";
CM_ SG_ 413 RFC_Loc027_DrVrCoVnce "Covariance of Dr and Vr";
CM_ SG_ 413 RFC_Loc027_RCS "Radar Cross Section (RCS) estimation";
CM_ SG_ 413 RFC_Loc027_RSSI "Received Signal Strength Indication (RSSI)";
CM_ SG_ 413 RFC_Loc027_DrVrQuality "Quality of radial distance and velocity resolution processing. Physical range [0..1]";
CM_ SG_ 413 RFC_Loc027_ThetaQuality "Probability for correct signal model (azimuth angle). Physical range [0..1]";
CM_ SG_ 413 RFC_Loc027_PhiQuality "Probability for correct signal model (elevation angle). Physical range [0..1]";
CM_ SG_ 414 RFC_Loc028_CRC "CRC - Autosar E2E Profile 5, DataID = TBD";
CM_ SG_ 414 RFC_Loc028_AliveCtr "Alive counter - Autosar E2E Profile 5";
CM_ SG_ 414 RFC_Loc028_ProtBlockCtr "Protocol-Signal: Block-Counter";
CM_ SG_ 414 RFC_Loc028_Dr "Location radial distance";
CM_ SG_ 414 RFC_Loc028_Vr "Location radial relative velocity";
CM_ SG_ 414 RFC_Loc028_Theta "Location azimuth angle. \"Not a number\" TBD";
CM_ SG_ 414 RFC_Loc028_Phi "Location elevation angle. \"Not a number\" TBD";
CM_ SG_ 414 RFC_Loc028_DrVnce "Variance of Location radial distance";
CM_ SG_ 414 RFC_Loc028_VrVnce "Variance of Location radial relative velocity";
CM_ SG_ 414 RFC_Loc028_ThetaVnce "Variance of Location azimuth angle";
CM_ SG_ 414 RFC_Loc028_PhiVnce "Variance of Location elevation angle";
CM_ SG_ 414 RFC_Loc028_DrVrCoVnce "Covariance of Dr and Vr";
CM_ SG_ 414 RFC_Loc028_RCS "Radar Cross Section (RCS) estimation";
CM_ SG_ 414 RFC_Loc028_RSSI "Received Signal Strength Indication (RSSI)";
CM_ SG_ 414 RFC_Loc028_DrVrQuality "Quality of radial distance and velocity resolution processing. Physical range [0..1]";
CM_ SG_ 414 RFC_Loc028_ThetaQuality "Probability for correct signal model (azimuth angle). Physical range [0..1]";
CM_ SG_ 414 RFC_Loc028_PhiQuality "Probability for correct signal model (elevation angle). Physical range [0..1]";
CM_ SG_ 414 RFC_Loc029_Dr "Location radial distance";
CM_ SG_ 414 RFC_Loc029_Vr "Location radial relative velocity";
CM_ SG_ 414 RFC_Loc029_Theta "Location azimuth angle. \"Not a number\" TBD";
CM_ SG_ 414 RFC_Loc029_Phi "Location elevation angle. \"Not a number\" TBD";
CM_ SG_ 414 RFC_Loc029_DrVnce "Variance of Location radial distance";
CM_ SG_ 414 RFC_Loc029_VrVnce "Variance of Location radial relative velocity";
CM_ SG_ 414 RFC_Loc029_ThetaVnce "Variance of Location azimuth angle";
CM_ SG_ 414 RFC_Loc029_PhiVnce "Variance of Location elevation angle";
CM_ SG_ 414 RFC_Loc029_DrVrCoVnce "Covariance of Dr and Vr";
CM_ SG_ 414 RFC_Loc029_RCS "Radar Cross Section (RCS) estimation";
CM_ SG_ 414 RFC_Loc029_RSSI "Received Signal Strength Indication (RSSI)";
CM_ SG_ 414 RFC_Loc029_DrVrQuality "Quality of radial distance and velocity resolution processing. Physical range [0..1]";
CM_ SG_ 414 RFC_Loc029_ThetaQuality "Probability for correct signal model (azimuth angle). Physical range [0..1]";
CM_ SG_ 414 RFC_Loc029_PhiQuality "Probability for correct signal model (elevation angle). Physical range [0..1]";
CM_ SG_ 415 RFC_Loc030_CRC "CRC - Autosar E2E Profile 5, DataID = TBD";
CM_ SG_ 415 RFC_Loc030_AliveCtr "Alive counter - Autosar E2E Profile 5";
CM_ SG_ 415 RFC_Loc030_ProtBlockCtr "Protocol-Signal: Block-Counter";
CM_ SG_ 415 RFC_Loc030_Dr "Location radial distance";
CM_ SG_ 415 RFC_Loc030_Vr "Location radial relative velocity";
CM_ SG_ 415 RFC_Loc030_Theta "Location azimuth angle. \"Not a number\" TBD";
CM_ SG_ 415 RFC_Loc030_Phi "Location elevation angle. \"Not a number\" TBD";
CM_ SG_ 415 RFC_Loc030_DrVnce "Variance of Location radial distance";
CM_ SG_ 415 RFC_Loc030_VrVnce "Variance of Location radial relative velocity";
CM_ SG_ 415 RFC_Loc030_ThetaVnce "Variance of Location azimuth angle";
CM_ SG_ 415 RFC_Loc030_PhiVnce "Variance of Location elevation angle";
CM_ SG_ 415 RFC_Loc030_DrVrCoVnce "Covariance of Dr and Vr";
CM_ SG_ 415 RFC_Loc030_RCS "Radar Cross Section (RCS) estimation";
CM_ SG_ 415 RFC_Loc030_RSSI "Received Signal Strength Indication (RSSI)";
CM_ SG_ 415 RFC_Loc030_DrVrQuality "Quality of radial distance and velocity resolution processing. Physical range [0..1]";
CM_ SG_ 415 RFC_Loc030_ThetaQuality "Probability for correct signal model (azimuth angle). Physical range [0..1]";
CM_ SG_ 415 RFC_Loc030_PhiQuality "Probability for correct signal model (elevation angle). Physical range [0..1]";
CM_ SG_ 415 RFC_Loc031_Dr "Location radial distance";
CM_ SG_ 415 RFC_Loc031_Vr "Location radial relative velocity";
CM_ SG_ 415 RFC_Loc031_Theta "Location azimuth angle. \"Not a number\" TBD";
CM_ SG_ 415 RFC_Loc031_Phi "Location elevation angle. \"Not a number\" TBD";
CM_ SG_ 415 RFC_Loc031_DrVnce "Variance of Location radial distance";
CM_ SG_ 415 RFC_Loc031_VrVnce "Variance of Location radial relative velocity";
CM_ SG_ 415 RFC_Loc031_ThetaVnce "Variance of Location azimuth angle";
CM_ SG_ 415 RFC_Loc031_PhiVnce "Variance of Location elevation angle";
CM_ SG_ 415 RFC_Loc031_DrVrCoVnce "Covariance of Dr and Vr";
CM_ SG_ 415 RFC_Loc031_RCS "Radar Cross Section (RCS) estimation";
CM_ SG_ 415 RFC_Loc031_RSSI "Received Signal Strength Indication (RSSI)";
CM_ SG_ 415 RFC_Loc031_DrVrQuality "Quality of radial distance and velocity resolution processing. Physical range [0..1]";
CM_ SG_ 415 RFC_Loc031_ThetaQuality "Probability for correct signal model (azimuth angle). Physical range [0..1]";
CM_ SG_ 415 RFC_Loc031_PhiQuality "Probability for correct signal model (elevation angle). Physical range [0..1]";
CM_ SG_ 416 RFC_Loc032_CRC "CRC - Autosar E2E Profile 5, DataID = TBD";
CM_ SG_ 416 RFC_Loc032_AliveCtr "Alive counter - Autosar E2E Profile 5";
CM_ SG_ 416 RFC_Loc032_ProtBlockCtr "Protocol-Signal: Block-Counter";
CM_ SG_ 416 RFC_Loc032_Dr "Location radial distance";
CM_ SG_ 416 RFC_Loc032_Vr "Location radial relative velocity";
CM_ SG_ 416 RFC_Loc032_Theta "Location azimuth angle. \"Not a number\" TBD";
CM_ SG_ 416 RFC_Loc032_Phi "Location elevation angle. \"Not a number\" TBD";
CM_ SG_ 416 RFC_Loc032_DrVnce "Variance of Location radial distance";
CM_ SG_ 416 RFC_Loc032_VrVnce "Variance of Location radial relative velocity";
CM_ SG_ 416 RFC_Loc032_ThetaVnce "Variance of Location azimuth angle";
CM_ SG_ 416 RFC_Loc032_PhiVnce "Variance of Location elevation angle";
CM_ SG_ 416 RFC_Loc032_DrVrCoVnce "Covariance of Dr and Vr";
CM_ SG_ 416 RFC_Loc032_RCS "Radar Cross Section (RCS) estimation";
CM_ SG_ 416 RFC_Loc032_RSSI "Received Signal Strength Indication (RSSI)";
CM_ SG_ 416 RFC_Loc032_DrVrQuality "Quality of radial distance and velocity resolution processing. Physical range [0..1]";
CM_ SG_ 416 RFC_Loc032_ThetaQuality "Probability for correct signal model (azimuth angle). Physical range [0..1]";
CM_ SG_ 416 RFC_Loc032_PhiQuality "Probability for correct signal model (elevation angle). Physical range [0..1]";
CM_ SG_ 416 RFC_Loc033_Dr "Location radial distance";
CM_ SG_ 416 RFC_Loc033_Vr "Location radial relative velocity";
CM_ SG_ 416 RFC_Loc033_Theta "Location azimuth angle. \"Not a number\" TBD";
CM_ SG_ 416 RFC_Loc033_Phi "Location elevation angle. \"Not a number\" TBD";
CM_ SG_ 416 RFC_Loc033_DrVnce "Variance of Location radial distance";
CM_ SG_ 416 RFC_Loc033_VrVnce "Variance of Location radial relative velocity";
CM_ SG_ 416 RFC_Loc033_ThetaVnce "Variance of Location azimuth angle";
CM_ SG_ 416 RFC_Loc033_PhiVnce "Variance of Location elevation angle";
CM_ SG_ 416 RFC_Loc033_DrVrCoVnce "Covariance of Dr and Vr";
CM_ SG_ 416 RFC_Loc033_RCS "Radar Cross Section (RCS) estimation";
CM_ SG_ 416 RFC_Loc033_RSSI "Received Signal Strength Indication (RSSI)";
CM_ SG_ 416 RFC_Loc033_DrVrQuality "Quality of radial distance and velocity resolution processing. Physical range [0..1]";
CM_ SG_ 416 RFC_Loc033_ThetaQuality "Probability for correct signal model (azimuth angle). Physical range [0..1]";
CM_ SG_ 416 RFC_Loc033_PhiQuality "Probability for correct signal model (elevation angle). Physical range [0..1]";
CM_ SG_ 417 RFC_Loc034_CRC "CRC - Autosar E2E Profile 5, DataID = TBD";
CM_ SG_ 417 RFC_Loc034_AliveCtr "Alive counter - Autosar E2E Profile 5";
CM_ SG_ 417 RFC_Loc034_ProtBlockCtr "Protocol-Signal: Block-Counter";
CM_ SG_ 417 RFC_Loc034_Dr "Location radial distance";
CM_ SG_ 417 RFC_Loc034_Vr "Location radial relative velocity";
CM_ SG_ 417 RFC_Loc034_Theta "Location azimuth angle. \"Not a number\" TBD";
CM_ SG_ 417 RFC_Loc034_Phi "Location elevation angle. \"Not a number\" TBD";
CM_ SG_ 417 RFC_Loc034_DrVnce "Variance of Location radial distance";
CM_ SG_ 417 RFC_Loc034_VrVnce "Variance of Location radial relative velocity";
CM_ SG_ 417 RFC_Loc034_ThetaVnce "Variance of Location azimuth angle";
CM_ SG_ 417 RFC_Loc034_PhiVnce "Variance of Location elevation angle";
CM_ SG_ 417 RFC_Loc034_DrVrCoVnce "Covariance of Dr and Vr";
CM_ SG_ 417 RFC_Loc034_RCS "Radar Cross Section (RCS) estimation";
CM_ SG_ 417 RFC_Loc034_RSSI "Received Signal Strength Indication (RSSI)";
CM_ SG_ 417 RFC_Loc034_DrVrQuality "Quality of radial distance and velocity resolution processing. Physical range [0..1]";
CM_ SG_ 417 RFC_Loc034_ThetaQuality "Probability for correct signal model (azimuth angle). Physical range [0..1]";
CM_ SG_ 417 RFC_Loc034_PhiQuality "Probability for correct signal model (elevation angle). Physical range [0..1]";
CM_ SG_ 417 RFC_Loc035_Dr "Location radial distance";
CM_ SG_ 417 RFC_Loc035_Vr "Location radial relative velocity";
CM_ SG_ 417 RFC_Loc035_Theta "Location azimuth angle. \"Not a number\" TBD";
CM_ SG_ 417 RFC_Loc035_Phi "Location elevation angle. \"Not a number\" TBD";
CM_ SG_ 417 RFC_Loc035_DrVnce "Variance of Location radial distance";
CM_ SG_ 417 RFC_Loc035_VrVnce "Variance of Location radial relative velocity";
CM_ SG_ 417 RFC_Loc035_ThetaVnce "Variance of Location azimuth angle";
CM_ SG_ 417 RFC_Loc035_PhiVnce "Variance of Location elevation angle";
CM_ SG_ 417 RFC_Loc035_DrVrCoVnce "Covariance of Dr and Vr";
CM_ SG_ 417 RFC_Loc035_RCS "Radar Cross Section (RCS) estimation";
CM_ SG_ 417 RFC_Loc035_RSSI "Received Signal Strength Indication (RSSI)";
CM_ SG_ 417 RFC_Loc035_DrVrQuality "Quality of radial distance and velocity resolution processing. Physical range [0..1]";
CM_ SG_ 417 RFC_Loc035_ThetaQuality "Probability for correct signal model (azimuth angle). Physical range [0..1]";
CM_ SG_ 417 RFC_Loc035_PhiQuality "Probability for correct signal model (elevation angle). Physical range [0..1]";
CM_ SG_ 418 RFC_Loc036_CRC "CRC - Autosar E2E Profile 5, DataID = TBD";
CM_ SG_ 418 RFC_Loc036_AliveCtr "Alive counter - Autosar E2E Profile 5";
CM_ SG_ 418 RFC_Loc036_ProtBlockCtr "Protocol-Signal: Block-Counter";
CM_ SG_ 418 RFC_Loc036_Dr "Location radial distance";
CM_ SG_ 418 RFC_Loc036_Vr "Location radial relative velocity";
CM_ SG_ 418 RFC_Loc036_Theta "Location azimuth angle. \"Not a number\" TBD";
CM_ SG_ 418 RFC_Loc036_Phi "Location elevation angle. \"Not a number\" TBD";
CM_ SG_ 418 RFC_Loc036_DrVnce "Variance of Location radial distance";
CM_ SG_ 418 RFC_Loc036_VrVnce "Variance of Location radial relative velocity";
CM_ SG_ 418 RFC_Loc036_ThetaVnce "Variance of Location azimuth angle";
CM_ SG_ 418 RFC_Loc036_PhiVnce "Variance of Location elevation angle";
CM_ SG_ 418 RFC_Loc036_DrVrCoVnce "Covariance of Dr and Vr";
CM_ SG_ 418 RFC_Loc036_RCS "Radar Cross Section (RCS) estimation";
CM_ SG_ 418 RFC_Loc036_RSSI "Received Signal Strength Indication (RSSI)";
CM_ SG_ 418 RFC_Loc036_DrVrQuality "Quality of radial distance and velocity resolution processing. Physical range [0..1]";
CM_ SG_ 418 RFC_Loc036_ThetaQuality "Probability for correct signal model (azimuth angle). Physical range [0..1]";
CM_ SG_ 418 RFC_Loc036_PhiQuality "Probability for correct signal model (elevation angle). Physical range [0..1]";
CM_ SG_ 418 RFC_Loc037_Dr "Location radial distance";
CM_ SG_ 418 RFC_Loc037_Vr "Location radial relative velocity";
CM_ SG_ 418 RFC_Loc037_Theta "Location azimuth angle. \"Not a number\" TBD";
CM_ SG_ 418 RFC_Loc037_Phi "Location elevation angle. \"Not a number\" TBD";
CM_ SG_ 418 RFC_Loc037_DrVnce "Variance of Location radial distance";
CM_ SG_ 418 RFC_Loc037_VrVnce "Variance of Location radial relative velocity";
CM_ SG_ 418 RFC_Loc037_ThetaVnce "Variance of Location azimuth angle";
CM_ SG_ 418 RFC_Loc037_PhiVnce "Variance of Location elevation angle";
CM_ SG_ 418 RFC_Loc037_DrVrCoVnce "Covariance of Dr and Vr";
CM_ SG_ 418 RFC_Loc037_RCS "Radar Cross Section (RCS) estimation";
CM_ SG_ 418 RFC_Loc037_RSSI "Received Signal Strength Indication (RSSI)";
CM_ SG_ 418 RFC_Loc037_DrVrQuality "Quality of radial distance and velocity resolution processing. Physical range [0..1]";
CM_ SG_ 418 RFC_Loc037_ThetaQuality "Probability for correct signal model (azimuth angle). Physical range [0..1]";
CM_ SG_ 418 RFC_Loc037_PhiQuality "Probability for correct signal model (elevation angle). Physical range [0..1]";
CM_ SG_ 419 RFC_Loc038_CRC "CRC - Autosar E2E Profile 5, DataID = TBD";
CM_ SG_ 419 RFC_Loc038_AliveCtr "Alive counter - Autosar E2E Profile 5";
CM_ SG_ 419 RFC_Loc038_ProtBlockCtr "Protocol-Signal: Block-Counter";
CM_ SG_ 419 RFC_Loc038_Dr "Location radial distance";
CM_ SG_ 419 RFC_Loc038_Vr "Location radial relative velocity";
CM_ SG_ 419 RFC_Loc038_Theta "Location azimuth angle. \"Not a number\" TBD";
CM_ SG_ 419 RFC_Loc038_Phi "Location elevation angle. \"Not a number\" TBD";
CM_ SG_ 419 RFC_Loc038_DrVnce "Variance of Location radial distance";
CM_ SG_ 419 RFC_Loc038_VrVnce "Variance of Location radial relative velocity";
CM_ SG_ 419 RFC_Loc038_ThetaVnce "Variance of Location azimuth angle";
CM_ SG_ 419 RFC_Loc038_PhiVnce "Variance of Location elevation angle";
CM_ SG_ 419 RFC_Loc038_DrVrCoVnce "Covariance of Dr and Vr";
CM_ SG_ 419 RFC_Loc038_RCS "Radar Cross Section (RCS) estimation";
CM_ SG_ 419 RFC_Loc038_RSSI "Received Signal Strength Indication (RSSI)";
CM_ SG_ 419 RFC_Loc038_DrVrQuality "Quality of radial distance and velocity resolution processing. Physical range [0..1]";
CM_ SG_ 419 RFC_Loc038_ThetaQuality "Probability for correct signal model (azimuth angle). Physical range [0..1]";
CM_ SG_ 419 RFC_Loc038_PhiQuality "Probability for correct signal model (elevation angle). Physical range [0..1]";
CM_ SG_ 419 RFC_Loc039_Dr "Location radial distance";
CM_ SG_ 419 RFC_Loc039_Vr "Location radial relative velocity";
CM_ SG_ 419 RFC_Loc039_Theta "Location azimuth angle. \"Not a number\" TBD";
CM_ SG_ 419 RFC_Loc039_Phi "Location elevation angle. \"Not a number\" TBD";
CM_ SG_ 419 RFC_Loc039_DrVnce "Variance of Location radial distance";
CM_ SG_ 419 RFC_Loc039_VrVnce "Variance of Location radial relative velocity";
CM_ SG_ 419 RFC_Loc039_ThetaVnce "Variance of Location azimuth angle";
CM_ SG_ 419 RFC_Loc039_PhiVnce "Variance of Location elevation angle";
CM_ SG_ 419 RFC_Loc039_DrVrCoVnce "Covariance of Dr and Vr";
CM_ SG_ 419 RFC_Loc039_RCS "Radar Cross Section (RCS) estimation";
CM_ SG_ 419 RFC_Loc039_RSSI "Received Signal Strength Indication (RSSI)";
CM_ SG_ 419 RFC_Loc039_DrVrQuality "Quality of radial distance and velocity resolution processing. Physical range [0..1]";
CM_ SG_ 419 RFC_Loc039_ThetaQuality "Probability for correct signal model (azimuth angle). Physical range [0..1]";
CM_ SG_ 419 RFC_Loc039_PhiQuality "Probability for correct signal model (elevation angle). Physical range [0..1]";
CM_ SG_ 420 RFC_Loc040_CRC "CRC - Autosar E2E Profile 5, DataID = TBD";
CM_ SG_ 420 RFC_Loc040_AliveCtr "Alive counter - Autosar E2E Profile 5";
CM_ SG_ 420 RFC_Loc040_ProtBlockCtr "Protocol-Signal: Block-Counter";
CM_ SG_ 420 RFC_Loc040_Dr "Location radial distance";
CM_ SG_ 420 RFC_Loc040_Vr "Location radial relative velocity";
CM_ SG_ 420 RFC_Loc040_Theta "Location azimuth angle. \"Not a number\" TBD";
CM_ SG_ 420 RFC_Loc040_Phi "Location elevation angle. \"Not a number\" TBD";
CM_ SG_ 420 RFC_Loc040_DrVnce "Variance of Location radial distance";
CM_ SG_ 420 RFC_Loc040_VrVnce "Variance of Location radial relative velocity";
CM_ SG_ 420 RFC_Loc040_ThetaVnce "Variance of Location azimuth angle";
CM_ SG_ 420 RFC_Loc040_PhiVnce "Variance of Location elevation angle";
CM_ SG_ 420 RFC_Loc040_DrVrCoVnce "Covariance of Dr and Vr";
CM_ SG_ 420 RFC_Loc040_RCS "Radar Cross Section (RCS) estimation";
CM_ SG_ 420 RFC_Loc040_RSSI "Received Signal Strength Indication (RSSI)";
CM_ SG_ 420 RFC_Loc040_DrVrQuality "Quality of radial distance and velocity resolution processing. Physical range [0..1]";
CM_ SG_ 420 RFC_Loc040_ThetaQuality "Probability for correct signal model (azimuth angle). Physical range [0..1]";
CM_ SG_ 420 RFC_Loc040_PhiQuality "Probability for correct signal model (elevation angle). Physical range [0..1]";
CM_ SG_ 420 RFC_Loc041_Dr "Location radial distance";
CM_ SG_ 420 RFC_Loc041_Vr "Location radial relative velocity";
CM_ SG_ 420 RFC_Loc041_Theta "Location azimuth angle. \"Not a number\" TBD";
CM_ SG_ 420 RFC_Loc041_Phi "Location elevation angle. \"Not a number\" TBD";
CM_ SG_ 420 RFC_Loc041_DrVnce "Variance of Location radial distance";
CM_ SG_ 420 RFC_Loc041_VrVnce "Variance of Location radial relative velocity";
CM_ SG_ 420 RFC_Loc041_ThetaVnce "Variance of Location azimuth angle";
CM_ SG_ 420 RFC_Loc041_PhiVnce "Variance of Location elevation angle";
CM_ SG_ 420 RFC_Loc041_DrVrCoVnce "Covariance of Dr and Vr";
CM_ SG_ 420 RFC_Loc041_RCS "Radar Cross Section (RCS) estimation";
CM_ SG_ 420 RFC_Loc041_RSSI "Received Signal Strength Indication (RSSI)";
CM_ SG_ 420 RFC_Loc041_DrVrQuality "Quality of radial distance and velocity resolution processing. Physical range [0..1]";
CM_ SG_ 420 RFC_Loc041_ThetaQuality "Probability for correct signal model (azimuth angle). Physical range [0..1]";
CM_ SG_ 420 RFC_Loc041_PhiQuality "Probability for correct signal model (elevation angle). Physical range [0..1]";
CM_ SG_ 421 RFC_Loc042_CRC "CRC - Autosar E2E Profile 5, DataID = TBD";
CM_ SG_ 421 RFC_Loc042_AliveCtr "Alive counter - Autosar E2E Profile 5";
CM_ SG_ 421 RFC_Loc042_ProtBlockCtr "Protocol-Signal: Block-Counter";
CM_ SG_ 421 RFC_Loc042_Dr "Location radial distance";
CM_ SG_ 421 RFC_Loc042_Vr "Location radial relative velocity";
CM_ SG_ 421 RFC_Loc042_Theta "Location azimuth angle. \"Not a number\" TBD";
CM_ SG_ 421 RFC_Loc042_Phi "Location elevation angle. \"Not a number\" TBD";
CM_ SG_ 421 RFC_Loc042_DrVnce "Variance of Location radial distance";
CM_ SG_ 421 RFC_Loc042_VrVnce "Variance of Location radial relative velocity";
CM_ SG_ 421 RFC_Loc042_ThetaVnce "Variance of Location azimuth angle";
CM_ SG_ 421 RFC_Loc042_PhiVnce "Variance of Location elevation angle";
CM_ SG_ 421 RFC_Loc042_DrVrCoVnce "Covariance of Dr and Vr";
CM_ SG_ 421 RFC_Loc042_RCS "Radar Cross Section (RCS) estimation";
CM_ SG_ 421 RFC_Loc042_RSSI "Received Signal Strength Indication (RSSI)";
CM_ SG_ 421 RFC_Loc042_DrVrQuality "Quality of radial distance and velocity resolution processing. Physical range [0..1]";
CM_ SG_ 421 RFC_Loc042_ThetaQuality "Probability for correct signal model (azimuth angle). Physical range [0..1]";
CM_ SG_ 421 RFC_Loc042_PhiQuality "Probability for correct signal model (elevation angle). Physical range [0..1]";
CM_ SG_ 421 RFC_Loc043_Dr "Location radial distance";
CM_ SG_ 421 RFC_Loc043_Vr "Location radial relative velocity";
CM_ SG_ 421 RFC_Loc043_Theta "Location azimuth angle. \"Not a number\" TBD";
CM_ SG_ 421 RFC_Loc043_Phi "Location elevation angle. \"Not a number\" TBD";
CM_ SG_ 421 RFC_Loc043_DrVnce "Variance of Location radial distance";
CM_ SG_ 421 RFC_Loc043_VrVnce "Variance of Location radial relative velocity";
CM_ SG_ 421 RFC_Loc043_ThetaVnce "Variance of Location azimuth angle";
CM_ SG_ 421 RFC_Loc043_PhiVnce "Variance of Location elevation angle";
CM_ SG_ 421 RFC_Loc043_DrVrCoVnce "Covariance of Dr and Vr";
CM_ SG_ 421 RFC_Loc043_RCS "Radar Cross Section (RCS) estimation";
CM_ SG_ 421 RFC_Loc043_RSSI "Received Signal Strength Indication (RSSI)";
CM_ SG_ 421 RFC_Loc043_DrVrQuality "Quality of radial distance and velocity resolution processing. Physical range [0..1]";
CM_ SG_ 421 RFC_Loc043_ThetaQuality "Probability for correct signal model (azimuth angle). Physical range [0..1]";
CM_ SG_ 421 RFC_Loc043_PhiQuality "Probability for correct signal model (elevation angle). Physical range [0..1]";
CM_ SG_ 422 RFC_Loc044_CRC "CRC - Autosar E2E Profile 5, DataID = TBD";
CM_ SG_ 422 RFC_Loc044_AliveCtr "Alive counter - Autosar E2E Profile 5";
CM_ SG_ 422 RFC_Loc044_ProtBlockCtr "Protocol-Signal: Block-Counter";
CM_ SG_ 422 RFC_Loc044_Dr "Location radial distance";
CM_ SG_ 422 RFC_Loc044_Vr "Location radial relative velocity";
CM_ SG_ 422 RFC_Loc044_Theta "Location azimuth angle. \"Not a number\" TBD";
CM_ SG_ 422 RFC_Loc044_Phi "Location elevation angle. \"Not a number\" TBD";
CM_ SG_ 422 RFC_Loc044_DrVnce "Variance of Location radial distance";
CM_ SG_ 422 RFC_Loc044_VrVnce "Variance of Location radial relative velocity";
CM_ SG_ 422 RFC_Loc044_ThetaVnce "Variance of Location azimuth angle";
CM_ SG_ 422 RFC_Loc044_PhiVnce "Variance of Location elevation angle";
CM_ SG_ 422 RFC_Loc044_DrVrCoVnce "Covariance of Dr and Vr";
CM_ SG_ 422 RFC_Loc044_RCS "Radar Cross Section (RCS) estimation";
CM_ SG_ 422 RFC_Loc044_RSSI "Received Signal Strength Indication (RSSI)";
CM_ SG_ 422 RFC_Loc044_DrVrQuality "Quality of radial distance and velocity resolution processing. Physical range [0..1]";
CM_ SG_ 422 RFC_Loc044_ThetaQuality "Probability for correct signal model (azimuth angle). Physical range [0..1]";
CM_ SG_ 422 RFC_Loc044_PhiQuality "Probability for correct signal model (elevation angle). Physical range [0..1]";
CM_ SG_ 422 RFC_Loc045_Dr "Location radial distance";
CM_ SG_ 422 RFC_Loc045_Vr "Location radial relative velocity";
CM_ SG_ 422 RFC_Loc045_Theta "Location azimuth angle. \"Not a number\" TBD";
CM_ SG_ 422 RFC_Loc045_Phi "Location elevation angle. \"Not a number\" TBD";
CM_ SG_ 422 RFC_Loc045_DrVnce "Variance of Location radial distance";
CM_ SG_ 422 RFC_Loc045_VrVnce "Variance of Location radial relative velocity";
CM_ SG_ 422 RFC_Loc045_ThetaVnce "Variance of Location azimuth angle";
CM_ SG_ 422 RFC_Loc045_PhiVnce "Variance of Location elevation angle";
CM_ SG_ 422 RFC_Loc045_DrVrCoVnce "Covariance of Dr and Vr";
CM_ SG_ 422 RFC_Loc045_RCS "Radar Cross Section (RCS) estimation";
CM_ SG_ 422 RFC_Loc045_RSSI "Received Signal Strength Indication (RSSI)";
CM_ SG_ 422 RFC_Loc045_DrVrQuality "Quality of radial distance and velocity resolution processing. Physical range [0..1]";
CM_ SG_ 422 RFC_Loc045_ThetaQuality "Probability for correct signal model (azimuth angle). Physical range [0..1]";
CM_ SG_ 422 RFC_Loc045_PhiQuality "Probability for correct signal model (elevation angle). Physical range [0..1]";
CM_ SG_ 423 RFC_Loc046_CRC "CRC - Autosar E2E Profile 5, DataID = TBD";
CM_ SG_ 423 RFC_Loc046_AliveCtr "Alive counter - Autosar E2E Profile 5";
CM_ SG_ 423 RFC_Loc046_ProtBlockCtr "Protocol-Signal: Block-Counter";
CM_ SG_ 423 RFC_Loc046_Dr "Location radial distance";
CM_ SG_ 423 RFC_Loc046_Vr "Location radial relative velocity";
CM_ SG_ 423 RFC_Loc046_Theta "Location azimuth angle. \"Not a number\" TBD";
CM_ SG_ 423 RFC_Loc046_Phi "Location elevation angle. \"Not a number\" TBD";
CM_ SG_ 423 RFC_Loc046_DrVnce "Variance of Location radial distance";
CM_ SG_ 423 RFC_Loc046_VrVnce "Variance of Location radial relative velocity";
CM_ SG_ 423 RFC_Loc046_ThetaVnce "Variance of Location azimuth angle";
CM_ SG_ 423 RFC_Loc046_PhiVnce "Variance of Location elevation angle";
CM_ SG_ 423 RFC_Loc046_DrVrCoVnce "Covariance of Dr and Vr";
CM_ SG_ 423 RFC_Loc046_RCS "Radar Cross Section (RCS) estimation";
CM_ SG_ 423 RFC_Loc046_RSSI "Received Signal Strength Indication (RSSI)";
CM_ SG_ 423 RFC_Loc046_DrVrQuality "Quality of radial distance and velocity resolution processing. Physical range [0..1]";
CM_ SG_ 423 RFC_Loc046_ThetaQuality "Probability for correct signal model (azimuth angle). Physical range [0..1]";
CM_ SG_ 423 RFC_Loc046_PhiQuality "Probability for correct signal model (elevation angle). Physical range [0..1]";
CM_ SG_ 423 RFC_Loc047_Dr "Location radial distance";
CM_ SG_ 423 RFC_Loc047_Vr "Location radial relative velocity";
CM_ SG_ 423 RFC_Loc047_Theta "Location azimuth angle. \"Not a number\" TBD";
CM_ SG_ 423 RFC_Loc047_Phi "Location elevation angle. \"Not a number\" TBD";
CM_ SG_ 423 RFC_Loc047_DrVnce "Variance of Location radial distance";
CM_ SG_ 423 RFC_Loc047_VrVnce "Variance of Location radial relative velocity";
CM_ SG_ 423 RFC_Loc047_ThetaVnce "Variance of Location azimuth angle";
CM_ SG_ 423 RFC_Loc047_PhiVnce "Variance of Location elevation angle";
CM_ SG_ 423 RFC_Loc047_DrVrCoVnce "Covariance of Dr and Vr";
CM_ SG_ 423 RFC_Loc047_RCS "Radar Cross Section (RCS) estimation";
CM_ SG_ 423 RFC_Loc047_RSSI "Received Signal Strength Indication (RSSI)";
CM_ SG_ 423 RFC_Loc047_DrVrQuality "Quality of radial distance and velocity resolution processing. Physical range [0..1]";
CM_ SG_ 423 RFC_Loc047_ThetaQuality "Probability for correct signal model (azimuth angle). Physical range [0..1]";
CM_ SG_ 423 RFC_Loc047_PhiQuality "Probability for correct signal model (elevation angle). Physical range [0..1]";
CM_ SG_ 424 RFC_Loc048_CRC "CRC - Autosar E2E Profile 5, DataID = TBD";
CM_ SG_ 424 RFC_Loc048_AliveCtr "Alive counter - Autosar E2E Profile 5";
CM_ SG_ 424 RFC_Loc048_ProtBlockCtr "Protocol-Signal: Block-Counter";
CM_ SG_ 424 RFC_Loc048_Dr "Location radial distance";
CM_ SG_ 424 RFC_Loc048_Vr "Location radial relative velocity";
CM_ SG_ 424 RFC_Loc048_Theta "Location azimuth angle. \"Not a number\" TBD";
CM_ SG_ 424 RFC_Loc048_Phi "Location elevation angle. \"Not a number\" TBD";
CM_ SG_ 424 RFC_Loc048_DrVnce "Variance of Location radial distance";
CM_ SG_ 424 RFC_Loc048_VrVnce "Variance of Location radial relative velocity";
CM_ SG_ 424 RFC_Loc048_ThetaVnce "Variance of Location azimuth angle";
CM_ SG_ 424 RFC_Loc048_PhiVnce "Variance of Location elevation angle";
CM_ SG_ 424 RFC_Loc048_DrVrCoVnce "Covariance of Dr and Vr";
CM_ SG_ 424 RFC_Loc048_RCS "Radar Cross Section (RCS) estimation";
CM_ SG_ 424 RFC_Loc048_RSSI "Received Signal Strength Indication (RSSI)";
CM_ SG_ 424 RFC_Loc048_DrVrQuality "Quality of radial distance and velocity resolution processing. Physical range [0..1]";
CM_ SG_ 424 RFC_Loc048_ThetaQuality "Probability for correct signal model (azimuth angle). Physical range [0..1]";
CM_ SG_ 424 RFC_Loc048_PhiQuality "Probability for correct signal model (elevation angle). Physical range [0..1]";
CM_ SG_ 424 RFC_Loc049_Dr "Location radial distance";
CM_ SG_ 424 RFC_Loc049_Vr "Location radial relative velocity";
CM_ SG_ 424 RFC_Loc049_Theta "Location azimuth angle. \"Not a number\" TBD";
CM_ SG_ 424 RFC_Loc049_Phi "Location elevation angle. \"Not a number\" TBD";
CM_ SG_ 424 RFC_Loc049_DrVnce "Variance of Location radial distance";
CM_ SG_ 424 RFC_Loc049_VrVnce "Variance of Location radial relative velocity";
CM_ SG_ 424 RFC_Loc049_ThetaVnce "Variance of Location azimuth angle";
CM_ SG_ 424 RFC_Loc049_PhiVnce "Variance of Location elevation angle";
CM_ SG_ 424 RFC_Loc049_DrVrCoVnce "Covariance of Dr and Vr";
CM_ SG_ 424 RFC_Loc049_RCS "Radar Cross Section (RCS) estimation";
CM_ SG_ 424 RFC_Loc049_RSSI "Received Signal Strength Indication (RSSI)";
CM_ SG_ 424 RFC_Loc049_DrVrQuality "Quality of radial distance and velocity resolution processing. Physical range [0..1]";
CM_ SG_ 424 RFC_Loc049_ThetaQuality "Probability for correct signal model (azimuth angle). Physical range [0..1]";
CM_ SG_ 424 RFC_Loc049_PhiQuality "Probability for correct signal model (elevation angle). Physical range [0..1]";
CM_ SG_ 425 RFC_Loc050_CRC "CRC - Autosar E2E Profile 5, DataID = TBD";
CM_ SG_ 425 RFC_Loc050_AliveCtr "Alive counter - Autosar E2E Profile 5";
CM_ SG_ 425 RFC_Loc050_ProtBlockCtr "Protocol-Signal: Block-Counter";
CM_ SG_ 425 RFC_Loc050_Dr "Location radial distance";
CM_ SG_ 425 RFC_Loc050_Vr "Location radial relative velocity";
CM_ SG_ 425 RFC_Loc050_Theta "Location azimuth angle. \"Not a number\" TBD";
CM_ SG_ 425 RFC_Loc050_Phi "Location elevation angle. \"Not a number\" TBD";
CM_ SG_ 425 RFC_Loc050_DrVnce "Variance of Location radial distance";
CM_ SG_ 425 RFC_Loc050_VrVnce "Variance of Location radial relative velocity";
CM_ SG_ 425 RFC_Loc050_ThetaVnce "Variance of Location azimuth angle";
CM_ SG_ 425 RFC_Loc050_PhiVnce "Variance of Location elevation angle";
CM_ SG_ 425 RFC_Loc050_DrVrCoVnce "Covariance of Dr and Vr";
CM_ SG_ 425 RFC_Loc050_RCS "Radar Cross Section (RCS) estimation";
CM_ SG_ 425 RFC_Loc050_RSSI "Received Signal Strength Indication (RSSI)";
CM_ SG_ 425 RFC_Loc050_DrVrQuality "Quality of radial distance and velocity resolution processing. Physical range [0..1]";
CM_ SG_ 425 RFC_Loc050_ThetaQuality "Probability for correct signal model (azimuth angle). Physical range [0..1]";
CM_ SG_ 425 RFC_Loc050_PhiQuality "Probability for correct signal model (elevation angle). Physical range [0..1]";
CM_ SG_ 425 RFC_Loc051_Dr "Location radial distance";
CM_ SG_ 425 RFC_Loc051_Vr "Location radial relative velocity";
CM_ SG_ 425 RFC_Loc051_Theta "Location azimuth angle. \"Not a number\" TBD";
CM_ SG_ 425 RFC_Loc051_Phi "Location elevation angle. \"Not a number\" TBD";
CM_ SG_ 425 RFC_Loc051_DrVnce "Variance of Location radial distance";
CM_ SG_ 425 RFC_Loc051_VrVnce "Variance of Location radial relative velocity";
CM_ SG_ 425 RFC_Loc051_ThetaVnce "Variance of Location azimuth angle";
CM_ SG_ 425 RFC_Loc051_PhiVnce "Variance of Location elevation angle";
CM_ SG_ 425 RFC_Loc051_DrVrCoVnce "Covariance of Dr and Vr";
CM_ SG_ 425 RFC_Loc051_RCS "Radar Cross Section (RCS) estimation";
CM_ SG_ 425 RFC_Loc051_RSSI "Received Signal Strength Indication (RSSI)";
CM_ SG_ 425 RFC_Loc051_DrVrQuality "Quality of radial distance and velocity resolution processing. Physical range [0..1]";
CM_ SG_ 425 RFC_Loc051_ThetaQuality "Probability for correct signal model (azimuth angle). Physical range [0..1]";
CM_ SG_ 425 RFC_Loc051_PhiQuality "Probability for correct signal model (elevation angle). Physical range [0..1]";
CM_ SG_ 426 RFC_Loc052_CRC "CRC - Autosar E2E Profile 5, DataID = TBD";
CM_ SG_ 426 RFC_Loc052_AliveCtr "Alive counter - Autosar E2E Profile 5";
CM_ SG_ 426 RFC_Loc052_ProtBlockCtr "Protocol-Signal: Block-Counter";
CM_ SG_ 426 RFC_Loc052_Dr "Location radial distance";
CM_ SG_ 426 RFC_Loc052_Vr "Location radial relative velocity";
CM_ SG_ 426 RFC_Loc052_Theta "Location azimuth angle. \"Not a number\" TBD";
CM_ SG_ 426 RFC_Loc052_Phi "Location elevation angle. \"Not a number\" TBD";
CM_ SG_ 426 RFC_Loc052_DrVnce "Variance of Location radial distance";
CM_ SG_ 426 RFC_Loc052_VrVnce "Variance of Location radial relative velocity";
CM_ SG_ 426 RFC_Loc052_ThetaVnce "Variance of Location azimuth angle";
CM_ SG_ 426 RFC_Loc052_PhiVnce "Variance of Location elevation angle";
CM_ SG_ 426 RFC_Loc052_DrVrCoVnce "Covariance of Dr and Vr";
CM_ SG_ 426 RFC_Loc052_RCS "Radar Cross Section (RCS) estimation";
CM_ SG_ 426 RFC_Loc052_RSSI "Received Signal Strength Indication (RSSI)";
CM_ SG_ 426 RFC_Loc052_DrVrQuality "Quality of radial distance and velocity resolution processing. Physical range [0..1]";
CM_ SG_ 426 RFC_Loc052_ThetaQuality "Probability for correct signal model (azimuth angle). Physical range [0..1]";
CM_ SG_ 426 RFC_Loc052_PhiQuality "Probability for correct signal model (elevation angle). Physical range [0..1]";
CM_ SG_ 426 RFC_Loc053_Dr "Location radial distance";
CM_ SG_ 426 RFC_Loc053_Vr "Location radial relative velocity";
CM_ SG_ 426 RFC_Loc053_Theta "Location azimuth angle. \"Not a number\" TBD";
CM_ SG_ 426 RFC_Loc053_Phi "Location elevation angle. \"Not a number\" TBD";
CM_ SG_ 426 RFC_Loc053_DrVnce "Variance of Location radial distance";
CM_ SG_ 426 RFC_Loc053_VrVnce "Variance of Location radial relative velocity";
CM_ SG_ 426 RFC_Loc053_ThetaVnce "Variance of Location azimuth angle";
CM_ SG_ 426 RFC_Loc053_PhiVnce "Variance of Location elevation angle";
CM_ SG_ 426 RFC_Loc053_DrVrCoVnce "Covariance of Dr and Vr";
CM_ SG_ 426 RFC_Loc053_RCS "Radar Cross Section (RCS) estimation";
CM_ SG_ 426 RFC_Loc053_RSSI "Received Signal Strength Indication (RSSI)";
CM_ SG_ 426 RFC_Loc053_DrVrQuality "Quality of radial distance and velocity resolution processing. Physical range [0..1]";
CM_ SG_ 426 RFC_Loc053_ThetaQuality "Probability for correct signal model (azimuth angle). Physical range [0..1]";
CM_ SG_ 426 RFC_Loc053_PhiQuality "Probability for correct signal model (elevation angle). Physical range [0..1]";
CM_ SG_ 427 RFC_Loc054_CRC "CRC - Autosar E2E Profile 5, DataID = TBD";
CM_ SG_ 427 RFC_Loc054_AliveCtr "Alive counter - Autosar E2E Profile 5";
CM_ SG_ 427 RFC_Loc054_ProtBlockCtr "Protocol-Signal: Block-Counter";
CM_ SG_ 427 RFC_Loc054_Dr "Location radial distance";
CM_ SG_ 427 RFC_Loc054_Vr "Location radial relative velocity";
CM_ SG_ 427 RFC_Loc054_Theta "Location azimuth angle. \"Not a number\" TBD";
CM_ SG_ 427 RFC_Loc054_Phi "Location elevation angle. \"Not a number\" TBD";
CM_ SG_ 427 RFC_Loc054_DrVnce "Variance of Location radial distance";
CM_ SG_ 427 RFC_Loc054_VrVnce "Variance of Location radial relative velocity";
CM_ SG_ 427 RFC_Loc054_ThetaVnce "Variance of Location azimuth angle";
CM_ SG_ 427 RFC_Loc054_PhiVnce "Variance of Location elevation angle";
CM_ SG_ 427 RFC_Loc054_DrVrCoVnce "Covariance of Dr and Vr";
CM_ SG_ 427 RFC_Loc054_RCS "Radar Cross Section (RCS) estimation";
CM_ SG_ 427 RFC_Loc054_RSSI "Received Signal Strength Indication (RSSI)";
CM_ SG_ 427 RFC_Loc054_DrVrQuality "Quality of radial distance and velocity resolution processing. Physical range [0..1]";
CM_ SG_ 427 RFC_Loc054_ThetaQuality "Probability for correct signal model (azimuth angle). Physical range [0..1]";
CM_ SG_ 427 RFC_Loc054_PhiQuality "Probability for correct signal model (elevation angle). Physical range [0..1]";
CM_ SG_ 427 RFC_Loc055_Dr "Location radial distance";
CM_ SG_ 427 RFC_Loc055_Vr "Location radial relative velocity";
CM_ SG_ 427 RFC_Loc055_Theta "Location azimuth angle. \"Not a number\" TBD";
CM_ SG_ 427 RFC_Loc055_Phi "Location elevation angle. \"Not a number\" TBD";
CM_ SG_ 427 RFC_Loc055_DrVnce "Variance of Location radial distance";
CM_ SG_ 427 RFC_Loc055_VrVnce "Variance of Location radial relative velocity";
CM_ SG_ 427 RFC_Loc055_ThetaVnce "Variance of Location azimuth angle";
CM_ SG_ 427 RFC_Loc055_PhiVnce "Variance of Location elevation angle";
CM_ SG_ 427 RFC_Loc055_DrVrCoVnce "Covariance of Dr and Vr";
CM_ SG_ 427 RFC_Loc055_RCS "Radar Cross Section (RCS) estimation";
CM_ SG_ 427 RFC_Loc055_RSSI "Received Signal Strength Indication (RSSI)";
CM_ SG_ 427 RFC_Loc055_DrVrQuality "Quality of radial distance and velocity resolution processing. Physical range [0..1]";
CM_ SG_ 427 RFC_Loc055_ThetaQuality "Probability for correct signal model (azimuth angle). Physical range [0..1]";
CM_ SG_ 427 RFC_Loc055_PhiQuality "Probability for correct signal model (elevation angle). Physical range [0..1]";
CM_ SG_ 428 RFC_Loc056_CRC "CRC - Autosar E2E Profile 5, DataID = TBD";
CM_ SG_ 428 RFC_Loc056_AliveCtr "Alive counter - Autosar E2E Profile 5";
CM_ SG_ 428 RFC_Loc056_ProtBlockCtr "Protocol-Signal: Block-Counter";
CM_ SG_ 428 RFC_Loc056_Dr "Location radial distance";
CM_ SG_ 428 RFC_Loc056_Vr "Location radial relative velocity";
CM_ SG_ 428 RFC_Loc056_Theta "Location azimuth angle. \"Not a number\" TBD";
CM_ SG_ 428 RFC_Loc056_Phi "Location elevation angle. \"Not a number\" TBD";
CM_ SG_ 428 RFC_Loc056_DrVnce "Variance of Location radial distance";
CM_ SG_ 428 RFC_Loc056_VrVnce "Variance of Location radial relative velocity";
CM_ SG_ 428 RFC_Loc056_ThetaVnce "Variance of Location azimuth angle";
CM_ SG_ 428 RFC_Loc056_PhiVnce "Variance of Location elevation angle";
CM_ SG_ 428 RFC_Loc056_DrVrCoVnce "Covariance of Dr and Vr";
CM_ SG_ 428 RFC_Loc056_RCS "Radar Cross Section (RCS) estimation";
CM_ SG_ 428 RFC_Loc056_RSSI "Received Signal Strength Indication (RSSI)";
CM_ SG_ 428 RFC_Loc056_DrVrQuality "Quality of radial distance and velocity resolution processing. Physical range [0..1]";
CM_ SG_ 428 RFC_Loc056_ThetaQuality "Probability for correct signal model (azimuth angle). Physical range [0..1]";
CM_ SG_ 428 RFC_Loc056_PhiQuality "Probability for correct signal model (elevation angle). Physical range [0..1]";
CM_ SG_ 428 RFC_Loc057_Dr "Location radial distance";
CM_ SG_ 428 RFC_Loc057_Vr "Location radial relative velocity";
CM_ SG_ 428 RFC_Loc057_Theta "Location azimuth angle. \"Not a number\" TBD";
CM_ SG_ 428 RFC_Loc057_Phi "Location elevation angle. \"Not a number\" TBD";
CM_ SG_ 428 RFC_Loc057_DrVnce "Variance of Location radial distance";
CM_ SG_ 428 RFC_Loc057_VrVnce "Variance of Location radial relative velocity";
CM_ SG_ 428 RFC_Loc057_ThetaVnce "Variance of Location azimuth angle";
CM_ SG_ 428 RFC_Loc057_PhiVnce "Variance of Location elevation angle";
CM_ SG_ 428 RFC_Loc057_DrVrCoVnce "Covariance of Dr and Vr";
CM_ SG_ 428 RFC_Loc057_RCS "Radar Cross Section (RCS) estimation";
CM_ SG_ 428 RFC_Loc057_RSSI "Received Signal Strength Indication (RSSI)";
CM_ SG_ 428 RFC_Loc057_DrVrQuality "Quality of radial distance and velocity resolution processing. Physical range [0..1]";
CM_ SG_ 428 RFC_Loc057_ThetaQuality "Probability for correct signal model (azimuth angle). Physical range [0..1]";
CM_ SG_ 428 RFC_Loc057_PhiQuality "Probability for correct signal model (elevation angle). Physical range [0..1]";
CM_ SG_ 429 RFC_Loc058_CRC "CRC - Autosar E2E Profile 5, DataID = TBD";
CM_ SG_ 429 RFC_Loc058_AliveCtr "Alive counter - Autosar E2E Profile 5";
CM_ SG_ 429 RFC_Loc058_ProtBlockCtr "Protocol-Signal: Block-Counter";
CM_ SG_ 429 RFC_Loc058_Dr "Location radial distance";
CM_ SG_ 429 RFC_Loc058_Vr "Location radial relative velocity";
CM_ SG_ 429 RFC_Loc058_Theta "Location azimuth angle. \"Not a number\" TBD";
CM_ SG_ 429 RFC_Loc058_Phi "Location elevation angle. \"Not a number\" TBD";
CM_ SG_ 429 RFC_Loc058_DrVnce "Variance of Location radial distance";
CM_ SG_ 429 RFC_Loc058_VrVnce "Variance of Location radial relative velocity";
CM_ SG_ 429 RFC_Loc058_ThetaVnce "Variance of Location azimuth angle";
CM_ SG_ 429 RFC_Loc058_PhiVnce "Variance of Location elevation angle";
CM_ SG_ 429 RFC_Loc058_DrVrCoVnce "Covariance of Dr and Vr";
CM_ SG_ 429 RFC_Loc058_RCS "Radar Cross Section (RCS) estimation";
CM_ SG_ 429 RFC_Loc058_RSSI "Received Signal Strength Indication (RSSI)";
CM_ SG_ 429 RFC_Loc058_DrVrQuality "Quality of radial distance and velocity resolution processing. Physical range [0..1]";
CM_ SG_ 429 RFC_Loc058_ThetaQuality "Probability for correct signal model (azimuth angle). Physical range [0..1]";
CM_ SG_ 429 RFC_Loc058_PhiQuality "Probability for correct signal model (elevation angle). Physical range [0..1]";
CM_ SG_ 429 RFC_Loc059_Dr "Location radial distance";
CM_ SG_ 429 RFC_Loc059_Vr "Location radial relative velocity";
CM_ SG_ 429 RFC_Loc059_Theta "Location azimuth angle. \"Not a number\" TBD";
CM_ SG_ 429 RFC_Loc059_Phi "Location elevation angle. \"Not a number\" TBD";
CM_ SG_ 429 RFC_Loc059_DrVnce "Variance of Location radial distance";
CM_ SG_ 429 RFC_Loc059_VrVnce "Variance of Location radial relative velocity";
CM_ SG_ 429 RFC_Loc059_ThetaVnce "Variance of Location azimuth angle";
CM_ SG_ 429 RFC_Loc059_PhiVnce "Variance of Location elevation angle";
CM_ SG_ 429 RFC_Loc059_DrVrCoVnce "Covariance of Dr and Vr";
CM_ SG_ 429 RFC_Loc059_RCS "Radar Cross Section (RCS) estimation";
CM_ SG_ 429 RFC_Loc059_RSSI "Received Signal Strength Indication (RSSI)";
CM_ SG_ 429 RFC_Loc059_DrVrQuality "Quality of radial distance and velocity resolution processing. Physical range [0..1]";
CM_ SG_ 429 RFC_Loc059_ThetaQuality "Probability for correct signal model (azimuth angle). Physical range [0..1]";
CM_ SG_ 429 RFC_Loc059_PhiQuality "Probability for correct signal model (elevation angle). Physical range [0..1]";
CM_ SG_ 430 RFC_Loc060_CRC "CRC - Autosar E2E Profile 5, DataID = TBD";
CM_ SG_ 430 RFC_Loc060_AliveCtr "Alive counter - Autosar E2E Profile 5";
CM_ SG_ 430 RFC_Loc060_ProtBlockCtr "Protocol-Signal: Block-Counter";
CM_ SG_ 430 RFC_Loc060_Dr "Location radial distance";
CM_ SG_ 430 RFC_Loc060_Vr "Location radial relative velocity";
CM_ SG_ 430 RFC_Loc060_Theta "Location azimuth angle. \"Not a number\" TBD";
CM_ SG_ 430 RFC_Loc060_Phi "Location elevation angle. \"Not a number\" TBD";
CM_ SG_ 430 RFC_Loc060_DrVnce "Variance of Location radial distance";
CM_ SG_ 430 RFC_Loc060_VrVnce "Variance of Location radial relative velocity";
CM_ SG_ 430 RFC_Loc060_ThetaVnce "Variance of Location azimuth angle";
CM_ SG_ 430 RFC_Loc060_PhiVnce "Variance of Location elevation angle";
CM_ SG_ 430 RFC_Loc060_DrVrCoVnce "Covariance of Dr and Vr";
CM_ SG_ 430 RFC_Loc060_RCS "Radar Cross Section (RCS) estimation";
CM_ SG_ 430 RFC_Loc060_RSSI "Received Signal Strength Indication (RSSI)";
CM_ SG_ 430 RFC_Loc060_DrVrQuality "Quality of radial distance and velocity resolution processing. Physical range [0..1]";
CM_ SG_ 430 RFC_Loc060_ThetaQuality "Probability for correct signal model (azimuth angle). Physical range [0..1]";
CM_ SG_ 430 RFC_Loc060_PhiQuality "Probability for correct signal model (elevation angle). Physical range [0..1]";
CM_ SG_ 430 RFC_Loc061_Dr "Location radial distance";
CM_ SG_ 430 RFC_Loc061_Vr "Location radial relative velocity";
CM_ SG_ 430 RFC_Loc061_Theta "Location azimuth angle. \"Not a number\" TBD";
CM_ SG_ 430 RFC_Loc061_Phi "Location elevation angle. \"Not a number\" TBD";
CM_ SG_ 430 RFC_Loc061_DrVnce "Variance of Location radial distance";
CM_ SG_ 430 RFC_Loc061_VrVnce "Variance of Location radial relative velocity";
CM_ SG_ 430 RFC_Loc061_ThetaVnce "Variance of Location azimuth angle";
CM_ SG_ 430 RFC_Loc061_PhiVnce "Variance of Location elevation angle";
CM_ SG_ 430 RFC_Loc061_DrVrCoVnce "Covariance of Dr and Vr";
CM_ SG_ 430 RFC_Loc061_RCS "Radar Cross Section (RCS) estimation";
CM_ SG_ 430 RFC_Loc061_RSSI "Received Signal Strength Indication (RSSI)";
CM_ SG_ 430 RFC_Loc061_DrVrQuality "Quality of radial distance and velocity resolution processing. Physical range [0..1]";
CM_ SG_ 430 RFC_Loc061_ThetaQuality "Probability for correct signal model (azimuth angle). Physical range [0..1]";
CM_ SG_ 430 RFC_Loc061_PhiQuality "Probability for correct signal model (elevation angle). Physical range [0..1]";
CM_ SG_ 431 RFC_Loc062_CRC "CRC - Autosar E2E Profile 5, DataID = TBD";
CM_ SG_ 431 RFC_Loc062_AliveCtr "Alive counter - Autosar E2E Profile 5";
CM_ SG_ 431 RFC_Loc062_ProtBlockCtr "Protocol-Signal: Block-Counter";
CM_ SG_ 431 RFC_Loc062_Dr "Location radial distance";
CM_ SG_ 431 RFC_Loc062_Vr "Location radial relative velocity";
CM_ SG_ 431 RFC_Loc062_Theta "Location azimuth angle. \"Not a number\" TBD";
CM_ SG_ 431 RFC_Loc062_Phi "Location elevation angle. \"Not a number\" TBD";
CM_ SG_ 431 RFC_Loc062_DrVnce "Variance of Location radial distance";
CM_ SG_ 431 RFC_Loc062_VrVnce "Variance of Location radial relative velocity";
CM_ SG_ 431 RFC_Loc062_ThetaVnce "Variance of Location azimuth angle";
CM_ SG_ 431 RFC_Loc062_PhiVnce "Variance of Location elevation angle";
CM_ SG_ 431 RFC_Loc062_DrVrCoVnce "Covariance of Dr and Vr";
CM_ SG_ 431 RFC_Loc062_RCS "Radar Cross Section (RCS) estimation";
CM_ SG_ 431 RFC_Loc062_RSSI "Received Signal Strength Indication (RSSI)";
CM_ SG_ 431 RFC_Loc062_DrVrQuality "Quality of radial distance and velocity resolution processing. Physical range [0..1]";
CM_ SG_ 431 RFC_Loc062_ThetaQuality "Probability for correct signal model (azimuth angle). Physical range [0..1]";
CM_ SG_ 431 RFC_Loc062_PhiQuality "Probability for correct signal model (elevation angle). Physical range [0..1]";
CM_ SG_ 431 RFC_Loc063_Dr "Location radial distance";
CM_ SG_ 431 RFC_Loc063_Vr "Location radial relative velocity";
CM_ SG_ 431 RFC_Loc063_Theta "Location azimuth angle. \"Not a number\" TBD";
CM_ SG_ 431 RFC_Loc063_Phi "Location elevation angle. \"Not a number\" TBD";
CM_ SG_ 431 RFC_Loc063_DrVnce "Variance of Location radial distance";
CM_ SG_ 431 RFC_Loc063_VrVnce "Variance of Location radial relative velocity";
CM_ SG_ 431 RFC_Loc063_ThetaVnce "Variance of Location azimuth angle";
CM_ SG_ 431 RFC_Loc063_PhiVnce "Variance of Location elevation angle";
CM_ SG_ 431 RFC_Loc063_DrVrCoVnce "Covariance of Dr and Vr";
CM_ SG_ 431 RFC_Loc063_RCS "Radar Cross Section (RCS) estimation";
CM_ SG_ 431 RFC_Loc063_RSSI "Received Signal Strength Indication (RSSI)";
CM_ SG_ 431 RFC_Loc063_DrVrQuality "Quality of radial distance and velocity resolution processing. Physical range [0..1]";
CM_ SG_ 431 RFC_Loc063_ThetaQuality "Probability for correct signal model (azimuth angle). Physical range [0..1]";
CM_ SG_ 431 RFC_Loc063_PhiQuality "Probability for correct signal model (elevation angle). Physical range [0..1]";
CM_ SG_ 432 RFC_Loc064_CRC "CRC - Autosar E2E Profile 5, DataID = TBD";
CM_ SG_ 432 RFC_Loc064_AliveCtr "Alive counter - Autosar E2E Profile 5";
CM_ SG_ 432 RFC_Loc064_ProtBlockCtr "Protocol-Signal: Block-Counter";
CM_ SG_ 432 RFC_Loc064_Dr "Location radial distance";
CM_ SG_ 432 RFC_Loc064_Vr "Location radial relative velocity";
CM_ SG_ 432 RFC_Loc064_Theta "Location azimuth angle. \"Not a number\" TBD";
CM_ SG_ 432 RFC_Loc064_Phi "Location elevation angle. \"Not a number\" TBD";
CM_ SG_ 432 RFC_Loc064_DrVnce "Variance of Location radial distance";
CM_ SG_ 432 RFC_Loc064_VrVnce "Variance of Location radial relative velocity";
CM_ SG_ 432 RFC_Loc064_ThetaVnce "Variance of Location azimuth angle";
CM_ SG_ 432 RFC_Loc064_PhiVnce "Variance of Location elevation angle";
CM_ SG_ 432 RFC_Loc064_DrVrCoVnce "Covariance of Dr and Vr";
CM_ SG_ 432 RFC_Loc064_RCS "Radar Cross Section (RCS) estimation";
CM_ SG_ 432 RFC_Loc064_RSSI "Received Signal Strength Indication (RSSI)";
CM_ SG_ 432 RFC_Loc064_DrVrQuality "Quality of radial distance and velocity resolution processing. Physical range [0..1]";
CM_ SG_ 432 RFC_Loc064_ThetaQuality "Probability for correct signal model (azimuth angle). Physical range [0..1]";
CM_ SG_ 432 RFC_Loc064_PhiQuality "Probability for correct signal model (elevation angle). Physical range [0..1]";
CM_ SG_ 432 RFC_Loc065_Dr "Location radial distance";
CM_ SG_ 432 RFC_Loc065_Vr "Location radial relative velocity";
CM_ SG_ 432 RFC_Loc065_Theta "Location azimuth angle. \"Not a number\" TBD";
CM_ SG_ 432 RFC_Loc065_Phi "Location elevation angle. \"Not a number\" TBD";
CM_ SG_ 432 RFC_Loc065_DrVnce "Variance of Location radial distance";
CM_ SG_ 432 RFC_Loc065_VrVnce "Variance of Location radial relative velocity";
CM_ SG_ 432 RFC_Loc065_ThetaVnce "Variance of Location azimuth angle";
CM_ SG_ 432 RFC_Loc065_PhiVnce "Variance of Location elevation angle";
CM_ SG_ 432 RFC_Loc065_DrVrCoVnce "Covariance of Dr and Vr";
CM_ SG_ 432 RFC_Loc065_RCS "Radar Cross Section (RCS) estimation";
CM_ SG_ 432 RFC_Loc065_RSSI "Received Signal Strength Indication (RSSI)";
CM_ SG_ 432 RFC_Loc065_DrVrQuality "Quality of radial distance and velocity resolution processing. Physical range [0..1]";
CM_ SG_ 432 RFC_Loc065_ThetaQuality "Probability for correct signal model (azimuth angle). Physical range [0..1]";
CM_ SG_ 432 RFC_Loc065_PhiQuality "Probability for correct signal model (elevation angle). Physical range [0..1]";
CM_ SG_ 433 RFC_Loc066_CRC "CRC - Autosar E2E Profile 5, DataID = TBD";
CM_ SG_ 433 RFC_Loc066_AliveCtr "Alive counter - Autosar E2E Profile 5";
CM_ SG_ 433 RFC_Loc066_ProtBlockCtr "Protocol-Signal: Block-Counter";
CM_ SG_ 433 RFC_Loc066_Dr "Location radial distance";
CM_ SG_ 433 RFC_Loc066_Vr "Location radial relative velocity";
CM_ SG_ 433 RFC_Loc066_Theta "Location azimuth angle. \"Not a number\" TBD";
CM_ SG_ 433 RFC_Loc066_Phi "Location elevation angle. \"Not a number\" TBD";
CM_ SG_ 433 RFC_Loc066_DrVnce "Variance of Location radial distance";
CM_ SG_ 433 RFC_Loc066_VrVnce "Variance of Location radial relative velocity";
CM_ SG_ 433 RFC_Loc066_ThetaVnce "Variance of Location azimuth angle";
CM_ SG_ 433 RFC_Loc066_PhiVnce "Variance of Location elevation angle";
CM_ SG_ 433 RFC_Loc066_DrVrCoVnce "Covariance of Dr and Vr";
CM_ SG_ 433 RFC_Loc066_RCS "Radar Cross Section (RCS) estimation";
CM_ SG_ 433 RFC_Loc066_RSSI "Received Signal Strength Indication (RSSI)";
CM_ SG_ 433 RFC_Loc066_DrVrQuality "Quality of radial distance and velocity resolution processing. Physical range [0..1]";
CM_ SG_ 433 RFC_Loc066_ThetaQuality "Probability for correct signal model (azimuth angle). Physical range [0..1]";
CM_ SG_ 433 RFC_Loc066_PhiQuality "Probability for correct signal model (elevation angle). Physical range [0..1]";
CM_ SG_ 433 RFC_Loc067_Dr "Location radial distance";
CM_ SG_ 433 RFC_Loc067_Vr "Location radial relative velocity";
CM_ SG_ 433 RFC_Loc067_Theta "Location azimuth angle. \"Not a number\" TBD";
CM_ SG_ 433 RFC_Loc067_Phi "Location elevation angle. \"Not a number\" TBD";
CM_ SG_ 433 RFC_Loc067_DrVnce "Variance of Location radial distance";
CM_ SG_ 433 RFC_Loc067_VrVnce "Variance of Location radial relative velocity";
CM_ SG_ 433 RFC_Loc067_ThetaVnce "Variance of Location azimuth angle";
CM_ SG_ 433 RFC_Loc067_PhiVnce "Variance of Location elevation angle";
CM_ SG_ 433 RFC_Loc067_DrVrCoVnce "Covariance of Dr and Vr";
CM_ SG_ 433 RFC_Loc067_RCS "Radar Cross Section (RCS) estimation";
CM_ SG_ 433 RFC_Loc067_RSSI "Received Signal Strength Indication (RSSI)";
CM_ SG_ 433 RFC_Loc067_DrVrQuality "Quality of radial distance and velocity resolution processing. Physical range [0..1]";
CM_ SG_ 433 RFC_Loc067_ThetaQuality "Probability for correct signal model (azimuth angle). Physical range [0..1]";
CM_ SG_ 433 RFC_Loc067_PhiQuality "Probability for correct signal model (elevation angle). Physical range [0..1]";
CM_ SG_ 434 RFC_Loc068_CRC "CRC - Autosar E2E Profile 5, DataID = TBD";
CM_ SG_ 434 RFC_Loc068_AliveCtr "Alive counter - Autosar E2E Profile 5";
CM_ SG_ 434 RFC_Loc068_ProtBlockCtr "Protocol-Signal: Block-Counter";
CM_ SG_ 434 RFC_Loc068_Dr "Location radial distance";
CM_ SG_ 434 RFC_Loc068_Vr "Location radial relative velocity";
CM_ SG_ 434 RFC_Loc068_Theta "Location azimuth angle. \"Not a number\" TBD";
CM_ SG_ 434 RFC_Loc068_Phi "Location elevation angle. \"Not a number\" TBD";
CM_ SG_ 434 RFC_Loc068_DrVnce "Variance of Location radial distance";
CM_ SG_ 434 RFC_Loc068_VrVnce "Variance of Location radial relative velocity";
CM_ SG_ 434 RFC_Loc068_ThetaVnce "Variance of Location azimuth angle";
CM_ SG_ 434 RFC_Loc068_PhiVnce "Variance of Location elevation angle";
CM_ SG_ 434 RFC_Loc068_DrVrCoVnce "Covariance of Dr and Vr";
CM_ SG_ 434 RFC_Loc068_RCS "Radar Cross Section (RCS) estimation";
CM_ SG_ 434 RFC_Loc068_RSSI "Received Signal Strength Indication (RSSI)";
CM_ SG_ 434 RFC_Loc068_DrVrQuality "Quality of radial distance and velocity resolution processing. Physical range [0..1]";
CM_ SG_ 434 RFC_Loc068_ThetaQuality "Probability for correct signal model (azimuth angle). Physical range [0..1]";
CM_ SG_ 434 RFC_Loc068_PhiQuality "Probability for correct signal model (elevation angle). Physical range [0..1]";
CM_ SG_ 434 RFC_Loc069_Dr "Location radial distance";
CM_ SG_ 434 RFC_Loc069_Vr "Location radial relative velocity";
CM_ SG_ 434 RFC_Loc069_Theta "Location azimuth angle. \"Not a number\" TBD";
CM_ SG_ 434 RFC_Loc069_Phi "Location elevation angle. \"Not a number\" TBD";
CM_ SG_ 434 RFC_Loc069_DrVnce "Variance of Location radial distance";
CM_ SG_ 434 RFC_Loc069_VrVnce "Variance of Location radial relative velocity";
CM_ SG_ 434 RFC_Loc069_ThetaVnce "Variance of Location azimuth angle";
CM_ SG_ 434 RFC_Loc069_PhiVnce "Variance of Location elevation angle";
CM_ SG_ 434 RFC_Loc069_DrVrCoVnce "Covariance of Dr and Vr";
CM_ SG_ 434 RFC_Loc069_RCS "Radar Cross Section (RCS) estimation";
CM_ SG_ 434 RFC_Loc069_RSSI "Received Signal Strength Indication (RSSI)";
CM_ SG_ 434 RFC_Loc069_DrVrQuality "Quality of radial distance and velocity resolution processing. Physical range [0..1]";
CM_ SG_ 434 RFC_Loc069_ThetaQuality "Probability for correct signal model (azimuth angle). Physical range [0..1]";
CM_ SG_ 434 RFC_Loc069_PhiQuality "Probability for correct signal model (elevation angle). Physical range [0..1]";
BA_DEF_ BO_  "GenMsgSendType" ENUM  "cyclic","NoMsgSendType","IfActive","Event","CA","CE";
BA_DEF_ BO_  "GenMsgCycleTime" INT 0 0;
BA_DEF_ SG_  "GenSigSendType" ENUM  "cyclic","OnChange","OnWrite","IfActive","OnChangeWithRepetition","OnWriteWithRepetition","IfActiveWithRepetition","CA","CE","Event";
BA_DEF_ SG_  "GenSigStartValue" INT 0 0;
BA_DEF_ BO_  "CANFD_BRS" ENUM  "0","1";
BA_DEF_ BO_  "VFrameFormat" ENUM  "StandardCAN","ExtendedCAN","reserved","reserved","reserved","reserved","reserved","reserved","reserved","reserved","reserved","reserved","reserved","reserved","StandardCAN_FD","ExtendedCAN_FD";
BA_DEF_ BO_  "GenMsgILSupport" ENUM  "No","Yes";
BA_DEF_ SG_  "sigDespEng" STRING ;
BA_DEF_ SG_  "sigSecLevel" STRING ;
BA_DEF_ SG_  "sigConfig" STRING ;
BA_DEF_ SG_  "sigExplanation" STRING ;
BA_DEF_DEF_  "GenMsgSendType" "cyclic";
BA_DEF_DEF_  "GenMsgCycleTime" 0;
BA_DEF_DEF_  "GenSigSendType" "cyclic";
BA_DEF_DEF_  "GenSigStartValue" 0;
BA_DEF_DEF_  "CANFD_BRS" "1";
BA_DEF_DEF_  "VFrameFormat" "";
BA_DEF_DEF_  "GenMsgILSupport" "Yes";
BA_DEF_DEF_  "sigDespEng" "";
BA_DEF_DEF_  "sigSecLevel" "";
BA_DEF_DEF_  "sigConfig" "";
BA_DEF_DEF_  "sigExplanation" "";
BA_ "GenMsgSendType" BO_ 409 3;
BA_ "VFrameFormat" BO_ 409 14;
BA_ "GenMsgSendType" BO_ 410 3;
BA_ "VFrameFormat" BO_ 410 14;
BA_ "GenMsgSendType" BO_ 411 3;
BA_ "VFrameFormat" BO_ 411 14;
BA_ "GenMsgSendType" BO_ 412 3;
BA_ "VFrameFormat" BO_ 412 14;
BA_ "GenMsgSendType" BO_ 413 3;
BA_ "VFrameFormat" BO_ 413 14;
BA_ "GenMsgSendType" BO_ 414 3;
BA_ "VFrameFormat" BO_ 414 14;
BA_ "GenMsgSendType" BO_ 415 3;
BA_ "VFrameFormat" BO_ 415 14;
BA_ "GenMsgSendType" BO_ 416 3;
BA_ "VFrameFormat" BO_ 416 14;
BA_ "GenMsgSendType" BO_ 417 3;
BA_ "VFrameFormat" BO_ 417 14;
BA_ "GenMsgSendType" BO_ 418 3;
BA_ "VFrameFormat" BO_ 418 14;
BA_ "GenMsgSendType" BO_ 419 3;
BA_ "VFrameFormat" BO_ 419 14;
BA_ "GenMsgSendType" BO_ 420 3;
BA_ "VFrameFormat" BO_ 420 14;
BA_ "GenMsgSendType" BO_ 421 3;
BA_ "VFrameFormat" BO_ 421 14;
BA_ "GenMsgSendType" BO_ 422 3;
BA_ "VFrameFormat" BO_ 422 14;
BA_ "GenMsgSendType" BO_ 423 3;
BA_ "VFrameFormat" BO_ 423 14;
BA_ "GenMsgSendType" BO_ 424 3;
BA_ "VFrameFormat" BO_ 424 14;
BA_ "GenMsgSendType" BO_ 425 3;
BA_ "VFrameFormat" BO_ 425 14;
BA_ "GenMsgSendType" BO_ 426 3;
BA_ "VFrameFormat" BO_ 426 14;
BA_ "GenMsgSendType" BO_ 427 3;
BA_ "VFrameFormat" BO_ 427 14;
BA_ "GenMsgSendType" BO_ 428 3;
BA_ "VFrameFormat" BO_ 428 14;
BA_ "GenMsgSendType" BO_ 429 3;
BA_ "VFrameFormat" BO_ 429 14;
BA_ "GenMsgSendType" BO_ 430 3;
BA_ "VFrameFormat" BO_ 430 14;
BA_ "GenMsgSendType" BO_ 431 3;
BA_ "VFrameFormat" BO_ 431 14;
BA_ "GenMsgSendType" BO_ 432 3;
BA_ "VFrameFormat" BO_ 432 14;
BA_ "GenMsgSendType" BO_ 433 3;
BA_ "VFrameFormat" BO_ 433 14;
BA_ "GenMsgSendType" BO_ 434 3;
BA_ "VFrameFormat" BO_ 434 14;
BA_ "GenSigSendType" SG_ 409 RFC_Loc018_CRC 9;
BA_ "GenSigSendType" SG_ 409 RFC_Loc018_AliveCtr 9;
BA_ "GenSigSendType" SG_ 409 RFC_Loc018_ProtBlockCtr 9;
BA_ "GenSigSendType" SG_ 409 RFC_Loc018_Dr 9;
BA_ "GenSigSendType" SG_ 409 RFC_Loc018_Vr 9;
BA_ "GenSigStartValue" SG_ 409 RFC_Loc018_Vr 32768;
BA_ "GenSigSendType" SG_ 409 RFC_Loc018_Theta 9;
BA_ "GenSigStartValue" SG_ 409 RFC_Loc018_Theta 32768;
BA_ "GenSigSendType" SG_ 409 RFC_Loc018_Phi 9;
BA_ "GenSigStartValue" SG_ 409 RFC_Loc018_Phi 32768;
BA_ "GenSigSendType" SG_ 409 RFC_Loc018_DrVnce 9;
BA_ "GenSigSendType" SG_ 409 RFC_Loc018_VrVnce 9;
BA_ "GenSigSendType" SG_ 409 RFC_Loc018_ThetaVnce 9;
BA_ "GenSigSendType" SG_ 409 RFC_Loc018_PhiVnce 9;
BA_ "GenSigSendType" SG_ 409 RFC_Loc018_DrVrCoVnce 9;
BA_ "GenSigStartValue" SG_ 409 RFC_Loc018_DrVrCoVnce 32768;
BA_ "GenSigSendType" SG_ 409 RFC_Loc018_RCS 9;
BA_ "GenSigStartValue" SG_ 409 RFC_Loc018_RCS 32768;
BA_ "GenSigSendType" SG_ 409 RFC_Loc018_RSSI 9;
BA_ "GenSigSendType" SG_ 409 RFC_Loc018_DrVrQuality 9;
BA_ "GenSigSendType" SG_ 409 RFC_Loc018_ThetaQuality 9;
BA_ "GenSigSendType" SG_ 409 RFC_Loc018_PhiQuality 9;
BA_ "GenSigSendType" SG_ 409 RFC_Loc019_Dr 9;
BA_ "GenSigSendType" SG_ 409 RFC_Loc019_Vr 9;
BA_ "GenSigStartValue" SG_ 409 RFC_Loc019_Vr 32768;
BA_ "GenSigSendType" SG_ 409 RFC_Loc019_Theta 9;
BA_ "GenSigStartValue" SG_ 409 RFC_Loc019_Theta 32768;
BA_ "GenSigSendType" SG_ 409 RFC_Loc019_Phi 9;
BA_ "GenSigStartValue" SG_ 409 RFC_Loc019_Phi 32768;
BA_ "GenSigSendType" SG_ 409 RFC_Loc019_DrVnce 9;
BA_ "GenSigSendType" SG_ 409 RFC_Loc019_VrVnce 9;
BA_ "GenSigSendType" SG_ 409 RFC_Loc019_ThetaVnce 9;
BA_ "GenSigSendType" SG_ 409 RFC_Loc019_PhiVnce 9;
BA_ "GenSigSendType" SG_ 409 RFC_Loc019_DrVrCoVnce 9;
BA_ "GenSigStartValue" SG_ 409 RFC_Loc019_DrVrCoVnce 32768;
BA_ "GenSigSendType" SG_ 409 RFC_Loc019_RCS 9;
BA_ "GenSigStartValue" SG_ 409 RFC_Loc019_RCS 32768;
BA_ "GenSigSendType" SG_ 409 RFC_Loc019_RSSI 9;
BA_ "GenSigSendType" SG_ 409 RFC_Loc019_DrVrQuality 9;
BA_ "GenSigSendType" SG_ 409 RFC_Loc019_ThetaQuality 9;
BA_ "GenSigSendType" SG_ 409 RFC_Loc019_PhiQuality 9;
BA_ "GenSigSendType" SG_ 410 RFC_Loc020_CRC 9;
BA_ "GenSigSendType" SG_ 410 RFC_Loc020_AliveCtr 9;
BA_ "GenSigSendType" SG_ 410 RFC_Loc020_ProtBlockCtr 9;
BA_ "GenSigSendType" SG_ 410 RFC_Loc020_Dr 9;
BA_ "GenSigSendType" SG_ 410 RFC_Loc020_Vr 9;
BA_ "GenSigStartValue" SG_ 410 RFC_Loc020_Vr 32768;
BA_ "GenSigSendType" SG_ 410 RFC_Loc020_Theta 9;
BA_ "GenSigStartValue" SG_ 410 RFC_Loc020_Theta 32768;
BA_ "GenSigSendType" SG_ 410 RFC_Loc020_Phi 9;
BA_ "GenSigStartValue" SG_ 410 RFC_Loc020_Phi 32768;
BA_ "GenSigSendType" SG_ 410 RFC_Loc020_DrVnce 9;
BA_ "GenSigSendType" SG_ 410 RFC_Loc020_VrVnce 9;
BA_ "GenSigSendType" SG_ 410 RFC_Loc020_ThetaVnce 9;
BA_ "GenSigSendType" SG_ 410 RFC_Loc020_PhiVnce 9;
BA_ "GenSigSendType" SG_ 410 RFC_Loc020_DrVrCoVnce 9;
BA_ "GenSigStartValue" SG_ 410 RFC_Loc020_DrVrCoVnce 32768;
BA_ "GenSigSendType" SG_ 410 RFC_Loc020_RCS 9;
BA_ "GenSigStartValue" SG_ 410 RFC_Loc020_RCS 32768;
BA_ "GenSigSendType" SG_ 410 RFC_Loc020_RSSI 9;
BA_ "GenSigSendType" SG_ 410 RFC_Loc020_DrVrQuality 9;
BA_ "GenSigSendType" SG_ 410 RFC_Loc020_ThetaQuality 9;
BA_ "GenSigSendType" SG_ 410 RFC_Loc020_PhiQuality 9;
BA_ "GenSigSendType" SG_ 410 RFC_Loc021_Dr 9;
BA_ "GenSigSendType" SG_ 410 RFC_Loc021_Vr 9;
BA_ "GenSigStartValue" SG_ 410 RFC_Loc021_Vr 32768;
BA_ "GenSigSendType" SG_ 410 RFC_Loc021_Theta 9;
BA_ "GenSigStartValue" SG_ 410 RFC_Loc021_Theta 32768;
BA_ "GenSigSendType" SG_ 410 RFC_Loc021_Phi 9;
BA_ "GenSigStartValue" SG_ 410 RFC_Loc021_Phi 32768;
BA_ "GenSigSendType" SG_ 410 RFC_Loc021_DrVnce 9;
BA_ "GenSigSendType" SG_ 410 RFC_Loc021_VrVnce 9;
BA_ "GenSigSendType" SG_ 410 RFC_Loc021_ThetaVnce 9;
BA_ "GenSigSendType" SG_ 410 RFC_Loc021_PhiVnce 9;
BA_ "GenSigSendType" SG_ 410 RFC_Loc021_DrVrCoVnce 9;
BA_ "GenSigStartValue" SG_ 410 RFC_Loc021_DrVrCoVnce 32768;
BA_ "GenSigSendType" SG_ 410 RFC_Loc021_RCS 9;
BA_ "GenSigStartValue" SG_ 410 RFC_Loc021_RCS 32768;
BA_ "GenSigSendType" SG_ 410 RFC_Loc021_RSSI 9;
BA_ "GenSigSendType" SG_ 410 RFC_Loc021_DrVrQuality 9;
BA_ "GenSigSendType" SG_ 410 RFC_Loc021_ThetaQuality 9;
BA_ "GenSigSendType" SG_ 410 RFC_Loc021_PhiQuality 9;
BA_ "GenSigSendType" SG_ 411 RFC_Loc022_CRC 9;
BA_ "GenSigSendType" SG_ 411 RFC_Loc022_AliveCtr 9;
BA_ "GenSigSendType" SG_ 411 RFC_Loc022_ProtBlockCtr 9;
BA_ "GenSigSendType" SG_ 411 RFC_Loc022_Dr 9;
BA_ "GenSigSendType" SG_ 411 RFC_Loc022_Vr 9;
BA_ "GenSigStartValue" SG_ 411 RFC_Loc022_Vr 32768;
BA_ "GenSigSendType" SG_ 411 RFC_Loc022_Theta 9;
BA_ "GenSigStartValue" SG_ 411 RFC_Loc022_Theta 32768;
BA_ "GenSigSendType" SG_ 411 RFC_Loc022_Phi 9;
BA_ "GenSigStartValue" SG_ 411 RFC_Loc022_Phi 32768;
BA_ "GenSigSendType" SG_ 411 RFC_Loc022_DrVnce 9;
BA_ "GenSigSendType" SG_ 411 RFC_Loc022_VrVnce 9;
BA_ "GenSigSendType" SG_ 411 RFC_Loc022_ThetaVnce 9;
BA_ "GenSigSendType" SG_ 411 RFC_Loc022_PhiVnce 9;
BA_ "GenSigSendType" SG_ 411 RFC_Loc022_DrVrCoVnce 9;
BA_ "GenSigStartValue" SG_ 411 RFC_Loc022_DrVrCoVnce 32768;
BA_ "GenSigSendType" SG_ 411 RFC_Loc022_RCS 9;
BA_ "GenSigStartValue" SG_ 411 RFC_Loc022_RCS 32768;
BA_ "GenSigSendType" SG_ 411 RFC_Loc022_RSSI 9;
BA_ "GenSigSendType" SG_ 411 RFC_Loc022_DrVrQuality 9;
BA_ "GenSigSendType" SG_ 411 RFC_Loc022_ThetaQuality 9;
BA_ "GenSigSendType" SG_ 411 RFC_Loc022_PhiQuality 9;
BA_ "GenSigSendType" SG_ 411 RFC_Loc023_Dr 9;
BA_ "GenSigSendType" SG_ 411 RFC_Loc023_Vr 9;
BA_ "GenSigStartValue" SG_ 411 RFC_Loc023_Vr 32768;
BA_ "GenSigSendType" SG_ 411 RFC_Loc023_Theta 9;
BA_ "GenSigStartValue" SG_ 411 RFC_Loc023_Theta 32768;
BA_ "GenSigSendType" SG_ 411 RFC_Loc023_Phi 9;
BA_ "GenSigStartValue" SG_ 411 RFC_Loc023_Phi 32768;
BA_ "GenSigSendType" SG_ 411 RFC_Loc023_DrVnce 9;
BA_ "GenSigSendType" SG_ 411 RFC_Loc023_VrVnce 9;
BA_ "GenSigSendType" SG_ 411 RFC_Loc023_ThetaVnce 9;
BA_ "GenSigSendType" SG_ 411 RFC_Loc023_PhiVnce 9;
BA_ "GenSigSendType" SG_ 411 RFC_Loc023_DrVrCoVnce 9;
BA_ "GenSigStartValue" SG_ 411 RFC_Loc023_DrVrCoVnce 32768;
BA_ "GenSigSendType" SG_ 411 RFC_Loc023_RCS 9;
BA_ "GenSigStartValue" SG_ 411 RFC_Loc023_RCS 32768;
BA_ "GenSigSendType" SG_ 411 RFC_Loc023_RSSI 9;
BA_ "GenSigSendType" SG_ 411 RFC_Loc023_DrVrQuality 9;
BA_ "GenSigSendType" SG_ 411 RFC_Loc023_ThetaQuality 9;
BA_ "GenSigSendType" SG_ 411 RFC_Loc023_PhiQuality 9;
BA_ "GenSigSendType" SG_ 412 RFC_Loc024_CRC 9;
BA_ "GenSigSendType" SG_ 412 RFC_Loc024_AliveCtr 9;
BA_ "GenSigSendType" SG_ 412 RFC_Loc024_ProtBlockCtr 9;
BA_ "GenSigSendType" SG_ 412 RFC_Loc024_Dr 9;
BA_ "GenSigSendType" SG_ 412 RFC_Loc024_Vr 9;
BA_ "GenSigStartValue" SG_ 412 RFC_Loc024_Vr 32768;
BA_ "GenSigSendType" SG_ 412 RFC_Loc024_Theta 9;
BA_ "GenSigStartValue" SG_ 412 RFC_Loc024_Theta 32768;
BA_ "GenSigSendType" SG_ 412 RFC_Loc024_Phi 9;
BA_ "GenSigStartValue" SG_ 412 RFC_Loc024_Phi 32768;
BA_ "GenSigSendType" SG_ 412 RFC_Loc024_DrVnce 9;
BA_ "GenSigSendType" SG_ 412 RFC_Loc024_VrVnce 9;
BA_ "GenSigSendType" SG_ 412 RFC_Loc024_ThetaVnce 9;
BA_ "GenSigSendType" SG_ 412 RFC_Loc024_PhiVnce 9;
BA_ "GenSigSendType" SG_ 412 RFC_Loc024_DrVrCoVnce 9;
BA_ "GenSigStartValue" SG_ 412 RFC_Loc024_DrVrCoVnce 32768;
BA_ "GenSigSendType" SG_ 412 RFC_Loc024_RCS 9;
BA_ "GenSigStartValue" SG_ 412 RFC_Loc024_RCS 32768;
BA_ "GenSigSendType" SG_ 412 RFC_Loc024_RSSI 9;
BA_ "GenSigSendType" SG_ 412 RFC_Loc024_DrVrQuality 9;
BA_ "GenSigSendType" SG_ 412 RFC_Loc024_ThetaQuality 9;
BA_ "GenSigSendType" SG_ 412 RFC_Loc024_PhiQuality 9;
BA_ "GenSigSendType" SG_ 412 RFC_Loc025_Dr 9;
BA_ "GenSigSendType" SG_ 412 RFC_Loc025_Vr 9;
BA_ "GenSigStartValue" SG_ 412 RFC_Loc025_Vr 32768;
BA_ "GenSigSendType" SG_ 412 RFC_Loc025_Theta 9;
BA_ "GenSigStartValue" SG_ 412 RFC_Loc025_Theta 32768;
BA_ "GenSigSendType" SG_ 412 RFC_Loc025_Phi 9;
BA_ "GenSigStartValue" SG_ 412 RFC_Loc025_Phi 32768;
BA_ "GenSigSendType" SG_ 412 RFC_Loc025_DrVnce 9;
BA_ "GenSigSendType" SG_ 412 RFC_Loc025_VrVnce 9;
BA_ "GenSigSendType" SG_ 412 RFC_Loc025_ThetaVnce 9;
BA_ "GenSigSendType" SG_ 412 RFC_Loc025_PhiVnce 9;
BA_ "GenSigSendType" SG_ 412 RFC_Loc025_DrVrCoVnce 9;
BA_ "GenSigStartValue" SG_ 412 RFC_Loc025_DrVrCoVnce 32768;
BA_ "GenSigSendType" SG_ 412 RFC_Loc025_RCS 9;
BA_ "GenSigStartValue" SG_ 412 RFC_Loc025_RCS 32768;
BA_ "GenSigSendType" SG_ 412 RFC_Loc025_RSSI 9;
BA_ "GenSigSendType" SG_ 412 RFC_Loc025_DrVrQuality 9;
BA_ "GenSigSendType" SG_ 412 RFC_Loc025_ThetaQuality 9;
BA_ "GenSigSendType" SG_ 412 RFC_Loc025_PhiQuality 9;
BA_ "GenSigSendType" SG_ 413 RFC_Loc026_CRC 9;
BA_ "GenSigSendType" SG_ 413 RFC_Loc026_AliveCtr 9;
BA_ "GenSigSendType" SG_ 413 RFC_Loc026_ProtBlockCtr 9;
BA_ "GenSigSendType" SG_ 413 RFC_Loc026_Dr 9;
BA_ "GenSigSendType" SG_ 413 RFC_Loc026_Vr 9;
BA_ "GenSigStartValue" SG_ 413 RFC_Loc026_Vr 32768;
BA_ "GenSigSendType" SG_ 413 RFC_Loc026_Theta 9;
BA_ "GenSigStartValue" SG_ 413 RFC_Loc026_Theta 32768;
BA_ "GenSigSendType" SG_ 413 RFC_Loc026_Phi 9;
BA_ "GenSigStartValue" SG_ 413 RFC_Loc026_Phi 32768;
BA_ "GenSigSendType" SG_ 413 RFC_Loc026_DrVnce 9;
BA_ "GenSigSendType" SG_ 413 RFC_Loc026_VrVnce 9;
BA_ "GenSigSendType" SG_ 413 RFC_Loc026_ThetaVnce 9;
BA_ "GenSigSendType" SG_ 413 RFC_Loc026_PhiVnce 9;
BA_ "GenSigSendType" SG_ 413 RFC_Loc026_DrVrCoVnce 9;
BA_ "GenSigStartValue" SG_ 413 RFC_Loc026_DrVrCoVnce 32768;
BA_ "GenSigSendType" SG_ 413 RFC_Loc026_RCS 9;
BA_ "GenSigStartValue" SG_ 413 RFC_Loc026_RCS 32768;
BA_ "GenSigSendType" SG_ 413 RFC_Loc026_RSSI 9;
BA_ "GenSigSendType" SG_ 413 RFC_Loc026_DrVrQuality 9;
BA_ "GenSigSendType" SG_ 413 RFC_Loc026_ThetaQuality 9;
BA_ "GenSigSendType" SG_ 413 RFC_Loc026_PhiQuality 9;
BA_ "GenSigSendType" SG_ 413 RFC_Loc027_Dr 9;
BA_ "GenSigSendType" SG_ 413 RFC_Loc027_Vr 9;
BA_ "GenSigStartValue" SG_ 413 RFC_Loc027_Vr 32768;
BA_ "GenSigSendType" SG_ 413 RFC_Loc027_Theta 9;
BA_ "GenSigStartValue" SG_ 413 RFC_Loc027_Theta 32768;
BA_ "GenSigSendType" SG_ 413 RFC_Loc027_Phi 9;
BA_ "GenSigStartValue" SG_ 413 RFC_Loc027_Phi 32768;
BA_ "GenSigSendType" SG_ 413 RFC_Loc027_DrVnce 9;
BA_ "GenSigSendType" SG_ 413 RFC_Loc027_VrVnce 9;
BA_ "GenSigSendType" SG_ 413 RFC_Loc027_ThetaVnce 9;
BA_ "GenSigSendType" SG_ 413 RFC_Loc027_PhiVnce 9;
BA_ "GenSigSendType" SG_ 413 RFC_Loc027_DrVrCoVnce 9;
BA_ "GenSigStartValue" SG_ 413 RFC_Loc027_DrVrCoVnce 32768;
BA_ "GenSigSendType" SG_ 413 RFC_Loc027_RCS 9;
BA_ "GenSigStartValue" SG_ 413 RFC_Loc027_RCS 32768;
BA_ "GenSigSendType" SG_ 413 RFC_Loc027_RSSI 9;
BA_ "GenSigSendType" SG_ 413 RFC_Loc027_DrVrQuality 9;
BA_ "GenSigSendType" SG_ 413 RFC_Loc027_ThetaQuality 9;
BA_ "GenSigSendType" SG_ 413 RFC_Loc027_PhiQuality 9;
BA_ "GenSigSendType" SG_ 414 RFC_Loc028_CRC 9;
BA_ "GenSigSendType" SG_ 414 RFC_Loc028_AliveCtr 9;
BA_ "GenSigSendType" SG_ 414 RFC_Loc028_ProtBlockCtr 9;
BA_ "GenSigSendType" SG_ 414 RFC_Loc028_Dr 9;
BA_ "GenSigSendType" SG_ 414 RFC_Loc028_Vr 9;
BA_ "GenSigStartValue" SG_ 414 RFC_Loc028_Vr 32768;
BA_ "GenSigSendType" SG_ 414 RFC_Loc028_Theta 9;
BA_ "GenSigStartValue" SG_ 414 RFC_Loc028_Theta 32768;
BA_ "GenSigSendType" SG_ 414 RFC_Loc028_Phi 9;
BA_ "GenSigStartValue" SG_ 414 RFC_Loc028_Phi 32768;
BA_ "GenSigSendType" SG_ 414 RFC_Loc028_DrVnce 9;
BA_ "GenSigSendType" SG_ 414 RFC_Loc028_VrVnce 9;
BA_ "GenSigSendType" SG_ 414 RFC_Loc028_ThetaVnce 9;
BA_ "GenSigSendType" SG_ 414 RFC_Loc028_PhiVnce 9;
BA_ "GenSigSendType" SG_ 414 RFC_Loc028_DrVrCoVnce 9;
BA_ "GenSigStartValue" SG_ 414 RFC_Loc028_DrVrCoVnce 32768;
BA_ "GenSigSendType" SG_ 414 RFC_Loc028_RCS 9;
BA_ "GenSigStartValue" SG_ 414 RFC_Loc028_RCS 32768;
BA_ "GenSigSendType" SG_ 414 RFC_Loc028_RSSI 9;
BA_ "GenSigSendType" SG_ 414 RFC_Loc028_DrVrQuality 9;
BA_ "GenSigSendType" SG_ 414 RFC_Loc028_ThetaQuality 9;
BA_ "GenSigSendType" SG_ 414 RFC_Loc028_PhiQuality 9;
BA_ "GenSigSendType" SG_ 414 RFC_Loc029_Dr 9;
BA_ "GenSigSendType" SG_ 414 RFC_Loc029_Vr 9;
BA_ "GenSigStartValue" SG_ 414 RFC_Loc029_Vr 32768;
BA_ "GenSigSendType" SG_ 414 RFC_Loc029_Theta 9;
BA_ "GenSigStartValue" SG_ 414 RFC_Loc029_Theta 32768;
BA_ "GenSigSendType" SG_ 414 RFC_Loc029_Phi 9;
BA_ "GenSigStartValue" SG_ 414 RFC_Loc029_Phi 32768;
BA_ "GenSigSendType" SG_ 414 RFC_Loc029_DrVnce 9;
BA_ "GenSigSendType" SG_ 414 RFC_Loc029_VrVnce 9;
BA_ "GenSigSendType" SG_ 414 RFC_Loc029_ThetaVnce 9;
BA_ "GenSigSendType" SG_ 414 RFC_Loc029_PhiVnce 9;
BA_ "GenSigSendType" SG_ 414 RFC_Loc029_DrVrCoVnce 9;
BA_ "GenSigStartValue" SG_ 414 RFC_Loc029_DrVrCoVnce 32768;
BA_ "GenSigSendType" SG_ 414 RFC_Loc029_RCS 9;
BA_ "GenSigStartValue" SG_ 414 RFC_Loc029_RCS 32768;
BA_ "GenSigSendType" SG_ 414 RFC_Loc029_RSSI 9;
BA_ "GenSigSendType" SG_ 414 RFC_Loc029_DrVrQuality 9;
BA_ "GenSigSendType" SG_ 414 RFC_Loc029_ThetaQuality 9;
BA_ "GenSigSendType" SG_ 414 RFC_Loc029_PhiQuality 9;
BA_ "GenSigSendType" SG_ 415 RFC_Loc030_CRC 9;
BA_ "GenSigSendType" SG_ 415 RFC_Loc030_AliveCtr 9;
BA_ "GenSigSendType" SG_ 415 RFC_Loc030_ProtBlockCtr 9;
BA_ "GenSigSendType" SG_ 415 RFC_Loc030_Dr 9;
BA_ "GenSigSendType" SG_ 415 RFC_Loc030_Vr 9;
BA_ "GenSigStartValue" SG_ 415 RFC_Loc030_Vr 32768;
BA_ "GenSigSendType" SG_ 415 RFC_Loc030_Theta 9;
BA_ "GenSigStartValue" SG_ 415 RFC_Loc030_Theta 32768;
BA_ "GenSigSendType" SG_ 415 RFC_Loc030_Phi 9;
BA_ "GenSigStartValue" SG_ 415 RFC_Loc030_Phi 32768;
BA_ "GenSigSendType" SG_ 415 RFC_Loc030_DrVnce 9;
BA_ "GenSigSendType" SG_ 415 RFC_Loc030_VrVnce 9;
BA_ "GenSigSendType" SG_ 415 RFC_Loc030_ThetaVnce 9;
BA_ "GenSigSendType" SG_ 415 RFC_Loc030_PhiVnce 9;
BA_ "GenSigSendType" SG_ 415 RFC_Loc030_DrVrCoVnce 9;
BA_ "GenSigStartValue" SG_ 415 RFC_Loc030_DrVrCoVnce 32768;
BA_ "GenSigSendType" SG_ 415 RFC_Loc030_RCS 9;
BA_ "GenSigStartValue" SG_ 415 RFC_Loc030_RCS 32768;
BA_ "GenSigSendType" SG_ 415 RFC_Loc030_RSSI 9;
BA_ "GenSigSendType" SG_ 415 RFC_Loc030_DrVrQuality 9;
BA_ "GenSigSendType" SG_ 415 RFC_Loc030_ThetaQuality 9;
BA_ "GenSigSendType" SG_ 415 RFC_Loc030_PhiQuality 9;
BA_ "GenSigSendType" SG_ 415 RFC_Loc031_Dr 9;
BA_ "GenSigSendType" SG_ 415 RFC_Loc031_Vr 9;
BA_ "GenSigStartValue" SG_ 415 RFC_Loc031_Vr 32768;
BA_ "GenSigSendType" SG_ 415 RFC_Loc031_Theta 9;
BA_ "GenSigStartValue" SG_ 415 RFC_Loc031_Theta 32768;
BA_ "GenSigSendType" SG_ 415 RFC_Loc031_Phi 9;
BA_ "GenSigStartValue" SG_ 415 RFC_Loc031_Phi 32768;
BA_ "GenSigSendType" SG_ 415 RFC_Loc031_DrVnce 9;
BA_ "GenSigSendType" SG_ 415 RFC_Loc031_VrVnce 9;
BA_ "GenSigSendType" SG_ 415 RFC_Loc031_ThetaVnce 9;
BA_ "GenSigSendType" SG_ 415 RFC_Loc031_PhiVnce 9;
BA_ "GenSigSendType" SG_ 415 RFC_Loc031_DrVrCoVnce 9;
BA_ "GenSigStartValue" SG_ 415 RFC_Loc031_DrVrCoVnce 32768;
BA_ "GenSigSendType" SG_ 415 RFC_Loc031_RCS 9;
BA_ "GenSigStartValue" SG_ 415 RFC_Loc031_RCS 32768;
BA_ "GenSigSendType" SG_ 415 RFC_Loc031_RSSI 9;
BA_ "GenSigSendType" SG_ 415 RFC_Loc031_DrVrQuality 9;
BA_ "GenSigSendType" SG_ 415 RFC_Loc031_ThetaQuality 9;
BA_ "GenSigSendType" SG_ 415 RFC_Loc031_PhiQuality 9;
BA_ "GenSigSendType" SG_ 416 RFC_Loc032_CRC 9;
BA_ "GenSigSendType" SG_ 416 RFC_Loc032_AliveCtr 9;
BA_ "GenSigSendType" SG_ 416 RFC_Loc032_ProtBlockCtr 9;
BA_ "GenSigSendType" SG_ 416 RFC_Loc032_Dr 9;
BA_ "GenSigSendType" SG_ 416 RFC_Loc032_Vr 9;
BA_ "GenSigStartValue" SG_ 416 RFC_Loc032_Vr 32768;
BA_ "GenSigSendType" SG_ 416 RFC_Loc032_Theta 9;
BA_ "GenSigStartValue" SG_ 416 RFC_Loc032_Theta 32768;
BA_ "GenSigSendType" SG_ 416 RFC_Loc032_Phi 9;
BA_ "GenSigStartValue" SG_ 416 RFC_Loc032_Phi 32768;
BA_ "GenSigSendType" SG_ 416 RFC_Loc032_DrVnce 9;
BA_ "GenSigSendType" SG_ 416 RFC_Loc032_VrVnce 9;
BA_ "GenSigSendType" SG_ 416 RFC_Loc032_ThetaVnce 9;
BA_ "GenSigSendType" SG_ 416 RFC_Loc032_PhiVnce 9;
BA_ "GenSigSendType" SG_ 416 RFC_Loc032_DrVrCoVnce 9;
BA_ "GenSigStartValue" SG_ 416 RFC_Loc032_DrVrCoVnce 32768;
BA_ "GenSigSendType" SG_ 416 RFC_Loc032_RCS 9;
BA_ "GenSigStartValue" SG_ 416 RFC_Loc032_RCS 32768;
BA_ "GenSigSendType" SG_ 416 RFC_Loc032_RSSI 9;
BA_ "GenSigSendType" SG_ 416 RFC_Loc032_DrVrQuality 9;
BA_ "GenSigSendType" SG_ 416 RFC_Loc032_ThetaQuality 9;
BA_ "GenSigSendType" SG_ 416 RFC_Loc032_PhiQuality 9;
BA_ "GenSigSendType" SG_ 416 RFC_Loc033_Dr 9;
BA_ "GenSigSendType" SG_ 416 RFC_Loc033_Vr 9;
BA_ "GenSigStartValue" SG_ 416 RFC_Loc033_Vr 32768;
BA_ "GenSigSendType" SG_ 416 RFC_Loc033_Theta 9;
BA_ "GenSigStartValue" SG_ 416 RFC_Loc033_Theta 32768;
BA_ "GenSigSendType" SG_ 416 RFC_Loc033_Phi 9;
BA_ "GenSigStartValue" SG_ 416 RFC_Loc033_Phi 32768;
BA_ "GenSigSendType" SG_ 416 RFC_Loc033_DrVnce 9;
BA_ "GenSigSendType" SG_ 416 RFC_Loc033_VrVnce 9;
BA_ "GenSigSendType" SG_ 416 RFC_Loc033_ThetaVnce 9;
BA_ "GenSigSendType" SG_ 416 RFC_Loc033_PhiVnce 9;
BA_ "GenSigSendType" SG_ 416 RFC_Loc033_DrVrCoVnce 9;
BA_ "GenSigStartValue" SG_ 416 RFC_Loc033_DrVrCoVnce 32768;
BA_ "GenSigSendType" SG_ 416 RFC_Loc033_RCS 9;
BA_ "GenSigStartValue" SG_ 416 RFC_Loc033_RCS 32768;
BA_ "GenSigSendType" SG_ 416 RFC_Loc033_RSSI 9;
BA_ "GenSigSendType" SG_ 416 RFC_Loc033_DrVrQuality 9;
BA_ "GenSigSendType" SG_ 416 RFC_Loc033_ThetaQuality 9;
BA_ "GenSigSendType" SG_ 416 RFC_Loc033_PhiQuality 9;
BA_ "GenSigSendType" SG_ 417 RFC_Loc034_CRC 9;
BA_ "GenSigSendType" SG_ 417 RFC_Loc034_AliveCtr 9;
BA_ "GenSigSendType" SG_ 417 RFC_Loc034_ProtBlockCtr 9;
BA_ "GenSigSendType" SG_ 417 RFC_Loc034_Dr 9;
BA_ "GenSigSendType" SG_ 417 RFC_Loc034_Vr 9;
BA_ "GenSigStartValue" SG_ 417 RFC_Loc034_Vr 32768;
BA_ "GenSigSendType" SG_ 417 RFC_Loc034_Theta 9;
BA_ "GenSigStartValue" SG_ 417 RFC_Loc034_Theta 32768;
BA_ "GenSigSendType" SG_ 417 RFC_Loc034_Phi 9;
BA_ "GenSigStartValue" SG_ 417 RFC_Loc034_Phi 32768;
BA_ "GenSigSendType" SG_ 417 RFC_Loc034_DrVnce 9;
BA_ "GenSigSendType" SG_ 417 RFC_Loc034_VrVnce 9;
BA_ "GenSigSendType" SG_ 417 RFC_Loc034_ThetaVnce 9;
BA_ "GenSigSendType" SG_ 417 RFC_Loc034_PhiVnce 9;
BA_ "GenSigSendType" SG_ 417 RFC_Loc034_DrVrCoVnce 9;
BA_ "GenSigStartValue" SG_ 417 RFC_Loc034_DrVrCoVnce 32768;
BA_ "GenSigSendType" SG_ 417 RFC_Loc034_RCS 9;
BA_ "GenSigStartValue" SG_ 417 RFC_Loc034_RCS 32768;
BA_ "GenSigSendType" SG_ 417 RFC_Loc034_RSSI 9;
BA_ "GenSigSendType" SG_ 417 RFC_Loc034_DrVrQuality 9;
BA_ "GenSigSendType" SG_ 417 RFC_Loc034_ThetaQuality 9;
BA_ "GenSigSendType" SG_ 417 RFC_Loc034_PhiQuality 9;
BA_ "GenSigSendType" SG_ 417 RFC_Loc035_Dr 9;
BA_ "GenSigSendType" SG_ 417 RFC_Loc035_Vr 9;
BA_ "GenSigStartValue" SG_ 417 RFC_Loc035_Vr 32768;
BA_ "GenSigSendType" SG_ 417 RFC_Loc035_Theta 9;
BA_ "GenSigStartValue" SG_ 417 RFC_Loc035_Theta 32768;
BA_ "GenSigSendType" SG_ 417 RFC_Loc035_Phi 9;
BA_ "GenSigStartValue" SG_ 417 RFC_Loc035_Phi 32768;
BA_ "GenSigSendType" SG_ 417 RFC_Loc035_DrVnce 9;
BA_ "GenSigSendType" SG_ 417 RFC_Loc035_VrVnce 9;
BA_ "GenSigSendType" SG_ 417 RFC_Loc035_ThetaVnce 9;
BA_ "GenSigSendType" SG_ 417 RFC_Loc035_PhiVnce 9;
BA_ "GenSigSendType" SG_ 417 RFC_Loc035_DrVrCoVnce 9;
BA_ "GenSigStartValue" SG_ 417 RFC_Loc035_DrVrCoVnce 32768;
BA_ "GenSigSendType" SG_ 417 RFC_Loc035_RCS 9;
BA_ "GenSigStartValue" SG_ 417 RFC_Loc035_RCS 32768;
BA_ "GenSigSendType" SG_ 417 RFC_Loc035_RSSI 9;
BA_ "GenSigSendType" SG_ 417 RFC_Loc035_DrVrQuality 9;
BA_ "GenSigSendType" SG_ 417 RFC_Loc035_ThetaQuality 9;
BA_ "GenSigSendType" SG_ 417 RFC_Loc035_PhiQuality 9;
BA_ "GenSigSendType" SG_ 418 RFC_Loc036_CRC 9;
BA_ "GenSigSendType" SG_ 418 RFC_Loc036_AliveCtr 9;
BA_ "GenSigSendType" SG_ 418 RFC_Loc036_ProtBlockCtr 9;
BA_ "GenSigSendType" SG_ 418 RFC_Loc036_Dr 9;
BA_ "GenSigSendType" SG_ 418 RFC_Loc036_Vr 9;
BA_ "GenSigStartValue" SG_ 418 RFC_Loc036_Vr 32768;
BA_ "GenSigSendType" SG_ 418 RFC_Loc036_Theta 9;
BA_ "GenSigStartValue" SG_ 418 RFC_Loc036_Theta 32768;
BA_ "GenSigSendType" SG_ 418 RFC_Loc036_Phi 9;
BA_ "GenSigStartValue" SG_ 418 RFC_Loc036_Phi 32768;
BA_ "GenSigSendType" SG_ 418 RFC_Loc036_DrVnce 9;
BA_ "GenSigSendType" SG_ 418 RFC_Loc036_VrVnce 9;
BA_ "GenSigSendType" SG_ 418 RFC_Loc036_ThetaVnce 9;
BA_ "GenSigSendType" SG_ 418 RFC_Loc036_PhiVnce 9;
BA_ "GenSigSendType" SG_ 418 RFC_Loc036_DrVrCoVnce 9;
BA_ "GenSigStartValue" SG_ 418 RFC_Loc036_DrVrCoVnce 32768;
BA_ "GenSigSendType" SG_ 418 RFC_Loc036_RCS 9;
BA_ "GenSigStartValue" SG_ 418 RFC_Loc036_RCS 32768;
BA_ "GenSigSendType" SG_ 418 RFC_Loc036_RSSI 9;
BA_ "GenSigSendType" SG_ 418 RFC_Loc036_DrVrQuality 9;
BA_ "GenSigSendType" SG_ 418 RFC_Loc036_ThetaQuality 9;
BA_ "GenSigSendType" SG_ 418 RFC_Loc036_PhiQuality 9;
BA_ "GenSigSendType" SG_ 418 RFC_Loc037_Dr 9;
BA_ "GenSigSendType" SG_ 418 RFC_Loc037_Vr 9;
BA_ "GenSigStartValue" SG_ 418 RFC_Loc037_Vr 32768;
BA_ "GenSigSendType" SG_ 418 RFC_Loc037_Theta 9;
BA_ "GenSigStartValue" SG_ 418 RFC_Loc037_Theta 32768;
BA_ "GenSigSendType" SG_ 418 RFC_Loc037_Phi 9;
BA_ "GenSigStartValue" SG_ 418 RFC_Loc037_Phi 32768;
BA_ "GenSigSendType" SG_ 418 RFC_Loc037_DrVnce 9;
BA_ "GenSigSendType" SG_ 418 RFC_Loc037_VrVnce 9;
BA_ "GenSigSendType" SG_ 418 RFC_Loc037_ThetaVnce 9;
BA_ "GenSigSendType" SG_ 418 RFC_Loc037_PhiVnce 9;
BA_ "GenSigSendType" SG_ 418 RFC_Loc037_DrVrCoVnce 9;
BA_ "GenSigStartValue" SG_ 418 RFC_Loc037_DrVrCoVnce 32768;
BA_ "GenSigSendType" SG_ 418 RFC_Loc037_RCS 9;
BA_ "GenSigStartValue" SG_ 418 RFC_Loc037_RCS 32768;
BA_ "GenSigSendType" SG_ 418 RFC_Loc037_RSSI 9;
BA_ "GenSigSendType" SG_ 418 RFC_Loc037_DrVrQuality 9;
BA_ "GenSigSendType" SG_ 418 RFC_Loc037_ThetaQuality 9;
BA_ "GenSigSendType" SG_ 418 RFC_Loc037_PhiQuality 9;
BA_ "GenSigSendType" SG_ 419 RFC_Loc038_CRC 9;
BA_ "GenSigSendType" SG_ 419 RFC_Loc038_AliveCtr 9;
BA_ "GenSigSendType" SG_ 419 RFC_Loc038_ProtBlockCtr 9;
BA_ "GenSigSendType" SG_ 419 RFC_Loc038_Dr 9;
BA_ "GenSigSendType" SG_ 419 RFC_Loc038_Vr 9;
BA_ "GenSigStartValue" SG_ 419 RFC_Loc038_Vr 32768;
BA_ "GenSigSendType" SG_ 419 RFC_Loc038_Theta 9;
BA_ "GenSigStartValue" SG_ 419 RFC_Loc038_Theta 32768;
BA_ "GenSigSendType" SG_ 419 RFC_Loc038_Phi 9;
BA_ "GenSigStartValue" SG_ 419 RFC_Loc038_Phi 32768;
BA_ "GenSigSendType" SG_ 419 RFC_Loc038_DrVnce 9;
BA_ "GenSigSendType" SG_ 419 RFC_Loc038_VrVnce 9;
BA_ "GenSigSendType" SG_ 419 RFC_Loc038_ThetaVnce 9;
BA_ "GenSigSendType" SG_ 419 RFC_Loc038_PhiVnce 9;
BA_ "GenSigSendType" SG_ 419 RFC_Loc038_DrVrCoVnce 9;
BA_ "GenSigStartValue" SG_ 419 RFC_Loc038_DrVrCoVnce 32768;
BA_ "GenSigSendType" SG_ 419 RFC_Loc038_RCS 9;
BA_ "GenSigStartValue" SG_ 419 RFC_Loc038_RCS 32768;
BA_ "GenSigSendType" SG_ 419 RFC_Loc038_RSSI 9;
BA_ "GenSigSendType" SG_ 419 RFC_Loc038_DrVrQuality 9;
BA_ "GenSigSendType" SG_ 419 RFC_Loc038_ThetaQuality 9;
BA_ "GenSigSendType" SG_ 419 RFC_Loc038_PhiQuality 9;
BA_ "GenSigSendType" SG_ 419 RFC_Loc039_Dr 9;
BA_ "GenSigSendType" SG_ 419 RFC_Loc039_Vr 9;
BA_ "GenSigStartValue" SG_ 419 RFC_Loc039_Vr 32768;
BA_ "GenSigSendType" SG_ 419 RFC_Loc039_Theta 9;
BA_ "GenSigStartValue" SG_ 419 RFC_Loc039_Theta 32768;
BA_ "GenSigSendType" SG_ 419 RFC_Loc039_Phi 9;
BA_ "GenSigStartValue" SG_ 419 RFC_Loc039_Phi 32768;
BA_ "GenSigSendType" SG_ 419 RFC_Loc039_DrVnce 9;
BA_ "GenSigSendType" SG_ 419 RFC_Loc039_VrVnce 9;
BA_ "GenSigSendType" SG_ 419 RFC_Loc039_ThetaVnce 9;
BA_ "GenSigSendType" SG_ 419 RFC_Loc039_PhiVnce 9;
BA_ "GenSigSendType" SG_ 419 RFC_Loc039_DrVrCoVnce 9;
BA_ "GenSigStartValue" SG_ 419 RFC_Loc039_DrVrCoVnce 32768;
BA_ "GenSigSendType" SG_ 419 RFC_Loc039_RCS 9;
BA_ "GenSigStartValue" SG_ 419 RFC_Loc039_RCS 32768;
BA_ "GenSigSendType" SG_ 419 RFC_Loc039_RSSI 9;
BA_ "GenSigSendType" SG_ 419 RFC_Loc039_DrVrQuality 9;
BA_ "GenSigSendType" SG_ 419 RFC_Loc039_ThetaQuality 9;
BA_ "GenSigSendType" SG_ 419 RFC_Loc039_PhiQuality 9;
BA_ "GenSigSendType" SG_ 420 RFC_Loc040_CRC 9;
BA_ "GenSigSendType" SG_ 420 RFC_Loc040_AliveCtr 9;
BA_ "GenSigSendType" SG_ 420 RFC_Loc040_ProtBlockCtr 9;
BA_ "GenSigSendType" SG_ 420 RFC_Loc040_Dr 9;
BA_ "GenSigSendType" SG_ 420 RFC_Loc040_Vr 9;
BA_ "GenSigStartValue" SG_ 420 RFC_Loc040_Vr 32768;
BA_ "GenSigSendType" SG_ 420 RFC_Loc040_Theta 9;
BA_ "GenSigStartValue" SG_ 420 RFC_Loc040_Theta 32768;
BA_ "GenSigSendType" SG_ 420 RFC_Loc040_Phi 9;
BA_ "GenSigStartValue" SG_ 420 RFC_Loc040_Phi 32768;
BA_ "GenSigSendType" SG_ 420 RFC_Loc040_DrVnce 9;
BA_ "GenSigSendType" SG_ 420 RFC_Loc040_VrVnce 9;
BA_ "GenSigSendType" SG_ 420 RFC_Loc040_ThetaVnce 9;
BA_ "GenSigSendType" SG_ 420 RFC_Loc040_PhiVnce 9;
BA_ "GenSigSendType" SG_ 420 RFC_Loc040_DrVrCoVnce 9;
BA_ "GenSigStartValue" SG_ 420 RFC_Loc040_DrVrCoVnce 32768;
BA_ "GenSigSendType" SG_ 420 RFC_Loc040_RCS 9;
BA_ "GenSigStartValue" SG_ 420 RFC_Loc040_RCS 32768;
BA_ "GenSigSendType" SG_ 420 RFC_Loc040_RSSI 9;
BA_ "GenSigSendType" SG_ 420 RFC_Loc040_DrVrQuality 9;
BA_ "GenSigSendType" SG_ 420 RFC_Loc040_ThetaQuality 9;
BA_ "GenSigSendType" SG_ 420 RFC_Loc040_PhiQuality 9;
BA_ "GenSigSendType" SG_ 420 RFC_Loc041_Dr 9;
BA_ "GenSigSendType" SG_ 420 RFC_Loc041_Vr 9;
BA_ "GenSigStartValue" SG_ 420 RFC_Loc041_Vr 32768;
BA_ "GenSigSendType" SG_ 420 RFC_Loc041_Theta 9;
BA_ "GenSigStartValue" SG_ 420 RFC_Loc041_Theta 32768;
BA_ "GenSigSendType" SG_ 420 RFC_Loc041_Phi 9;
BA_ "GenSigStartValue" SG_ 420 RFC_Loc041_Phi 32768;
BA_ "GenSigSendType" SG_ 420 RFC_Loc041_DrVnce 9;
BA_ "GenSigSendType" SG_ 420 RFC_Loc041_VrVnce 9;
BA_ "GenSigSendType" SG_ 420 RFC_Loc041_ThetaVnce 9;
BA_ "GenSigSendType" SG_ 420 RFC_Loc041_PhiVnce 9;
BA_ "GenSigSendType" SG_ 420 RFC_Loc041_DrVrCoVnce 9;
BA_ "GenSigStartValue" SG_ 420 RFC_Loc041_DrVrCoVnce 32768;
BA_ "GenSigSendType" SG_ 420 RFC_Loc041_RCS 9;
BA_ "GenSigStartValue" SG_ 420 RFC_Loc041_RCS 32768;
BA_ "GenSigSendType" SG_ 420 RFC_Loc041_RSSI 9;
BA_ "GenSigSendType" SG_ 420 RFC_Loc041_DrVrQuality 9;
BA_ "GenSigSendType" SG_ 420 RFC_Loc041_ThetaQuality 9;
BA_ "GenSigSendType" SG_ 420 RFC_Loc041_PhiQuality 9;
BA_ "GenSigSendType" SG_ 421 RFC_Loc042_CRC 9;
BA_ "GenSigSendType" SG_ 421 RFC_Loc042_AliveCtr 9;
BA_ "GenSigSendType" SG_ 421 RFC_Loc042_ProtBlockCtr 9;
BA_ "GenSigSendType" SG_ 421 RFC_Loc042_Dr 9;
BA_ "GenSigSendType" SG_ 421 RFC_Loc042_Vr 9;
BA_ "GenSigStartValue" SG_ 421 RFC_Loc042_Vr 32768;
BA_ "GenSigSendType" SG_ 421 RFC_Loc042_Theta 9;
BA_ "GenSigStartValue" SG_ 421 RFC_Loc042_Theta 32768;
BA_ "GenSigSendType" SG_ 421 RFC_Loc042_Phi 9;
BA_ "GenSigStartValue" SG_ 421 RFC_Loc042_Phi 32768;
BA_ "GenSigSendType" SG_ 421 RFC_Loc042_DrVnce 9;
BA_ "GenSigSendType" SG_ 421 RFC_Loc042_VrVnce 9;
BA_ "GenSigSendType" SG_ 421 RFC_Loc042_ThetaVnce 9;
BA_ "GenSigSendType" SG_ 421 RFC_Loc042_PhiVnce 9;
BA_ "GenSigSendType" SG_ 421 RFC_Loc042_DrVrCoVnce 9;
BA_ "GenSigStartValue" SG_ 421 RFC_Loc042_DrVrCoVnce 32768;
BA_ "GenSigSendType" SG_ 421 RFC_Loc042_RCS 9;
BA_ "GenSigStartValue" SG_ 421 RFC_Loc042_RCS 32768;
BA_ "GenSigSendType" SG_ 421 RFC_Loc042_RSSI 9;
BA_ "GenSigSendType" SG_ 421 RFC_Loc042_DrVrQuality 9;
BA_ "GenSigSendType" SG_ 421 RFC_Loc042_ThetaQuality 9;
BA_ "GenSigSendType" SG_ 421 RFC_Loc042_PhiQuality 9;
BA_ "GenSigSendType" SG_ 421 RFC_Loc043_Dr 9;
BA_ "GenSigSendType" SG_ 421 RFC_Loc043_Vr 9;
BA_ "GenSigStartValue" SG_ 421 RFC_Loc043_Vr 32768;
BA_ "GenSigSendType" SG_ 421 RFC_Loc043_Theta 9;
BA_ "GenSigStartValue" SG_ 421 RFC_Loc043_Theta 32768;
BA_ "GenSigSendType" SG_ 421 RFC_Loc043_Phi 9;
BA_ "GenSigStartValue" SG_ 421 RFC_Loc043_Phi 32768;
BA_ "GenSigSendType" SG_ 421 RFC_Loc043_DrVnce 9;
BA_ "GenSigSendType" SG_ 421 RFC_Loc043_VrVnce 9;
BA_ "GenSigSendType" SG_ 421 RFC_Loc043_ThetaVnce 9;
BA_ "GenSigSendType" SG_ 421 RFC_Loc043_PhiVnce 9;
BA_ "GenSigSendType" SG_ 421 RFC_Loc043_DrVrCoVnce 9;
BA_ "GenSigStartValue" SG_ 421 RFC_Loc043_DrVrCoVnce 32768;
BA_ "GenSigSendType" SG_ 421 RFC_Loc043_RCS 9;
BA_ "GenSigStartValue" SG_ 421 RFC_Loc043_RCS 32768;
BA_ "GenSigSendType" SG_ 421 RFC_Loc043_RSSI 9;
BA_ "GenSigSendType" SG_ 421 RFC_Loc043_DrVrQuality 9;
BA_ "GenSigSendType" SG_ 421 RFC_Loc043_ThetaQuality 9;
BA_ "GenSigSendType" SG_ 421 RFC_Loc043_PhiQuality 9;
BA_ "GenSigSendType" SG_ 422 RFC_Loc044_CRC 9;
BA_ "GenSigSendType" SG_ 422 RFC_Loc044_AliveCtr 9;
BA_ "GenSigSendType" SG_ 422 RFC_Loc044_ProtBlockCtr 9;
BA_ "GenSigSendType" SG_ 422 RFC_Loc044_Dr 9;
BA_ "GenSigSendType" SG_ 422 RFC_Loc044_Vr 9;
BA_ "GenSigStartValue" SG_ 422 RFC_Loc044_Vr 32768;
BA_ "GenSigSendType" SG_ 422 RFC_Loc044_Theta 9;
BA_ "GenSigStartValue" SG_ 422 RFC_Loc044_Theta 32768;
BA_ "GenSigSendType" SG_ 422 RFC_Loc044_Phi 9;
BA_ "GenSigStartValue" SG_ 422 RFC_Loc044_Phi 32768;
BA_ "GenSigSendType" SG_ 422 RFC_Loc044_DrVnce 9;
BA_ "GenSigSendType" SG_ 422 RFC_Loc044_VrVnce 9;
BA_ "GenSigSendType" SG_ 422 RFC_Loc044_ThetaVnce 9;
BA_ "GenSigSendType" SG_ 422 RFC_Loc044_PhiVnce 9;
BA_ "GenSigSendType" SG_ 422 RFC_Loc044_DrVrCoVnce 9;
BA_ "GenSigStartValue" SG_ 422 RFC_Loc044_DrVrCoVnce 32768;
BA_ "GenSigSendType" SG_ 422 RFC_Loc044_RCS 9;
BA_ "GenSigStartValue" SG_ 422 RFC_Loc044_RCS 32768;
BA_ "GenSigSendType" SG_ 422 RFC_Loc044_RSSI 9;
BA_ "GenSigSendType" SG_ 422 RFC_Loc044_DrVrQuality 9;
BA_ "GenSigSendType" SG_ 422 RFC_Loc044_ThetaQuality 9;
BA_ "GenSigSendType" SG_ 422 RFC_Loc044_PhiQuality 9;
BA_ "GenSigSendType" SG_ 422 RFC_Loc045_Dr 9;
BA_ "GenSigSendType" SG_ 422 RFC_Loc045_Vr 9;
BA_ "GenSigStartValue" SG_ 422 RFC_Loc045_Vr 32768;
BA_ "GenSigSendType" SG_ 422 RFC_Loc045_Theta 9;
BA_ "GenSigStartValue" SG_ 422 RFC_Loc045_Theta 32768;
BA_ "GenSigSendType" SG_ 422 RFC_Loc045_Phi 9;
BA_ "GenSigStartValue" SG_ 422 RFC_Loc045_Phi 32768;
BA_ "GenSigSendType" SG_ 422 RFC_Loc045_DrVnce 9;
BA_ "GenSigSendType" SG_ 422 RFC_Loc045_VrVnce 9;
BA_ "GenSigSendType" SG_ 422 RFC_Loc045_ThetaVnce 9;
BA_ "GenSigSendType" SG_ 422 RFC_Loc045_PhiVnce 9;
BA_ "GenSigSendType" SG_ 422 RFC_Loc045_DrVrCoVnce 9;
BA_ "GenSigStartValue" SG_ 422 RFC_Loc045_DrVrCoVnce 32768;
BA_ "GenSigSendType" SG_ 422 RFC_Loc045_RCS 9;
BA_ "GenSigStartValue" SG_ 422 RFC_Loc045_RCS 32768;
BA_ "GenSigSendType" SG_ 422 RFC_Loc045_RSSI 9;
BA_ "GenSigSendType" SG_ 422 RFC_Loc045_DrVrQuality 9;
BA_ "GenSigSendType" SG_ 422 RFC_Loc045_ThetaQuality 9;
BA_ "GenSigSendType" SG_ 422 RFC_Loc045_PhiQuality 9;
BA_ "GenSigSendType" SG_ 423 RFC_Loc046_CRC 9;
BA_ "GenSigSendType" SG_ 423 RFC_Loc046_AliveCtr 9;
BA_ "GenSigSendType" SG_ 423 RFC_Loc046_ProtBlockCtr 9;
BA_ "GenSigSendType" SG_ 423 RFC_Loc046_Dr 9;
BA_ "GenSigSendType" SG_ 423 RFC_Loc046_Vr 9;
BA_ "GenSigStartValue" SG_ 423 RFC_Loc046_Vr 32768;
BA_ "GenSigSendType" SG_ 423 RFC_Loc046_Theta 9;
BA_ "GenSigStartValue" SG_ 423 RFC_Loc046_Theta 32768;
BA_ "GenSigSendType" SG_ 423 RFC_Loc046_Phi 9;
BA_ "GenSigStartValue" SG_ 423 RFC_Loc046_Phi 32768;
BA_ "GenSigSendType" SG_ 423 RFC_Loc046_DrVnce 9;
BA_ "GenSigSendType" SG_ 423 RFC_Loc046_VrVnce 9;
BA_ "GenSigSendType" SG_ 423 RFC_Loc046_ThetaVnce 9;
BA_ "GenSigSendType" SG_ 423 RFC_Loc046_PhiVnce 9;
BA_ "GenSigSendType" SG_ 423 RFC_Loc046_DrVrCoVnce 9;
BA_ "GenSigStartValue" SG_ 423 RFC_Loc046_DrVrCoVnce 32768;
BA_ "GenSigSendType" SG_ 423 RFC_Loc046_RCS 9;
BA_ "GenSigStartValue" SG_ 423 RFC_Loc046_RCS 32768;
BA_ "GenSigSendType" SG_ 423 RFC_Loc046_RSSI 9;
BA_ "GenSigSendType" SG_ 423 RFC_Loc046_DrVrQuality 9;
BA_ "GenSigSendType" SG_ 423 RFC_Loc046_ThetaQuality 9;
BA_ "GenSigSendType" SG_ 423 RFC_Loc046_PhiQuality 9;
BA_ "GenSigSendType" SG_ 423 RFC_Loc047_Dr 9;
BA_ "GenSigSendType" SG_ 423 RFC_Loc047_Vr 9;
BA_ "GenSigStartValue" SG_ 423 RFC_Loc047_Vr 32768;
BA_ "GenSigSendType" SG_ 423 RFC_Loc047_Theta 9;
BA_ "GenSigStartValue" SG_ 423 RFC_Loc047_Theta 32768;
BA_ "GenSigSendType" SG_ 423 RFC_Loc047_Phi 9;
BA_ "GenSigStartValue" SG_ 423 RFC_Loc047_Phi 32768;
BA_ "GenSigSendType" SG_ 423 RFC_Loc047_DrVnce 9;
BA_ "GenSigSendType" SG_ 423 RFC_Loc047_VrVnce 9;
BA_ "GenSigSendType" SG_ 423 RFC_Loc047_ThetaVnce 9;
BA_ "GenSigSendType" SG_ 423 RFC_Loc047_PhiVnce 9;
BA_ "GenSigSendType" SG_ 423 RFC_Loc047_DrVrCoVnce 9;
BA_ "GenSigStartValue" SG_ 423 RFC_Loc047_DrVrCoVnce 32768;
BA_ "GenSigSendType" SG_ 423 RFC_Loc047_RCS 9;
BA_ "GenSigStartValue" SG_ 423 RFC_Loc047_RCS 32768;
BA_ "GenSigSendType" SG_ 423 RFC_Loc047_RSSI 9;
BA_ "GenSigSendType" SG_ 423 RFC_Loc047_DrVrQuality 9;
BA_ "GenSigSendType" SG_ 423 RFC_Loc047_ThetaQuality 9;
BA_ "GenSigSendType" SG_ 423 RFC_Loc047_PhiQuality 9;
BA_ "GenSigSendType" SG_ 424 RFC_Loc048_CRC 9;
BA_ "GenSigSendType" SG_ 424 RFC_Loc048_AliveCtr 9;
BA_ "GenSigSendType" SG_ 424 RFC_Loc048_ProtBlockCtr 9;
BA_ "GenSigSendType" SG_ 424 RFC_Loc048_Dr 9;
BA_ "GenSigSendType" SG_ 424 RFC_Loc048_Vr 9;
BA_ "GenSigStartValue" SG_ 424 RFC_Loc048_Vr 32768;
BA_ "GenSigSendType" SG_ 424 RFC_Loc048_Theta 9;
BA_ "GenSigStartValue" SG_ 424 RFC_Loc048_Theta 32768;
BA_ "GenSigSendType" SG_ 424 RFC_Loc048_Phi 9;
BA_ "GenSigStartValue" SG_ 424 RFC_Loc048_Phi 32768;
BA_ "GenSigSendType" SG_ 424 RFC_Loc048_DrVnce 9;
BA_ "GenSigSendType" SG_ 424 RFC_Loc048_VrVnce 9;
BA_ "GenSigSendType" SG_ 424 RFC_Loc048_ThetaVnce 9;
BA_ "GenSigSendType" SG_ 424 RFC_Loc048_PhiVnce 9;
BA_ "GenSigSendType" SG_ 424 RFC_Loc048_DrVrCoVnce 9;
BA_ "GenSigStartValue" SG_ 424 RFC_Loc048_DrVrCoVnce 32768;
BA_ "GenSigSendType" SG_ 424 RFC_Loc048_RCS 9;
BA_ "GenSigStartValue" SG_ 424 RFC_Loc048_RCS 32768;
BA_ "GenSigSendType" SG_ 424 RFC_Loc048_RSSI 9;
BA_ "GenSigSendType" SG_ 424 RFC_Loc048_DrVrQuality 9;
BA_ "GenSigSendType" SG_ 424 RFC_Loc048_ThetaQuality 9;
BA_ "GenSigSendType" SG_ 424 RFC_Loc048_PhiQuality 9;
BA_ "GenSigSendType" SG_ 424 RFC_Loc049_Dr 9;
BA_ "GenSigSendType" SG_ 424 RFC_Loc049_Vr 9;
BA_ "GenSigStartValue" SG_ 424 RFC_Loc049_Vr 32768;
BA_ "GenSigSendType" SG_ 424 RFC_Loc049_Theta 9;
BA_ "GenSigStartValue" SG_ 424 RFC_Loc049_Theta 32768;
BA_ "GenSigSendType" SG_ 424 RFC_Loc049_Phi 9;
BA_ "GenSigStartValue" SG_ 424 RFC_Loc049_Phi 32768;
BA_ "GenSigSendType" SG_ 424 RFC_Loc049_DrVnce 9;
BA_ "GenSigSendType" SG_ 424 RFC_Loc049_VrVnce 9;
BA_ "GenSigSendType" SG_ 424 RFC_Loc049_ThetaVnce 9;
BA_ "GenSigSendType" SG_ 424 RFC_Loc049_PhiVnce 9;
BA_ "GenSigSendType" SG_ 424 RFC_Loc049_DrVrCoVnce 9;
BA_ "GenSigStartValue" SG_ 424 RFC_Loc049_DrVrCoVnce 32768;
BA_ "GenSigSendType" SG_ 424 RFC_Loc049_RCS 9;
BA_ "GenSigStartValue" SG_ 424 RFC_Loc049_RCS 32768;
BA_ "GenSigSendType" SG_ 424 RFC_Loc049_RSSI 9;
BA_ "GenSigSendType" SG_ 424 RFC_Loc049_DrVrQuality 9;
BA_ "GenSigSendType" SG_ 424 RFC_Loc049_ThetaQuality 9;
BA_ "GenSigSendType" SG_ 424 RFC_Loc049_PhiQuality 9;
BA_ "GenSigSendType" SG_ 425 RFC_Loc050_CRC 9;
BA_ "GenSigSendType" SG_ 425 RFC_Loc050_AliveCtr 9;
BA_ "GenSigSendType" SG_ 425 RFC_Loc050_ProtBlockCtr 9;
BA_ "GenSigSendType" SG_ 425 RFC_Loc050_Dr 9;
BA_ "GenSigSendType" SG_ 425 RFC_Loc050_Vr 9;
BA_ "GenSigStartValue" SG_ 425 RFC_Loc050_Vr 32768;
BA_ "GenSigSendType" SG_ 425 RFC_Loc050_Theta 9;
BA_ "GenSigStartValue" SG_ 425 RFC_Loc050_Theta 32768;
BA_ "GenSigSendType" SG_ 425 RFC_Loc050_Phi 9;
BA_ "GenSigStartValue" SG_ 425 RFC_Loc050_Phi 32768;
BA_ "GenSigSendType" SG_ 425 RFC_Loc050_DrVnce 9;
BA_ "GenSigSendType" SG_ 425 RFC_Loc050_VrVnce 9;
BA_ "GenSigSendType" SG_ 425 RFC_Loc050_ThetaVnce 9;
BA_ "GenSigSendType" SG_ 425 RFC_Loc050_PhiVnce 9;
BA_ "GenSigSendType" SG_ 425 RFC_Loc050_DrVrCoVnce 9;
BA_ "GenSigStartValue" SG_ 425 RFC_Loc050_DrVrCoVnce 32768;
BA_ "GenSigSendType" SG_ 425 RFC_Loc050_RCS 9;
BA_ "GenSigStartValue" SG_ 425 RFC_Loc050_RCS 32768;
BA_ "GenSigSendType" SG_ 425 RFC_Loc050_RSSI 9;
BA_ "GenSigSendType" SG_ 425 RFC_Loc050_DrVrQuality 9;
BA_ "GenSigSendType" SG_ 425 RFC_Loc050_ThetaQuality 9;
BA_ "GenSigSendType" SG_ 425 RFC_Loc050_PhiQuality 9;
BA_ "GenSigSendType" SG_ 425 RFC_Loc051_Dr 9;
BA_ "GenSigSendType" SG_ 425 RFC_Loc051_Vr 9;
BA_ "GenSigStartValue" SG_ 425 RFC_Loc051_Vr 32768;
BA_ "GenSigSendType" SG_ 425 RFC_Loc051_Theta 9;
BA_ "GenSigStartValue" SG_ 425 RFC_Loc051_Theta 32768;
BA_ "GenSigSendType" SG_ 425 RFC_Loc051_Phi 9;
BA_ "GenSigStartValue" SG_ 425 RFC_Loc051_Phi 32768;
BA_ "GenSigSendType" SG_ 425 RFC_Loc051_DrVnce 9;
BA_ "GenSigSendType" SG_ 425 RFC_Loc051_VrVnce 9;
BA_ "GenSigSendType" SG_ 425 RFC_Loc051_ThetaVnce 9;
BA_ "GenSigSendType" SG_ 425 RFC_Loc051_PhiVnce 9;
BA_ "GenSigSendType" SG_ 425 RFC_Loc051_DrVrCoVnce 9;
BA_ "GenSigStartValue" SG_ 425 RFC_Loc051_DrVrCoVnce 32768;
BA_ "GenSigSendType" SG_ 425 RFC_Loc051_RCS 9;
BA_ "GenSigStartValue" SG_ 425 RFC_Loc051_RCS 32768;
BA_ "GenSigSendType" SG_ 425 RFC_Loc051_RSSI 9;
BA_ "GenSigSendType" SG_ 425 RFC_Loc051_DrVrQuality 9;
BA_ "GenSigSendType" SG_ 425 RFC_Loc051_ThetaQuality 9;
BA_ "GenSigSendType" SG_ 425 RFC_Loc051_PhiQuality 9;
BA_ "GenSigSendType" SG_ 426 RFC_Loc052_CRC 9;
BA_ "GenSigSendType" SG_ 426 RFC_Loc052_AliveCtr 9;
BA_ "GenSigSendType" SG_ 426 RFC_Loc052_ProtBlockCtr 9;
BA_ "GenSigSendType" SG_ 426 RFC_Loc052_Dr 9;
BA_ "GenSigSendType" SG_ 426 RFC_Loc052_Vr 9;
BA_ "GenSigStartValue" SG_ 426 RFC_Loc052_Vr 32768;
BA_ "GenSigSendType" SG_ 426 RFC_Loc052_Theta 9;
BA_ "GenSigStartValue" SG_ 426 RFC_Loc052_Theta 32768;
BA_ "GenSigSendType" SG_ 426 RFC_Loc052_Phi 9;
BA_ "GenSigStartValue" SG_ 426 RFC_Loc052_Phi 32768;
BA_ "GenSigSendType" SG_ 426 RFC_Loc052_DrVnce 9;
BA_ "GenSigSendType" SG_ 426 RFC_Loc052_VrVnce 9;
BA_ "GenSigSendType" SG_ 426 RFC_Loc052_ThetaVnce 9;
BA_ "GenSigSendType" SG_ 426 RFC_Loc052_PhiVnce 9;
BA_ "GenSigSendType" SG_ 426 RFC_Loc052_DrVrCoVnce 9;
BA_ "GenSigStartValue" SG_ 426 RFC_Loc052_DrVrCoVnce 32768;
BA_ "GenSigSendType" SG_ 426 RFC_Loc052_RCS 9;
BA_ "GenSigStartValue" SG_ 426 RFC_Loc052_RCS 32768;
BA_ "GenSigSendType" SG_ 426 RFC_Loc052_RSSI 9;
BA_ "GenSigSendType" SG_ 426 RFC_Loc052_DrVrQuality 9;
BA_ "GenSigSendType" SG_ 426 RFC_Loc052_ThetaQuality 9;
BA_ "GenSigSendType" SG_ 426 RFC_Loc052_PhiQuality 9;
BA_ "GenSigSendType" SG_ 426 RFC_Loc053_Dr 9;
BA_ "GenSigSendType" SG_ 426 RFC_Loc053_Vr 9;
BA_ "GenSigStartValue" SG_ 426 RFC_Loc053_Vr 32768;
BA_ "GenSigSendType" SG_ 426 RFC_Loc053_Theta 9;
BA_ "GenSigStartValue" SG_ 426 RFC_Loc053_Theta 32768;
BA_ "GenSigSendType" SG_ 426 RFC_Loc053_Phi 9;
BA_ "GenSigStartValue" SG_ 426 RFC_Loc053_Phi 32768;
BA_ "GenSigSendType" SG_ 426 RFC_Loc053_DrVnce 9;
BA_ "GenSigSendType" SG_ 426 RFC_Loc053_VrVnce 9;
BA_ "GenSigSendType" SG_ 426 RFC_Loc053_ThetaVnce 9;
BA_ "GenSigSendType" SG_ 426 RFC_Loc053_PhiVnce 9;
BA_ "GenSigSendType" SG_ 426 RFC_Loc053_DrVrCoVnce 9;
BA_ "GenSigStartValue" SG_ 426 RFC_Loc053_DrVrCoVnce 32768;
BA_ "GenSigSendType" SG_ 426 RFC_Loc053_RCS 9;
BA_ "GenSigStartValue" SG_ 426 RFC_Loc053_RCS 32768;
BA_ "GenSigSendType" SG_ 426 RFC_Loc053_RSSI 9;
BA_ "GenSigSendType" SG_ 426 RFC_Loc053_DrVrQuality 9;
BA_ "GenSigSendType" SG_ 426 RFC_Loc053_ThetaQuality 9;
BA_ "GenSigSendType" SG_ 426 RFC_Loc053_PhiQuality 9;
BA_ "GenSigSendType" SG_ 427 RFC_Loc054_CRC 9;
BA_ "GenSigSendType" SG_ 427 RFC_Loc054_AliveCtr 9;
BA_ "GenSigSendType" SG_ 427 RFC_Loc054_ProtBlockCtr 9;
BA_ "GenSigSendType" SG_ 427 RFC_Loc054_Dr 9;
BA_ "GenSigSendType" SG_ 427 RFC_Loc054_Vr 9;
BA_ "GenSigStartValue" SG_ 427 RFC_Loc054_Vr 32768;
BA_ "GenSigSendType" SG_ 427 RFC_Loc054_Theta 9;
BA_ "GenSigStartValue" SG_ 427 RFC_Loc054_Theta 32768;
BA_ "GenSigSendType" SG_ 427 RFC_Loc054_Phi 9;
BA_ "GenSigStartValue" SG_ 427 RFC_Loc054_Phi 32768;
BA_ "GenSigSendType" SG_ 427 RFC_Loc054_DrVnce 9;
BA_ "GenSigSendType" SG_ 427 RFC_Loc054_VrVnce 9;
BA_ "GenSigSendType" SG_ 427 RFC_Loc054_ThetaVnce 9;
BA_ "GenSigSendType" SG_ 427 RFC_Loc054_PhiVnce 9;
BA_ "GenSigSendType" SG_ 427 RFC_Loc054_DrVrCoVnce 9;
BA_ "GenSigStartValue" SG_ 427 RFC_Loc054_DrVrCoVnce 32768;
BA_ "GenSigSendType" SG_ 427 RFC_Loc054_RCS 9;
BA_ "GenSigStartValue" SG_ 427 RFC_Loc054_RCS 32768;
BA_ "GenSigSendType" SG_ 427 RFC_Loc054_RSSI 9;
BA_ "GenSigSendType" SG_ 427 RFC_Loc054_DrVrQuality 9;
BA_ "GenSigSendType" SG_ 427 RFC_Loc054_ThetaQuality 9;
BA_ "GenSigSendType" SG_ 427 RFC_Loc054_PhiQuality 9;
BA_ "GenSigSendType" SG_ 427 RFC_Loc055_Dr 9;
BA_ "GenSigSendType" SG_ 427 RFC_Loc055_Vr 9;
BA_ "GenSigStartValue" SG_ 427 RFC_Loc055_Vr 32768;
BA_ "GenSigSendType" SG_ 427 RFC_Loc055_Theta 9;
BA_ "GenSigStartValue" SG_ 427 RFC_Loc055_Theta 32768;
BA_ "GenSigSendType" SG_ 427 RFC_Loc055_Phi 9;
BA_ "GenSigStartValue" SG_ 427 RFC_Loc055_Phi 32768;
BA_ "GenSigSendType" SG_ 427 RFC_Loc055_DrVnce 9;
BA_ "GenSigSendType" SG_ 427 RFC_Loc055_VrVnce 9;
BA_ "GenSigSendType" SG_ 427 RFC_Loc055_ThetaVnce 9;
BA_ "GenSigSendType" SG_ 427 RFC_Loc055_PhiVnce 9;
BA_ "GenSigSendType" SG_ 427 RFC_Loc055_DrVrCoVnce 9;
BA_ "GenSigStartValue" SG_ 427 RFC_Loc055_DrVrCoVnce 32768;
BA_ "GenSigSendType" SG_ 427 RFC_Loc055_RCS 9;
BA_ "GenSigStartValue" SG_ 427 RFC_Loc055_RCS 32768;
BA_ "GenSigSendType" SG_ 427 RFC_Loc055_RSSI 9;
BA_ "GenSigSendType" SG_ 427 RFC_Loc055_DrVrQuality 9;
BA_ "GenSigSendType" SG_ 427 RFC_Loc055_ThetaQuality 9;
BA_ "GenSigSendType" SG_ 427 RFC_Loc055_PhiQuality 9;
BA_ "GenSigSendType" SG_ 428 RFC_Loc056_CRC 9;
BA_ "GenSigSendType" SG_ 428 RFC_Loc056_AliveCtr 9;
BA_ "GenSigSendType" SG_ 428 RFC_Loc056_ProtBlockCtr 9;
BA_ "GenSigSendType" SG_ 428 RFC_Loc056_Dr 9;
BA_ "GenSigSendType" SG_ 428 RFC_Loc056_Vr 9;
BA_ "GenSigStartValue" SG_ 428 RFC_Loc056_Vr 32768;
BA_ "GenSigSendType" SG_ 428 RFC_Loc056_Theta 9;
BA_ "GenSigStartValue" SG_ 428 RFC_Loc056_Theta 32768;
BA_ "GenSigSendType" SG_ 428 RFC_Loc056_Phi 9;
BA_ "GenSigStartValue" SG_ 428 RFC_Loc056_Phi 32768;
BA_ "GenSigSendType" SG_ 428 RFC_Loc056_DrVnce 9;
BA_ "GenSigSendType" SG_ 428 RFC_Loc056_VrVnce 9;
BA_ "GenSigSendType" SG_ 428 RFC_Loc056_ThetaVnce 9;
BA_ "GenSigSendType" SG_ 428 RFC_Loc056_PhiVnce 9;
BA_ "GenSigSendType" SG_ 428 RFC_Loc056_DrVrCoVnce 9;
BA_ "GenSigStartValue" SG_ 428 RFC_Loc056_DrVrCoVnce 32768;
BA_ "GenSigSendType" SG_ 428 RFC_Loc056_RCS 9;
BA_ "GenSigStartValue" SG_ 428 RFC_Loc056_RCS 32768;
BA_ "GenSigSendType" SG_ 428 RFC_Loc056_RSSI 9;
BA_ "GenSigSendType" SG_ 428 RFC_Loc056_DrVrQuality 9;
BA_ "GenSigSendType" SG_ 428 RFC_Loc056_ThetaQuality 9;
BA_ "GenSigSendType" SG_ 428 RFC_Loc056_PhiQuality 9;
BA_ "GenSigSendType" SG_ 428 RFC_Loc057_Dr 9;
BA_ "GenSigSendType" SG_ 428 RFC_Loc057_Vr 9;
BA_ "GenSigStartValue" SG_ 428 RFC_Loc057_Vr 32768;
BA_ "GenSigSendType" SG_ 428 RFC_Loc057_Theta 9;
BA_ "GenSigStartValue" SG_ 428 RFC_Loc057_Theta 32768;
BA_ "GenSigSendType" SG_ 428 RFC_Loc057_Phi 9;
BA_ "GenSigStartValue" SG_ 428 RFC_Loc057_Phi 32768;
BA_ "GenSigSendType" SG_ 428 RFC_Loc057_DrVnce 9;
BA_ "GenSigSendType" SG_ 428 RFC_Loc057_VrVnce 9;
BA_ "GenSigSendType" SG_ 428 RFC_Loc057_ThetaVnce 9;
BA_ "GenSigSendType" SG_ 428 RFC_Loc057_PhiVnce 9;
BA_ "GenSigSendType" SG_ 428 RFC_Loc057_DrVrCoVnce 9;
BA_ "GenSigStartValue" SG_ 428 RFC_Loc057_DrVrCoVnce 32768;
BA_ "GenSigSendType" SG_ 428 RFC_Loc057_RCS 9;
BA_ "GenSigStartValue" SG_ 428 RFC_Loc057_RCS 32768;
BA_ "GenSigSendType" SG_ 428 RFC_Loc057_RSSI 9;
BA_ "GenSigSendType" SG_ 428 RFC_Loc057_DrVrQuality 9;
BA_ "GenSigSendType" SG_ 428 RFC_Loc057_ThetaQuality 9;
BA_ "GenSigSendType" SG_ 428 RFC_Loc057_PhiQuality 9;
BA_ "GenSigSendType" SG_ 429 RFC_Loc058_CRC 9;
BA_ "GenSigSendType" SG_ 429 RFC_Loc058_AliveCtr 9;
BA_ "GenSigSendType" SG_ 429 RFC_Loc058_ProtBlockCtr 9;
BA_ "GenSigSendType" SG_ 429 RFC_Loc058_Dr 9;
BA_ "GenSigSendType" SG_ 429 RFC_Loc058_Vr 9;
BA_ "GenSigStartValue" SG_ 429 RFC_Loc058_Vr 32768;
BA_ "GenSigSendType" SG_ 429 RFC_Loc058_Theta 9;
BA_ "GenSigStartValue" SG_ 429 RFC_Loc058_Theta 32768;
BA_ "GenSigSendType" SG_ 429 RFC_Loc058_Phi 9;
BA_ "GenSigStartValue" SG_ 429 RFC_Loc058_Phi 32768;
BA_ "GenSigSendType" SG_ 429 RFC_Loc058_DrVnce 9;
BA_ "GenSigSendType" SG_ 429 RFC_Loc058_VrVnce 9;
BA_ "GenSigSendType" SG_ 429 RFC_Loc058_ThetaVnce 9;
BA_ "GenSigSendType" SG_ 429 RFC_Loc058_PhiVnce 9;
BA_ "GenSigSendType" SG_ 429 RFC_Loc058_DrVrCoVnce 9;
BA_ "GenSigStartValue" SG_ 429 RFC_Loc058_DrVrCoVnce 32768;
BA_ "GenSigSendType" SG_ 429 RFC_Loc058_RCS 9;
BA_ "GenSigStartValue" SG_ 429 RFC_Loc058_RCS 32768;
BA_ "GenSigSendType" SG_ 429 RFC_Loc058_RSSI 9;
BA_ "GenSigSendType" SG_ 429 RFC_Loc058_DrVrQuality 9;
BA_ "GenSigSendType" SG_ 429 RFC_Loc058_ThetaQuality 9;
BA_ "GenSigSendType" SG_ 429 RFC_Loc058_PhiQuality 9;
BA_ "GenSigSendType" SG_ 429 RFC_Loc059_Dr 9;
BA_ "GenSigSendType" SG_ 429 RFC_Loc059_Vr 9;
BA_ "GenSigStartValue" SG_ 429 RFC_Loc059_Vr 32768;
BA_ "GenSigSendType" SG_ 429 RFC_Loc059_Theta 9;
BA_ "GenSigStartValue" SG_ 429 RFC_Loc059_Theta 32768;
BA_ "GenSigSendType" SG_ 429 RFC_Loc059_Phi 9;
BA_ "GenSigStartValue" SG_ 429 RFC_Loc059_Phi 32768;
BA_ "GenSigSendType" SG_ 429 RFC_Loc059_DrVnce 9;
BA_ "GenSigSendType" SG_ 429 RFC_Loc059_VrVnce 9;
BA_ "GenSigSendType" SG_ 429 RFC_Loc059_ThetaVnce 9;
BA_ "GenSigSendType" SG_ 429 RFC_Loc059_PhiVnce 9;
BA_ "GenSigSendType" SG_ 429 RFC_Loc059_DrVrCoVnce 9;
BA_ "GenSigStartValue" SG_ 429 RFC_Loc059_DrVrCoVnce 32768;
BA_ "GenSigSendType" SG_ 429 RFC_Loc059_RCS 9;
BA_ "GenSigStartValue" SG_ 429 RFC_Loc059_RCS 32768;
BA_ "GenSigSendType" SG_ 429 RFC_Loc059_RSSI 9;
BA_ "GenSigSendType" SG_ 429 RFC_Loc059_DrVrQuality 9;
BA_ "GenSigSendType" SG_ 429 RFC_Loc059_ThetaQuality 9;
BA_ "GenSigSendType" SG_ 429 RFC_Loc059_PhiQuality 9;
BA_ "GenSigSendType" SG_ 430 RFC_Loc060_CRC 9;
BA_ "GenSigSendType" SG_ 430 RFC_Loc060_AliveCtr 9;
BA_ "GenSigSendType" SG_ 430 RFC_Loc060_ProtBlockCtr 9;
BA_ "GenSigSendType" SG_ 430 RFC_Loc060_Dr 9;
BA_ "GenSigSendType" SG_ 430 RFC_Loc060_Vr 9;
BA_ "GenSigStartValue" SG_ 430 RFC_Loc060_Vr 32768;
BA_ "GenSigSendType" SG_ 430 RFC_Loc060_Theta 9;
BA_ "GenSigStartValue" SG_ 430 RFC_Loc060_Theta 32768;
BA_ "GenSigSendType" SG_ 430 RFC_Loc060_Phi 9;
BA_ "GenSigStartValue" SG_ 430 RFC_Loc060_Phi 32768;
BA_ "GenSigSendType" SG_ 430 RFC_Loc060_DrVnce 9;
BA_ "GenSigSendType" SG_ 430 RFC_Loc060_VrVnce 9;
BA_ "GenSigSendType" SG_ 430 RFC_Loc060_ThetaVnce 9;
BA_ "GenSigSendType" SG_ 430 RFC_Loc060_PhiVnce 9;
BA_ "GenSigSendType" SG_ 430 RFC_Loc060_DrVrCoVnce 9;
BA_ "GenSigStartValue" SG_ 430 RFC_Loc060_DrVrCoVnce 32768;
BA_ "GenSigSendType" SG_ 430 RFC_Loc060_RCS 9;
BA_ "GenSigStartValue" SG_ 430 RFC_Loc060_RCS 32768;
BA_ "GenSigSendType" SG_ 430 RFC_Loc060_RSSI 9;
BA_ "GenSigSendType" SG_ 430 RFC_Loc060_DrVrQuality 9;
BA_ "GenSigSendType" SG_ 430 RFC_Loc060_ThetaQuality 9;
BA_ "GenSigSendType" SG_ 430 RFC_Loc060_PhiQuality 9;
BA_ "GenSigSendType" SG_ 430 RFC_Loc061_Dr 9;
BA_ "GenSigSendType" SG_ 430 RFC_Loc061_Vr 9;
BA_ "GenSigStartValue" SG_ 430 RFC_Loc061_Vr 32768;
BA_ "GenSigSendType" SG_ 430 RFC_Loc061_Theta 9;
BA_ "GenSigStartValue" SG_ 430 RFC_Loc061_Theta 32768;
BA_ "GenSigSendType" SG_ 430 RFC_Loc061_Phi 9;
BA_ "GenSigStartValue" SG_ 430 RFC_Loc061_Phi 32768;
BA_ "GenSigSendType" SG_ 430 RFC_Loc061_DrVnce 9;
BA_ "GenSigSendType" SG_ 430 RFC_Loc061_VrVnce 9;
BA_ "GenSigSendType" SG_ 430 RFC_Loc061_ThetaVnce 9;
BA_ "GenSigSendType" SG_ 430 RFC_Loc061_PhiVnce 9;
BA_ "GenSigSendType" SG_ 430 RFC_Loc061_DrVrCoVnce 9;
BA_ "GenSigStartValue" SG_ 430 RFC_Loc061_DrVrCoVnce 32768;
BA_ "GenSigSendType" SG_ 430 RFC_Loc061_RCS 9;
BA_ "GenSigStartValue" SG_ 430 RFC_Loc061_RCS 32768;
BA_ "GenSigSendType" SG_ 430 RFC_Loc061_RSSI 9;
BA_ "GenSigSendType" SG_ 430 RFC_Loc061_DrVrQuality 9;
BA_ "GenSigSendType" SG_ 430 RFC_Loc061_ThetaQuality 9;
BA_ "GenSigSendType" SG_ 430 RFC_Loc061_PhiQuality 9;
BA_ "GenSigSendType" SG_ 431 RFC_Loc062_CRC 9;
BA_ "GenSigSendType" SG_ 431 RFC_Loc062_AliveCtr 9;
BA_ "GenSigSendType" SG_ 431 RFC_Loc062_ProtBlockCtr 9;
BA_ "GenSigSendType" SG_ 431 RFC_Loc062_Dr 9;
BA_ "GenSigSendType" SG_ 431 RFC_Loc062_Vr 9;
BA_ "GenSigStartValue" SG_ 431 RFC_Loc062_Vr 32768;
BA_ "GenSigSendType" SG_ 431 RFC_Loc062_Theta 9;
BA_ "GenSigStartValue" SG_ 431 RFC_Loc062_Theta 32768;
BA_ "GenSigSendType" SG_ 431 RFC_Loc062_Phi 9;
BA_ "GenSigStartValue" SG_ 431 RFC_Loc062_Phi 32768;
BA_ "GenSigSendType" SG_ 431 RFC_Loc062_DrVnce 9;
BA_ "GenSigSendType" SG_ 431 RFC_Loc062_VrVnce 9;
BA_ "GenSigSendType" SG_ 431 RFC_Loc062_ThetaVnce 9;
BA_ "GenSigSendType" SG_ 431 RFC_Loc062_PhiVnce 9;
BA_ "GenSigSendType" SG_ 431 RFC_Loc062_DrVrCoVnce 9;
BA_ "GenSigStartValue" SG_ 431 RFC_Loc062_DrVrCoVnce 32768;
BA_ "GenSigSendType" SG_ 431 RFC_Loc062_RCS 9;
BA_ "GenSigStartValue" SG_ 431 RFC_Loc062_RCS 32768;
BA_ "GenSigSendType" SG_ 431 RFC_Loc062_RSSI 9;
BA_ "GenSigSendType" SG_ 431 RFC_Loc062_DrVrQuality 9;
BA_ "GenSigSendType" SG_ 431 RFC_Loc062_ThetaQuality 9;
BA_ "GenSigSendType" SG_ 431 RFC_Loc062_PhiQuality 9;
BA_ "GenSigSendType" SG_ 431 RFC_Loc063_Dr 9;
BA_ "GenSigSendType" SG_ 431 RFC_Loc063_Vr 9;
BA_ "GenSigStartValue" SG_ 431 RFC_Loc063_Vr 32768;
BA_ "GenSigSendType" SG_ 431 RFC_Loc063_Theta 9;
BA_ "GenSigStartValue" SG_ 431 RFC_Loc063_Theta 32768;
BA_ "GenSigSendType" SG_ 431 RFC_Loc063_Phi 9;
BA_ "GenSigStartValue" SG_ 431 RFC_Loc063_Phi 32768;
BA_ "GenSigSendType" SG_ 431 RFC_Loc063_DrVnce 9;
BA_ "GenSigSendType" SG_ 431 RFC_Loc063_VrVnce 9;
BA_ "GenSigSendType" SG_ 431 RFC_Loc063_ThetaVnce 9;
BA_ "GenSigSendType" SG_ 431 RFC_Loc063_PhiVnce 9;
BA_ "GenSigSendType" SG_ 431 RFC_Loc063_DrVrCoVnce 9;
BA_ "GenSigStartValue" SG_ 431 RFC_Loc063_DrVrCoVnce 32768;
BA_ "GenSigSendType" SG_ 431 RFC_Loc063_RCS 9;
BA_ "GenSigStartValue" SG_ 431 RFC_Loc063_RCS 32768;
BA_ "GenSigSendType" SG_ 431 RFC_Loc063_RSSI 9;
BA_ "GenSigSendType" SG_ 431 RFC_Loc063_DrVrQuality 9;
BA_ "GenSigSendType" SG_ 431 RFC_Loc063_ThetaQuality 9;
BA_ "GenSigSendType" SG_ 431 RFC_Loc063_PhiQuality 9;
BA_ "GenSigSendType" SG_ 432 RFC_Loc064_CRC 9;
BA_ "GenSigSendType" SG_ 432 RFC_Loc064_AliveCtr 9;
BA_ "GenSigSendType" SG_ 432 RFC_Loc064_ProtBlockCtr 9;
BA_ "GenSigSendType" SG_ 432 RFC_Loc064_Dr 9;
BA_ "GenSigSendType" SG_ 432 RFC_Loc064_Vr 9;
BA_ "GenSigStartValue" SG_ 432 RFC_Loc064_Vr 32768;
BA_ "GenSigSendType" SG_ 432 RFC_Loc064_Theta 9;
BA_ "GenSigStartValue" SG_ 432 RFC_Loc064_Theta 32768;
BA_ "GenSigSendType" SG_ 432 RFC_Loc064_Phi 9;
BA_ "GenSigStartValue" SG_ 432 RFC_Loc064_Phi 32768;
BA_ "GenSigSendType" SG_ 432 RFC_Loc064_DrVnce 9;
BA_ "GenSigSendType" SG_ 432 RFC_Loc064_VrVnce 9;
BA_ "GenSigSendType" SG_ 432 RFC_Loc064_ThetaVnce 9;
BA_ "GenSigSendType" SG_ 432 RFC_Loc064_PhiVnce 9;
BA_ "GenSigSendType" SG_ 432 RFC_Loc064_DrVrCoVnce 9;
BA_ "GenSigStartValue" SG_ 432 RFC_Loc064_DrVrCoVnce 32768;
BA_ "GenSigSendType" SG_ 432 RFC_Loc064_RCS 9;
BA_ "GenSigStartValue" SG_ 432 RFC_Loc064_RCS 32768;
BA_ "GenSigSendType" SG_ 432 RFC_Loc064_RSSI 9;
BA_ "GenSigSendType" SG_ 432 RFC_Loc064_DrVrQuality 9;
BA_ "GenSigSendType" SG_ 432 RFC_Loc064_ThetaQuality 9;
BA_ "GenSigSendType" SG_ 432 RFC_Loc064_PhiQuality 9;
BA_ "GenSigSendType" SG_ 432 RFC_Loc065_Dr 9;
BA_ "GenSigSendType" SG_ 432 RFC_Loc065_Vr 9;
BA_ "GenSigStartValue" SG_ 432 RFC_Loc065_Vr 32768;
BA_ "GenSigSendType" SG_ 432 RFC_Loc065_Theta 9;
BA_ "GenSigStartValue" SG_ 432 RFC_Loc065_Theta 32768;
BA_ "GenSigSendType" SG_ 432 RFC_Loc065_Phi 9;
BA_ "GenSigStartValue" SG_ 432 RFC_Loc065_Phi 32768;
BA_ "GenSigSendType" SG_ 432 RFC_Loc065_DrVnce 9;
BA_ "GenSigSendType" SG_ 432 RFC_Loc065_VrVnce 9;
BA_ "GenSigSendType" SG_ 432 RFC_Loc065_ThetaVnce 9;
BA_ "GenSigSendType" SG_ 432 RFC_Loc065_PhiVnce 9;
BA_ "GenSigSendType" SG_ 432 RFC_Loc065_DrVrCoVnce 9;
BA_ "GenSigStartValue" SG_ 432 RFC_Loc065_DrVrCoVnce 32768;
BA_ "GenSigSendType" SG_ 432 RFC_Loc065_RCS 9;
BA_ "GenSigStartValue" SG_ 432 RFC_Loc065_RCS 32768;
BA_ "GenSigSendType" SG_ 432 RFC_Loc065_RSSI 9;
BA_ "GenSigSendType" SG_ 432 RFC_Loc065_DrVrQuality 9;
BA_ "GenSigSendType" SG_ 432 RFC_Loc065_ThetaQuality 9;
BA_ "GenSigSendType" SG_ 432 RFC_Loc065_PhiQuality 9;
BA_ "GenSigSendType" SG_ 433 RFC_Loc066_CRC 9;
BA_ "GenSigSendType" SG_ 433 RFC_Loc066_AliveCtr 9;
BA_ "GenSigSendType" SG_ 433 RFC_Loc066_ProtBlockCtr 9;
BA_ "GenSigSendType" SG_ 433 RFC_Loc066_Dr 9;
BA_ "GenSigSendType" SG_ 433 RFC_Loc066_Vr 9;
BA_ "GenSigStartValue" SG_ 433 RFC_Loc066_Vr 32768;
BA_ "GenSigSendType" SG_ 433 RFC_Loc066_Theta 9;
BA_ "GenSigStartValue" SG_ 433 RFC_Loc066_Theta 32768;
BA_ "GenSigSendType" SG_ 433 RFC_Loc066_Phi 9;
BA_ "GenSigStartValue" SG_ 433 RFC_Loc066_Phi 32768;
BA_ "GenSigSendType" SG_ 433 RFC_Loc066_DrVnce 9;
BA_ "GenSigSendType" SG_ 433 RFC_Loc066_VrVnce 9;
BA_ "GenSigSendType" SG_ 433 RFC_Loc066_ThetaVnce 9;
BA_ "GenSigSendType" SG_ 433 RFC_Loc066_PhiVnce 9;
BA_ "GenSigSendType" SG_ 433 RFC_Loc066_DrVrCoVnce 9;
BA_ "GenSigStartValue" SG_ 433 RFC_Loc066_DrVrCoVnce 32768;
BA_ "GenSigSendType" SG_ 433 RFC_Loc066_RCS 9;
BA_ "GenSigStartValue" SG_ 433 RFC_Loc066_RCS 32768;
BA_ "GenSigSendType" SG_ 433 RFC_Loc066_RSSI 9;
BA_ "GenSigSendType" SG_ 433 RFC_Loc066_DrVrQuality 9;
BA_ "GenSigSendType" SG_ 433 RFC_Loc066_ThetaQuality 9;
BA_ "GenSigSendType" SG_ 433 RFC_Loc066_PhiQuality 9;
BA_ "GenSigSendType" SG_ 433 RFC_Loc067_Dr 9;
BA_ "GenSigSendType" SG_ 433 RFC_Loc067_Vr 9;
BA_ "GenSigStartValue" SG_ 433 RFC_Loc067_Vr 32768;
BA_ "GenSigSendType" SG_ 433 RFC_Loc067_Theta 9;
BA_ "GenSigStartValue" SG_ 433 RFC_Loc067_Theta 32768;
BA_ "GenSigSendType" SG_ 433 RFC_Loc067_Phi 9;
BA_ "GenSigStartValue" SG_ 433 RFC_Loc067_Phi 32768;
BA_ "GenSigSendType" SG_ 433 RFC_Loc067_DrVnce 9;
BA_ "GenSigSendType" SG_ 433 RFC_Loc067_VrVnce 9;
BA_ "GenSigSendType" SG_ 433 RFC_Loc067_ThetaVnce 9;
BA_ "GenSigSendType" SG_ 433 RFC_Loc067_PhiVnce 9;
BA_ "GenSigSendType" SG_ 433 RFC_Loc067_DrVrCoVnce 9;
BA_ "GenSigStartValue" SG_ 433 RFC_Loc067_DrVrCoVnce 32768;
BA_ "GenSigSendType" SG_ 433 RFC_Loc067_RCS 9;
BA_ "GenSigStartValue" SG_ 433 RFC_Loc067_RCS 32768;
BA_ "GenSigSendType" SG_ 433 RFC_Loc067_RSSI 9;
BA_ "GenSigSendType" SG_ 433 RFC_Loc067_DrVrQuality 9;
BA_ "GenSigSendType" SG_ 433 RFC_Loc067_ThetaQuality 9;
BA_ "GenSigSendType" SG_ 433 RFC_Loc067_PhiQuality 9;
BA_ "GenSigSendType" SG_ 434 RFC_Loc068_CRC 9;
BA_ "GenSigSendType" SG_ 434 RFC_Loc068_AliveCtr 9;
BA_ "GenSigSendType" SG_ 434 RFC_Loc068_ProtBlockCtr 9;
BA_ "GenSigSendType" SG_ 434 RFC_Loc068_Dr 9;
BA_ "GenSigSendType" SG_ 434 RFC_Loc068_Vr 9;
BA_ "GenSigStartValue" SG_ 434 RFC_Loc068_Vr 32768;
BA_ "GenSigSendType" SG_ 434 RFC_Loc068_Theta 9;
BA_ "GenSigStartValue" SG_ 434 RFC_Loc068_Theta 32768;
BA_ "GenSigSendType" SG_ 434 RFC_Loc068_Phi 9;
BA_ "GenSigStartValue" SG_ 434 RFC_Loc068_Phi 32768;
BA_ "GenSigSendType" SG_ 434 RFC_Loc068_DrVnce 9;
BA_ "GenSigSendType" SG_ 434 RFC_Loc068_VrVnce 9;
BA_ "GenSigSendType" SG_ 434 RFC_Loc068_ThetaVnce 9;
BA_ "GenSigSendType" SG_ 434 RFC_Loc068_PhiVnce 9;
BA_ "GenSigSendType" SG_ 434 RFC_Loc068_DrVrCoVnce 9;
BA_ "GenSigStartValue" SG_ 434 RFC_Loc068_DrVrCoVnce 32768;
BA_ "GenSigSendType" SG_ 434 RFC_Loc068_RCS 9;
BA_ "GenSigStartValue" SG_ 434 RFC_Loc068_RCS 32768;
BA_ "GenSigSendType" SG_ 434 RFC_Loc068_RSSI 9;
BA_ "GenSigSendType" SG_ 434 RFC_Loc068_DrVrQuality 9;
BA_ "GenSigSendType" SG_ 434 RFC_Loc068_ThetaQuality 9;
BA_ "GenSigSendType" SG_ 434 RFC_Loc068_PhiQuality 9;
BA_ "GenSigSendType" SG_ 434 RFC_Loc069_Dr 9;
BA_ "GenSigSendType" SG_ 434 RFC_Loc069_Vr 9;
BA_ "GenSigStartValue" SG_ 434 RFC_Loc069_Vr 32768;
BA_ "GenSigSendType" SG_ 434 RFC_Loc069_Theta 9;
BA_ "GenSigStartValue" SG_ 434 RFC_Loc069_Theta 32768;
BA_ "GenSigSendType" SG_ 434 RFC_Loc069_Phi 9;
BA_ "GenSigStartValue" SG_ 434 RFC_Loc069_Phi 32768;
BA_ "GenSigSendType" SG_ 434 RFC_Loc069_DrVnce 9;
BA_ "GenSigSendType" SG_ 434 RFC_Loc069_VrVnce 9;
BA_ "GenSigSendType" SG_ 434 RFC_Loc069_ThetaVnce 9;
BA_ "GenSigSendType" SG_ 434 RFC_Loc069_PhiVnce 9;
BA_ "GenSigSendType" SG_ 434 RFC_Loc069_DrVrCoVnce 9;
BA_ "GenSigStartValue" SG_ 434 RFC_Loc069_DrVrCoVnce 32768;
BA_ "GenSigSendType" SG_ 434 RFC_Loc069_RCS 9;
BA_ "GenSigStartValue" SG_ 434 RFC_Loc069_RCS 32768;
BA_ "GenSigSendType" SG_ 434 RFC_Loc069_RSSI 9;
BA_ "GenSigSendType" SG_ 434 RFC_Loc069_DrVrQuality 9;
BA_ "GenSigSendType" SG_ 434 RFC_Loc069_ThetaQuality 9;
BA_ "GenSigSendType" SG_ 434 RFC_Loc069_PhiQuality 9;
