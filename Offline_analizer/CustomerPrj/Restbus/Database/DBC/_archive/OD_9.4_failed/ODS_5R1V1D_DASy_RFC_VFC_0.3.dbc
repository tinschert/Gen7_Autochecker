VERSION "created by canmatrix"

NS_ :

BS_:

BU_: RadarFrontCenter DASy MPC3

BO_ 80 VFC_GlobalHdr: 32 MPC3
 SG_ VFC_GlobalHdr_CRC : 0|16@1+ (1,0) [0|65535] ""  DASy,RadarFrontCenter
 SG_ VFC_GlobalHdr_AliveCtr : 16|8@1+ (1,0) [0|255] ""  DASy,RadarFrontCenter
 SG_ VFC_GlobalHdr_SensorState : 24|3@1+ (1,0) [0|7] ""  DASy,RadarFrontCenter
 SG_ VFC_GlobalHdr_CalibState : 27|3@1+ (1,0) [0|7] ""  DASy,RadarFrontCenter
 SG_ VFC_GlobalHdr_ProtocolVersion : 64|16@1+ (1,0) [0|65535] ""  DASy,RadarFrontCenter
 SG_ VFC_GlobalHdr_TimeStampStatus : 56|8@1+ (1,0) [0|255] ""  DASy,RadarFrontCenter
 SG_ VFC_GlobalHdr_TimeStamp : 30|26@1+ (1,0) [0|67108863] "ms"  DASy,RadarFrontCenter
 SG_ VFC_GlobalHdr_SwVersion : 96|20@1+ (0.01,0) [0|9999.99] ""  DASy,RadarFrontCenter
 SG_ VFC_GlobalHdr_FrameNumber : 80|16@1+ (1,0) [0|65535] ""  DASy,RadarFrontCenter
 SG_ VFC_GlobalHdr_MountPosX : 128|13@1+ (0.001,-4.096) [-4.096|4.095] "m"  DASy,RadarFrontCenter
 SG_ VFC_GlobalHdr_MountPosY : 116|12@1+ (0.001,-2.048) [-2.048|2.047] "m"  DASy,RadarFrontCenter
 SG_ VFC_GlobalHdr_MountPosZ : 141|13@1+ (0.001,0) [0|5] "m"  DASy,RadarFrontCenter
 SG_ VFC_GlobalHdr_CalibYawAngle : 154|10@1+ (0.0005,-0.256) [-0.256|0.2555] "rad"  DASy,RadarFrontCenter
 SG_ VFC_GlobalHdr_CalibPitchAngle : 164|10@1+ (0.0005,-0.256) [-0.256|0.2555] "rad"  DASy,RadarFrontCenter
 SG_ VFC_GlobalHdr_CalibRollAngle : 174|10@1+ (0.0005,-0.256) [-0.256|0.2555] "rad"  DASy,RadarFrontCenter
  SG_ VFC_GlobalHdr_CalYawAngStdDev : 192|9@1+ (0.0005,0) [0|0.2555] "rad"  DASy,RadarFrontCenter
 SG_ VFC_GlobalHdr_CalPitchAngStdDev : 201|9@1+ (0.0005,0) [0|0.2555] "rad"  DASy,RadarFrontCenter
 SG_ VFC_GlobalHdr_CalRollAngStdDev : 210|9@1+ (0.0005,0) [0|0.2555] "rad"  DASy,RadarFrontCenter
 SG_ VFC_GlobalHdr_FV : 231|8@0+ (1,0) [0|255] ""  DASy,RadarFrontCenter
 SG_ VFC_GlobalHdr_MAC : 239|24@0+ (1,0) [0|16777215] ""  DASy,RadarFrontCenter

BO_ 96 VFC_ObjectHdr: 32 MPC3
 SG_ VFC_ObjHdr_CRC : 0|16@1+ (1,0) [0|65535] ""  DASy
 SG_ VFC_ObjHdr_AliveCtr : 16|8@1+ (1,0) [0|255] ""  DASy
 SG_ VFC_ObjHdr_ProtBlockCtr : 24|4@1+ (1,0) [0|15] ""  DASy
  SG_ VFC_ObjHdr_ProtObjCount : 28|6@1+ (1,0) [0|32] ""  DASy
 SG_ VFC_ObjHdr_State : 34|3@1+ (1,0) [0|7] ""  DASy
 SG_ VFC_ObjHdr_TimeStampStatus : 37|8@1+ (1,0) [0|255] ""  DASy
 SG_ VFC_ObjHdr_TimeStamp : 45|26@1+ (1,0) [0|67108863] "ms"  DASy
 SG_ VFC_ObjHdr_FV : 231|8@0+ (1,0) [0|255] ""  DASy
 SG_ VFC_ObjHdr_MAC : 239|24@0+ (1,0) [0|16777215] ""  DASy
 SG_ VFC_ObjHdr_Principal_Point_U : 72|11@1+ (1,0) [0|2047] ""  DASy
 SG_ VFC_ObjHdr_Principal_Point_V : 88|10@1+ (1,0) [0|1023] ""  DASy
 SG_ VFC_ObjHdr_Focal_Length_X : 104|8@1+ (1,1572) [1572|1827] ""  DASy
 SG_ VFC_ObjHdr_Focal_Length_Y : 112|8@1+ (1,1572) [1572|1827] ""  DASy

BO_ 98 VFC_Object00A: 64 MPC3
 SG_ VFC_Obj00A_CRC : 0|16@1+ (1,0) [0|65535] ""  DASy
 SG_ VFC_Obj00A_AliveCtr : 16|8@1+ (1,0) [0|255] ""  DASy
 SG_ VFC_Obj00A_ProtBlockCtr : 24|4@1+ (1,0) [0|15] ""  DASy
 SG_ VFC_Obj00A_ID : 32|8@1+ (1,0) [1|255] ""  DASy
 SG_ VFC_Obj00A_Type : 60|4@1+ (1,0) [0|15] ""  DASy
 SG_ VFC_Obj00A_TypeProb : 378|6@1+ (2,0) [0|100] "%"  DASy
 SG_ VFC_Obj00A_Dx : 48|12@1+ (0.05,0) [0|204.75] "m"  DASy
 SG_ VFC_Obj00A_Dy : 64|14@1+ (0.01,-80) [-80|80] "m"  DASy
 SG_ VFC_Obj00A_Vx : 80|11@1+ (0.1,-154) [-154|50] "m/s"  DASy
 SG_ VFC_Obj00A_Vy : 96|10@1+ (0.1,-50) [-50|50] "m/s"  DASy
 SG_ VFC_Obj00A_Ax : 112|9@1+ (0.1,-16) [-16|16] "m/s^2"  DASy
 SG_ VFC_Obj00A_Ay : 128|8@1+ (0.1,-12) [-12|12] "m/s^2"  DASy
 SG_ VFC_Obj00A_DxStdDev : 144|10@1+ (0.05,0) [0|51.15] "m"  DASy
 SG_ VFC_Obj00A_DyStdDev : 160|10@1+ (0.02,0) [0|20.46] "m"  DASy
 SG_ VFC_Obj00A_VxStdDev : 176|10@1+ (0.1,0) [0|102.3] "m/s"  DASy
 SG_ VFC_Obj00A_VyStdDev : 192|9@1+ (0.1,0) [0|51.1] "m/s"  DASy
 SG_ VFC_Obj00A_AxStdDev : 40|8@1+ (0.1,0) [0|25.5] "m/s^2"  DASy
 SG_ VFC_Obj00A_AyStdDev : 136|8@1+ (0.1,0) [0|25.5] "m/s^2"  DASy
 SG_ VFC_Obj00A_Length : 217|9@1+ (0.05,0) [0|25.55] "m"  DASy
 SG_ VFC_Obj00A_Width : 294|10@1+ (0.01,0) [0|10.23] "m"  DASy
 SG_ VFC_Obj00A_Height : 208|9@1+ (0.01,0) [0|5.11] "m"  DASy
 SG_ VFC_Obj00A_LengthStdDev : 384|7@1+ (0.05,0) [0|5] "m"  DASy
 SG_ VFC_Obj00A_WidthStdDev : 391|7@1+ (0.01,0) [0|1] "m"  DASy
 SG_ VFC_Obj00A_HeightStdDev : 201|7@1+ (0.01,0) [0|1] "m"  DASy
 SG_ VFC_Obj00A_EdgeLeft : 411|13@1+ (0.00025,-1) [-1|1] "unitless"  DASy
 SG_ VFC_Obj00A_EdgeMid : 398|13@1+ (0.00025,-1) [-1|1] "unitless"  DASy
 SG_ VFC_Obj00A_EdgeRight : 424|13@1+ (0.00025,-1) [-1|1] "unitless"  DASy
 SG_ VFC_Obj00A_EdgeTop : 448|12@1+ (0.00025,-0.5) [-0.5|0.5] "unitless"  DASy
 SG_ VFC_Obj00A_EdgeBottom : 269|12@1+ (0.00025,-0.5) [-0.5|0.5] "unitless"  DASy
 SG_ VFC_Obj00A_EdgeLeftStdDev : 440|8@1+ (0.0002,0) [0|0.051] "unitless"  DASy
 SG_ VFC_Obj00A_EdgeMidStdDev : 464|8@1+ (0.0002,0) [0|0.051] "unitless"  DASy
 SG_ VFC_Obj00A_EdgeRightStdDev : 472|8@1+ (0.0002,0) [0|0.051] "unitless"  DASy
 SG_ VFC_Obj00A_EdgeTopStdDev : 480|8@1+ (0.0002,0) [0|0.051] "unitless"  DASy
 SG_ VFC_Obj00A_EdgeBottomStdDev : 488|8@1+ (0.0002,0) [0|0.051] "unitless"  DASy
 SG_ VFC_Obj00A_NormVx : 304|16@1+ (0.001,-40) [-40|25] "1/s"  DASy
 SG_ VFC_Obj00A_NormAx : 235|13@1+ (0.002,-10) [-10|6] "1/s^2"  DASy
 SG_ VFC_Obj00A_NormVyEdgeLeft : 256|13@1+ (0.001,-4) [-4|4] "1/s"  DASy
 SG_ VFC_Obj00A_NormVyEdgeRight : 281|13@1+ (0.001,-4) [-4|4] "1/s"  DASy
 SG_ VFC_Obj00A_NormVxStdDev : 368|10@1+ (0.001,0) [0|1.023] "1/s"  DASy
 SG_ VFC_Obj00A_NormAxStdDev : 328|10@1+ (0.0025,0) [0|2.5575] "1/s^2"  DASy
 SG_ VFC_Obj00A_NormVyEdgeLeftStdDev : 248|8@1+ (0.001,0) [0|0.255] "1/s"  DASy
 SG_ VFC_Obj00A_NormVyEdgeRightStdDev : 320|8@1+ (0.001,0) [0|0.255] "1/s"  DASy
 SG_ VFC_Obj00A_ScaleChange : 338|14@1+ (0.0001,0.5) [0.5|2.1383] "unitless"  DASy
 SG_ VFC_Obj00A_ScaleChngStdDev : 352|10@1+ (0.0001,0) [0|0.1023] "unitless"  DASy
 SG_ VFC_Obj00A_HeadingAngle : 226|9@1+ (0.01,-1.57) [-1.57|1.57] "rad"  DASy
 SG_ VFC_Obj00A_HeadingAngleStdDev : 186|6@1+ (0.01,0) [0|0.5] "rad"  DASy
 SG_ VFC_Obj00A_HeadOrientation : 460|4@1+ (1,0) [0|15] ""  DASy
 SG_ VFC_Obj00A_CompletelyInImg : 121|1@1+ (1,0) [0|1] ""  DASy
 SG_ VFC_Obj00A_ProbMovingLat : 154|6@1+ (2,0) [0|100] "%"  DASy
 SG_ VFC_Obj00A_ProbMovingLong : 170|6@1+ (2,0) [0|100] "%"  DASy
 SG_ VFC_Obj00A_ProbExist : 122|6@1+ (2,0) [0|100] "%"  DASy
 SG_ VFC_Obj00A_MeasSource : 91|5@1+ (1,0) [0|31] ""  DASy
 SG_ VFC_Obj00A_Reliability : 362|6@1+ (1,0) [0|63] ""  DASy
 SG_ VFC_Obj00A_Measured : 78|2@1+ (1,0) [0|3] ""  DASy
 SG_ VFC_Obj00A_VisibleView : 437|3@1+ (1,0) [0|4] ""  DASy
 SG_ VFC_Obj00A_ClassifiedView : 496|3@1+ (1,0) [0|4] ""  DASy
 SG_ VFC_Obj00A_DirIndicator : 106|3@1+ (1,0) [0|4] ""  DASy
 SG_ VFC_Obj00A_BrakeLight : 109|3@1+ (1,0) [0|7] ""  DASy

BO_ 100 VFC_Object01A: 64 MPC3
 SG_ VFC_Obj01A_CRC : 0|16@1+ (1,0) [0|65535] ""  DASy
 SG_ VFC_Obj01A_AliveCtr : 16|8@1+ (1,0) [0|255] ""  DASy
 SG_ VFC_Obj01A_ProtBlockCtr : 24|4@1+ (1,0) [0|15] ""  DASy
 SG_ VFC_Obj01A_ID : 32|8@1+ (1,0) [1|255] ""  DASy
 SG_ VFC_Obj01A_Type : 60|4@1+ (1,0) [0|15] ""  DASy
 SG_ VFC_Obj01A_TypeProb : 378|6@1+ (2,0) [0|100] "%"  DASy
 SG_ VFC_Obj01A_Dx : 48|12@1+ (0.05,0) [0|204.75] "m"  DASy
 SG_ VFC_Obj01A_Dy : 64|14@1+ (0.01,-80) [-80|80] "m"  DASy
 SG_ VFC_Obj01A_Vx : 80|11@1+ (0.1,-154) [-154|50] "m/s"  DASy
 SG_ VFC_Obj01A_Vy : 96|10@1+ (0.1,-50) [-50|50] "m/s"  DASy
 SG_ VFC_Obj01A_Ax : 112|9@1+ (0.1,-16) [-16|16] "m/s^2"  DASy
 SG_ VFC_Obj01A_Ay : 128|8@1+ (0.1,-12) [-12|12] "m/s^2"  DASy
 SG_ VFC_Obj01A_DxStdDev : 144|10@1+ (0.05,0) [0|51.15] "m"  DASy
 SG_ VFC_Obj01A_DyStdDev : 160|10@1+ (0.02,0) [0|20.46] "m"  DASy
 SG_ VFC_Obj01A_VxStdDev : 176|10@1+ (0.1,0) [0|102.3] "m/s"  DASy
 SG_ VFC_Obj01A_VyStdDev : 192|9@1+ (0.1,0) [0|51.1] "m/s"  DASy
 SG_ VFC_Obj01A_AxStdDev : 40|8@1+ (0.1,0) [0|25.5] "m/s^2"  DASy
 SG_ VFC_Obj01A_AyStdDev : 136|8@1+ (0.1,0) [0|25.5] "m/s^2"  DASy
 SG_ VFC_Obj01A_Length : 217|9@1+ (0.05,0) [0|25.55] "m"  DASy
 SG_ VFC_Obj01A_Width : 294|10@1+ (0.01,0) [0|10.23] "m"  DASy
 SG_ VFC_Obj01A_Height : 208|9@1+ (0.01,0) [0|5.11] "m"  DASy
 SG_ VFC_Obj01A_LengthStdDev : 384|7@1+ (0.05,0) [0|5] "m"  DASy
 SG_ VFC_Obj01A_WidthStdDev : 391|7@1+ (0.01,0) [0|1] "m"  DASy
 SG_ VFC_Obj01A_HeightStdDev : 201|7@1+ (0.01,0) [0|1] "m"  DASy
 SG_ VFC_Obj01A_EdgeLeft : 411|13@1+ (0.00025,-1) [-1|1] "unitless"  DASy
 SG_ VFC_Obj01A_EdgeMid : 398|13@1+ (0.00025,-1) [-1|1] "unitless"  DASy
 SG_ VFC_Obj01A_EdgeRight : 424|13@1+ (0.00025,-1) [-1|1] "unitless"  DASy
 SG_ VFC_Obj01A_EdgeTop : 448|12@1+ (0.00025,-0.5) [-0.5|0.5] "unitless"  DASy
 SG_ VFC_Obj01A_EdgeBottom : 269|12@1+ (0.00025,-0.5) [-0.5|0.5] "unitless"  DASy
 SG_ VFC_Obj01A_EdgeLeftStdDev : 440|8@1+ (0.0002,0) [0|0.051] "unitless"  DASy
 SG_ VFC_Obj01A_EdgeMidStdDev : 464|8@1+ (0.0002,0) [0|0.051] "unitless"  DASy
 SG_ VFC_Obj01A_EdgeRightStdDev : 472|8@1+ (0.0002,0) [0|0.051] "unitless"  DASy
 SG_ VFC_Obj01A_EdgeTopStdDev : 480|8@1+ (0.0002,0) [0|0.051] "unitless"  DASy
 SG_ VFC_Obj01A_EdgeBottomStdDev : 488|8@1+ (0.0002,0) [0|0.051] "unitless"  DASy
 SG_ VFC_Obj01A_NormVx : 304|16@1+ (0.001,-40) [-40|25] "1/s"  DASy
 SG_ VFC_Obj01A_NormAx : 235|13@1+ (0.002,-10) [-10|6] "1/s^2"  DASy
 SG_ VFC_Obj01A_NormVyEdgeLeft : 256|13@1+ (0.001,-4) [-4|4] "1/s"  DASy
 SG_ VFC_Obj01A_NormVyEdgeRight : 281|13@1+ (0.001,-4) [-4|4] "1/s"  DASy
 SG_ VFC_Obj01A_NormVxStdDev : 368|10@1+ (0.001,0) [0|1.023] "1/s"  DASy
 SG_ VFC_Obj01A_NormAxStdDev : 328|10@1+ (0.0025,0) [0|2.5575] "1/s^2"  DASy
 SG_ VFC_Obj01A_NormVyEdgeLeftStdDev : 248|8@1+ (0.001,0) [0|0.255] "1/s"  DASy
 SG_ VFC_Obj01A_NormVyEdgeRightStdDev : 320|8@1+ (0.001,0) [0|0.255] "1/s"  DASy
 SG_ VFC_Obj01A_ScaleChange : 338|14@1+ (0.0001,0.5) [0.5|2.1383] "unitless"  DASy
 SG_ VFC_Obj01A_ScaleChngStdDev : 352|10@1+ (0.0001,0) [0|0.1023] "unitless"  DASy
 SG_ VFC_Obj01A_HeadingAngle : 226|9@1+ (0.01,-1.57) [-1.57|1.57] "rad"  DASy
 SG_ VFC_Obj01A_HeadingAngleStdDev : 186|6@1+ (0.01,0) [0|0.5] "rad"  DASy
 SG_ VFC_Obj01A_HeadOrientation : 460|4@1+ (1,0) [0|15] ""  DASy
 SG_ VFC_Obj01A_CompletelyInImg : 121|1@1+ (1,0) [0|1] ""  DASy
 SG_ VFC_Obj01A_ProbMovingLat : 154|6@1+ (2,0) [0|100] "%"  DASy
 SG_ VFC_Obj01A_ProbMovingLong : 170|6@1+ (2,0) [0|100] "%"  DASy
 SG_ VFC_Obj01A_ProbExist : 122|6@1+ (2,0) [0|100] "%"  DASy
 SG_ VFC_Obj01A_MeasSource : 91|5@1+ (1,0) [0|31] ""  DASy
 SG_ VFC_Obj01A_Reliability : 362|6@1+ (1,0) [0|63] ""  DASy
 SG_ VFC_Obj01A_Measured : 78|2@1+ (1,0) [0|3] ""  DASy
 SG_ VFC_Obj01A_VisibleView : 437|3@1+ (1,0) [0|4] ""  DASy
 SG_ VFC_Obj01A_ClassifiedView : 496|3@1+ (1,0) [0|4] ""  DASy
 SG_ VFC_Obj01A_DirIndicator : 106|3@1+ (1,0) [0|4] ""  DASy
 SG_ VFC_Obj01A_BrakeLight : 109|3@1+ (1,0) [0|7] ""  DASy

BO_ 102 VFC_Object02A: 64 MPC3
 SG_ VFC_Obj02A_CRC : 0|16@1+ (1,0) [0|65535] ""  DASy
 SG_ VFC_Obj02A_AliveCtr : 16|8@1+ (1,0) [0|255] ""  DASy
 SG_ VFC_Obj02A_ProtBlockCtr : 24|4@1+ (1,0) [0|15] ""  DASy
 SG_ VFC_Obj02A_ID : 32|8@1+ (1,0) [1|255] ""  DASy
 SG_ VFC_Obj02A_Type : 60|4@1+ (1,0) [0|15] ""  DASy
 SG_ VFC_Obj02A_TypeProb : 378|6@1+ (2,0) [0|100] "%"  DASy
 SG_ VFC_Obj02A_Dx : 48|12@1+ (0.05,0) [0|204.75] "m"  DASy
 SG_ VFC_Obj02A_Dy : 64|14@1+ (0.01,-80) [-80|80] "m"  DASy
 SG_ VFC_Obj02A_Vx : 80|11@1+ (0.1,-154) [-154|50] "m/s"  DASy
 SG_ VFC_Obj02A_Vy : 96|10@1+ (0.1,-50) [-50|50] "m/s"  DASy
 SG_ VFC_Obj02A_Ax : 112|9@1+ (0.1,-16) [-16|16] "m/s^2"  DASy
 SG_ VFC_Obj02A_Ay : 128|8@1+ (0.1,-12) [-12|12] "m/s^2"  DASy
 SG_ VFC_Obj02A_DxStdDev : 144|10@1+ (0.05,0) [0|51.15] "m"  DASy
 SG_ VFC_Obj02A_DyStdDev : 160|10@1+ (0.02,0) [0|20.46] "m"  DASy
 SG_ VFC_Obj02A_VxStdDev : 176|10@1+ (0.1,0) [0|102.3] "m/s"  DASy
 SG_ VFC_Obj02A_VyStdDev : 192|9@1+ (0.1,0) [0|51.1] "m/s"  DASy
 SG_ VFC_Obj02A_AxStdDev : 40|8@1+ (0.1,0) [0|25.5] "m/s^2"  DASy
 SG_ VFC_Obj02A_AyStdDev : 136|8@1+ (0.1,0) [0|25.5] "m/s^2"  DASy
 SG_ VFC_Obj02A_Length : 217|9@1+ (0.05,0) [0|25.55] "m"  DASy
 SG_ VFC_Obj02A_Width : 294|10@1+ (0.01,0) [0|10.23] "m"  DASy
 SG_ VFC_Obj02A_Height : 208|9@1+ (0.01,0) [0|5.11] "m"  DASy
 SG_ VFC_Obj02A_LengthStdDev : 384|7@1+ (0.05,0) [0|5] "m"  DASy
 SG_ VFC_Obj02A_WidthStdDev : 391|7@1+ (0.01,0) [0|1] "m"  DASy
 SG_ VFC_Obj02A_HeightStdDev : 201|7@1+ (0.01,0) [0|1] "m"  DASy
 SG_ VFC_Obj02A_EdgeLeft : 411|13@1+ (0.00025,-1) [-1|1] "unitless"  DASy
 SG_ VFC_Obj02A_EdgeMid : 398|13@1+ (0.00025,-1) [-1|1] "unitless"  DASy
 SG_ VFC_Obj02A_EdgeRight : 424|13@1+ (0.00025,-1) [-1|1] "unitless"  DASy
 SG_ VFC_Obj02A_EdgeTop : 448|12@1+ (0.00025,-0.5) [-0.5|0.5] "unitless"  DASy
 SG_ VFC_Obj02A_EdgeBottom : 269|12@1+ (0.00025,-0.5) [-0.5|0.5] "unitless"  DASy
 SG_ VFC_Obj02A_EdgeLeftStdDev : 440|8@1+ (0.0002,0) [0|0.051] "unitless"  DASy
 SG_ VFC_Obj02A_EdgeMidStdDev : 464|8@1+ (0.0002,0) [0|0.051] "unitless"  DASy
 SG_ VFC_Obj02A_EdgeRightStdDev : 472|8@1+ (0.0002,0) [0|0.051] "unitless"  DASy
 SG_ VFC_Obj02A_EdgeTopStdDev : 480|8@1+ (0.0002,0) [0|0.051] "unitless"  DASy
 SG_ VFC_Obj02A_EdgeBottomStdDev : 488|8@1+ (0.0002,0) [0|0.051] "unitless"  DASy
 SG_ VFC_Obj02A_NormVx : 304|16@1+ (0.001,-40) [-40|25] "1/s"  DASy
 SG_ VFC_Obj02A_NormAx : 235|13@1+ (0.002,-10) [-10|6] "1/s^2"  DASy
 SG_ VFC_Obj02A_NormVyEdgeLeft : 256|13@1+ (0.001,-4) [-4|4] "1/s"  DASy
 SG_ VFC_Obj02A_NormVyEdgeRight : 281|13@1+ (0.001,-4) [-4|4] "1/s"  DASy
 SG_ VFC_Obj02A_NormVxStdDev : 368|10@1+ (0.001,0) [0|1.023] "1/s"  DASy
 SG_ VFC_Obj02A_NormAxStdDev : 328|10@1+ (0.0025,0) [0|2.5575] "1/s^2"  DASy
 SG_ VFC_Obj02A_NormVyEdgeLeftStdDev : 248|8@1+ (0.001,0) [0|0.255] "1/s"  DASy
 SG_ VFC_Obj02A_NormVyEdgeRightStdDev : 320|8@1+ (0.001,0) [0|0.255] "1/s"  DASy
 SG_ VFC_Obj02A_ScaleChange : 338|14@1+ (0.0001,0.5) [0.5|2.1383] "unitless"  DASy
 SG_ VFC_Obj02A_ScaleChngStdDev : 352|10@1+ (0.0001,0) [0|0.1023] "unitless"  DASy
 SG_ VFC_Obj02A_HeadingAngle : 226|9@1+ (0.01,-1.57) [-1.57|1.57] "rad"  DASy
 SG_ VFC_Obj02A_HeadingAngleStdDev : 186|6@1+ (0.01,0) [0|0.5] "rad"  DASy
 SG_ VFC_Obj02A_HeadOrientation : 460|4@1+ (1,0) [0|15] ""  DASy
 SG_ VFC_Obj02A_CompletelyInImg : 121|1@1+ (1,0) [0|1] ""  DASy
 SG_ VFC_Obj02A_ProbMovingLat : 154|6@1+ (2,0) [0|100] "%"  DASy
 SG_ VFC_Obj02A_ProbMovingLong : 170|6@1+ (2,0) [0|100] "%"  DASy
 SG_ VFC_Obj02A_ProbExist : 122|6@1+ (2,0) [0|100] "%"  DASy
 SG_ VFC_Obj02A_MeasSource : 91|5@1+ (1,0) [0|31] ""  DASy
 SG_ VFC_Obj02A_Reliability : 362|6@1+ (1,0) [0|63] ""  DASy
 SG_ VFC_Obj02A_Measured : 78|2@1+ (1,0) [0|3] ""  DASy
 SG_ VFC_Obj02A_VisibleView : 437|3@1+ (1,0) [0|4] ""  DASy
 SG_ VFC_Obj02A_ClassifiedView : 496|3@1+ (1,0) [0|4] ""  DASy
 SG_ VFC_Obj02A_DirIndicator : 106|3@1+ (1,0) [0|4] ""  DASy
 SG_ VFC_Obj02A_BrakeLight : 109|3@1+ (1,0) [0|7] ""  DASy

BO_ 104 VFC_Object03A: 64 MPC3
 SG_ VFC_Obj03A_CRC : 0|16@1+ (1,0) [0|65535] ""  DASy
 SG_ VFC_Obj03A_AliveCtr : 16|8@1+ (1,0) [0|255] ""  DASy
 SG_ VFC_Obj03A_ProtBlockCtr : 24|4@1+ (1,0) [0|15] ""  DASy
 SG_ VFC_Obj03A_ID : 32|8@1+ (1,0) [1|255] ""  DASy
 SG_ VFC_Obj03A_Type : 60|4@1+ (1,0) [0|15] ""  DASy
 SG_ VFC_Obj03A_TypeProb : 378|6@1+ (2,0) [0|100] "%"  DASy
 SG_ VFC_Obj03A_Dx : 48|12@1+ (0.05,0) [0|204.75] "m"  DASy
 SG_ VFC_Obj03A_Dy : 64|14@1+ (0.01,-80) [-80|80] "m"  DASy
 SG_ VFC_Obj03A_Vx : 80|11@1+ (0.1,-154) [-154|50] "m/s"  DASy
 SG_ VFC_Obj03A_Vy : 96|10@1+ (0.1,-50) [-50|50] "m/s"  DASy
 SG_ VFC_Obj03A_Ax : 112|9@1+ (0.1,-16) [-16|16] "m/s^2"  DASy
 SG_ VFC_Obj03A_Ay : 128|8@1+ (0.1,-12) [-12|12] "m/s^2"  DASy
 SG_ VFC_Obj03A_DxStdDev : 144|10@1+ (0.05,0) [0|51.15] "m"  DASy
 SG_ VFC_Obj03A_DyStdDev : 160|10@1+ (0.02,0) [0|20.46] "m"  DASy
 SG_ VFC_Obj03A_VxStdDev : 176|10@1+ (0.1,0) [0|102.3] "m/s"  DASy
 SG_ VFC_Obj03A_VyStdDev : 192|9@1+ (0.1,0) [0|51.1] "m/s"  DASy
 SG_ VFC_Obj03A_AxStdDev : 40|8@1+ (0.1,0) [0|25.5] "m/s^2"  DASy
 SG_ VFC_Obj03A_AyStdDev : 136|8@1+ (0.1,0) [0|25.5] "m/s^2"  DASy
 SG_ VFC_Obj03A_Length : 217|9@1+ (0.05,0) [0|25.55] "m"  DASy
 SG_ VFC_Obj03A_Width : 294|10@1+ (0.01,0) [0|10.23] "m"  DASy
 SG_ VFC_Obj03A_Height : 208|9@1+ (0.01,0) [0|5.11] "m"  DASy
 SG_ VFC_Obj03A_LengthStdDev : 384|7@1+ (0.05,0) [0|5] "m"  DASy
 SG_ VFC_Obj03A_WidthStdDev : 391|7@1+ (0.01,0) [0|1] "m"  DASy
 SG_ VFC_Obj03A_HeightStdDev : 201|7@1+ (0.01,0) [0|1] "m"  DASy
 SG_ VFC_Obj03A_EdgeLeft : 411|13@1+ (0.00025,-1) [-1|1] "unitless"  DASy
 SG_ VFC_Obj03A_EdgeMid : 398|13@1+ (0.00025,-1) [-1|1] "unitless"  DASy
 SG_ VFC_Obj03A_EdgeRight : 424|13@1+ (0.00025,-1) [-1|1] "unitless"  DASy
 SG_ VFC_Obj03A_EdgeTop : 448|12@1+ (0.00025,-0.5) [-0.5|0.5] "unitless"  DASy
 SG_ VFC_Obj03A_EdgeBottom : 269|12@1+ (0.00025,-0.5) [-0.5|0.5] "unitless"  DASy
 SG_ VFC_Obj03A_EdgeLeftStdDev : 440|8@1+ (0.0002,0) [0|0.051] "unitless"  DASy
 SG_ VFC_Obj03A_EdgeMidStdDev : 464|8@1+ (0.0002,0) [0|0.051] "unitless"  DASy
 SG_ VFC_Obj03A_EdgeRightStdDev : 472|8@1+ (0.0002,0) [0|0.051] "unitless"  DASy
 SG_ VFC_Obj03A_EdgeTopStdDev : 480|8@1+ (0.0002,0) [0|0.051] "unitless"  DASy
 SG_ VFC_Obj03A_EdgeBottomStdDev : 488|8@1+ (0.0002,0) [0|0.051] "unitless"  DASy
 SG_ VFC_Obj03A_NormVx : 304|16@1+ (0.001,-40) [-40|25] "1/s"  DASy
 SG_ VFC_Obj03A_NormAx : 235|13@1+ (0.002,-10) [-10|6] "1/s^2"  DASy
 SG_ VFC_Obj03A_NormVyEdgeLeft : 256|13@1+ (0.001,-4) [-4|4] "1/s"  DASy
 SG_ VFC_Obj03A_NormVyEdgeRight : 281|13@1+ (0.001,-4) [-4|4] "1/s"  DASy
 SG_ VFC_Obj03A_NormVxStdDev : 368|10@1+ (0.001,0) [0|1.023] "1/s"  DASy
 SG_ VFC_Obj03A_NormAxStdDev : 328|10@1+ (0.0025,0) [0|2.5575] "1/s^2"  DASy
 SG_ VFC_Obj03A_NormVyEdgeLeftStdDev : 248|8@1+ (0.001,0) [0|0.255] "1/s"  DASy
 SG_ VFC_Obj03A_NormVyEdgeRightStdDev : 320|8@1+ (0.001,0) [0|0.255] "1/s"  DASy
 SG_ VFC_Obj03A_ScaleChange : 338|14@1+ (0.0001,0.5) [0.5|2.1383] "unitless"  DASy
 SG_ VFC_Obj03A_ScaleChngStdDev : 352|10@1+ (0.0001,0) [0|0.1023] "unitless"  DASy
 SG_ VFC_Obj03A_HeadingAngle : 226|9@1+ (0.01,-1.57) [-1.57|1.57] "rad"  DASy
 SG_ VFC_Obj03A_HeadingAngleStdDev : 186|6@1+ (0.01,0) [0|0.5] "rad"  DASy
 SG_ VFC_Obj03A_HeadOrientation : 460|4@1+ (1,0) [0|15] ""  DASy
 SG_ VFC_Obj03A_CompletelyInImg : 121|1@1+ (1,0) [0|1] ""  DASy
 SG_ VFC_Obj03A_ProbMovingLat : 154|6@1+ (2,0) [0|100] "%"  DASy
 SG_ VFC_Obj03A_ProbMovingLong : 170|6@1+ (2,0) [0|100] "%"  DASy
 SG_ VFC_Obj03A_ProbExist : 122|6@1+ (2,0) [0|100] "%"  DASy
 SG_ VFC_Obj03A_MeasSource : 91|5@1+ (1,0) [0|31] ""  DASy
 SG_ VFC_Obj03A_Reliability : 362|6@1+ (1,0) [0|63] ""  DASy
 SG_ VFC_Obj03A_Measured : 78|2@1+ (1,0) [0|3] ""  DASy
 SG_ VFC_Obj03A_VisibleView : 437|3@1+ (1,0) [0|4] ""  DASy
 SG_ VFC_Obj03A_ClassifiedView : 496|3@1+ (1,0) [0|4] ""  DASy
 SG_ VFC_Obj03A_DirIndicator : 106|3@1+ (1,0) [0|4] ""  DASy
 SG_ VFC_Obj03A_BrakeLight : 109|3@1+ (1,0) [0|7] ""  DASy

BO_ 106 VFC_Object04A: 64 MPC3
 SG_ VFC_Obj04A_CRC : 0|16@1+ (1,0) [0|65535] ""  DASy
 SG_ VFC_Obj04A_AliveCtr : 16|8@1+ (1,0) [0|255] ""  DASy
 SG_ VFC_Obj04A_ProtBlockCtr : 24|4@1+ (1,0) [0|15] ""  DASy
 SG_ VFC_Obj04A_ID : 32|8@1+ (1,0) [1|255] ""  DASy
 SG_ VFC_Obj04A_Type : 60|4@1+ (1,0) [0|15] ""  DASy
 SG_ VFC_Obj04A_TypeProb : 378|6@1+ (2,0) [0|100] "%"  DASy
 SG_ VFC_Obj04A_Dx : 48|12@1+ (0.05,0) [0|204.75] "m"  DASy
 SG_ VFC_Obj04A_Dy : 64|14@1+ (0.01,-80) [-80|80] "m"  DASy
 SG_ VFC_Obj04A_Vx : 80|11@1+ (0.1,-154) [-154|50] "m/s"  DASy
 SG_ VFC_Obj04A_Vy : 96|10@1+ (0.1,-50) [-50|50] "m/s"  DASy
 SG_ VFC_Obj04A_Ax : 112|9@1+ (0.1,-16) [-16|16] "m/s^2"  DASy
 SG_ VFC_Obj04A_Ay : 128|8@1+ (0.1,-12) [-12|12] "m/s^2"  DASy
 SG_ VFC_Obj04A_DxStdDev : 144|10@1+ (0.05,0) [0|51.15] "m"  DASy
 SG_ VFC_Obj04A_DyStdDev : 160|10@1+ (0.02,0) [0|20.46] "m"  DASy
 SG_ VFC_Obj04A_VxStdDev : 176|10@1+ (0.1,0) [0|102.3] "m/s"  DASy
 SG_ VFC_Obj04A_VyStdDev : 192|9@1+ (0.1,0) [0|51.1] "m/s"  DASy
 SG_ VFC_Obj04A_AxStdDev : 40|8@1+ (0.1,0) [0|25.5] "m/s^2"  DASy
 SG_ VFC_Obj04A_AyStdDev : 136|8@1+ (0.1,0) [0|25.5] "m/s^2"  DASy
 SG_ VFC_Obj04A_Length : 217|9@1+ (0.05,0) [0|25.55] "m"  DASy
 SG_ VFC_Obj04A_Width : 294|10@1+ (0.01,0) [0|10.23] "m"  DASy
 SG_ VFC_Obj04A_Height : 208|9@1+ (0.01,0) [0|5.11] "m"  DASy
 SG_ VFC_Obj04A_LengthStdDev : 384|7@1+ (0.05,0) [0|5] "m"  DASy
 SG_ VFC_Obj04A_WidthStdDev : 391|7@1+ (0.01,0) [0|1] "m"  DASy
 SG_ VFC_Obj04A_HeightStdDev : 201|7@1+ (0.01,0) [0|1] "m"  DASy
 SG_ VFC_Obj04A_EdgeLeft : 411|13@1+ (0.00025,-1) [-1|1] "unitless"  DASy
 SG_ VFC_Obj04A_EdgeMid : 398|13@1+ (0.00025,-1) [-1|1] "unitless"  DASy
 SG_ VFC_Obj04A_EdgeRight : 424|13@1+ (0.00025,-1) [-1|1] "unitless"  DASy
 SG_ VFC_Obj04A_EdgeTop : 448|12@1+ (0.00025,-0.5) [-0.5|0.5] "unitless"  DASy
 SG_ VFC_Obj04A_EdgeBottom : 269|12@1+ (0.00025,-0.5) [-0.5|0.5] "unitless"  DASy
 SG_ VFC_Obj04A_EdgeLeftStdDev : 440|8@1+ (0.0002,0) [0|0.051] "unitless"  DASy
 SG_ VFC_Obj04A_EdgeMidStdDev : 464|8@1+ (0.0002,0) [0|0.051] "unitless"  DASy
 SG_ VFC_Obj04A_EdgeRightStdDev : 472|8@1+ (0.0002,0) [0|0.051] "unitless"  DASy
 SG_ VFC_Obj04A_EdgeTopStdDev : 480|8@1+ (0.0002,0) [0|0.051] "unitless"  DASy
 SG_ VFC_Obj04A_EdgeBottomStdDev : 488|8@1+ (0.0002,0) [0|0.051] "unitless"  DASy
 SG_ VFC_Obj04A_NormVx : 304|16@1+ (0.001,-40) [-40|25] "1/s"  DASy
 SG_ VFC_Obj04A_NormAx : 235|13@1+ (0.002,-10) [-10|6] "1/s^2"  DASy
 SG_ VFC_Obj04A_NormVyEdgeLeft : 256|13@1+ (0.001,-4) [-4|4] "1/s"  DASy
 SG_ VFC_Obj04A_NormVyEdgeRight : 281|13@1+ (0.001,-4) [-4|4] "1/s"  DASy
 SG_ VFC_Obj04A_NormVxStdDev : 368|10@1+ (0.001,0) [0|1.023] "1/s"  DASy
 SG_ VFC_Obj04A_NormAxStdDev : 328|10@1+ (0.0025,0) [0|2.5575] "1/s^2"  DASy
 SG_ VFC_Obj04A_NormVyEdgeLeftStdDev : 248|8@1+ (0.001,0) [0|0.255] "1/s"  DASy
 SG_ VFC_Obj04A_NormVyEdgeRightStdDev : 320|8@1+ (0.001,0) [0|0.255] "1/s"  DASy
 SG_ VFC_Obj04A_ScaleChange : 338|14@1+ (0.0001,0.5) [0.5|2.1383] "unitless"  DASy
 SG_ VFC_Obj04A_ScaleChngStdDev : 352|10@1+ (0.0001,0) [0|0.1023] "unitless"  DASy
 SG_ VFC_Obj04A_HeadingAngle : 226|9@1+ (0.01,-1.57) [-1.57|1.57] "rad"  DASy
 SG_ VFC_Obj04A_HeadingAngleStdDev : 186|6@1+ (0.01,0) [0|0.5] "rad"  DASy
 SG_ VFC_Obj04A_HeadOrientation : 460|4@1+ (1,0) [0|15] ""  DASy
 SG_ VFC_Obj04A_CompletelyInImg : 121|1@1+ (1,0) [0|1] ""  DASy
 SG_ VFC_Obj04A_ProbMovingLat : 154|6@1+ (2,0) [0|100] "%"  DASy
 SG_ VFC_Obj04A_ProbMovingLong : 170|6@1+ (2,0) [0|100] "%"  DASy
 SG_ VFC_Obj04A_ProbExist : 122|6@1+ (2,0) [0|100] "%"  DASy
 SG_ VFC_Obj04A_MeasSource : 91|5@1+ (1,0) [0|31] ""  DASy
 SG_ VFC_Obj04A_Reliability : 362|6@1+ (1,0) [0|63] ""  DASy
 SG_ VFC_Obj04A_Measured : 78|2@1+ (1,0) [0|3] ""  DASy
 SG_ VFC_Obj04A_VisibleView : 437|3@1+ (1,0) [0|4] ""  DASy
 SG_ VFC_Obj04A_ClassifiedView : 496|3@1+ (1,0) [0|4] ""  DASy
 SG_ VFC_Obj04A_DirIndicator : 106|3@1+ (1,0) [0|4] ""  DASy
 SG_ VFC_Obj04A_BrakeLight : 109|3@1+ (1,0) [0|7] ""  DASy

BO_ 108 VFC_Object05A: 64 MPC3
 SG_ VFC_Obj05A_CRC : 0|16@1+ (1,0) [0|65535] ""  DASy
 SG_ VFC_Obj05A_AliveCtr : 16|8@1+ (1,0) [0|255] ""  DASy
 SG_ VFC_Obj05A_ProtBlockCtr : 24|4@1+ (1,0) [0|15] ""  DASy
 SG_ VFC_Obj05A_ID : 32|8@1+ (1,0) [1|255] ""  DASy
 SG_ VFC_Obj05A_Type : 60|4@1+ (1,0) [0|15] ""  DASy
 SG_ VFC_Obj05A_TypeProb : 378|6@1+ (2,0) [0|100] "%"  DASy
 SG_ VFC_Obj05A_Dx : 48|12@1+ (0.05,0) [0|204.75] "m"  DASy
 SG_ VFC_Obj05A_Dy : 64|14@1+ (0.01,-80) [-80|80] "m"  DASy
 SG_ VFC_Obj05A_Vx : 80|11@1+ (0.1,-154) [-154|50] "m/s"  DASy
 SG_ VFC_Obj05A_Vy : 96|10@1+ (0.1,-50) [-50|50] "m/s"  DASy
 SG_ VFC_Obj05A_Ax : 112|9@1+ (0.1,-16) [-16|16] "m/s^2"  DASy
 SG_ VFC_Obj05A_Ay : 128|8@1+ (0.1,-12) [-12|12] "m/s^2"  DASy
 SG_ VFC_Obj05A_DxStdDev : 144|10@1+ (0.05,0) [0|51.15] "m"  DASy
 SG_ VFC_Obj05A_DyStdDev : 160|10@1+ (0.02,0) [0|20.46] "m"  DASy
 SG_ VFC_Obj05A_VxStdDev : 176|10@1+ (0.1,0) [0|102.3] "m/s"  DASy
 SG_ VFC_Obj05A_VyStdDev : 192|9@1+ (0.1,0) [0|51.1] "m/s"  DASy
 SG_ VFC_Obj05A_AxStdDev : 40|8@1+ (0.1,0) [0|25.5] "m/s^2"  DASy
 SG_ VFC_Obj05A_AyStdDev : 136|8@1+ (0.1,0) [0|25.5] "m/s^2"  DASy
 SG_ VFC_Obj05A_Length : 217|9@1+ (0.05,0) [0|25.55] "m"  DASy
 SG_ VFC_Obj05A_Width : 294|10@1+ (0.01,0) [0|10.23] "m"  DASy
 SG_ VFC_Obj05A_Height : 208|9@1+ (0.01,0) [0|5.11] "m"  DASy
 SG_ VFC_Obj05A_LengthStdDev : 384|7@1+ (0.05,0) [0|5] "m"  DASy
 SG_ VFC_Obj05A_WidthStdDev : 391|7@1+ (0.01,0) [0|1] "m"  DASy
 SG_ VFC_Obj05A_HeightStdDev : 201|7@1+ (0.01,0) [0|1] "m"  DASy
 SG_ VFC_Obj05A_EdgeLeft : 411|13@1+ (0.00025,-1) [-1|1] "unitless"  DASy
 SG_ VFC_Obj05A_EdgeMid : 398|13@1+ (0.00025,-1) [-1|1] "unitless"  DASy
 SG_ VFC_Obj05A_EdgeRight : 424|13@1+ (0.00025,-1) [-1|1] "unitless"  DASy
 SG_ VFC_Obj05A_EdgeTop : 448|12@1+ (0.00025,-0.5) [-0.5|0.5] "unitless"  DASy
 SG_ VFC_Obj05A_EdgeBottom : 269|12@1+ (0.00025,-0.5) [-0.5|0.5] "unitless"  DASy
 SG_ VFC_Obj05A_EdgeLeftStdDev : 440|8@1+ (0.0002,0) [0|0.051] "unitless"  DASy
 SG_ VFC_Obj05A_EdgeMidStdDev : 464|8@1+ (0.0002,0) [0|0.051] "unitless"  DASy
 SG_ VFC_Obj05A_EdgeRightStdDev : 472|8@1+ (0.0002,0) [0|0.051] "unitless"  DASy
 SG_ VFC_Obj05A_EdgeTopStdDev : 480|8@1+ (0.0002,0) [0|0.051] "unitless"  DASy
 SG_ VFC_Obj05A_EdgeBottomStdDev : 488|8@1+ (0.0002,0) [0|0.051] "unitless"  DASy
 SG_ VFC_Obj05A_NormVx : 304|16@1+ (0.001,-40) [-40|25] "1/s"  DASy
 SG_ VFC_Obj05A_NormAx : 235|13@1+ (0.002,-10) [-10|6] "1/s^2"  DASy
 SG_ VFC_Obj05A_NormVyEdgeLeft : 256|13@1+ (0.001,-4) [-4|4] "1/s"  DASy
 SG_ VFC_Obj05A_NormVyEdgeRight : 281|13@1+ (0.001,-4) [-4|4] "1/s"  DASy
 SG_ VFC_Obj05A_NormVxStdDev : 368|10@1+ (0.001,0) [0|1.023] "1/s"  DASy
 SG_ VFC_Obj05A_NormAxStdDev : 328|10@1+ (0.0025,0) [0|2.5575] "1/s^2"  DASy
 SG_ VFC_Obj05A_NormVyEdgeLeftStdDev : 248|8@1+ (0.001,0) [0|0.255] "1/s"  DASy
 SG_ VFC_Obj05A_NormVyEdgeRightStdDev : 320|8@1+ (0.001,0) [0|0.255] "1/s"  DASy
 SG_ VFC_Obj05A_ScaleChange : 338|14@1+ (0.0001,0.5) [0.5|2.1383] "unitless"  DASy
 SG_ VFC_Obj05A_ScaleChngStdDev : 352|10@1+ (0.0001,0) [0|0.1023] "unitless"  DASy
 SG_ VFC_Obj05A_HeadingAngle : 226|9@1+ (0.01,-1.57) [-1.57|1.57] "rad"  DASy
 SG_ VFC_Obj05A_HeadingAngleStdDev : 186|6@1+ (0.01,0) [0|0.5] "rad"  DASy
 SG_ VFC_Obj05A_HeadOrientation : 460|4@1+ (1,0) [0|15] ""  DASy
 SG_ VFC_Obj05A_CompletelyInImg : 121|1@1+ (1,0) [0|1] ""  DASy
 SG_ VFC_Obj05A_ProbMovingLat : 154|6@1+ (2,0) [0|100] "%"  DASy
 SG_ VFC_Obj05A_ProbMovingLong : 170|6@1+ (2,0) [0|100] "%"  DASy
 SG_ VFC_Obj05A_ProbExist : 122|6@1+ (2,0) [0|100] "%"  DASy
 SG_ VFC_Obj05A_MeasSource : 91|5@1+ (1,0) [0|31] ""  DASy
 SG_ VFC_Obj05A_Reliability : 362|6@1+ (1,0) [0|63] ""  DASy
 SG_ VFC_Obj05A_Measured : 78|2@1+ (1,0) [0|3] ""  DASy
 SG_ VFC_Obj05A_VisibleView : 437|3@1+ (1,0) [0|4] ""  DASy
 SG_ VFC_Obj05A_ClassifiedView : 496|3@1+ (1,0) [0|4] ""  DASy
 SG_ VFC_Obj05A_DirIndicator : 106|3@1+ (1,0) [0|4] ""  DASy
 SG_ VFC_Obj05A_BrakeLight : 109|3@1+ (1,0) [0|7] ""  DASy

BO_ 110 VFC_Object06A: 64 MPC3
 SG_ VFC_Obj06A_CRC : 0|16@1+ (1,0) [0|65535] ""  DASy
 SG_ VFC_Obj06A_AliveCtr : 16|8@1+ (1,0) [0|255] ""  DASy
 SG_ VFC_Obj06A_ProtBlockCtr : 24|4@1+ (1,0) [0|15] ""  DASy
 SG_ VFC_Obj06A_ID : 32|8@1+ (1,0) [1|255] ""  DASy
 SG_ VFC_Obj06A_Type : 60|4@1+ (1,0) [0|15] ""  DASy
 SG_ VFC_Obj06A_TypeProb : 378|6@1+ (2,0) [0|100] "%"  DASy
 SG_ VFC_Obj06A_Dx : 48|12@1+ (0.05,0) [0|204.75] "m"  DASy
 SG_ VFC_Obj06A_Dy : 64|14@1+ (0.01,-80) [-80|80] "m"  DASy
 SG_ VFC_Obj06A_Vx : 80|11@1+ (0.1,-154) [-154|50] "m/s"  DASy
 SG_ VFC_Obj06A_Vy : 96|10@1+ (0.1,-50) [-50|50] "m/s"  DASy
 SG_ VFC_Obj06A_Ax : 112|9@1+ (0.1,-16) [-16|16] "m/s^2"  DASy
 SG_ VFC_Obj06A_Ay : 128|8@1+ (0.1,-12) [-12|12] "m/s^2"  DASy
 SG_ VFC_Obj06A_DxStdDev : 144|10@1+ (0.05,0) [0|51.15] "m"  DASy
 SG_ VFC_Obj06A_DyStdDev : 160|10@1+ (0.02,0) [0|20.46] "m"  DASy
 SG_ VFC_Obj06A_VxStdDev : 176|10@1+ (0.1,0) [0|102.3] "m/s"  DASy
 SG_ VFC_Obj06A_VyStdDev : 192|9@1+ (0.1,0) [0|51.1] "m/s"  DASy
 SG_ VFC_Obj06A_AxStdDev : 40|8@1+ (0.1,0) [0|25.5] "m/s^2"  DASy
 SG_ VFC_Obj06A_AyStdDev : 136|8@1+ (0.1,0) [0|25.5] "m/s^2"  DASy
 SG_ VFC_Obj06A_Length : 217|9@1+ (0.05,0) [0|25.55] "m"  DASy
 SG_ VFC_Obj06A_Width : 294|10@1+ (0.01,0) [0|10.23] "m"  DASy
 SG_ VFC_Obj06A_Height : 208|9@1+ (0.01,0) [0|5.11] "m"  DASy
 SG_ VFC_Obj06A_LengthStdDev : 384|7@1+ (0.05,0) [0|5] "m"  DASy
 SG_ VFC_Obj06A_WidthStdDev : 391|7@1+ (0.01,0) [0|1] "m"  DASy
 SG_ VFC_Obj06A_HeightStdDev : 201|7@1+ (0.01,0) [0|1] "m"  DASy
 SG_ VFC_Obj06A_EdgeLeft : 411|13@1+ (0.00025,-1) [-1|1] "unitless"  DASy
 SG_ VFC_Obj06A_EdgeMid : 398|13@1+ (0.00025,-1) [-1|1] "unitless"  DASy
 SG_ VFC_Obj06A_EdgeRight : 424|13@1+ (0.00025,-1) [-1|1] "unitless"  DASy
 SG_ VFC_Obj06A_EdgeTop : 448|12@1+ (0.00025,-0.5) [-0.5|0.5] "unitless"  DASy
 SG_ VFC_Obj06A_EdgeBottom : 269|12@1+ (0.00025,-0.5) [-0.5|0.5] "unitless"  DASy
 SG_ VFC_Obj06A_EdgeLeftStdDev : 440|8@1+ (0.0002,0) [0|0.051] "unitless"  DASy
 SG_ VFC_Obj06A_EdgeMidStdDev : 464|8@1+ (0.0002,0) [0|0.051] "unitless"  DASy
 SG_ VFC_Obj06A_EdgeRightStdDev : 472|8@1+ (0.0002,0) [0|0.051] "unitless"  DASy
 SG_ VFC_Obj06A_EdgeTopStdDev : 480|8@1+ (0.0002,0) [0|0.051] "unitless"  DASy
 SG_ VFC_Obj06A_EdgeBottomStdDev : 488|8@1+ (0.0002,0) [0|0.051] "unitless"  DASy
 SG_ VFC_Obj06A_NormVx : 304|16@1+ (0.001,-40) [-40|25] "1/s"  DASy
 SG_ VFC_Obj06A_NormAx : 235|13@1+ (0.002,-10) [-10|6] "1/s^2"  DASy
 SG_ VFC_Obj06A_NormVyEdgeLeft : 256|13@1+ (0.001,-4) [-4|4] "1/s"  DASy
 SG_ VFC_Obj06A_NormVyEdgeRight : 281|13@1+ (0.001,-4) [-4|4] "1/s"  DASy
 SG_ VFC_Obj06A_NormVxStdDev : 368|10@1+ (0.001,0) [0|1.023] "1/s"  DASy
 SG_ VFC_Obj06A_NormAxStdDev : 328|10@1+ (0.0025,0) [0|2.5575] "1/s^2"  DASy
 SG_ VFC_Obj06A_NormVyEdgeLeftStdDev : 248|8@1+ (0.001,0) [0|0.255] "1/s"  DASy
 SG_ VFC_Obj06A_NormVyEdgeRightStdDev : 320|8@1+ (0.001,0) [0|0.255] "1/s"  DASy
 SG_ VFC_Obj06A_ScaleChange : 338|14@1+ (0.0001,0.5) [0.5|2.1383] "unitless"  DASy
 SG_ VFC_Obj06A_ScaleChngStdDev : 352|10@1+ (0.0001,0) [0|0.1023] "unitless"  DASy
 SG_ VFC_Obj06A_HeadingAngle : 226|9@1+ (0.01,-1.57) [-1.57|1.57] "rad"  DASy
 SG_ VFC_Obj06A_HeadingAngleStdDev : 186|6@1+ (0.01,0) [0|0.5] "rad"  DASy
 SG_ VFC_Obj06A_HeadOrientation : 460|4@1+ (1,0) [0|15] ""  DASy
 SG_ VFC_Obj06A_CompletelyInImg : 121|1@1+ (1,0) [0|1] ""  DASy
 SG_ VFC_Obj06A_ProbMovingLat : 154|6@1+ (2,0) [0|100] "%"  DASy
 SG_ VFC_Obj06A_ProbMovingLong : 170|6@1+ (2,0) [0|100] "%"  DASy
 SG_ VFC_Obj06A_ProbExist : 122|6@1+ (2,0) [0|100] "%"  DASy
 SG_ VFC_Obj06A_MeasSource : 91|5@1+ (1,0) [0|31] ""  DASy
 SG_ VFC_Obj06A_Reliability : 362|6@1+ (1,0) [0|63] ""  DASy
 SG_ VFC_Obj06A_Measured : 78|2@1+ (1,0) [0|3] ""  DASy
 SG_ VFC_Obj06A_VisibleView : 437|3@1+ (1,0) [0|4] ""  DASy
 SG_ VFC_Obj06A_ClassifiedView : 496|3@1+ (1,0) [0|4] ""  DASy
 SG_ VFC_Obj06A_DirIndicator : 106|3@1+ (1,0) [0|4] ""  DASy
 SG_ VFC_Obj06A_BrakeLight : 109|3@1+ (1,0) [0|7] ""  DASy

BO_ 112 VFC_Object07A: 64 MPC3
 SG_ VFC_Obj07A_CRC : 0|16@1+ (1,0) [0|65535] ""  DASy
 SG_ VFC_Obj07A_AliveCtr : 16|8@1+ (1,0) [0|255] ""  DASy
 SG_ VFC_Obj07A_ProtBlockCtr : 24|4@1+ (1,0) [0|15] ""  DASy
 SG_ VFC_Obj07A_ID : 32|8@1+ (1,0) [1|255] ""  DASy
 SG_ VFC_Obj07A_Type : 60|4@1+ (1,0) [0|15] ""  DASy
 SG_ VFC_Obj07A_TypeProb : 378|6@1+ (2,0) [0|100] "%"  DASy
 SG_ VFC_Obj07A_Dx : 48|12@1+ (0.05,0) [0|204.75] "m"  DASy
 SG_ VFC_Obj07A_Dy : 64|14@1+ (0.01,-80) [-80|80] "m"  DASy
 SG_ VFC_Obj07A_Vx : 80|11@1+ (0.1,-154) [-154|50] "m/s"  DASy
 SG_ VFC_Obj07A_Vy : 96|10@1+ (0.1,-50) [-50|50] "m/s"  DASy
 SG_ VFC_Obj07A_Ax : 112|9@1+ (0.1,-16) [-16|16] "m/s^2"  DASy
 SG_ VFC_Obj07A_Ay : 128|8@1+ (0.1,-12) [-12|12] "m/s^2"  DASy
 SG_ VFC_Obj07A_DxStdDev : 144|10@1+ (0.05,0) [0|51.15] "m"  DASy
 SG_ VFC_Obj07A_DyStdDev : 160|10@1+ (0.02,0) [0|20.46] "m"  DASy
 SG_ VFC_Obj07A_VxStdDev : 176|10@1+ (0.1,0) [0|102.3] "m/s"  DASy
 SG_ VFC_Obj07A_VyStdDev : 192|9@1+ (0.1,0) [0|51.1] "m/s"  DASy
 SG_ VFC_Obj07A_AxStdDev : 40|8@1+ (0.1,0) [0|25.5] "m/s^2"  DASy
 SG_ VFC_Obj07A_AyStdDev : 136|8@1+ (0.1,0) [0|25.5] "m/s^2"  DASy
 SG_ VFC_Obj07A_Length : 217|9@1+ (0.05,0) [0|25.55] "m"  DASy
 SG_ VFC_Obj07A_Width : 294|10@1+ (0.01,0) [0|10.23] "m"  DASy
 SG_ VFC_Obj07A_Height : 208|9@1+ (0.01,0) [0|5.11] "m"  DASy
 SG_ VFC_Obj07A_LengthStdDev : 384|7@1+ (0.05,0) [0|5] "m"  DASy
 SG_ VFC_Obj07A_WidthStdDev : 391|7@1+ (0.01,0) [0|1] "m"  DASy
 SG_ VFC_Obj07A_HeightStdDev : 201|7@1+ (0.01,0) [0|1] "m"  DASy
 SG_ VFC_Obj07A_EdgeLeft : 411|13@1+ (0.00025,-1) [-1|1] "unitless"  DASy
 SG_ VFC_Obj07A_EdgeMid : 398|13@1+ (0.00025,-1) [-1|1] "unitless"  DASy
 SG_ VFC_Obj07A_EdgeRight : 424|13@1+ (0.00025,-1) [-1|1] "unitless"  DASy
 SG_ VFC_Obj07A_EdgeTop : 448|12@1+ (0.00025,-0.5) [-0.5|0.5] "unitless"  DASy
 SG_ VFC_Obj07A_EdgeBottom : 269|12@1+ (0.00025,-0.5) [-0.5|0.5] "unitless"  DASy
 SG_ VFC_Obj07A_EdgeLeftStdDev : 440|8@1+ (0.0002,0) [0|0.051] "unitless"  DASy
 SG_ VFC_Obj07A_EdgeMidStdDev : 464|8@1+ (0.0002,0) [0|0.051] "unitless"  DASy
 SG_ VFC_Obj07A_EdgeRightStdDev : 472|8@1+ (0.0002,0) [0|0.051] "unitless"  DASy
 SG_ VFC_Obj07A_EdgeTopStdDev : 480|8@1+ (0.0002,0) [0|0.051] "unitless"  DASy
 SG_ VFC_Obj07A_EdgeBottomStdDev : 488|8@1+ (0.0002,0) [0|0.051] "unitless"  DASy
 SG_ VFC_Obj07A_NormVx : 304|16@1+ (0.001,-40) [-40|25] "1/s"  DASy
 SG_ VFC_Obj07A_NormAx : 235|13@1+ (0.002,-10) [-10|6] "1/s^2"  DASy
 SG_ VFC_Obj07A_NormVyEdgeLeft : 256|13@1+ (0.001,-4) [-4|4] "1/s"  DASy
 SG_ VFC_Obj07A_NormVyEdgeRight : 281|13@1+ (0.001,-4) [-4|4] "1/s"  DASy
 SG_ VFC_Obj07A_NormVxStdDev : 368|10@1+ (0.001,0) [0|1.023] "1/s"  DASy
 SG_ VFC_Obj07A_NormAxStdDev : 328|10@1+ (0.0025,0) [0|2.5575] "1/s^2"  DASy
 SG_ VFC_Obj07A_NormVyEdgeLeftStdDev : 248|8@1+ (0.001,0) [0|0.255] "1/s"  DASy
 SG_ VFC_Obj07A_NormVyEdgeRightStdDev : 320|8@1+ (0.001,0) [0|0.255] "1/s"  DASy
 SG_ VFC_Obj07A_ScaleChange : 338|14@1+ (0.0001,0.5) [0.5|2.1383] "unitless"  DASy
 SG_ VFC_Obj07A_ScaleChngStdDev : 352|10@1+ (0.0001,0) [0|0.1023] "unitless"  DASy
 SG_ VFC_Obj07A_HeadingAngle : 226|9@1+ (0.01,-1.57) [-1.57|1.57] "rad"  DASy
 SG_ VFC_Obj07A_HeadingAngleStdDev : 186|6@1+ (0.01,0) [0|0.5] "rad"  DASy
 SG_ VFC_Obj07A_HeadOrientation : 460|4@1+ (1,0) [0|15] ""  DASy
 SG_ VFC_Obj07A_CompletelyInImg : 121|1@1+ (1,0) [0|1] ""  DASy
 SG_ VFC_Obj07A_ProbMovingLat : 154|6@1+ (2,0) [0|100] "%"  DASy
 SG_ VFC_Obj07A_ProbMovingLong : 170|6@1+ (2,0) [0|100] "%"  DASy
 SG_ VFC_Obj07A_ProbExist : 122|6@1+ (2,0) [0|100] "%"  DASy
 SG_ VFC_Obj07A_MeasSource : 91|5@1+ (1,0) [0|31] ""  DASy
 SG_ VFC_Obj07A_Reliability : 362|6@1+ (1,0) [0|63] ""  DASy
 SG_ VFC_Obj07A_Measured : 78|2@1+ (1,0) [0|3] ""  DASy
 SG_ VFC_Obj07A_VisibleView : 437|3@1+ (1,0) [0|4] ""  DASy
 SG_ VFC_Obj07A_ClassifiedView : 496|3@1+ (1,0) [0|4] ""  DASy
 SG_ VFC_Obj07A_DirIndicator : 106|3@1+ (1,0) [0|4] ""  DASy
 SG_ VFC_Obj07A_BrakeLight : 109|3@1+ (1,0) [0|7] ""  DASy

BO_ 114 VFC_Object08A: 64 MPC3
 SG_ VFC_Obj08A_CRC : 0|16@1+ (1,0) [0|65535] ""  DASy
 SG_ VFC_Obj08A_AliveCtr : 16|8@1+ (1,0) [0|255] ""  DASy
 SG_ VFC_Obj08A_ProtBlockCtr : 24|4@1+ (1,0) [0|15] ""  DASy
 SG_ VFC_Obj08A_ID : 32|8@1+ (1,0) [1|255] ""  DASy
 SG_ VFC_Obj08A_Type : 60|4@1+ (1,0) [0|15] ""  DASy
 SG_ VFC_Obj08A_TypeProb : 378|6@1+ (2,0) [0|100] "%"  DASy
 SG_ VFC_Obj08A_Dx : 48|12@1+ (0.05,0) [0|204.75] "m"  DASy
 SG_ VFC_Obj08A_Dy : 64|14@1+ (0.01,-80) [-80|80] "m"  DASy
 SG_ VFC_Obj08A_Vx : 80|11@1+ (0.1,-154) [-154|50] "m/s"  DASy
 SG_ VFC_Obj08A_Vy : 96|10@1+ (0.1,-50) [-50|50] "m/s"  DASy
 SG_ VFC_Obj08A_Ax : 112|9@1+ (0.1,-16) [-16|16] "m/s^2"  DASy
 SG_ VFC_Obj08A_Ay : 128|8@1+ (0.1,-12) [-12|12] "m/s^2"  DASy
 SG_ VFC_Obj08A_DxStdDev : 144|10@1+ (0.05,0) [0|51.15] "m"  DASy
 SG_ VFC_Obj08A_DyStdDev : 160|10@1+ (0.02,0) [0|20.46] "m"  DASy
 SG_ VFC_Obj08A_VxStdDev : 176|10@1+ (0.1,0) [0|102.3] "m/s"  DASy
 SG_ VFC_Obj08A_VyStdDev : 192|9@1+ (0.1,0) [0|51.1] "m/s"  DASy
 SG_ VFC_Obj08A_AxStdDev : 40|8@1+ (0.1,0) [0|25.5] "m/s^2"  DASy
 SG_ VFC_Obj08A_AyStdDev : 136|8@1+ (0.1,0) [0|25.5] "m/s^2"  DASy
 SG_ VFC_Obj08A_Length : 217|9@1+ (0.05,0) [0|25.55] "m"  DASy
 SG_ VFC_Obj08A_Width : 294|10@1+ (0.01,0) [0|10.23] "m"  DASy
 SG_ VFC_Obj08A_Height : 208|9@1+ (0.01,0) [0|5.11] "m"  DASy
 SG_ VFC_Obj08A_LengthStdDev : 384|7@1+ (0.05,0) [0|5] "m"  DASy
 SG_ VFC_Obj08A_WidthStdDev : 391|7@1+ (0.01,0) [0|1] "m"  DASy
 SG_ VFC_Obj08A_HeightStdDev : 201|7@1+ (0.01,0) [0|1] "m"  DASy
 SG_ VFC_Obj08A_EdgeLeft : 411|13@1+ (0.00025,-1) [-1|1] "unitless"  DASy
 SG_ VFC_Obj08A_EdgeMid : 398|13@1+ (0.00025,-1) [-1|1] "unitless"  DASy
 SG_ VFC_Obj08A_EdgeRight : 424|13@1+ (0.00025,-1) [-1|1] "unitless"  DASy
 SG_ VFC_Obj08A_EdgeTop : 448|12@1+ (0.00025,-0.5) [-0.5|0.5] "unitless"  DASy
 SG_ VFC_Obj08A_EdgeBottom : 269|12@1+ (0.00025,-0.5) [-0.5|0.5] "unitless"  DASy
 SG_ VFC_Obj08A_EdgeLeftStdDev : 440|8@1+ (0.0002,0) [0|0.051] "unitless"  DASy
 SG_ VFC_Obj08A_EdgeMidStdDev : 464|8@1+ (0.0002,0) [0|0.051] "unitless"  DASy
 SG_ VFC_Obj08A_EdgeRightStdDev : 472|8@1+ (0.0002,0) [0|0.051] "unitless"  DASy
 SG_ VFC_Obj08A_EdgeTopStdDev : 480|8@1+ (0.0002,0) [0|0.051] "unitless"  DASy
 SG_ VFC_Obj08A_EdgeBottomStdDev : 488|8@1+ (0.0002,0) [0|0.051] "unitless"  DASy
 SG_ VFC_Obj08A_NormVx : 304|16@1+ (0.001,-40) [-40|25] "1/s"  DASy
 SG_ VFC_Obj08A_NormAx : 235|13@1+ (0.002,-10) [-10|6] "1/s^2"  DASy
 SG_ VFC_Obj08A_NormVyEdgeLeft : 256|13@1+ (0.001,-4) [-4|4] "1/s"  DASy
 SG_ VFC_Obj08A_NormVyEdgeRight : 281|13@1+ (0.001,-4) [-4|4] "1/s"  DASy
 SG_ VFC_Obj08A_NormVxStdDev : 368|10@1+ (0.001,0) [0|1.023] "1/s"  DASy
 SG_ VFC_Obj08A_NormAxStdDev : 328|10@1+ (0.0025,0) [0|2.5575] "1/s^2"  DASy
 SG_ VFC_Obj08A_NormVyEdgeLeftStdDev : 248|8@1+ (0.001,0) [0|0.255] "1/s"  DASy
 SG_ VFC_Obj08A_NormVyEdgeRightStdDev : 320|8@1+ (0.001,0) [0|0.255] "1/s"  DASy
 SG_ VFC_Obj08A_ScaleChange : 338|14@1+ (0.0001,0.5) [0.5|2.1383] "unitless"  DASy
 SG_ VFC_Obj08A_ScaleChngStdDev : 352|10@1+ (0.0001,0) [0|0.1023] "unitless"  DASy
 SG_ VFC_Obj08A_HeadingAngle : 226|9@1+ (0.01,-1.57) [-1.57|1.57] "rad"  DASy
 SG_ VFC_Obj08A_HeadingAngleStdDev : 186|6@1+ (0.01,0) [0|0.5] "rad"  DASy
 SG_ VFC_Obj08A_HeadOrientation : 460|4@1+ (1,0) [0|15] ""  DASy
 SG_ VFC_Obj08A_CompletelyInImg : 121|1@1+ (1,0) [0|1] ""  DASy
 SG_ VFC_Obj08A_ProbMovingLat : 154|6@1+ (2,0) [0|100] "%"  DASy
 SG_ VFC_Obj08A_ProbMovingLong : 170|6@1+ (2,0) [0|100] "%"  DASy
 SG_ VFC_Obj08A_ProbExist : 122|6@1+ (2,0) [0|100] "%"  DASy
 SG_ VFC_Obj08A_MeasSource : 91|5@1+ (1,0) [0|31] ""  DASy
 SG_ VFC_Obj08A_Reliability : 362|6@1+ (1,0) [0|63] ""  DASy
 SG_ VFC_Obj08A_Measured : 78|2@1+ (1,0) [0|3] ""  DASy
 SG_ VFC_Obj08A_VisibleView : 437|3@1+ (1,0) [0|4] ""  DASy
 SG_ VFC_Obj08A_ClassifiedView : 496|3@1+ (1,0) [0|4] ""  DASy
 SG_ VFC_Obj08A_DirIndicator : 106|3@1+ (1,0) [0|4] ""  DASy
 SG_ VFC_Obj08A_BrakeLight : 109|3@1+ (1,0) [0|7] ""  DASy

BO_ 116 VFC_Object09A: 64 MPC3
 SG_ VFC_Obj09A_CRC : 0|16@1+ (1,0) [0|65535] ""  DASy
 SG_ VFC_Obj09A_AliveCtr : 16|8@1+ (1,0) [0|255] ""  DASy
 SG_ VFC_Obj09A_ProtBlockCtr : 24|4@1+ (1,0) [0|15] ""  DASy
 SG_ VFC_Obj09A_ID : 32|8@1+ (1,0) [1|255] ""  DASy
 SG_ VFC_Obj09A_Type : 60|4@1+ (1,0) [0|15] ""  DASy
 SG_ VFC_Obj09A_TypeProb : 378|6@1+ (2,0) [0|100] "%"  DASy
 SG_ VFC_Obj09A_Dx : 48|12@1+ (0.05,0) [0|204.75] "m"  DASy
 SG_ VFC_Obj09A_Dy : 64|14@1+ (0.01,-80) [-80|80] "m"  DASy
 SG_ VFC_Obj09A_Vx : 80|11@1+ (0.1,-154) [-154|50] "m/s"  DASy
 SG_ VFC_Obj09A_Vy : 96|10@1+ (0.1,-50) [-50|50] "m/s"  DASy
 SG_ VFC_Obj09A_Ax : 112|9@1+ (0.1,-16) [-16|16] "m/s^2"  DASy
 SG_ VFC_Obj09A_Ay : 128|8@1+ (0.1,-12) [-12|12] "m/s^2"  DASy
 SG_ VFC_Obj09A_DxStdDev : 144|10@1+ (0.05,0) [0|51.15] "m"  DASy
 SG_ VFC_Obj09A_DyStdDev : 160|10@1+ (0.02,0) [0|20.46] "m"  DASy
 SG_ VFC_Obj09A_VxStdDev : 176|10@1+ (0.1,0) [0|102.3] "m/s"  DASy
 SG_ VFC_Obj09A_VyStdDev : 192|9@1+ (0.1,0) [0|51.1] "m/s"  DASy
 SG_ VFC_Obj09A_AxStdDev : 40|8@1+ (0.1,0) [0|25.5] "m/s^2"  DASy
 SG_ VFC_Obj09A_AyStdDev : 136|8@1+ (0.1,0) [0|25.5] "m/s^2"  DASy
 SG_ VFC_Obj09A_Length : 217|9@1+ (0.05,0) [0|25.55] "m"  DASy
 SG_ VFC_Obj09A_Width : 294|10@1+ (0.01,0) [0|10.23] "m"  DASy
 SG_ VFC_Obj09A_Height : 208|9@1+ (0.01,0) [0|5.11] "m"  DASy
 SG_ VFC_Obj09A_LengthStdDev : 384|7@1+ (0.05,0) [0|5] "m"  DASy
 SG_ VFC_Obj09A_WidthStdDev : 391|7@1+ (0.01,0) [0|1] "m"  DASy
 SG_ VFC_Obj09A_HeightStdDev : 201|7@1+ (0.01,0) [0|1] "m"  DASy
 SG_ VFC_Obj09A_EdgeLeft : 411|13@1+ (0.00025,-1) [-1|1] "unitless"  DASy
 SG_ VFC_Obj09A_EdgeMid : 398|13@1+ (0.00025,-1) [-1|1] "unitless"  DASy
 SG_ VFC_Obj09A_EdgeRight : 424|13@1+ (0.00025,-1) [-1|1] "unitless"  DASy
 SG_ VFC_Obj09A_EdgeTop : 448|12@1+ (0.00025,-0.5) [-0.5|0.5] "unitless"  DASy
 SG_ VFC_Obj09A_EdgeBottom : 269|12@1+ (0.00025,-0.5) [-0.5|0.5] "unitless"  DASy
 SG_ VFC_Obj09A_EdgeLeftStdDev : 440|8@1+ (0.0002,0) [0|0.051] "unitless"  DASy
 SG_ VFC_Obj09A_EdgeMidStdDev : 464|8@1+ (0.0002,0) [0|0.051] "unitless"  DASy
 SG_ VFC_Obj09A_EdgeRightStdDev : 472|8@1+ (0.0002,0) [0|0.051] "unitless"  DASy
 SG_ VFC_Obj09A_EdgeTopStdDev : 480|8@1+ (0.0002,0) [0|0.051] "unitless"  DASy
 SG_ VFC_Obj09A_EdgeBottomStdDev : 488|8@1+ (0.0002,0) [0|0.051] "unitless"  DASy
 SG_ VFC_Obj09A_NormVx : 304|16@1+ (0.001,-40) [-40|25] "1/s"  DASy
 SG_ VFC_Obj09A_NormAx : 235|13@1+ (0.002,-10) [-10|6] "1/s^2"  DASy
 SG_ VFC_Obj09A_NormVyEdgeLeft : 256|13@1+ (0.001,-4) [-4|4] "1/s"  DASy
 SG_ VFC_Obj09A_NormVyEdgeRight : 281|13@1+ (0.001,-4) [-4|4] "1/s"  DASy
 SG_ VFC_Obj09A_NormVxStdDev : 368|10@1+ (0.001,0) [0|1.023] "1/s"  DASy
 SG_ VFC_Obj09A_NormAxStdDev : 328|10@1+ (0.0025,0) [0|2.5575] "1/s^2"  DASy
 SG_ VFC_Obj09A_NormVyEdgeLeftStdDev : 248|8@1+ (0.001,0) [0|0.255] "1/s"  DASy
 SG_ VFC_Obj09A_NormVyEdgeRightStdDev : 320|8@1+ (0.001,0) [0|0.255] "1/s"  DASy
 SG_ VFC_Obj09A_ScaleChange : 338|14@1+ (0.0001,0.5) [0.5|2.1383] "unitless"  DASy
 SG_ VFC_Obj09A_ScaleChngStdDev : 352|10@1+ (0.0001,0) [0|0.1023] "unitless"  DASy
 SG_ VFC_Obj09A_HeadingAngle : 226|9@1+ (0.01,-1.57) [-1.57|1.57] "rad"  DASy
 SG_ VFC_Obj09A_HeadingAngleStdDev : 186|6@1+ (0.01,0) [0|0.5] "rad"  DASy
 SG_ VFC_Obj09A_HeadOrientation : 460|4@1+ (1,0) [0|15] ""  DASy
 SG_ VFC_Obj09A_CompletelyInImg : 121|1@1+ (1,0) [0|1] ""  DASy
 SG_ VFC_Obj09A_ProbMovingLat : 154|6@1+ (2,0) [0|100] "%"  DASy
 SG_ VFC_Obj09A_ProbMovingLong : 170|6@1+ (2,0) [0|100] "%"  DASy
 SG_ VFC_Obj09A_ProbExist : 122|6@1+ (2,0) [0|100] "%"  DASy
 SG_ VFC_Obj09A_MeasSource : 91|5@1+ (1,0) [0|31] ""  DASy
 SG_ VFC_Obj09A_Reliability : 362|6@1+ (1,0) [0|63] ""  DASy
 SG_ VFC_Obj09A_Measured : 78|2@1+ (1,0) [0|3] ""  DASy
 SG_ VFC_Obj09A_VisibleView : 437|3@1+ (1,0) [0|4] ""  DASy
 SG_ VFC_Obj09A_ClassifiedView : 496|3@1+ (1,0) [0|4] ""  DASy
 SG_ VFC_Obj09A_DirIndicator : 106|3@1+ (1,0) [0|4] ""  DASy
 SG_ VFC_Obj09A_BrakeLight : 109|3@1+ (1,0) [0|7] ""  DASy

BO_ 118 VFC_Object10A: 64 MPC3
 SG_ VFC_Obj10A_CRC : 0|16@1+ (1,0) [0|65535] ""  DASy
 SG_ VFC_Obj10A_AliveCtr : 16|8@1+ (1,0) [0|255] ""  DASy
 SG_ VFC_Obj10A_ProtBlockCtr : 24|4@1+ (1,0) [0|15] ""  DASy
 SG_ VFC_Obj10A_ID : 32|8@1+ (1,0) [1|255] ""  DASy
 SG_ VFC_Obj10A_Type : 60|4@1+ (1,0) [0|15] ""  DASy
 SG_ VFC_Obj10A_TypeProb : 378|6@1+ (2,0) [0|100] "%"  DASy
 SG_ VFC_Obj10A_Dx : 48|12@1+ (0.05,0) [0|204.75] "m"  DASy
 SG_ VFC_Obj10A_Dy : 64|14@1+ (0.01,-80) [-80|80] "m"  DASy
 SG_ VFC_Obj10A_Vx : 80|11@1+ (0.1,-154) [-154|50] "m/s"  DASy
 SG_ VFC_Obj10A_Vy : 96|10@1+ (0.1,-50) [-50|50] "m/s"  DASy
 SG_ VFC_Obj10A_Ax : 112|9@1+ (0.1,-16) [-16|16] "m/s^2"  DASy
 SG_ VFC_Obj10A_Ay : 128|8@1+ (0.1,-12) [-12|12] "m/s^2"  DASy
 SG_ VFC_Obj10A_DxStdDev : 144|10@1+ (0.05,0) [0|51.15] "m"  DASy
 SG_ VFC_Obj10A_DyStdDev : 160|10@1+ (0.02,0) [0|20.46] "m"  DASy
 SG_ VFC_Obj10A_VxStdDev : 176|10@1+ (0.1,0) [0|102.3] "m/s"  DASy
 SG_ VFC_Obj10A_VyStdDev : 192|9@1+ (0.1,0) [0|51.1] "m/s"  DASy
 SG_ VFC_Obj10A_AxStdDev : 40|8@1+ (0.1,0) [0|25.5] "m/s^2"  DASy
 SG_ VFC_Obj10A_AyStdDev : 136|8@1+ (0.1,0) [0|25.5] "m/s^2"  DASy
 SG_ VFC_Obj10A_Length : 217|9@1+ (0.05,0) [0|25.55] "m"  DASy
 SG_ VFC_Obj10A_Width : 294|10@1+ (0.01,0) [0|10.23] "m"  DASy
 SG_ VFC_Obj10A_Height : 208|9@1+ (0.01,0) [0|5.11] "m"  DASy
 SG_ VFC_Obj10A_LengthStdDev : 384|7@1+ (0.05,0) [0|5] "m"  DASy
 SG_ VFC_Obj10A_WidthStdDev : 391|7@1+ (0.01,0) [0|1] "m"  DASy
 SG_ VFC_Obj10A_HeightStdDev : 201|7@1+ (0.01,0) [0|1] "m"  DASy
 SG_ VFC_Obj10A_EdgeLeft : 411|13@1+ (0.00025,-1) [-1|1] "unitless"  DASy
 SG_ VFC_Obj10A_EdgeMid : 398|13@1+ (0.00025,-1) [-1|1] "unitless"  DASy
 SG_ VFC_Obj10A_EdgeRight : 424|13@1+ (0.00025,-1) [-1|1] "unitless"  DASy
 SG_ VFC_Obj10A_EdgeTop : 448|12@1+ (0.00025,-0.5) [-0.5|0.5] "unitless"  DASy
 SG_ VFC_Obj10A_EdgeBottom : 269|12@1+ (0.00025,-0.5) [-0.5|0.5] "unitless"  DASy
 SG_ VFC_Obj10A_EdgeLeftStdDev : 440|8@1+ (0.0002,0) [0|0.051] "unitless"  DASy
 SG_ VFC_Obj10A_EdgeMidStdDev : 464|8@1+ (0.0002,0) [0|0.051] "unitless"  DASy
 SG_ VFC_Obj10A_EdgeRightStdDev : 472|8@1+ (0.0002,0) [0|0.051] "unitless"  DASy
 SG_ VFC_Obj10A_EdgeTopStdDev : 480|8@1+ (0.0002,0) [0|0.051] "unitless"  DASy
 SG_ VFC_Obj10A_EdgeBottomStdDev : 488|8@1+ (0.0002,0) [0|0.051] "unitless"  DASy
 SG_ VFC_Obj10A_NormVx : 304|16@1+ (0.001,-40) [-40|25] "1/s"  DASy
 SG_ VFC_Obj10A_NormAx : 235|13@1+ (0.002,-10) [-10|6] "1/s^2"  DASy
 SG_ VFC_Obj10A_NormVyEdgeLeft : 256|13@1+ (0.001,-4) [-4|4] "1/s"  DASy
 SG_ VFC_Obj10A_NormVyEdgeRight : 281|13@1+ (0.001,-4) [-4|4] "1/s"  DASy
 SG_ VFC_Obj10A_NormVxStdDev : 368|10@1+ (0.001,0) [0|1.023] "1/s"  DASy
 SG_ VFC_Obj10A_NormAxStdDev : 328|10@1+ (0.0025,0) [0|2.5575] "1/s^2"  DASy
 SG_ VFC_Obj10A_NormVyEdgeLeftStdDev : 248|8@1+ (0.001,0) [0|0.255] "1/s"  DASy
 SG_ VFC_Obj10A_NormVyEdgeRightStdDev : 320|8@1+ (0.001,0) [0|0.255] "1/s"  DASy
 SG_ VFC_Obj10A_ScaleChange : 338|14@1+ (0.0001,0.5) [0.5|2.1383] "unitless"  DASy
 SG_ VFC_Obj10A_ScaleChngStdDev : 352|10@1+ (0.0001,0) [0|0.1023] "unitless"  DASy
 SG_ VFC_Obj10A_HeadingAngle : 226|9@1+ (0.01,-1.57) [-1.57|1.57] "rad"  DASy
 SG_ VFC_Obj10A_HeadingAngleStdDev : 186|6@1+ (0.01,0) [0|0.5] "rad"  DASy
 SG_ VFC_Obj10A_HeadOrientation : 460|4@1+ (1,0) [0|15] ""  DASy
 SG_ VFC_Obj10A_CompletelyInImg : 121|1@1+ (1,0) [0|1] ""  DASy
 SG_ VFC_Obj10A_ProbMovingLat : 154|6@1+ (2,0) [0|100] "%"  DASy
 SG_ VFC_Obj10A_ProbMovingLong : 170|6@1+ (2,0) [0|100] "%"  DASy
 SG_ VFC_Obj10A_ProbExist : 122|6@1+ (2,0) [0|100] "%"  DASy
 SG_ VFC_Obj10A_MeasSource : 91|5@1+ (1,0) [0|31] ""  DASy
 SG_ VFC_Obj10A_Reliability : 362|6@1+ (1,0) [0|63] ""  DASy
 SG_ VFC_Obj10A_Measured : 78|2@1+ (1,0) [0|3] ""  DASy
 SG_ VFC_Obj10A_VisibleView : 437|3@1+ (1,0) [0|4] ""  DASy
 SG_ VFC_Obj10A_ClassifiedView : 496|3@1+ (1,0) [0|4] ""  DASy
 SG_ VFC_Obj10A_DirIndicator : 106|3@1+ (1,0) [0|4] ""  DASy
 SG_ VFC_Obj10A_BrakeLight : 109|3@1+ (1,0) [0|7] ""  DASy

BO_ 120 VFC_Object11A: 64 MPC3
 SG_ VFC_Obj11A_CRC : 0|16@1+ (1,0) [0|65535] ""  DASy
 SG_ VFC_Obj11A_AliveCtr : 16|8@1+ (1,0) [0|255] ""  DASy
 SG_ VFC_Obj11A_ProtBlockCtr : 24|4@1+ (1,0) [0|15] ""  DASy
 SG_ VFC_Obj11A_ID : 32|8@1+ (1,0) [1|255] ""  DASy
 SG_ VFC_Obj11A_Type : 60|4@1+ (1,0) [0|15] ""  DASy
 SG_ VFC_Obj11A_TypeProb : 378|6@1+ (2,0) [0|100] "%"  DASy
 SG_ VFC_Obj11A_Dx : 48|12@1+ (0.05,0) [0|204.75] "m"  DASy
 SG_ VFC_Obj11A_Dy : 64|14@1+ (0.01,-80) [-80|80] "m"  DASy
 SG_ VFC_Obj11A_Vx : 80|11@1+ (0.1,-154) [-154|50] "m/s"  DASy
 SG_ VFC_Obj11A_Vy : 96|10@1+ (0.1,-50) [-50|50] "m/s"  DASy
 SG_ VFC_Obj11A_Ax : 112|9@1+ (0.1,-16) [-16|16] "m/s^2"  DASy
 SG_ VFC_Obj11A_Ay : 128|8@1+ (0.1,-12) [-12|12] "m/s^2"  DASy
 SG_ VFC_Obj11A_DxStdDev : 144|10@1+ (0.05,0) [0|51.15] "m"  DASy
 SG_ VFC_Obj11A_DyStdDev : 160|10@1+ (0.02,0) [0|20.46] "m"  DASy
 SG_ VFC_Obj11A_VxStdDev : 176|10@1+ (0.1,0) [0|102.3] "m/s"  DASy
 SG_ VFC_Obj11A_VyStdDev : 192|9@1+ (0.1,0) [0|51.1] "m/s"  DASy
 SG_ VFC_Obj11A_AxStdDev : 40|8@1+ (0.1,0) [0|25.5] "m/s^2"  DASy
 SG_ VFC_Obj11A_AyStdDev : 136|8@1+ (0.1,0) [0|25.5] "m/s^2"  DASy
 SG_ VFC_Obj11A_Length : 217|9@1+ (0.05,0) [0|25.55] "m"  DASy
 SG_ VFC_Obj11A_Width : 294|10@1+ (0.01,0) [0|10.23] "m"  DASy
 SG_ VFC_Obj11A_Height : 208|9@1+ (0.01,0) [0|5.11] "m"  DASy
 SG_ VFC_Obj11A_LengthStdDev : 384|7@1+ (0.05,0) [0|5] "m"  DASy
 SG_ VFC_Obj11A_WidthStdDev : 391|7@1+ (0.01,0) [0|1] "m"  DASy
 SG_ VFC_Obj11A_HeightStdDev : 201|7@1+ (0.01,0) [0|1] "m"  DASy
 SG_ VFC_Obj11A_EdgeLeft : 411|13@1+ (0.00025,-1) [-1|1] "unitless"  DASy
 SG_ VFC_Obj11A_EdgeMid : 398|13@1+ (0.00025,-1) [-1|1] "unitless"  DASy
 SG_ VFC_Obj11A_EdgeRight : 424|13@1+ (0.00025,-1) [-1|1] "unitless"  DASy
 SG_ VFC_Obj11A_EdgeTop : 448|12@1+ (0.00025,-0.5) [-0.5|0.5] "unitless"  DASy
 SG_ VFC_Obj11A_EdgeBottom : 269|12@1+ (0.00025,-0.5) [-0.5|0.5] "unitless"  DASy
 SG_ VFC_Obj11A_EdgeLeftStdDev : 440|8@1+ (0.0002,0) [0|0.051] "unitless"  DASy
 SG_ VFC_Obj11A_EdgeMidStdDev : 464|8@1+ (0.0002,0) [0|0.051] "unitless"  DASy
 SG_ VFC_Obj11A_EdgeRightStdDev : 472|8@1+ (0.0002,0) [0|0.051] "unitless"  DASy
 SG_ VFC_Obj11A_EdgeTopStdDev : 480|8@1+ (0.0002,0) [0|0.051] "unitless"  DASy
 SG_ VFC_Obj11A_EdgeBottomStdDev : 488|8@1+ (0.0002,0) [0|0.051] "unitless"  DASy
 SG_ VFC_Obj11A_NormVx : 304|16@1+ (0.001,-40) [-40|25] "1/s"  DASy
 SG_ VFC_Obj11A_NormAx : 235|13@1+ (0.002,-10) [-10|6] "1/s^2"  DASy
 SG_ VFC_Obj11A_NormVyEdgeLeft : 256|13@1+ (0.001,-4) [-4|4] "1/s"  DASy
 SG_ VFC_Obj11A_NormVyEdgeRight : 281|13@1+ (0.001,-4) [-4|4] "1/s"  DASy
 SG_ VFC_Obj11A_NormVxStdDev : 368|10@1+ (0.001,0) [0|1.023] "1/s"  DASy
 SG_ VFC_Obj11A_NormAxStdDev : 328|10@1+ (0.0025,0) [0|2.5575] "1/s^2"  DASy
 SG_ VFC_Obj11A_NormVyEdgeLeftStdDev : 248|8@1+ (0.001,0) [0|0.255] "1/s"  DASy
 SG_ VFC_Obj11A_NormVyEdgeRightStdDev : 320|8@1+ (0.001,0) [0|0.255] "1/s"  DASy
 SG_ VFC_Obj11A_ScaleChange : 338|14@1+ (0.0001,0.5) [0.5|2.1383] "unitless"  DASy
 SG_ VFC_Obj11A_ScaleChngStdDev : 352|10@1+ (0.0001,0) [0|0.1023] "unitless"  DASy
 SG_ VFC_Obj11A_HeadingAngle : 226|9@1+ (0.01,-1.57) [-1.57|1.57] "rad"  DASy
 SG_ VFC_Obj11A_HeadingAngleStdDev : 186|6@1+ (0.01,0) [0|0.5] "rad"  DASy
 SG_ VFC_Obj11A_HeadOrientation : 460|4@1+ (1,0) [0|15] ""  DASy
 SG_ VFC_Obj11A_CompletelyInImg : 121|1@1+ (1,0) [0|1] ""  DASy
 SG_ VFC_Obj11A_ProbMovingLat : 154|6@1+ (2,0) [0|100] "%"  DASy
 SG_ VFC_Obj11A_ProbMovingLong : 170|6@1+ (2,0) [0|100] "%"  DASy
 SG_ VFC_Obj11A_ProbExist : 122|6@1+ (2,0) [0|100] "%"  DASy
 SG_ VFC_Obj11A_MeasSource : 91|5@1+ (1,0) [0|31] ""  DASy
 SG_ VFC_Obj11A_Reliability : 362|6@1+ (1,0) [0|63] ""  DASy
 SG_ VFC_Obj11A_Measured : 78|2@1+ (1,0) [0|3] ""  DASy
 SG_ VFC_Obj11A_VisibleView : 437|3@1+ (1,0) [0|4] ""  DASy
 SG_ VFC_Obj11A_ClassifiedView : 496|3@1+ (1,0) [0|4] ""  DASy
 SG_ VFC_Obj11A_DirIndicator : 106|3@1+ (1,0) [0|4] ""  DASy
 SG_ VFC_Obj11A_BrakeLight : 109|3@1+ (1,0) [0|7] ""  DASy

BO_ 122 VFC_Object12A: 64 MPC3
 SG_ VFC_Obj12A_CRC : 0|16@1+ (1,0) [0|65535] ""  DASy
 SG_ VFC_Obj12A_AliveCtr : 16|8@1+ (1,0) [0|255] ""  DASy
 SG_ VFC_Obj12A_ProtBlockCtr : 24|4@1+ (1,0) [0|15] ""  DASy
 SG_ VFC_Obj12A_ID : 32|8@1+ (1,0) [1|255] ""  DASy
 SG_ VFC_Obj12A_Type : 60|4@1+ (1,0) [0|15] ""  DASy
 SG_ VFC_Obj12A_TypeProb : 378|6@1+ (2,0) [0|100] "%"  DASy
 SG_ VFC_Obj12A_Dx : 48|12@1+ (0.05,0) [0|204.75] "m"  DASy
 SG_ VFC_Obj12A_Dy : 64|14@1+ (0.01,-80) [-80|80] "m"  DASy
 SG_ VFC_Obj12A_Vx : 80|11@1+ (0.1,-154) [-154|50] "m/s"  DASy
 SG_ VFC_Obj12A_Vy : 96|10@1+ (0.1,-50) [-50|50] "m/s"  DASy
 SG_ VFC_Obj12A_Ax : 112|9@1+ (0.1,-16) [-16|16] "m/s^2"  DASy
 SG_ VFC_Obj12A_Ay : 128|8@1+ (0.1,-12) [-12|12] "m/s^2"  DASy
 SG_ VFC_Obj12A_DxStdDev : 144|10@1+ (0.05,0) [0|51.15] "m"  DASy
 SG_ VFC_Obj12A_DyStdDev : 160|10@1+ (0.02,0) [0|20.46] "m"  DASy
 SG_ VFC_Obj12A_VxStdDev : 176|10@1+ (0.1,0) [0|102.3] "m/s"  DASy
 SG_ VFC_Obj12A_VyStdDev : 192|9@1+ (0.1,0) [0|51.1] "m/s"  DASy
 SG_ VFC_Obj12A_AxStdDev : 40|8@1+ (0.1,0) [0|25.5] "m/s^2"  DASy
 SG_ VFC_Obj12A_AyStdDev : 136|8@1+ (0.1,0) [0|25.5] "m/s^2"  DASy
 SG_ VFC_Obj12A_Length : 217|9@1+ (0.05,0) [0|25.55] "m"  DASy
 SG_ VFC_Obj12A_Width : 294|10@1+ (0.01,0) [0|10.23] "m"  DASy
 SG_ VFC_Obj12A_Height : 208|9@1+ (0.01,0) [0|5.11] "m"  DASy
 SG_ VFC_Obj12A_LengthStdDev : 384|7@1+ (0.05,0) [0|5] "m"  DASy
 SG_ VFC_Obj12A_WidthStdDev : 391|7@1+ (0.01,0) [0|1] "m"  DASy
 SG_ VFC_Obj12A_HeightStdDev : 201|7@1+ (0.01,0) [0|1] "m"  DASy
 SG_ VFC_Obj12A_EdgeLeft : 411|13@1+ (0.00025,-1) [-1|1] "unitless"  DASy
 SG_ VFC_Obj12A_EdgeMid : 398|13@1+ (0.00025,-1) [-1|1] "unitless"  DASy
 SG_ VFC_Obj12A_EdgeRight : 424|13@1+ (0.00025,-1) [-1|1] "unitless"  DASy
 SG_ VFC_Obj12A_EdgeTop : 448|12@1+ (0.00025,-0.5) [-0.5|0.5] "unitless"  DASy
 SG_ VFC_Obj12A_EdgeBottom : 269|12@1+ (0.00025,-0.5) [-0.5|0.5] "unitless"  DASy
 SG_ VFC_Obj12A_EdgeLeftStdDev : 440|8@1+ (0.0002,0) [0|0.051] "unitless"  DASy
 SG_ VFC_Obj12A_EdgeMidStdDev : 464|8@1+ (0.0002,0) [0|0.051] "unitless"  DASy
 SG_ VFC_Obj12A_EdgeRightStdDev : 472|8@1+ (0.0002,0) [0|0.051] "unitless"  DASy
 SG_ VFC_Obj12A_EdgeTopStdDev : 480|8@1+ (0.0002,0) [0|0.051] "unitless"  DASy
 SG_ VFC_Obj12A_EdgeBottomStdDev : 488|8@1+ (0.0002,0) [0|0.051] "unitless"  DASy
 SG_ VFC_Obj12A_NormVx : 304|16@1+ (0.001,-40) [-40|25] "1/s"  DASy
 SG_ VFC_Obj12A_NormAx : 235|13@1+ (0.002,-10) [-10|6] "1/s^2"  DASy
 SG_ VFC_Obj12A_NormVyEdgeLeft : 256|13@1+ (0.001,-4) [-4|4] "1/s"  DASy
 SG_ VFC_Obj12A_NormVyEdgeRight : 281|13@1+ (0.001,-4) [-4|4] "1/s"  DASy
 SG_ VFC_Obj12A_NormVxStdDev : 368|10@1+ (0.001,0) [0|1.023] "1/s"  DASy
 SG_ VFC_Obj12A_NormAxStdDev : 328|10@1+ (0.0025,0) [0|2.5575] "1/s^2"  DASy
 SG_ VFC_Obj12A_NormVyEdgeLeftStdDev : 248|8@1+ (0.001,0) [0|0.255] "1/s"  DASy
 SG_ VFC_Obj12A_NormVyEdgeRightStdDev : 320|8@1+ (0.001,0) [0|0.255] "1/s"  DASy
 SG_ VFC_Obj12A_ScaleChange : 338|14@1+ (0.0001,0.5) [0.5|2.1383] "unitless"  DASy
 SG_ VFC_Obj12A_ScaleChngStdDev : 352|10@1+ (0.0001,0) [0|0.1023] "unitless"  DASy
 SG_ VFC_Obj12A_HeadingAngle : 226|9@1+ (0.01,-1.57) [-1.57|1.57] "rad"  DASy
 SG_ VFC_Obj12A_HeadingAngleStdDev : 186|6@1+ (0.01,0) [0|0.5] "rad"  DASy
 SG_ VFC_Obj12A_HeadOrientation : 460|4@1+ (1,0) [0|15] ""  DASy
 SG_ VFC_Obj12A_CompletelyInImg : 121|1@1+ (1,0) [0|1] ""  DASy
 SG_ VFC_Obj12A_ProbMovingLat : 154|6@1+ (2,0) [0|100] "%"  DASy
 SG_ VFC_Obj12A_ProbMovingLong : 170|6@1+ (2,0) [0|100] "%"  DASy
 SG_ VFC_Obj12A_ProbExist : 122|6@1+ (2,0) [0|100] "%"  DASy
 SG_ VFC_Obj12A_MeasSource : 91|5@1+ (1,0) [0|31] ""  DASy
 SG_ VFC_Obj12A_Reliability : 362|6@1+ (1,0) [0|63] ""  DASy
 SG_ VFC_Obj12A_Measured : 78|2@1+ (1,0) [0|3] ""  DASy
 SG_ VFC_Obj12A_VisibleView : 437|3@1+ (1,0) [0|4] ""  DASy
 SG_ VFC_Obj12A_ClassifiedView : 496|3@1+ (1,0) [0|4] ""  DASy
 SG_ VFC_Obj12A_DirIndicator : 106|3@1+ (1,0) [0|4] ""  DASy
 SG_ VFC_Obj12A_BrakeLight : 109|3@1+ (1,0) [0|7] ""  DASy

BO_ 124 VFC_Object13A: 64 MPC3
 SG_ VFC_Obj13A_CRC : 0|16@1+ (1,0) [0|65535] ""  DASy
 SG_ VFC_Obj13A_AliveCtr : 16|8@1+ (1,0) [0|255] ""  DASy
 SG_ VFC_Obj13A_ProtBlockCtr : 24|4@1+ (1,0) [0|15] ""  DASy
 SG_ VFC_Obj13A_ID : 32|8@1+ (1,0) [1|255] ""  DASy
 SG_ VFC_Obj13A_Type : 60|4@1+ (1,0) [0|15] ""  DASy
 SG_ VFC_Obj13A_TypeProb : 378|6@1+ (2,0) [0|100] "%"  DASy
 SG_ VFC_Obj13A_Dx : 48|12@1+ (0.05,0) [0|204.75] "m"  DASy
 SG_ VFC_Obj13A_Dy : 64|14@1+ (0.01,-80) [-80|80] "m"  DASy
 SG_ VFC_Obj13A_Vx : 80|11@1+ (0.1,-154) [-154|50] "m/s"  DASy
 SG_ VFC_Obj13A_Vy : 96|10@1+ (0.1,-50) [-50|50] "m/s"  DASy
 SG_ VFC_Obj13A_Ax : 112|9@1+ (0.1,-16) [-16|16] "m/s^2"  DASy
 SG_ VFC_Obj13A_Ay : 128|8@1+ (0.1,-12) [-12|12] "m/s^2"  DASy
 SG_ VFC_Obj13A_DxStdDev : 144|10@1+ (0.05,0) [0|51.15] "m"  DASy
 SG_ VFC_Obj13A_DyStdDev : 160|10@1+ (0.02,0) [0|20.46] "m"  DASy
 SG_ VFC_Obj13A_VxStdDev : 176|10@1+ (0.1,0) [0|102.3] "m/s"  DASy
 SG_ VFC_Obj13A_VyStdDev : 192|9@1+ (0.1,0) [0|51.1] "m/s"  DASy
 SG_ VFC_Obj13A_AxStdDev : 40|8@1+ (0.1,0) [0|25.5] "m/s^2"  DASy
 SG_ VFC_Obj13A_AyStdDev : 136|8@1+ (0.1,0) [0|25.5] "m/s^2"  DASy
 SG_ VFC_Obj13A_Length : 217|9@1+ (0.05,0) [0|25.55] "m"  DASy
 SG_ VFC_Obj13A_Width : 294|10@1+ (0.01,0) [0|10.23] "m"  DASy
 SG_ VFC_Obj13A_Height : 208|9@1+ (0.01,0) [0|5.11] "m"  DASy
 SG_ VFC_Obj13A_LengthStdDev : 384|7@1+ (0.05,0) [0|5] "m"  DASy
 SG_ VFC_Obj13A_WidthStdDev : 391|7@1+ (0.01,0) [0|1] "m"  DASy
 SG_ VFC_Obj13A_HeightStdDev : 201|7@1+ (0.01,0) [0|1] "m"  DASy
 SG_ VFC_Obj13A_EdgeLeft : 411|13@1+ (0.00025,-1) [-1|1] "unitless"  DASy
 SG_ VFC_Obj13A_EdgeMid : 398|13@1+ (0.00025,-1) [-1|1] "unitless"  DASy
 SG_ VFC_Obj13A_EdgeRight : 424|13@1+ (0.00025,-1) [-1|1] "unitless"  DASy
 SG_ VFC_Obj13A_EdgeTop : 448|12@1+ (0.00025,-0.5) [-0.5|0.5] "unitless"  DASy
 SG_ VFC_Obj13A_EdgeBottom : 269|12@1+ (0.00025,-0.5) [-0.5|0.5] "unitless"  DASy
 SG_ VFC_Obj13A_EdgeLeftStdDev : 440|8@1+ (0.0002,0) [0|0.051] "unitless"  DASy
 SG_ VFC_Obj13A_EdgeMidStdDev : 464|8@1+ (0.0002,0) [0|0.051] "unitless"  DASy
 SG_ VFC_Obj13A_EdgeRightStdDev : 472|8@1+ (0.0002,0) [0|0.051] "unitless"  DASy
 SG_ VFC_Obj13A_EdgeTopStdDev : 480|8@1+ (0.0002,0) [0|0.051] "unitless"  DASy
 SG_ VFC_Obj13A_EdgeBottomStdDev : 488|8@1+ (0.0002,0) [0|0.051] "unitless"  DASy
 SG_ VFC_Obj13A_NormVx : 304|16@1+ (0.001,-40) [-40|25] "1/s"  DASy
 SG_ VFC_Obj13A_NormAx : 235|13@1+ (0.002,-10) [-10|6] "1/s^2"  DASy
 SG_ VFC_Obj13A_NormVyEdgeLeft : 256|13@1+ (0.001,-4) [-4|4] "1/s"  DASy
 SG_ VFC_Obj13A_NormVyEdgeRight : 281|13@1+ (0.001,-4) [-4|4] "1/s"  DASy
 SG_ VFC_Obj13A_NormVxStdDev : 368|10@1+ (0.001,0) [0|1.023] "1/s"  DASy
 SG_ VFC_Obj13A_NormAxStdDev : 328|10@1+ (0.0025,0) [0|2.5575] "1/s^2"  DASy
 SG_ VFC_Obj13A_NormVyEdgeLeftStdDev : 248|8@1+ (0.001,0) [0|0.255] "1/s"  DASy
 SG_ VFC_Obj13A_NormVyEdgeRightStdDev : 320|8@1+ (0.001,0) [0|0.255] "1/s"  DASy
 SG_ VFC_Obj13A_ScaleChange : 338|14@1+ (0.0001,0.5) [0.5|2.1383] "unitless"  DASy
 SG_ VFC_Obj13A_ScaleChngStdDev : 352|10@1+ (0.0001,0) [0|0.1023] "unitless"  DASy
 SG_ VFC_Obj13A_HeadingAngle : 226|9@1+ (0.01,-1.57) [-1.57|1.57] "rad"  DASy
 SG_ VFC_Obj13A_HeadingAngleStdDev : 186|6@1+ (0.01,0) [0|0.5] "rad"  DASy
 SG_ VFC_Obj13A_HeadOrientation : 460|4@1+ (1,0) [0|15] ""  DASy
 SG_ VFC_Obj13A_CompletelyInImg : 121|1@1+ (1,0) [0|1] ""  DASy
 SG_ VFC_Obj13A_ProbMovingLat : 154|6@1+ (2,0) [0|100] "%"  DASy
 SG_ VFC_Obj13A_ProbMovingLong : 170|6@1+ (2,0) [0|100] "%"  DASy
 SG_ VFC_Obj13A_ProbExist : 122|6@1+ (2,0) [0|100] "%"  DASy
 SG_ VFC_Obj13A_MeasSource : 91|5@1+ (1,0) [0|31] ""  DASy
 SG_ VFC_Obj13A_Reliability : 362|6@1+ (1,0) [0|63] ""  DASy
 SG_ VFC_Obj13A_Measured : 78|2@1+ (1,0) [0|3] ""  DASy
 SG_ VFC_Obj13A_VisibleView : 437|3@1+ (1,0) [0|4] ""  DASy
 SG_ VFC_Obj13A_ClassifiedView : 496|3@1+ (1,0) [0|4] ""  DASy
 SG_ VFC_Obj13A_DirIndicator : 106|3@1+ (1,0) [0|4] ""  DASy
 SG_ VFC_Obj13A_BrakeLight : 109|3@1+ (1,0) [0|7] ""  DASy

BO_ 126 VFC_Object14A: 64 MPC3
 SG_ VFC_Obj14A_CRC : 0|16@1+ (1,0) [0|65535] ""  DASy
 SG_ VFC_Obj14A_AliveCtr : 16|8@1+ (1,0) [0|255] ""  DASy
 SG_ VFC_Obj14A_ProtBlockCtr : 24|4@1+ (1,0) [0|15] ""  DASy
 SG_ VFC_Obj14A_ID : 32|8@1+ (1,0) [1|255] ""  DASy
 SG_ VFC_Obj14A_Type : 60|4@1+ (1,0) [0|15] ""  DASy
 SG_ VFC_Obj14A_TypeProb : 378|6@1+ (2,0) [0|100] "%"  DASy
 SG_ VFC_Obj14A_Dx : 48|12@1+ (0.05,0) [0|204.75] "m"  DASy
 SG_ VFC_Obj14A_Dy : 64|14@1+ (0.01,-80) [-80|80] "m"  DASy
 SG_ VFC_Obj14A_Vx : 80|11@1+ (0.1,-154) [-154|50] "m/s"  DASy
 SG_ VFC_Obj14A_Vy : 96|10@1+ (0.1,-50) [-50|50] "m/s"  DASy
 SG_ VFC_Obj14A_Ax : 112|9@1+ (0.1,-16) [-16|16] "m/s^2"  DASy
 SG_ VFC_Obj14A_Ay : 128|8@1+ (0.1,-12) [-12|12] "m/s^2"  DASy
 SG_ VFC_Obj14A_DxStdDev : 144|10@1+ (0.05,0) [0|51.15] "m"  DASy
 SG_ VFC_Obj14A_DyStdDev : 160|10@1+ (0.02,0) [0|20.46] "m"  DASy
 SG_ VFC_Obj14A_VxStdDev : 176|10@1+ (0.1,0) [0|102.3] "m/s"  DASy
 SG_ VFC_Obj14A_VyStdDev : 192|9@1+ (0.1,0) [0|51.1] "m/s"  DASy
 SG_ VFC_Obj14A_AxStdDev : 40|8@1+ (0.1,0) [0|25.5] "m/s^2"  DASy
 SG_ VFC_Obj14A_AyStdDev : 136|8@1+ (0.1,0) [0|25.5] "m/s^2"  DASy
 SG_ VFC_Obj14A_Length : 217|9@1+ (0.05,0) [0|25.55] "m"  DASy
 SG_ VFC_Obj14A_Width : 294|10@1+ (0.01,0) [0|10.23] "m"  DASy
 SG_ VFC_Obj14A_Height : 208|9@1+ (0.01,0) [0|5.11] "m"  DASy
 SG_ VFC_Obj14A_LengthStdDev : 384|7@1+ (0.05,0) [0|5] "m"  DASy
 SG_ VFC_Obj14A_WidthStdDev : 391|7@1+ (0.01,0) [0|1] "m"  DASy
 SG_ VFC_Obj14A_HeightStdDev : 201|7@1+ (0.01,0) [0|1] "m"  DASy
 SG_ VFC_Obj14A_EdgeLeft : 411|13@1+ (0.00025,-1) [-1|1] "unitless"  DASy
 SG_ VFC_Obj14A_EdgeMid : 398|13@1+ (0.00025,-1) [-1|1] "unitless"  DASy
 SG_ VFC_Obj14A_EdgeRight : 424|13@1+ (0.00025,-1) [-1|1] "unitless"  DASy
 SG_ VFC_Obj14A_EdgeTop : 448|12@1+ (0.00025,-0.5) [-0.5|0.5] "unitless"  DASy
 SG_ VFC_Obj14A_EdgeBottom : 269|12@1+ (0.00025,-0.5) [-0.5|0.5] "unitless"  DASy
 SG_ VFC_Obj14A_EdgeLeftStdDev : 440|8@1+ (0.0002,0) [0|0.051] "unitless"  DASy
 SG_ VFC_Obj14A_EdgeMidStdDev : 464|8@1+ (0.0002,0) [0|0.051] "unitless"  DASy
 SG_ VFC_Obj14A_EdgeRightStdDev : 472|8@1+ (0.0002,0) [0|0.051] "unitless"  DASy
 SG_ VFC_Obj14A_EdgeTopStdDev : 480|8@1+ (0.0002,0) [0|0.051] "unitless"  DASy
 SG_ VFC_Obj14A_EdgeBottomStdDev : 488|8@1+ (0.0002,0) [0|0.051] "unitless"  DASy
 SG_ VFC_Obj14A_NormVx : 304|16@1+ (0.001,-40) [-40|25] "1/s"  DASy
 SG_ VFC_Obj14A_NormAx : 235|13@1+ (0.002,-10) [-10|6] "1/s^2"  DASy
 SG_ VFC_Obj14A_NormVyEdgeLeft : 256|13@1+ (0.001,-4) [-4|4] "1/s"  DASy
 SG_ VFC_Obj14A_NormVyEdgeRight : 281|13@1+ (0.001,-4) [-4|4] "1/s"  DASy
 SG_ VFC_Obj14A_NormVxStdDev : 368|10@1+ (0.001,0) [0|1.023] "1/s"  DASy
 SG_ VFC_Obj14A_NormAxStdDev : 328|10@1+ (0.0025,0) [0|2.5575] "1/s^2"  DASy
 SG_ VFC_Obj14A_NormVyEdgeLeftStdDev : 248|8@1+ (0.001,0) [0|0.255] "1/s"  DASy
 SG_ VFC_Obj14A_NormVyEdgeRightStdDev : 320|8@1+ (0.001,0) [0|0.255] "1/s"  DASy
 SG_ VFC_Obj14A_ScaleChange : 338|14@1+ (0.0001,0.5) [0.5|2.1383] "unitless"  DASy
 SG_ VFC_Obj14A_ScaleChngStdDev : 352|10@1+ (0.0001,0) [0|0.1023] "unitless"  DASy
 SG_ VFC_Obj14A_HeadingAngle : 226|9@1+ (0.01,-1.57) [-1.57|1.57] "rad"  DASy
 SG_ VFC_Obj14A_HeadingAngleStdDev : 186|6@1+ (0.01,0) [0|0.5] "rad"  DASy
 SG_ VFC_Obj14A_HeadOrientation : 460|4@1+ (1,0) [0|15] ""  DASy
 SG_ VFC_Obj14A_CompletelyInImg : 121|1@1+ (1,0) [0|1] ""  DASy
 SG_ VFC_Obj14A_ProbMovingLat : 154|6@1+ (2,0) [0|100] "%"  DASy
 SG_ VFC_Obj14A_ProbMovingLong : 170|6@1+ (2,0) [0|100] "%"  DASy
 SG_ VFC_Obj14A_ProbExist : 122|6@1+ (2,0) [0|100] "%"  DASy
 SG_ VFC_Obj14A_MeasSource : 91|5@1+ (1,0) [0|31] ""  DASy
 SG_ VFC_Obj14A_Reliability : 362|6@1+ (1,0) [0|63] ""  DASy
 SG_ VFC_Obj14A_Measured : 78|2@1+ (1,0) [0|3] ""  DASy
 SG_ VFC_Obj14A_VisibleView : 437|3@1+ (1,0) [0|4] ""  DASy
 SG_ VFC_Obj14A_ClassifiedView : 496|3@1+ (1,0) [0|4] ""  DASy
 SG_ VFC_Obj14A_DirIndicator : 106|3@1+ (1,0) [0|4] ""  DASy
 SG_ VFC_Obj14A_BrakeLight : 109|3@1+ (1,0) [0|7] ""  DASy

CM_ "for BJEV BL05";
CM_ SG_ 80 VFC_GlobalHdr_CRC "CRC - Autosar E2E Profile 5";
CM_ SG_ 80 VFC_GlobalHdr_AliveCtr "Alive counter - Autosar E2E Profile 5";
CM_ SG_ 80 VFC_GlobalHdr_SensorState "The current state of the camera system";
CM_ SG_ 80 VFC_GlobalHdr_CalibState "The calibration state of the camera system";
CM_ SG_ 80 VFC_GlobalHdr_ProtocolVersion "Protocol version to be send (BCD coded: Major.Minor): 0x0200 = V2.0";
CM_ SG_ 80 VFC_GlobalHdr_TimeStampStatus "Autosar StbM_TimeBaseStatusType bitfield with extension:
Bit 0: TIMEOUT
Bit 1: Reserved1
Bit 2: SYNC_TO_GATEWAY
Bit 3: GLOBAL_TIME_BASE
Bit 4: TIMELEAP_FUTURE
Bit 5: TIMELEAP_PAST
Bit 6: Reserved6
Bit 7: Extension: GENERAL_ERROR";
CM_ SG_ 80 VFC_GlobalHdr_TimeStamp "TimeStamp of frame";
CM_ SG_ 80 VFC_GlobalHdr_SwVersion "SW version: 4 digits major version, 2 digits minor version";
CM_ SG_ 80 VFC_GlobalHdr_FrameNumber "The frame number that the data belongs to";
CM_ SG_ 80 VFC_GlobalHdr_MountPosX "The current estimation of mounting position of the camera in the longitudinal direction";
CM_ SG_ 80 VFC_GlobalHdr_MountPosY "The current estimation of mounting position of the camera in the lateral direction";
CM_ SG_ 80 VFC_GlobalHdr_MountPosZ "The current estimation of mounting position of the camera in the vertical direction";
CM_ SG_ 80 VFC_GlobalHdr_CalibYawAngle "The calibrated yaw angle of the camera";
CM_ SG_ 80 VFC_GlobalHdr_CalibPitchAngle "The calibrated pitch angle of the camera";
CM_ SG_ 80 VFC_GlobalHdr_CalibRollAngle "The calibrated roll angle of the camera";
CM_ SG_ 80 VFC_GlobalHdr_CalYawAngStdDev "The standard deviation of the calibrated yaw angle of the camera";
CM_ SG_ 80 VFC_GlobalHdr_CalPitchAngStdDev "The standard deviation of the calibrated pitch angle of the camera";
CM_ SG_ 80 VFC_GlobalHdr_CalRollAngStdDev "The standard deviation of the calibrated roll angle of the camera";
CM_ SG_ 80 VFC_GlobalHdr_FV "SecOC Freshness Value (Profile 1)";
CM_ SG_ 80 VFC_GlobalHdr_MAC "SecOC MAC (Profile 1)";
CM_ SG_ 96 VFC_ObjHdr_CRC "CRC - Autosar E2E Profile 5";
CM_ SG_ 96 VFC_ObjHdr_AliveCtr "Alive counter - Autosar E2E Profile 5";
CM_ SG_ 96 VFC_ObjHdr_ProtBlockCtr "Protocol-Signal: Block-Counter";
CM_ SG_ 96 VFC_ObjHdr_ProtObjCount "Protocol-Signal: count of all objects";
CM_ SG_ 96 VFC_ObjHdr_State "Informs the system of the current state of the camera";
CM_ SG_ 96 VFC_ObjHdr_TimeStampStatus "Autosar StbM_TimeBaseStatusType bitfield with extension:
Bit 0: TIMEOUT
Bit 1: Reserved1
Bit 2: SYNC_TO_GATEWAY
Bit 3: GLOBAL_TIME_BASE
Bit 4: TIMELEAP_FUTURE
Bit 5: TIMELEAP_PAST
Bit 6: Reserved6
Bit 7: Extension: GENERAL_ERROR";
CM_ SG_ 96 VFC_ObjHdr_TimeStamp "TimeStamp of Objects";
CM_ SG_ 96 VFC_ObjHdr_FV "SecOC Freshness Value (Profile 1)";
CM_ SG_ 96 VFC_ObjHdr_MAC "SecOC MAC (Profile 1)";
CM_ SG_ 98 VFC_Obj00A_CRC "CRC - Autosar E2E Profile 5";
CM_ SG_ 98 VFC_Obj00A_AliveCtr "Alive counter - Autosar E2E Profile 5";
CM_ SG_ 98 VFC_Obj00A_ProtBlockCtr "Protocol-Signal: Block-Counter";
CM_ SG_ 98 VFC_Obj00A_ID "Unique Object ID";
CM_ SG_ 98 VFC_Obj00A_Type "Classification of the object";
CM_ SG_ 98 VFC_Obj00A_TypeProb "Probability of the classified object type";
CM_ SG_ 98 VFC_Obj00A_Dx "Object distance in longitudinal direction";
CM_ SG_ 98 VFC_Obj00A_Dy "Object distance in lateral direction";
CM_ SG_ 98 VFC_Obj00A_Vx "Object velocity in longitudinal direction";
CM_ SG_ 98 VFC_Obj00A_Vy "Object velocity in lateral direction";
CM_ SG_ 98 VFC_Obj00A_Ax "Object acceleration in longitudinal direction";
CM_ SG_ 98 VFC_Obj00A_Ay "Object acceleration in lateral direction";
CM_ SG_ 98 VFC_Obj00A_DxStdDev "Standard deviation of Object distance in longitudinal direction";
CM_ SG_ 98 VFC_Obj00A_DyStdDev "Standard deviation of Object distance in lateral direction";
CM_ SG_ 98 VFC_Obj00A_VxStdDev "Standard deviation of Object velocity in longitudinal direction";
CM_ SG_ 98 VFC_Obj00A_VyStdDev "Standard deviation of Object velocity in lateral direction";
CM_ SG_ 98 VFC_Obj00A_AxStdDev "Standard deviation of Object acceleration in longitudinal direction";
CM_ SG_ 98 VFC_Obj00A_AyStdDev "Standard deviation of Object acceleration in lateral direction";
CM_ SG_ 98 VFC_Obj00A_Length "Length of the object";
CM_ SG_ 98 VFC_Obj00A_Width "Width of the object";
CM_ SG_ 98 VFC_Obj00A_Height "Height of the object";
CM_ SG_ 98 VFC_Obj00A_LengthStdDev "Standard deviation of object length";
CM_ SG_ 98 VFC_Obj00A_WidthStdDev "Standard deviation of object width";
CM_ SG_ 98 VFC_Obj00A_HeightStdDev "Standard deviation of object height";
CM_ SG_ 98 VFC_Obj00A_EdgeLeft "In ACCS coordinates; corresponds to tan(viewing angle of left object edge)";
CM_ SG_ 98 VFC_Obj00A_EdgeMid "In ACCS coordinates; corresponds to tan(viewing angle of middle object edge)";
CM_ SG_ 98 VFC_Obj00A_EdgeRight "In ACCS coordinates; corresponds to tan(viewing angle of right object edge)";
CM_ SG_ 98 VFC_Obj00A_EdgeTop "In ACCS coordinates; corresponds to tan(viewing angle of top object edge)";
CM_ SG_ 98 VFC_Obj00A_EdgeBottom "In ACCS coordinates; corresponds to tan(viewing angle of bottom object edge)";
CM_ SG_ 98 VFC_Obj00A_EdgeLeftStdDev "Standard deviation of the ACCS left object edge";
CM_ SG_ 98 VFC_Obj00A_EdgeMidStdDev "Standard deviation of the ACCS middle object edge";
CM_ SG_ 98 VFC_Obj00A_EdgeRightStdDev "Standard deviation of the ACCS right object edge";
CM_ SG_ 98 VFC_Obj00A_EdgeTopStdDev "Standard deviation of the ACCS top object edge";
CM_ SG_ 98 VFC_Obj00A_EdgeBottomStdDev "Standard deviation of the ACCS bottom object edge";
CM_ SG_ 98 VFC_Obj00A_NormVx "Normalised Object velocity in longitudinal direction";
CM_ SG_ 98 VFC_Obj00A_NormAx "Normalised Object acceleration in longitudinal direction";
CM_ SG_ 98 VFC_Obj00A_NormVyEdgeLeft "Normalised velocity of the ACCS left object edge in lateral direction";
CM_ SG_ 98 VFC_Obj00A_NormVyEdgeRight "Normalised velocity of the ACCS right object edge in lateral direction";
CM_ SG_ 98 VFC_Obj00A_NormVxStdDev "Standard deviation of Normalised Object velocity in longitudinal direction";
CM_ SG_ 98 VFC_Obj00A_NormAxStdDev "Standard deviation of Normalised Object acceleration in longitudinal direction";
CM_ SG_ 98 VFC_Obj00A_NormVyEdgeLeftStdDev "Standard deviation of Normalised velocity of the ACCS left object edge in lateral direction";
CM_ SG_ 98 VFC_Obj00A_NormVyEdgeRightStdDev "Standard deviation of Normalised velocity of the ACCS right object edge in lateral direction";
CM_ SG_ 98 VFC_Obj00A_ScaleChange "A scale change of of the detected object";
CM_ SG_ 98 VFC_Obj00A_ScaleChngStdDev "Standard deviation of object scale change";
CM_ SG_ 98 VFC_Obj00A_HeadingAngle "Heading angle of the object";
CM_ SG_ 98 VFC_Obj00A_HeadingAngleStdDev "Standard deviation of object Heading angle";
CM_ SG_ 98 VFC_Obj00A_HeadOrientation "The orientation of the head of cyclists or pedestrians that are detected";
CM_ SG_ 98 VFC_Obj00A_CompletelyInImg "indicator if the object is completely measured in the image";
CM_ SG_ 98 VFC_Obj00A_ProbMovingLat "Probability of object moving laterally";
CM_ SG_ 98 VFC_Obj00A_ProbMovingLong "Probability of object moving longitudinally";
CM_ SG_ 98 VFC_Obj00A_ProbExist "Object existence probability";
CM_ SG_ 98 VFC_Obj00A_MeasSource "Bitfield for the measurement programs from which this object originates
Bit 0: MOD
Bit 1: PDET
Bit 2: OFT
Bit 3: OLS
Bit 4: RESERVED";
CM_ SG_ 98 VFC_Obj00A_Reliability "The bitfield shows if the signal quality is assumed to be sufficient for functions with safety target -no false positives-
Bit 0: DYNAMIC
Bit 1: SEMSEG_SURFACE
Bit 2: WDD_CRITICAL
Bit 3: GOD_CONFIRMED
Bit 4: RESTRICTED
Bit 5: ISO26262_SAFE";
CM_ SG_ 98 VFC_Obj00A_Measured "Indicator if the object detected is measured or predicted";
CM_ SG_ 98 VFC_Obj00A_VisibleView "The visible view of the detected object";
CM_ SG_ 98 VFC_Obj00A_ClassifiedView "The classified view of object to be used in connection with Heading angle";
CM_ SG_ 98 VFC_Obj00A_DirIndicator "The detected direction indicator lights";
CM_ SG_ 98 VFC_Obj00A_BrakeLight "The number of detected lights. More confident if more lights are detected.";
CM_ SG_ 100 VFC_Obj01A_CRC "CRC - Autosar E2E Profile 5";
CM_ SG_ 100 VFC_Obj01A_AliveCtr "Alive counter - Autosar E2E Profile 5";
CM_ SG_ 100 VFC_Obj01A_ProtBlockCtr "Protocol-Signal: Block-Counter";
CM_ SG_ 100 VFC_Obj01A_ID "Unique Object ID";
CM_ SG_ 100 VFC_Obj01A_Type "Classification of the object";
CM_ SG_ 100 VFC_Obj01A_TypeProb "Probability of the classified object type";
CM_ SG_ 100 VFC_Obj01A_Dx "Object distance in longitudinal direction";
CM_ SG_ 100 VFC_Obj01A_Dy "Object distance in lateral direction";
CM_ SG_ 100 VFC_Obj01A_Vx "Object velocity in longitudinal direction";
CM_ SG_ 100 VFC_Obj01A_Vy "Object velocity in lateral direction";
CM_ SG_ 100 VFC_Obj01A_Ax "Object acceleration in longitudinal direction";
CM_ SG_ 100 VFC_Obj01A_Ay "Object acceleration in lateral direction";
CM_ SG_ 100 VFC_Obj01A_DxStdDev "Standard deviation of Object distance in longitudinal direction";
CM_ SG_ 100 VFC_Obj01A_DyStdDev "Standard deviation of Object distance in lateral direction";
CM_ SG_ 100 VFC_Obj01A_VxStdDev "Standard deviation of Object velocity in longitudinal direction";
CM_ SG_ 100 VFC_Obj01A_VyStdDev "Standard deviation of Object velocity in lateral direction";
CM_ SG_ 100 VFC_Obj01A_AxStdDev "Standard deviation of Object acceleration in longitudinal direction";
CM_ SG_ 100 VFC_Obj01A_AyStdDev "Standard deviation of Object acceleration in lateral direction";
CM_ SG_ 100 VFC_Obj01A_Length "Length of the object";
CM_ SG_ 100 VFC_Obj01A_Width "Width of the object";
CM_ SG_ 100 VFC_Obj01A_Height "Height of the object";
CM_ SG_ 100 VFC_Obj01A_LengthStdDev "Standard deviation of object length";
CM_ SG_ 100 VFC_Obj01A_WidthStdDev "Standard deviation of object width";
CM_ SG_ 100 VFC_Obj01A_HeightStdDev "Standard deviation of object height";
CM_ SG_ 100 VFC_Obj01A_EdgeLeft "In ACCS coordinates; corresponds to tan(viewing angle of left object edge)";
CM_ SG_ 100 VFC_Obj01A_EdgeMid "In ACCS coordinates; corresponds to tan(viewing angle of middle object edge)";
CM_ SG_ 100 VFC_Obj01A_EdgeRight "In ACCS coordinates; corresponds to tan(viewing angle of right object edge)";
CM_ SG_ 100 VFC_Obj01A_EdgeTop "In ACCS coordinates; corresponds to tan(viewing angle of top object edge)";
CM_ SG_ 100 VFC_Obj01A_EdgeBottom "In ACCS coordinates; corresponds to tan(viewing angle of bottom object edge)";
CM_ SG_ 100 VFC_Obj01A_EdgeLeftStdDev "Standard deviation of the ACCS left object edge";
CM_ SG_ 100 VFC_Obj01A_EdgeMidStdDev "Standard deviation of the ACCS middle object edge";
CM_ SG_ 100 VFC_Obj01A_EdgeRightStdDev "Standard deviation of the ACCS right object edge";
CM_ SG_ 100 VFC_Obj01A_EdgeTopStdDev "Standard deviation of the ACCS top object edge";
CM_ SG_ 100 VFC_Obj01A_EdgeBottomStdDev "Standard deviation of the ACCS bottom object edge";
CM_ SG_ 100 VFC_Obj01A_NormVx "Normalised Object velocity in longitudinal direction";
CM_ SG_ 100 VFC_Obj01A_NormAx "Normalised Object acceleration in longitudinal direction";
CM_ SG_ 100 VFC_Obj01A_NormVyEdgeLeft "Normalised velocity of the ACCS left object edge in lateral direction";
CM_ SG_ 100 VFC_Obj01A_NormVyEdgeRight "Normalised velocity of the ACCS right object edge in lateral direction";
CM_ SG_ 100 VFC_Obj01A_NormVxStdDev "Standard deviation of Normalised Object velocity in longitudinal direction";
CM_ SG_ 100 VFC_Obj01A_NormAxStdDev "Standard deviation of Normalised Object acceleration in longitudinal direction";
CM_ SG_ 100 VFC_Obj01A_NormVyEdgeLeftStdDev "Standard deviation of Normalised velocity of the ACCS left object edge in lateral direction";
CM_ SG_ 100 VFC_Obj01A_NormVyEdgeRightStdDev "Standard deviation of Normalised velocity of the ACCS right object edge in lateral direction";
CM_ SG_ 100 VFC_Obj01A_ScaleChange "A scale change of of the detected object";
CM_ SG_ 100 VFC_Obj01A_ScaleChngStdDev "Standard deviation of object scale change";
CM_ SG_ 100 VFC_Obj01A_HeadingAngle "Heading angle of the object";
CM_ SG_ 100 VFC_Obj01A_HeadingAngleStdDev "Standard deviation of object Heading angle";
CM_ SG_ 100 VFC_Obj01A_HeadOrientation "The orientation of the head of cyclists or pedestrians that are detected";
CM_ SG_ 100 VFC_Obj01A_CompletelyInImg "indicator if the object is completely measured in the image";
CM_ SG_ 100 VFC_Obj01A_ProbMovingLat "Probability of object moving laterally";
CM_ SG_ 100 VFC_Obj01A_ProbMovingLong "Probability of object moving longitudinally";
CM_ SG_ 100 VFC_Obj01A_ProbExist "Object existence probability";
CM_ SG_ 100 VFC_Obj01A_MeasSource "Bitfield for the measurement programs from which this object originates
Bit 0: MOD
Bit 1: PDET
Bit 2: OFT
Bit 3: OLS
Bit 4: RESERVED";
CM_ SG_ 100 VFC_Obj01A_Reliability "The bitfield shows if the signal quality is assumed to be sufficient for functions with safety target -no false positives- 
Bit 0: DYNAMIC
Bit 1: SEMSEG_SURFACE
Bit 2: WDD_CRITICAL
Bit 3: GOD_CONFIRMED
Bit 4: RESTRICTED
Bit 5: ISO26262_SAFE";
CM_ SG_ 100 VFC_Obj01A_Measured "Indicator if the object detected is measured or predicted";
CM_ SG_ 100 VFC_Obj01A_VisibleView "The visible view of the detected object";
CM_ SG_ 100 VFC_Obj01A_ClassifiedView "The classified view of object to be used in connection with Heading angle";
CM_ SG_ 100 VFC_Obj01A_DirIndicator "The detected direction indicator lights";
CM_ SG_ 100 VFC_Obj01A_BrakeLight "The number of detected lights. More confident if more lights are detected.";
CM_ SG_ 102 VFC_Obj02A_CRC "CRC - Autosar E2E Profile 5";
CM_ SG_ 102 VFC_Obj02A_AliveCtr "Alive counter - Autosar E2E Profile 5";
CM_ SG_ 102 VFC_Obj02A_ProtBlockCtr "Protocol-Signal: Block-Counter";
CM_ SG_ 102 VFC_Obj02A_ID "Unique Object ID";
CM_ SG_ 102 VFC_Obj02A_Type "Classification of the object";
CM_ SG_ 102 VFC_Obj02A_TypeProb "Probability of the classified object type";
CM_ SG_ 102 VFC_Obj02A_Dx "Object distance in longitudinal direction";
CM_ SG_ 102 VFC_Obj02A_Dy "Object distance in lateral direction";
CM_ SG_ 102 VFC_Obj02A_Vx "Object velocity in longitudinal direction";
CM_ SG_ 102 VFC_Obj02A_Vy "Object velocity in lateral direction";
CM_ SG_ 102 VFC_Obj02A_Ax "Object acceleration in longitudinal direction";
CM_ SG_ 102 VFC_Obj02A_Ay "Object acceleration in lateral direction";
CM_ SG_ 102 VFC_Obj02A_DxStdDev "Standard deviation of Object distance in longitudinal direction";
CM_ SG_ 102 VFC_Obj02A_DyStdDev "Standard deviation of Object distance in lateral direction";
CM_ SG_ 102 VFC_Obj02A_VxStdDev "Standard deviation of Object velocity in longitudinal direction";
CM_ SG_ 102 VFC_Obj02A_VyStdDev "Standard deviation of Object velocity in lateral direction";
CM_ SG_ 102 VFC_Obj02A_AxStdDev "Standard deviation of Object acceleration in longitudinal direction";
CM_ SG_ 102 VFC_Obj02A_AyStdDev "Standard deviation of Object acceleration in lateral direction";
CM_ SG_ 102 VFC_Obj02A_Length "Length of the object";
CM_ SG_ 102 VFC_Obj02A_Width "Width of the object";
CM_ SG_ 102 VFC_Obj02A_Height "Height of the object";
CM_ SG_ 102 VFC_Obj02A_LengthStdDev "Standard deviation of object length";
CM_ SG_ 102 VFC_Obj02A_WidthStdDev "Standard deviation of object width";
CM_ SG_ 102 VFC_Obj02A_HeightStdDev "Standard deviation of object height";
CM_ SG_ 102 VFC_Obj02A_EdgeLeft "In ACCS coordinates; corresponds to tan(viewing angle of left object edge)";
CM_ SG_ 102 VFC_Obj02A_EdgeMid "In ACCS coordinates; corresponds to tan(viewing angle of middle object edge)";
CM_ SG_ 102 VFC_Obj02A_EdgeRight "In ACCS coordinates; corresponds to tan(viewing angle of right object edge)";
CM_ SG_ 102 VFC_Obj02A_EdgeTop "In ACCS coordinates; corresponds to tan(viewing angle of top object edge)";
CM_ SG_ 102 VFC_Obj02A_EdgeBottom "In ACCS coordinates; corresponds to tan(viewing angle of bottom object edge)";
CM_ SG_ 102 VFC_Obj02A_EdgeLeftStdDev "Standard deviation of the ACCS left object edge";
CM_ SG_ 102 VFC_Obj02A_EdgeMidStdDev "Standard deviation of the ACCS middle object edge";
CM_ SG_ 102 VFC_Obj02A_EdgeRightStdDev "Standard deviation of the ACCS right object edge";
CM_ SG_ 102 VFC_Obj02A_EdgeTopStdDev "Standard deviation of the ACCS top object edge";
CM_ SG_ 102 VFC_Obj02A_EdgeBottomStdDev "Standard deviation of the ACCS bottom object edge";
CM_ SG_ 102 VFC_Obj02A_NormVx "Normalised Object velocity in longitudinal direction";
CM_ SG_ 102 VFC_Obj02A_NormAx "Normalised Object acceleration in longitudinal direction";
CM_ SG_ 102 VFC_Obj02A_NormVyEdgeLeft "Normalised velocity of the ACCS left object edge in lateral direction";
CM_ SG_ 102 VFC_Obj02A_NormVyEdgeRight "Normalised velocity of the ACCS right object edge in lateral direction";
CM_ SG_ 102 VFC_Obj02A_NormVxStdDev "Standard deviation of Normalised Object velocity in longitudinal direction";
CM_ SG_ 102 VFC_Obj02A_NormAxStdDev "Standard deviation of Normalised Object acceleration in longitudinal direction";
CM_ SG_ 102 VFC_Obj02A_NormVyEdgeLeftStdDev "Standard deviation of Normalised velocity of the ACCS left object edge in lateral direction";
CM_ SG_ 102 VFC_Obj02A_NormVyEdgeRightStdDev "Standard deviation of Normalised velocity of the ACCS right object edge in lateral direction";
CM_ SG_ 102 VFC_Obj02A_ScaleChange "A scale change of of the detected object";
CM_ SG_ 102 VFC_Obj02A_ScaleChngStdDev "Standard deviation of object scale change";
CM_ SG_ 102 VFC_Obj02A_HeadingAngle "Heading angle of the object";
CM_ SG_ 102 VFC_Obj02A_HeadingAngleStdDev "Standard deviation of object Heading angle";
CM_ SG_ 102 VFC_Obj02A_HeadOrientation "The orientation of the head of cyclists or pedestrians that are detected";
CM_ SG_ 102 VFC_Obj02A_CompletelyInImg "indicator if the object is completely measured in the image";
CM_ SG_ 102 VFC_Obj02A_ProbMovingLat "Probability of object moving laterally";
CM_ SG_ 102 VFC_Obj02A_ProbMovingLong "Probability of object moving longitudinally";
CM_ SG_ 102 VFC_Obj02A_ProbExist "Object existence probability";
CM_ SG_ 102 VFC_Obj02A_MeasSource "Bitfield for the measurement programs from which this object originates
Bit 0: MOD
Bit 1: PDET
Bit 2: OFT
Bit 3: OLS
Bit 4: RESERVED";
CM_ SG_ 102 VFC_Obj02A_Reliability "The bitfield shows if the signal quality is assumed to be sufficient for functions with safety target -no false positives-
Bit 0: DYNAMIC
Bit 1: SEMSEG_SURFACE
Bit 2: WDD_CRITICAL
Bit 3: GOD_CONFIRMED
Bit 4: RESTRICTED
Bit 5: ISO26262_SAFE";
CM_ SG_ 102 VFC_Obj02A_Measured "Indicator if the object detected is measured or predicted";
CM_ SG_ 102 VFC_Obj02A_VisibleView "The visible view of the detected object";
CM_ SG_ 102 VFC_Obj02A_ClassifiedView "The classified view of object to be used in connection with Heading angle";
CM_ SG_ 102 VFC_Obj02A_DirIndicator "The detected direction indicator lights";
CM_ SG_ 102 VFC_Obj02A_BrakeLight "The number of detected lights. More confident if more lights are detected.";
CM_ SG_ 104 VFC_Obj03A_CRC "CRC - Autosar E2E Profile 5";
CM_ SG_ 104 VFC_Obj03A_AliveCtr "Alive counter - Autosar E2E Profile 5";
CM_ SG_ 104 VFC_Obj03A_ProtBlockCtr "Protocol-Signal: Block-Counter";
CM_ SG_ 104 VFC_Obj03A_ID "Unique Object ID";
CM_ SG_ 104 VFC_Obj03A_Type "Classification of the object";
CM_ SG_ 104 VFC_Obj03A_TypeProb "Probability of the classified object type";
CM_ SG_ 104 VFC_Obj03A_Dx "Object distance in longitudinal direction";
CM_ SG_ 104 VFC_Obj03A_Dy "Object distance in lateral direction";
CM_ SG_ 104 VFC_Obj03A_Vx "Object velocity in longitudinal direction";
CM_ SG_ 104 VFC_Obj03A_Vy "Object velocity in lateral direction";
CM_ SG_ 104 VFC_Obj03A_Ax "Object acceleration in longitudinal direction";
CM_ SG_ 104 VFC_Obj03A_Ay "Object acceleration in lateral direction";
CM_ SG_ 104 VFC_Obj03A_DxStdDev "Standard deviation of Object distance in longitudinal direction";
CM_ SG_ 104 VFC_Obj03A_DyStdDev "Standard deviation of Object distance in lateral direction";
CM_ SG_ 104 VFC_Obj03A_VxStdDev "Standard deviation of Object velocity in longitudinal direction";
CM_ SG_ 104 VFC_Obj03A_VyStdDev "Standard deviation of Object velocity in lateral direction";
CM_ SG_ 104 VFC_Obj03A_AxStdDev "Standard deviation of Object acceleration in longitudinal direction";
CM_ SG_ 104 VFC_Obj03A_AyStdDev "Standard deviation of Object acceleration in lateral direction";
CM_ SG_ 104 VFC_Obj03A_Length "Length of the object";
CM_ SG_ 104 VFC_Obj03A_Width "Width of the object";
CM_ SG_ 104 VFC_Obj03A_Height "Height of the object";
CM_ SG_ 104 VFC_Obj03A_LengthStdDev "Standard deviation of object length";
CM_ SG_ 104 VFC_Obj03A_WidthStdDev "Standard deviation of object width";
CM_ SG_ 104 VFC_Obj03A_HeightStdDev "Standard deviation of object height";
CM_ SG_ 104 VFC_Obj03A_EdgeLeft "In ACCS coordinates; corresponds to tan(viewing angle of left object edge)";
CM_ SG_ 104 VFC_Obj03A_EdgeMid "In ACCS coordinates; corresponds to tan(viewing angle of middle object edge)";
CM_ SG_ 104 VFC_Obj03A_EdgeRight "In ACCS coordinates; corresponds to tan(viewing angle of right object edge)";
CM_ SG_ 104 VFC_Obj03A_EdgeTop "In ACCS coordinates; corresponds to tan(viewing angle of top object edge)";
CM_ SG_ 104 VFC_Obj03A_EdgeBottom "In ACCS coordinates; corresponds to tan(viewing angle of bottom object edge)";
CM_ SG_ 104 VFC_Obj03A_EdgeLeftStdDev "Standard deviation of the ACCS left object edge";
CM_ SG_ 104 VFC_Obj03A_EdgeMidStdDev "Standard deviation of the ACCS middle object edge";
CM_ SG_ 104 VFC_Obj03A_EdgeRightStdDev "Standard deviation of the ACCS right object edge";
CM_ SG_ 104 VFC_Obj03A_EdgeTopStdDev "Standard deviation of the ACCS top object edge";
CM_ SG_ 104 VFC_Obj03A_EdgeBottomStdDev "Standard deviation of the ACCS bottom object edge";
CM_ SG_ 104 VFC_Obj03A_NormVx "Normalised Object velocity in longitudinal direction";
CM_ SG_ 104 VFC_Obj03A_NormAx "Normalised Object acceleration in longitudinal direction";
CM_ SG_ 104 VFC_Obj03A_NormVyEdgeLeft "Normalised velocity of the ACCS left object edge in lateral direction";
CM_ SG_ 104 VFC_Obj03A_NormVyEdgeRight "Normalised velocity of the ACCS right object edge in lateral direction";
CM_ SG_ 104 VFC_Obj03A_NormVxStdDev "Standard deviation of Normalised Object velocity in longitudinal direction";
CM_ SG_ 104 VFC_Obj03A_NormAxStdDev "Standard deviation of Normalised Object acceleration in longitudinal direction";
CM_ SG_ 104 VFC_Obj03A_NormVyEdgeLeftStdDev "Standard deviation of Normalised velocity of the ACCS left object edge in lateral direction";
CM_ SG_ 104 VFC_Obj03A_NormVyEdgeRightStdDev "Standard deviation of Normalised velocity of the ACCS right object edge in lateral direction";
CM_ SG_ 104 VFC_Obj03A_ScaleChange "A scale change of of the detected object";
CM_ SG_ 104 VFC_Obj03A_ScaleChngStdDev "Standard deviation of object scale change";
CM_ SG_ 104 VFC_Obj03A_HeadingAngle "Heading angle of the object";
CM_ SG_ 104 VFC_Obj03A_HeadingAngleStdDev "Standard deviation of object Heading angle";
CM_ SG_ 104 VFC_Obj03A_HeadOrientation "The orientation of the head of cyclists or pedestrians that are detected";
CM_ SG_ 104 VFC_Obj03A_CompletelyInImg "indicator if the object is completely measured in the image";
CM_ SG_ 104 VFC_Obj03A_ProbMovingLat "Probability of object moving laterally";
CM_ SG_ 104 VFC_Obj03A_ProbMovingLong "Probability of object moving longitudinally";
CM_ SG_ 104 VFC_Obj03A_ProbExist "Object existence probability";
CM_ SG_ 104 VFC_Obj03A_MeasSource "Bitfield for the measurement programs from which this object originates
Bit 0: MOD
Bit 1: PDET
Bit 2: OFT
Bit 3: OLS
Bit 4: RESERVED";
CM_ SG_ 104 VFC_Obj03A_Reliability "The bitfield shows if the signal quality is assumed to be sufficient for functions with safety target -no false positives-
Bit 0: DYNAMIC
Bit 1: SEMSEG_SURFACE
Bit 2: WDD_CRITICAL
Bit 3: GOD_CONFIRMED
Bit 4: RESTRICTED
Bit 5: ISO26262_SAFE";
CM_ SG_ 104 VFC_Obj03A_Measured "Indicator if the object detected is measured or predicted";
CM_ SG_ 104 VFC_Obj03A_VisibleView "The visible view of the detected object";
CM_ SG_ 104 VFC_Obj03A_ClassifiedView "The classified view of object to be used in connection with Heading angle";
CM_ SG_ 104 VFC_Obj03A_DirIndicator "The detected direction indicator lights";
CM_ SG_ 104 VFC_Obj03A_BrakeLight "The number of detected lights. More confident if more lights are detected.";
CM_ SG_ 106 VFC_Obj04A_CRC "CRC - Autosar E2E Profile 5";
CM_ SG_ 106 VFC_Obj04A_AliveCtr "Alive counter - Autosar E2E Profile 5";
CM_ SG_ 106 VFC_Obj04A_ProtBlockCtr "Protocol-Signal: Block-Counter";
CM_ SG_ 106 VFC_Obj04A_ID "Unique Object ID";
CM_ SG_ 106 VFC_Obj04A_Type "Classification of the object";
CM_ SG_ 106 VFC_Obj04A_TypeProb "Probability of the classified object type";
CM_ SG_ 106 VFC_Obj04A_Dx "Object distance in longitudinal direction";
CM_ SG_ 106 VFC_Obj04A_Dy "Object distance in lateral direction";
CM_ SG_ 106 VFC_Obj04A_Vx "Object velocity in longitudinal direction";
CM_ SG_ 106 VFC_Obj04A_Vy "Object velocity in lateral direction";
CM_ SG_ 106 VFC_Obj04A_Ax "Object acceleration in longitudinal direction";
CM_ SG_ 106 VFC_Obj04A_Ay "Object acceleration in lateral direction";
CM_ SG_ 106 VFC_Obj04A_DxStdDev "Standard deviation of Object distance in longitudinal direction";
CM_ SG_ 106 VFC_Obj04A_DyStdDev "Standard deviation of Object distance in lateral direction";
CM_ SG_ 106 VFC_Obj04A_VxStdDev "Standard deviation of Object velocity in longitudinal direction";
CM_ SG_ 106 VFC_Obj04A_VyStdDev "Standard deviation of Object velocity in lateral direction";
CM_ SG_ 106 VFC_Obj04A_AxStdDev "Standard deviation of Object acceleration in longitudinal direction";
CM_ SG_ 106 VFC_Obj04A_AyStdDev "Standard deviation of Object acceleration in lateral direction";
CM_ SG_ 106 VFC_Obj04A_Length "Length of the object";
CM_ SG_ 106 VFC_Obj04A_Width "Width of the object";
CM_ SG_ 106 VFC_Obj04A_Height "Height of the object";
CM_ SG_ 106 VFC_Obj04A_LengthStdDev "Standard deviation of object length";
CM_ SG_ 106 VFC_Obj04A_WidthStdDev "Standard deviation of object width";
CM_ SG_ 106 VFC_Obj04A_HeightStdDev "Standard deviation of object height";
CM_ SG_ 106 VFC_Obj04A_EdgeLeft "In ACCS coordinates; corresponds to tan(viewing angle of left object edge)";
CM_ SG_ 106 VFC_Obj04A_EdgeMid "In ACCS coordinates; corresponds to tan(viewing angle of middle object edge)";
CM_ SG_ 106 VFC_Obj04A_EdgeRight "In ACCS coordinates; corresponds to tan(viewing angle of right object edge)";
CM_ SG_ 106 VFC_Obj04A_EdgeTop "In ACCS coordinates; corresponds to tan(viewing angle of top object edge)";
CM_ SG_ 106 VFC_Obj04A_EdgeBottom "In ACCS coordinates; corresponds to tan(viewing angle of bottom object edge)";
CM_ SG_ 106 VFC_Obj04A_EdgeLeftStdDev "Standard deviation of the ACCS left object edge";
CM_ SG_ 106 VFC_Obj04A_EdgeMidStdDev "Standard deviation of the ACCS middle object edge";
CM_ SG_ 106 VFC_Obj04A_EdgeRightStdDev "Standard deviation of the ACCS right object edge";
CM_ SG_ 106 VFC_Obj04A_EdgeTopStdDev "Standard deviation of the ACCS top object edge";
CM_ SG_ 106 VFC_Obj04A_EdgeBottomStdDev "Standard deviation of the ACCS bottom object edge";
CM_ SG_ 106 VFC_Obj04A_NormVx "Normalised Object velocity in longitudinal direction";
CM_ SG_ 106 VFC_Obj04A_NormAx "Normalised Object acceleration in longitudinal direction";
CM_ SG_ 106 VFC_Obj04A_NormVyEdgeLeft "Normalised velocity of the ACCS left object edge in lateral direction";
CM_ SG_ 106 VFC_Obj04A_NormVyEdgeRight "Normalised velocity of the ACCS right object edge in lateral direction";
CM_ SG_ 106 VFC_Obj04A_NormVxStdDev "Standard deviation of Normalised Object velocity in longitudinal direction";
CM_ SG_ 106 VFC_Obj04A_NormAxStdDev "Standard deviation of Normalised Object acceleration in longitudinal direction";
CM_ SG_ 106 VFC_Obj04A_NormVyEdgeLeftStdDev "Standard deviation of Normalised velocity of the ACCS left object edge in lateral direction";
CM_ SG_ 106 VFC_Obj04A_NormVyEdgeRightStdDev "Standard deviation of Normalised velocity of the ACCS right object edge in lateral direction";
CM_ SG_ 106 VFC_Obj04A_ScaleChange "A scale change of of the detected object";
CM_ SG_ 106 VFC_Obj04A_ScaleChngStdDev "Standard deviation of object scale change";
CM_ SG_ 106 VFC_Obj04A_HeadingAngle "Heading angle of the object";
CM_ SG_ 106 VFC_Obj04A_HeadingAngleStdDev "Standard deviation of object Heading angle";
CM_ SG_ 106 VFC_Obj04A_HeadOrientation "The orientation of the head of cyclists or pedestrians that are detected";
CM_ SG_ 106 VFC_Obj04A_CompletelyInImg "indicator if the object is completely measured in the image";
CM_ SG_ 106 VFC_Obj04A_ProbMovingLat "Probability of object moving laterally";
CM_ SG_ 106 VFC_Obj04A_ProbMovingLong "Probability of object moving longitudinally";
CM_ SG_ 106 VFC_Obj04A_ProbExist "Object existence probability";
CM_ SG_ 106 VFC_Obj04A_MeasSource "Bitfield for the measurement programs from which this object originates
Bit 0: MOD
Bit 1: PDET
Bit 2: OFT
Bit 3: OLS
Bit 4: RESERVED";
CM_ SG_ 106 VFC_Obj04A_Reliability "The bitfield shows if the signal quality is assumed to be sufficient for functions with safety target -no false positives-
Bit 0: DYNAMIC
Bit 1: SEMSEG_SURFACE
Bit 2: WDD_CRITICAL
Bit 3: GOD_CONFIRMED
Bit 4: RESTRICTED
Bit 5: ISO26262_SAFE";
CM_ SG_ 106 VFC_Obj04A_Measured "Indicator if the object detected is measured or predicted";
CM_ SG_ 106 VFC_Obj04A_VisibleView "The visible view of the detected object";
CM_ SG_ 106 VFC_Obj04A_ClassifiedView "The classified view of object to be used in connection with Heading angle";
CM_ SG_ 106 VFC_Obj04A_DirIndicator "The detected direction indicator lights";
CM_ SG_ 106 VFC_Obj04A_BrakeLight "The number of detected lights. More confident if more lights are detected.";
CM_ SG_ 108 VFC_Obj05A_CRC "CRC - Autosar E2E Profile 5";
CM_ SG_ 108 VFC_Obj05A_AliveCtr "Alive counter - Autosar E2E Profile 5";
CM_ SG_ 108 VFC_Obj05A_ProtBlockCtr "Protocol-Signal: Block-Counter";
CM_ SG_ 108 VFC_Obj05A_ID "Unique Object ID";
CM_ SG_ 108 VFC_Obj05A_Type "Classification of the object";
CM_ SG_ 108 VFC_Obj05A_TypeProb "Probability of the classified object type";
CM_ SG_ 108 VFC_Obj05A_Dx "Object distance in longitudinal direction";
CM_ SG_ 108 VFC_Obj05A_Dy "Object distance in lateral direction";
CM_ SG_ 108 VFC_Obj05A_Vx "Object velocity in longitudinal direction";
CM_ SG_ 108 VFC_Obj05A_Vy "Object velocity in lateral direction";
CM_ SG_ 108 VFC_Obj05A_Ax "Object acceleration in longitudinal direction";
CM_ SG_ 108 VFC_Obj05A_Ay "Object acceleration in lateral direction";
CM_ SG_ 108 VFC_Obj05A_DxStdDev "Standard deviation of Object distance in longitudinal direction";
CM_ SG_ 108 VFC_Obj05A_DyStdDev "Standard deviation of Object distance in lateral direction";
CM_ SG_ 108 VFC_Obj05A_VxStdDev "Standard deviation of Object velocity in longitudinal direction";
CM_ SG_ 108 VFC_Obj05A_VyStdDev "Standard deviation of Object velocity in lateral direction";
CM_ SG_ 108 VFC_Obj05A_AxStdDev "Standard deviation of Object acceleration in longitudinal direction";
CM_ SG_ 108 VFC_Obj05A_AyStdDev "Standard deviation of Object acceleration in lateral direction";
CM_ SG_ 108 VFC_Obj05A_Length "Length of the object";
CM_ SG_ 108 VFC_Obj05A_Width "Width of the object";
CM_ SG_ 108 VFC_Obj05A_Height "Height of the object";
CM_ SG_ 108 VFC_Obj05A_LengthStdDev "Standard deviation of object length";
CM_ SG_ 108 VFC_Obj05A_WidthStdDev "Standard deviation of object width";
CM_ SG_ 108 VFC_Obj05A_HeightStdDev "Standard deviation of object height";
CM_ SG_ 108 VFC_Obj05A_EdgeLeft "In ACCS coordinates; corresponds to tan(viewing angle of left object edge)";
CM_ SG_ 108 VFC_Obj05A_EdgeMid "In ACCS coordinates; corresponds to tan(viewing angle of middle object edge)";
CM_ SG_ 108 VFC_Obj05A_EdgeRight "In ACCS coordinates; corresponds to tan(viewing angle of right object edge)";
CM_ SG_ 108 VFC_Obj05A_EdgeTop "In ACCS coordinates; corresponds to tan(viewing angle of top object edge)";
CM_ SG_ 108 VFC_Obj05A_EdgeBottom "In ACCS coordinates; corresponds to tan(viewing angle of bottom object edge)";
CM_ SG_ 108 VFC_Obj05A_EdgeLeftStdDev "Standard deviation of the ACCS left object edge";
CM_ SG_ 108 VFC_Obj05A_EdgeMidStdDev "Standard deviation of the ACCS middle object edge";
CM_ SG_ 108 VFC_Obj05A_EdgeRightStdDev "Standard deviation of the ACCS right object edge";
CM_ SG_ 108 VFC_Obj05A_EdgeTopStdDev "Standard deviation of the ACCS top object edge";
CM_ SG_ 108 VFC_Obj05A_EdgeBottomStdDev "Standard deviation of the ACCS bottom object edge";
CM_ SG_ 108 VFC_Obj05A_NormVx "Normalised Object velocity in longitudinal direction";
CM_ SG_ 108 VFC_Obj05A_NormAx "Normalised Object acceleration in longitudinal direction";
CM_ SG_ 108 VFC_Obj05A_NormVyEdgeLeft "Normalised velocity of the ACCS left object edge in lateral direction";
CM_ SG_ 108 VFC_Obj05A_NormVyEdgeRight "Normalised velocity of the ACCS right object edge in lateral direction";
CM_ SG_ 108 VFC_Obj05A_NormVxStdDev "Standard deviation of Normalised Object velocity in longitudinal direction";
CM_ SG_ 108 VFC_Obj05A_NormAxStdDev "Standard deviation of Normalised Object acceleration in longitudinal direction";
CM_ SG_ 108 VFC_Obj05A_NormVyEdgeLeftStdDev "Standard deviation of Normalised velocity of the ACCS left object edge in lateral direction";
CM_ SG_ 108 VFC_Obj05A_NormVyEdgeRightStdDev "Standard deviation of Normalised velocity of the ACCS right object edge in lateral direction";
CM_ SG_ 108 VFC_Obj05A_ScaleChange "A scale change of of the detected object";
CM_ SG_ 108 VFC_Obj05A_ScaleChngStdDev "Standard deviation of object scale change";
CM_ SG_ 108 VFC_Obj05A_HeadingAngle "Heading angle of the object";
CM_ SG_ 108 VFC_Obj05A_HeadingAngleStdDev "Standard deviation of object Heading angle";
CM_ SG_ 108 VFC_Obj05A_HeadOrientation "The orientation of the head of cyclists or pedestrians that are detected";
CM_ SG_ 108 VFC_Obj05A_CompletelyInImg "indicator if the object is completely measured in the image";
CM_ SG_ 108 VFC_Obj05A_ProbMovingLat "Probability of object moving laterally";
CM_ SG_ 108 VFC_Obj05A_ProbMovingLong "Probability of object moving longitudinally";
CM_ SG_ 108 VFC_Obj05A_ProbExist "Object existence probability";
CM_ SG_ 108 VFC_Obj05A_MeasSource "Bitfield for the measurement programs from which this object originates
Bit 0: MOD
Bit 1: PDET
Bit 2: OFT
Bit 3: OLS
Bit 4: RESERVED";
CM_ SG_ 108 VFC_Obj05A_Reliability "The bitfield shows if the signal quality is assumed to be sufficient for functions with safety target -no false positives-
Bit 0: DYNAMIC
Bit 1: SEMSEG_SURFACE
Bit 2: WDD_CRITICAL
Bit 3: GOD_CONFIRMED
Bit 4: RESTRICTED
Bit 5: ISO26262_SAFE";
CM_ SG_ 108 VFC_Obj05A_Measured "Indicator if the object detected is measured or predicted";
CM_ SG_ 108 VFC_Obj05A_VisibleView "The visible view of the detected object";
CM_ SG_ 108 VFC_Obj05A_ClassifiedView "The classified view of object to be used in connection with Heading angle";
CM_ SG_ 108 VFC_Obj05A_DirIndicator "The detected direction indicator lights";
CM_ SG_ 108 VFC_Obj05A_BrakeLight "The number of detected lights. More confident if more lights are detected.";
CM_ SG_ 110 VFC_Obj06A_CRC "CRC - Autosar E2E Profile 5";
CM_ SG_ 110 VFC_Obj06A_AliveCtr "Alive counter - Autosar E2E Profile 5";
CM_ SG_ 110 VFC_Obj06A_ProtBlockCtr "Protocol-Signal: Block-Counter";
CM_ SG_ 110 VFC_Obj06A_ID "Unique Object ID";
CM_ SG_ 110 VFC_Obj06A_Type "Classification of the object";
CM_ SG_ 110 VFC_Obj06A_TypeProb "Probability of the classified object type";
CM_ SG_ 110 VFC_Obj06A_Dx "Object distance in longitudinal direction";
CM_ SG_ 110 VFC_Obj06A_Dy "Object distance in lateral direction";
CM_ SG_ 110 VFC_Obj06A_Vx "Object velocity in longitudinal direction";
CM_ SG_ 110 VFC_Obj06A_Vy "Object velocity in lateral direction";
CM_ SG_ 110 VFC_Obj06A_Ax "Object acceleration in longitudinal direction";
CM_ SG_ 110 VFC_Obj06A_Ay "Object acceleration in lateral direction";
CM_ SG_ 110 VFC_Obj06A_DxStdDev "Standard deviation of Object distance in longitudinal direction";
CM_ SG_ 110 VFC_Obj06A_DyStdDev "Standard deviation of Object distance in lateral direction";
CM_ SG_ 110 VFC_Obj06A_VxStdDev "Standard deviation of Object velocity in longitudinal direction";
CM_ SG_ 110 VFC_Obj06A_VyStdDev "Standard deviation of Object velocity in lateral direction";
CM_ SG_ 110 VFC_Obj06A_AxStdDev "Standard deviation of Object acceleration in longitudinal direction";
CM_ SG_ 110 VFC_Obj06A_AyStdDev "Standard deviation of Object acceleration in lateral direction";
CM_ SG_ 110 VFC_Obj06A_Length "Length of the object";
CM_ SG_ 110 VFC_Obj06A_Width "Width of the object";
CM_ SG_ 110 VFC_Obj06A_Height "Height of the object";
CM_ SG_ 110 VFC_Obj06A_LengthStdDev "Standard deviation of object length";
CM_ SG_ 110 VFC_Obj06A_WidthStdDev "Standard deviation of object width";
CM_ SG_ 110 VFC_Obj06A_HeightStdDev "Standard deviation of object height";
CM_ SG_ 110 VFC_Obj06A_EdgeLeft "In ACCS coordinates; corresponds to tan(viewing angle of left object edge)";
CM_ SG_ 110 VFC_Obj06A_EdgeMid "In ACCS coordinates; corresponds to tan(viewing angle of middle object edge)";
CM_ SG_ 110 VFC_Obj06A_EdgeRight "In ACCS coordinates; corresponds to tan(viewing angle of right object edge)";
CM_ SG_ 110 VFC_Obj06A_EdgeTop "In ACCS coordinates; corresponds to tan(viewing angle of top object edge)";
CM_ SG_ 110 VFC_Obj06A_EdgeBottom "In ACCS coordinates; corresponds to tan(viewing angle of bottom object edge)";
CM_ SG_ 110 VFC_Obj06A_EdgeLeftStdDev "Standard deviation of the ACCS left object edge";
CM_ SG_ 110 VFC_Obj06A_EdgeMidStdDev "Standard deviation of the ACCS middle object edge";
CM_ SG_ 110 VFC_Obj06A_EdgeRightStdDev "Standard deviation of the ACCS right object edge";
CM_ SG_ 110 VFC_Obj06A_EdgeTopStdDev "Standard deviation of the ACCS top object edge";
CM_ SG_ 110 VFC_Obj06A_EdgeBottomStdDev "Standard deviation of the ACCS bottom object edge";
CM_ SG_ 110 VFC_Obj06A_NormVx "Normalised Object velocity in longitudinal direction";
CM_ SG_ 110 VFC_Obj06A_NormAx "Normalised Object acceleration in longitudinal direction";
CM_ SG_ 110 VFC_Obj06A_NormVyEdgeLeft "Normalised velocity of the ACCS left object edge in lateral direction";
CM_ SG_ 110 VFC_Obj06A_NormVyEdgeRight "Normalised velocity of the ACCS right object edge in lateral direction";
CM_ SG_ 110 VFC_Obj06A_NormVxStdDev "Standard deviation of Normalised Object velocity in longitudinal direction";
CM_ SG_ 110 VFC_Obj06A_NormAxStdDev "Standard deviation of Normalised Object acceleration in longitudinal direction";
CM_ SG_ 110 VFC_Obj06A_NormVyEdgeLeftStdDev "Standard deviation of Normalised velocity of the ACCS left object edge in lateral direction";
CM_ SG_ 110 VFC_Obj06A_NormVyEdgeRightStdDev "Standard deviation of Normalised velocity of the ACCS right object edge in lateral direction";
CM_ SG_ 110 VFC_Obj06A_ScaleChange "A scale change of of the detected object";
CM_ SG_ 110 VFC_Obj06A_ScaleChngStdDev "Standard deviation of object scale change";
CM_ SG_ 110 VFC_Obj06A_HeadingAngle "Heading angle of the object";
CM_ SG_ 110 VFC_Obj06A_HeadingAngleStdDev "Standard deviation of object Heading angle";
CM_ SG_ 110 VFC_Obj06A_HeadOrientation "The orientation of the head of cyclists or pedestrians that are detected";
CM_ SG_ 110 VFC_Obj06A_CompletelyInImg "indicator if the object is completely measured in the image";
CM_ SG_ 110 VFC_Obj06A_ProbMovingLat "Probability of object moving laterally";
CM_ SG_ 110 VFC_Obj06A_ProbMovingLong "Probability of object moving longitudinally";
CM_ SG_ 110 VFC_Obj06A_ProbExist "Object existence probability";
CM_ SG_ 110 VFC_Obj06A_MeasSource "Bitfield for the measurement programs from which this object originates
Bit 0: MOD
Bit 1: PDET
Bit 2: OFT
Bit 3: OLS
Bit 4: RESERVED";
CM_ SG_ 110 VFC_Obj06A_Reliability "The bitfield shows if the signal quality is assumed to be sufficient for functions with safety target -no false positives-
Bit 0: DYNAMIC
Bit 1: SEMSEG_SURFACE
Bit 2: WDD_CRITICAL
Bit 3: GOD_CONFIRMED
Bit 4: RESTRICTED
Bit 5: ISO26262_SAFE";
CM_ SG_ 110 VFC_Obj06A_Measured "Indicator if the object detected is measured or predicted";
CM_ SG_ 110 VFC_Obj06A_VisibleView "The visible view of the detected object";
CM_ SG_ 110 VFC_Obj06A_ClassifiedView "The classified view of object to be used in connection with Heading angle";
CM_ SG_ 110 VFC_Obj06A_DirIndicator "The detected direction indicator lights";
CM_ SG_ 110 VFC_Obj06A_BrakeLight "The number of detected lights. More confident if more lights are detected.";
CM_ SG_ 112 VFC_Obj07A_CRC "CRC - Autosar E2E Profile 5";
CM_ SG_ 112 VFC_Obj07A_AliveCtr "Alive counter - Autosar E2E Profile 5";
CM_ SG_ 112 VFC_Obj07A_ProtBlockCtr "Protocol-Signal: Block-Counter";
CM_ SG_ 112 VFC_Obj07A_ID "Unique Object ID";
CM_ SG_ 112 VFC_Obj07A_Type "Classification of the object";
CM_ SG_ 112 VFC_Obj07A_TypeProb "Probability of the classified object type";
CM_ SG_ 112 VFC_Obj07A_Dx "Object distance in longitudinal direction";
CM_ SG_ 112 VFC_Obj07A_Dy "Object distance in lateral direction";
CM_ SG_ 112 VFC_Obj07A_Vx "Object velocity in longitudinal direction";
CM_ SG_ 112 VFC_Obj07A_Vy "Object velocity in lateral direction";
CM_ SG_ 112 VFC_Obj07A_Ax "Object acceleration in longitudinal direction";
CM_ SG_ 112 VFC_Obj07A_Ay "Object acceleration in lateral direction";
CM_ SG_ 112 VFC_Obj07A_DxStdDev "Standard deviation of Object distance in longitudinal direction";
CM_ SG_ 112 VFC_Obj07A_DyStdDev "Standard deviation of Object distance in lateral direction";
CM_ SG_ 112 VFC_Obj07A_VxStdDev "Standard deviation of Object velocity in longitudinal direction";
CM_ SG_ 112 VFC_Obj07A_VyStdDev "Standard deviation of Object velocity in lateral direction";
CM_ SG_ 112 VFC_Obj07A_AxStdDev "Standard deviation of Object acceleration in longitudinal direction";
CM_ SG_ 112 VFC_Obj07A_AyStdDev "Standard deviation of Object acceleration in lateral direction";
CM_ SG_ 112 VFC_Obj07A_Length "Length of the object";
CM_ SG_ 112 VFC_Obj07A_Width "Width of the object";
CM_ SG_ 112 VFC_Obj07A_Height "Height of the object";
CM_ SG_ 112 VFC_Obj07A_LengthStdDev "Standard deviation of object length";
CM_ SG_ 112 VFC_Obj07A_WidthStdDev "Standard deviation of object width";
CM_ SG_ 112 VFC_Obj07A_HeightStdDev "Standard deviation of object height";
CM_ SG_ 112 VFC_Obj07A_EdgeLeft "In ACCS coordinates; corresponds to tan(viewing angle of left object edge)";
CM_ SG_ 112 VFC_Obj07A_EdgeMid "In ACCS coordinates; corresponds to tan(viewing angle of middle object edge)";
CM_ SG_ 112 VFC_Obj07A_EdgeRight "In ACCS coordinates; corresponds to tan(viewing angle of right object edge)";
CM_ SG_ 112 VFC_Obj07A_EdgeTop "In ACCS coordinates; corresponds to tan(viewing angle of top object edge)";
CM_ SG_ 112 VFC_Obj07A_EdgeBottom "In ACCS coordinates; corresponds to tan(viewing angle of bottom object edge)";
CM_ SG_ 112 VFC_Obj07A_EdgeLeftStdDev "Standard deviation of the ACCS left object edge";
CM_ SG_ 112 VFC_Obj07A_EdgeMidStdDev "Standard deviation of the ACCS middle object edge";
CM_ SG_ 112 VFC_Obj07A_EdgeRightStdDev "Standard deviation of the ACCS right object edge";
CM_ SG_ 112 VFC_Obj07A_EdgeTopStdDev "Standard deviation of the ACCS top object edge";
CM_ SG_ 112 VFC_Obj07A_EdgeBottomStdDev "Standard deviation of the ACCS bottom object edge";
CM_ SG_ 112 VFC_Obj07A_NormVx "Normalised Object velocity in longitudinal direction";
CM_ SG_ 112 VFC_Obj07A_NormAx "Normalised Object acceleration in longitudinal direction";
CM_ SG_ 112 VFC_Obj07A_NormVyEdgeLeft "Normalised velocity of the ACCS left object edge in lateral direction";
CM_ SG_ 112 VFC_Obj07A_NormVyEdgeRight "Normalised velocity of the ACCS right object edge in lateral direction";
CM_ SG_ 112 VFC_Obj07A_NormVxStdDev "Standard deviation of Normalised Object velocity in longitudinal direction";
CM_ SG_ 112 VFC_Obj07A_NormAxStdDev "Standard deviation of Normalised Object acceleration in longitudinal direction";
CM_ SG_ 112 VFC_Obj07A_NormVyEdgeLeftStdDev "Standard deviation of Normalised velocity of the ACCS left object edge in lateral direction";
CM_ SG_ 112 VFC_Obj07A_NormVyEdgeRightStdDev "Standard deviation of Normalised velocity of the ACCS right object edge in lateral direction";
CM_ SG_ 112 VFC_Obj07A_ScaleChange "A scale change of of the detected object";
CM_ SG_ 112 VFC_Obj07A_ScaleChngStdDev "Standard deviation of object scale change";
CM_ SG_ 112 VFC_Obj07A_HeadingAngle "Heading angle of the object";
CM_ SG_ 112 VFC_Obj07A_HeadingAngleStdDev "Standard deviation of object Heading angle";
CM_ SG_ 112 VFC_Obj07A_HeadOrientation "The orientation of the head of cyclists or pedestrians that are detected";
CM_ SG_ 112 VFC_Obj07A_CompletelyInImg "indicator if the object is completely measured in the image";
CM_ SG_ 112 VFC_Obj07A_ProbMovingLat "Probability of object moving laterally";
CM_ SG_ 112 VFC_Obj07A_ProbMovingLong "Probability of object moving longitudinally";
CM_ SG_ 112 VFC_Obj07A_ProbExist "Object existence probability";
CM_ SG_ 112 VFC_Obj07A_MeasSource "Bitfield for the measurement programs from which this object originates
Bit 0: MOD
Bit 1: PDET
Bit 2: OFT
Bit 3: OLS
Bit 4: RESERVED";
CM_ SG_ 112 VFC_Obj07A_Reliability "The bitfield shows if the signal quality is assumed to be sufficient for functions with safety target -no false positives-
Bit 0: DYNAMIC
Bit 1: SEMSEG_SURFACE
Bit 2: WDD_CRITICAL
Bit 3: GOD_CONFIRMED
Bit 4: RESTRICTED
Bit 5: ISO26262_SAFE";
CM_ SG_ 112 VFC_Obj07A_Measured "Indicator if the object detected is measured or predicted";
CM_ SG_ 112 VFC_Obj07A_VisibleView "The visible view of the detected object";
CM_ SG_ 112 VFC_Obj07A_ClassifiedView "The classified view of object to be used in connection with Heading angle";
CM_ SG_ 112 VFC_Obj07A_DirIndicator "The detected direction indicator lights";
CM_ SG_ 112 VFC_Obj07A_BrakeLight "The number of detected lights. More confident if more lights are detected.";
CM_ SG_ 114 VFC_Obj08A_CRC "CRC - Autosar E2E Profile 5";
CM_ SG_ 114 VFC_Obj08A_AliveCtr "Alive counter - Autosar E2E Profile 5";
CM_ SG_ 114 VFC_Obj08A_ProtBlockCtr "Protocol-Signal: Block-Counter";
CM_ SG_ 114 VFC_Obj08A_ID "Unique Object ID";
CM_ SG_ 114 VFC_Obj08A_Type "Classification of the object";
CM_ SG_ 114 VFC_Obj08A_TypeProb "Probability of the classified object type";
CM_ SG_ 114 VFC_Obj08A_Dx "Object distance in longitudinal direction";
CM_ SG_ 114 VFC_Obj08A_Dy "Object distance in lateral direction";
CM_ SG_ 114 VFC_Obj08A_Vx "Object velocity in longitudinal direction";
CM_ SG_ 114 VFC_Obj08A_Vy "Object velocity in lateral direction";
CM_ SG_ 114 VFC_Obj08A_Ax "Object acceleration in longitudinal direction";
CM_ SG_ 114 VFC_Obj08A_Ay "Object acceleration in lateral direction";
CM_ SG_ 114 VFC_Obj08A_DxStdDev "Standard deviation of Object distance in longitudinal direction";
CM_ SG_ 114 VFC_Obj08A_DyStdDev "Standard deviation of Object distance in lateral direction";
CM_ SG_ 114 VFC_Obj08A_VxStdDev "Standard deviation of Object velocity in longitudinal direction";
CM_ SG_ 114 VFC_Obj08A_VyStdDev "Standard deviation of Object velocity in lateral direction";
CM_ SG_ 114 VFC_Obj08A_AxStdDev "Standard deviation of Object acceleration in longitudinal direction";
CM_ SG_ 114 VFC_Obj08A_AyStdDev "Standard deviation of Object acceleration in lateral direction";
CM_ SG_ 114 VFC_Obj08A_Length "Length of the object";
CM_ SG_ 114 VFC_Obj08A_Width "Width of the object";
CM_ SG_ 114 VFC_Obj08A_Height "Height of the object";
CM_ SG_ 114 VFC_Obj08A_LengthStdDev "Standard deviation of object length";
CM_ SG_ 114 VFC_Obj08A_WidthStdDev "Standard deviation of object width";
CM_ SG_ 114 VFC_Obj08A_HeightStdDev "Standard deviation of object height";
CM_ SG_ 114 VFC_Obj08A_EdgeLeft "In ACCS coordinates; corresponds to tan(viewing angle of left object edge)";
CM_ SG_ 114 VFC_Obj08A_EdgeMid "In ACCS coordinates; corresponds to tan(viewing angle of middle object edge)";
CM_ SG_ 114 VFC_Obj08A_EdgeRight "In ACCS coordinates; corresponds to tan(viewing angle of right object edge)";
CM_ SG_ 114 VFC_Obj08A_EdgeTop "In ACCS coordinates; corresponds to tan(viewing angle of top object edge)";
CM_ SG_ 114 VFC_Obj08A_EdgeBottom "In ACCS coordinates; corresponds to tan(viewing angle of bottom object edge)";
CM_ SG_ 114 VFC_Obj08A_EdgeLeftStdDev "Standard deviation of the ACCS left object edge";
CM_ SG_ 114 VFC_Obj08A_EdgeMidStdDev "Standard deviation of the ACCS middle object edge";
CM_ SG_ 114 VFC_Obj08A_EdgeRightStdDev "Standard deviation of the ACCS right object edge";
CM_ SG_ 114 VFC_Obj08A_EdgeTopStdDev "Standard deviation of the ACCS top object edge";
CM_ SG_ 114 VFC_Obj08A_EdgeBottomStdDev "Standard deviation of the ACCS bottom object edge";
CM_ SG_ 114 VFC_Obj08A_NormVx "Normalised Object velocity in longitudinal direction";
CM_ SG_ 114 VFC_Obj08A_NormAx "Normalised Object acceleration in longitudinal direction";
CM_ SG_ 114 VFC_Obj08A_NormVyEdgeLeft "Normalised velocity of the ACCS left object edge in lateral direction";
CM_ SG_ 114 VFC_Obj08A_NormVyEdgeRight "Normalised velocity of the ACCS right object edge in lateral direction";
CM_ SG_ 114 VFC_Obj08A_NormVxStdDev "Standard deviation of Normalised Object velocity in longitudinal direction";
CM_ SG_ 114 VFC_Obj08A_NormAxStdDev "Standard deviation of Normalised Object acceleration in longitudinal direction";
CM_ SG_ 114 VFC_Obj08A_NormVyEdgeLeftStdDev "Standard deviation of Normalised velocity of the ACCS left object edge in lateral direction";
CM_ SG_ 114 VFC_Obj08A_NormVyEdgeRightStdDev "Standard deviation of Normalised velocity of the ACCS right object edge in lateral direction";
CM_ SG_ 114 VFC_Obj08A_ScaleChange "A scale change of of the detected object";
CM_ SG_ 114 VFC_Obj08A_ScaleChngStdDev "Standard deviation of object scale change";
CM_ SG_ 114 VFC_Obj08A_HeadingAngle "Heading angle of the object";
CM_ SG_ 114 VFC_Obj08A_HeadingAngleStdDev "Standard deviation of object Heading angle";
CM_ SG_ 114 VFC_Obj08A_HeadOrientation "The orientation of the head of cyclists or pedestrians that are detected";
CM_ SG_ 114 VFC_Obj08A_CompletelyInImg "indicator if the object is completely measured in the image";
CM_ SG_ 114 VFC_Obj08A_ProbMovingLat "Probability of object moving laterally";
CM_ SG_ 114 VFC_Obj08A_ProbMovingLong "Probability of object moving longitudinally";
CM_ SG_ 114 VFC_Obj08A_ProbExist "Object existence probability";
CM_ SG_ 114 VFC_Obj08A_MeasSource "Bitfield for the measurement programs from which this object originates
Bit 0: MOD
Bit 1: PDET
Bit 2: OFT
Bit 3: OLS
Bit 4: RESERVED";
CM_ SG_ 114 VFC_Obj08A_Reliability "The bitfield shows if the signal quality is assumed to be sufficient for functions with safety target -no false positives-
Bit 0: DYNAMIC
Bit 1: SEMSEG_SURFACE
Bit 2: WDD_CRITICAL
Bit 3: GOD_CONFIRMED
Bit 4: RESTRICTED
Bit 5: ISO26262_SAFE";
CM_ SG_ 114 VFC_Obj08A_Measured "Indicator if the object detected is measured or predicted";
CM_ SG_ 114 VFC_Obj08A_VisibleView "The visible view of the detected object";
CM_ SG_ 114 VFC_Obj08A_ClassifiedView "The classified view of object to be used in connection with Heading angle";
CM_ SG_ 114 VFC_Obj08A_DirIndicator "The detected direction indicator lights";
CM_ SG_ 114 VFC_Obj08A_BrakeLight "The number of detected lights. More confident if more lights are detected.";
CM_ SG_ 116 VFC_Obj09A_CRC "CRC - Autosar E2E Profile 5";
CM_ SG_ 116 VFC_Obj09A_AliveCtr "Alive counter - Autosar E2E Profile 5";
CM_ SG_ 116 VFC_Obj09A_ProtBlockCtr "Protocol-Signal: Block-Counter";
CM_ SG_ 116 VFC_Obj09A_ID "Unique Object ID";
CM_ SG_ 116 VFC_Obj09A_Type "Classification of the object";
CM_ SG_ 116 VFC_Obj09A_TypeProb "Probability of the classified object type";
CM_ SG_ 116 VFC_Obj09A_Dx "Object distance in longitudinal direction";
CM_ SG_ 116 VFC_Obj09A_Dy "Object distance in lateral direction";
CM_ SG_ 116 VFC_Obj09A_Vx "Object velocity in longitudinal direction";
CM_ SG_ 116 VFC_Obj09A_Vy "Object velocity in lateral direction";
CM_ SG_ 116 VFC_Obj09A_Ax "Object acceleration in longitudinal direction";
CM_ SG_ 116 VFC_Obj09A_Ay "Object acceleration in lateral direction";
CM_ SG_ 116 VFC_Obj09A_DxStdDev "Standard deviation of Object distance in longitudinal direction";
CM_ SG_ 116 VFC_Obj09A_DyStdDev "Standard deviation of Object distance in lateral direction";
CM_ SG_ 116 VFC_Obj09A_VxStdDev "Standard deviation of Object velocity in longitudinal direction";
CM_ SG_ 116 VFC_Obj09A_VyStdDev "Standard deviation of Object velocity in lateral direction";
CM_ SG_ 116 VFC_Obj09A_AxStdDev "Standard deviation of Object acceleration in longitudinal direction";
CM_ SG_ 116 VFC_Obj09A_AyStdDev "Standard deviation of Object acceleration in lateral direction";
CM_ SG_ 116 VFC_Obj09A_Length "Length of the object";
CM_ SG_ 116 VFC_Obj09A_Width "Width of the object";
CM_ SG_ 116 VFC_Obj09A_Height "Height of the object";
CM_ SG_ 116 VFC_Obj09A_LengthStdDev "Standard deviation of object length";
CM_ SG_ 116 VFC_Obj09A_WidthStdDev "Standard deviation of object width";
CM_ SG_ 116 VFC_Obj09A_HeightStdDev "Standard deviation of object height";
CM_ SG_ 116 VFC_Obj09A_EdgeLeft "In ACCS coordinates; corresponds to tan(viewing angle of left object edge)";
CM_ SG_ 116 VFC_Obj09A_EdgeMid "In ACCS coordinates; corresponds to tan(viewing angle of middle object edge)";
CM_ SG_ 116 VFC_Obj09A_EdgeRight "In ACCS coordinates; corresponds to tan(viewing angle of right object edge)";
CM_ SG_ 116 VFC_Obj09A_EdgeTop "In ACCS coordinates; corresponds to tan(viewing angle of top object edge)";
CM_ SG_ 116 VFC_Obj09A_EdgeBottom "In ACCS coordinates; corresponds to tan(viewing angle of bottom object edge)";
CM_ SG_ 116 VFC_Obj09A_EdgeLeftStdDev "Standard deviation of the ACCS left object edge";
CM_ SG_ 116 VFC_Obj09A_EdgeMidStdDev "Standard deviation of the ACCS middle object edge";
CM_ SG_ 116 VFC_Obj09A_EdgeRightStdDev "Standard deviation of the ACCS right object edge";
CM_ SG_ 116 VFC_Obj09A_EdgeTopStdDev "Standard deviation of the ACCS top object edge";
CM_ SG_ 116 VFC_Obj09A_EdgeBottomStdDev "Standard deviation of the ACCS bottom object edge";
CM_ SG_ 116 VFC_Obj09A_NormVx "Normalised Object velocity in longitudinal direction";
CM_ SG_ 116 VFC_Obj09A_NormAx "Normalised Object acceleration in longitudinal direction";
CM_ SG_ 116 VFC_Obj09A_NormVyEdgeLeft "Normalised velocity of the ACCS left object edge in lateral direction";
CM_ SG_ 116 VFC_Obj09A_NormVyEdgeRight "Normalised velocity of the ACCS right object edge in lateral direction";
CM_ SG_ 116 VFC_Obj09A_NormVxStdDev "Standard deviation of Normalised Object velocity in longitudinal direction";
CM_ SG_ 116 VFC_Obj09A_NormAxStdDev "Standard deviation of Normalised Object acceleration in longitudinal direction";
CM_ SG_ 116 VFC_Obj09A_NormVyEdgeLeftStdDev "Standard deviation of Normalised velocity of the ACCS left object edge in lateral direction";
CM_ SG_ 116 VFC_Obj09A_NormVyEdgeRightStdDev "Standard deviation of Normalised velocity of the ACCS right object edge in lateral direction";
CM_ SG_ 116 VFC_Obj09A_ScaleChange "A scale change of of the detected object";
CM_ SG_ 116 VFC_Obj09A_ScaleChngStdDev "Standard deviation of object scale change";
CM_ SG_ 116 VFC_Obj09A_HeadingAngle "Heading angle of the object";
CM_ SG_ 116 VFC_Obj09A_HeadingAngleStdDev "Standard deviation of object Heading angle";
CM_ SG_ 116 VFC_Obj09A_HeadOrientation "The orientation of the head of cyclists or pedestrians that are detected";
CM_ SG_ 116 VFC_Obj09A_CompletelyInImg "indicator if the object is completely measured in the image";
CM_ SG_ 116 VFC_Obj09A_ProbMovingLat "Probability of object moving laterally";
CM_ SG_ 116 VFC_Obj09A_ProbMovingLong "Probability of object moving longitudinally";
CM_ SG_ 116 VFC_Obj09A_ProbExist "Object existence probability";
CM_ SG_ 116 VFC_Obj09A_MeasSource "Bitfield for the measurement programs from which this object originates
Bit 0: MOD
Bit 1: PDET
Bit 2: OFT
Bit 3: OLS
Bit 4: RESERVED";
CM_ SG_ 116 VFC_Obj09A_Reliability "The bitfield shows if the signal quality is assumed to be sufficient for functions with safety target -no false positives-
Bit 0: DYNAMIC
Bit 1: SEMSEG_SURFACE
Bit 2: WDD_CRITICAL
Bit 3: GOD_CONFIRMED
Bit 4: RESTRICTED
Bit 5: ISO26262_SAFE";
CM_ SG_ 116 VFC_Obj09A_Measured "Indicator if the object detected is measured or predicted";
CM_ SG_ 116 VFC_Obj09A_VisibleView "The visible view of the detected object";
CM_ SG_ 116 VFC_Obj09A_ClassifiedView "The classified view of object to be used in connection with Heading angle";
CM_ SG_ 116 VFC_Obj09A_DirIndicator "The detected direction indicator lights";
CM_ SG_ 116 VFC_Obj09A_BrakeLight "The number of detected lights. More confident if more lights are detected.";
CM_ SG_ 118 VFC_Obj10A_CRC "CRC - Autosar E2E Profile 5";
CM_ SG_ 118 VFC_Obj10A_AliveCtr "Alive counter - Autosar E2E Profile 5";
CM_ SG_ 118 VFC_Obj10A_ProtBlockCtr "Protocol-Signal: Block-Counter";
CM_ SG_ 118 VFC_Obj10A_ID "Unique Object ID";
CM_ SG_ 118 VFC_Obj10A_Type "Classification of the object";
CM_ SG_ 118 VFC_Obj10A_TypeProb "Probability of the classified object type";
CM_ SG_ 118 VFC_Obj10A_Dx "Object distance in longitudinal direction";
CM_ SG_ 118 VFC_Obj10A_Dy "Object distance in lateral direction";
CM_ SG_ 118 VFC_Obj10A_Vx "Object velocity in longitudinal direction";
CM_ SG_ 118 VFC_Obj10A_Vy "Object velocity in lateral direction";
CM_ SG_ 118 VFC_Obj10A_Ax "Object acceleration in longitudinal direction";
CM_ SG_ 118 VFC_Obj10A_Ay "Object acceleration in lateral direction";
CM_ SG_ 118 VFC_Obj10A_DxStdDev "Standard deviation of Object distance in longitudinal direction";
CM_ SG_ 118 VFC_Obj10A_DyStdDev "Standard deviation of Object distance in lateral direction";
CM_ SG_ 118 VFC_Obj10A_VxStdDev "Standard deviation of Object velocity in longitudinal direction";
CM_ SG_ 118 VFC_Obj10A_VyStdDev "Standard deviation of Object velocity in lateral direction";
CM_ SG_ 118 VFC_Obj10A_AxStdDev "Standard deviation of Object acceleration in longitudinal direction";
CM_ SG_ 118 VFC_Obj10A_AyStdDev "Standard deviation of Object acceleration in lateral direction";
CM_ SG_ 118 VFC_Obj10A_Length "Length of the object";
CM_ SG_ 118 VFC_Obj10A_Width "Width of the object";
CM_ SG_ 118 VFC_Obj10A_Height "Height of the object";
CM_ SG_ 118 VFC_Obj10A_LengthStdDev "Standard deviation of object length";
CM_ SG_ 118 VFC_Obj10A_WidthStdDev "Standard deviation of object width";
CM_ SG_ 118 VFC_Obj10A_HeightStdDev "Standard deviation of object height";
CM_ SG_ 118 VFC_Obj10A_EdgeLeft "In ACCS coordinates; corresponds to tan(viewing angle of left object edge)";
CM_ SG_ 118 VFC_Obj10A_EdgeMid "In ACCS coordinates; corresponds to tan(viewing angle of middle object edge)";
CM_ SG_ 118 VFC_Obj10A_EdgeRight "In ACCS coordinates; corresponds to tan(viewing angle of right object edge)";
CM_ SG_ 118 VFC_Obj10A_EdgeTop "In ACCS coordinates; corresponds to tan(viewing angle of top object edge)";
CM_ SG_ 118 VFC_Obj10A_EdgeBottom "In ACCS coordinates; corresponds to tan(viewing angle of bottom object edge)";
CM_ SG_ 118 VFC_Obj10A_EdgeLeftStdDev "Standard deviation of the ACCS left object edge";
CM_ SG_ 118 VFC_Obj10A_EdgeMidStdDev "Standard deviation of the ACCS middle object edge";
CM_ SG_ 118 VFC_Obj10A_EdgeRightStdDev "Standard deviation of the ACCS right object edge";
CM_ SG_ 118 VFC_Obj10A_EdgeTopStdDev "Standard deviation of the ACCS top object edge";
CM_ SG_ 118 VFC_Obj10A_EdgeBottomStdDev "Standard deviation of the ACCS bottom object edge";
CM_ SG_ 118 VFC_Obj10A_NormVx "Normalised Object velocity in longitudinal direction";
CM_ SG_ 118 VFC_Obj10A_NormAx "Normalised Object acceleration in longitudinal direction";
CM_ SG_ 118 VFC_Obj10A_NormVyEdgeLeft "Normalised velocity of the ACCS left object edge in lateral direction";
CM_ SG_ 118 VFC_Obj10A_NormVyEdgeRight "Normalised velocity of the ACCS right object edge in lateral direction";
CM_ SG_ 118 VFC_Obj10A_NormVxStdDev "Standard deviation of Normalised Object velocity in longitudinal direction";
CM_ SG_ 118 VFC_Obj10A_NormAxStdDev "Standard deviation of Normalised Object acceleration in longitudinal direction";
CM_ SG_ 118 VFC_Obj10A_NormVyEdgeLeftStdDev "Standard deviation of Normalised velocity of the ACCS left object edge in lateral direction";
CM_ SG_ 118 VFC_Obj10A_NormVyEdgeRightStdDev "Standard deviation of Normalised velocity of the ACCS right object edge in lateral direction";
CM_ SG_ 118 VFC_Obj10A_ScaleChange "A scale change of of the detected object";
CM_ SG_ 118 VFC_Obj10A_ScaleChngStdDev "Standard deviation of object scale change";
CM_ SG_ 118 VFC_Obj10A_HeadingAngle "Heading angle of the object";
CM_ SG_ 118 VFC_Obj10A_HeadingAngleStdDev "Standard deviation of object Heading angle";
CM_ SG_ 118 VFC_Obj10A_HeadOrientation "The orientation of the head of cyclists or pedestrians that are detected";
CM_ SG_ 118 VFC_Obj10A_CompletelyInImg "indicator if the object is completely measured in the image";
CM_ SG_ 118 VFC_Obj10A_ProbMovingLat "Probability of object moving laterally";
CM_ SG_ 118 VFC_Obj10A_ProbMovingLong "Probability of object moving longitudinally";
CM_ SG_ 118 VFC_Obj10A_ProbExist "Object existence probability";
CM_ SG_ 118 VFC_Obj10A_MeasSource "Bitfield for the measurement programs from which this object originates
Bit 0: MOD
Bit 1: PDET
Bit 2: OFT
Bit 3: OLS
Bit 4: RESERVED";
CM_ SG_ 118 VFC_Obj10A_Reliability "The bitfield shows if the signal quality is assumed to be sufficient for functions with safety target -no false positives-
Bit 0: DYNAMIC
Bit 1: SEMSEG_SURFACE
Bit 2: WDD_CRITICAL
Bit 3: GOD_CONFIRMED
Bit 4: RESTRICTED
Bit 5: ISO26262_SAFE";
CM_ SG_ 118 VFC_Obj10A_Measured "Indicator if the object detected is measured or predicted";
CM_ SG_ 118 VFC_Obj10A_VisibleView "The visible view of the detected object";
CM_ SG_ 118 VFC_Obj10A_ClassifiedView "The classified view of object to be used in connection with Heading angle";
CM_ SG_ 118 VFC_Obj10A_DirIndicator "The detected direction indicator lights";
CM_ SG_ 118 VFC_Obj10A_BrakeLight "The number of detected lights. More confident if more lights are detected.";
CM_ SG_ 120 VFC_Obj11A_CRC "CRC - Autosar E2E Profile 5";
CM_ SG_ 120 VFC_Obj11A_AliveCtr "Alive counter - Autosar E2E Profile 5";
CM_ SG_ 120 VFC_Obj11A_ProtBlockCtr "Protocol-Signal: Block-Counter";
CM_ SG_ 120 VFC_Obj11A_ID "Unique Object ID";
CM_ SG_ 120 VFC_Obj11A_Type "Classification of the object";
CM_ SG_ 120 VFC_Obj11A_TypeProb "Probability of the classified object type";
CM_ SG_ 120 VFC_Obj11A_Dx "Object distance in longitudinal direction";
CM_ SG_ 120 VFC_Obj11A_Dy "Object distance in lateral direction";
CM_ SG_ 120 VFC_Obj11A_Vx "Object velocity in longitudinal direction";
CM_ SG_ 120 VFC_Obj11A_Vy "Object velocity in lateral direction";
CM_ SG_ 120 VFC_Obj11A_Ax "Object acceleration in longitudinal direction";
CM_ SG_ 120 VFC_Obj11A_Ay "Object acceleration in lateral direction";
CM_ SG_ 120 VFC_Obj11A_DxStdDev "Standard deviation of Object distance in longitudinal direction";
CM_ SG_ 120 VFC_Obj11A_DyStdDev "Standard deviation of Object distance in lateral direction";
CM_ SG_ 120 VFC_Obj11A_VxStdDev "Standard deviation of Object velocity in longitudinal direction";
CM_ SG_ 120 VFC_Obj11A_VyStdDev "Standard deviation of Object velocity in lateral direction";
CM_ SG_ 120 VFC_Obj11A_AxStdDev "Standard deviation of Object acceleration in longitudinal direction";
CM_ SG_ 120 VFC_Obj11A_AyStdDev "Standard deviation of Object acceleration in lateral direction";
CM_ SG_ 120 VFC_Obj11A_Length "Length of the object";
CM_ SG_ 120 VFC_Obj11A_Width "Width of the object";
CM_ SG_ 120 VFC_Obj11A_Height "Height of the object";
CM_ SG_ 120 VFC_Obj11A_LengthStdDev "Standard deviation of object length";
CM_ SG_ 120 VFC_Obj11A_WidthStdDev "Standard deviation of object width";
CM_ SG_ 120 VFC_Obj11A_HeightStdDev "Standard deviation of object height";
CM_ SG_ 120 VFC_Obj11A_EdgeLeft "In ACCS coordinates; corresponds to tan(viewing angle of left object edge)";
CM_ SG_ 120 VFC_Obj11A_EdgeMid "In ACCS coordinates; corresponds to tan(viewing angle of middle object edge)";
CM_ SG_ 120 VFC_Obj11A_EdgeRight "In ACCS coordinates; corresponds to tan(viewing angle of right object edge)";
CM_ SG_ 120 VFC_Obj11A_EdgeTop "In ACCS coordinates; corresponds to tan(viewing angle of top object edge)";
CM_ SG_ 120 VFC_Obj11A_EdgeBottom "In ACCS coordinates; corresponds to tan(viewing angle of bottom object edge)";
CM_ SG_ 120 VFC_Obj11A_EdgeLeftStdDev "Standard deviation of the ACCS left object edge";
CM_ SG_ 120 VFC_Obj11A_EdgeMidStdDev "Standard deviation of the ACCS middle object edge";
CM_ SG_ 120 VFC_Obj11A_EdgeRightStdDev "Standard deviation of the ACCS right object edge";
CM_ SG_ 120 VFC_Obj11A_EdgeTopStdDev "Standard deviation of the ACCS top object edge";
CM_ SG_ 120 VFC_Obj11A_EdgeBottomStdDev "Standard deviation of the ACCS bottom object edge";
CM_ SG_ 120 VFC_Obj11A_NormVx "Normalised Object velocity in longitudinal direction";
CM_ SG_ 120 VFC_Obj11A_NormAx "Normalised Object acceleration in longitudinal direction";
CM_ SG_ 120 VFC_Obj11A_NormVyEdgeLeft "Normalised velocity of the ACCS left object edge in lateral direction";
CM_ SG_ 120 VFC_Obj11A_NormVyEdgeRight "Normalised velocity of the ACCS right object edge in lateral direction";
CM_ SG_ 120 VFC_Obj11A_NormVxStdDev "Standard deviation of Normalised Object velocity in longitudinal direction";
CM_ SG_ 120 VFC_Obj11A_NormAxStdDev "Standard deviation of Normalised Object acceleration in longitudinal direction";
CM_ SG_ 120 VFC_Obj11A_NormVyEdgeLeftStdDev "Standard deviation of Normalised velocity of the ACCS left object edge in lateral direction";
CM_ SG_ 120 VFC_Obj11A_NormVyEdgeRightStdDev "Standard deviation of Normalised velocity of the ACCS right object edge in lateral direction";
CM_ SG_ 120 VFC_Obj11A_ScaleChange "A scale change of of the detected object";
CM_ SG_ 120 VFC_Obj11A_ScaleChngStdDev "Standard deviation of object scale change";
CM_ SG_ 120 VFC_Obj11A_HeadingAngle "Heading angle of the object";
CM_ SG_ 120 VFC_Obj11A_HeadingAngleStdDev "Standard deviation of object Heading angle";
CM_ SG_ 120 VFC_Obj11A_HeadOrientation "The orientation of the head of cyclists or pedestrians that are detected";
CM_ SG_ 120 VFC_Obj11A_CompletelyInImg "indicator if the object is completely measured in the image";
CM_ SG_ 120 VFC_Obj11A_ProbMovingLat "Probability of object moving laterally";
CM_ SG_ 120 VFC_Obj11A_ProbMovingLong "Probability of object moving longitudinally";
CM_ SG_ 120 VFC_Obj11A_ProbExist "Object existence probability";
CM_ SG_ 120 VFC_Obj11A_MeasSource "Bitfield for the measurement programs from which this object originates
Bit 0: MOD
Bit 1: PDET
Bit 2: OFT
Bit 3: OLS
Bit 4: RESERVED";
CM_ SG_ 120 VFC_Obj11A_Reliability "The bitfield shows if the signal quality is assumed to be sufficient for functions with safety target -no false positives-
Bit 0: DYNAMIC
Bit 1: SEMSEG_SURFACE
Bit 2: WDD_CRITICAL
Bit 3: GOD_CONFIRMED
Bit 4: RESTRICTED
Bit 5: ISO26262_SAFE";
CM_ SG_ 120 VFC_Obj11A_Measured "Indicator if the object detected is measured or predicted";
CM_ SG_ 120 VFC_Obj11A_VisibleView "The visible view of the detected object";
CM_ SG_ 120 VFC_Obj11A_ClassifiedView "The classified view of object to be used in connection with Heading angle";
CM_ SG_ 120 VFC_Obj11A_DirIndicator "The detected direction indicator lights";
CM_ SG_ 120 VFC_Obj11A_BrakeLight "The number of detected lights. More confident if more lights are detected.";
CM_ SG_ 122 VFC_Obj12A_CRC "CRC - Autosar E2E Profile 5";
CM_ SG_ 122 VFC_Obj12A_AliveCtr "Alive counter - Autosar E2E Profile 5";
CM_ SG_ 122 VFC_Obj12A_ProtBlockCtr "Protocol-Signal: Block-Counter";
CM_ SG_ 122 VFC_Obj12A_ID "Unique Object ID";
CM_ SG_ 122 VFC_Obj12A_Type "Classification of the object";
CM_ SG_ 122 VFC_Obj12A_TypeProb "Probability of the classified object type";
CM_ SG_ 122 VFC_Obj12A_Dx "Object distance in longitudinal direction";
CM_ SG_ 122 VFC_Obj12A_Dy "Object distance in lateral direction";
CM_ SG_ 122 VFC_Obj12A_Vx "Object velocity in longitudinal direction";
CM_ SG_ 122 VFC_Obj12A_Vy "Object velocity in lateral direction";
CM_ SG_ 122 VFC_Obj12A_Ax "Object acceleration in longitudinal direction";
CM_ SG_ 122 VFC_Obj12A_Ay "Object acceleration in lateral direction";
CM_ SG_ 122 VFC_Obj12A_DxStdDev "Standard deviation of Object distance in longitudinal direction";
CM_ SG_ 122 VFC_Obj12A_DyStdDev "Standard deviation of Object distance in lateral direction";
CM_ SG_ 122 VFC_Obj12A_VxStdDev "Standard deviation of Object velocity in longitudinal direction";
CM_ SG_ 122 VFC_Obj12A_VyStdDev "Standard deviation of Object velocity in lateral direction";
CM_ SG_ 122 VFC_Obj12A_AxStdDev "Standard deviation of Object acceleration in longitudinal direction";
CM_ SG_ 122 VFC_Obj12A_AyStdDev "Standard deviation of Object acceleration in lateral direction";
CM_ SG_ 122 VFC_Obj12A_Length "Length of the object";
CM_ SG_ 122 VFC_Obj12A_Width "Width of the object";
CM_ SG_ 122 VFC_Obj12A_Height "Height of the object";
CM_ SG_ 122 VFC_Obj12A_LengthStdDev "Standard deviation of object length";
CM_ SG_ 122 VFC_Obj12A_WidthStdDev "Standard deviation of object width";
CM_ SG_ 122 VFC_Obj12A_HeightStdDev "Standard deviation of object height";
CM_ SG_ 122 VFC_Obj12A_EdgeLeft "In ACCS coordinates; corresponds to tan(viewing angle of left object edge)";
CM_ SG_ 122 VFC_Obj12A_EdgeMid "In ACCS coordinates; corresponds to tan(viewing angle of middle object edge)";
CM_ SG_ 122 VFC_Obj12A_EdgeRight "In ACCS coordinates; corresponds to tan(viewing angle of right object edge)";
CM_ SG_ 122 VFC_Obj12A_EdgeTop "In ACCS coordinates; corresponds to tan(viewing angle of top object edge)";
CM_ SG_ 122 VFC_Obj12A_EdgeBottom "In ACCS coordinates; corresponds to tan(viewing angle of bottom object edge)";
CM_ SG_ 122 VFC_Obj12A_EdgeLeftStdDev "Standard deviation of the ACCS left object edge";
CM_ SG_ 122 VFC_Obj12A_EdgeMidStdDev "Standard deviation of the ACCS middle object edge";
CM_ SG_ 122 VFC_Obj12A_EdgeRightStdDev "Standard deviation of the ACCS right object edge";
CM_ SG_ 122 VFC_Obj12A_EdgeTopStdDev "Standard deviation of the ACCS top object edge";
CM_ SG_ 122 VFC_Obj12A_EdgeBottomStdDev "Standard deviation of the ACCS bottom object edge";
CM_ SG_ 122 VFC_Obj12A_NormVx "Normalised Object velocity in longitudinal direction";
CM_ SG_ 122 VFC_Obj12A_NormAx "Normalised Object acceleration in longitudinal direction";
CM_ SG_ 122 VFC_Obj12A_NormVyEdgeLeft "Normalised velocity of the ACCS left object edge in lateral direction";
CM_ SG_ 122 VFC_Obj12A_NormVyEdgeRight "Normalised velocity of the ACCS right object edge in lateral direction";
CM_ SG_ 122 VFC_Obj12A_NormVxStdDev "Standard deviation of Normalised Object velocity in longitudinal direction";
CM_ SG_ 122 VFC_Obj12A_NormAxStdDev "Standard deviation of Normalised Object acceleration in longitudinal direction";
CM_ SG_ 122 VFC_Obj12A_NormVyEdgeLeftStdDev "Standard deviation of Normalised velocity of the ACCS left object edge in lateral direction";
CM_ SG_ 122 VFC_Obj12A_NormVyEdgeRightStdDev "Standard deviation of Normalised velocity of the ACCS right object edge in lateral direction";
CM_ SG_ 122 VFC_Obj12A_ScaleChange "A scale change of of the detected object";
CM_ SG_ 122 VFC_Obj12A_ScaleChngStdDev "Standard deviation of object scale change";
CM_ SG_ 122 VFC_Obj12A_HeadingAngle "Heading angle of the object";
CM_ SG_ 122 VFC_Obj12A_HeadingAngleStdDev "Standard deviation of object Heading angle";
CM_ SG_ 122 VFC_Obj12A_HeadOrientation "The orientation of the head of cyclists or pedestrians that are detected";
CM_ SG_ 122 VFC_Obj12A_CompletelyInImg "indicator if the object is completely measured in the image";
CM_ SG_ 122 VFC_Obj12A_ProbMovingLat "Probability of object moving laterally";
CM_ SG_ 122 VFC_Obj12A_ProbMovingLong "Probability of object moving longitudinally";
CM_ SG_ 122 VFC_Obj12A_ProbExist "Object existence probability";
CM_ SG_ 122 VFC_Obj12A_MeasSource "Bitfield for the measurement programs from which this object originates
Bit 0: MOD
Bit 1: PDET
Bit 2: OFT
Bit 3: OLS
Bit 4: RESERVED";
CM_ SG_ 122 VFC_Obj12A_Reliability "The bitfield shows if the signal quality is assumed to be sufficient for functions with safety target -no false positives-
Bit 0: DYNAMIC
Bit 1: SEMSEG_SURFACE
Bit 2: WDD_CRITICAL
Bit 3: GOD_CONFIRMED
Bit 4: RESTRICTED
Bit 5: ISO26262_SAFE";
CM_ SG_ 122 VFC_Obj12A_Measured "Indicator if the object detected is measured or predicted";
CM_ SG_ 122 VFC_Obj12A_VisibleView "The visible view of the detected object";
CM_ SG_ 122 VFC_Obj12A_ClassifiedView "The classified view of object to be used in connection with Heading angle";
CM_ SG_ 122 VFC_Obj12A_DirIndicator "The detected direction indicator lights";
CM_ SG_ 122 VFC_Obj12A_BrakeLight "The number of detected lights. More confident if more lights are detected.";
CM_ SG_ 124 VFC_Obj13A_CRC "CRC - Autosar E2E Profile 5";
CM_ SG_ 124 VFC_Obj13A_AliveCtr "Alive counter - Autosar E2E Profile 5";
CM_ SG_ 124 VFC_Obj13A_ProtBlockCtr "Protocol-Signal: Block-Counter";
CM_ SG_ 124 VFC_Obj13A_ID "Unique Object ID";
CM_ SG_ 124 VFC_Obj13A_Type "Classification of the object";
CM_ SG_ 124 VFC_Obj13A_TypeProb "Probability of the classified object type";
CM_ SG_ 124 VFC_Obj13A_Dx "Object distance in longitudinal direction";
CM_ SG_ 124 VFC_Obj13A_Dy "Object distance in lateral direction";
CM_ SG_ 124 VFC_Obj13A_Vx "Object velocity in longitudinal direction";
CM_ SG_ 124 VFC_Obj13A_Vy "Object velocity in lateral direction";
CM_ SG_ 124 VFC_Obj13A_Ax "Object acceleration in longitudinal direction";
CM_ SG_ 124 VFC_Obj13A_Ay "Object acceleration in lateral direction";
CM_ SG_ 124 VFC_Obj13A_DxStdDev "Standard deviation of Object distance in longitudinal direction";
CM_ SG_ 124 VFC_Obj13A_DyStdDev "Standard deviation of Object distance in lateral direction";
CM_ SG_ 124 VFC_Obj13A_VxStdDev "Standard deviation of Object velocity in longitudinal direction";
CM_ SG_ 124 VFC_Obj13A_VyStdDev "Standard deviation of Object velocity in lateral direction";
CM_ SG_ 124 VFC_Obj13A_AxStdDev "Standard deviation of Object acceleration in longitudinal direction";
CM_ SG_ 124 VFC_Obj13A_AyStdDev "Standard deviation of Object acceleration in lateral direction";
CM_ SG_ 124 VFC_Obj13A_Length "Length of the object";
CM_ SG_ 124 VFC_Obj13A_Width "Width of the object";
CM_ SG_ 124 VFC_Obj13A_Height "Height of the object";
CM_ SG_ 124 VFC_Obj13A_LengthStdDev "Standard deviation of object length";
CM_ SG_ 124 VFC_Obj13A_WidthStdDev "Standard deviation of object width";
CM_ SG_ 124 VFC_Obj13A_HeightStdDev "Standard deviation of object height";
CM_ SG_ 124 VFC_Obj13A_EdgeLeft "In ACCS coordinates; corresponds to tan(viewing angle of left object edge)";
CM_ SG_ 124 VFC_Obj13A_EdgeMid "In ACCS coordinates; corresponds to tan(viewing angle of middle object edge)";
CM_ SG_ 124 VFC_Obj13A_EdgeRight "In ACCS coordinates; corresponds to tan(viewing angle of right object edge)";
CM_ SG_ 124 VFC_Obj13A_EdgeTop "In ACCS coordinates; corresponds to tan(viewing angle of top object edge)";
CM_ SG_ 124 VFC_Obj13A_EdgeBottom "In ACCS coordinates; corresponds to tan(viewing angle of bottom object edge)";
CM_ SG_ 124 VFC_Obj13A_EdgeLeftStdDev "Standard deviation of the ACCS left object edge";
CM_ SG_ 124 VFC_Obj13A_EdgeMidStdDev "Standard deviation of the ACCS middle object edge";
CM_ SG_ 124 VFC_Obj13A_EdgeRightStdDev "Standard deviation of the ACCS right object edge";
CM_ SG_ 124 VFC_Obj13A_EdgeTopStdDev "Standard deviation of the ACCS top object edge";
CM_ SG_ 124 VFC_Obj13A_EdgeBottomStdDev "Standard deviation of the ACCS bottom object edge";
CM_ SG_ 124 VFC_Obj13A_NormVx "Normalised Object velocity in longitudinal direction";
CM_ SG_ 124 VFC_Obj13A_NormAx "Normalised Object acceleration in longitudinal direction";
CM_ SG_ 124 VFC_Obj13A_NormVyEdgeLeft "Normalised velocity of the ACCS left object edge in lateral direction";
CM_ SG_ 124 VFC_Obj13A_NormVyEdgeRight "Normalised velocity of the ACCS right object edge in lateral direction";
CM_ SG_ 124 VFC_Obj13A_NormVxStdDev "Standard deviation of Normalised Object velocity in longitudinal direction";
CM_ SG_ 124 VFC_Obj13A_NormAxStdDev "Standard deviation of Normalised Object acceleration in longitudinal direction";
CM_ SG_ 124 VFC_Obj13A_NormVyEdgeLeftStdDev "Standard deviation of Normalised velocity of the ACCS left object edge in lateral direction";
CM_ SG_ 124 VFC_Obj13A_NormVyEdgeRightStdDev "Standard deviation of Normalised velocity of the ACCS right object edge in lateral direction";
CM_ SG_ 124 VFC_Obj13A_ScaleChange "A scale change of of the detected object";
CM_ SG_ 124 VFC_Obj13A_ScaleChngStdDev "Standard deviation of object scale change";
CM_ SG_ 124 VFC_Obj13A_HeadingAngle "Heading angle of the object";
CM_ SG_ 124 VFC_Obj13A_HeadingAngleStdDev "Standard deviation of object Heading angle";
CM_ SG_ 124 VFC_Obj13A_HeadOrientation "The orientation of the head of cyclists or pedestrians that are detected";
CM_ SG_ 124 VFC_Obj13A_CompletelyInImg "indicator if the object is completely measured in the image";
CM_ SG_ 124 VFC_Obj13A_ProbMovingLat "Probability of object moving laterally";
CM_ SG_ 124 VFC_Obj13A_ProbMovingLong "Probability of object moving longitudinally";
CM_ SG_ 124 VFC_Obj13A_ProbExist "Object existence probability";
CM_ SG_ 124 VFC_Obj13A_MeasSource "Bitfield for the measurement programs from which this object originates
Bit 0: MOD
Bit 1: PDET
Bit 2: OFT
Bit 3: OLS
Bit 4: RESERVED";
CM_ SG_ 124 VFC_Obj13A_Reliability "The bitfield shows if the signal quality is assumed to be sufficient for functions with safety target -no false positives-
Bit 0: DYNAMIC
Bit 1: SEMSEG_SURFACE
Bit 2: WDD_CRITICAL
Bit 3: GOD_CONFIRMED
Bit 4: RESTRICTED
Bit 5: ISO26262_SAFE";
CM_ SG_ 124 VFC_Obj13A_Measured "Indicator if the object detected is measured or predicted";
CM_ SG_ 124 VFC_Obj13A_VisibleView "The visible view of the detected object";
CM_ SG_ 124 VFC_Obj13A_ClassifiedView "The classified view of object to be used in connection with Heading angle";
CM_ SG_ 124 VFC_Obj13A_DirIndicator "The detected direction indicator lights";
CM_ SG_ 124 VFC_Obj13A_BrakeLight "The number of detected lights. More confident if more lights are detected.";
CM_ SG_ 126 VFC_Obj14A_CRC "CRC - Autosar E2E Profile 5";
CM_ SG_ 126 VFC_Obj14A_AliveCtr "Alive counter - Autosar E2E Profile 5";
CM_ SG_ 126 VFC_Obj14A_ProtBlockCtr "Protocol-Signal: Block-Counter";
CM_ SG_ 126 VFC_Obj14A_ID "Unique Object ID";
CM_ SG_ 126 VFC_Obj14A_Type "Classification of the object";
CM_ SG_ 126 VFC_Obj14A_TypeProb "Probability of the classified object type";
CM_ SG_ 126 VFC_Obj14A_Dx "Object distance in longitudinal direction";
CM_ SG_ 126 VFC_Obj14A_Dy "Object distance in lateral direction";
CM_ SG_ 126 VFC_Obj14A_Vx "Object velocity in longitudinal direction";
CM_ SG_ 126 VFC_Obj14A_Vy "Object velocity in lateral direction";
CM_ SG_ 126 VFC_Obj14A_Ax "Object acceleration in longitudinal direction";
CM_ SG_ 126 VFC_Obj14A_Ay "Object acceleration in lateral direction";
CM_ SG_ 126 VFC_Obj14A_DxStdDev "Standard deviation of Object distance in longitudinal direction";
CM_ SG_ 126 VFC_Obj14A_DyStdDev "Standard deviation of Object distance in lateral direction";
CM_ SG_ 126 VFC_Obj14A_VxStdDev "Standard deviation of Object velocity in longitudinal direction";
CM_ SG_ 126 VFC_Obj14A_VyStdDev "Standard deviation of Object velocity in lateral direction";
CM_ SG_ 126 VFC_Obj14A_AxStdDev "Standard deviation of Object acceleration in longitudinal direction";
CM_ SG_ 126 VFC_Obj14A_AyStdDev "Standard deviation of Object acceleration in lateral direction";
CM_ SG_ 126 VFC_Obj14A_Length "Length of the object";
CM_ SG_ 126 VFC_Obj14A_Width "Width of the object";
CM_ SG_ 126 VFC_Obj14A_Height "Height of the object";
CM_ SG_ 126 VFC_Obj14A_LengthStdDev "Standard deviation of object length";
CM_ SG_ 126 VFC_Obj14A_WidthStdDev "Standard deviation of object width";
CM_ SG_ 126 VFC_Obj14A_HeightStdDev "Standard deviation of object height";
CM_ SG_ 126 VFC_Obj14A_EdgeLeft "In ACCS coordinates; corresponds to tan(viewing angle of left object edge)";
CM_ SG_ 126 VFC_Obj14A_EdgeMid "In ACCS coordinates; corresponds to tan(viewing angle of middle object edge)";
CM_ SG_ 126 VFC_Obj14A_EdgeRight "In ACCS coordinates; corresponds to tan(viewing angle of right object edge)";
CM_ SG_ 126 VFC_Obj14A_EdgeTop "In ACCS coordinates; corresponds to tan(viewing angle of top object edge)";
CM_ SG_ 126 VFC_Obj14A_EdgeBottom "In ACCS coordinates; corresponds to tan(viewing angle of bottom object edge)";
CM_ SG_ 126 VFC_Obj14A_EdgeLeftStdDev "Standard deviation of the ACCS left object edge";
CM_ SG_ 126 VFC_Obj14A_EdgeMidStdDev "Standard deviation of the ACCS middle object edge";
CM_ SG_ 126 VFC_Obj14A_EdgeRightStdDev "Standard deviation of the ACCS right object edge";
CM_ SG_ 126 VFC_Obj14A_EdgeTopStdDev "Standard deviation of the ACCS top object edge";
CM_ SG_ 126 VFC_Obj14A_EdgeBottomStdDev "Standard deviation of the ACCS bottom object edge";
CM_ SG_ 126 VFC_Obj14A_NormVx "Normalised Object velocity in longitudinal direction";
CM_ SG_ 126 VFC_Obj14A_NormAx "Normalised Object acceleration in longitudinal direction";
CM_ SG_ 126 VFC_Obj14A_NormVyEdgeLeft "Normalised velocity of the ACCS left object edge in lateral direction";
CM_ SG_ 126 VFC_Obj14A_NormVyEdgeRight "Normalised velocity of the ACCS right object edge in lateral direction";
CM_ SG_ 126 VFC_Obj14A_NormVxStdDev "Standard deviation of Normalised Object velocity in longitudinal direction";
CM_ SG_ 126 VFC_Obj14A_NormAxStdDev "Standard deviation of Normalised Object acceleration in longitudinal direction";
CM_ SG_ 126 VFC_Obj14A_NormVyEdgeLeftStdDev "Standard deviation of Normalised velocity of the ACCS left object edge in lateral direction";
CM_ SG_ 126 VFC_Obj14A_NormVyEdgeRightStdDev "Standard deviation of Normalised velocity of the ACCS right object edge in lateral direction";
CM_ SG_ 126 VFC_Obj14A_ScaleChange "A scale change of of the detected object";
CM_ SG_ 126 VFC_Obj14A_ScaleChngStdDev "Standard deviation of object scale change";
CM_ SG_ 126 VFC_Obj14A_HeadingAngle "Heading angle of the object";
CM_ SG_ 126 VFC_Obj14A_HeadingAngleStdDev "Standard deviation of object Heading angle";
CM_ SG_ 126 VFC_Obj14A_HeadOrientation "The orientation of the head of cyclists or pedestrians that are detected";
CM_ SG_ 126 VFC_Obj14A_CompletelyInImg "indicator if the object is completely measured in the image";
CM_ SG_ 126 VFC_Obj14A_ProbMovingLat "Probability of object moving laterally";
CM_ SG_ 126 VFC_Obj14A_ProbMovingLong "Probability of object moving longitudinally";
CM_ SG_ 126 VFC_Obj14A_ProbExist "Object existence probability";
CM_ SG_ 126 VFC_Obj14A_MeasSource "Bitfield for the measurement programs from which this object originates
Bit 0: MOD
Bit 1: PDET
Bit 2: OFT
Bit 3: OLS
Bit 4: RESERVED";
CM_ SG_ 126 VFC_Obj14A_Reliability "The bitfield shows if the signal quality is assumed to be sufficient for functions with safety target -no false positives-
Bit 0: DYNAMIC
Bit 1: SEMSEG_SURFACE
Bit 2: WDD_CRITICAL
Bit 3: GOD_CONFIRMED
Bit 4: RESTRICTED
Bit 5: ISO26262_SAFE";
CM_ SG_ 126 VFC_Obj14A_Measured "Indicator if the object detected is measured or predicted";
CM_ SG_ 126 VFC_Obj14A_VisibleView "The visible view of the detected object";
CM_ SG_ 126 VFC_Obj14A_ClassifiedView "The classified view of object to be used in connection with Heading angle";
CM_ SG_ 126 VFC_Obj14A_DirIndicator "The detected direction indicator lights";
CM_ SG_ 126 VFC_Obj14A_BrakeLight "The number of detected lights. More confident if more lights are detected.";
BA_DEF_ BO_  "GenMsgSendType" ENUM  "cyclic","NoMsgSendType","IfActive","Event","CA","CE";
BA_DEF_ BO_  "GenMsgCycleTime" INT 0 0;
BA_DEF_ SG_  "GenSigSendType" ENUM  "cyclic","OnChange","OnWrite","IfActive","OnChangeWithRepetition","OnWriteWithRepetition","IfActiveWithRepetition","CA","CE","Event";
BA_DEF_ SG_  "GenSigStartValue" INT 0 0;
BA_DEF_  "DBName" STRING ;
BA_DEF_ BO_  "CANFD_BRS" ENUM  "0","1";
BA_DEF_ BO_  "VFrameFormat" ENUM  "StandardCAN","ExtendedCAN","reserved","reserved","reserved","reserved","reserved","reserved","reserved","reserved","reserved","reserved","reserved","reserved","StandardCAN_FD","ExtendedCAN_FD";
BA_DEF_  "BusBaudateData" INT 0 10000;
BA_DEF_  "BusBaudateOther" INT 0 10000;
BA_DEF_ BO_  "GenMsgILSupport" ENUM  "No","Yes";
BA_DEF_  "BusType" STRING ;
BA_DEF_ SG_  "sigDespEng" STRING ;
BA_DEF_ SG_  "sigSecLevel" STRING ;
BA_DEF_ SG_  "sigConfig" STRING ;
BA_DEF_ SG_  "sigExplanation" STRING ;
BA_DEF_DEF_  "GenMsgSendType" "cyclic";
BA_DEF_DEF_  "GenMsgCycleTime" 0;
BA_DEF_DEF_  "GenSigSendType" "cyclic";
BA_DEF_DEF_  "GenSigStartValue" 0;
BA_DEF_DEF_  "DBName" "";
BA_DEF_DEF_  "CANFD_BRS" "1";
BA_DEF_DEF_  "VFrameFormat" "";
BA_DEF_DEF_  "BusBaudateData" 2;
BA_DEF_DEF_  "BusBaudateOther" 500;
BA_DEF_DEF_  "GenMsgILSupport" "Yes";
BA_DEF_DEF_  "BusType" "CAN FD";
BA_DEF_DEF_  "sigDespEng" "";
BA_DEF_DEF_  "sigSecLevel" "";
BA_DEF_DEF_  "sigConfig" "";
BA_DEF_DEF_  "sigExplanation" "";
BA_ "DBName" "BJEV_5R1V1D_AEB_V3_5";
BA_ "GenMsgSendType" BO_ 80 3;
BA_ "VFrameFormat" BO_ 80 14;
BA_ "GenMsgSendType" BO_ 96 3;
BA_ "VFrameFormat" BO_ 96 14;
BA_ "GenMsgSendType" BO_ 98 3;
BA_ "VFrameFormat" BO_ 98 14;
BA_ "GenMsgSendType" BO_ 100 3;
BA_ "VFrameFormat" BO_ 100 14;
BA_ "GenMsgSendType" BO_ 102 3;
BA_ "VFrameFormat" BO_ 102 14;
BA_ "GenMsgSendType" BO_ 104 3;
BA_ "VFrameFormat" BO_ 104 14;
BA_ "GenMsgSendType" BO_ 106 3;
BA_ "VFrameFormat" BO_ 106 14;
BA_ "GenMsgSendType" BO_ 108 3;
BA_ "VFrameFormat" BO_ 108 14;
BA_ "GenMsgSendType" BO_ 110 3;
BA_ "VFrameFormat" BO_ 110 14;
BA_ "GenMsgSendType" BO_ 112 3;
BA_ "VFrameFormat" BO_ 112 14;
BA_ "GenMsgSendType" BO_ 114 3;
BA_ "VFrameFormat" BO_ 114 14;
BA_ "GenMsgSendType" BO_ 116 3;
BA_ "VFrameFormat" BO_ 116 14;
BA_ "GenMsgSendType" BO_ 118 3;
BA_ "VFrameFormat" BO_ 118 14;
BA_ "GenMsgSendType" BO_ 120 3;
BA_ "VFrameFormat" BO_ 120 14;
BA_ "GenMsgSendType" BO_ 122 3;
BA_ "VFrameFormat" BO_ 122 14;
BA_ "GenMsgSendType" BO_ 124 3;
BA_ "VFrameFormat" BO_ 124 14;
BA_ "GenMsgSendType" BO_ 126 3;
BA_ "VFrameFormat" BO_ 126 14;
BA_ "GenSigStartValue" SG_ 80 VFC_GlobalHdr_ProtocolVersion 512;
BA_ "GenSigStartValue" SG_ 80 VFC_GlobalHdr_MountPosX 4096;
BA_ "GenSigStartValue" SG_ 80 VFC_GlobalHdr_MountPosY 2048;
BA_ "GenSigStartValue" SG_ 80 VFC_GlobalHdr_CalibYawAngle 512;
BA_ "GenSigStartValue" SG_ 80 VFC_GlobalHdr_CalibPitchAngle 512;
BA_ "GenSigStartValue" SG_ 80 VFC_GlobalHdr_CalibRollAngle 512;
BA_ "GenSigStartValue" SG_ 98 VFC_Obj00A_Dy 8000;
BA_ "GenSigStartValue" SG_ 98 VFC_Obj00A_Vx 1540;
BA_ "GenSigStartValue" SG_ 98 VFC_Obj00A_Vy 500;
BA_ "GenSigStartValue" SG_ 98 VFC_Obj00A_Ax 160;
BA_ "GenSigStartValue" SG_ 98 VFC_Obj00A_Ay 120;
BA_ "GenSigStartValue" SG_ 98 VFC_Obj00A_EdgeLeft 4000;
BA_ "GenSigStartValue" SG_ 98 VFC_Obj00A_EdgeMid 4000;
BA_ "GenSigStartValue" SG_ 98 VFC_Obj00A_EdgeRight 4000;
BA_ "GenSigStartValue" SG_ 98 VFC_Obj00A_EdgeTop 2000;
BA_ "GenSigStartValue" SG_ 98 VFC_Obj00A_EdgeBottom 2000;
BA_ "GenSigStartValue" SG_ 98 VFC_Obj00A_NormVx 40000;
BA_ "GenSigStartValue" SG_ 98 VFC_Obj00A_NormAx 5000;
BA_ "GenSigStartValue" SG_ 98 VFC_Obj00A_NormVyEdgeLeft 4000;
BA_ "GenSigStartValue" SG_ 98 VFC_Obj00A_NormVyEdgeRight 4000;
BA_ "GenSigStartValue" SG_ 98 VFC_Obj00A_HeadingAngle 157;
BA_ "GenSigStartValue" SG_ 100 VFC_Obj01A_Dy 8000;
BA_ "GenSigStartValue" SG_ 100 VFC_Obj01A_Vx 1540;
BA_ "GenSigStartValue" SG_ 100 VFC_Obj01A_Vy 500;
BA_ "GenSigStartValue" SG_ 100 VFC_Obj01A_Ax 160;
BA_ "GenSigStartValue" SG_ 100 VFC_Obj01A_Ay 120;
BA_ "GenSigStartValue" SG_ 100 VFC_Obj01A_EdgeLeft 4000;
BA_ "GenSigStartValue" SG_ 100 VFC_Obj01A_EdgeMid 4000;
BA_ "GenSigStartValue" SG_ 100 VFC_Obj01A_EdgeRight 4000;
BA_ "GenSigStartValue" SG_ 100 VFC_Obj01A_EdgeTop 2000;
BA_ "GenSigStartValue" SG_ 100 VFC_Obj01A_EdgeBottom 2000;
BA_ "GenSigStartValue" SG_ 100 VFC_Obj01A_NormVx 40000;
BA_ "GenSigStartValue" SG_ 100 VFC_Obj01A_NormAx 5000;
BA_ "GenSigStartValue" SG_ 100 VFC_Obj01A_NormVyEdgeLeft 4000;
BA_ "GenSigStartValue" SG_ 100 VFC_Obj01A_NormVyEdgeRight 4000;
BA_ "GenSigStartValue" SG_ 100 VFC_Obj01A_HeadingAngle 157;
BA_ "GenSigStartValue" SG_ 102 VFC_Obj02A_Dy 8000;
BA_ "GenSigStartValue" SG_ 102 VFC_Obj02A_Vx 1540;
BA_ "GenSigStartValue" SG_ 102 VFC_Obj02A_Vy 500;
BA_ "GenSigStartValue" SG_ 102 VFC_Obj02A_Ax 160;
BA_ "GenSigStartValue" SG_ 102 VFC_Obj02A_Ay 120;
BA_ "GenSigStartValue" SG_ 102 VFC_Obj02A_EdgeLeft 4000;
BA_ "GenSigStartValue" SG_ 102 VFC_Obj02A_EdgeMid 4000;
BA_ "GenSigStartValue" SG_ 102 VFC_Obj02A_EdgeRight 4000;
BA_ "GenSigStartValue" SG_ 102 VFC_Obj02A_EdgeTop 2000;
BA_ "GenSigStartValue" SG_ 102 VFC_Obj02A_EdgeBottom 2000;
BA_ "GenSigStartValue" SG_ 102 VFC_Obj02A_NormVx 40000;
BA_ "GenSigStartValue" SG_ 102 VFC_Obj02A_NormAx 5000;
BA_ "GenSigStartValue" SG_ 102 VFC_Obj02A_NormVyEdgeLeft 4000;
BA_ "GenSigStartValue" SG_ 102 VFC_Obj02A_NormVyEdgeRight 4000;
BA_ "GenSigStartValue" SG_ 102 VFC_Obj02A_HeadingAngle 157;
BA_ "GenSigStartValue" SG_ 104 VFC_Obj03A_Dy 8000;
BA_ "GenSigStartValue" SG_ 104 VFC_Obj03A_Vx 1540;
BA_ "GenSigStartValue" SG_ 104 VFC_Obj03A_Vy 500;
BA_ "GenSigStartValue" SG_ 104 VFC_Obj03A_Ax 160;
BA_ "GenSigStartValue" SG_ 104 VFC_Obj03A_Ay 120;
BA_ "GenSigStartValue" SG_ 104 VFC_Obj03A_EdgeLeft 4000;
BA_ "GenSigStartValue" SG_ 104 VFC_Obj03A_EdgeMid 4000;
BA_ "GenSigStartValue" SG_ 104 VFC_Obj03A_EdgeRight 4000;
BA_ "GenSigStartValue" SG_ 104 VFC_Obj03A_EdgeTop 2000;
BA_ "GenSigStartValue" SG_ 104 VFC_Obj03A_EdgeBottom 2000;
BA_ "GenSigStartValue" SG_ 104 VFC_Obj03A_NormVx 40000;
BA_ "GenSigStartValue" SG_ 104 VFC_Obj03A_NormAx 5000;
BA_ "GenSigStartValue" SG_ 104 VFC_Obj03A_NormVyEdgeLeft 4000;
BA_ "GenSigStartValue" SG_ 104 VFC_Obj03A_NormVyEdgeRight 4000;
BA_ "GenSigStartValue" SG_ 104 VFC_Obj03A_HeadingAngle 157;
BA_ "GenSigStartValue" SG_ 106 VFC_Obj04A_Dy 8000;
BA_ "GenSigStartValue" SG_ 106 VFC_Obj04A_Vx 1540;
BA_ "GenSigStartValue" SG_ 106 VFC_Obj04A_Vy 500;
BA_ "GenSigStartValue" SG_ 106 VFC_Obj04A_Ax 160;
BA_ "GenSigStartValue" SG_ 106 VFC_Obj04A_Ay 120;
BA_ "GenSigStartValue" SG_ 106 VFC_Obj04A_EdgeLeft 4000;
BA_ "GenSigStartValue" SG_ 106 VFC_Obj04A_EdgeMid 4000;
BA_ "GenSigStartValue" SG_ 106 VFC_Obj04A_EdgeRight 4000;
BA_ "GenSigStartValue" SG_ 106 VFC_Obj04A_EdgeTop 2000;
BA_ "GenSigStartValue" SG_ 106 VFC_Obj04A_EdgeBottom 2000;
BA_ "GenSigStartValue" SG_ 106 VFC_Obj04A_NormVx 40000;
BA_ "GenSigStartValue" SG_ 106 VFC_Obj04A_NormAx 5000;
BA_ "GenSigStartValue" SG_ 106 VFC_Obj04A_NormVyEdgeLeft 4000;
BA_ "GenSigStartValue" SG_ 106 VFC_Obj04A_NormVyEdgeRight 4000;
BA_ "GenSigStartValue" SG_ 106 VFC_Obj04A_HeadingAngle 157;
BA_ "GenSigStartValue" SG_ 108 VFC_Obj05A_Dy 8000;
BA_ "GenSigStartValue" SG_ 108 VFC_Obj05A_Vx 1540;
BA_ "GenSigStartValue" SG_ 108 VFC_Obj05A_Vy 500;
BA_ "GenSigStartValue" SG_ 108 VFC_Obj05A_Ax 160;
BA_ "GenSigStartValue" SG_ 108 VFC_Obj05A_Ay 120;
BA_ "GenSigStartValue" SG_ 108 VFC_Obj05A_EdgeLeft 4000;
BA_ "GenSigStartValue" SG_ 108 VFC_Obj05A_EdgeMid 4000;
BA_ "GenSigStartValue" SG_ 108 VFC_Obj05A_EdgeRight 4000;
BA_ "GenSigStartValue" SG_ 108 VFC_Obj05A_EdgeTop 2000;
BA_ "GenSigStartValue" SG_ 108 VFC_Obj05A_EdgeBottom 2000;
BA_ "GenSigStartValue" SG_ 108 VFC_Obj05A_NormVx 40000;
BA_ "GenSigStartValue" SG_ 108 VFC_Obj05A_NormAx 5000;
BA_ "GenSigStartValue" SG_ 108 VFC_Obj05A_NormVyEdgeLeft 4000;
BA_ "GenSigStartValue" SG_ 108 VFC_Obj05A_NormVyEdgeRight 4000;
BA_ "GenSigStartValue" SG_ 108 VFC_Obj05A_HeadingAngle 157;
BA_ "GenSigStartValue" SG_ 110 VFC_Obj06A_Dy 8000;
BA_ "GenSigStartValue" SG_ 110 VFC_Obj06A_Vx 1540;
BA_ "GenSigStartValue" SG_ 110 VFC_Obj06A_Vy 500;
BA_ "GenSigStartValue" SG_ 110 VFC_Obj06A_Ax 160;
BA_ "GenSigStartValue" SG_ 110 VFC_Obj06A_Ay 120;
BA_ "GenSigStartValue" SG_ 110 VFC_Obj06A_EdgeLeft 4000;
BA_ "GenSigStartValue" SG_ 110 VFC_Obj06A_EdgeMid 4000;
BA_ "GenSigStartValue" SG_ 110 VFC_Obj06A_EdgeRight 4000;
BA_ "GenSigStartValue" SG_ 110 VFC_Obj06A_EdgeTop 2000;
BA_ "GenSigStartValue" SG_ 110 VFC_Obj06A_EdgeBottom 2000;
BA_ "GenSigStartValue" SG_ 110 VFC_Obj06A_NormVx 40000;
BA_ "GenSigStartValue" SG_ 110 VFC_Obj06A_NormAx 5000;
BA_ "GenSigStartValue" SG_ 110 VFC_Obj06A_NormVyEdgeLeft 4000;
BA_ "GenSigStartValue" SG_ 110 VFC_Obj06A_NormVyEdgeRight 4000;
BA_ "GenSigStartValue" SG_ 110 VFC_Obj06A_HeadingAngle 157;
BA_ "GenSigStartValue" SG_ 112 VFC_Obj07A_Dy 8000;
BA_ "GenSigStartValue" SG_ 112 VFC_Obj07A_Vx 1540;
BA_ "GenSigStartValue" SG_ 112 VFC_Obj07A_Vy 500;
BA_ "GenSigStartValue" SG_ 112 VFC_Obj07A_Ax 160;
BA_ "GenSigStartValue" SG_ 112 VFC_Obj07A_Ay 120;
BA_ "GenSigStartValue" SG_ 112 VFC_Obj07A_EdgeLeft 4000;
BA_ "GenSigStartValue" SG_ 112 VFC_Obj07A_EdgeMid 4000;
BA_ "GenSigStartValue" SG_ 112 VFC_Obj07A_EdgeRight 4000;
BA_ "GenSigStartValue" SG_ 112 VFC_Obj07A_EdgeTop 2000;
BA_ "GenSigStartValue" SG_ 112 VFC_Obj07A_EdgeBottom 2000;
BA_ "GenSigStartValue" SG_ 112 VFC_Obj07A_NormVx 40000;
BA_ "GenSigStartValue" SG_ 112 VFC_Obj07A_NormAx 5000;
BA_ "GenSigStartValue" SG_ 112 VFC_Obj07A_NormVyEdgeLeft 4000;
BA_ "GenSigStartValue" SG_ 112 VFC_Obj07A_NormVyEdgeRight 4000;
BA_ "GenSigStartValue" SG_ 112 VFC_Obj07A_HeadingAngle 157;
BA_ "GenSigStartValue" SG_ 114 VFC_Obj08A_Dy 8000;
BA_ "GenSigStartValue" SG_ 114 VFC_Obj08A_Vx 1540;
BA_ "GenSigStartValue" SG_ 114 VFC_Obj08A_Vy 500;
BA_ "GenSigStartValue" SG_ 114 VFC_Obj08A_Ax 160;
BA_ "GenSigStartValue" SG_ 114 VFC_Obj08A_Ay 120;
BA_ "GenSigStartValue" SG_ 114 VFC_Obj08A_EdgeLeft 4000;
BA_ "GenSigStartValue" SG_ 114 VFC_Obj08A_EdgeMid 4000;
BA_ "GenSigStartValue" SG_ 114 VFC_Obj08A_EdgeRight 4000;
BA_ "GenSigStartValue" SG_ 114 VFC_Obj08A_EdgeTop 2000;
BA_ "GenSigStartValue" SG_ 114 VFC_Obj08A_EdgeBottom 2000;
BA_ "GenSigStartValue" SG_ 114 VFC_Obj08A_NormVx 40000;
BA_ "GenSigStartValue" SG_ 114 VFC_Obj08A_NormAx 5000;
BA_ "GenSigStartValue" SG_ 114 VFC_Obj08A_NormVyEdgeLeft 4000;
BA_ "GenSigStartValue" SG_ 114 VFC_Obj08A_NormVyEdgeRight 4000;
BA_ "GenSigStartValue" SG_ 114 VFC_Obj08A_HeadingAngle 157;
BA_ "GenSigStartValue" SG_ 116 VFC_Obj09A_Dy 8000;
BA_ "GenSigStartValue" SG_ 116 VFC_Obj09A_Vx 1540;
BA_ "GenSigStartValue" SG_ 116 VFC_Obj09A_Vy 500;
BA_ "GenSigStartValue" SG_ 116 VFC_Obj09A_Ax 160;
BA_ "GenSigStartValue" SG_ 116 VFC_Obj09A_Ay 120;
BA_ "GenSigStartValue" SG_ 116 VFC_Obj09A_EdgeLeft 4000;
BA_ "GenSigStartValue" SG_ 116 VFC_Obj09A_EdgeMid 4000;
BA_ "GenSigStartValue" SG_ 116 VFC_Obj09A_EdgeRight 4000;
BA_ "GenSigStartValue" SG_ 116 VFC_Obj09A_EdgeTop 2000;
BA_ "GenSigStartValue" SG_ 116 VFC_Obj09A_EdgeBottom 2000;
BA_ "GenSigStartValue" SG_ 116 VFC_Obj09A_NormVx 40000;
BA_ "GenSigStartValue" SG_ 116 VFC_Obj09A_NormAx 5000;
BA_ "GenSigStartValue" SG_ 116 VFC_Obj09A_NormVyEdgeLeft 4000;
BA_ "GenSigStartValue" SG_ 116 VFC_Obj09A_NormVyEdgeRight 4000;
BA_ "GenSigStartValue" SG_ 116 VFC_Obj09A_HeadingAngle 157;
BA_ "GenSigStartValue" SG_ 118 VFC_Obj10A_Dy 8000;
BA_ "GenSigStartValue" SG_ 118 VFC_Obj10A_Vx 1540;
BA_ "GenSigStartValue" SG_ 118 VFC_Obj10A_Vy 500;
BA_ "GenSigStartValue" SG_ 118 VFC_Obj10A_Ax 160;
BA_ "GenSigStartValue" SG_ 118 VFC_Obj10A_Ay 120;
BA_ "GenSigStartValue" SG_ 118 VFC_Obj10A_EdgeLeft 4000;
BA_ "GenSigStartValue" SG_ 118 VFC_Obj10A_EdgeMid 4000;
BA_ "GenSigStartValue" SG_ 118 VFC_Obj10A_EdgeRight 4000;
BA_ "GenSigStartValue" SG_ 118 VFC_Obj10A_EdgeTop 2000;
BA_ "GenSigStartValue" SG_ 118 VFC_Obj10A_EdgeBottom 2000;
BA_ "GenSigStartValue" SG_ 118 VFC_Obj10A_NormVx 40000;
BA_ "GenSigStartValue" SG_ 118 VFC_Obj10A_NormAx 5000;
BA_ "GenSigStartValue" SG_ 118 VFC_Obj10A_NormVyEdgeLeft 4000;
BA_ "GenSigStartValue" SG_ 118 VFC_Obj10A_NormVyEdgeRight 4000;
BA_ "GenSigStartValue" SG_ 118 VFC_Obj10A_HeadingAngle 157;
BA_ "GenSigStartValue" SG_ 120 VFC_Obj11A_Dy 8000;
BA_ "GenSigStartValue" SG_ 120 VFC_Obj11A_Vx 1540;
BA_ "GenSigStartValue" SG_ 120 VFC_Obj11A_Vy 500;
BA_ "GenSigStartValue" SG_ 120 VFC_Obj11A_Ax 160;
BA_ "GenSigStartValue" SG_ 120 VFC_Obj11A_Ay 120;
BA_ "GenSigStartValue" SG_ 120 VFC_Obj11A_EdgeLeft 4000;
BA_ "GenSigStartValue" SG_ 120 VFC_Obj11A_EdgeMid 4000;
BA_ "GenSigStartValue" SG_ 120 VFC_Obj11A_EdgeRight 4000;
BA_ "GenSigStartValue" SG_ 120 VFC_Obj11A_EdgeTop 2000;
BA_ "GenSigStartValue" SG_ 120 VFC_Obj11A_EdgeBottom 2000;
BA_ "GenSigStartValue" SG_ 120 VFC_Obj11A_NormVx 40000;
BA_ "GenSigStartValue" SG_ 120 VFC_Obj11A_NormAx 5000;
BA_ "GenSigStartValue" SG_ 120 VFC_Obj11A_NormVyEdgeLeft 4000;
BA_ "GenSigStartValue" SG_ 120 VFC_Obj11A_NormVyEdgeRight 4000;
BA_ "GenSigStartValue" SG_ 120 VFC_Obj11A_HeadingAngle 157;
BA_ "GenSigStartValue" SG_ 122 VFC_Obj12A_Dy 8000;
BA_ "GenSigStartValue" SG_ 122 VFC_Obj12A_Vx 1540;
BA_ "GenSigStartValue" SG_ 122 VFC_Obj12A_Vy 500;
BA_ "GenSigStartValue" SG_ 122 VFC_Obj12A_Ax 160;
BA_ "GenSigStartValue" SG_ 122 VFC_Obj12A_Ay 120;
BA_ "GenSigStartValue" SG_ 122 VFC_Obj12A_EdgeLeft 4000;
BA_ "GenSigStartValue" SG_ 122 VFC_Obj12A_EdgeMid 4000;
BA_ "GenSigStartValue" SG_ 122 VFC_Obj12A_EdgeRight 4000;
BA_ "GenSigStartValue" SG_ 122 VFC_Obj12A_EdgeTop 2000;
BA_ "GenSigStartValue" SG_ 122 VFC_Obj12A_EdgeBottom 2000;
BA_ "GenSigStartValue" SG_ 122 VFC_Obj12A_NormVx 40000;
BA_ "GenSigStartValue" SG_ 122 VFC_Obj12A_NormAx 5000;
BA_ "GenSigStartValue" SG_ 122 VFC_Obj12A_NormVyEdgeLeft 4000;
BA_ "GenSigStartValue" SG_ 122 VFC_Obj12A_NormVyEdgeRight 4000;
BA_ "GenSigStartValue" SG_ 122 VFC_Obj12A_HeadingAngle 157;
BA_ "GenSigStartValue" SG_ 124 VFC_Obj13A_Dy 8000;
BA_ "GenSigStartValue" SG_ 124 VFC_Obj13A_Vx 1540;
BA_ "GenSigStartValue" SG_ 124 VFC_Obj13A_Vy 500;
BA_ "GenSigStartValue" SG_ 124 VFC_Obj13A_Ax 160;
BA_ "GenSigStartValue" SG_ 124 VFC_Obj13A_Ay 120;
BA_ "GenSigStartValue" SG_ 124 VFC_Obj13A_EdgeLeft 4000;
BA_ "GenSigStartValue" SG_ 124 VFC_Obj13A_EdgeMid 4000;
BA_ "GenSigStartValue" SG_ 124 VFC_Obj13A_EdgeRight 4000;
BA_ "GenSigStartValue" SG_ 124 VFC_Obj13A_EdgeTop 2000;
BA_ "GenSigStartValue" SG_ 124 VFC_Obj13A_EdgeBottom 2000;
BA_ "GenSigStartValue" SG_ 124 VFC_Obj13A_NormVx 40000;
BA_ "GenSigStartValue" SG_ 124 VFC_Obj13A_NormAx 5000;
BA_ "GenSigStartValue" SG_ 124 VFC_Obj13A_NormVyEdgeLeft 4000;
BA_ "GenSigStartValue" SG_ 124 VFC_Obj13A_NormVyEdgeRight 4000;
BA_ "GenSigStartValue" SG_ 124 VFC_Obj13A_HeadingAngle 157;
BA_ "GenSigStartValue" SG_ 126 VFC_Obj14A_Dy 8000;
BA_ "GenSigStartValue" SG_ 126 VFC_Obj14A_Vx 1540;
BA_ "GenSigStartValue" SG_ 126 VFC_Obj14A_Vy 500;
BA_ "GenSigStartValue" SG_ 126 VFC_Obj14A_Ax 160;
BA_ "GenSigStartValue" SG_ 126 VFC_Obj14A_Ay 120;
BA_ "GenSigStartValue" SG_ 126 VFC_Obj14A_EdgeLeft 4000;
BA_ "GenSigStartValue" SG_ 126 VFC_Obj14A_EdgeMid 4000;
BA_ "GenSigStartValue" SG_ 126 VFC_Obj14A_EdgeRight 4000;
BA_ "GenSigStartValue" SG_ 126 VFC_Obj14A_EdgeTop 2000;
BA_ "GenSigStartValue" SG_ 126 VFC_Obj14A_EdgeBottom 2000;
BA_ "GenSigStartValue" SG_ 126 VFC_Obj14A_NormVx 40000;
BA_ "GenSigStartValue" SG_ 126 VFC_Obj14A_NormAx 5000;
BA_ "GenSigStartValue" SG_ 126 VFC_Obj14A_NormVyEdgeLeft 4000;
BA_ "GenSigStartValue" SG_ 126 VFC_Obj14A_NormVyEdgeRight 4000;
BA_ "GenSigStartValue" SG_ 126 VFC_Obj14A_HeadingAngle 157;
VAL_ 80 VFC_GlobalHdr_SensorState 0 "Camera Operational" 1 "Camera Initialization" 2 "Camera Limited (reduced Mode)" 3 "Reserved" 4 "Camera Blocked" 5 "Camera Error" 6 "Camera Calibration" 7 "Camera Decalibrated" ;
VAL_ 80 VFC_GlobalHdr_CalibState 0 "Fully Calibrated" 1 "Not Calibrated" 2 "Yaw Not Calibrated" 3 "Pitch Not Calibrated" 4 "Roll Not Calibrated" 5 "Reserved5" 6 "Reserved6" 7 "Reserved7" ;
VAL_ 96 VFC_ObjHdr_State 0 "off" 1 "on" 2 "Reduced" 3 "HW_Error" 4 "SW_Error" 5 "FID_Active" 6 "Reserved6" 7 "Reserved7" ;
VAL_ 98 VFC_Obj00A_ID 0 "INVALID" ;
VAL_ 98 VFC_Obj00A_Type 0 "NOTYPE" 1 "CAR" 2 "RESERVED02" 3 "TRUCK" 4 "RESERVED04" 5 "RESERVED05" 6 "MOTORCYCLIST" 7 "PEDESTRIAN" 8 "CYCLIST" 9 "BOLLARD" 10 "ROADPOST" 11 "ARROWPOST" 12 "RESERVED12" 13 "RESERVED13" 14 "RESERVED14" 15 "RESERVED15" ;
VAL_ 98 VFC_Obj00A_HeadOrientation 0 "N/A" 1 "Head front" 2 "Head left front" 3 "Head left" 4 "Head left back" 5 "Head back" 6 "Head right back" 7 "Head right" 8 "Head right front" 9 "Reserved09" 10 "Reserved10" 11 "Reserved11" 12 "Reserved12" 13 "Reserved13" 14 "Reserved14" 15 "Unknown" ;
VAL_ 98 VFC_Obj00A_CompletelyInImg 0 "not completely measured" 1 "completely measured" ;
VAL_ 98 VFC_Obj00A_Measured 0 "Invalid" 1 "Measured" 2 "Predicted" 3 "Reserved3" ;
VAL_ 98 VFC_Obj00A_VisibleView 0 "UNKNOWN" 1 "CLASSIC" 2 "SIDE" 3 "CLASSIC_SIDE" 4 "SIDE_CLASSIC" ;
VAL_ 98 VFC_Obj00A_ClassifiedView 0 "Unknown" 1 "Front" 2 "Rear" 3 "Left" 4 "Right" ;
VAL_ 98 VFC_Obj00A_DirIndicator 0 "Unknown" 1 "No direction indicator" 2 "Left indicator" 3 "Right indicator" 4 "Warning Lights" ;
VAL_ 98 VFC_Obj00A_BrakeLight 0 "Unknown" 1 "No light detected" 2 "One light detected" 3 "Two lights detected" 4 "Three lights detected" 5 "Reserved5" 6 "Reserved6" 7 "Reserved7" ;
VAL_ 100 VFC_Obj01A_ID 0 "INVALID" ;
VAL_ 100 VFC_Obj01A_Type 0 "NOTYPE" 1 "CAR" 2 "RESERVED02" 3 "TRUCK" 4 "RESERVED04" 5 "RESERVED05" 6 "MOTORCYCLIST" 7 "PEDESTRIAN" 8 "CYCLIST" 9 "BOLLARD" 10 "ROADPOST" 11 "ARROWPOST" 12 "RESERVED12" 13 "RESERVED13" 14 "RESERVED14" 15 "RESERVED15" ;
VAL_ 100 VFC_Obj01A_HeadOrientation 0 "N/A" 1 "Head front" 2 "Head left front" 3 "Head left" 4 "Head left back" 5 "Head back" 6 "Head right back" 7 "Head right" 8 "Head right front" 9 "Reserved09" 10 "Reserved10" 11 "Reserved11" 12 "Reserved12" 13 "Reserved13" 14 "Reserved14" 15 "Unknown" ;
VAL_ 100 VFC_Obj01A_CompletelyInImg 0 "not completely measured" 1 "completely measured" ;
VAL_ 100 VFC_Obj01A_Measured 0 "Invalid" 1 "Measured" 2 "Predicted" 3 "Reserved3" ;
VAL_ 100 VFC_Obj01A_VisibleView 0 "UNKNOWN" 1 "CLASSIC" 2 "SIDE" 3 "CLASSIC_SIDE" 4 "SIDE_CLASSIC" ;
VAL_ 100 VFC_Obj01A_ClassifiedView 0 "Unknown" 1 "Front" 2 "Rear" 3 "Left" 4 "Right" ;
VAL_ 100 VFC_Obj01A_DirIndicator 0 "Unknown" 1 "No direction indicator" 2 "Left indicator" 3 "Right indicator" 4 "Warning Lights" ;
VAL_ 100 VFC_Obj01A_BrakeLight 0 "Unknown" 1 "No light detected" 2 "One light detected" 3 "Two lights detected" 4 "Three lights detected" 5 "Reserved5" 6 "Reserved6" 7 "Reserved7" ;
VAL_ 102 VFC_Obj02A_ID 0 "INVALID" ;
VAL_ 102 VFC_Obj02A_Type 0 "NOTYPE" 1 "CAR" 2 "RESERVED02" 3 "TRUCK" 4 "RESERVED04" 5 "RESERVED05" 6 "MOTORCYCLIST" 7 "PEDESTRIAN" 8 "CYCLIST" 9 "BOLLARD" 10 "ROADPOST" 11 "ARROWPOST" 12 "RESERVED12" 13 "RESERVED13" 14 "RESERVED14" 15 "RESERVED15" ;
VAL_ 102 VFC_Obj02A_HeadOrientation 0 "N/A" 1 "Head front" 2 "Head left front" 3 "Head left" 4 "Head left back" 5 "Head back" 6 "Head right back" 7 "Head right" 8 "Head right front" 9 "Reserved09" 10 "Reserved10" 11 "Reserved11" 12 "Reserved12" 13 "Reserved13" 14 "Reserved14" 15 "Unknown" ;
VAL_ 102 VFC_Obj02A_CompletelyInImg 0 "not completely measured" 1 "completely measured" ;
VAL_ 102 VFC_Obj02A_Measured 0 "Invalid" 1 "Measured" 2 "Predicted" 3 "Reserved3" ;
VAL_ 102 VFC_Obj02A_VisibleView 0 "UNKNOWN" 1 "CLASSIC" 2 "SIDE" 3 "CLASSIC_SIDE" 4 "SIDE_CLASSIC" ;
VAL_ 102 VFC_Obj02A_ClassifiedView 0 "Unknown" 1 "Front" 2 "Rear" 3 "Left" 4 "Right" ;
VAL_ 102 VFC_Obj02A_DirIndicator 0 "Unknown" 1 "No direction indicator" 2 "Left indicator" 3 "Right indicator" 4 "Warning Lights" ;
VAL_ 102 VFC_Obj02A_BrakeLight 0 "Unknown" 1 "No light detected" 2 "One light detected" 3 "Two lights detected" 4 "Three lights detected" 5 "Reserved5" 6 "Reserved6" 7 "Reserved7" ;
VAL_ 104 VFC_Obj03A_ID 0 "INVALID" ;
VAL_ 104 VFC_Obj03A_Type 0 "NOTYPE" 1 "CAR" 2 "RESERVED02" 3 "TRUCK" 4 "RESERVED04" 5 "RESERVED05" 6 "MOTORCYCLIST" 7 "PEDESTRIAN" 8 "CYCLIST" 9 "BOLLARD" 10 "ROADPOST" 11 "ARROWPOST" 12 "RESERVED12" 13 "RESERVED13" 14 "RESERVED14" 15 "RESERVED15" ;
VAL_ 104 VFC_Obj03A_HeadOrientation 0 "N/A" 1 "Head front" 2 "Head left front" 3 "Head left" 4 "Head left back" 5 "Head back" 6 "Head right back" 7 "Head right" 8 "Head right front" 9 "Reserved09" 10 "Reserved10" 11 "Reserved11" 12 "Reserved12" 13 "Reserved13" 14 "Reserved14" 15 "Unknown" ;
VAL_ 104 VFC_Obj03A_CompletelyInImg 0 "not completely measured" 1 "completely measured" ;
VAL_ 104 VFC_Obj03A_Measured 0 "Invalid" 1 "Measured" 2 "Predicted" 3 "Reserved3" ;
VAL_ 104 VFC_Obj03A_VisibleView 0 "UNKNOWN" 1 "CLASSIC" 2 "SIDE" 3 "CLASSIC_SIDE" 4 "SIDE_CLASSIC" ;
VAL_ 104 VFC_Obj03A_ClassifiedView 0 "Unknown" 1 "Front" 2 "Rear" 3 "Left" 4 "Right" ;
VAL_ 104 VFC_Obj03A_DirIndicator 0 "Unknown" 1 "No direction indicator" 2 "Left indicator" 3 "Right indicator" 4 "Warning Lights" ;
VAL_ 104 VFC_Obj03A_BrakeLight 0 "Unknown" 1 "No light detected" 2 "One light detected" 3 "Two lights detected" 4 "Three lights detected" 5 "Reserved5" 6 "Reserved6" 7 "Reserved7" ;
VAL_ 106 VFC_Obj04A_ID 0 "INVALID" ;
VAL_ 106 VFC_Obj04A_Type 0 "NOTYPE" 1 "CAR" 2 "RESERVED02" 3 "TRUCK" 4 "RESERVED04" 5 "RESERVED05" 6 "MOTORCYCLIST" 7 "PEDESTRIAN" 8 "CYCLIST" 9 "BOLLARD" 10 "ROADPOST" 11 "ARROWPOST" 12 "RESERVED12" 13 "RESERVED13" 14 "RESERVED14" 15 "RESERVED15" ;
VAL_ 106 VFC_Obj04A_HeadOrientation 0 "N/A" 1 "Head front" 2 "Head left front" 3 "Head left" 4 "Head left back" 5 "Head back" 6 "Head right back" 7 "Head right" 8 "Head right front" 9 "Reserved09" 10 "Reserved10" 11 "Reserved11" 12 "Reserved12" 13 "Reserved13" 14 "Reserved14" 15 "Unknown" ;
VAL_ 106 VFC_Obj04A_CompletelyInImg 0 "not completely measured" 1 "completely measured" ;
VAL_ 106 VFC_Obj04A_Measured 0 "Invalid" 1 "Measured" 2 "Predicted" 3 "Reserved3" ;
VAL_ 106 VFC_Obj04A_VisibleView 0 "UNKNOWN" 1 "CLASSIC" 2 "SIDE" 3 "CLASSIC_SIDE" 4 "SIDE_CLASSIC" ;
VAL_ 106 VFC_Obj04A_ClassifiedView 0 "Unknown" 1 "Front" 2 "Rear" 3 "Left" 4 "Right" ;
VAL_ 106 VFC_Obj04A_DirIndicator 0 "Unknown" 1 "No direction indicator" 2 "Left indicator" 3 "Right indicator" 4 "Warning Lights" ;
VAL_ 106 VFC_Obj04A_BrakeLight 0 "Unknown" 1 "No light detected" 2 "One light detected" 3 "Two lights detected" 4 "Three lights detected" 5 "Reserved5" 6 "Reserved6" 7 "Reserved7" ;
VAL_ 108 VFC_Obj05A_ID 0 "INVALID" ;
VAL_ 108 VFC_Obj05A_Type 0 "NOTYPE" 1 "CAR" 2 "RESERVED02" 3 "TRUCK" 4 "RESERVED04" 5 "RESERVED05" 6 "MOTORCYCLIST" 7 "PEDESTRIAN" 8 "CYCLIST" 9 "BOLLARD" 10 "ROADPOST" 11 "ARROWPOST" 12 "RESERVED12" 13 "RESERVED13" 14 "RESERVED14" 15 "RESERVED15" ;
VAL_ 108 VFC_Obj05A_HeadOrientation 0 "N/A" 1 "Head front" 2 "Head left front" 3 "Head left" 4 "Head left back" 5 "Head back" 6 "Head right back" 7 "Head right" 8 "Head right front" 9 "Reserved09" 10 "Reserved10" 11 "Reserved11" 12 "Reserved12" 13 "Reserved13" 14 "Reserved14" 15 "Unknown" ;
VAL_ 108 VFC_Obj05A_CompletelyInImg 0 "not completely measured" 1 "completely measured" ;
VAL_ 108 VFC_Obj05A_Measured 0 "Invalid" 1 "Measured" 2 "Predicted" 3 "Reserved3" ;
VAL_ 108 VFC_Obj05A_VisibleView 0 "UNKNOWN" 1 "CLASSIC" 2 "SIDE" 3 "CLASSIC_SIDE" 4 "SIDE_CLASSIC" ;
VAL_ 108 VFC_Obj05A_ClassifiedView 0 "Unknown" 1 "Front" 2 "Rear" 3 "Left" 4 "Right" ;
VAL_ 108 VFC_Obj05A_DirIndicator 0 "Unknown" 1 "No direction indicator" 2 "Left indicator" 3 "Right indicator" 4 "Warning Lights" ;
VAL_ 108 VFC_Obj05A_BrakeLight 0 "Unknown" 1 "No light detected" 2 "One light detected" 3 "Two lights detected" 4 "Three lights detected" 5 "Reserved5" 6 "Reserved6" 7 "Reserved7" ;
VAL_ 110 VFC_Obj06A_ID 0 "INVALID" ;
VAL_ 110 VFC_Obj06A_Type 0 "NOTYPE" 1 "CAR" 2 "RESERVED02" 3 "TRUCK" 4 "RESERVED04" 5 "RESERVED05" 6 "MOTORCYCLIST" 7 "PEDESTRIAN" 8 "CYCLIST" 9 "BOLLARD" 10 "ROADPOST" 11 "ARROWPOST" 12 "RESERVED12" 13 "RESERVED13" 14 "RESERVED14" 15 "RESERVED15" ;
VAL_ 110 VFC_Obj06A_HeadOrientation 0 "N/A" 1 "Head front" 2 "Head left front" 3 "Head left" 4 "Head left back" 5 "Head back" 6 "Head right back" 7 "Head right" 8 "Head right front" 9 "Reserved09" 10 "Reserved10" 11 "Reserved11" 12 "Reserved12" 13 "Reserved13" 14 "Reserved14" 15 "Unknown" ;
VAL_ 110 VFC_Obj06A_CompletelyInImg 0 "not completely measured" 1 "completely measured" ;
VAL_ 110 VFC_Obj06A_Measured 0 "Invalid" 1 "Measured" 2 "Predicted" 3 "Reserved3" ;
VAL_ 110 VFC_Obj06A_VisibleView 0 "UNKNOWN" 1 "CLASSIC" 2 "SIDE" 3 "CLASSIC_SIDE" 4 "SIDE_CLASSIC" ;
VAL_ 110 VFC_Obj06A_ClassifiedView 0 "Unknown" 1 "Front" 2 "Rear" 3 "Left" 4 "Right" ;
VAL_ 110 VFC_Obj06A_DirIndicator 0 "Unknown" 1 "No direction indicator" 2 "Left indicator" 3 "Right indicator" 4 "Warning Lights" ;
VAL_ 110 VFC_Obj06A_BrakeLight 0 "Unknown" 1 "No light detected" 2 "One light detected" 3 "Two lights detected" 4 "Three lights detected" 5 "Reserved5" 6 "Reserved6" 7 "Reserved7" ;
VAL_ 112 VFC_Obj07A_ID 0 "INVALID" ;
VAL_ 112 VFC_Obj07A_Type 0 "NOTYPE" 1 "CAR" 2 "RESERVED02" 3 "TRUCK" 4 "RESERVED04" 5 "RESERVED05" 6 "MOTORCYCLIST" 7 "PEDESTRIAN" 8 "CYCLIST" 9 "BOLLARD" 10 "ROADPOST" 11 "ARROWPOST" 12 "RESERVED12" 13 "RESERVED13" 14 "RESERVED14" 15 "RESERVED15" ;
VAL_ 112 VFC_Obj07A_HeadOrientation 0 "N/A" 1 "Head front" 2 "Head left front" 3 "Head left" 4 "Head left back" 5 "Head back" 6 "Head right back" 7 "Head right" 8 "Head right front" 9 "Reserved09" 10 "Reserved10" 11 "Reserved11" 12 "Reserved12" 13 "Reserved13" 14 "Reserved14" 15 "Unknown" ;
VAL_ 112 VFC_Obj07A_CompletelyInImg 0 "not completely measured" 1 "completely measured" ;
VAL_ 112 VFC_Obj07A_Measured 0 "Invalid" 1 "Measured" 2 "Predicted" 3 "Reserved3" ;
VAL_ 112 VFC_Obj07A_VisibleView 0 "UNKNOWN" 1 "CLASSIC" 2 "SIDE" 3 "CLASSIC_SIDE" 4 "SIDE_CLASSIC" ;
VAL_ 112 VFC_Obj07A_ClassifiedView 0 "Unknown" 1 "Front" 2 "Rear" 3 "Left" 4 "Right" ;
VAL_ 112 VFC_Obj07A_DirIndicator 0 "Unknown" 1 "No direction indicator" 2 "Left indicator" 3 "Right indicator" 4 "Warning Lights" ;
VAL_ 112 VFC_Obj07A_BrakeLight 0 "Unknown" 1 "No light detected" 2 "One light detected" 3 "Two lights detected" 4 "Three lights detected" 5 "Reserved5" 6 "Reserved6" 7 "Reserved7" ;
VAL_ 114 VFC_Obj08A_ID 0 "INVALID" ;
VAL_ 114 VFC_Obj08A_Type 0 "NOTYPE" 1 "CAR" 2 "RESERVED02" 3 "TRUCK" 4 "RESERVED04" 5 "RESERVED05" 6 "MOTORCYCLIST" 7 "PEDESTRIAN" 8 "CYCLIST" 9 "BOLLARD" 10 "ROADPOST" 11 "ARROWPOST" 12 "RESERVED12" 13 "RESERVED13" 14 "RESERVED14" 15 "RESERVED15" ;
VAL_ 114 VFC_Obj08A_HeadOrientation 0 "N/A" 1 "Head front" 2 "Head left front" 3 "Head left" 4 "Head left back" 5 "Head back" 6 "Head right back" 7 "Head right" 8 "Head right front" 9 "Reserved09" 10 "Reserved10" 11 "Reserved11" 12 "Reserved12" 13 "Reserved13" 14 "Reserved14" 15 "Unknown" ;
VAL_ 114 VFC_Obj08A_CompletelyInImg 0 "not completely measured" 1 "completely measured" ;
VAL_ 114 VFC_Obj08A_Measured 0 "Invalid" 1 "Measured" 2 "Predicted" 3 "Reserved3" ;
VAL_ 114 VFC_Obj08A_VisibleView 0 "UNKNOWN" 1 "CLASSIC" 2 "SIDE" 3 "CLASSIC_SIDE" 4 "SIDE_CLASSIC" ;
VAL_ 114 VFC_Obj08A_ClassifiedView 0 "Unknown" 1 "Front" 2 "Rear" 3 "Left" 4 "Right" ;
VAL_ 114 VFC_Obj08A_DirIndicator 0 "Unknown" 1 "No direction indicator" 2 "Left indicator" 3 "Right indicator" 4 "Warning Lights" ;
VAL_ 114 VFC_Obj08A_BrakeLight 0 "Unknown" 1 "No light detected" 2 "One light detected" 3 "Two lights detected" 4 "Three lights detected" 5 "Reserved5" 6 "Reserved6" 7 "Reserved7" ;
VAL_ 116 VFC_Obj09A_ID 0 "INVALID" ;
VAL_ 116 VFC_Obj09A_Type 0 "NOTYPE" 1 "CAR" 2 "RESERVED02" 3 "TRUCK" 4 "RESERVED04" 5 "RESERVED05" 6 "MOTORCYCLIST" 7 "PEDESTRIAN" 8 "CYCLIST" 9 "BOLLARD" 10 "ROADPOST" 11 "ARROWPOST" 12 "RESERVED12" 13 "RESERVED13" 14 "RESERVED14" 15 "RESERVED15" ;
VAL_ 116 VFC_Obj09A_HeadOrientation 0 "N/A" 1 "Head front" 2 "Head left front" 3 "Head left" 4 "Head left back" 5 "Head back" 6 "Head right back" 7 "Head right" 8 "Head right front" 9 "Reserved09" 10 "Reserved10" 11 "Reserved11" 12 "Reserved12" 13 "Reserved13" 14 "Reserved14" 15 "Unknown" ;
VAL_ 116 VFC_Obj09A_CompletelyInImg 0 "not completely measured" 1 "completely measured" ;
VAL_ 116 VFC_Obj09A_Measured 0 "Invalid" 1 "Measured" 2 "Predicted" 3 "Reserved3" ;
VAL_ 116 VFC_Obj09A_VisibleView 0 "UNKNOWN" 1 "CLASSIC" 2 "SIDE" 3 "CLASSIC_SIDE" 4 "SIDE_CLASSIC" ;
VAL_ 116 VFC_Obj09A_ClassifiedView 0 "Unknown" 1 "Front" 2 "Rear" 3 "Left" 4 "Right" ;
VAL_ 116 VFC_Obj09A_DirIndicator 0 "Unknown" 1 "No direction indicator" 2 "Left indicator" 3 "Right indicator" 4 "Warning Lights" ;
VAL_ 116 VFC_Obj09A_BrakeLight 0 "Unknown" 1 "No light detected" 2 "One light detected" 3 "Two lights detected" 4 "Three lights detected" 5 "Reserved5" 6 "Reserved6" 7 "Reserved7" ;
VAL_ 118 VFC_Obj10A_ID 0 "INVALID" ;
VAL_ 118 VFC_Obj10A_Type 0 "NOTYPE" 1 "CAR" 2 "RESERVED02" 3 "TRUCK" 4 "RESERVED04" 5 "RESERVED05" 6 "MOTORCYCLIST" 7 "PEDESTRIAN" 8 "CYCLIST" 9 "BOLLARD" 10 "ROADPOST" 11 "ARROWPOST" 12 "RESERVED12" 13 "RESERVED13" 14 "RESERVED14" 15 "RESERVED15" ;
VAL_ 118 VFC_Obj10A_HeadOrientation 0 "N/A" 1 "Head front" 2 "Head left front" 3 "Head left" 4 "Head left back" 5 "Head back" 6 "Head right back" 7 "Head right" 8 "Head right front" 9 "Reserved09" 10 "Reserved10" 11 "Reserved11" 12 "Reserved12" 13 "Reserved13" 14 "Reserved14" 15 "Unknown" ;
VAL_ 118 VFC_Obj10A_CompletelyInImg 0 "not completely measured" 1 "completely measured" ;
VAL_ 118 VFC_Obj10A_Measured 0 "Invalid" 1 "Measured" 2 "Predicted" 3 "Reserved3" ;
VAL_ 118 VFC_Obj10A_VisibleView 0 "UNKNOWN" 1 "CLASSIC" 2 "SIDE" 3 "CLASSIC_SIDE" 4 "SIDE_CLASSIC" ;
VAL_ 118 VFC_Obj10A_ClassifiedView 0 "Unknown" 1 "Front" 2 "Rear" 3 "Left" 4 "Right" ;
VAL_ 118 VFC_Obj10A_DirIndicator 0 "Unknown" 1 "No direction indicator" 2 "Left indicator" 3 "Right indicator" 4 "Warning Lights" ;
VAL_ 118 VFC_Obj10A_BrakeLight 0 "Unknown" 1 "No light detected" 2 "One light detected" 3 "Two lights detected" 4 "Three lights detected" 5 "Reserved5" 6 "Reserved6" 7 "Reserved7" ;
VAL_ 120 VFC_Obj11A_ID 0 "INVALID" ;
VAL_ 120 VFC_Obj11A_Type 0 "NOTYPE" 1 "CAR" 2 "RESERVED02" 3 "TRUCK" 4 "RESERVED04" 5 "RESERVED05" 6 "MOTORCYCLIST" 7 "PEDESTRIAN" 8 "CYCLIST" 9 "BOLLARD" 10 "ROADPOST" 11 "ARROWPOST" 12 "RESERVED12" 13 "RESERVED13" 14 "RESERVED14" 15 "RESERVED15" ;
VAL_ 120 VFC_Obj11A_HeadOrientation 0 "N/A" 1 "Head front" 2 "Head left front" 3 "Head left" 4 "Head left back" 5 "Head back" 6 "Head right back" 7 "Head right" 8 "Head right front" 9 "Reserved09" 10 "Reserved10" 11 "Reserved11" 12 "Reserved12" 13 "Reserved13" 14 "Reserved14" 15 "Unknown" ;
VAL_ 120 VFC_Obj11A_CompletelyInImg 0 "not completely measured" 1 "completely measured" ;
VAL_ 120 VFC_Obj11A_Measured 0 "Invalid" 1 "Measured" 2 "Predicted" 3 "Reserved3" ;
VAL_ 120 VFC_Obj11A_VisibleView 0 "UNKNOWN" 1 "CLASSIC" 2 "SIDE" 3 "CLASSIC_SIDE" 4 "SIDE_CLASSIC" ;
VAL_ 120 VFC_Obj11A_ClassifiedView 0 "Unknown" 1 "Front" 2 "Rear" 3 "Left" 4 "Right" ;
VAL_ 120 VFC_Obj11A_DirIndicator 0 "Unknown" 1 "No direction indicator" 2 "Left indicator" 3 "Right indicator" 4 "Warning Lights" ;
VAL_ 120 VFC_Obj11A_BrakeLight 0 "Unknown" 1 "No light detected" 2 "One light detected" 3 "Two lights detected" 4 "Three lights detected" 5 "Reserved5" 6 "Reserved6" 7 "Reserved7" ;
VAL_ 122 VFC_Obj12A_ID 0 "INVALID" ;
VAL_ 122 VFC_Obj12A_Type 0 "NOTYPE" 1 "CAR" 2 "RESERVED02" 3 "TRUCK" 4 "RESERVED04" 5 "RESERVED05" 6 "MOTORCYCLIST" 7 "PEDESTRIAN" 8 "CYCLIST" 9 "BOLLARD" 10 "ROADPOST" 11 "ARROWPOST" 12 "RESERVED12" 13 "RESERVED13" 14 "RESERVED14" 15 "RESERVED15" ;
VAL_ 122 VFC_Obj12A_HeadOrientation 0 "N/A" 1 "Head front" 2 "Head left front" 3 "Head left" 4 "Head left back" 5 "Head back" 6 "Head right back" 7 "Head right" 8 "Head right front" 9 "Reserved09" 10 "Reserved10" 11 "Reserved11" 12 "Reserved12" 13 "Reserved13" 14 "Reserved14" 15 "Unknown" ;
VAL_ 122 VFC_Obj12A_CompletelyInImg 0 "not completely measured" 1 "completely measured" ;
VAL_ 122 VFC_Obj12A_Measured 0 "Invalid" 1 "Measured" 2 "Predicted" 3 "Reserved3" ;
VAL_ 122 VFC_Obj12A_VisibleView 0 "UNKNOWN" 1 "CLASSIC" 2 "SIDE" 3 "CLASSIC_SIDE" 4 "SIDE_CLASSIC" ;
VAL_ 122 VFC_Obj12A_ClassifiedView 0 "Unknown" 1 "Front" 2 "Rear" 3 "Left" 4 "Right" ;
VAL_ 122 VFC_Obj12A_DirIndicator 0 "Unknown" 1 "No direction indicator" 2 "Left indicator" 3 "Right indicator" 4 "Warning Lights" ;
VAL_ 122 VFC_Obj12A_BrakeLight 0 "Unknown" 1 "No light detected" 2 "One light detected" 3 "Two lights detected" 4 "Three lights detected" 5 "Reserved5" 6 "Reserved6" 7 "Reserved7" ;
VAL_ 124 VFC_Obj13A_ID 0 "INVALID" ;
VAL_ 124 VFC_Obj13A_Type 0 "NOTYPE" 1 "CAR" 2 "RESERVED02" 3 "TRUCK" 4 "RESERVED04" 5 "RESERVED05" 6 "MOTORCYCLIST" 7 "PEDESTRIAN" 8 "CYCLIST" 9 "BOLLARD" 10 "ROADPOST" 11 "ARROWPOST" 12 "RESERVED12" 13 "RESERVED13" 14 "RESERVED14" 15 "RESERVED15" ;
VAL_ 124 VFC_Obj13A_HeadOrientation 0 "N/A" 1 "Head front" 2 "Head left front" 3 "Head left" 4 "Head left back" 5 "Head back" 6 "Head right back" 7 "Head right" 8 "Head right front" 9 "Reserved09" 10 "Reserved10" 11 "Reserved11" 12 "Reserved12" 13 "Reserved13" 14 "Reserved14" 15 "Unknown" ;
VAL_ 124 VFC_Obj13A_CompletelyInImg 0 "not completely measured" 1 "completely measured" ;
VAL_ 124 VFC_Obj13A_Measured 0 "Invalid" 1 "Measured" 2 "Predicted" 3 "Reserved3" ;
VAL_ 124 VFC_Obj13A_VisibleView 0 "UNKNOWN" 1 "CLASSIC" 2 "SIDE" 3 "CLASSIC_SIDE" 4 "SIDE_CLASSIC" ;
VAL_ 124 VFC_Obj13A_ClassifiedView 0 "Unknown" 1 "Front" 2 "Rear" 3 "Left" 4 "Right" ;
VAL_ 124 VFC_Obj13A_DirIndicator 0 "Unknown" 1 "No direction indicator" 2 "Left indicator" 3 "Right indicator" 4 "Warning Lights" ;
VAL_ 124 VFC_Obj13A_BrakeLight 0 "Unknown" 1 "No light detected" 2 "One light detected" 3 "Two lights detected" 4 "Three lights detected" 5 "Reserved5" 6 "Reserved6" 7 "Reserved7" ;
VAL_ 126 VFC_Obj14A_ID 0 "INVALID" ;
VAL_ 126 VFC_Obj14A_Type 0 "NOTYPE" 1 "CAR" 2 "RESERVED02" 3 "TRUCK" 4 "RESERVED04" 5 "RESERVED05" 6 "MOTORCYCLIST" 7 "PEDESTRIAN" 8 "CYCLIST" 9 "BOLLARD" 10 "ROADPOST" 11 "ARROWPOST" 12 "RESERVED12" 13 "RESERVED13" 14 "RESERVED14" 15 "RESERVED15" ;
VAL_ 126 VFC_Obj14A_HeadOrientation 0 "N/A" 1 "Head front" 2 "Head left front" 3 "Head left" 4 "Head left back" 5 "Head back" 6 "Head right back" 7 "Head right" 8 "Head right front" 9 "Reserved09" 10 "Reserved10" 11 "Reserved11" 12 "Reserved12" 13 "Reserved13" 14 "Reserved14" 15 "Unknown" ;
VAL_ 126 VFC_Obj14A_CompletelyInImg 0 "not completely measured" 1 "completely measured" ;
VAL_ 126 VFC_Obj14A_Measured 0 "Invalid" 1 "Measured" 2 "Predicted" 3 "Reserved3" ;
VAL_ 126 VFC_Obj14A_VisibleView 0 "UNKNOWN" 1 "CLASSIC" 2 "SIDE" 3 "CLASSIC_SIDE" 4 "SIDE_CLASSIC" ;
VAL_ 126 VFC_Obj14A_ClassifiedView 0 "Unknown" 1 "Front" 2 "Rear" 3 "Left" 4 "Right" ;
VAL_ 126 VFC_Obj14A_DirIndicator 0 "Unknown" 1 "No direction indicator" 2 "Left indicator" 3 "Right indicator" 4 "Warning Lights" ;
VAL_ 126 VFC_Obj14A_BrakeLight 0 "Unknown" 1 "No light detected" 2 "One light detected" 3 "Two lights detected" 4 "Three lights detected" 5 "Reserved5" 6 "Reserved6" 7 "Reserved7" ;
