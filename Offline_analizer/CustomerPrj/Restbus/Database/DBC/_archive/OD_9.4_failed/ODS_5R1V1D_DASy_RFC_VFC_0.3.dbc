VERSION "created by canmatrix"

NS_ :

BS_:

BU_: RadarFrontCenter DASy MPC3

BO_ 128 VFC_Object15A: 64 MPC3
 SG_ VFC_Obj15A_CRC : 0|16@1+ (1,0) [0|65535] ""  DASy
 SG_ VFC_Obj15A_AliveCtr : 16|8@1+ (1,0) [0|255] ""  DASy
 SG_ VFC_Obj15A_ProtBlockCtr : 24|4@1+ (1,0) [0|15] ""  DASy
 SG_ VFC_Obj15A_ID : 32|8@1+ (1,0) [1|255] ""  DASy
 SG_ VFC_Obj15A_Type : 60|4@1+ (1,0) [0|15] ""  DASy
 SG_ VFC_Obj15A_TypeProb : 378|6@1+ (2,0) [0|100] "%"  DASy
 SG_ VFC_Obj15A_Dx : 48|12@1+ (0.05,0) [0|204.75] "m"  DASy
 SG_ VFC_Obj15A_Dy : 64|14@1+ (0.01,-80) [-80|80] "m"  DASy
 SG_ VFC_Obj15A_Vx : 80|11@1+ (0.1,-154) [-154|50] "m/s"  DASy
 SG_ VFC_Obj15A_Vy : 96|10@1+ (0.1,-50) [-50|50] "m/s"  DASy
 SG_ VFC_Obj15A_Ax : 112|9@1+ (0.1,-16) [-16|16] "m/s^2"  DASy
 SG_ VFC_Obj15A_Ay : 128|8@1+ (0.1,-12) [-12|12] "m/s^2"  DASy
 SG_ VFC_Obj15A_DxStdDev : 144|10@1+ (0.05,0) [0|51.15] "m"  DASy
 SG_ VFC_Obj15A_DyStdDev : 160|10@1+ (0.02,0) [0|20.46] "m"  DASy
 SG_ VFC_Obj15A_VxStdDev : 176|10@1+ (0.1,0) [0|102.3] "m/s"  DASy
 SG_ VFC_Obj15A_VyStdDev : 192|9@1+ (0.1,0) [0|51.1] "m/s"  DASy
 SG_ VFC_Obj15A_AxStdDev : 40|8@1+ (0.1,0) [0|25.5] "m/s^2"  DASy
 SG_ VFC_Obj15A_AyStdDev : 136|8@1+ (0.1,0) [0|25.5] "m/s^2"  DASy
 SG_ VFC_Obj15A_Length : 217|9@1+ (0.05,0) [0|25.55] "m"  DASy
 SG_ VFC_Obj15A_Width : 294|10@1+ (0.01,0) [0|10.23] "m"  DASy
 SG_ VFC_Obj15A_Height : 208|9@1+ (0.01,0) [0|5.11] "m"  DASy
 SG_ VFC_Obj15A_LengthStdDev : 384|7@1+ (0.05,0) [0|5] "m"  DASy
 SG_ VFC_Obj15A_WidthStdDev : 391|7@1+ (0.01,0) [0|1] "m"  DASy
 SG_ VFC_Obj15A_HeightStdDev : 201|7@1+ (0.01,0) [0|1] "m"  DASy
 SG_ VFC_Obj15A_EdgeLeft : 411|13@1+ (0.00025,-1) [-1|1] "unitless"  DASy
 SG_ VFC_Obj15A_EdgeMid : 398|13@1+ (0.00025,-1) [-1|1] "unitless"  DASy
 SG_ VFC_Obj15A_EdgeRight : 424|13@1+ (0.00025,-1) [-1|1] "unitless"  DASy
 SG_ VFC_Obj15A_EdgeTop : 448|12@1+ (0.00025,-0.5) [-0.5|0.5] "unitless"  DASy
 SG_ VFC_Obj15A_EdgeBottom : 269|12@1+ (0.00025,-0.5) [-0.5|0.5] "unitless"  DASy
 SG_ VFC_Obj15A_EdgeLeftStdDev : 440|8@1+ (0.0002,0) [0|0.051] "unitless"  DASy
 SG_ VFC_Obj15A_EdgeMidStdDev : 464|8@1+ (0.0002,0) [0|0.051] "unitless"  DASy
 SG_ VFC_Obj15A_EdgeRightStdDev : 472|8@1+ (0.0002,0) [0|0.051] "unitless"  DASy
 SG_ VFC_Obj15A_EdgeTopStdDev : 480|8@1+ (0.0002,0) [0|0.051] "unitless"  DASy
 SG_ VFC_Obj15A_EdgeBottomStdDev : 488|8@1+ (0.0002,0) [0|0.051] "unitless"  DASy
 SG_ VFC_Obj15A_NormVx : 304|16@1+ (0.001,-40) [-40|25] "1/s"  DASy
 SG_ VFC_Obj15A_NormAx : 235|13@1+ (0.002,-10) [-10|6] "1/s^2"  DASy
 SG_ VFC_Obj15A_NormVyEdgeLeft : 256|13@1+ (0.001,-4) [-4|4] "1/s"  DASy
 SG_ VFC_Obj15A_NormVyEdgeRight : 281|13@1+ (0.001,-4) [-4|4] "1/s"  DASy
 SG_ VFC_Obj15A_NormVxStdDev : 368|10@1+ (0.001,0) [0|1.023] "1/s"  DASy
 SG_ VFC_Obj15A_NormAxStdDev : 328|10@1+ (0.0025,0) [0|2.5575] "1/s^2"  DASy
 SG_ VFC_Obj15A_NormVyEdgeLeftStdDev : 248|8@1+ (0.001,0) [0|0.255] "1/s"  DASy
 SG_ VFC_Obj15A_NormVyEdgeRightStdDev : 320|8@1+ (0.001,0) [0|0.255] "1/s"  DASy
 SG_ VFC_Obj15A_ScaleChange : 338|14@1+ (0.0001,0.5) [0.5|2.1383] "unitless"  DASy
 SG_ VFC_Obj15A_ScaleChngStdDev : 352|10@1+ (0.0001,0) [0|0.1023] "unitless"  DASy
 SG_ VFC_Obj15A_HeadingAngle : 226|9@1+ (0.01,-1.57) [-1.57|1.57] "rad"  DASy
 SG_ VFC_Obj15A_HeadingAngleStdDev : 186|6@1+ (0.01,0) [0|0.5] "rad"  DASy
 SG_ VFC_Obj15A_HeadOrientation : 460|4@1+ (1,0) [0|15] ""  DASy
 SG_ VFC_Obj15A_CompletelyInImg : 121|1@1+ (1,0) [0|1] ""  DASy
 SG_ VFC_Obj15A_ProbMovingLat : 154|6@1+ (2,0) [0|100] "%"  DASy
 SG_ VFC_Obj15A_ProbMovingLong : 170|6@1+ (2,0) [0|100] "%"  DASy
 SG_ VFC_Obj15A_ProbExist : 122|6@1+ (2,0) [0|100] "%"  DASy
 SG_ VFC_Obj15A_MeasSource : 91|5@1+ (1,0) [0|31] ""  DASy
 SG_ VFC_Obj15A_Reliability : 362|6@1+ (1,0) [0|63] ""  DASy
 SG_ VFC_Obj15A_Measured : 78|2@1+ (1,0) [0|3] ""  DASy
 SG_ VFC_Obj15A_VisibleView : 437|3@1+ (1,0) [0|4] ""  DASy
 SG_ VFC_Obj15A_ClassifiedView : 496|3@1+ (1,0) [0|4] ""  DASy
 SG_ VFC_Obj15A_DirIndicator : 106|3@1+ (1,0) [0|4] ""  DASy
 SG_ VFC_Obj15A_BrakeLight : 109|3@1+ (1,0) [0|7] ""  DASy

BO_ 130 VFC_Object16A: 64 MPC3
 SG_ VFC_Obj16A_CRC : 0|16@1+ (1,0) [0|65535] ""  DASy
 SG_ VFC_Obj16A_AliveCtr : 16|8@1+ (1,0) [0|255] ""  DASy
 SG_ VFC_Obj16A_ProtBlockCtr : 24|4@1+ (1,0) [0|15] ""  DASy
 SG_ VFC_Obj16A_ID : 32|8@1+ (1,0) [1|255] ""  DASy
 SG_ VFC_Obj16A_Type : 60|4@1+ (1,0) [0|15] ""  DASy
 SG_ VFC_Obj16A_TypeProb : 378|6@1+ (2,0) [0|100] "%"  DASy
 SG_ VFC_Obj16A_Dx : 48|12@1+ (0.05,0) [0|204.75] "m"  DASy
 SG_ VFC_Obj16A_Dy : 64|14@1+ (0.01,-80) [-80|80] "m"  DASy
 SG_ VFC_Obj16A_Vx : 80|11@1+ (0.1,-154) [-154|50] "m/s"  DASy
 SG_ VFC_Obj16A_Vy : 96|10@1+ (0.1,-50) [-50|50] "m/s"  DASy
 SG_ VFC_Obj16A_Ax : 112|9@1+ (0.1,-16) [-16|16] "m/s^2"  DASy
 SG_ VFC_Obj16A_Ay : 128|8@1+ (0.1,-12) [-12|12] "m/s^2"  DASy
 SG_ VFC_Obj16A_DxStdDev : 144|10@1+ (0.05,0) [0|51.15] "m"  DASy
 SG_ VFC_Obj16A_DyStdDev : 160|10@1+ (0.02,0) [0|20.46] "m"  DASy
 SG_ VFC_Obj16A_VxStdDev : 176|10@1+ (0.1,0) [0|102.3] "m/s"  DASy
 SG_ VFC_Obj16A_VyStdDev : 192|9@1+ (0.1,0) [0|51.1] "m/s"  DASy
 SG_ VFC_Obj16A_AxStdDev : 40|8@1+ (0.1,0) [0|25.5] "m/s^2"  DASy
 SG_ VFC_Obj16A_AyStdDev : 136|8@1+ (0.1,0) [0|25.5] "m/s^2"  DASy
 SG_ VFC_Obj16A_Length : 217|9@1+ (0.05,0) [0|25.55] "m"  DASy
 SG_ VFC_Obj16A_Width : 294|10@1+ (0.01,0) [0|10.23] "m"  DASy
 SG_ VFC_Obj16A_Height : 208|9@1+ (0.01,0) [0|5.11] "m"  DASy
 SG_ VFC_Obj16A_LengthStdDev : 384|7@1+ (0.05,0) [0|5] "m"  DASy
 SG_ VFC_Obj16A_WidthStdDev : 391|7@1+ (0.01,0) [0|1] "m"  DASy
 SG_ VFC_Obj16A_HeightStdDev : 201|7@1+ (0.01,0) [0|1] "m"  DASy
 SG_ VFC_Obj16A_EdgeLeft : 411|13@1+ (0.00025,-1) [-1|1] "unitless"  DASy
 SG_ VFC_Obj16A_EdgeMid : 398|13@1+ (0.00025,-1) [-1|1] "unitless"  DASy
 SG_ VFC_Obj16A_EdgeRight : 424|13@1+ (0.00025,-1) [-1|1] "unitless"  DASy
 SG_ VFC_Obj16A_EdgeTop : 448|12@1+ (0.00025,-0.5) [-0.5|0.5] "unitless"  DASy
 SG_ VFC_Obj16A_EdgeBottom : 269|12@1+ (0.00025,-0.5) [-0.5|0.5] "unitless"  DASy
 SG_ VFC_Obj16A_EdgeLeftStdDev : 440|8@1+ (0.0002,0) [0|0.051] "unitless"  DASy
 SG_ VFC_Obj16A_EdgeMidStdDev : 464|8@1+ (0.0002,0) [0|0.051] "unitless"  DASy
 SG_ VFC_Obj16A_EdgeRightStdDev : 472|8@1+ (0.0002,0) [0|0.051] "unitless"  DASy
 SG_ VFC_Obj16A_EdgeTopStdDev : 480|8@1+ (0.0002,0) [0|0.051] "unitless"  DASy
 SG_ VFC_Obj16A_EdgeBottomStdDev : 488|8@1+ (0.0002,0) [0|0.051] "unitless"  DASy
 SG_ VFC_Obj16A_NormVx : 304|16@1+ (0.001,-40) [-40|25] "1/s"  DASy
 SG_ VFC_Obj16A_NormAx : 235|13@1+ (0.002,-10) [-10|6] "1/s^2"  DASy
 SG_ VFC_Obj16A_NormVyEdgeLeft : 256|13@1+ (0.001,-4) [-4|4] "1/s"  DASy
 SG_ VFC_Obj16A_NormVyEdgeRight : 281|13@1+ (0.001,-4) [-4|4] "1/s"  DASy
 SG_ VFC_Obj16A_NormVxStdDev : 368|10@1+ (0.001,0) [0|1.023] "1/s"  DASy
 SG_ VFC_Obj16A_NormAxStdDev : 328|10@1+ (0.0025,0) [0|2.5575] "1/s^2"  DASy
 SG_ VFC_Obj16A_NormVyEdgeLeftStdDev : 248|8@1+ (0.001,0) [0|0.255] "1/s"  DASy
 SG_ VFC_Obj16A_NormVyEdgeRightStdDev : 320|8@1+ (0.001,0) [0|0.255] "1/s"  DASy
 SG_ VFC_Obj16A_ScaleChange : 338|14@1+ (0.0001,0.5) [0.5|2.1383] "unitless"  DASy
 SG_ VFC_Obj16A_ScaleChngStdDev : 352|10@1+ (0.0001,0) [0|0.1023] "unitless"  DASy
 SG_ VFC_Obj16A_HeadingAngle : 226|9@1+ (0.01,-1.57) [-1.57|1.57] "rad"  DASy
 SG_ VFC_Obj16A_HeadingAngleStdDev : 186|6@1+ (0.01,0) [0|0.5] "rad"  DASy
 SG_ VFC_Obj16A_HeadOrientation : 460|4@1+ (1,0) [0|15] ""  DASy
 SG_ VFC_Obj16A_CompletelyInImg : 121|1@1+ (1,0) [0|1] ""  DASy
 SG_ VFC_Obj16A_ProbMovingLat : 154|6@1+ (2,0) [0|100] "%"  DASy
 SG_ VFC_Obj16A_ProbMovingLong : 170|6@1+ (2,0) [0|100] "%"  DASy
 SG_ VFC_Obj16A_ProbExist : 122|6@1+ (2,0) [0|100] "%"  DASy
 SG_ VFC_Obj16A_MeasSource : 91|5@1+ (1,0) [0|31] ""  DASy
 SG_ VFC_Obj16A_Reliability : 362|6@1+ (1,0) [0|63] ""  DASy
 SG_ VFC_Obj16A_Measured : 78|2@1+ (1,0) [0|3] ""  DASy
 SG_ VFC_Obj16A_VisibleView : 437|3@1+ (1,0) [0|4] ""  DASy
 SG_ VFC_Obj16A_ClassifiedView : 496|3@1+ (1,0) [0|4] ""  DASy
 SG_ VFC_Obj16A_DirIndicator : 106|3@1+ (1,0) [0|4] ""  DASy
 SG_ VFC_Obj16A_BrakeLight : 109|3@1+ (1,0) [0|7] ""  DASy

BO_ 132 VFC_Object17A: 64 MPC3
 SG_ VFC_Obj17A_CRC : 0|16@1+ (1,0) [0|65535] ""  DASy
 SG_ VFC_Obj17A_AliveCtr : 16|8@1+ (1,0) [0|255] ""  DASy
 SG_ VFC_Obj17A_ProtBlockCtr : 24|4@1+ (1,0) [0|15] ""  DASy
 SG_ VFC_Obj17A_ID : 32|8@1+ (1,0) [1|255] ""  DASy
 SG_ VFC_Obj17A_Type : 60|4@1+ (1,0) [0|15] ""  DASy
 SG_ VFC_Obj17A_TypeProb : 378|6@1+ (2,0) [0|100] "%"  DASy
 SG_ VFC_Obj17A_Dx : 48|12@1+ (0.05,0) [0|204.75] "m"  DASy
 SG_ VFC_Obj17A_Dy : 64|14@1+ (0.01,-80) [-80|80] "m"  DASy
 SG_ VFC_Obj17A_Vx : 80|11@1+ (0.1,-154) [-154|50] "m/s"  DASy
 SG_ VFC_Obj17A_Vy : 96|10@1+ (0.1,-50) [-50|50] "m/s"  DASy
 SG_ VFC_Obj17A_Ax : 112|9@1+ (0.1,-16) [-16|16] "m/s^2"  DASy
 SG_ VFC_Obj17A_Ay : 128|8@1+ (0.1,-12) [-12|12] "m/s^2"  DASy
 SG_ VFC_Obj17A_DxStdDev : 144|10@1+ (0.05,0) [0|51.15] "m"  DASy
 SG_ VFC_Obj17A_DyStdDev : 160|10@1+ (0.02,0) [0|20.46] "m"  DASy
 SG_ VFC_Obj17A_VxStdDev : 176|10@1+ (0.1,0) [0|102.3] "m/s"  DASy
 SG_ VFC_Obj17A_VyStdDev : 192|9@1+ (0.1,0) [0|51.1] "m/s"  DASy
 SG_ VFC_Obj17A_AxStdDev : 40|8@1+ (0.1,0) [0|25.5] "m/s^2"  DASy
 SG_ VFC_Obj17A_AyStdDev : 136|8@1+ (0.1,0) [0|25.5] "m/s^2"  DASy
 SG_ VFC_Obj17A_Length : 217|9@1+ (0.05,0) [0|25.55] "m"  DASy
 SG_ VFC_Obj17A_Width : 294|10@1+ (0.01,0) [0|10.23] "m"  DASy
 SG_ VFC_Obj17A_Height : 208|9@1+ (0.01,0) [0|5.11] "m"  DASy
 SG_ VFC_Obj17A_LengthStdDev : 384|7@1+ (0.05,0) [0|5] "m"  DASy
 SG_ VFC_Obj17A_WidthStdDev : 391|7@1+ (0.01,0) [0|1] "m"  DASy
 SG_ VFC_Obj17A_HeightStdDev : 201|7@1+ (0.01,0) [0|1] "m"  DASy
 SG_ VFC_Obj17A_EdgeLeft : 411|13@1+ (0.00025,-1) [-1|1] "unitless"  DASy
 SG_ VFC_Obj17A_EdgeMid : 398|13@1+ (0.00025,-1) [-1|1] "unitless"  DASy
 SG_ VFC_Obj17A_EdgeRight : 424|13@1+ (0.00025,-1) [-1|1] "unitless"  DASy
 SG_ VFC_Obj17A_EdgeTop : 448|12@1+ (0.00025,-0.5) [-0.5|0.5] "unitless"  DASy
 SG_ VFC_Obj17A_EdgeBottom : 269|12@1+ (0.00025,-0.5) [-0.5|0.5] "unitless"  DASy
 SG_ VFC_Obj17A_EdgeLeftStdDev : 440|8@1+ (0.0002,0) [0|0.051] "unitless"  DASy
 SG_ VFC_Obj17A_EdgeMidStdDev : 464|8@1+ (0.0002,0) [0|0.051] "unitless"  DASy
 SG_ VFC_Obj17A_EdgeRightStdDev : 472|8@1+ (0.0002,0) [0|0.051] "unitless"  DASy
 SG_ VFC_Obj17A_EdgeTopStdDev : 480|8@1+ (0.0002,0) [0|0.051] "unitless"  DASy
 SG_ VFC_Obj17A_EdgeBottomStdDev : 488|8@1+ (0.0002,0) [0|0.051] "unitless"  DASy
 SG_ VFC_Obj17A_NormVx : 304|16@1+ (0.001,-40) [-40|25] "1/s"  DASy
 SG_ VFC_Obj17A_NormAx : 235|13@1+ (0.002,-10) [-10|6] "1/s^2"  DASy
 SG_ VFC_Obj17A_NormVyEdgeLeft : 256|13@1+ (0.001,-4) [-4|4] "1/s"  DASy
 SG_ VFC_Obj17A_NormVyEdgeRight : 281|13@1+ (0.001,-4) [-4|4] "1/s"  DASy
 SG_ VFC_Obj17A_NormVxStdDev : 368|10@1+ (0.001,0) [0|1.023] "1/s"  DASy
 SG_ VFC_Obj17A_NormAxStdDev : 328|10@1+ (0.0025,0) [0|2.5575] "1/s^2"  DASy
 SG_ VFC_Obj17A_NormVyEdgeLeftStdDev : 248|8@1+ (0.001,0) [0|0.255] "1/s"  DASy
 SG_ VFC_Obj17A_NormVyEdgeRightStdDev : 320|8@1+ (0.001,0) [0|0.255] "1/s"  DASy
 SG_ VFC_Obj17A_ScaleChange : 338|14@1+ (0.0001,0.5) [0.5|2.1383] "unitless"  DASy
 SG_ VFC_Obj17A_ScaleChngStdDev : 352|10@1+ (0.0001,0) [0|0.1023] "unitless"  DASy
 SG_ VFC_Obj17A_HeadingAngle : 226|9@1+ (0.01,-1.57) [-1.57|1.57] "rad"  DASy
 SG_ VFC_Obj17A_HeadingAngleStdDev : 186|6@1+ (0.01,0) [0|0.5] "rad"  DASy
 SG_ VFC_Obj17A_HeadOrientation : 460|4@1+ (1,0) [0|15] ""  DASy
 SG_ VFC_Obj17A_CompletelyInImg : 121|1@1+ (1,0) [0|1] ""  DASy
 SG_ VFC_Obj17A_ProbMovingLat : 154|6@1+ (2,0) [0|100] "%"  DASy
 SG_ VFC_Obj17A_ProbMovingLong : 170|6@1+ (2,0) [0|100] "%"  DASy
 SG_ VFC_Obj17A_ProbExist : 122|6@1+ (2,0) [0|100] "%"  DASy
 SG_ VFC_Obj17A_MeasSource : 91|5@1+ (1,0) [0|31] ""  DASy
 SG_ VFC_Obj17A_Reliability : 362|6@1+ (1,0) [0|63] ""  DASy
 SG_ VFC_Obj17A_Measured : 78|2@1+ (1,0) [0|3] ""  DASy
 SG_ VFC_Obj17A_VisibleView : 437|3@1+ (1,0) [0|4] ""  DASy
 SG_ VFC_Obj17A_ClassifiedView : 496|3@1+ (1,0) [0|4] ""  DASy
 SG_ VFC_Obj17A_DirIndicator : 106|3@1+ (1,0) [0|4] ""  DASy
 SG_ VFC_Obj17A_BrakeLight : 109|3@1+ (1,0) [0|7] ""  DASy

BO_ 134 VFC_Object18A: 64 MPC3
 SG_ VFC_Obj18A_CRC : 0|16@1+ (1,0) [0|65535] ""  DASy
 SG_ VFC_Obj18A_AliveCtr : 16|8@1+ (1,0) [0|255] ""  DASy
 SG_ VFC_Obj18A_ProtBlockCtr : 24|4@1+ (1,0) [0|15] ""  DASy
 SG_ VFC_Obj18A_ID : 32|8@1+ (1,0) [1|255] ""  DASy
 SG_ VFC_Obj18A_Type : 60|4@1+ (1,0) [0|15] ""  DASy
 SG_ VFC_Obj18A_TypeProb : 378|6@1+ (2,0) [0|100] "%"  DASy
 SG_ VFC_Obj18A_Dx : 48|12@1+ (0.05,0) [0|204.75] "m"  DASy
 SG_ VFC_Obj18A_Dy : 64|14@1+ (0.01,-80) [-80|80] "m"  DASy
 SG_ VFC_Obj18A_Vx : 80|11@1+ (0.1,-154) [-154|50] "m/s"  DASy
 SG_ VFC_Obj18A_Vy : 96|10@1+ (0.1,-50) [-50|50] "m/s"  DASy
 SG_ VFC_Obj18A_Ax : 112|9@1+ (0.1,-16) [-16|16] "m/s^2"  DASy
 SG_ VFC_Obj18A_Ay : 128|8@1+ (0.1,-12) [-12|12] "m/s^2"  DASy
 SG_ VFC_Obj18A_DxStdDev : 144|10@1+ (0.05,0) [0|51.15] "m"  DASy
 SG_ VFC_Obj18A_DyStdDev : 160|10@1+ (0.02,0) [0|20.46] "m"  DASy
 SG_ VFC_Obj18A_VxStdDev : 176|10@1+ (0.1,0) [0|102.3] "m/s"  DASy
 SG_ VFC_Obj18A_VyStdDev : 192|9@1+ (0.1,0) [0|51.1] "m/s"  DASy
 SG_ VFC_Obj18A_AxStdDev : 40|8@1+ (0.1,0) [0|25.5] "m/s^2"  DASy
 SG_ VFC_Obj18A_AyStdDev : 136|8@1+ (0.1,0) [0|25.5] "m/s^2"  DASy
 SG_ VFC_Obj18A_Length : 217|9@1+ (0.05,0) [0|25.55] "m"  DASy
 SG_ VFC_Obj18A_Width : 294|10@1+ (0.01,0) [0|10.23] "m"  DASy
 SG_ VFC_Obj18A_Height : 208|9@1+ (0.01,0) [0|5.11] "m"  DASy
 SG_ VFC_Obj18A_LengthStdDev : 384|7@1+ (0.05,0) [0|5] "m"  DASy
 SG_ VFC_Obj18A_WidthStdDev : 391|7@1+ (0.01,0) [0|1] "m"  DASy
 SG_ VFC_Obj18A_HeightStdDev : 201|7@1+ (0.01,0) [0|1] "m"  DASy
 SG_ VFC_Obj18A_EdgeLeft : 411|13@1+ (0.00025,-1) [-1|1] "unitless"  DASy
 SG_ VFC_Obj18A_EdgeMid : 398|13@1+ (0.00025,-1) [-1|1] "unitless"  DASy
 SG_ VFC_Obj18A_EdgeRight : 424|13@1+ (0.00025,-1) [-1|1] "unitless"  DASy
 SG_ VFC_Obj18A_EdgeTop : 448|12@1+ (0.00025,-0.5) [-0.5|0.5] "unitless"  DASy
 SG_ VFC_Obj18A_EdgeBottom : 269|12@1+ (0.00025,-0.5) [-0.5|0.5] "unitless"  DASy
 SG_ VFC_Obj18A_EdgeLeftStdDev : 440|8@1+ (0.0002,0) [0|0.051] "unitless"  DASy
 SG_ VFC_Obj18A_EdgeMidStdDev : 464|8@1+ (0.0002,0) [0|0.051] "unitless"  DASy
 SG_ VFC_Obj18A_EdgeRightStdDev : 472|8@1+ (0.0002,0) [0|0.051] "unitless"  DASy
 SG_ VFC_Obj18A_EdgeTopStdDev : 480|8@1+ (0.0002,0) [0|0.051] "unitless"  DASy
 SG_ VFC_Obj18A_EdgeBottomStdDev : 488|8@1+ (0.0002,0) [0|0.051] "unitless"  DASy
 SG_ VFC_Obj18A_NormVx : 304|16@1+ (0.001,-40) [-40|25] "1/s"  DASy
 SG_ VFC_Obj18A_NormAx : 235|13@1+ (0.002,-10) [-10|6] "1/s^2"  DASy
 SG_ VFC_Obj18A_NormVyEdgeLeft : 256|13@1+ (0.001,-4) [-4|4] "1/s"  DASy
 SG_ VFC_Obj18A_NormVyEdgeRight : 281|13@1+ (0.001,-4) [-4|4] "1/s"  DASy
 SG_ VFC_Obj18A_NormVxStdDev : 368|10@1+ (0.001,0) [0|1.023] "1/s"  DASy
 SG_ VFC_Obj18A_NormAxStdDev : 328|10@1+ (0.0025,0) [0|2.5575] "1/s^2"  DASy
 SG_ VFC_Obj18A_NormVyEdgeLeftStdDev : 248|8@1+ (0.001,0) [0|0.255] "1/s"  DASy
 SG_ VFC_Obj18A_NormVyEdgeRightStdDev : 320|8@1+ (0.001,0) [0|0.255] "1/s"  DASy
 SG_ VFC_Obj18A_ScaleChange : 338|14@1+ (0.0001,0.5) [0.5|2.1383] "unitless"  DASy
 SG_ VFC_Obj18A_ScaleChngStdDev : 352|10@1+ (0.0001,0) [0|0.1023] "unitless"  DASy
 SG_ VFC_Obj18A_HeadingAngle : 226|9@1+ (0.01,-1.57) [-1.57|1.57] "rad"  DASy
 SG_ VFC_Obj18A_HeadingAngleStdDev : 186|6@1+ (0.01,0) [0|0.5] "rad"  DASy
 SG_ VFC_Obj18A_HeadOrientation : 460|4@1+ (1,0) [0|15] ""  DASy
 SG_ VFC_Obj18A_CompletelyInImg : 121|1@1+ (1,0) [0|1] ""  DASy
 SG_ VFC_Obj18A_ProbMovingLat : 154|6@1+ (2,0) [0|100] "%"  DASy
 SG_ VFC_Obj18A_ProbMovingLong : 170|6@1+ (2,0) [0|100] "%"  DASy
 SG_ VFC_Obj18A_ProbExist : 122|6@1+ (2,0) [0|100] "%"  DASy
 SG_ VFC_Obj18A_MeasSource : 91|5@1+ (1,0) [0|31] ""  DASy
 SG_ VFC_Obj18A_Reliability : 362|6@1+ (1,0) [0|63] ""  DASy
 SG_ VFC_Obj18A_Measured : 78|2@1+ (1,0) [0|3] ""  DASy
 SG_ VFC_Obj18A_VisibleView : 437|3@1+ (1,0) [0|4] ""  DASy
 SG_ VFC_Obj18A_ClassifiedView : 496|3@1+ (1,0) [0|4] ""  DASy
 SG_ VFC_Obj18A_DirIndicator : 106|3@1+ (1,0) [0|4] ""  DASy
 SG_ VFC_Obj18A_BrakeLight : 109|3@1+ (1,0) [0|7] ""  DASy

BO_ 136 VFC_Object19A: 64 MPC3
 SG_ VFC_Obj19A_CRC : 0|16@1+ (1,0) [0|65535] ""  DASy
 SG_ VFC_Obj19A_AliveCtr : 16|8@1+ (1,0) [0|255] ""  DASy
 SG_ VFC_Obj19A_ProtBlockCtr : 24|4@1+ (1,0) [0|15] ""  DASy
 SG_ VFC_Obj19A_ID : 32|8@1+ (1,0) [1|255] ""  DASy
 SG_ VFC_Obj19A_Type : 60|4@1+ (1,0) [0|15] ""  DASy
 SG_ VFC_Obj19A_TypeProb : 378|6@1+ (2,0) [0|100] "%"  DASy
 SG_ VFC_Obj19A_Dx : 48|12@1+ (0.05,0) [0|204.75] "m"  DASy
 SG_ VFC_Obj19A_Dy : 64|14@1+ (0.01,-80) [-80|80] "m"  DASy
 SG_ VFC_Obj19A_Vx : 80|11@1+ (0.1,-154) [-154|50] "m/s"  DASy
 SG_ VFC_Obj19A_Vy : 96|10@1+ (0.1,-50) [-50|50] "m/s"  DASy
 SG_ VFC_Obj19A_Ax : 112|9@1+ (0.1,-16) [-16|16] "m/s^2"  DASy
 SG_ VFC_Obj19A_Ay : 128|8@1+ (0.1,-12) [-12|12] "m/s^2"  DASy
 SG_ VFC_Obj19A_DxStdDev : 144|10@1+ (0.05,0) [0|51.15] "m"  DASy
 SG_ VFC_Obj19A_DyStdDev : 160|10@1+ (0.02,0) [0|20.46] "m"  DASy
 SG_ VFC_Obj19A_VxStdDev : 176|10@1+ (0.1,0) [0|102.3] "m/s"  DASy
 SG_ VFC_Obj19A_VyStdDev : 192|9@1+ (0.1,0) [0|51.1] "m/s"  DASy
 SG_ VFC_Obj19A_AxStdDev : 40|8@1+ (0.1,0) [0|25.5] "m/s^2"  DASy
 SG_ VFC_Obj19A_AyStdDev : 136|8@1+ (0.1,0) [0|25.5] "m/s^2"  DASy
 SG_ VFC_Obj19A_Length : 217|9@1+ (0.05,0) [0|25.55] "m"  DASy
 SG_ VFC_Obj19A_Width : 294|10@1+ (0.01,0) [0|10.23] "m"  DASy
 SG_ VFC_Obj19A_Height : 208|9@1+ (0.01,0) [0|5.11] "m"  DASy
 SG_ VFC_Obj19A_LengthStdDev : 384|7@1+ (0.05,0) [0|5] "m"  DASy
 SG_ VFC_Obj19A_WidthStdDev : 391|7@1+ (0.01,0) [0|1] "m"  DASy
 SG_ VFC_Obj19A_HeightStdDev : 201|7@1+ (0.01,0) [0|1] "m"  DASy
 SG_ VFC_Obj19A_EdgeLeft : 411|13@1+ (0.00025,-1) [-1|1] "unitless"  DASy
 SG_ VFC_Obj19A_EdgeMid : 398|13@1+ (0.00025,-1) [-1|1] "unitless"  DASy
 SG_ VFC_Obj19A_EdgeRight : 424|13@1+ (0.00025,-1) [-1|1] "unitless"  DASy
 SG_ VFC_Obj19A_EdgeTop : 448|12@1+ (0.00025,-0.5) [-0.5|0.5] "unitless"  DASy
 SG_ VFC_Obj19A_EdgeBottom : 269|12@1+ (0.00025,-0.5) [-0.5|0.5] "unitless"  DASy
 SG_ VFC_Obj19A_EdgeLeftStdDev : 440|8@1+ (0.0002,0) [0|0.051] "unitless"  DASy
 SG_ VFC_Obj19A_EdgeMidStdDev : 464|8@1+ (0.0002,0) [0|0.051] "unitless"  DASy
 SG_ VFC_Obj19A_EdgeRightStdDev : 472|8@1+ (0.0002,0) [0|0.051] "unitless"  DASy
 SG_ VFC_Obj19A_EdgeTopStdDev : 480|8@1+ (0.0002,0) [0|0.051] "unitless"  DASy
 SG_ VFC_Obj19A_EdgeBottomStdDev : 488|8@1+ (0.0002,0) [0|0.051] "unitless"  DASy
 SG_ VFC_Obj19A_NormVx : 304|16@1+ (0.001,-40) [-40|25] "1/s"  DASy
 SG_ VFC_Obj19A_NormAx : 235|13@1+ (0.002,-10) [-10|6] "1/s^2"  DASy
 SG_ VFC_Obj19A_NormVyEdgeLeft : 256|13@1+ (0.001,-4) [-4|4] "1/s"  DASy
 SG_ VFC_Obj19A_NormVyEdgeRight : 281|13@1+ (0.001,-4) [-4|4] "1/s"  DASy
 SG_ VFC_Obj19A_NormVxStdDev : 368|10@1+ (0.001,0) [0|1.023] "1/s"  DASy
 SG_ VFC_Obj19A_NormAxStdDev : 328|10@1+ (0.0025,0) [0|2.5575] "1/s^2"  DASy
 SG_ VFC_Obj19A_NormVyEdgeLeftStdDev : 248|8@1+ (0.001,0) [0|0.255] "1/s"  DASy
 SG_ VFC_Obj19A_NormVyEdgeRightStdDev : 320|8@1+ (0.001,0) [0|0.255] "1/s"  DASy
 SG_ VFC_Obj19A_ScaleChange : 338|14@1+ (0.0001,0.5) [0.5|2.1383] "unitless"  DASy
 SG_ VFC_Obj19A_ScaleChngStdDev : 352|10@1+ (0.0001,0) [0|0.1023] "unitless"  DASy
 SG_ VFC_Obj19A_HeadingAngle : 226|9@1+ (0.01,-1.57) [-1.57|1.57] "rad"  DASy
 SG_ VFC_Obj19A_HeadingAngleStdDev : 186|6@1+ (0.01,0) [0|0.5] "rad"  DASy
 SG_ VFC_Obj19A_HeadOrientation : 460|4@1+ (1,0) [0|15] ""  DASy
 SG_ VFC_Obj19A_CompletelyInImg : 121|1@1+ (1,0) [0|1] ""  DASy
 SG_ VFC_Obj19A_ProbMovingLat : 154|6@1+ (2,0) [0|100] "%"  DASy
 SG_ VFC_Obj19A_ProbMovingLong : 170|6@1+ (2,0) [0|100] "%"  DASy
 SG_ VFC_Obj19A_ProbExist : 122|6@1+ (2,0) [0|100] "%"  DASy
 SG_ VFC_Obj19A_MeasSource : 91|5@1+ (1,0) [0|31] ""  DASy
 SG_ VFC_Obj19A_Reliability : 362|6@1+ (1,0) [0|63] ""  DASy
 SG_ VFC_Obj19A_Measured : 78|2@1+ (1,0) [0|3] ""  DASy
 SG_ VFC_Obj19A_VisibleView : 437|3@1+ (1,0) [0|4] ""  DASy
 SG_ VFC_Obj19A_ClassifiedView : 496|3@1+ (1,0) [0|4] ""  DASy
 SG_ VFC_Obj19A_DirIndicator : 106|3@1+ (1,0) [0|4] ""  DASy
 SG_ VFC_Obj19A_BrakeLight : 109|3@1+ (1,0) [0|7] ""  DASy

BO_ 138 VFC_Object20A: 64 MPC3
 SG_ VFC_Obj20A_CRC : 0|16@1+ (1,0) [0|65535] ""  DASy
 SG_ VFC_Obj20A_AliveCtr : 16|8@1+ (1,0) [0|255] ""  DASy
 SG_ VFC_Obj20A_ProtBlockCtr : 24|4@1+ (1,0) [0|15] ""  DASy
 SG_ VFC_Obj20A_ID : 32|8@1+ (1,0) [1|255] ""  DASy
 SG_ VFC_Obj20A_Type : 60|4@1+ (1,0) [0|15] ""  DASy
 SG_ VFC_Obj20A_TypeProb : 378|6@1+ (2,0) [0|100] "%"  DASy
 SG_ VFC_Obj20A_Dx : 48|12@1+ (0.05,0) [0|204.75] "m"  DASy
 SG_ VFC_Obj20A_Dy : 64|14@1+ (0.01,-80) [-80|80] "m"  DASy
 SG_ VFC_Obj20A_Vx : 80|11@1+ (0.1,-154) [-154|50] "m/s"  DASy
 SG_ VFC_Obj20A_Vy : 96|10@1+ (0.1,-50) [-50|50] "m/s"  DASy
 SG_ VFC_Obj20A_Ax : 112|9@1+ (0.1,-16) [-16|16] "m/s^2"  DASy
 SG_ VFC_Obj20A_Ay : 128|8@1+ (0.1,-12) [-12|12] "m/s^2"  DASy
 SG_ VFC_Obj20A_DxStdDev : 144|10@1+ (0.05,0) [0|51.15] "m"  DASy
 SG_ VFC_Obj20A_DyStdDev : 160|10@1+ (0.02,0) [0|20.46] "m"  DASy
 SG_ VFC_Obj20A_VxStdDev : 176|10@1+ (0.1,0) [0|102.3] "m/s"  DASy
 SG_ VFC_Obj20A_VyStdDev : 192|9@1+ (0.1,0) [0|51.1] "m/s"  DASy
 SG_ VFC_Obj20A_AxStdDev : 40|8@1+ (0.1,0) [0|25.5] "m/s^2"  DASy
 SG_ VFC_Obj20A_AyStdDev : 136|8@1+ (0.1,0) [0|25.5] "m/s^2"  DASy
 SG_ VFC_Obj20A_Length : 217|9@1+ (0.05,0) [0|25.55] "m"  DASy
 SG_ VFC_Obj20A_Width : 294|10@1+ (0.01,0) [0|10.23] "m"  DASy
 SG_ VFC_Obj20A_Height : 208|9@1+ (0.01,0) [0|5.11] "m"  DASy
 SG_ VFC_Obj20A_LengthStdDev : 384|7@1+ (0.05,0) [0|5] "m"  DASy
 SG_ VFC_Obj20A_WidthStdDev : 391|7@1+ (0.01,0) [0|1] "m"  DASy
 SG_ VFC_Obj20A_HeightStdDev : 201|7@1+ (0.01,0) [0|1] "m"  DASy
 SG_ VFC_Obj20A_EdgeLeft : 411|13@1+ (0.00025,-1) [-1|1] "unitless"  DASy
 SG_ VFC_Obj20A_EdgeMid : 398|13@1+ (0.00025,-1) [-1|1] "unitless"  DASy
 SG_ VFC_Obj20A_EdgeRight : 424|13@1+ (0.00025,-1) [-1|1] "unitless"  DASy
 SG_ VFC_Obj20A_EdgeTop : 448|12@1+ (0.00025,-0.5) [-0.5|0.5] "unitless"  DASy
 SG_ VFC_Obj20A_EdgeBottom : 269|12@1+ (0.00025,-0.5) [-0.5|0.5] "unitless"  DASy
 SG_ VFC_Obj20A_EdgeLeftStdDev : 440|8@1+ (0.0002,0) [0|0.051] "unitless"  DASy
 SG_ VFC_Obj20A_EdgeMidStdDev : 464|8@1+ (0.0002,0) [0|0.051] "unitless"  DASy
 SG_ VFC_Obj20A_EdgeRightStdDev : 472|8@1+ (0.0002,0) [0|0.051] "unitless"  DASy
 SG_ VFC_Obj20A_EdgeTopStdDev : 480|8@1+ (0.0002,0) [0|0.051] "unitless"  DASy
 SG_ VFC_Obj20A_EdgeBottomStdDev : 488|8@1+ (0.0002,0) [0|0.051] "unitless"  DASy
 SG_ VFC_Obj20A_NormVx : 304|16@1+ (0.001,-40) [-40|25] "1/s"  DASy
 SG_ VFC_Obj20A_NormAx : 235|13@1+ (0.002,-10) [-10|6] "1/s^2"  DASy
 SG_ VFC_Obj20A_NormVyEdgeLeft : 256|13@1+ (0.001,-4) [-4|4] "1/s"  DASy
 SG_ VFC_Obj20A_NormVyEdgeRight : 281|13@1+ (0.001,-4) [-4|4] "1/s"  DASy
 SG_ VFC_Obj20A_NormVxStdDev : 368|10@1+ (0.001,0) [0|1.023] "1/s"  DASy
 SG_ VFC_Obj20A_NormAxStdDev : 328|10@1+ (0.0025,0) [0|2.5575] "1/s^2"  DASy
 SG_ VFC_Obj20A_NormVyEdgeLeftStdDev : 248|8@1+ (0.001,0) [0|0.255] "1/s"  DASy
 SG_ VFC_Obj20A_NormVyEdgeRightStdDev : 320|8@1+ (0.001,0) [0|0.255] "1/s"  DASy
 SG_ VFC_Obj20A_ScaleChange : 338|14@1+ (0.0001,0.5) [0.5|2.1383] "unitless"  DASy
 SG_ VFC_Obj20A_ScaleChngStdDev : 352|10@1+ (0.0001,0) [0|0.1023] "unitless"  DASy
 SG_ VFC_Obj20A_HeadingAngle : 226|9@1+ (0.01,-1.57) [-1.57|1.57] "rad"  DASy
 SG_ VFC_Obj20A_HeadingAngleStdDev : 186|6@1+ (0.01,0) [0|0.5] "rad"  DASy
 SG_ VFC_Obj20A_HeadOrientation : 460|4@1+ (1,0) [0|15] ""  DASy
 SG_ VFC_Obj20A_CompletelyInImg : 121|1@1+ (1,0) [0|1] ""  DASy
 SG_ VFC_Obj20A_ProbMovingLat : 154|6@1+ (2,0) [0|100] "%"  DASy
 SG_ VFC_Obj20A_ProbMovingLong : 170|6@1+ (2,0) [0|100] "%"  DASy
 SG_ VFC_Obj20A_ProbExist : 122|6@1+ (2,0) [0|100] "%"  DASy
 SG_ VFC_Obj20A_MeasSource : 91|5@1+ (1,0) [0|31] ""  DASy
 SG_ VFC_Obj20A_Reliability : 362|6@1+ (1,0) [0|63] ""  DASy
 SG_ VFC_Obj20A_Measured : 78|2@1+ (1,0) [0|3] ""  DASy
 SG_ VFC_Obj20A_VisibleView : 437|3@1+ (1,0) [0|4] ""  DASy
 SG_ VFC_Obj20A_ClassifiedView : 496|3@1+ (1,0) [0|4] ""  DASy
 SG_ VFC_Obj20A_DirIndicator : 106|3@1+ (1,0) [0|4] ""  DASy
 SG_ VFC_Obj20A_BrakeLight : 109|3@1+ (1,0) [0|7] ""  DASy

BO_ 140 VFC_Object21A: 64 MPC3
 SG_ VFC_Obj21A_CRC : 0|16@1+ (1,0) [0|65535] ""  DASy
 SG_ VFC_Obj21A_AliveCtr : 16|8@1+ (1,0) [0|255] ""  DASy
 SG_ VFC_Obj21A_ProtBlockCtr : 24|4@1+ (1,0) [0|15] ""  DASy
 SG_ VFC_Obj21A_ID : 32|8@1+ (1,0) [1|255] ""  DASy
 SG_ VFC_Obj21A_Type : 60|4@1+ (1,0) [0|15] ""  DASy
 SG_ VFC_Obj21A_TypeProb : 378|6@1+ (2,0) [0|100] "%"  DASy
 SG_ VFC_Obj21A_Dx : 48|12@1+ (0.05,0) [0|204.75] "m"  DASy
 SG_ VFC_Obj21A_Dy : 64|14@1+ (0.01,-80) [-80|80] "m"  DASy
 SG_ VFC_Obj21A_Vx : 80|11@1+ (0.1,-154) [-154|50] "m/s"  DASy
 SG_ VFC_Obj21A_Vy : 96|10@1+ (0.1,-50) [-50|50] "m/s"  DASy
 SG_ VFC_Obj21A_Ax : 112|9@1+ (0.1,-16) [-16|16] "m/s^2"  DASy
 SG_ VFC_Obj21A_Ay : 128|8@1+ (0.1,-12) [-12|12] "m/s^2"  DASy
 SG_ VFC_Obj21A_DxStdDev : 144|10@1+ (0.05,0) [0|51.15] "m"  DASy
 SG_ VFC_Obj21A_DyStdDev : 160|10@1+ (0.02,0) [0|20.46] "m"  DASy
 SG_ VFC_Obj21A_VxStdDev : 176|10@1+ (0.1,0) [0|102.3] "m/s"  DASy
 SG_ VFC_Obj21A_VyStdDev : 192|9@1+ (0.1,0) [0|51.1] "m/s"  DASy
 SG_ VFC_Obj21A_AxStdDev : 40|8@1+ (0.1,0) [0|25.5] "m/s^2"  DASy
 SG_ VFC_Obj21A_AyStdDev : 136|8@1+ (0.1,0) [0|25.5] "m/s^2"  DASy
 SG_ VFC_Obj21A_Length : 217|9@1+ (0.05,0) [0|25.55] "m"  DASy
 SG_ VFC_Obj21A_Width : 294|10@1+ (0.01,0) [0|10.23] "m"  DASy
 SG_ VFC_Obj21A_Height : 208|9@1+ (0.01,0) [0|5.11] "m"  DASy
 SG_ VFC_Obj21A_LengthStdDev : 384|7@1+ (0.05,0) [0|5] "m"  DASy
 SG_ VFC_Obj21A_WidthStdDev : 391|7@1+ (0.01,0) [0|1] "m"  DASy
 SG_ VFC_Obj21A_HeightStdDev : 201|7@1+ (0.01,0) [0|1] "m"  DASy
 SG_ VFC_Obj21A_EdgeLeft : 411|13@1+ (0.00025,-1) [-1|1] "unitless"  DASy
 SG_ VFC_Obj21A_EdgeMid : 398|13@1+ (0.00025,-1) [-1|1] "unitless"  DASy
 SG_ VFC_Obj21A_EdgeRight : 424|13@1+ (0.00025,-1) [-1|1] "unitless"  DASy
 SG_ VFC_Obj21A_EdgeTop : 448|12@1+ (0.00025,-0.5) [-0.5|0.5] "unitless"  DASy
 SG_ VFC_Obj21A_EdgeBottom : 269|12@1+ (0.00025,-0.5) [-0.5|0.5] "unitless"  DASy
 SG_ VFC_Obj21A_EdgeLeftStdDev : 440|8@1+ (0.0002,0) [0|0.051] "unitless"  DASy
 SG_ VFC_Obj21A_EdgeMidStdDev : 464|8@1+ (0.0002,0) [0|0.051] "unitless"  DASy
 SG_ VFC_Obj21A_EdgeRightStdDev : 472|8@1+ (0.0002,0) [0|0.051] "unitless"  DASy
 SG_ VFC_Obj21A_EdgeTopStdDev : 480|8@1+ (0.0002,0) [0|0.051] "unitless"  DASy
 SG_ VFC_Obj21A_EdgeBottomStdDev : 488|8@1+ (0.0002,0) [0|0.051] "unitless"  DASy
 SG_ VFC_Obj21A_NormVx : 304|16@1+ (0.001,-40) [-40|25] "1/s"  DASy
 SG_ VFC_Obj21A_NormAx : 235|13@1+ (0.002,-10) [-10|6] "1/s^2"  DASy
 SG_ VFC_Obj21A_NormVyEdgeLeft : 256|13@1+ (0.001,-4) [-4|4] "1/s"  DASy
 SG_ VFC_Obj21A_NormVyEdgeRight : 281|13@1+ (0.001,-4) [-4|4] "1/s"  DASy
 SG_ VFC_Obj21A_NormVxStdDev : 368|10@1+ (0.001,0) [0|1.023] "1/s"  DASy
 SG_ VFC_Obj21A_NormAxStdDev : 328|10@1+ (0.0025,0) [0|2.5575] "1/s^2"  DASy
 SG_ VFC_Obj21A_NormVyEdgeLeftStdDev : 248|8@1+ (0.001,0) [0|0.255] "1/s"  DASy
 SG_ VFC_Obj21A_NormVyEdgeRightStdDev : 320|8@1+ (0.001,0) [0|0.255] "1/s"  DASy
 SG_ VFC_Obj21A_ScaleChange : 338|14@1+ (0.0001,0.5) [0.5|2.1383] "unitless"  DASy
 SG_ VFC_Obj21A_ScaleChngStdDev : 352|10@1+ (0.0001,0) [0|0.1023] "unitless"  DASy
 SG_ VFC_Obj21A_HeadingAngle : 226|9@1+ (0.01,-1.57) [-1.57|1.57] "rad"  DASy
 SG_ VFC_Obj21A_HeadingAngleStdDev : 186|6@1+ (0.01,0) [0|0.5] "rad"  DASy
 SG_ VFC_Obj21A_HeadOrientation : 460|4@1+ (1,0) [0|15] ""  DASy
 SG_ VFC_Obj21A_CompletelyInImg : 121|1@1+ (1,0) [0|1] ""  DASy
 SG_ VFC_Obj21A_ProbMovingLat : 154|6@1+ (2,0) [0|100] "%"  DASy
 SG_ VFC_Obj21A_ProbMovingLong : 170|6@1+ (2,0) [0|100] "%"  DASy
 SG_ VFC_Obj21A_ProbExist : 122|6@1+ (2,0) [0|100] "%"  DASy
 SG_ VFC_Obj21A_MeasSource : 91|5@1+ (1,0) [0|31] ""  DASy
 SG_ VFC_Obj21A_Reliability : 362|6@1+ (1,0) [0|63] ""  DASy
 SG_ VFC_Obj21A_Measured : 78|2@1+ (1,0) [0|3] ""  DASy
 SG_ VFC_Obj21A_VisibleView : 437|3@1+ (1,0) [0|4] ""  DASy
 SG_ VFC_Obj21A_ClassifiedView : 496|3@1+ (1,0) [0|4] ""  DASy
 SG_ VFC_Obj21A_DirIndicator : 106|3@1+ (1,0) [0|4] ""  DASy
 SG_ VFC_Obj21A_BrakeLight : 109|3@1+ (1,0) [0|7] ""  DASy

BO_ 142 VFC_Object22A: 64 MPC3
 SG_ VFC_Obj22A_CRC : 0|16@1+ (1,0) [0|65535] ""  DASy
 SG_ VFC_Obj22A_AliveCtr : 16|8@1+ (1,0) [0|255] ""  DASy
 SG_ VFC_Obj22A_ProtBlockCtr : 24|4@1+ (1,0) [0|15] ""  DASy
 SG_ VFC_Obj22A_ID : 32|8@1+ (1,0) [1|255] ""  DASy
 SG_ VFC_Obj22A_Type : 60|4@1+ (1,0) [0|15] ""  DASy
 SG_ VFC_Obj22A_TypeProb : 378|6@1+ (2,0) [0|100] "%"  DASy
 SG_ VFC_Obj22A_Dx : 48|12@1+ (0.05,0) [0|204.75] "m"  DASy
 SG_ VFC_Obj22A_Dy : 64|14@1+ (0.01,-80) [-80|80] "m"  DASy
 SG_ VFC_Obj22A_Vx : 80|11@1+ (0.1,-154) [-154|50] "m/s"  DASy
 SG_ VFC_Obj22A_Vy : 96|10@1+ (0.1,-50) [-50|50] "m/s"  DASy
 SG_ VFC_Obj22A_Ax : 112|9@1+ (0.1,-16) [-16|16] "m/s^2"  DASy
 SG_ VFC_Obj22A_Ay : 128|8@1+ (0.1,-12) [-12|12] "m/s^2"  DASy
 SG_ VFC_Obj22A_DxStdDev : 144|10@1+ (0.05,0) [0|51.15] "m"  DASy
 SG_ VFC_Obj22A_DyStdDev : 160|10@1+ (0.02,0) [0|20.46] "m"  DASy
 SG_ VFC_Obj22A_VxStdDev : 176|10@1+ (0.1,0) [0|102.3] "m/s"  DASy
 SG_ VFC_Obj22A_VyStdDev : 192|9@1+ (0.1,0) [0|51.1] "m/s"  DASy
 SG_ VFC_Obj22A_AxStdDev : 40|8@1+ (0.1,0) [0|25.5] "m/s^2"  DASy
 SG_ VFC_Obj22A_AyStdDev : 136|8@1+ (0.1,0) [0|25.5] "m/s^2"  DASy
 SG_ VFC_Obj22A_Length : 217|9@1+ (0.05,0) [0|25.55] "m"  DASy
 SG_ VFC_Obj22A_Width : 294|10@1+ (0.01,0) [0|10.23] "m"  DASy
 SG_ VFC_Obj22A_Height : 208|9@1+ (0.01,0) [0|5.11] "m"  DASy
 SG_ VFC_Obj22A_LengthStdDev : 384|7@1+ (0.05,0) [0|5] "m"  DASy
 SG_ VFC_Obj22A_WidthStdDev : 391|7@1+ (0.01,0) [0|1] "m"  DASy
 SG_ VFC_Obj22A_HeightStdDev : 201|7@1+ (0.01,0) [0|1] "m"  DASy
 SG_ VFC_Obj22A_EdgeLeft : 411|13@1+ (0.00025,-1) [-1|1] "unitless"  DASy
 SG_ VFC_Obj22A_EdgeMid : 398|13@1+ (0.00025,-1) [-1|1] "unitless"  DASy
 SG_ VFC_Obj22A_EdgeRight : 424|13@1+ (0.00025,-1) [-1|1] "unitless"  DASy
 SG_ VFC_Obj22A_EdgeTop : 448|12@1+ (0.00025,-0.5) [-0.5|0.5] "unitless"  DASy
 SG_ VFC_Obj22A_EdgeBottom : 269|12@1+ (0.00025,-0.5) [-0.5|0.5] "unitless"  DASy
 SG_ VFC_Obj22A_EdgeLeftStdDev : 440|8@1+ (0.0002,0) [0|0.051] "unitless"  DASy
 SG_ VFC_Obj22A_EdgeMidStdDev : 464|8@1+ (0.0002,0) [0|0.051] "unitless"  DASy
 SG_ VFC_Obj22A_EdgeRightStdDev : 472|8@1+ (0.0002,0) [0|0.051] "unitless"  DASy
 SG_ VFC_Obj22A_EdgeTopStdDev : 480|8@1+ (0.0002,0) [0|0.051] "unitless"  DASy
 SG_ VFC_Obj22A_EdgeBottomStdDev : 488|8@1+ (0.0002,0) [0|0.051] "unitless"  DASy
 SG_ VFC_Obj22A_NormVx : 304|16@1+ (0.001,-40) [-40|25] "1/s"  DASy
 SG_ VFC_Obj22A_NormAx : 235|13@1+ (0.002,-10) [-10|6] "1/s^2"  DASy
 SG_ VFC_Obj22A_NormVyEdgeLeft : 256|13@1+ (0.001,-4) [-4|4] "1/s"  DASy
 SG_ VFC_Obj22A_NormVyEdgeRight : 281|13@1+ (0.001,-4) [-4|4] "1/s"  DASy
 SG_ VFC_Obj22A_NormVxStdDev : 368|10@1+ (0.001,0) [0|1.023] "1/s"  DASy
 SG_ VFC_Obj22A_NormAxStdDev : 328|10@1+ (0.0025,0) [0|2.5575] "1/s^2"  DASy
 SG_ VFC_Obj22A_NormVyEdgeLeftStdDev : 248|8@1+ (0.001,0) [0|0.255] "1/s"  DASy
 SG_ VFC_Obj22A_NormVyEdgeRightStdDev : 320|8@1+ (0.001,0) [0|0.255] "1/s"  DASy
 SG_ VFC_Obj22A_ScaleChange : 338|14@1+ (0.0001,0.5) [0.5|2.1383] "unitless"  DASy
 SG_ VFC_Obj22A_ScaleChngStdDev : 352|10@1+ (0.0001,0) [0|0.1023] "unitless"  DASy
 SG_ VFC_Obj22A_HeadingAngle : 226|9@1+ (0.01,-1.57) [-1.57|1.57] "rad"  DASy
 SG_ VFC_Obj22A_HeadingAngleStdDev : 186|6@1+ (0.01,0) [0|0.5] "rad"  DASy
 SG_ VFC_Obj22A_HeadOrientation : 460|4@1+ (1,0) [0|15] ""  DASy
 SG_ VFC_Obj22A_CompletelyInImg : 121|1@1+ (1,0) [0|1] ""  DASy
 SG_ VFC_Obj22A_ProbMovingLat : 154|6@1+ (2,0) [0|100] "%"  DASy
 SG_ VFC_Obj22A_ProbMovingLong : 170|6@1+ (2,0) [0|100] "%"  DASy
 SG_ VFC_Obj22A_ProbExist : 122|6@1+ (2,0) [0|100] "%"  DASy
 SG_ VFC_Obj22A_MeasSource : 91|5@1+ (1,0) [0|31] ""  DASy
 SG_ VFC_Obj22A_Reliability : 362|6@1+ (1,0) [0|63] ""  DASy
 SG_ VFC_Obj22A_Measured : 78|2@1+ (1,0) [0|3] ""  DASy
 SG_ VFC_Obj22A_VisibleView : 437|3@1+ (1,0) [0|4] ""  DASy
 SG_ VFC_Obj22A_ClassifiedView : 496|3@1+ (1,0) [0|4] ""  DASy
 SG_ VFC_Obj22A_DirIndicator : 106|3@1+ (1,0) [0|4] ""  DASy
 SG_ VFC_Obj22A_BrakeLight : 109|3@1+ (1,0) [0|7] ""  DASy

BO_ 144 VFC_Object23A: 64 MPC3
 SG_ VFC_Obj23A_CRC : 0|16@1+ (1,0) [0|65535] ""  DASy
 SG_ VFC_Obj23A_AliveCtr : 16|8@1+ (1,0) [0|255] ""  DASy
 SG_ VFC_Obj23A_ProtBlockCtr : 24|4@1+ (1,0) [0|15] ""  DASy
 SG_ VFC_Obj23A_ID : 32|8@1+ (1,0) [1|255] ""  DASy
 SG_ VFC_Obj23A_Type : 60|4@1+ (1,0) [0|15] ""  DASy
 SG_ VFC_Obj23A_TypeProb : 378|6@1+ (2,0) [0|100] "%"  DASy
 SG_ VFC_Obj23A_Dx : 48|12@1+ (0.05,0) [0|204.75] "m"  DASy
 SG_ VFC_Obj23A_Dy : 64|14@1+ (0.01,-80) [-80|80] "m"  DASy
 SG_ VFC_Obj23A_Vx : 80|11@1+ (0.1,-154) [-154|50] "m/s"  DASy
 SG_ VFC_Obj23A_Vy : 96|10@1+ (0.1,-50) [-50|50] "m/s"  DASy
 SG_ VFC_Obj23A_Ax : 112|9@1+ (0.1,-16) [-16|16] "m/s^2"  DASy
 SG_ VFC_Obj23A_Ay : 128|8@1+ (0.1,-12) [-12|12] "m/s^2"  DASy
 SG_ VFC_Obj23A_DxStdDev : 144|10@1+ (0.05,0) [0|51.15] "m"  DASy
 SG_ VFC_Obj23A_DyStdDev : 160|10@1+ (0.02,0) [0|20.46] "m"  DASy
 SG_ VFC_Obj23A_VxStdDev : 176|10@1+ (0.1,0) [0|102.3] "m/s"  DASy
 SG_ VFC_Obj23A_VyStdDev : 192|9@1+ (0.1,0) [0|51.1] "m/s"  DASy
 SG_ VFC_Obj23A_AxStdDev : 40|8@1+ (0.1,0) [0|25.5] "m/s^2"  DASy
 SG_ VFC_Obj23A_AyStdDev : 136|8@1+ (0.1,0) [0|25.5] "m/s^2"  DASy
 SG_ VFC_Obj23A_Length : 217|9@1+ (0.05,0) [0|25.55] "m"  DASy
 SG_ VFC_Obj23A_Width : 294|10@1+ (0.01,0) [0|10.23] "m"  DASy
 SG_ VFC_Obj23A_Height : 208|9@1+ (0.01,0) [0|5.11] "m"  DASy
 SG_ VFC_Obj23A_LengthStdDev : 384|7@1+ (0.05,0) [0|5] "m"  DASy
 SG_ VFC_Obj23A_WidthStdDev : 391|7@1+ (0.01,0) [0|1] "m"  DASy
 SG_ VFC_Obj23A_HeightStdDev : 201|7@1+ (0.01,0) [0|1] "m"  DASy
 SG_ VFC_Obj23A_EdgeLeft : 411|13@1+ (0.00025,-1) [-1|1] "unitless"  DASy
 SG_ VFC_Obj23A_EdgeMid : 398|13@1+ (0.00025,-1) [-1|1] "unitless"  DASy
 SG_ VFC_Obj23A_EdgeRight : 424|13@1+ (0.00025,-1) [-1|1] "unitless"  DASy
 SG_ VFC_Obj23A_EdgeTop : 448|12@1+ (0.00025,-0.5) [-0.5|0.5] "unitless"  DASy
 SG_ VFC_Obj23A_EdgeBottom : 269|12@1+ (0.00025,-0.5) [-0.5|0.5] "unitless"  DASy
 SG_ VFC_Obj23A_EdgeLeftStdDev : 440|8@1+ (0.0002,0) [0|0.051] "unitless"  DASy
 SG_ VFC_Obj23A_EdgeMidStdDev : 464|8@1+ (0.0002,0) [0|0.051] "unitless"  DASy
 SG_ VFC_Obj23A_EdgeRightStdDev : 472|8@1+ (0.0002,0) [0|0.051] "unitless"  DASy
 SG_ VFC_Obj23A_EdgeTopStdDev : 480|8@1+ (0.0002,0) [0|0.051] "unitless"  DASy
 SG_ VFC_Obj23A_EdgeBottomStdDev : 488|8@1+ (0.0002,0) [0|0.051] "unitless"  DASy
 SG_ VFC_Obj23A_NormVx : 304|16@1+ (0.001,-40) [-40|25] "1/s"  DASy
 SG_ VFC_Obj23A_NormAx : 235|13@1+ (0.002,-10) [-10|6] "1/s^2"  DASy
 SG_ VFC_Obj23A_NormVyEdgeLeft : 256|13@1+ (0.001,-4) [-4|4] "1/s"  DASy
 SG_ VFC_Obj23A_NormVyEdgeRight : 281|13@1+ (0.001,-4) [-4|4] "1/s"  DASy
 SG_ VFC_Obj23A_NormVxStdDev : 368|10@1+ (0.001,0) [0|1.023] "1/s"  DASy
 SG_ VFC_Obj23A_NormAxStdDev : 328|10@1+ (0.0025,0) [0|2.5575] "1/s^2"  DASy
 SG_ VFC_Obj23A_NormVyEdgeLeftStdDev : 248|8@1+ (0.001,0) [0|0.255] "1/s"  DASy
 SG_ VFC_Obj23A_NormVyEdgeRightStdDev : 320|8@1+ (0.001,0) [0|0.255] "1/s"  DASy
 SG_ VFC_Obj23A_ScaleChange : 338|14@1+ (0.0001,0.5) [0.5|2.1383] "unitless"  DASy
 SG_ VFC_Obj23A_ScaleChngStdDev : 352|10@1+ (0.0001,0) [0|0.1023] "unitless"  DASy
 SG_ VFC_Obj23A_HeadingAngle : 226|9@1+ (0.01,-1.57) [-1.57|1.57] "rad"  DASy
 SG_ VFC_Obj23A_HeadingAngleStdDev : 186|6@1+ (0.01,0) [0|0.5] "rad"  DASy
 SG_ VFC_Obj23A_HeadOrientation : 460|4@1+ (1,0) [0|15] ""  DASy
 SG_ VFC_Obj23A_CompletelyInImg : 121|1@1+ (1,0) [0|1] ""  DASy
 SG_ VFC_Obj23A_ProbMovingLat : 154|6@1+ (2,0) [0|100] "%"  DASy
 SG_ VFC_Obj23A_ProbMovingLong : 170|6@1+ (2,0) [0|100] "%"  DASy
 SG_ VFC_Obj23A_ProbExist : 122|6@1+ (2,0) [0|100] "%"  DASy
 SG_ VFC_Obj23A_MeasSource : 91|5@1+ (1,0) [0|31] ""  DASy
 SG_ VFC_Obj23A_Reliability : 362|6@1+ (1,0) [0|63] ""  DASy
 SG_ VFC_Obj23A_Measured : 78|2@1+ (1,0) [0|3] ""  DASy
 SG_ VFC_Obj23A_VisibleView : 437|3@1+ (1,0) [0|4] ""  DASy
 SG_ VFC_Obj23A_ClassifiedView : 496|3@1+ (1,0) [0|4] ""  DASy
 SG_ VFC_Obj23A_DirIndicator : 106|3@1+ (1,0) [0|4] ""  DASy
 SG_ VFC_Obj23A_BrakeLight : 109|3@1+ (1,0) [0|7] ""  DASy

BO_ 198 VFC_LaneHdr: 16 MPC3
 SG_ VFC_LaneHdr_CRC : 0|16@1+ (1,0) [0|65535] ""  DASy
 SG_ VFC_LaneHdr_AliveCtr : 16|8@1+ (1,0) [0|255] ""  DASy
 SG_ VFC_LaneHdr_ProtBlockCtr : 24|4@1+ (1,0) [0|15] ""  DASy
 SG_ VFC_LaneHdr_ProtSegCount : 32|8@1+ (1,0) [0|240] ""  DASy
 SG_ VFC_LaneHdr_ProtPointCount : 40|10@1+ (1,0) [0|1000] ""  DASy
 SG_ VFC_LaneHdr_ProtClothCount : 50|4@1+ (1,0) [0|8] ""  DASy
 SG_ VFC_LaneHdr_TimeStampStatus : 56|8@1+ (1,0) [0|255] ""  DASy
 SG_ VFC_LaneHdr_TimeStamp : 64|26@1+ (1,0) [0|67108863] "ms"  DASy
 SG_ VFC_LaneHdr_State : 93|3@1+ (1,0) [0|7] ""  DASy
 SG_ VFC_LaneHdr_FV : 103|8@0+ (1,0) [0|255] ""  DASy
 SG_ VFC_LaneHdr_MAC : 111|24@0+ (1,0) [0|16777215] ""  DASy

BO_ 200 VFC_LaneClothoid00: 24 MPC3
 SG_ VFC_Cloth00_CRC : 0|16@1+ (1,0) [0|65535] ""  DASy
 SG_ VFC_Cloth00_AliveCtr : 16|8@1+ (1,0) [0|255] ""  DASy
 SG_ VFC_Cloth00_ProtBlockCtr : 24|4@1+ (1,0) [0|15] ""  DASy
 SG_ VFC_Cloth00_Conf : 40|6@1+ (2,0) [0|100] "%"  DASy
 SG_ VFC_Cloth00_LineNumber : 137|3@1+ (1,0) [0|7] ""  DASy
 SG_ VFC_Cloth00_DxEnd : 31|9@1+ (0.5,0) [0|255.5] "m"  DASy
 SG_ VFC_Cloth00_Dy : 76|12@1+ (0.0078125,-16) [-16|15.9921875] "m"  DASy
 SG_ VFC_Cloth00_DyStdDev : 140|9@1+ (0.0078125,0) [0|3.9921875] "m"  DASy
 SG_ VFC_Cloth00_Curv : 152|15@1+ (3.814697265625E-006,-0.0625) [-0.0625|0.0624961853027344] "1/m"  DASy
 SG_ VFC_Cloth00_CurvChange : 108|24@1+ (1.86264514923096E-009,-0.0156249990686774) [-0.0156249990686774|0.0156249990686774] "1/m^2"  DASy
 SG_ VFC_Cloth00_CourseDeviation : 46|10@1+ (0.05,0) [0|51.15] ""  DASy
 SG_ VFC_Cloth00_HeadingAngle : 64|12@1+ (0.00048828125,-1) [-1|0.99951171875] "rad"  DASy
 SG_ VFC_Cloth00_LineWidth : 56|8@1+ (0.01,0) [0|2.55] "m"  DASy
 SG_ VFC_Cloth00_Type : 132|5@1+ (1,0) [0|19] ""  DASy
 SG_ VFC_Cloth00_StartPosition : 96|9@1+ (0.25,0) [0|127.5] "m"  DASy
 SG_ VFC_Cloth00_ColorClass : 149|3@1+ (1,0) [0|7] ""  DASy

BO_ 201 VFC_LaneClothoid01: 24 MPC3
 SG_ VFC_Cloth01_CRC : 0|16@1+ (1,0) [0|65535] ""  DASy
 SG_ VFC_Cloth01_AliveCtr : 16|8@1+ (1,0) [0|255] ""  DASy
 SG_ VFC_Cloth01_ProtBlockCtr : 24|4@1+ (1,0) [0|15] ""  DASy
 SG_ VFC_Cloth01_Conf : 40|6@1+ (2,0) [0|100] "%"  DASy
 SG_ VFC_Cloth01_LineNumber : 137|3@1+ (1,0) [0|7] ""  DASy
 SG_ VFC_Cloth01_DxEnd : 31|9@1+ (0.5,0) [0|255.5] "m"  DASy
 SG_ VFC_Cloth01_Dy : 76|12@1+ (0.0078125,-16) [-16|15.9921875] "m"  DASy
 SG_ VFC_Cloth01_DyStdDev : 140|9@1+ (0.0078125,0) [0|3.9921875] "m"  DASy
 SG_ VFC_Cloth01_Curv : 152|15@1+ (3.814697265625E-006,-0.0625) [-0.0625|0.0624961853027344] "1/m"  DASy
 SG_ VFC_Cloth01_CurvChange : 108|24@1+ (1.86264514923096E-009,-0.0156249990686774) [-0.0156249990686774|0.0156249990686774] "1/m^2"  DASy
 SG_ VFC_Cloth01_CourseDeviation : 46|10@1+ (0.05,0) [0|51.15] ""  DASy
 SG_ VFC_Cloth01_HeadingAngle : 64|12@1+ (0.00048828125,-1) [-1|0.99951171875] "rad"  DASy
 SG_ VFC_Cloth01_LineWidth : 56|8@1+ (0.01,0) [0|2.55] "m"  DASy
 SG_ VFC_Cloth01_Type : 132|5@1+ (1,0) [0|19] ""  DASy
 SG_ VFC_Cloth01_StartPosition : 96|9@1+ (0.25,0) [0|127.75] ""  DASy
 SG_ VFC_Cloth01_ColorClass : 149|3@1+ (1,0) [0|7] ""  DASy

BO_ 202 VFC_LaneClothoid02: 24 MPC3
 SG_ VFC_Cloth02_CRC : 0|16@1+ (1,0) [0|65535] ""  DASy
 SG_ VFC_Cloth02_AliveCtr : 16|8@1+ (1,0) [0|255] ""  DASy
 SG_ VFC_Cloth02_ProtBlockCtr : 24|4@1+ (1,0) [0|15] ""  DASy
 SG_ VFC_Cloth02_Conf : 40|6@1+ (2,0) [0|100] "%"  DASy
 SG_ VFC_Cloth02_LineNumber : 137|3@1+ (1,0) [0|7] ""  DASy
 SG_ VFC_Cloth02_DxEnd : 31|9@1+ (0.5,0) [0|255.5] "m"  DASy
 SG_ VFC_Cloth02_Dy : 76|12@1+ (0.0078125,-16) [-16|15.9921875] "m"  DASy
 SG_ VFC_Cloth02_DyStdDev : 140|9@1+ (0.0078125,0) [0|3.9921875] "m"  DASy
 SG_ VFC_Cloth02_Curv : 152|15@1+ (3.814697265625E-006,-0.0625) [-0.0625|0.0624961853027344] "1/m"  DASy
 SG_ VFC_Cloth02_CurvChange : 108|24@1+ (1.86264514923096E-009,-0.0156249990686774) [-0.0156249990686774|0.0156249990686774] "1/m^2"  DASy
 SG_ VFC_Cloth02_CourseDeviation : 46|10@1+ (0.05,0) [0|51.15] ""  DASy
 SG_ VFC_Cloth02_HeadingAngle : 64|12@1+ (0.00048828125,-1) [-1|0.99951171875] "rad"  DASy
 SG_ VFC_Cloth02_LineWidth : 56|8@1+ (0.01,0) [0|2.55] "m"  DASy
 SG_ VFC_Cloth02_Type : 132|5@1+ (1,0) [0|19] ""  DASy
 SG_ VFC_Cloth02_StartPosition : 96|9@1+ (0.25,0) [0|127.75] ""  DASy
 SG_ VFC_Cloth02_ColorClass : 149|3@1+ (1,0) [0|7] ""  DASy

BO_ 203 VFC_LaneClothoid03: 24 MPC3
 SG_ VFC_Cloth03_CRC : 0|16@1+ (1,0) [0|65535] ""  DASy
 SG_ VFC_Cloth03_AliveCtr : 16|8@1+ (1,0) [0|255] ""  DASy
 SG_ VFC_Cloth03_ProtBlockCtr : 24|4@1+ (1,0) [0|15] ""  DASy
 SG_ VFC_Cloth03_Conf : 40|6@1+ (2,0) [0|100] "%"  DASy
 SG_ VFC_Cloth03_LineNumber : 137|3@1+ (1,0) [0|7] ""  DASy
 SG_ VFC_Cloth03_DxEnd : 31|9@1+ (0.5,0) [0|255.5] "m"  DASy
 SG_ VFC_Cloth03_Dy : 76|12@1+ (0.0078125,-16) [-16|15.9921875] "m"  DASy
 SG_ VFC_Cloth03_DyStdDev : 140|9@1+ (0.0078125,0) [0|3.9921875] "m"  DASy
 SG_ VFC_Cloth03_Curv : 152|15@1+ (3.814697265625E-006,-0.0625) [-0.0625|0.0624961853027344] "1/m"  DASy
 SG_ VFC_Cloth03_CurvChange : 108|24@1+ (1.86264514923096E-009,-0.0156249990686774) [-0.0156249990686774|0.0156249990686774] "1/m^2"  DASy
 SG_ VFC_Cloth03_CourseDeviation : 46|10@1+ (0.05,0) [0|51.15] ""  DASy
 SG_ VFC_Cloth03_HeadingAngle : 64|12@1+ (0.00048828125,-1) [-1|0.99951171875] "rad"  DASy
 SG_ VFC_Cloth03_LineWidth : 56|8@1+ (0.01,0) [0|2.55] "m"  DASy
 SG_ VFC_Cloth03_Type : 132|5@1+ (1,0) [0|19] ""  DASy
 SG_ VFC_Cloth03_StartPosition : 96|9@1+ (0.25,0) [0|127.75] ""  DASy
 SG_ VFC_Cloth03_ColorClass : 149|3@1+ (1,0) [0|7] ""  DASy

BO_ 204 VFC_LaneClothoid04: 24 MPC3
 SG_ VFC_Cloth04_CRC : 0|16@1+ (1,0) [0|65535] ""  DASy
 SG_ VFC_Cloth04_AliveCtr : 16|8@1+ (1,0) [0|255] ""  DASy
 SG_ VFC_Cloth04_ProtBlockCtr : 24|4@1+ (1,0) [0|15] ""  DASy
 SG_ VFC_Cloth04_Conf : 40|6@1+ (2,0) [0|100] "%"  DASy
 SG_ VFC_Cloth04_LineNumber : 137|3@1+ (1,0) [0|7] ""  DASy
 SG_ VFC_Cloth04_DxEnd : 31|9@1+ (0.5,0) [0|255.5] "m"  DASy
 SG_ VFC_Cloth04_Dy : 76|12@1+ (0.0078125,-16) [-16|15.9921875] "m"  DASy
 SG_ VFC_Cloth04_DyStdDev : 140|9@1+ (0.0078125,0) [0|3.9921875] "m"  DASy
 SG_ VFC_Cloth04_Curv : 152|15@1+ (3.814697265625E-006,-0.0625) [-0.0625|0.0624961853027344] "1/m"  DASy
 SG_ VFC_Cloth04_CurvChange : 108|24@1+ (1.86264514923096E-009,-0.0156249990686774) [-0.0156249990686774|0.0156249990686774] "1/m^2"  DASy
 SG_ VFC_Cloth04_CourseDeviation : 46|10@1+ (0.05,0) [0|51.15] ""  DASy
 SG_ VFC_Cloth04_HeadingAngle : 64|12@1+ (0.00048828125,-1) [-1|0.99951171875] "rad"  DASy
 SG_ VFC_Cloth04_LineWidth : 56|8@1+ (0.01,0) [0|2.55] "m"  DASy
 SG_ VFC_Cloth04_Type : 132|5@1+ (1,0) [0|19] ""  DASy
 SG_ VFC_Cloth04_StartPosition : 96|9@1+ (0.25,0) [0|127.75] ""  DASy
 SG_ VFC_Cloth04_ColorClass : 149|3@1+ (1,0) [0|7] ""  DASy

BO_ 205 VFC_LaneClothoid05: 24 MPC3
 SG_ VFC_Cloth05_CRC : 0|16@1+ (1,0) [0|65535] ""  DASy
 SG_ VFC_Cloth05_AliveCtr : 16|8@1+ (1,0) [0|255] ""  DASy
 SG_ VFC_Cloth05_ProtBlockCtr : 24|4@1+ (1,0) [0|15] ""  DASy
 SG_ VFC_Cloth05_Conf : 40|6@1+ (2,0) [0|100] "%"  DASy
 SG_ VFC_Cloth05_LineNumber : 137|3@1+ (1,0) [0|7] ""  DASy
 SG_ VFC_Cloth05_DxEnd : 31|9@1+ (0.5,0) [0|255.5] "m"  DASy
 SG_ VFC_Cloth05_Dy : 76|12@1+ (0.0078125,-16) [-16|15.9921875] "m"  DASy
 SG_ VFC_Cloth05_DyStdDev : 140|9@1+ (0.0078125,0) [0|3.9921875] "m"  DASy
 SG_ VFC_Cloth05_Curv : 152|15@1+ (3.814697265625E-006,-0.0625) [-0.0625|0.0624961853027344] "1/m"  DASy
 SG_ VFC_Cloth05_CurvChange : 108|24@1+ (1.86264514923096E-009,-0.0156249990686774) [-0.0156249990686774|0.0156249990686774] "1/m^2"  DASy
 SG_ VFC_Cloth05_CourseDeviation : 46|10@1+ (0.05,0) [0|51.15] ""  DASy
 SG_ VFC_Cloth05_HeadingAngle : 64|12@1+ (0.00048828125,-1) [-1|0.99951171875] "rad"  DASy
 SG_ VFC_Cloth05_LineWidth : 56|8@1+ (0.01,0) [0|2.55] "m"  DASy
 SG_ VFC_Cloth05_Type : 132|5@1+ (1,0) [0|19] ""  DASy
 SG_ VFC_Cloth05_StartPosition : 96|9@1+ (0.25,0) [0|127.75] ""  DASy
 SG_ VFC_Cloth05_ColorClass : 149|3@1+ (1,0) [0|7] ""  DASy

BO_ 206 VFC_LaneClothoid06: 24 MPC3
 SG_ VFC_Cloth06_CRC : 0|16@1+ (1,0) [0|65535] ""  DASy
 SG_ VFC_Cloth06_AliveCtr : 16|8@1+ (1,0) [0|255] ""  DASy
 SG_ VFC_Cloth06_ProtBlockCtr : 24|4@1+ (1,0) [0|15] ""  DASy
 SG_ VFC_Cloth06_Conf : 40|6@1+ (2,0) [0|100] "%"  DASy
 SG_ VFC_Cloth06_LineNumber : 137|3@1+ (1,0) [0|7] ""  DASy
 SG_ VFC_Cloth06_DxEnd : 31|9@1+ (0.5,0) [0|255.5] "m"  DASy
 SG_ VFC_Cloth06_Dy : 76|12@1+ (0.0078125,-16) [-16|15.9921875] "m"  DASy
 SG_ VFC_Cloth06_DyStdDev : 140|9@1+ (0.0078125,0) [0|3.9921875] "m"  DASy
 SG_ VFC_Cloth06_Curv : 152|15@1+ (3.814697265625E-006,-0.0625) [-0.0625|0.0624961853027344] "1/m"  DASy
 SG_ VFC_Cloth06_CurvChange : 108|24@1+ (1.86264514923096E-009,-0.0156249990686774) [-0.0156249990686774|0.0156249990686774] "1/m^2"  DASy
 SG_ VFC_Cloth06_CourseDeviation : 46|10@1+ (0.05,0) [0|51.15] ""  DASy
 SG_ VFC_Cloth06_HeadingAngle : 64|12@1+ (0.00048828125,-1) [-1|0.99951171875] "rad"  DASy
 SG_ VFC_Cloth06_LineWidth : 56|8@1+ (0.01,0) [0|2.55] "m"  DASy
 SG_ VFC_Cloth06_Type : 132|5@1+ (1,0) [0|19] ""  DASy
 SG_ VFC_Cloth06_StartPosition : 96|9@1+ (0.25,0) [0|127.75] ""  DASy
 SG_ VFC_Cloth06_ColorClass : 149|3@1+ (1,0) [0|7] ""  DASy

BO_ 207 VFC_LaneClothoid07: 24 MPC3
 SG_ VFC_Cloth07_CRC : 0|16@1+ (1,0) [0|65535] ""  DASy
 SG_ VFC_Cloth07_AliveCtr : 16|8@1+ (1,0) [0|255] ""  DASy
 SG_ VFC_Cloth07_ProtBlockCtr : 24|4@1+ (1,0) [0|15] ""  DASy
 SG_ VFC_Cloth07_Conf : 40|6@1+ (2,0) [0|100] "%"  DASy
 SG_ VFC_Cloth07_LineNumber : 137|3@1+ (1,0) [0|7] ""  DASy
 SG_ VFC_Cloth07_DxEnd : 31|9@1+ (0.5,0) [0|255.5] "m"  DASy
 SG_ VFC_Cloth07_Dy : 76|12@1+ (0.0078125,-16) [-16|15.9921875] "m"  DASy
 SG_ VFC_Cloth07_DyStdDev : 140|9@1+ (0.0078125,0) [0|3.9921875] "m"  DASy
 SG_ VFC_Cloth07_Curv : 152|15@1+ (3.814697265625E-006,-0.0625) [-0.0625|0.0624961853027344] "1/m"  DASy
 SG_ VFC_Cloth07_CurvChange : 108|24@1+ (1.86264514923096E-009,-0.0156249990686774) [-0.0156249990686774|0.0156249990686774] "1/m^2"  DASy
 SG_ VFC_Cloth07_CourseDeviation : 46|10@1+ (0.05,0) [0|51.15] ""  DASy
 SG_ VFC_Cloth07_HeadingAngle : 64|12@1+ (0.00048828125,-1) [-1|0.99951171875] "rad"  DASy
 SG_ VFC_Cloth07_LineWidth : 56|8@1+ (0.01,0) [0|2.55] "m"  DASy
 SG_ VFC_Cloth07_Type : 132|5@1+ (1,0) [0|19] ""  DASy
 SG_ VFC_Cloth07_StartPosition : 96|9@1+ (0.25,0) [0|127.75] ""  DASy
 SG_ VFC_Cloth07_ColorClass : 149|3@1+ (1,0) [0|7] ""  DASy

BO_ 210 VFC_LanePolynomsA: 64 MPC3
 SG_ VFC_PolyA_CRC : 0|16@1+ (1,0) [0|65535] ""  DASy
 SG_ VFC_PolyA_AliveCtr : 16|8@1+ (1,0) [0|255] ""  DASy
 SG_ VFC_PolyA_ProtBlockCtr : 24|4@1+ (1,0) [0|15] ""  DASy
 SG_ VFC_PolyA_Line_Left_C0 : 28|14@1+ (1.17,-6000) [-6000|13168.11] ""  DASy
 SG_ VFC_PolyA_Line_Left_C1 : 42|14@1+ (0.00854,-100) [-100|39.91082] ""  DASy
 SG_ VFC_PolyA_Line_Left_C2 : 56|14@1+ (2.44E-005,-0.1) [-0.1|0.2997452] ""  DASy
 SG_ VFC_PolyA_Line_Left_C3 : 72|14@1+ (2.07E-008,-0.0003) [-0.0003|3.91281E-005] ""  DASy
 SG_ VFC_PolyA_Line_Right_C0 : 88|14@1+ (1.17,-6000) [-6000|13168.11] ""  DASy
 SG_ VFC_PolyA_Line_Right_C1 : 104|14@1+ (0.00854,-100) [-100|39.91082] ""  DASy
 SG_ VFC_PolyA_Line_Right_C2 : 120|14@1+ (2.44E-005,-0.1) [-0.1|0.2997452] ""  DASy
 SG_ VFC_PolyA_Line_Right_C3 : 136|14@1+ (2.07E-008,-0.0003) [-0.0003|3.91281E-005] ""  DASy
 SG_ VFC_PolyA_Line_LeftLeft_C0 : 152|14@1+ (1.17,-6000) [-6000|13168.11] ""  DASy
 SG_ VFC_PolyA_Line_LeftLeft_C1 : 168|14@1+ (0.00854,-100) [-100|39.91082] ""  DASy
 SG_ VFC_PolyA_Line_LeftLeft_C2 : 184|14@1+ (2.44E-005,-0.1) [-0.1|0.2997452] ""  DASy
 SG_ VFC_PolyA_Line_LeftLeft_C3 : 200|14@1+ (2.07E-008,-0.0003) [-0.0003|3.91281E-005] ""  DASy
 SG_ VFC_PolyA_Line_RightRight_C0 : 216|14@1+ (1.17,-6000) [-6000|13168.11] ""  DASy
 SG_ VFC_PolyA_Line_RightRight_C1 : 232|14@1+ (0.00854,-100) [-100|39.91082] ""  DASy
 SG_ VFC_PolyA_Line_RightRight_C2 : 248|14@1+ (2.44E-005,-0.1) [-0.1|0.2997452] ""  DASy
 SG_ VFC_PolyA_Line_RightRight_C3 : 264|14@1+ (2.07E-008,-0.0003) [-0.0003|3.91281E-005] ""  DASy
 SG_ VFC_PolyA_Line_Left_Id : 280|8@1+ (1,0) [0|255] ""  DASy
 SG_ VFC_PolyA_Line_Right_Id : 288|8@1+ (1,0) [0|255] ""  DASy
 SG_ VFC_PolyA_Line_LeftLeft_Id : 296|8@1+ (1,0) [0|255] ""  DASy
 SG_ VFC_PolyA_Line_RightRight_Id : 304|8@1+ (1,0) [0|255] ""  DASy
 SG_ VFC_PolyA_Line_Left_Start : 312|10@1+ (1,0) [0|1023] ""  DASy
 SG_ VFC_PolyA_Line_Right_Start : 328|10@1+ (1,0) [0|1023] ""  DASy
 SG_ VFC_PolyA_Line_LeftLeft_Start : 344|10@1+ (1,0) [0|1023] ""  DASy
 SG_ VFC_PolyA_Line_RightRight_Start : 360|10@1+ (1,0) [0|1023] ""  DASy
 SG_ VFC_PolyA_Line_Left_End : 376|10@1+ (1,0) [0|1023] ""  DASy
 SG_ VFC_PolyA_Line_Right_End : 392|10@1+ (1,0) [0|1023] ""  DASy
 SG_ VFC_PolyA_Line_LeftLeft_End : 408|10@1+ (1,0) [0|1023] ""  DASy
 SG_ VFC_PolyA_Line_RightRight_End : 424|10@1+ (1,0) [0|1023] ""  DASy
 SG_ VFC_PolyA_FV : 487|8@0+ (1,0) [0|255] ""  DASy
 SG_ VFC_PolyA_MAC : 495|24@0+ (1,0) [0|16777215] ""  DASy

BO_ 211 VFC_LanePolynomsB: 64 MPC3
 SG_ VFC_PolyB_CRC : 0|16@1+ (1,0) [0|65535] ""  DASy
 SG_ VFC_PolyB_AliveCtr : 16|8@1+ (1,0) [0|255] ""  DASy
 SG_ VFC_PolyB_ProtBlockCtr : 24|4@1+ (1,0) [0|15] ""  DASy
 SG_ VFC_PolyB_Line_RoadLineLeft_C0 : 28|14@1+ (1.17,-6000) [-6000|13168.11] ""  DASy
 SG_ VFC_PolyB_Line_RoadLineLeft_C1 : 42|14@1+ (0.00854,-100) [-100|39.91082] ""  DASy
 SG_ VFC_PolyB_Line_RoadLineLeft_C2 : 56|14@1+ (2.44E-005,-0.1) [-0.1|0.2997452] ""  DASy
 SG_ VFC_PolyB_Line_RoadLineLeft_C3 : 72|14@1+ (2.07E-008,-0.0003) [-0.0003|3.91281E-005] ""  DASy
 SG_ VFC_PolyB_Line_RoadLineRight_C0 : 88|14@1+ (1.17,-6000) [-6000|13168.11] ""  DASy
 SG_ VFC_PolyB_Line_RoadLineRight_C1 : 104|14@1+ (0.00854,-100) [-100|39.91082] ""  DASy
 SG_ VFC_PolyB_Line_RoadLineRight_C2 : 120|14@1+ (2.44E-005,-0.1) [-0.1|0.2997452] ""  DASy
 SG_ VFC_PolyB_Line_RoadLineRight_C3 : 136|14@1+ (2.07E-008,-0.0003) [-0.0003|3.91281E-005] ""  DASy
 SG_ VFC_PolyB_Line_EgotrackLeft_C0 : 152|14@1+ (1.17,-6000) [-6000|13168.11] ""  DASy
 SG_ VFC_PolyB_Line_EgotrackLeft_C1 : 168|14@1+ (0.00854,-100) [-100|39.91082] ""  DASy
 SG_ VFC_PolyB_Line_EgotrackLeft_C2 : 184|14@1+ (2.44E-005,-0.1) [-0.1|0.2997452] ""  DASy
 SG_ VFC_PolyB_Line_EgotrackLeft_C3 : 200|14@1+ (2.07E-008,-0.0003) [-0.0003|3.91281E-005] ""  DASy
 SG_ VFC_PolyB_Line_EgotrackRight_C0 : 216|14@1+ (1.17,-6000) [-6000|13168.11] ""  DASy
 SG_ VFC_PolyB_Line_EgotrackRight_C1 : 232|14@1+ (0.00854,-100) [-100|39.91082] ""  DASy
 SG_ VFC_PolyB_Line_EgotrackRight_C2 : 248|14@1+ (2.44E-005,-0.1) [-0.1|0.2997452] ""  DASy
 SG_ VFC_PolyB_Line_EgotrackRight_C3 : 264|14@1+ (2.07E-008,-0.0003) [-0.0003|3.91281E-005] ""  DASy
 SG_ VFC_PolyB_Line_LineRoadLeft_Id : 280|8@1+ (1,0) [0|255] ""  DASy
 SG_ VFC_PolyB_Line_LineRoadRight_Id : 288|8@1+ (1,0) [0|255] ""  DASy
 SG_ VFC_PolyB_Line_EgotrackLeft_Id : 296|8@1+ (1,0) [0|255] ""  DASy
 SG_ VFC_PolyB_Line_EgotrackRight_Id : 304|8@1+ (1,0) [0|255] ""  DASy
 SG_ VFC_PolyB_Line_RoadLineLe_Start : 312|10@1+ (1,0) [0|1023] ""  DASy
 SG_ VFC_PolyB_Line_RoadLineRi_Start : 328|10@1+ (1,0) [0|1023] ""  DASy
 SG_ VFC_PolyB_Line_EgotrackLe_Start : 344|10@1+ (1,0) [0|1023] ""  DASy
 SG_ VFC_PolyB_Line_EgotrackRi_Start : 360|10@1+ (1,0) [0|1023] ""  DASy
 SG_ VFC_PolyB_Line_RoadLineLeft_End : 376|10@1+ (1,0) [0|1023] ""  DASy
 SG_ VFC_PolyB_Line_RoadLineRight_End : 392|10@1+ (1,0) [0|1023] ""  DASy
 SG_ VFC_PolyB_Line_EgotrackLeft_End : 408|10@1+ (1,0) [0|1023] ""  DASy
 SG_ VFC_PolyB_Line_EgotrackRight_End : 424|10@1+ (1,0) [0|1023] ""  DASy
 SG_ VFC_PolyB_FV : 487|8@0+ (1,0) [0|255] ""  DASy
 SG_ VFC_PolyB_MAC : 495|24@0+ (1,0) [0|16777215] ""  DASy

BO_ 236 VFC_TrafficSignHdr: 16 MPC3
 SG_ VFC_TSHdr_CRC : 0|16@1+ (1,0) [0|65535] ""  DASy
 SG_ VFC_TSHdr_AliveCtr : 16|8@1+ (1,0) [0|255] ""  DASy
 SG_ VFC_TSHdr_ProtBlockCtr : 24|4@1+ (1,0) [0|15] ""  DASy
 SG_ VFC_TSHdr_ProtTrafficSignCount : 32|5@1+ (1,0) [0|16] ""  DASy
 SG_ VFC_TSHdr_State : 40|3@1+ (1,0) [0|7] ""  DASy
 SG_ VFC_TSHdr_Brightness : 43|3@1+ (1,0) [0|7] ""  DASy
 SG_ VFC_TSHdr_Country : 46|10@1+ (1,0) [0|894] ""  DASy
 SG_ VFC_TSHdr_TimeStampStatus : 56|8@1+ (1,0) [0|255] ""  DASy
 SG_ VFC_TSHdr_TimeStamp : 64|26@1+ (1,0) [0|67108863] "ms"  DASy
 SG_ VFC_TSHdr_CountryMode : 93|3@1+ (1,0) [0|7] ""  DASy
 SG_ VFC_TSHdr_FV : 103|8@0+ (1,0) [0|255] ""  DASy
 SG_ VFC_TSHdr_MAC : 111|24@0+ (1,0) [0|16777215] ""  DASy

BO_ 238 VFC_TrafficSign00: 48 MPC3
 SG_ VFC_TS00_CRC : 0|16@1+ (1,0) [0|65535] ""  DASy
 SG_ VFC_TS00_AliveCtr : 16|8@1+ (1,0) [0|255] ""  DASy
 SG_ VFC_TS00_ProtBlockCtr : 24|4@1+ (1,0) [0|15] ""  DASy
 SG_ VFC_TS00_ProtOrderIndex : 32|4@1+ (1,0) [0|15] ""  DASy
 SG_ VFC_TS00_ID : 40|8@1+ (1,0) [1|255] ""  DASy
 SG_ VFC_TS00_Class : 48|8@1+ (1,0) [0|206] ""  DASy
 SG_ VFC_TS00_TSProb : 56|6@1+ (2,0) [0|100] "%"  DASy
 SG_ VFC_TS00_Dx : 64|9@1+ (0.2,0) [0|102.2] "m"  DASy
 SG_ VFC_TS00_Dy : 80|8@1+ (0.2,-25.6) [-25.6|25.4] "m"  DASy
 SG_ VFC_TS00_Dz : 88|6@1+ (0.2,0) [0|12.6] "m"  DASy
 SG_ VFC_TS00_DxStdDev : 96|8@1+ (0.25,0) [0|63.75] "m"  DASy
 SG_ VFC_TS00_DyStdDev : 104|7@1+ (0.1,0) [0|12.7] "m"  DASy
 SG_ VFC_TS00_DzStdDev : 112|6@1+ (0.1,0) [0|6.3] "m"  DASy
 SG_ VFC_TS00_Width : 120|7@1+ (0.1,0) [0|12.7] "m"  DASy
 SG_ VFC_TS00_Height : 128|6@1+ (0.1,0) [0|6.3] "m"  DASy
 SG_ VFC_TS00_EmbedFlag : 136|3@1+ (1,0) [0|7] ""  DASy
 SG_ VFC_TS00_Quality : 139|1@1+ (1,0) [0|1] ""  DASy
 SG_ VFC_TS00_VMS : 140|1@1+ (1,0) [0|1] ""  DASy
 SG_ VFC_TS00_Stable : 141|1@1+ (1,0) [0|1] ""  DASy
 SG_ VFC_TS00_VehicleSticker : 142|1@1+ (1,0) [0|1] ""  DASy
 SG_ VFC_TS00_InternalTrack : 143|1@1+ (1,0) [0|1] ""  DASy
 SG_ VFC_TS00_ValidLanes : 144|5@1+ (1,0) [0|31] ""  DASy
 SG_ VFC_TS00_ValidDay : 152|7@1+ (1,0) [0|127] ""  DASy
 SG_ VFC_TS00_ValidTimeRange1Start : 160|7@1+ (15,0) [0|1440] "min"  DASy
 SG_ VFC_TS00_ValidTimeRange1End : 168|7@1+ (15,0) [0|1440] "min"  DASy
 SG_ VFC_TS00_ValidTimeRange2Start : 176|7@1+ (15,0) [0|1440] "min"  DASy
 SG_ VFC_TS00_ValidTimeRange2End : 184|7@1+ (15,0) [0|1440] "min"  DASy
 SG_ VFC_TS00_ValidInDist : 192|10@1+ (10,0) [0|10230] "m"  DASy
 SG_ VFC_TS00_ValidDist : 208|10@1+ (10,0) [0|10230] "m"  DASy
 SG_ VFC_TS00_AddTSCount : 232|3@1+ (1,0) [0|6] ""  DASy
 SG_ VFC_TS00_AddTS1Class : 240|8@1+ (1,0) [0|68] ""  DASy
 SG_ VFC_TS00_AddTS1Prob : 248|6@1+ (2,0) [0|100] "%"  DASy
 SG_ VFC_TS00_AddTS1Quality : 254|1@1+ (1,0) [0|1] ""  DASy
 SG_ VFC_TS00_AddTS1VMS : 255|1@1+ (1,0) [0|1] ""  DASy
 SG_ VFC_TS00_AddTS2Class : 256|8@1+ (1,0) [0|68] ""  DASy
 SG_ VFC_TS00_AddTS2Prob : 264|6@1+ (2,0) [0|100] "%"  DASy
 SG_ VFC_TS00_AddTS2Quality : 270|1@1+ (1,0) [0|1] ""  DASy
 SG_ VFC_TS00_AddTS2VMS : 271|1@1+ (1,0) [0|1] ""  DASy
 SG_ VFC_TS00_AddTS3Class : 272|8@1+ (1,0) [0|68] ""  DASy
 SG_ VFC_TS00_AddTS3Prob : 280|6@1+ (2,0) [0|100] "%"  DASy
 SG_ VFC_TS00_AddTS3Quality : 286|1@1+ (1,0) [0|1] ""  DASy
 SG_ VFC_TS00_AddTS3VMS : 287|1@1+ (1,0) [0|1] ""  DASy
 SG_ VFC_TS00_AddTS4Class : 288|8@1+ (1,0) [0|68] ""  DASy
 SG_ VFC_TS00_AddTS4Prob : 296|6@1+ (2,0) [0|100] "%"  DASy
 SG_ VFC_TS00_AddTS4Quality : 302|1@1+ (1,0) [0|1] ""  DASy
 SG_ VFC_TS00_AddTS4VMS : 303|1@1+ (1,0) [0|1] ""  DASy
 SG_ VFC_TS00_AddTS5Class : 304|8@1+ (1,0) [0|68] ""  DASy
 SG_ VFC_TS00_AddTS5Prob : 312|6@1+ (2,0) [0|100] "%"  DASy
 SG_ VFC_TS00_AddTS5Quality : 318|1@1+ (1,0) [0|1] ""  DASy
 SG_ VFC_TS00_AddTS5VMS : 319|1@1+ (1,0) [0|1] ""  DASy
 SG_ VFC_TS00_AddTS6Class : 320|8@1+ (1,0) [0|68] ""  DASy
 SG_ VFC_TS00_AddTS6Prob : 328|6@1+ (2,0) [0|100] "%"  DASy
 SG_ VFC_TS00_AddTS6Quality : 334|1@1+ (1,0) [0|1] ""  DASy
 SG_ VFC_TS00_AddTS6VMS : 335|1@1+ (1,0) [0|1] ""  DASy
 SG_ VFC_TS00_FV : 359|8@0+ (1,0) [0|255] ""  DASy
 SG_ VFC_TS00_MAC : 367|24@0+ (1,0) [0|16777215] ""  DASy

BO_ 239 VFC_TrafficSign01: 48 MPC3
 SG_ VFC_TS01_CRC : 0|16@1+ (1,0) [0|65535] ""  DASy
 SG_ VFC_TS01_AliveCtr : 16|8@1+ (1,0) [0|255] ""  DASy
 SG_ VFC_TS01_ProtBlockCtr : 24|4@1+ (1,0) [0|15] ""  DASy
 SG_ VFC_TS01_ProtOrderIndex : 32|4@1+ (1,0) [0|15] ""  DASy
 SG_ VFC_TS01_ID : 40|8@1+ (1,0) [1|255] ""  DASy
 SG_ VFC_TS01_Class : 48|8@1+ (1,0) [0|206] ""  DASy
 SG_ VFC_TS01_TSProb : 56|6@1+ (2,0) [0|100] "%"  DASy
 SG_ VFC_TS01_Dx : 64|9@1+ (0.2,0) [0|102.2] "m"  DASy
 SG_ VFC_TS01_Dy : 80|8@1+ (0.2,-25.6) [-25.6|25.4] "m"  DASy
 SG_ VFC_TS01_Dz : 88|6@1+ (0.2,0) [0|12.6] "m"  DASy
 SG_ VFC_TS01_DxStdDev : 96|8@1+ (0.25,0) [0|63.75] "m"  DASy
 SG_ VFC_TS01_DyStdDev : 104|7@1+ (0.1,0) [0|12.7] "m"  DASy
 SG_ VFC_TS01_DzStdDev : 112|6@1+ (0.1,0) [0|6.3] "m"  DASy
 SG_ VFC_TS01_Width : 120|7@1+ (0.1,0) [0|12.7] "m"  DASy
 SG_ VFC_TS01_Height : 128|6@1+ (0.1,0) [0|6.3] "m"  DASy
 SG_ VFC_TS01_EmbedFlag : 136|3@1+ (1,0) [0|7] ""  DASy
 SG_ VFC_TS01_Quality : 139|1@1+ (1,0) [0|1] ""  DASy
 SG_ VFC_TS01_VMS : 140|1@1+ (1,0) [0|1] ""  DASy
 SG_ VFC_TS01_Stable : 141|1@1+ (1,0) [0|1] ""  DASy
 SG_ VFC_TS01_VehicleSticker : 142|1@1+ (1,0) [0|1] ""  DASy
 SG_ VFC_TS01_InternalTrack : 143|1@1+ (1,0) [0|1] ""  DASy
 SG_ VFC_TS01_ValidLanes : 144|5@1+ (1,0) [0|31] ""  DASy
 SG_ VFC_TS01_ValidDay : 152|7@1+ (1,0) [0|127] ""  DASy
 SG_ VFC_TS01_ValidTimeRange1Start : 160|7@1+ (15,0) [0|1440] "min"  DASy
 SG_ VFC_TS01_ValidTimeRange1End : 168|7@1+ (15,0) [0|1440] "min"  DASy
 SG_ VFC_TS01_ValidTimeRange2Start : 176|7@1+ (15,0) [0|1440] "min"  DASy
 SG_ VFC_TS01_ValidTimeRange2End : 184|7@1+ (15,0) [0|1440] "min"  DASy
 SG_ VFC_TS01_ValidInDist : 192|10@1+ (10,0) [0|10230] "m"  DASy
 SG_ VFC_TS01_ValidDist : 208|10@1+ (10,0) [0|10230] "m"  DASy
 SG_ VFC_TS01_AddTSCount : 232|3@1+ (1,0) [0|6] ""  DASy
 SG_ VFC_TS01_AddTS1Class : 240|8@1+ (1,0) [0|68] ""  DASy
 SG_ VFC_TS01_AddTS1Prob : 248|6@1+ (2,0) [0|100] "%"  DASy
 SG_ VFC_TS01_AddTS1Quality : 254|1@1+ (1,0) [0|1] ""  DASy
 SG_ VFC_TS01_AddTS1VMS : 255|1@1+ (1,0) [0|1] ""  DASy
 SG_ VFC_TS01_AddTS2Class : 256|8@1+ (1,0) [0|68] ""  DASy
 SG_ VFC_TS01_AddTS2Prob : 264|6@1+ (2,0) [0|100] "%"  DASy
 SG_ VFC_TS01_AddTS2Quality : 270|1@1+ (1,0) [0|1] ""  DASy
 SG_ VFC_TS01_AddTS2VMS : 271|1@1+ (1,0) [0|1] ""  DASy
 SG_ VFC_TS01_AddTS3Class : 272|8@1+ (1,0) [0|68] ""  DASy
 SG_ VFC_TS01_AddTS3Prob : 280|6@1+ (2,0) [0|100] "%"  DASy
 SG_ VFC_TS01_AddTS3Quality : 286|1@1+ (1,0) [0|1] ""  DASy
 SG_ VFC_TS01_AddTS3VMS : 287|1@1+ (1,0) [0|1] ""  DASy
 SG_ VFC_TS01_AddTS4Class : 288|8@1+ (1,0) [0|68] ""  DASy
 SG_ VFC_TS01_AddTS4Prob : 296|6@1+ (2,0) [0|100] "%"  DASy
 SG_ VFC_TS01_AddTS4Quality : 302|1@1+ (1,0) [0|1] ""  DASy
 SG_ VFC_TS01_AddTS4VMS : 303|1@1+ (1,0) [0|1] ""  DASy
 SG_ VFC_TS01_AddTS5Class : 304|8@1+ (1,0) [0|68] ""  DASy
 SG_ VFC_TS01_AddTS5Prob : 312|6@1+ (2,0) [0|100] "%"  DASy
 SG_ VFC_TS01_AddTS5Quality : 318|1@1+ (1,0) [0|1] ""  DASy
 SG_ VFC_TS01_AddTS5VMS : 319|1@1+ (1,0) [0|1] ""  DASy
 SG_ VFC_TS01_AddTS6Class : 320|8@1+ (1,0) [0|68] ""  DASy
 SG_ VFC_TS01_AddTS6Prob : 328|6@1+ (2,0) [0|100] "%"  DASy
 SG_ VFC_TS01_AddTS6Quality : 334|1@1+ (1,0) [0|1] ""  DASy
 SG_ VFC_TS01_AddTS6VMS : 335|1@1+ (1,0) [0|1] ""  DASy
 SG_ VFC_TS01_FV : 359|8@0+ (1,0) [0|255] ""  DASy
 SG_ VFC_TS01_MAC : 367|24@0+ (1,0) [0|16777215] ""  DASy

CM_ SG_ 128 VFC_Obj15A_CRC "CRC - Autosar E2E Profile 5";
CM_ SG_ 128 VFC_Obj15A_AliveCtr "Alive counter - Autosar E2E Profile 5";
CM_ SG_ 128 VFC_Obj15A_ProtBlockCtr "Protocol-Signal: Block-Counter";
CM_ SG_ 128 VFC_Obj15A_ID "Unique Object ID";
CM_ SG_ 128 VFC_Obj15A_Type "Classification of the object";
CM_ SG_ 128 VFC_Obj15A_TypeProb "Probability of the classified object type";
CM_ SG_ 128 VFC_Obj15A_Dx "Object distance in longitudinal direction";
CM_ SG_ 128 VFC_Obj15A_Dy "Object distance in lateral direction";
CM_ SG_ 128 VFC_Obj15A_Vx "Object velocity in longitudinal direction";
CM_ SG_ 128 VFC_Obj15A_Vy "Object velocity in lateral direction";
CM_ SG_ 128 VFC_Obj15A_Ax "Object acceleration in longitudinal direction";
CM_ SG_ 128 VFC_Obj15A_Ay "Object acceleration in lateral direction";
CM_ SG_ 128 VFC_Obj15A_DxStdDev "Standard deviation of Object distance in longitudinal direction";
CM_ SG_ 128 VFC_Obj15A_DyStdDev "Standard deviation of Object distance in lateral direction";
CM_ SG_ 128 VFC_Obj15A_VxStdDev "Standard deviation of Object velocity in longitudinal direction";
CM_ SG_ 128 VFC_Obj15A_VyStdDev "Standard deviation of Object velocity in lateral direction";
CM_ SG_ 128 VFC_Obj15A_AxStdDev "Standard deviation of Object acceleration in longitudinal direction";
CM_ SG_ 128 VFC_Obj15A_AyStdDev "Standard deviation of Object acceleration in lateral direction";
CM_ SG_ 128 VFC_Obj15A_Length "Length of the object";
CM_ SG_ 128 VFC_Obj15A_Width "Width of the object";
CM_ SG_ 128 VFC_Obj15A_Height "Height of the object";
CM_ SG_ 128 VFC_Obj15A_LengthStdDev "Standard deviation of object length";
CM_ SG_ 128 VFC_Obj15A_WidthStdDev "Standard deviation of object width";
CM_ SG_ 128 VFC_Obj15A_HeightStdDev "Standard deviation of object height";
CM_ SG_ 128 VFC_Obj15A_EdgeLeft "In ACCS coordinates; corresponds to tan(viewing angle of left object edge)";
CM_ SG_ 128 VFC_Obj15A_EdgeMid "In ACCS coordinates; corresponds to tan(viewing angle of middle object edge)";
CM_ SG_ 128 VFC_Obj15A_EdgeRight "In ACCS coordinates; corresponds to tan(viewing angle of right object edge)";
CM_ SG_ 128 VFC_Obj15A_EdgeTop "In ACCS coordinates; corresponds to tan(viewing angle of top object edge)";
CM_ SG_ 128 VFC_Obj15A_EdgeBottom "In ACCS coordinates; corresponds to tan(viewing angle of bottom object edge)";
CM_ SG_ 128 VFC_Obj15A_EdgeLeftStdDev "Standard deviation of the ACCS left object edge";
CM_ SG_ 128 VFC_Obj15A_EdgeMidStdDev "Standard deviation of the ACCS middle object edge";
CM_ SG_ 128 VFC_Obj15A_EdgeRightStdDev "Standard deviation of the ACCS right object edge";
CM_ SG_ 128 VFC_Obj15A_EdgeTopStdDev "Standard deviation of the ACCS top object edge";
CM_ SG_ 128 VFC_Obj15A_EdgeBottomStdDev "Standard deviation of the ACCS bottom object edge";
CM_ SG_ 128 VFC_Obj15A_NormVx "Normalised Object velocity in longitudinal direction";
CM_ SG_ 128 VFC_Obj15A_NormAx "Normalised Object acceleration in longitudinal direction";
CM_ SG_ 128 VFC_Obj15A_NormVyEdgeLeft "Normalised velocity of the ACCS left object edge in lateral direction";
CM_ SG_ 128 VFC_Obj15A_NormVyEdgeRight "Normalised velocity of the ACCS right object edge in lateral direction";
CM_ SG_ 128 VFC_Obj15A_NormVxStdDev "Standard deviation of Normalised Object velocity in longitudinal direction";
CM_ SG_ 128 VFC_Obj15A_NormAxStdDev "Standard deviation of Normalised Object acceleration in longitudinal direction";
CM_ SG_ 128 VFC_Obj15A_NormVyEdgeLeftStdDev "Standard deviation of Normalised velocity of the ACCS left object edge in lateral direction";
CM_ SG_ 128 VFC_Obj15A_NormVyEdgeRightStdDev "Standard deviation of Normalised velocity of the ACCS right object edge in lateral direction";
CM_ SG_ 128 VFC_Obj15A_ScaleChange "A scale change of of the detected object";
CM_ SG_ 128 VFC_Obj15A_ScaleChngStdDev "Standard deviation of object scale change";
CM_ SG_ 128 VFC_Obj15A_HeadingAngle "Heading angle of the object";
CM_ SG_ 128 VFC_Obj15A_HeadingAngleStdDev "Standard deviation of object Heading angle";
CM_ SG_ 128 VFC_Obj15A_HeadOrientation "The orientation of the head of cyclists or pedestrians that are detected";
CM_ SG_ 128 VFC_Obj15A_CompletelyInImg "indicator if the object is completely measured in the image";
CM_ SG_ 128 VFC_Obj15A_ProbMovingLat "Probability of object moving laterally";
CM_ SG_ 128 VFC_Obj15A_ProbMovingLong "Probability of object moving longitudinally";
CM_ SG_ 128 VFC_Obj15A_ProbExist "Object existence probability";
CM_ SG_ 128 VFC_Obj15A_MeasSource "Bitfield for the measurement programs from which this object originates
Bit 0: MOD
Bit 1: PDET
Bit 2: OFT
Bit 3: OLS
Bit 4: RESERVED";
CM_ SG_ 128 VFC_Obj15A_Reliability "The bitfield shows if the signal quality is assumed to be sufficient for functions with safety target -no false positives-
Bit 0: DYNAMIC
Bit 1: SEMSEG_SURFACE
Bit 2: WDD_CRITICAL
Bit 3: GOD_CONFIRMED
Bit 4: RESTRICTED
Bit 5: ISO26262_SAFE";
CM_ SG_ 128 VFC_Obj15A_Measured "Indicator if the object detected is measured or predicted";
CM_ SG_ 128 VFC_Obj15A_VisibleView "The visible view of the detected object";
CM_ SG_ 128 VFC_Obj15A_ClassifiedView "The classified view of object to be used in connection with Heading angle";
CM_ SG_ 128 VFC_Obj15A_DirIndicator "The detected direction indicator lights";
CM_ SG_ 128 VFC_Obj15A_BrakeLight "The number of detected lights. More confident if more lights are detected.";
CM_ SG_ 130 VFC_Obj16A_CRC "CRC - Autosar E2E Profile 5";
CM_ SG_ 130 VFC_Obj16A_AliveCtr "Alive counter - Autosar E2E Profile 5";
CM_ SG_ 130 VFC_Obj16A_ProtBlockCtr "Protocol-Signal: Block-Counter";
CM_ SG_ 130 VFC_Obj16A_ID "Unique Object ID";
CM_ SG_ 130 VFC_Obj16A_Type "Classification of the object";
CM_ SG_ 130 VFC_Obj16A_TypeProb "Probability of the classified object type";
CM_ SG_ 130 VFC_Obj16A_Dx "Object distance in longitudinal direction";
CM_ SG_ 130 VFC_Obj16A_Dy "Object distance in lateral direction";
CM_ SG_ 130 VFC_Obj16A_Vx "Object velocity in longitudinal direction";
CM_ SG_ 130 VFC_Obj16A_Vy "Object velocity in lateral direction";
CM_ SG_ 130 VFC_Obj16A_Ax "Object acceleration in longitudinal direction";
CM_ SG_ 130 VFC_Obj16A_Ay "Object acceleration in lateral direction";
CM_ SG_ 130 VFC_Obj16A_DxStdDev "Standard deviation of Object distance in longitudinal direction";
CM_ SG_ 130 VFC_Obj16A_DyStdDev "Standard deviation of Object distance in lateral direction";
CM_ SG_ 130 VFC_Obj16A_VxStdDev "Standard deviation of Object velocity in longitudinal direction";
CM_ SG_ 130 VFC_Obj16A_VyStdDev "Standard deviation of Object velocity in lateral direction";
CM_ SG_ 130 VFC_Obj16A_AxStdDev "Standard deviation of Object acceleration in longitudinal direction";
CM_ SG_ 130 VFC_Obj16A_AyStdDev "Standard deviation of Object acceleration in lateral direction";
CM_ SG_ 130 VFC_Obj16A_Length "Length of the object";
CM_ SG_ 130 VFC_Obj16A_Width "Width of the object";
CM_ SG_ 130 VFC_Obj16A_Height "Height of the object";
CM_ SG_ 130 VFC_Obj16A_LengthStdDev "Standard deviation of object length";
CM_ SG_ 130 VFC_Obj16A_WidthStdDev "Standard deviation of object width";
CM_ SG_ 130 VFC_Obj16A_HeightStdDev "Standard deviation of object height";
CM_ SG_ 130 VFC_Obj16A_EdgeLeft "In ACCS coordinates; corresponds to tan(viewing angle of left object edge)";
CM_ SG_ 130 VFC_Obj16A_EdgeMid "In ACCS coordinates; corresponds to tan(viewing angle of middle object edge)";
CM_ SG_ 130 VFC_Obj16A_EdgeRight "In ACCS coordinates; corresponds to tan(viewing angle of right object edge)";
CM_ SG_ 130 VFC_Obj16A_EdgeTop "In ACCS coordinates; corresponds to tan(viewing angle of top object edge)";
CM_ SG_ 130 VFC_Obj16A_EdgeBottom "In ACCS coordinates; corresponds to tan(viewing angle of bottom object edge)";
CM_ SG_ 130 VFC_Obj16A_EdgeLeftStdDev "Standard deviation of the ACCS left object edge";
CM_ SG_ 130 VFC_Obj16A_EdgeMidStdDev "Standard deviation of the ACCS middle object edge";
CM_ SG_ 130 VFC_Obj16A_EdgeRightStdDev "Standard deviation of the ACCS right object edge";
CM_ SG_ 130 VFC_Obj16A_EdgeTopStdDev "Standard deviation of the ACCS top object edge";
CM_ SG_ 130 VFC_Obj16A_EdgeBottomStdDev "Standard deviation of the ACCS bottom object edge";
CM_ SG_ 130 VFC_Obj16A_NormVx "Normalised Object velocity in longitudinal direction";
CM_ SG_ 130 VFC_Obj16A_NormAx "Normalised Object acceleration in longitudinal direction";
CM_ SG_ 130 VFC_Obj16A_NormVyEdgeLeft "Normalised velocity of the ACCS left object edge in lateral direction";
CM_ SG_ 130 VFC_Obj16A_NormVyEdgeRight "Normalised velocity of the ACCS right object edge in lateral direction";
CM_ SG_ 130 VFC_Obj16A_NormVxStdDev "Standard deviation of Normalised Object velocity in longitudinal direction";
CM_ SG_ 130 VFC_Obj16A_NormAxStdDev "Standard deviation of Normalised Object acceleration in longitudinal direction";
CM_ SG_ 130 VFC_Obj16A_NormVyEdgeLeftStdDev "Standard deviation of Normalised velocity of the ACCS left object edge in lateral direction";
CM_ SG_ 130 VFC_Obj16A_NormVyEdgeRightStdDev "Standard deviation of Normalised velocity of the ACCS right object edge in lateral direction";
CM_ SG_ 130 VFC_Obj16A_ScaleChange "A scale change of of the detected object";
CM_ SG_ 130 VFC_Obj16A_ScaleChngStdDev "Standard deviation of object scale change";
CM_ SG_ 130 VFC_Obj16A_HeadingAngle "Heading angle of the object";
CM_ SG_ 130 VFC_Obj16A_HeadingAngleStdDev "Standard deviation of object Heading angle";
CM_ SG_ 130 VFC_Obj16A_HeadOrientation "The orientation of the head of cyclists or pedestrians that are detected";
CM_ SG_ 130 VFC_Obj16A_CompletelyInImg "indicator if the object is completely measured in the image";
CM_ SG_ 130 VFC_Obj16A_ProbMovingLat "Probability of object moving laterally";
CM_ SG_ 130 VFC_Obj16A_ProbMovingLong "Probability of object moving longitudinally";
CM_ SG_ 130 VFC_Obj16A_ProbExist "Object existence probability";
CM_ SG_ 130 VFC_Obj16A_MeasSource "Bitfield for the measurement programs from which this object originates
Bit 0: MOD
Bit 1: PDET
Bit 2: OFT
Bit 3: OLS
Bit 4: RESERVED";
CM_ SG_ 130 VFC_Obj16A_Reliability "The bitfield shows if the signal quality is assumed to be sufficient for functions with safety target -no false positives-
Bit 0: DYNAMIC
Bit 1: SEMSEG_SURFACE
Bit 2: WDD_CRITICAL
Bit 3: GOD_CONFIRMED
Bit 4: RESTRICTED
Bit 5: ISO26262_SAFE";
CM_ SG_ 130 VFC_Obj16A_Measured "Indicator if the object detected is measured or predicted";
CM_ SG_ 130 VFC_Obj16A_VisibleView "The visible view of the detected object";
CM_ SG_ 130 VFC_Obj16A_ClassifiedView "The classified view of object to be used in connection with Heading angle";
CM_ SG_ 130 VFC_Obj16A_DirIndicator "The detected direction indicator lights";
CM_ SG_ 130 VFC_Obj16A_BrakeLight "The number of detected lights. More confident if more lights are detected.";
CM_ SG_ 132 VFC_Obj17A_CRC "CRC - Autosar E2E Profile 5";
CM_ SG_ 132 VFC_Obj17A_AliveCtr "Alive counter - Autosar E2E Profile 5";
CM_ SG_ 132 VFC_Obj17A_ProtBlockCtr "Protocol-Signal: Block-Counter";
CM_ SG_ 132 VFC_Obj17A_ID "Unique Object ID";
CM_ SG_ 132 VFC_Obj17A_Type "Classification of the object";
CM_ SG_ 132 VFC_Obj17A_TypeProb "Probability of the classified object type";
CM_ SG_ 132 VFC_Obj17A_Dx "Object distance in longitudinal direction";
CM_ SG_ 132 VFC_Obj17A_Dy "Object distance in lateral direction";
CM_ SG_ 132 VFC_Obj17A_Vx "Object velocity in longitudinal direction";
CM_ SG_ 132 VFC_Obj17A_Vy "Object velocity in lateral direction";
CM_ SG_ 132 VFC_Obj17A_Ax "Object acceleration in longitudinal direction";
CM_ SG_ 132 VFC_Obj17A_Ay "Object acceleration in lateral direction";
CM_ SG_ 132 VFC_Obj17A_DxStdDev "Standard deviation of Object distance in longitudinal direction";
CM_ SG_ 132 VFC_Obj17A_DyStdDev "Standard deviation of Object distance in lateral direction";
CM_ SG_ 132 VFC_Obj17A_VxStdDev "Standard deviation of Object velocity in longitudinal direction";
CM_ SG_ 132 VFC_Obj17A_VyStdDev "Standard deviation of Object velocity in lateral direction";
CM_ SG_ 132 VFC_Obj17A_AxStdDev "Standard deviation of Object acceleration in longitudinal direction";
CM_ SG_ 132 VFC_Obj17A_AyStdDev "Standard deviation of Object acceleration in lateral direction";
CM_ SG_ 132 VFC_Obj17A_Length "Length of the object";
CM_ SG_ 132 VFC_Obj17A_Width "Width of the object";
CM_ SG_ 132 VFC_Obj17A_Height "Height of the object";
CM_ SG_ 132 VFC_Obj17A_LengthStdDev "Standard deviation of object length";
CM_ SG_ 132 VFC_Obj17A_WidthStdDev "Standard deviation of object width";
CM_ SG_ 132 VFC_Obj17A_HeightStdDev "Standard deviation of object height";
CM_ SG_ 132 VFC_Obj17A_EdgeLeft "In ACCS coordinates; corresponds to tan(viewing angle of left object edge)";
CM_ SG_ 132 VFC_Obj17A_EdgeMid "In ACCS coordinates; corresponds to tan(viewing angle of middle object edge)";
CM_ SG_ 132 VFC_Obj17A_EdgeRight "In ACCS coordinates; corresponds to tan(viewing angle of right object edge)";
CM_ SG_ 132 VFC_Obj17A_EdgeTop "In ACCS coordinates; corresponds to tan(viewing angle of top object edge)";
CM_ SG_ 132 VFC_Obj17A_EdgeBottom "In ACCS coordinates; corresponds to tan(viewing angle of bottom object edge)";
CM_ SG_ 132 VFC_Obj17A_EdgeLeftStdDev "Standard deviation of the ACCS left object edge";
CM_ SG_ 132 VFC_Obj17A_EdgeMidStdDev "Standard deviation of the ACCS middle object edge";
CM_ SG_ 132 VFC_Obj17A_EdgeRightStdDev "Standard deviation of the ACCS right object edge";
CM_ SG_ 132 VFC_Obj17A_EdgeTopStdDev "Standard deviation of the ACCS top object edge";
CM_ SG_ 132 VFC_Obj17A_EdgeBottomStdDev "Standard deviation of the ACCS bottom object edge";
CM_ SG_ 132 VFC_Obj17A_NormVx "Normalised Object velocity in longitudinal direction";
CM_ SG_ 132 VFC_Obj17A_NormAx "Normalised Object acceleration in longitudinal direction";
CM_ SG_ 132 VFC_Obj17A_NormVyEdgeLeft "Normalised velocity of the ACCS left object edge in lateral direction";
CM_ SG_ 132 VFC_Obj17A_NormVyEdgeRight "Normalised velocity of the ACCS right object edge in lateral direction";
CM_ SG_ 132 VFC_Obj17A_NormVxStdDev "Standard deviation of Normalised Object velocity in longitudinal direction";
CM_ SG_ 132 VFC_Obj17A_NormAxStdDev "Standard deviation of Normalised Object acceleration in longitudinal direction";
CM_ SG_ 132 VFC_Obj17A_NormVyEdgeLeftStdDev "Standard deviation of Normalised velocity of the ACCS left object edge in lateral direction";
CM_ SG_ 132 VFC_Obj17A_NormVyEdgeRightStdDev "Standard deviation of Normalised velocity of the ACCS right object edge in lateral direction";
CM_ SG_ 132 VFC_Obj17A_ScaleChange "A scale change of of the detected object";
CM_ SG_ 132 VFC_Obj17A_ScaleChngStdDev "Standard deviation of object scale change";
CM_ SG_ 132 VFC_Obj17A_HeadingAngle "Heading angle of the object";
CM_ SG_ 132 VFC_Obj17A_HeadingAngleStdDev "Standard deviation of object Heading angle";
CM_ SG_ 132 VFC_Obj17A_HeadOrientation "The orientation of the head of cyclists or pedestrians that are detected";
CM_ SG_ 132 VFC_Obj17A_CompletelyInImg "indicator if the object is completely measured in the image";
CM_ SG_ 132 VFC_Obj17A_ProbMovingLat "Probability of object moving laterally";
CM_ SG_ 132 VFC_Obj17A_ProbMovingLong "Probability of object moving longitudinally";
CM_ SG_ 132 VFC_Obj17A_ProbExist "Object existence probability";
CM_ SG_ 132 VFC_Obj17A_MeasSource "Bitfield for the measurement programs from which this object originates
Bit 0: MOD
Bit 1: PDET
Bit 2: OFT
Bit 3: OLS
Bit 4: RESERVED";
CM_ SG_ 132 VFC_Obj17A_Reliability "The bitfield shows if the signal quality is assumed to be sufficient for functions with safety target -no false positives-
Bit 0: DYNAMIC
Bit 1: SEMSEG_SURFACE
Bit 2: WDD_CRITICAL
Bit 3: GOD_CONFIRMED
Bit 4: RESTRICTED
Bit 5: ISO26262_SAFE";
CM_ SG_ 132 VFC_Obj17A_Measured "Indicator if the object detected is measured or predicted";
CM_ SG_ 132 VFC_Obj17A_VisibleView "The visible view of the detected object";
CM_ SG_ 132 VFC_Obj17A_ClassifiedView "The classified view of object to be used in connection with Heading angle";
CM_ SG_ 132 VFC_Obj17A_DirIndicator "The detected direction indicator lights";
CM_ SG_ 132 VFC_Obj17A_BrakeLight "The number of detected lights. More confident if more lights are detected.";
CM_ SG_ 134 VFC_Obj18A_CRC "CRC - Autosar E2E Profile 5";
CM_ SG_ 134 VFC_Obj18A_AliveCtr "Alive counter - Autosar E2E Profile 5";
CM_ SG_ 134 VFC_Obj18A_ProtBlockCtr "Protocol-Signal: Block-Counter";
CM_ SG_ 134 VFC_Obj18A_ID "Unique Object ID";
CM_ SG_ 134 VFC_Obj18A_Type "Classification of the object";
CM_ SG_ 134 VFC_Obj18A_TypeProb "Probability of the classified object type";
CM_ SG_ 134 VFC_Obj18A_Dx "Object distance in longitudinal direction";
CM_ SG_ 134 VFC_Obj18A_Dy "Object distance in lateral direction";
CM_ SG_ 134 VFC_Obj18A_Vx "Object velocity in longitudinal direction";
CM_ SG_ 134 VFC_Obj18A_Vy "Object velocity in lateral direction";
CM_ SG_ 134 VFC_Obj18A_Ax "Object acceleration in longitudinal direction";
CM_ SG_ 134 VFC_Obj18A_Ay "Object acceleration in lateral direction";
CM_ SG_ 134 VFC_Obj18A_DxStdDev "Standard deviation of Object distance in longitudinal direction";
CM_ SG_ 134 VFC_Obj18A_DyStdDev "Standard deviation of Object distance in lateral direction";
CM_ SG_ 134 VFC_Obj18A_VxStdDev "Standard deviation of Object velocity in longitudinal direction";
CM_ SG_ 134 VFC_Obj18A_VyStdDev "Standard deviation of Object velocity in lateral direction";
CM_ SG_ 134 VFC_Obj18A_AxStdDev "Standard deviation of Object acceleration in longitudinal direction";
CM_ SG_ 134 VFC_Obj18A_AyStdDev "Standard deviation of Object acceleration in lateral direction";
CM_ SG_ 134 VFC_Obj18A_Length "Length of the object";
CM_ SG_ 134 VFC_Obj18A_Width "Width of the object";
CM_ SG_ 134 VFC_Obj18A_Height "Height of the object";
CM_ SG_ 134 VFC_Obj18A_LengthStdDev "Standard deviation of object length";
CM_ SG_ 134 VFC_Obj18A_WidthStdDev "Standard deviation of object width";
CM_ SG_ 134 VFC_Obj18A_HeightStdDev "Standard deviation of object height";
CM_ SG_ 134 VFC_Obj18A_EdgeLeft "In ACCS coordinates; corresponds to tan(viewing angle of left object edge)";
CM_ SG_ 134 VFC_Obj18A_EdgeMid "In ACCS coordinates; corresponds to tan(viewing angle of middle object edge)";
CM_ SG_ 134 VFC_Obj18A_EdgeRight "In ACCS coordinates; corresponds to tan(viewing angle of right object edge)";
CM_ SG_ 134 VFC_Obj18A_EdgeTop "In ACCS coordinates; corresponds to tan(viewing angle of top object edge)";
CM_ SG_ 134 VFC_Obj18A_EdgeBottom "In ACCS coordinates; corresponds to tan(viewing angle of bottom object edge)";
CM_ SG_ 134 VFC_Obj18A_EdgeLeftStdDev "Standard deviation of the ACCS left object edge";
CM_ SG_ 134 VFC_Obj18A_EdgeMidStdDev "Standard deviation of the ACCS middle object edge";
CM_ SG_ 134 VFC_Obj18A_EdgeRightStdDev "Standard deviation of the ACCS right object edge";
CM_ SG_ 134 VFC_Obj18A_EdgeTopStdDev "Standard deviation of the ACCS top object edge";
CM_ SG_ 134 VFC_Obj18A_EdgeBottomStdDev "Standard deviation of the ACCS bottom object edge";
CM_ SG_ 134 VFC_Obj18A_NormVx "Normalised Object velocity in longitudinal direction";
CM_ SG_ 134 VFC_Obj18A_NormAx "Normalised Object acceleration in longitudinal direction";
CM_ SG_ 134 VFC_Obj18A_NormVyEdgeLeft "Normalised velocity of the ACCS left object edge in lateral direction";
CM_ SG_ 134 VFC_Obj18A_NormVyEdgeRight "Normalised velocity of the ACCS right object edge in lateral direction";
CM_ SG_ 134 VFC_Obj18A_NormVxStdDev "Standard deviation of Normalised Object velocity in longitudinal direction";
CM_ SG_ 134 VFC_Obj18A_NormAxStdDev "Standard deviation of Normalised Object acceleration in longitudinal direction";
CM_ SG_ 134 VFC_Obj18A_NormVyEdgeLeftStdDev "Standard deviation of Normalised velocity of the ACCS left object edge in lateral direction";
CM_ SG_ 134 VFC_Obj18A_NormVyEdgeRightStdDev "Standard deviation of Normalised velocity of the ACCS right object edge in lateral direction";
CM_ SG_ 134 VFC_Obj18A_ScaleChange "A scale change of of the detected object";
CM_ SG_ 134 VFC_Obj18A_ScaleChngStdDev "Standard deviation of object scale change";
CM_ SG_ 134 VFC_Obj18A_HeadingAngle "Heading angle of the object";
CM_ SG_ 134 VFC_Obj18A_HeadingAngleStdDev "Standard deviation of object Heading angle";
CM_ SG_ 134 VFC_Obj18A_HeadOrientation "The orientation of the head of cyclists or pedestrians that are detected";
CM_ SG_ 134 VFC_Obj18A_CompletelyInImg "indicator if the object is completely measured in the image";
CM_ SG_ 134 VFC_Obj18A_ProbMovingLat "Probability of object moving laterally";
CM_ SG_ 134 VFC_Obj18A_ProbMovingLong "Probability of object moving longitudinally";
CM_ SG_ 134 VFC_Obj18A_ProbExist "Object existence probability";
CM_ SG_ 134 VFC_Obj18A_MeasSource "Bitfield for the measurement programs from which this object originates
Bit 0: MOD
Bit 1: PDET
Bit 2: OFT
Bit 3: OLS
Bit 4: RESERVED";
CM_ SG_ 134 VFC_Obj18A_Reliability "The bitfield shows if the signal quality is assumed to be sufficient for functions with safety target -no false positives-
Bit 0: DYNAMIC
Bit 1: SEMSEG_SURFACE
Bit 2: WDD_CRITICAL
Bit 3: GOD_CONFIRMED
Bit 4: RESTRICTED
Bit 5: ISO26262_SAFE";
CM_ SG_ 134 VFC_Obj18A_Measured "Indicator if the object detected is measured or predicted";
CM_ SG_ 134 VFC_Obj18A_VisibleView "The visible view of the detected object";
CM_ SG_ 134 VFC_Obj18A_ClassifiedView "The classified view of object to be used in connection with Heading angle";
CM_ SG_ 134 VFC_Obj18A_DirIndicator "The detected direction indicator lights";
CM_ SG_ 134 VFC_Obj18A_BrakeLight "The number of detected lights. More confident if more lights are detected.";
CM_ SG_ 136 VFC_Obj19A_CRC "CRC - Autosar E2E Profile 5";
CM_ SG_ 136 VFC_Obj19A_AliveCtr "Alive counter - Autosar E2E Profile 5";
CM_ SG_ 136 VFC_Obj19A_ProtBlockCtr "Protocol-Signal: Block-Counter";
CM_ SG_ 136 VFC_Obj19A_ID "Unique Object ID";
CM_ SG_ 136 VFC_Obj19A_Type "Classification of the object";
CM_ SG_ 136 VFC_Obj19A_TypeProb "Probability of the classified object type";
CM_ SG_ 136 VFC_Obj19A_Dx "Object distance in longitudinal direction";
CM_ SG_ 136 VFC_Obj19A_Dy "Object distance in lateral direction";
CM_ SG_ 136 VFC_Obj19A_Vx "Object velocity in longitudinal direction";
CM_ SG_ 136 VFC_Obj19A_Vy "Object velocity in lateral direction";
CM_ SG_ 136 VFC_Obj19A_Ax "Object acceleration in longitudinal direction";
CM_ SG_ 136 VFC_Obj19A_Ay "Object acceleration in lateral direction";
CM_ SG_ 136 VFC_Obj19A_DxStdDev "Standard deviation of Object distance in longitudinal direction";
CM_ SG_ 136 VFC_Obj19A_DyStdDev "Standard deviation of Object distance in lateral direction";
CM_ SG_ 136 VFC_Obj19A_VxStdDev "Standard deviation of Object velocity in longitudinal direction";
CM_ SG_ 136 VFC_Obj19A_VyStdDev "Standard deviation of Object velocity in lateral direction";
CM_ SG_ 136 VFC_Obj19A_AxStdDev "Standard deviation of Object acceleration in longitudinal direction";
CM_ SG_ 136 VFC_Obj19A_AyStdDev "Standard deviation of Object acceleration in lateral direction";
CM_ SG_ 136 VFC_Obj19A_Length "Length of the object";
CM_ SG_ 136 VFC_Obj19A_Width "Width of the object";
CM_ SG_ 136 VFC_Obj19A_Height "Height of the object";
CM_ SG_ 136 VFC_Obj19A_LengthStdDev "Standard deviation of object length";
CM_ SG_ 136 VFC_Obj19A_WidthStdDev "Standard deviation of object width";
CM_ SG_ 136 VFC_Obj19A_HeightStdDev "Standard deviation of object height";
CM_ SG_ 136 VFC_Obj19A_EdgeLeft "In ACCS coordinates; corresponds to tan(viewing angle of left object edge)";
CM_ SG_ 136 VFC_Obj19A_EdgeMid "In ACCS coordinates; corresponds to tan(viewing angle of middle object edge)";
CM_ SG_ 136 VFC_Obj19A_EdgeRight "In ACCS coordinates; corresponds to tan(viewing angle of right object edge)";
CM_ SG_ 136 VFC_Obj19A_EdgeTop "In ACCS coordinates; corresponds to tan(viewing angle of top object edge)";
CM_ SG_ 136 VFC_Obj19A_EdgeBottom "In ACCS coordinates; corresponds to tan(viewing angle of bottom object edge)";
CM_ SG_ 136 VFC_Obj19A_EdgeLeftStdDev "Standard deviation of the ACCS left object edge";
CM_ SG_ 136 VFC_Obj19A_EdgeMidStdDev "Standard deviation of the ACCS middle object edge";
CM_ SG_ 136 VFC_Obj19A_EdgeRightStdDev "Standard deviation of the ACCS right object edge";
CM_ SG_ 136 VFC_Obj19A_EdgeTopStdDev "Standard deviation of the ACCS top object edge";
CM_ SG_ 136 VFC_Obj19A_EdgeBottomStdDev "Standard deviation of the ACCS bottom object edge";
CM_ SG_ 136 VFC_Obj19A_NormVx "Normalised Object velocity in longitudinal direction";
CM_ SG_ 136 VFC_Obj19A_NormAx "Normalised Object acceleration in longitudinal direction";
CM_ SG_ 136 VFC_Obj19A_NormVyEdgeLeft "Normalised velocity of the ACCS left object edge in lateral direction";
CM_ SG_ 136 VFC_Obj19A_NormVyEdgeRight "Normalised velocity of the ACCS right object edge in lateral direction";
CM_ SG_ 136 VFC_Obj19A_NormVxStdDev "Standard deviation of Normalised Object velocity in longitudinal direction";
CM_ SG_ 136 VFC_Obj19A_NormAxStdDev "Standard deviation of Normalised Object acceleration in longitudinal direction";
CM_ SG_ 136 VFC_Obj19A_NormVyEdgeLeftStdDev "Standard deviation of Normalised velocity of the ACCS left object edge in lateral direction";
CM_ SG_ 136 VFC_Obj19A_NormVyEdgeRightStdDev "Standard deviation of Normalised velocity of the ACCS right object edge in lateral direction";
CM_ SG_ 136 VFC_Obj19A_ScaleChange "A scale change of of the detected object";
CM_ SG_ 136 VFC_Obj19A_ScaleChngStdDev "Standard deviation of object scale change";
CM_ SG_ 136 VFC_Obj19A_HeadingAngle "Heading angle of the object";
CM_ SG_ 136 VFC_Obj19A_HeadingAngleStdDev "Standard deviation of object Heading angle";
CM_ SG_ 136 VFC_Obj19A_HeadOrientation "The orientation of the head of cyclists or pedestrians that are detected";
CM_ SG_ 136 VFC_Obj19A_CompletelyInImg "indicator if the object is completely measured in the image";
CM_ SG_ 136 VFC_Obj19A_ProbMovingLat "Probability of object moving laterally";
CM_ SG_ 136 VFC_Obj19A_ProbMovingLong "Probability of object moving longitudinally";
CM_ SG_ 136 VFC_Obj19A_ProbExist "Object existence probability";
CM_ SG_ 136 VFC_Obj19A_MeasSource "Bitfield for the measurement programs from which this object originates
Bit 0: MOD
Bit 1: PDET
Bit 2: OFT
Bit 3: OLS
Bit 4: RESERVED";
CM_ SG_ 136 VFC_Obj19A_Reliability "The bitfield shows if the signal quality is assumed to be sufficient for functions with safety target -no false positives-
Bit 0: DYNAMIC
Bit 1: SEMSEG_SURFACE
Bit 2: WDD_CRITICAL
Bit 3: GOD_CONFIRMED
Bit 4: RESTRICTED
Bit 5: ISO26262_SAFE";
CM_ SG_ 136 VFC_Obj19A_Measured "Indicator if the object detected is measured or predicted";
CM_ SG_ 136 VFC_Obj19A_VisibleView "The visible view of the detected object";
CM_ SG_ 136 VFC_Obj19A_ClassifiedView "The classified view of object to be used in connection with Heading angle";
CM_ SG_ 136 VFC_Obj19A_DirIndicator "The detected direction indicator lights";
CM_ SG_ 136 VFC_Obj19A_BrakeLight "The number of detected lights. More confident if more lights are detected.";
CM_ SG_ 138 VFC_Obj20A_CRC "CRC - Autosar E2E Profile 5";
CM_ SG_ 138 VFC_Obj20A_AliveCtr "Alive counter - Autosar E2E Profile 5";
CM_ SG_ 138 VFC_Obj20A_ProtBlockCtr "Protocol-Signal: Block-Counter";
CM_ SG_ 138 VFC_Obj20A_ID "Unique Object ID";
CM_ SG_ 138 VFC_Obj20A_Type "Classification of the object";
CM_ SG_ 138 VFC_Obj20A_TypeProb "Probability of the classified object type";
CM_ SG_ 138 VFC_Obj20A_Dx "Object distance in longitudinal direction";
CM_ SG_ 138 VFC_Obj20A_Dy "Object distance in lateral direction";
CM_ SG_ 138 VFC_Obj20A_Vx "Object velocity in longitudinal direction";
CM_ SG_ 138 VFC_Obj20A_Vy "Object velocity in lateral direction";
CM_ SG_ 138 VFC_Obj20A_Ax "Object acceleration in longitudinal direction";
CM_ SG_ 138 VFC_Obj20A_Ay "Object acceleration in lateral direction";
CM_ SG_ 138 VFC_Obj20A_DxStdDev "Standard deviation of Object distance in longitudinal direction";
CM_ SG_ 138 VFC_Obj20A_DyStdDev "Standard deviation of Object distance in lateral direction";
CM_ SG_ 138 VFC_Obj20A_VxStdDev "Standard deviation of Object velocity in longitudinal direction";
CM_ SG_ 138 VFC_Obj20A_VyStdDev "Standard deviation of Object velocity in lateral direction";
CM_ SG_ 138 VFC_Obj20A_AxStdDev "Standard deviation of Object acceleration in longitudinal direction";
CM_ SG_ 138 VFC_Obj20A_AyStdDev "Standard deviation of Object acceleration in lateral direction";
CM_ SG_ 138 VFC_Obj20A_Length "Length of the object";
CM_ SG_ 138 VFC_Obj20A_Width "Width of the object";
CM_ SG_ 138 VFC_Obj20A_Height "Height of the object";
CM_ SG_ 138 VFC_Obj20A_LengthStdDev "Standard deviation of object length";
CM_ SG_ 138 VFC_Obj20A_WidthStdDev "Standard deviation of object width";
CM_ SG_ 138 VFC_Obj20A_HeightStdDev "Standard deviation of object height";
CM_ SG_ 138 VFC_Obj20A_EdgeLeft "In ACCS coordinates; corresponds to tan(viewing angle of left object edge)";
CM_ SG_ 138 VFC_Obj20A_EdgeMid "In ACCS coordinates; corresponds to tan(viewing angle of middle object edge)";
CM_ SG_ 138 VFC_Obj20A_EdgeRight "In ACCS coordinates; corresponds to tan(viewing angle of right object edge)";
CM_ SG_ 138 VFC_Obj20A_EdgeTop "In ACCS coordinates; corresponds to tan(viewing angle of top object edge)";
CM_ SG_ 138 VFC_Obj20A_EdgeBottom "In ACCS coordinates; corresponds to tan(viewing angle of bottom object edge)";
CM_ SG_ 138 VFC_Obj20A_EdgeLeftStdDev "Standard deviation of the ACCS left object edge";
CM_ SG_ 138 VFC_Obj20A_EdgeMidStdDev "Standard deviation of the ACCS middle object edge";
CM_ SG_ 138 VFC_Obj20A_EdgeRightStdDev "Standard deviation of the ACCS right object edge";
CM_ SG_ 138 VFC_Obj20A_EdgeTopStdDev "Standard deviation of the ACCS top object edge";
CM_ SG_ 138 VFC_Obj20A_EdgeBottomStdDev "Standard deviation of the ACCS bottom object edge";
CM_ SG_ 138 VFC_Obj20A_NormVx "Normalised Object velocity in longitudinal direction";
CM_ SG_ 138 VFC_Obj20A_NormAx "Normalised Object acceleration in longitudinal direction";
CM_ SG_ 138 VFC_Obj20A_NormVyEdgeLeft "Normalised velocity of the ACCS left object edge in lateral direction";
CM_ SG_ 138 VFC_Obj20A_NormVyEdgeRight "Normalised velocity of the ACCS right object edge in lateral direction";
CM_ SG_ 138 VFC_Obj20A_NormVxStdDev "Standard deviation of Normalised Object velocity in longitudinal direction";
CM_ SG_ 138 VFC_Obj20A_NormAxStdDev "Standard deviation of Normalised Object acceleration in longitudinal direction";
CM_ SG_ 138 VFC_Obj20A_NormVyEdgeLeftStdDev "Standard deviation of Normalised velocity of the ACCS left object edge in lateral direction";
CM_ SG_ 138 VFC_Obj20A_NormVyEdgeRightStdDev "Standard deviation of Normalised velocity of the ACCS right object edge in lateral direction";
CM_ SG_ 138 VFC_Obj20A_ScaleChange "A scale change of of the detected object";
CM_ SG_ 138 VFC_Obj20A_ScaleChngStdDev "Standard deviation of object scale change";
CM_ SG_ 138 VFC_Obj20A_HeadingAngle "Heading angle of the object";
CM_ SG_ 138 VFC_Obj20A_HeadingAngleStdDev "Standard deviation of object Heading angle";
CM_ SG_ 138 VFC_Obj20A_HeadOrientation "The orientation of the head of cyclists or pedestrians that are detected";
CM_ SG_ 138 VFC_Obj20A_CompletelyInImg "indicator if the object is completely measured in the image";
CM_ SG_ 138 VFC_Obj20A_ProbMovingLat "Probability of object moving laterally";
CM_ SG_ 138 VFC_Obj20A_ProbMovingLong "Probability of object moving longitudinally";
CM_ SG_ 138 VFC_Obj20A_ProbExist "Object existence probability";
CM_ SG_ 138 VFC_Obj20A_MeasSource "Bitfield for the measurement programs from which this object originates
Bit 0: MOD
Bit 1: PDET
Bit 2: OFT
Bit 3: OLS
Bit 4: RESERVED";
CM_ SG_ 138 VFC_Obj20A_Reliability "The bitfield shows if the signal quality is assumed to be sufficient for functions with safety target -no false positives-
Bit 0: DYNAMIC
Bit 1: SEMSEG_SURFACE
Bit 2: WDD_CRITICAL
Bit 3: GOD_CONFIRMED
Bit 4: RESTRICTED
Bit 5: ISO26262_SAFE";
CM_ SG_ 138 VFC_Obj20A_Measured "Indicator if the object detected is measured or predicted";
CM_ SG_ 138 VFC_Obj20A_VisibleView "The visible view of the detected object";
CM_ SG_ 138 VFC_Obj20A_ClassifiedView "The classified view of object to be used in connection with Heading angle";
CM_ SG_ 138 VFC_Obj20A_DirIndicator "The detected direction indicator lights";
CM_ SG_ 138 VFC_Obj20A_BrakeLight "The number of detected lights. More confident if more lights are detected.";
CM_ SG_ 140 VFC_Obj21A_CRC "CRC - Autosar E2E Profile 5";
CM_ SG_ 140 VFC_Obj21A_AliveCtr "Alive counter - Autosar E2E Profile 5";
CM_ SG_ 140 VFC_Obj21A_ProtBlockCtr "Protocol-Signal: Block-Counter";
CM_ SG_ 140 VFC_Obj21A_ID "Unique Object ID";
CM_ SG_ 140 VFC_Obj21A_Type "Classification of the object";
CM_ SG_ 140 VFC_Obj21A_TypeProb "Probability of the classified object type";
CM_ SG_ 140 VFC_Obj21A_Dx "Object distance in longitudinal direction";
CM_ SG_ 140 VFC_Obj21A_Dy "Object distance in lateral direction";
CM_ SG_ 140 VFC_Obj21A_Vx "Object velocity in longitudinal direction";
CM_ SG_ 140 VFC_Obj21A_Vy "Object velocity in lateral direction";
CM_ SG_ 140 VFC_Obj21A_Ax "Object acceleration in longitudinal direction";
CM_ SG_ 140 VFC_Obj21A_Ay "Object acceleration in lateral direction";
CM_ SG_ 140 VFC_Obj21A_DxStdDev "Standard deviation of Object distance in longitudinal direction";
CM_ SG_ 140 VFC_Obj21A_DyStdDev "Standard deviation of Object distance in lateral direction";
CM_ SG_ 140 VFC_Obj21A_VxStdDev "Standard deviation of Object velocity in longitudinal direction";
CM_ SG_ 140 VFC_Obj21A_VyStdDev "Standard deviation of Object velocity in lateral direction";
CM_ SG_ 140 VFC_Obj21A_AxStdDev "Standard deviation of Object acceleration in longitudinal direction";
CM_ SG_ 140 VFC_Obj21A_AyStdDev "Standard deviation of Object acceleration in lateral direction";
CM_ SG_ 140 VFC_Obj21A_Length "Length of the object";
CM_ SG_ 140 VFC_Obj21A_Width "Width of the object";
CM_ SG_ 140 VFC_Obj21A_Height "Height of the object";
CM_ SG_ 140 VFC_Obj21A_LengthStdDev "Standard deviation of object length";
CM_ SG_ 140 VFC_Obj21A_WidthStdDev "Standard deviation of object width";
CM_ SG_ 140 VFC_Obj21A_HeightStdDev "Standard deviation of object height";
CM_ SG_ 140 VFC_Obj21A_EdgeLeft "In ACCS coordinates; corresponds to tan(viewing angle of left object edge)";
CM_ SG_ 140 VFC_Obj21A_EdgeMid "In ACCS coordinates; corresponds to tan(viewing angle of middle object edge)";
CM_ SG_ 140 VFC_Obj21A_EdgeRight "In ACCS coordinates; corresponds to tan(viewing angle of right object edge)";
CM_ SG_ 140 VFC_Obj21A_EdgeTop "In ACCS coordinates; corresponds to tan(viewing angle of top object edge)";
CM_ SG_ 140 VFC_Obj21A_EdgeBottom "In ACCS coordinates; corresponds to tan(viewing angle of bottom object edge)";
CM_ SG_ 140 VFC_Obj21A_EdgeLeftStdDev "Standard deviation of the ACCS left object edge";
CM_ SG_ 140 VFC_Obj21A_EdgeMidStdDev "Standard deviation of the ACCS middle object edge";
CM_ SG_ 140 VFC_Obj21A_EdgeRightStdDev "Standard deviation of the ACCS right object edge";
CM_ SG_ 140 VFC_Obj21A_EdgeTopStdDev "Standard deviation of the ACCS top object edge";
CM_ SG_ 140 VFC_Obj21A_EdgeBottomStdDev "Standard deviation of the ACCS bottom object edge";
CM_ SG_ 140 VFC_Obj21A_NormVx "Normalised Object velocity in longitudinal direction";
CM_ SG_ 140 VFC_Obj21A_NormAx "Normalised Object acceleration in longitudinal direction";
CM_ SG_ 140 VFC_Obj21A_NormVyEdgeLeft "Normalised velocity of the ACCS left object edge in lateral direction";
CM_ SG_ 140 VFC_Obj21A_NormVyEdgeRight "Normalised velocity of the ACCS right object edge in lateral direction";
CM_ SG_ 140 VFC_Obj21A_NormVxStdDev "Standard deviation of Normalised Object velocity in longitudinal direction";
CM_ SG_ 140 VFC_Obj21A_NormAxStdDev "Standard deviation of Normalised Object acceleration in longitudinal direction";
CM_ SG_ 140 VFC_Obj21A_NormVyEdgeLeftStdDev "Standard deviation of Normalised velocity of the ACCS left object edge in lateral direction";
CM_ SG_ 140 VFC_Obj21A_NormVyEdgeRightStdDev "Standard deviation of Normalised velocity of the ACCS right object edge in lateral direction";
CM_ SG_ 140 VFC_Obj21A_ScaleChange "A scale change of of the detected object";
CM_ SG_ 140 VFC_Obj21A_ScaleChngStdDev "Standard deviation of object scale change";
CM_ SG_ 140 VFC_Obj21A_HeadingAngle "Heading angle of the object";
CM_ SG_ 140 VFC_Obj21A_HeadingAngleStdDev "Standard deviation of object Heading angle";
CM_ SG_ 140 VFC_Obj21A_HeadOrientation "The orientation of the head of cyclists or pedestrians that are detected";
CM_ SG_ 140 VFC_Obj21A_CompletelyInImg "indicator if the object is completely measured in the image";
CM_ SG_ 140 VFC_Obj21A_ProbMovingLat "Probability of object moving laterally";
CM_ SG_ 140 VFC_Obj21A_ProbMovingLong "Probability of object moving longitudinally";
CM_ SG_ 140 VFC_Obj21A_ProbExist "Object existence probability";
CM_ SG_ 140 VFC_Obj21A_MeasSource "Bitfield for the measurement programs from which this object originates
Bit 0: MOD
Bit 1: PDET
Bit 2: OFT
Bit 3: OLS
Bit 4: RESERVED";
CM_ SG_ 140 VFC_Obj21A_Reliability "The bitfield shows if the signal quality is assumed to be sufficient for functions with safety target -no false positives-
Bit 0: DYNAMIC
Bit 1: SEMSEG_SURFACE
Bit 2: WDD_CRITICAL
Bit 3: GOD_CONFIRMED
Bit 4: RESTRICTED
Bit 5: ISO26262_SAFE";
CM_ SG_ 140 VFC_Obj21A_Measured "Indicator if the object detected is measured or predicted";
CM_ SG_ 140 VFC_Obj21A_VisibleView "The visible view of the detected object";
CM_ SG_ 140 VFC_Obj21A_ClassifiedView "The classified view of object to be used in connection with Heading angle";
CM_ SG_ 140 VFC_Obj21A_DirIndicator "The detected direction indicator lights";
CM_ SG_ 140 VFC_Obj21A_BrakeLight "The number of detected lights. More confident if more lights are detected.";
CM_ SG_ 142 VFC_Obj22A_CRC "CRC - Autosar E2E Profile 5";
CM_ SG_ 142 VFC_Obj22A_AliveCtr "Alive counter - Autosar E2E Profile 5";
CM_ SG_ 142 VFC_Obj22A_ProtBlockCtr "Protocol-Signal: Block-Counter";
CM_ SG_ 142 VFC_Obj22A_ID "Unique Object ID";
CM_ SG_ 142 VFC_Obj22A_Type "Classification of the object";
CM_ SG_ 142 VFC_Obj22A_TypeProb "Probability of the classified object type";
CM_ SG_ 142 VFC_Obj22A_Dx "Object distance in longitudinal direction";
CM_ SG_ 142 VFC_Obj22A_Dy "Object distance in lateral direction";
CM_ SG_ 142 VFC_Obj22A_Vx "Object velocity in longitudinal direction";
CM_ SG_ 142 VFC_Obj22A_Vy "Object velocity in lateral direction";
CM_ SG_ 142 VFC_Obj22A_Ax "Object acceleration in longitudinal direction";
CM_ SG_ 142 VFC_Obj22A_Ay "Object acceleration in lateral direction";
CM_ SG_ 142 VFC_Obj22A_DxStdDev "Standard deviation of Object distance in longitudinal direction";
CM_ SG_ 142 VFC_Obj22A_DyStdDev "Standard deviation of Object distance in lateral direction";
CM_ SG_ 142 VFC_Obj22A_VxStdDev "Standard deviation of Object velocity in longitudinal direction";
CM_ SG_ 142 VFC_Obj22A_VyStdDev "Standard deviation of Object velocity in lateral direction";
CM_ SG_ 142 VFC_Obj22A_AxStdDev "Standard deviation of Object acceleration in longitudinal direction";
CM_ SG_ 142 VFC_Obj22A_AyStdDev "Standard deviation of Object acceleration in lateral direction";
CM_ SG_ 142 VFC_Obj22A_Length "Length of the object";
CM_ SG_ 142 VFC_Obj22A_Width "Width of the object";
CM_ SG_ 142 VFC_Obj22A_Height "Height of the object";
CM_ SG_ 142 VFC_Obj22A_LengthStdDev "Standard deviation of object length";
CM_ SG_ 142 VFC_Obj22A_WidthStdDev "Standard deviation of object width";
CM_ SG_ 142 VFC_Obj22A_HeightStdDev "Standard deviation of object height";
CM_ SG_ 142 VFC_Obj22A_EdgeLeft "In ACCS coordinates; corresponds to tan(viewing angle of left object edge)";
CM_ SG_ 142 VFC_Obj22A_EdgeMid "In ACCS coordinates; corresponds to tan(viewing angle of middle object edge)";
CM_ SG_ 142 VFC_Obj22A_EdgeRight "In ACCS coordinates; corresponds to tan(viewing angle of right object edge)";
CM_ SG_ 142 VFC_Obj22A_EdgeTop "In ACCS coordinates; corresponds to tan(viewing angle of top object edge)";
CM_ SG_ 142 VFC_Obj22A_EdgeBottom "In ACCS coordinates; corresponds to tan(viewing angle of bottom object edge)";
CM_ SG_ 142 VFC_Obj22A_EdgeLeftStdDev "Standard deviation of the ACCS left object edge";
CM_ SG_ 142 VFC_Obj22A_EdgeMidStdDev "Standard deviation of the ACCS middle object edge";
CM_ SG_ 142 VFC_Obj22A_EdgeRightStdDev "Standard deviation of the ACCS right object edge";
CM_ SG_ 142 VFC_Obj22A_EdgeTopStdDev "Standard deviation of the ACCS top object edge";
CM_ SG_ 142 VFC_Obj22A_EdgeBottomStdDev "Standard deviation of the ACCS bottom object edge";
CM_ SG_ 142 VFC_Obj22A_NormVx "Normalised Object velocity in longitudinal direction";
CM_ SG_ 142 VFC_Obj22A_NormAx "Normalised Object acceleration in longitudinal direction";
CM_ SG_ 142 VFC_Obj22A_NormVyEdgeLeft "Normalised velocity of the ACCS left object edge in lateral direction";
CM_ SG_ 142 VFC_Obj22A_NormVyEdgeRight "Normalised velocity of the ACCS right object edge in lateral direction";
CM_ SG_ 142 VFC_Obj22A_NormVxStdDev "Standard deviation of Normalised Object velocity in longitudinal direction";
CM_ SG_ 142 VFC_Obj22A_NormAxStdDev "Standard deviation of Normalised Object acceleration in longitudinal direction";
CM_ SG_ 142 VFC_Obj22A_NormVyEdgeLeftStdDev "Standard deviation of Normalised velocity of the ACCS left object edge in lateral direction";
CM_ SG_ 142 VFC_Obj22A_NormVyEdgeRightStdDev "Standard deviation of Normalised velocity of the ACCS right object edge in lateral direction";
CM_ SG_ 142 VFC_Obj22A_ScaleChange "A scale change of of the detected object";
CM_ SG_ 142 VFC_Obj22A_ScaleChngStdDev "Standard deviation of object scale change";
CM_ SG_ 142 VFC_Obj22A_HeadingAngle "Heading angle of the object";
CM_ SG_ 142 VFC_Obj22A_HeadingAngleStdDev "Standard deviation of object Heading angle";
CM_ SG_ 142 VFC_Obj22A_HeadOrientation "The orientation of the head of cyclists or pedestrians that are detected";
CM_ SG_ 142 VFC_Obj22A_CompletelyInImg "indicator if the object is completely measured in the image";
CM_ SG_ 142 VFC_Obj22A_ProbMovingLat "Probability of object moving laterally";
CM_ SG_ 142 VFC_Obj22A_ProbMovingLong "Probability of object moving longitudinally";
CM_ SG_ 142 VFC_Obj22A_ProbExist "Object existence probability";
CM_ SG_ 142 VFC_Obj22A_MeasSource "Bitfield for the measurement programs from which this object originates
Bit 0: MOD
Bit 1: PDET
Bit 2: OFT
Bit 3: OLS
Bit 4: RESERVED";
CM_ SG_ 142 VFC_Obj22A_Reliability "The bitfield shows if the signal quality is assumed to be sufficient for functions with safety target -no false positives-
Bit 0: DYNAMIC
Bit 1: SEMSEG_SURFACE
Bit 2: WDD_CRITICAL
Bit 3: GOD_CONFIRMED
Bit 4: RESTRICTED
Bit 5: ISO26262_SAFE";
CM_ SG_ 142 VFC_Obj22A_Measured "Indicator if the object detected is measured or predicted";
CM_ SG_ 142 VFC_Obj22A_VisibleView "The visible view of the detected object";
CM_ SG_ 142 VFC_Obj22A_ClassifiedView "The classified view of object to be used in connection with Heading angle";
CM_ SG_ 142 VFC_Obj22A_DirIndicator "The detected direction indicator lights";
CM_ SG_ 142 VFC_Obj22A_BrakeLight "The number of detected lights. More confident if more lights are detected.";
CM_ SG_ 144 VFC_Obj23A_CRC "CRC - Autosar E2E Profile 5";
CM_ SG_ 144 VFC_Obj23A_AliveCtr "Alive counter - Autosar E2E Profile 5";
CM_ SG_ 144 VFC_Obj23A_ProtBlockCtr "Protocol-Signal: Block-Counter";
CM_ SG_ 144 VFC_Obj23A_ID "Unique Object ID";
CM_ SG_ 144 VFC_Obj23A_Type "Classification of the object";
CM_ SG_ 144 VFC_Obj23A_TypeProb "Probability of the classified object type";
CM_ SG_ 144 VFC_Obj23A_Dx "Object distance in longitudinal direction";
CM_ SG_ 144 VFC_Obj23A_Dy "Object distance in lateral direction";
CM_ SG_ 144 VFC_Obj23A_Vx "Object velocity in longitudinal direction";
CM_ SG_ 144 VFC_Obj23A_Vy "Object velocity in lateral direction";
CM_ SG_ 144 VFC_Obj23A_Ax "Object acceleration in longitudinal direction";
CM_ SG_ 144 VFC_Obj23A_Ay "Object acceleration in lateral direction";
CM_ SG_ 144 VFC_Obj23A_DxStdDev "Standard deviation of Object distance in longitudinal direction";
CM_ SG_ 144 VFC_Obj23A_DyStdDev "Standard deviation of Object distance in lateral direction";
CM_ SG_ 144 VFC_Obj23A_VxStdDev "Standard deviation of Object velocity in longitudinal direction";
CM_ SG_ 144 VFC_Obj23A_VyStdDev "Standard deviation of Object velocity in lateral direction";
CM_ SG_ 144 VFC_Obj23A_AxStdDev "Standard deviation of Object acceleration in longitudinal direction";
CM_ SG_ 144 VFC_Obj23A_AyStdDev "Standard deviation of Object acceleration in lateral direction";
CM_ SG_ 144 VFC_Obj23A_Length "Length of the object";
CM_ SG_ 144 VFC_Obj23A_Width "Width of the object";
CM_ SG_ 144 VFC_Obj23A_Height "Height of the object";
CM_ SG_ 144 VFC_Obj23A_LengthStdDev "Standard deviation of object length";
CM_ SG_ 144 VFC_Obj23A_WidthStdDev "Standard deviation of object width";
CM_ SG_ 144 VFC_Obj23A_HeightStdDev "Standard deviation of object height";
CM_ SG_ 144 VFC_Obj23A_EdgeLeft "In ACCS coordinates; corresponds to tan(viewing angle of left object edge)";
CM_ SG_ 144 VFC_Obj23A_EdgeMid "In ACCS coordinates; corresponds to tan(viewing angle of middle object edge)";
CM_ SG_ 144 VFC_Obj23A_EdgeRight "In ACCS coordinates; corresponds to tan(viewing angle of right object edge)";
CM_ SG_ 144 VFC_Obj23A_EdgeTop "In ACCS coordinates; corresponds to tan(viewing angle of top object edge)";
CM_ SG_ 144 VFC_Obj23A_EdgeBottom "In ACCS coordinates; corresponds to tan(viewing angle of bottom object edge)";
CM_ SG_ 144 VFC_Obj23A_EdgeLeftStdDev "Standard deviation of the ACCS left object edge";
CM_ SG_ 144 VFC_Obj23A_EdgeMidStdDev "Standard deviation of the ACCS middle object edge";
CM_ SG_ 144 VFC_Obj23A_EdgeRightStdDev "Standard deviation of the ACCS right object edge";
CM_ SG_ 144 VFC_Obj23A_EdgeTopStdDev "Standard deviation of the ACCS top object edge";
CM_ SG_ 144 VFC_Obj23A_EdgeBottomStdDev "Standard deviation of the ACCS bottom object edge";
CM_ SG_ 144 VFC_Obj23A_NormVx "Normalised Object velocity in longitudinal direction";
CM_ SG_ 144 VFC_Obj23A_NormAx "Normalised Object acceleration in longitudinal direction";
CM_ SG_ 144 VFC_Obj23A_NormVyEdgeLeft "Normalised velocity of the ACCS left object edge in lateral direction";
CM_ SG_ 144 VFC_Obj23A_NormVyEdgeRight "Normalised velocity of the ACCS right object edge in lateral direction";
CM_ SG_ 144 VFC_Obj23A_NormVxStdDev "Standard deviation of Normalised Object velocity in longitudinal direction";
CM_ SG_ 144 VFC_Obj23A_NormAxStdDev "Standard deviation of Normalised Object acceleration in longitudinal direction";
CM_ SG_ 144 VFC_Obj23A_NormVyEdgeLeftStdDev "Standard deviation of Normalised velocity of the ACCS left object edge in lateral direction";
CM_ SG_ 144 VFC_Obj23A_NormVyEdgeRightStdDev "Standard deviation of Normalised velocity of the ACCS right object edge in lateral direction";
CM_ SG_ 144 VFC_Obj23A_ScaleChange "A scale change of of the detected object";
CM_ SG_ 144 VFC_Obj23A_ScaleChngStdDev "Standard deviation of object scale change";
CM_ SG_ 144 VFC_Obj23A_HeadingAngle "Heading angle of the object";
CM_ SG_ 144 VFC_Obj23A_HeadingAngleStdDev "Standard deviation of object Heading angle";
CM_ SG_ 144 VFC_Obj23A_HeadOrientation "The orientation of the head of cyclists or pedestrians that are detected";
CM_ SG_ 144 VFC_Obj23A_CompletelyInImg "indicator if the object is completely measured in the image";
CM_ SG_ 144 VFC_Obj23A_ProbMovingLat "Probability of object moving laterally";
CM_ SG_ 144 VFC_Obj23A_ProbMovingLong "Probability of object moving longitudinally";
CM_ SG_ 144 VFC_Obj23A_ProbExist "Object existence probability";
CM_ SG_ 144 VFC_Obj23A_MeasSource "Bitfield for the measurement programs from which this object originates
Bit 0: MOD
Bit 1: PDET
Bit 2: OFT
Bit 3: OLS
Bit 4: RESERVED";
CM_ SG_ 144 VFC_Obj23A_Reliability "The bitfield shows if the signal quality is assumed to be sufficient for functions with safety target -no false positives-
Bit 0: DYNAMIC
Bit 1: SEMSEG_SURFACE
Bit 2: WDD_CRITICAL
Bit 3: GOD_CONFIRMED
Bit 4: RESTRICTED
Bit 5: ISO26262_SAFE";
CM_ SG_ 144 VFC_Obj23A_Measured "Indicator if the object detected is measured or predicted";
CM_ SG_ 144 VFC_Obj23A_VisibleView "The visible view of the detected object";
CM_ SG_ 144 VFC_Obj23A_ClassifiedView "The classified view of object to be used in connection with Heading angle";
CM_ SG_ 144 VFC_Obj23A_DirIndicator "The detected direction indicator lights";
CM_ SG_ 144 VFC_Obj23A_BrakeLight "The number of detected lights. More confident if more lights are detected.";
CM_ SG_ 198 VFC_LaneHdr_CRC "CRC - Autosar E2E Profile 5";
CM_ SG_ 198 VFC_LaneHdr_AliveCtr "Alive counter - Autosar E2E Profile 5";
CM_ SG_ 198 VFC_LaneHdr_ProtBlockCtr "Protocol-Signal: Block-Counter";
CM_ SG_ 198 VFC_LaneHdr_ProtSegCount "Protocol-Signal: count of all lane segments";
CM_ SG_ 198 VFC_LaneHdr_ProtPointCount "Protocol-Signal: count of all lane points";
CM_ SG_ 198 VFC_LaneHdr_ProtClothCount "Protocol-Signal: count of all clothoids";
CM_ SG_ 198 VFC_LaneHdr_TimeStampStatus "Autosar StbM_TimeBaseStatusType bitfield with extension:
Bit 0: TIMEOUT
Bit 1: Reserved1
Bit 2: SYNC_TO_GATEWAY
Bit 3: GLOBAL_TIME_BASE
Bit 4: TIMELEAP_FUTURE
Bit 5: TIMELEAP_PAST
Bit 6: Reserved6
Bit 7: Extension: GENERAL_ERROR";
CM_ SG_ 198 VFC_LaneHdr_TimeStamp "TimeStamp of Lane objects";
CM_ SG_ 198 VFC_LaneHdr_State "Informs the system of the current state of the lane detection system";
CM_ SG_ 198 VFC_LaneHdr_FV "SecOC Freshness Value (Profile 1)";
CM_ SG_ 198 VFC_LaneHdr_MAC "SecOC MAC (Profile 1)";
CM_ SG_ 200 VFC_Cloth00_CRC "CRC - Autosar E2E Profile 5";
CM_ SG_ 200 VFC_Cloth00_AliveCtr "Alive counter - Autosar E2E Profile 5";
CM_ SG_ 200 VFC_Cloth00_ProtBlockCtr "Protocol-Signal: Block-Counter";
CM_ SG_ 200 VFC_Cloth00_Conf "Confidence for this clothoid, probability that it describes the true lane boundary";
CM_ SG_ 200 VFC_Cloth00_LineNumber "Number of the clothoid, indicating its position relative to the ego lane";
CM_ SG_ 200 VFC_Cloth00_DxEnd "Longitudinal range of the clothoid, also called LookAheadDistance";
CM_ SG_ 200 VFC_Cloth00_Dy "Lateral offset at x=0, also called LatDeviation (resolution = 2^-7)";
CM_ SG_ 200 VFC_Cloth00_DyStdDev "Standard deviation at x=0 of the lateral offset (resolution = 2^-7)";
CM_ SG_ 200 VFC_Cloth00_Curv "Curvature of the clothoid, also called kappa (resolution = 2^-15)";
CM_ SG_ 200 VFC_Cloth00_CurvChange "Curvature change or alteration of the clothoid, also called kappaDt (resolution = 2^-17)";
CM_ SG_ 200 VFC_Cloth00_CourseDeviation "Confidence measure quantifying a weighted deviation between course/path and the predicted lane";
CM_ SG_ 200 VFC_Cloth00_HeadingAngle "Heading angle, difference in yaw angle between vehicle heading and clothoid (resolution = 2^-11)";
CM_ SG_ 200 VFC_Cloth00_LineWidth "Width of the line";
CM_ SG_ 200 VFC_Cloth00_Type "Type of the Line";
CM_ SG_ 200 VFC_Cloth00_StartPosition "Indicates if clothoid was measured, interpolated or inferred (virtual line)";
CM_ SG_ 200 VFC_Cloth00_ColorClass "The color of the line";
CM_ SG_ 201 VFC_Cloth01_CRC "CRC - Autosar E2E Profile 5";
CM_ SG_ 201 VFC_Cloth01_AliveCtr "Alive counter - Autosar E2E Profile 5";
CM_ SG_ 201 VFC_Cloth01_ProtBlockCtr "Protocol-Signal: Block-Counter";
CM_ SG_ 201 VFC_Cloth01_Conf "Confidence for this clothoid, probability that it describes the true lane boundary";
CM_ SG_ 201 VFC_Cloth01_LineNumber "Number of the clothoid, indicating its position relative to the ego lane";
CM_ SG_ 201 VFC_Cloth01_DxEnd "Longitudinal range of the clothoid, also called LookAheadDistance";
CM_ SG_ 201 VFC_Cloth01_Dy "Lateral offset at x=0, also called LatDeviation (resolution = 2^-7)";
CM_ SG_ 201 VFC_Cloth01_DyStdDev "Standard deviation at x=0 of the lateral offset (resolution = 2^-7)";
CM_ SG_ 201 VFC_Cloth01_Curv "Curvature of the clothoid, also called kappa (resolution = 2^-15)";
CM_ SG_ 201 VFC_Cloth01_CurvChange "Curvature change or alteration of the clothoid, also called kappaDt (resolution = 2^-17)";
CM_ SG_ 201 VFC_Cloth01_CourseDeviation "Confidence measure quantifying a weighted deviation between course/path and the predicted lane";
CM_ SG_ 201 VFC_Cloth01_HeadingAngle "Heading angle, difference in yaw angle between vehicle heading and clothoid (resolution = 2^-11)";
CM_ SG_ 201 VFC_Cloth01_LineWidth "Width of the line";
CM_ SG_ 201 VFC_Cloth01_Type "Type of the Line";
CM_ SG_ 201 VFC_Cloth01_StartPosition "Indicates if clothoid was measured, interpolated or inferred (virtual line)";
CM_ SG_ 201 VFC_Cloth01_ColorClass "The color of the line";
CM_ SG_ 202 VFC_Cloth02_CRC "CRC - Autosar E2E Profile 5";
CM_ SG_ 202 VFC_Cloth02_AliveCtr "Alive counter - Autosar E2E Profile 5";
CM_ SG_ 202 VFC_Cloth02_ProtBlockCtr "Protocol-Signal: Block-Counter";
CM_ SG_ 202 VFC_Cloth02_Conf "Confidence for this clothoid, probability that it describes the true lane boundary";
CM_ SG_ 202 VFC_Cloth02_LineNumber "Number of the clothoid, indicating its position relative to the ego lane";
CM_ SG_ 202 VFC_Cloth02_DxEnd "Longitudinal range of the clothoid, also called LookAheadDistance";
CM_ SG_ 202 VFC_Cloth02_Dy "Lateral offset at x=0, also called LatDeviation (resolution = 2^-7)";
CM_ SG_ 202 VFC_Cloth02_DyStdDev "Standard deviation at x=0 of the lateral offset (resolution = 2^-7)";
CM_ SG_ 202 VFC_Cloth02_Curv "Curvature of the clothoid, also called kappa (resolution = 2^-15)";
CM_ SG_ 202 VFC_Cloth02_CurvChange "Curvature change or alteration of the clothoid, also called kappaDt (resolution = 2^-17)";
CM_ SG_ 202 VFC_Cloth02_CourseDeviation "Confidence measure quantifying a weighted deviation between course/path and the predicted lane";
CM_ SG_ 202 VFC_Cloth02_HeadingAngle "Heading angle, difference in yaw angle between vehicle heading and clothoid (resolution = 2^-11)";
CM_ SG_ 202 VFC_Cloth02_LineWidth "Width of the line";
CM_ SG_ 202 VFC_Cloth02_Type "Type of the Line";
CM_ SG_ 202 VFC_Cloth02_StartPosition "Indicates if clothoid was measured, interpolated or inferred (virtual line)";
CM_ SG_ 202 VFC_Cloth02_ColorClass "The color of the line";
CM_ SG_ 203 VFC_Cloth03_CRC "CRC - Autosar E2E Profile 5";
CM_ SG_ 203 VFC_Cloth03_AliveCtr "Alive counter - Autosar E2E Profile 5";
CM_ SG_ 203 VFC_Cloth03_ProtBlockCtr "Protocol-Signal: Block-Counter";
CM_ SG_ 203 VFC_Cloth03_Conf "Confidence for this clothoid, probability that it describes the true lane boundary";
CM_ SG_ 203 VFC_Cloth03_LineNumber "Number of the clothoid, indicating its position relative to the ego lane";
CM_ SG_ 203 VFC_Cloth03_DxEnd "Longitudinal range of the clothoid, also called LookAheadDistance";
CM_ SG_ 203 VFC_Cloth03_Dy "Lateral offset at x=0, also called LatDeviation (resolution = 2^-7)";
CM_ SG_ 203 VFC_Cloth03_DyStdDev "Standard deviation at x=0 of the lateral offset (resolution = 2^-7)";
CM_ SG_ 203 VFC_Cloth03_Curv "Curvature of the clothoid, also called kappa (resolution = 2^-15)";
CM_ SG_ 203 VFC_Cloth03_CurvChange "Curvature change or alteration of the clothoid, also called kappaDt (resolution = 2^-17)";
CM_ SG_ 203 VFC_Cloth03_CourseDeviation "Confidence measure quantifying a weighted deviation between course/path and the predicted lane";
CM_ SG_ 203 VFC_Cloth03_HeadingAngle "Heading angle, difference in yaw angle between vehicle heading and clothoid (resolution = 2^-11)";
CM_ SG_ 203 VFC_Cloth03_LineWidth "Width of the line";
CM_ SG_ 203 VFC_Cloth03_Type "Type of the Line";
CM_ SG_ 203 VFC_Cloth03_StartPosition "Indicates if clothoid was measured, interpolated or inferred (virtual line)";
CM_ SG_ 203 VFC_Cloth03_ColorClass "The color of the line";
CM_ SG_ 204 VFC_Cloth04_CRC "CRC - Autosar E2E Profile 5";
CM_ SG_ 204 VFC_Cloth04_AliveCtr "Alive counter - Autosar E2E Profile 5";
CM_ SG_ 204 VFC_Cloth04_ProtBlockCtr "Protocol-Signal: Block-Counter";
CM_ SG_ 204 VFC_Cloth04_Conf "Confidence for this clothoid, probability that it describes the true lane boundary";
CM_ SG_ 204 VFC_Cloth04_LineNumber "Number of the clothoid, indicating its position relative to the ego lane";
CM_ SG_ 204 VFC_Cloth04_DxEnd "Longitudinal range of the clothoid, also called LookAheadDistance";
CM_ SG_ 204 VFC_Cloth04_Dy "Lateral offset at x=0, also called LatDeviation (resolution = 2^-7)";
CM_ SG_ 204 VFC_Cloth04_DyStdDev "Standard deviation at x=0 of the lateral offset (resolution = 2^-7)";
CM_ SG_ 204 VFC_Cloth04_Curv "Curvature of the clothoid, also called kappa (resolution = 2^-15)";
CM_ SG_ 204 VFC_Cloth04_CurvChange "Curvature change or alteration of the clothoid, also called kappaDt (resolution = 2^-17)";
CM_ SG_ 204 VFC_Cloth04_CourseDeviation "Confidence measure quantifying a weighted deviation between course/path and the predicted lane";
CM_ SG_ 204 VFC_Cloth04_HeadingAngle "Heading angle, difference in yaw angle between vehicle heading and clothoid (resolution = 2^-11)";
CM_ SG_ 204 VFC_Cloth04_LineWidth "Width of the line";
CM_ SG_ 204 VFC_Cloth04_Type "Type of the Line";
CM_ SG_ 204 VFC_Cloth04_StartPosition "Indicates if clothoid was measured, interpolated or inferred (virtual line)";
CM_ SG_ 204 VFC_Cloth04_ColorClass "The color of the line";
CM_ SG_ 205 VFC_Cloth05_CRC "CRC - Autosar E2E Profile 5";
CM_ SG_ 205 VFC_Cloth05_AliveCtr "Alive counter - Autosar E2E Profile 5";
CM_ SG_ 205 VFC_Cloth05_ProtBlockCtr "Protocol-Signal: Block-Counter";
CM_ SG_ 205 VFC_Cloth05_Conf "Confidence for this clothoid, probability that it describes the true lane boundary";
CM_ SG_ 205 VFC_Cloth05_LineNumber "Number of the clothoid, indicating its position relative to the ego lane";
CM_ SG_ 205 VFC_Cloth05_DxEnd "Longitudinal range of the clothoid, also called LookAheadDistance";
CM_ SG_ 205 VFC_Cloth05_Dy "Lateral offset at x=0, also called LatDeviation (resolution = 2^-7)";
CM_ SG_ 205 VFC_Cloth05_DyStdDev "Standard deviation at x=0 of the lateral offset (resolution = 2^-7)";
CM_ SG_ 205 VFC_Cloth05_Curv "Curvature of the clothoid, also called kappa (resolution = 2^-15)";
CM_ SG_ 205 VFC_Cloth05_CurvChange "Curvature change or alteration of the clothoid, also called kappaDt (resolution = 2^-17)";
CM_ SG_ 205 VFC_Cloth05_CourseDeviation "Confidence measure quantifying a weighted deviation between course/path and the predicted lane";
CM_ SG_ 205 VFC_Cloth05_HeadingAngle "Heading angle, difference in yaw angle between vehicle heading and clothoid (resolution = 2^-11)";
CM_ SG_ 205 VFC_Cloth05_LineWidth "Width of the line";
CM_ SG_ 205 VFC_Cloth05_Type "Type of the Line";
CM_ SG_ 205 VFC_Cloth05_StartPosition "Indicates if clothoid was measured, interpolated or inferred (virtual line)";
CM_ SG_ 205 VFC_Cloth05_ColorClass "The color of the line";
CM_ SG_ 206 VFC_Cloth06_CRC "CRC - Autosar E2E Profile 5";
CM_ SG_ 206 VFC_Cloth06_AliveCtr "Alive counter - Autosar E2E Profile 5";
CM_ SG_ 206 VFC_Cloth06_ProtBlockCtr "Protocol-Signal: Block-Counter";
CM_ SG_ 206 VFC_Cloth06_Conf "Confidence for this clothoid, probability that it describes the true lane boundary";
CM_ SG_ 206 VFC_Cloth06_LineNumber "Number of the clothoid, indicating its position relative to the ego lane";
CM_ SG_ 206 VFC_Cloth06_DxEnd "Longitudinal range of the clothoid, also called LookAheadDistance";
CM_ SG_ 206 VFC_Cloth06_Dy "Lateral offset at x=0, also called LatDeviation (resolution = 2^-7)";
CM_ SG_ 206 VFC_Cloth06_DyStdDev "Standard deviation at x=0 of the lateral offset (resolution = 2^-7)";
CM_ SG_ 206 VFC_Cloth06_Curv "Curvature of the clothoid, also called kappa (resolution = 2^-15)";
CM_ SG_ 206 VFC_Cloth06_CurvChange "Curvature change or alteration of the clothoid, also called kappaDt (resolution = 2^-17)";
CM_ SG_ 206 VFC_Cloth06_CourseDeviation "Confidence measure quantifying a weighted deviation between course/path and the predicted lane";
CM_ SG_ 206 VFC_Cloth06_HeadingAngle "Heading angle, difference in yaw angle between vehicle heading and clothoid (resolution = 2^-11)";
CM_ SG_ 206 VFC_Cloth06_LineWidth "Width of the line";
CM_ SG_ 206 VFC_Cloth06_Type "Type of the Line";
CM_ SG_ 206 VFC_Cloth06_StartPosition "Indicates if clothoid was measured, interpolated or inferred (virtual line)";
CM_ SG_ 206 VFC_Cloth06_ColorClass "The color of the line";
CM_ SG_ 207 VFC_Cloth07_CRC "CRC - Autosar E2E Profile 5";
CM_ SG_ 207 VFC_Cloth07_AliveCtr "Alive counter - Autosar E2E Profile 5";
CM_ SG_ 207 VFC_Cloth07_ProtBlockCtr "Protocol-Signal: Block-Counter";
CM_ SG_ 207 VFC_Cloth07_Conf "Confidence for this clothoid, probability that it describes the true lane boundary";
CM_ SG_ 207 VFC_Cloth07_LineNumber "Number of the clothoid, indicating its position relative to the ego lane";
CM_ SG_ 207 VFC_Cloth07_DxEnd "Longitudinal range of the clothoid, also called LookAheadDistance";
CM_ SG_ 207 VFC_Cloth07_Dy "Lateral offset at x=0, also called LatDeviation (resolution = 2^-7)";
CM_ SG_ 207 VFC_Cloth07_DyStdDev "Standard deviation at x=0 of the lateral offset (resolution = 2^-7)";
CM_ SG_ 207 VFC_Cloth07_Curv "Curvature of the clothoid, also called kappa (resolution = 2^-15)";
CM_ SG_ 207 VFC_Cloth07_CurvChange "Curvature change or alteration of the clothoid, also called kappaDt (resolution = 2^-17)";
CM_ SG_ 207 VFC_Cloth07_CourseDeviation "Confidence measure quantifying a weighted deviation between course/path and the predicted lane";
CM_ SG_ 207 VFC_Cloth07_HeadingAngle "Heading angle, difference in yaw angle between vehicle heading and clothoid (resolution = 2^-11)";
CM_ SG_ 207 VFC_Cloth07_LineWidth "Width of the line";
CM_ SG_ 207 VFC_Cloth07_Type "Type of the Line";
CM_ SG_ 207 VFC_Cloth07_StartPosition "Indicates if clothoid was measured, interpolated or inferred (virtual line)";
CM_ SG_ 207 VFC_Cloth07_ColorClass "The color of the line";
CM_ SG_ 236 VFC_TSHdr_CRC "CRC - Autosar E2E Profile 5";
CM_ SG_ 236 VFC_TSHdr_AliveCtr "Alive counter - Autosar E2E Profile 5";
CM_ SG_ 236 VFC_TSHdr_ProtBlockCtr "Protocol-Signal: Block-Counter";
CM_ SG_ 236 VFC_TSHdr_ProtTrafficSignCount "Protocol-Signal: count of all traffic signs";
CM_ SG_ 236 VFC_TSHdr_State "Informs the system of the current state of the traffic sign detection system";
CM_ SG_ 236 VFC_TSHdr_Brightness "The ambient light conditions detected by the camera";
CM_ SG_ 236 VFC_TSHdr_Country "The current country that the vision system is using as ISO 3166 Code";
CM_ SG_ 236 VFC_TSHdr_TimeStampStatus "Autosar StbM_TimeBaseStatusType bitfield with extension:
Bit 0: TIMEOUT
Bit 1: Reserved1
Bit 2: SYNC_TO_GATEWAY
Bit 3: GLOBAL_TIME_BASE
Bit 4: TIMELEAP_FUTURE
Bit 5: TIMELEAP_PAST
Bit 6: Reserved6
Bit 7: Extension: GENERAL_ERROR";
CM_ SG_ 236 VFC_TSHdr_TimeStamp "TimeStamp of Traffic Signs";
CM_ SG_ 236 VFC_TSHdr_CountryMode "Tells the system the current country mode that the system is operating in";
CM_ SG_ 236 VFC_TSHdr_FV "SecOC Freshness Value (Profile 1)";
CM_ SG_ 236 VFC_TSHdr_MAC "SecOC MAC (Profile 1)";
CM_ SG_ 238 VFC_TS00_CRC "CRC - Autosar E2E Profile 5";
CM_ SG_ 238 VFC_TS00_AliveCtr "Alive counter - Autosar E2E Profile 5";
CM_ SG_ 238 VFC_TS00_ProtBlockCtr "Protocol-Signal: Block-Counter";
CM_ SG_ 238 VFC_TS00_ProtOrderIndex "Protocol-Signal: Index to ensure same order in Tx and Rx (Ethernet only)";
CM_ SG_ 238 VFC_TS00_ID "Unique Traffic Sign ID";
CM_ SG_ 238 VFC_TS00_Class "The type of main sign that has been detected by the vision system";
CM_ SG_ 238 VFC_TS00_TSProb "Probability that the sign is a traffic sign";
CM_ SG_ 238 VFC_TS00_Dx "Traffic sign distance in longitudinal direction";
CM_ SG_ 238 VFC_TS00_Dy "Traffic sign distance in lateral direction";
CM_ SG_ 238 VFC_TS00_Dz "Traffic sign distance in vertical direction";
CM_ SG_ 238 VFC_TS00_DxStdDev "Standard deviation of Traffic sign distance in longitudinal direction";
CM_ SG_ 238 VFC_TS00_DyStdDev "Standard deviation of Traffic sign distance in lateral direction";
CM_ SG_ 238 VFC_TS00_DzStdDev "Standard deviation of Traffic sign distance in vertical direction";
CM_ SG_ 238 VFC_TS00_Width "Width of the sign";
CM_ SG_ 238 VFC_TS00_Height "Height of the sign";
CM_ SG_ 238 VFC_TS00_EmbedFlag "Determines whether the sign is embedded or not";
CM_ SG_ 238 VFC_TS00_Quality "A flag that determines the quality of the sign";
CM_ SG_ 238 VFC_TS00_VMS "Variable-message sign: Determines whether the traffic sign is Variable or fixed";
CM_ SG_ 238 VFC_TS00_Stable "Determines whether the object is stable";
CM_ SG_ 238 VFC_TS00_VehicleSticker "Flag which indicates whether the detected traffic sign is a invalid sign on a vehicle or not";
CM_ SG_ 238 VFC_TS00_InternalTrack "Flag which indicates if this sign is an internal track, i.e. an sign hypothesis of low quality";
CM_ SG_ 238 VFC_TS00_ValidLanes "Indicates on which lane the detected sign is valid. Bitfield:

Bit 0: valid on first right hand lane

Bit 1: valid on second right hand lane

Bit 2: valid on third right hand lane

Bit 3: valid on fourth right hand lane

Bit 4: valid on fifth right hand lane";
CM_ SG_ 238 VFC_TS00_ValidDay "The MPC3 sensor shall provide the week days for which the main traffic sign is valid. Bitfield:

Bit 0: MONDAY

Bit 1: TUESDAY

Bit 2: WEDNESDAY

Bit 3: THURSDAY

Bit 4: FRIDAY

Bit 5: SATURDAY

Bit 6: SUNDAY";
CM_ SG_ 238 VFC_TS00_ValidTimeRange1Start "Start time for the first time range in which the main traffic sign is valid. Minutes since midnight.";
CM_ SG_ 238 VFC_TS00_ValidTimeRange1End "End time for the first time range in which the main traffic sign is valid. Minutes since midnight.";
CM_ SG_ 238 VFC_TS00_ValidTimeRange2Start "Start time for the first time range in which the main traffic sign is valid. Minutes since midnight.";
CM_ SG_ 238 VFC_TS00_ValidTimeRange2End "End time for the first time range in which the main traffic sign is valid. Minutes since midnight.";
CM_ SG_ 238 VFC_TS00_ValidInDist "Indicates the longitudinal distance in which the validity of the main TSR starts";
CM_ SG_ 238 VFC_TS00_ValidDist "Indicates the longitudinal distance for which the main traffic sign is valid";
CM_ SG_ 238 VFC_TS00_AddTSCount "Number of additional signs attached to the main sign. This can be a minimum of 0 and a maximum of 6.";
CM_ SG_ 238 VFC_TS00_AddTS1Class "The type of additonal sign that has been detected by the vision system";
CM_ SG_ 238 VFC_TS00_AddTS1Prob "Probability that the sign is a traffic sign";
CM_ SG_ 238 VFC_TS00_AddTS1Quality "A flag that determines the quality of the signal";
CM_ SG_ 238 VFC_TS00_AddTS1VMS "Variable-message sign: Determines whether the traffic sign is Variable or fixed";
CM_ SG_ 238 VFC_TS00_AddTS2Class "The type of additonal sign that has been detected by the vision system";
CM_ SG_ 238 VFC_TS00_AddTS2Prob "Probability that the sign is a traffic sign";
CM_ SG_ 238 VFC_TS00_AddTS2Quality "A flag that determines the quality of the signal";
CM_ SG_ 238 VFC_TS00_AddTS2VMS "Variable-message sign: Determines whether the traffic sign is Variable or fixed";
CM_ SG_ 238 VFC_TS00_AddTS3Class "The type of additonal sign that has been detected by the vision system";
CM_ SG_ 238 VFC_TS00_AddTS3Prob "Probability that the sign is a traffic sign";
CM_ SG_ 238 VFC_TS00_AddTS3Quality "A flag that determines the quality of the signal";
CM_ SG_ 238 VFC_TS00_AddTS3VMS "Variable-message sign: Determines whether the traffic sign is Variable or fixed";
CM_ SG_ 238 VFC_TS00_AddTS4Class "The type of additonal sign that has been detected by the vision system";
CM_ SG_ 238 VFC_TS00_AddTS4Prob "Probability that the sign is a traffic sign";
CM_ SG_ 238 VFC_TS00_AddTS4Quality "A flag that determines the quality of the signal";
CM_ SG_ 238 VFC_TS00_AddTS4VMS "Variable-message sign: Determines whether the traffic sign is Variable or fixed";
CM_ SG_ 238 VFC_TS00_AddTS5Class "The type of additonal sign that has been detected by the vision system";
CM_ SG_ 238 VFC_TS00_AddTS5Prob "Probability that the sign is a traffic sign";
CM_ SG_ 238 VFC_TS00_AddTS5Quality "A flag that determines the quality of the signal";
CM_ SG_ 238 VFC_TS00_AddTS5VMS "Variable-message sign: Determines whether the traffic sign is Variable or fixed";
CM_ SG_ 238 VFC_TS00_AddTS6Class "The type of additonal sign that has been detected by the vision system";
CM_ SG_ 238 VFC_TS00_AddTS6Prob "Probability that the sign is a traffic sign";
CM_ SG_ 238 VFC_TS00_AddTS6Quality "A flag that determines the quality of the signal";
CM_ SG_ 238 VFC_TS00_AddTS6VMS "Variable-message sign: Determines whether the traffic sign is Variable or fixed";
CM_ SG_ 238 VFC_TS00_FV "SecOC Freshness Value (Profile 1)";
CM_ SG_ 238 VFC_TS00_MAC "SecOC MAC (Profile 1)";
CM_ SG_ 239 VFC_TS01_CRC "CRC - Autosar E2E Profile 5";
CM_ SG_ 239 VFC_TS01_AliveCtr "Alive counter - Autosar E2E Profile 5";
CM_ SG_ 239 VFC_TS01_ProtBlockCtr "Protocol-Signal: Block-Counter";
CM_ SG_ 239 VFC_TS01_ProtOrderIndex "Protocol-Signal: Index to ensure same order in Tx and Rx (Ethernet only)";
CM_ SG_ 239 VFC_TS01_ID "Unique Traffic Sign ID";
CM_ SG_ 239 VFC_TS01_Class "The type of main sign that has been detected by the vision system";
CM_ SG_ 239 VFC_TS01_TSProb "Probability that the sign is a traffic sign";
CM_ SG_ 239 VFC_TS01_Dx "Traffic sign distance in longitudinal direction";
CM_ SG_ 239 VFC_TS01_Dy "Traffic sign distance in lateral direction";
CM_ SG_ 239 VFC_TS01_Dz "Traffic sign distance in vertical direction";
CM_ SG_ 239 VFC_TS01_DxStdDev "Standard deviation of Traffic sign distance in longitudinal direction";
CM_ SG_ 239 VFC_TS01_DyStdDev "Standard deviation of Traffic sign distance in lateral direction";
CM_ SG_ 239 VFC_TS01_DzStdDev "Standard deviation of Traffic sign distance in vertical direction";
CM_ SG_ 239 VFC_TS01_Width "Width of the sign";
CM_ SG_ 239 VFC_TS01_Height "Height of the sign";
CM_ SG_ 239 VFC_TS01_EmbedFlag "Determines whether the sign is embedded or not";
CM_ SG_ 239 VFC_TS01_Quality "A flag that determines the quality of the sign";
CM_ SG_ 239 VFC_TS01_VMS "Variable-message sign: Determines whether the traffic sign is Variable or fixed";
CM_ SG_ 239 VFC_TS01_Stable "Determines whether the object is stable";
CM_ SG_ 239 VFC_TS01_VehicleSticker "Flag which indicates whether the detected traffic sign is a invalid sign on a vehicle or not";
CM_ SG_ 239 VFC_TS01_InternalTrack "Flag which indicates if this sign is an internal track, i.e. an sign hypothesis of low quality";
CM_ SG_ 239 VFC_TS01_ValidLanes "Indicates on which lane the detected sign is valid. Bitfield:

Bit 0: valid on first right hand lane

Bit 1: valid on second right hand lane

Bit 2: valid on third right hand lane

Bit 3: valid on fourth right hand lane

Bit 4: valid on fifth right hand lane";
CM_ SG_ 239 VFC_TS01_ValidDay "The MPC3 sensor shall provide the week days for which the main traffic sign is valid. Bitfield:

Bit 0: MONDAY

Bit 1: TUESDAY

Bit 2: WEDNESDAY

Bit 3: THURSDAY

Bit 4: FRIDAY

Bit 5: SATURDAY

Bit 6: SUNDAY";
CM_ SG_ 239 VFC_TS01_ValidTimeRange1Start "Start time for the first time range in which the main traffic sign is valid. Minutes since midnight.";
CM_ SG_ 239 VFC_TS01_ValidTimeRange1End "End time for the first time range in which the main traffic sign is valid. Minutes since midnight.";
CM_ SG_ 239 VFC_TS01_ValidTimeRange2Start "Start time for the first time range in which the main traffic sign is valid. Minutes since midnight.";
CM_ SG_ 239 VFC_TS01_ValidTimeRange2End "End time for the first time range in which the main traffic sign is valid. Minutes since midnight.";
CM_ SG_ 239 VFC_TS01_ValidInDist "Indicates the longitudinal distance in which the validity of the main TSR starts";
CM_ SG_ 239 VFC_TS01_ValidDist "Indicates the longitudinal distance for which the main traffic sign is valid";
CM_ SG_ 239 VFC_TS01_AddTSCount "Number of additional signs attached to the main sign. This can be a minimum of 0 and a maximum of 6.";
CM_ SG_ 239 VFC_TS01_AddTS1Class "The type of additonal sign that has been detected by the vision system";
CM_ SG_ 239 VFC_TS01_AddTS1Prob "Probability that the sign is a traffic sign";
CM_ SG_ 239 VFC_TS01_AddTS1Quality "A flag that determines the quality of the signal";
CM_ SG_ 239 VFC_TS01_AddTS1VMS "Variable-message sign: Determines whether the traffic sign is Variable or fixed";
CM_ SG_ 239 VFC_TS01_AddTS2Class "The type of additonal sign that has been detected by the vision system";
CM_ SG_ 239 VFC_TS01_AddTS2Prob "Probability that the sign is a traffic sign";
CM_ SG_ 239 VFC_TS01_AddTS2Quality "A flag that determines the quality of the signal";
CM_ SG_ 239 VFC_TS01_AddTS2VMS "Variable-message sign: Determines whether the traffic sign is Variable or fixed";
CM_ SG_ 239 VFC_TS01_AddTS3Class "The type of additonal sign that has been detected by the vision system";
CM_ SG_ 239 VFC_TS01_AddTS3Prob "Probability that the sign is a traffic sign";
CM_ SG_ 239 VFC_TS01_AddTS3Quality "A flag that determines the quality of the signal";
CM_ SG_ 239 VFC_TS01_AddTS3VMS "Variable-message sign: Determines whether the traffic sign is Variable or fixed";
CM_ SG_ 239 VFC_TS01_AddTS4Class "The type of additonal sign that has been detected by the vision system";
CM_ SG_ 239 VFC_TS01_AddTS4Prob "Probability that the sign is a traffic sign";
CM_ SG_ 239 VFC_TS01_AddTS4Quality "A flag that determines the quality of the signal";
CM_ SG_ 239 VFC_TS01_AddTS4VMS "Variable-message sign: Determines whether the traffic sign is Variable or fixed";
CM_ SG_ 239 VFC_TS01_AddTS5Class "The type of additonal sign that has been detected by the vision system";
CM_ SG_ 239 VFC_TS01_AddTS5Prob "Probability that the sign is a traffic sign";
CM_ SG_ 239 VFC_TS01_AddTS5Quality "A flag that determines the quality of the signal";
CM_ SG_ 239 VFC_TS01_AddTS5VMS "Variable-message sign: Determines whether the traffic sign is Variable or fixed";
CM_ SG_ 239 VFC_TS01_AddTS6Class "The type of additonal sign that has been detected by the vision system";
CM_ SG_ 239 VFC_TS01_AddTS6Prob "Probability that the sign is a traffic sign";
CM_ SG_ 239 VFC_TS01_AddTS6Quality "A flag that determines the quality of the signal";
CM_ SG_ 239 VFC_TS01_AddTS6VMS "Variable-message sign: Determines whether the traffic sign is Variable or fixed";
CM_ SG_ 239 VFC_TS01_FV "SecOC Freshness Value (Profile 1)";
CM_ SG_ 239 VFC_TS01_MAC "SecOC MAC (Profile 1)";
BA_DEF_ BO_  "GenMsgSendType" ENUM  "cyclic","NoMsgSendType","IfActive","Event","CA","CE";
BA_DEF_ BO_  "GenMsgCycleTime" INT 0 0;
BA_DEF_ SG_  "GenSigSendType" ENUM  "cyclic","OnChange","OnWrite","IfActive","OnChangeWithRepetition","OnWriteWithRepetition","IfActiveWithRepetition","CA","CE","Event";
BA_DEF_ SG_  "GenSigStartValue" INT 0 0;
BA_DEF_ BO_  "CANFD_BRS" ENUM  "0","1";
BA_DEF_ BO_  "VFrameFormat" ENUM  "StandardCAN","ExtendedCAN","reserved","reserved","reserved","reserved","reserved","reserved","reserved","reserved","reserved","reserved","reserved","reserved","StandardCAN_FD","ExtendedCAN_FD";
BA_DEF_ BO_  "GenMsgILSupport" ENUM  "No","Yes";
BA_DEF_ SG_  "sigDespEng" STRING ;
BA_DEF_ SG_  "sigSecLevel" STRING ;
BA_DEF_ SG_  "sigConfig" STRING ;
BA_DEF_ SG_  "sigExplanation" STRING ;
BA_DEF_DEF_  "GenMsgSendType" "cyclic";
BA_DEF_DEF_  "GenMsgCycleTime" 0;
BA_DEF_DEF_  "GenSigSendType" "cyclic";
BA_DEF_DEF_  "GenSigStartValue" 0;
BA_DEF_DEF_  "CANFD_BRS" "1";
BA_DEF_DEF_  "VFrameFormat" "";
BA_DEF_DEF_  "GenMsgILSupport" "Yes";
BA_DEF_DEF_  "sigDespEng" "";
BA_DEF_DEF_  "sigSecLevel" "";
BA_DEF_DEF_  "sigConfig" "";
BA_DEF_DEF_  "sigExplanation" "";
BA_ "GenMsgSendType" BO_ 128 3;
BA_ "VFrameFormat" BO_ 128 14;
BA_ "GenMsgSendType" BO_ 130 3;
BA_ "VFrameFormat" BO_ 130 14;
BA_ "GenMsgSendType" BO_ 132 3;
BA_ "VFrameFormat" BO_ 132 14;
BA_ "GenMsgSendType" BO_ 134 3;
BA_ "VFrameFormat" BO_ 134 14;
BA_ "GenMsgSendType" BO_ 136 3;
BA_ "VFrameFormat" BO_ 136 14;
BA_ "GenMsgSendType" BO_ 138 3;
BA_ "VFrameFormat" BO_ 138 14;
BA_ "GenMsgSendType" BO_ 140 3;
BA_ "VFrameFormat" BO_ 140 14;
BA_ "GenMsgSendType" BO_ 142 3;
BA_ "VFrameFormat" BO_ 142 14;
BA_ "GenMsgSendType" BO_ 144 3;
BA_ "VFrameFormat" BO_ 144 14;
BA_ "GenMsgSendType" BO_ 198 3;
BA_ "VFrameFormat" BO_ 198 14;
BA_ "GenMsgSendType" BO_ 200 3;
BA_ "VFrameFormat" BO_ 200 14;
BA_ "GenMsgSendType" BO_ 201 3;
BA_ "VFrameFormat" BO_ 201 14;
BA_ "GenMsgSendType" BO_ 202 3;
BA_ "VFrameFormat" BO_ 202 14;
BA_ "GenMsgSendType" BO_ 203 3;
BA_ "VFrameFormat" BO_ 203 14;
BA_ "GenMsgSendType" BO_ 204 3;
BA_ "VFrameFormat" BO_ 204 14;
BA_ "GenMsgSendType" BO_ 205 3;
BA_ "VFrameFormat" BO_ 205 14;
BA_ "GenMsgSendType" BO_ 206 3;
BA_ "VFrameFormat" BO_ 206 14;
BA_ "GenMsgSendType" BO_ 207 3;
BA_ "VFrameFormat" BO_ 207 14;
BA_ "GenMsgSendType" BO_ 210 3;
BA_ "VFrameFormat" BO_ 210 14;
BA_ "GenMsgSendType" BO_ 211 3;
BA_ "VFrameFormat" BO_ 211 14;
BA_ "GenMsgSendType" BO_ 236 3;
BA_ "VFrameFormat" BO_ 236 14;
BA_ "GenMsgSendType" BO_ 238 3;
BA_ "VFrameFormat" BO_ 238 14;
BA_ "GenMsgSendType" BO_ 239 3;
BA_ "VFrameFormat" BO_ 239 14;
BA_ "GenSigStartValue" SG_ 128 VFC_Obj15A_Dy 8000;
BA_ "GenSigStartValue" SG_ 128 VFC_Obj15A_Vx 1540;
BA_ "GenSigStartValue" SG_ 128 VFC_Obj15A_Vy 500;
BA_ "GenSigStartValue" SG_ 128 VFC_Obj15A_Ax 160;
BA_ "GenSigStartValue" SG_ 128 VFC_Obj15A_Ay 120;
BA_ "GenSigStartValue" SG_ 128 VFC_Obj15A_EdgeLeft 4000;
BA_ "GenSigStartValue" SG_ 128 VFC_Obj15A_EdgeMid 4000;
BA_ "GenSigStartValue" SG_ 128 VFC_Obj15A_EdgeRight 4000;
BA_ "GenSigStartValue" SG_ 128 VFC_Obj15A_EdgeTop 2000;
BA_ "GenSigStartValue" SG_ 128 VFC_Obj15A_EdgeBottom 2000;
BA_ "GenSigStartValue" SG_ 128 VFC_Obj15A_NormVx 40000;
BA_ "GenSigStartValue" SG_ 128 VFC_Obj15A_NormAx 5000;
BA_ "GenSigStartValue" SG_ 128 VFC_Obj15A_NormVyEdgeLeft 4000;
BA_ "GenSigStartValue" SG_ 128 VFC_Obj15A_NormVyEdgeRight 4000;
BA_ "GenSigStartValue" SG_ 128 VFC_Obj15A_HeadingAngle 157;
BA_ "GenSigStartValue" SG_ 130 VFC_Obj16A_Dy 8000;
BA_ "GenSigStartValue" SG_ 130 VFC_Obj16A_Vx 1540;
BA_ "GenSigStartValue" SG_ 130 VFC_Obj16A_Vy 500;
BA_ "GenSigStartValue" SG_ 130 VFC_Obj16A_Ax 160;
BA_ "GenSigStartValue" SG_ 130 VFC_Obj16A_Ay 120;
BA_ "GenSigStartValue" SG_ 130 VFC_Obj16A_EdgeLeft 4000;
BA_ "GenSigStartValue" SG_ 130 VFC_Obj16A_EdgeMid 4000;
BA_ "GenSigStartValue" SG_ 130 VFC_Obj16A_EdgeRight 4000;
BA_ "GenSigStartValue" SG_ 130 VFC_Obj16A_EdgeTop 2000;
BA_ "GenSigStartValue" SG_ 130 VFC_Obj16A_EdgeBottom 2000;
BA_ "GenSigStartValue" SG_ 130 VFC_Obj16A_NormVx 40000;
BA_ "GenSigStartValue" SG_ 130 VFC_Obj16A_NormAx 5000;
BA_ "GenSigStartValue" SG_ 130 VFC_Obj16A_NormVyEdgeLeft 4000;
BA_ "GenSigStartValue" SG_ 130 VFC_Obj16A_NormVyEdgeRight 4000;
BA_ "GenSigStartValue" SG_ 130 VFC_Obj16A_HeadingAngle 157;
BA_ "GenSigStartValue" SG_ 132 VFC_Obj17A_Dy 8000;
BA_ "GenSigStartValue" SG_ 132 VFC_Obj17A_Vx 1540;
BA_ "GenSigStartValue" SG_ 132 VFC_Obj17A_Vy 500;
BA_ "GenSigStartValue" SG_ 132 VFC_Obj17A_Ax 160;
BA_ "GenSigStartValue" SG_ 132 VFC_Obj17A_Ay 120;
BA_ "GenSigStartValue" SG_ 132 VFC_Obj17A_EdgeLeft 4000;
BA_ "GenSigStartValue" SG_ 132 VFC_Obj17A_EdgeMid 4000;
BA_ "GenSigStartValue" SG_ 132 VFC_Obj17A_EdgeRight 4000;
BA_ "GenSigStartValue" SG_ 132 VFC_Obj17A_EdgeTop 2000;
BA_ "GenSigStartValue" SG_ 132 VFC_Obj17A_EdgeBottom 2000;
BA_ "GenSigStartValue" SG_ 132 VFC_Obj17A_NormVx 40000;
BA_ "GenSigStartValue" SG_ 132 VFC_Obj17A_NormAx 5000;
BA_ "GenSigStartValue" SG_ 132 VFC_Obj17A_NormVyEdgeLeft 4000;
BA_ "GenSigStartValue" SG_ 132 VFC_Obj17A_NormVyEdgeRight 4000;
BA_ "GenSigStartValue" SG_ 132 VFC_Obj17A_HeadingAngle 157;
BA_ "GenSigStartValue" SG_ 134 VFC_Obj18A_Dy 8000;
BA_ "GenSigStartValue" SG_ 134 VFC_Obj18A_Vx 1540;
BA_ "GenSigStartValue" SG_ 134 VFC_Obj18A_Vy 500;
BA_ "GenSigStartValue" SG_ 134 VFC_Obj18A_Ax 160;
BA_ "GenSigStartValue" SG_ 134 VFC_Obj18A_Ay 120;
BA_ "GenSigStartValue" SG_ 134 VFC_Obj18A_EdgeLeft 4000;
BA_ "GenSigStartValue" SG_ 134 VFC_Obj18A_EdgeMid 4000;
BA_ "GenSigStartValue" SG_ 134 VFC_Obj18A_EdgeRight 4000;
BA_ "GenSigStartValue" SG_ 134 VFC_Obj18A_EdgeTop 2000;
BA_ "GenSigStartValue" SG_ 134 VFC_Obj18A_EdgeBottom 2000;
BA_ "GenSigStartValue" SG_ 134 VFC_Obj18A_NormVx 40000;
BA_ "GenSigStartValue" SG_ 134 VFC_Obj18A_NormAx 5000;
BA_ "GenSigStartValue" SG_ 134 VFC_Obj18A_NormVyEdgeLeft 4000;
BA_ "GenSigStartValue" SG_ 134 VFC_Obj18A_NormVyEdgeRight 4000;
BA_ "GenSigStartValue" SG_ 134 VFC_Obj18A_HeadingAngle 157;
BA_ "GenSigStartValue" SG_ 136 VFC_Obj19A_Dy 8000;
BA_ "GenSigStartValue" SG_ 136 VFC_Obj19A_Vx 1540;
BA_ "GenSigStartValue" SG_ 136 VFC_Obj19A_Vy 500;
BA_ "GenSigStartValue" SG_ 136 VFC_Obj19A_Ax 160;
BA_ "GenSigStartValue" SG_ 136 VFC_Obj19A_Ay 120;
BA_ "GenSigStartValue" SG_ 136 VFC_Obj19A_EdgeLeft 4000;
BA_ "GenSigStartValue" SG_ 136 VFC_Obj19A_EdgeMid 4000;
BA_ "GenSigStartValue" SG_ 136 VFC_Obj19A_EdgeRight 4000;
BA_ "GenSigStartValue" SG_ 136 VFC_Obj19A_EdgeTop 2000;
BA_ "GenSigStartValue" SG_ 136 VFC_Obj19A_EdgeBottom 2000;
BA_ "GenSigStartValue" SG_ 136 VFC_Obj19A_NormVx 40000;
BA_ "GenSigStartValue" SG_ 136 VFC_Obj19A_NormAx 5000;
BA_ "GenSigStartValue" SG_ 136 VFC_Obj19A_NormVyEdgeLeft 4000;
BA_ "GenSigStartValue" SG_ 136 VFC_Obj19A_NormVyEdgeRight 4000;
BA_ "GenSigStartValue" SG_ 136 VFC_Obj19A_HeadingAngle 157;
BA_ "GenSigStartValue" SG_ 138 VFC_Obj20A_Dy 8000;
BA_ "GenSigStartValue" SG_ 138 VFC_Obj20A_Vx 1540;
BA_ "GenSigStartValue" SG_ 138 VFC_Obj20A_Vy 500;
BA_ "GenSigStartValue" SG_ 138 VFC_Obj20A_Ax 160;
BA_ "GenSigStartValue" SG_ 138 VFC_Obj20A_Ay 120;
BA_ "GenSigStartValue" SG_ 138 VFC_Obj20A_EdgeLeft 4000;
BA_ "GenSigStartValue" SG_ 138 VFC_Obj20A_EdgeMid 4000;
BA_ "GenSigStartValue" SG_ 138 VFC_Obj20A_EdgeRight 4000;
BA_ "GenSigStartValue" SG_ 138 VFC_Obj20A_EdgeTop 2000;
BA_ "GenSigStartValue" SG_ 138 VFC_Obj20A_EdgeBottom 2000;
BA_ "GenSigStartValue" SG_ 138 VFC_Obj20A_NormVx 40000;
BA_ "GenSigStartValue" SG_ 138 VFC_Obj20A_NormAx 5000;
BA_ "GenSigStartValue" SG_ 138 VFC_Obj20A_NormVyEdgeLeft 4000;
BA_ "GenSigStartValue" SG_ 138 VFC_Obj20A_NormVyEdgeRight 4000;
BA_ "GenSigStartValue" SG_ 138 VFC_Obj20A_HeadingAngle 157;
BA_ "GenSigStartValue" SG_ 140 VFC_Obj21A_Dy 8000;
BA_ "GenSigStartValue" SG_ 140 VFC_Obj21A_Vx 1540;
BA_ "GenSigStartValue" SG_ 140 VFC_Obj21A_Vy 500;
BA_ "GenSigStartValue" SG_ 140 VFC_Obj21A_Ax 160;
BA_ "GenSigStartValue" SG_ 140 VFC_Obj21A_Ay 120;
BA_ "GenSigStartValue" SG_ 140 VFC_Obj21A_EdgeLeft 4000;
BA_ "GenSigStartValue" SG_ 140 VFC_Obj21A_EdgeMid 4000;
BA_ "GenSigStartValue" SG_ 140 VFC_Obj21A_EdgeRight 4000;
BA_ "GenSigStartValue" SG_ 140 VFC_Obj21A_EdgeTop 2000;
BA_ "GenSigStartValue" SG_ 140 VFC_Obj21A_EdgeBottom 2000;
BA_ "GenSigStartValue" SG_ 140 VFC_Obj21A_NormVx 40000;
BA_ "GenSigStartValue" SG_ 140 VFC_Obj21A_NormAx 5000;
BA_ "GenSigStartValue" SG_ 140 VFC_Obj21A_NormVyEdgeLeft 4000;
BA_ "GenSigStartValue" SG_ 140 VFC_Obj21A_NormVyEdgeRight 4000;
BA_ "GenSigStartValue" SG_ 140 VFC_Obj21A_HeadingAngle 157;
BA_ "GenSigStartValue" SG_ 142 VFC_Obj22A_Dy 8000;
BA_ "GenSigStartValue" SG_ 142 VFC_Obj22A_Vx 1540;
BA_ "GenSigStartValue" SG_ 142 VFC_Obj22A_Vy 500;
BA_ "GenSigStartValue" SG_ 142 VFC_Obj22A_Ax 160;
BA_ "GenSigStartValue" SG_ 142 VFC_Obj22A_Ay 120;
BA_ "GenSigStartValue" SG_ 142 VFC_Obj22A_EdgeLeft 4000;
BA_ "GenSigStartValue" SG_ 142 VFC_Obj22A_EdgeMid 4000;
BA_ "GenSigStartValue" SG_ 142 VFC_Obj22A_EdgeRight 4000;
BA_ "GenSigStartValue" SG_ 142 VFC_Obj22A_EdgeTop 2000;
BA_ "GenSigStartValue" SG_ 142 VFC_Obj22A_EdgeBottom 2000;
BA_ "GenSigStartValue" SG_ 142 VFC_Obj22A_NormVx 40000;
BA_ "GenSigStartValue" SG_ 142 VFC_Obj22A_NormAx 5000;
BA_ "GenSigStartValue" SG_ 142 VFC_Obj22A_NormVyEdgeLeft 4000;
BA_ "GenSigStartValue" SG_ 142 VFC_Obj22A_NormVyEdgeRight 4000;
BA_ "GenSigStartValue" SG_ 142 VFC_Obj22A_HeadingAngle 157;
BA_ "GenSigStartValue" SG_ 144 VFC_Obj23A_Dy 8000;
BA_ "GenSigStartValue" SG_ 144 VFC_Obj23A_Vx 1540;
BA_ "GenSigStartValue" SG_ 144 VFC_Obj23A_Vy 500;
BA_ "GenSigStartValue" SG_ 144 VFC_Obj23A_Ax 160;
BA_ "GenSigStartValue" SG_ 144 VFC_Obj23A_Ay 120;
BA_ "GenSigStartValue" SG_ 144 VFC_Obj23A_EdgeLeft 4000;
BA_ "GenSigStartValue" SG_ 144 VFC_Obj23A_EdgeMid 4000;
BA_ "GenSigStartValue" SG_ 144 VFC_Obj23A_EdgeRight 4000;
BA_ "GenSigStartValue" SG_ 144 VFC_Obj23A_EdgeTop 2000;
BA_ "GenSigStartValue" SG_ 144 VFC_Obj23A_EdgeBottom 2000;
BA_ "GenSigStartValue" SG_ 144 VFC_Obj23A_NormVx 40000;
BA_ "GenSigStartValue" SG_ 144 VFC_Obj23A_NormAx 5000;
BA_ "GenSigStartValue" SG_ 144 VFC_Obj23A_NormVyEdgeLeft 4000;
BA_ "GenSigStartValue" SG_ 144 VFC_Obj23A_NormVyEdgeRight 4000;
BA_ "GenSigStartValue" SG_ 144 VFC_Obj23A_HeadingAngle 157;
BA_ "GenSigStartValue" SG_ 200 VFC_Cloth00_Dy 2048;
BA_ "GenSigStartValue" SG_ 200 VFC_Cloth00_Curv 2048;
BA_ "GenSigStartValue" SG_ 200 VFC_Cloth00_CurvChange 8388607;
BA_ "GenSigStartValue" SG_ 200 VFC_Cloth00_HeadingAngle 2048;
BA_ "GenSigStartValue" SG_ 201 VFC_Cloth01_Dy 2048;
BA_ "GenSigStartValue" SG_ 201 VFC_Cloth01_Curv 2048;
BA_ "GenSigStartValue" SG_ 201 VFC_Cloth01_CurvChange 8388607;
BA_ "GenSigStartValue" SG_ 201 VFC_Cloth01_HeadingAngle 2048;
BA_ "GenSigStartValue" SG_ 202 VFC_Cloth02_Dy 2048;
BA_ "GenSigStartValue" SG_ 202 VFC_Cloth02_Curv 2048;
BA_ "GenSigStartValue" SG_ 202 VFC_Cloth02_CurvChange 8388607;
BA_ "GenSigStartValue" SG_ 202 VFC_Cloth02_HeadingAngle 2048;
BA_ "GenSigStartValue" SG_ 203 VFC_Cloth03_Dy 2048;
BA_ "GenSigStartValue" SG_ 203 VFC_Cloth03_Curv 2048;
BA_ "GenSigStartValue" SG_ 203 VFC_Cloth03_CurvChange 8388607;
BA_ "GenSigStartValue" SG_ 203 VFC_Cloth03_HeadingAngle 2048;
BA_ "GenSigStartValue" SG_ 204 VFC_Cloth04_Dy 2048;
BA_ "GenSigStartValue" SG_ 204 VFC_Cloth04_Curv 2048;
BA_ "GenSigStartValue" SG_ 204 VFC_Cloth04_CurvChange 8388607;
BA_ "GenSigStartValue" SG_ 204 VFC_Cloth04_HeadingAngle 2048;
BA_ "GenSigStartValue" SG_ 205 VFC_Cloth05_Dy 2048;
BA_ "GenSigStartValue" SG_ 205 VFC_Cloth05_Curv 2048;
BA_ "GenSigStartValue" SG_ 205 VFC_Cloth05_CurvChange 8388607;
BA_ "GenSigStartValue" SG_ 205 VFC_Cloth05_HeadingAngle 2048;
BA_ "GenSigStartValue" SG_ 206 VFC_Cloth06_Dy 2048;
BA_ "GenSigStartValue" SG_ 206 VFC_Cloth06_Curv 2048;
BA_ "GenSigStartValue" SG_ 206 VFC_Cloth06_CurvChange 8388607;
BA_ "GenSigStartValue" SG_ 206 VFC_Cloth06_HeadingAngle 2048;
BA_ "GenSigStartValue" SG_ 207 VFC_Cloth07_Dy 2048;
BA_ "GenSigStartValue" SG_ 207 VFC_Cloth07_Curv 2048;
BA_ "GenSigStartValue" SG_ 207 VFC_Cloth07_CurvChange 8388607;
BA_ "GenSigStartValue" SG_ 207 VFC_Cloth07_HeadingAngle 2048;
BA_ "GenSigStartValue" SG_ 210 VFC_PolyA_Line_Left_C0 5128;
BA_ "GenSigStartValue" SG_ 210 VFC_PolyA_Line_Left_C1 11709;
BA_ "GenSigStartValue" SG_ 210 VFC_PolyA_Line_Left_C2 4098;
BA_ "GenSigStartValue" SG_ 210 VFC_PolyA_Line_Left_C3 14492;
BA_ "GenSigStartValue" SG_ 210 VFC_PolyA_Line_Right_C0 5128;
BA_ "GenSigStartValue" SG_ 210 VFC_PolyA_Line_Right_C1 11709;
BA_ "GenSigStartValue" SG_ 210 VFC_PolyA_Line_Right_C2 4098;
BA_ "GenSigStartValue" SG_ 210 VFC_PolyA_Line_Right_C3 14492;
BA_ "GenSigStartValue" SG_ 210 VFC_PolyA_Line_LeftLeft_C0 5128;
BA_ "GenSigStartValue" SG_ 210 VFC_PolyA_Line_LeftLeft_C1 11709;
BA_ "GenSigStartValue" SG_ 210 VFC_PolyA_Line_LeftLeft_C2 4098;
BA_ "GenSigStartValue" SG_ 210 VFC_PolyA_Line_LeftLeft_C3 14492;
BA_ "GenSigStartValue" SG_ 210 VFC_PolyA_Line_RightRight_C0 5128;
BA_ "GenSigStartValue" SG_ 210 VFC_PolyA_Line_RightRight_C1 11709;
BA_ "GenSigStartValue" SG_ 210 VFC_PolyA_Line_RightRight_C2 4098;
BA_ "GenSigStartValue" SG_ 210 VFC_PolyA_Line_RightRight_C3 14492;
BA_ "GenSigStartValue" SG_ 211 VFC_PolyB_Line_RoadLineLeft_C0 5128;
BA_ "GenSigStartValue" SG_ 211 VFC_PolyB_Line_RoadLineLeft_C1 11709;
BA_ "GenSigStartValue" SG_ 211 VFC_PolyB_Line_RoadLineLeft_C2 4098;
BA_ "GenSigStartValue" SG_ 211 VFC_PolyB_Line_RoadLineLeft_C3 14492;
BA_ "GenSigStartValue" SG_ 211 VFC_PolyB_Line_RoadLineRight_C0 5128;
BA_ "GenSigStartValue" SG_ 211 VFC_PolyB_Line_RoadLineRight_C1 11709;
BA_ "GenSigStartValue" SG_ 211 VFC_PolyB_Line_RoadLineRight_C2 4098;
BA_ "GenSigStartValue" SG_ 211 VFC_PolyB_Line_RoadLineRight_C3 14492;
BA_ "GenSigStartValue" SG_ 211 VFC_PolyB_Line_EgotrackLeft_C0 5128;
BA_ "GenSigStartValue" SG_ 211 VFC_PolyB_Line_EgotrackLeft_C1 11709;
BA_ "GenSigStartValue" SG_ 211 VFC_PolyB_Line_EgotrackLeft_C2 4098;
BA_ "GenSigStartValue" SG_ 211 VFC_PolyB_Line_EgotrackLeft_C3 14492;
BA_ "GenSigStartValue" SG_ 211 VFC_PolyB_Line_EgotrackRight_C0 5128;
BA_ "GenSigStartValue" SG_ 211 VFC_PolyB_Line_EgotrackRight_C1 11709;
BA_ "GenSigStartValue" SG_ 211 VFC_PolyB_Line_EgotrackRight_C2 4098;
BA_ "GenSigStartValue" SG_ 211 VFC_PolyB_Line_EgotrackRight_C3 14492;
BA_ "GenSigStartValue" SG_ 238 VFC_TS00_Dy 128;
BA_ "GenSigStartValue" SG_ 239 VFC_TS01_Dy 128;
VAL_ 128 VFC_Obj15A_ID 0 "INVALID" ;
VAL_ 128 VFC_Obj15A_Type 0 "NOTYPE" 1 "CAR" 2 "RESERVED02" 3 "TRUCK" 4 "RESERVED04" 5 "RESERVED05" 6 "MOTORCYCLIST" 7 "PEDESTRIAN" 8 "CYCLIST" 9 "BOLLARD" 10 "ROADPOST" 11 "ARROWPOST" 12 "RESERVED12" 13 "RESERVED13" 14 "RESERVED14" 15 "RESERVED15" ;
VAL_ 128 VFC_Obj15A_HeadOrientation 0 "N/A" 1 "Head front" 2 "Head left front" 3 "Head left" 4 "Head left back" 5 "Head back" 6 "Head right back" 7 "Head right" 8 "Head right front" 9 "Reserved09" 10 "Reserved10" 11 "Reserved11" 12 "Reserved12" 13 "Reserved13" 14 "Reserved14" 15 "Unknown" ;
VAL_ 128 VFC_Obj15A_CompletelyInImg 0 "not completely measured" 1 "completely measured" ;
VAL_ 128 VFC_Obj15A_Measured 0 "Invalid" 1 "Measured" 2 "Predicted" 3 "Reserved3" ;
VAL_ 128 VFC_Obj15A_VisibleView 0 "UNKNOWN" 1 "CLASSIC" 2 "SIDE" 3 "CLASSIC_SIDE" 4 "SIDE_CLASSIC" ;
VAL_ 128 VFC_Obj15A_ClassifiedView 0 "Unknown" 1 "Front" 2 "Rear" 3 "Left" 4 "Right" ;
VAL_ 128 VFC_Obj15A_DirIndicator 0 "Unknown" 1 "No direction indicator" 2 "Left indicator" 3 "Right indicator" 4 "Warning Lights" ;
VAL_ 128 VFC_Obj15A_BrakeLight 0 "Unknown" 1 "No light detected" 2 "One light detected" 3 "Two lights detected" 4 "Three lights detected" 5 "Reserved5" 6 "Reserved6" 7 "Reserved7" ;
VAL_ 130 VFC_Obj16A_ID 0 "INVALID" ;
VAL_ 130 VFC_Obj16A_Type 0 "NOTYPE" 1 "CAR" 2 "RESERVED02" 3 "TRUCK" 4 "RESERVED04" 5 "RESERVED05" 6 "MOTORCYCLIST" 7 "PEDESTRIAN" 8 "CYCLIST" 9 "BOLLARD" 10 "ROADPOST" 11 "ARROWPOST" 12 "RESERVED12" 13 "RESERVED13" 14 "RESERVED14" 15 "RESERVED15" ;
VAL_ 130 VFC_Obj16A_HeadOrientation 0 "N/A" 1 "Head front" 2 "Head left front" 3 "Head left" 4 "Head left back" 5 "Head back" 6 "Head right back" 7 "Head right" 8 "Head right front" 9 "Reserved09" 10 "Reserved10" 11 "Reserved11" 12 "Reserved12" 13 "Reserved13" 14 "Reserved14" 15 "Unknown" ;
VAL_ 130 VFC_Obj16A_CompletelyInImg 0 "not completely measured" 1 "completely measured" ;
VAL_ 130 VFC_Obj16A_Measured 0 "Invalid" 1 "Measured" 2 "Predicted" 3 "Reserved3" ;
VAL_ 130 VFC_Obj16A_VisibleView 0 "UNKNOWN" 1 "CLASSIC" 2 "SIDE" 3 "CLASSIC_SIDE" 4 "SIDE_CLASSIC" ;
VAL_ 130 VFC_Obj16A_ClassifiedView 0 "Unknown" 1 "Front" 2 "Rear" 3 "Left" 4 "Right" ;
VAL_ 130 VFC_Obj16A_DirIndicator 0 "Unknown" 1 "No direction indicator" 2 "Left indicator" 3 "Right indicator" 4 "Warning Lights" ;
VAL_ 130 VFC_Obj16A_BrakeLight 0 "Unknown" 1 "No light detected" 2 "One light detected" 3 "Two lights detected" 4 "Three lights detected" 5 "Reserved5" 6 "Reserved6" 7 "Reserved7" ;
VAL_ 132 VFC_Obj17A_ID 0 "INVALID" ;
VAL_ 132 VFC_Obj17A_Type 0 "NOTYPE" 1 "CAR" 2 "RESERVED02" 3 "TRUCK" 4 "RESERVED04" 5 "RESERVED05" 6 "MOTORCYCLIST" 7 "PEDESTRIAN" 8 "CYCLIST" 9 "BOLLARD" 10 "ROADPOST" 11 "ARROWPOST" 12 "RESERVED12" 13 "RESERVED13" 14 "RESERVED14" 15 "RESERVED15" ;
VAL_ 132 VFC_Obj17A_HeadOrientation 0 "N/A" 1 "Head front" 2 "Head left front" 3 "Head left" 4 "Head left back" 5 "Head back" 6 "Head right back" 7 "Head right" 8 "Head right front" 9 "Reserved09" 10 "Reserved10" 11 "Reserved11" 12 "Reserved12" 13 "Reserved13" 14 "Reserved14" 15 "Unknown" ;
VAL_ 132 VFC_Obj17A_CompletelyInImg 0 "not completely measured" 1 "completely measured" ;
VAL_ 132 VFC_Obj17A_Measured 0 "Invalid" 1 "Measured" 2 "Predicted" 3 "Reserved3" ;
VAL_ 132 VFC_Obj17A_VisibleView 0 "UNKNOWN" 1 "CLASSIC" 2 "SIDE" 3 "CLASSIC_SIDE" 4 "SIDE_CLASSIC" ;
VAL_ 132 VFC_Obj17A_ClassifiedView 0 "Unknown" 1 "Front" 2 "Rear" 3 "Left" 4 "Right" ;
VAL_ 132 VFC_Obj17A_DirIndicator 0 "Unknown" 1 "No direction indicator" 2 "Left indicator" 3 "Right indicator" 4 "Warning Lights" ;
VAL_ 132 VFC_Obj17A_BrakeLight 0 "Unknown" 1 "No light detected" 2 "One light detected" 3 "Two lights detected" 4 "Three lights detected" 5 "Reserved5" 6 "Reserved6" 7 "Reserved7" ;
VAL_ 134 VFC_Obj18A_ID 0 "INVALID" ;
VAL_ 134 VFC_Obj18A_Type 0 "NOTYPE" 1 "CAR" 2 "RESERVED02" 3 "TRUCK" 4 "RESERVED04" 5 "RESERVED05" 6 "MOTORCYCLIST" 7 "PEDESTRIAN" 8 "CYCLIST" 9 "BOLLARD" 10 "ROADPOST" 11 "ARROWPOST" 12 "RESERVED12" 13 "RESERVED13" 14 "RESERVED14" 15 "RESERVED15" ;
VAL_ 134 VFC_Obj18A_HeadOrientation 0 "N/A" 1 "Head front" 2 "Head left front" 3 "Head left" 4 "Head left back" 5 "Head back" 6 "Head right back" 7 "Head right" 8 "Head right front" 9 "Reserved09" 10 "Reserved10" 11 "Reserved11" 12 "Reserved12" 13 "Reserved13" 14 "Reserved14" 15 "Unknown" ;
VAL_ 134 VFC_Obj18A_CompletelyInImg 0 "not completely measured" 1 "completely measured" ;
VAL_ 134 VFC_Obj18A_Measured 0 "Invalid" 1 "Measured" 2 "Predicted" 3 "Reserved3" ;
VAL_ 134 VFC_Obj18A_VisibleView 0 "UNKNOWN" 1 "CLASSIC" 2 "SIDE" 3 "CLASSIC_SIDE" 4 "SIDE_CLASSIC" ;
VAL_ 134 VFC_Obj18A_ClassifiedView 0 "Unknown" 1 "Front" 2 "Rear" 3 "Left" 4 "Right" ;
VAL_ 134 VFC_Obj18A_DirIndicator 0 "Unknown" 1 "No direction indicator" 2 "Left indicator" 3 "Right indicator" 4 "Warning Lights" ;
VAL_ 134 VFC_Obj18A_BrakeLight 0 "Unknown" 1 "No light detected" 2 "One light detected" 3 "Two lights detected" 4 "Three lights detected" 5 "Reserved5" 6 "Reserved6" 7 "Reserved7" ;
VAL_ 136 VFC_Obj19A_ID 0 "INVALID" ;
VAL_ 136 VFC_Obj19A_Type 0 "NOTYPE" 1 "CAR" 2 "RESERVED02" 3 "TRUCK" 4 "RESERVED04" 5 "RESERVED05" 6 "MOTORCYCLIST" 7 "PEDESTRIAN" 8 "CYCLIST" 9 "BOLLARD" 10 "ROADPOST" 11 "ARROWPOST" 12 "RESERVED12" 13 "RESERVED13" 14 "RESERVED14" 15 "RESERVED15" ;
VAL_ 136 VFC_Obj19A_HeadOrientation 0 "N/A" 1 "Head front" 2 "Head left front" 3 "Head left" 4 "Head left back" 5 "Head back" 6 "Head right back" 7 "Head right" 8 "Head right front" 9 "Reserved09" 10 "Reserved10" 11 "Reserved11" 12 "Reserved12" 13 "Reserved13" 14 "Reserved14" 15 "Unknown" ;
VAL_ 136 VFC_Obj19A_CompletelyInImg 0 "not completely measured" 1 "completely measured" ;
VAL_ 136 VFC_Obj19A_Measured 0 "Invalid" 1 "Measured" 2 "Predicted" 3 "Reserved3" ;
VAL_ 136 VFC_Obj19A_VisibleView 0 "UNKNOWN" 1 "CLASSIC" 2 "SIDE" 3 "CLASSIC_SIDE" 4 "SIDE_CLASSIC" ;
VAL_ 136 VFC_Obj19A_ClassifiedView 0 "Unknown" 1 "Front" 2 "Rear" 3 "Left" 4 "Right" ;
VAL_ 136 VFC_Obj19A_DirIndicator 0 "Unknown" 1 "No direction indicator" 2 "Left indicator" 3 "Right indicator" 4 "Warning Lights" ;
VAL_ 136 VFC_Obj19A_BrakeLight 0 "Unknown" 1 "No light detected" 2 "One light detected" 3 "Two lights detected" 4 "Three lights detected" 5 "Reserved5" 6 "Reserved6" 7 "Reserved7" ;
VAL_ 138 VFC_Obj20A_ID 0 "INVALID" ;
VAL_ 138 VFC_Obj20A_Type 0 "NOTYPE" 1 "CAR" 2 "RESERVED02" 3 "TRUCK" 4 "RESERVED04" 5 "RESERVED05" 6 "MOTORCYCLIST" 7 "PEDESTRIAN" 8 "CYCLIST" 9 "BOLLARD" 10 "ROADPOST" 11 "ARROWPOST" 12 "RESERVED12" 13 "RESERVED13" 14 "RESERVED14" 15 "RESERVED15" ;
VAL_ 138 VFC_Obj20A_HeadOrientation 0 "N/A" 1 "Head front" 2 "Head left front" 3 "Head left" 4 "Head left back" 5 "Head back" 6 "Head right back" 7 "Head right" 8 "Head right front" 9 "Reserved09" 10 "Reserved10" 11 "Reserved11" 12 "Reserved12" 13 "Reserved13" 14 "Reserved14" 15 "Unknown" ;
VAL_ 138 VFC_Obj20A_CompletelyInImg 0 "not completely measured" 1 "completely measured" ;
VAL_ 138 VFC_Obj20A_Measured 0 "Invalid" 1 "Measured" 2 "Predicted" 3 "Reserved3" ;
VAL_ 138 VFC_Obj20A_VisibleView 0 "UNKNOWN" 1 "CLASSIC" 2 "SIDE" 3 "CLASSIC_SIDE" 4 "SIDE_CLASSIC" ;
VAL_ 138 VFC_Obj20A_ClassifiedView 0 "Unknown" 1 "Front" 2 "Rear" 3 "Left" 4 "Right" ;
VAL_ 138 VFC_Obj20A_DirIndicator 0 "Unknown" 1 "No direction indicator" 2 "Left indicator" 3 "Right indicator" 4 "Warning Lights" ;
VAL_ 138 VFC_Obj20A_BrakeLight 0 "Unknown" 1 "No light detected" 2 "One light detected" 3 "Two lights detected" 4 "Three lights detected" 5 "Reserved5" 6 "Reserved6" 7 "Reserved7" ;
VAL_ 140 VFC_Obj21A_ID 0 "INVALID" ;
VAL_ 140 VFC_Obj21A_Type 0 "NOTYPE" 1 "CAR" 2 "RESERVED02" 3 "TRUCK" 4 "RESERVED04" 5 "RESERVED05" 6 "MOTORCYCLIST" 7 "PEDESTRIAN" 8 "CYCLIST" 9 "BOLLARD" 10 "ROADPOST" 11 "ARROWPOST" 12 "RESERVED12" 13 "RESERVED13" 14 "RESERVED14" 15 "RESERVED15" ;
VAL_ 140 VFC_Obj21A_HeadOrientation 0 "N/A" 1 "Head front" 2 "Head left front" 3 "Head left" 4 "Head left back" 5 "Head back" 6 "Head right back" 7 "Head right" 8 "Head right front" 9 "Reserved09" 10 "Reserved10" 11 "Reserved11" 12 "Reserved12" 13 "Reserved13" 14 "Reserved14" 15 "Unknown" ;
VAL_ 140 VFC_Obj21A_CompletelyInImg 0 "not completely measured" 1 "completely measured" ;
VAL_ 140 VFC_Obj21A_Measured 0 "Invalid" 1 "Measured" 2 "Predicted" 3 "Reserved3" ;
VAL_ 140 VFC_Obj21A_VisibleView 0 "UNKNOWN" 1 "CLASSIC" 2 "SIDE" 3 "CLASSIC_SIDE" 4 "SIDE_CLASSIC" ;
VAL_ 140 VFC_Obj21A_ClassifiedView 0 "Unknown" 1 "Front" 2 "Rear" 3 "Left" 4 "Right" ;
VAL_ 140 VFC_Obj21A_DirIndicator 0 "Unknown" 1 "No direction indicator" 2 "Left indicator" 3 "Right indicator" 4 "Warning Lights" ;
VAL_ 140 VFC_Obj21A_BrakeLight 0 "Unknown" 1 "No light detected" 2 "One light detected" 3 "Two lights detected" 4 "Three lights detected" 5 "Reserved5" 6 "Reserved6" 7 "Reserved7" ;
VAL_ 142 VFC_Obj22A_ID 0 "INVALID" ;
VAL_ 142 VFC_Obj22A_Type 0 "NOTYPE" 1 "CAR" 2 "RESERVED02" 3 "TRUCK" 4 "RESERVED04" 5 "RESERVED05" 6 "MOTORCYCLIST" 7 "PEDESTRIAN" 8 "CYCLIST" 9 "BOLLARD" 10 "ROADPOST" 11 "ARROWPOST" 12 "RESERVED12" 13 "RESERVED13" 14 "RESERVED14" 15 "RESERVED15" ;
VAL_ 142 VFC_Obj22A_HeadOrientation 0 "N/A" 1 "Head front" 2 "Head left front" 3 "Head left" 4 "Head left back" 5 "Head back" 6 "Head right back" 7 "Head right" 8 "Head right front" 9 "Reserved09" 10 "Reserved10" 11 "Reserved11" 12 "Reserved12" 13 "Reserved13" 14 "Reserved14" 15 "Unknown" ;
VAL_ 142 VFC_Obj22A_CompletelyInImg 0 "not completely measured" 1 "completely measured" ;
VAL_ 142 VFC_Obj22A_Measured 0 "Invalid" 1 "Measured" 2 "Predicted" 3 "Reserved3" ;
VAL_ 142 VFC_Obj22A_VisibleView 0 "UNKNOWN" 1 "CLASSIC" 2 "SIDE" 3 "CLASSIC_SIDE" 4 "SIDE_CLASSIC" ;
VAL_ 142 VFC_Obj22A_ClassifiedView 0 "Unknown" 1 "Front" 2 "Rear" 3 "Left" 4 "Right" ;
VAL_ 142 VFC_Obj22A_DirIndicator 0 "Unknown" 1 "No direction indicator" 2 "Left indicator" 3 "Right indicator" 4 "Warning Lights" ;
VAL_ 142 VFC_Obj22A_BrakeLight 0 "Unknown" 1 "No light detected" 2 "One light detected" 3 "Two lights detected" 4 "Three lights detected" 5 "Reserved5" 6 "Reserved6" 7 "Reserved7" ;
VAL_ 144 VFC_Obj23A_ID 0 "INVALID" ;
VAL_ 144 VFC_Obj23A_Type 0 "NOTYPE" 1 "CAR" 2 "RESERVED02" 3 "TRUCK" 4 "RESERVED04" 5 "RESERVED05" 6 "MOTORCYCLIST" 7 "PEDESTRIAN" 8 "CYCLIST" 9 "BOLLARD" 10 "ROADPOST" 11 "ARROWPOST" 12 "RESERVED12" 13 "RESERVED13" 14 "RESERVED14" 15 "RESERVED15" ;
VAL_ 144 VFC_Obj23A_HeadOrientation 0 "N/A" 1 "Head front" 2 "Head left front" 3 "Head left" 4 "Head left back" 5 "Head back" 6 "Head right back" 7 "Head right" 8 "Head right front" 9 "Reserved09" 10 "Reserved10" 11 "Reserved11" 12 "Reserved12" 13 "Reserved13" 14 "Reserved14" 15 "Unknown" ;
VAL_ 144 VFC_Obj23A_CompletelyInImg 0 "not completely measured" 1 "completely measured" ;
VAL_ 144 VFC_Obj23A_Measured 0 "Invalid" 1 "Measured" 2 "Predicted" 3 "Reserved3" ;
VAL_ 144 VFC_Obj23A_VisibleView 0 "UNKNOWN" 1 "CLASSIC" 2 "SIDE" 3 "CLASSIC_SIDE" 4 "SIDE_CLASSIC" ;
VAL_ 144 VFC_Obj23A_ClassifiedView 0 "Unknown" 1 "Front" 2 "Rear" 3 "Left" 4 "Right" ;
VAL_ 144 VFC_Obj23A_DirIndicator 0 "Unknown" 1 "No direction indicator" 2 "Left indicator" 3 "Right indicator" 4 "Warning Lights" ;
VAL_ 144 VFC_Obj23A_BrakeLight 0 "Unknown" 1 "No light detected" 2 "One light detected" 3 "Two lights detected" 4 "Three lights detected" 5 "Reserved5" 6 "Reserved6" 7 "Reserved7" ;
VAL_ 198 VFC_LaneHdr_State 0 "Off" 1 "On" 2 "Reduced" 3 "HW_Error" 4 "SW_Error" 5 "FID_Active" 6 "Reserved6" 7 "Reserved7" ;
VAL_ 200 VFC_Cloth00_LineNumber 0 "LEFT_EGO_LINE" 1 "RIGHT_EGO_LINE" 2 "LEFT_LEFT_LINE" 3 "RIGHT_RIGHT_LINE" 4 "ROAD_EDGE_LEFT" 5 "ROAD_EDGE_RIGHT" 6 "RAISED_LEFT" 7 "RAISED_RIGHT" ;
VAL_ 200 VFC_Cloth00_Type 0 "TYPE_SOLID_LINE" 1 "TYPE_DASHED_LINE" 2 "TYPE_DOUBLE_DASHED_DASHED" 3 "TYPE_DOUBLE_DASHED_SOLID" 4 "TYPE_DOUBLE_SOLID_DASHED" 5 "TYPE_DOUBLE_SOLID_SOLID" 6 "TYPE_MULTIPLE" 7 "TYPE_MULTIPLE_WARNING" 8 "TYPE_BOTTS_DOTS" 9 "TYPE_ROAD_EDGE" 10 "TYPE_ROAD_FURNITURE" 11 "TYPE_CURBSTONE" 12 "TYPE_TRAFFIC_STATIC" 13 "TYPE_UNKNOWN_RAISED" 14 "TYPE_UNKNOWN" ;
VAL_ 200 VFC_Cloth00_ColorClass 0 "COLOR_WHITE" 1 "COLOR_YELLOW" 2 "COLOR_RED" 3 "COLOR_BLUE" 4 "COLOR_GREEN" 5 "RESERVED5" 6 "RESERVED6" 7 "COLOR_UNKNOWN" ;
VAL_ 201 VFC_Cloth01_LineNumber 0 "LEFT_EGO_LINE" 1 "RIGHT_EGO_LINE" 2 "LEFT_LEFT_LINE" 3 "RIGHT_RIGHT_LINE" 4 "ROAD_EDGE_LEFT" 5 "ROAD_EDGE_RIGHT" 6 "RAISED_LEFT" 7 "RAISED_RIGHT" ;
VAL_ 201 VFC_Cloth01_Type 0 "TYPE_SOLID_LINE" 1 "TYPE_DASHED_LINE" 2 "TYPE_DOUBLE_DASHED_DASHED" 3 "TYPE_DOUBLE_DASHED_SOLID" 4 "TYPE_DOUBLE_SOLID_DASHED" 5 "TYPE_DOUBLE_SOLID_SOLID" 6 "TYPE_MULTIPLE" 7 "TYPE_MULTIPLE_WARNING" 8 "TYPE_BOTTS_DOTS" 9 "TYPE_ROAD_EDGE" 10 "TYPE_ROAD_FURNITURE" 11 "TYPE_CURBSTONE" 12 "TYPE_TRAFFIC_STATIC" 13 "TYPE_UNKNOWN_RAISED" 14 "TYPE_UNKNOWN" ;
VAL_ 201 VFC_Cloth01_ColorClass 0 "COLOR_WHITE" 1 "COLOR_YELLOW" 2 "COLOR_RED" 3 "COLOR_BLUE" 4 "COLOR_GREEN" 5 "RESERVED5" 6 "RESERVED6" 7 "COLOR_UNKNOWN" ;
VAL_ 202 VFC_Cloth02_LineNumber 0 "LEFT_EGO_LINE" 1 "RIGHT_EGO_LINE" 2 "LEFT_LEFT_LINE" 3 "RIGHT_RIGHT_LINE" 4 "ROAD_EDGE_LEFT" 5 "ROAD_EDGE_RIGHT" 6 "RAISED_LEFT" 7 "RAISED_RIGHT" ;
VAL_ 202 VFC_Cloth02_Type 0 "TYPE_SOLID_LINE" 1 "TYPE_DASHED_LINE" 2 "TYPE_DOUBLE_DASHED_DASHED" 3 "TYPE_DOUBLE_DASHED_SOLID" 4 "TYPE_DOUBLE_SOLID_DASHED" 5 "TYPE_DOUBLE_SOLID_SOLID" 6 "TYPE_MULTIPLE" 7 "TYPE_MULTIPLE_WARNING" 8 "TYPE_BOTTS_DOTS" 9 "TYPE_ROAD_EDGE" 10 "TYPE_ROAD_FURNITURE" 11 "TYPE_CURBSTONE" 12 "TYPE_TRAFFIC_STATIC" 13 "TYPE_UNKNOWN_RAISED" 14 "TYPE_UNKNOWN" ;
VAL_ 202 VFC_Cloth02_ColorClass 0 "COLOR_WHITE" 1 "COLOR_YELLOW" 2 "COLOR_RED" 3 "COLOR_BLUE" 4 "COLOR_GREEN" 5 "RESERVED5" 6 "RESERVED6" 7 "COLOR_UNKNOWN" ;
VAL_ 203 VFC_Cloth03_LineNumber 0 "LEFT_EGO_LINE" 1 "RIGHT_EGO_LINE" 2 "LEFT_LEFT_LINE" 3 "RIGHT_RIGHT_LINE" 4 "ROAD_EDGE_LEFT" 5 "ROAD_EDGE_RIGHT" 6 "RAISED_LEFT" 7 "RAISED_RIGHT" ;
VAL_ 203 VFC_Cloth03_Type 0 "TYPE_SOLID_LINE" 1 "TYPE_DASHED_LINE" 2 "TYPE_DOUBLE_DASHED_DASHED" 3 "TYPE_DOUBLE_DASHED_SOLID" 4 "TYPE_DOUBLE_SOLID_DASHED" 5 "TYPE_DOUBLE_SOLID_SOLID" 6 "TYPE_MULTIPLE" 7 "TYPE_MULTIPLE_WARNING" 8 "TYPE_BOTTS_DOTS" 9 "TYPE_ROAD_EDGE" 10 "TYPE_ROAD_FURNITURE" 11 "TYPE_CURBSTONE" 12 "TYPE_TRAFFIC_STATIC" 13 "TYPE_UNKNOWN_RAISED" 14 "TYPE_UNKNOWN" ;
VAL_ 203 VFC_Cloth03_ColorClass 0 "COLOR_WHITE" 1 "COLOR_YELLOW" 2 "COLOR_RED" 3 "COLOR_BLUE" 4 "COLOR_GREEN" 5 "RESERVED5" 6 "RESERVED6" 7 "COLOR_UNKNOWN" ;
VAL_ 204 VFC_Cloth04_LineNumber 0 "LEFT_EGO_LINE" 1 "RIGHT_EGO_LINE" 2 "LEFT_LEFT_LINE" 3 "RIGHT_RIGHT_LINE" 4 "ROAD_EDGE_LEFT" 5 "ROAD_EDGE_RIGHT" 6 "RAISED_LEFT" 7 "RAISED_RIGHT" ;
VAL_ 204 VFC_Cloth04_Type 0 "TYPE_SOLID_LINE" 1 "TYPE_DASHED_LINE" 2 "TYPE_DOUBLE_DASHED_DASHED" 3 "TYPE_DOUBLE_DASHED_SOLID" 4 "TYPE_DOUBLE_SOLID_DASHED" 5 "TYPE_DOUBLE_SOLID_SOLID" 6 "TYPE_MULTIPLE" 7 "TYPE_MULTIPLE_WARNING" 8 "TYPE_BOTTS_DOTS" 9 "TYPE_ROAD_EDGE" 10 "TYPE_ROAD_FURNITURE" 11 "TYPE_CURBSTONE" 12 "TYPE_TRAFFIC_STATIC" 13 "TYPE_UNKNOWN_RAISED" 14 "TYPE_UNKNOWN" ;
VAL_ 204 VFC_Cloth04_ColorClass 0 "COLOR_WHITE" 1 "COLOR_YELLOW" 2 "COLOR_RED" 3 "COLOR_BLUE" 4 "COLOR_GREEN" 5 "RESERVED5" 6 "RESERVED6" 7 "COLOR_UNKNOWN" ;
VAL_ 205 VFC_Cloth05_LineNumber 0 "LEFT_EGO_LINE" 1 "RIGHT_EGO_LINE" 2 "LEFT_LEFT_LINE" 3 "RIGHT_RIGHT_LINE" 4 "ROAD_EDGE_LEFT" 5 "ROAD_EDGE_RIGHT" 6 "RAISED_LEFT" 7 "RAISED_RIGHT" ;
VAL_ 205 VFC_Cloth05_Type 0 "TYPE_SOLID_LINE" 1 "TYPE_DASHED_LINE" 2 "TYPE_DOUBLE_DASHED_DASHED" 3 "TYPE_DOUBLE_DASHED_SOLID" 4 "TYPE_DOUBLE_SOLID_DASHED" 5 "TYPE_DOUBLE_SOLID_SOLID" 6 "TYPE_MULTIPLE" 7 "TYPE_MULTIPLE_WARNING" 8 "TYPE_BOTTS_DOTS" 9 "TYPE_ROAD_EDGE" 10 "TYPE_ROAD_FURNITURE" 11 "TYPE_CURBSTONE" 12 "TYPE_TRAFFIC_STATIC" 13 "TYPE_UNKNOWN_RAISED" 14 "TYPE_UNKNOWN" ;
VAL_ 205 VFC_Cloth05_ColorClass 0 "COLOR_WHITE" 1 "COLOR_YELLOW" 2 "COLOR_RED" 3 "COLOR_BLUE" 4 "COLOR_GREEN" 5 "RESERVED5" 6 "RESERVED6" 7 "COLOR_UNKNOWN" ;
VAL_ 206 VFC_Cloth06_LineNumber 0 "LEFT_EGO_LINE" 1 "RIGHT_EGO_LINE" 2 "LEFT_LEFT_LINE" 3 "RIGHT_RIGHT_LINE" 4 "ROAD_EDGE_LEFT" 5 "ROAD_EDGE_RIGHT" 6 "RAISED_LEFT" 7 "RAISED_RIGHT" ;
VAL_ 206 VFC_Cloth06_Type 0 "TYPE_SOLID_LINE" 1 "TYPE_DASHED_LINE" 2 "TYPE_DOUBLE_DASHED_DASHED" 3 "TYPE_DOUBLE_DASHED_SOLID" 4 "TYPE_DOUBLE_SOLID_DASHED" 5 "TYPE_DOUBLE_SOLID_SOLID" 6 "TYPE_MULTIPLE" 7 "TYPE_MULTIPLE_WARNING" 8 "TYPE_BOTTS_DOTS" 9 "TYPE_ROAD_EDGE" 10 "TYPE_ROAD_FURNITURE" 11 "TYPE_CURBSTONE" 12 "TYPE_TRAFFIC_STATIC" 13 "TYPE_UNKNOWN_RAISED" 14 "TYPE_UNKNOWN" ;
VAL_ 206 VFC_Cloth06_ColorClass 0 "COLOR_WHITE" 1 "COLOR_YELLOW" 2 "COLOR_RED" 3 "COLOR_BLUE" 4 "COLOR_GREEN" 5 "RESERVED5" 6 "RESERVED6" 7 "COLOR_UNKNOWN" ;
VAL_ 207 VFC_Cloth07_LineNumber 0 "LEFT_EGO_LINE" 1 "RIGHT_EGO_LINE" 2 "LEFT_LEFT_LINE" 3 "RIGHT_RIGHT_LINE" 4 "ROAD_EDGE_LEFT" 5 "ROAD_EDGE_RIGHT" 6 "RAISED_LEFT" 7 "RAISED_RIGHT" ;
VAL_ 207 VFC_Cloth07_Type 0 "TYPE_SOLID_LINE" 1 "TYPE_DASHED_LINE" 2 "TYPE_DOUBLE_DASHED_DASHED" 3 "TYPE_DOUBLE_DASHED_SOLID" 4 "TYPE_DOUBLE_SOLID_DASHED" 5 "TYPE_DOUBLE_SOLID_SOLID" 6 "TYPE_MULTIPLE" 7 "TYPE_MULTIPLE_WARNING" 8 "TYPE_BOTTS_DOTS" 9 "TYPE_ROAD_EDGE" 10 "TYPE_ROAD_FURNITURE" 11 "TYPE_CURBSTONE" 12 "TYPE_TRAFFIC_STATIC" 13 "TYPE_UNKNOWN_RAISED" 14 "TYPE_UNKNOWN" ;
VAL_ 207 VFC_Cloth07_StartPosition 0 "MTYPE_MEASURED" 1 "MTYPE_VIRTUAL" 2 "MTYPE_INTERPOLATED" 3 "MTYPE_UNKNOWN" ;
VAL_ 207 VFC_Cloth07_ColorClass 0 "COLOR_WHITE" 1 "COLOR_YELLOW" 2 "COLOR_RED" 3 "COLOR_BLUE" 4 "COLOR_GREEN" 5 "RESERVED5" 6 "RESERVED6" 7 "COLOR_UNKNOWN" ;
VAL_ 236 VFC_TSHdr_State 0 "Off" 1 "On" 2 "Reduced" 3 "HW_Error" 4 "SW_Error" 5 "FID_Active" 6 "Reserved6" 7 "Reserved7" ;
VAL_ 236 VFC_TSHdr_Brightness 0 "Daylight" 1 "Night" 2 "Reserved2" 3 "Reserved3" 4 "Reserved4" 5 "Reserved5" 6 "Reserved6" 7 "Reserved7" ;
VAL_ 236 VFC_TSHdr_Country 0 "0 Unknown" 4 "Afghanistan" 8 "Albania" 10 "Antarctica" 12 "Algeria" 16 "American Samoa" 20 "Andorra" 24 "Angola" 28 "Antigua and Barbuda" 31 "Azerbaijan" 32 "Argentina" 36 "Australia" 40 "Austria" 44 "Bahamas (the)" 48 "Bahrain" 50 "Bangladesh" 51 "Armenia" 52 "Barbados" 56 "Belgium" 60 "Bermuda" 64 "Bhutan" 68 "Bolivia (Plurinational State of)" 70 "Bosnia and Herzegovina" 72 "Botswana" 74 "Bouvet Island" 76 "Brazil" 84 "Belize" 86 "British Indian Ocean Territory (the)" 90 "Solomon Islands" 92 "Virgin Islands (British)" 96 "Brunei Darussalam" 100 "Bulgaria" 104 "Myanmar" 108 "Burundi" 112 "Belarus" 116 "Cambodia" 120 "Cameroon" 124 "Canada" 132 "Cabo Verde" 136 "Cayman Islands (the)" 140 "Central African Republic (the)" 144 "Sri Lanka" 148 "Chad" 152 "Chile" 156 "China" 158 "Taiwan (Province of China)" 162 "Christmas Island" 166 "Cocos (Keeling) Islands (the)" 170 "Colombia" 174 "Comoros (the)" 175 "Mayotte" 178 "Congo (the)" 180 "Congo (the Democratic Republic of the)" 184 "Cook Islands (the)" 188 "Costa Rica" 191 "Croatia" 192 "Cuba" 196 "Cyprus" 203 "Czechia" 204 "Benin" 208 "Denmark" 212 "Dominica" 214 "Dominican Republic (the)" 218 "Ecuador" 222 "El Salvador" 226 "Equatorial Guinea" 231 "Ethiopia" 232 "Eritrea" 233 "Estonia" 234 "Faroe Islands (the)" 238 "Falkland Islands (the) [Malvinas]" 239 "South Georgia and the South Sandwich Islands" 242 "Fiji" 246 "Finland" 248 "�land Islands" 250 "France" 254 "French Guiana" 258 "French Polynesia" 260 "French Southern Territories (the)" 262 "Djibouti" 266 "Gabon" 268 "Georgia" 270 "Gambia (the)" 275 "Palestine, State of" 276 "Germany" 288 "Ghana" 292 "Gibraltar" 296 "Kiribati" 300 "Greece" 304 "Greenland" 308 "Grenada" 312 "Guadeloupe" 316 "Guam" 320 "Guatemala" 324 "Guinea" 328 "Guyana" 332 "Haiti" 334 "Heard Island and McDonald Islands" 336 "Holy See (the)" 340 "Honduras" 344 "Hong Kong" 348 "Hungary" 352 "Iceland" 356 "India" 360 "Indonesia" 364 "Iran (Islamic Republic of)" 368 "Iraq" 372 "Ireland" 376 "Israel" 380 "Italy" 384 "C�te d'Ivoire" 388 "Jamaica" 392 "Japan" 398 "Kazakhstan" 400 "Jordan" 404 "Kenya" 408 "Korea (the Democratic People's Republic of)" 410 "Korea (the Republic of)" 414 "Kuwait" 417 "Kyrgyzstan" 418 "Lao People's Democratic Republic (the)" 422 "Lebanon" 426 "Lesotho" 428 "Latvia" 430 "Liberia" 434 "Libya" 438 "Liechtenstein" 440 "Lithuania" 442 "Luxembourg" 446 "Macao" 450 "Madagascar" 454 "Malawi" 458 "Malaysia" 462 "Maldives" 466 "Mali" 470 "Malta" 474 "Martinique" 478 "Mauritania" 480 "Mauritius" 484 "Mexico" 492 "Monaco" 496 "Mongolia" 498 "Moldova (the Republic of)" 499 "Montenegro" 500 "Montserrat" 504 "Morocco" 508 "Mozambique" 512 "Oman" 516 "Namibia" 520 "Nauru" 524 "Nepal" 528 "Netherlands (the)" 531 "Cura�ao" 533 "Aruba" 534 "Sint Maarten (Dutch part)" 535 "Bonaire, Sint Eustatius and Saba" 540 "New Caledonia" 548 "Vanuatu" 554 "New Zealand" 558 "Nicaragua" 562 "Niger (the)" 566 "Nigeria" 570 "Niue" 574 "Norfolk Island" 578 "Norway" 580 "Northern Mariana Islands (the)" 581 "United States Minor Outlying Islands (the)" 583 "Micronesia (Federated States of)" 584 "Marshall Islands (the)" 585 "Palau" 586 "Pakistan" 591 "Panama" 598 "Papua New Guinea" 600 "Paraguay" 604 "Peru" 608 "Philippines (the)" 612 "Pitcairn" 616 "Poland" 620 "Portugal" 624 "Guinea-Bissau" 626 "Timor-Leste" 630 "Puerto Rico" 634 "Qatar" 638 "R�union" 642 "Romania" 643 "Russian Federation (the)" 646 "Rwanda" 652 "Saint Barth�lemy" 654 "Saint Helena, Ascension and Tristan da Cunha" 659 "Saint Kitts and Nevis" 660 "Anguilla" 662 "Saint Lucia" 663 "Saint Martin (French part)" 666 "Saint Pierre and Miquelon" 670 "Saint Vincent and the Grenadines" 674 "San Marino" 678 "Sao Tome and Principe" 682 "Saudi Arabia" 686 "Senegal" 688 "Serbia" 690 "Seychelles" 694 "Sierra Leone" 702 "Singapore" 703 "Slovakia" 704 "Viet Nam" 705 "Slovenia" 706 "Somalia" 710 "South Africa" 716 "Zimbabwe" 724 "Spain" 728 "South Sudan" 729 "Sudan (the)" 732 "Western Sahara*" 740 "Suriname" 744 "Svalbard and Jan Mayen" 748 "Eswatini" 752 "Sweden" 756 "Switzerland" 760 "Syrian Arab Republic" 762 "Tajikistan" 764 "Thailand" 768 "Togo" 772 "Tokelau" 776 "Tonga" 780 "Trinidad and Tobago" 784 "United Arab Emirates (the)" 788 "Tunisia" 792 "Turkey" 795 "Turkmenistan" 796 "Turks and Caicos Islands (the)" 798 "Tuvalu" 800 "Uganda" 804 "Ukraine" 807 "Macedonia (the former Yugoslav Republic of)" 818 "Egypt" 826 "United Kingdom of Great Britain and Northern Ireland (the)" 831 "Guernsey" 832 "Jersey" 833 "Isle of Man" 834 "Tanzania, United Republic of" 840 "United States of America (the)" 850 "Virgin Islands (U.S.)" 854 "Burkina Faso" 858 "Uruguay" 860 "Uzbekistan" 862 "Venezuela(Bolivarian Republic of)" 876 "Wallis and Futuna" 882 "Samoa" 887 "Yemen" 894 "Zambia" ;
VAL_ 236 VFC_TSHdr_CountryMode 0 "Unknown" 1 "EHR_CAN" 2 "EHR_Default_Country" 3 "EHR_Adaptation_Value" 4 "EHR_Variant_Coding" 5 "RSR_Dataset" 6 "RSR_CCD" 7 "Reserved" ;
VAL_ 238 VFC_TS00_ID 0 "INVALID" ;
VAL_ 238 VFC_TS00_Class 0 "UNKNOWN" 1 "SL5" 2 "SL10" 3 "SL15" 4 "SL20" 5 "SL25" 6 "SL30" 7 "SL35" 8 "SL40" 9 "SL45" 10 "SL50" 11 "SL55" 12 "SL60" 13 "SL65" 14 "SL70" 15 "SL75" 16 "SL80" 17 "SL85" 18 "SL90" 19 "SL95" 20 "SL100" 21 "SL105" 22 "SL110" 23 "SL115" 24 "SL120" 25 "SL125" 26 "SL130" 27 "SL135" 28 "SL140" 29 "SL145" 30 "SL150" 31 "SL155" 32 "SL160" 33 "ESL" 34 "EA" 35 "OP" 36 "EOP" 37 "OL" 38 "EOL" 39 "GIVEWAY" 40 "PRIOCROSS" 41 "PRIOCROSSYIELDTORIGHT" 42 "PRIOSTREET" 43 "EPRIOSTREET" 44 "STOP" 45 "AXLEWEIGHT" 46 "CARDIST" 47 "HEIGHT" 48 "LENGTH" 49 "LORRYDIST" 50 "NOALL" 51 "NOBIKE" 52 "NOBUS" 53 "NOCAR" 54 "NOCARBIKE" 55 "NOCARRIAGE" 56 "NOENTRY" 57 "NOHAZMAT" 58 "NOHAZWATER" 59 "NOLORRY" 60 "NOLORRYTRAILER" 61 "NOLTURN" 62 "NOPED" 63 "NORIDER" 64 "NORTURN" 65 "NOTRACTOR" 66 "NOTWOWAY" 67 "NOUTURN" 68 "UMWELT" 69 "EUMWELT" 70 "WEIGHT" 71 "WIDTH" 72 "WARNBIKE" 73 "WARNBUS" 74 "WARNCATTLE" 75 "WARNCONST" 76 "WARNCONSTL" 77 "WARNCONSTR" 78 "WARNCURVEL" 79 "WARNCURVER" 80 "WARNDANGER" 81 "WARNDCURVEL" 82 "WARNDCURVER" 83 "WARNDRAWBRIDGE" 84 "WARNFROG" 85 "WARNGRAVEL" 86 "WARNHUMP" 87 "WARNJAM" 88 "WARNKIDS" 89 "WARNLIGHTS" 90 "WARNLOWTREE" 91 "WARNPCROSS" 92 "WARNPED" 93 "WARNPIER" 94 "WARNPLANE" 95 "WARNRIDER" 96 "WARNROCK" 97 "WARNROUND" 98 "WARNRWORKS" 99 "WARNSKID" 100 "WARNSLOPED" 101 "WARNSLOPEU" 102 "WARNSNOW" 103 "WARNTRAIN" 104 "WARNTWOWAY" 105 "WARNWILDANIMAL" 106 "WARNWIND" 107 "ASL" 108 "EASL" 109 "CALM" 110 "ECALM" 111 "DEADEND" 112 "DOUANE" 113 "FWAY" 114 "EFWAY" 115 "HWAY" 116 "EHWAY" 117 "MSL" 118 "EMSL" 119 "NOPARK" 120 "NOSTOP" 121 "ONEWAYS" 122 "ONEWAYU" 123 "SLOWDOWN" 124 "SCHOOL" 125 "ESCHOOL" 126 "TWN" 127 "ETWN" 128 "WBBENTLEFT" 129 "WBBENTLEFTRIGHT" 130 "WBBENTRIGHT" 131 "WBDIAGL" 132 "WBDIAGLR" 133 "WBDIAGR" 134 "WBHAZWATER" 135 "WBLEFT" 136 "WBRIGHT" 137 "WBROUND" 138 "WBUP" 139 "WBUPLEFT" 140 "WBUPRIGHT" 141 "ZEBRA" 142 "HAZMAT" 143 "EMERGENCYBAY" 144 "ENDOFLANEL" 145 "ENDOFLANER" 146 "ENOPARK" 147 "EONEWAY" 148 "EPARK" 149 "ETOLL" 150 "NOPARKL" 151 "NOPARKLR" 152 "NOPARKR" 153 "NOSTOPL" 154 "NOSTOPLR" 155 "NOSTOPR" 156 "NOTURNONRED" 157 "ONEWAYL" 158 "ONEWAYR" 159 "PARK" 160 "PRIOCROSSL" 161 "PRIOCROSSR" 162 "TOLL" 163 "TUNNEL" 164 "TWOWAY" 165 "WARNCROSS" 166 "WARNCROSSL" 167 "WARNCROSSLR" 168 "WARNCROSSR" 169 "WARNCROSSRL" 170 "WARNCROSST" 171 "WARNGIVEWAYAHEAD" 172 "WARNSLAHEAD" 173 "WARNSTOPAHEAD" 174 "WBBUS" 175 "WRONGWAY" 176 "HAZWATER" 177 "GIVEWAYROUND" 178 "WARNWINDINGL" 179 "WARNWINDINGR" 180 "WARNHAIRPINL" 181 "WARNHAIRPINR" 182 "WARNPEDBIKE" 183 "WARNCROSSY" 184 "WARNBRANCHL" 185 "WARNBRANCHR" 186 "WARNAXLEWEIGHT" 187 "WARNWEIGHT" 188 "WARNHEIGHT" 189 "WARNLENGTH" 190 "WARNWIDTH" 191 "WARNBLACKSPOT" 192 "WARNMERGEL" 193 "WARNMERGER" 194 "WARNTUNNEL" 195 "WARNTRACTOR" 196 "WARNRWORKSVEHICLE" 197 "WARNNARROWBRIDGE" 198 "WARNFLAGGER" 199 "LANES" 200 "LANESHIFTL" 201 "LANESHIFTR" 202 "NEWLANEL" 203 "NEWLANER" 204 "RIGHTTURNONRED" 205 "BORDERLIMIT" 206 "EMBEDDEDRAIN" ;
VAL_ 238 VFC_TS00_EmbedFlag 0 "Unknown" 1 "Not Embedded" 2 "Border Limit" 3 "Multi Lane" 4 "Rain" 5 "Vehicle Type" 6 "Plate" 7 "Error Value" ;
VAL_ 238 VFC_TS00_Quality 0 "Poor Quality" 1 "Good Quality" ;
VAL_ 238 VFC_TS00_VMS 0 "Fixed" 1 "Variable" ;
VAL_ 238 VFC_TS00_Stable 0 "Object Is Not Stable" 1 "Object Is Stable" ;
VAL_ 238 VFC_TS00_VehicleSticker 0 "not_sticker_on_vehicle" 1 "Sign is a sticker on a vehicle" ;
VAL_ 238 VFC_TS00_InternalTrack 0 "Sign is not an internal track" 1 "Sign is an internal track" ;
VAL_ 238 VFC_TS00_AddTS1Class 0 "UNKNOWN" 1 "DETECTED" 2 "ACCIDENT" 3 "ADVICE" 4 "BEGINS" 5 "BUS" 6 "CAMPER" 7 "CAR" 8 "CARAVAN" 9 "CRASHRISK" 10 "DIRT" 11 "DISTANCE" 12 "DISTANCEBARS" 13 "END" 14 "EXITL" 15 "EXITR" 16 "FOG" 17 "GRAVEL" 18 "HAZMAT" 19 "HUMP" 20 "JAM" 21 "LORRY" 22 "EXCEPTLORRY" 23 "LOWTREE" 24 "MCYCLE" 25 "MINIMUM" 26 "NIGHT" 27 "NOSTOPSHOULDER" 28 "OILTRAIL" 29 "PRIOTURN" 30 "RADAR" 31 "RAIN" 32 "RAINSNOW" 33 "REMINDER" 34 "ROADDAMAGE" 35 "RUTS" 36 "RWORKSACCESS" 37 "RWORKSENTRY" 38 "RWORKSEXIT" 39 "SCHOOL" 40 "SECTION" 41 "SMOKE" 42 "SNOW" 43 "SOFTSHOULDERCAR" 44 "SHOFTSHOULDERLORRY" 45 "TEXT" 46 "TIME" 47 "TOWING" 48 "TRACTOR" 49 "TRACTOR_OVER" 50 "TRAILER" 51 "WEIGHT" 52 "WET" 53 "WITHIN" 54 "ZONE" 55 "EXIT" 56 "ACCESS" 57 "ALLWAY" 58 "EXCEPTBUS" 59 "EXCEPTDELIVERY" 60 "EXCEPTLOCAL" 61 "FROG" 62 "PRIOTURNL" 63 "PRIOTURNR" 64 "START" 65 "STOPIN" 66 "HAZWATER" 67 "DAY" 68 "SL" ;
VAL_ 238 VFC_TS00_AddTS1Quality 0 "Poor Quality" 1 "Good Quality" ;
VAL_ 238 VFC_TS00_AddTS1VMS 0 "Fixed" 1 "Variable" ;
VAL_ 238 VFC_TS00_AddTS2Class 0 "UNKNOWN" 1 "DETECTED" 2 "ACCIDENT" 3 "ADVICE" 4 "BEGINS" 5 "BUS" 6 "CAMPER" 7 "CAR" 8 "CARAVAN" 9 "CRASHRISK" 10 "DIRT" 11 "DISTANCE" 12 "DISTANCEBARS" 13 "END" 14 "EXITL" 15 "EXITR" 16 "FOG" 17 "GRAVEL" 18 "HAZMAT" 19 "HUMP" 20 "JAM" 21 "LORRY" 22 "EXCEPTLORRY" 23 "LOWTREE" 24 "MCYCLE" 25 "MINIMUM" 26 "NIGHT" 27 "NOSTOPSHOULDER" 28 "OILTRAIL" 29 "PRIOTURN" 30 "RADAR" 31 "RAIN" 32 "RAINSNOW" 33 "REMINDER" 34 "ROADDAMAGE" 35 "RUTS" 36 "RWORKSACCESS" 37 "RWORKSENTRY" 38 "RWORKSEXIT" 39 "SCHOOL" 40 "SECTION" 41 "SMOKE" 42 "SNOW" 43 "SOFTSHOULDERCAR" 44 "SHOFTSHOULDERLORRY" 45 "TEXT" 46 "TIME" 47 "TOWING" 48 "TRACTOR" 49 "TRACTOR_OVER" 50 "TRAILER" 51 "WEIGHT" 52 "WET" 53 "WITHIN" 54 "ZONE" 55 "EXIT" 56 "ACCESS" 57 "ALLWAY" 58 "EXCEPTBUS" 59 "EXCEPTDELIVERY" 60 "EXCEPTLOCAL" 61 "FROG" 62 "PRIOTURNL" 63 "PRIOTURNR" 64 "START" 65 "STOPIN" 66 "HAZWATER" 67 "DAY" 68 "SL" ;
VAL_ 238 VFC_TS00_AddTS2Quality 0 "Poor Quality" 1 "Good Quality" ;
VAL_ 238 VFC_TS00_AddTS2VMS 0 "Fixed" 1 "Variable" ;
VAL_ 238 VFC_TS00_AddTS3Class 0 "UNKNOWN" 1 "DETECTED" 2 "ACCIDENT" 3 "ADVICE" 4 "BEGINS" 5 "BUS" 6 "CAMPER" 7 "CAR" 8 "CARAVAN" 9 "CRASHRISK" 10 "DIRT" 11 "DISTANCE" 12 "DISTANCEBARS" 13 "END" 14 "EXITL" 15 "EXITR" 16 "FOG" 17 "GRAVEL" 18 "HAZMAT" 19 "HUMP" 20 "JAM" 21 "LORRY" 22 "EXCEPTLORRY" 23 "LOWTREE" 24 "MCYCLE" 25 "MINIMUM" 26 "NIGHT" 27 "NOSTOPSHOULDER" 28 "OILTRAIL" 29 "PRIOTURN" 30 "RADAR" 31 "RAIN" 32 "RAINSNOW" 33 "REMINDER" 34 "ROADDAMAGE" 35 "RUTS" 36 "RWORKSACCESS" 37 "RWORKSENTRY" 38 "RWORKSEXIT" 39 "SCHOOL" 40 "SECTION" 41 "SMOKE" 42 "SNOW" 43 "SOFTSHOULDERCAR" 44 "SHOFTSHOULDERLORRY" 45 "TEXT" 46 "TIME" 47 "TOWING" 48 "TRACTOR" 49 "TRACTOR_OVER" 50 "TRAILER" 51 "WEIGHT" 52 "WET" 53 "WITHIN" 54 "ZONE" 55 "EXIT" 56 "ACCESS" 57 "ALLWAY" 58 "EXCEPTBUS" 59 "EXCEPTDELIVERY" 60 "EXCEPTLOCAL" 61 "FROG" 62 "PRIOTURNL" 63 "PRIOTURNR" 64 "START" 65 "STOPIN" 66 "HAZWATER" 67 "DAY" 68 "SL" ;
VAL_ 238 VFC_TS00_AddTS3Quality 0 "Poor Quality" 1 "Good Quality" ;
VAL_ 238 VFC_TS00_AddTS3VMS 0 "Fixed" 1 "Variable" ;
VAL_ 238 VFC_TS00_AddTS4Class 0 "UNKNOWN" 1 "DETECTED" 2 "ACCIDENT" 3 "ADVICE" 4 "BEGINS" 5 "BUS" 6 "CAMPER" 7 "CAR" 8 "CARAVAN" 9 "CRASHRISK" 10 "DIRT" 11 "DISTANCE" 12 "DISTANCEBARS" 13 "END" 14 "EXITL" 15 "EXITR" 16 "FOG" 17 "GRAVEL" 18 "HAZMAT" 19 "HUMP" 20 "JAM" 21 "LORRY" 22 "EXCEPTLORRY" 23 "LOWTREE" 24 "MCYCLE" 25 "MINIMUM" 26 "NIGHT" 27 "NOSTOPSHOULDER" 28 "OILTRAIL" 29 "PRIOTURN" 30 "RADAR" 31 "RAIN" 32 "RAINSNOW" 33 "REMINDER" 34 "ROADDAMAGE" 35 "RUTS" 36 "RWORKSACCESS" 37 "RWORKSENTRY" 38 "RWORKSEXIT" 39 "SCHOOL" 40 "SECTION" 41 "SMOKE" 42 "SNOW" 43 "SOFTSHOULDERCAR" 44 "SHOFTSHOULDERLORRY" 45 "TEXT" 46 "TIME" 47 "TOWING" 48 "TRACTOR" 49 "TRACTOR_OVER" 50 "TRAILER" 51 "WEIGHT" 52 "WET" 53 "WITHIN" 54 "ZONE" 55 "EXIT" 56 "ACCESS" 57 "ALLWAY" 58 "EXCEPTBUS" 59 "EXCEPTDELIVERY" 60 "EXCEPTLOCAL" 61 "FROG" 62 "PRIOTURNL" 63 "PRIOTURNR" 64 "START" 65 "STOPIN" 66 "HAZWATER" 67 "DAY" 68 "SL" ;
VAL_ 238 VFC_TS00_AddTS4Quality 0 "Poor Quality" 1 "Good Quality" ;
VAL_ 238 VFC_TS00_AddTS4VMS 0 "Fixed" 1 "Variable" ;
VAL_ 238 VFC_TS00_AddTS5Class 0 "UNKNOWN" 1 "DETECTED" 2 "ACCIDENT" 3 "ADVICE" 4 "BEGINS" 5 "BUS" 6 "CAMPER" 7 "CAR" 8 "CARAVAN" 9 "CRASHRISK" 10 "DIRT" 11 "DISTANCE" 12 "DISTANCEBARS" 13 "END" 14 "EXITL" 15 "EXITR" 16 "FOG" 17 "GRAVEL" 18 "HAZMAT" 19 "HUMP" 20 "JAM" 21 "LORRY" 22 "EXCEPTLORRY" 23 "LOWTREE" 24 "MCYCLE" 25 "MINIMUM" 26 "NIGHT" 27 "NOSTOPSHOULDER" 28 "OILTRAIL" 29 "PRIOTURN" 30 "RADAR" 31 "RAIN" 32 "RAINSNOW" 33 "REMINDER" 34 "ROADDAMAGE" 35 "RUTS" 36 "RWORKSACCESS" 37 "RWORKSENTRY" 38 "RWORKSEXIT" 39 "SCHOOL" 40 "SECTION" 41 "SMOKE" 42 "SNOW" 43 "SOFTSHOULDERCAR" 44 "SHOFTSHOULDERLORRY" 45 "TEXT" 46 "TIME" 47 "TOWING" 48 "TRACTOR" 49 "TRACTOR_OVER" 50 "TRAILER" 51 "WEIGHT" 52 "WET" 53 "WITHIN" 54 "ZONE" 55 "EXIT" 56 "ACCESS" 57 "ALLWAY" 58 "EXCEPTBUS" 59 "EXCEPTDELIVERY" 60 "EXCEPTLOCAL" 61 "FROG" 62 "PRIOTURNL" 63 "PRIOTURNR" 64 "START" 65 "STOPIN" 66 "HAZWATER" 67 "DAY" 68 "SL" ;
VAL_ 238 VFC_TS00_AddTS5Quality 0 "Poor Quality" 1 "Good Quality" ;
VAL_ 238 VFC_TS00_AddTS5VMS 0 "Fixed" 1 "Variable" ;
VAL_ 238 VFC_TS00_AddTS6Class 0 "UNKNOWN" 1 "DETECTED" 2 "ACCIDENT" 3 "ADVICE" 4 "BEGINS" 5 "BUS" 6 "CAMPER" 7 "CAR" 8 "CARAVAN" 9 "CRASHRISK" 10 "DIRT" 11 "DISTANCE" 12 "DISTANCEBARS" 13 "END" 14 "EXITL" 15 "EXITR" 16 "FOG" 17 "GRAVEL" 18 "HAZMAT" 19 "HUMP" 20 "JAM" 21 "LORRY" 22 "EXCEPTLORRY" 23 "LOWTREE" 24 "MCYCLE" 25 "MINIMUM" 26 "NIGHT" 27 "NOSTOPSHOULDER" 28 "OILTRAIL" 29 "PRIOTURN" 30 "RADAR" 31 "RAIN" 32 "RAINSNOW" 33 "REMINDER" 34 "ROADDAMAGE" 35 "RUTS" 36 "RWORKSACCESS" 37 "RWORKSENTRY" 38 "RWORKSEXIT" 39 "SCHOOL" 40 "SECTION" 41 "SMOKE" 42 "SNOW" 43 "SOFTSHOULDERCAR" 44 "SHOFTSHOULDERLORRY" 45 "TEXT" 46 "TIME" 47 "TOWING" 48 "TRACTOR" 49 "TRACTOR_OVER" 50 "TRAILER" 51 "WEIGHT" 52 "WET" 53 "WITHIN" 54 "ZONE" 55 "EXIT" 56 "ACCESS" 57 "ALLWAY" 58 "EXCEPTBUS" 59 "EXCEPTDELIVERY" 60 "EXCEPTLOCAL" 61 "FROG" 62 "PRIOTURNL" 63 "PRIOTURNR" 64 "START" 65 "STOPIN" 66 "HAZWATER" 67 "DAY" 68 "SL" ;
VAL_ 238 VFC_TS00_AddTS6Quality 0 "Poor Quality" 1 "Good Quality" ;
VAL_ 238 VFC_TS00_AddTS6VMS 0 "Fixed" 1 "Variable" ;
VAL_ 239 VFC_TS01_ID 0 "INVALID" ;
VAL_ 239 VFC_TS01_Class 0 "UNKNOWN" 1 "SL5" 2 "SL10" 3 "SL15" 4 "SL20" 5 "SL25" 6 "SL30" 7 "SL35" 8 "SL40" 9 "SL45" 10 "SL50" 11 "SL55" 12 "SL60" 13 "SL65" 14 "SL70" 15 "SL75" 16 "SL80" 17 "SL85" 18 "SL90" 19 "SL95" 20 "SL100" 21 "SL105" 22 "SL110" 23 "SL115" 24 "SL120" 25 "SL125" 26 "SL130" 27 "SL135" 28 "SL140" 29 "SL145" 30 "SL150" 31 "SL155" 32 "SL160" 33 "ESL" 34 "EA" 35 "OP" 36 "EOP" 37 "OL" 38 "EOL" 39 "GIVEWAY" 40 "PRIOCROSS" 41 "PRIOCROSSYIELDTORIGHT" 42 "PRIOSTREET" 43 "EPRIOSTREET" 44 "STOP" 45 "AXLEWEIGHT" 46 "CARDIST" 47 "HEIGHT" 48 "LENGTH" 49 "LORRYDIST" 50 "NOALL" 51 "NOBIKE" 52 "NOBUS" 53 "NOCAR" 54 "NOCARBIKE" 55 "NOCARRIAGE" 56 "NOENTRY" 57 "NOHAZMAT" 58 "NOHAZWATER" 59 "NOLORRY" 60 "NOLORRYTRAILER" 61 "NOLTURN" 62 "NOPED" 63 "NORIDER" 64 "NORTURN" 65 "NOTRACTOR" 66 "NOTWOWAY" 67 "NOUTURN" 68 "UMWELT" 69 "EUMWELT" 70 "WEIGHT" 71 "WIDTH" 72 "WARNBIKE" 73 "WARNBUS" 74 "WARNCATTLE" 75 "WARNCONST" 76 "WARNCONSTL" 77 "WARNCONSTR" 78 "WARNCURVEL" 79 "WARNCURVER" 80 "WARNDANGER" 81 "WARNDCURVEL" 82 "WARNDCURVER" 83 "WARNDRAWBRIDGE" 84 "WARNFROG" 85 "WARNGRAVEL" 86 "WARNHUMP" 87 "WARNJAM" 88 "WARNKIDS" 89 "WARNLIGHTS" 90 "WARNLOWTREE" 91 "WARNPCROSS" 92 "WARNPED" 93 "WARNPIER" 94 "WARNPLANE" 95 "WARNRIDER" 96 "WARNROCK" 97 "WARNROUND" 98 "WARNRWORKS" 99 "WARNSKID" 100 "WARNSLOPED" 101 "WARNSLOPEU" 102 "WARNSNOW" 103 "WARNTRAIN" 104 "WARNTWOWAY" 105 "WARNWILDANIMAL" 106 "WARNWIND" 107 "ASL" 108 "EASL" 109 "CALM" 110 "ECALM" 111 "DEADEND" 112 "DOUANE" 113 "FWAY" 114 "EFWAY" 115 "HWAY" 116 "EHWAY" 117 "MSL" 118 "EMSL" 119 "NOPARK" 120 "NOSTOP" 121 "ONEWAYS" 122 "ONEWAYU" 123 "SLOWDOWN" 124 "SCHOOL" 125 "ESCHOOL" 126 "TWN" 127 "ETWN" 128 "WBBENTLEFT" 129 "WBBENTLEFTRIGHT" 130 "WBBENTRIGHT" 131 "WBDIAGL" 132 "WBDIAGLR" 133 "WBDIAGR" 134 "WBHAZWATER" 135 "WBLEFT" 136 "WBRIGHT" 137 "WBROUND" 138 "WBUP" 139 "WBUPLEFT" 140 "WBUPRIGHT" 141 "ZEBRA" 142 "HAZMAT" 143 "EMERGENCYBAY" 144 "ENDOFLANEL" 145 "ENDOFLANER" 146 "ENOPARK" 147 "EONEWAY" 148 "EPARK" 149 "ETOLL" 150 "NOPARKL" 151 "NOPARKLR" 152 "NOPARKR" 153 "NOSTOPL" 154 "NOSTOPLR" 155 "NOSTOPR" 156 "NOTURNONRED" 157 "ONEWAYL" 158 "ONEWAYR" 159 "PARK" 160 "PRIOCROSSL" 161 "PRIOCROSSR" 162 "TOLL" 163 "TUNNEL" 164 "TWOWAY" 165 "WARNCROSS" 166 "WARNCROSSL" 167 "WARNCROSSLR" 168 "WARNCROSSR" 169 "WARNCROSSRL" 170 "WARNCROSST" 171 "WARNGIVEWAYAHEAD" 172 "WARNSLAHEAD" 173 "WARNSTOPAHEAD" 174 "WBBUS" 175 "WRONGWAY" 176 "HAZWATER" 177 "GIVEWAYROUND" 178 "WARNWINDINGL" 179 "WARNWINDINGR" 180 "WARNHAIRPINL" 181 "WARNHAIRPINR" 182 "WARNPEDBIKE" 183 "WARNCROSSY" 184 "WARNBRANCHL" 185 "WARNBRANCHR" 186 "WARNAXLEWEIGHT" 187 "WARNWEIGHT" 188 "WARNHEIGHT" 189 "WARNLENGTH" 190 "WARNWIDTH" 191 "WARNBLACKSPOT" 192 "WARNMERGEL" 193 "WARNMERGER" 194 "WARNTUNNEL" 195 "WARNTRACTOR" 196 "WARNRWORKSVEHICLE" 197 "WARNNARROWBRIDGE" 198 "WARNFLAGGER" 199 "LANES" 200 "LANESHIFTL" 201 "LANESHIFTR" 202 "NEWLANEL" 203 "NEWLANER" 204 "RIGHTTURNONRED" 205 "BORDERLIMIT" 206 "EMBEDDEDRAIN" ;
VAL_ 239 VFC_TS01_EmbedFlag 0 "Unknown" 1 "Not Embedded" 2 "Border Limit" 3 "Multi Lane" 4 "Rain" 5 "Vehicle Type" 6 "Plate" 7 "Error Value" ;
VAL_ 239 VFC_TS01_Quality 0 "Poor Quality" 1 "Good Quality" ;
VAL_ 239 VFC_TS01_VMS 0 "Fixed" 1 "Variable" ;
VAL_ 239 VFC_TS01_Stable 0 "Object Is Not Stable" 1 "Object Is Stable" ;
VAL_ 239 VFC_TS01_VehicleSticker 0 "not_sticker_on_vehicle" 1 "Sign is a sticker on a vehicle" ;
VAL_ 239 VFC_TS01_InternalTrack 0 "Sign is not an internal track" 1 "Sign is an internal track" ;
VAL_ 239 VFC_TS01_AddTS1Class 0 "UNKNOWN" 1 "DETECTED" 2 "ACCIDENT" 3 "ADVICE" 4 "BEGINS" 5 "BUS" 6 "CAMPER" 7 "CAR" 8 "CARAVAN" 9 "CRASHRISK" 10 "DIRT" 11 "DISTANCE" 12 "DISTANCEBARS" 13 "END" 14 "EXITL" 15 "EXITR" 16 "FOG" 17 "GRAVEL" 18 "HAZMAT" 19 "HUMP" 20 "JAM" 21 "LORRY" 22 "EXCEPTLORRY" 23 "LOWTREE" 24 "MCYCLE" 25 "MINIMUM" 26 "NIGHT" 27 "NOSTOPSHOULDER" 28 "OILTRAIL" 29 "PRIOTURN" 30 "RADAR" 31 "RAIN" 32 "RAINSNOW" 33 "REMINDER" 34 "ROADDAMAGE" 35 "RUTS" 36 "RWORKSACCESS" 37 "RWORKSENTRY" 38 "RWORKSEXIT" 39 "SCHOOL" 40 "SECTION" 41 "SMOKE" 42 "SNOW" 43 "SOFTSHOULDERCAR" 44 "SHOFTSHOULDERLORRY" 45 "TEXT" 46 "TIME" 47 "TOWING" 48 "TRACTOR" 49 "TRACTOR_OVER" 50 "TRAILER" 51 "WEIGHT" 52 "WET" 53 "WITHIN" 54 "ZONE" 55 "EXIT" 56 "ACCESS" 57 "ALLWAY" 58 "EXCEPTBUS" 59 "EXCEPTDELIVERY" 60 "EXCEPTLOCAL" 61 "FROG" 62 "PRIOTURNL" 63 "PRIOTURNR" 64 "START" 65 "STOPIN" 66 "HAZWATER" 67 "DAY" 68 "SL" ;
VAL_ 239 VFC_TS01_AddTS1Quality 0 "Poor Quality" 1 "Good Quality" ;
VAL_ 239 VFC_TS01_AddTS1VMS 0 "Fixed" 1 "Variable" ;
VAL_ 239 VFC_TS01_AddTS2Class 0 "UNKNOWN" 1 "DETECTED" 2 "ACCIDENT" 3 "ADVICE" 4 "BEGINS" 5 "BUS" 6 "CAMPER" 7 "CAR" 8 "CARAVAN" 9 "CRASHRISK" 10 "DIRT" 11 "DISTANCE" 12 "DISTANCEBARS" 13 "END" 14 "EXITL" 15 "EXITR" 16 "FOG" 17 "GRAVEL" 18 "HAZMAT" 19 "HUMP" 20 "JAM" 21 "LORRY" 22 "EXCEPTLORRY" 23 "LOWTREE" 24 "MCYCLE" 25 "MINIMUM" 26 "NIGHT" 27 "NOSTOPSHOULDER" 28 "OILTRAIL" 29 "PRIOTURN" 30 "RADAR" 31 "RAIN" 32 "RAINSNOW" 33 "REMINDER" 34 "ROADDAMAGE" 35 "RUTS" 36 "RWORKSACCESS" 37 "RWORKSENTRY" 38 "RWORKSEXIT" 39 "SCHOOL" 40 "SECTION" 41 "SMOKE" 42 "SNOW" 43 "SOFTSHOULDERCAR" 44 "SHOFTSHOULDERLORRY" 45 "TEXT" 46 "TIME" 47 "TOWING" 48 "TRACTOR" 49 "TRACTOR_OVER" 50 "TRAILER" 51 "WEIGHT" 52 "WET" 53 "WITHIN" 54 "ZONE" 55 "EXIT" 56 "ACCESS" 57 "ALLWAY" 58 "EXCEPTBUS" 59 "EXCEPTDELIVERY" 60 "EXCEPTLOCAL" 61 "FROG" 62 "PRIOTURNL" 63 "PRIOTURNR" 64 "START" 65 "STOPIN" 66 "HAZWATER" 67 "DAY" 68 "SL" ;
VAL_ 239 VFC_TS01_AddTS2Quality 0 "Poor Quality" 1 "Good Quality" ;
VAL_ 239 VFC_TS01_AddTS2VMS 0 "Fixed" 1 "Variable" ;
VAL_ 239 VFC_TS01_AddTS3Class 0 "UNKNOWN" 1 "DETECTED" 2 "ACCIDENT" 3 "ADVICE" 4 "BEGINS" 5 "BUS" 6 "CAMPER" 7 "CAR" 8 "CARAVAN" 9 "CRASHRISK" 10 "DIRT" 11 "DISTANCE" 12 "DISTANCEBARS" 13 "END" 14 "EXITL" 15 "EXITR" 16 "FOG" 17 "GRAVEL" 18 "HAZMAT" 19 "HUMP" 20 "JAM" 21 "LORRY" 22 "EXCEPTLORRY" 23 "LOWTREE" 24 "MCYCLE" 25 "MINIMUM" 26 "NIGHT" 27 "NOSTOPSHOULDER" 28 "OILTRAIL" 29 "PRIOTURN" 30 "RADAR" 31 "RAIN" 32 "RAINSNOW" 33 "REMINDER" 34 "ROADDAMAGE" 35 "RUTS" 36 "RWORKSACCESS" 37 "RWORKSENTRY" 38 "RWORKSEXIT" 39 "SCHOOL" 40 "SECTION" 41 "SMOKE" 42 "SNOW" 43 "SOFTSHOULDERCAR" 44 "SHOFTSHOULDERLORRY" 45 "TEXT" 46 "TIME" 47 "TOWING" 48 "TRACTOR" 49 "TRACTOR_OVER" 50 "TRAILER" 51 "WEIGHT" 52 "WET" 53 "WITHIN" 54 "ZONE" 55 "EXIT" 56 "ACCESS" 57 "ALLWAY" 58 "EXCEPTBUS" 59 "EXCEPTDELIVERY" 60 "EXCEPTLOCAL" 61 "FROG" 62 "PRIOTURNL" 63 "PRIOTURNR" 64 "START" 65 "STOPIN" 66 "HAZWATER" 67 "DAY" 68 "SL" ;
VAL_ 239 VFC_TS01_AddTS3Quality 0 "Poor Quality" 1 "Good Quality" ;
VAL_ 239 VFC_TS01_AddTS3VMS 0 "Fixed" 1 "Variable" ;
VAL_ 239 VFC_TS01_AddTS4Class 0 "UNKNOWN" 1 "DETECTED" 2 "ACCIDENT" 3 "ADVICE" 4 "BEGINS" 5 "BUS" 6 "CAMPER" 7 "CAR" 8 "CARAVAN" 9 "CRASHRISK" 10 "DIRT" 11 "DISTANCE" 12 "DISTANCEBARS" 13 "END" 14 "EXITL" 15 "EXITR" 16 "FOG" 17 "GRAVEL" 18 "HAZMAT" 19 "HUMP" 20 "JAM" 21 "LORRY" 22 "EXCEPTLORRY" 23 "LOWTREE" 24 "MCYCLE" 25 "MINIMUM" 26 "NIGHT" 27 "NOSTOPSHOULDER" 28 "OILTRAIL" 29 "PRIOTURN" 30 "RADAR" 31 "RAIN" 32 "RAINSNOW" 33 "REMINDER" 34 "ROADDAMAGE" 35 "RUTS" 36 "RWORKSACCESS" 37 "RWORKSENTRY" 38 "RWORKSEXIT" 39 "SCHOOL" 40 "SECTION" 41 "SMOKE" 42 "SNOW" 43 "SOFTSHOULDERCAR" 44 "SHOFTSHOULDERLORRY" 45 "TEXT" 46 "TIME" 47 "TOWING" 48 "TRACTOR" 49 "TRACTOR_OVER" 50 "TRAILER" 51 "WEIGHT" 52 "WET" 53 "WITHIN" 54 "ZONE" 55 "EXIT" 56 "ACCESS" 57 "ALLWAY" 58 "EXCEPTBUS" 59 "EXCEPTDELIVERY" 60 "EXCEPTLOCAL" 61 "FROG" 62 "PRIOTURNL" 63 "PRIOTURNR" 64 "START" 65 "STOPIN" 66 "HAZWATER" 67 "DAY" 68 "SL" ;
VAL_ 239 VFC_TS01_AddTS4Quality 0 "Poor Quality" 1 "Good Quality" ;
VAL_ 239 VFC_TS01_AddTS4VMS 0 "Fixed" 1 "Variable" ;
VAL_ 239 VFC_TS01_AddTS5Class 0 "UNKNOWN" 1 "DETECTED" 2 "ACCIDENT" 3 "ADVICE" 4 "BEGINS" 5 "BUS" 6 "CAMPER" 7 "CAR" 8 "CARAVAN" 9 "CRASHRISK" 10 "DIRT" 11 "DISTANCE" 12 "DISTANCEBARS" 13 "END" 14 "EXITL" 15 "EXITR" 16 "FOG" 17 "GRAVEL" 18 "HAZMAT" 19 "HUMP" 20 "JAM" 21 "LORRY" 22 "EXCEPTLORRY" 23 "LOWTREE" 24 "MCYCLE" 25 "MINIMUM" 26 "NIGHT" 27 "NOSTOPSHOULDER" 28 "OILTRAIL" 29 "PRIOTURN" 30 "RADAR" 31 "RAIN" 32 "RAINSNOW" 33 "REMINDER" 34 "ROADDAMAGE" 35 "RUTS" 36 "RWORKSACCESS" 37 "RWORKSENTRY" 38 "RWORKSEXIT" 39 "SCHOOL" 40 "SECTION" 41 "SMOKE" 42 "SNOW" 43 "SOFTSHOULDERCAR" 44 "SHOFTSHOULDERLORRY" 45 "TEXT" 46 "TIME" 47 "TOWING" 48 "TRACTOR" 49 "TRACTOR_OVER" 50 "TRAILER" 51 "WEIGHT" 52 "WET" 53 "WITHIN" 54 "ZONE" 55 "EXIT" 56 "ACCESS" 57 "ALLWAY" 58 "EXCEPTBUS" 59 "EXCEPTDELIVERY" 60 "EXCEPTLOCAL" 61 "FROG" 62 "PRIOTURNL" 63 "PRIOTURNR" 64 "START" 65 "STOPIN" 66 "HAZWATER" 67 "DAY" 68 "SL" ;
VAL_ 239 VFC_TS01_AddTS5Quality 0 "Poor Quality" 1 "Good Quality" ;
VAL_ 239 VFC_TS01_AddTS5VMS 0 "Fixed" 1 "Variable" ;
VAL_ 239 VFC_TS01_AddTS6Class 0 "UNKNOWN" 1 "DETECTED" 2 "ACCIDENT" 3 "ADVICE" 4 "BEGINS" 5 "BUS" 6 "CAMPER" 7 "CAR" 8 "CARAVAN" 9 "CRASHRISK" 10 "DIRT" 11 "DISTANCE" 12 "DISTANCEBARS" 13 "END" 14 "EXITL" 15 "EXITR" 16 "FOG" 17 "GRAVEL" 18 "HAZMAT" 19 "HUMP" 20 "JAM" 21 "LORRY" 22 "EXCEPTLORRY" 23 "LOWTREE" 24 "MCYCLE" 25 "MINIMUM" 26 "NIGHT" 27 "NOSTOPSHOULDER" 28 "OILTRAIL" 29 "PRIOTURN" 30 "RADAR" 31 "RAIN" 32 "RAINSNOW" 33 "REMINDER" 34 "ROADDAMAGE" 35 "RUTS" 36 "RWORKSACCESS" 37 "RWORKSENTRY" 38 "RWORKSEXIT" 39 "SCHOOL" 40 "SECTION" 41 "SMOKE" 42 "SNOW" 43 "SOFTSHOULDERCAR" 44 "SHOFTSHOULDERLORRY" 45 "TEXT" 46 "TIME" 47 "TOWING" 48 "TRACTOR" 49 "TRACTOR_OVER" 50 "TRAILER" 51 "WEIGHT" 52 "WET" 53 "WITHIN" 54 "ZONE" 55 "EXIT" 56 "ACCESS" 57 "ALLWAY" 58 "EXCEPTBUS" 59 "EXCEPTDELIVERY" 60 "EXCEPTLOCAL" 61 "FROG" 62 "PRIOTURNL" 63 "PRIOTURNR" 64 "START" 65 "STOPIN" 66 "HAZWATER" 67 "DAY" 68 "SL" ;
VAL_ 239 VFC_TS01_AddTS6Quality 0 "Poor Quality" 1 "Good Quality" ;
VAL_ 239 VFC_TS01_AddTS6VMS 0 "Fixed" 1 "Variable" ;
