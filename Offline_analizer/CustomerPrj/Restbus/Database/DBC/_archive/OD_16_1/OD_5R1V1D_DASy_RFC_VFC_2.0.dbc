VERSION "created by canmatrix"

NS_ :

BS_:

BU_: RadarFrontCenter VideoFrontCenter DASy ReceiveECU

BO_ 247 VFC_TrafficSign09: 48 VideoFrontCenter
 SG_ VFC_TS09_CRC : 0|16@1+ (1,0) [0|65535] ""  DASy
 SG_ VFC_TS09_AliveCtr : 16|8@1+ (1,0) [0|255] ""  DASy
 SG_ VFC_TS09_ProtBlockCtr : 24|4@1+ (1,0) [0|15] ""  DASy
 SG_ VFC_TS09_ProtOrderIndex : 32|4@1+ (1,0) [0|15] ""  DASy
 SG_ VFC_TS09_ID : 40|8@1+ (1,0) [1|255] ""  DASy
 SG_ VFC_TS09_Class : 48|8@1+ (1,0) [0|206] ""  DASy
 SG_ VFC_TS09_TSProb : 56|6@1+ (2,0) [0|100] "%"  DASy
 SG_ VFC_TS09_Dx : 64|9@1+ (0.2,0) [0|102.2] "m"  DASy
 SG_ VFC_TS09_Dy : 80|8@1+ (0.2,-25.6) [-25.6|25.4] "m"  DASy
 SG_ VFC_TS09_Dz : 88|6@1+ (0.2,0) [0|12.6] "m"  DASy
 SG_ VFC_TS09_DxStdDev : 96|8@1+ (0.25,0) [0|63.75] "m"  DASy
 SG_ VFC_TS09_DyStdDev : 104|7@1+ (0.1,0) [0|12.7] "m"  DASy
 SG_ VFC_TS09_DzStdDev : 112|6@1+ (0.1,0) [0|6.3] "m"  DASy
 SG_ VFC_TS09_Width : 120|7@1+ (0.1,0) [0|12.7] "m"  DASy
 SG_ VFC_TS09_Height : 128|6@1+ (0.1,0) [0|6.3] "m"  DASy
 SG_ VFC_TS09_EmbedFlag : 136|3@1+ (1,0) [0|7] ""  DASy
 SG_ VFC_TS09_Quality : 139|1@1+ (1,0) [0|1] ""  DASy
 SG_ VFC_TS09_VMS : 140|1@1+ (1,0) [0|1] ""  DASy
 SG_ VFC_TS09_Stable : 141|1@1+ (1,0) [0|1] ""  DASy
 SG_ VFC_TS09_VehicleSticker : 142|1@1+ (1,0) [0|1] ""  DASy
 SG_ VFC_TS09_InternalTrack : 143|1@1+ (1,0) [0|1] ""  DASy
 SG_ VFC_TS09_ValidLanes : 144|5@1+ (1,0) [0|31] ""  DASy
 SG_ VFC_TS09_ValidDay : 152|7@1+ (1,0) [0|127] ""  DASy
 SG_ VFC_TS09_ValidTimeRange1Start : 160|7@1+ (15,0) [0|1440] "min"  DASy
 SG_ VFC_TS09_ValidTimeRange1End : 168|7@1+ (15,0) [0|1440] "min"  DASy
 SG_ VFC_TS09_ValidTimeRange2Start : 176|7@1+ (15,0) [0|1440] "min"  DASy
 SG_ VFC_TS09_ValidTimeRange2End : 184|7@1+ (15,0) [0|1440] "min"  DASy
 SG_ VFC_TS09_ValidInDist : 192|10@1+ (10,0) [0|10230] "m"  DASy
 SG_ VFC_TS09_ValidDist : 208|10@1+ (10,0) [0|10230] "m"  DASy
 SG_ VFC_TS09_AddTSCount : 232|3@1+ (1,0) [0|6] ""  DASy
 SG_ VFC_TS09_AddTS1Class : 240|8@1+ (1,0) [0|68] ""  DASy
 SG_ VFC_TS09_AddTS1Prob : 248|6@1+ (2,0) [0|100] "%"  DASy
 SG_ VFC_TS09_AddTS1Quality : 254|1@1+ (1,0) [0|1] ""  DASy
 SG_ VFC_TS09_AddTS1VMS : 255|1@1+ (1,0) [0|1] ""  DASy
 SG_ VFC_TS09_AddTS2Class : 256|8@1+ (1,0) [0|68] ""  DASy
 SG_ VFC_TS09_AddTS2Prob : 264|6@1+ (2,0) [0|100] "%"  DASy
 SG_ VFC_TS09_AddTS2Quality : 270|1@1+ (1,0) [0|1] ""  DASy
 SG_ VFC_TS09_AddTS2VMS : 271|1@1+ (1,0) [0|1] ""  DASy
 SG_ VFC_TS09_AddTS3Class : 272|8@1+ (1,0) [0|68] ""  DASy
 SG_ VFC_TS09_AddTS3Prob : 280|6@1+ (2,0) [0|100] "%"  DASy
 SG_ VFC_TS09_AddTS3Quality : 286|1@1+ (1,0) [0|1] ""  DASy
 SG_ VFC_TS09_AddTS3VMS : 287|1@1+ (1,0) [0|1] ""  DASy
 SG_ VFC_TS09_AddTS4Class : 288|8@1+ (1,0) [0|68] ""  DASy
 SG_ VFC_TS09_AddTS4Prob : 296|6@1+ (2,0) [0|100] "%"  DASy
 SG_ VFC_TS09_AddTS4Quality : 302|1@1+ (1,0) [0|1] ""  DASy
 SG_ VFC_TS09_AddTS4VMS : 303|1@1+ (1,0) [0|1] ""  DASy
 SG_ VFC_TS09_AddTS5Class : 304|8@1+ (1,0) [0|68] ""  DASy
 SG_ VFC_TS09_AddTS5Prob : 312|6@1+ (2,0) [0|100] "%"  DASy
 SG_ VFC_TS09_AddTS5Quality : 318|1@1+ (1,0) [0|1] ""  DASy
 SG_ VFC_TS09_AddTS5VMS : 319|1@1+ (1,0) [0|1] ""  DASy
 SG_ VFC_TS09_AddTS6Class : 320|8@1+ (1,0) [0|68] ""  DASy
 SG_ VFC_TS09_AddTS6Prob : 328|6@1+ (2,0) [0|100] "%"  DASy
 SG_ VFC_TS09_AddTS6Quality : 334|1@1+ (1,0) [0|1] ""  DASy
 SG_ VFC_TS09_AddTS6VMS : 335|1@1+ (1,0) [0|1] ""  DASy

BO_ 248 VFC_TrafficSign10: 48 VideoFrontCenter
 SG_ VFC_TS10_CRC : 0|16@1+ (1,0) [0|65535] ""  DASy
 SG_ VFC_TS10_AliveCtr : 16|8@1+ (1,0) [0|255] ""  DASy
 SG_ VFC_TS10_ProtBlockCtr : 24|4@1+ (1,0) [0|15] ""  DASy
 SG_ VFC_TS10_ProtOrderIndex : 32|4@1+ (1,0) [0|15] ""  DASy
 SG_ VFC_TS10_ID : 40|8@1+ (1,0) [1|255] ""  DASy
 SG_ VFC_TS10_Class : 48|8@1+ (1,0) [0|206] ""  DASy
 SG_ VFC_TS10_TSProb : 56|6@1+ (2,0) [0|100] "%"  DASy
 SG_ VFC_TS10_Dx : 64|9@1+ (0.2,0) [0|102.2] "m"  DASy
 SG_ VFC_TS10_Dy : 80|8@1+ (0.2,-25.6) [-25.6|25.4] "m"  DASy
 SG_ VFC_TS10_Dz : 88|6@1+ (0.2,0) [0|12.6] "m"  DASy
 SG_ VFC_TS10_DxStdDev : 96|8@1+ (0.25,0) [0|63.75] "m"  DASy
 SG_ VFC_TS10_DyStdDev : 104|7@1+ (0.1,0) [0|12.7] "m"  DASy
 SG_ VFC_TS10_DzStdDev : 112|6@1+ (0.1,0) [0|6.3] "m"  DASy
 SG_ VFC_TS10_Width : 120|7@1+ (0.1,0) [0|12.7] "m"  DASy
 SG_ VFC_TS10_Height : 128|6@1+ (0.1,0) [0|6.3] "m"  DASy
 SG_ VFC_TS10_EmbedFlag : 136|3@1+ (1,0) [0|7] ""  DASy
 SG_ VFC_TS10_Quality : 139|1@1+ (1,0) [0|1] ""  DASy
 SG_ VFC_TS10_VMS : 140|1@1+ (1,0) [0|1] ""  DASy
 SG_ VFC_TS10_Stable : 141|1@1+ (1,0) [0|1] ""  DASy
 SG_ VFC_TS10_VehicleSticker : 142|1@1+ (1,0) [0|1] ""  DASy
 SG_ VFC_TS10_InternalTrack : 143|1@1+ (1,0) [0|1] ""  DASy
 SG_ VFC_TS10_ValidLanes : 144|5@1+ (1,0) [0|31] ""  DASy
 SG_ VFC_TS10_ValidDay : 152|7@1+ (1,0) [0|127] ""  DASy
 SG_ VFC_TS10_ValidTimeRange1Start : 160|7@1+ (15,0) [0|1440] "min"  DASy
 SG_ VFC_TS10_ValidTimeRange1End : 168|7@1+ (15,0) [0|1440] "min"  DASy
 SG_ VFC_TS10_ValidTimeRange2Start : 176|7@1+ (15,0) [0|1440] "min"  DASy
 SG_ VFC_TS10_ValidTimeRange2End : 184|7@1+ (15,0) [0|1440] "min"  DASy
 SG_ VFC_TS10_ValidInDist : 192|10@1+ (10,0) [0|10230] "m"  DASy
 SG_ VFC_TS10_ValidDist : 208|10@1+ (10,0) [0|10230] "m"  DASy
 SG_ VFC_TS10_AddTSCount : 232|3@1+ (1,0) [0|6] ""  DASy
 SG_ VFC_TS10_AddTS1Class : 240|8@1+ (1,0) [0|68] ""  DASy
 SG_ VFC_TS10_AddTS1Prob : 248|6@1+ (2,0) [0|100] "%"  DASy
 SG_ VFC_TS10_AddTS1Quality : 254|1@1+ (1,0) [0|1] ""  DASy
 SG_ VFC_TS10_AddTS1VMS : 255|1@1+ (1,0) [0|1] ""  DASy
 SG_ VFC_TS10_AddTS2Class : 256|8@1+ (1,0) [0|68] ""  DASy
 SG_ VFC_TS10_AddTS2Prob : 264|6@1+ (2,0) [0|100] "%"  DASy
 SG_ VFC_TS10_AddTS2Quality : 270|1@1+ (1,0) [0|1] ""  DASy
 SG_ VFC_TS10_AddTS2VMS : 271|1@1+ (1,0) [0|1] ""  DASy
 SG_ VFC_TS10_AddTS3Class : 272|8@1+ (1,0) [0|68] ""  DASy
 SG_ VFC_TS10_AddTS3Prob : 280|6@1+ (2,0) [0|100] "%"  DASy
 SG_ VFC_TS10_AddTS3Quality : 286|1@1+ (1,0) [0|1] ""  DASy
 SG_ VFC_TS10_AddTS3VMS : 287|1@1+ (1,0) [0|1] ""  DASy
 SG_ VFC_TS10_AddTS4Class : 288|8@1+ (1,0) [0|68] ""  DASy
 SG_ VFC_TS10_AddTS4Prob : 296|6@1+ (2,0) [0|100] "%"  DASy
 SG_ VFC_TS10_AddTS4Quality : 302|1@1+ (1,0) [0|1] ""  DASy
 SG_ VFC_TS10_AddTS4VMS : 303|1@1+ (1,0) [0|1] ""  DASy
 SG_ VFC_TS10_AddTS5Class : 304|8@1+ (1,0) [0|68] ""  DASy
 SG_ VFC_TS10_AddTS5Prob : 312|6@1+ (2,0) [0|100] "%"  DASy
 SG_ VFC_TS10_AddTS5Quality : 318|1@1+ (1,0) [0|1] ""  DASy
 SG_ VFC_TS10_AddTS5VMS : 319|1@1+ (1,0) [0|1] ""  DASy
 SG_ VFC_TS10_AddTS6Class : 320|8@1+ (1,0) [0|68] ""  DASy
 SG_ VFC_TS10_AddTS6Prob : 328|6@1+ (2,0) [0|100] "%"  DASy
 SG_ VFC_TS10_AddTS6Quality : 334|1@1+ (1,0) [0|1] ""  DASy
 SG_ VFC_TS10_AddTS6VMS : 335|1@1+ (1,0) [0|1] ""  DASy

BO_ 249 VFC_TrafficSign11: 48 VideoFrontCenter
 SG_ VFC_TS11_CRC : 0|16@1+ (1,0) [0|65535] ""  DASy
 SG_ VFC_TS11_AliveCtr : 16|8@1+ (1,0) [0|255] ""  DASy
 SG_ VFC_TS11_ProtBlockCtr : 24|4@1+ (1,0) [0|15] ""  DASy
 SG_ VFC_TS11_ProtOrderIndex : 32|4@1+ (1,0) [0|15] ""  DASy
 SG_ VFC_TS11_ID : 40|8@1+ (1,0) [1|255] ""  DASy
 SG_ VFC_TS11_Class : 48|8@1+ (1,0) [0|206] ""  DASy
 SG_ VFC_TS11_TSProb : 56|6@1+ (2,0) [0|100] "%"  DASy
 SG_ VFC_TS11_Dx : 64|9@1+ (0.2,0) [0|102.2] "m"  DASy
 SG_ VFC_TS11_Dy : 80|8@1+ (0.2,-25.6) [-25.6|25.4] "m"  DASy
 SG_ VFC_TS11_Dz : 88|6@1+ (0.2,0) [0|12.6] "m"  DASy
 SG_ VFC_TS11_DxStdDev : 96|8@1+ (0.25,0) [0|63.75] "m"  DASy
 SG_ VFC_TS11_DyStdDev : 104|7@1+ (0.1,0) [0|12.7] "m"  DASy
 SG_ VFC_TS11_DzStdDev : 112|6@1+ (0.1,0) [0|6.3] "m"  DASy
 SG_ VFC_TS11_Width : 120|7@1+ (0.1,0) [0|12.7] "m"  DASy
 SG_ VFC_TS11_Height : 128|6@1+ (0.1,0) [0|6.3] "m"  DASy
 SG_ VFC_TS11_EmbedFlag : 136|3@1+ (1,0) [0|7] ""  DASy
 SG_ VFC_TS11_Quality : 139|1@1+ (1,0) [0|1] ""  DASy
 SG_ VFC_TS11_VMS : 140|1@1+ (1,0) [0|1] ""  DASy
 SG_ VFC_TS11_Stable : 141|1@1+ (1,0) [0|1] ""  DASy
 SG_ VFC_TS11_VehicleSticker : 142|1@1+ (1,0) [0|1] ""  DASy
 SG_ VFC_TS11_InternalTrack : 143|1@1+ (1,0) [0|1] ""  DASy
 SG_ VFC_TS11_ValidLanes : 144|5@1+ (1,0) [0|31] ""  DASy
 SG_ VFC_TS11_ValidDay : 152|7@1+ (1,0) [0|127] ""  DASy
 SG_ VFC_TS11_ValidTimeRange1Start : 160|7@1+ (15,0) [0|1440] "min"  DASy
 SG_ VFC_TS11_ValidTimeRange1End : 168|7@1+ (15,0) [0|1440] "min"  DASy
 SG_ VFC_TS11_ValidTimeRange2Start : 176|7@1+ (15,0) [0|1440] "min"  DASy
 SG_ VFC_TS11_ValidTimeRange2End : 184|7@1+ (15,0) [0|1440] "min"  DASy
 SG_ VFC_TS11_ValidInDist : 192|10@1+ (10,0) [0|10230] "m"  DASy
 SG_ VFC_TS11_ValidDist : 208|10@1+ (10,0) [0|10230] "m"  DASy
 SG_ VFC_TS11_AddTSCount : 232|3@1+ (1,0) [0|6] ""  DASy
 SG_ VFC_TS11_AddTS1Class : 240|8@1+ (1,0) [0|68] ""  DASy
 SG_ VFC_TS11_AddTS1Prob : 248|6@1+ (2,0) [0|100] "%"  DASy
 SG_ VFC_TS11_AddTS1Quality : 254|1@1+ (1,0) [0|1] ""  DASy
 SG_ VFC_TS11_AddTS1VMS : 255|1@1+ (1,0) [0|1] ""  DASy
 SG_ VFC_TS11_AddTS2Class : 256|8@1+ (1,0) [0|68] ""  DASy
 SG_ VFC_TS11_AddTS2Prob : 264|6@1+ (2,0) [0|100] "%"  DASy
 SG_ VFC_TS11_AddTS2Quality : 270|1@1+ (1,0) [0|1] ""  DASy
 SG_ VFC_TS11_AddTS2VMS : 271|1@1+ (1,0) [0|1] ""  DASy
 SG_ VFC_TS11_AddTS3Class : 272|8@1+ (1,0) [0|68] ""  DASy
 SG_ VFC_TS11_AddTS3Prob : 280|6@1+ (2,0) [0|100] "%"  DASy
 SG_ VFC_TS11_AddTS3Quality : 286|1@1+ (1,0) [0|1] ""  DASy
 SG_ VFC_TS11_AddTS3VMS : 287|1@1+ (1,0) [0|1] ""  DASy
 SG_ VFC_TS11_AddTS4Class : 288|8@1+ (1,0) [0|68] ""  DASy
 SG_ VFC_TS11_AddTS4Prob : 296|6@1+ (2,0) [0|100] "%"  DASy
 SG_ VFC_TS11_AddTS4Quality : 302|1@1+ (1,0) [0|1] ""  DASy
 SG_ VFC_TS11_AddTS4VMS : 303|1@1+ (1,0) [0|1] ""  DASy
 SG_ VFC_TS11_AddTS5Class : 304|8@1+ (1,0) [0|68] ""  DASy
 SG_ VFC_TS11_AddTS5Prob : 312|6@1+ (2,0) [0|100] "%"  DASy
 SG_ VFC_TS11_AddTS5Quality : 318|1@1+ (1,0) [0|1] ""  DASy
 SG_ VFC_TS11_AddTS5VMS : 319|1@1+ (1,0) [0|1] ""  DASy
 SG_ VFC_TS11_AddTS6Class : 320|8@1+ (1,0) [0|68] ""  DASy
 SG_ VFC_TS11_AddTS6Prob : 328|6@1+ (2,0) [0|100] "%"  DASy
 SG_ VFC_TS11_AddTS6Quality : 334|1@1+ (1,0) [0|1] ""  DASy
 SG_ VFC_TS11_AddTS6VMS : 335|1@1+ (1,0) [0|1] ""  DASy

BO_ 250 VFC_TrafficSign12: 48 VideoFrontCenter
 SG_ VFC_TS12_CRC : 0|16@1+ (1,0) [0|65535] ""  DASy
 SG_ VFC_TS12_AliveCtr : 16|8@1+ (1,0) [0|255] ""  DASy
 SG_ VFC_TS12_ProtBlockCtr : 24|4@1+ (1,0) [0|15] ""  DASy
 SG_ VFC_TS12_ProtOrderIndex : 32|4@1+ (1,0) [0|15] ""  DASy
 SG_ VFC_TS12_ID : 40|8@1+ (1,0) [1|255] ""  DASy
 SG_ VFC_TS12_Class : 48|8@1+ (1,0) [0|206] ""  DASy
 SG_ VFC_TS12_TSProb : 56|6@1+ (2,0) [0|100] "%"  DASy
 SG_ VFC_TS12_Dx : 64|9@1+ (0.2,0) [0|102.2] "m"  DASy
 SG_ VFC_TS12_Dy : 80|8@1+ (0.2,-25.6) [-25.6|25.4] "m"  DASy
 SG_ VFC_TS12_Dz : 88|6@1+ (0.2,0) [0|12.6] "m"  DASy
 SG_ VFC_TS12_DxStdDev : 96|8@1+ (0.25,0) [0|63.75] "m"  DASy
 SG_ VFC_TS12_DyStdDev : 104|7@1+ (0.1,0) [0|12.7] "m"  DASy
 SG_ VFC_TS12_DzStdDev : 112|6@1+ (0.1,0) [0|6.3] "m"  DASy
 SG_ VFC_TS12_Width : 120|7@1+ (0.1,0) [0|12.7] "m"  DASy
 SG_ VFC_TS12_Height : 128|6@1+ (0.1,0) [0|6.3] "m"  DASy
 SG_ VFC_TS12_EmbedFlag : 136|3@1+ (1,0) [0|7] ""  DASy
 SG_ VFC_TS12_Quality : 139|1@1+ (1,0) [0|1] ""  DASy
 SG_ VFC_TS12_VMS : 140|1@1+ (1,0) [0|1] ""  DASy
 SG_ VFC_TS12_Stable : 141|1@1+ (1,0) [0|1] ""  DASy
 SG_ VFC_TS12_VehicleSticker : 142|1@1+ (1,0) [0|1] ""  DASy
 SG_ VFC_TS12_InternalTrack : 143|1@1+ (1,0) [0|1] ""  DASy
 SG_ VFC_TS12_ValidLanes : 144|5@1+ (1,0) [0|31] ""  DASy
 SG_ VFC_TS12_ValidDay : 152|7@1+ (1,0) [0|127] ""  DASy
 SG_ VFC_TS12_ValidTimeRange1Start : 160|7@1+ (15,0) [0|1440] "min"  DASy
 SG_ VFC_TS12_ValidTimeRange1End : 168|7@1+ (15,0) [0|1440] "min"  DASy
 SG_ VFC_TS12_ValidTimeRange2Start : 176|7@1+ (15,0) [0|1440] "min"  DASy
 SG_ VFC_TS12_ValidTimeRange2End : 184|7@1+ (15,0) [0|1440] "min"  DASy
 SG_ VFC_TS12_ValidInDist : 192|10@1+ (10,0) [0|10230] "m"  DASy
 SG_ VFC_TS12_ValidDist : 208|10@1+ (10,0) [0|10230] "m"  DASy
 SG_ VFC_TS12_AddTSCount : 232|3@1+ (1,0) [0|6] ""  DASy
 SG_ VFC_TS12_AddTS1Class : 240|8@1+ (1,0) [0|68] ""  DASy
 SG_ VFC_TS12_AddTS1Prob : 248|6@1+ (2,0) [0|100] "%"  DASy
 SG_ VFC_TS12_AddTS1Quality : 254|1@1+ (1,0) [0|1] ""  DASy
 SG_ VFC_TS12_AddTS1VMS : 255|1@1+ (1,0) [0|1] ""  DASy
 SG_ VFC_TS12_AddTS2Class : 256|8@1+ (1,0) [0|68] ""  DASy
 SG_ VFC_TS12_AddTS2Prob : 264|6@1+ (2,0) [0|100] "%"  DASy
 SG_ VFC_TS12_AddTS2Quality : 270|1@1+ (1,0) [0|1] ""  DASy
 SG_ VFC_TS12_AddTS2VMS : 271|1@1+ (1,0) [0|1] ""  DASy
 SG_ VFC_TS12_AddTS3Class : 272|8@1+ (1,0) [0|68] ""  DASy
 SG_ VFC_TS12_AddTS3Prob : 280|6@1+ (2,0) [0|100] "%"  DASy
 SG_ VFC_TS12_AddTS3Quality : 286|1@1+ (1,0) [0|1] ""  DASy
 SG_ VFC_TS12_AddTS3VMS : 287|1@1+ (1,0) [0|1] ""  DASy
 SG_ VFC_TS12_AddTS4Class : 288|8@1+ (1,0) [0|68] ""  DASy
 SG_ VFC_TS12_AddTS4Prob : 296|6@1+ (2,0) [0|100] "%"  DASy
 SG_ VFC_TS12_AddTS4Quality : 302|1@1+ (1,0) [0|1] ""  DASy
 SG_ VFC_TS12_AddTS4VMS : 303|1@1+ (1,0) [0|1] ""  DASy
 SG_ VFC_TS12_AddTS5Class : 304|8@1+ (1,0) [0|68] ""  DASy
 SG_ VFC_TS12_AddTS5Prob : 312|6@1+ (2,0) [0|100] "%"  DASy
 SG_ VFC_TS12_AddTS5Quality : 318|1@1+ (1,0) [0|1] ""  DASy
 SG_ VFC_TS12_AddTS5VMS : 319|1@1+ (1,0) [0|1] ""  DASy
 SG_ VFC_TS12_AddTS6Class : 320|8@1+ (1,0) [0|68] ""  DASy
 SG_ VFC_TS12_AddTS6Prob : 328|6@1+ (2,0) [0|100] "%"  DASy
 SG_ VFC_TS12_AddTS6Quality : 334|1@1+ (1,0) [0|1] ""  DASy
 SG_ VFC_TS12_AddTS6VMS : 335|1@1+ (1,0) [0|1] ""  DASy

BO_ 251 VFC_TrafficSign13: 48 VideoFrontCenter
 SG_ VFC_TS13_CRC : 0|16@1+ (1,0) [0|65535] ""  DASy
 SG_ VFC_TS13_AliveCtr : 16|8@1+ (1,0) [0|255] ""  DASy
 SG_ VFC_TS13_ProtBlockCtr : 24|4@1+ (1,0) [0|15] ""  DASy
 SG_ VFC_TS13_ProtOrderIndex : 32|4@1+ (1,0) [0|15] ""  DASy
 SG_ VFC_TS13_ID : 40|8@1+ (1,0) [1|255] ""  DASy
 SG_ VFC_TS13_Class : 48|8@1+ (1,0) [0|206] ""  DASy
 SG_ VFC_TS13_TSProb : 56|6@1+ (2,0) [0|100] "%"  DASy
 SG_ VFC_TS13_Dx : 64|9@1+ (0.2,0) [0|102.2] "m"  DASy
 SG_ VFC_TS13_Dy : 80|8@1+ (0.2,-25.6) [-25.6|25.4] "m"  DASy
 SG_ VFC_TS13_Dz : 88|6@1+ (0.2,0) [0|12.6] "m"  DASy
 SG_ VFC_TS13_DxStdDev : 96|8@1+ (0.25,0) [0|63.75] "m"  DASy
 SG_ VFC_TS13_DyStdDev : 104|7@1+ (0.1,0) [0|12.7] "m"  DASy
 SG_ VFC_TS13_DzStdDev : 112|6@1+ (0.1,0) [0|6.3] "m"  DASy
 SG_ VFC_TS13_Width : 120|7@1+ (0.1,0) [0|12.7] "m"  DASy
 SG_ VFC_TS13_Height : 128|6@1+ (0.1,0) [0|6.3] "m"  DASy
 SG_ VFC_TS13_EmbedFlag : 136|3@1+ (1,0) [0|7] ""  DASy
 SG_ VFC_TS13_Quality : 139|1@1+ (1,0) [0|1] ""  DASy
 SG_ VFC_TS13_VMS : 140|1@1+ (1,0) [0|1] ""  DASy
 SG_ VFC_TS13_Stable : 141|1@1+ (1,0) [0|1] ""  DASy
 SG_ VFC_TS13_VehicleSticker : 142|1@1+ (1,0) [0|1] ""  DASy
 SG_ VFC_TS13_InternalTrack : 143|1@1+ (1,0) [0|1] ""  DASy
 SG_ VFC_TS13_ValidLanes : 144|5@1+ (1,0) [0|31] ""  DASy
 SG_ VFC_TS13_ValidDay : 152|7@1+ (1,0) [0|127] ""  DASy
 SG_ VFC_TS13_ValidTimeRange1Start : 160|7@1+ (15,0) [0|1440] "min"  DASy
 SG_ VFC_TS13_ValidTimeRange1End : 168|7@1+ (15,0) [0|1440] "min"  DASy
 SG_ VFC_TS13_ValidTimeRange2Start : 176|7@1+ (15,0) [0|1440] "min"  DASy
 SG_ VFC_TS13_ValidTimeRange2End : 184|7@1+ (15,0) [0|1440] "min"  DASy
 SG_ VFC_TS13_ValidInDist : 192|10@1+ (10,0) [0|10230] "m"  DASy
 SG_ VFC_TS13_ValidDist : 208|10@1+ (10,0) [0|10230] "m"  DASy
 SG_ VFC_TS13_AddTSCount : 232|3@1+ (1,0) [0|6] ""  DASy
 SG_ VFC_TS13_AddTS1Class : 240|8@1+ (1,0) [0|68] ""  DASy
 SG_ VFC_TS13_AddTS1Prob : 248|6@1+ (2,0) [0|100] "%"  DASy
 SG_ VFC_TS13_AddTS1Quality : 254|1@1+ (1,0) [0|1] ""  DASy
 SG_ VFC_TS13_AddTS1VMS : 255|1@1+ (1,0) [0|1] ""  DASy
 SG_ VFC_TS13_AddTS2Class : 256|8@1+ (1,0) [0|68] ""  DASy
 SG_ VFC_TS13_AddTS2Prob : 264|6@1+ (2,0) [0|100] "%"  DASy
 SG_ VFC_TS13_AddTS2Quality : 270|1@1+ (1,0) [0|1] ""  DASy
 SG_ VFC_TS13_AddTS2VMS : 271|1@1+ (1,0) [0|1] ""  DASy
 SG_ VFC_TS13_AddTS3Class : 272|8@1+ (1,0) [0|68] ""  DASy
 SG_ VFC_TS13_AddTS3Prob : 280|6@1+ (2,0) [0|100] "%"  DASy
 SG_ VFC_TS13_AddTS3Quality : 286|1@1+ (1,0) [0|1] ""  DASy
 SG_ VFC_TS13_AddTS3VMS : 287|1@1+ (1,0) [0|1] ""  DASy
 SG_ VFC_TS13_AddTS4Class : 288|8@1+ (1,0) [0|68] ""  DASy
 SG_ VFC_TS13_AddTS4Prob : 296|6@1+ (2,0) [0|100] "%"  DASy
 SG_ VFC_TS13_AddTS4Quality : 302|1@1+ (1,0) [0|1] ""  DASy
 SG_ VFC_TS13_AddTS4VMS : 303|1@1+ (1,0) [0|1] ""  DASy
 SG_ VFC_TS13_AddTS5Class : 304|8@1+ (1,0) [0|68] ""  DASy
 SG_ VFC_TS13_AddTS5Prob : 312|6@1+ (2,0) [0|100] "%"  DASy
 SG_ VFC_TS13_AddTS5Quality : 318|1@1+ (1,0) [0|1] ""  DASy
 SG_ VFC_TS13_AddTS5VMS : 319|1@1+ (1,0) [0|1] ""  DASy
 SG_ VFC_TS13_AddTS6Class : 320|8@1+ (1,0) [0|68] ""  DASy
 SG_ VFC_TS13_AddTS6Prob : 328|6@1+ (2,0) [0|100] "%"  DASy
 SG_ VFC_TS13_AddTS6Quality : 334|1@1+ (1,0) [0|1] ""  DASy
 SG_ VFC_TS13_AddTS6VMS : 335|1@1+ (1,0) [0|1] ""  DASy

BO_ 252 VFC_TrafficSign14: 48 VideoFrontCenter
 SG_ VFC_TS14_CRC : 0|16@1+ (1,0) [0|65535] ""  DASy
 SG_ VFC_TS14_AliveCtr : 16|8@1+ (1,0) [0|255] ""  DASy
 SG_ VFC_TS14_ProtBlockCtr : 24|4@1+ (1,0) [0|15] ""  DASy
 SG_ VFC_TS14_ProtOrderIndex : 32|4@1+ (1,0) [0|15] ""  DASy
 SG_ VFC_TS14_ID : 40|8@1+ (1,0) [1|255] ""  DASy
 SG_ VFC_TS14_Class : 48|8@1+ (1,0) [0|206] ""  DASy
 SG_ VFC_TS14_TSProb : 56|6@1+ (2,0) [0|100] "%"  DASy
 SG_ VFC_TS14_Dx : 64|9@1+ (0.2,0) [0|102.2] "m"  DASy
 SG_ VFC_TS14_Dy : 80|8@1+ (0.2,-25.6) [-25.6|25.4] "m"  DASy
 SG_ VFC_TS14_Dz : 88|6@1+ (0.2,0) [0|12.6] "m"  DASy
 SG_ VFC_TS14_DxStdDev : 96|8@1+ (0.25,0) [0|63.75] "m"  DASy
 SG_ VFC_TS14_DyStdDev : 104|7@1+ (0.1,0) [0|12.7] "m"  DASy
 SG_ VFC_TS14_DzStdDev : 112|6@1+ (0.1,0) [0|6.3] "m"  DASy
 SG_ VFC_TS14_Width : 120|7@1+ (0.1,0) [0|12.7] "m"  DASy
 SG_ VFC_TS14_Height : 128|6@1+ (0.1,0) [0|6.3] "m"  DASy
 SG_ VFC_TS14_EmbedFlag : 136|3@1+ (1,0) [0|7] ""  DASy
 SG_ VFC_TS14_Quality : 139|1@1+ (1,0) [0|1] ""  DASy
 SG_ VFC_TS14_VMS : 140|1@1+ (1,0) [0|1] ""  DASy
 SG_ VFC_TS14_Stable : 141|1@1+ (1,0) [0|1] ""  DASy
 SG_ VFC_TS14_VehicleSticker : 142|1@1+ (1,0) [0|1] ""  DASy
 SG_ VFC_TS14_InternalTrack : 143|1@1+ (1,0) [0|1] ""  DASy
 SG_ VFC_TS14_ValidLanes : 144|5@1+ (1,0) [0|31] ""  DASy
 SG_ VFC_TS14_ValidDay : 152|7@1+ (1,0) [0|127] ""  DASy
 SG_ VFC_TS14_ValidTimeRange1Start : 160|7@1+ (15,0) [0|1440] "min"  DASy
 SG_ VFC_TS14_ValidTimeRange1End : 168|7@1+ (15,0) [0|1440] "min"  DASy
 SG_ VFC_TS14_ValidTimeRange2Start : 176|7@1+ (15,0) [0|1440] "min"  DASy
 SG_ VFC_TS14_ValidTimeRange2End : 184|7@1+ (15,0) [0|1440] "min"  DASy
 SG_ VFC_TS14_ValidInDist : 192|10@1+ (10,0) [0|10230] "m"  DASy
 SG_ VFC_TS14_ValidDist : 208|10@1+ (10,0) [0|10230] "m"  DASy
 SG_ VFC_TS14_AddTSCount : 232|3@1+ (1,0) [0|6] ""  DASy
 SG_ VFC_TS14_AddTS1Class : 240|8@1+ (1,0) [0|68] ""  DASy
 SG_ VFC_TS14_AddTS1Prob : 248|6@1+ (2,0) [0|100] "%"  DASy
 SG_ VFC_TS14_AddTS1Quality : 254|1@1+ (1,0) [0|1] ""  DASy
 SG_ VFC_TS14_AddTS1VMS : 255|1@1+ (1,0) [0|1] ""  DASy
 SG_ VFC_TS14_AddTS2Class : 256|8@1+ (1,0) [0|68] ""  DASy
 SG_ VFC_TS14_AddTS2Prob : 264|6@1+ (2,0) [0|100] "%"  DASy
 SG_ VFC_TS14_AddTS2Quality : 270|1@1+ (1,0) [0|1] ""  DASy
 SG_ VFC_TS14_AddTS2VMS : 271|1@1+ (1,0) [0|1] ""  DASy
 SG_ VFC_TS14_AddTS3Class : 272|8@1+ (1,0) [0|68] ""  DASy
 SG_ VFC_TS14_AddTS3Prob : 280|6@1+ (2,0) [0|100] "%"  DASy
 SG_ VFC_TS14_AddTS3Quality : 286|1@1+ (1,0) [0|1] ""  DASy
 SG_ VFC_TS14_AddTS3VMS : 287|1@1+ (1,0) [0|1] ""  DASy
 SG_ VFC_TS14_AddTS4Class : 288|8@1+ (1,0) [0|68] ""  DASy
 SG_ VFC_TS14_AddTS4Prob : 296|6@1+ (2,0) [0|100] "%"  DASy
 SG_ VFC_TS14_AddTS4Quality : 302|1@1+ (1,0) [0|1] ""  DASy
 SG_ VFC_TS14_AddTS4VMS : 303|1@1+ (1,0) [0|1] ""  DASy
 SG_ VFC_TS14_AddTS5Class : 304|8@1+ (1,0) [0|68] ""  DASy
 SG_ VFC_TS14_AddTS5Prob : 312|6@1+ (2,0) [0|100] "%"  DASy
 SG_ VFC_TS14_AddTS5Quality : 318|1@1+ (1,0) [0|1] ""  DASy
 SG_ VFC_TS14_AddTS5VMS : 319|1@1+ (1,0) [0|1] ""  DASy
 SG_ VFC_TS14_AddTS6Class : 320|8@1+ (1,0) [0|68] ""  DASy
 SG_ VFC_TS14_AddTS6Prob : 328|6@1+ (2,0) [0|100] "%"  DASy
 SG_ VFC_TS14_AddTS6Quality : 334|1@1+ (1,0) [0|1] ""  DASy
 SG_ VFC_TS14_AddTS6VMS : 335|1@1+ (1,0) [0|1] ""  DASy

BO_ 253 VFC_TrafficSign15: 48 VideoFrontCenter
 SG_ VFC_TS15_CRC : 0|16@1+ (1,0) [0|65535] ""  DASy
 SG_ VFC_TS15_AliveCtr : 16|8@1+ (1,0) [0|255] ""  DASy
 SG_ VFC_TS15_ProtBlockCtr : 24|4@1+ (1,0) [0|15] ""  DASy
 SG_ VFC_TS15_ProtOrderIndex : 32|4@1+ (1,0) [0|15] ""  DASy
 SG_ VFC_TS15_ID : 40|8@1+ (1,0) [1|255] ""  DASy
 SG_ VFC_TS15_Class : 48|8@1+ (1,0) [0|206] ""  DASy
 SG_ VFC_TS15_TSProb : 56|6@1+ (2,0) [0|100] "%"  DASy
 SG_ VFC_TS15_Dx : 64|9@1+ (0.2,0) [0|102.2] "m"  DASy
 SG_ VFC_TS15_Dy : 80|8@1+ (0.2,-25.6) [-25.6|25.4] "m"  DASy
 SG_ VFC_TS15_Dz : 88|6@1+ (0.2,0) [0|12.6] "m"  DASy
 SG_ VFC_TS15_DxStdDev : 96|8@1+ (0.25,0) [0|63.75] "m"  DASy
 SG_ VFC_TS15_DyStdDev : 104|7@1+ (0.1,0) [0|12.7] "m"  DASy
 SG_ VFC_TS15_DzStdDev : 112|6@1+ (0.1,0) [0|6.3] "m"  DASy
 SG_ VFC_TS15_Width : 120|7@1+ (0.1,0) [0|12.7] "m"  DASy
 SG_ VFC_TS15_Height : 128|6@1+ (0.1,0) [0|6.3] "m"  DASy
 SG_ VFC_TS15_EmbedFlag : 136|3@1+ (1,0) [0|7] ""  DASy
 SG_ VFC_TS15_Quality : 139|1@1+ (1,0) [0|1] ""  DASy
 SG_ VFC_TS15_VMS : 140|1@1+ (1,0) [0|1] ""  DASy
 SG_ VFC_TS15_Stable : 141|1@1+ (1,0) [0|1] ""  DASy
 SG_ VFC_TS15_VehicleSticker : 142|1@1+ (1,0) [0|1] ""  DASy
 SG_ VFC_TS15_InternalTrack : 143|1@1+ (1,0) [0|1] ""  DASy
 SG_ VFC_TS15_ValidLanes : 144|5@1+ (1,0) [0|31] ""  DASy
 SG_ VFC_TS15_ValidDay : 152|7@1+ (1,0) [0|127] ""  DASy
 SG_ VFC_TS15_ValidTimeRange1Start : 160|7@1+ (15,0) [0|1440] "min"  DASy
 SG_ VFC_TS15_ValidTimeRange1End : 168|7@1+ (15,0) [0|1440] "min"  DASy
 SG_ VFC_TS15_ValidTimeRange2Start : 176|7@1+ (15,0) [0|1440] "min"  DASy
 SG_ VFC_TS15_ValidTimeRange2End : 184|7@1+ (15,0) [0|1440] "min"  DASy
 SG_ VFC_TS15_ValidInDist : 192|10@1+ (10,0) [0|10230] "m"  DASy
 SG_ VFC_TS15_ValidDist : 208|10@1+ (10,0) [0|10230] "m"  DASy
 SG_ VFC_TS15_AddTSCount : 232|3@1+ (1,0) [0|6] ""  DASy
 SG_ VFC_TS15_AddTS1Class : 240|8@1+ (1,0) [0|68] ""  DASy
 SG_ VFC_TS15_AddTS1Prob : 248|6@1+ (2,0) [0|100] "%"  DASy
 SG_ VFC_TS15_AddTS1Quality : 254|1@1+ (1,0) [0|1] ""  DASy
 SG_ VFC_TS15_AddTS1VMS : 255|1@1+ (1,0) [0|1] ""  DASy
 SG_ VFC_TS15_AddTS2Class : 256|8@1+ (1,0) [0|68] ""  DASy
 SG_ VFC_TS15_AddTS2Prob : 264|6@1+ (2,0) [0|100] "%"  DASy
 SG_ VFC_TS15_AddTS2Quality : 270|1@1+ (1,0) [0|1] ""  DASy
 SG_ VFC_TS15_AddTS2VMS : 271|1@1+ (1,0) [0|1] ""  DASy
 SG_ VFC_TS15_AddTS3Class : 272|8@1+ (1,0) [0|68] ""  DASy
 SG_ VFC_TS15_AddTS3Prob : 280|6@1+ (2,0) [0|100] "%"  DASy
 SG_ VFC_TS15_AddTS3Quality : 286|1@1+ (1,0) [0|1] ""  DASy
 SG_ VFC_TS15_AddTS3VMS : 287|1@1+ (1,0) [0|1] ""  DASy
 SG_ VFC_TS15_AddTS4Class : 288|8@1+ (1,0) [0|68] ""  DASy
 SG_ VFC_TS15_AddTS4Prob : 296|6@1+ (2,0) [0|100] "%"  DASy
 SG_ VFC_TS15_AddTS4Quality : 302|1@1+ (1,0) [0|1] ""  DASy
 SG_ VFC_TS15_AddTS4VMS : 303|1@1+ (1,0) [0|1] ""  DASy
 SG_ VFC_TS15_AddTS5Class : 304|8@1+ (1,0) [0|68] ""  DASy
 SG_ VFC_TS15_AddTS5Prob : 312|6@1+ (2,0) [0|100] "%"  DASy
 SG_ VFC_TS15_AddTS5Quality : 318|1@1+ (1,0) [0|1] ""  DASy
 SG_ VFC_TS15_AddTS5VMS : 319|1@1+ (1,0) [0|1] ""  DASy
 SG_ VFC_TS15_AddTS6Class : 320|8@1+ (1,0) [0|68] ""  DASy
 SG_ VFC_TS15_AddTS6Prob : 328|6@1+ (2,0) [0|100] "%"  DASy
 SG_ VFC_TS15_AddTS6Quality : 334|1@1+ (1,0) [0|1] ""  DASy
 SG_ VFC_TS15_AddTS6VMS : 335|1@1+ (1,0) [0|1] ""  DASy

BO_ 260 RFC_LocationHdrA: 64 RadarFrontCenter
 SG_ RFC_LocHdrA_CRC : 0|16@1+ (1,0) [0|65535] ""  DASy
 SG_ RFC_LocHdrA_AliveCtr : 16|8@1+ (1,0) [0|255] ""  DASy
 SG_ RFC_LocHdrA_ProtBlockCtr : 24|4@1+ (1,0) [0|15] ""  DASy
 SG_ RFC_LocHdr_IfVersionIdMajor : 32|8@1+ (1,0) [0|255] ""  DASy
 SG_ RFC_LocHdr_IfVersionIdMinor : 40|8@1+ (1,0) [0|255] ""  DASy
 SG_ RFC_LocHdr_NumValidDetections : 48|10@1+ (1,0) [0|1023] ""  DASy
 SG_ RFC_LocHdr_TimeStamp : 64|26@1+ (1,0) [0|67108863] "ms"  DASy
 SG_ RFC_LocHdr_SensorStatus : 96|8@1+ (1,0) [0|255] ""  DASy
 SG_ RFC_LocHdr_SensorStatusExt : 104|7@1+ (1,0) [0|127] ""  DASy
 SG_ RFC_LocHdr_LocDownSel : 111|1@1+ (1,0) [0|1] ""  DASy
 SG_ RFC_LocHdr_TimeStampStatus : 112|8@1+ (1,0) [0|255] ""  DASy
 SG_ RFC_LocHdr_BlindnessEvent : 120|8@1+ (1,0) [0|255] ""  DASy
 SG_ RFC_LocHdr_SwVersion : 128|20@1+ (0.01,0) [0|9999.99] ""  DASy
 SG_ RFC_LocHdr_SensorOriginPointY : 152|8@1+ (0.01,-1.28) [-1.28|1.27] "m"  DASy
 SG_ RFC_LocHdr_SensorOriginPointX : 160|9@1+ (0.02,-5.12) [-5.12|5.1] "m"  DASy
 SG_ RFC_LocHdr_SensorOriginPointZ : 171|5@1+ (0.05,0) [0|1.55] "m"  DASy
 SG_ RFC_LocHdr_SensorOrientCorrYaw : 176|16@1+ (0.0001,-3.2768) [-3.2|3.2] "rad"  DASy
 SG_ RFC_LocHdr_SensorOrientCorrPitch : 192|14@1+ (0.0001,-0.8192) [-0.8192|0.8191] "rad"  DASy
 SG_ RFC_LocHdr_SensorOrientYaw : 208|16@1+ (0.0001,-3.2768) [-3.2|3.2] "rad"  DASy
 SG_ RFC_LocHdr_SensorOrientPitch : 224|14@1+ (0.0001,-0.8192) [-0.8192|0.8191] "rad"  DASy
 SG_ RFC_LocHdr_ModPerfDistanceMax : 288|16@1+ (0.01,0) [0|655.35] "m"  DASy
 SG_ RFC_LocHdr_FovElev00RangeGain : 304|7@1+ (0.01,0) [0|1] "unitless"  DASy
 SG_ RFC_LocHdr_FovElev01RangeGain : 312|7@1+ (0.01,0) [0|1] "unitless"  DASy
 SG_ RFC_LocHdr_FovElev02RangeGain : 320|7@1+ (0.01,0) [0|1] "unitless"  DASy
 SG_ RFC_LocHdr_FovElev03RangeGain : 328|7@1+ (0.01,0) [0|1] "unitless"  DASy
 SG_ RFC_LocHdr_FovElev04RangeGain : 336|7@1+ (0.01,0) [0|1] "unitless"  DASy
 SG_ RFC_LocHdr_FovElev05RangeGain : 344|7@1+ (0.01,0) [0|1] "unitless"  DASy
 SG_ RFC_LocHdr_FovElev06RangeGain : 352|7@1+ (0.01,0) [0|1] "unitless"  DASy
 SG_ RFC_LocHdr_FovElev07RangeGain : 360|7@1+ (0.01,0) [0|1] "unitless"  DASy
 SG_ RFC_LocHdr_FovElev08RangeGain : 368|7@1+ (0.01,0) [0|1] "unitless"  DASy
 SG_ RFC_LocHdr_FovElev09RangeGain : 376|7@1+ (0.01,0) [0|1] "unitless"  DASy
 SG_ RFC_LocHdr_FovElev10RangeGain : 384|7@1+ (0.01,0) [0|1] "unitless"  DASy
 SG_ RFC_LocHdr_FovElevation00 : 392|7@1+ (1,-64) [-45|45] "deg"  DASy
 SG_ RFC_LocHdr_FovElevation01 : 400|7@1+ (1,-64) [-45|45] "deg"  DASy
 SG_ RFC_LocHdr_FovElevation02 : 408|7@1+ (1,-64) [-45|45] "deg"  DASy
 SG_ RFC_LocHdr_FovElevation03 : 416|7@1+ (1,-64) [-45|45] "deg"  DASy
 SG_ RFC_LocHdr_FovElevation04 : 424|7@1+ (1,-64) [-45|45] "deg"  DASy
 SG_ RFC_LocHdr_FovElevation05 : 432|7@1+ (1,-64) [-45|45] "deg"  DASy
 SG_ RFC_LocHdr_FovElevation06 : 440|7@1+ (1,-64) [-45|45] "deg"  DASy
 SG_ RFC_LocHdr_FovElevation07 : 448|7@1+ (1,-64) [-45|45] "deg"  DASy
 SG_ RFC_LocHdr_FovElevation08 : 456|7@1+ (1,-64) [-45|45] "deg"  DASy
 SG_ RFC_LocHdr_FovElevation09 : 464|7@1+ (1,-64) [-45|45] "deg"  DASy
 SG_ RFC_LocHdr_FovElevation10 : 472|7@1+ (1,-64) [-45|45] "deg"  DASy

BO_ 261 RFC_LocationHdrB: 64 RadarFrontCenter
 SG_ RFC_LocHdrB_CRC : 0|16@1+ (1,0) [0|65535] ""  DASy
 SG_ RFC_LocHdrB_AliveCtr : 16|8@1+ (1,0) [0|255] ""  DASy
 SG_ RFC_LocHdrB_ProtBlockCtr : 24|4@1+ (1,0) [0|15] ""  DASy
 SG_ RFC_LocHdr_FovAzimuth00Range : 32|9@1+ (1,0) [0|511] "m"  DASy
 SG_ RFC_LocHdr_FovAzimuth01Range : 41|9@1+ (1,0) [0|511] "m"  DASy
 SG_ RFC_LocHdr_FovAzimuth02Range : 50|9@1+ (1,0) [0|511] "m"  DASy
 SG_ RFC_LocHdr_FovAzimuth03Range : 59|9@1+ (1,0) [0|511] "m"  DASy
 SG_ RFC_LocHdr_FovAzimuth04Range : 68|9@1+ (1,0) [0|511] "m"  DASy
 SG_ RFC_LocHdr_FovAzimuth05Range : 77|9@1+ (1,0) [0|511] "m"  DASy
 SG_ RFC_LocHdr_FovAzimuth06Range : 86|9@1+ (1,0) [0|511] "m"  DASy
 SG_ RFC_LocHdr_FovAzimuth07Range : 95|9@1+ (1,0) [0|511] "m"  DASy
 SG_ RFC_LocHdr_FovAzimuth08Range : 104|9@1+ (1,0) [0|511] "m"  DASy
 SG_ RFC_LocHdr_FovAzimuth09Range : 113|9@1+ (1,0) [0|511] "m"  DASy
 SG_ RFC_LocHdr_FovAzimuth10Range : 122|9@1+ (1,0) [0|511] "m"  DASy
 SG_ RFC_LocHdr_FovAzimuth11Range : 131|9@1+ (1,0) [0|511] "m"  DASy
 SG_ RFC_LocHdr_FovAzimuth12Range : 140|9@1+ (1,0) [0|511] "m"  DASy
 SG_ RFC_LocHdr_FovAzimuth13Range : 149|9@1+ (1,0) [0|511] "m"  DASy
 SG_ RFC_LocHdr_FovAzimuth14Range : 158|9@1+ (1,0) [0|511] "m"  DASy
 SG_ RFC_LocHdr_FovAzimuth15Range : 167|9@1+ (1,0) [0|511] "m"  DASy
 SG_ RFC_LocHdr_FovAzimuth16Range : 176|9@1+ (1,0) [0|511] "m"  DASy
 SG_ RFC_LocHdr_FovAzimuth17Range : 185|9@1+ (1,0) [0|511] "m"  DASy
 SG_ RFC_LocHdr_FovAzimuth18Range : 194|9@1+ (1,0) [0|511] "m"  DASy
 SG_ RFC_LocHdr_FovAzimuth19Range : 203|9@1+ (1,0) [0|511] "m"  DASy
 SG_ RFC_LocHdr_FovAzimuth20Range : 212|9@1+ (1,0) [0|511] "m"  DASy
 SG_ RFC_LocHdr_FovAzimuth21Range : 221|9@1+ (1,0) [0|511] "m"  DASy
 SG_ RFC_LocHdr_FovAzimuth22Range : 230|9@1+ (1,0) [0|511] "m"  DASy
 SG_ RFC_LocHdr_FovAzimuth23Range : 239|9@1+ (1,0) [0|511] "m"  DASy
 SG_ RFC_LocHdr_FovAzimuth24Range : 248|9@1+ (1,0) [0|511] "m"  DASy
 SG_ RFC_LocHdr_FovAzimuth00 : 264|8@1+ (1,-128) [-90|90] "deg"  DASy
 SG_ RFC_LocHdr_FovAzimuth01 : 272|8@1+ (1,-128) [-90|90] "deg"  DASy
 SG_ RFC_LocHdr_FovAzimuth02 : 280|8@1+ (1,-128) [-90|90] "deg"  DASy
 SG_ RFC_LocHdr_FovAzimuth03 : 288|8@1+ (1,-128) [-90|90] "deg"  DASy
 SG_ RFC_LocHdr_FovAzimuth04 : 296|8@1+ (1,-128) [-90|90] "deg"  DASy
 SG_ RFC_LocHdr_FovAzimuth05 : 304|8@1+ (1,-128) [-90|90] "deg"  DASy
 SG_ RFC_LocHdr_FovAzimuth06 : 312|8@1+ (1,-128) [-90|90] "deg"  DASy
 SG_ RFC_LocHdr_FovAzimuth07 : 320|8@1+ (1,-128) [-90|90] "deg"  DASy
 SG_ RFC_LocHdr_FovAzimuth08 : 328|8@1+ (1,-128) [-90|90] "deg"  DASy
 SG_ RFC_LocHdr_FovAzimuth09 : 336|8@1+ (1,-128) [-90|90] "deg"  DASy
 SG_ RFC_LocHdr_FovAzimuth10 : 344|8@1+ (1,-128) [-90|90] "deg"  DASy
 SG_ RFC_LocHdr_FovAzimuth11 : 352|8@1+ (1,-128) [-90|90] "deg"  DASy
 SG_ RFC_LocHdr_FovAzimuth12 : 360|8@1+ (1,-128) [-90|90] "deg"  DASy
 SG_ RFC_LocHdr_FovAzimuth13 : 368|8@1+ (1,-128) [-90|90] "deg"  DASy
 SG_ RFC_LocHdr_FovAzimuth14 : 376|8@1+ (1,-128) [-90|90] "deg"  DASy
 SG_ RFC_LocHdr_FovAzimuth15 : 384|8@1+ (1,-128) [-90|90] "deg"  DASy
 SG_ RFC_LocHdr_FovAzimuth16 : 392|8@1+ (1,-128) [-90|90] "deg"  DASy
 SG_ RFC_LocHdr_FovAzimuth17 : 400|8@1+ (1,-128) [-90|90] "deg"  DASy
 SG_ RFC_LocHdr_FovAzimuth18 : 408|8@1+ (1,-128) [-90|90] "deg"  DASy
 SG_ RFC_LocHdr_FovAzimuth19 : 416|8@1+ (1,-128) [-90|90] "deg"  DASy
 SG_ RFC_LocHdr_FovAzimuth20 : 424|8@1+ (1,-128) [-90|90] "deg"  DASy
 SG_ RFC_LocHdr_FovAzimuth21 : 432|8@1+ (1,-128) [-90|90] "deg"  DASy
 SG_ RFC_LocHdr_FovAzimuth22 : 440|8@1+ (1,-128) [-90|90] "deg"  DASy
 SG_ RFC_LocHdr_FovAzimuth23 : 448|8@1+ (1,-128) [-90|90] "deg"  DASy
 SG_ RFC_LocHdr_FovAzimuth24 : 456|8@1+ (1,-128) [-90|90] "deg"  DASy

BO_ 264 RFC_Location_000_002: 64 RadarFrontCenter
 SG_ RFC_Loc000_002_CRC : 0|16@1+ (1,0) [0|65535] ""  DASy
 SG_ RFC_Loc000_002_AliveCtr : 16|8@1+ (1,0) [0|255] ""  DASy
 SG_ RFC_Loc000_002_ProtBlockCtr : 24|4@1+ (1,0) [0|15] ""  DASy
 SG_ RFC_Loc000_RadialDistance : 32|15@1+ (0.01,0) [0|327.67] "m"  DASy
 SG_ RFC_Loc000_RadialVelocity : 47|15@1+ (0.01,-163.84) [-110|55] "m/s"  DASy
 SG_ RFC_Loc000_Elevation : 62|10@1+ (0.1,-51.2) [-45|45] "deg"  DASy
 SG_ RFC_Loc000_Azimuth : 72|11@1+ (0.1,-102.4) [-90|90] "deg"  DASy
 SG_ RFC_Loc000_DistVelocityCoVnce : 83|11@1+ (0.0001,-0.1024) [-0.1024|0.1023] "m^2/s"  DASy
 SG_ RFC_Loc000_RadialDistanceVnce : 94|10@1+ (5E-005,0) [0|0.05115] "m^2"  DASy
 SG_ RFC_Loc000_RadialVelocityVnce : 104|10@1+ (0.0001,0) [0|0.1023] "m^2/s^2"  DASy
 SG_ RFC_Loc000_ElevationVnce : 114|10@1+ (0.001,0) [0|1.023] "deg^2"  DASy
 SG_ RFC_Loc000_AzimuthVnce : 124|10@1+ (0.001,0) [0|1.023] "deg^2"  DASy
 SG_ RFC_Loc000_RadarCrossSection : 134|10@1+ (0.2,-102.4) [-50|70] "dBsm"  DASy
 SG_ RFC_Loc000_DistVelocityQuality : 144|8@1+ (1,0) [0|255] "unitless"  DASy
 SG_ RFC_Loc000_ElevationQuality : 152|8@1+ (1,0) [0|255] "unitless"  DASy
 SG_ RFC_Loc000_AzimuthQuality : 160|8@1+ (1,0) [0|255] "unitless"  DASy
 SG_ RFC_Loc000_RSSI : 168|10@1+ (0.1,0) [0|100] "unitless"  DASy
 SG_ RFC_Loc000_AzimuthalPartnerId : 178|10@1+ (1,0) [0|1023] "unitless"  DASy
 SG_ RFC_Loc001_RadialDistance : 192|15@1+ (0.01,0) [0|327.67] "m"  DASy
 SG_ RFC_Loc001_RadialVelocity : 207|15@1+ (0.01,-163.84) [-110|55] "m/s"  DASy
 SG_ RFC_Loc001_Elevation : 222|10@1+ (0.1,-51.2) [-45|45] "deg"  DASy
 SG_ RFC_Loc001_Azimuth : 232|11@1+ (0.1,-102.4) [-90|90] "deg"  DASy
 SG_ RFC_Loc001_DistVelocityCoVnce : 243|11@1+ (0.0001,-0.1024) [-0.1024|0.1023] "m^2/s"  DASy
 SG_ RFC_Loc001_RadialDistanceVnce : 254|10@1+ (5E-005,0) [0|0.05115] "m^2"  DASy
 SG_ RFC_Loc001_RadialVelocityVnce : 264|10@1+ (0.0001,0) [0|0.1023] "m^2/s^2"  DASy
 SG_ RFC_Loc001_ElevationVnce : 274|10@1+ (0.001,0) [0|1.023] "deg^2"  DASy
 SG_ RFC_Loc001_AzimuthVnce : 284|10@1+ (0.001,0) [0|1.023] "deg^2"  DASy
 SG_ RFC_Loc001_RadarCrossSection : 294|10@1+ (0.2,-102.4) [-50|70] "dBsm"  DASy
 SG_ RFC_Loc001_DistVelocityQuality : 304|8@1+ (1,0) [0|255] "unitless"  DASy
 SG_ RFC_Loc001_ElevationQuality : 312|8@1+ (1,0) [0|255] "unitless"  DASy
 SG_ RFC_Loc001_AzimuthQuality : 320|8@1+ (1,0) [0|255] "unitless"  DASy
 SG_ RFC_Loc001_RSSI : 328|10@1+ (0.1,0) [0|100] "unitless"  DASy
 SG_ RFC_Loc001_AzimuthalPartnerId : 338|10@1+ (1,0) [0|1023] "unitless"  DASy
 SG_ RFC_Loc002_RadialDistance : 352|15@1+ (0.01,0) [0|327.67] "m"  DASy
 SG_ RFC_Loc002_RadialVelocity : 367|15@1+ (0.01,-163.84) [-110|55] "m/s"  DASy
 SG_ RFC_Loc002_Elevation : 382|10@1+ (0.1,-51.2) [-45|45] "deg"  DASy
 SG_ RFC_Loc002_Azimuth : 392|11@1+ (0.1,-102.4) [-90|90] "deg"  DASy
 SG_ RFC_Loc002_DistVelocityCoVnce : 403|11@1+ (0.0001,-0.1024) [-0.1024|0.1023] "m^2/s"  DASy
 SG_ RFC_Loc002_RadialDistanceVnce : 414|10@1+ (5E-005,0) [0|0.05115] "m^2"  DASy
 SG_ RFC_Loc002_RadialVelocityVnce : 424|10@1+ (0.0001,0) [0|0.1023] "m^2/s^2"  DASy
 SG_ RFC_Loc002_ElevationVnce : 434|10@1+ (0.001,0) [0|1.023] "deg^2"  DASy
 SG_ RFC_Loc002_AzimuthVnce : 444|10@1+ (0.001,0) [0|1.023] "deg^2"  DASy
 SG_ RFC_Loc002_RadarCrossSection : 454|10@1+ (0.2,-102.4) [-50|70] "dBsm"  DASy
 SG_ RFC_Loc002_DistVelocityQuality : 464|8@1+ (1,0) [0|255] "unitless"  DASy
 SG_ RFC_Loc002_ElevationQuality : 472|8@1+ (1,0) [0|255] "unitless"  DASy
 SG_ RFC_Loc002_AzimuthQuality : 480|8@1+ (1,0) [0|255] "unitless"  DASy
 SG_ RFC_Loc002_RSSI : 488|10@1+ (0.1,0) [0|100] "unitless"  DASy
 SG_ RFC_Loc002_AzimuthalPartnerId : 498|10@1+ (1,0) [0|1023] "unitless"  DASy

CM_ SG_ 247 VFC_TS09_CRC "CRC - Autosar E2E Profile 5";
CM_ SG_ 247 VFC_TS09_AliveCtr "Alive counter - Autosar E2E Profile 5";
CM_ SG_ 247 VFC_TS09_ProtBlockCtr "Protocol-Signal: Block-Counter";
CM_ SG_ 247 VFC_TS09_ProtOrderIndex "Protocol-Signal: Index to ensure same order in Tx and Rx (Ethernet only)";
CM_ SG_ 247 VFC_TS09_ID "Unique Traffic Sign ID";
CM_ SG_ 247 VFC_TS09_Class "The type of main sign that has been detected by the vision system";
CM_ SG_ 247 VFC_TS09_TSProb "Probability that the sign is a traffic sign";
CM_ SG_ 247 VFC_TS09_Dx "Traffic sign distance in longitudinal direction";
CM_ SG_ 247 VFC_TS09_Dy "Traffic sign distance in lateral direction";
CM_ SG_ 247 VFC_TS09_Dz "Traffic sign distance in vertical direction";
CM_ SG_ 247 VFC_TS09_DxStdDev "Standard deviation of Traffic sign distance in longitudinal direction";
CM_ SG_ 247 VFC_TS09_DyStdDev "Standard deviation of Traffic sign distance in lateral direction";
CM_ SG_ 247 VFC_TS09_DzStdDev "Standard deviation of Traffic sign distance in vertical direction";
CM_ SG_ 247 VFC_TS09_Width "Width of the sign";
CM_ SG_ 247 VFC_TS09_Height "Height of the sign";
CM_ SG_ 247 VFC_TS09_EmbedFlag "Determines whether the sign is embedded or not";
CM_ SG_ 247 VFC_TS09_Quality "A flag that determines the quality of the sign";
CM_ SG_ 247 VFC_TS09_VMS "Variable-message sign: Determines whether the traffic sign is Variable or fixed";
CM_ SG_ 247 VFC_TS09_Stable "Determines whether the object is stable";
CM_ SG_ 247 VFC_TS09_VehicleSticker "Flag which indicates whether the detected traffic sign is a invalid sign on a vehicle or not";
CM_ SG_ 247 VFC_TS09_InternalTrack "Flag which indicates if this sign is an internal track, i.e. an sign hypothesis of low quality";
CM_ SG_ 247 VFC_TS09_ValidLanes "Indicates on which lane the detected sign is valid. Bitfield:
Bit 0: valid on first right hand lane
Bit 1: valid on second right hand lane
Bit 2: valid on third right hand lane
Bit 3: valid on fourth right hand lane
Bit 4: valid on fifth right hand lane";
CM_ SG_ 247 VFC_TS09_ValidDay "The video sensor shall provide the week days for which the main traffic sign is valid. Bitfield:
Bit 0: MONDAY
Bit 1: TUESDAY
Bit 2: WEDNESDAY
Bit 3: THURSDAY
Bit 4: FRIDAY
Bit 5: SATURDAY
Bit 6: SUNDAY";
CM_ SG_ 247 VFC_TS09_ValidTimeRange1Start "Start time for the first time range in which the main traffic sign is valid. Minutes since midnight.";
CM_ SG_ 247 VFC_TS09_ValidTimeRange1End "End time for the first time range in which the main traffic sign is valid. Minutes since midnight.";
CM_ SG_ 247 VFC_TS09_ValidTimeRange2Start "Start time for the first time range in which the main traffic sign is valid. Minutes since midnight.";
CM_ SG_ 247 VFC_TS09_ValidTimeRange2End "End time for the first time range in which the main traffic sign is valid. Minutes since midnight.";
CM_ SG_ 247 VFC_TS09_ValidInDist "Indicates the longitudinal distance in which the validity of the main TSR starts";
CM_ SG_ 247 VFC_TS09_ValidDist "Indicates the longitudinal distance for which the main traffic sign is valid";
CM_ SG_ 247 VFC_TS09_AddTSCount "Number of additional signs attached to the main sign. This can be a minimum of 0 and a maximum of 6.";
CM_ SG_ 247 VFC_TS09_AddTS1Class "The type of additonal sign that has been detected by the vision system";
CM_ SG_ 247 VFC_TS09_AddTS1Prob "Probability that the sign is a traffic sign";
CM_ SG_ 247 VFC_TS09_AddTS1Quality "A flag that determines the quality of the signal";
CM_ SG_ 247 VFC_TS09_AddTS1VMS "Variable-message sign: Determines whether the traffic sign is Variable or fixed";
CM_ SG_ 247 VFC_TS09_AddTS2Class "The type of additonal sign that has been detected by the vision system";
CM_ SG_ 247 VFC_TS09_AddTS2Prob "Probability that the sign is a traffic sign";
CM_ SG_ 247 VFC_TS09_AddTS2Quality "A flag that determines the quality of the signal";
CM_ SG_ 247 VFC_TS09_AddTS2VMS "Variable-message sign: Determines whether the traffic sign is Variable or fixed";
CM_ SG_ 247 VFC_TS09_AddTS3Class "The type of additonal sign that has been detected by the vision system";
CM_ SG_ 247 VFC_TS09_AddTS3Prob "Probability that the sign is a traffic sign";
CM_ SG_ 247 VFC_TS09_AddTS3Quality "A flag that determines the quality of the signal";
CM_ SG_ 247 VFC_TS09_AddTS3VMS "Variable-message sign: Determines whether the traffic sign is Variable or fixed";
CM_ SG_ 247 VFC_TS09_AddTS4Class "The type of additonal sign that has been detected by the vision system";
CM_ SG_ 247 VFC_TS09_AddTS4Prob "Probability that the sign is a traffic sign";
CM_ SG_ 247 VFC_TS09_AddTS4Quality "A flag that determines the quality of the signal";
CM_ SG_ 247 VFC_TS09_AddTS4VMS "Variable-message sign: Determines whether the traffic sign is Variable or fixed";
CM_ SG_ 247 VFC_TS09_AddTS5Class "The type of additonal sign that has been detected by the vision system";
CM_ SG_ 247 VFC_TS09_AddTS5Prob "Probability that the sign is a traffic sign";
CM_ SG_ 247 VFC_TS09_AddTS5Quality "A flag that determines the quality of the signal";
CM_ SG_ 247 VFC_TS09_AddTS5VMS "Variable-message sign: Determines whether the traffic sign is Variable or fixed";
CM_ SG_ 247 VFC_TS09_AddTS6Class "The type of additonal sign that has been detected by the vision system";
CM_ SG_ 247 VFC_TS09_AddTS6Prob "Probability that the sign is a traffic sign";
CM_ SG_ 247 VFC_TS09_AddTS6Quality "A flag that determines the quality of the signal";
CM_ SG_ 247 VFC_TS09_AddTS6VMS "Variable-message sign: Determines whether the traffic sign is Variable or fixed";
CM_ SG_ 248 VFC_TS10_CRC "CRC - Autosar E2E Profile 5";
CM_ SG_ 248 VFC_TS10_AliveCtr "Alive counter - Autosar E2E Profile 5";
CM_ SG_ 248 VFC_TS10_ProtBlockCtr "Protocol-Signal: Block-Counter";
CM_ SG_ 248 VFC_TS10_ProtOrderIndex "Protocol-Signal: Index to ensure same order in Tx and Rx (Ethernet only)";
CM_ SG_ 248 VFC_TS10_ID "Unique Traffic Sign ID";
CM_ SG_ 248 VFC_TS10_Class "The type of main sign that has been detected by the vision system";
CM_ SG_ 248 VFC_TS10_TSProb "Probability that the sign is a traffic sign";
CM_ SG_ 248 VFC_TS10_Dx "Traffic sign distance in longitudinal direction";
CM_ SG_ 248 VFC_TS10_Dy "Traffic sign distance in lateral direction";
CM_ SG_ 248 VFC_TS10_Dz "Traffic sign distance in vertical direction";
CM_ SG_ 248 VFC_TS10_DxStdDev "Standard deviation of Traffic sign distance in longitudinal direction";
CM_ SG_ 248 VFC_TS10_DyStdDev "Standard deviation of Traffic sign distance in lateral direction";
CM_ SG_ 248 VFC_TS10_DzStdDev "Standard deviation of Traffic sign distance in vertical direction";
CM_ SG_ 248 VFC_TS10_Width "Width of the sign";
CM_ SG_ 248 VFC_TS10_Height "Height of the sign";
CM_ SG_ 248 VFC_TS10_EmbedFlag "Determines whether the sign is embedded or not";
CM_ SG_ 248 VFC_TS10_Quality "A flag that determines the quality of the sign";
CM_ SG_ 248 VFC_TS10_VMS "Variable-message sign: Determines whether the traffic sign is Variable or fixed";
CM_ SG_ 248 VFC_TS10_Stable "Determines whether the object is stable";
CM_ SG_ 248 VFC_TS10_VehicleSticker "Flag which indicates whether the detected traffic sign is a invalid sign on a vehicle or not";
CM_ SG_ 248 VFC_TS10_InternalTrack "Flag which indicates if this sign is an internal track, i.e. an sign hypothesis of low quality";
CM_ SG_ 248 VFC_TS10_ValidLanes "Indicates on which lane the detected sign is valid. Bitfield:
Bit 0: valid on first right hand lane
Bit 1: valid on second right hand lane
Bit 2: valid on third right hand lane
Bit 3: valid on fourth right hand lane
Bit 4: valid on fifth right hand lane";
CM_ SG_ 248 VFC_TS10_ValidDay "The video sensor shall provide the week days for which the main traffic sign is valid. Bitfield:
Bit 0: MONDAY
Bit 1: TUESDAY
Bit 2: WEDNESDAY
Bit 3: THURSDAY
Bit 4: FRIDAY
Bit 5: SATURDAY
Bit 6: SUNDAY";
CM_ SG_ 248 VFC_TS10_ValidTimeRange1Start "Start time for the first time range in which the main traffic sign is valid. Minutes since midnight.";
CM_ SG_ 248 VFC_TS10_ValidTimeRange1End "End time for the first time range in which the main traffic sign is valid. Minutes since midnight.";
CM_ SG_ 248 VFC_TS10_ValidTimeRange2Start "Start time for the first time range in which the main traffic sign is valid. Minutes since midnight.";
CM_ SG_ 248 VFC_TS10_ValidTimeRange2End "End time for the first time range in which the main traffic sign is valid. Minutes since midnight.";
CM_ SG_ 248 VFC_TS10_ValidInDist "Indicates the longitudinal distance in which the validity of the main TSR starts";
CM_ SG_ 248 VFC_TS10_ValidDist "Indicates the longitudinal distance for which the main traffic sign is valid";
CM_ SG_ 248 VFC_TS10_AddTSCount "Number of additional signs attached to the main sign. This can be a minimum of 0 and a maximum of 6.";
CM_ SG_ 248 VFC_TS10_AddTS1Class "The type of additonal sign that has been detected by the vision system";
CM_ SG_ 248 VFC_TS10_AddTS1Prob "Probability that the sign is a traffic sign";
CM_ SG_ 248 VFC_TS10_AddTS1Quality "A flag that determines the quality of the signal";
CM_ SG_ 248 VFC_TS10_AddTS1VMS "Variable-message sign: Determines whether the traffic sign is Variable or fixed";
CM_ SG_ 248 VFC_TS10_AddTS2Class "The type of additonal sign that has been detected by the vision system";
CM_ SG_ 248 VFC_TS10_AddTS2Prob "Probability that the sign is a traffic sign";
CM_ SG_ 248 VFC_TS10_AddTS2Quality "A flag that determines the quality of the signal";
CM_ SG_ 248 VFC_TS10_AddTS2VMS "Variable-message sign: Determines whether the traffic sign is Variable or fixed";
CM_ SG_ 248 VFC_TS10_AddTS3Class "The type of additonal sign that has been detected by the vision system";
CM_ SG_ 248 VFC_TS10_AddTS3Prob "Probability that the sign is a traffic sign";
CM_ SG_ 248 VFC_TS10_AddTS3Quality "A flag that determines the quality of the signal";
CM_ SG_ 248 VFC_TS10_AddTS3VMS "Variable-message sign: Determines whether the traffic sign is Variable or fixed";
CM_ SG_ 248 VFC_TS10_AddTS4Class "The type of additonal sign that has been detected by the vision system";
CM_ SG_ 248 VFC_TS10_AddTS4Prob "Probability that the sign is a traffic sign";
CM_ SG_ 248 VFC_TS10_AddTS4Quality "A flag that determines the quality of the signal";
CM_ SG_ 248 VFC_TS10_AddTS4VMS "Variable-message sign: Determines whether the traffic sign is Variable or fixed";
CM_ SG_ 248 VFC_TS10_AddTS5Class "The type of additonal sign that has been detected by the vision system";
CM_ SG_ 248 VFC_TS10_AddTS5Prob "Probability that the sign is a traffic sign";
CM_ SG_ 248 VFC_TS10_AddTS5Quality "A flag that determines the quality of the signal";
CM_ SG_ 248 VFC_TS10_AddTS5VMS "Variable-message sign: Determines whether the traffic sign is Variable or fixed";
CM_ SG_ 248 VFC_TS10_AddTS6Class "The type of additonal sign that has been detected by the vision system";
CM_ SG_ 248 VFC_TS10_AddTS6Prob "Probability that the sign is a traffic sign";
CM_ SG_ 248 VFC_TS10_AddTS6Quality "A flag that determines the quality of the signal";
CM_ SG_ 248 VFC_TS10_AddTS6VMS "Variable-message sign: Determines whether the traffic sign is Variable or fixed";
CM_ SG_ 249 VFC_TS11_CRC "CRC - Autosar E2E Profile 5";
CM_ SG_ 249 VFC_TS11_AliveCtr "Alive counter - Autosar E2E Profile 5";
CM_ SG_ 249 VFC_TS11_ProtBlockCtr "Protocol-Signal: Block-Counter";
CM_ SG_ 249 VFC_TS11_ProtOrderIndex "Protocol-Signal: Index to ensure same order in Tx and Rx (Ethernet only)";
CM_ SG_ 249 VFC_TS11_ID "Unique Traffic Sign ID";
CM_ SG_ 249 VFC_TS11_Class "The type of main sign that has been detected by the vision system";
CM_ SG_ 249 VFC_TS11_TSProb "Probability that the sign is a traffic sign";
CM_ SG_ 249 VFC_TS11_Dx "Traffic sign distance in longitudinal direction";
CM_ SG_ 249 VFC_TS11_Dy "Traffic sign distance in lateral direction";
CM_ SG_ 249 VFC_TS11_Dz "Traffic sign distance in vertical direction";
CM_ SG_ 249 VFC_TS11_DxStdDev "Standard deviation of Traffic sign distance in longitudinal direction";
CM_ SG_ 249 VFC_TS11_DyStdDev "Standard deviation of Traffic sign distance in lateral direction";
CM_ SG_ 249 VFC_TS11_DzStdDev "Standard deviation of Traffic sign distance in vertical direction";
CM_ SG_ 249 VFC_TS11_Width "Width of the sign";
CM_ SG_ 249 VFC_TS11_Height "Height of the sign";
CM_ SG_ 249 VFC_TS11_EmbedFlag "Determines whether the sign is embedded or not";
CM_ SG_ 249 VFC_TS11_Quality "A flag that determines the quality of the sign";
CM_ SG_ 249 VFC_TS11_VMS "Variable-message sign: Determines whether the traffic sign is Variable or fixed";
CM_ SG_ 249 VFC_TS11_Stable "Determines whether the object is stable";
CM_ SG_ 249 VFC_TS11_VehicleSticker "Flag which indicates whether the detected traffic sign is a invalid sign on a vehicle or not";
CM_ SG_ 249 VFC_TS11_InternalTrack "Flag which indicates if this sign is an internal track, i.e. an sign hypothesis of low quality";
CM_ SG_ 249 VFC_TS11_ValidLanes "Indicates on which lane the detected sign is valid. Bitfield:
Bit 0: valid on first right hand lane
Bit 1: valid on second right hand lane
Bit 2: valid on third right hand lane
Bit 3: valid on fourth right hand lane
Bit 4: valid on fifth right hand lane";
CM_ SG_ 249 VFC_TS11_ValidDay "The video sensor shall provide the week days for which the main traffic sign is valid. Bitfield:
Bit 0: MONDAY
Bit 1: TUESDAY
Bit 2: WEDNESDAY
Bit 3: THURSDAY
Bit 4: FRIDAY
Bit 5: SATURDAY
Bit 6: SUNDAY";
CM_ SG_ 249 VFC_TS11_ValidTimeRange1Start "Start time for the first time range in which the main traffic sign is valid. Minutes since midnight.";
CM_ SG_ 249 VFC_TS11_ValidTimeRange1End "End time for the first time range in which the main traffic sign is valid. Minutes since midnight.";
CM_ SG_ 249 VFC_TS11_ValidTimeRange2Start "Start time for the first time range in which the main traffic sign is valid. Minutes since midnight.";
CM_ SG_ 249 VFC_TS11_ValidTimeRange2End "End time for the first time range in which the main traffic sign is valid. Minutes since midnight.";
CM_ SG_ 249 VFC_TS11_ValidInDist "Indicates the longitudinal distance in which the validity of the main TSR starts";
CM_ SG_ 249 VFC_TS11_ValidDist "Indicates the longitudinal distance for which the main traffic sign is valid";
CM_ SG_ 249 VFC_TS11_AddTSCount "Number of additional signs attached to the main sign. This can be a minimum of 0 and a maximum of 6.";
CM_ SG_ 249 VFC_TS11_AddTS1Class "The type of additonal sign that has been detected by the vision system";
CM_ SG_ 249 VFC_TS11_AddTS1Prob "Probability that the sign is a traffic sign";
CM_ SG_ 249 VFC_TS11_AddTS1Quality "A flag that determines the quality of the signal";
CM_ SG_ 249 VFC_TS11_AddTS1VMS "Variable-message sign: Determines whether the traffic sign is Variable or fixed";
CM_ SG_ 249 VFC_TS11_AddTS2Class "The type of additonal sign that has been detected by the vision system";
CM_ SG_ 249 VFC_TS11_AddTS2Prob "Probability that the sign is a traffic sign";
CM_ SG_ 249 VFC_TS11_AddTS2Quality "A flag that determines the quality of the signal";
CM_ SG_ 249 VFC_TS11_AddTS2VMS "Variable-message sign: Determines whether the traffic sign is Variable or fixed";
CM_ SG_ 249 VFC_TS11_AddTS3Class "The type of additonal sign that has been detected by the vision system";
CM_ SG_ 249 VFC_TS11_AddTS3Prob "Probability that the sign is a traffic sign";
CM_ SG_ 249 VFC_TS11_AddTS3Quality "A flag that determines the quality of the signal";
CM_ SG_ 249 VFC_TS11_AddTS3VMS "Variable-message sign: Determines whether the traffic sign is Variable or fixed";
CM_ SG_ 249 VFC_TS11_AddTS4Class "The type of additonal sign that has been detected by the vision system";
CM_ SG_ 249 VFC_TS11_AddTS4Prob "Probability that the sign is a traffic sign";
CM_ SG_ 249 VFC_TS11_AddTS4Quality "A flag that determines the quality of the signal";
CM_ SG_ 249 VFC_TS11_AddTS4VMS "Variable-message sign: Determines whether the traffic sign is Variable or fixed";
CM_ SG_ 249 VFC_TS11_AddTS5Class "The type of additonal sign that has been detected by the vision system";
CM_ SG_ 249 VFC_TS11_AddTS5Prob "Probability that the sign is a traffic sign";
CM_ SG_ 249 VFC_TS11_AddTS5Quality "A flag that determines the quality of the signal";
CM_ SG_ 249 VFC_TS11_AddTS5VMS "Variable-message sign: Determines whether the traffic sign is Variable or fixed";
CM_ SG_ 249 VFC_TS11_AddTS6Class "The type of additonal sign that has been detected by the vision system";
CM_ SG_ 249 VFC_TS11_AddTS6Prob "Probability that the sign is a traffic sign";
CM_ SG_ 249 VFC_TS11_AddTS6Quality "A flag that determines the quality of the signal";
CM_ SG_ 249 VFC_TS11_AddTS6VMS "Variable-message sign: Determines whether the traffic sign is Variable or fixed";
CM_ SG_ 250 VFC_TS12_CRC "CRC - Autosar E2E Profile 5";
CM_ SG_ 250 VFC_TS12_AliveCtr "Alive counter - Autosar E2E Profile 5";
CM_ SG_ 250 VFC_TS12_ProtBlockCtr "Protocol-Signal: Block-Counter";
CM_ SG_ 250 VFC_TS12_ProtOrderIndex "Protocol-Signal: Index to ensure same order in Tx and Rx (Ethernet only)";
CM_ SG_ 250 VFC_TS12_ID "Unique Traffic Sign ID";
CM_ SG_ 250 VFC_TS12_Class "The type of main sign that has been detected by the vision system";
CM_ SG_ 250 VFC_TS12_TSProb "Probability that the sign is a traffic sign";
CM_ SG_ 250 VFC_TS12_Dx "Traffic sign distance in longitudinal direction";
CM_ SG_ 250 VFC_TS12_Dy "Traffic sign distance in lateral direction";
CM_ SG_ 250 VFC_TS12_Dz "Traffic sign distance in vertical direction";
CM_ SG_ 250 VFC_TS12_DxStdDev "Standard deviation of Traffic sign distance in longitudinal direction";
CM_ SG_ 250 VFC_TS12_DyStdDev "Standard deviation of Traffic sign distance in lateral direction";
CM_ SG_ 250 VFC_TS12_DzStdDev "Standard deviation of Traffic sign distance in vertical direction";
CM_ SG_ 250 VFC_TS12_Width "Width of the sign";
CM_ SG_ 250 VFC_TS12_Height "Height of the sign";
CM_ SG_ 250 VFC_TS12_EmbedFlag "Determines whether the sign is embedded or not";
CM_ SG_ 250 VFC_TS12_Quality "A flag that determines the quality of the sign";
CM_ SG_ 250 VFC_TS12_VMS "Variable-message sign: Determines whether the traffic sign is Variable or fixed";
CM_ SG_ 250 VFC_TS12_Stable "Determines whether the object is stable";
CM_ SG_ 250 VFC_TS12_VehicleSticker "Flag which indicates whether the detected traffic sign is a invalid sign on a vehicle or not";
CM_ SG_ 250 VFC_TS12_InternalTrack "Flag which indicates if this sign is an internal track, i.e. an sign hypothesis of low quality";
CM_ SG_ 250 VFC_TS12_ValidLanes "Indicates on which lane the detected sign is valid. Bitfield:
Bit 0: valid on first right hand lane
Bit 1: valid on second right hand lane
Bit 2: valid on third right hand lane
Bit 3: valid on fourth right hand lane
Bit 4: valid on fifth right hand lane";
CM_ SG_ 250 VFC_TS12_ValidDay "The video sensor shall provide the week days for which the main traffic sign is valid. Bitfield:
Bit 0: MONDAY
Bit 1: TUESDAY
Bit 2: WEDNESDAY
Bit 3: THURSDAY
Bit 4: FRIDAY
Bit 5: SATURDAY
Bit 6: SUNDAY";
CM_ SG_ 250 VFC_TS12_ValidTimeRange1Start "Start time for the first time range in which the main traffic sign is valid. Minutes since midnight.";
CM_ SG_ 250 VFC_TS12_ValidTimeRange1End "End time for the first time range in which the main traffic sign is valid. Minutes since midnight.";
CM_ SG_ 250 VFC_TS12_ValidTimeRange2Start "Start time for the first time range in which the main traffic sign is valid. Minutes since midnight.";
CM_ SG_ 250 VFC_TS12_ValidTimeRange2End "End time for the first time range in which the main traffic sign is valid. Minutes since midnight.";
CM_ SG_ 250 VFC_TS12_ValidInDist "Indicates the longitudinal distance in which the validity of the main TSR starts";
CM_ SG_ 250 VFC_TS12_ValidDist "Indicates the longitudinal distance for which the main traffic sign is valid";
CM_ SG_ 250 VFC_TS12_AddTSCount "Number of additional signs attached to the main sign. This can be a minimum of 0 and a maximum of 6.";
CM_ SG_ 250 VFC_TS12_AddTS1Class "The type of additonal sign that has been detected by the vision system";
CM_ SG_ 250 VFC_TS12_AddTS1Prob "Probability that the sign is a traffic sign";
CM_ SG_ 250 VFC_TS12_AddTS1Quality "A flag that determines the quality of the signal";
CM_ SG_ 250 VFC_TS12_AddTS1VMS "Variable-message sign: Determines whether the traffic sign is Variable or fixed";
CM_ SG_ 250 VFC_TS12_AddTS2Class "The type of additonal sign that has been detected by the vision system";
CM_ SG_ 250 VFC_TS12_AddTS2Prob "Probability that the sign is a traffic sign";
CM_ SG_ 250 VFC_TS12_AddTS2Quality "A flag that determines the quality of the signal";
CM_ SG_ 250 VFC_TS12_AddTS2VMS "Variable-message sign: Determines whether the traffic sign is Variable or fixed";
CM_ SG_ 250 VFC_TS12_AddTS3Class "The type of additonal sign that has been detected by the vision system";
CM_ SG_ 250 VFC_TS12_AddTS3Prob "Probability that the sign is a traffic sign";
CM_ SG_ 250 VFC_TS12_AddTS3Quality "A flag that determines the quality of the signal";
CM_ SG_ 250 VFC_TS12_AddTS3VMS "Variable-message sign: Determines whether the traffic sign is Variable or fixed";
CM_ SG_ 250 VFC_TS12_AddTS4Class "The type of additonal sign that has been detected by the vision system";
CM_ SG_ 250 VFC_TS12_AddTS4Prob "Probability that the sign is a traffic sign";
CM_ SG_ 250 VFC_TS12_AddTS4Quality "A flag that determines the quality of the signal";
CM_ SG_ 250 VFC_TS12_AddTS4VMS "Variable-message sign: Determines whether the traffic sign is Variable or fixed";
CM_ SG_ 250 VFC_TS12_AddTS5Class "The type of additonal sign that has been detected by the vision system";
CM_ SG_ 250 VFC_TS12_AddTS5Prob "Probability that the sign is a traffic sign";
CM_ SG_ 250 VFC_TS12_AddTS5Quality "A flag that determines the quality of the signal";
CM_ SG_ 250 VFC_TS12_AddTS5VMS "Variable-message sign: Determines whether the traffic sign is Variable or fixed";
CM_ SG_ 250 VFC_TS12_AddTS6Class "The type of additonal sign that has been detected by the vision system";
CM_ SG_ 250 VFC_TS12_AddTS6Prob "Probability that the sign is a traffic sign";
CM_ SG_ 250 VFC_TS12_AddTS6Quality "A flag that determines the quality of the signal";
CM_ SG_ 250 VFC_TS12_AddTS6VMS "Variable-message sign: Determines whether the traffic sign is Variable or fixed";
CM_ SG_ 251 VFC_TS13_CRC "CRC - Autosar E2E Profile 5";
CM_ SG_ 251 VFC_TS13_AliveCtr "Alive counter - Autosar E2E Profile 5";
CM_ SG_ 251 VFC_TS13_ProtBlockCtr "Protocol-Signal: Block-Counter";
CM_ SG_ 251 VFC_TS13_ProtOrderIndex "Protocol-Signal: Index to ensure same order in Tx and Rx (Ethernet only)";
CM_ SG_ 251 VFC_TS13_ID "Unique Traffic Sign ID";
CM_ SG_ 251 VFC_TS13_Class "The type of main sign that has been detected by the vision system";
CM_ SG_ 251 VFC_TS13_TSProb "Probability that the sign is a traffic sign";
CM_ SG_ 251 VFC_TS13_Dx "Traffic sign distance in longitudinal direction";
CM_ SG_ 251 VFC_TS13_Dy "Traffic sign distance in lateral direction";
CM_ SG_ 251 VFC_TS13_Dz "Traffic sign distance in vertical direction";
CM_ SG_ 251 VFC_TS13_DxStdDev "Standard deviation of Traffic sign distance in longitudinal direction";
CM_ SG_ 251 VFC_TS13_DyStdDev "Standard deviation of Traffic sign distance in lateral direction";
CM_ SG_ 251 VFC_TS13_DzStdDev "Standard deviation of Traffic sign distance in vertical direction";
CM_ SG_ 251 VFC_TS13_Width "Width of the sign";
CM_ SG_ 251 VFC_TS13_Height "Height of the sign";
CM_ SG_ 251 VFC_TS13_EmbedFlag "Determines whether the sign is embedded or not";
CM_ SG_ 251 VFC_TS13_Quality "A flag that determines the quality of the sign";
CM_ SG_ 251 VFC_TS13_VMS "Variable-message sign: Determines whether the traffic sign is Variable or fixed";
CM_ SG_ 251 VFC_TS13_Stable "Determines whether the object is stable";
CM_ SG_ 251 VFC_TS13_VehicleSticker "Flag which indicates whether the detected traffic sign is a invalid sign on a vehicle or not";
CM_ SG_ 251 VFC_TS13_InternalTrack "Flag which indicates if this sign is an internal track, i.e. an sign hypothesis of low quality";
CM_ SG_ 251 VFC_TS13_ValidLanes "Indicates on which lane the detected sign is valid. Bitfield:
Bit 0: valid on first right hand lane
Bit 1: valid on second right hand lane
Bit 2: valid on third right hand lane
Bit 3: valid on fourth right hand lane
Bit 4: valid on fifth right hand lane";
CM_ SG_ 251 VFC_TS13_ValidDay "The video sensor shall provide the week days for which the main traffic sign is valid. Bitfield:
Bit 0: MONDAY
Bit 1: TUESDAY
Bit 2: WEDNESDAY
Bit 3: THURSDAY
Bit 4: FRIDAY
Bit 5: SATURDAY
Bit 6: SUNDAY";
CM_ SG_ 251 VFC_TS13_ValidTimeRange1Start "Start time for the first time range in which the main traffic sign is valid. Minutes since midnight.";
CM_ SG_ 251 VFC_TS13_ValidTimeRange1End "End time for the first time range in which the main traffic sign is valid. Minutes since midnight.";
CM_ SG_ 251 VFC_TS13_ValidTimeRange2Start "Start time for the first time range in which the main traffic sign is valid. Minutes since midnight.";
CM_ SG_ 251 VFC_TS13_ValidTimeRange2End "End time for the first time range in which the main traffic sign is valid. Minutes since midnight.";
CM_ SG_ 251 VFC_TS13_ValidInDist "Indicates the longitudinal distance in which the validity of the main TSR starts";
CM_ SG_ 251 VFC_TS13_ValidDist "Indicates the longitudinal distance for which the main traffic sign is valid";
CM_ SG_ 251 VFC_TS13_AddTSCount "Number of additional signs attached to the main sign. This can be a minimum of 0 and a maximum of 6.";
CM_ SG_ 251 VFC_TS13_AddTS1Class "The type of additonal sign that has been detected by the vision system";
CM_ SG_ 251 VFC_TS13_AddTS1Prob "Probability that the sign is a traffic sign";
CM_ SG_ 251 VFC_TS13_AddTS1Quality "A flag that determines the quality of the signal";
CM_ SG_ 251 VFC_TS13_AddTS1VMS "Variable-message sign: Determines whether the traffic sign is Variable or fixed";
CM_ SG_ 251 VFC_TS13_AddTS2Class "The type of additonal sign that has been detected by the vision system";
CM_ SG_ 251 VFC_TS13_AddTS2Prob "Probability that the sign is a traffic sign";
CM_ SG_ 251 VFC_TS13_AddTS2Quality "A flag that determines the quality of the signal";
CM_ SG_ 251 VFC_TS13_AddTS2VMS "Variable-message sign: Determines whether the traffic sign is Variable or fixed";
CM_ SG_ 251 VFC_TS13_AddTS3Class "The type of additonal sign that has been detected by the vision system";
CM_ SG_ 251 VFC_TS13_AddTS3Prob "Probability that the sign is a traffic sign";
CM_ SG_ 251 VFC_TS13_AddTS3Quality "A flag that determines the quality of the signal";
CM_ SG_ 251 VFC_TS13_AddTS3VMS "Variable-message sign: Determines whether the traffic sign is Variable or fixed";
CM_ SG_ 251 VFC_TS13_AddTS4Class "The type of additonal sign that has been detected by the vision system";
CM_ SG_ 251 VFC_TS13_AddTS4Prob "Probability that the sign is a traffic sign";
CM_ SG_ 251 VFC_TS13_AddTS4Quality "A flag that determines the quality of the signal";
CM_ SG_ 251 VFC_TS13_AddTS4VMS "Variable-message sign: Determines whether the traffic sign is Variable or fixed";
CM_ SG_ 251 VFC_TS13_AddTS5Class "The type of additonal sign that has been detected by the vision system";
CM_ SG_ 251 VFC_TS13_AddTS5Prob "Probability that the sign is a traffic sign";
CM_ SG_ 251 VFC_TS13_AddTS5Quality "A flag that determines the quality of the signal";
CM_ SG_ 251 VFC_TS13_AddTS5VMS "Variable-message sign: Determines whether the traffic sign is Variable or fixed";
CM_ SG_ 251 VFC_TS13_AddTS6Class "The type of additonal sign that has been detected by the vision system";
CM_ SG_ 251 VFC_TS13_AddTS6Prob "Probability that the sign is a traffic sign";
CM_ SG_ 251 VFC_TS13_AddTS6Quality "A flag that determines the quality of the signal";
CM_ SG_ 251 VFC_TS13_AddTS6VMS "Variable-message sign: Determines whether the traffic sign is Variable or fixed";
CM_ SG_ 252 VFC_TS14_CRC "CRC - Autosar E2E Profile 5";
CM_ SG_ 252 VFC_TS14_AliveCtr "Alive counter - Autosar E2E Profile 5";
CM_ SG_ 252 VFC_TS14_ProtBlockCtr "Protocol-Signal: Block-Counter";
CM_ SG_ 252 VFC_TS14_ProtOrderIndex "Protocol-Signal: Index to ensure same order in Tx and Rx (Ethernet only)";
CM_ SG_ 252 VFC_TS14_ID "Unique Traffic Sign ID";
CM_ SG_ 252 VFC_TS14_Class "The type of main sign that has been detected by the vision system";
CM_ SG_ 252 VFC_TS14_TSProb "Probability that the sign is a traffic sign";
CM_ SG_ 252 VFC_TS14_Dx "Traffic sign distance in longitudinal direction";
CM_ SG_ 252 VFC_TS14_Dy "Traffic sign distance in lateral direction";
CM_ SG_ 252 VFC_TS14_Dz "Traffic sign distance in vertical direction";
CM_ SG_ 252 VFC_TS14_DxStdDev "Standard deviation of Traffic sign distance in longitudinal direction";
CM_ SG_ 252 VFC_TS14_DyStdDev "Standard deviation of Traffic sign distance in lateral direction";
CM_ SG_ 252 VFC_TS14_DzStdDev "Standard deviation of Traffic sign distance in vertical direction";
CM_ SG_ 252 VFC_TS14_Width "Width of the sign";
CM_ SG_ 252 VFC_TS14_Height "Height of the sign";
CM_ SG_ 252 VFC_TS14_EmbedFlag "Determines whether the sign is embedded or not";
CM_ SG_ 252 VFC_TS14_Quality "A flag that determines the quality of the sign";
CM_ SG_ 252 VFC_TS14_VMS "Variable-message sign: Determines whether the traffic sign is Variable or fixed";
CM_ SG_ 252 VFC_TS14_Stable "Determines whether the object is stable";
CM_ SG_ 252 VFC_TS14_VehicleSticker "Flag which indicates whether the detected traffic sign is a invalid sign on a vehicle or not";
CM_ SG_ 252 VFC_TS14_InternalTrack "Flag which indicates if this sign is an internal track, i.e. an sign hypothesis of low quality";
CM_ SG_ 252 VFC_TS14_ValidLanes "Indicates on which lane the detected sign is valid. Bitfield:
Bit 0: valid on first right hand lane
Bit 1: valid on second right hand lane
Bit 2: valid on third right hand lane
Bit 3: valid on fourth right hand lane
Bit 4: valid on fifth right hand lane";
CM_ SG_ 252 VFC_TS14_ValidDay "The video sensor shall provide the week days for which the main traffic sign is valid. Bitfield:
Bit 0: MONDAY
Bit 1: TUESDAY
Bit 2: WEDNESDAY
Bit 3: THURSDAY
Bit 4: FRIDAY
Bit 5: SATURDAY
Bit 6: SUNDAY";
CM_ SG_ 252 VFC_TS14_ValidTimeRange1Start "Start time for the first time range in which the main traffic sign is valid. Minutes since midnight.";
CM_ SG_ 252 VFC_TS14_ValidTimeRange1End "End time for the first time range in which the main traffic sign is valid. Minutes since midnight.";
CM_ SG_ 252 VFC_TS14_ValidTimeRange2Start "Start time for the first time range in which the main traffic sign is valid. Minutes since midnight.";
CM_ SG_ 252 VFC_TS14_ValidTimeRange2End "End time for the first time range in which the main traffic sign is valid. Minutes since midnight.";
CM_ SG_ 252 VFC_TS14_ValidInDist "Indicates the longitudinal distance in which the validity of the main TSR starts";
CM_ SG_ 252 VFC_TS14_ValidDist "Indicates the longitudinal distance for which the main traffic sign is valid";
CM_ SG_ 252 VFC_TS14_AddTSCount "Number of additional signs attached to the main sign. This can be a minimum of 0 and a maximum of 6.";
CM_ SG_ 252 VFC_TS14_AddTS1Class "The type of additonal sign that has been detected by the vision system";
CM_ SG_ 252 VFC_TS14_AddTS1Prob "Probability that the sign is a traffic sign";
CM_ SG_ 252 VFC_TS14_AddTS1Quality "A flag that determines the quality of the signal";
CM_ SG_ 252 VFC_TS14_AddTS1VMS "Variable-message sign: Determines whether the traffic sign is Variable or fixed";
CM_ SG_ 252 VFC_TS14_AddTS2Class "The type of additonal sign that has been detected by the vision system";
CM_ SG_ 252 VFC_TS14_AddTS2Prob "Probability that the sign is a traffic sign";
CM_ SG_ 252 VFC_TS14_AddTS2Quality "A flag that determines the quality of the signal";
CM_ SG_ 252 VFC_TS14_AddTS2VMS "Variable-message sign: Determines whether the traffic sign is Variable or fixed";
CM_ SG_ 252 VFC_TS14_AddTS3Class "The type of additonal sign that has been detected by the vision system";
CM_ SG_ 252 VFC_TS14_AddTS3Prob "Probability that the sign is a traffic sign";
CM_ SG_ 252 VFC_TS14_AddTS3Quality "A flag that determines the quality of the signal";
CM_ SG_ 252 VFC_TS14_AddTS3VMS "Variable-message sign: Determines whether the traffic sign is Variable or fixed";
CM_ SG_ 252 VFC_TS14_AddTS4Class "The type of additonal sign that has been detected by the vision system";
CM_ SG_ 252 VFC_TS14_AddTS4Prob "Probability that the sign is a traffic sign";
CM_ SG_ 252 VFC_TS14_AddTS4Quality "A flag that determines the quality of the signal";
CM_ SG_ 252 VFC_TS14_AddTS4VMS "Variable-message sign: Determines whether the traffic sign is Variable or fixed";
CM_ SG_ 252 VFC_TS14_AddTS5Class "The type of additonal sign that has been detected by the vision system";
CM_ SG_ 252 VFC_TS14_AddTS5Prob "Probability that the sign is a traffic sign";
CM_ SG_ 252 VFC_TS14_AddTS5Quality "A flag that determines the quality of the signal";
CM_ SG_ 252 VFC_TS14_AddTS5VMS "Variable-message sign: Determines whether the traffic sign is Variable or fixed";
CM_ SG_ 252 VFC_TS14_AddTS6Class "The type of additonal sign that has been detected by the vision system";
CM_ SG_ 252 VFC_TS14_AddTS6Prob "Probability that the sign is a traffic sign";
CM_ SG_ 252 VFC_TS14_AddTS6Quality "A flag that determines the quality of the signal";
CM_ SG_ 252 VFC_TS14_AddTS6VMS "Variable-message sign: Determines whether the traffic sign is Variable or fixed";
CM_ SG_ 253 VFC_TS15_CRC "CRC - Autosar E2E Profile 5";
CM_ SG_ 253 VFC_TS15_AliveCtr "Alive counter - Autosar E2E Profile 5";
CM_ SG_ 253 VFC_TS15_ProtBlockCtr "Protocol-Signal: Block-Counter";
CM_ SG_ 253 VFC_TS15_ProtOrderIndex "Protocol-Signal: Index to ensure same order in Tx and Rx (Ethernet only)";
CM_ SG_ 253 VFC_TS15_ID "Unique Traffic Sign ID";
CM_ SG_ 253 VFC_TS15_Class "The type of main sign that has been detected by the vision system";
CM_ SG_ 253 VFC_TS15_TSProb "Probability that the sign is a traffic sign";
CM_ SG_ 253 VFC_TS15_Dx "Traffic sign distance in longitudinal direction";
CM_ SG_ 253 VFC_TS15_Dy "Traffic sign distance in lateral direction";
CM_ SG_ 253 VFC_TS15_Dz "Traffic sign distance in vertical direction";
CM_ SG_ 253 VFC_TS15_DxStdDev "Standard deviation of Traffic sign distance in longitudinal direction";
CM_ SG_ 253 VFC_TS15_DyStdDev "Standard deviation of Traffic sign distance in lateral direction";
CM_ SG_ 253 VFC_TS15_DzStdDev "Standard deviation of Traffic sign distance in vertical direction";
CM_ SG_ 253 VFC_TS15_Width "Width of the sign";
CM_ SG_ 253 VFC_TS15_Height "Height of the sign";
CM_ SG_ 253 VFC_TS15_EmbedFlag "Determines whether the sign is embedded or not";
CM_ SG_ 253 VFC_TS15_Quality "A flag that determines the quality of the sign";
CM_ SG_ 253 VFC_TS15_VMS "Variable-message sign: Determines whether the traffic sign is Variable or fixed";
CM_ SG_ 253 VFC_TS15_Stable "Determines whether the object is stable";
CM_ SG_ 253 VFC_TS15_VehicleSticker "Flag which indicates whether the detected traffic sign is a invalid sign on a vehicle or not";
CM_ SG_ 253 VFC_TS15_InternalTrack "Flag which indicates if this sign is an internal track, i.e. an sign hypothesis of low quality";
CM_ SG_ 253 VFC_TS15_ValidLanes "Indicates on which lane the detected sign is valid. Bitfield:
Bit 0: valid on first right hand lane
Bit 1: valid on second right hand lane
Bit 2: valid on third right hand lane
Bit 3: valid on fourth right hand lane
Bit 4: valid on fifth right hand lane";
CM_ SG_ 253 VFC_TS15_ValidDay "The video sensor shall provide the week days for which the main traffic sign is valid. Bitfield:
Bit 0: MONDAY
Bit 1: TUESDAY
Bit 2: WEDNESDAY
Bit 3: THURSDAY
Bit 4: FRIDAY
Bit 5: SATURDAY
Bit 6: SUNDAY";
CM_ SG_ 253 VFC_TS15_ValidTimeRange1Start "Start time for the first time range in which the main traffic sign is valid. Minutes since midnight.";
CM_ SG_ 253 VFC_TS15_ValidTimeRange1End "End time for the first time range in which the main traffic sign is valid. Minutes since midnight.";
CM_ SG_ 253 VFC_TS15_ValidTimeRange2Start "Start time for the first time range in which the main traffic sign is valid. Minutes since midnight.";
CM_ SG_ 253 VFC_TS15_ValidTimeRange2End "End time for the first time range in which the main traffic sign is valid. Minutes since midnight.";
CM_ SG_ 253 VFC_TS15_ValidInDist "Indicates the longitudinal distance in which the validity of the main TSR starts";
CM_ SG_ 253 VFC_TS15_ValidDist "Indicates the longitudinal distance for which the main traffic sign is valid";
CM_ SG_ 253 VFC_TS15_AddTSCount "Number of additional signs attached to the main sign. This can be a minimum of 0 and a maximum of 6.";
CM_ SG_ 253 VFC_TS15_AddTS1Class "The type of additonal sign that has been detected by the vision system";
CM_ SG_ 253 VFC_TS15_AddTS1Prob "Probability that the sign is a traffic sign";
CM_ SG_ 253 VFC_TS15_AddTS1Quality "A flag that determines the quality of the signal";
CM_ SG_ 253 VFC_TS15_AddTS1VMS "Variable-message sign: Determines whether the traffic sign is Variable or fixed";
CM_ SG_ 253 VFC_TS15_AddTS2Class "The type of additonal sign that has been detected by the vision system";
CM_ SG_ 253 VFC_TS15_AddTS2Prob "Probability that the sign is a traffic sign";
CM_ SG_ 253 VFC_TS15_AddTS2Quality "A flag that determines the quality of the signal";
CM_ SG_ 253 VFC_TS15_AddTS2VMS "Variable-message sign: Determines whether the traffic sign is Variable or fixed";
CM_ SG_ 253 VFC_TS15_AddTS3Class "The type of additonal sign that has been detected by the vision system";
CM_ SG_ 253 VFC_TS15_AddTS3Prob "Probability that the sign is a traffic sign";
CM_ SG_ 253 VFC_TS15_AddTS3Quality "A flag that determines the quality of the signal";
CM_ SG_ 253 VFC_TS15_AddTS3VMS "Variable-message sign: Determines whether the traffic sign is Variable or fixed";
CM_ SG_ 253 VFC_TS15_AddTS4Class "The type of additonal sign that has been detected by the vision system";
CM_ SG_ 253 VFC_TS15_AddTS4Prob "Probability that the sign is a traffic sign";
CM_ SG_ 253 VFC_TS15_AddTS4Quality "A flag that determines the quality of the signal";
CM_ SG_ 253 VFC_TS15_AddTS4VMS "Variable-message sign: Determines whether the traffic sign is Variable or fixed";
CM_ SG_ 253 VFC_TS15_AddTS5Class "The type of additonal sign that has been detected by the vision system";
CM_ SG_ 253 VFC_TS15_AddTS5Prob "Probability that the sign is a traffic sign";
CM_ SG_ 253 VFC_TS15_AddTS5Quality "A flag that determines the quality of the signal";
CM_ SG_ 253 VFC_TS15_AddTS5VMS "Variable-message sign: Determines whether the traffic sign is Variable or fixed";
CM_ SG_ 253 VFC_TS15_AddTS6Class "The type of additonal sign that has been detected by the vision system";
CM_ SG_ 253 VFC_TS15_AddTS6Prob "Probability that the sign is a traffic sign";
CM_ SG_ 253 VFC_TS15_AddTS6Quality "A flag that determines the quality of the signal";
CM_ SG_ 253 VFC_TS15_AddTS6VMS "Variable-message sign: Determines whether the traffic sign is Variable or fixed";
CM_ SG_ 260 RFC_LocHdrA_CRC "CRC - Autosar E2E Profile 5";
CM_ SG_ 260 RFC_LocHdrA_AliveCtr "Alive counter - Autosar E2E Profile 5";
CM_ SG_ 260 RFC_LocHdrA_ProtBlockCtr "Protocol-Signal: Block-Counter";
CM_ SG_ 260 RFC_LocHdr_IfVersionIdMajor "Version information of the interface. e. g. version 1.0: Major = 1. ISO 23150: Interface version ID {major, minor, patch} (A.1.1)";
CM_ SG_ 260 RFC_LocHdr_IfVersionIdMinor "Version information of the interface. e. g. version 1.0: Minor = 0. ISO 23150: Interface version ID {major, minor, patch} (A.1.1)";
CM_ SG_ 260 RFC_LocHdr_NumValidDetections "Number of detected VALID Locations that have been sent to the bus ISO 23150: Number of valid detections (A.1.12.8)";
CM_ SG_ 260 RFC_LocHdr_TimeStamp "Time Stamp ISO 23150: Time stamp  predicted (A.1.5.1)";
CM_ SG_ 260 RFC_LocHdr_SensorStatus "Bit 0: HW MALFUNCTION
Bit 1: DSP ISSUES
Bit 2: COMMUNICATION ERRORS
Bit 3: MISALIGNMENT (OUT OF SPEC)
Bit 4: SENSOR BLIDNESS DETECTED
Bit 5: SENSOR DISTURBED
Bit 6: OTHER ISSUES
Bit 7: RESERVED
Value 0: no event
Value 1: event occured";
CM_ SG_ 260 RFC_LocHdr_SensorStatusExt "Bit 0-4: RESERVED
Bit 5: AZIMUTH OUT OF SPEC
Bit 6: ELEVATION OUT OF SPEC
Value 0: no event
Value 1: event occured";
CM_ SG_ 260 RFC_LocHdr_LocDownSel "The detected number of locations exceeded the number of max. locations that can be transmitted";
CM_ SG_ 260 RFC_LocHdr_TimeStampStatus "Autosar StbM_TimeBaseStatusType bitfield with extension:
Bit 0: TIMEOUT
Bit 1: Reserved1
Bit 2: SYNC_TO_GATEWAY
Bit 3: GLOBAL_TIME_BASE
Bit 4: TIMELEAP_FUTURE
Bit 5: TIMELEAP_PAST
Bit 6: Reserved6
Bit 7: Extension: GENERAL_ERROR";
CM_ SG_ 260 RFC_LocHdr_BlindnessEvent "Bit 0: General blindness
-----------
Detailed blindness info:
Bit 1: Blindness algo event (deprecated)
Bit 2: Absorbtion blindness
Bit 3: Distortion blindness azimuth
Bit 4: Distortion blindness elevation
Value 0: no event
Value 1: event occured";
CM_ SG_ 260 RFC_LocHdr_SwVersion "SW version: 4 digits major version, 2 digits minor version";
CM_ SG_ 260 RFC_LocHdr_SensorOriginPointY "Nominal mounting position in the lateral direction ISO 23150: Sensor origin point {y} (A.1.22)";
CM_ SG_ 260 RFC_LocHdr_SensorOriginPointX "Nominal mounting position in the longitudinal direction  ISO 23150: Sensor origin point {x} (A.1.22)";
CM_ SG_ 260 RFC_LocHdr_SensorOriginPointZ "Nominal mounting position in the vertical direction  ISO 23150: Sensor origin point {z} (A.1.22)";
CM_ SG_ 260 RFC_LocHdr_SensorOrientCorrYaw "Sensor mounting angle azimuth current ISO 23150: Sensor orientation  correction {yaw} (A.5.46) - this signal contains the absolute value not the difference to the nominal";
CM_ SG_ 260 RFC_LocHdr_SensorOrientCorrPitch "Sensor mounting angle elevation current ISO 23150: Sensor orientation  correction {pitch} (A.5.46) - this signal contains the absolute value not the difference to the nominal";
CM_ SG_ 260 RFC_LocHdr_SensorOrientYaw "Sensor mounting angle azimuth nominal ISO 23150: Sensor orientation {yaw} (A.1.24)";
CM_ SG_ 260 RFC_LocHdr_SensorOrientPitch "Sensor mounting angle elevation nominal ISO 23150: Sensor orientation {pitch} (A.1.24)";
CM_ SG_ 260 RFC_LocHdr_ModPerfDistanceMax "Modulation performance max. measurable distance";
CM_ SG_ 260 RFC_LocHdr_FovElev00RangeGain "Maximal detection distance elevation related scaling parameter. Similar ISO 23150 definition: Range gain (A.5.5). Further details refer to DSP Location Interface definition";
CM_ SG_ 260 RFC_LocHdr_FovElev01RangeGain "Maximal detection distance elevation related scaling parameter. Similar ISO 23150 definition: Range gain (A.5.5). Further details refer to DSP Location Interface definition";
CM_ SG_ 260 RFC_LocHdr_FovElev02RangeGain "Maximal detection distance elevation related scaling parameter. Similar ISO 23150 definition: Range gain (A.5.5). Further details refer to DSP Location Interface definition";
CM_ SG_ 260 RFC_LocHdr_FovElev03RangeGain "Maximal detection distance elevation related scaling parameter. Similar ISO 23150 definition: Range gain (A.5.5). Further details refer to DSP Location Interface definition";
CM_ SG_ 260 RFC_LocHdr_FovElev04RangeGain "Maximal detection distance elevation related scaling parameter. Similar ISO 23150 definition: Range gain (A.5.5). Further details refer to DSP Location Interface definition";
CM_ SG_ 260 RFC_LocHdr_FovElev05RangeGain "Maximal detection distance elevation related scaling parameter. Similar ISO 23150 definition: Range gain (A.5.5). Further details refer to DSP Location Interface definition";
CM_ SG_ 260 RFC_LocHdr_FovElev06RangeGain "Maximal detection distance elevation related scaling parameter. Similar ISO 23150 definition: Range gain (A.5.5). Further details refer to DSP Location Interface definition";
CM_ SG_ 260 RFC_LocHdr_FovElev07RangeGain "Maximal detection distance elevation related scaling parameter. Similar ISO 23150 definition: Range gain (A.5.5). Further details refer to DSP Location Interface definition";
CM_ SG_ 260 RFC_LocHdr_FovElev08RangeGain "Maximal detection distance elevation related scaling parameter. Similar ISO 23150 definition: Range gain (A.5.5). Further details refer to DSP Location Interface definition";
CM_ SG_ 260 RFC_LocHdr_FovElev09RangeGain "Maximal detection distance elevation related scaling parameter. Similar ISO 23150 definition: Range gain (A.5.5). Further details refer to DSP Location Interface definition";
CM_ SG_ 260 RFC_LocHdr_FovElev10RangeGain "Maximal detection distance elevation related scaling parameter. Similar ISO 23150 definition: Range gain (A.5.5). Further details refer to DSP Location Interface definition";
CM_ SG_ 260 RFC_LocHdr_FovElevation00 "Field of view elevation angle definition. ISO 23150: Segment elevation {begin, end} (A.5.2) can be calculated from this signal value. Further details refers to DSP Location Interface definition";
CM_ SG_ 260 RFC_LocHdr_FovElevation01 "Field of view elevation angle definition. ISO 23150: Segment elevation {begin, end} (A.5.2) can be calculated from this signal value. Further details refers to DSP Location Interface definition";
CM_ SG_ 260 RFC_LocHdr_FovElevation02 "Field of view elevation angle definition. ISO 23150: Segment elevation {begin, end} (A.5.2) can be calculated from this signal value. Further details refers to DSP Location Interface definition";
CM_ SG_ 260 RFC_LocHdr_FovElevation03 "Field of view elevation angle definition. ISO 23150: Segment elevation {begin, end} (A.5.2) can be calculated from this signal value. Further details refers to DSP Location Interface definition";
CM_ SG_ 260 RFC_LocHdr_FovElevation04 "Field of view elevation angle definition. ISO 23150: Segment elevation {begin, end} (A.5.2) can be calculated from this signal value. Further details refers to DSP Location Interface definition";
CM_ SG_ 260 RFC_LocHdr_FovElevation05 "Field of view elevation angle definition. ISO 23150: Segment elevation {begin, end} (A.5.2) can be calculated from this signal value. Further details refers to DSP Location Interface definition";
CM_ SG_ 260 RFC_LocHdr_FovElevation06 "Field of view elevation angle definition. ISO 23150: Segment elevation {begin, end} (A.5.2) can be calculated from this signal value. Further details refers to DSP Location Interface definition";
CM_ SG_ 260 RFC_LocHdr_FovElevation07 "Field of view elevation angle definition. ISO 23150: Segment elevation {begin, end} (A.5.2) can be calculated from this signal value. Further details refers to DSP Location Interface definition";
CM_ SG_ 260 RFC_LocHdr_FovElevation08 "Field of view elevation angle definition. ISO 23150: Segment elevation {begin, end} (A.5.2) can be calculated from this signal value. Further details refers to DSP Location Interface definition";
CM_ SG_ 260 RFC_LocHdr_FovElevation09 "Field of view elevation angle definition. ISO 23150: Segment elevation {begin, end} (A.5.2) can be calculated from this signal value. Further details refers to DSP Location Interface definition";
CM_ SG_ 260 RFC_LocHdr_FovElevation10 "Field of view elevation angle definition. ISO 23150: Segment elevation {begin, end} (A.5.2) can be calculated from this signal value. Further details refers to DSP Location Interface definition";
CM_ SG_ 261 RFC_LocHdrB_CRC "CRC - Autosar E2E Profile 5";
CM_ SG_ 261 RFC_LocHdrB_AliveCtr "Alive counter - Autosar E2E Profile 5";
CM_ SG_ 261 RFC_LocHdrB_ProtBlockCtr "Protocol-Signal: Block-Counter";
CM_ SG_ 261 RFC_LocHdr_FovAzimuth00Range "Maximal detection distance in the corresponding azimuth angle. Similar ISO 23150 definition: Range gain (A.5.5). Further details refer to DSP Location Interface definition";
CM_ SG_ 261 RFC_LocHdr_FovAzimuth01Range "Maximal detection distance in the corresponding azimuth angle. Similar ISO 23150 definition: Range gain (A.5.5). Further details refer to DSP Location Interface definition";
CM_ SG_ 261 RFC_LocHdr_FovAzimuth02Range "Maximal detection distance in the corresponding azimuth angle. Similar ISO 23150 definition: Range gain (A.5.5). Further details refer to DSP Location Interface definition";
CM_ SG_ 261 RFC_LocHdr_FovAzimuth03Range "Maximal detection distance in the corresponding azimuth angle. Similar ISO 23150 definition: Range gain (A.5.5). Further details refer to DSP Location Interface definition";
CM_ SG_ 261 RFC_LocHdr_FovAzimuth04Range "Maximal detection distance in the corresponding azimuth angle. Similar ISO 23150 definition: Range gain (A.5.5). Further details refer to DSP Location Interface definition";
CM_ SG_ 261 RFC_LocHdr_FovAzimuth05Range "Maximal detection distance in the corresponding azimuth angle. Similar ISO 23150 definition: Range gain (A.5.5). Further details refer to DSP Location Interface definition";
CM_ SG_ 261 RFC_LocHdr_FovAzimuth06Range "Maximal detection distance in the corresponding azimuth angle. Similar ISO 23150 definition: Range gain (A.5.5). Further details refer to DSP Location Interface definition";
CM_ SG_ 261 RFC_LocHdr_FovAzimuth07Range "Maximal detection distance in the corresponding azimuth angle. Similar ISO 23150 definition: Range gain (A.5.5). Further details refer to DSP Location Interface definition";
CM_ SG_ 261 RFC_LocHdr_FovAzimuth08Range "Maximal detection distance in the corresponding azimuth angle. Similar ISO 23150 definition: Range gain (A.5.5). Further details refer to DSP Location Interface definition";
CM_ SG_ 261 RFC_LocHdr_FovAzimuth09Range "Maximal detection distance in the corresponding azimuth angle. Similar ISO 23150 definition: Range gain (A.5.5). Further details refer to DSP Location Interface definition";
CM_ SG_ 261 RFC_LocHdr_FovAzimuth10Range "Maximal detection distance in the corresponding azimuth angle. Similar ISO 23150 definition: Range gain (A.5.5). Further details refer to DSP Location Interface definition";
CM_ SG_ 261 RFC_LocHdr_FovAzimuth11Range "Maximal detection distance in the corresponding azimuth angle. Similar ISO 23150 definition: Range gain (A.5.5). Further details refer to DSP Location Interface definition";
CM_ SG_ 261 RFC_LocHdr_FovAzimuth12Range "Maximal detection distance in the corresponding azimuth angle. Similar ISO 23150 definition: Range gain (A.5.5). Further details refer to DSP Location Interface definition";
CM_ SG_ 261 RFC_LocHdr_FovAzimuth13Range "Maximal detection distance in the corresponding azimuth angle. Similar ISO 23150 definition: Range gain (A.5.5). Further details refer to DSP Location Interface definition";
CM_ SG_ 261 RFC_LocHdr_FovAzimuth14Range "Maximal detection distance in the corresponding azimuth angle. Similar ISO 23150 definition: Range gain (A.5.5). Further details refer to DSP Location Interface definition";
CM_ SG_ 261 RFC_LocHdr_FovAzimuth15Range "Maximal detection distance in the corresponding azimuth angle. Similar ISO 23150 definition: Range gain (A.5.5). Further details refer to DSP Location Interface definition";
CM_ SG_ 261 RFC_LocHdr_FovAzimuth16Range "Maximal detection distance in the corresponding azimuth angle. Similar ISO 23150 definition: Range gain (A.5.5). Further details refer to DSP Location Interface definition";
CM_ SG_ 261 RFC_LocHdr_FovAzimuth17Range "Maximal detection distance in the corresponding azimuth angle. Similar ISO 23150 definition: Range gain (A.5.5). Further details refer to DSP Location Interface definition";
CM_ SG_ 261 RFC_LocHdr_FovAzimuth18Range "Maximal detection distance in the corresponding azimuth angle. Similar ISO 23150 definition: Range gain (A.5.5). Further details refer to DSP Location Interface definition";
CM_ SG_ 261 RFC_LocHdr_FovAzimuth19Range "Maximal detection distance in the corresponding azimuth angle. Similar ISO 23150 definition: Range gain (A.5.5). Further details refer to DSP Location Interface definition";
CM_ SG_ 261 RFC_LocHdr_FovAzimuth20Range "Maximal detection distance in the corresponding azimuth angle. Similar ISO 23150 definition: Range gain (A.5.5). Further details refer to DSP Location Interface definition";
CM_ SG_ 261 RFC_LocHdr_FovAzimuth21Range "Maximal detection distance in the corresponding azimuth angle. Similar ISO 23150 definition: Range gain (A.5.5). Further details refer to DSP Location Interface definition";
CM_ SG_ 261 RFC_LocHdr_FovAzimuth22Range "Maximal detection distance in the corresponding azimuth angle. Similar ISO 23150 definition: Range gain (A.5.5). Further details refer to DSP Location Interface definition";
CM_ SG_ 261 RFC_LocHdr_FovAzimuth23Range "Maximal detection distance in the corresponding azimuth angle. Similar ISO 23150 definition: Range gain (A.5.5). Further details refer to DSP Location Interface definition";
CM_ SG_ 261 RFC_LocHdr_FovAzimuth24Range "Maximal detection distance in the corresponding azimuth angle. Similar ISO 23150 definition: Range gain (A.5.5). Further details refer to DSP Location Interface definition";
CM_ SG_ 261 RFC_LocHdr_FovAzimuth00 "Field of view azimuthal angle definition. ISO 23150: Segment azimuth {begin, end} (A.5.1) can be calculated from this signal value. Further details refers to DSP Location Interface definition";
CM_ SG_ 261 RFC_LocHdr_FovAzimuth01 "Field of view azimuthal angle definition. ISO 23150: Segment azimuth {begin, end} (A.5.1) can be calculated from this signal value. Further details refers to DSP Location Interface definition";
CM_ SG_ 261 RFC_LocHdr_FovAzimuth02 "Field of view azimuthal angle definition. ISO 23150: Segment azimuth {begin, end} (A.5.1) can be calculated from this signal value. Further details refers to DSP Location Interface definition";
CM_ SG_ 261 RFC_LocHdr_FovAzimuth03 "Field of view azimuthal angle definition. ISO 23150: Segment azimuth {begin, end} (A.5.1) can be calculated from this signal value. Further details refers to DSP Location Interface definition";
CM_ SG_ 261 RFC_LocHdr_FovAzimuth04 "Field of view azimuthal angle definition. ISO 23150: Segment azimuth {begin, end} (A.5.1) can be calculated from this signal value. Further details refers to DSP Location Interface definition";
CM_ SG_ 261 RFC_LocHdr_FovAzimuth05 "Field of view azimuthal angle definition. ISO 23150: Segment azimuth {begin, end} (A.5.1) can be calculated from this signal value. Further details refers to DSP Location Interface definition";
CM_ SG_ 261 RFC_LocHdr_FovAzimuth06 "Field of view azimuthal angle definition. ISO 23150: Segment azimuth {begin, end} (A.5.1) can be calculated from this signal value. Further details refers to DSP Location Interface definition";
CM_ SG_ 261 RFC_LocHdr_FovAzimuth07 "Field of view azimuthal angle definition. ISO 23150: Segment azimuth {begin, end} (A.5.1) can be calculated from this signal value. Further details refers to DSP Location Interface definition";
CM_ SG_ 261 RFC_LocHdr_FovAzimuth08 "Field of view azimuthal angle definition. ISO 23150: Segment azimuth {begin, end} (A.5.1) can be calculated from this signal value. Further details refers to DSP Location Interface definition";
CM_ SG_ 261 RFC_LocHdr_FovAzimuth09 "Field of view azimuthal angle definition. ISO 23150: Segment azimuth {begin, end} (A.5.1) can be calculated from this signal value. Further details refers to DSP Location Interface definition";
CM_ SG_ 261 RFC_LocHdr_FovAzimuth10 "Field of view azimuthal angle definition. ISO 23150: Segment azimuth {begin, end} (A.5.1) can be calculated from this signal value. Further details refers to DSP Location Interface definition";
CM_ SG_ 261 RFC_LocHdr_FovAzimuth11 "Field of view azimuthal angle definition. ISO 23150: Segment azimuth {begin, end} (A.5.1) can be calculated from this signal value. Further details refers to DSP Location Interface definition";
CM_ SG_ 261 RFC_LocHdr_FovAzimuth12 "Field of view azimuthal angle definition. ISO 23150: Segment azimuth {begin, end} (A.5.1) can be calculated from this signal value. Further details refers to DSP Location Interface definition";
CM_ SG_ 261 RFC_LocHdr_FovAzimuth13 "Field of view azimuthal angle definition. ISO 23150: Segment azimuth {begin, end} (A.5.1) can be calculated from this signal value. Further details refers to DSP Location Interface definition";
CM_ SG_ 261 RFC_LocHdr_FovAzimuth14 "Field of view azimuthal angle definition. ISO 23150: Segment azimuth {begin, end} (A.5.1) can be calculated from this signal value. Further details refers to DSP Location Interface definition";
CM_ SG_ 261 RFC_LocHdr_FovAzimuth15 "Field of view azimuthal angle definition. ISO 23150: Segment azimuth {begin, end} (A.5.1) can be calculated from this signal value. Further details refers to DSP Location Interface definition";
CM_ SG_ 261 RFC_LocHdr_FovAzimuth16 "Field of view azimuthal angle definition. ISO 23150: Segment azimuth {begin, end} (A.5.1) can be calculated from this signal value. Further details refers to DSP Location Interface definition";
CM_ SG_ 261 RFC_LocHdr_FovAzimuth17 "Field of view azimuthal angle definition. ISO 23150: Segment azimuth {begin, end} (A.5.1) can be calculated from this signal value. Further details refers to DSP Location Interface definition";
CM_ SG_ 261 RFC_LocHdr_FovAzimuth18 "Field of view azimuthal angle definition. ISO 23150: Segment azimuth {begin, end} (A.5.1) can be calculated from this signal value. Further details refers to DSP Location Interface definition";
CM_ SG_ 261 RFC_LocHdr_FovAzimuth19 "Field of view azimuthal angle definition. ISO 23150: Segment azimuth {begin, end} (A.5.1) can be calculated from this signal value. Further details refers to DSP Location Interface definition";
CM_ SG_ 261 RFC_LocHdr_FovAzimuth20 "Field of view azimuthal angle definition. ISO 23150: Segment azimuth {begin, end} (A.5.1) can be calculated from this signal value. Further details refers to DSP Location Interface definition";
CM_ SG_ 261 RFC_LocHdr_FovAzimuth21 "Field of view azimuthal angle definition. ISO 23150: Segment azimuth {begin, end} (A.5.1) can be calculated from this signal value. Further details refers to DSP Location Interface definition";
CM_ SG_ 261 RFC_LocHdr_FovAzimuth22 "Field of view azimuthal angle definition. ISO 23150: Segment azimuth {begin, end} (A.5.1) can be calculated from this signal value. Further details refers to DSP Location Interface definition";
CM_ SG_ 261 RFC_LocHdr_FovAzimuth23 "Field of view azimuthal angle definition. ISO 23150: Segment azimuth {begin, end} (A.5.1) can be calculated from this signal value. Further details refers to DSP Location Interface definition";
CM_ SG_ 261 RFC_LocHdr_FovAzimuth24 "Field of view azimuthal angle definition. ISO 23150: Segment azimuth {begin, end} (A.5.1) can be calculated from this signal value. Further details refers to DSP Location Interface definition";
CM_ SG_ 264 RFC_Loc000_002_CRC "CRC - Autosar E2E Profile 5";
CM_ SG_ 264 RFC_Loc000_002_AliveCtr "Alive counter - Autosar E2E Profile 5";
CM_ SG_ 264 RFC_Loc000_002_ProtBlockCtr "Protocol-Signal: Block-Counter";
CM_ SG_ 264 RFC_Loc000_RadialDistance "Location radial distance. Represented in conical coordinate system. Same as ISO 23150: Position radial distance (A.4.16)";
CM_ SG_ 264 RFC_Loc000_RadialVelocity "Location radial relative velocity ISO 23150: Relative velocity {radial distance} (A.4.18)";
CM_ SG_ 264 RFC_Loc000_Elevation "Location elevation angle. Represented in conical coordinate system. Same as ISO 23150: Position elevation (A.4.16)";
CM_ SG_ 264 RFC_Loc000_Azimuth "Location azimuth angle. Represented in conical coordinate system. Deviation from ISO 23150: Position azimuth (A.4.16). Further details refers to DSP Location Interface definition";
CM_ SG_ 264 RFC_Loc000_DistVelocityCoVnce "Covariance of radial distance and radial velocity";
CM_ SG_ 264 RFC_Loc000_RadialDistanceVnce "Variance of Location radial distance ISO 23150: Position radial distance  error (A.4.17)";
CM_ SG_ 264 RFC_Loc000_RadialVelocityVnce "Variance of Location radial relative velocity ISO 23150: Relative velocity {radial distance}  error (A.4.19)";
CM_ SG_ 264 RFC_Loc000_ElevationVnce "Variance of Location elevation angle ISO 23150: Position elevation  error (A.4.17)";
CM_ SG_ 264 RFC_Loc000_AzimuthVnce "Variance of Location azimuth angle ISO 23150: Position azimuth  error (A.4.17)";
CM_ SG_ 264 RFC_Loc000_RadarCrossSection "Radar Cross Section (RCS) estimation ISO 23150: Radar cross section (A.4.5)";
CM_ SG_ 264 RFC_Loc000_DistVelocityQuality "Quality of radial distance and velocity resolution processing. Physical range [0..1]";
CM_ SG_ 264 RFC_Loc000_ElevationQuality "Probability for correct signal model (elevation angle). Physical range [0..1]";
CM_ SG_ 264 RFC_Loc000_AzimuthQuality "Probability for correct signal model (azimuth angle). Physical range [0..1]";
CM_ SG_ 264 RFC_Loc000_RSSI "Received Signal Strength Indication (RSSI). This signal is not exactly ISO 23150: Signal to noise ratio  detection level (A.4.7), but SNR can be calculated from this signal. Further detail please refer to the DSP Location Interface definition";
CM_ SG_ 264 RFC_Loc000_AzimuthalPartnerId "Id of the azimuthal partner location";
CM_ SG_ 264 RFC_Loc001_RadialDistance "Location radial distance. Represented in conical coordinate system. Same as ISO 23150: Position radial distance (A.4.16)";
CM_ SG_ 264 RFC_Loc001_RadialVelocity "Location radial relative velocity ISO 23150: Relative velocity {radial distance} (A.4.18)";
CM_ SG_ 264 RFC_Loc001_Elevation "Location elevation angle. Represented in conical coordinate system. Same as ISO 23150: Position elevation (A.4.16)";
CM_ SG_ 264 RFC_Loc001_Azimuth "Location azimuth angle. Represented in conical coordinate system. Deviation from ISO 23150: Position azimuth (A.4.16). Further details refers to DSP Location Interface definition";
CM_ SG_ 264 RFC_Loc001_DistVelocityCoVnce "Covariance of radial distance and radial velocity";
CM_ SG_ 264 RFC_Loc001_RadialDistanceVnce "Variance of Location radial distance ISO 23150: Position radial distance  error (A.4.17)";
CM_ SG_ 264 RFC_Loc001_RadialVelocityVnce "Variance of Location radial relative velocity ISO 23150: Relative velocity {radial distance}  error (A.4.19)";
CM_ SG_ 264 RFC_Loc001_ElevationVnce "Variance of Location elevation angle ISO 23150: Position elevation  error (A.4.17)";
CM_ SG_ 264 RFC_Loc001_AzimuthVnce "Variance of Location azimuth angle ISO 23150: Position azimuth  error (A.4.17)";
CM_ SG_ 264 RFC_Loc001_RadarCrossSection "Radar Cross Section (RCS) estimation ISO 23150: Radar cross section (A.4.5)";
CM_ SG_ 264 RFC_Loc001_DistVelocityQuality "Quality of radial distance and velocity resolution processing. Physical range [0..1]";
CM_ SG_ 264 RFC_Loc001_ElevationQuality "Probability for correct signal model (elevation angle). Physical range [0..1]";
CM_ SG_ 264 RFC_Loc001_AzimuthQuality "Probability for correct signal model (azimuth angle). Physical range [0..1]";
CM_ SG_ 264 RFC_Loc001_RSSI "Received Signal Strength Indication (RSSI). This signal is not exactly ISO 23150: Signal to noise ratio  detection level (A.4.7), but SNR can be calculated from this signal. Further detail please refer to the DSP Location Interface definition";
CM_ SG_ 264 RFC_Loc001_AzimuthalPartnerId "Id of the azimuthal partner location";
CM_ SG_ 264 RFC_Loc002_RadialDistance "Location radial distance. Represented in conical coordinate system. Same as ISO 23150: Position radial distance (A.4.16)";
CM_ SG_ 264 RFC_Loc002_RadialVelocity "Location radial relative velocity ISO 23150: Relative velocity {radial distance} (A.4.18)";
CM_ SG_ 264 RFC_Loc002_Elevation "Location elevation angle. Represented in conical coordinate system. Same as ISO 23150: Position elevation (A.4.16)";
CM_ SG_ 264 RFC_Loc002_Azimuth "Location azimuth angle. Represented in conical coordinate system. Deviation from ISO 23150: Position azimuth (A.4.16). Further details refers to DSP Location Interface definition";
CM_ SG_ 264 RFC_Loc002_DistVelocityCoVnce "Covariance of radial distance and radial velocity";
CM_ SG_ 264 RFC_Loc002_RadialDistanceVnce "Variance of Location radial distance ISO 23150: Position radial distance  error (A.4.17)";
CM_ SG_ 264 RFC_Loc002_RadialVelocityVnce "Variance of Location radial relative velocity ISO 23150: Relative velocity {radial distance}  error (A.4.19)";
CM_ SG_ 264 RFC_Loc002_ElevationVnce "Variance of Location elevation angle ISO 23150: Position elevation  error (A.4.17)";
CM_ SG_ 264 RFC_Loc002_AzimuthVnce "Variance of Location azimuth angle ISO 23150: Position azimuth  error (A.4.17)";
CM_ SG_ 264 RFC_Loc002_RadarCrossSection "Radar Cross Section (RCS) estimation ISO 23150: Radar cross section (A.4.5)";
CM_ SG_ 264 RFC_Loc002_DistVelocityQuality "Quality of radial distance and velocity resolution processing. Physical range [0..1]";
CM_ SG_ 264 RFC_Loc002_ElevationQuality "Probability for correct signal model (elevation angle). Physical range [0..1]";
CM_ SG_ 264 RFC_Loc002_AzimuthQuality "Probability for correct signal model (azimuth angle). Physical range [0..1]";
CM_ SG_ 264 RFC_Loc002_RSSI "Received Signal Strength Indication (RSSI). This signal is not exactly ISO 23150: Signal to noise ratio  detection level (A.4.7), but SNR can be calculated from this signal. Further detail please refer to the DSP Location Interface definition";
CM_ SG_ 264 RFC_Loc002_AzimuthalPartnerId "Id of the azimuthal partner location";
BA_DEF_ BO_  "CANFD_BRS" ENUM  "0","1";
BA_DEF_ BO_  "GenMsgCycleTime" INT 0 65535;
BA_DEF_ BO_  "GenMsgSendType" ENUM  "Event","cyclic","event";
BA_DEF_ BO_  "VFrameFormat" ENUM  "StandardCAN","ExtendedCAN","reserved","reserved","reserved","reserved","reserved","reserved","reserved","reserved","reserved","reserved","reserved","reserved","StandardCAN_FD","ExtendedCAN_FD";
BA_DEF_ SG_  "GenSigStartValue" FLOAT 0 100000000000;
BA_DEF_DEF_  "CANFD_BRS" "1";
BA_DEF_DEF_  "GenMsgCycleTime" 0;
BA_DEF_DEF_  "GenMsgSendType" "";
BA_DEF_DEF_  "VFrameFormat" "";
BA_DEF_DEF_  "GenSigStartValue" 0;
BA_ "GenMsgSendType" BO_ 247 0;
BA_ "VFrameFormat" BO_ 247 14;
BA_ "GenMsgSendType" BO_ 248 0;
BA_ "VFrameFormat" BO_ 248 14;
BA_ "GenMsgSendType" BO_ 249 0;
BA_ "VFrameFormat" BO_ 249 14;
BA_ "GenMsgSendType" BO_ 250 0;
BA_ "VFrameFormat" BO_ 250 14;
BA_ "GenMsgSendType" BO_ 251 0;
BA_ "VFrameFormat" BO_ 251 14;
BA_ "GenMsgSendType" BO_ 252 0;
BA_ "VFrameFormat" BO_ 252 14;
BA_ "GenMsgSendType" BO_ 253 0;
BA_ "VFrameFormat" BO_ 253 14;
BA_ "GenMsgSendType" BO_ 260 2;
BA_ "VFrameFormat" BO_ 260 14;
BA_ "GenMsgSendType" BO_ 261 2;
BA_ "VFrameFormat" BO_ 261 14;
BA_ "GenMsgSendType" BO_ 264 2;
BA_ "VFrameFormat" BO_ 264 14;
BA_ "GenSigStartValue" SG_ 247 VFC_TS09_Dy 128;
BA_ "GenSigStartValue" SG_ 248 VFC_TS10_Dy 128;
BA_ "GenSigStartValue" SG_ 249 VFC_TS11_Dy 128;
BA_ "GenSigStartValue" SG_ 250 VFC_TS12_Dy 128;
BA_ "GenSigStartValue" SG_ 251 VFC_TS13_Dy 128;
BA_ "GenSigStartValue" SG_ 252 VFC_TS14_Dy 128;
BA_ "GenSigStartValue" SG_ 253 VFC_TS15_Dy 128;
BA_ "GenSigStartValue" SG_ 260 RFC_LocHdr_SensorOriginPointY 128;
BA_ "GenSigStartValue" SG_ 260 RFC_LocHdr_SensorOriginPointX 256;
BA_ "GenSigStartValue" SG_ 260 RFC_LocHdr_SensorOrientCorrYaw 32768;
BA_ "GenSigStartValue" SG_ 260 RFC_LocHdr_SensorOrientCorrPitch 8192;
BA_ "GenSigStartValue" SG_ 260 RFC_LocHdr_SensorOrientYaw 32768;
BA_ "GenSigStartValue" SG_ 260 RFC_LocHdr_SensorOrientPitch 8192;
BA_ "GenSigStartValue" SG_ 260 RFC_LocHdr_FovElevation00 64;
BA_ "GenSigStartValue" SG_ 260 RFC_LocHdr_FovElevation01 64;
BA_ "GenSigStartValue" SG_ 260 RFC_LocHdr_FovElevation02 64;
BA_ "GenSigStartValue" SG_ 260 RFC_LocHdr_FovElevation03 64;
BA_ "GenSigStartValue" SG_ 260 RFC_LocHdr_FovElevation04 64;
BA_ "GenSigStartValue" SG_ 260 RFC_LocHdr_FovElevation05 64;
BA_ "GenSigStartValue" SG_ 260 RFC_LocHdr_FovElevation06 64;
BA_ "GenSigStartValue" SG_ 260 RFC_LocHdr_FovElevation07 64;
BA_ "GenSigStartValue" SG_ 260 RFC_LocHdr_FovElevation08 64;
BA_ "GenSigStartValue" SG_ 260 RFC_LocHdr_FovElevation09 64;
BA_ "GenSigStartValue" SG_ 260 RFC_LocHdr_FovElevation10 64;
BA_ "GenSigStartValue" SG_ 261 RFC_LocHdr_FovAzimuth00 128;
BA_ "GenSigStartValue" SG_ 261 RFC_LocHdr_FovAzimuth01 128;
BA_ "GenSigStartValue" SG_ 261 RFC_LocHdr_FovAzimuth02 128;
BA_ "GenSigStartValue" SG_ 261 RFC_LocHdr_FovAzimuth03 128;
BA_ "GenSigStartValue" SG_ 261 RFC_LocHdr_FovAzimuth04 128;
BA_ "GenSigStartValue" SG_ 261 RFC_LocHdr_FovAzimuth05 128;
BA_ "GenSigStartValue" SG_ 261 RFC_LocHdr_FovAzimuth06 128;
BA_ "GenSigStartValue" SG_ 261 RFC_LocHdr_FovAzimuth07 128;
BA_ "GenSigStartValue" SG_ 261 RFC_LocHdr_FovAzimuth08 128;
BA_ "GenSigStartValue" SG_ 261 RFC_LocHdr_FovAzimuth09 128;
BA_ "GenSigStartValue" SG_ 261 RFC_LocHdr_FovAzimuth10 128;
BA_ "GenSigStartValue" SG_ 261 RFC_LocHdr_FovAzimuth11 128;
BA_ "GenSigStartValue" SG_ 261 RFC_LocHdr_FovAzimuth12 128;
BA_ "GenSigStartValue" SG_ 261 RFC_LocHdr_FovAzimuth13 128;
BA_ "GenSigStartValue" SG_ 261 RFC_LocHdr_FovAzimuth14 128;
BA_ "GenSigStartValue" SG_ 261 RFC_LocHdr_FovAzimuth15 128;
BA_ "GenSigStartValue" SG_ 261 RFC_LocHdr_FovAzimuth16 128;
BA_ "GenSigStartValue" SG_ 261 RFC_LocHdr_FovAzimuth17 128;
BA_ "GenSigStartValue" SG_ 261 RFC_LocHdr_FovAzimuth18 128;
BA_ "GenSigStartValue" SG_ 261 RFC_LocHdr_FovAzimuth19 128;
BA_ "GenSigStartValue" SG_ 261 RFC_LocHdr_FovAzimuth20 128;
BA_ "GenSigStartValue" SG_ 261 RFC_LocHdr_FovAzimuth21 128;
BA_ "GenSigStartValue" SG_ 261 RFC_LocHdr_FovAzimuth22 128;
BA_ "GenSigStartValue" SG_ 261 RFC_LocHdr_FovAzimuth23 128;
BA_ "GenSigStartValue" SG_ 261 RFC_LocHdr_FovAzimuth24 128;
BA_ "GenSigStartValue" SG_ 264 RFC_Loc000_RadialVelocity 16384;
BA_ "GenSigStartValue" SG_ 264 RFC_Loc000_Elevation 512;
BA_ "GenSigStartValue" SG_ 264 RFC_Loc000_Azimuth 1024;
BA_ "GenSigStartValue" SG_ 264 RFC_Loc000_DistVelocityCoVnce 1024;
BA_ "GenSigStartValue" SG_ 264 RFC_Loc000_RadarCrossSection 512;
BA_ "GenSigStartValue" SG_ 264 RFC_Loc001_RadialVelocity 16384;
BA_ "GenSigStartValue" SG_ 264 RFC_Loc001_Elevation 512;
BA_ "GenSigStartValue" SG_ 264 RFC_Loc001_Azimuth 1024;
BA_ "GenSigStartValue" SG_ 264 RFC_Loc001_DistVelocityCoVnce 1024;
BA_ "GenSigStartValue" SG_ 264 RFC_Loc001_RadarCrossSection 512;
BA_ "GenSigStartValue" SG_ 264 RFC_Loc002_RadialVelocity 16384;
BA_ "GenSigStartValue" SG_ 264 RFC_Loc002_Elevation 512;
BA_ "GenSigStartValue" SG_ 264 RFC_Loc002_Azimuth 1024;
BA_ "GenSigStartValue" SG_ 264 RFC_Loc002_DistVelocityCoVnce 1024;
BA_ "GenSigStartValue" SG_ 264 RFC_Loc002_RadarCrossSection 512;
VAL_ 247 VFC_TS09_ID 0 "INVALID" ;
VAL_ 247 VFC_TS09_Class 0 "UNKNOWN" 1 "SL5" 2 "SL10" 3 "SL15" 4 "SL20" 5 "SL25" 6 "SL30" 7 "SL35" 8 "SL40" 9 "SL45" 10 "SL50" 11 "SL55" 12 "SL60" 13 "SL65" 14 "SL70" 15 "SL75" 16 "SL80" 17 "SL85" 18 "SL90" 19 "SL95" 20 "SL100" 21 "SL105" 22 "SL110" 23 "SL115" 24 "SL120" 25 "SL125" 26 "SL130" 27 "SL135" 28 "SL140" 29 "SL145" 30 "SL150" 31 "SL155" 32 "SL160" 33 "ESL" 34 "EA" 35 "OP" 36 "EOP" 37 "OL" 38 "EOL" 39 "GIVEWAY" 40 "PRIOCROSS" 41 "PRIOCROSSYIELDTORIGHT" 42 "PRIOSTREET" 43 "EPRIOSTREET" 44 "STOP" 45 "AXLEWEIGHT" 46 "CARDIST" 47 "HEIGHT" 48 "LENGTH" 49 "LORRYDIST" 50 "NOALL" 51 "NOBIKE" 52 "NOBUS" 53 "NOCAR" 54 "NOCARBIKE" 55 "NOCARRIAGE" 56 "NOENTRY" 57 "NOHAZMAT" 58 "NOHAZWATER" 59 "NOLORRY" 60 "NOLORRYTRAILER" 61 "NOLTURN" 62 "NOPED" 63 "NORIDER" 64 "NORTURN" 65 "NOTRACTOR" 66 "NOTWOWAY" 67 "NOUTURN" 68 "UMWELT" 69 "EUMWELT" 70 "WEIGHT" 71 "WIDTH" 72 "WARNBIKE" 73 "WARNBUS" 74 "WARNCATTLE" 75 "WARNCONST" 76 "WARNCONSTL" 77 "WARNCONSTR" 78 "WARNCURVEL" 79 "WARNCURVER" 80 "WARNDANGER" 81 "WARNDCURVEL" 82 "WARNDCURVER" 83 "WARNDRAWBRIDGE" 84 "WARNFROG" 85 "WARNGRAVEL" 86 "WARNHUMP" 87 "WARNJAM" 88 "WARNKIDS" 89 "WARNLIGHTS" 90 "WARNLOWTREE" 91 "WARNPCROSS" 92 "WARNPED" 93 "WARNPIER" 94 "WARNPLANE" 95 "WARNRIDER" 96 "WARNROCK" 97 "WARNROUND" 98 "WARNRWORKS" 99 "WARNSKID" 100 "WARNSLOPED" 101 "WARNSLOPEU" 102 "WARNSNOW" 103 "WARNTRAIN" 104 "WARNTWOWAY" 105 "WARNWILDANIMAL" 106 "WARNWIND" 107 "ASL" 108 "EASL" 109 "CALM" 110 "ECALM" 111 "DEADEND" 112 "DOUANE" 113 "FWAY" 114 "EFWAY" 115 "HWAY" 116 "EHWAY" 117 "MSL" 118 "EMSL" 119 "NOPARK" 120 "NOSTOP" 121 "ONEWAYS" 122 "ONEWAYU" 123 "SLOWDOWN" 124 "SCHOOL" 125 "ESCHOOL" 126 "TWN" 127 "ETWN" 128 "WBBENTLEFT" 129 "WBBENTLEFTRIGHT" 130 "WBBENTRIGHT" 131 "WBDIAGL" 132 "WBDIAGLR" 133 "WBDIAGR" 134 "WBHAZWATER" 135 "WBLEFT" 136 "WBRIGHT" 137 "WBROUND" 138 "WBUP" 139 "WBUPLEFT" 140 "WBUPRIGHT" 141 "ZEBRA" 142 "HAZMAT" 143 "EMERGENCYBAY" 144 "ENDOFLANEL" 145 "ENDOFLANER" 146 "ENOPARK" 147 "EONEWAY" 148 "EPARK" 149 "ETOLL" 150 "NOPARKL" 151 "NOPARKLR" 152 "NOPARKR" 153 "NOSTOPL" 154 "NOSTOPLR" 155 "NOSTOPR" 156 "NOTURNONRED" 157 "ONEWAYL" 158 "ONEWAYR" 159 "PARK" 160 "PRIOCROSSL" 161 "PRIOCROSSR" 162 "TOLL" 163 "TUNNEL" 164 "TWOWAY" 165 "WARNCROSS" 166 "WARNCROSSL" 167 "WARNCROSSLR" 168 "WARNCROSSR" 169 "WARNCROSSRL" 170 "WARNCROSST" 171 "WARNGIVEWAYAHEAD" 172 "WARNSLAHEAD" 173 "WARNSTOPAHEAD" 174 "WBBUS" 175 "WRONGWAY" 176 "HAZWATER" 177 "GIVEWAYROUND" 178 "WARNWINDINGL" 179 "WARNWINDINGR" 180 "WARNHAIRPINL" 181 "WARNHAIRPINR" 182 "WARNPEDBIKE" 183 "WARNCROSSY" 184 "WARNBRANCHL" 185 "WARNBRANCHR" 186 "WARNAXLEWEIGHT" 187 "WARNWEIGHT" 188 "WARNHEIGHT" 189 "WARNLENGTH" 190 "WARNWIDTH" 191 "WARNBLACKSPOT" 192 "WARNMERGEL" 193 "WARNMERGER" 194 "WARNTUNNEL" 195 "WARNTRACTOR" 196 "WARNRWORKSVEHICLE" 197 "WARNNARROWBRIDGE" 198 "WARNFLAGGER" 199 "LANES" 200 "LANESHIFTL" 201 "LANESHIFTR" 202 "NEWLANEL" 203 "NEWLANER" 204 "RIGHTTURNONRED" 205 "BORDERLIMIT" 206 "EMBEDDEDRAIN" ;
VAL_ 247 VFC_TS09_EmbedFlag 0 "Unknown" 1 "Not Embedded" 2 "Border Limit" 3 "Multi Lane" 4 "Rain" 5 "Vehicle Type" 6 "Plate" 7 "Error Value" ;
VAL_ 247 VFC_TS09_Quality 0 "Poor Quality" 1 "Good Quality" ;
VAL_ 247 VFC_TS09_VMS 0 "Fixed" 1 "Variable" ;
VAL_ 247 VFC_TS09_Stable 0 "Object Is Not Stable" 1 "Object Is Stable" ;
VAL_ 247 VFC_TS09_VehicleSticker 0 "not_sticker_on_vehicle" 1 "Sign is a sticker on a vehicle" ;
VAL_ 247 VFC_TS09_InternalTrack 0 "Sign is not an internal track" 1 "Sign is an internal track" ;
VAL_ 247 VFC_TS09_AddTS1Class 0 "UNKNOWN" 1 "DETECTED" 2 "ACCIDENT" 3 "ADVICE" 4 "BEGINS" 5 "BUS" 6 "CAMPER" 7 "CAR" 8 "CARAVAN" 9 "CRASHRISK" 10 "DIRT" 11 "DISTANCE" 12 "DISTANCEBARS" 13 "END" 14 "EXITL" 15 "EXITR" 16 "FOG" 17 "GRAVEL" 18 "HAZMAT" 19 "HUMP" 20 "JAM" 21 "LORRY" 22 "EXCEPTLORRY" 23 "LOWTREE" 24 "MCYCLE" 25 "MINIMUM" 26 "NIGHT" 27 "NOSTOPSHOULDER" 28 "OILTRAIL" 29 "PRIOTURN" 30 "RADAR" 31 "RAIN" 32 "RAINSNOW" 33 "REMINDER" 34 "ROADDAMAGE" 35 "RUTS" 36 "RWORKSACCESS" 37 "RWORKSENTRY" 38 "RWORKSEXIT" 39 "SCHOOL" 40 "SECTION" 41 "SMOKE" 42 "SNOW" 43 "SOFTSHOULDERCAR" 44 "SHOFTSHOULDERLORRY" 45 "TEXT" 46 "TIME" 47 "TOWING" 48 "TRACTOR" 49 "TRACTOR_OVER" 50 "TRAILER" 51 "WEIGHT" 52 "WET" 53 "WITHIN" 54 "ZONE" 55 "EXIT" 56 "ACCESS" 57 "ALLWAY" 58 "EXCEPTBUS" 59 "EXCEPTDELIVERY" 60 "EXCEPTLOCAL" 61 "FROG" 62 "PRIOTURNL" 63 "PRIOTURNR" 64 "START" 65 "STOPIN" 66 "HAZWATER" 67 "DAY" 68 "SL" ;
VAL_ 247 VFC_TS09_AddTS1Quality 0 "Poor Quality" 1 "Good Quality" ;
VAL_ 247 VFC_TS09_AddTS1VMS 0 "Fixed" 1 "Variable" ;
VAL_ 247 VFC_TS09_AddTS2Class 0 "UNKNOWN" 1 "DETECTED" 2 "ACCIDENT" 3 "ADVICE" 4 "BEGINS" 5 "BUS" 6 "CAMPER" 7 "CAR" 8 "CARAVAN" 9 "CRASHRISK" 10 "DIRT" 11 "DISTANCE" 12 "DISTANCEBARS" 13 "END" 14 "EXITL" 15 "EXITR" 16 "FOG" 17 "GRAVEL" 18 "HAZMAT" 19 "HUMP" 20 "JAM" 21 "LORRY" 22 "EXCEPTLORRY" 23 "LOWTREE" 24 "MCYCLE" 25 "MINIMUM" 26 "NIGHT" 27 "NOSTOPSHOULDER" 28 "OILTRAIL" 29 "PRIOTURN" 30 "RADAR" 31 "RAIN" 32 "RAINSNOW" 33 "REMINDER" 34 "ROADDAMAGE" 35 "RUTS" 36 "RWORKSACCESS" 37 "RWORKSENTRY" 38 "RWORKSEXIT" 39 "SCHOOL" 40 "SECTION" 41 "SMOKE" 42 "SNOW" 43 "SOFTSHOULDERCAR" 44 "SHOFTSHOULDERLORRY" 45 "TEXT" 46 "TIME" 47 "TOWING" 48 "TRACTOR" 49 "TRACTOR_OVER" 50 "TRAILER" 51 "WEIGHT" 52 "WET" 53 "WITHIN" 54 "ZONE" 55 "EXIT" 56 "ACCESS" 57 "ALLWAY" 58 "EXCEPTBUS" 59 "EXCEPTDELIVERY" 60 "EXCEPTLOCAL" 61 "FROG" 62 "PRIOTURNL" 63 "PRIOTURNR" 64 "START" 65 "STOPIN" 66 "HAZWATER" 67 "DAY" 68 "SL" ;
VAL_ 247 VFC_TS09_AddTS2Quality 0 "Poor Quality" 1 "Good Quality" ;
VAL_ 247 VFC_TS09_AddTS2VMS 0 "Fixed" 1 "Variable" ;
VAL_ 247 VFC_TS09_AddTS3Class 0 "UNKNOWN" 1 "DETECTED" 2 "ACCIDENT" 3 "ADVICE" 4 "BEGINS" 5 "BUS" 6 "CAMPER" 7 "CAR" 8 "CARAVAN" 9 "CRASHRISK" 10 "DIRT" 11 "DISTANCE" 12 "DISTANCEBARS" 13 "END" 14 "EXITL" 15 "EXITR" 16 "FOG" 17 "GRAVEL" 18 "HAZMAT" 19 "HUMP" 20 "JAM" 21 "LORRY" 22 "EXCEPTLORRY" 23 "LOWTREE" 24 "MCYCLE" 25 "MINIMUM" 26 "NIGHT" 27 "NOSTOPSHOULDER" 28 "OILTRAIL" 29 "PRIOTURN" 30 "RADAR" 31 "RAIN" 32 "RAINSNOW" 33 "REMINDER" 34 "ROADDAMAGE" 35 "RUTS" 36 "RWORKSACCESS" 37 "RWORKSENTRY" 38 "RWORKSEXIT" 39 "SCHOOL" 40 "SECTION" 41 "SMOKE" 42 "SNOW" 43 "SOFTSHOULDERCAR" 44 "SHOFTSHOULDERLORRY" 45 "TEXT" 46 "TIME" 47 "TOWING" 48 "TRACTOR" 49 "TRACTOR_OVER" 50 "TRAILER" 51 "WEIGHT" 52 "WET" 53 "WITHIN" 54 "ZONE" 55 "EXIT" 56 "ACCESS" 57 "ALLWAY" 58 "EXCEPTBUS" 59 "EXCEPTDELIVERY" 60 "EXCEPTLOCAL" 61 "FROG" 62 "PRIOTURNL" 63 "PRIOTURNR" 64 "START" 65 "STOPIN" 66 "HAZWATER" 67 "DAY" 68 "SL" ;
VAL_ 247 VFC_TS09_AddTS3Quality 0 "Poor Quality" 1 "Good Quality" ;
VAL_ 247 VFC_TS09_AddTS3VMS 0 "Fixed" 1 "Variable" ;
VAL_ 247 VFC_TS09_AddTS4Class 0 "UNKNOWN" 1 "DETECTED" 2 "ACCIDENT" 3 "ADVICE" 4 "BEGINS" 5 "BUS" 6 "CAMPER" 7 "CAR" 8 "CARAVAN" 9 "CRASHRISK" 10 "DIRT" 11 "DISTANCE" 12 "DISTANCEBARS" 13 "END" 14 "EXITL" 15 "EXITR" 16 "FOG" 17 "GRAVEL" 18 "HAZMAT" 19 "HUMP" 20 "JAM" 21 "LORRY" 22 "EXCEPTLORRY" 23 "LOWTREE" 24 "MCYCLE" 25 "MINIMUM" 26 "NIGHT" 27 "NOSTOPSHOULDER" 28 "OILTRAIL" 29 "PRIOTURN" 30 "RADAR" 31 "RAIN" 32 "RAINSNOW" 33 "REMINDER" 34 "ROADDAMAGE" 35 "RUTS" 36 "RWORKSACCESS" 37 "RWORKSENTRY" 38 "RWORKSEXIT" 39 "SCHOOL" 40 "SECTION" 41 "SMOKE" 42 "SNOW" 43 "SOFTSHOULDERCAR" 44 "SHOFTSHOULDERLORRY" 45 "TEXT" 46 "TIME" 47 "TOWING" 48 "TRACTOR" 49 "TRACTOR_OVER" 50 "TRAILER" 51 "WEIGHT" 52 "WET" 53 "WITHIN" 54 "ZONE" 55 "EXIT" 56 "ACCESS" 57 "ALLWAY" 58 "EXCEPTBUS" 59 "EXCEPTDELIVERY" 60 "EXCEPTLOCAL" 61 "FROG" 62 "PRIOTURNL" 63 "PRIOTURNR" 64 "START" 65 "STOPIN" 66 "HAZWATER" 67 "DAY" 68 "SL" ;
VAL_ 247 VFC_TS09_AddTS4Quality 0 "Poor Quality" 1 "Good Quality" ;
VAL_ 247 VFC_TS09_AddTS4VMS 0 "Fixed" 1 "Variable" ;
VAL_ 247 VFC_TS09_AddTS5Class 0 "UNKNOWN" 1 "DETECTED" 2 "ACCIDENT" 3 "ADVICE" 4 "BEGINS" 5 "BUS" 6 "CAMPER" 7 "CAR" 8 "CARAVAN" 9 "CRASHRISK" 10 "DIRT" 11 "DISTANCE" 12 "DISTANCEBARS" 13 "END" 14 "EXITL" 15 "EXITR" 16 "FOG" 17 "GRAVEL" 18 "HAZMAT" 19 "HUMP" 20 "JAM" 21 "LORRY" 22 "EXCEPTLORRY" 23 "LOWTREE" 24 "MCYCLE" 25 "MINIMUM" 26 "NIGHT" 27 "NOSTOPSHOULDER" 28 "OILTRAIL" 29 "PRIOTURN" 30 "RADAR" 31 "RAIN" 32 "RAINSNOW" 33 "REMINDER" 34 "ROADDAMAGE" 35 "RUTS" 36 "RWORKSACCESS" 37 "RWORKSENTRY" 38 "RWORKSEXIT" 39 "SCHOOL" 40 "SECTION" 41 "SMOKE" 42 "SNOW" 43 "SOFTSHOULDERCAR" 44 "SHOFTSHOULDERLORRY" 45 "TEXT" 46 "TIME" 47 "TOWING" 48 "TRACTOR" 49 "TRACTOR_OVER" 50 "TRAILER" 51 "WEIGHT" 52 "WET" 53 "WITHIN" 54 "ZONE" 55 "EXIT" 56 "ACCESS" 57 "ALLWAY" 58 "EXCEPTBUS" 59 "EXCEPTDELIVERY" 60 "EXCEPTLOCAL" 61 "FROG" 62 "PRIOTURNL" 63 "PRIOTURNR" 64 "START" 65 "STOPIN" 66 "HAZWATER" 67 "DAY" 68 "SL" ;
VAL_ 247 VFC_TS09_AddTS5Quality 0 "Poor Quality" 1 "Good Quality" ;
VAL_ 247 VFC_TS09_AddTS5VMS 0 "Fixed" 1 "Variable" ;
VAL_ 247 VFC_TS09_AddTS6Class 0 "UNKNOWN" 1 "DETECTED" 2 "ACCIDENT" 3 "ADVICE" 4 "BEGINS" 5 "BUS" 6 "CAMPER" 7 "CAR" 8 "CARAVAN" 9 "CRASHRISK" 10 "DIRT" 11 "DISTANCE" 12 "DISTANCEBARS" 13 "END" 14 "EXITL" 15 "EXITR" 16 "FOG" 17 "GRAVEL" 18 "HAZMAT" 19 "HUMP" 20 "JAM" 21 "LORRY" 22 "EXCEPTLORRY" 23 "LOWTREE" 24 "MCYCLE" 25 "MINIMUM" 26 "NIGHT" 27 "NOSTOPSHOULDER" 28 "OILTRAIL" 29 "PRIOTURN" 30 "RADAR" 31 "RAIN" 32 "RAINSNOW" 33 "REMINDER" 34 "ROADDAMAGE" 35 "RUTS" 36 "RWORKSACCESS" 37 "RWORKSENTRY" 38 "RWORKSEXIT" 39 "SCHOOL" 40 "SECTION" 41 "SMOKE" 42 "SNOW" 43 "SOFTSHOULDERCAR" 44 "SHOFTSHOULDERLORRY" 45 "TEXT" 46 "TIME" 47 "TOWING" 48 "TRACTOR" 49 "TRACTOR_OVER" 50 "TRAILER" 51 "WEIGHT" 52 "WET" 53 "WITHIN" 54 "ZONE" 55 "EXIT" 56 "ACCESS" 57 "ALLWAY" 58 "EXCEPTBUS" 59 "EXCEPTDELIVERY" 60 "EXCEPTLOCAL" 61 "FROG" 62 "PRIOTURNL" 63 "PRIOTURNR" 64 "START" 65 "STOPIN" 66 "HAZWATER" 67 "DAY" 68 "SL" ;
VAL_ 247 VFC_TS09_AddTS6Quality 0 "Poor Quality" 1 "Good Quality" ;
VAL_ 247 VFC_TS09_AddTS6VMS 0 "Fixed" 1 "Variable" ;
VAL_ 248 VFC_TS10_ID 0 "INVALID" ;
VAL_ 248 VFC_TS10_Class 0 "UNKNOWN" 1 "SL5" 2 "SL10" 3 "SL15" 4 "SL20" 5 "SL25" 6 "SL30" 7 "SL35" 8 "SL40" 9 "SL45" 10 "SL50" 11 "SL55" 12 "SL60" 13 "SL65" 14 "SL70" 15 "SL75" 16 "SL80" 17 "SL85" 18 "SL90" 19 "SL95" 20 "SL100" 21 "SL105" 22 "SL110" 23 "SL115" 24 "SL120" 25 "SL125" 26 "SL130" 27 "SL135" 28 "SL140" 29 "SL145" 30 "SL150" 31 "SL155" 32 "SL160" 33 "ESL" 34 "EA" 35 "OP" 36 "EOP" 37 "OL" 38 "EOL" 39 "GIVEWAY" 40 "PRIOCROSS" 41 "PRIOCROSSYIELDTORIGHT" 42 "PRIOSTREET" 43 "EPRIOSTREET" 44 "STOP" 45 "AXLEWEIGHT" 46 "CARDIST" 47 "HEIGHT" 48 "LENGTH" 49 "LORRYDIST" 50 "NOALL" 51 "NOBIKE" 52 "NOBUS" 53 "NOCAR" 54 "NOCARBIKE" 55 "NOCARRIAGE" 56 "NOENTRY" 57 "NOHAZMAT" 58 "NOHAZWATER" 59 "NOLORRY" 60 "NOLORRYTRAILER" 61 "NOLTURN" 62 "NOPED" 63 "NORIDER" 64 "NORTURN" 65 "NOTRACTOR" 66 "NOTWOWAY" 67 "NOUTURN" 68 "UMWELT" 69 "EUMWELT" 70 "WEIGHT" 71 "WIDTH" 72 "WARNBIKE" 73 "WARNBUS" 74 "WARNCATTLE" 75 "WARNCONST" 76 "WARNCONSTL" 77 "WARNCONSTR" 78 "WARNCURVEL" 79 "WARNCURVER" 80 "WARNDANGER" 81 "WARNDCURVEL" 82 "WARNDCURVER" 83 "WARNDRAWBRIDGE" 84 "WARNFROG" 85 "WARNGRAVEL" 86 "WARNHUMP" 87 "WARNJAM" 88 "WARNKIDS" 89 "WARNLIGHTS" 90 "WARNLOWTREE" 91 "WARNPCROSS" 92 "WARNPED" 93 "WARNPIER" 94 "WARNPLANE" 95 "WARNRIDER" 96 "WARNROCK" 97 "WARNROUND" 98 "WARNRWORKS" 99 "WARNSKID" 100 "WARNSLOPED" 101 "WARNSLOPEU" 102 "WARNSNOW" 103 "WARNTRAIN" 104 "WARNTWOWAY" 105 "WARNWILDANIMAL" 106 "WARNWIND" 107 "ASL" 108 "EASL" 109 "CALM" 110 "ECALM" 111 "DEADEND" 112 "DOUANE" 113 "FWAY" 114 "EFWAY" 115 "HWAY" 116 "EHWAY" 117 "MSL" 118 "EMSL" 119 "NOPARK" 120 "NOSTOP" 121 "ONEWAYS" 122 "ONEWAYU" 123 "SLOWDOWN" 124 "SCHOOL" 125 "ESCHOOL" 126 "TWN" 127 "ETWN" 128 "WBBENTLEFT" 129 "WBBENTLEFTRIGHT" 130 "WBBENTRIGHT" 131 "WBDIAGL" 132 "WBDIAGLR" 133 "WBDIAGR" 134 "WBHAZWATER" 135 "WBLEFT" 136 "WBRIGHT" 137 "WBROUND" 138 "WBUP" 139 "WBUPLEFT" 140 "WBUPRIGHT" 141 "ZEBRA" 142 "HAZMAT" 143 "EMERGENCYBAY" 144 "ENDOFLANEL" 145 "ENDOFLANER" 146 "ENOPARK" 147 "EONEWAY" 148 "EPARK" 149 "ETOLL" 150 "NOPARKL" 151 "NOPARKLR" 152 "NOPARKR" 153 "NOSTOPL" 154 "NOSTOPLR" 155 "NOSTOPR" 156 "NOTURNONRED" 157 "ONEWAYL" 158 "ONEWAYR" 159 "PARK" 160 "PRIOCROSSL" 161 "PRIOCROSSR" 162 "TOLL" 163 "TUNNEL" 164 "TWOWAY" 165 "WARNCROSS" 166 "WARNCROSSL" 167 "WARNCROSSLR" 168 "WARNCROSSR" 169 "WARNCROSSRL" 170 "WARNCROSST" 171 "WARNGIVEWAYAHEAD" 172 "WARNSLAHEAD" 173 "WARNSTOPAHEAD" 174 "WBBUS" 175 "WRONGWAY" 176 "HAZWATER" 177 "GIVEWAYROUND" 178 "WARNWINDINGL" 179 "WARNWINDINGR" 180 "WARNHAIRPINL" 181 "WARNHAIRPINR" 182 "WARNPEDBIKE" 183 "WARNCROSSY" 184 "WARNBRANCHL" 185 "WARNBRANCHR" 186 "WARNAXLEWEIGHT" 187 "WARNWEIGHT" 188 "WARNHEIGHT" 189 "WARNLENGTH" 190 "WARNWIDTH" 191 "WARNBLACKSPOT" 192 "WARNMERGEL" 193 "WARNMERGER" 194 "WARNTUNNEL" 195 "WARNTRACTOR" 196 "WARNRWORKSVEHICLE" 197 "WARNNARROWBRIDGE" 198 "WARNFLAGGER" 199 "LANES" 200 "LANESHIFTL" 201 "LANESHIFTR" 202 "NEWLANEL" 203 "NEWLANER" 204 "RIGHTTURNONRED" 205 "BORDERLIMIT" 206 "EMBEDDEDRAIN" ;
VAL_ 248 VFC_TS10_EmbedFlag 0 "Unknown" 1 "Not Embedded" 2 "Border Limit" 3 "Multi Lane" 4 "Rain" 5 "Vehicle Type" 6 "Plate" 7 "Error Value" ;
VAL_ 248 VFC_TS10_Quality 0 "Poor Quality" 1 "Good Quality" ;
VAL_ 248 VFC_TS10_VMS 0 "Fixed" 1 "Variable" ;
VAL_ 248 VFC_TS10_Stable 0 "Object Is Not Stable" 1 "Object Is Stable" ;
VAL_ 248 VFC_TS10_VehicleSticker 0 "not_sticker_on_vehicle" 1 "Sign is a sticker on a vehicle" ;
VAL_ 248 VFC_TS10_InternalTrack 0 "Sign is not an internal track" 1 "Sign is an internal track" ;
VAL_ 248 VFC_TS10_AddTS1Class 0 "UNKNOWN" 1 "DETECTED" 2 "ACCIDENT" 3 "ADVICE" 4 "BEGINS" 5 "BUS" 6 "CAMPER" 7 "CAR" 8 "CARAVAN" 9 "CRASHRISK" 10 "DIRT" 11 "DISTANCE" 12 "DISTANCEBARS" 13 "END" 14 "EXITL" 15 "EXITR" 16 "FOG" 17 "GRAVEL" 18 "HAZMAT" 19 "HUMP" 20 "JAM" 21 "LORRY" 22 "EXCEPTLORRY" 23 "LOWTREE" 24 "MCYCLE" 25 "MINIMUM" 26 "NIGHT" 27 "NOSTOPSHOULDER" 28 "OILTRAIL" 29 "PRIOTURN" 30 "RADAR" 31 "RAIN" 32 "RAINSNOW" 33 "REMINDER" 34 "ROADDAMAGE" 35 "RUTS" 36 "RWORKSACCESS" 37 "RWORKSENTRY" 38 "RWORKSEXIT" 39 "SCHOOL" 40 "SECTION" 41 "SMOKE" 42 "SNOW" 43 "SOFTSHOULDERCAR" 44 "SHOFTSHOULDERLORRY" 45 "TEXT" 46 "TIME" 47 "TOWING" 48 "TRACTOR" 49 "TRACTOR_OVER" 50 "TRAILER" 51 "WEIGHT" 52 "WET" 53 "WITHIN" 54 "ZONE" 55 "EXIT" 56 "ACCESS" 57 "ALLWAY" 58 "EXCEPTBUS" 59 "EXCEPTDELIVERY" 60 "EXCEPTLOCAL" 61 "FROG" 62 "PRIOTURNL" 63 "PRIOTURNR" 64 "START" 65 "STOPIN" 66 "HAZWATER" 67 "DAY" 68 "SL" ;
VAL_ 248 VFC_TS10_AddTS1Quality 0 "Poor Quality" 1 "Good Quality" ;
VAL_ 248 VFC_TS10_AddTS1VMS 0 "Fixed" 1 "Variable" ;
VAL_ 248 VFC_TS10_AddTS2Class 0 "UNKNOWN" 1 "DETECTED" 2 "ACCIDENT" 3 "ADVICE" 4 "BEGINS" 5 "BUS" 6 "CAMPER" 7 "CAR" 8 "CARAVAN" 9 "CRASHRISK" 10 "DIRT" 11 "DISTANCE" 12 "DISTANCEBARS" 13 "END" 14 "EXITL" 15 "EXITR" 16 "FOG" 17 "GRAVEL" 18 "HAZMAT" 19 "HUMP" 20 "JAM" 21 "LORRY" 22 "EXCEPTLORRY" 23 "LOWTREE" 24 "MCYCLE" 25 "MINIMUM" 26 "NIGHT" 27 "NOSTOPSHOULDER" 28 "OILTRAIL" 29 "PRIOTURN" 30 "RADAR" 31 "RAIN" 32 "RAINSNOW" 33 "REMINDER" 34 "ROADDAMAGE" 35 "RUTS" 36 "RWORKSACCESS" 37 "RWORKSENTRY" 38 "RWORKSEXIT" 39 "SCHOOL" 40 "SECTION" 41 "SMOKE" 42 "SNOW" 43 "SOFTSHOULDERCAR" 44 "SHOFTSHOULDERLORRY" 45 "TEXT" 46 "TIME" 47 "TOWING" 48 "TRACTOR" 49 "TRACTOR_OVER" 50 "TRAILER" 51 "WEIGHT" 52 "WET" 53 "WITHIN" 54 "ZONE" 55 "EXIT" 56 "ACCESS" 57 "ALLWAY" 58 "EXCEPTBUS" 59 "EXCEPTDELIVERY" 60 "EXCEPTLOCAL" 61 "FROG" 62 "PRIOTURNL" 63 "PRIOTURNR" 64 "START" 65 "STOPIN" 66 "HAZWATER" 67 "DAY" 68 "SL" ;
VAL_ 248 VFC_TS10_AddTS2Quality 0 "Poor Quality" 1 "Good Quality" ;
VAL_ 248 VFC_TS10_AddTS2VMS 0 "Fixed" 1 "Variable" ;
VAL_ 248 VFC_TS10_AddTS3Class 0 "UNKNOWN" 1 "DETECTED" 2 "ACCIDENT" 3 "ADVICE" 4 "BEGINS" 5 "BUS" 6 "CAMPER" 7 "CAR" 8 "CARAVAN" 9 "CRASHRISK" 10 "DIRT" 11 "DISTANCE" 12 "DISTANCEBARS" 13 "END" 14 "EXITL" 15 "EXITR" 16 "FOG" 17 "GRAVEL" 18 "HAZMAT" 19 "HUMP" 20 "JAM" 21 "LORRY" 22 "EXCEPTLORRY" 23 "LOWTREE" 24 "MCYCLE" 25 "MINIMUM" 26 "NIGHT" 27 "NOSTOPSHOULDER" 28 "OILTRAIL" 29 "PRIOTURN" 30 "RADAR" 31 "RAIN" 32 "RAINSNOW" 33 "REMINDER" 34 "ROADDAMAGE" 35 "RUTS" 36 "RWORKSACCESS" 37 "RWORKSENTRY" 38 "RWORKSEXIT" 39 "SCHOOL" 40 "SECTION" 41 "SMOKE" 42 "SNOW" 43 "SOFTSHOULDERCAR" 44 "SHOFTSHOULDERLORRY" 45 "TEXT" 46 "TIME" 47 "TOWING" 48 "TRACTOR" 49 "TRACTOR_OVER" 50 "TRAILER" 51 "WEIGHT" 52 "WET" 53 "WITHIN" 54 "ZONE" 55 "EXIT" 56 "ACCESS" 57 "ALLWAY" 58 "EXCEPTBUS" 59 "EXCEPTDELIVERY" 60 "EXCEPTLOCAL" 61 "FROG" 62 "PRIOTURNL" 63 "PRIOTURNR" 64 "START" 65 "STOPIN" 66 "HAZWATER" 67 "DAY" 68 "SL" ;
VAL_ 248 VFC_TS10_AddTS3Quality 0 "Poor Quality" 1 "Good Quality" ;
VAL_ 248 VFC_TS10_AddTS3VMS 0 "Fixed" 1 "Variable" ;
VAL_ 248 VFC_TS10_AddTS4Class 0 "UNKNOWN" 1 "DETECTED" 2 "ACCIDENT" 3 "ADVICE" 4 "BEGINS" 5 "BUS" 6 "CAMPER" 7 "CAR" 8 "CARAVAN" 9 "CRASHRISK" 10 "DIRT" 11 "DISTANCE" 12 "DISTANCEBARS" 13 "END" 14 "EXITL" 15 "EXITR" 16 "FOG" 17 "GRAVEL" 18 "HAZMAT" 19 "HUMP" 20 "JAM" 21 "LORRY" 22 "EXCEPTLORRY" 23 "LOWTREE" 24 "MCYCLE" 25 "MINIMUM" 26 "NIGHT" 27 "NOSTOPSHOULDER" 28 "OILTRAIL" 29 "PRIOTURN" 30 "RADAR" 31 "RAIN" 32 "RAINSNOW" 33 "REMINDER" 34 "ROADDAMAGE" 35 "RUTS" 36 "RWORKSACCESS" 37 "RWORKSENTRY" 38 "RWORKSEXIT" 39 "SCHOOL" 40 "SECTION" 41 "SMOKE" 42 "SNOW" 43 "SOFTSHOULDERCAR" 44 "SHOFTSHOULDERLORRY" 45 "TEXT" 46 "TIME" 47 "TOWING" 48 "TRACTOR" 49 "TRACTOR_OVER" 50 "TRAILER" 51 "WEIGHT" 52 "WET" 53 "WITHIN" 54 "ZONE" 55 "EXIT" 56 "ACCESS" 57 "ALLWAY" 58 "EXCEPTBUS" 59 "EXCEPTDELIVERY" 60 "EXCEPTLOCAL" 61 "FROG" 62 "PRIOTURNL" 63 "PRIOTURNR" 64 "START" 65 "STOPIN" 66 "HAZWATER" 67 "DAY" 68 "SL" ;
VAL_ 248 VFC_TS10_AddTS4Quality 0 "Poor Quality" 1 "Good Quality" ;
VAL_ 248 VFC_TS10_AddTS4VMS 0 "Fixed" 1 "Variable" ;
VAL_ 248 VFC_TS10_AddTS5Class 0 "UNKNOWN" 1 "DETECTED" 2 "ACCIDENT" 3 "ADVICE" 4 "BEGINS" 5 "BUS" 6 "CAMPER" 7 "CAR" 8 "CARAVAN" 9 "CRASHRISK" 10 "DIRT" 11 "DISTANCE" 12 "DISTANCEBARS" 13 "END" 14 "EXITL" 15 "EXITR" 16 "FOG" 17 "GRAVEL" 18 "HAZMAT" 19 "HUMP" 20 "JAM" 21 "LORRY" 22 "EXCEPTLORRY" 23 "LOWTREE" 24 "MCYCLE" 25 "MINIMUM" 26 "NIGHT" 27 "NOSTOPSHOULDER" 28 "OILTRAIL" 29 "PRIOTURN" 30 "RADAR" 31 "RAIN" 32 "RAINSNOW" 33 "REMINDER" 34 "ROADDAMAGE" 35 "RUTS" 36 "RWORKSACCESS" 37 "RWORKSENTRY" 38 "RWORKSEXIT" 39 "SCHOOL" 40 "SECTION" 41 "SMOKE" 42 "SNOW" 43 "SOFTSHOULDERCAR" 44 "SHOFTSHOULDERLORRY" 45 "TEXT" 46 "TIME" 47 "TOWING" 48 "TRACTOR" 49 "TRACTOR_OVER" 50 "TRAILER" 51 "WEIGHT" 52 "WET" 53 "WITHIN" 54 "ZONE" 55 "EXIT" 56 "ACCESS" 57 "ALLWAY" 58 "EXCEPTBUS" 59 "EXCEPTDELIVERY" 60 "EXCEPTLOCAL" 61 "FROG" 62 "PRIOTURNL" 63 "PRIOTURNR" 64 "START" 65 "STOPIN" 66 "HAZWATER" 67 "DAY" 68 "SL" ;
VAL_ 248 VFC_TS10_AddTS5Quality 0 "Poor Quality" 1 "Good Quality" ;
VAL_ 248 VFC_TS10_AddTS5VMS 0 "Fixed" 1 "Variable" ;
VAL_ 248 VFC_TS10_AddTS6Class 0 "UNKNOWN" 1 "DETECTED" 2 "ACCIDENT" 3 "ADVICE" 4 "BEGINS" 5 "BUS" 6 "CAMPER" 7 "CAR" 8 "CARAVAN" 9 "CRASHRISK" 10 "DIRT" 11 "DISTANCE" 12 "DISTANCEBARS" 13 "END" 14 "EXITL" 15 "EXITR" 16 "FOG" 17 "GRAVEL" 18 "HAZMAT" 19 "HUMP" 20 "JAM" 21 "LORRY" 22 "EXCEPTLORRY" 23 "LOWTREE" 24 "MCYCLE" 25 "MINIMUM" 26 "NIGHT" 27 "NOSTOPSHOULDER" 28 "OILTRAIL" 29 "PRIOTURN" 30 "RADAR" 31 "RAIN" 32 "RAINSNOW" 33 "REMINDER" 34 "ROADDAMAGE" 35 "RUTS" 36 "RWORKSACCESS" 37 "RWORKSENTRY" 38 "RWORKSEXIT" 39 "SCHOOL" 40 "SECTION" 41 "SMOKE" 42 "SNOW" 43 "SOFTSHOULDERCAR" 44 "SHOFTSHOULDERLORRY" 45 "TEXT" 46 "TIME" 47 "TOWING" 48 "TRACTOR" 49 "TRACTOR_OVER" 50 "TRAILER" 51 "WEIGHT" 52 "WET" 53 "WITHIN" 54 "ZONE" 55 "EXIT" 56 "ACCESS" 57 "ALLWAY" 58 "EXCEPTBUS" 59 "EXCEPTDELIVERY" 60 "EXCEPTLOCAL" 61 "FROG" 62 "PRIOTURNL" 63 "PRIOTURNR" 64 "START" 65 "STOPIN" 66 "HAZWATER" 67 "DAY" 68 "SL" ;
VAL_ 248 VFC_TS10_AddTS6Quality 0 "Poor Quality" 1 "Good Quality" ;
VAL_ 248 VFC_TS10_AddTS6VMS 0 "Fixed" 1 "Variable" ;
VAL_ 249 VFC_TS11_ID 0 "INVALID" ;
VAL_ 249 VFC_TS11_Class 0 "UNKNOWN" 1 "SL5" 2 "SL10" 3 "SL15" 4 "SL20" 5 "SL25" 6 "SL30" 7 "SL35" 8 "SL40" 9 "SL45" 10 "SL50" 11 "SL55" 12 "SL60" 13 "SL65" 14 "SL70" 15 "SL75" 16 "SL80" 17 "SL85" 18 "SL90" 19 "SL95" 20 "SL100" 21 "SL105" 22 "SL110" 23 "SL115" 24 "SL120" 25 "SL125" 26 "SL130" 27 "SL135" 28 "SL140" 29 "SL145" 30 "SL150" 31 "SL155" 32 "SL160" 33 "ESL" 34 "EA" 35 "OP" 36 "EOP" 37 "OL" 38 "EOL" 39 "GIVEWAY" 40 "PRIOCROSS" 41 "PRIOCROSSYIELDTORIGHT" 42 "PRIOSTREET" 43 "EPRIOSTREET" 44 "STOP" 45 "AXLEWEIGHT" 46 "CARDIST" 47 "HEIGHT" 48 "LENGTH" 49 "LORRYDIST" 50 "NOALL" 51 "NOBIKE" 52 "NOBUS" 53 "NOCAR" 54 "NOCARBIKE" 55 "NOCARRIAGE" 56 "NOENTRY" 57 "NOHAZMAT" 58 "NOHAZWATER" 59 "NOLORRY" 60 "NOLORRYTRAILER" 61 "NOLTURN" 62 "NOPED" 63 "NORIDER" 64 "NORTURN" 65 "NOTRACTOR" 66 "NOTWOWAY" 67 "NOUTURN" 68 "UMWELT" 69 "EUMWELT" 70 "WEIGHT" 71 "WIDTH" 72 "WARNBIKE" 73 "WARNBUS" 74 "WARNCATTLE" 75 "WARNCONST" 76 "WARNCONSTL" 77 "WARNCONSTR" 78 "WARNCURVEL" 79 "WARNCURVER" 80 "WARNDANGER" 81 "WARNDCURVEL" 82 "WARNDCURVER" 83 "WARNDRAWBRIDGE" 84 "WARNFROG" 85 "WARNGRAVEL" 86 "WARNHUMP" 87 "WARNJAM" 88 "WARNKIDS" 89 "WARNLIGHTS" 90 "WARNLOWTREE" 91 "WARNPCROSS" 92 "WARNPED" 93 "WARNPIER" 94 "WARNPLANE" 95 "WARNRIDER" 96 "WARNROCK" 97 "WARNROUND" 98 "WARNRWORKS" 99 "WARNSKID" 100 "WARNSLOPED" 101 "WARNSLOPEU" 102 "WARNSNOW" 103 "WARNTRAIN" 104 "WARNTWOWAY" 105 "WARNWILDANIMAL" 106 "WARNWIND" 107 "ASL" 108 "EASL" 109 "CALM" 110 "ECALM" 111 "DEADEND" 112 "DOUANE" 113 "FWAY" 114 "EFWAY" 115 "HWAY" 116 "EHWAY" 117 "MSL" 118 "EMSL" 119 "NOPARK" 120 "NOSTOP" 121 "ONEWAYS" 122 "ONEWAYU" 123 "SLOWDOWN" 124 "SCHOOL" 125 "ESCHOOL" 126 "TWN" 127 "ETWN" 128 "WBBENTLEFT" 129 "WBBENTLEFTRIGHT" 130 "WBBENTRIGHT" 131 "WBDIAGL" 132 "WBDIAGLR" 133 "WBDIAGR" 134 "WBHAZWATER" 135 "WBLEFT" 136 "WBRIGHT" 137 "WBROUND" 138 "WBUP" 139 "WBUPLEFT" 140 "WBUPRIGHT" 141 "ZEBRA" 142 "HAZMAT" 143 "EMERGENCYBAY" 144 "ENDOFLANEL" 145 "ENDOFLANER" 146 "ENOPARK" 147 "EONEWAY" 148 "EPARK" 149 "ETOLL" 150 "NOPARKL" 151 "NOPARKLR" 152 "NOPARKR" 153 "NOSTOPL" 154 "NOSTOPLR" 155 "NOSTOPR" 156 "NOTURNONRED" 157 "ONEWAYL" 158 "ONEWAYR" 159 "PARK" 160 "PRIOCROSSL" 161 "PRIOCROSSR" 162 "TOLL" 163 "TUNNEL" 164 "TWOWAY" 165 "WARNCROSS" 166 "WARNCROSSL" 167 "WARNCROSSLR" 168 "WARNCROSSR" 169 "WARNCROSSRL" 170 "WARNCROSST" 171 "WARNGIVEWAYAHEAD" 172 "WARNSLAHEAD" 173 "WARNSTOPAHEAD" 174 "WBBUS" 175 "WRONGWAY" 176 "HAZWATER" 177 "GIVEWAYROUND" 178 "WARNWINDINGL" 179 "WARNWINDINGR" 180 "WARNHAIRPINL" 181 "WARNHAIRPINR" 182 "WARNPEDBIKE" 183 "WARNCROSSY" 184 "WARNBRANCHL" 185 "WARNBRANCHR" 186 "WARNAXLEWEIGHT" 187 "WARNWEIGHT" 188 "WARNHEIGHT" 189 "WARNLENGTH" 190 "WARNWIDTH" 191 "WARNBLACKSPOT" 192 "WARNMERGEL" 193 "WARNMERGER" 194 "WARNTUNNEL" 195 "WARNTRACTOR" 196 "WARNRWORKSVEHICLE" 197 "WARNNARROWBRIDGE" 198 "WARNFLAGGER" 199 "LANES" 200 "LANESHIFTL" 201 "LANESHIFTR" 202 "NEWLANEL" 203 "NEWLANER" 204 "RIGHTTURNONRED" 205 "BORDERLIMIT" 206 "EMBEDDEDRAIN" ;
VAL_ 249 VFC_TS11_EmbedFlag 0 "Unknown" 1 "Not Embedded" 2 "Border Limit" 3 "Multi Lane" 4 "Rain" 5 "Vehicle Type" 6 "Plate" 7 "Error Value" ;
VAL_ 249 VFC_TS11_Quality 0 "Poor Quality" 1 "Good Quality" ;
VAL_ 249 VFC_TS11_VMS 0 "Fixed" 1 "Variable" ;
VAL_ 249 VFC_TS11_Stable 0 "Object Is Not Stable" 1 "Object Is Stable" ;
VAL_ 249 VFC_TS11_VehicleSticker 0 "not_sticker_on_vehicle" 1 "Sign is a sticker on a vehicle" ;
VAL_ 249 VFC_TS11_InternalTrack 0 "Sign is not an internal track" 1 "Sign is an internal track" ;
VAL_ 249 VFC_TS11_AddTS1Class 0 "UNKNOWN" 1 "DETECTED" 2 "ACCIDENT" 3 "ADVICE" 4 "BEGINS" 5 "BUS" 6 "CAMPER" 7 "CAR" 8 "CARAVAN" 9 "CRASHRISK" 10 "DIRT" 11 "DISTANCE" 12 "DISTANCEBARS" 13 "END" 14 "EXITL" 15 "EXITR" 16 "FOG" 17 "GRAVEL" 18 "HAZMAT" 19 "HUMP" 20 "JAM" 21 "LORRY" 22 "EXCEPTLORRY" 23 "LOWTREE" 24 "MCYCLE" 25 "MINIMUM" 26 "NIGHT" 27 "NOSTOPSHOULDER" 28 "OILTRAIL" 29 "PRIOTURN" 30 "RADAR" 31 "RAIN" 32 "RAINSNOW" 33 "REMINDER" 34 "ROADDAMAGE" 35 "RUTS" 36 "RWORKSACCESS" 37 "RWORKSENTRY" 38 "RWORKSEXIT" 39 "SCHOOL" 40 "SECTION" 41 "SMOKE" 42 "SNOW" 43 "SOFTSHOULDERCAR" 44 "SHOFTSHOULDERLORRY" 45 "TEXT" 46 "TIME" 47 "TOWING" 48 "TRACTOR" 49 "TRACTOR_OVER" 50 "TRAILER" 51 "WEIGHT" 52 "WET" 53 "WITHIN" 54 "ZONE" 55 "EXIT" 56 "ACCESS" 57 "ALLWAY" 58 "EXCEPTBUS" 59 "EXCEPTDELIVERY" 60 "EXCEPTLOCAL" 61 "FROG" 62 "PRIOTURNL" 63 "PRIOTURNR" 64 "START" 65 "STOPIN" 66 "HAZWATER" 67 "DAY" 68 "SL" ;
VAL_ 249 VFC_TS11_AddTS1Quality 0 "Poor Quality" 1 "Good Quality" ;
VAL_ 249 VFC_TS11_AddTS1VMS 0 "Fixed" 1 "Variable" ;
VAL_ 249 VFC_TS11_AddTS2Class 0 "UNKNOWN" 1 "DETECTED" 2 "ACCIDENT" 3 "ADVICE" 4 "BEGINS" 5 "BUS" 6 "CAMPER" 7 "CAR" 8 "CARAVAN" 9 "CRASHRISK" 10 "DIRT" 11 "DISTANCE" 12 "DISTANCEBARS" 13 "END" 14 "EXITL" 15 "EXITR" 16 "FOG" 17 "GRAVEL" 18 "HAZMAT" 19 "HUMP" 20 "JAM" 21 "LORRY" 22 "EXCEPTLORRY" 23 "LOWTREE" 24 "MCYCLE" 25 "MINIMUM" 26 "NIGHT" 27 "NOSTOPSHOULDER" 28 "OILTRAIL" 29 "PRIOTURN" 30 "RADAR" 31 "RAIN" 32 "RAINSNOW" 33 "REMINDER" 34 "ROADDAMAGE" 35 "RUTS" 36 "RWORKSACCESS" 37 "RWORKSENTRY" 38 "RWORKSEXIT" 39 "SCHOOL" 40 "SECTION" 41 "SMOKE" 42 "SNOW" 43 "SOFTSHOULDERCAR" 44 "SHOFTSHOULDERLORRY" 45 "TEXT" 46 "TIME" 47 "TOWING" 48 "TRACTOR" 49 "TRACTOR_OVER" 50 "TRAILER" 51 "WEIGHT" 52 "WET" 53 "WITHIN" 54 "ZONE" 55 "EXIT" 56 "ACCESS" 57 "ALLWAY" 58 "EXCEPTBUS" 59 "EXCEPTDELIVERY" 60 "EXCEPTLOCAL" 61 "FROG" 62 "PRIOTURNL" 63 "PRIOTURNR" 64 "START" 65 "STOPIN" 66 "HAZWATER" 67 "DAY" 68 "SL" ;
VAL_ 249 VFC_TS11_AddTS2Quality 0 "Poor Quality" 1 "Good Quality" ;
VAL_ 249 VFC_TS11_AddTS2VMS 0 "Fixed" 1 "Variable" ;
VAL_ 249 VFC_TS11_AddTS3Class 0 "UNKNOWN" 1 "DETECTED" 2 "ACCIDENT" 3 "ADVICE" 4 "BEGINS" 5 "BUS" 6 "CAMPER" 7 "CAR" 8 "CARAVAN" 9 "CRASHRISK" 10 "DIRT" 11 "DISTANCE" 12 "DISTANCEBARS" 13 "END" 14 "EXITL" 15 "EXITR" 16 "FOG" 17 "GRAVEL" 18 "HAZMAT" 19 "HUMP" 20 "JAM" 21 "LORRY" 22 "EXCEPTLORRY" 23 "LOWTREE" 24 "MCYCLE" 25 "MINIMUM" 26 "NIGHT" 27 "NOSTOPSHOULDER" 28 "OILTRAIL" 29 "PRIOTURN" 30 "RADAR" 31 "RAIN" 32 "RAINSNOW" 33 "REMINDER" 34 "ROADDAMAGE" 35 "RUTS" 36 "RWORKSACCESS" 37 "RWORKSENTRY" 38 "RWORKSEXIT" 39 "SCHOOL" 40 "SECTION" 41 "SMOKE" 42 "SNOW" 43 "SOFTSHOULDERCAR" 44 "SHOFTSHOULDERLORRY" 45 "TEXT" 46 "TIME" 47 "TOWING" 48 "TRACTOR" 49 "TRACTOR_OVER" 50 "TRAILER" 51 "WEIGHT" 52 "WET" 53 "WITHIN" 54 "ZONE" 55 "EXIT" 56 "ACCESS" 57 "ALLWAY" 58 "EXCEPTBUS" 59 "EXCEPTDELIVERY" 60 "EXCEPTLOCAL" 61 "FROG" 62 "PRIOTURNL" 63 "PRIOTURNR" 64 "START" 65 "STOPIN" 66 "HAZWATER" 67 "DAY" 68 "SL" ;
VAL_ 249 VFC_TS11_AddTS3Quality 0 "Poor Quality" 1 "Good Quality" ;
VAL_ 249 VFC_TS11_AddTS3VMS 0 "Fixed" 1 "Variable" ;
VAL_ 249 VFC_TS11_AddTS4Class 0 "UNKNOWN" 1 "DETECTED" 2 "ACCIDENT" 3 "ADVICE" 4 "BEGINS" 5 "BUS" 6 "CAMPER" 7 "CAR" 8 "CARAVAN" 9 "CRASHRISK" 10 "DIRT" 11 "DISTANCE" 12 "DISTANCEBARS" 13 "END" 14 "EXITL" 15 "EXITR" 16 "FOG" 17 "GRAVEL" 18 "HAZMAT" 19 "HUMP" 20 "JAM" 21 "LORRY" 22 "EXCEPTLORRY" 23 "LOWTREE" 24 "MCYCLE" 25 "MINIMUM" 26 "NIGHT" 27 "NOSTOPSHOULDER" 28 "OILTRAIL" 29 "PRIOTURN" 30 "RADAR" 31 "RAIN" 32 "RAINSNOW" 33 "REMINDER" 34 "ROADDAMAGE" 35 "RUTS" 36 "RWORKSACCESS" 37 "RWORKSENTRY" 38 "RWORKSEXIT" 39 "SCHOOL" 40 "SECTION" 41 "SMOKE" 42 "SNOW" 43 "SOFTSHOULDERCAR" 44 "SHOFTSHOULDERLORRY" 45 "TEXT" 46 "TIME" 47 "TOWING" 48 "TRACTOR" 49 "TRACTOR_OVER" 50 "TRAILER" 51 "WEIGHT" 52 "WET" 53 "WITHIN" 54 "ZONE" 55 "EXIT" 56 "ACCESS" 57 "ALLWAY" 58 "EXCEPTBUS" 59 "EXCEPTDELIVERY" 60 "EXCEPTLOCAL" 61 "FROG" 62 "PRIOTURNL" 63 "PRIOTURNR" 64 "START" 65 "STOPIN" 66 "HAZWATER" 67 "DAY" 68 "SL" ;
VAL_ 249 VFC_TS11_AddTS4Quality 0 "Poor Quality" 1 "Good Quality" ;
VAL_ 249 VFC_TS11_AddTS4VMS 0 "Fixed" 1 "Variable" ;
VAL_ 249 VFC_TS11_AddTS5Class 0 "UNKNOWN" 1 "DETECTED" 2 "ACCIDENT" 3 "ADVICE" 4 "BEGINS" 5 "BUS" 6 "CAMPER" 7 "CAR" 8 "CARAVAN" 9 "CRASHRISK" 10 "DIRT" 11 "DISTANCE" 12 "DISTANCEBARS" 13 "END" 14 "EXITL" 15 "EXITR" 16 "FOG" 17 "GRAVEL" 18 "HAZMAT" 19 "HUMP" 20 "JAM" 21 "LORRY" 22 "EXCEPTLORRY" 23 "LOWTREE" 24 "MCYCLE" 25 "MINIMUM" 26 "NIGHT" 27 "NOSTOPSHOULDER" 28 "OILTRAIL" 29 "PRIOTURN" 30 "RADAR" 31 "RAIN" 32 "RAINSNOW" 33 "REMINDER" 34 "ROADDAMAGE" 35 "RUTS" 36 "RWORKSACCESS" 37 "RWORKSENTRY" 38 "RWORKSEXIT" 39 "SCHOOL" 40 "SECTION" 41 "SMOKE" 42 "SNOW" 43 "SOFTSHOULDERCAR" 44 "SHOFTSHOULDERLORRY" 45 "TEXT" 46 "TIME" 47 "TOWING" 48 "TRACTOR" 49 "TRACTOR_OVER" 50 "TRAILER" 51 "WEIGHT" 52 "WET" 53 "WITHIN" 54 "ZONE" 55 "EXIT" 56 "ACCESS" 57 "ALLWAY" 58 "EXCEPTBUS" 59 "EXCEPTDELIVERY" 60 "EXCEPTLOCAL" 61 "FROG" 62 "PRIOTURNL" 63 "PRIOTURNR" 64 "START" 65 "STOPIN" 66 "HAZWATER" 67 "DAY" 68 "SL" ;
VAL_ 249 VFC_TS11_AddTS5Quality 0 "Poor Quality" 1 "Good Quality" ;
VAL_ 249 VFC_TS11_AddTS5VMS 0 "Fixed" 1 "Variable" ;
VAL_ 249 VFC_TS11_AddTS6Class 0 "UNKNOWN" 1 "DETECTED" 2 "ACCIDENT" 3 "ADVICE" 4 "BEGINS" 5 "BUS" 6 "CAMPER" 7 "CAR" 8 "CARAVAN" 9 "CRASHRISK" 10 "DIRT" 11 "DISTANCE" 12 "DISTANCEBARS" 13 "END" 14 "EXITL" 15 "EXITR" 16 "FOG" 17 "GRAVEL" 18 "HAZMAT" 19 "HUMP" 20 "JAM" 21 "LORRY" 22 "EXCEPTLORRY" 23 "LOWTREE" 24 "MCYCLE" 25 "MINIMUM" 26 "NIGHT" 27 "NOSTOPSHOULDER" 28 "OILTRAIL" 29 "PRIOTURN" 30 "RADAR" 31 "RAIN" 32 "RAINSNOW" 33 "REMINDER" 34 "ROADDAMAGE" 35 "RUTS" 36 "RWORKSACCESS" 37 "RWORKSENTRY" 38 "RWORKSEXIT" 39 "SCHOOL" 40 "SECTION" 41 "SMOKE" 42 "SNOW" 43 "SOFTSHOULDERCAR" 44 "SHOFTSHOULDERLORRY" 45 "TEXT" 46 "TIME" 47 "TOWING" 48 "TRACTOR" 49 "TRACTOR_OVER" 50 "TRAILER" 51 "WEIGHT" 52 "WET" 53 "WITHIN" 54 "ZONE" 55 "EXIT" 56 "ACCESS" 57 "ALLWAY" 58 "EXCEPTBUS" 59 "EXCEPTDELIVERY" 60 "EXCEPTLOCAL" 61 "FROG" 62 "PRIOTURNL" 63 "PRIOTURNR" 64 "START" 65 "STOPIN" 66 "HAZWATER" 67 "DAY" 68 "SL" ;
VAL_ 249 VFC_TS11_AddTS6Quality 0 "Poor Quality" 1 "Good Quality" ;
VAL_ 249 VFC_TS11_AddTS6VMS 0 "Fixed" 1 "Variable" ;
VAL_ 250 VFC_TS12_ID 0 "INVALID" ;
VAL_ 250 VFC_TS12_Class 0 "UNKNOWN" 1 "SL5" 2 "SL10" 3 "SL15" 4 "SL20" 5 "SL25" 6 "SL30" 7 "SL35" 8 "SL40" 9 "SL45" 10 "SL50" 11 "SL55" 12 "SL60" 13 "SL65" 14 "SL70" 15 "SL75" 16 "SL80" 17 "SL85" 18 "SL90" 19 "SL95" 20 "SL100" 21 "SL105" 22 "SL110" 23 "SL115" 24 "SL120" 25 "SL125" 26 "SL130" 27 "SL135" 28 "SL140" 29 "SL145" 30 "SL150" 31 "SL155" 32 "SL160" 33 "ESL" 34 "EA" 35 "OP" 36 "EOP" 37 "OL" 38 "EOL" 39 "GIVEWAY" 40 "PRIOCROSS" 41 "PRIOCROSSYIELDTORIGHT" 42 "PRIOSTREET" 43 "EPRIOSTREET" 44 "STOP" 45 "AXLEWEIGHT" 46 "CARDIST" 47 "HEIGHT" 48 "LENGTH" 49 "LORRYDIST" 50 "NOALL" 51 "NOBIKE" 52 "NOBUS" 53 "NOCAR" 54 "NOCARBIKE" 55 "NOCARRIAGE" 56 "NOENTRY" 57 "NOHAZMAT" 58 "NOHAZWATER" 59 "NOLORRY" 60 "NOLORRYTRAILER" 61 "NOLTURN" 62 "NOPED" 63 "NORIDER" 64 "NORTURN" 65 "NOTRACTOR" 66 "NOTWOWAY" 67 "NOUTURN" 68 "UMWELT" 69 "EUMWELT" 70 "WEIGHT" 71 "WIDTH" 72 "WARNBIKE" 73 "WARNBUS" 74 "WARNCATTLE" 75 "WARNCONST" 76 "WARNCONSTL" 77 "WARNCONSTR" 78 "WARNCURVEL" 79 "WARNCURVER" 80 "WARNDANGER" 81 "WARNDCURVEL" 82 "WARNDCURVER" 83 "WARNDRAWBRIDGE" 84 "WARNFROG" 85 "WARNGRAVEL" 86 "WARNHUMP" 87 "WARNJAM" 88 "WARNKIDS" 89 "WARNLIGHTS" 90 "WARNLOWTREE" 91 "WARNPCROSS" 92 "WARNPED" 93 "WARNPIER" 94 "WARNPLANE" 95 "WARNRIDER" 96 "WARNROCK" 97 "WARNROUND" 98 "WARNRWORKS" 99 "WARNSKID" 100 "WARNSLOPED" 101 "WARNSLOPEU" 102 "WARNSNOW" 103 "WARNTRAIN" 104 "WARNTWOWAY" 105 "WARNWILDANIMAL" 106 "WARNWIND" 107 "ASL" 108 "EASL" 109 "CALM" 110 "ECALM" 111 "DEADEND" 112 "DOUANE" 113 "FWAY" 114 "EFWAY" 115 "HWAY" 116 "EHWAY" 117 "MSL" 118 "EMSL" 119 "NOPARK" 120 "NOSTOP" 121 "ONEWAYS" 122 "ONEWAYU" 123 "SLOWDOWN" 124 "SCHOOL" 125 "ESCHOOL" 126 "TWN" 127 "ETWN" 128 "WBBENTLEFT" 129 "WBBENTLEFTRIGHT" 130 "WBBENTRIGHT" 131 "WBDIAGL" 132 "WBDIAGLR" 133 "WBDIAGR" 134 "WBHAZWATER" 135 "WBLEFT" 136 "WBRIGHT" 137 "WBROUND" 138 "WBUP" 139 "WBUPLEFT" 140 "WBUPRIGHT" 141 "ZEBRA" 142 "HAZMAT" 143 "EMERGENCYBAY" 144 "ENDOFLANEL" 145 "ENDOFLANER" 146 "ENOPARK" 147 "EONEWAY" 148 "EPARK" 149 "ETOLL" 150 "NOPARKL" 151 "NOPARKLR" 152 "NOPARKR" 153 "NOSTOPL" 154 "NOSTOPLR" 155 "NOSTOPR" 156 "NOTURNONRED" 157 "ONEWAYL" 158 "ONEWAYR" 159 "PARK" 160 "PRIOCROSSL" 161 "PRIOCROSSR" 162 "TOLL" 163 "TUNNEL" 164 "TWOWAY" 165 "WARNCROSS" 166 "WARNCROSSL" 167 "WARNCROSSLR" 168 "WARNCROSSR" 169 "WARNCROSSRL" 170 "WARNCROSST" 171 "WARNGIVEWAYAHEAD" 172 "WARNSLAHEAD" 173 "WARNSTOPAHEAD" 174 "WBBUS" 175 "WRONGWAY" 176 "HAZWATER" 177 "GIVEWAYROUND" 178 "WARNWINDINGL" 179 "WARNWINDINGR" 180 "WARNHAIRPINL" 181 "WARNHAIRPINR" 182 "WARNPEDBIKE" 183 "WARNCROSSY" 184 "WARNBRANCHL" 185 "WARNBRANCHR" 186 "WARNAXLEWEIGHT" 187 "WARNWEIGHT" 188 "WARNHEIGHT" 189 "WARNLENGTH" 190 "WARNWIDTH" 191 "WARNBLACKSPOT" 192 "WARNMERGEL" 193 "WARNMERGER" 194 "WARNTUNNEL" 195 "WARNTRACTOR" 196 "WARNRWORKSVEHICLE" 197 "WARNNARROWBRIDGE" 198 "WARNFLAGGER" 199 "LANES" 200 "LANESHIFTL" 201 "LANESHIFTR" 202 "NEWLANEL" 203 "NEWLANER" 204 "RIGHTTURNONRED" 205 "BORDERLIMIT" 206 "EMBEDDEDRAIN" ;
VAL_ 250 VFC_TS12_EmbedFlag 0 "Unknown" 1 "Not Embedded" 2 "Border Limit" 3 "Multi Lane" 4 "Rain" 5 "Vehicle Type" 6 "Plate" 7 "Error Value" ;
VAL_ 250 VFC_TS12_Quality 0 "Poor Quality" 1 "Good Quality" ;
VAL_ 250 VFC_TS12_VMS 0 "Fixed" 1 "Variable" ;
VAL_ 250 VFC_TS12_Stable 0 "Object Is Not Stable" 1 "Object Is Stable" ;
VAL_ 250 VFC_TS12_VehicleSticker 0 "not_sticker_on_vehicle" 1 "Sign is a sticker on a vehicle" ;
VAL_ 250 VFC_TS12_InternalTrack 0 "Sign is not an internal track" 1 "Sign is an internal track" ;
VAL_ 250 VFC_TS12_AddTS1Class 0 "UNKNOWN" 1 "DETECTED" 2 "ACCIDENT" 3 "ADVICE" 4 "BEGINS" 5 "BUS" 6 "CAMPER" 7 "CAR" 8 "CARAVAN" 9 "CRASHRISK" 10 "DIRT" 11 "DISTANCE" 12 "DISTANCEBARS" 13 "END" 14 "EXITL" 15 "EXITR" 16 "FOG" 17 "GRAVEL" 18 "HAZMAT" 19 "HUMP" 20 "JAM" 21 "LORRY" 22 "EXCEPTLORRY" 23 "LOWTREE" 24 "MCYCLE" 25 "MINIMUM" 26 "NIGHT" 27 "NOSTOPSHOULDER" 28 "OILTRAIL" 29 "PRIOTURN" 30 "RADAR" 31 "RAIN" 32 "RAINSNOW" 33 "REMINDER" 34 "ROADDAMAGE" 35 "RUTS" 36 "RWORKSACCESS" 37 "RWORKSENTRY" 38 "RWORKSEXIT" 39 "SCHOOL" 40 "SECTION" 41 "SMOKE" 42 "SNOW" 43 "SOFTSHOULDERCAR" 44 "SHOFTSHOULDERLORRY" 45 "TEXT" 46 "TIME" 47 "TOWING" 48 "TRACTOR" 49 "TRACTOR_OVER" 50 "TRAILER" 51 "WEIGHT" 52 "WET" 53 "WITHIN" 54 "ZONE" 55 "EXIT" 56 "ACCESS" 57 "ALLWAY" 58 "EXCEPTBUS" 59 "EXCEPTDELIVERY" 60 "EXCEPTLOCAL" 61 "FROG" 62 "PRIOTURNL" 63 "PRIOTURNR" 64 "START" 65 "STOPIN" 66 "HAZWATER" 67 "DAY" 68 "SL" ;
VAL_ 250 VFC_TS12_AddTS1Quality 0 "Poor Quality" 1 "Good Quality" ;
VAL_ 250 VFC_TS12_AddTS1VMS 0 "Fixed" 1 "Variable" ;
VAL_ 250 VFC_TS12_AddTS2Class 0 "UNKNOWN" 1 "DETECTED" 2 "ACCIDENT" 3 "ADVICE" 4 "BEGINS" 5 "BUS" 6 "CAMPER" 7 "CAR" 8 "CARAVAN" 9 "CRASHRISK" 10 "DIRT" 11 "DISTANCE" 12 "DISTANCEBARS" 13 "END" 14 "EXITL" 15 "EXITR" 16 "FOG" 17 "GRAVEL" 18 "HAZMAT" 19 "HUMP" 20 "JAM" 21 "LORRY" 22 "EXCEPTLORRY" 23 "LOWTREE" 24 "MCYCLE" 25 "MINIMUM" 26 "NIGHT" 27 "NOSTOPSHOULDER" 28 "OILTRAIL" 29 "PRIOTURN" 30 "RADAR" 31 "RAIN" 32 "RAINSNOW" 33 "REMINDER" 34 "ROADDAMAGE" 35 "RUTS" 36 "RWORKSACCESS" 37 "RWORKSENTRY" 38 "RWORKSEXIT" 39 "SCHOOL" 40 "SECTION" 41 "SMOKE" 42 "SNOW" 43 "SOFTSHOULDERCAR" 44 "SHOFTSHOULDERLORRY" 45 "TEXT" 46 "TIME" 47 "TOWING" 48 "TRACTOR" 49 "TRACTOR_OVER" 50 "TRAILER" 51 "WEIGHT" 52 "WET" 53 "WITHIN" 54 "ZONE" 55 "EXIT" 56 "ACCESS" 57 "ALLWAY" 58 "EXCEPTBUS" 59 "EXCEPTDELIVERY" 60 "EXCEPTLOCAL" 61 "FROG" 62 "PRIOTURNL" 63 "PRIOTURNR" 64 "START" 65 "STOPIN" 66 "HAZWATER" 67 "DAY" 68 "SL" ;
VAL_ 250 VFC_TS12_AddTS2Quality 0 "Poor Quality" 1 "Good Quality" ;
VAL_ 250 VFC_TS12_AddTS2VMS 0 "Fixed" 1 "Variable" ;
VAL_ 250 VFC_TS12_AddTS3Class 0 "UNKNOWN" 1 "DETECTED" 2 "ACCIDENT" 3 "ADVICE" 4 "BEGINS" 5 "BUS" 6 "CAMPER" 7 "CAR" 8 "CARAVAN" 9 "CRASHRISK" 10 "DIRT" 11 "DISTANCE" 12 "DISTANCEBARS" 13 "END" 14 "EXITL" 15 "EXITR" 16 "FOG" 17 "GRAVEL" 18 "HAZMAT" 19 "HUMP" 20 "JAM" 21 "LORRY" 22 "EXCEPTLORRY" 23 "LOWTREE" 24 "MCYCLE" 25 "MINIMUM" 26 "NIGHT" 27 "NOSTOPSHOULDER" 28 "OILTRAIL" 29 "PRIOTURN" 30 "RADAR" 31 "RAIN" 32 "RAINSNOW" 33 "REMINDER" 34 "ROADDAMAGE" 35 "RUTS" 36 "RWORKSACCESS" 37 "RWORKSENTRY" 38 "RWORKSEXIT" 39 "SCHOOL" 40 "SECTION" 41 "SMOKE" 42 "SNOW" 43 "SOFTSHOULDERCAR" 44 "SHOFTSHOULDERLORRY" 45 "TEXT" 46 "TIME" 47 "TOWING" 48 "TRACTOR" 49 "TRACTOR_OVER" 50 "TRAILER" 51 "WEIGHT" 52 "WET" 53 "WITHIN" 54 "ZONE" 55 "EXIT" 56 "ACCESS" 57 "ALLWAY" 58 "EXCEPTBUS" 59 "EXCEPTDELIVERY" 60 "EXCEPTLOCAL" 61 "FROG" 62 "PRIOTURNL" 63 "PRIOTURNR" 64 "START" 65 "STOPIN" 66 "HAZWATER" 67 "DAY" 68 "SL" ;
VAL_ 250 VFC_TS12_AddTS3Quality 0 "Poor Quality" 1 "Good Quality" ;
VAL_ 250 VFC_TS12_AddTS3VMS 0 "Fixed" 1 "Variable" ;
VAL_ 250 VFC_TS12_AddTS4Class 0 "UNKNOWN" 1 "DETECTED" 2 "ACCIDENT" 3 "ADVICE" 4 "BEGINS" 5 "BUS" 6 "CAMPER" 7 "CAR" 8 "CARAVAN" 9 "CRASHRISK" 10 "DIRT" 11 "DISTANCE" 12 "DISTANCEBARS" 13 "END" 14 "EXITL" 15 "EXITR" 16 "FOG" 17 "GRAVEL" 18 "HAZMAT" 19 "HUMP" 20 "JAM" 21 "LORRY" 22 "EXCEPTLORRY" 23 "LOWTREE" 24 "MCYCLE" 25 "MINIMUM" 26 "NIGHT" 27 "NOSTOPSHOULDER" 28 "OILTRAIL" 29 "PRIOTURN" 30 "RADAR" 31 "RAIN" 32 "RAINSNOW" 33 "REMINDER" 34 "ROADDAMAGE" 35 "RUTS" 36 "RWORKSACCESS" 37 "RWORKSENTRY" 38 "RWORKSEXIT" 39 "SCHOOL" 40 "SECTION" 41 "SMOKE" 42 "SNOW" 43 "SOFTSHOULDERCAR" 44 "SHOFTSHOULDERLORRY" 45 "TEXT" 46 "TIME" 47 "TOWING" 48 "TRACTOR" 49 "TRACTOR_OVER" 50 "TRAILER" 51 "WEIGHT" 52 "WET" 53 "WITHIN" 54 "ZONE" 55 "EXIT" 56 "ACCESS" 57 "ALLWAY" 58 "EXCEPTBUS" 59 "EXCEPTDELIVERY" 60 "EXCEPTLOCAL" 61 "FROG" 62 "PRIOTURNL" 63 "PRIOTURNR" 64 "START" 65 "STOPIN" 66 "HAZWATER" 67 "DAY" 68 "SL" ;
VAL_ 250 VFC_TS12_AddTS4Quality 0 "Poor Quality" 1 "Good Quality" ;
VAL_ 250 VFC_TS12_AddTS4VMS 0 "Fixed" 1 "Variable" ;
VAL_ 250 VFC_TS12_AddTS5Class 0 "UNKNOWN" 1 "DETECTED" 2 "ACCIDENT" 3 "ADVICE" 4 "BEGINS" 5 "BUS" 6 "CAMPER" 7 "CAR" 8 "CARAVAN" 9 "CRASHRISK" 10 "DIRT" 11 "DISTANCE" 12 "DISTANCEBARS" 13 "END" 14 "EXITL" 15 "EXITR" 16 "FOG" 17 "GRAVEL" 18 "HAZMAT" 19 "HUMP" 20 "JAM" 21 "LORRY" 22 "EXCEPTLORRY" 23 "LOWTREE" 24 "MCYCLE" 25 "MINIMUM" 26 "NIGHT" 27 "NOSTOPSHOULDER" 28 "OILTRAIL" 29 "PRIOTURN" 30 "RADAR" 31 "RAIN" 32 "RAINSNOW" 33 "REMINDER" 34 "ROADDAMAGE" 35 "RUTS" 36 "RWORKSACCESS" 37 "RWORKSENTRY" 38 "RWORKSEXIT" 39 "SCHOOL" 40 "SECTION" 41 "SMOKE" 42 "SNOW" 43 "SOFTSHOULDERCAR" 44 "SHOFTSHOULDERLORRY" 45 "TEXT" 46 "TIME" 47 "TOWING" 48 "TRACTOR" 49 "TRACTOR_OVER" 50 "TRAILER" 51 "WEIGHT" 52 "WET" 53 "WITHIN" 54 "ZONE" 55 "EXIT" 56 "ACCESS" 57 "ALLWAY" 58 "EXCEPTBUS" 59 "EXCEPTDELIVERY" 60 "EXCEPTLOCAL" 61 "FROG" 62 "PRIOTURNL" 63 "PRIOTURNR" 64 "START" 65 "STOPIN" 66 "HAZWATER" 67 "DAY" 68 "SL" ;
VAL_ 250 VFC_TS12_AddTS5Quality 0 "Poor Quality" 1 "Good Quality" ;
VAL_ 250 VFC_TS12_AddTS5VMS 0 "Fixed" 1 "Variable" ;
VAL_ 250 VFC_TS12_AddTS6Class 0 "UNKNOWN" 1 "DETECTED" 2 "ACCIDENT" 3 "ADVICE" 4 "BEGINS" 5 "BUS" 6 "CAMPER" 7 "CAR" 8 "CARAVAN" 9 "CRASHRISK" 10 "DIRT" 11 "DISTANCE" 12 "DISTANCEBARS" 13 "END" 14 "EXITL" 15 "EXITR" 16 "FOG" 17 "GRAVEL" 18 "HAZMAT" 19 "HUMP" 20 "JAM" 21 "LORRY" 22 "EXCEPTLORRY" 23 "LOWTREE" 24 "MCYCLE" 25 "MINIMUM" 26 "NIGHT" 27 "NOSTOPSHOULDER" 28 "OILTRAIL" 29 "PRIOTURN" 30 "RADAR" 31 "RAIN" 32 "RAINSNOW" 33 "REMINDER" 34 "ROADDAMAGE" 35 "RUTS" 36 "RWORKSACCESS" 37 "RWORKSENTRY" 38 "RWORKSEXIT" 39 "SCHOOL" 40 "SECTION" 41 "SMOKE" 42 "SNOW" 43 "SOFTSHOULDERCAR" 44 "SHOFTSHOULDERLORRY" 45 "TEXT" 46 "TIME" 47 "TOWING" 48 "TRACTOR" 49 "TRACTOR_OVER" 50 "TRAILER" 51 "WEIGHT" 52 "WET" 53 "WITHIN" 54 "ZONE" 55 "EXIT" 56 "ACCESS" 57 "ALLWAY" 58 "EXCEPTBUS" 59 "EXCEPTDELIVERY" 60 "EXCEPTLOCAL" 61 "FROG" 62 "PRIOTURNL" 63 "PRIOTURNR" 64 "START" 65 "STOPIN" 66 "HAZWATER" 67 "DAY" 68 "SL" ;
VAL_ 250 VFC_TS12_AddTS6Quality 0 "Poor Quality" 1 "Good Quality" ;
VAL_ 250 VFC_TS12_AddTS6VMS 0 "Fixed" 1 "Variable" ;
VAL_ 251 VFC_TS13_ID 0 "INVALID" ;
VAL_ 251 VFC_TS13_Class 0 "UNKNOWN" 1 "SL5" 2 "SL10" 3 "SL15" 4 "SL20" 5 "SL25" 6 "SL30" 7 "SL35" 8 "SL40" 9 "SL45" 10 "SL50" 11 "SL55" 12 "SL60" 13 "SL65" 14 "SL70" 15 "SL75" 16 "SL80" 17 "SL85" 18 "SL90" 19 "SL95" 20 "SL100" 21 "SL105" 22 "SL110" 23 "SL115" 24 "SL120" 25 "SL125" 26 "SL130" 27 "SL135" 28 "SL140" 29 "SL145" 30 "SL150" 31 "SL155" 32 "SL160" 33 "ESL" 34 "EA" 35 "OP" 36 "EOP" 37 "OL" 38 "EOL" 39 "GIVEWAY" 40 "PRIOCROSS" 41 "PRIOCROSSYIELDTORIGHT" 42 "PRIOSTREET" 43 "EPRIOSTREET" 44 "STOP" 45 "AXLEWEIGHT" 46 "CARDIST" 47 "HEIGHT" 48 "LENGTH" 49 "LORRYDIST" 50 "NOALL" 51 "NOBIKE" 52 "NOBUS" 53 "NOCAR" 54 "NOCARBIKE" 55 "NOCARRIAGE" 56 "NOENTRY" 57 "NOHAZMAT" 58 "NOHAZWATER" 59 "NOLORRY" 60 "NOLORRYTRAILER" 61 "NOLTURN" 62 "NOPED" 63 "NORIDER" 64 "NORTURN" 65 "NOTRACTOR" 66 "NOTWOWAY" 67 "NOUTURN" 68 "UMWELT" 69 "EUMWELT" 70 "WEIGHT" 71 "WIDTH" 72 "WARNBIKE" 73 "WARNBUS" 74 "WARNCATTLE" 75 "WARNCONST" 76 "WARNCONSTL" 77 "WARNCONSTR" 78 "WARNCURVEL" 79 "WARNCURVER" 80 "WARNDANGER" 81 "WARNDCURVEL" 82 "WARNDCURVER" 83 "WARNDRAWBRIDGE" 84 "WARNFROG" 85 "WARNGRAVEL" 86 "WARNHUMP" 87 "WARNJAM" 88 "WARNKIDS" 89 "WARNLIGHTS" 90 "WARNLOWTREE" 91 "WARNPCROSS" 92 "WARNPED" 93 "WARNPIER" 94 "WARNPLANE" 95 "WARNRIDER" 96 "WARNROCK" 97 "WARNROUND" 98 "WARNRWORKS" 99 "WARNSKID" 100 "WARNSLOPED" 101 "WARNSLOPEU" 102 "WARNSNOW" 103 "WARNTRAIN" 104 "WARNTWOWAY" 105 "WARNWILDANIMAL" 106 "WARNWIND" 107 "ASL" 108 "EASL" 109 "CALM" 110 "ECALM" 111 "DEADEND" 112 "DOUANE" 113 "FWAY" 114 "EFWAY" 115 "HWAY" 116 "EHWAY" 117 "MSL" 118 "EMSL" 119 "NOPARK" 120 "NOSTOP" 121 "ONEWAYS" 122 "ONEWAYU" 123 "SLOWDOWN" 124 "SCHOOL" 125 "ESCHOOL" 126 "TWN" 127 "ETWN" 128 "WBBENTLEFT" 129 "WBBENTLEFTRIGHT" 130 "WBBENTRIGHT" 131 "WBDIAGL" 132 "WBDIAGLR" 133 "WBDIAGR" 134 "WBHAZWATER" 135 "WBLEFT" 136 "WBRIGHT" 137 "WBROUND" 138 "WBUP" 139 "WBUPLEFT" 140 "WBUPRIGHT" 141 "ZEBRA" 142 "HAZMAT" 143 "EMERGENCYBAY" 144 "ENDOFLANEL" 145 "ENDOFLANER" 146 "ENOPARK" 147 "EONEWAY" 148 "EPARK" 149 "ETOLL" 150 "NOPARKL" 151 "NOPARKLR" 152 "NOPARKR" 153 "NOSTOPL" 154 "NOSTOPLR" 155 "NOSTOPR" 156 "NOTURNONRED" 157 "ONEWAYL" 158 "ONEWAYR" 159 "PARK" 160 "PRIOCROSSL" 161 "PRIOCROSSR" 162 "TOLL" 163 "TUNNEL" 164 "TWOWAY" 165 "WARNCROSS" 166 "WARNCROSSL" 167 "WARNCROSSLR" 168 "WARNCROSSR" 169 "WARNCROSSRL" 170 "WARNCROSST" 171 "WARNGIVEWAYAHEAD" 172 "WARNSLAHEAD" 173 "WARNSTOPAHEAD" 174 "WBBUS" 175 "WRONGWAY" 176 "HAZWATER" 177 "GIVEWAYROUND" 178 "WARNWINDINGL" 179 "WARNWINDINGR" 180 "WARNHAIRPINL" 181 "WARNHAIRPINR" 182 "WARNPEDBIKE" 183 "WARNCROSSY" 184 "WARNBRANCHL" 185 "WARNBRANCHR" 186 "WARNAXLEWEIGHT" 187 "WARNWEIGHT" 188 "WARNHEIGHT" 189 "WARNLENGTH" 190 "WARNWIDTH" 191 "WARNBLACKSPOT" 192 "WARNMERGEL" 193 "WARNMERGER" 194 "WARNTUNNEL" 195 "WARNTRACTOR" 196 "WARNRWORKSVEHICLE" 197 "WARNNARROWBRIDGE" 198 "WARNFLAGGER" 199 "LANES" 200 "LANESHIFTL" 201 "LANESHIFTR" 202 "NEWLANEL" 203 "NEWLANER" 204 "RIGHTTURNONRED" 205 "BORDERLIMIT" 206 "EMBEDDEDRAIN" ;
VAL_ 251 VFC_TS13_EmbedFlag 0 "Unknown" 1 "Not Embedded" 2 "Border Limit" 3 "Multi Lane" 4 "Rain" 5 "Vehicle Type" 6 "Plate" 7 "Error Value" ;
VAL_ 251 VFC_TS13_Quality 0 "Poor Quality" 1 "Good Quality" ;
VAL_ 251 VFC_TS13_VMS 0 "Fixed" 1 "Variable" ;
VAL_ 251 VFC_TS13_Stable 0 "Object Is Not Stable" 1 "Object Is Stable" ;
VAL_ 251 VFC_TS13_VehicleSticker 0 "not_sticker_on_vehicle" 1 "Sign is a sticker on a vehicle" ;
VAL_ 251 VFC_TS13_InternalTrack 0 "Sign is not an internal track" 1 "Sign is an internal track" ;
VAL_ 251 VFC_TS13_AddTS1Class 0 "UNKNOWN" 1 "DETECTED" 2 "ACCIDENT" 3 "ADVICE" 4 "BEGINS" 5 "BUS" 6 "CAMPER" 7 "CAR" 8 "CARAVAN" 9 "CRASHRISK" 10 "DIRT" 11 "DISTANCE" 12 "DISTANCEBARS" 13 "END" 14 "EXITL" 15 "EXITR" 16 "FOG" 17 "GRAVEL" 18 "HAZMAT" 19 "HUMP" 20 "JAM" 21 "LORRY" 22 "EXCEPTLORRY" 23 "LOWTREE" 24 "MCYCLE" 25 "MINIMUM" 26 "NIGHT" 27 "NOSTOPSHOULDER" 28 "OILTRAIL" 29 "PRIOTURN" 30 "RADAR" 31 "RAIN" 32 "RAINSNOW" 33 "REMINDER" 34 "ROADDAMAGE" 35 "RUTS" 36 "RWORKSACCESS" 37 "RWORKSENTRY" 38 "RWORKSEXIT" 39 "SCHOOL" 40 "SECTION" 41 "SMOKE" 42 "SNOW" 43 "SOFTSHOULDERCAR" 44 "SHOFTSHOULDERLORRY" 45 "TEXT" 46 "TIME" 47 "TOWING" 48 "TRACTOR" 49 "TRACTOR_OVER" 50 "TRAILER" 51 "WEIGHT" 52 "WET" 53 "WITHIN" 54 "ZONE" 55 "EXIT" 56 "ACCESS" 57 "ALLWAY" 58 "EXCEPTBUS" 59 "EXCEPTDELIVERY" 60 "EXCEPTLOCAL" 61 "FROG" 62 "PRIOTURNL" 63 "PRIOTURNR" 64 "START" 65 "STOPIN" 66 "HAZWATER" 67 "DAY" 68 "SL" ;
VAL_ 251 VFC_TS13_AddTS1Quality 0 "Poor Quality" 1 "Good Quality" ;
VAL_ 251 VFC_TS13_AddTS1VMS 0 "Fixed" 1 "Variable" ;
VAL_ 251 VFC_TS13_AddTS2Class 0 "UNKNOWN" 1 "DETECTED" 2 "ACCIDENT" 3 "ADVICE" 4 "BEGINS" 5 "BUS" 6 "CAMPER" 7 "CAR" 8 "CARAVAN" 9 "CRASHRISK" 10 "DIRT" 11 "DISTANCE" 12 "DISTANCEBARS" 13 "END" 14 "EXITL" 15 "EXITR" 16 "FOG" 17 "GRAVEL" 18 "HAZMAT" 19 "HUMP" 20 "JAM" 21 "LORRY" 22 "EXCEPTLORRY" 23 "LOWTREE" 24 "MCYCLE" 25 "MINIMUM" 26 "NIGHT" 27 "NOSTOPSHOULDER" 28 "OILTRAIL" 29 "PRIOTURN" 30 "RADAR" 31 "RAIN" 32 "RAINSNOW" 33 "REMINDER" 34 "ROADDAMAGE" 35 "RUTS" 36 "RWORKSACCESS" 37 "RWORKSENTRY" 38 "RWORKSEXIT" 39 "SCHOOL" 40 "SECTION" 41 "SMOKE" 42 "SNOW" 43 "SOFTSHOULDERCAR" 44 "SHOFTSHOULDERLORRY" 45 "TEXT" 46 "TIME" 47 "TOWING" 48 "TRACTOR" 49 "TRACTOR_OVER" 50 "TRAILER" 51 "WEIGHT" 52 "WET" 53 "WITHIN" 54 "ZONE" 55 "EXIT" 56 "ACCESS" 57 "ALLWAY" 58 "EXCEPTBUS" 59 "EXCEPTDELIVERY" 60 "EXCEPTLOCAL" 61 "FROG" 62 "PRIOTURNL" 63 "PRIOTURNR" 64 "START" 65 "STOPIN" 66 "HAZWATER" 67 "DAY" 68 "SL" ;
VAL_ 251 VFC_TS13_AddTS2Quality 0 "Poor Quality" 1 "Good Quality" ;
VAL_ 251 VFC_TS13_AddTS2VMS 0 "Fixed" 1 "Variable" ;
VAL_ 251 VFC_TS13_AddTS3Class 0 "UNKNOWN" 1 "DETECTED" 2 "ACCIDENT" 3 "ADVICE" 4 "BEGINS" 5 "BUS" 6 "CAMPER" 7 "CAR" 8 "CARAVAN" 9 "CRASHRISK" 10 "DIRT" 11 "DISTANCE" 12 "DISTANCEBARS" 13 "END" 14 "EXITL" 15 "EXITR" 16 "FOG" 17 "GRAVEL" 18 "HAZMAT" 19 "HUMP" 20 "JAM" 21 "LORRY" 22 "EXCEPTLORRY" 23 "LOWTREE" 24 "MCYCLE" 25 "MINIMUM" 26 "NIGHT" 27 "NOSTOPSHOULDER" 28 "OILTRAIL" 29 "PRIOTURN" 30 "RADAR" 31 "RAIN" 32 "RAINSNOW" 33 "REMINDER" 34 "ROADDAMAGE" 35 "RUTS" 36 "RWORKSACCESS" 37 "RWORKSENTRY" 38 "RWORKSEXIT" 39 "SCHOOL" 40 "SECTION" 41 "SMOKE" 42 "SNOW" 43 "SOFTSHOULDERCAR" 44 "SHOFTSHOULDERLORRY" 45 "TEXT" 46 "TIME" 47 "TOWING" 48 "TRACTOR" 49 "TRACTOR_OVER" 50 "TRAILER" 51 "WEIGHT" 52 "WET" 53 "WITHIN" 54 "ZONE" 55 "EXIT" 56 "ACCESS" 57 "ALLWAY" 58 "EXCEPTBUS" 59 "EXCEPTDELIVERY" 60 "EXCEPTLOCAL" 61 "FROG" 62 "PRIOTURNL" 63 "PRIOTURNR" 64 "START" 65 "STOPIN" 66 "HAZWATER" 67 "DAY" 68 "SL" ;
VAL_ 251 VFC_TS13_AddTS3Quality 0 "Poor Quality" 1 "Good Quality" ;
VAL_ 251 VFC_TS13_AddTS3VMS 0 "Fixed" 1 "Variable" ;
VAL_ 251 VFC_TS13_AddTS4Class 0 "UNKNOWN" 1 "DETECTED" 2 "ACCIDENT" 3 "ADVICE" 4 "BEGINS" 5 "BUS" 6 "CAMPER" 7 "CAR" 8 "CARAVAN" 9 "CRASHRISK" 10 "DIRT" 11 "DISTANCE" 12 "DISTANCEBARS" 13 "END" 14 "EXITL" 15 "EXITR" 16 "FOG" 17 "GRAVEL" 18 "HAZMAT" 19 "HUMP" 20 "JAM" 21 "LORRY" 22 "EXCEPTLORRY" 23 "LOWTREE" 24 "MCYCLE" 25 "MINIMUM" 26 "NIGHT" 27 "NOSTOPSHOULDER" 28 "OILTRAIL" 29 "PRIOTURN" 30 "RADAR" 31 "RAIN" 32 "RAINSNOW" 33 "REMINDER" 34 "ROADDAMAGE" 35 "RUTS" 36 "RWORKSACCESS" 37 "RWORKSENTRY" 38 "RWORKSEXIT" 39 "SCHOOL" 40 "SECTION" 41 "SMOKE" 42 "SNOW" 43 "SOFTSHOULDERCAR" 44 "SHOFTSHOULDERLORRY" 45 "TEXT" 46 "TIME" 47 "TOWING" 48 "TRACTOR" 49 "TRACTOR_OVER" 50 "TRAILER" 51 "WEIGHT" 52 "WET" 53 "WITHIN" 54 "ZONE" 55 "EXIT" 56 "ACCESS" 57 "ALLWAY" 58 "EXCEPTBUS" 59 "EXCEPTDELIVERY" 60 "EXCEPTLOCAL" 61 "FROG" 62 "PRIOTURNL" 63 "PRIOTURNR" 64 "START" 65 "STOPIN" 66 "HAZWATER" 67 "DAY" 68 "SL" ;
VAL_ 251 VFC_TS13_AddTS4Quality 0 "Poor Quality" 1 "Good Quality" ;
VAL_ 251 VFC_TS13_AddTS4VMS 0 "Fixed" 1 "Variable" ;
VAL_ 251 VFC_TS13_AddTS5Class 0 "UNKNOWN" 1 "DETECTED" 2 "ACCIDENT" 3 "ADVICE" 4 "BEGINS" 5 "BUS" 6 "CAMPER" 7 "CAR" 8 "CARAVAN" 9 "CRASHRISK" 10 "DIRT" 11 "DISTANCE" 12 "DISTANCEBARS" 13 "END" 14 "EXITL" 15 "EXITR" 16 "FOG" 17 "GRAVEL" 18 "HAZMAT" 19 "HUMP" 20 "JAM" 21 "LORRY" 22 "EXCEPTLORRY" 23 "LOWTREE" 24 "MCYCLE" 25 "MINIMUM" 26 "NIGHT" 27 "NOSTOPSHOULDER" 28 "OILTRAIL" 29 "PRIOTURN" 30 "RADAR" 31 "RAIN" 32 "RAINSNOW" 33 "REMINDER" 34 "ROADDAMAGE" 35 "RUTS" 36 "RWORKSACCESS" 37 "RWORKSENTRY" 38 "RWORKSEXIT" 39 "SCHOOL" 40 "SECTION" 41 "SMOKE" 42 "SNOW" 43 "SOFTSHOULDERCAR" 44 "SHOFTSHOULDERLORRY" 45 "TEXT" 46 "TIME" 47 "TOWING" 48 "TRACTOR" 49 "TRACTOR_OVER" 50 "TRAILER" 51 "WEIGHT" 52 "WET" 53 "WITHIN" 54 "ZONE" 55 "EXIT" 56 "ACCESS" 57 "ALLWAY" 58 "EXCEPTBUS" 59 "EXCEPTDELIVERY" 60 "EXCEPTLOCAL" 61 "FROG" 62 "PRIOTURNL" 63 "PRIOTURNR" 64 "START" 65 "STOPIN" 66 "HAZWATER" 67 "DAY" 68 "SL" ;
VAL_ 251 VFC_TS13_AddTS5Quality 0 "Poor Quality" 1 "Good Quality" ;
VAL_ 251 VFC_TS13_AddTS5VMS 0 "Fixed" 1 "Variable" ;
VAL_ 251 VFC_TS13_AddTS6Class 0 "UNKNOWN" 1 "DETECTED" 2 "ACCIDENT" 3 "ADVICE" 4 "BEGINS" 5 "BUS" 6 "CAMPER" 7 "CAR" 8 "CARAVAN" 9 "CRASHRISK" 10 "DIRT" 11 "DISTANCE" 12 "DISTANCEBARS" 13 "END" 14 "EXITL" 15 "EXITR" 16 "FOG" 17 "GRAVEL" 18 "HAZMAT" 19 "HUMP" 20 "JAM" 21 "LORRY" 22 "EXCEPTLORRY" 23 "LOWTREE" 24 "MCYCLE" 25 "MINIMUM" 26 "NIGHT" 27 "NOSTOPSHOULDER" 28 "OILTRAIL" 29 "PRIOTURN" 30 "RADAR" 31 "RAIN" 32 "RAINSNOW" 33 "REMINDER" 34 "ROADDAMAGE" 35 "RUTS" 36 "RWORKSACCESS" 37 "RWORKSENTRY" 38 "RWORKSEXIT" 39 "SCHOOL" 40 "SECTION" 41 "SMOKE" 42 "SNOW" 43 "SOFTSHOULDERCAR" 44 "SHOFTSHOULDERLORRY" 45 "TEXT" 46 "TIME" 47 "TOWING" 48 "TRACTOR" 49 "TRACTOR_OVER" 50 "TRAILER" 51 "WEIGHT" 52 "WET" 53 "WITHIN" 54 "ZONE" 55 "EXIT" 56 "ACCESS" 57 "ALLWAY" 58 "EXCEPTBUS" 59 "EXCEPTDELIVERY" 60 "EXCEPTLOCAL" 61 "FROG" 62 "PRIOTURNL" 63 "PRIOTURNR" 64 "START" 65 "STOPIN" 66 "HAZWATER" 67 "DAY" 68 "SL" ;
VAL_ 251 VFC_TS13_AddTS6Quality 0 "Poor Quality" 1 "Good Quality" ;
VAL_ 251 VFC_TS13_AddTS6VMS 0 "Fixed" 1 "Variable" ;
VAL_ 252 VFC_TS14_ID 0 "INVALID" ;
VAL_ 252 VFC_TS14_Class 0 "UNKNOWN" 1 "SL5" 2 "SL10" 3 "SL15" 4 "SL20" 5 "SL25" 6 "SL30" 7 "SL35" 8 "SL40" 9 "SL45" 10 "SL50" 11 "SL55" 12 "SL60" 13 "SL65" 14 "SL70" 15 "SL75" 16 "SL80" 17 "SL85" 18 "SL90" 19 "SL95" 20 "SL100" 21 "SL105" 22 "SL110" 23 "SL115" 24 "SL120" 25 "SL125" 26 "SL130" 27 "SL135" 28 "SL140" 29 "SL145" 30 "SL150" 31 "SL155" 32 "SL160" 33 "ESL" 34 "EA" 35 "OP" 36 "EOP" 37 "OL" 38 "EOL" 39 "GIVEWAY" 40 "PRIOCROSS" 41 "PRIOCROSSYIELDTORIGHT" 42 "PRIOSTREET" 43 "EPRIOSTREET" 44 "STOP" 45 "AXLEWEIGHT" 46 "CARDIST" 47 "HEIGHT" 48 "LENGTH" 49 "LORRYDIST" 50 "NOALL" 51 "NOBIKE" 52 "NOBUS" 53 "NOCAR" 54 "NOCARBIKE" 55 "NOCARRIAGE" 56 "NOENTRY" 57 "NOHAZMAT" 58 "NOHAZWATER" 59 "NOLORRY" 60 "NOLORRYTRAILER" 61 "NOLTURN" 62 "NOPED" 63 "NORIDER" 64 "NORTURN" 65 "NOTRACTOR" 66 "NOTWOWAY" 67 "NOUTURN" 68 "UMWELT" 69 "EUMWELT" 70 "WEIGHT" 71 "WIDTH" 72 "WARNBIKE" 73 "WARNBUS" 74 "WARNCATTLE" 75 "WARNCONST" 76 "WARNCONSTL" 77 "WARNCONSTR" 78 "WARNCURVEL" 79 "WARNCURVER" 80 "WARNDANGER" 81 "WARNDCURVEL" 82 "WARNDCURVER" 83 "WARNDRAWBRIDGE" 84 "WARNFROG" 85 "WARNGRAVEL" 86 "WARNHUMP" 87 "WARNJAM" 88 "WARNKIDS" 89 "WARNLIGHTS" 90 "WARNLOWTREE" 91 "WARNPCROSS" 92 "WARNPED" 93 "WARNPIER" 94 "WARNPLANE" 95 "WARNRIDER" 96 "WARNROCK" 97 "WARNROUND" 98 "WARNRWORKS" 99 "WARNSKID" 100 "WARNSLOPED" 101 "WARNSLOPEU" 102 "WARNSNOW" 103 "WARNTRAIN" 104 "WARNTWOWAY" 105 "WARNWILDANIMAL" 106 "WARNWIND" 107 "ASL" 108 "EASL" 109 "CALM" 110 "ECALM" 111 "DEADEND" 112 "DOUANE" 113 "FWAY" 114 "EFWAY" 115 "HWAY" 116 "EHWAY" 117 "MSL" 118 "EMSL" 119 "NOPARK" 120 "NOSTOP" 121 "ONEWAYS" 122 "ONEWAYU" 123 "SLOWDOWN" 124 "SCHOOL" 125 "ESCHOOL" 126 "TWN" 127 "ETWN" 128 "WBBENTLEFT" 129 "WBBENTLEFTRIGHT" 130 "WBBENTRIGHT" 131 "WBDIAGL" 132 "WBDIAGLR" 133 "WBDIAGR" 134 "WBHAZWATER" 135 "WBLEFT" 136 "WBRIGHT" 137 "WBROUND" 138 "WBUP" 139 "WBUPLEFT" 140 "WBUPRIGHT" 141 "ZEBRA" 142 "HAZMAT" 143 "EMERGENCYBAY" 144 "ENDOFLANEL" 145 "ENDOFLANER" 146 "ENOPARK" 147 "EONEWAY" 148 "EPARK" 149 "ETOLL" 150 "NOPARKL" 151 "NOPARKLR" 152 "NOPARKR" 153 "NOSTOPL" 154 "NOSTOPLR" 155 "NOSTOPR" 156 "NOTURNONRED" 157 "ONEWAYL" 158 "ONEWAYR" 159 "PARK" 160 "PRIOCROSSL" 161 "PRIOCROSSR" 162 "TOLL" 163 "TUNNEL" 164 "TWOWAY" 165 "WARNCROSS" 166 "WARNCROSSL" 167 "WARNCROSSLR" 168 "WARNCROSSR" 169 "WARNCROSSRL" 170 "WARNCROSST" 171 "WARNGIVEWAYAHEAD" 172 "WARNSLAHEAD" 173 "WARNSTOPAHEAD" 174 "WBBUS" 175 "WRONGWAY" 176 "HAZWATER" 177 "GIVEWAYROUND" 178 "WARNWINDINGL" 179 "WARNWINDINGR" 180 "WARNHAIRPINL" 181 "WARNHAIRPINR" 182 "WARNPEDBIKE" 183 "WARNCROSSY" 184 "WARNBRANCHL" 185 "WARNBRANCHR" 186 "WARNAXLEWEIGHT" 187 "WARNWEIGHT" 188 "WARNHEIGHT" 189 "WARNLENGTH" 190 "WARNWIDTH" 191 "WARNBLACKSPOT" 192 "WARNMERGEL" 193 "WARNMERGER" 194 "WARNTUNNEL" 195 "WARNTRACTOR" 196 "WARNRWORKSVEHICLE" 197 "WARNNARROWBRIDGE" 198 "WARNFLAGGER" 199 "LANES" 200 "LANESHIFTL" 201 "LANESHIFTR" 202 "NEWLANEL" 203 "NEWLANER" 204 "RIGHTTURNONRED" 205 "BORDERLIMIT" 206 "EMBEDDEDRAIN" ;
VAL_ 252 VFC_TS14_EmbedFlag 0 "Unknown" 1 "Not Embedded" 2 "Border Limit" 3 "Multi Lane" 4 "Rain" 5 "Vehicle Type" 6 "Plate" 7 "Error Value" ;
VAL_ 252 VFC_TS14_Quality 0 "Poor Quality" 1 "Good Quality" ;
VAL_ 252 VFC_TS14_VMS 0 "Fixed" 1 "Variable" ;
VAL_ 252 VFC_TS14_Stable 0 "Object Is Not Stable" 1 "Object Is Stable" ;
VAL_ 252 VFC_TS14_VehicleSticker 0 "not_sticker_on_vehicle" 1 "Sign is a sticker on a vehicle" ;
VAL_ 252 VFC_TS14_InternalTrack 0 "Sign is not an internal track" 1 "Sign is an internal track" ;
VAL_ 252 VFC_TS14_AddTS1Class 0 "UNKNOWN" 1 "DETECTED" 2 "ACCIDENT" 3 "ADVICE" 4 "BEGINS" 5 "BUS" 6 "CAMPER" 7 "CAR" 8 "CARAVAN" 9 "CRASHRISK" 10 "DIRT" 11 "DISTANCE" 12 "DISTANCEBARS" 13 "END" 14 "EXITL" 15 "EXITR" 16 "FOG" 17 "GRAVEL" 18 "HAZMAT" 19 "HUMP" 20 "JAM" 21 "LORRY" 22 "EXCEPTLORRY" 23 "LOWTREE" 24 "MCYCLE" 25 "MINIMUM" 26 "NIGHT" 27 "NOSTOPSHOULDER" 28 "OILTRAIL" 29 "PRIOTURN" 30 "RADAR" 31 "RAIN" 32 "RAINSNOW" 33 "REMINDER" 34 "ROADDAMAGE" 35 "RUTS" 36 "RWORKSACCESS" 37 "RWORKSENTRY" 38 "RWORKSEXIT" 39 "SCHOOL" 40 "SECTION" 41 "SMOKE" 42 "SNOW" 43 "SOFTSHOULDERCAR" 44 "SHOFTSHOULDERLORRY" 45 "TEXT" 46 "TIME" 47 "TOWING" 48 "TRACTOR" 49 "TRACTOR_OVER" 50 "TRAILER" 51 "WEIGHT" 52 "WET" 53 "WITHIN" 54 "ZONE" 55 "EXIT" 56 "ACCESS" 57 "ALLWAY" 58 "EXCEPTBUS" 59 "EXCEPTDELIVERY" 60 "EXCEPTLOCAL" 61 "FROG" 62 "PRIOTURNL" 63 "PRIOTURNR" 64 "START" 65 "STOPIN" 66 "HAZWATER" 67 "DAY" 68 "SL" ;
VAL_ 252 VFC_TS14_AddTS1Quality 0 "Poor Quality" 1 "Good Quality" ;
VAL_ 252 VFC_TS14_AddTS1VMS 0 "Fixed" 1 "Variable" ;
VAL_ 252 VFC_TS14_AddTS2Class 0 "UNKNOWN" 1 "DETECTED" 2 "ACCIDENT" 3 "ADVICE" 4 "BEGINS" 5 "BUS" 6 "CAMPER" 7 "CAR" 8 "CARAVAN" 9 "CRASHRISK" 10 "DIRT" 11 "DISTANCE" 12 "DISTANCEBARS" 13 "END" 14 "EXITL" 15 "EXITR" 16 "FOG" 17 "GRAVEL" 18 "HAZMAT" 19 "HUMP" 20 "JAM" 21 "LORRY" 22 "EXCEPTLORRY" 23 "LOWTREE" 24 "MCYCLE" 25 "MINIMUM" 26 "NIGHT" 27 "NOSTOPSHOULDER" 28 "OILTRAIL" 29 "PRIOTURN" 30 "RADAR" 31 "RAIN" 32 "RAINSNOW" 33 "REMINDER" 34 "ROADDAMAGE" 35 "RUTS" 36 "RWORKSACCESS" 37 "RWORKSENTRY" 38 "RWORKSEXIT" 39 "SCHOOL" 40 "SECTION" 41 "SMOKE" 42 "SNOW" 43 "SOFTSHOULDERCAR" 44 "SHOFTSHOULDERLORRY" 45 "TEXT" 46 "TIME" 47 "TOWING" 48 "TRACTOR" 49 "TRACTOR_OVER" 50 "TRAILER" 51 "WEIGHT" 52 "WET" 53 "WITHIN" 54 "ZONE" 55 "EXIT" 56 "ACCESS" 57 "ALLWAY" 58 "EXCEPTBUS" 59 "EXCEPTDELIVERY" 60 "EXCEPTLOCAL" 61 "FROG" 62 "PRIOTURNL" 63 "PRIOTURNR" 64 "START" 65 "STOPIN" 66 "HAZWATER" 67 "DAY" 68 "SL" ;
VAL_ 252 VFC_TS14_AddTS2Quality 0 "Poor Quality" 1 "Good Quality" ;
VAL_ 252 VFC_TS14_AddTS2VMS 0 "Fixed" 1 "Variable" ;
VAL_ 252 VFC_TS14_AddTS3Class 0 "UNKNOWN" 1 "DETECTED" 2 "ACCIDENT" 3 "ADVICE" 4 "BEGINS" 5 "BUS" 6 "CAMPER" 7 "CAR" 8 "CARAVAN" 9 "CRASHRISK" 10 "DIRT" 11 "DISTANCE" 12 "DISTANCEBARS" 13 "END" 14 "EXITL" 15 "EXITR" 16 "FOG" 17 "GRAVEL" 18 "HAZMAT" 19 "HUMP" 20 "JAM" 21 "LORRY" 22 "EXCEPTLORRY" 23 "LOWTREE" 24 "MCYCLE" 25 "MINIMUM" 26 "NIGHT" 27 "NOSTOPSHOULDER" 28 "OILTRAIL" 29 "PRIOTURN" 30 "RADAR" 31 "RAIN" 32 "RAINSNOW" 33 "REMINDER" 34 "ROADDAMAGE" 35 "RUTS" 36 "RWORKSACCESS" 37 "RWORKSENTRY" 38 "RWORKSEXIT" 39 "SCHOOL" 40 "SECTION" 41 "SMOKE" 42 "SNOW" 43 "SOFTSHOULDERCAR" 44 "SHOFTSHOULDERLORRY" 45 "TEXT" 46 "TIME" 47 "TOWING" 48 "TRACTOR" 49 "TRACTOR_OVER" 50 "TRAILER" 51 "WEIGHT" 52 "WET" 53 "WITHIN" 54 "ZONE" 55 "EXIT" 56 "ACCESS" 57 "ALLWAY" 58 "EXCEPTBUS" 59 "EXCEPTDELIVERY" 60 "EXCEPTLOCAL" 61 "FROG" 62 "PRIOTURNL" 63 "PRIOTURNR" 64 "START" 65 "STOPIN" 66 "HAZWATER" 67 "DAY" 68 "SL" ;
VAL_ 252 VFC_TS14_AddTS3Quality 0 "Poor Quality" 1 "Good Quality" ;
VAL_ 252 VFC_TS14_AddTS3VMS 0 "Fixed" 1 "Variable" ;
VAL_ 252 VFC_TS14_AddTS4Class 0 "UNKNOWN" 1 "DETECTED" 2 "ACCIDENT" 3 "ADVICE" 4 "BEGINS" 5 "BUS" 6 "CAMPER" 7 "CAR" 8 "CARAVAN" 9 "CRASHRISK" 10 "DIRT" 11 "DISTANCE" 12 "DISTANCEBARS" 13 "END" 14 "EXITL" 15 "EXITR" 16 "FOG" 17 "GRAVEL" 18 "HAZMAT" 19 "HUMP" 20 "JAM" 21 "LORRY" 22 "EXCEPTLORRY" 23 "LOWTREE" 24 "MCYCLE" 25 "MINIMUM" 26 "NIGHT" 27 "NOSTOPSHOULDER" 28 "OILTRAIL" 29 "PRIOTURN" 30 "RADAR" 31 "RAIN" 32 "RAINSNOW" 33 "REMINDER" 34 "ROADDAMAGE" 35 "RUTS" 36 "RWORKSACCESS" 37 "RWORKSENTRY" 38 "RWORKSEXIT" 39 "SCHOOL" 40 "SECTION" 41 "SMOKE" 42 "SNOW" 43 "SOFTSHOULDERCAR" 44 "SHOFTSHOULDERLORRY" 45 "TEXT" 46 "TIME" 47 "TOWING" 48 "TRACTOR" 49 "TRACTOR_OVER" 50 "TRAILER" 51 "WEIGHT" 52 "WET" 53 "WITHIN" 54 "ZONE" 55 "EXIT" 56 "ACCESS" 57 "ALLWAY" 58 "EXCEPTBUS" 59 "EXCEPTDELIVERY" 60 "EXCEPTLOCAL" 61 "FROG" 62 "PRIOTURNL" 63 "PRIOTURNR" 64 "START" 65 "STOPIN" 66 "HAZWATER" 67 "DAY" 68 "SL" ;
VAL_ 252 VFC_TS14_AddTS4Quality 0 "Poor Quality" 1 "Good Quality" ;
VAL_ 252 VFC_TS14_AddTS4VMS 0 "Fixed" 1 "Variable" ;
VAL_ 252 VFC_TS14_AddTS5Class 0 "UNKNOWN" 1 "DETECTED" 2 "ACCIDENT" 3 "ADVICE" 4 "BEGINS" 5 "BUS" 6 "CAMPER" 7 "CAR" 8 "CARAVAN" 9 "CRASHRISK" 10 "DIRT" 11 "DISTANCE" 12 "DISTANCEBARS" 13 "END" 14 "EXITL" 15 "EXITR" 16 "FOG" 17 "GRAVEL" 18 "HAZMAT" 19 "HUMP" 20 "JAM" 21 "LORRY" 22 "EXCEPTLORRY" 23 "LOWTREE" 24 "MCYCLE" 25 "MINIMUM" 26 "NIGHT" 27 "NOSTOPSHOULDER" 28 "OILTRAIL" 29 "PRIOTURN" 30 "RADAR" 31 "RAIN" 32 "RAINSNOW" 33 "REMINDER" 34 "ROADDAMAGE" 35 "RUTS" 36 "RWORKSACCESS" 37 "RWORKSENTRY" 38 "RWORKSEXIT" 39 "SCHOOL" 40 "SECTION" 41 "SMOKE" 42 "SNOW" 43 "SOFTSHOULDERCAR" 44 "SHOFTSHOULDERLORRY" 45 "TEXT" 46 "TIME" 47 "TOWING" 48 "TRACTOR" 49 "TRACTOR_OVER" 50 "TRAILER" 51 "WEIGHT" 52 "WET" 53 "WITHIN" 54 "ZONE" 55 "EXIT" 56 "ACCESS" 57 "ALLWAY" 58 "EXCEPTBUS" 59 "EXCEPTDELIVERY" 60 "EXCEPTLOCAL" 61 "FROG" 62 "PRIOTURNL" 63 "PRIOTURNR" 64 "START" 65 "STOPIN" 66 "HAZWATER" 67 "DAY" 68 "SL" ;
VAL_ 252 VFC_TS14_AddTS5Quality 0 "Poor Quality" 1 "Good Quality" ;
VAL_ 252 VFC_TS14_AddTS5VMS 0 "Fixed" 1 "Variable" ;
VAL_ 252 VFC_TS14_AddTS6Class 0 "UNKNOWN" 1 "DETECTED" 2 "ACCIDENT" 3 "ADVICE" 4 "BEGINS" 5 "BUS" 6 "CAMPER" 7 "CAR" 8 "CARAVAN" 9 "CRASHRISK" 10 "DIRT" 11 "DISTANCE" 12 "DISTANCEBARS" 13 "END" 14 "EXITL" 15 "EXITR" 16 "FOG" 17 "GRAVEL" 18 "HAZMAT" 19 "HUMP" 20 "JAM" 21 "LORRY" 22 "EXCEPTLORRY" 23 "LOWTREE" 24 "MCYCLE" 25 "MINIMUM" 26 "NIGHT" 27 "NOSTOPSHOULDER" 28 "OILTRAIL" 29 "PRIOTURN" 30 "RADAR" 31 "RAIN" 32 "RAINSNOW" 33 "REMINDER" 34 "ROADDAMAGE" 35 "RUTS" 36 "RWORKSACCESS" 37 "RWORKSENTRY" 38 "RWORKSEXIT" 39 "SCHOOL" 40 "SECTION" 41 "SMOKE" 42 "SNOW" 43 "SOFTSHOULDERCAR" 44 "SHOFTSHOULDERLORRY" 45 "TEXT" 46 "TIME" 47 "TOWING" 48 "TRACTOR" 49 "TRACTOR_OVER" 50 "TRAILER" 51 "WEIGHT" 52 "WET" 53 "WITHIN" 54 "ZONE" 55 "EXIT" 56 "ACCESS" 57 "ALLWAY" 58 "EXCEPTBUS" 59 "EXCEPTDELIVERY" 60 "EXCEPTLOCAL" 61 "FROG" 62 "PRIOTURNL" 63 "PRIOTURNR" 64 "START" 65 "STOPIN" 66 "HAZWATER" 67 "DAY" 68 "SL" ;
VAL_ 252 VFC_TS14_AddTS6Quality 0 "Poor Quality" 1 "Good Quality" ;
VAL_ 252 VFC_TS14_AddTS6VMS 0 "Fixed" 1 "Variable" ;
VAL_ 253 VFC_TS15_ID 0 "INVALID" ;
VAL_ 253 VFC_TS15_Class 0 "UNKNOWN" 1 "SL5" 2 "SL10" 3 "SL15" 4 "SL20" 5 "SL25" 6 "SL30" 7 "SL35" 8 "SL40" 9 "SL45" 10 "SL50" 11 "SL55" 12 "SL60" 13 "SL65" 14 "SL70" 15 "SL75" 16 "SL80" 17 "SL85" 18 "SL90" 19 "SL95" 20 "SL100" 21 "SL105" 22 "SL110" 23 "SL115" 24 "SL120" 25 "SL125" 26 "SL130" 27 "SL135" 28 "SL140" 29 "SL145" 30 "SL150" 31 "SL155" 32 "SL160" 33 "ESL" 34 "EA" 35 "OP" 36 "EOP" 37 "OL" 38 "EOL" 39 "GIVEWAY" 40 "PRIOCROSS" 41 "PRIOCROSSYIELDTORIGHT" 42 "PRIOSTREET" 43 "EPRIOSTREET" 44 "STOP" 45 "AXLEWEIGHT" 46 "CARDIST" 47 "HEIGHT" 48 "LENGTH" 49 "LORRYDIST" 50 "NOALL" 51 "NOBIKE" 52 "NOBUS" 53 "NOCAR" 54 "NOCARBIKE" 55 "NOCARRIAGE" 56 "NOENTRY" 57 "NOHAZMAT" 58 "NOHAZWATER" 59 "NOLORRY" 60 "NOLORRYTRAILER" 61 "NOLTURN" 62 "NOPED" 63 "NORIDER" 64 "NORTURN" 65 "NOTRACTOR" 66 "NOTWOWAY" 67 "NOUTURN" 68 "UMWELT" 69 "EUMWELT" 70 "WEIGHT" 71 "WIDTH" 72 "WARNBIKE" 73 "WARNBUS" 74 "WARNCATTLE" 75 "WARNCONST" 76 "WARNCONSTL" 77 "WARNCONSTR" 78 "WARNCURVEL" 79 "WARNCURVER" 80 "WARNDANGER" 81 "WARNDCURVEL" 82 "WARNDCURVER" 83 "WARNDRAWBRIDGE" 84 "WARNFROG" 85 "WARNGRAVEL" 86 "WARNHUMP" 87 "WARNJAM" 88 "WARNKIDS" 89 "WARNLIGHTS" 90 "WARNLOWTREE" 91 "WARNPCROSS" 92 "WARNPED" 93 "WARNPIER" 94 "WARNPLANE" 95 "WARNRIDER" 96 "WARNROCK" 97 "WARNROUND" 98 "WARNRWORKS" 99 "WARNSKID" 100 "WARNSLOPED" 101 "WARNSLOPEU" 102 "WARNSNOW" 103 "WARNTRAIN" 104 "WARNTWOWAY" 105 "WARNWILDANIMAL" 106 "WARNWIND" 107 "ASL" 108 "EASL" 109 "CALM" 110 "ECALM" 111 "DEADEND" 112 "DOUANE" 113 "FWAY" 114 "EFWAY" 115 "HWAY" 116 "EHWAY" 117 "MSL" 118 "EMSL" 119 "NOPARK" 120 "NOSTOP" 121 "ONEWAYS" 122 "ONEWAYU" 123 "SLOWDOWN" 124 "SCHOOL" 125 "ESCHOOL" 126 "TWN" 127 "ETWN" 128 "WBBENTLEFT" 129 "WBBENTLEFTRIGHT" 130 "WBBENTRIGHT" 131 "WBDIAGL" 132 "WBDIAGLR" 133 "WBDIAGR" 134 "WBHAZWATER" 135 "WBLEFT" 136 "WBRIGHT" 137 "WBROUND" 138 "WBUP" 139 "WBUPLEFT" 140 "WBUPRIGHT" 141 "ZEBRA" 142 "HAZMAT" 143 "EMERGENCYBAY" 144 "ENDOFLANEL" 145 "ENDOFLANER" 146 "ENOPARK" 147 "EONEWAY" 148 "EPARK" 149 "ETOLL" 150 "NOPARKL" 151 "NOPARKLR" 152 "NOPARKR" 153 "NOSTOPL" 154 "NOSTOPLR" 155 "NOSTOPR" 156 "NOTURNONRED" 157 "ONEWAYL" 158 "ONEWAYR" 159 "PARK" 160 "PRIOCROSSL" 161 "PRIOCROSSR" 162 "TOLL" 163 "TUNNEL" 164 "TWOWAY" 165 "WARNCROSS" 166 "WARNCROSSL" 167 "WARNCROSSLR" 168 "WARNCROSSR" 169 "WARNCROSSRL" 170 "WARNCROSST" 171 "WARNGIVEWAYAHEAD" 172 "WARNSLAHEAD" 173 "WARNSTOPAHEAD" 174 "WBBUS" 175 "WRONGWAY" 176 "HAZWATER" 177 "GIVEWAYROUND" 178 "WARNWINDINGL" 179 "WARNWINDINGR" 180 "WARNHAIRPINL" 181 "WARNHAIRPINR" 182 "WARNPEDBIKE" 183 "WARNCROSSY" 184 "WARNBRANCHL" 185 "WARNBRANCHR" 186 "WARNAXLEWEIGHT" 187 "WARNWEIGHT" 188 "WARNHEIGHT" 189 "WARNLENGTH" 190 "WARNWIDTH" 191 "WARNBLACKSPOT" 192 "WARNMERGEL" 193 "WARNMERGER" 194 "WARNTUNNEL" 195 "WARNTRACTOR" 196 "WARNRWORKSVEHICLE" 197 "WARNNARROWBRIDGE" 198 "WARNFLAGGER" 199 "LANES" 200 "LANESHIFTL" 201 "LANESHIFTR" 202 "NEWLANEL" 203 "NEWLANER" 204 "RIGHTTURNONRED" 205 "BORDERLIMIT" 206 "EMBEDDEDRAIN" ;
VAL_ 253 VFC_TS15_EmbedFlag 0 "Unknown" 1 "Not Embedded" 2 "Border Limit" 3 "Multi Lane" 4 "Rain" 5 "Vehicle Type" 6 "Plate" 7 "Error Value" ;
VAL_ 253 VFC_TS15_Quality 0 "Poor Quality" 1 "Good Quality" ;
VAL_ 253 VFC_TS15_VMS 0 "Fixed" 1 "Variable" ;
VAL_ 253 VFC_TS15_Stable 0 "Object Is Not Stable" 1 "Object Is Stable" ;
VAL_ 253 VFC_TS15_VehicleSticker 0 "not_sticker_on_vehicle" 1 "Sign is a sticker on a vehicle" ;
VAL_ 253 VFC_TS15_InternalTrack 0 "Sign is not an internal track" 1 "Sign is an internal track" ;
VAL_ 253 VFC_TS15_AddTS1Class 0 "UNKNOWN" 1 "DETECTED" 2 "ACCIDENT" 3 "ADVICE" 4 "BEGINS" 5 "BUS" 6 "CAMPER" 7 "CAR" 8 "CARAVAN" 9 "CRASHRISK" 10 "DIRT" 11 "DISTANCE" 12 "DISTANCEBARS" 13 "END" 14 "EXITL" 15 "EXITR" 16 "FOG" 17 "GRAVEL" 18 "HAZMAT" 19 "HUMP" 20 "JAM" 21 "LORRY" 22 "EXCEPTLORRY" 23 "LOWTREE" 24 "MCYCLE" 25 "MINIMUM" 26 "NIGHT" 27 "NOSTOPSHOULDER" 28 "OILTRAIL" 29 "PRIOTURN" 30 "RADAR" 31 "RAIN" 32 "RAINSNOW" 33 "REMINDER" 34 "ROADDAMAGE" 35 "RUTS" 36 "RWORKSACCESS" 37 "RWORKSENTRY" 38 "RWORKSEXIT" 39 "SCHOOL" 40 "SECTION" 41 "SMOKE" 42 "SNOW" 43 "SOFTSHOULDERCAR" 44 "SHOFTSHOULDERLORRY" 45 "TEXT" 46 "TIME" 47 "TOWING" 48 "TRACTOR" 49 "TRACTOR_OVER" 50 "TRAILER" 51 "WEIGHT" 52 "WET" 53 "WITHIN" 54 "ZONE" 55 "EXIT" 56 "ACCESS" 57 "ALLWAY" 58 "EXCEPTBUS" 59 "EXCEPTDELIVERY" 60 "EXCEPTLOCAL" 61 "FROG" 62 "PRIOTURNL" 63 "PRIOTURNR" 64 "START" 65 "STOPIN" 66 "HAZWATER" 67 "DAY" 68 "SL" ;
VAL_ 253 VFC_TS15_AddTS1Quality 0 "Poor Quality" 1 "Good Quality" ;
VAL_ 253 VFC_TS15_AddTS1VMS 0 "Fixed" 1 "Variable" ;
VAL_ 253 VFC_TS15_AddTS2Class 0 "UNKNOWN" 1 "DETECTED" 2 "ACCIDENT" 3 "ADVICE" 4 "BEGINS" 5 "BUS" 6 "CAMPER" 7 "CAR" 8 "CARAVAN" 9 "CRASHRISK" 10 "DIRT" 11 "DISTANCE" 12 "DISTANCEBARS" 13 "END" 14 "EXITL" 15 "EXITR" 16 "FOG" 17 "GRAVEL" 18 "HAZMAT" 19 "HUMP" 20 "JAM" 21 "LORRY" 22 "EXCEPTLORRY" 23 "LOWTREE" 24 "MCYCLE" 25 "MINIMUM" 26 "NIGHT" 27 "NOSTOPSHOULDER" 28 "OILTRAIL" 29 "PRIOTURN" 30 "RADAR" 31 "RAIN" 32 "RAINSNOW" 33 "REMINDER" 34 "ROADDAMAGE" 35 "RUTS" 36 "RWORKSACCESS" 37 "RWORKSENTRY" 38 "RWORKSEXIT" 39 "SCHOOL" 40 "SECTION" 41 "SMOKE" 42 "SNOW" 43 "SOFTSHOULDERCAR" 44 "SHOFTSHOULDERLORRY" 45 "TEXT" 46 "TIME" 47 "TOWING" 48 "TRACTOR" 49 "TRACTOR_OVER" 50 "TRAILER" 51 "WEIGHT" 52 "WET" 53 "WITHIN" 54 "ZONE" 55 "EXIT" 56 "ACCESS" 57 "ALLWAY" 58 "EXCEPTBUS" 59 "EXCEPTDELIVERY" 60 "EXCEPTLOCAL" 61 "FROG" 62 "PRIOTURNL" 63 "PRIOTURNR" 64 "START" 65 "STOPIN" 66 "HAZWATER" 67 "DAY" 68 "SL" ;
VAL_ 253 VFC_TS15_AddTS2Quality 0 "Poor Quality" 1 "Good Quality" ;
VAL_ 253 VFC_TS15_AddTS2VMS 0 "Fixed" 1 "Variable" ;
VAL_ 253 VFC_TS15_AddTS3Class 0 "UNKNOWN" 1 "DETECTED" 2 "ACCIDENT" 3 "ADVICE" 4 "BEGINS" 5 "BUS" 6 "CAMPER" 7 "CAR" 8 "CARAVAN" 9 "CRASHRISK" 10 "DIRT" 11 "DISTANCE" 12 "DISTANCEBARS" 13 "END" 14 "EXITL" 15 "EXITR" 16 "FOG" 17 "GRAVEL" 18 "HAZMAT" 19 "HUMP" 20 "JAM" 21 "LORRY" 22 "EXCEPTLORRY" 23 "LOWTREE" 24 "MCYCLE" 25 "MINIMUM" 26 "NIGHT" 27 "NOSTOPSHOULDER" 28 "OILTRAIL" 29 "PRIOTURN" 30 "RADAR" 31 "RAIN" 32 "RAINSNOW" 33 "REMINDER" 34 "ROADDAMAGE" 35 "RUTS" 36 "RWORKSACCESS" 37 "RWORKSENTRY" 38 "RWORKSEXIT" 39 "SCHOOL" 40 "SECTION" 41 "SMOKE" 42 "SNOW" 43 "SOFTSHOULDERCAR" 44 "SHOFTSHOULDERLORRY" 45 "TEXT" 46 "TIME" 47 "TOWING" 48 "TRACTOR" 49 "TRACTOR_OVER" 50 "TRAILER" 51 "WEIGHT" 52 "WET" 53 "WITHIN" 54 "ZONE" 55 "EXIT" 56 "ACCESS" 57 "ALLWAY" 58 "EXCEPTBUS" 59 "EXCEPTDELIVERY" 60 "EXCEPTLOCAL" 61 "FROG" 62 "PRIOTURNL" 63 "PRIOTURNR" 64 "START" 65 "STOPIN" 66 "HAZWATER" 67 "DAY" 68 "SL" ;
VAL_ 253 VFC_TS15_AddTS3Quality 0 "Poor Quality" 1 "Good Quality" ;
VAL_ 253 VFC_TS15_AddTS3VMS 0 "Fixed" 1 "Variable" ;
VAL_ 253 VFC_TS15_AddTS4Class 0 "UNKNOWN" 1 "DETECTED" 2 "ACCIDENT" 3 "ADVICE" 4 "BEGINS" 5 "BUS" 6 "CAMPER" 7 "CAR" 8 "CARAVAN" 9 "CRASHRISK" 10 "DIRT" 11 "DISTANCE" 12 "DISTANCEBARS" 13 "END" 14 "EXITL" 15 "EXITR" 16 "FOG" 17 "GRAVEL" 18 "HAZMAT" 19 "HUMP" 20 "JAM" 21 "LORRY" 22 "EXCEPTLORRY" 23 "LOWTREE" 24 "MCYCLE" 25 "MINIMUM" 26 "NIGHT" 27 "NOSTOPSHOULDER" 28 "OILTRAIL" 29 "PRIOTURN" 30 "RADAR" 31 "RAIN" 32 "RAINSNOW" 33 "REMINDER" 34 "ROADDAMAGE" 35 "RUTS" 36 "RWORKSACCESS" 37 "RWORKSENTRY" 38 "RWORKSEXIT" 39 "SCHOOL" 40 "SECTION" 41 "SMOKE" 42 "SNOW" 43 "SOFTSHOULDERCAR" 44 "SHOFTSHOULDERLORRY" 45 "TEXT" 46 "TIME" 47 "TOWING" 48 "TRACTOR" 49 "TRACTOR_OVER" 50 "TRAILER" 51 "WEIGHT" 52 "WET" 53 "WITHIN" 54 "ZONE" 55 "EXIT" 56 "ACCESS" 57 "ALLWAY" 58 "EXCEPTBUS" 59 "EXCEPTDELIVERY" 60 "EXCEPTLOCAL" 61 "FROG" 62 "PRIOTURNL" 63 "PRIOTURNR" 64 "START" 65 "STOPIN" 66 "HAZWATER" 67 "DAY" 68 "SL" ;
VAL_ 253 VFC_TS15_AddTS4Quality 0 "Poor Quality" 1 "Good Quality" ;
VAL_ 253 VFC_TS15_AddTS4VMS 0 "Fixed" 1 "Variable" ;
VAL_ 253 VFC_TS15_AddTS5Class 0 "UNKNOWN" 1 "DETECTED" 2 "ACCIDENT" 3 "ADVICE" 4 "BEGINS" 5 "BUS" 6 "CAMPER" 7 "CAR" 8 "CARAVAN" 9 "CRASHRISK" 10 "DIRT" 11 "DISTANCE" 12 "DISTANCEBARS" 13 "END" 14 "EXITL" 15 "EXITR" 16 "FOG" 17 "GRAVEL" 18 "HAZMAT" 19 "HUMP" 20 "JAM" 21 "LORRY" 22 "EXCEPTLORRY" 23 "LOWTREE" 24 "MCYCLE" 25 "MINIMUM" 26 "NIGHT" 27 "NOSTOPSHOULDER" 28 "OILTRAIL" 29 "PRIOTURN" 30 "RADAR" 31 "RAIN" 32 "RAINSNOW" 33 "REMINDER" 34 "ROADDAMAGE" 35 "RUTS" 36 "RWORKSACCESS" 37 "RWORKSENTRY" 38 "RWORKSEXIT" 39 "SCHOOL" 40 "SECTION" 41 "SMOKE" 42 "SNOW" 43 "SOFTSHOULDERCAR" 44 "SHOFTSHOULDERLORRY" 45 "TEXT" 46 "TIME" 47 "TOWING" 48 "TRACTOR" 49 "TRACTOR_OVER" 50 "TRAILER" 51 "WEIGHT" 52 "WET" 53 "WITHIN" 54 "ZONE" 55 "EXIT" 56 "ACCESS" 57 "ALLWAY" 58 "EXCEPTBUS" 59 "EXCEPTDELIVERY" 60 "EXCEPTLOCAL" 61 "FROG" 62 "PRIOTURNL" 63 "PRIOTURNR" 64 "START" 65 "STOPIN" 66 "HAZWATER" 67 "DAY" 68 "SL" ;
VAL_ 253 VFC_TS15_AddTS5Quality 0 "Poor Quality" 1 "Good Quality" ;
VAL_ 253 VFC_TS15_AddTS5VMS 0 "Fixed" 1 "Variable" ;
VAL_ 253 VFC_TS15_AddTS6Class 0 "UNKNOWN" 1 "DETECTED" 2 "ACCIDENT" 3 "ADVICE" 4 "BEGINS" 5 "BUS" 6 "CAMPER" 7 "CAR" 8 "CARAVAN" 9 "CRASHRISK" 10 "DIRT" 11 "DISTANCE" 12 "DISTANCEBARS" 13 "END" 14 "EXITL" 15 "EXITR" 16 "FOG" 17 "GRAVEL" 18 "HAZMAT" 19 "HUMP" 20 "JAM" 21 "LORRY" 22 "EXCEPTLORRY" 23 "LOWTREE" 24 "MCYCLE" 25 "MINIMUM" 26 "NIGHT" 27 "NOSTOPSHOULDER" 28 "OILTRAIL" 29 "PRIOTURN" 30 "RADAR" 31 "RAIN" 32 "RAINSNOW" 33 "REMINDER" 34 "ROADDAMAGE" 35 "RUTS" 36 "RWORKSACCESS" 37 "RWORKSENTRY" 38 "RWORKSEXIT" 39 "SCHOOL" 40 "SECTION" 41 "SMOKE" 42 "SNOW" 43 "SOFTSHOULDERCAR" 44 "SHOFTSHOULDERLORRY" 45 "TEXT" 46 "TIME" 47 "TOWING" 48 "TRACTOR" 49 "TRACTOR_OVER" 50 "TRAILER" 51 "WEIGHT" 52 "WET" 53 "WITHIN" 54 "ZONE" 55 "EXIT" 56 "ACCESS" 57 "ALLWAY" 58 "EXCEPTBUS" 59 "EXCEPTDELIVERY" 60 "EXCEPTLOCAL" 61 "FROG" 62 "PRIOTURNL" 63 "PRIOTURNR" 64 "START" 65 "STOPIN" 66 "HAZWATER" 67 "DAY" 68 "SL" ;
VAL_ 253 VFC_TS15_AddTS6Quality 0 "Poor Quality" 1 "Good Quality" ;
VAL_ 253 VFC_TS15_AddTS6VMS 0 "Fixed" 1 "Variable" ;
VAL_ 260 RFC_LocHdr_LocDownSel 0 "no downselection" 1 "downselected" ;
SIG_GROUP_ 247 SG_VFC_TrafficSign09 1 : VFC_TS09_CRC VFC_TS09_AliveCtr VFC_TS09_ProtBlockCtr VFC_TS09_ProtOrderIndex VFC_TS09_ID VFC_TS09_Class VFC_TS09_TSProb VFC_TS09_Dx VFC_TS09_Dy VFC_TS09_Dz VFC_TS09_DxStdDev VFC_TS09_DyStdDev VFC_TS09_DzStdDev VFC_TS09_Width VFC_TS09_Height VFC_TS09_EmbedFlag VFC_TS09_Quality VFC_TS09_VMS VFC_TS09_Stable VFC_TS09_VehicleSticker VFC_TS09_InternalTrack VFC_TS09_ValidLanes VFC_TS09_ValidDay VFC_TS09_ValidTimeRange1Start VFC_TS09_ValidTimeRange1End VFC_TS09_ValidTimeRange2Start VFC_TS09_ValidTimeRange2End VFC_TS09_ValidInDist VFC_TS09_ValidDist VFC_TS09_AddTSCount VFC_TS09_AddTS1Class VFC_TS09_AddTS1Prob VFC_TS09_AddTS1Quality VFC_TS09_AddTS1VMS VFC_TS09_AddTS2Class VFC_TS09_AddTS2Prob VFC_TS09_AddTS2Quality VFC_TS09_AddTS2VMS VFC_TS09_AddTS3Class VFC_TS09_AddTS3Prob VFC_TS09_AddTS3Quality VFC_TS09_AddTS3VMS VFC_TS09_AddTS4Class VFC_TS09_AddTS4Prob VFC_TS09_AddTS4Quality VFC_TS09_AddTS4VMS VFC_TS09_AddTS5Class VFC_TS09_AddTS5Prob VFC_TS09_AddTS5Quality VFC_TS09_AddTS5VMS VFC_TS09_AddTS6Class VFC_TS09_AddTS6Prob VFC_TS09_AddTS6Quality VFC_TS09_AddTS6VMS;
SIG_GROUP_ 248 SG_VFC_TrafficSign10 1 : VFC_TS10_CRC VFC_TS10_AliveCtr VFC_TS10_ProtBlockCtr VFC_TS10_ProtOrderIndex VFC_TS10_ID VFC_TS10_Class VFC_TS10_TSProb VFC_TS10_Dx VFC_TS10_Dy VFC_TS10_Dz VFC_TS10_DxStdDev VFC_TS10_DyStdDev VFC_TS10_DzStdDev VFC_TS10_Width VFC_TS10_Height VFC_TS10_EmbedFlag VFC_TS10_Quality VFC_TS10_VMS VFC_TS10_Stable VFC_TS10_VehicleSticker VFC_TS10_InternalTrack VFC_TS10_ValidLanes VFC_TS10_ValidDay VFC_TS10_ValidTimeRange1Start VFC_TS10_ValidTimeRange1End VFC_TS10_ValidTimeRange2Start VFC_TS10_ValidTimeRange2End VFC_TS10_ValidInDist VFC_TS10_ValidDist VFC_TS10_AddTSCount VFC_TS10_AddTS1Class VFC_TS10_AddTS1Prob VFC_TS10_AddTS1Quality VFC_TS10_AddTS1VMS VFC_TS10_AddTS2Class VFC_TS10_AddTS2Prob VFC_TS10_AddTS2Quality VFC_TS10_AddTS2VMS VFC_TS10_AddTS3Class VFC_TS10_AddTS3Prob VFC_TS10_AddTS3Quality VFC_TS10_AddTS3VMS VFC_TS10_AddTS4Class VFC_TS10_AddTS4Prob VFC_TS10_AddTS4Quality VFC_TS10_AddTS4VMS VFC_TS10_AddTS5Class VFC_TS10_AddTS5Prob VFC_TS10_AddTS5Quality VFC_TS10_AddTS5VMS VFC_TS10_AddTS6Class VFC_TS10_AddTS6Prob VFC_TS10_AddTS6Quality VFC_TS10_AddTS6VMS;
SIG_GROUP_ 249 SG_VFC_TrafficSign11 1 : VFC_TS11_CRC VFC_TS11_AliveCtr VFC_TS11_ProtBlockCtr VFC_TS11_ProtOrderIndex VFC_TS11_ID VFC_TS11_Class VFC_TS11_TSProb VFC_TS11_Dx VFC_TS11_Dy VFC_TS11_Dz VFC_TS11_DxStdDev VFC_TS11_DyStdDev VFC_TS11_DzStdDev VFC_TS11_Width VFC_TS11_Height VFC_TS11_EmbedFlag VFC_TS11_Quality VFC_TS11_VMS VFC_TS11_Stable VFC_TS11_VehicleSticker VFC_TS11_InternalTrack VFC_TS11_ValidLanes VFC_TS11_ValidDay VFC_TS11_ValidTimeRange1Start VFC_TS11_ValidTimeRange1End VFC_TS11_ValidTimeRange2Start VFC_TS11_ValidTimeRange2End VFC_TS11_ValidInDist VFC_TS11_ValidDist VFC_TS11_AddTSCount VFC_TS11_AddTS1Class VFC_TS11_AddTS1Prob VFC_TS11_AddTS1Quality VFC_TS11_AddTS1VMS VFC_TS11_AddTS2Class VFC_TS11_AddTS2Prob VFC_TS11_AddTS2Quality VFC_TS11_AddTS2VMS VFC_TS11_AddTS3Class VFC_TS11_AddTS3Prob VFC_TS11_AddTS3Quality VFC_TS11_AddTS3VMS VFC_TS11_AddTS4Class VFC_TS11_AddTS4Prob VFC_TS11_AddTS4Quality VFC_TS11_AddTS4VMS VFC_TS11_AddTS5Class VFC_TS11_AddTS5Prob VFC_TS11_AddTS5Quality VFC_TS11_AddTS5VMS VFC_TS11_AddTS6Class VFC_TS11_AddTS6Prob VFC_TS11_AddTS6Quality VFC_TS11_AddTS6VMS;
SIG_GROUP_ 250 SG_VFC_TrafficSign12 1 : VFC_TS12_CRC VFC_TS12_AliveCtr VFC_TS12_ProtBlockCtr VFC_TS12_ProtOrderIndex VFC_TS12_ID VFC_TS12_Class VFC_TS12_TSProb VFC_TS12_Dx VFC_TS12_Dy VFC_TS12_Dz VFC_TS12_DxStdDev VFC_TS12_DyStdDev VFC_TS12_DzStdDev VFC_TS12_Width VFC_TS12_Height VFC_TS12_EmbedFlag VFC_TS12_Quality VFC_TS12_VMS VFC_TS12_Stable VFC_TS12_VehicleSticker VFC_TS12_InternalTrack VFC_TS12_ValidLanes VFC_TS12_ValidDay VFC_TS12_ValidTimeRange1Start VFC_TS12_ValidTimeRange1End VFC_TS12_ValidTimeRange2Start VFC_TS12_ValidTimeRange2End VFC_TS12_ValidInDist VFC_TS12_ValidDist VFC_TS12_AddTSCount VFC_TS12_AddTS1Class VFC_TS12_AddTS1Prob VFC_TS12_AddTS1Quality VFC_TS12_AddTS1VMS VFC_TS12_AddTS2Class VFC_TS12_AddTS2Prob VFC_TS12_AddTS2Quality VFC_TS12_AddTS2VMS VFC_TS12_AddTS3Class VFC_TS12_AddTS3Prob VFC_TS12_AddTS3Quality VFC_TS12_AddTS3VMS VFC_TS12_AddTS4Class VFC_TS12_AddTS4Prob VFC_TS12_AddTS4Quality VFC_TS12_AddTS4VMS VFC_TS12_AddTS5Class VFC_TS12_AddTS5Prob VFC_TS12_AddTS5Quality VFC_TS12_AddTS5VMS VFC_TS12_AddTS6Class VFC_TS12_AddTS6Prob VFC_TS12_AddTS6Quality VFC_TS12_AddTS6VMS;
SIG_GROUP_ 251 SG_VFC_TrafficSign13 1 : VFC_TS13_CRC VFC_TS13_AliveCtr VFC_TS13_ProtBlockCtr VFC_TS13_ProtOrderIndex VFC_TS13_ID VFC_TS13_Class VFC_TS13_TSProb VFC_TS13_Dx VFC_TS13_Dy VFC_TS13_Dz VFC_TS13_DxStdDev VFC_TS13_DyStdDev VFC_TS13_DzStdDev VFC_TS13_Width VFC_TS13_Height VFC_TS13_EmbedFlag VFC_TS13_Quality VFC_TS13_VMS VFC_TS13_Stable VFC_TS13_VehicleSticker VFC_TS13_InternalTrack VFC_TS13_ValidLanes VFC_TS13_ValidDay VFC_TS13_ValidTimeRange1Start VFC_TS13_ValidTimeRange1End VFC_TS13_ValidTimeRange2Start VFC_TS13_ValidTimeRange2End VFC_TS13_ValidInDist VFC_TS13_ValidDist VFC_TS13_AddTSCount VFC_TS13_AddTS1Class VFC_TS13_AddTS1Prob VFC_TS13_AddTS1Quality VFC_TS13_AddTS1VMS VFC_TS13_AddTS2Class VFC_TS13_AddTS2Prob VFC_TS13_AddTS2Quality VFC_TS13_AddTS2VMS VFC_TS13_AddTS3Class VFC_TS13_AddTS3Prob VFC_TS13_AddTS3Quality VFC_TS13_AddTS3VMS VFC_TS13_AddTS4Class VFC_TS13_AddTS4Prob VFC_TS13_AddTS4Quality VFC_TS13_AddTS4VMS VFC_TS13_AddTS5Class VFC_TS13_AddTS5Prob VFC_TS13_AddTS5Quality VFC_TS13_AddTS5VMS VFC_TS13_AddTS6Class VFC_TS13_AddTS6Prob VFC_TS13_AddTS6Quality VFC_TS13_AddTS6VMS;
SIG_GROUP_ 252 SG_VFC_TrafficSign14 1 : VFC_TS14_CRC VFC_TS14_AliveCtr VFC_TS14_ProtBlockCtr VFC_TS14_ProtOrderIndex VFC_TS14_ID VFC_TS14_Class VFC_TS14_TSProb VFC_TS14_Dx VFC_TS14_Dy VFC_TS14_Dz VFC_TS14_DxStdDev VFC_TS14_DyStdDev VFC_TS14_DzStdDev VFC_TS14_Width VFC_TS14_Height VFC_TS14_EmbedFlag VFC_TS14_Quality VFC_TS14_VMS VFC_TS14_Stable VFC_TS14_VehicleSticker VFC_TS14_InternalTrack VFC_TS14_ValidLanes VFC_TS14_ValidDay VFC_TS14_ValidTimeRange1Start VFC_TS14_ValidTimeRange1End VFC_TS14_ValidTimeRange2Start VFC_TS14_ValidTimeRange2End VFC_TS14_ValidInDist VFC_TS14_ValidDist VFC_TS14_AddTSCount VFC_TS14_AddTS1Class VFC_TS14_AddTS1Prob VFC_TS14_AddTS1Quality VFC_TS14_AddTS1VMS VFC_TS14_AddTS2Class VFC_TS14_AddTS2Prob VFC_TS14_AddTS2Quality VFC_TS14_AddTS2VMS VFC_TS14_AddTS3Class VFC_TS14_AddTS3Prob VFC_TS14_AddTS3Quality VFC_TS14_AddTS3VMS VFC_TS14_AddTS4Class VFC_TS14_AddTS4Prob VFC_TS14_AddTS4Quality VFC_TS14_AddTS4VMS VFC_TS14_AddTS5Class VFC_TS14_AddTS5Prob VFC_TS14_AddTS5Quality VFC_TS14_AddTS5VMS VFC_TS14_AddTS6Class VFC_TS14_AddTS6Prob VFC_TS14_AddTS6Quality VFC_TS14_AddTS6VMS;
SIG_GROUP_ 253 SG_VFC_TrafficSign15 1 : VFC_TS15_CRC VFC_TS15_AliveCtr VFC_TS15_ProtBlockCtr VFC_TS15_ProtOrderIndex VFC_TS15_ID VFC_TS15_Class VFC_TS15_TSProb VFC_TS15_Dx VFC_TS15_Dy VFC_TS15_Dz VFC_TS15_DxStdDev VFC_TS15_DyStdDev VFC_TS15_DzStdDev VFC_TS15_Width VFC_TS15_Height VFC_TS15_EmbedFlag VFC_TS15_Quality VFC_TS15_VMS VFC_TS15_Stable VFC_TS15_VehicleSticker VFC_TS15_InternalTrack VFC_TS15_ValidLanes VFC_TS15_ValidDay VFC_TS15_ValidTimeRange1Start VFC_TS15_ValidTimeRange1End VFC_TS15_ValidTimeRange2Start VFC_TS15_ValidTimeRange2End VFC_TS15_ValidInDist VFC_TS15_ValidDist VFC_TS15_AddTSCount VFC_TS15_AddTS1Class VFC_TS15_AddTS1Prob VFC_TS15_AddTS1Quality VFC_TS15_AddTS1VMS VFC_TS15_AddTS2Class VFC_TS15_AddTS2Prob VFC_TS15_AddTS2Quality VFC_TS15_AddTS2VMS VFC_TS15_AddTS3Class VFC_TS15_AddTS3Prob VFC_TS15_AddTS3Quality VFC_TS15_AddTS3VMS VFC_TS15_AddTS4Class VFC_TS15_AddTS4Prob VFC_TS15_AddTS4Quality VFC_TS15_AddTS4VMS VFC_TS15_AddTS5Class VFC_TS15_AddTS5Prob VFC_TS15_AddTS5Quality VFC_TS15_AddTS5VMS VFC_TS15_AddTS6Class VFC_TS15_AddTS6Prob VFC_TS15_AddTS6Quality VFC_TS15_AddTS6VMS;
SIG_GROUP_ 260 SG_RFC_LocationHdrA 1 : RFC_LocHdrA_CRC RFC_LocHdrA_AliveCtr RFC_LocHdrA_ProtBlockCtr RFC_LocHdr_IfVersionIdMajor RFC_LocHdr_IfVersionIdMinor RFC_LocHdr_NumValidDetections RFC_LocHdr_TimeStamp RFC_LocHdr_SensorStatus RFC_LocHdr_SensorStatusExt RFC_LocHdr_LocDownSel RFC_LocHdr_TimeStampStatus RFC_LocHdr_BlindnessEvent RFC_LocHdr_SwVersion RFC_LocHdr_SensorOriginPointY RFC_LocHdr_SensorOriginPointX RFC_LocHdr_SensorOriginPointZ RFC_LocHdr_SensorOrientCorrYaw RFC_LocHdr_SensorOrientCorrPitch RFC_LocHdr_SensorOrientYaw RFC_LocHdr_SensorOrientPitch RFC_LocHdr_ModPerfDistanceMax RFC_LocHdr_FovElev00RangeGain RFC_LocHdr_FovElev01RangeGain RFC_LocHdr_FovElev02RangeGain RFC_LocHdr_FovElev03RangeGain RFC_LocHdr_FovElev04RangeGain RFC_LocHdr_FovElev05RangeGain RFC_LocHdr_FovElev06RangeGain RFC_LocHdr_FovElev07RangeGain RFC_LocHdr_FovElev08RangeGain RFC_LocHdr_FovElev09RangeGain RFC_LocHdr_FovElev10RangeGain RFC_LocHdr_FovElevation00 RFC_LocHdr_FovElevation01 RFC_LocHdr_FovElevation02 RFC_LocHdr_FovElevation03 RFC_LocHdr_FovElevation04 RFC_LocHdr_FovElevation05 RFC_LocHdr_FovElevation06 RFC_LocHdr_FovElevation07 RFC_LocHdr_FovElevation08 RFC_LocHdr_FovElevation09 RFC_LocHdr_FovElevation10;
SIG_GROUP_ 261 SG_RFC_LocationHdrB 1 : RFC_LocHdrB_CRC RFC_LocHdrB_AliveCtr RFC_LocHdrB_ProtBlockCtr RFC_LocHdr_FovAzimuth00Range RFC_LocHdr_FovAzimuth01Range RFC_LocHdr_FovAzimuth02Range RFC_LocHdr_FovAzimuth03Range RFC_LocHdr_FovAzimuth04Range RFC_LocHdr_FovAzimuth05Range RFC_LocHdr_FovAzimuth06Range RFC_LocHdr_FovAzimuth07Range RFC_LocHdr_FovAzimuth08Range RFC_LocHdr_FovAzimuth09Range RFC_LocHdr_FovAzimuth10Range RFC_LocHdr_FovAzimuth11Range RFC_LocHdr_FovAzimuth12Range RFC_LocHdr_FovAzimuth13Range RFC_LocHdr_FovAzimuth14Range RFC_LocHdr_FovAzimuth15Range RFC_LocHdr_FovAzimuth16Range RFC_LocHdr_FovAzimuth17Range RFC_LocHdr_FovAzimuth18Range RFC_LocHdr_FovAzimuth19Range RFC_LocHdr_FovAzimuth20Range RFC_LocHdr_FovAzimuth21Range RFC_LocHdr_FovAzimuth22Range RFC_LocHdr_FovAzimuth23Range RFC_LocHdr_FovAzimuth24Range RFC_LocHdr_FovAzimuth00 RFC_LocHdr_FovAzimuth01 RFC_LocHdr_FovAzimuth02 RFC_LocHdr_FovAzimuth03 RFC_LocHdr_FovAzimuth04 RFC_LocHdr_FovAzimuth05 RFC_LocHdr_FovAzimuth06 RFC_LocHdr_FovAzimuth07 RFC_LocHdr_FovAzimuth08 RFC_LocHdr_FovAzimuth09 RFC_LocHdr_FovAzimuth10 RFC_LocHdr_FovAzimuth11 RFC_LocHdr_FovAzimuth12 RFC_LocHdr_FovAzimuth13 RFC_LocHdr_FovAzimuth14 RFC_LocHdr_FovAzimuth15 RFC_LocHdr_FovAzimuth16 RFC_LocHdr_FovAzimuth17 RFC_LocHdr_FovAzimuth18 RFC_LocHdr_FovAzimuth19 RFC_LocHdr_FovAzimuth20 RFC_LocHdr_FovAzimuth21 RFC_LocHdr_FovAzimuth22 RFC_LocHdr_FovAzimuth23 RFC_LocHdr_FovAzimuth24;
SIG_GROUP_ 264 SG_RFC_Location_000_002 1 : RFC_Loc000_002_CRC RFC_Loc000_002_AliveCtr RFC_Loc000_002_ProtBlockCtr RFC_Loc000_RadialDistance RFC_Loc000_RadialVelocity RFC_Loc000_Elevation RFC_Loc000_Azimuth RFC_Loc000_DistVelocityCoVnce RFC_Loc000_RadialDistanceVnce RFC_Loc000_RadialVelocityVnce RFC_Loc000_ElevationVnce RFC_Loc000_AzimuthVnce RFC_Loc000_RadarCrossSection RFC_Loc000_DistVelocityQuality RFC_Loc000_ElevationQuality RFC_Loc000_AzimuthQuality RFC_Loc000_RSSI RFC_Loc000_AzimuthalPartnerId RFC_Loc001_RadialDistance RFC_Loc001_RadialVelocity RFC_Loc001_Elevation RFC_Loc001_Azimuth RFC_Loc001_DistVelocityCoVnce RFC_Loc001_RadialDistanceVnce RFC_Loc001_RadialVelocityVnce RFC_Loc001_ElevationVnce RFC_Loc001_AzimuthVnce RFC_Loc001_RadarCrossSection RFC_Loc001_DistVelocityQuality RFC_Loc001_ElevationQuality RFC_Loc001_AzimuthQuality RFC_Loc001_RSSI RFC_Loc001_AzimuthalPartnerId RFC_Loc002_RadialDistance RFC_Loc002_RadialVelocity RFC_Loc002_Elevation RFC_Loc002_Azimuth RFC_Loc002_DistVelocityCoVnce RFC_Loc002_RadialDistanceVnce RFC_Loc002_RadialVelocityVnce RFC_Loc002_ElevationVnce RFC_Loc002_AzimuthVnce RFC_Loc002_RadarCrossSection RFC_Loc002_DistVelocityQuality RFC_Loc002_ElevationQuality RFC_Loc002_AzimuthQuality RFC_Loc002_RSSI RFC_Loc002_AzimuthalPartnerId;
