VERSION "created by canmatrix"

NS_ :

BS_:

BU_: RadarFrontCenter VideoFrontCenter DASy ReceiveECU

BO_ 236 VFC_TrafficSignHdr: 16 VideoFrontCenter
 SG_ VFC_TSHdr_CRC : 0|16@1+ (1,0) [0|65535] ""  DASy
 SG_ VFC_TSHdr_AliveCtr : 16|8@1+ (1,0) [0|255] ""  DASy
 SG_ VFC_TSHdr_ProtBlockCtr : 24|4@1+ (1,0) [0|15] ""  DASy
 SG_ VFC_TSHdr_ProtTrafficSignCount : 32|5@1+ (1,0) [0|16] ""  DASy
 SG_ VFC_TSHdr_State : 40|3@1+ (1,0) [0|7] ""  DASy
 SG_ VFC_TSHdr_Brightness : 43|3@1+ (1,0) [0|7] ""  DASy
 SG_ VFC_TSHdr_Country : 46|10@1+ (1,0) [0|894] ""  DASy
 SG_ VFC_TSHdr_TimeStampStatus : 56|8@1+ (1,0) [0|255] ""  DASy
 SG_ VFC_TSHdr_TimeStamp : 64|26@1+ (1,0) [0|67108863] "ms"  DASy
 SG_ VFC_TSHdr_CountryMode : 93|3@1+ (1,0) [0|7] ""  DASy

BO_ 238 VFC_TrafficSign00: 48 VideoFrontCenter
 SG_ VFC_TS00_CRC : 0|16@1+ (1,0) [0|65535] ""  DASy
 SG_ VFC_TS00_AliveCtr : 16|8@1+ (1,0) [0|255] ""  DASy
 SG_ VFC_TS00_ProtBlockCtr : 24|4@1+ (1,0) [0|15] ""  DASy
 SG_ VFC_TS00_ProtOrderIndex : 32|4@1+ (1,0) [0|15] ""  DASy
 SG_ VFC_TS00_ID : 40|8@1+ (1,0) [1|255] ""  DASy
 SG_ VFC_TS00_Class : 48|8@1+ (1,0) [0|206] ""  DASy
 SG_ VFC_TS00_TSProb : 56|6@1+ (2,0) [0|100] "%"  DASy
 SG_ VFC_TS00_Dx : 64|9@1+ (0.2,0) [0|102.2] "m"  DASy
 SG_ VFC_TS00_Dy : 80|8@1+ (0.2,-25.6) [-25.6|25.4] "m"  DASy
 SG_ VFC_TS00_Dz : 88|6@1+ (0.2,0) [0|12.6] "m"  DASy
 SG_ VFC_TS00_DxStdDev : 96|8@1+ (0.25,0) [0|63.75] "m"  DASy
 SG_ VFC_TS00_DyStdDev : 104|7@1+ (0.1,0) [0|12.7] "m"  DASy
 SG_ VFC_TS00_DzStdDev : 112|6@1+ (0.1,0) [0|6.3] "m"  DASy
 SG_ VFC_TS00_Width : 120|7@1+ (0.1,0) [0|12.7] "m"  DASy
 SG_ VFC_TS00_Height : 128|6@1+ (0.1,0) [0|6.3] "m"  DASy
 SG_ VFC_TS00_EmbedFlag : 136|3@1+ (1,0) [0|7] ""  DASy
 SG_ VFC_TS00_Quality : 139|1@1+ (1,0) [0|1] ""  DASy
 SG_ VFC_TS00_VMS : 140|1@1+ (1,0) [0|1] ""  DASy
 SG_ VFC_TS00_Stable : 141|1@1+ (1,0) [0|1] ""  DASy
 SG_ VFC_TS00_VehicleSticker : 142|1@1+ (1,0) [0|1] ""  DASy
 SG_ VFC_TS00_InternalTrack : 143|1@1+ (1,0) [0|1] ""  DASy
 SG_ VFC_TS00_ValidLanes : 144|5@1+ (1,0) [0|31] ""  DASy
 SG_ VFC_TS00_ValidDay : 152|7@1+ (1,0) [0|127] ""  DASy
 SG_ VFC_TS00_ValidTimeRange1Start : 160|7@1+ (15,0) [0|1440] "min"  DASy
 SG_ VFC_TS00_ValidTimeRange1End : 168|7@1+ (15,0) [0|1440] "min"  DASy
 SG_ VFC_TS00_ValidTimeRange2Start : 176|7@1+ (15,0) [0|1440] "min"  DASy
 SG_ VFC_TS00_ValidTimeRange2End : 184|7@1+ (15,0) [0|1440] "min"  DASy
 SG_ VFC_TS00_ValidInDist : 192|10@1+ (10,0) [0|10230] "m"  DASy
 SG_ VFC_TS00_ValidDist : 208|10@1+ (10,0) [0|10230] "m"  DASy
 SG_ VFC_TS00_AddTSCount : 232|3@1+ (1,0) [0|6] ""  DASy
 SG_ VFC_TS00_AddTS1Class : 240|8@1+ (1,0) [0|68] ""  DASy
 SG_ VFC_TS00_AddTS1Prob : 248|6@1+ (2,0) [0|100] "%"  DASy
 SG_ VFC_TS00_AddTS1Quality : 254|1@1+ (1,0) [0|1] ""  DASy
 SG_ VFC_TS00_AddTS1VMS : 255|1@1+ (1,0) [0|1] ""  DASy
 SG_ VFC_TS00_AddTS2Class : 256|8@1+ (1,0) [0|68] ""  DASy
 SG_ VFC_TS00_AddTS2Prob : 264|6@1+ (2,0) [0|100] "%"  DASy
 SG_ VFC_TS00_AddTS2Quality : 270|1@1+ (1,0) [0|1] ""  DASy
 SG_ VFC_TS00_AddTS2VMS : 271|1@1+ (1,0) [0|1] ""  DASy
 SG_ VFC_TS00_AddTS3Class : 272|8@1+ (1,0) [0|68] ""  DASy
 SG_ VFC_TS00_AddTS3Prob : 280|6@1+ (2,0) [0|100] "%"  DASy
 SG_ VFC_TS00_AddTS3Quality : 286|1@1+ (1,0) [0|1] ""  DASy
 SG_ VFC_TS00_AddTS3VMS : 287|1@1+ (1,0) [0|1] ""  DASy
 SG_ VFC_TS00_AddTS4Class : 288|8@1+ (1,0) [0|68] ""  DASy
 SG_ VFC_TS00_AddTS4Prob : 296|6@1+ (2,0) [0|100] "%"  DASy
 SG_ VFC_TS00_AddTS4Quality : 302|1@1+ (1,0) [0|1] ""  DASy
 SG_ VFC_TS00_AddTS4VMS : 303|1@1+ (1,0) [0|1] ""  DASy
 SG_ VFC_TS00_AddTS5Class : 304|8@1+ (1,0) [0|68] ""  DASy
 SG_ VFC_TS00_AddTS5Prob : 312|6@1+ (2,0) [0|100] "%"  DASy
 SG_ VFC_TS00_AddTS5Quality : 318|1@1+ (1,0) [0|1] ""  DASy
 SG_ VFC_TS00_AddTS5VMS : 319|1@1+ (1,0) [0|1] ""  DASy
 SG_ VFC_TS00_AddTS6Class : 320|8@1+ (1,0) [0|68] ""  DASy
 SG_ VFC_TS00_AddTS6Prob : 328|6@1+ (2,0) [0|100] "%"  DASy
 SG_ VFC_TS00_AddTS6Quality : 334|1@1+ (1,0) [0|1] ""  DASy
 SG_ VFC_TS00_AddTS6VMS : 335|1@1+ (1,0) [0|1] ""  DASy

BO_ 239 VFC_TrafficSign01: 48 VideoFrontCenter
 SG_ VFC_TS01_CRC : 0|16@1+ (1,0) [0|65535] ""  DASy
 SG_ VFC_TS01_AliveCtr : 16|8@1+ (1,0) [0|255] ""  DASy
 SG_ VFC_TS01_ProtBlockCtr : 24|4@1+ (1,0) [0|15] ""  DASy
 SG_ VFC_TS01_ProtOrderIndex : 32|4@1+ (1,0) [0|15] ""  DASy
 SG_ VFC_TS01_ID : 40|8@1+ (1,0) [1|255] ""  DASy
 SG_ VFC_TS01_Class : 48|8@1+ (1,0) [0|206] ""  DASy
 SG_ VFC_TS01_TSProb : 56|6@1+ (2,0) [0|100] "%"  DASy
 SG_ VFC_TS01_Dx : 64|9@1+ (0.2,0) [0|102.2] "m"  DASy
 SG_ VFC_TS01_Dy : 80|8@1+ (0.2,-25.6) [-25.6|25.4] "m"  DASy
 SG_ VFC_TS01_Dz : 88|6@1+ (0.2,0) [0|12.6] "m"  DASy
 SG_ VFC_TS01_DxStdDev : 96|8@1+ (0.25,0) [0|63.75] "m"  DASy
 SG_ VFC_TS01_DyStdDev : 104|7@1+ (0.1,0) [0|12.7] "m"  DASy
 SG_ VFC_TS01_DzStdDev : 112|6@1+ (0.1,0) [0|6.3] "m"  DASy
 SG_ VFC_TS01_Width : 120|7@1+ (0.1,0) [0|12.7] "m"  DASy
 SG_ VFC_TS01_Height : 128|6@1+ (0.1,0) [0|6.3] "m"  DASy
 SG_ VFC_TS01_EmbedFlag : 136|3@1+ (1,0) [0|7] ""  DASy
 SG_ VFC_TS01_Quality : 139|1@1+ (1,0) [0|1] ""  DASy
 SG_ VFC_TS01_VMS : 140|1@1+ (1,0) [0|1] ""  DASy
 SG_ VFC_TS01_Stable : 141|1@1+ (1,0) [0|1] ""  DASy
 SG_ VFC_TS01_VehicleSticker : 142|1@1+ (1,0) [0|1] ""  DASy
 SG_ VFC_TS01_InternalTrack : 143|1@1+ (1,0) [0|1] ""  DASy
 SG_ VFC_TS01_ValidLanes : 144|5@1+ (1,0) [0|31] ""  DASy
 SG_ VFC_TS01_ValidDay : 152|7@1+ (1,0) [0|127] ""  DASy
 SG_ VFC_TS01_ValidTimeRange1Start : 160|7@1+ (15,0) [0|1440] "min"  DASy
 SG_ VFC_TS01_ValidTimeRange1End : 168|7@1+ (15,0) [0|1440] "min"  DASy
 SG_ VFC_TS01_ValidTimeRange2Start : 176|7@1+ (15,0) [0|1440] "min"  DASy
 SG_ VFC_TS01_ValidTimeRange2End : 184|7@1+ (15,0) [0|1440] "min"  DASy
 SG_ VFC_TS01_ValidInDist : 192|10@1+ (10,0) [0|10230] "m"  DASy
 SG_ VFC_TS01_ValidDist : 208|10@1+ (10,0) [0|10230] "m"  DASy
 SG_ VFC_TS01_AddTSCount : 232|3@1+ (1,0) [0|6] ""  DASy
 SG_ VFC_TS01_AddTS1Class : 240|8@1+ (1,0) [0|68] ""  DASy
 SG_ VFC_TS01_AddTS1Prob : 248|6@1+ (2,0) [0|100] "%"  DASy
 SG_ VFC_TS01_AddTS1Quality : 254|1@1+ (1,0) [0|1] ""  DASy
 SG_ VFC_TS01_AddTS1VMS : 255|1@1+ (1,0) [0|1] ""  DASy
 SG_ VFC_TS01_AddTS2Class : 256|8@1+ (1,0) [0|68] ""  DASy
 SG_ VFC_TS01_AddTS2Prob : 264|6@1+ (2,0) [0|100] "%"  DASy
 SG_ VFC_TS01_AddTS2Quality : 270|1@1+ (1,0) [0|1] ""  DASy
 SG_ VFC_TS01_AddTS2VMS : 271|1@1+ (1,0) [0|1] ""  DASy
 SG_ VFC_TS01_AddTS3Class : 272|8@1+ (1,0) [0|68] ""  DASy
 SG_ VFC_TS01_AddTS3Prob : 280|6@1+ (2,0) [0|100] "%"  DASy
 SG_ VFC_TS01_AddTS3Quality : 286|1@1+ (1,0) [0|1] ""  DASy
 SG_ VFC_TS01_AddTS3VMS : 287|1@1+ (1,0) [0|1] ""  DASy
 SG_ VFC_TS01_AddTS4Class : 288|8@1+ (1,0) [0|68] ""  DASy
 SG_ VFC_TS01_AddTS4Prob : 296|6@1+ (2,0) [0|100] "%"  DASy
 SG_ VFC_TS01_AddTS4Quality : 302|1@1+ (1,0) [0|1] ""  DASy
 SG_ VFC_TS01_AddTS4VMS : 303|1@1+ (1,0) [0|1] ""  DASy
 SG_ VFC_TS01_AddTS5Class : 304|8@1+ (1,0) [0|68] ""  DASy
 SG_ VFC_TS01_AddTS5Prob : 312|6@1+ (2,0) [0|100] "%"  DASy
 SG_ VFC_TS01_AddTS5Quality : 318|1@1+ (1,0) [0|1] ""  DASy
 SG_ VFC_TS01_AddTS5VMS : 319|1@1+ (1,0) [0|1] ""  DASy
 SG_ VFC_TS01_AddTS6Class : 320|8@1+ (1,0) [0|68] ""  DASy
 SG_ VFC_TS01_AddTS6Prob : 328|6@1+ (2,0) [0|100] "%"  DASy
 SG_ VFC_TS01_AddTS6Quality : 334|1@1+ (1,0) [0|1] ""  DASy
 SG_ VFC_TS01_AddTS6VMS : 335|1@1+ (1,0) [0|1] ""  DASy

BO_ 240 VFC_TrafficSign02: 48 VideoFrontCenter
 SG_ VFC_TS02_CRC : 0|16@1+ (1,0) [0|65535] ""  DASy
 SG_ VFC_TS02_AliveCtr : 16|8@1+ (1,0) [0|255] ""  DASy
 SG_ VFC_TS02_ProtBlockCtr : 24|4@1+ (1,0) [0|15] ""  DASy
 SG_ VFC_TS02_ProtOrderIndex : 32|4@1+ (1,0) [0|15] ""  DASy
 SG_ VFC_TS02_ID : 40|8@1+ (1,0) [1|255] ""  DASy
 SG_ VFC_TS02_Class : 48|8@1+ (1,0) [0|206] ""  DASy
 SG_ VFC_TS02_TSProb : 56|6@1+ (2,0) [0|100] "%"  DASy
 SG_ VFC_TS02_Dx : 64|9@1+ (0.2,0) [0|102.2] "m"  DASy
 SG_ VFC_TS02_Dy : 80|8@1+ (0.2,-25.6) [-25.6|25.4] "m"  DASy
 SG_ VFC_TS02_Dz : 88|6@1+ (0.2,0) [0|12.6] "m"  DASy
 SG_ VFC_TS02_DxStdDev : 96|8@1+ (0.25,0) [0|63.75] "m"  DASy
 SG_ VFC_TS02_DyStdDev : 104|7@1+ (0.1,0) [0|12.7] "m"  DASy
 SG_ VFC_TS02_DzStdDev : 112|6@1+ (0.1,0) [0|6.3] "m"  DASy
 SG_ VFC_TS02_Width : 120|7@1+ (0.1,0) [0|12.7] "m"  DASy
 SG_ VFC_TS02_Height : 128|6@1+ (0.1,0) [0|6.3] "m"  DASy
 SG_ VFC_TS02_EmbedFlag : 136|3@1+ (1,0) [0|7] ""  DASy
 SG_ VFC_TS02_Quality : 139|1@1+ (1,0) [0|1] ""  DASy
 SG_ VFC_TS02_VMS : 140|1@1+ (1,0) [0|1] ""  DASy
 SG_ VFC_TS02_Stable : 141|1@1+ (1,0) [0|1] ""  DASy
 SG_ VFC_TS02_VehicleSticker : 142|1@1+ (1,0) [0|1] ""  DASy
 SG_ VFC_TS02_InternalTrack : 143|1@1+ (1,0) [0|1] ""  DASy
 SG_ VFC_TS02_ValidLanes : 144|5@1+ (1,0) [0|31] ""  DASy
 SG_ VFC_TS02_ValidDay : 152|7@1+ (1,0) [0|127] ""  DASy
 SG_ VFC_TS02_ValidTimeRange1Start : 160|7@1+ (15,0) [0|1440] "min"  DASy
 SG_ VFC_TS02_ValidTimeRange1End : 168|7@1+ (15,0) [0|1440] "min"  DASy
 SG_ VFC_TS02_ValidTimeRange2Start : 176|7@1+ (15,0) [0|1440] "min"  DASy
 SG_ VFC_TS02_ValidTimeRange2End : 184|7@1+ (15,0) [0|1440] "min"  DASy
 SG_ VFC_TS02_ValidInDist : 192|10@1+ (10,0) [0|10230] "m"  DASy
 SG_ VFC_TS02_ValidDist : 208|10@1+ (10,0) [0|10230] "m"  DASy
 SG_ VFC_TS02_AddTSCount : 232|3@1+ (1,0) [0|6] ""  DASy
 SG_ VFC_TS02_AddTS1Class : 240|8@1+ (1,0) [0|68] ""  DASy
 SG_ VFC_TS02_AddTS1Prob : 248|6@1+ (2,0) [0|100] "%"  DASy
 SG_ VFC_TS02_AddTS1Quality : 254|1@1+ (1,0) [0|1] ""  DASy
 SG_ VFC_TS02_AddTS1VMS : 255|1@1+ (1,0) [0|1] ""  DASy
 SG_ VFC_TS02_AddTS2Class : 256|8@1+ (1,0) [0|68] ""  DASy
 SG_ VFC_TS02_AddTS2Prob : 264|6@1+ (2,0) [0|100] "%"  DASy
 SG_ VFC_TS02_AddTS2Quality : 270|1@1+ (1,0) [0|1] ""  DASy
 SG_ VFC_TS02_AddTS2VMS : 271|1@1+ (1,0) [0|1] ""  DASy
 SG_ VFC_TS02_AddTS3Class : 272|8@1+ (1,0) [0|68] ""  DASy
 SG_ VFC_TS02_AddTS3Prob : 280|6@1+ (2,0) [0|100] "%"  DASy
 SG_ VFC_TS02_AddTS3Quality : 286|1@1+ (1,0) [0|1] ""  DASy
 SG_ VFC_TS02_AddTS3VMS : 287|1@1+ (1,0) [0|1] ""  DASy
 SG_ VFC_TS02_AddTS4Class : 288|8@1+ (1,0) [0|68] ""  DASy
 SG_ VFC_TS02_AddTS4Prob : 296|6@1+ (2,0) [0|100] "%"  DASy
 SG_ VFC_TS02_AddTS4Quality : 302|1@1+ (1,0) [0|1] ""  DASy
 SG_ VFC_TS02_AddTS4VMS : 303|1@1+ (1,0) [0|1] ""  DASy
 SG_ VFC_TS02_AddTS5Class : 304|8@1+ (1,0) [0|68] ""  DASy
 SG_ VFC_TS02_AddTS5Prob : 312|6@1+ (2,0) [0|100] "%"  DASy
 SG_ VFC_TS02_AddTS5Quality : 318|1@1+ (1,0) [0|1] ""  DASy
 SG_ VFC_TS02_AddTS5VMS : 319|1@1+ (1,0) [0|1] ""  DASy
 SG_ VFC_TS02_AddTS6Class : 320|8@1+ (1,0) [0|68] ""  DASy
 SG_ VFC_TS02_AddTS6Prob : 328|6@1+ (2,0) [0|100] "%"  DASy
 SG_ VFC_TS02_AddTS6Quality : 334|1@1+ (1,0) [0|1] ""  DASy
 SG_ VFC_TS02_AddTS6VMS : 335|1@1+ (1,0) [0|1] ""  DASy

BO_ 241 VFC_TrafficSign03: 48 VideoFrontCenter
 SG_ VFC_TS03_CRC : 0|16@1+ (1,0) [0|65535] ""  DASy
 SG_ VFC_TS03_AliveCtr : 16|8@1+ (1,0) [0|255] ""  DASy
 SG_ VFC_TS03_ProtBlockCtr : 24|4@1+ (1,0) [0|15] ""  DASy
 SG_ VFC_TS03_ProtOrderIndex : 32|4@1+ (1,0) [0|15] ""  DASy
 SG_ VFC_TS03_ID : 40|8@1+ (1,0) [1|255] ""  DASy
 SG_ VFC_TS03_Class : 48|8@1+ (1,0) [0|206] ""  DASy
 SG_ VFC_TS03_TSProb : 56|6@1+ (2,0) [0|100] "%"  DASy
 SG_ VFC_TS03_Dx : 64|9@1+ (0.2,0) [0|102.2] "m"  DASy
 SG_ VFC_TS03_Dy : 80|8@1+ (0.2,-25.6) [-25.6|25.4] "m"  DASy
 SG_ VFC_TS03_Dz : 88|6@1+ (0.2,0) [0|12.6] "m"  DASy
 SG_ VFC_TS03_DxStdDev : 96|8@1+ (0.25,0) [0|63.75] "m"  DASy
 SG_ VFC_TS03_DyStdDev : 104|7@1+ (0.1,0) [0|12.7] "m"  DASy
 SG_ VFC_TS03_DzStdDev : 112|6@1+ (0.1,0) [0|6.3] "m"  DASy
 SG_ VFC_TS03_Width : 120|7@1+ (0.1,0) [0|12.7] "m"  DASy
 SG_ VFC_TS03_Height : 128|6@1+ (0.1,0) [0|6.3] "m"  DASy
 SG_ VFC_TS03_EmbedFlag : 136|3@1+ (1,0) [0|7] ""  DASy
 SG_ VFC_TS03_Quality : 139|1@1+ (1,0) [0|1] ""  DASy
 SG_ VFC_TS03_VMS : 140|1@1+ (1,0) [0|1] ""  DASy
 SG_ VFC_TS03_Stable : 141|1@1+ (1,0) [0|1] ""  DASy
 SG_ VFC_TS03_VehicleSticker : 142|1@1+ (1,0) [0|1] ""  DASy
 SG_ VFC_TS03_InternalTrack : 143|1@1+ (1,0) [0|1] ""  DASy
 SG_ VFC_TS03_ValidLanes : 144|5@1+ (1,0) [0|31] ""  DASy
 SG_ VFC_TS03_ValidDay : 152|7@1+ (1,0) [0|127] ""  DASy
 SG_ VFC_TS03_ValidTimeRange1Start : 160|7@1+ (15,0) [0|1440] "min"  DASy
 SG_ VFC_TS03_ValidTimeRange1End : 168|7@1+ (15,0) [0|1440] "min"  DASy
 SG_ VFC_TS03_ValidTimeRange2Start : 176|7@1+ (15,0) [0|1440] "min"  DASy
 SG_ VFC_TS03_ValidTimeRange2End : 184|7@1+ (15,0) [0|1440] "min"  DASy
 SG_ VFC_TS03_ValidInDist : 192|10@1+ (10,0) [0|10230] "m"  DASy
 SG_ VFC_TS03_ValidDist : 208|10@1+ (10,0) [0|10230] "m"  DASy
 SG_ VFC_TS03_AddTSCount : 232|3@1+ (1,0) [0|6] ""  DASy
 SG_ VFC_TS03_AddTS1Class : 240|8@1+ (1,0) [0|68] ""  DASy
 SG_ VFC_TS03_AddTS1Prob : 248|6@1+ (2,0) [0|100] "%"  DASy
 SG_ VFC_TS03_AddTS1Quality : 254|1@1+ (1,0) [0|1] ""  DASy
 SG_ VFC_TS03_AddTS1VMS : 255|1@1+ (1,0) [0|1] ""  DASy
 SG_ VFC_TS03_AddTS2Class : 256|8@1+ (1,0) [0|68] ""  DASy
 SG_ VFC_TS03_AddTS2Prob : 264|6@1+ (2,0) [0|100] "%"  DASy
 SG_ VFC_TS03_AddTS2Quality : 270|1@1+ (1,0) [0|1] ""  DASy
 SG_ VFC_TS03_AddTS2VMS : 271|1@1+ (1,0) [0|1] ""  DASy
 SG_ VFC_TS03_AddTS3Class : 272|8@1+ (1,0) [0|68] ""  DASy
 SG_ VFC_TS03_AddTS3Prob : 280|6@1+ (2,0) [0|100] "%"  DASy
 SG_ VFC_TS03_AddTS3Quality : 286|1@1+ (1,0) [0|1] ""  DASy
 SG_ VFC_TS03_AddTS3VMS : 287|1@1+ (1,0) [0|1] ""  DASy
 SG_ VFC_TS03_AddTS4Class : 288|8@1+ (1,0) [0|68] ""  DASy
 SG_ VFC_TS03_AddTS4Prob : 296|6@1+ (2,0) [0|100] "%"  DASy
 SG_ VFC_TS03_AddTS4Quality : 302|1@1+ (1,0) [0|1] ""  DASy
 SG_ VFC_TS03_AddTS4VMS : 303|1@1+ (1,0) [0|1] ""  DASy
 SG_ VFC_TS03_AddTS5Class : 304|8@1+ (1,0) [0|68] ""  DASy
 SG_ VFC_TS03_AddTS5Prob : 312|6@1+ (2,0) [0|100] "%"  DASy
 SG_ VFC_TS03_AddTS5Quality : 318|1@1+ (1,0) [0|1] ""  DASy
 SG_ VFC_TS03_AddTS5VMS : 319|1@1+ (1,0) [0|1] ""  DASy
 SG_ VFC_TS03_AddTS6Class : 320|8@1+ (1,0) [0|68] ""  DASy
 SG_ VFC_TS03_AddTS6Prob : 328|6@1+ (2,0) [0|100] "%"  DASy
 SG_ VFC_TS03_AddTS6Quality : 334|1@1+ (1,0) [0|1] ""  DASy
 SG_ VFC_TS03_AddTS6VMS : 335|1@1+ (1,0) [0|1] ""  DASy

BO_ 242 VFC_TrafficSign04: 48 VideoFrontCenter
 SG_ VFC_TS04_CRC : 0|16@1+ (1,0) [0|65535] ""  DASy
 SG_ VFC_TS04_AliveCtr : 16|8@1+ (1,0) [0|255] ""  DASy
 SG_ VFC_TS04_ProtBlockCtr : 24|4@1+ (1,0) [0|15] ""  DASy
 SG_ VFC_TS04_ProtOrderIndex : 32|4@1+ (1,0) [0|15] ""  DASy
 SG_ VFC_TS04_ID : 40|8@1+ (1,0) [1|255] ""  DASy
 SG_ VFC_TS04_Class : 48|8@1+ (1,0) [0|206] ""  DASy
 SG_ VFC_TS04_TSProb : 56|6@1+ (2,0) [0|100] "%"  DASy
 SG_ VFC_TS04_Dx : 64|9@1+ (0.2,0) [0|102.2] "m"  DASy
 SG_ VFC_TS04_Dy : 80|8@1+ (0.2,-25.6) [-25.6|25.4] "m"  DASy
 SG_ VFC_TS04_Dz : 88|6@1+ (0.2,0) [0|12.6] "m"  DASy
 SG_ VFC_TS04_DxStdDev : 96|8@1+ (0.25,0) [0|63.75] "m"  DASy
 SG_ VFC_TS04_DyStdDev : 104|7@1+ (0.1,0) [0|12.7] "m"  DASy
 SG_ VFC_TS04_DzStdDev : 112|6@1+ (0.1,0) [0|6.3] "m"  DASy
 SG_ VFC_TS04_Width : 120|7@1+ (0.1,0) [0|12.7] "m"  DASy
 SG_ VFC_TS04_Height : 128|6@1+ (0.1,0) [0|6.3] "m"  DASy
 SG_ VFC_TS04_EmbedFlag : 136|3@1+ (1,0) [0|7] ""  DASy
 SG_ VFC_TS04_Quality : 139|1@1+ (1,0) [0|1] ""  DASy
 SG_ VFC_TS04_VMS : 140|1@1+ (1,0) [0|1] ""  DASy
 SG_ VFC_TS04_Stable : 141|1@1+ (1,0) [0|1] ""  DASy
 SG_ VFC_TS04_VehicleSticker : 142|1@1+ (1,0) [0|1] ""  DASy
 SG_ VFC_TS04_InternalTrack : 143|1@1+ (1,0) [0|1] ""  DASy
 SG_ VFC_TS04_ValidLanes : 144|5@1+ (1,0) [0|31] ""  DASy
 SG_ VFC_TS04_ValidDay : 152|7@1+ (1,0) [0|127] ""  DASy
 SG_ VFC_TS04_ValidTimeRange1Start : 160|7@1+ (15,0) [0|1440] "min"  DASy
 SG_ VFC_TS04_ValidTimeRange1End : 168|7@1+ (15,0) [0|1440] "min"  DASy
 SG_ VFC_TS04_ValidTimeRange2Start : 176|7@1+ (15,0) [0|1440] "min"  DASy
 SG_ VFC_TS04_ValidTimeRange2End : 184|7@1+ (15,0) [0|1440] "min"  DASy
 SG_ VFC_TS04_ValidInDist : 192|10@1+ (10,0) [0|10230] "m"  DASy
 SG_ VFC_TS04_ValidDist : 208|10@1+ (10,0) [0|10230] "m"  DASy
 SG_ VFC_TS04_AddTSCount : 232|3@1+ (1,0) [0|6] ""  DASy
 SG_ VFC_TS04_AddTS1Class : 240|8@1+ (1,0) [0|68] ""  DASy
 SG_ VFC_TS04_AddTS1Prob : 248|6@1+ (2,0) [0|100] "%"  DASy
 SG_ VFC_TS04_AddTS1Quality : 254|1@1+ (1,0) [0|1] ""  DASy
 SG_ VFC_TS04_AddTS1VMS : 255|1@1+ (1,0) [0|1] ""  DASy
 SG_ VFC_TS04_AddTS2Class : 256|8@1+ (1,0) [0|68] ""  DASy
 SG_ VFC_TS04_AddTS2Prob : 264|6@1+ (2,0) [0|100] "%"  DASy
 SG_ VFC_TS04_AddTS2Quality : 270|1@1+ (1,0) [0|1] ""  DASy
 SG_ VFC_TS04_AddTS2VMS : 271|1@1+ (1,0) [0|1] ""  DASy
 SG_ VFC_TS04_AddTS3Class : 272|8@1+ (1,0) [0|68] ""  DASy
 SG_ VFC_TS04_AddTS3Prob : 280|6@1+ (2,0) [0|100] "%"  DASy
 SG_ VFC_TS04_AddTS3Quality : 286|1@1+ (1,0) [0|1] ""  DASy
 SG_ VFC_TS04_AddTS3VMS : 287|1@1+ (1,0) [0|1] ""  DASy
 SG_ VFC_TS04_AddTS4Class : 288|8@1+ (1,0) [0|68] ""  DASy
 SG_ VFC_TS04_AddTS4Prob : 296|6@1+ (2,0) [0|100] "%"  DASy
 SG_ VFC_TS04_AddTS4Quality : 302|1@1+ (1,0) [0|1] ""  DASy
 SG_ VFC_TS04_AddTS4VMS : 303|1@1+ (1,0) [0|1] ""  DASy
 SG_ VFC_TS04_AddTS5Class : 304|8@1+ (1,0) [0|68] ""  DASy
 SG_ VFC_TS04_AddTS5Prob : 312|6@1+ (2,0) [0|100] "%"  DASy
 SG_ VFC_TS04_AddTS5Quality : 318|1@1+ (1,0) [0|1] ""  DASy
 SG_ VFC_TS04_AddTS5VMS : 319|1@1+ (1,0) [0|1] ""  DASy
 SG_ VFC_TS04_AddTS6Class : 320|8@1+ (1,0) [0|68] ""  DASy
 SG_ VFC_TS04_AddTS6Prob : 328|6@1+ (2,0) [0|100] "%"  DASy
 SG_ VFC_TS04_AddTS6Quality : 334|1@1+ (1,0) [0|1] ""  DASy
 SG_ VFC_TS04_AddTS6VMS : 335|1@1+ (1,0) [0|1] ""  DASy

BO_ 243 VFC_TrafficSign05: 48 VideoFrontCenter
 SG_ VFC_TS05_CRC : 0|16@1+ (1,0) [0|65535] ""  DASy
 SG_ VFC_TS05_AliveCtr : 16|8@1+ (1,0) [0|255] ""  DASy
 SG_ VFC_TS05_ProtBlockCtr : 24|4@1+ (1,0) [0|15] ""  DASy
 SG_ VFC_TS05_ProtOrderIndex : 32|4@1+ (1,0) [0|15] ""  DASy
 SG_ VFC_TS05_ID : 40|8@1+ (1,0) [1|255] ""  DASy
 SG_ VFC_TS05_Class : 48|8@1+ (1,0) [0|206] ""  DASy
 SG_ VFC_TS05_TSProb : 56|6@1+ (2,0) [0|100] "%"  DASy
 SG_ VFC_TS05_Dx : 64|9@1+ (0.2,0) [0|102.2] "m"  DASy
 SG_ VFC_TS05_Dy : 80|8@1+ (0.2,-25.6) [-25.6|25.4] "m"  DASy
 SG_ VFC_TS05_Dz : 88|6@1+ (0.2,0) [0|12.6] "m"  DASy
 SG_ VFC_TS05_DxStdDev : 96|8@1+ (0.25,0) [0|63.75] "m"  DASy
 SG_ VFC_TS05_DyStdDev : 104|7@1+ (0.1,0) [0|12.7] "m"  DASy
 SG_ VFC_TS05_DzStdDev : 112|6@1+ (0.1,0) [0|6.3] "m"  DASy
 SG_ VFC_TS05_Width : 120|7@1+ (0.1,0) [0|12.7] "m"  DASy
 SG_ VFC_TS05_Height : 128|6@1+ (0.1,0) [0|6.3] "m"  DASy
 SG_ VFC_TS05_EmbedFlag : 136|3@1+ (1,0) [0|7] ""  DASy
 SG_ VFC_TS05_Quality : 139|1@1+ (1,0) [0|1] ""  DASy
 SG_ VFC_TS05_VMS : 140|1@1+ (1,0) [0|1] ""  DASy
 SG_ VFC_TS05_Stable : 141|1@1+ (1,0) [0|1] ""  DASy
 SG_ VFC_TS05_VehicleSticker : 142|1@1+ (1,0) [0|1] ""  DASy
 SG_ VFC_TS05_InternalTrack : 143|1@1+ (1,0) [0|1] ""  DASy
 SG_ VFC_TS05_ValidLanes : 144|5@1+ (1,0) [0|31] ""  DASy
 SG_ VFC_TS05_ValidDay : 152|7@1+ (1,0) [0|127] ""  DASy
 SG_ VFC_TS05_ValidTimeRange1Start : 160|7@1+ (15,0) [0|1440] "min"  DASy
 SG_ VFC_TS05_ValidTimeRange1End : 168|7@1+ (15,0) [0|1440] "min"  DASy
 SG_ VFC_TS05_ValidTimeRange2Start : 176|7@1+ (15,0) [0|1440] "min"  DASy
 SG_ VFC_TS05_ValidTimeRange2End : 184|7@1+ (15,0) [0|1440] "min"  DASy
 SG_ VFC_TS05_ValidInDist : 192|10@1+ (10,0) [0|10230] "m"  DASy
 SG_ VFC_TS05_ValidDist : 208|10@1+ (10,0) [0|10230] "m"  DASy
 SG_ VFC_TS05_AddTSCount : 232|3@1+ (1,0) [0|6] ""  DASy
 SG_ VFC_TS05_AddTS1Class : 240|8@1+ (1,0) [0|68] ""  DASy
 SG_ VFC_TS05_AddTS1Prob : 248|6@1+ (2,0) [0|100] "%"  DASy
 SG_ VFC_TS05_AddTS1Quality : 254|1@1+ (1,0) [0|1] ""  DASy
 SG_ VFC_TS05_AddTS1VMS : 255|1@1+ (1,0) [0|1] ""  DASy
 SG_ VFC_TS05_AddTS2Class : 256|8@1+ (1,0) [0|68] ""  DASy
 SG_ VFC_TS05_AddTS2Prob : 264|6@1+ (2,0) [0|100] "%"  DASy
 SG_ VFC_TS05_AddTS2Quality : 270|1@1+ (1,0) [0|1] ""  DASy
 SG_ VFC_TS05_AddTS2VMS : 271|1@1+ (1,0) [0|1] ""  DASy
 SG_ VFC_TS05_AddTS3Class : 272|8@1+ (1,0) [0|68] ""  DASy
 SG_ VFC_TS05_AddTS3Prob : 280|6@1+ (2,0) [0|100] "%"  DASy
 SG_ VFC_TS05_AddTS3Quality : 286|1@1+ (1,0) [0|1] ""  DASy
 SG_ VFC_TS05_AddTS3VMS : 287|1@1+ (1,0) [0|1] ""  DASy
 SG_ VFC_TS05_AddTS4Class : 288|8@1+ (1,0) [0|68] ""  DASy
 SG_ VFC_TS05_AddTS4Prob : 296|6@1+ (2,0) [0|100] "%"  DASy
 SG_ VFC_TS05_AddTS4Quality : 302|1@1+ (1,0) [0|1] ""  DASy
 SG_ VFC_TS05_AddTS4VMS : 303|1@1+ (1,0) [0|1] ""  DASy
 SG_ VFC_TS05_AddTS5Class : 304|8@1+ (1,0) [0|68] ""  DASy
 SG_ VFC_TS05_AddTS5Prob : 312|6@1+ (2,0) [0|100] "%"  DASy
 SG_ VFC_TS05_AddTS5Quality : 318|1@1+ (1,0) [0|1] ""  DASy
 SG_ VFC_TS05_AddTS5VMS : 319|1@1+ (1,0) [0|1] ""  DASy
 SG_ VFC_TS05_AddTS6Class : 320|8@1+ (1,0) [0|68] ""  DASy
 SG_ VFC_TS05_AddTS6Prob : 328|6@1+ (2,0) [0|100] "%"  DASy
 SG_ VFC_TS05_AddTS6Quality : 334|1@1+ (1,0) [0|1] ""  DASy
 SG_ VFC_TS05_AddTS6VMS : 335|1@1+ (1,0) [0|1] ""  DASy

BO_ 244 VFC_TrafficSign06: 48 VideoFrontCenter
 SG_ VFC_TS06_CRC : 0|16@1+ (1,0) [0|65535] ""  DASy
 SG_ VFC_TS06_AliveCtr : 16|8@1+ (1,0) [0|255] ""  DASy
 SG_ VFC_TS06_ProtBlockCtr : 24|4@1+ (1,0) [0|15] ""  DASy
 SG_ VFC_TS06_ProtOrderIndex : 32|4@1+ (1,0) [0|15] ""  DASy
 SG_ VFC_TS06_ID : 40|8@1+ (1,0) [1|255] ""  DASy
 SG_ VFC_TS06_Class : 48|8@1+ (1,0) [0|206] ""  DASy
 SG_ VFC_TS06_TSProb : 56|6@1+ (2,0) [0|100] "%"  DASy
 SG_ VFC_TS06_Dx : 64|9@1+ (0.2,0) [0|102.2] "m"  DASy
 SG_ VFC_TS06_Dy : 80|8@1+ (0.2,-25.6) [-25.6|25.4] "m"  DASy
 SG_ VFC_TS06_Dz : 88|6@1+ (0.2,0) [0|12.6] "m"  DASy
 SG_ VFC_TS06_DxStdDev : 96|8@1+ (0.25,0) [0|63.75] "m"  DASy
 SG_ VFC_TS06_DyStdDev : 104|7@1+ (0.1,0) [0|12.7] "m"  DASy
 SG_ VFC_TS06_DzStdDev : 112|6@1+ (0.1,0) [0|6.3] "m"  DASy
 SG_ VFC_TS06_Width : 120|7@1+ (0.1,0) [0|12.7] "m"  DASy
 SG_ VFC_TS06_Height : 128|6@1+ (0.1,0) [0|6.3] "m"  DASy
 SG_ VFC_TS06_EmbedFlag : 136|3@1+ (1,0) [0|7] ""  DASy
 SG_ VFC_TS06_Quality : 139|1@1+ (1,0) [0|1] ""  DASy
 SG_ VFC_TS06_VMS : 140|1@1+ (1,0) [0|1] ""  DASy
 SG_ VFC_TS06_Stable : 141|1@1+ (1,0) [0|1] ""  DASy
 SG_ VFC_TS06_VehicleSticker : 142|1@1+ (1,0) [0|1] ""  DASy
 SG_ VFC_TS06_InternalTrack : 143|1@1+ (1,0) [0|1] ""  DASy
 SG_ VFC_TS06_ValidLanes : 144|5@1+ (1,0) [0|31] ""  DASy
 SG_ VFC_TS06_ValidDay : 152|7@1+ (1,0) [0|127] ""  DASy
 SG_ VFC_TS06_ValidTimeRange1Start : 160|7@1+ (15,0) [0|1440] "min"  DASy
 SG_ VFC_TS06_ValidTimeRange1End : 168|7@1+ (15,0) [0|1440] "min"  DASy
 SG_ VFC_TS06_ValidTimeRange2Start : 176|7@1+ (15,0) [0|1440] "min"  DASy
 SG_ VFC_TS06_ValidTimeRange2End : 184|7@1+ (15,0) [0|1440] "min"  DASy
 SG_ VFC_TS06_ValidInDist : 192|10@1+ (10,0) [0|10230] "m"  DASy
 SG_ VFC_TS06_ValidDist : 208|10@1+ (10,0) [0|10230] "m"  DASy
 SG_ VFC_TS06_AddTSCount : 232|3@1+ (1,0) [0|6] ""  DASy
 SG_ VFC_TS06_AddTS1Class : 240|8@1+ (1,0) [0|68] ""  DASy
 SG_ VFC_TS06_AddTS1Prob : 248|6@1+ (2,0) [0|100] "%"  DASy
 SG_ VFC_TS06_AddTS1Quality : 254|1@1+ (1,0) [0|1] ""  DASy
 SG_ VFC_TS06_AddTS1VMS : 255|1@1+ (1,0) [0|1] ""  DASy
 SG_ VFC_TS06_AddTS2Class : 256|8@1+ (1,0) [0|68] ""  DASy
 SG_ VFC_TS06_AddTS2Prob : 264|6@1+ (2,0) [0|100] "%"  DASy
 SG_ VFC_TS06_AddTS2Quality : 270|1@1+ (1,0) [0|1] ""  DASy
 SG_ VFC_TS06_AddTS2VMS : 271|1@1+ (1,0) [0|1] ""  DASy
 SG_ VFC_TS06_AddTS3Class : 272|8@1+ (1,0) [0|68] ""  DASy
 SG_ VFC_TS06_AddTS3Prob : 280|6@1+ (2,0) [0|100] "%"  DASy
 SG_ VFC_TS06_AddTS3Quality : 286|1@1+ (1,0) [0|1] ""  DASy
 SG_ VFC_TS06_AddTS3VMS : 287|1@1+ (1,0) [0|1] ""  DASy
 SG_ VFC_TS06_AddTS4Class : 288|8@1+ (1,0) [0|68] ""  DASy
 SG_ VFC_TS06_AddTS4Prob : 296|6@1+ (2,0) [0|100] "%"  DASy
 SG_ VFC_TS06_AddTS4Quality : 302|1@1+ (1,0) [0|1] ""  DASy
 SG_ VFC_TS06_AddTS4VMS : 303|1@1+ (1,0) [0|1] ""  DASy
 SG_ VFC_TS06_AddTS5Class : 304|8@1+ (1,0) [0|68] ""  DASy
 SG_ VFC_TS06_AddTS5Prob : 312|6@1+ (2,0) [0|100] "%"  DASy
 SG_ VFC_TS06_AddTS5Quality : 318|1@1+ (1,0) [0|1] ""  DASy
 SG_ VFC_TS06_AddTS5VMS : 319|1@1+ (1,0) [0|1] ""  DASy
 SG_ VFC_TS06_AddTS6Class : 320|8@1+ (1,0) [0|68] ""  DASy
 SG_ VFC_TS06_AddTS6Prob : 328|6@1+ (2,0) [0|100] "%"  DASy
 SG_ VFC_TS06_AddTS6Quality : 334|1@1+ (1,0) [0|1] ""  DASy
 SG_ VFC_TS06_AddTS6VMS : 335|1@1+ (1,0) [0|1] ""  DASy

BO_ 245 VFC_TrafficSign07: 48 VideoFrontCenter
 SG_ VFC_TS07_CRC : 0|16@1+ (1,0) [0|65535] ""  DASy
 SG_ VFC_TS07_AliveCtr : 16|8@1+ (1,0) [0|255] ""  DASy
 SG_ VFC_TS07_ProtBlockCtr : 24|4@1+ (1,0) [0|15] ""  DASy
 SG_ VFC_TS07_ProtOrderIndex : 32|4@1+ (1,0) [0|15] ""  DASy
 SG_ VFC_TS07_ID : 40|8@1+ (1,0) [1|255] ""  DASy
 SG_ VFC_TS07_Class : 48|8@1+ (1,0) [0|206] ""  DASy
 SG_ VFC_TS07_TSProb : 56|6@1+ (2,0) [0|100] "%"  DASy
 SG_ VFC_TS07_Dx : 64|9@1+ (0.2,0) [0|102.2] "m"  DASy
 SG_ VFC_TS07_Dy : 80|8@1+ (0.2,-25.6) [-25.6|25.4] "m"  DASy
 SG_ VFC_TS07_Dz : 88|6@1+ (0.2,0) [0|12.6] "m"  DASy
 SG_ VFC_TS07_DxStdDev : 96|8@1+ (0.25,0) [0|63.75] "m"  DASy
 SG_ VFC_TS07_DyStdDev : 104|7@1+ (0.1,0) [0|12.7] "m"  DASy
 SG_ VFC_TS07_DzStdDev : 112|6@1+ (0.1,0) [0|6.3] "m"  DASy
 SG_ VFC_TS07_Width : 120|7@1+ (0.1,0) [0|12.7] "m"  DASy
 SG_ VFC_TS07_Height : 128|6@1+ (0.1,0) [0|6.3] "m"  DASy
 SG_ VFC_TS07_EmbedFlag : 136|3@1+ (1,0) [0|7] ""  DASy
 SG_ VFC_TS07_Quality : 139|1@1+ (1,0) [0|1] ""  DASy
 SG_ VFC_TS07_VMS : 140|1@1+ (1,0) [0|1] ""  DASy
 SG_ VFC_TS07_Stable : 141|1@1+ (1,0) [0|1] ""  DASy
 SG_ VFC_TS07_VehicleSticker : 142|1@1+ (1,0) [0|1] ""  DASy
 SG_ VFC_TS07_InternalTrack : 143|1@1+ (1,0) [0|1] ""  DASy
 SG_ VFC_TS07_ValidLanes : 144|5@1+ (1,0) [0|31] ""  DASy
 SG_ VFC_TS07_ValidDay : 152|7@1+ (1,0) [0|127] ""  DASy
 SG_ VFC_TS07_ValidTimeRange1Start : 160|7@1+ (15,0) [0|1440] "min"  DASy
 SG_ VFC_TS07_ValidTimeRange1End : 168|7@1+ (15,0) [0|1440] "min"  DASy
 SG_ VFC_TS07_ValidTimeRange2Start : 176|7@1+ (15,0) [0|1440] "min"  DASy
 SG_ VFC_TS07_ValidTimeRange2End : 184|7@1+ (15,0) [0|1440] "min"  DASy
 SG_ VFC_TS07_ValidInDist : 192|10@1+ (10,0) [0|10230] "m"  DASy
 SG_ VFC_TS07_ValidDist : 208|10@1+ (10,0) [0|10230] "m"  DASy
 SG_ VFC_TS07_AddTSCount : 232|3@1+ (1,0) [0|6] ""  DASy
 SG_ VFC_TS07_AddTS1Class : 240|8@1+ (1,0) [0|68] ""  DASy
 SG_ VFC_TS07_AddTS1Prob : 248|6@1+ (2,0) [0|100] "%"  DASy
 SG_ VFC_TS07_AddTS1Quality : 254|1@1+ (1,0) [0|1] ""  DASy
 SG_ VFC_TS07_AddTS1VMS : 255|1@1+ (1,0) [0|1] ""  DASy
 SG_ VFC_TS07_AddTS2Class : 256|8@1+ (1,0) [0|68] ""  DASy
 SG_ VFC_TS07_AddTS2Prob : 264|6@1+ (2,0) [0|100] "%"  DASy
 SG_ VFC_TS07_AddTS2Quality : 270|1@1+ (1,0) [0|1] ""  DASy
 SG_ VFC_TS07_AddTS2VMS : 271|1@1+ (1,0) [0|1] ""  DASy
 SG_ VFC_TS07_AddTS3Class : 272|8@1+ (1,0) [0|68] ""  DASy
 SG_ VFC_TS07_AddTS3Prob : 280|6@1+ (2,0) [0|100] "%"  DASy
 SG_ VFC_TS07_AddTS3Quality : 286|1@1+ (1,0) [0|1] ""  DASy
 SG_ VFC_TS07_AddTS3VMS : 287|1@1+ (1,0) [0|1] ""  DASy
 SG_ VFC_TS07_AddTS4Class : 288|8@1+ (1,0) [0|68] ""  DASy
 SG_ VFC_TS07_AddTS4Prob : 296|6@1+ (2,0) [0|100] "%"  DASy
 SG_ VFC_TS07_AddTS4Quality : 302|1@1+ (1,0) [0|1] ""  DASy
 SG_ VFC_TS07_AddTS4VMS : 303|1@1+ (1,0) [0|1] ""  DASy
 SG_ VFC_TS07_AddTS5Class : 304|8@1+ (1,0) [0|68] ""  DASy
 SG_ VFC_TS07_AddTS5Prob : 312|6@1+ (2,0) [0|100] "%"  DASy
 SG_ VFC_TS07_AddTS5Quality : 318|1@1+ (1,0) [0|1] ""  DASy
 SG_ VFC_TS07_AddTS5VMS : 319|1@1+ (1,0) [0|1] ""  DASy
 SG_ VFC_TS07_AddTS6Class : 320|8@1+ (1,0) [0|68] ""  DASy
 SG_ VFC_TS07_AddTS6Prob : 328|6@1+ (2,0) [0|100] "%"  DASy
 SG_ VFC_TS07_AddTS6Quality : 334|1@1+ (1,0) [0|1] ""  DASy
 SG_ VFC_TS07_AddTS6VMS : 335|1@1+ (1,0) [0|1] ""  DASy

BO_ 246 VFC_TrafficSign08: 48 VideoFrontCenter
 SG_ VFC_TS08_CRC : 0|16@1+ (1,0) [0|65535] ""  DASy
 SG_ VFC_TS08_AliveCtr : 16|8@1+ (1,0) [0|255] ""  DASy
 SG_ VFC_TS08_ProtBlockCtr : 24|4@1+ (1,0) [0|15] ""  DASy
 SG_ VFC_TS08_ProtOrderIndex : 32|4@1+ (1,0) [0|15] ""  DASy
 SG_ VFC_TS08_ID : 40|8@1+ (1,0) [1|255] ""  DASy
 SG_ VFC_TS08_Class : 48|8@1+ (1,0) [0|206] ""  DASy
 SG_ VFC_TS08_TSProb : 56|6@1+ (2,0) [0|100] "%"  DASy
 SG_ VFC_TS08_Dx : 64|9@1+ (0.2,0) [0|102.2] "m"  DASy
 SG_ VFC_TS08_Dy : 80|8@1+ (0.2,-25.6) [-25.6|25.4] "m"  DASy
 SG_ VFC_TS08_Dz : 88|6@1+ (0.2,0) [0|12.6] "m"  DASy
 SG_ VFC_TS08_DxStdDev : 96|8@1+ (0.25,0) [0|63.75] "m"  DASy
 SG_ VFC_TS08_DyStdDev : 104|7@1+ (0.1,0) [0|12.7] "m"  DASy
 SG_ VFC_TS08_DzStdDev : 112|6@1+ (0.1,0) [0|6.3] "m"  DASy
 SG_ VFC_TS08_Width : 120|7@1+ (0.1,0) [0|12.7] "m"  DASy
 SG_ VFC_TS08_Height : 128|6@1+ (0.1,0) [0|6.3] "m"  DASy
 SG_ VFC_TS08_EmbedFlag : 136|3@1+ (1,0) [0|7] ""  DASy
 SG_ VFC_TS08_Quality : 139|1@1+ (1,0) [0|1] ""  DASy
 SG_ VFC_TS08_VMS : 140|1@1+ (1,0) [0|1] ""  DASy
 SG_ VFC_TS08_Stable : 141|1@1+ (1,0) [0|1] ""  DASy
 SG_ VFC_TS08_VehicleSticker : 142|1@1+ (1,0) [0|1] ""  DASy
 SG_ VFC_TS08_InternalTrack : 143|1@1+ (1,0) [0|1] ""  DASy
 SG_ VFC_TS08_ValidLanes : 144|5@1+ (1,0) [0|31] ""  DASy
 SG_ VFC_TS08_ValidDay : 152|7@1+ (1,0) [0|127] ""  DASy
 SG_ VFC_TS08_ValidTimeRange1Start : 160|7@1+ (15,0) [0|1440] "min"  DASy
 SG_ VFC_TS08_ValidTimeRange1End : 168|7@1+ (15,0) [0|1440] "min"  DASy
 SG_ VFC_TS08_ValidTimeRange2Start : 176|7@1+ (15,0) [0|1440] "min"  DASy
 SG_ VFC_TS08_ValidTimeRange2End : 184|7@1+ (15,0) [0|1440] "min"  DASy
 SG_ VFC_TS08_ValidInDist : 192|10@1+ (10,0) [0|10230] "m"  DASy
 SG_ VFC_TS08_ValidDist : 208|10@1+ (10,0) [0|10230] "m"  DASy
 SG_ VFC_TS08_AddTSCount : 232|3@1+ (1,0) [0|6] ""  DASy
 SG_ VFC_TS08_AddTS1Class : 240|8@1+ (1,0) [0|68] ""  DASy
 SG_ VFC_TS08_AddTS1Prob : 248|6@1+ (2,0) [0|100] "%"  DASy
 SG_ VFC_TS08_AddTS1Quality : 254|1@1+ (1,0) [0|1] ""  DASy
 SG_ VFC_TS08_AddTS1VMS : 255|1@1+ (1,0) [0|1] ""  DASy
 SG_ VFC_TS08_AddTS2Class : 256|8@1+ (1,0) [0|68] ""  DASy
 SG_ VFC_TS08_AddTS2Prob : 264|6@1+ (2,0) [0|100] "%"  DASy
 SG_ VFC_TS08_AddTS2Quality : 270|1@1+ (1,0) [0|1] ""  DASy
 SG_ VFC_TS08_AddTS2VMS : 271|1@1+ (1,0) [0|1] ""  DASy
 SG_ VFC_TS08_AddTS3Class : 272|8@1+ (1,0) [0|68] ""  DASy
 SG_ VFC_TS08_AddTS3Prob : 280|6@1+ (2,0) [0|100] "%"  DASy
 SG_ VFC_TS08_AddTS3Quality : 286|1@1+ (1,0) [0|1] ""  DASy
 SG_ VFC_TS08_AddTS3VMS : 287|1@1+ (1,0) [0|1] ""  DASy
 SG_ VFC_TS08_AddTS4Class : 288|8@1+ (1,0) [0|68] ""  DASy
 SG_ VFC_TS08_AddTS4Prob : 296|6@1+ (2,0) [0|100] "%"  DASy
 SG_ VFC_TS08_AddTS4Quality : 302|1@1+ (1,0) [0|1] ""  DASy
 SG_ VFC_TS08_AddTS4VMS : 303|1@1+ (1,0) [0|1] ""  DASy
 SG_ VFC_TS08_AddTS5Class : 304|8@1+ (1,0) [0|68] ""  DASy
 SG_ VFC_TS08_AddTS5Prob : 312|6@1+ (2,0) [0|100] "%"  DASy
 SG_ VFC_TS08_AddTS5Quality : 318|1@1+ (1,0) [0|1] ""  DASy
 SG_ VFC_TS08_AddTS5VMS : 319|1@1+ (1,0) [0|1] ""  DASy
 SG_ VFC_TS08_AddTS6Class : 320|8@1+ (1,0) [0|68] ""  DASy
 SG_ VFC_TS08_AddTS6Prob : 328|6@1+ (2,0) [0|100] "%"  DASy
 SG_ VFC_TS08_AddTS6Quality : 334|1@1+ (1,0) [0|1] ""  DASy
 SG_ VFC_TS08_AddTS6VMS : 335|1@1+ (1,0) [0|1] ""  DASy

CM_ SG_ 236 VFC_TSHdr_CRC "CRC - Autosar E2E Profile 5";
CM_ SG_ 236 VFC_TSHdr_AliveCtr "Alive counter - Autosar E2E Profile 5";
CM_ SG_ 236 VFC_TSHdr_ProtBlockCtr "Protocol-Signal: Block-Counter";
CM_ SG_ 236 VFC_TSHdr_ProtTrafficSignCount "Protocol-Signal: count of all traffic signs";
CM_ SG_ 236 VFC_TSHdr_State "Informs the system of the current state of the traffic sign detection system";
CM_ SG_ 236 VFC_TSHdr_Brightness "The ambient light conditions detected by the camera";
CM_ SG_ 236 VFC_TSHdr_Country "The current country that the vision system is using as ISO 3166 Code";
CM_ SG_ 236 VFC_TSHdr_TimeStampStatus "Autosar StbM_TimeBaseStatusType bitfield with extension:
Bit 0: TIMEOUT
Bit 1: Reserved1
Bit 2: SYNC_TO_GATEWAY
Bit 3: GLOBAL_TIME_BASE
Bit 4: TIMELEAP_FUTURE
Bit 5: TIMELEAP_PAST
Bit 6: Reserved6
Bit 7: Extension: GENERAL_ERROR";
CM_ SG_ 236 VFC_TSHdr_TimeStamp "TimeStamp of Traffic Signs";
CM_ SG_ 236 VFC_TSHdr_CountryMode "Tells the system the current country mode that the system is operating in";
CM_ SG_ 238 VFC_TS00_CRC "CRC - Autosar E2E Profile 5";
CM_ SG_ 238 VFC_TS00_AliveCtr "Alive counter - Autosar E2E Profile 5";
CM_ SG_ 238 VFC_TS00_ProtBlockCtr "Protocol-Signal: Block-Counter";
CM_ SG_ 238 VFC_TS00_ProtOrderIndex "Protocol-Signal: Index to ensure same order in Tx and Rx (Ethernet only)";
CM_ SG_ 238 VFC_TS00_ID "Unique Traffic Sign ID";
CM_ SG_ 238 VFC_TS00_Class "The type of main sign that has been detected by the vision system";
CM_ SG_ 238 VFC_TS00_TSProb "Probability that the sign is a traffic sign";
CM_ SG_ 238 VFC_TS00_Dx "Traffic sign distance in longitudinal direction";
CM_ SG_ 238 VFC_TS00_Dy "Traffic sign distance in lateral direction";
CM_ SG_ 238 VFC_TS00_Dz "Traffic sign distance in vertical direction";
CM_ SG_ 238 VFC_TS00_DxStdDev "Standard deviation of Traffic sign distance in longitudinal direction";
CM_ SG_ 238 VFC_TS00_DyStdDev "Standard deviation of Traffic sign distance in lateral direction";
CM_ SG_ 238 VFC_TS00_DzStdDev "Standard deviation of Traffic sign distance in vertical direction";
CM_ SG_ 238 VFC_TS00_Width "Width of the sign";
CM_ SG_ 238 VFC_TS00_Height "Height of the sign";
CM_ SG_ 238 VFC_TS00_EmbedFlag "Determines whether the sign is embedded or not";
CM_ SG_ 238 VFC_TS00_Quality "A flag that determines the quality of the sign";
CM_ SG_ 238 VFC_TS00_VMS "Variable-message sign: Determines whether the traffic sign is Variable or fixed";
CM_ SG_ 238 VFC_TS00_Stable "Determines whether the object is stable";
CM_ SG_ 238 VFC_TS00_VehicleSticker "Flag which indicates whether the detected traffic sign is a invalid sign on a vehicle or not";
CM_ SG_ 238 VFC_TS00_InternalTrack "Flag which indicates if this sign is an internal track, i.e. an sign hypothesis of low quality";
CM_ SG_ 238 VFC_TS00_ValidLanes "Indicates on which lane the detected sign is valid. Bitfield:
Bit 0: valid on first right hand lane
Bit 1: valid on second right hand lane
Bit 2: valid on third right hand lane
Bit 3: valid on fourth right hand lane
Bit 4: valid on fifth right hand lane";
CM_ SG_ 238 VFC_TS00_ValidDay "The video sensor shall provide the week days for which the main traffic sign is valid. Bitfield:
Bit 0: MONDAY
Bit 1: TUESDAY
Bit 2: WEDNESDAY
Bit 3: THURSDAY
Bit 4: FRIDAY
Bit 5: SATURDAY
Bit 6: SUNDAY";
CM_ SG_ 238 VFC_TS00_ValidTimeRange1Start "Start time for the first time range in which the main traffic sign is valid. Minutes since midnight.";
CM_ SG_ 238 VFC_TS00_ValidTimeRange1End "End time for the first time range in which the main traffic sign is valid. Minutes since midnight.";
CM_ SG_ 238 VFC_TS00_ValidTimeRange2Start "Start time for the first time range in which the main traffic sign is valid. Minutes since midnight.";
CM_ SG_ 238 VFC_TS00_ValidTimeRange2End "End time for the first time range in which the main traffic sign is valid. Minutes since midnight.";
CM_ SG_ 238 VFC_TS00_ValidInDist "Indicates the longitudinal distance in which the validity of the main TSR starts";
CM_ SG_ 238 VFC_TS00_ValidDist "Indicates the longitudinal distance for which the main traffic sign is valid";
CM_ SG_ 238 VFC_TS00_AddTSCount "Number of additional signs attached to the main sign. This can be a minimum of 0 and a maximum of 6.";
CM_ SG_ 238 VFC_TS00_AddTS1Class "The type of additonal sign that has been detected by the vision system";
CM_ SG_ 238 VFC_TS00_AddTS1Prob "Probability that the sign is a traffic sign";
CM_ SG_ 238 VFC_TS00_AddTS1Quality "A flag that determines the quality of the signal";
CM_ SG_ 238 VFC_TS00_AddTS1VMS "Variable-message sign: Determines whether the traffic sign is Variable or fixed";
CM_ SG_ 238 VFC_TS00_AddTS2Class "The type of additonal sign that has been detected by the vision system";
CM_ SG_ 238 VFC_TS00_AddTS2Prob "Probability that the sign is a traffic sign";
CM_ SG_ 238 VFC_TS00_AddTS2Quality "A flag that determines the quality of the signal";
CM_ SG_ 238 VFC_TS00_AddTS2VMS "Variable-message sign: Determines whether the traffic sign is Variable or fixed";
CM_ SG_ 238 VFC_TS00_AddTS3Class "The type of additonal sign that has been detected by the vision system";
CM_ SG_ 238 VFC_TS00_AddTS3Prob "Probability that the sign is a traffic sign";
CM_ SG_ 238 VFC_TS00_AddTS3Quality "A flag that determines the quality of the signal";
CM_ SG_ 238 VFC_TS00_AddTS3VMS "Variable-message sign: Determines whether the traffic sign is Variable or fixed";
CM_ SG_ 238 VFC_TS00_AddTS4Class "The type of additonal sign that has been detected by the vision system";
CM_ SG_ 238 VFC_TS00_AddTS4Prob "Probability that the sign is a traffic sign";
CM_ SG_ 238 VFC_TS00_AddTS4Quality "A flag that determines the quality of the signal";
CM_ SG_ 238 VFC_TS00_AddTS4VMS "Variable-message sign: Determines whether the traffic sign is Variable or fixed";
CM_ SG_ 238 VFC_TS00_AddTS5Class "The type of additonal sign that has been detected by the vision system";
CM_ SG_ 238 VFC_TS00_AddTS5Prob "Probability that the sign is a traffic sign";
CM_ SG_ 238 VFC_TS00_AddTS5Quality "A flag that determines the quality of the signal";
CM_ SG_ 238 VFC_TS00_AddTS5VMS "Variable-message sign: Determines whether the traffic sign is Variable or fixed";
CM_ SG_ 238 VFC_TS00_AddTS6Class "The type of additonal sign that has been detected by the vision system";
CM_ SG_ 238 VFC_TS00_AddTS6Prob "Probability that the sign is a traffic sign";
CM_ SG_ 238 VFC_TS00_AddTS6Quality "A flag that determines the quality of the signal";
CM_ SG_ 238 VFC_TS00_AddTS6VMS "Variable-message sign: Determines whether the traffic sign is Variable or fixed";
CM_ SG_ 239 VFC_TS01_CRC "CRC - Autosar E2E Profile 5";
CM_ SG_ 239 VFC_TS01_AliveCtr "Alive counter - Autosar E2E Profile 5";
CM_ SG_ 239 VFC_TS01_ProtBlockCtr "Protocol-Signal: Block-Counter";
CM_ SG_ 239 VFC_TS01_ProtOrderIndex "Protocol-Signal: Index to ensure same order in Tx and Rx (Ethernet only)";
CM_ SG_ 239 VFC_TS01_ID "Unique Traffic Sign ID";
CM_ SG_ 239 VFC_TS01_Class "The type of main sign that has been detected by the vision system";
CM_ SG_ 239 VFC_TS01_TSProb "Probability that the sign is a traffic sign";
CM_ SG_ 239 VFC_TS01_Dx "Traffic sign distance in longitudinal direction";
CM_ SG_ 239 VFC_TS01_Dy "Traffic sign distance in lateral direction";
CM_ SG_ 239 VFC_TS01_Dz "Traffic sign distance in vertical direction";
CM_ SG_ 239 VFC_TS01_DxStdDev "Standard deviation of Traffic sign distance in longitudinal direction";
CM_ SG_ 239 VFC_TS01_DyStdDev "Standard deviation of Traffic sign distance in lateral direction";
CM_ SG_ 239 VFC_TS01_DzStdDev "Standard deviation of Traffic sign distance in vertical direction";
CM_ SG_ 239 VFC_TS01_Width "Width of the sign";
CM_ SG_ 239 VFC_TS01_Height "Height of the sign";
CM_ SG_ 239 VFC_TS01_EmbedFlag "Determines whether the sign is embedded or not";
CM_ SG_ 239 VFC_TS01_Quality "A flag that determines the quality of the sign";
CM_ SG_ 239 VFC_TS01_VMS "Variable-message sign: Determines whether the traffic sign is Variable or fixed";
CM_ SG_ 239 VFC_TS01_Stable "Determines whether the object is stable";
CM_ SG_ 239 VFC_TS01_VehicleSticker "Flag which indicates whether the detected traffic sign is a invalid sign on a vehicle or not";
CM_ SG_ 239 VFC_TS01_InternalTrack "Flag which indicates if this sign is an internal track, i.e. an sign hypothesis of low quality";
CM_ SG_ 239 VFC_TS01_ValidLanes "Indicates on which lane the detected sign is valid. Bitfield:
Bit 0: valid on first right hand lane
Bit 1: valid on second right hand lane
Bit 2: valid on third right hand lane
Bit 3: valid on fourth right hand lane
Bit 4: valid on fifth right hand lane";
CM_ SG_ 239 VFC_TS01_ValidDay "The video sensor shall provide the week days for which the main traffic sign is valid. Bitfield:
Bit 0: MONDAY
Bit 1: TUESDAY
Bit 2: WEDNESDAY
Bit 3: THURSDAY
Bit 4: FRIDAY
Bit 5: SATURDAY
Bit 6: SUNDAY";
CM_ SG_ 239 VFC_TS01_ValidTimeRange1Start "Start time for the first time range in which the main traffic sign is valid. Minutes since midnight.";
CM_ SG_ 239 VFC_TS01_ValidTimeRange1End "End time for the first time range in which the main traffic sign is valid. Minutes since midnight.";
CM_ SG_ 239 VFC_TS01_ValidTimeRange2Start "Start time for the first time range in which the main traffic sign is valid. Minutes since midnight.";
CM_ SG_ 239 VFC_TS01_ValidTimeRange2End "End time for the first time range in which the main traffic sign is valid. Minutes since midnight.";
CM_ SG_ 239 VFC_TS01_ValidInDist "Indicates the longitudinal distance in which the validity of the main TSR starts";
CM_ SG_ 239 VFC_TS01_ValidDist "Indicates the longitudinal distance for which the main traffic sign is valid";
CM_ SG_ 239 VFC_TS01_AddTSCount "Number of additional signs attached to the main sign. This can be a minimum of 0 and a maximum of 6.";
CM_ SG_ 239 VFC_TS01_AddTS1Class "The type of additonal sign that has been detected by the vision system";
CM_ SG_ 239 VFC_TS01_AddTS1Prob "Probability that the sign is a traffic sign";
CM_ SG_ 239 VFC_TS01_AddTS1Quality "A flag that determines the quality of the signal";
CM_ SG_ 239 VFC_TS01_AddTS1VMS "Variable-message sign: Determines whether the traffic sign is Variable or fixed";
CM_ SG_ 239 VFC_TS01_AddTS2Class "The type of additonal sign that has been detected by the vision system";
CM_ SG_ 239 VFC_TS01_AddTS2Prob "Probability that the sign is a traffic sign";
CM_ SG_ 239 VFC_TS01_AddTS2Quality "A flag that determines the quality of the signal";
CM_ SG_ 239 VFC_TS01_AddTS2VMS "Variable-message sign: Determines whether the traffic sign is Variable or fixed";
CM_ SG_ 239 VFC_TS01_AddTS3Class "The type of additonal sign that has been detected by the vision system";
CM_ SG_ 239 VFC_TS01_AddTS3Prob "Probability that the sign is a traffic sign";
CM_ SG_ 239 VFC_TS01_AddTS3Quality "A flag that determines the quality of the signal";
CM_ SG_ 239 VFC_TS01_AddTS3VMS "Variable-message sign: Determines whether the traffic sign is Variable or fixed";
CM_ SG_ 239 VFC_TS01_AddTS4Class "The type of additonal sign that has been detected by the vision system";
CM_ SG_ 239 VFC_TS01_AddTS4Prob "Probability that the sign is a traffic sign";
CM_ SG_ 239 VFC_TS01_AddTS4Quality "A flag that determines the quality of the signal";
CM_ SG_ 239 VFC_TS01_AddTS4VMS "Variable-message sign: Determines whether the traffic sign is Variable or fixed";
CM_ SG_ 239 VFC_TS01_AddTS5Class "The type of additonal sign that has been detected by the vision system";
CM_ SG_ 239 VFC_TS01_AddTS5Prob "Probability that the sign is a traffic sign";
CM_ SG_ 239 VFC_TS01_AddTS5Quality "A flag that determines the quality of the signal";
CM_ SG_ 239 VFC_TS01_AddTS5VMS "Variable-message sign: Determines whether the traffic sign is Variable or fixed";
CM_ SG_ 239 VFC_TS01_AddTS6Class "The type of additonal sign that has been detected by the vision system";
CM_ SG_ 239 VFC_TS01_AddTS6Prob "Probability that the sign is a traffic sign";
CM_ SG_ 239 VFC_TS01_AddTS6Quality "A flag that determines the quality of the signal";
CM_ SG_ 239 VFC_TS01_AddTS6VMS "Variable-message sign: Determines whether the traffic sign is Variable or fixed";
CM_ SG_ 240 VFC_TS02_CRC "CRC - Autosar E2E Profile 5";
CM_ SG_ 240 VFC_TS02_AliveCtr "Alive counter - Autosar E2E Profile 5";
CM_ SG_ 240 VFC_TS02_ProtBlockCtr "Protocol-Signal: Block-Counter";
CM_ SG_ 240 VFC_TS02_ProtOrderIndex "Protocol-Signal: Index to ensure same order in Tx and Rx (Ethernet only)";
CM_ SG_ 240 VFC_TS02_ID "Unique Traffic Sign ID";
CM_ SG_ 240 VFC_TS02_Class "The type of main sign that has been detected by the vision system";
CM_ SG_ 240 VFC_TS02_TSProb "Probability that the sign is a traffic sign";
CM_ SG_ 240 VFC_TS02_Dx "Traffic sign distance in longitudinal direction";
CM_ SG_ 240 VFC_TS02_Dy "Traffic sign distance in lateral direction";
CM_ SG_ 240 VFC_TS02_Dz "Traffic sign distance in vertical direction";
CM_ SG_ 240 VFC_TS02_DxStdDev "Standard deviation of Traffic sign distance in longitudinal direction";
CM_ SG_ 240 VFC_TS02_DyStdDev "Standard deviation of Traffic sign distance in lateral direction";
CM_ SG_ 240 VFC_TS02_DzStdDev "Standard deviation of Traffic sign distance in vertical direction";
CM_ SG_ 240 VFC_TS02_Width "Width of the sign";
CM_ SG_ 240 VFC_TS02_Height "Height of the sign";
CM_ SG_ 240 VFC_TS02_EmbedFlag "Determines whether the sign is embedded or not";
CM_ SG_ 240 VFC_TS02_Quality "A flag that determines the quality of the sign";
CM_ SG_ 240 VFC_TS02_VMS "Variable-message sign: Determines whether the traffic sign is Variable or fixed";
CM_ SG_ 240 VFC_TS02_Stable "Determines whether the object is stable";
CM_ SG_ 240 VFC_TS02_VehicleSticker "Flag which indicates whether the detected traffic sign is a invalid sign on a vehicle or not";
CM_ SG_ 240 VFC_TS02_InternalTrack "Flag which indicates if this sign is an internal track, i.e. an sign hypothesis of low quality";
CM_ SG_ 240 VFC_TS02_ValidLanes "Indicates on which lane the detected sign is valid. Bitfield:
Bit 0: valid on first right hand lane
Bit 1: valid on second right hand lane
Bit 2: valid on third right hand lane
Bit 3: valid on fourth right hand lane
Bit 4: valid on fifth right hand lane";
CM_ SG_ 240 VFC_TS02_ValidDay "The video sensor shall provide the week days for which the main traffic sign is valid. Bitfield:
Bit 0: MONDAY
Bit 1: TUESDAY
Bit 2: WEDNESDAY
Bit 3: THURSDAY
Bit 4: FRIDAY
Bit 5: SATURDAY
Bit 6: SUNDAY";
CM_ SG_ 240 VFC_TS02_ValidTimeRange1Start "Start time for the first time range in which the main traffic sign is valid. Minutes since midnight.";
CM_ SG_ 240 VFC_TS02_ValidTimeRange1End "End time for the first time range in which the main traffic sign is valid. Minutes since midnight.";
CM_ SG_ 240 VFC_TS02_ValidTimeRange2Start "Start time for the first time range in which the main traffic sign is valid. Minutes since midnight.";
CM_ SG_ 240 VFC_TS02_ValidTimeRange2End "End time for the first time range in which the main traffic sign is valid. Minutes since midnight.";
CM_ SG_ 240 VFC_TS02_ValidInDist "Indicates the longitudinal distance in which the validity of the main TSR starts";
CM_ SG_ 240 VFC_TS02_ValidDist "Indicates the longitudinal distance for which the main traffic sign is valid";
CM_ SG_ 240 VFC_TS02_AddTSCount "Number of additional signs attached to the main sign. This can be a minimum of 0 and a maximum of 6.";
CM_ SG_ 240 VFC_TS02_AddTS1Class "The type of additonal sign that has been detected by the vision system";
CM_ SG_ 240 VFC_TS02_AddTS1Prob "Probability that the sign is a traffic sign";
CM_ SG_ 240 VFC_TS02_AddTS1Quality "A flag that determines the quality of the signal";
CM_ SG_ 240 VFC_TS02_AddTS1VMS "Variable-message sign: Determines whether the traffic sign is Variable or fixed";
CM_ SG_ 240 VFC_TS02_AddTS2Class "The type of additonal sign that has been detected by the vision system";
CM_ SG_ 240 VFC_TS02_AddTS2Prob "Probability that the sign is a traffic sign";
CM_ SG_ 240 VFC_TS02_AddTS2Quality "A flag that determines the quality of the signal";
CM_ SG_ 240 VFC_TS02_AddTS2VMS "Variable-message sign: Determines whether the traffic sign is Variable or fixed";
CM_ SG_ 240 VFC_TS02_AddTS3Class "The type of additonal sign that has been detected by the vision system";
CM_ SG_ 240 VFC_TS02_AddTS3Prob "Probability that the sign is a traffic sign";
CM_ SG_ 240 VFC_TS02_AddTS3Quality "A flag that determines the quality of the signal";
CM_ SG_ 240 VFC_TS02_AddTS3VMS "Variable-message sign: Determines whether the traffic sign is Variable or fixed";
CM_ SG_ 240 VFC_TS02_AddTS4Class "The type of additonal sign that has been detected by the vision system";
CM_ SG_ 240 VFC_TS02_AddTS4Prob "Probability that the sign is a traffic sign";
CM_ SG_ 240 VFC_TS02_AddTS4Quality "A flag that determines the quality of the signal";
CM_ SG_ 240 VFC_TS02_AddTS4VMS "Variable-message sign: Determines whether the traffic sign is Variable or fixed";
CM_ SG_ 240 VFC_TS02_AddTS5Class "The type of additonal sign that has been detected by the vision system";
CM_ SG_ 240 VFC_TS02_AddTS5Prob "Probability that the sign is a traffic sign";
CM_ SG_ 240 VFC_TS02_AddTS5Quality "A flag that determines the quality of the signal";
CM_ SG_ 240 VFC_TS02_AddTS5VMS "Variable-message sign: Determines whether the traffic sign is Variable or fixed";
CM_ SG_ 240 VFC_TS02_AddTS6Class "The type of additonal sign that has been detected by the vision system";
CM_ SG_ 240 VFC_TS02_AddTS6Prob "Probability that the sign is a traffic sign";
CM_ SG_ 240 VFC_TS02_AddTS6Quality "A flag that determines the quality of the signal";
CM_ SG_ 240 VFC_TS02_AddTS6VMS "Variable-message sign: Determines whether the traffic sign is Variable or fixed";
CM_ SG_ 241 VFC_TS03_CRC "CRC - Autosar E2E Profile 5";
CM_ SG_ 241 VFC_TS03_AliveCtr "Alive counter - Autosar E2E Profile 5";
CM_ SG_ 241 VFC_TS03_ProtBlockCtr "Protocol-Signal: Block-Counter";
CM_ SG_ 241 VFC_TS03_ProtOrderIndex "Protocol-Signal: Index to ensure same order in Tx and Rx (Ethernet only)";
CM_ SG_ 241 VFC_TS03_ID "Unique Traffic Sign ID";
CM_ SG_ 241 VFC_TS03_Class "The type of main sign that has been detected by the vision system";
CM_ SG_ 241 VFC_TS03_TSProb "Probability that the sign is a traffic sign";
CM_ SG_ 241 VFC_TS03_Dx "Traffic sign distance in longitudinal direction";
CM_ SG_ 241 VFC_TS03_Dy "Traffic sign distance in lateral direction";
CM_ SG_ 241 VFC_TS03_Dz "Traffic sign distance in vertical direction";
CM_ SG_ 241 VFC_TS03_DxStdDev "Standard deviation of Traffic sign distance in longitudinal direction";
CM_ SG_ 241 VFC_TS03_DyStdDev "Standard deviation of Traffic sign distance in lateral direction";
CM_ SG_ 241 VFC_TS03_DzStdDev "Standard deviation of Traffic sign distance in vertical direction";
CM_ SG_ 241 VFC_TS03_Width "Width of the sign";
CM_ SG_ 241 VFC_TS03_Height "Height of the sign";
CM_ SG_ 241 VFC_TS03_EmbedFlag "Determines whether the sign is embedded or not";
CM_ SG_ 241 VFC_TS03_Quality "A flag that determines the quality of the sign";
CM_ SG_ 241 VFC_TS03_VMS "Variable-message sign: Determines whether the traffic sign is Variable or fixed";
CM_ SG_ 241 VFC_TS03_Stable "Determines whether the object is stable";
CM_ SG_ 241 VFC_TS03_VehicleSticker "Flag which indicates whether the detected traffic sign is a invalid sign on a vehicle or not";
CM_ SG_ 241 VFC_TS03_InternalTrack "Flag which indicates if this sign is an internal track, i.e. an sign hypothesis of low quality";
CM_ SG_ 241 VFC_TS03_ValidLanes "Indicates on which lane the detected sign is valid. Bitfield:
Bit 0: valid on first right hand lane
Bit 1: valid on second right hand lane
Bit 2: valid on third right hand lane
Bit 3: valid on fourth right hand lane
Bit 4: valid on fifth right hand lane";
CM_ SG_ 241 VFC_TS03_ValidDay "The video sensor shall provide the week days for which the main traffic sign is valid. Bitfield:
Bit 0: MONDAY
Bit 1: TUESDAY
Bit 2: WEDNESDAY
Bit 3: THURSDAY
Bit 4: FRIDAY
Bit 5: SATURDAY
Bit 6: SUNDAY";
CM_ SG_ 241 VFC_TS03_ValidTimeRange1Start "Start time for the first time range in which the main traffic sign is valid. Minutes since midnight.";
CM_ SG_ 241 VFC_TS03_ValidTimeRange1End "End time for the first time range in which the main traffic sign is valid. Minutes since midnight.";
CM_ SG_ 241 VFC_TS03_ValidTimeRange2Start "Start time for the first time range in which the main traffic sign is valid. Minutes since midnight.";
CM_ SG_ 241 VFC_TS03_ValidTimeRange2End "End time for the first time range in which the main traffic sign is valid. Minutes since midnight.";
CM_ SG_ 241 VFC_TS03_ValidInDist "Indicates the longitudinal distance in which the validity of the main TSR starts";
CM_ SG_ 241 VFC_TS03_ValidDist "Indicates the longitudinal distance for which the main traffic sign is valid";
CM_ SG_ 241 VFC_TS03_AddTSCount "Number of additional signs attached to the main sign. This can be a minimum of 0 and a maximum of 6.";
CM_ SG_ 241 VFC_TS03_AddTS1Class "The type of additonal sign that has been detected by the vision system";
CM_ SG_ 241 VFC_TS03_AddTS1Prob "Probability that the sign is a traffic sign";
CM_ SG_ 241 VFC_TS03_AddTS1Quality "A flag that determines the quality of the signal";
CM_ SG_ 241 VFC_TS03_AddTS1VMS "Variable-message sign: Determines whether the traffic sign is Variable or fixed";
CM_ SG_ 241 VFC_TS03_AddTS2Class "The type of additonal sign that has been detected by the vision system";
CM_ SG_ 241 VFC_TS03_AddTS2Prob "Probability that the sign is a traffic sign";
CM_ SG_ 241 VFC_TS03_AddTS2Quality "A flag that determines the quality of the signal";
CM_ SG_ 241 VFC_TS03_AddTS2VMS "Variable-message sign: Determines whether the traffic sign is Variable or fixed";
CM_ SG_ 241 VFC_TS03_AddTS3Class "The type of additonal sign that has been detected by the vision system";
CM_ SG_ 241 VFC_TS03_AddTS3Prob "Probability that the sign is a traffic sign";
CM_ SG_ 241 VFC_TS03_AddTS3Quality "A flag that determines the quality of the signal";
CM_ SG_ 241 VFC_TS03_AddTS3VMS "Variable-message sign: Determines whether the traffic sign is Variable or fixed";
CM_ SG_ 241 VFC_TS03_AddTS4Class "The type of additonal sign that has been detected by the vision system";
CM_ SG_ 241 VFC_TS03_AddTS4Prob "Probability that the sign is a traffic sign";
CM_ SG_ 241 VFC_TS03_AddTS4Quality "A flag that determines the quality of the signal";
CM_ SG_ 241 VFC_TS03_AddTS4VMS "Variable-message sign: Determines whether the traffic sign is Variable or fixed";
CM_ SG_ 241 VFC_TS03_AddTS5Class "The type of additonal sign that has been detected by the vision system";
CM_ SG_ 241 VFC_TS03_AddTS5Prob "Probability that the sign is a traffic sign";
CM_ SG_ 241 VFC_TS03_AddTS5Quality "A flag that determines the quality of the signal";
CM_ SG_ 241 VFC_TS03_AddTS5VMS "Variable-message sign: Determines whether the traffic sign is Variable or fixed";
CM_ SG_ 241 VFC_TS03_AddTS6Class "The type of additonal sign that has been detected by the vision system";
CM_ SG_ 241 VFC_TS03_AddTS6Prob "Probability that the sign is a traffic sign";
CM_ SG_ 241 VFC_TS03_AddTS6Quality "A flag that determines the quality of the signal";
CM_ SG_ 241 VFC_TS03_AddTS6VMS "Variable-message sign: Determines whether the traffic sign is Variable or fixed";
CM_ SG_ 242 VFC_TS04_CRC "CRC - Autosar E2E Profile 5";
CM_ SG_ 242 VFC_TS04_AliveCtr "Alive counter - Autosar E2E Profile 5";
CM_ SG_ 242 VFC_TS04_ProtBlockCtr "Protocol-Signal: Block-Counter";
CM_ SG_ 242 VFC_TS04_ProtOrderIndex "Protocol-Signal: Index to ensure same order in Tx and Rx (Ethernet only)";
CM_ SG_ 242 VFC_TS04_ID "Unique Traffic Sign ID";
CM_ SG_ 242 VFC_TS04_Class "The type of main sign that has been detected by the vision system";
CM_ SG_ 242 VFC_TS04_TSProb "Probability that the sign is a traffic sign";
CM_ SG_ 242 VFC_TS04_Dx "Traffic sign distance in longitudinal direction";
CM_ SG_ 242 VFC_TS04_Dy "Traffic sign distance in lateral direction";
CM_ SG_ 242 VFC_TS04_Dz "Traffic sign distance in vertical direction";
CM_ SG_ 242 VFC_TS04_DxStdDev "Standard deviation of Traffic sign distance in longitudinal direction";
CM_ SG_ 242 VFC_TS04_DyStdDev "Standard deviation of Traffic sign distance in lateral direction";
CM_ SG_ 242 VFC_TS04_DzStdDev "Standard deviation of Traffic sign distance in vertical direction";
CM_ SG_ 242 VFC_TS04_Width "Width of the sign";
CM_ SG_ 242 VFC_TS04_Height "Height of the sign";
CM_ SG_ 242 VFC_TS04_EmbedFlag "Determines whether the sign is embedded or not";
CM_ SG_ 242 VFC_TS04_Quality "A flag that determines the quality of the sign";
CM_ SG_ 242 VFC_TS04_VMS "Variable-message sign: Determines whether the traffic sign is Variable or fixed";
CM_ SG_ 242 VFC_TS04_Stable "Determines whether the object is stable";
CM_ SG_ 242 VFC_TS04_VehicleSticker "Flag which indicates whether the detected traffic sign is a invalid sign on a vehicle or not";
CM_ SG_ 242 VFC_TS04_InternalTrack "Flag which indicates if this sign is an internal track, i.e. an sign hypothesis of low quality";
CM_ SG_ 242 VFC_TS04_ValidLanes "Indicates on which lane the detected sign is valid. Bitfield:
Bit 0: valid on first right hand lane
Bit 1: valid on second right hand lane
Bit 2: valid on third right hand lane
Bit 3: valid on fourth right hand lane
Bit 4: valid on fifth right hand lane";
CM_ SG_ 242 VFC_TS04_ValidDay "The video sensor shall provide the week days for which the main traffic sign is valid. Bitfield:
Bit 0: MONDAY
Bit 1: TUESDAY
Bit 2: WEDNESDAY
Bit 3: THURSDAY
Bit 4: FRIDAY
Bit 5: SATURDAY
Bit 6: SUNDAY";
CM_ SG_ 242 VFC_TS04_ValidTimeRange1Start "Start time for the first time range in which the main traffic sign is valid. Minutes since midnight.";
CM_ SG_ 242 VFC_TS04_ValidTimeRange1End "End time for the first time range in which the main traffic sign is valid. Minutes since midnight.";
CM_ SG_ 242 VFC_TS04_ValidTimeRange2Start "Start time for the first time range in which the main traffic sign is valid. Minutes since midnight.";
CM_ SG_ 242 VFC_TS04_ValidTimeRange2End "End time for the first time range in which the main traffic sign is valid. Minutes since midnight.";
CM_ SG_ 242 VFC_TS04_ValidInDist "Indicates the longitudinal distance in which the validity of the main TSR starts";
CM_ SG_ 242 VFC_TS04_ValidDist "Indicates the longitudinal distance for which the main traffic sign is valid";
CM_ SG_ 242 VFC_TS04_AddTSCount "Number of additional signs attached to the main sign. This can be a minimum of 0 and a maximum of 6.";
CM_ SG_ 242 VFC_TS04_AddTS1Class "The type of additonal sign that has been detected by the vision system";
CM_ SG_ 242 VFC_TS04_AddTS1Prob "Probability that the sign is a traffic sign";
CM_ SG_ 242 VFC_TS04_AddTS1Quality "A flag that determines the quality of the signal";
CM_ SG_ 242 VFC_TS04_AddTS1VMS "Variable-message sign: Determines whether the traffic sign is Variable or fixed";
CM_ SG_ 242 VFC_TS04_AddTS2Class "The type of additonal sign that has been detected by the vision system";
CM_ SG_ 242 VFC_TS04_AddTS2Prob "Probability that the sign is a traffic sign";
CM_ SG_ 242 VFC_TS04_AddTS2Quality "A flag that determines the quality of the signal";
CM_ SG_ 242 VFC_TS04_AddTS2VMS "Variable-message sign: Determines whether the traffic sign is Variable or fixed";
CM_ SG_ 242 VFC_TS04_AddTS3Class "The type of additonal sign that has been detected by the vision system";
CM_ SG_ 242 VFC_TS04_AddTS3Prob "Probability that the sign is a traffic sign";
CM_ SG_ 242 VFC_TS04_AddTS3Quality "A flag that determines the quality of the signal";
CM_ SG_ 242 VFC_TS04_AddTS3VMS "Variable-message sign: Determines whether the traffic sign is Variable or fixed";
CM_ SG_ 242 VFC_TS04_AddTS4Class "The type of additonal sign that has been detected by the vision system";
CM_ SG_ 242 VFC_TS04_AddTS4Prob "Probability that the sign is a traffic sign";
CM_ SG_ 242 VFC_TS04_AddTS4Quality "A flag that determines the quality of the signal";
CM_ SG_ 242 VFC_TS04_AddTS4VMS "Variable-message sign: Determines whether the traffic sign is Variable or fixed";
CM_ SG_ 242 VFC_TS04_AddTS5Class "The type of additonal sign that has been detected by the vision system";
CM_ SG_ 242 VFC_TS04_AddTS5Prob "Probability that the sign is a traffic sign";
CM_ SG_ 242 VFC_TS04_AddTS5Quality "A flag that determines the quality of the signal";
CM_ SG_ 242 VFC_TS04_AddTS5VMS "Variable-message sign: Determines whether the traffic sign is Variable or fixed";
CM_ SG_ 242 VFC_TS04_AddTS6Class "The type of additonal sign that has been detected by the vision system";
CM_ SG_ 242 VFC_TS04_AddTS6Prob "Probability that the sign is a traffic sign";
CM_ SG_ 242 VFC_TS04_AddTS6Quality "A flag that determines the quality of the signal";
CM_ SG_ 242 VFC_TS04_AddTS6VMS "Variable-message sign: Determines whether the traffic sign is Variable or fixed";
CM_ SG_ 243 VFC_TS05_CRC "CRC - Autosar E2E Profile 5";
CM_ SG_ 243 VFC_TS05_AliveCtr "Alive counter - Autosar E2E Profile 5";
CM_ SG_ 243 VFC_TS05_ProtBlockCtr "Protocol-Signal: Block-Counter";
CM_ SG_ 243 VFC_TS05_ProtOrderIndex "Protocol-Signal: Index to ensure same order in Tx and Rx (Ethernet only)";
CM_ SG_ 243 VFC_TS05_ID "Unique Traffic Sign ID";
CM_ SG_ 243 VFC_TS05_Class "The type of main sign that has been detected by the vision system";
CM_ SG_ 243 VFC_TS05_TSProb "Probability that the sign is a traffic sign";
CM_ SG_ 243 VFC_TS05_Dx "Traffic sign distance in longitudinal direction";
CM_ SG_ 243 VFC_TS05_Dy "Traffic sign distance in lateral direction";
CM_ SG_ 243 VFC_TS05_Dz "Traffic sign distance in vertical direction";
CM_ SG_ 243 VFC_TS05_DxStdDev "Standard deviation of Traffic sign distance in longitudinal direction";
CM_ SG_ 243 VFC_TS05_DyStdDev "Standard deviation of Traffic sign distance in lateral direction";
CM_ SG_ 243 VFC_TS05_DzStdDev "Standard deviation of Traffic sign distance in vertical direction";
CM_ SG_ 243 VFC_TS05_Width "Width of the sign";
CM_ SG_ 243 VFC_TS05_Height "Height of the sign";
CM_ SG_ 243 VFC_TS05_EmbedFlag "Determines whether the sign is embedded or not";
CM_ SG_ 243 VFC_TS05_Quality "A flag that determines the quality of the sign";
CM_ SG_ 243 VFC_TS05_VMS "Variable-message sign: Determines whether the traffic sign is Variable or fixed";
CM_ SG_ 243 VFC_TS05_Stable "Determines whether the object is stable";
CM_ SG_ 243 VFC_TS05_VehicleSticker "Flag which indicates whether the detected traffic sign is a invalid sign on a vehicle or not";
CM_ SG_ 243 VFC_TS05_InternalTrack "Flag which indicates if this sign is an internal track, i.e. an sign hypothesis of low quality";
CM_ SG_ 243 VFC_TS05_ValidLanes "Indicates on which lane the detected sign is valid. Bitfield:
Bit 0: valid on first right hand lane
Bit 1: valid on second right hand lane
Bit 2: valid on third right hand lane
Bit 3: valid on fourth right hand lane
Bit 4: valid on fifth right hand lane";
CM_ SG_ 243 VFC_TS05_ValidDay "The video sensor shall provide the week days for which the main traffic sign is valid. Bitfield:
Bit 0: MONDAY
Bit 1: TUESDAY
Bit 2: WEDNESDAY
Bit 3: THURSDAY
Bit 4: FRIDAY
Bit 5: SATURDAY
Bit 6: SUNDAY";
CM_ SG_ 243 VFC_TS05_ValidTimeRange1Start "Start time for the first time range in which the main traffic sign is valid. Minutes since midnight.";
CM_ SG_ 243 VFC_TS05_ValidTimeRange1End "End time for the first time range in which the main traffic sign is valid. Minutes since midnight.";
CM_ SG_ 243 VFC_TS05_ValidTimeRange2Start "Start time for the first time range in which the main traffic sign is valid. Minutes since midnight.";
CM_ SG_ 243 VFC_TS05_ValidTimeRange2End "End time for the first time range in which the main traffic sign is valid. Minutes since midnight.";
CM_ SG_ 243 VFC_TS05_ValidInDist "Indicates the longitudinal distance in which the validity of the main TSR starts";
CM_ SG_ 243 VFC_TS05_ValidDist "Indicates the longitudinal distance for which the main traffic sign is valid";
CM_ SG_ 243 VFC_TS05_AddTSCount "Number of additional signs attached to the main sign. This can be a minimum of 0 and a maximum of 6.";
CM_ SG_ 243 VFC_TS05_AddTS1Class "The type of additonal sign that has been detected by the vision system";
CM_ SG_ 243 VFC_TS05_AddTS1Prob "Probability that the sign is a traffic sign";
CM_ SG_ 243 VFC_TS05_AddTS1Quality "A flag that determines the quality of the signal";
CM_ SG_ 243 VFC_TS05_AddTS1VMS "Variable-message sign: Determines whether the traffic sign is Variable or fixed";
CM_ SG_ 243 VFC_TS05_AddTS2Class "The type of additonal sign that has been detected by the vision system";
CM_ SG_ 243 VFC_TS05_AddTS2Prob "Probability that the sign is a traffic sign";
CM_ SG_ 243 VFC_TS05_AddTS2Quality "A flag that determines the quality of the signal";
CM_ SG_ 243 VFC_TS05_AddTS2VMS "Variable-message sign: Determines whether the traffic sign is Variable or fixed";
CM_ SG_ 243 VFC_TS05_AddTS3Class "The type of additonal sign that has been detected by the vision system";
CM_ SG_ 243 VFC_TS05_AddTS3Prob "Probability that the sign is a traffic sign";
CM_ SG_ 243 VFC_TS05_AddTS3Quality "A flag that determines the quality of the signal";
CM_ SG_ 243 VFC_TS05_AddTS3VMS "Variable-message sign: Determines whether the traffic sign is Variable or fixed";
CM_ SG_ 243 VFC_TS05_AddTS4Class "The type of additonal sign that has been detected by the vision system";
CM_ SG_ 243 VFC_TS05_AddTS4Prob "Probability that the sign is a traffic sign";
CM_ SG_ 243 VFC_TS05_AddTS4Quality "A flag that determines the quality of the signal";
CM_ SG_ 243 VFC_TS05_AddTS4VMS "Variable-message sign: Determines whether the traffic sign is Variable or fixed";
CM_ SG_ 243 VFC_TS05_AddTS5Class "The type of additonal sign that has been detected by the vision system";
CM_ SG_ 243 VFC_TS05_AddTS5Prob "Probability that the sign is a traffic sign";
CM_ SG_ 243 VFC_TS05_AddTS5Quality "A flag that determines the quality of the signal";
CM_ SG_ 243 VFC_TS05_AddTS5VMS "Variable-message sign: Determines whether the traffic sign is Variable or fixed";
CM_ SG_ 243 VFC_TS05_AddTS6Class "The type of additonal sign that has been detected by the vision system";
CM_ SG_ 243 VFC_TS05_AddTS6Prob "Probability that the sign is a traffic sign";
CM_ SG_ 243 VFC_TS05_AddTS6Quality "A flag that determines the quality of the signal";
CM_ SG_ 243 VFC_TS05_AddTS6VMS "Variable-message sign: Determines whether the traffic sign is Variable or fixed";
CM_ SG_ 244 VFC_TS06_CRC "CRC - Autosar E2E Profile 5";
CM_ SG_ 244 VFC_TS06_AliveCtr "Alive counter - Autosar E2E Profile 5";
CM_ SG_ 244 VFC_TS06_ProtBlockCtr "Protocol-Signal: Block-Counter";
CM_ SG_ 244 VFC_TS06_ProtOrderIndex "Protocol-Signal: Index to ensure same order in Tx and Rx (Ethernet only)";
CM_ SG_ 244 VFC_TS06_ID "Unique Traffic Sign ID";
CM_ SG_ 244 VFC_TS06_Class "The type of main sign that has been detected by the vision system";
CM_ SG_ 244 VFC_TS06_TSProb "Probability that the sign is a traffic sign";
CM_ SG_ 244 VFC_TS06_Dx "Traffic sign distance in longitudinal direction";
CM_ SG_ 244 VFC_TS06_Dy "Traffic sign distance in lateral direction";
CM_ SG_ 244 VFC_TS06_Dz "Traffic sign distance in vertical direction";
CM_ SG_ 244 VFC_TS06_DxStdDev "Standard deviation of Traffic sign distance in longitudinal direction";
CM_ SG_ 244 VFC_TS06_DyStdDev "Standard deviation of Traffic sign distance in lateral direction";
CM_ SG_ 244 VFC_TS06_DzStdDev "Standard deviation of Traffic sign distance in vertical direction";
CM_ SG_ 244 VFC_TS06_Width "Width of the sign";
CM_ SG_ 244 VFC_TS06_Height "Height of the sign";
CM_ SG_ 244 VFC_TS06_EmbedFlag "Determines whether the sign is embedded or not";
CM_ SG_ 244 VFC_TS06_Quality "A flag that determines the quality of the sign";
CM_ SG_ 244 VFC_TS06_VMS "Variable-message sign: Determines whether the traffic sign is Variable or fixed";
CM_ SG_ 244 VFC_TS06_Stable "Determines whether the object is stable";
CM_ SG_ 244 VFC_TS06_VehicleSticker "Flag which indicates whether the detected traffic sign is a invalid sign on a vehicle or not";
CM_ SG_ 244 VFC_TS06_InternalTrack "Flag which indicates if this sign is an internal track, i.e. an sign hypothesis of low quality";
CM_ SG_ 244 VFC_TS06_ValidLanes "Indicates on which lane the detected sign is valid. Bitfield:
Bit 0: valid on first right hand lane
Bit 1: valid on second right hand lane
Bit 2: valid on third right hand lane
Bit 3: valid on fourth right hand lane
Bit 4: valid on fifth right hand lane";
CM_ SG_ 244 VFC_TS06_ValidDay "The video sensor shall provide the week days for which the main traffic sign is valid. Bitfield:
Bit 0: MONDAY
Bit 1: TUESDAY
Bit 2: WEDNESDAY
Bit 3: THURSDAY
Bit 4: FRIDAY
Bit 5: SATURDAY
Bit 6: SUNDAY";
CM_ SG_ 244 VFC_TS06_ValidTimeRange1Start "Start time for the first time range in which the main traffic sign is valid. Minutes since midnight.";
CM_ SG_ 244 VFC_TS06_ValidTimeRange1End "End time for the first time range in which the main traffic sign is valid. Minutes since midnight.";
CM_ SG_ 244 VFC_TS06_ValidTimeRange2Start "Start time for the first time range in which the main traffic sign is valid. Minutes since midnight.";
CM_ SG_ 244 VFC_TS06_ValidTimeRange2End "End time for the first time range in which the main traffic sign is valid. Minutes since midnight.";
CM_ SG_ 244 VFC_TS06_ValidInDist "Indicates the longitudinal distance in which the validity of the main TSR starts";
CM_ SG_ 244 VFC_TS06_ValidDist "Indicates the longitudinal distance for which the main traffic sign is valid";
CM_ SG_ 244 VFC_TS06_AddTSCount "Number of additional signs attached to the main sign. This can be a minimum of 0 and a maximum of 6.";
CM_ SG_ 244 VFC_TS06_AddTS1Class "The type of additonal sign that has been detected by the vision system";
CM_ SG_ 244 VFC_TS06_AddTS1Prob "Probability that the sign is a traffic sign";
CM_ SG_ 244 VFC_TS06_AddTS1Quality "A flag that determines the quality of the signal";
CM_ SG_ 244 VFC_TS06_AddTS1VMS "Variable-message sign: Determines whether the traffic sign is Variable or fixed";
CM_ SG_ 244 VFC_TS06_AddTS2Class "The type of additonal sign that has been detected by the vision system";
CM_ SG_ 244 VFC_TS06_AddTS2Prob "Probability that the sign is a traffic sign";
CM_ SG_ 244 VFC_TS06_AddTS2Quality "A flag that determines the quality of the signal";
CM_ SG_ 244 VFC_TS06_AddTS2VMS "Variable-message sign: Determines whether the traffic sign is Variable or fixed";
CM_ SG_ 244 VFC_TS06_AddTS3Class "The type of additonal sign that has been detected by the vision system";
CM_ SG_ 244 VFC_TS06_AddTS3Prob "Probability that the sign is a traffic sign";
CM_ SG_ 244 VFC_TS06_AddTS3Quality "A flag that determines the quality of the signal";
CM_ SG_ 244 VFC_TS06_AddTS3VMS "Variable-message sign: Determines whether the traffic sign is Variable or fixed";
CM_ SG_ 244 VFC_TS06_AddTS4Class "The type of additonal sign that has been detected by the vision system";
CM_ SG_ 244 VFC_TS06_AddTS4Prob "Probability that the sign is a traffic sign";
CM_ SG_ 244 VFC_TS06_AddTS4Quality "A flag that determines the quality of the signal";
CM_ SG_ 244 VFC_TS06_AddTS4VMS "Variable-message sign: Determines whether the traffic sign is Variable or fixed";
CM_ SG_ 244 VFC_TS06_AddTS5Class "The type of additonal sign that has been detected by the vision system";
CM_ SG_ 244 VFC_TS06_AddTS5Prob "Probability that the sign is a traffic sign";
CM_ SG_ 244 VFC_TS06_AddTS5Quality "A flag that determines the quality of the signal";
CM_ SG_ 244 VFC_TS06_AddTS5VMS "Variable-message sign: Determines whether the traffic sign is Variable or fixed";
CM_ SG_ 244 VFC_TS06_AddTS6Class "The type of additonal sign that has been detected by the vision system";
CM_ SG_ 244 VFC_TS06_AddTS6Prob "Probability that the sign is a traffic sign";
CM_ SG_ 244 VFC_TS06_AddTS6Quality "A flag that determines the quality of the signal";
CM_ SG_ 244 VFC_TS06_AddTS6VMS "Variable-message sign: Determines whether the traffic sign is Variable or fixed";
CM_ SG_ 245 VFC_TS07_CRC "CRC - Autosar E2E Profile 5";
CM_ SG_ 245 VFC_TS07_AliveCtr "Alive counter - Autosar E2E Profile 5";
CM_ SG_ 245 VFC_TS07_ProtBlockCtr "Protocol-Signal: Block-Counter";
CM_ SG_ 245 VFC_TS07_ProtOrderIndex "Protocol-Signal: Index to ensure same order in Tx and Rx (Ethernet only)";
CM_ SG_ 245 VFC_TS07_ID "Unique Traffic Sign ID";
CM_ SG_ 245 VFC_TS07_Class "The type of main sign that has been detected by the vision system";
CM_ SG_ 245 VFC_TS07_TSProb "Probability that the sign is a traffic sign";
CM_ SG_ 245 VFC_TS07_Dx "Traffic sign distance in longitudinal direction";
CM_ SG_ 245 VFC_TS07_Dy "Traffic sign distance in lateral direction";
CM_ SG_ 245 VFC_TS07_Dz "Traffic sign distance in vertical direction";
CM_ SG_ 245 VFC_TS07_DxStdDev "Standard deviation of Traffic sign distance in longitudinal direction";
CM_ SG_ 245 VFC_TS07_DyStdDev "Standard deviation of Traffic sign distance in lateral direction";
CM_ SG_ 245 VFC_TS07_DzStdDev "Standard deviation of Traffic sign distance in vertical direction";
CM_ SG_ 245 VFC_TS07_Width "Width of the sign";
CM_ SG_ 245 VFC_TS07_Height "Height of the sign";
CM_ SG_ 245 VFC_TS07_EmbedFlag "Determines whether the sign is embedded or not";
CM_ SG_ 245 VFC_TS07_Quality "A flag that determines the quality of the sign";
CM_ SG_ 245 VFC_TS07_VMS "Variable-message sign: Determines whether the traffic sign is Variable or fixed";
CM_ SG_ 245 VFC_TS07_Stable "Determines whether the object is stable";
CM_ SG_ 245 VFC_TS07_VehicleSticker "Flag which indicates whether the detected traffic sign is a invalid sign on a vehicle or not";
CM_ SG_ 245 VFC_TS07_InternalTrack "Flag which indicates if this sign is an internal track, i.e. an sign hypothesis of low quality";
CM_ SG_ 245 VFC_TS07_ValidLanes "Indicates on which lane the detected sign is valid. Bitfield:
Bit 0: valid on first right hand lane
Bit 1: valid on second right hand lane
Bit 2: valid on third right hand lane
Bit 3: valid on fourth right hand lane
Bit 4: valid on fifth right hand lane";
CM_ SG_ 245 VFC_TS07_ValidDay "The video sensor shall provide the week days for which the main traffic sign is valid. Bitfield:
Bit 0: MONDAY
Bit 1: TUESDAY
Bit 2: WEDNESDAY
Bit 3: THURSDAY
Bit 4: FRIDAY
Bit 5: SATURDAY
Bit 6: SUNDAY";
CM_ SG_ 245 VFC_TS07_ValidTimeRange1Start "Start time for the first time range in which the main traffic sign is valid. Minutes since midnight.";
CM_ SG_ 245 VFC_TS07_ValidTimeRange1End "End time for the first time range in which the main traffic sign is valid. Minutes since midnight.";
CM_ SG_ 245 VFC_TS07_ValidTimeRange2Start "Start time for the first time range in which the main traffic sign is valid. Minutes since midnight.";
CM_ SG_ 245 VFC_TS07_ValidTimeRange2End "End time for the first time range in which the main traffic sign is valid. Minutes since midnight.";
CM_ SG_ 245 VFC_TS07_ValidInDist "Indicates the longitudinal distance in which the validity of the main TSR starts";
CM_ SG_ 245 VFC_TS07_ValidDist "Indicates the longitudinal distance for which the main traffic sign is valid";
CM_ SG_ 245 VFC_TS07_AddTSCount "Number of additional signs attached to the main sign. This can be a minimum of 0 and a maximum of 6.";
CM_ SG_ 245 VFC_TS07_AddTS1Class "The type of additonal sign that has been detected by the vision system";
CM_ SG_ 245 VFC_TS07_AddTS1Prob "Probability that the sign is a traffic sign";
CM_ SG_ 245 VFC_TS07_AddTS1Quality "A flag that determines the quality of the signal";
CM_ SG_ 245 VFC_TS07_AddTS1VMS "Variable-message sign: Determines whether the traffic sign is Variable or fixed";
CM_ SG_ 245 VFC_TS07_AddTS2Class "The type of additonal sign that has been detected by the vision system";
CM_ SG_ 245 VFC_TS07_AddTS2Prob "Probability that the sign is a traffic sign";
CM_ SG_ 245 VFC_TS07_AddTS2Quality "A flag that determines the quality of the signal";
CM_ SG_ 245 VFC_TS07_AddTS2VMS "Variable-message sign: Determines whether the traffic sign is Variable or fixed";
CM_ SG_ 245 VFC_TS07_AddTS3Class "The type of additonal sign that has been detected by the vision system";
CM_ SG_ 245 VFC_TS07_AddTS3Prob "Probability that the sign is a traffic sign";
CM_ SG_ 245 VFC_TS07_AddTS3Quality "A flag that determines the quality of the signal";
CM_ SG_ 245 VFC_TS07_AddTS3VMS "Variable-message sign: Determines whether the traffic sign is Variable or fixed";
CM_ SG_ 245 VFC_TS07_AddTS4Class "The type of additonal sign that has been detected by the vision system";
CM_ SG_ 245 VFC_TS07_AddTS4Prob "Probability that the sign is a traffic sign";
CM_ SG_ 245 VFC_TS07_AddTS4Quality "A flag that determines the quality of the signal";
CM_ SG_ 245 VFC_TS07_AddTS4VMS "Variable-message sign: Determines whether the traffic sign is Variable or fixed";
CM_ SG_ 245 VFC_TS07_AddTS5Class "The type of additonal sign that has been detected by the vision system";
CM_ SG_ 245 VFC_TS07_AddTS5Prob "Probability that the sign is a traffic sign";
CM_ SG_ 245 VFC_TS07_AddTS5Quality "A flag that determines the quality of the signal";
CM_ SG_ 245 VFC_TS07_AddTS5VMS "Variable-message sign: Determines whether the traffic sign is Variable or fixed";
CM_ SG_ 245 VFC_TS07_AddTS6Class "The type of additonal sign that has been detected by the vision system";
CM_ SG_ 245 VFC_TS07_AddTS6Prob "Probability that the sign is a traffic sign";
CM_ SG_ 245 VFC_TS07_AddTS6Quality "A flag that determines the quality of the signal";
CM_ SG_ 245 VFC_TS07_AddTS6VMS "Variable-message sign: Determines whether the traffic sign is Variable or fixed";
CM_ SG_ 246 VFC_TS08_CRC "CRC - Autosar E2E Profile 5";
CM_ SG_ 246 VFC_TS08_AliveCtr "Alive counter - Autosar E2E Profile 5";
CM_ SG_ 246 VFC_TS08_ProtBlockCtr "Protocol-Signal: Block-Counter";
CM_ SG_ 246 VFC_TS08_ProtOrderIndex "Protocol-Signal: Index to ensure same order in Tx and Rx (Ethernet only)";
CM_ SG_ 246 VFC_TS08_ID "Unique Traffic Sign ID";
CM_ SG_ 246 VFC_TS08_Class "The type of main sign that has been detected by the vision system";
CM_ SG_ 246 VFC_TS08_TSProb "Probability that the sign is a traffic sign";
CM_ SG_ 246 VFC_TS08_Dx "Traffic sign distance in longitudinal direction";
CM_ SG_ 246 VFC_TS08_Dy "Traffic sign distance in lateral direction";
CM_ SG_ 246 VFC_TS08_Dz "Traffic sign distance in vertical direction";
CM_ SG_ 246 VFC_TS08_DxStdDev "Standard deviation of Traffic sign distance in longitudinal direction";
CM_ SG_ 246 VFC_TS08_DyStdDev "Standard deviation of Traffic sign distance in lateral direction";
CM_ SG_ 246 VFC_TS08_DzStdDev "Standard deviation of Traffic sign distance in vertical direction";
CM_ SG_ 246 VFC_TS08_Width "Width of the sign";
CM_ SG_ 246 VFC_TS08_Height "Height of the sign";
CM_ SG_ 246 VFC_TS08_EmbedFlag "Determines whether the sign is embedded or not";
CM_ SG_ 246 VFC_TS08_Quality "A flag that determines the quality of the sign";
CM_ SG_ 246 VFC_TS08_VMS "Variable-message sign: Determines whether the traffic sign is Variable or fixed";
CM_ SG_ 246 VFC_TS08_Stable "Determines whether the object is stable";
CM_ SG_ 246 VFC_TS08_VehicleSticker "Flag which indicates whether the detected traffic sign is a invalid sign on a vehicle or not";
CM_ SG_ 246 VFC_TS08_InternalTrack "Flag which indicates if this sign is an internal track, i.e. an sign hypothesis of low quality";
CM_ SG_ 246 VFC_TS08_ValidLanes "Indicates on which lane the detected sign is valid. Bitfield:
Bit 0: valid on first right hand lane
Bit 1: valid on second right hand lane
Bit 2: valid on third right hand lane
Bit 3: valid on fourth right hand lane
Bit 4: valid on fifth right hand lane";
CM_ SG_ 246 VFC_TS08_ValidDay "The video sensor shall provide the week days for which the main traffic sign is valid. Bitfield:
Bit 0: MONDAY
Bit 1: TUESDAY
Bit 2: WEDNESDAY
Bit 3: THURSDAY
Bit 4: FRIDAY
Bit 5: SATURDAY
Bit 6: SUNDAY";
CM_ SG_ 246 VFC_TS08_ValidTimeRange1Start "Start time for the first time range in which the main traffic sign is valid. Minutes since midnight.";
CM_ SG_ 246 VFC_TS08_ValidTimeRange1End "End time for the first time range in which the main traffic sign is valid. Minutes since midnight.";
CM_ SG_ 246 VFC_TS08_ValidTimeRange2Start "Start time for the first time range in which the main traffic sign is valid. Minutes since midnight.";
CM_ SG_ 246 VFC_TS08_ValidTimeRange2End "End time for the first time range in which the main traffic sign is valid. Minutes since midnight.";
CM_ SG_ 246 VFC_TS08_ValidInDist "Indicates the longitudinal distance in which the validity of the main TSR starts";
CM_ SG_ 246 VFC_TS08_ValidDist "Indicates the longitudinal distance for which the main traffic sign is valid";
CM_ SG_ 246 VFC_TS08_AddTSCount "Number of additional signs attached to the main sign. This can be a minimum of 0 and a maximum of 6.";
CM_ SG_ 246 VFC_TS08_AddTS1Class "The type of additonal sign that has been detected by the vision system";
CM_ SG_ 246 VFC_TS08_AddTS1Prob "Probability that the sign is a traffic sign";
CM_ SG_ 246 VFC_TS08_AddTS1Quality "A flag that determines the quality of the signal";
CM_ SG_ 246 VFC_TS08_AddTS1VMS "Variable-message sign: Determines whether the traffic sign is Variable or fixed";
CM_ SG_ 246 VFC_TS08_AddTS2Class "The type of additonal sign that has been detected by the vision system";
CM_ SG_ 246 VFC_TS08_AddTS2Prob "Probability that the sign is a traffic sign";
CM_ SG_ 246 VFC_TS08_AddTS2Quality "A flag that determines the quality of the signal";
CM_ SG_ 246 VFC_TS08_AddTS2VMS "Variable-message sign: Determines whether the traffic sign is Variable or fixed";
CM_ SG_ 246 VFC_TS08_AddTS3Class "The type of additonal sign that has been detected by the vision system";
CM_ SG_ 246 VFC_TS08_AddTS3Prob "Probability that the sign is a traffic sign";
CM_ SG_ 246 VFC_TS08_AddTS3Quality "A flag that determines the quality of the signal";
CM_ SG_ 246 VFC_TS08_AddTS3VMS "Variable-message sign: Determines whether the traffic sign is Variable or fixed";
CM_ SG_ 246 VFC_TS08_AddTS4Class "The type of additonal sign that has been detected by the vision system";
CM_ SG_ 246 VFC_TS08_AddTS4Prob "Probability that the sign is a traffic sign";
CM_ SG_ 246 VFC_TS08_AddTS4Quality "A flag that determines the quality of the signal";
CM_ SG_ 246 VFC_TS08_AddTS4VMS "Variable-message sign: Determines whether the traffic sign is Variable or fixed";
CM_ SG_ 246 VFC_TS08_AddTS5Class "The type of additonal sign that has been detected by the vision system";
CM_ SG_ 246 VFC_TS08_AddTS5Prob "Probability that the sign is a traffic sign";
CM_ SG_ 246 VFC_TS08_AddTS5Quality "A flag that determines the quality of the signal";
CM_ SG_ 246 VFC_TS08_AddTS5VMS "Variable-message sign: Determines whether the traffic sign is Variable or fixed";
CM_ SG_ 246 VFC_TS08_AddTS6Class "The type of additonal sign that has been detected by the vision system";
CM_ SG_ 246 VFC_TS08_AddTS6Prob "Probability that the sign is a traffic sign";
CM_ SG_ 246 VFC_TS08_AddTS6Quality "A flag that determines the quality of the signal";
CM_ SG_ 246 VFC_TS08_AddTS6VMS "Variable-message sign: Determines whether the traffic sign is Variable or fixed";
BA_DEF_ BO_  "CANFD_BRS" ENUM  "0","1";
BA_DEF_ BO_  "GenMsgCycleTime" INT 0 65535;
BA_DEF_ BO_  "GenMsgSendType" ENUM  "Event","cyclic","event";
BA_DEF_ BO_  "VFrameFormat" ENUM  "StandardCAN","ExtendedCAN","reserved","reserved","reserved","reserved","reserved","reserved","reserved","reserved","reserved","reserved","reserved","reserved","StandardCAN_FD","ExtendedCAN_FD";
BA_DEF_ SG_  "GenSigStartValue" FLOAT 0 100000000000;
BA_DEF_DEF_  "CANFD_BRS" "1";
BA_DEF_DEF_  "GenMsgCycleTime" 0;
BA_DEF_DEF_  "GenMsgSendType" "";
BA_DEF_DEF_  "VFrameFormat" "";
BA_DEF_DEF_  "GenSigStartValue" 0;
BA_ "GenMsgSendType" BO_ 236 0;
BA_ "VFrameFormat" BO_ 236 14;
BA_ "GenMsgSendType" BO_ 238 0;
BA_ "VFrameFormat" BO_ 238 14;
BA_ "GenMsgSendType" BO_ 239 0;
BA_ "VFrameFormat" BO_ 239 14;
BA_ "GenMsgSendType" BO_ 240 0;
BA_ "VFrameFormat" BO_ 240 14;
BA_ "GenMsgSendType" BO_ 241 0;
BA_ "VFrameFormat" BO_ 241 14;
BA_ "GenMsgSendType" BO_ 242 0;
BA_ "VFrameFormat" BO_ 242 14;
BA_ "GenMsgSendType" BO_ 243 0;
BA_ "VFrameFormat" BO_ 243 14;
BA_ "GenMsgSendType" BO_ 244 0;
BA_ "VFrameFormat" BO_ 244 14;
BA_ "GenMsgSendType" BO_ 245 0;
BA_ "VFrameFormat" BO_ 245 14;
BA_ "GenMsgSendType" BO_ 246 0;
BA_ "VFrameFormat" BO_ 246 14;
BA_ "GenSigStartValue" SG_ 238 VFC_TS00_Dy 128;
BA_ "GenSigStartValue" SG_ 239 VFC_TS01_Dy 128;
BA_ "GenSigStartValue" SG_ 240 VFC_TS02_Dy 128;
BA_ "GenSigStartValue" SG_ 241 VFC_TS03_Dy 128;
BA_ "GenSigStartValue" SG_ 242 VFC_TS04_Dy 128;
BA_ "GenSigStartValue" SG_ 243 VFC_TS05_Dy 128;
BA_ "GenSigStartValue" SG_ 244 VFC_TS06_Dy 128;
BA_ "GenSigStartValue" SG_ 245 VFC_TS07_Dy 128;
BA_ "GenSigStartValue" SG_ 246 VFC_TS08_Dy 128;
VAL_ 236 VFC_TSHdr_State 0 "Off" 1 "On" 2 "Reduced" 3 "HW_Error" 4 "SW_Error" 5 "FID_Active" 6 "Reserved6" 7 "Reserved7" ;
VAL_ 236 VFC_TSHdr_Brightness 0 "Daylight" 1 "Night" 2 "Reserved2" 3 "Reserved3" 4 "Reserved4" 5 "Reserved5" 6 "Reserved6" 7 "Reserved7" ;
VAL_ 236 VFC_TSHdr_Country 0 "0 Unknown" 4 "Afghanistan" 8 "Albania" 10 "Antarctica" 12 "Algeria" 16 "American Samoa" 20 "Andorra" 24 "Angola" 28 "Antigua and Barbuda" 31 "Azerbaijan" 32 "Argentina" 36 "Australia" 40 "Austria" 44 "Bahamas (the)" 48 "Bahrain" 50 "Bangladesh" 51 "Armenia" 52 "Barbados" 56 "Belgium" 60 "Bermuda" 64 "Bhutan" 68 "Bolivia (Plurinational State of)" 70 "Bosnia and Herzegovina" 72 "Botswana" 74 "Bouvet Island" 76 "Brazil" 84 "Belize" 86 "British Indian Ocean Territory (the)" 90 "Solomon Islands" 92 "Virgin Islands (British)" 96 "Brunei Darussalam" 100 "Bulgaria" 104 "Myanmar" 108 "Burundi" 112 "Belarus" 116 "Cambodia" 120 "Cameroon" 124 "Canada" 132 "Cabo Verde" 136 "Cayman Islands (the)" 140 "Central African Republic (the)" 144 "Sri Lanka" 148 "Chad" 152 "Chile" 156 "China" 158 "Taiwan (Province of China)" 162 "Christmas Island" 166 "Cocos (Keeling) Islands (the)" 170 "Colombia" 174 "Comoros (the)" 175 "Mayotte" 178 "Congo (the)" 180 "Congo (the Democratic Republic of the)" 184 "Cook Islands (the)" 188 "Costa Rica" 191 "Croatia" 192 "Cuba" 196 "Cyprus" 203 "Czechia" 204 "Benin" 208 "Denmark" 212 "Dominica" 214 "Dominican Republic (the)" 218 "Ecuador" 222 "El Salvador" 226 "Equatorial Guinea" 231 "Ethiopia" 232 "Eritrea" 233 "Estonia" 234 "Faroe Islands (the)" 238 "Falkland Islands (the) [Malvinas]" 239 "South Georgia and the South Sandwich Islands" 242 "Fiji" 246 "Finland" 248 "Aland Islands" 250 "France" 254 "French Guiana" 258 "French Polynesia" 260 "French Southern Territories (the)" 262 "Djibouti" 266 "Gabon" 268 "Georgia" 270 "Gambia (the)" 275 "Palestine, State of" 276 "Germany" 288 "Ghana" 292 "Gibraltar" 296 "Kiribati" 300 "Greece" 304 "Greenland" 308 "Grenada" 312 "Guadeloupe" 316 "Guam" 320 "Guatemala" 324 "Guinea" 328 "Guyana" 332 "Haiti" 334 "Heard Island and McDonald Islands" 336 "Holy See (the)" 340 "Honduras" 344 "Hong Kong" 348 "Hungary" 352 "Iceland" 356 "India" 360 "Indonesia" 364 "Iran (Islamic Republic of)" 368 "Iraq" 372 "Ireland" 376 "Israel" 380 "Italy" 384 "Cote d'Ivoire" 388 "Jamaica" 392 "Japan" 398 "Kazakhstan" 400 "Jordan" 404 "Kenya" 408 "Korea (the Democratic People's Republic of)" 410 "Korea (the Republic of)" 414 "Kuwait" 417 "Kyrgyzstan" 418 "Lao People's Democratic Republic (the)" 422 "Lebanon" 426 "Lesotho" 428 "Latvia" 430 "Liberia" 434 "Libya" 438 "Liechtenstein" 440 "Lithuania" 442 "Luxembourg" 446 "Macao" 450 "Madagascar" 454 "Malawi" 458 "Malaysia" 462 "Maldives" 466 "Mali" 470 "Malta" 474 "Martinique" 478 "Mauritania" 480 "Mauritius" 484 "Mexico" 492 "Monaco" 496 "Mongolia" 498 "Moldova (the Republic of)" 499 "Montenegro" 500 "Montserrat" 504 "Morocco" 508 "Mozambique" 512 "Oman" 516 "Namibia" 520 "Nauru" 524 "Nepal" 528 "Netherlands (the)" 531 "Curacao" 533 "Aruba" 534 "Sint Maarten (Dutch part)" 535 "Bonaire, Sint Eustatius and Saba" 540 "New Caledonia" 548 "Vanuatu" 554 "New Zealand" 558 "Nicaragua" 562 "Niger (the)" 566 "Nigeria" 570 "Niue" 574 "Norfolk Island" 578 "Norway" 580 "Northern Mariana Islands (the)" 581 "United States Minor Outlying Islands (the)" 583 "Micronesia (Federated States of)" 584 "Marshall Islands (the)" 585 "Palau" 586 "Pakistan" 591 "Panama" 598 "Papua New Guinea" 600 "Paraguay" 604 "Peru" 608 "Philippines (the)" 612 "Pitcairn" 616 "Poland" 620 "Portugal" 624 "Guinea-Bissau" 626 "Timor-Leste" 630 "Puerto Rico" 634 "Qatar" 638 "Reunion" 642 "Romania" 643 "Russian Federation (the)" 646 "Rwanda" 652 "Saint Barthelemy" 654 "Saint Helena, Ascension and Tristan da Cunha" 659 "Saint Kitts and Nevis" 660 "Anguilla" 662 "Saint Lucia" 663 "Saint Martin (French part)" 666 "Saint Pierre and Miquelon" 670 "Saint Vincent and the Grenadines" 674 "San Marino" 678 "Sao Tome and Principe" 682 "Saudi Arabia" 686 "Senegal" 688 "Serbia" 690 "Seychelles" 694 "Sierra Leone" 702 "Singapore" 703 "Slovakia" 704 "Viet Nam" 705 "Slovenia" 706 "Somalia" 710 "South Africa" 716 "Zimbabwe" 724 "Spain" 728 "South Sudan" 729 "Sudan (the)" 732 "Western Sahara*" 740 "Suriname" 744 "Svalbard and Jan Mayen" 748 "Eswatini" 752 "Sweden" 756 "Switzerland" 760 "Syrian Arab Republic" 762 "Tajikistan" 764 "Thailand" 768 "Togo" 772 "Tokelau" 776 "Tonga" 780 "Trinidad and Tobago" 784 "United Arab Emirates (the)" 788 "Tunisia" 792 "Turkey" 795 "Turkmenistan" 796 "Turks and Caicos Islands (the)" 798 "Tuvalu" 800 "Uganda" 804 "Ukraine" 807 "Macedonia (the former Yugoslav Republic of)" 818 "Egypt" 826 "United Kingdom of Great Britain and Northern Ireland (the)" 831 "Guernsey" 832 "Jersey" 833 "Isle of Man" 834 "Tanzania, United Republic of" 840 "United States of America (the)" 850 "Virgin Islands (U.S.)" 854 "Burkina Faso" 858 "Uruguay" 860 "Uzbekistan" 862 "Venezuela(Bolivarian Republic of)" 876 "Wallis and Futuna" 882 "Samoa" 887 "Yemen" 894 "Zambia" ;
VAL_ 236 VFC_TSHdr_CountryMode 0 "Unknown" 1 "EHR_CAN" 2 "EHR_Default_Country" 3 "EHR_Adaptation_Value" 4 "EHR_Variant_Coding" 5 "RSR_Dataset" 6 "RSR_CCD" 7 "Reserved" ;
VAL_ 238 VFC_TS00_ID 0 "INVALID" ;
VAL_ 238 VFC_TS00_Class 0 "UNKNOWN" 1 "SL5" 2 "SL10" 3 "SL15" 4 "SL20" 5 "SL25" 6 "SL30" 7 "SL35" 8 "SL40" 9 "SL45" 10 "SL50" 11 "SL55" 12 "SL60" 13 "SL65" 14 "SL70" 15 "SL75" 16 "SL80" 17 "SL85" 18 "SL90" 19 "SL95" 20 "SL100" 21 "SL105" 22 "SL110" 23 "SL115" 24 "SL120" 25 "SL125" 26 "SL130" 27 "SL135" 28 "SL140" 29 "SL145" 30 "SL150" 31 "SL155" 32 "SL160" 33 "ESL" 34 "EA" 35 "OP" 36 "EOP" 37 "OL" 38 "EOL" 39 "GIVEWAY" 40 "PRIOCROSS" 41 "PRIOCROSSYIELDTORIGHT" 42 "PRIOSTREET" 43 "EPRIOSTREET" 44 "STOP" 45 "AXLEWEIGHT" 46 "CARDIST" 47 "HEIGHT" 48 "LENGTH" 49 "LORRYDIST" 50 "NOALL" 51 "NOBIKE" 52 "NOBUS" 53 "NOCAR" 54 "NOCARBIKE" 55 "NOCARRIAGE" 56 "NOENTRY" 57 "NOHAZMAT" 58 "NOHAZWATER" 59 "NOLORRY" 60 "NOLORRYTRAILER" 61 "NOLTURN" 62 "NOPED" 63 "NORIDER" 64 "NORTURN" 65 "NOTRACTOR" 66 "NOTWOWAY" 67 "NOUTURN" 68 "UMWELT" 69 "EUMWELT" 70 "WEIGHT" 71 "WIDTH" 72 "WARNBIKE" 73 "WARNBUS" 74 "WARNCATTLE" 75 "WARNCONST" 76 "WARNCONSTL" 77 "WARNCONSTR" 78 "WARNCURVEL" 79 "WARNCURVER" 80 "WARNDANGER" 81 "WARNDCURVEL" 82 "WARNDCURVER" 83 "WARNDRAWBRIDGE" 84 "WARNFROG" 85 "WARNGRAVEL" 86 "WARNHUMP" 87 "WARNJAM" 88 "WARNKIDS" 89 "WARNLIGHTS" 90 "WARNLOWTREE" 91 "WARNPCROSS" 92 "WARNPED" 93 "WARNPIER" 94 "WARNPLANE" 95 "WARNRIDER" 96 "WARNROCK" 97 "WARNROUND" 98 "WARNRWORKS" 99 "WARNSKID" 100 "WARNSLOPED" 101 "WARNSLOPEU" 102 "WARNSNOW" 103 "WARNTRAIN" 104 "WARNTWOWAY" 105 "WARNWILDANIMAL" 106 "WARNWIND" 107 "ASL" 108 "EASL" 109 "CALM" 110 "ECALM" 111 "DEADEND" 112 "DOUANE" 113 "FWAY" 114 "EFWAY" 115 "HWAY" 116 "EHWAY" 117 "MSL" 118 "EMSL" 119 "NOPARK" 120 "NOSTOP" 121 "ONEWAYS" 122 "ONEWAYU" 123 "SLOWDOWN" 124 "SCHOOL" 125 "ESCHOOL" 126 "TWN" 127 "ETWN" 128 "WBBENTLEFT" 129 "WBBENTLEFTRIGHT" 130 "WBBENTRIGHT" 131 "WBDIAGL" 132 "WBDIAGLR" 133 "WBDIAGR" 134 "WBHAZWATER" 135 "WBLEFT" 136 "WBRIGHT" 137 "WBROUND" 138 "WBUP" 139 "WBUPLEFT" 140 "WBUPRIGHT" 141 "ZEBRA" 142 "HAZMAT" 143 "EMERGENCYBAY" 144 "ENDOFLANEL" 145 "ENDOFLANER" 146 "ENOPARK" 147 "EONEWAY" 148 "EPARK" 149 "ETOLL" 150 "NOPARKL" 151 "NOPARKLR" 152 "NOPARKR" 153 "NOSTOPL" 154 "NOSTOPLR" 155 "NOSTOPR" 156 "NOTURNONRED" 157 "ONEWAYL" 158 "ONEWAYR" 159 "PARK" 160 "PRIOCROSSL" 161 "PRIOCROSSR" 162 "TOLL" 163 "TUNNEL" 164 "TWOWAY" 165 "WARNCROSS" 166 "WARNCROSSL" 167 "WARNCROSSLR" 168 "WARNCROSSR" 169 "WARNCROSSRL" 170 "WARNCROSST" 171 "WARNGIVEWAYAHEAD" 172 "WARNSLAHEAD" 173 "WARNSTOPAHEAD" 174 "WBBUS" 175 "WRONGWAY" 176 "HAZWATER" 177 "GIVEWAYROUND" 178 "WARNWINDINGL" 179 "WARNWINDINGR" 180 "WARNHAIRPINL" 181 "WARNHAIRPINR" 182 "WARNPEDBIKE" 183 "WARNCROSSY" 184 "WARNBRANCHL" 185 "WARNBRANCHR" 186 "WARNAXLEWEIGHT" 187 "WARNWEIGHT" 188 "WARNHEIGHT" 189 "WARNLENGTH" 190 "WARNWIDTH" 191 "WARNBLACKSPOT" 192 "WARNMERGEL" 193 "WARNMERGER" 194 "WARNTUNNEL" 195 "WARNTRACTOR" 196 "WARNRWORKSVEHICLE" 197 "WARNNARROWBRIDGE" 198 "WARNFLAGGER" 199 "LANES" 200 "LANESHIFTL" 201 "LANESHIFTR" 202 "NEWLANEL" 203 "NEWLANER" 204 "RIGHTTURNONRED" 205 "BORDERLIMIT" 206 "EMBEDDEDRAIN" ;
VAL_ 238 VFC_TS00_EmbedFlag 0 "Unknown" 1 "Not Embedded" 2 "Border Limit" 3 "Multi Lane" 4 "Rain" 5 "Vehicle Type" 6 "Plate" 7 "Error Value" ;
VAL_ 238 VFC_TS00_Quality 0 "Poor Quality" 1 "Good Quality" ;
VAL_ 238 VFC_TS00_VMS 0 "Fixed" 1 "Variable" ;
VAL_ 238 VFC_TS00_Stable 0 "Object Is Not Stable" 1 "Object Is Stable" ;
VAL_ 238 VFC_TS00_VehicleSticker 0 "not_sticker_on_vehicle" 1 "Sign is a sticker on a vehicle" ;
VAL_ 238 VFC_TS00_InternalTrack 0 "Sign is not an internal track" 1 "Sign is an internal track" ;
VAL_ 238 VFC_TS00_AddTS1Class 0 "UNKNOWN" 1 "DETECTED" 2 "ACCIDENT" 3 "ADVICE" 4 "BEGINS" 5 "BUS" 6 "CAMPER" 7 "CAR" 8 "CARAVAN" 9 "CRASHRISK" 10 "DIRT" 11 "DISTANCE" 12 "DISTANCEBARS" 13 "END" 14 "EXITL" 15 "EXITR" 16 "FOG" 17 "GRAVEL" 18 "HAZMAT" 19 "HUMP" 20 "JAM" 21 "LORRY" 22 "EXCEPTLORRY" 23 "LOWTREE" 24 "MCYCLE" 25 "MINIMUM" 26 "NIGHT" 27 "NOSTOPSHOULDER" 28 "OILTRAIL" 29 "PRIOTURN" 30 "RADAR" 31 "RAIN" 32 "RAINSNOW" 33 "REMINDER" 34 "ROADDAMAGE" 35 "RUTS" 36 "RWORKSACCESS" 37 "RWORKSENTRY" 38 "RWORKSEXIT" 39 "SCHOOL" 40 "SECTION" 41 "SMOKE" 42 "SNOW" 43 "SOFTSHOULDERCAR" 44 "SHOFTSHOULDERLORRY" 45 "TEXT" 46 "TIME" 47 "TOWING" 48 "TRACTOR" 49 "TRACTOR_OVER" 50 "TRAILER" 51 "WEIGHT" 52 "WET" 53 "WITHIN" 54 "ZONE" 55 "EXIT" 56 "ACCESS" 57 "ALLWAY" 58 "EXCEPTBUS" 59 "EXCEPTDELIVERY" 60 "EXCEPTLOCAL" 61 "FROG" 62 "PRIOTURNL" 63 "PRIOTURNR" 64 "START" 65 "STOPIN" 66 "HAZWATER" 67 "DAY" 68 "SL" ;
VAL_ 238 VFC_TS00_AddTS1Quality 0 "Poor Quality" 1 "Good Quality" ;
VAL_ 238 VFC_TS00_AddTS1VMS 0 "Fixed" 1 "Variable" ;
VAL_ 238 VFC_TS00_AddTS2Class 0 "UNKNOWN" 1 "DETECTED" 2 "ACCIDENT" 3 "ADVICE" 4 "BEGINS" 5 "BUS" 6 "CAMPER" 7 "CAR" 8 "CARAVAN" 9 "CRASHRISK" 10 "DIRT" 11 "DISTANCE" 12 "DISTANCEBARS" 13 "END" 14 "EXITL" 15 "EXITR" 16 "FOG" 17 "GRAVEL" 18 "HAZMAT" 19 "HUMP" 20 "JAM" 21 "LORRY" 22 "EXCEPTLORRY" 23 "LOWTREE" 24 "MCYCLE" 25 "MINIMUM" 26 "NIGHT" 27 "NOSTOPSHOULDER" 28 "OILTRAIL" 29 "PRIOTURN" 30 "RADAR" 31 "RAIN" 32 "RAINSNOW" 33 "REMINDER" 34 "ROADDAMAGE" 35 "RUTS" 36 "RWORKSACCESS" 37 "RWORKSENTRY" 38 "RWORKSEXIT" 39 "SCHOOL" 40 "SECTION" 41 "SMOKE" 42 "SNOW" 43 "SOFTSHOULDERCAR" 44 "SHOFTSHOULDERLORRY" 45 "TEXT" 46 "TIME" 47 "TOWING" 48 "TRACTOR" 49 "TRACTOR_OVER" 50 "TRAILER" 51 "WEIGHT" 52 "WET" 53 "WITHIN" 54 "ZONE" 55 "EXIT" 56 "ACCESS" 57 "ALLWAY" 58 "EXCEPTBUS" 59 "EXCEPTDELIVERY" 60 "EXCEPTLOCAL" 61 "FROG" 62 "PRIOTURNL" 63 "PRIOTURNR" 64 "START" 65 "STOPIN" 66 "HAZWATER" 67 "DAY" 68 "SL" ;
VAL_ 238 VFC_TS00_AddTS2Quality 0 "Poor Quality" 1 "Good Quality" ;
VAL_ 238 VFC_TS00_AddTS2VMS 0 "Fixed" 1 "Variable" ;
VAL_ 238 VFC_TS00_AddTS3Class 0 "UNKNOWN" 1 "DETECTED" 2 "ACCIDENT" 3 "ADVICE" 4 "BEGINS" 5 "BUS" 6 "CAMPER" 7 "CAR" 8 "CARAVAN" 9 "CRASHRISK" 10 "DIRT" 11 "DISTANCE" 12 "DISTANCEBARS" 13 "END" 14 "EXITL" 15 "EXITR" 16 "FOG" 17 "GRAVEL" 18 "HAZMAT" 19 "HUMP" 20 "JAM" 21 "LORRY" 22 "EXCEPTLORRY" 23 "LOWTREE" 24 "MCYCLE" 25 "MINIMUM" 26 "NIGHT" 27 "NOSTOPSHOULDER" 28 "OILTRAIL" 29 "PRIOTURN" 30 "RADAR" 31 "RAIN" 32 "RAINSNOW" 33 "REMINDER" 34 "ROADDAMAGE" 35 "RUTS" 36 "RWORKSACCESS" 37 "RWORKSENTRY" 38 "RWORKSEXIT" 39 "SCHOOL" 40 "SECTION" 41 "SMOKE" 42 "SNOW" 43 "SOFTSHOULDERCAR" 44 "SHOFTSHOULDERLORRY" 45 "TEXT" 46 "TIME" 47 "TOWING" 48 "TRACTOR" 49 "TRACTOR_OVER" 50 "TRAILER" 51 "WEIGHT" 52 "WET" 53 "WITHIN" 54 "ZONE" 55 "EXIT" 56 "ACCESS" 57 "ALLWAY" 58 "EXCEPTBUS" 59 "EXCEPTDELIVERY" 60 "EXCEPTLOCAL" 61 "FROG" 62 "PRIOTURNL" 63 "PRIOTURNR" 64 "START" 65 "STOPIN" 66 "HAZWATER" 67 "DAY" 68 "SL" ;
VAL_ 238 VFC_TS00_AddTS3Quality 0 "Poor Quality" 1 "Good Quality" ;
VAL_ 238 VFC_TS00_AddTS3VMS 0 "Fixed" 1 "Variable" ;
VAL_ 238 VFC_TS00_AddTS4Class 0 "UNKNOWN" 1 "DETECTED" 2 "ACCIDENT" 3 "ADVICE" 4 "BEGINS" 5 "BUS" 6 "CAMPER" 7 "CAR" 8 "CARAVAN" 9 "CRASHRISK" 10 "DIRT" 11 "DISTANCE" 12 "DISTANCEBARS" 13 "END" 14 "EXITL" 15 "EXITR" 16 "FOG" 17 "GRAVEL" 18 "HAZMAT" 19 "HUMP" 20 "JAM" 21 "LORRY" 22 "EXCEPTLORRY" 23 "LOWTREE" 24 "MCYCLE" 25 "MINIMUM" 26 "NIGHT" 27 "NOSTOPSHOULDER" 28 "OILTRAIL" 29 "PRIOTURN" 30 "RADAR" 31 "RAIN" 32 "RAINSNOW" 33 "REMINDER" 34 "ROADDAMAGE" 35 "RUTS" 36 "RWORKSACCESS" 37 "RWORKSENTRY" 38 "RWORKSEXIT" 39 "SCHOOL" 40 "SECTION" 41 "SMOKE" 42 "SNOW" 43 "SOFTSHOULDERCAR" 44 "SHOFTSHOULDERLORRY" 45 "TEXT" 46 "TIME" 47 "TOWING" 48 "TRACTOR" 49 "TRACTOR_OVER" 50 "TRAILER" 51 "WEIGHT" 52 "WET" 53 "WITHIN" 54 "ZONE" 55 "EXIT" 56 "ACCESS" 57 "ALLWAY" 58 "EXCEPTBUS" 59 "EXCEPTDELIVERY" 60 "EXCEPTLOCAL" 61 "FROG" 62 "PRIOTURNL" 63 "PRIOTURNR" 64 "START" 65 "STOPIN" 66 "HAZWATER" 67 "DAY" 68 "SL" ;
VAL_ 238 VFC_TS00_AddTS4Quality 0 "Poor Quality" 1 "Good Quality" ;
VAL_ 238 VFC_TS00_AddTS4VMS 0 "Fixed" 1 "Variable" ;
VAL_ 238 VFC_TS00_AddTS5Class 0 "UNKNOWN" 1 "DETECTED" 2 "ACCIDENT" 3 "ADVICE" 4 "BEGINS" 5 "BUS" 6 "CAMPER" 7 "CAR" 8 "CARAVAN" 9 "CRASHRISK" 10 "DIRT" 11 "DISTANCE" 12 "DISTANCEBARS" 13 "END" 14 "EXITL" 15 "EXITR" 16 "FOG" 17 "GRAVEL" 18 "HAZMAT" 19 "HUMP" 20 "JAM" 21 "LORRY" 22 "EXCEPTLORRY" 23 "LOWTREE" 24 "MCYCLE" 25 "MINIMUM" 26 "NIGHT" 27 "NOSTOPSHOULDER" 28 "OILTRAIL" 29 "PRIOTURN" 30 "RADAR" 31 "RAIN" 32 "RAINSNOW" 33 "REMINDER" 34 "ROADDAMAGE" 35 "RUTS" 36 "RWORKSACCESS" 37 "RWORKSENTRY" 38 "RWORKSEXIT" 39 "SCHOOL" 40 "SECTION" 41 "SMOKE" 42 "SNOW" 43 "SOFTSHOULDERCAR" 44 "SHOFTSHOULDERLORRY" 45 "TEXT" 46 "TIME" 47 "TOWING" 48 "TRACTOR" 49 "TRACTOR_OVER" 50 "TRAILER" 51 "WEIGHT" 52 "WET" 53 "WITHIN" 54 "ZONE" 55 "EXIT" 56 "ACCESS" 57 "ALLWAY" 58 "EXCEPTBUS" 59 "EXCEPTDELIVERY" 60 "EXCEPTLOCAL" 61 "FROG" 62 "PRIOTURNL" 63 "PRIOTURNR" 64 "START" 65 "STOPIN" 66 "HAZWATER" 67 "DAY" 68 "SL" ;
VAL_ 238 VFC_TS00_AddTS5Quality 0 "Poor Quality" 1 "Good Quality" ;
VAL_ 238 VFC_TS00_AddTS5VMS 0 "Fixed" 1 "Variable" ;
VAL_ 238 VFC_TS00_AddTS6Class 0 "UNKNOWN" 1 "DETECTED" 2 "ACCIDENT" 3 "ADVICE" 4 "BEGINS" 5 "BUS" 6 "CAMPER" 7 "CAR" 8 "CARAVAN" 9 "CRASHRISK" 10 "DIRT" 11 "DISTANCE" 12 "DISTANCEBARS" 13 "END" 14 "EXITL" 15 "EXITR" 16 "FOG" 17 "GRAVEL" 18 "HAZMAT" 19 "HUMP" 20 "JAM" 21 "LORRY" 22 "EXCEPTLORRY" 23 "LOWTREE" 24 "MCYCLE" 25 "MINIMUM" 26 "NIGHT" 27 "NOSTOPSHOULDER" 28 "OILTRAIL" 29 "PRIOTURN" 30 "RADAR" 31 "RAIN" 32 "RAINSNOW" 33 "REMINDER" 34 "ROADDAMAGE" 35 "RUTS" 36 "RWORKSACCESS" 37 "RWORKSENTRY" 38 "RWORKSEXIT" 39 "SCHOOL" 40 "SECTION" 41 "SMOKE" 42 "SNOW" 43 "SOFTSHOULDERCAR" 44 "SHOFTSHOULDERLORRY" 45 "TEXT" 46 "TIME" 47 "TOWING" 48 "TRACTOR" 49 "TRACTOR_OVER" 50 "TRAILER" 51 "WEIGHT" 52 "WET" 53 "WITHIN" 54 "ZONE" 55 "EXIT" 56 "ACCESS" 57 "ALLWAY" 58 "EXCEPTBUS" 59 "EXCEPTDELIVERY" 60 "EXCEPTLOCAL" 61 "FROG" 62 "PRIOTURNL" 63 "PRIOTURNR" 64 "START" 65 "STOPIN" 66 "HAZWATER" 67 "DAY" 68 "SL" ;
VAL_ 238 VFC_TS00_AddTS6Quality 0 "Poor Quality" 1 "Good Quality" ;
VAL_ 238 VFC_TS00_AddTS6VMS 0 "Fixed" 1 "Variable" ;
VAL_ 239 VFC_TS01_ID 0 "INVALID" ;
VAL_ 239 VFC_TS01_Class 0 "UNKNOWN" 1 "SL5" 2 "SL10" 3 "SL15" 4 "SL20" 5 "SL25" 6 "SL30" 7 "SL35" 8 "SL40" 9 "SL45" 10 "SL50" 11 "SL55" 12 "SL60" 13 "SL65" 14 "SL70" 15 "SL75" 16 "SL80" 17 "SL85" 18 "SL90" 19 "SL95" 20 "SL100" 21 "SL105" 22 "SL110" 23 "SL115" 24 "SL120" 25 "SL125" 26 "SL130" 27 "SL135" 28 "SL140" 29 "SL145" 30 "SL150" 31 "SL155" 32 "SL160" 33 "ESL" 34 "EA" 35 "OP" 36 "EOP" 37 "OL" 38 "EOL" 39 "GIVEWAY" 40 "PRIOCROSS" 41 "PRIOCROSSYIELDTORIGHT" 42 "PRIOSTREET" 43 "EPRIOSTREET" 44 "STOP" 45 "AXLEWEIGHT" 46 "CARDIST" 47 "HEIGHT" 48 "LENGTH" 49 "LORRYDIST" 50 "NOALL" 51 "NOBIKE" 52 "NOBUS" 53 "NOCAR" 54 "NOCARBIKE" 55 "NOCARRIAGE" 56 "NOENTRY" 57 "NOHAZMAT" 58 "NOHAZWATER" 59 "NOLORRY" 60 "NOLORRYTRAILER" 61 "NOLTURN" 62 "NOPED" 63 "NORIDER" 64 "NORTURN" 65 "NOTRACTOR" 66 "NOTWOWAY" 67 "NOUTURN" 68 "UMWELT" 69 "EUMWELT" 70 "WEIGHT" 71 "WIDTH" 72 "WARNBIKE" 73 "WARNBUS" 74 "WARNCATTLE" 75 "WARNCONST" 76 "WARNCONSTL" 77 "WARNCONSTR" 78 "WARNCURVEL" 79 "WARNCURVER" 80 "WARNDANGER" 81 "WARNDCURVEL" 82 "WARNDCURVER" 83 "WARNDRAWBRIDGE" 84 "WARNFROG" 85 "WARNGRAVEL" 86 "WARNHUMP" 87 "WARNJAM" 88 "WARNKIDS" 89 "WARNLIGHTS" 90 "WARNLOWTREE" 91 "WARNPCROSS" 92 "WARNPED" 93 "WARNPIER" 94 "WARNPLANE" 95 "WARNRIDER" 96 "WARNROCK" 97 "WARNROUND" 98 "WARNRWORKS" 99 "WARNSKID" 100 "WARNSLOPED" 101 "WARNSLOPEU" 102 "WARNSNOW" 103 "WARNTRAIN" 104 "WARNTWOWAY" 105 "WARNWILDANIMAL" 106 "WARNWIND" 107 "ASL" 108 "EASL" 109 "CALM" 110 "ECALM" 111 "DEADEND" 112 "DOUANE" 113 "FWAY" 114 "EFWAY" 115 "HWAY" 116 "EHWAY" 117 "MSL" 118 "EMSL" 119 "NOPARK" 120 "NOSTOP" 121 "ONEWAYS" 122 "ONEWAYU" 123 "SLOWDOWN" 124 "SCHOOL" 125 "ESCHOOL" 126 "TWN" 127 "ETWN" 128 "WBBENTLEFT" 129 "WBBENTLEFTRIGHT" 130 "WBBENTRIGHT" 131 "WBDIAGL" 132 "WBDIAGLR" 133 "WBDIAGR" 134 "WBHAZWATER" 135 "WBLEFT" 136 "WBRIGHT" 137 "WBROUND" 138 "WBUP" 139 "WBUPLEFT" 140 "WBUPRIGHT" 141 "ZEBRA" 142 "HAZMAT" 143 "EMERGENCYBAY" 144 "ENDOFLANEL" 145 "ENDOFLANER" 146 "ENOPARK" 147 "EONEWAY" 148 "EPARK" 149 "ETOLL" 150 "NOPARKL" 151 "NOPARKLR" 152 "NOPARKR" 153 "NOSTOPL" 154 "NOSTOPLR" 155 "NOSTOPR" 156 "NOTURNONRED" 157 "ONEWAYL" 158 "ONEWAYR" 159 "PARK" 160 "PRIOCROSSL" 161 "PRIOCROSSR" 162 "TOLL" 163 "TUNNEL" 164 "TWOWAY" 165 "WARNCROSS" 166 "WARNCROSSL" 167 "WARNCROSSLR" 168 "WARNCROSSR" 169 "WARNCROSSRL" 170 "WARNCROSST" 171 "WARNGIVEWAYAHEAD" 172 "WARNSLAHEAD" 173 "WARNSTOPAHEAD" 174 "WBBUS" 175 "WRONGWAY" 176 "HAZWATER" 177 "GIVEWAYROUND" 178 "WARNWINDINGL" 179 "WARNWINDINGR" 180 "WARNHAIRPINL" 181 "WARNHAIRPINR" 182 "WARNPEDBIKE" 183 "WARNCROSSY" 184 "WARNBRANCHL" 185 "WARNBRANCHR" 186 "WARNAXLEWEIGHT" 187 "WARNWEIGHT" 188 "WARNHEIGHT" 189 "WARNLENGTH" 190 "WARNWIDTH" 191 "WARNBLACKSPOT" 192 "WARNMERGEL" 193 "WARNMERGER" 194 "WARNTUNNEL" 195 "WARNTRACTOR" 196 "WARNRWORKSVEHICLE" 197 "WARNNARROWBRIDGE" 198 "WARNFLAGGER" 199 "LANES" 200 "LANESHIFTL" 201 "LANESHIFTR" 202 "NEWLANEL" 203 "NEWLANER" 204 "RIGHTTURNONRED" 205 "BORDERLIMIT" 206 "EMBEDDEDRAIN" ;
VAL_ 239 VFC_TS01_EmbedFlag 0 "Unknown" 1 "Not Embedded" 2 "Border Limit" 3 "Multi Lane" 4 "Rain" 5 "Vehicle Type" 6 "Plate" 7 "Error Value" ;
VAL_ 239 VFC_TS01_Quality 0 "Poor Quality" 1 "Good Quality" ;
VAL_ 239 VFC_TS01_VMS 0 "Fixed" 1 "Variable" ;
VAL_ 239 VFC_TS01_Stable 0 "Object Is Not Stable" 1 "Object Is Stable" ;
VAL_ 239 VFC_TS01_VehicleSticker 0 "not_sticker_on_vehicle" 1 "Sign is a sticker on a vehicle" ;
VAL_ 239 VFC_TS01_InternalTrack 0 "Sign is not an internal track" 1 "Sign is an internal track" ;
VAL_ 239 VFC_TS01_AddTS1Class 0 "UNKNOWN" 1 "DETECTED" 2 "ACCIDENT" 3 "ADVICE" 4 "BEGINS" 5 "BUS" 6 "CAMPER" 7 "CAR" 8 "CARAVAN" 9 "CRASHRISK" 10 "DIRT" 11 "DISTANCE" 12 "DISTANCEBARS" 13 "END" 14 "EXITL" 15 "EXITR" 16 "FOG" 17 "GRAVEL" 18 "HAZMAT" 19 "HUMP" 20 "JAM" 21 "LORRY" 22 "EXCEPTLORRY" 23 "LOWTREE" 24 "MCYCLE" 25 "MINIMUM" 26 "NIGHT" 27 "NOSTOPSHOULDER" 28 "OILTRAIL" 29 "PRIOTURN" 30 "RADAR" 31 "RAIN" 32 "RAINSNOW" 33 "REMINDER" 34 "ROADDAMAGE" 35 "RUTS" 36 "RWORKSACCESS" 37 "RWORKSENTRY" 38 "RWORKSEXIT" 39 "SCHOOL" 40 "SECTION" 41 "SMOKE" 42 "SNOW" 43 "SOFTSHOULDERCAR" 44 "SHOFTSHOULDERLORRY" 45 "TEXT" 46 "TIME" 47 "TOWING" 48 "TRACTOR" 49 "TRACTOR_OVER" 50 "TRAILER" 51 "WEIGHT" 52 "WET" 53 "WITHIN" 54 "ZONE" 55 "EXIT" 56 "ACCESS" 57 "ALLWAY" 58 "EXCEPTBUS" 59 "EXCEPTDELIVERY" 60 "EXCEPTLOCAL" 61 "FROG" 62 "PRIOTURNL" 63 "PRIOTURNR" 64 "START" 65 "STOPIN" 66 "HAZWATER" 67 "DAY" 68 "SL" ;
VAL_ 239 VFC_TS01_AddTS1Quality 0 "Poor Quality" 1 "Good Quality" ;
VAL_ 239 VFC_TS01_AddTS1VMS 0 "Fixed" 1 "Variable" ;
VAL_ 239 VFC_TS01_AddTS2Class 0 "UNKNOWN" 1 "DETECTED" 2 "ACCIDENT" 3 "ADVICE" 4 "BEGINS" 5 "BUS" 6 "CAMPER" 7 "CAR" 8 "CARAVAN" 9 "CRASHRISK" 10 "DIRT" 11 "DISTANCE" 12 "DISTANCEBARS" 13 "END" 14 "EXITL" 15 "EXITR" 16 "FOG" 17 "GRAVEL" 18 "HAZMAT" 19 "HUMP" 20 "JAM" 21 "LORRY" 22 "EXCEPTLORRY" 23 "LOWTREE" 24 "MCYCLE" 25 "MINIMUM" 26 "NIGHT" 27 "NOSTOPSHOULDER" 28 "OILTRAIL" 29 "PRIOTURN" 30 "RADAR" 31 "RAIN" 32 "RAINSNOW" 33 "REMINDER" 34 "ROADDAMAGE" 35 "RUTS" 36 "RWORKSACCESS" 37 "RWORKSENTRY" 38 "RWORKSEXIT" 39 "SCHOOL" 40 "SECTION" 41 "SMOKE" 42 "SNOW" 43 "SOFTSHOULDERCAR" 44 "SHOFTSHOULDERLORRY" 45 "TEXT" 46 "TIME" 47 "TOWING" 48 "TRACTOR" 49 "TRACTOR_OVER" 50 "TRAILER" 51 "WEIGHT" 52 "WET" 53 "WITHIN" 54 "ZONE" 55 "EXIT" 56 "ACCESS" 57 "ALLWAY" 58 "EXCEPTBUS" 59 "EXCEPTDELIVERY" 60 "EXCEPTLOCAL" 61 "FROG" 62 "PRIOTURNL" 63 "PRIOTURNR" 64 "START" 65 "STOPIN" 66 "HAZWATER" 67 "DAY" 68 "SL" ;
VAL_ 239 VFC_TS01_AddTS2Quality 0 "Poor Quality" 1 "Good Quality" ;
VAL_ 239 VFC_TS01_AddTS2VMS 0 "Fixed" 1 "Variable" ;
VAL_ 239 VFC_TS01_AddTS3Class 0 "UNKNOWN" 1 "DETECTED" 2 "ACCIDENT" 3 "ADVICE" 4 "BEGINS" 5 "BUS" 6 "CAMPER" 7 "CAR" 8 "CARAVAN" 9 "CRASHRISK" 10 "DIRT" 11 "DISTANCE" 12 "DISTANCEBARS" 13 "END" 14 "EXITL" 15 "EXITR" 16 "FOG" 17 "GRAVEL" 18 "HAZMAT" 19 "HUMP" 20 "JAM" 21 "LORRY" 22 "EXCEPTLORRY" 23 "LOWTREE" 24 "MCYCLE" 25 "MINIMUM" 26 "NIGHT" 27 "NOSTOPSHOULDER" 28 "OILTRAIL" 29 "PRIOTURN" 30 "RADAR" 31 "RAIN" 32 "RAINSNOW" 33 "REMINDER" 34 "ROADDAMAGE" 35 "RUTS" 36 "RWORKSACCESS" 37 "RWORKSENTRY" 38 "RWORKSEXIT" 39 "SCHOOL" 40 "SECTION" 41 "SMOKE" 42 "SNOW" 43 "SOFTSHOULDERCAR" 44 "SHOFTSHOULDERLORRY" 45 "TEXT" 46 "TIME" 47 "TOWING" 48 "TRACTOR" 49 "TRACTOR_OVER" 50 "TRAILER" 51 "WEIGHT" 52 "WET" 53 "WITHIN" 54 "ZONE" 55 "EXIT" 56 "ACCESS" 57 "ALLWAY" 58 "EXCEPTBUS" 59 "EXCEPTDELIVERY" 60 "EXCEPTLOCAL" 61 "FROG" 62 "PRIOTURNL" 63 "PRIOTURNR" 64 "START" 65 "STOPIN" 66 "HAZWATER" 67 "DAY" 68 "SL" ;
VAL_ 239 VFC_TS01_AddTS3Quality 0 "Poor Quality" 1 "Good Quality" ;
VAL_ 239 VFC_TS01_AddTS3VMS 0 "Fixed" 1 "Variable" ;
VAL_ 239 VFC_TS01_AddTS4Class 0 "UNKNOWN" 1 "DETECTED" 2 "ACCIDENT" 3 "ADVICE" 4 "BEGINS" 5 "BUS" 6 "CAMPER" 7 "CAR" 8 "CARAVAN" 9 "CRASHRISK" 10 "DIRT" 11 "DISTANCE" 12 "DISTANCEBARS" 13 "END" 14 "EXITL" 15 "EXITR" 16 "FOG" 17 "GRAVEL" 18 "HAZMAT" 19 "HUMP" 20 "JAM" 21 "LORRY" 22 "EXCEPTLORRY" 23 "LOWTREE" 24 "MCYCLE" 25 "MINIMUM" 26 "NIGHT" 27 "NOSTOPSHOULDER" 28 "OILTRAIL" 29 "PRIOTURN" 30 "RADAR" 31 "RAIN" 32 "RAINSNOW" 33 "REMINDER" 34 "ROADDAMAGE" 35 "RUTS" 36 "RWORKSACCESS" 37 "RWORKSENTRY" 38 "RWORKSEXIT" 39 "SCHOOL" 40 "SECTION" 41 "SMOKE" 42 "SNOW" 43 "SOFTSHOULDERCAR" 44 "SHOFTSHOULDERLORRY" 45 "TEXT" 46 "TIME" 47 "TOWING" 48 "TRACTOR" 49 "TRACTOR_OVER" 50 "TRAILER" 51 "WEIGHT" 52 "WET" 53 "WITHIN" 54 "ZONE" 55 "EXIT" 56 "ACCESS" 57 "ALLWAY" 58 "EXCEPTBUS" 59 "EXCEPTDELIVERY" 60 "EXCEPTLOCAL" 61 "FROG" 62 "PRIOTURNL" 63 "PRIOTURNR" 64 "START" 65 "STOPIN" 66 "HAZWATER" 67 "DAY" 68 "SL" ;
VAL_ 239 VFC_TS01_AddTS4Quality 0 "Poor Quality" 1 "Good Quality" ;
VAL_ 239 VFC_TS01_AddTS4VMS 0 "Fixed" 1 "Variable" ;
VAL_ 239 VFC_TS01_AddTS5Class 0 "UNKNOWN" 1 "DETECTED" 2 "ACCIDENT" 3 "ADVICE" 4 "BEGINS" 5 "BUS" 6 "CAMPER" 7 "CAR" 8 "CARAVAN" 9 "CRASHRISK" 10 "DIRT" 11 "DISTANCE" 12 "DISTANCEBARS" 13 "END" 14 "EXITL" 15 "EXITR" 16 "FOG" 17 "GRAVEL" 18 "HAZMAT" 19 "HUMP" 20 "JAM" 21 "LORRY" 22 "EXCEPTLORRY" 23 "LOWTREE" 24 "MCYCLE" 25 "MINIMUM" 26 "NIGHT" 27 "NOSTOPSHOULDER" 28 "OILTRAIL" 29 "PRIOTURN" 30 "RADAR" 31 "RAIN" 32 "RAINSNOW" 33 "REMINDER" 34 "ROADDAMAGE" 35 "RUTS" 36 "RWORKSACCESS" 37 "RWORKSENTRY" 38 "RWORKSEXIT" 39 "SCHOOL" 40 "SECTION" 41 "SMOKE" 42 "SNOW" 43 "SOFTSHOULDERCAR" 44 "SHOFTSHOULDERLORRY" 45 "TEXT" 46 "TIME" 47 "TOWING" 48 "TRACTOR" 49 "TRACTOR_OVER" 50 "TRAILER" 51 "WEIGHT" 52 "WET" 53 "WITHIN" 54 "ZONE" 55 "EXIT" 56 "ACCESS" 57 "ALLWAY" 58 "EXCEPTBUS" 59 "EXCEPTDELIVERY" 60 "EXCEPTLOCAL" 61 "FROG" 62 "PRIOTURNL" 63 "PRIOTURNR" 64 "START" 65 "STOPIN" 66 "HAZWATER" 67 "DAY" 68 "SL" ;
VAL_ 239 VFC_TS01_AddTS5Quality 0 "Poor Quality" 1 "Good Quality" ;
VAL_ 239 VFC_TS01_AddTS5VMS 0 "Fixed" 1 "Variable" ;
VAL_ 239 VFC_TS01_AddTS6Class 0 "UNKNOWN" 1 "DETECTED" 2 "ACCIDENT" 3 "ADVICE" 4 "BEGINS" 5 "BUS" 6 "CAMPER" 7 "CAR" 8 "CARAVAN" 9 "CRASHRISK" 10 "DIRT" 11 "DISTANCE" 12 "DISTANCEBARS" 13 "END" 14 "EXITL" 15 "EXITR" 16 "FOG" 17 "GRAVEL" 18 "HAZMAT" 19 "HUMP" 20 "JAM" 21 "LORRY" 22 "EXCEPTLORRY" 23 "LOWTREE" 24 "MCYCLE" 25 "MINIMUM" 26 "NIGHT" 27 "NOSTOPSHOULDER" 28 "OILTRAIL" 29 "PRIOTURN" 30 "RADAR" 31 "RAIN" 32 "RAINSNOW" 33 "REMINDER" 34 "ROADDAMAGE" 35 "RUTS" 36 "RWORKSACCESS" 37 "RWORKSENTRY" 38 "RWORKSEXIT" 39 "SCHOOL" 40 "SECTION" 41 "SMOKE" 42 "SNOW" 43 "SOFTSHOULDERCAR" 44 "SHOFTSHOULDERLORRY" 45 "TEXT" 46 "TIME" 47 "TOWING" 48 "TRACTOR" 49 "TRACTOR_OVER" 50 "TRAILER" 51 "WEIGHT" 52 "WET" 53 "WITHIN" 54 "ZONE" 55 "EXIT" 56 "ACCESS" 57 "ALLWAY" 58 "EXCEPTBUS" 59 "EXCEPTDELIVERY" 60 "EXCEPTLOCAL" 61 "FROG" 62 "PRIOTURNL" 63 "PRIOTURNR" 64 "START" 65 "STOPIN" 66 "HAZWATER" 67 "DAY" 68 "SL" ;
VAL_ 239 VFC_TS01_AddTS6Quality 0 "Poor Quality" 1 "Good Quality" ;
VAL_ 239 VFC_TS01_AddTS6VMS 0 "Fixed" 1 "Variable" ;
VAL_ 240 VFC_TS02_ID 0 "INVALID" ;
VAL_ 240 VFC_TS02_Class 0 "UNKNOWN" 1 "SL5" 2 "SL10" 3 "SL15" 4 "SL20" 5 "SL25" 6 "SL30" 7 "SL35" 8 "SL40" 9 "SL45" 10 "SL50" 11 "SL55" 12 "SL60" 13 "SL65" 14 "SL70" 15 "SL75" 16 "SL80" 17 "SL85" 18 "SL90" 19 "SL95" 20 "SL100" 21 "SL105" 22 "SL110" 23 "SL115" 24 "SL120" 25 "SL125" 26 "SL130" 27 "SL135" 28 "SL140" 29 "SL145" 30 "SL150" 31 "SL155" 32 "SL160" 33 "ESL" 34 "EA" 35 "OP" 36 "EOP" 37 "OL" 38 "EOL" 39 "GIVEWAY" 40 "PRIOCROSS" 41 "PRIOCROSSYIELDTORIGHT" 42 "PRIOSTREET" 43 "EPRIOSTREET" 44 "STOP" 45 "AXLEWEIGHT" 46 "CARDIST" 47 "HEIGHT" 48 "LENGTH" 49 "LORRYDIST" 50 "NOALL" 51 "NOBIKE" 52 "NOBUS" 53 "NOCAR" 54 "NOCARBIKE" 55 "NOCARRIAGE" 56 "NOENTRY" 57 "NOHAZMAT" 58 "NOHAZWATER" 59 "NOLORRY" 60 "NOLORRYTRAILER" 61 "NOLTURN" 62 "NOPED" 63 "NORIDER" 64 "NORTURN" 65 "NOTRACTOR" 66 "NOTWOWAY" 67 "NOUTURN" 68 "UMWELT" 69 "EUMWELT" 70 "WEIGHT" 71 "WIDTH" 72 "WARNBIKE" 73 "WARNBUS" 74 "WARNCATTLE" 75 "WARNCONST" 76 "WARNCONSTL" 77 "WARNCONSTR" 78 "WARNCURVEL" 79 "WARNCURVER" 80 "WARNDANGER" 81 "WARNDCURVEL" 82 "WARNDCURVER" 83 "WARNDRAWBRIDGE" 84 "WARNFROG" 85 "WARNGRAVEL" 86 "WARNHUMP" 87 "WARNJAM" 88 "WARNKIDS" 89 "WARNLIGHTS" 90 "WARNLOWTREE" 91 "WARNPCROSS" 92 "WARNPED" 93 "WARNPIER" 94 "WARNPLANE" 95 "WARNRIDER" 96 "WARNROCK" 97 "WARNROUND" 98 "WARNRWORKS" 99 "WARNSKID" 100 "WARNSLOPED" 101 "WARNSLOPEU" 102 "WARNSNOW" 103 "WARNTRAIN" 104 "WARNTWOWAY" 105 "WARNWILDANIMAL" 106 "WARNWIND" 107 "ASL" 108 "EASL" 109 "CALM" 110 "ECALM" 111 "DEADEND" 112 "DOUANE" 113 "FWAY" 114 "EFWAY" 115 "HWAY" 116 "EHWAY" 117 "MSL" 118 "EMSL" 119 "NOPARK" 120 "NOSTOP" 121 "ONEWAYS" 122 "ONEWAYU" 123 "SLOWDOWN" 124 "SCHOOL" 125 "ESCHOOL" 126 "TWN" 127 "ETWN" 128 "WBBENTLEFT" 129 "WBBENTLEFTRIGHT" 130 "WBBENTRIGHT" 131 "WBDIAGL" 132 "WBDIAGLR" 133 "WBDIAGR" 134 "WBHAZWATER" 135 "WBLEFT" 136 "WBRIGHT" 137 "WBROUND" 138 "WBUP" 139 "WBUPLEFT" 140 "WBUPRIGHT" 141 "ZEBRA" 142 "HAZMAT" 143 "EMERGENCYBAY" 144 "ENDOFLANEL" 145 "ENDOFLANER" 146 "ENOPARK" 147 "EONEWAY" 148 "EPARK" 149 "ETOLL" 150 "NOPARKL" 151 "NOPARKLR" 152 "NOPARKR" 153 "NOSTOPL" 154 "NOSTOPLR" 155 "NOSTOPR" 156 "NOTURNONRED" 157 "ONEWAYL" 158 "ONEWAYR" 159 "PARK" 160 "PRIOCROSSL" 161 "PRIOCROSSR" 162 "TOLL" 163 "TUNNEL" 164 "TWOWAY" 165 "WARNCROSS" 166 "WARNCROSSL" 167 "WARNCROSSLR" 168 "WARNCROSSR" 169 "WARNCROSSRL" 170 "WARNCROSST" 171 "WARNGIVEWAYAHEAD" 172 "WARNSLAHEAD" 173 "WARNSTOPAHEAD" 174 "WBBUS" 175 "WRONGWAY" 176 "HAZWATER" 177 "GIVEWAYROUND" 178 "WARNWINDINGL" 179 "WARNWINDINGR" 180 "WARNHAIRPINL" 181 "WARNHAIRPINR" 182 "WARNPEDBIKE" 183 "WARNCROSSY" 184 "WARNBRANCHL" 185 "WARNBRANCHR" 186 "WARNAXLEWEIGHT" 187 "WARNWEIGHT" 188 "WARNHEIGHT" 189 "WARNLENGTH" 190 "WARNWIDTH" 191 "WARNBLACKSPOT" 192 "WARNMERGEL" 193 "WARNMERGER" 194 "WARNTUNNEL" 195 "WARNTRACTOR" 196 "WARNRWORKSVEHICLE" 197 "WARNNARROWBRIDGE" 198 "WARNFLAGGER" 199 "LANES" 200 "LANESHIFTL" 201 "LANESHIFTR" 202 "NEWLANEL" 203 "NEWLANER" 204 "RIGHTTURNONRED" 205 "BORDERLIMIT" 206 "EMBEDDEDRAIN" ;
VAL_ 240 VFC_TS02_EmbedFlag 0 "Unknown" 1 "Not Embedded" 2 "Border Limit" 3 "Multi Lane" 4 "Rain" 5 "Vehicle Type" 6 "Plate" 7 "Error Value" ;
VAL_ 240 VFC_TS02_Quality 0 "Poor Quality" 1 "Good Quality" ;
VAL_ 240 VFC_TS02_VMS 0 "Fixed" 1 "Variable" ;
VAL_ 240 VFC_TS02_Stable 0 "Object Is Not Stable" 1 "Object Is Stable" ;
VAL_ 240 VFC_TS02_VehicleSticker 0 "not_sticker_on_vehicle" 1 "Sign is a sticker on a vehicle" ;
VAL_ 240 VFC_TS02_InternalTrack 0 "Sign is not an internal track" 1 "Sign is an internal track" ;
VAL_ 240 VFC_TS02_AddTS1Class 0 "UNKNOWN" 1 "DETECTED" 2 "ACCIDENT" 3 "ADVICE" 4 "BEGINS" 5 "BUS" 6 "CAMPER" 7 "CAR" 8 "CARAVAN" 9 "CRASHRISK" 10 "DIRT" 11 "DISTANCE" 12 "DISTANCEBARS" 13 "END" 14 "EXITL" 15 "EXITR" 16 "FOG" 17 "GRAVEL" 18 "HAZMAT" 19 "HUMP" 20 "JAM" 21 "LORRY" 22 "EXCEPTLORRY" 23 "LOWTREE" 24 "MCYCLE" 25 "MINIMUM" 26 "NIGHT" 27 "NOSTOPSHOULDER" 28 "OILTRAIL" 29 "PRIOTURN" 30 "RADAR" 31 "RAIN" 32 "RAINSNOW" 33 "REMINDER" 34 "ROADDAMAGE" 35 "RUTS" 36 "RWORKSACCESS" 37 "RWORKSENTRY" 38 "RWORKSEXIT" 39 "SCHOOL" 40 "SECTION" 41 "SMOKE" 42 "SNOW" 43 "SOFTSHOULDERCAR" 44 "SHOFTSHOULDERLORRY" 45 "TEXT" 46 "TIME" 47 "TOWING" 48 "TRACTOR" 49 "TRACTOR_OVER" 50 "TRAILER" 51 "WEIGHT" 52 "WET" 53 "WITHIN" 54 "ZONE" 55 "EXIT" 56 "ACCESS" 57 "ALLWAY" 58 "EXCEPTBUS" 59 "EXCEPTDELIVERY" 60 "EXCEPTLOCAL" 61 "FROG" 62 "PRIOTURNL" 63 "PRIOTURNR" 64 "START" 65 "STOPIN" 66 "HAZWATER" 67 "DAY" 68 "SL" ;
VAL_ 240 VFC_TS02_AddTS1Quality 0 "Poor Quality" 1 "Good Quality" ;
VAL_ 240 VFC_TS02_AddTS1VMS 0 "Fixed" 1 "Variable" ;
VAL_ 240 VFC_TS02_AddTS2Class 0 "UNKNOWN" 1 "DETECTED" 2 "ACCIDENT" 3 "ADVICE" 4 "BEGINS" 5 "BUS" 6 "CAMPER" 7 "CAR" 8 "CARAVAN" 9 "CRASHRISK" 10 "DIRT" 11 "DISTANCE" 12 "DISTANCEBARS" 13 "END" 14 "EXITL" 15 "EXITR" 16 "FOG" 17 "GRAVEL" 18 "HAZMAT" 19 "HUMP" 20 "JAM" 21 "LORRY" 22 "EXCEPTLORRY" 23 "LOWTREE" 24 "MCYCLE" 25 "MINIMUM" 26 "NIGHT" 27 "NOSTOPSHOULDER" 28 "OILTRAIL" 29 "PRIOTURN" 30 "RADAR" 31 "RAIN" 32 "RAINSNOW" 33 "REMINDER" 34 "ROADDAMAGE" 35 "RUTS" 36 "RWORKSACCESS" 37 "RWORKSENTRY" 38 "RWORKSEXIT" 39 "SCHOOL" 40 "SECTION" 41 "SMOKE" 42 "SNOW" 43 "SOFTSHOULDERCAR" 44 "SHOFTSHOULDERLORRY" 45 "TEXT" 46 "TIME" 47 "TOWING" 48 "TRACTOR" 49 "TRACTOR_OVER" 50 "TRAILER" 51 "WEIGHT" 52 "WET" 53 "WITHIN" 54 "ZONE" 55 "EXIT" 56 "ACCESS" 57 "ALLWAY" 58 "EXCEPTBUS" 59 "EXCEPTDELIVERY" 60 "EXCEPTLOCAL" 61 "FROG" 62 "PRIOTURNL" 63 "PRIOTURNR" 64 "START" 65 "STOPIN" 66 "HAZWATER" 67 "DAY" 68 "SL" ;
VAL_ 240 VFC_TS02_AddTS2Quality 0 "Poor Quality" 1 "Good Quality" ;
VAL_ 240 VFC_TS02_AddTS2VMS 0 "Fixed" 1 "Variable" ;
VAL_ 240 VFC_TS02_AddTS3Class 0 "UNKNOWN" 1 "DETECTED" 2 "ACCIDENT" 3 "ADVICE" 4 "BEGINS" 5 "BUS" 6 "CAMPER" 7 "CAR" 8 "CARAVAN" 9 "CRASHRISK" 10 "DIRT" 11 "DISTANCE" 12 "DISTANCEBARS" 13 "END" 14 "EXITL" 15 "EXITR" 16 "FOG" 17 "GRAVEL" 18 "HAZMAT" 19 "HUMP" 20 "JAM" 21 "LORRY" 22 "EXCEPTLORRY" 23 "LOWTREE" 24 "MCYCLE" 25 "MINIMUM" 26 "NIGHT" 27 "NOSTOPSHOULDER" 28 "OILTRAIL" 29 "PRIOTURN" 30 "RADAR" 31 "RAIN" 32 "RAINSNOW" 33 "REMINDER" 34 "ROADDAMAGE" 35 "RUTS" 36 "RWORKSACCESS" 37 "RWORKSENTRY" 38 "RWORKSEXIT" 39 "SCHOOL" 40 "SECTION" 41 "SMOKE" 42 "SNOW" 43 "SOFTSHOULDERCAR" 44 "SHOFTSHOULDERLORRY" 45 "TEXT" 46 "TIME" 47 "TOWING" 48 "TRACTOR" 49 "TRACTOR_OVER" 50 "TRAILER" 51 "WEIGHT" 52 "WET" 53 "WITHIN" 54 "ZONE" 55 "EXIT" 56 "ACCESS" 57 "ALLWAY" 58 "EXCEPTBUS" 59 "EXCEPTDELIVERY" 60 "EXCEPTLOCAL" 61 "FROG" 62 "PRIOTURNL" 63 "PRIOTURNR" 64 "START" 65 "STOPIN" 66 "HAZWATER" 67 "DAY" 68 "SL" ;
VAL_ 240 VFC_TS02_AddTS3Quality 0 "Poor Quality" 1 "Good Quality" ;
VAL_ 240 VFC_TS02_AddTS3VMS 0 "Fixed" 1 "Variable" ;
VAL_ 240 VFC_TS02_AddTS4Class 0 "UNKNOWN" 1 "DETECTED" 2 "ACCIDENT" 3 "ADVICE" 4 "BEGINS" 5 "BUS" 6 "CAMPER" 7 "CAR" 8 "CARAVAN" 9 "CRASHRISK" 10 "DIRT" 11 "DISTANCE" 12 "DISTANCEBARS" 13 "END" 14 "EXITL" 15 "EXITR" 16 "FOG" 17 "GRAVEL" 18 "HAZMAT" 19 "HUMP" 20 "JAM" 21 "LORRY" 22 "EXCEPTLORRY" 23 "LOWTREE" 24 "MCYCLE" 25 "MINIMUM" 26 "NIGHT" 27 "NOSTOPSHOULDER" 28 "OILTRAIL" 29 "PRIOTURN" 30 "RADAR" 31 "RAIN" 32 "RAINSNOW" 33 "REMINDER" 34 "ROADDAMAGE" 35 "RUTS" 36 "RWORKSACCESS" 37 "RWORKSENTRY" 38 "RWORKSEXIT" 39 "SCHOOL" 40 "SECTION" 41 "SMOKE" 42 "SNOW" 43 "SOFTSHOULDERCAR" 44 "SHOFTSHOULDERLORRY" 45 "TEXT" 46 "TIME" 47 "TOWING" 48 "TRACTOR" 49 "TRACTOR_OVER" 50 "TRAILER" 51 "WEIGHT" 52 "WET" 53 "WITHIN" 54 "ZONE" 55 "EXIT" 56 "ACCESS" 57 "ALLWAY" 58 "EXCEPTBUS" 59 "EXCEPTDELIVERY" 60 "EXCEPTLOCAL" 61 "FROG" 62 "PRIOTURNL" 63 "PRIOTURNR" 64 "START" 65 "STOPIN" 66 "HAZWATER" 67 "DAY" 68 "SL" ;
VAL_ 240 VFC_TS02_AddTS4Quality 0 "Poor Quality" 1 "Good Quality" ;
VAL_ 240 VFC_TS02_AddTS4VMS 0 "Fixed" 1 "Variable" ;
VAL_ 240 VFC_TS02_AddTS5Class 0 "UNKNOWN" 1 "DETECTED" 2 "ACCIDENT" 3 "ADVICE" 4 "BEGINS" 5 "BUS" 6 "CAMPER" 7 "CAR" 8 "CARAVAN" 9 "CRASHRISK" 10 "DIRT" 11 "DISTANCE" 12 "DISTANCEBARS" 13 "END" 14 "EXITL" 15 "EXITR" 16 "FOG" 17 "GRAVEL" 18 "HAZMAT" 19 "HUMP" 20 "JAM" 21 "LORRY" 22 "EXCEPTLORRY" 23 "LOWTREE" 24 "MCYCLE" 25 "MINIMUM" 26 "NIGHT" 27 "NOSTOPSHOULDER" 28 "OILTRAIL" 29 "PRIOTURN" 30 "RADAR" 31 "RAIN" 32 "RAINSNOW" 33 "REMINDER" 34 "ROADDAMAGE" 35 "RUTS" 36 "RWORKSACCESS" 37 "RWORKSENTRY" 38 "RWORKSEXIT" 39 "SCHOOL" 40 "SECTION" 41 "SMOKE" 42 "SNOW" 43 "SOFTSHOULDERCAR" 44 "SHOFTSHOULDERLORRY" 45 "TEXT" 46 "TIME" 47 "TOWING" 48 "TRACTOR" 49 "TRACTOR_OVER" 50 "TRAILER" 51 "WEIGHT" 52 "WET" 53 "WITHIN" 54 "ZONE" 55 "EXIT" 56 "ACCESS" 57 "ALLWAY" 58 "EXCEPTBUS" 59 "EXCEPTDELIVERY" 60 "EXCEPTLOCAL" 61 "FROG" 62 "PRIOTURNL" 63 "PRIOTURNR" 64 "START" 65 "STOPIN" 66 "HAZWATER" 67 "DAY" 68 "SL" ;
VAL_ 240 VFC_TS02_AddTS5Quality 0 "Poor Quality" 1 "Good Quality" ;
VAL_ 240 VFC_TS02_AddTS5VMS 0 "Fixed" 1 "Variable" ;
VAL_ 240 VFC_TS02_AddTS6Class 0 "UNKNOWN" 1 "DETECTED" 2 "ACCIDENT" 3 "ADVICE" 4 "BEGINS" 5 "BUS" 6 "CAMPER" 7 "CAR" 8 "CARAVAN" 9 "CRASHRISK" 10 "DIRT" 11 "DISTANCE" 12 "DISTANCEBARS" 13 "END" 14 "EXITL" 15 "EXITR" 16 "FOG" 17 "GRAVEL" 18 "HAZMAT" 19 "HUMP" 20 "JAM" 21 "LORRY" 22 "EXCEPTLORRY" 23 "LOWTREE" 24 "MCYCLE" 25 "MINIMUM" 26 "NIGHT" 27 "NOSTOPSHOULDER" 28 "OILTRAIL" 29 "PRIOTURN" 30 "RADAR" 31 "RAIN" 32 "RAINSNOW" 33 "REMINDER" 34 "ROADDAMAGE" 35 "RUTS" 36 "RWORKSACCESS" 37 "RWORKSENTRY" 38 "RWORKSEXIT" 39 "SCHOOL" 40 "SECTION" 41 "SMOKE" 42 "SNOW" 43 "SOFTSHOULDERCAR" 44 "SHOFTSHOULDERLORRY" 45 "TEXT" 46 "TIME" 47 "TOWING" 48 "TRACTOR" 49 "TRACTOR_OVER" 50 "TRAILER" 51 "WEIGHT" 52 "WET" 53 "WITHIN" 54 "ZONE" 55 "EXIT" 56 "ACCESS" 57 "ALLWAY" 58 "EXCEPTBUS" 59 "EXCEPTDELIVERY" 60 "EXCEPTLOCAL" 61 "FROG" 62 "PRIOTURNL" 63 "PRIOTURNR" 64 "START" 65 "STOPIN" 66 "HAZWATER" 67 "DAY" 68 "SL" ;
VAL_ 240 VFC_TS02_AddTS6Quality 0 "Poor Quality" 1 "Good Quality" ;
VAL_ 240 VFC_TS02_AddTS6VMS 0 "Fixed" 1 "Variable" ;
VAL_ 241 VFC_TS03_ID 0 "INVALID" ;
VAL_ 241 VFC_TS03_Class 0 "UNKNOWN" 1 "SL5" 2 "SL10" 3 "SL15" 4 "SL20" 5 "SL25" 6 "SL30" 7 "SL35" 8 "SL40" 9 "SL45" 10 "SL50" 11 "SL55" 12 "SL60" 13 "SL65" 14 "SL70" 15 "SL75" 16 "SL80" 17 "SL85" 18 "SL90" 19 "SL95" 20 "SL100" 21 "SL105" 22 "SL110" 23 "SL115" 24 "SL120" 25 "SL125" 26 "SL130" 27 "SL135" 28 "SL140" 29 "SL145" 30 "SL150" 31 "SL155" 32 "SL160" 33 "ESL" 34 "EA" 35 "OP" 36 "EOP" 37 "OL" 38 "EOL" 39 "GIVEWAY" 40 "PRIOCROSS" 41 "PRIOCROSSYIELDTORIGHT" 42 "PRIOSTREET" 43 "EPRIOSTREET" 44 "STOP" 45 "AXLEWEIGHT" 46 "CARDIST" 47 "HEIGHT" 48 "LENGTH" 49 "LORRYDIST" 50 "NOALL" 51 "NOBIKE" 52 "NOBUS" 53 "NOCAR" 54 "NOCARBIKE" 55 "NOCARRIAGE" 56 "NOENTRY" 57 "NOHAZMAT" 58 "NOHAZWATER" 59 "NOLORRY" 60 "NOLORRYTRAILER" 61 "NOLTURN" 62 "NOPED" 63 "NORIDER" 64 "NORTURN" 65 "NOTRACTOR" 66 "NOTWOWAY" 67 "NOUTURN" 68 "UMWELT" 69 "EUMWELT" 70 "WEIGHT" 71 "WIDTH" 72 "WARNBIKE" 73 "WARNBUS" 74 "WARNCATTLE" 75 "WARNCONST" 76 "WARNCONSTL" 77 "WARNCONSTR" 78 "WARNCURVEL" 79 "WARNCURVER" 80 "WARNDANGER" 81 "WARNDCURVEL" 82 "WARNDCURVER" 83 "WARNDRAWBRIDGE" 84 "WARNFROG" 85 "WARNGRAVEL" 86 "WARNHUMP" 87 "WARNJAM" 88 "WARNKIDS" 89 "WARNLIGHTS" 90 "WARNLOWTREE" 91 "WARNPCROSS" 92 "WARNPED" 93 "WARNPIER" 94 "WARNPLANE" 95 "WARNRIDER" 96 "WARNROCK" 97 "WARNROUND" 98 "WARNRWORKS" 99 "WARNSKID" 100 "WARNSLOPED" 101 "WARNSLOPEU" 102 "WARNSNOW" 103 "WARNTRAIN" 104 "WARNTWOWAY" 105 "WARNWILDANIMAL" 106 "WARNWIND" 107 "ASL" 108 "EASL" 109 "CALM" 110 "ECALM" 111 "DEADEND" 112 "DOUANE" 113 "FWAY" 114 "EFWAY" 115 "HWAY" 116 "EHWAY" 117 "MSL" 118 "EMSL" 119 "NOPARK" 120 "NOSTOP" 121 "ONEWAYS" 122 "ONEWAYU" 123 "SLOWDOWN" 124 "SCHOOL" 125 "ESCHOOL" 126 "TWN" 127 "ETWN" 128 "WBBENTLEFT" 129 "WBBENTLEFTRIGHT" 130 "WBBENTRIGHT" 131 "WBDIAGL" 132 "WBDIAGLR" 133 "WBDIAGR" 134 "WBHAZWATER" 135 "WBLEFT" 136 "WBRIGHT" 137 "WBROUND" 138 "WBUP" 139 "WBUPLEFT" 140 "WBUPRIGHT" 141 "ZEBRA" 142 "HAZMAT" 143 "EMERGENCYBAY" 144 "ENDOFLANEL" 145 "ENDOFLANER" 146 "ENOPARK" 147 "EONEWAY" 148 "EPARK" 149 "ETOLL" 150 "NOPARKL" 151 "NOPARKLR" 152 "NOPARKR" 153 "NOSTOPL" 154 "NOSTOPLR" 155 "NOSTOPR" 156 "NOTURNONRED" 157 "ONEWAYL" 158 "ONEWAYR" 159 "PARK" 160 "PRIOCROSSL" 161 "PRIOCROSSR" 162 "TOLL" 163 "TUNNEL" 164 "TWOWAY" 165 "WARNCROSS" 166 "WARNCROSSL" 167 "WARNCROSSLR" 168 "WARNCROSSR" 169 "WARNCROSSRL" 170 "WARNCROSST" 171 "WARNGIVEWAYAHEAD" 172 "WARNSLAHEAD" 173 "WARNSTOPAHEAD" 174 "WBBUS" 175 "WRONGWAY" 176 "HAZWATER" 177 "GIVEWAYROUND" 178 "WARNWINDINGL" 179 "WARNWINDINGR" 180 "WARNHAIRPINL" 181 "WARNHAIRPINR" 182 "WARNPEDBIKE" 183 "WARNCROSSY" 184 "WARNBRANCHL" 185 "WARNBRANCHR" 186 "WARNAXLEWEIGHT" 187 "WARNWEIGHT" 188 "WARNHEIGHT" 189 "WARNLENGTH" 190 "WARNWIDTH" 191 "WARNBLACKSPOT" 192 "WARNMERGEL" 193 "WARNMERGER" 194 "WARNTUNNEL" 195 "WARNTRACTOR" 196 "WARNRWORKSVEHICLE" 197 "WARNNARROWBRIDGE" 198 "WARNFLAGGER" 199 "LANES" 200 "LANESHIFTL" 201 "LANESHIFTR" 202 "NEWLANEL" 203 "NEWLANER" 204 "RIGHTTURNONRED" 205 "BORDERLIMIT" 206 "EMBEDDEDRAIN" ;
VAL_ 241 VFC_TS03_EmbedFlag 0 "Unknown" 1 "Not Embedded" 2 "Border Limit" 3 "Multi Lane" 4 "Rain" 5 "Vehicle Type" 6 "Plate" 7 "Error Value" ;
VAL_ 241 VFC_TS03_Quality 0 "Poor Quality" 1 "Good Quality" ;
VAL_ 241 VFC_TS03_VMS 0 "Fixed" 1 "Variable" ;
VAL_ 241 VFC_TS03_Stable 0 "Object Is Not Stable" 1 "Object Is Stable" ;
VAL_ 241 VFC_TS03_VehicleSticker 0 "not_sticker_on_vehicle" 1 "Sign is a sticker on a vehicle" ;
VAL_ 241 VFC_TS03_InternalTrack 0 "Sign is not an internal track" 1 "Sign is an internal track" ;
VAL_ 241 VFC_TS03_AddTS1Class 0 "UNKNOWN" 1 "DETECTED" 2 "ACCIDENT" 3 "ADVICE" 4 "BEGINS" 5 "BUS" 6 "CAMPER" 7 "CAR" 8 "CARAVAN" 9 "CRASHRISK" 10 "DIRT" 11 "DISTANCE" 12 "DISTANCEBARS" 13 "END" 14 "EXITL" 15 "EXITR" 16 "FOG" 17 "GRAVEL" 18 "HAZMAT" 19 "HUMP" 20 "JAM" 21 "LORRY" 22 "EXCEPTLORRY" 23 "LOWTREE" 24 "MCYCLE" 25 "MINIMUM" 26 "NIGHT" 27 "NOSTOPSHOULDER" 28 "OILTRAIL" 29 "PRIOTURN" 30 "RADAR" 31 "RAIN" 32 "RAINSNOW" 33 "REMINDER" 34 "ROADDAMAGE" 35 "RUTS" 36 "RWORKSACCESS" 37 "RWORKSENTRY" 38 "RWORKSEXIT" 39 "SCHOOL" 40 "SECTION" 41 "SMOKE" 42 "SNOW" 43 "SOFTSHOULDERCAR" 44 "SHOFTSHOULDERLORRY" 45 "TEXT" 46 "TIME" 47 "TOWING" 48 "TRACTOR" 49 "TRACTOR_OVER" 50 "TRAILER" 51 "WEIGHT" 52 "WET" 53 "WITHIN" 54 "ZONE" 55 "EXIT" 56 "ACCESS" 57 "ALLWAY" 58 "EXCEPTBUS" 59 "EXCEPTDELIVERY" 60 "EXCEPTLOCAL" 61 "FROG" 62 "PRIOTURNL" 63 "PRIOTURNR" 64 "START" 65 "STOPIN" 66 "HAZWATER" 67 "DAY" 68 "SL" ;
VAL_ 241 VFC_TS03_AddTS1Quality 0 "Poor Quality" 1 "Good Quality" ;
VAL_ 241 VFC_TS03_AddTS1VMS 0 "Fixed" 1 "Variable" ;
VAL_ 241 VFC_TS03_AddTS2Class 0 "UNKNOWN" 1 "DETECTED" 2 "ACCIDENT" 3 "ADVICE" 4 "BEGINS" 5 "BUS" 6 "CAMPER" 7 "CAR" 8 "CARAVAN" 9 "CRASHRISK" 10 "DIRT" 11 "DISTANCE" 12 "DISTANCEBARS" 13 "END" 14 "EXITL" 15 "EXITR" 16 "FOG" 17 "GRAVEL" 18 "HAZMAT" 19 "HUMP" 20 "JAM" 21 "LORRY" 22 "EXCEPTLORRY" 23 "LOWTREE" 24 "MCYCLE" 25 "MINIMUM" 26 "NIGHT" 27 "NOSTOPSHOULDER" 28 "OILTRAIL" 29 "PRIOTURN" 30 "RADAR" 31 "RAIN" 32 "RAINSNOW" 33 "REMINDER" 34 "ROADDAMAGE" 35 "RUTS" 36 "RWORKSACCESS" 37 "RWORKSENTRY" 38 "RWORKSEXIT" 39 "SCHOOL" 40 "SECTION" 41 "SMOKE" 42 "SNOW" 43 "SOFTSHOULDERCAR" 44 "SHOFTSHOULDERLORRY" 45 "TEXT" 46 "TIME" 47 "TOWING" 48 "TRACTOR" 49 "TRACTOR_OVER" 50 "TRAILER" 51 "WEIGHT" 52 "WET" 53 "WITHIN" 54 "ZONE" 55 "EXIT" 56 "ACCESS" 57 "ALLWAY" 58 "EXCEPTBUS" 59 "EXCEPTDELIVERY" 60 "EXCEPTLOCAL" 61 "FROG" 62 "PRIOTURNL" 63 "PRIOTURNR" 64 "START" 65 "STOPIN" 66 "HAZWATER" 67 "DAY" 68 "SL" ;
VAL_ 241 VFC_TS03_AddTS2Quality 0 "Poor Quality" 1 "Good Quality" ;
VAL_ 241 VFC_TS03_AddTS2VMS 0 "Fixed" 1 "Variable" ;
VAL_ 241 VFC_TS03_AddTS3Class 0 "UNKNOWN" 1 "DETECTED" 2 "ACCIDENT" 3 "ADVICE" 4 "BEGINS" 5 "BUS" 6 "CAMPER" 7 "CAR" 8 "CARAVAN" 9 "CRASHRISK" 10 "DIRT" 11 "DISTANCE" 12 "DISTANCEBARS" 13 "END" 14 "EXITL" 15 "EXITR" 16 "FOG" 17 "GRAVEL" 18 "HAZMAT" 19 "HUMP" 20 "JAM" 21 "LORRY" 22 "EXCEPTLORRY" 23 "LOWTREE" 24 "MCYCLE" 25 "MINIMUM" 26 "NIGHT" 27 "NOSTOPSHOULDER" 28 "OILTRAIL" 29 "PRIOTURN" 30 "RADAR" 31 "RAIN" 32 "RAINSNOW" 33 "REMINDER" 34 "ROADDAMAGE" 35 "RUTS" 36 "RWORKSACCESS" 37 "RWORKSENTRY" 38 "RWORKSEXIT" 39 "SCHOOL" 40 "SECTION" 41 "SMOKE" 42 "SNOW" 43 "SOFTSHOULDERCAR" 44 "SHOFTSHOULDERLORRY" 45 "TEXT" 46 "TIME" 47 "TOWING" 48 "TRACTOR" 49 "TRACTOR_OVER" 50 "TRAILER" 51 "WEIGHT" 52 "WET" 53 "WITHIN" 54 "ZONE" 55 "EXIT" 56 "ACCESS" 57 "ALLWAY" 58 "EXCEPTBUS" 59 "EXCEPTDELIVERY" 60 "EXCEPTLOCAL" 61 "FROG" 62 "PRIOTURNL" 63 "PRIOTURNR" 64 "START" 65 "STOPIN" 66 "HAZWATER" 67 "DAY" 68 "SL" ;
VAL_ 241 VFC_TS03_AddTS3Quality 0 "Poor Quality" 1 "Good Quality" ;
VAL_ 241 VFC_TS03_AddTS3VMS 0 "Fixed" 1 "Variable" ;
VAL_ 241 VFC_TS03_AddTS4Class 0 "UNKNOWN" 1 "DETECTED" 2 "ACCIDENT" 3 "ADVICE" 4 "BEGINS" 5 "BUS" 6 "CAMPER" 7 "CAR" 8 "CARAVAN" 9 "CRASHRISK" 10 "DIRT" 11 "DISTANCE" 12 "DISTANCEBARS" 13 "END" 14 "EXITL" 15 "EXITR" 16 "FOG" 17 "GRAVEL" 18 "HAZMAT" 19 "HUMP" 20 "JAM" 21 "LORRY" 22 "EXCEPTLORRY" 23 "LOWTREE" 24 "MCYCLE" 25 "MINIMUM" 26 "NIGHT" 27 "NOSTOPSHOULDER" 28 "OILTRAIL" 29 "PRIOTURN" 30 "RADAR" 31 "RAIN" 32 "RAINSNOW" 33 "REMINDER" 34 "ROADDAMAGE" 35 "RUTS" 36 "RWORKSACCESS" 37 "RWORKSENTRY" 38 "RWORKSEXIT" 39 "SCHOOL" 40 "SECTION" 41 "SMOKE" 42 "SNOW" 43 "SOFTSHOULDERCAR" 44 "SHOFTSHOULDERLORRY" 45 "TEXT" 46 "TIME" 47 "TOWING" 48 "TRACTOR" 49 "TRACTOR_OVER" 50 "TRAILER" 51 "WEIGHT" 52 "WET" 53 "WITHIN" 54 "ZONE" 55 "EXIT" 56 "ACCESS" 57 "ALLWAY" 58 "EXCEPTBUS" 59 "EXCEPTDELIVERY" 60 "EXCEPTLOCAL" 61 "FROG" 62 "PRIOTURNL" 63 "PRIOTURNR" 64 "START" 65 "STOPIN" 66 "HAZWATER" 67 "DAY" 68 "SL" ;
VAL_ 241 VFC_TS03_AddTS4Quality 0 "Poor Quality" 1 "Good Quality" ;
VAL_ 241 VFC_TS03_AddTS4VMS 0 "Fixed" 1 "Variable" ;
VAL_ 241 VFC_TS03_AddTS5Class 0 "UNKNOWN" 1 "DETECTED" 2 "ACCIDENT" 3 "ADVICE" 4 "BEGINS" 5 "BUS" 6 "CAMPER" 7 "CAR" 8 "CARAVAN" 9 "CRASHRISK" 10 "DIRT" 11 "DISTANCE" 12 "DISTANCEBARS" 13 "END" 14 "EXITL" 15 "EXITR" 16 "FOG" 17 "GRAVEL" 18 "HAZMAT" 19 "HUMP" 20 "JAM" 21 "LORRY" 22 "EXCEPTLORRY" 23 "LOWTREE" 24 "MCYCLE" 25 "MINIMUM" 26 "NIGHT" 27 "NOSTOPSHOULDER" 28 "OILTRAIL" 29 "PRIOTURN" 30 "RADAR" 31 "RAIN" 32 "RAINSNOW" 33 "REMINDER" 34 "ROADDAMAGE" 35 "RUTS" 36 "RWORKSACCESS" 37 "RWORKSENTRY" 38 "RWORKSEXIT" 39 "SCHOOL" 40 "SECTION" 41 "SMOKE" 42 "SNOW" 43 "SOFTSHOULDERCAR" 44 "SHOFTSHOULDERLORRY" 45 "TEXT" 46 "TIME" 47 "TOWING" 48 "TRACTOR" 49 "TRACTOR_OVER" 50 "TRAILER" 51 "WEIGHT" 52 "WET" 53 "WITHIN" 54 "ZONE" 55 "EXIT" 56 "ACCESS" 57 "ALLWAY" 58 "EXCEPTBUS" 59 "EXCEPTDELIVERY" 60 "EXCEPTLOCAL" 61 "FROG" 62 "PRIOTURNL" 63 "PRIOTURNR" 64 "START" 65 "STOPIN" 66 "HAZWATER" 67 "DAY" 68 "SL" ;
VAL_ 241 VFC_TS03_AddTS5Quality 0 "Poor Quality" 1 "Good Quality" ;
VAL_ 241 VFC_TS03_AddTS5VMS 0 "Fixed" 1 "Variable" ;
VAL_ 241 VFC_TS03_AddTS6Class 0 "UNKNOWN" 1 "DETECTED" 2 "ACCIDENT" 3 "ADVICE" 4 "BEGINS" 5 "BUS" 6 "CAMPER" 7 "CAR" 8 "CARAVAN" 9 "CRASHRISK" 10 "DIRT" 11 "DISTANCE" 12 "DISTANCEBARS" 13 "END" 14 "EXITL" 15 "EXITR" 16 "FOG" 17 "GRAVEL" 18 "HAZMAT" 19 "HUMP" 20 "JAM" 21 "LORRY" 22 "EXCEPTLORRY" 23 "LOWTREE" 24 "MCYCLE" 25 "MINIMUM" 26 "NIGHT" 27 "NOSTOPSHOULDER" 28 "OILTRAIL" 29 "PRIOTURN" 30 "RADAR" 31 "RAIN" 32 "RAINSNOW" 33 "REMINDER" 34 "ROADDAMAGE" 35 "RUTS" 36 "RWORKSACCESS" 37 "RWORKSENTRY" 38 "RWORKSEXIT" 39 "SCHOOL" 40 "SECTION" 41 "SMOKE" 42 "SNOW" 43 "SOFTSHOULDERCAR" 44 "SHOFTSHOULDERLORRY" 45 "TEXT" 46 "TIME" 47 "TOWING" 48 "TRACTOR" 49 "TRACTOR_OVER" 50 "TRAILER" 51 "WEIGHT" 52 "WET" 53 "WITHIN" 54 "ZONE" 55 "EXIT" 56 "ACCESS" 57 "ALLWAY" 58 "EXCEPTBUS" 59 "EXCEPTDELIVERY" 60 "EXCEPTLOCAL" 61 "FROG" 62 "PRIOTURNL" 63 "PRIOTURNR" 64 "START" 65 "STOPIN" 66 "HAZWATER" 67 "DAY" 68 "SL" ;
VAL_ 241 VFC_TS03_AddTS6Quality 0 "Poor Quality" 1 "Good Quality" ;
VAL_ 241 VFC_TS03_AddTS6VMS 0 "Fixed" 1 "Variable" ;
VAL_ 242 VFC_TS04_ID 0 "INVALID" ;
VAL_ 242 VFC_TS04_Class 0 "UNKNOWN" 1 "SL5" 2 "SL10" 3 "SL15" 4 "SL20" 5 "SL25" 6 "SL30" 7 "SL35" 8 "SL40" 9 "SL45" 10 "SL50" 11 "SL55" 12 "SL60" 13 "SL65" 14 "SL70" 15 "SL75" 16 "SL80" 17 "SL85" 18 "SL90" 19 "SL95" 20 "SL100" 21 "SL105" 22 "SL110" 23 "SL115" 24 "SL120" 25 "SL125" 26 "SL130" 27 "SL135" 28 "SL140" 29 "SL145" 30 "SL150" 31 "SL155" 32 "SL160" 33 "ESL" 34 "EA" 35 "OP" 36 "EOP" 37 "OL" 38 "EOL" 39 "GIVEWAY" 40 "PRIOCROSS" 41 "PRIOCROSSYIELDTORIGHT" 42 "PRIOSTREET" 43 "EPRIOSTREET" 44 "STOP" 45 "AXLEWEIGHT" 46 "CARDIST" 47 "HEIGHT" 48 "LENGTH" 49 "LORRYDIST" 50 "NOALL" 51 "NOBIKE" 52 "NOBUS" 53 "NOCAR" 54 "NOCARBIKE" 55 "NOCARRIAGE" 56 "NOENTRY" 57 "NOHAZMAT" 58 "NOHAZWATER" 59 "NOLORRY" 60 "NOLORRYTRAILER" 61 "NOLTURN" 62 "NOPED" 63 "NORIDER" 64 "NORTURN" 65 "NOTRACTOR" 66 "NOTWOWAY" 67 "NOUTURN" 68 "UMWELT" 69 "EUMWELT" 70 "WEIGHT" 71 "WIDTH" 72 "WARNBIKE" 73 "WARNBUS" 74 "WARNCATTLE" 75 "WARNCONST" 76 "WARNCONSTL" 77 "WARNCONSTR" 78 "WARNCURVEL" 79 "WARNCURVER" 80 "WARNDANGER" 81 "WARNDCURVEL" 82 "WARNDCURVER" 83 "WARNDRAWBRIDGE" 84 "WARNFROG" 85 "WARNGRAVEL" 86 "WARNHUMP" 87 "WARNJAM" 88 "WARNKIDS" 89 "WARNLIGHTS" 90 "WARNLOWTREE" 91 "WARNPCROSS" 92 "WARNPED" 93 "WARNPIER" 94 "WARNPLANE" 95 "WARNRIDER" 96 "WARNROCK" 97 "WARNROUND" 98 "WARNRWORKS" 99 "WARNSKID" 100 "WARNSLOPED" 101 "WARNSLOPEU" 102 "WARNSNOW" 103 "WARNTRAIN" 104 "WARNTWOWAY" 105 "WARNWILDANIMAL" 106 "WARNWIND" 107 "ASL" 108 "EASL" 109 "CALM" 110 "ECALM" 111 "DEADEND" 112 "DOUANE" 113 "FWAY" 114 "EFWAY" 115 "HWAY" 116 "EHWAY" 117 "MSL" 118 "EMSL" 119 "NOPARK" 120 "NOSTOP" 121 "ONEWAYS" 122 "ONEWAYU" 123 "SLOWDOWN" 124 "SCHOOL" 125 "ESCHOOL" 126 "TWN" 127 "ETWN" 128 "WBBENTLEFT" 129 "WBBENTLEFTRIGHT" 130 "WBBENTRIGHT" 131 "WBDIAGL" 132 "WBDIAGLR" 133 "WBDIAGR" 134 "WBHAZWATER" 135 "WBLEFT" 136 "WBRIGHT" 137 "WBROUND" 138 "WBUP" 139 "WBUPLEFT" 140 "WBUPRIGHT" 141 "ZEBRA" 142 "HAZMAT" 143 "EMERGENCYBAY" 144 "ENDOFLANEL" 145 "ENDOFLANER" 146 "ENOPARK" 147 "EONEWAY" 148 "EPARK" 149 "ETOLL" 150 "NOPARKL" 151 "NOPARKLR" 152 "NOPARKR" 153 "NOSTOPL" 154 "NOSTOPLR" 155 "NOSTOPR" 156 "NOTURNONRED" 157 "ONEWAYL" 158 "ONEWAYR" 159 "PARK" 160 "PRIOCROSSL" 161 "PRIOCROSSR" 162 "TOLL" 163 "TUNNEL" 164 "TWOWAY" 165 "WARNCROSS" 166 "WARNCROSSL" 167 "WARNCROSSLR" 168 "WARNCROSSR" 169 "WARNCROSSRL" 170 "WARNCROSST" 171 "WARNGIVEWAYAHEAD" 172 "WARNSLAHEAD" 173 "WARNSTOPAHEAD" 174 "WBBUS" 175 "WRONGWAY" 176 "HAZWATER" 177 "GIVEWAYROUND" 178 "WARNWINDINGL" 179 "WARNWINDINGR" 180 "WARNHAIRPINL" 181 "WARNHAIRPINR" 182 "WARNPEDBIKE" 183 "WARNCROSSY" 184 "WARNBRANCHL" 185 "WARNBRANCHR" 186 "WARNAXLEWEIGHT" 187 "WARNWEIGHT" 188 "WARNHEIGHT" 189 "WARNLENGTH" 190 "WARNWIDTH" 191 "WARNBLACKSPOT" 192 "WARNMERGEL" 193 "WARNMERGER" 194 "WARNTUNNEL" 195 "WARNTRACTOR" 196 "WARNRWORKSVEHICLE" 197 "WARNNARROWBRIDGE" 198 "WARNFLAGGER" 199 "LANES" 200 "LANESHIFTL" 201 "LANESHIFTR" 202 "NEWLANEL" 203 "NEWLANER" 204 "RIGHTTURNONRED" 205 "BORDERLIMIT" 206 "EMBEDDEDRAIN" ;
VAL_ 242 VFC_TS04_EmbedFlag 0 "Unknown" 1 "Not Embedded" 2 "Border Limit" 3 "Multi Lane" 4 "Rain" 5 "Vehicle Type" 6 "Plate" 7 "Error Value" ;
VAL_ 242 VFC_TS04_Quality 0 "Poor Quality" 1 "Good Quality" ;
VAL_ 242 VFC_TS04_VMS 0 "Fixed" 1 "Variable" ;
VAL_ 242 VFC_TS04_Stable 0 "Object Is Not Stable" 1 "Object Is Stable" ;
VAL_ 242 VFC_TS04_VehicleSticker 0 "not_sticker_on_vehicle" 1 "Sign is a sticker on a vehicle" ;
VAL_ 242 VFC_TS04_InternalTrack 0 "Sign is not an internal track" 1 "Sign is an internal track" ;
VAL_ 242 VFC_TS04_AddTS1Class 0 "UNKNOWN" 1 "DETECTED" 2 "ACCIDENT" 3 "ADVICE" 4 "BEGINS" 5 "BUS" 6 "CAMPER" 7 "CAR" 8 "CARAVAN" 9 "CRASHRISK" 10 "DIRT" 11 "DISTANCE" 12 "DISTANCEBARS" 13 "END" 14 "EXITL" 15 "EXITR" 16 "FOG" 17 "GRAVEL" 18 "HAZMAT" 19 "HUMP" 20 "JAM" 21 "LORRY" 22 "EXCEPTLORRY" 23 "LOWTREE" 24 "MCYCLE" 25 "MINIMUM" 26 "NIGHT" 27 "NOSTOPSHOULDER" 28 "OILTRAIL" 29 "PRIOTURN" 30 "RADAR" 31 "RAIN" 32 "RAINSNOW" 33 "REMINDER" 34 "ROADDAMAGE" 35 "RUTS" 36 "RWORKSACCESS" 37 "RWORKSENTRY" 38 "RWORKSEXIT" 39 "SCHOOL" 40 "SECTION" 41 "SMOKE" 42 "SNOW" 43 "SOFTSHOULDERCAR" 44 "SHOFTSHOULDERLORRY" 45 "TEXT" 46 "TIME" 47 "TOWING" 48 "TRACTOR" 49 "TRACTOR_OVER" 50 "TRAILER" 51 "WEIGHT" 52 "WET" 53 "WITHIN" 54 "ZONE" 55 "EXIT" 56 "ACCESS" 57 "ALLWAY" 58 "EXCEPTBUS" 59 "EXCEPTDELIVERY" 60 "EXCEPTLOCAL" 61 "FROG" 62 "PRIOTURNL" 63 "PRIOTURNR" 64 "START" 65 "STOPIN" 66 "HAZWATER" 67 "DAY" 68 "SL" ;
VAL_ 242 VFC_TS04_AddTS1Quality 0 "Poor Quality" 1 "Good Quality" ;
VAL_ 242 VFC_TS04_AddTS1VMS 0 "Fixed" 1 "Variable" ;
VAL_ 242 VFC_TS04_AddTS2Class 0 "UNKNOWN" 1 "DETECTED" 2 "ACCIDENT" 3 "ADVICE" 4 "BEGINS" 5 "BUS" 6 "CAMPER" 7 "CAR" 8 "CARAVAN" 9 "CRASHRISK" 10 "DIRT" 11 "DISTANCE" 12 "DISTANCEBARS" 13 "END" 14 "EXITL" 15 "EXITR" 16 "FOG" 17 "GRAVEL" 18 "HAZMAT" 19 "HUMP" 20 "JAM" 21 "LORRY" 22 "EXCEPTLORRY" 23 "LOWTREE" 24 "MCYCLE" 25 "MINIMUM" 26 "NIGHT" 27 "NOSTOPSHOULDER" 28 "OILTRAIL" 29 "PRIOTURN" 30 "RADAR" 31 "RAIN" 32 "RAINSNOW" 33 "REMINDER" 34 "ROADDAMAGE" 35 "RUTS" 36 "RWORKSACCESS" 37 "RWORKSENTRY" 38 "RWORKSEXIT" 39 "SCHOOL" 40 "SECTION" 41 "SMOKE" 42 "SNOW" 43 "SOFTSHOULDERCAR" 44 "SHOFTSHOULDERLORRY" 45 "TEXT" 46 "TIME" 47 "TOWING" 48 "TRACTOR" 49 "TRACTOR_OVER" 50 "TRAILER" 51 "WEIGHT" 52 "WET" 53 "WITHIN" 54 "ZONE" 55 "EXIT" 56 "ACCESS" 57 "ALLWAY" 58 "EXCEPTBUS" 59 "EXCEPTDELIVERY" 60 "EXCEPTLOCAL" 61 "FROG" 62 "PRIOTURNL" 63 "PRIOTURNR" 64 "START" 65 "STOPIN" 66 "HAZWATER" 67 "DAY" 68 "SL" ;
VAL_ 242 VFC_TS04_AddTS2Quality 0 "Poor Quality" 1 "Good Quality" ;
VAL_ 242 VFC_TS04_AddTS2VMS 0 "Fixed" 1 "Variable" ;
VAL_ 242 VFC_TS04_AddTS3Class 0 "UNKNOWN" 1 "DETECTED" 2 "ACCIDENT" 3 "ADVICE" 4 "BEGINS" 5 "BUS" 6 "CAMPER" 7 "CAR" 8 "CARAVAN" 9 "CRASHRISK" 10 "DIRT" 11 "DISTANCE" 12 "DISTANCEBARS" 13 "END" 14 "EXITL" 15 "EXITR" 16 "FOG" 17 "GRAVEL" 18 "HAZMAT" 19 "HUMP" 20 "JAM" 21 "LORRY" 22 "EXCEPTLORRY" 23 "LOWTREE" 24 "MCYCLE" 25 "MINIMUM" 26 "NIGHT" 27 "NOSTOPSHOULDER" 28 "OILTRAIL" 29 "PRIOTURN" 30 "RADAR" 31 "RAIN" 32 "RAINSNOW" 33 "REMINDER" 34 "ROADDAMAGE" 35 "RUTS" 36 "RWORKSACCESS" 37 "RWORKSENTRY" 38 "RWORKSEXIT" 39 "SCHOOL" 40 "SECTION" 41 "SMOKE" 42 "SNOW" 43 "SOFTSHOULDERCAR" 44 "SHOFTSHOULDERLORRY" 45 "TEXT" 46 "TIME" 47 "TOWING" 48 "TRACTOR" 49 "TRACTOR_OVER" 50 "TRAILER" 51 "WEIGHT" 52 "WET" 53 "WITHIN" 54 "ZONE" 55 "EXIT" 56 "ACCESS" 57 "ALLWAY" 58 "EXCEPTBUS" 59 "EXCEPTDELIVERY" 60 "EXCEPTLOCAL" 61 "FROG" 62 "PRIOTURNL" 63 "PRIOTURNR" 64 "START" 65 "STOPIN" 66 "HAZWATER" 67 "DAY" 68 "SL" ;
VAL_ 242 VFC_TS04_AddTS3Quality 0 "Poor Quality" 1 "Good Quality" ;
VAL_ 242 VFC_TS04_AddTS3VMS 0 "Fixed" 1 "Variable" ;
VAL_ 242 VFC_TS04_AddTS4Class 0 "UNKNOWN" 1 "DETECTED" 2 "ACCIDENT" 3 "ADVICE" 4 "BEGINS" 5 "BUS" 6 "CAMPER" 7 "CAR" 8 "CARAVAN" 9 "CRASHRISK" 10 "DIRT" 11 "DISTANCE" 12 "DISTANCEBARS" 13 "END" 14 "EXITL" 15 "EXITR" 16 "FOG" 17 "GRAVEL" 18 "HAZMAT" 19 "HUMP" 20 "JAM" 21 "LORRY" 22 "EXCEPTLORRY" 23 "LOWTREE" 24 "MCYCLE" 25 "MINIMUM" 26 "NIGHT" 27 "NOSTOPSHOULDER" 28 "OILTRAIL" 29 "PRIOTURN" 30 "RADAR" 31 "RAIN" 32 "RAINSNOW" 33 "REMINDER" 34 "ROADDAMAGE" 35 "RUTS" 36 "RWORKSACCESS" 37 "RWORKSENTRY" 38 "RWORKSEXIT" 39 "SCHOOL" 40 "SECTION" 41 "SMOKE" 42 "SNOW" 43 "SOFTSHOULDERCAR" 44 "SHOFTSHOULDERLORRY" 45 "TEXT" 46 "TIME" 47 "TOWING" 48 "TRACTOR" 49 "TRACTOR_OVER" 50 "TRAILER" 51 "WEIGHT" 52 "WET" 53 "WITHIN" 54 "ZONE" 55 "EXIT" 56 "ACCESS" 57 "ALLWAY" 58 "EXCEPTBUS" 59 "EXCEPTDELIVERY" 60 "EXCEPTLOCAL" 61 "FROG" 62 "PRIOTURNL" 63 "PRIOTURNR" 64 "START" 65 "STOPIN" 66 "HAZWATER" 67 "DAY" 68 "SL" ;
VAL_ 242 VFC_TS04_AddTS4Quality 0 "Poor Quality" 1 "Good Quality" ;
VAL_ 242 VFC_TS04_AddTS4VMS 0 "Fixed" 1 "Variable" ;
VAL_ 242 VFC_TS04_AddTS5Class 0 "UNKNOWN" 1 "DETECTED" 2 "ACCIDENT" 3 "ADVICE" 4 "BEGINS" 5 "BUS" 6 "CAMPER" 7 "CAR" 8 "CARAVAN" 9 "CRASHRISK" 10 "DIRT" 11 "DISTANCE" 12 "DISTANCEBARS" 13 "END" 14 "EXITL" 15 "EXITR" 16 "FOG" 17 "GRAVEL" 18 "HAZMAT" 19 "HUMP" 20 "JAM" 21 "LORRY" 22 "EXCEPTLORRY" 23 "LOWTREE" 24 "MCYCLE" 25 "MINIMUM" 26 "NIGHT" 27 "NOSTOPSHOULDER" 28 "OILTRAIL" 29 "PRIOTURN" 30 "RADAR" 31 "RAIN" 32 "RAINSNOW" 33 "REMINDER" 34 "ROADDAMAGE" 35 "RUTS" 36 "RWORKSACCESS" 37 "RWORKSENTRY" 38 "RWORKSEXIT" 39 "SCHOOL" 40 "SECTION" 41 "SMOKE" 42 "SNOW" 43 "SOFTSHOULDERCAR" 44 "SHOFTSHOULDERLORRY" 45 "TEXT" 46 "TIME" 47 "TOWING" 48 "TRACTOR" 49 "TRACTOR_OVER" 50 "TRAILER" 51 "WEIGHT" 52 "WET" 53 "WITHIN" 54 "ZONE" 55 "EXIT" 56 "ACCESS" 57 "ALLWAY" 58 "EXCEPTBUS" 59 "EXCEPTDELIVERY" 60 "EXCEPTLOCAL" 61 "FROG" 62 "PRIOTURNL" 63 "PRIOTURNR" 64 "START" 65 "STOPIN" 66 "HAZWATER" 67 "DAY" 68 "SL" ;
VAL_ 242 VFC_TS04_AddTS5Quality 0 "Poor Quality" 1 "Good Quality" ;
VAL_ 242 VFC_TS04_AddTS5VMS 0 "Fixed" 1 "Variable" ;
VAL_ 242 VFC_TS04_AddTS6Class 0 "UNKNOWN" 1 "DETECTED" 2 "ACCIDENT" 3 "ADVICE" 4 "BEGINS" 5 "BUS" 6 "CAMPER" 7 "CAR" 8 "CARAVAN" 9 "CRASHRISK" 10 "DIRT" 11 "DISTANCE" 12 "DISTANCEBARS" 13 "END" 14 "EXITL" 15 "EXITR" 16 "FOG" 17 "GRAVEL" 18 "HAZMAT" 19 "HUMP" 20 "JAM" 21 "LORRY" 22 "EXCEPTLORRY" 23 "LOWTREE" 24 "MCYCLE" 25 "MINIMUM" 26 "NIGHT" 27 "NOSTOPSHOULDER" 28 "OILTRAIL" 29 "PRIOTURN" 30 "RADAR" 31 "RAIN" 32 "RAINSNOW" 33 "REMINDER" 34 "ROADDAMAGE" 35 "RUTS" 36 "RWORKSACCESS" 37 "RWORKSENTRY" 38 "RWORKSEXIT" 39 "SCHOOL" 40 "SECTION" 41 "SMOKE" 42 "SNOW" 43 "SOFTSHOULDERCAR" 44 "SHOFTSHOULDERLORRY" 45 "TEXT" 46 "TIME" 47 "TOWING" 48 "TRACTOR" 49 "TRACTOR_OVER" 50 "TRAILER" 51 "WEIGHT" 52 "WET" 53 "WITHIN" 54 "ZONE" 55 "EXIT" 56 "ACCESS" 57 "ALLWAY" 58 "EXCEPTBUS" 59 "EXCEPTDELIVERY" 60 "EXCEPTLOCAL" 61 "FROG" 62 "PRIOTURNL" 63 "PRIOTURNR" 64 "START" 65 "STOPIN" 66 "HAZWATER" 67 "DAY" 68 "SL" ;
VAL_ 242 VFC_TS04_AddTS6Quality 0 "Poor Quality" 1 "Good Quality" ;
VAL_ 242 VFC_TS04_AddTS6VMS 0 "Fixed" 1 "Variable" ;
VAL_ 243 VFC_TS05_ID 0 "INVALID" ;
VAL_ 243 VFC_TS05_Class 0 "UNKNOWN" 1 "SL5" 2 "SL10" 3 "SL15" 4 "SL20" 5 "SL25" 6 "SL30" 7 "SL35" 8 "SL40" 9 "SL45" 10 "SL50" 11 "SL55" 12 "SL60" 13 "SL65" 14 "SL70" 15 "SL75" 16 "SL80" 17 "SL85" 18 "SL90" 19 "SL95" 20 "SL100" 21 "SL105" 22 "SL110" 23 "SL115" 24 "SL120" 25 "SL125" 26 "SL130" 27 "SL135" 28 "SL140" 29 "SL145" 30 "SL150" 31 "SL155" 32 "SL160" 33 "ESL" 34 "EA" 35 "OP" 36 "EOP" 37 "OL" 38 "EOL" 39 "GIVEWAY" 40 "PRIOCROSS" 41 "PRIOCROSSYIELDTORIGHT" 42 "PRIOSTREET" 43 "EPRIOSTREET" 44 "STOP" 45 "AXLEWEIGHT" 46 "CARDIST" 47 "HEIGHT" 48 "LENGTH" 49 "LORRYDIST" 50 "NOALL" 51 "NOBIKE" 52 "NOBUS" 53 "NOCAR" 54 "NOCARBIKE" 55 "NOCARRIAGE" 56 "NOENTRY" 57 "NOHAZMAT" 58 "NOHAZWATER" 59 "NOLORRY" 60 "NOLORRYTRAILER" 61 "NOLTURN" 62 "NOPED" 63 "NORIDER" 64 "NORTURN" 65 "NOTRACTOR" 66 "NOTWOWAY" 67 "NOUTURN" 68 "UMWELT" 69 "EUMWELT" 70 "WEIGHT" 71 "WIDTH" 72 "WARNBIKE" 73 "WARNBUS" 74 "WARNCATTLE" 75 "WARNCONST" 76 "WARNCONSTL" 77 "WARNCONSTR" 78 "WARNCURVEL" 79 "WARNCURVER" 80 "WARNDANGER" 81 "WARNDCURVEL" 82 "WARNDCURVER" 83 "WARNDRAWBRIDGE" 84 "WARNFROG" 85 "WARNGRAVEL" 86 "WARNHUMP" 87 "WARNJAM" 88 "WARNKIDS" 89 "WARNLIGHTS" 90 "WARNLOWTREE" 91 "WARNPCROSS" 92 "WARNPED" 93 "WARNPIER" 94 "WARNPLANE" 95 "WARNRIDER" 96 "WARNROCK" 97 "WARNROUND" 98 "WARNRWORKS" 99 "WARNSKID" 100 "WARNSLOPED" 101 "WARNSLOPEU" 102 "WARNSNOW" 103 "WARNTRAIN" 104 "WARNTWOWAY" 105 "WARNWILDANIMAL" 106 "WARNWIND" 107 "ASL" 108 "EASL" 109 "CALM" 110 "ECALM" 111 "DEADEND" 112 "DOUANE" 113 "FWAY" 114 "EFWAY" 115 "HWAY" 116 "EHWAY" 117 "MSL" 118 "EMSL" 119 "NOPARK" 120 "NOSTOP" 121 "ONEWAYS" 122 "ONEWAYU" 123 "SLOWDOWN" 124 "SCHOOL" 125 "ESCHOOL" 126 "TWN" 127 "ETWN" 128 "WBBENTLEFT" 129 "WBBENTLEFTRIGHT" 130 "WBBENTRIGHT" 131 "WBDIAGL" 132 "WBDIAGLR" 133 "WBDIAGR" 134 "WBHAZWATER" 135 "WBLEFT" 136 "WBRIGHT" 137 "WBROUND" 138 "WBUP" 139 "WBUPLEFT" 140 "WBUPRIGHT" 141 "ZEBRA" 142 "HAZMAT" 143 "EMERGENCYBAY" 144 "ENDOFLANEL" 145 "ENDOFLANER" 146 "ENOPARK" 147 "EONEWAY" 148 "EPARK" 149 "ETOLL" 150 "NOPARKL" 151 "NOPARKLR" 152 "NOPARKR" 153 "NOSTOPL" 154 "NOSTOPLR" 155 "NOSTOPR" 156 "NOTURNONRED" 157 "ONEWAYL" 158 "ONEWAYR" 159 "PARK" 160 "PRIOCROSSL" 161 "PRIOCROSSR" 162 "TOLL" 163 "TUNNEL" 164 "TWOWAY" 165 "WARNCROSS" 166 "WARNCROSSL" 167 "WARNCROSSLR" 168 "WARNCROSSR" 169 "WARNCROSSRL" 170 "WARNCROSST" 171 "WARNGIVEWAYAHEAD" 172 "WARNSLAHEAD" 173 "WARNSTOPAHEAD" 174 "WBBUS" 175 "WRONGWAY" 176 "HAZWATER" 177 "GIVEWAYROUND" 178 "WARNWINDINGL" 179 "WARNWINDINGR" 180 "WARNHAIRPINL" 181 "WARNHAIRPINR" 182 "WARNPEDBIKE" 183 "WARNCROSSY" 184 "WARNBRANCHL" 185 "WARNBRANCHR" 186 "WARNAXLEWEIGHT" 187 "WARNWEIGHT" 188 "WARNHEIGHT" 189 "WARNLENGTH" 190 "WARNWIDTH" 191 "WARNBLACKSPOT" 192 "WARNMERGEL" 193 "WARNMERGER" 194 "WARNTUNNEL" 195 "WARNTRACTOR" 196 "WARNRWORKSVEHICLE" 197 "WARNNARROWBRIDGE" 198 "WARNFLAGGER" 199 "LANES" 200 "LANESHIFTL" 201 "LANESHIFTR" 202 "NEWLANEL" 203 "NEWLANER" 204 "RIGHTTURNONRED" 205 "BORDERLIMIT" 206 "EMBEDDEDRAIN" ;
VAL_ 243 VFC_TS05_EmbedFlag 0 "Unknown" 1 "Not Embedded" 2 "Border Limit" 3 "Multi Lane" 4 "Rain" 5 "Vehicle Type" 6 "Plate" 7 "Error Value" ;
VAL_ 243 VFC_TS05_Quality 0 "Poor Quality" 1 "Good Quality" ;
VAL_ 243 VFC_TS05_VMS 0 "Fixed" 1 "Variable" ;
VAL_ 243 VFC_TS05_Stable 0 "Object Is Not Stable" 1 "Object Is Stable" ;
VAL_ 243 VFC_TS05_VehicleSticker 0 "not_sticker_on_vehicle" 1 "Sign is a sticker on a vehicle" ;
VAL_ 243 VFC_TS05_InternalTrack 0 "Sign is not an internal track" 1 "Sign is an internal track" ;
VAL_ 243 VFC_TS05_AddTS1Class 0 "UNKNOWN" 1 "DETECTED" 2 "ACCIDENT" 3 "ADVICE" 4 "BEGINS" 5 "BUS" 6 "CAMPER" 7 "CAR" 8 "CARAVAN" 9 "CRASHRISK" 10 "DIRT" 11 "DISTANCE" 12 "DISTANCEBARS" 13 "END" 14 "EXITL" 15 "EXITR" 16 "FOG" 17 "GRAVEL" 18 "HAZMAT" 19 "HUMP" 20 "JAM" 21 "LORRY" 22 "EXCEPTLORRY" 23 "LOWTREE" 24 "MCYCLE" 25 "MINIMUM" 26 "NIGHT" 27 "NOSTOPSHOULDER" 28 "OILTRAIL" 29 "PRIOTURN" 30 "RADAR" 31 "RAIN" 32 "RAINSNOW" 33 "REMINDER" 34 "ROADDAMAGE" 35 "RUTS" 36 "RWORKSACCESS" 37 "RWORKSENTRY" 38 "RWORKSEXIT" 39 "SCHOOL" 40 "SECTION" 41 "SMOKE" 42 "SNOW" 43 "SOFTSHOULDERCAR" 44 "SHOFTSHOULDERLORRY" 45 "TEXT" 46 "TIME" 47 "TOWING" 48 "TRACTOR" 49 "TRACTOR_OVER" 50 "TRAILER" 51 "WEIGHT" 52 "WET" 53 "WITHIN" 54 "ZONE" 55 "EXIT" 56 "ACCESS" 57 "ALLWAY" 58 "EXCEPTBUS" 59 "EXCEPTDELIVERY" 60 "EXCEPTLOCAL" 61 "FROG" 62 "PRIOTURNL" 63 "PRIOTURNR" 64 "START" 65 "STOPIN" 66 "HAZWATER" 67 "DAY" 68 "SL" ;
VAL_ 243 VFC_TS05_AddTS1Quality 0 "Poor Quality" 1 "Good Quality" ;
VAL_ 243 VFC_TS05_AddTS1VMS 0 "Fixed" 1 "Variable" ;
VAL_ 243 VFC_TS05_AddTS2Class 0 "UNKNOWN" 1 "DETECTED" 2 "ACCIDENT" 3 "ADVICE" 4 "BEGINS" 5 "BUS" 6 "CAMPER" 7 "CAR" 8 "CARAVAN" 9 "CRASHRISK" 10 "DIRT" 11 "DISTANCE" 12 "DISTANCEBARS" 13 "END" 14 "EXITL" 15 "EXITR" 16 "FOG" 17 "GRAVEL" 18 "HAZMAT" 19 "HUMP" 20 "JAM" 21 "LORRY" 22 "EXCEPTLORRY" 23 "LOWTREE" 24 "MCYCLE" 25 "MINIMUM" 26 "NIGHT" 27 "NOSTOPSHOULDER" 28 "OILTRAIL" 29 "PRIOTURN" 30 "RADAR" 31 "RAIN" 32 "RAINSNOW" 33 "REMINDER" 34 "ROADDAMAGE" 35 "RUTS" 36 "RWORKSACCESS" 37 "RWORKSENTRY" 38 "RWORKSEXIT" 39 "SCHOOL" 40 "SECTION" 41 "SMOKE" 42 "SNOW" 43 "SOFTSHOULDERCAR" 44 "SHOFTSHOULDERLORRY" 45 "TEXT" 46 "TIME" 47 "TOWING" 48 "TRACTOR" 49 "TRACTOR_OVER" 50 "TRAILER" 51 "WEIGHT" 52 "WET" 53 "WITHIN" 54 "ZONE" 55 "EXIT" 56 "ACCESS" 57 "ALLWAY" 58 "EXCEPTBUS" 59 "EXCEPTDELIVERY" 60 "EXCEPTLOCAL" 61 "FROG" 62 "PRIOTURNL" 63 "PRIOTURNR" 64 "START" 65 "STOPIN" 66 "HAZWATER" 67 "DAY" 68 "SL" ;
VAL_ 243 VFC_TS05_AddTS2Quality 0 "Poor Quality" 1 "Good Quality" ;
VAL_ 243 VFC_TS05_AddTS2VMS 0 "Fixed" 1 "Variable" ;
VAL_ 243 VFC_TS05_AddTS3Class 0 "UNKNOWN" 1 "DETECTED" 2 "ACCIDENT" 3 "ADVICE" 4 "BEGINS" 5 "BUS" 6 "CAMPER" 7 "CAR" 8 "CARAVAN" 9 "CRASHRISK" 10 "DIRT" 11 "DISTANCE" 12 "DISTANCEBARS" 13 "END" 14 "EXITL" 15 "EXITR" 16 "FOG" 17 "GRAVEL" 18 "HAZMAT" 19 "HUMP" 20 "JAM" 21 "LORRY" 22 "EXCEPTLORRY" 23 "LOWTREE" 24 "MCYCLE" 25 "MINIMUM" 26 "NIGHT" 27 "NOSTOPSHOULDER" 28 "OILTRAIL" 29 "PRIOTURN" 30 "RADAR" 31 "RAIN" 32 "RAINSNOW" 33 "REMINDER" 34 "ROADDAMAGE" 35 "RUTS" 36 "RWORKSACCESS" 37 "RWORKSENTRY" 38 "RWORKSEXIT" 39 "SCHOOL" 40 "SECTION" 41 "SMOKE" 42 "SNOW" 43 "SOFTSHOULDERCAR" 44 "SHOFTSHOULDERLORRY" 45 "TEXT" 46 "TIME" 47 "TOWING" 48 "TRACTOR" 49 "TRACTOR_OVER" 50 "TRAILER" 51 "WEIGHT" 52 "WET" 53 "WITHIN" 54 "ZONE" 55 "EXIT" 56 "ACCESS" 57 "ALLWAY" 58 "EXCEPTBUS" 59 "EXCEPTDELIVERY" 60 "EXCEPTLOCAL" 61 "FROG" 62 "PRIOTURNL" 63 "PRIOTURNR" 64 "START" 65 "STOPIN" 66 "HAZWATER" 67 "DAY" 68 "SL" ;
VAL_ 243 VFC_TS05_AddTS3Quality 0 "Poor Quality" 1 "Good Quality" ;
VAL_ 243 VFC_TS05_AddTS3VMS 0 "Fixed" 1 "Variable" ;
VAL_ 243 VFC_TS05_AddTS4Class 0 "UNKNOWN" 1 "DETECTED" 2 "ACCIDENT" 3 "ADVICE" 4 "BEGINS" 5 "BUS" 6 "CAMPER" 7 "CAR" 8 "CARAVAN" 9 "CRASHRISK" 10 "DIRT" 11 "DISTANCE" 12 "DISTANCEBARS" 13 "END" 14 "EXITL" 15 "EXITR" 16 "FOG" 17 "GRAVEL" 18 "HAZMAT" 19 "HUMP" 20 "JAM" 21 "LORRY" 22 "EXCEPTLORRY" 23 "LOWTREE" 24 "MCYCLE" 25 "MINIMUM" 26 "NIGHT" 27 "NOSTOPSHOULDER" 28 "OILTRAIL" 29 "PRIOTURN" 30 "RADAR" 31 "RAIN" 32 "RAINSNOW" 33 "REMINDER" 34 "ROADDAMAGE" 35 "RUTS" 36 "RWORKSACCESS" 37 "RWORKSENTRY" 38 "RWORKSEXIT" 39 "SCHOOL" 40 "SECTION" 41 "SMOKE" 42 "SNOW" 43 "SOFTSHOULDERCAR" 44 "SHOFTSHOULDERLORRY" 45 "TEXT" 46 "TIME" 47 "TOWING" 48 "TRACTOR" 49 "TRACTOR_OVER" 50 "TRAILER" 51 "WEIGHT" 52 "WET" 53 "WITHIN" 54 "ZONE" 55 "EXIT" 56 "ACCESS" 57 "ALLWAY" 58 "EXCEPTBUS" 59 "EXCEPTDELIVERY" 60 "EXCEPTLOCAL" 61 "FROG" 62 "PRIOTURNL" 63 "PRIOTURNR" 64 "START" 65 "STOPIN" 66 "HAZWATER" 67 "DAY" 68 "SL" ;
VAL_ 243 VFC_TS05_AddTS4Quality 0 "Poor Quality" 1 "Good Quality" ;
VAL_ 243 VFC_TS05_AddTS4VMS 0 "Fixed" 1 "Variable" ;
VAL_ 243 VFC_TS05_AddTS5Class 0 "UNKNOWN" 1 "DETECTED" 2 "ACCIDENT" 3 "ADVICE" 4 "BEGINS" 5 "BUS" 6 "CAMPER" 7 "CAR" 8 "CARAVAN" 9 "CRASHRISK" 10 "DIRT" 11 "DISTANCE" 12 "DISTANCEBARS" 13 "END" 14 "EXITL" 15 "EXITR" 16 "FOG" 17 "GRAVEL" 18 "HAZMAT" 19 "HUMP" 20 "JAM" 21 "LORRY" 22 "EXCEPTLORRY" 23 "LOWTREE" 24 "MCYCLE" 25 "MINIMUM" 26 "NIGHT" 27 "NOSTOPSHOULDER" 28 "OILTRAIL" 29 "PRIOTURN" 30 "RADAR" 31 "RAIN" 32 "RAINSNOW" 33 "REMINDER" 34 "ROADDAMAGE" 35 "RUTS" 36 "RWORKSACCESS" 37 "RWORKSENTRY" 38 "RWORKSEXIT" 39 "SCHOOL" 40 "SECTION" 41 "SMOKE" 42 "SNOW" 43 "SOFTSHOULDERCAR" 44 "SHOFTSHOULDERLORRY" 45 "TEXT" 46 "TIME" 47 "TOWING" 48 "TRACTOR" 49 "TRACTOR_OVER" 50 "TRAILER" 51 "WEIGHT" 52 "WET" 53 "WITHIN" 54 "ZONE" 55 "EXIT" 56 "ACCESS" 57 "ALLWAY" 58 "EXCEPTBUS" 59 "EXCEPTDELIVERY" 60 "EXCEPTLOCAL" 61 "FROG" 62 "PRIOTURNL" 63 "PRIOTURNR" 64 "START" 65 "STOPIN" 66 "HAZWATER" 67 "DAY" 68 "SL" ;
VAL_ 243 VFC_TS05_AddTS5Quality 0 "Poor Quality" 1 "Good Quality" ;
VAL_ 243 VFC_TS05_AddTS5VMS 0 "Fixed" 1 "Variable" ;
VAL_ 243 VFC_TS05_AddTS6Class 0 "UNKNOWN" 1 "DETECTED" 2 "ACCIDENT" 3 "ADVICE" 4 "BEGINS" 5 "BUS" 6 "CAMPER" 7 "CAR" 8 "CARAVAN" 9 "CRASHRISK" 10 "DIRT" 11 "DISTANCE" 12 "DISTANCEBARS" 13 "END" 14 "EXITL" 15 "EXITR" 16 "FOG" 17 "GRAVEL" 18 "HAZMAT" 19 "HUMP" 20 "JAM" 21 "LORRY" 22 "EXCEPTLORRY" 23 "LOWTREE" 24 "MCYCLE" 25 "MINIMUM" 26 "NIGHT" 27 "NOSTOPSHOULDER" 28 "OILTRAIL" 29 "PRIOTURN" 30 "RADAR" 31 "RAIN" 32 "RAINSNOW" 33 "REMINDER" 34 "ROADDAMAGE" 35 "RUTS" 36 "RWORKSACCESS" 37 "RWORKSENTRY" 38 "RWORKSEXIT" 39 "SCHOOL" 40 "SECTION" 41 "SMOKE" 42 "SNOW" 43 "SOFTSHOULDERCAR" 44 "SHOFTSHOULDERLORRY" 45 "TEXT" 46 "TIME" 47 "TOWING" 48 "TRACTOR" 49 "TRACTOR_OVER" 50 "TRAILER" 51 "WEIGHT" 52 "WET" 53 "WITHIN" 54 "ZONE" 55 "EXIT" 56 "ACCESS" 57 "ALLWAY" 58 "EXCEPTBUS" 59 "EXCEPTDELIVERY" 60 "EXCEPTLOCAL" 61 "FROG" 62 "PRIOTURNL" 63 "PRIOTURNR" 64 "START" 65 "STOPIN" 66 "HAZWATER" 67 "DAY" 68 "SL" ;
VAL_ 243 VFC_TS05_AddTS6Quality 0 "Poor Quality" 1 "Good Quality" ;
VAL_ 243 VFC_TS05_AddTS6VMS 0 "Fixed" 1 "Variable" ;
VAL_ 244 VFC_TS06_ID 0 "INVALID" ;
VAL_ 244 VFC_TS06_Class 0 "UNKNOWN" 1 "SL5" 2 "SL10" 3 "SL15" 4 "SL20" 5 "SL25" 6 "SL30" 7 "SL35" 8 "SL40" 9 "SL45" 10 "SL50" 11 "SL55" 12 "SL60" 13 "SL65" 14 "SL70" 15 "SL75" 16 "SL80" 17 "SL85" 18 "SL90" 19 "SL95" 20 "SL100" 21 "SL105" 22 "SL110" 23 "SL115" 24 "SL120" 25 "SL125" 26 "SL130" 27 "SL135" 28 "SL140" 29 "SL145" 30 "SL150" 31 "SL155" 32 "SL160" 33 "ESL" 34 "EA" 35 "OP" 36 "EOP" 37 "OL" 38 "EOL" 39 "GIVEWAY" 40 "PRIOCROSS" 41 "PRIOCROSSYIELDTORIGHT" 42 "PRIOSTREET" 43 "EPRIOSTREET" 44 "STOP" 45 "AXLEWEIGHT" 46 "CARDIST" 47 "HEIGHT" 48 "LENGTH" 49 "LORRYDIST" 50 "NOALL" 51 "NOBIKE" 52 "NOBUS" 53 "NOCAR" 54 "NOCARBIKE" 55 "NOCARRIAGE" 56 "NOENTRY" 57 "NOHAZMAT" 58 "NOHAZWATER" 59 "NOLORRY" 60 "NOLORRYTRAILER" 61 "NOLTURN" 62 "NOPED" 63 "NORIDER" 64 "NORTURN" 65 "NOTRACTOR" 66 "NOTWOWAY" 67 "NOUTURN" 68 "UMWELT" 69 "EUMWELT" 70 "WEIGHT" 71 "WIDTH" 72 "WARNBIKE" 73 "WARNBUS" 74 "WARNCATTLE" 75 "WARNCONST" 76 "WARNCONSTL" 77 "WARNCONSTR" 78 "WARNCURVEL" 79 "WARNCURVER" 80 "WARNDANGER" 81 "WARNDCURVEL" 82 "WARNDCURVER" 83 "WARNDRAWBRIDGE" 84 "WARNFROG" 85 "WARNGRAVEL" 86 "WARNHUMP" 87 "WARNJAM" 88 "WARNKIDS" 89 "WARNLIGHTS" 90 "WARNLOWTREE" 91 "WARNPCROSS" 92 "WARNPED" 93 "WARNPIER" 94 "WARNPLANE" 95 "WARNRIDER" 96 "WARNROCK" 97 "WARNROUND" 98 "WARNRWORKS" 99 "WARNSKID" 100 "WARNSLOPED" 101 "WARNSLOPEU" 102 "WARNSNOW" 103 "WARNTRAIN" 104 "WARNTWOWAY" 105 "WARNWILDANIMAL" 106 "WARNWIND" 107 "ASL" 108 "EASL" 109 "CALM" 110 "ECALM" 111 "DEADEND" 112 "DOUANE" 113 "FWAY" 114 "EFWAY" 115 "HWAY" 116 "EHWAY" 117 "MSL" 118 "EMSL" 119 "NOPARK" 120 "NOSTOP" 121 "ONEWAYS" 122 "ONEWAYU" 123 "SLOWDOWN" 124 "SCHOOL" 125 "ESCHOOL" 126 "TWN" 127 "ETWN" 128 "WBBENTLEFT" 129 "WBBENTLEFTRIGHT" 130 "WBBENTRIGHT" 131 "WBDIAGL" 132 "WBDIAGLR" 133 "WBDIAGR" 134 "WBHAZWATER" 135 "WBLEFT" 136 "WBRIGHT" 137 "WBROUND" 138 "WBUP" 139 "WBUPLEFT" 140 "WBUPRIGHT" 141 "ZEBRA" 142 "HAZMAT" 143 "EMERGENCYBAY" 144 "ENDOFLANEL" 145 "ENDOFLANER" 146 "ENOPARK" 147 "EONEWAY" 148 "EPARK" 149 "ETOLL" 150 "NOPARKL" 151 "NOPARKLR" 152 "NOPARKR" 153 "NOSTOPL" 154 "NOSTOPLR" 155 "NOSTOPR" 156 "NOTURNONRED" 157 "ONEWAYL" 158 "ONEWAYR" 159 "PARK" 160 "PRIOCROSSL" 161 "PRIOCROSSR" 162 "TOLL" 163 "TUNNEL" 164 "TWOWAY" 165 "WARNCROSS" 166 "WARNCROSSL" 167 "WARNCROSSLR" 168 "WARNCROSSR" 169 "WARNCROSSRL" 170 "WARNCROSST" 171 "WARNGIVEWAYAHEAD" 172 "WARNSLAHEAD" 173 "WARNSTOPAHEAD" 174 "WBBUS" 175 "WRONGWAY" 176 "HAZWATER" 177 "GIVEWAYROUND" 178 "WARNWINDINGL" 179 "WARNWINDINGR" 180 "WARNHAIRPINL" 181 "WARNHAIRPINR" 182 "WARNPEDBIKE" 183 "WARNCROSSY" 184 "WARNBRANCHL" 185 "WARNBRANCHR" 186 "WARNAXLEWEIGHT" 187 "WARNWEIGHT" 188 "WARNHEIGHT" 189 "WARNLENGTH" 190 "WARNWIDTH" 191 "WARNBLACKSPOT" 192 "WARNMERGEL" 193 "WARNMERGER" 194 "WARNTUNNEL" 195 "WARNTRACTOR" 196 "WARNRWORKSVEHICLE" 197 "WARNNARROWBRIDGE" 198 "WARNFLAGGER" 199 "LANES" 200 "LANESHIFTL" 201 "LANESHIFTR" 202 "NEWLANEL" 203 "NEWLANER" 204 "RIGHTTURNONRED" 205 "BORDERLIMIT" 206 "EMBEDDEDRAIN" ;
VAL_ 244 VFC_TS06_EmbedFlag 0 "Unknown" 1 "Not Embedded" 2 "Border Limit" 3 "Multi Lane" 4 "Rain" 5 "Vehicle Type" 6 "Plate" 7 "Error Value" ;
VAL_ 244 VFC_TS06_Quality 0 "Poor Quality" 1 "Good Quality" ;
VAL_ 244 VFC_TS06_VMS 0 "Fixed" 1 "Variable" ;
VAL_ 244 VFC_TS06_Stable 0 "Object Is Not Stable" 1 "Object Is Stable" ;
VAL_ 244 VFC_TS06_VehicleSticker 0 "not_sticker_on_vehicle" 1 "Sign is a sticker on a vehicle" ;
VAL_ 244 VFC_TS06_InternalTrack 0 "Sign is not an internal track" 1 "Sign is an internal track" ;
VAL_ 244 VFC_TS06_AddTS1Class 0 "UNKNOWN" 1 "DETECTED" 2 "ACCIDENT" 3 "ADVICE" 4 "BEGINS" 5 "BUS" 6 "CAMPER" 7 "CAR" 8 "CARAVAN" 9 "CRASHRISK" 10 "DIRT" 11 "DISTANCE" 12 "DISTANCEBARS" 13 "END" 14 "EXITL" 15 "EXITR" 16 "FOG" 17 "GRAVEL" 18 "HAZMAT" 19 "HUMP" 20 "JAM" 21 "LORRY" 22 "EXCEPTLORRY" 23 "LOWTREE" 24 "MCYCLE" 25 "MINIMUM" 26 "NIGHT" 27 "NOSTOPSHOULDER" 28 "OILTRAIL" 29 "PRIOTURN" 30 "RADAR" 31 "RAIN" 32 "RAINSNOW" 33 "REMINDER" 34 "ROADDAMAGE" 35 "RUTS" 36 "RWORKSACCESS" 37 "RWORKSENTRY" 38 "RWORKSEXIT" 39 "SCHOOL" 40 "SECTION" 41 "SMOKE" 42 "SNOW" 43 "SOFTSHOULDERCAR" 44 "SHOFTSHOULDERLORRY" 45 "TEXT" 46 "TIME" 47 "TOWING" 48 "TRACTOR" 49 "TRACTOR_OVER" 50 "TRAILER" 51 "WEIGHT" 52 "WET" 53 "WITHIN" 54 "ZONE" 55 "EXIT" 56 "ACCESS" 57 "ALLWAY" 58 "EXCEPTBUS" 59 "EXCEPTDELIVERY" 60 "EXCEPTLOCAL" 61 "FROG" 62 "PRIOTURNL" 63 "PRIOTURNR" 64 "START" 65 "STOPIN" 66 "HAZWATER" 67 "DAY" 68 "SL" ;
VAL_ 244 VFC_TS06_AddTS1Quality 0 "Poor Quality" 1 "Good Quality" ;
VAL_ 244 VFC_TS06_AddTS1VMS 0 "Fixed" 1 "Variable" ;
VAL_ 244 VFC_TS06_AddTS2Class 0 "UNKNOWN" 1 "DETECTED" 2 "ACCIDENT" 3 "ADVICE" 4 "BEGINS" 5 "BUS" 6 "CAMPER" 7 "CAR" 8 "CARAVAN" 9 "CRASHRISK" 10 "DIRT" 11 "DISTANCE" 12 "DISTANCEBARS" 13 "END" 14 "EXITL" 15 "EXITR" 16 "FOG" 17 "GRAVEL" 18 "HAZMAT" 19 "HUMP" 20 "JAM" 21 "LORRY" 22 "EXCEPTLORRY" 23 "LOWTREE" 24 "MCYCLE" 25 "MINIMUM" 26 "NIGHT" 27 "NOSTOPSHOULDER" 28 "OILTRAIL" 29 "PRIOTURN" 30 "RADAR" 31 "RAIN" 32 "RAINSNOW" 33 "REMINDER" 34 "ROADDAMAGE" 35 "RUTS" 36 "RWORKSACCESS" 37 "RWORKSENTRY" 38 "RWORKSEXIT" 39 "SCHOOL" 40 "SECTION" 41 "SMOKE" 42 "SNOW" 43 "SOFTSHOULDERCAR" 44 "SHOFTSHOULDERLORRY" 45 "TEXT" 46 "TIME" 47 "TOWING" 48 "TRACTOR" 49 "TRACTOR_OVER" 50 "TRAILER" 51 "WEIGHT" 52 "WET" 53 "WITHIN" 54 "ZONE" 55 "EXIT" 56 "ACCESS" 57 "ALLWAY" 58 "EXCEPTBUS" 59 "EXCEPTDELIVERY" 60 "EXCEPTLOCAL" 61 "FROG" 62 "PRIOTURNL" 63 "PRIOTURNR" 64 "START" 65 "STOPIN" 66 "HAZWATER" 67 "DAY" 68 "SL" ;
VAL_ 244 VFC_TS06_AddTS2Quality 0 "Poor Quality" 1 "Good Quality" ;
VAL_ 244 VFC_TS06_AddTS2VMS 0 "Fixed" 1 "Variable" ;
VAL_ 244 VFC_TS06_AddTS3Class 0 "UNKNOWN" 1 "DETECTED" 2 "ACCIDENT" 3 "ADVICE" 4 "BEGINS" 5 "BUS" 6 "CAMPER" 7 "CAR" 8 "CARAVAN" 9 "CRASHRISK" 10 "DIRT" 11 "DISTANCE" 12 "DISTANCEBARS" 13 "END" 14 "EXITL" 15 "EXITR" 16 "FOG" 17 "GRAVEL" 18 "HAZMAT" 19 "HUMP" 20 "JAM" 21 "LORRY" 22 "EXCEPTLORRY" 23 "LOWTREE" 24 "MCYCLE" 25 "MINIMUM" 26 "NIGHT" 27 "NOSTOPSHOULDER" 28 "OILTRAIL" 29 "PRIOTURN" 30 "RADAR" 31 "RAIN" 32 "RAINSNOW" 33 "REMINDER" 34 "ROADDAMAGE" 35 "RUTS" 36 "RWORKSACCESS" 37 "RWORKSENTRY" 38 "RWORKSEXIT" 39 "SCHOOL" 40 "SECTION" 41 "SMOKE" 42 "SNOW" 43 "SOFTSHOULDERCAR" 44 "SHOFTSHOULDERLORRY" 45 "TEXT" 46 "TIME" 47 "TOWING" 48 "TRACTOR" 49 "TRACTOR_OVER" 50 "TRAILER" 51 "WEIGHT" 52 "WET" 53 "WITHIN" 54 "ZONE" 55 "EXIT" 56 "ACCESS" 57 "ALLWAY" 58 "EXCEPTBUS" 59 "EXCEPTDELIVERY" 60 "EXCEPTLOCAL" 61 "FROG" 62 "PRIOTURNL" 63 "PRIOTURNR" 64 "START" 65 "STOPIN" 66 "HAZWATER" 67 "DAY" 68 "SL" ;
VAL_ 244 VFC_TS06_AddTS3Quality 0 "Poor Quality" 1 "Good Quality" ;
VAL_ 244 VFC_TS06_AddTS3VMS 0 "Fixed" 1 "Variable" ;
VAL_ 244 VFC_TS06_AddTS4Class 0 "UNKNOWN" 1 "DETECTED" 2 "ACCIDENT" 3 "ADVICE" 4 "BEGINS" 5 "BUS" 6 "CAMPER" 7 "CAR" 8 "CARAVAN" 9 "CRASHRISK" 10 "DIRT" 11 "DISTANCE" 12 "DISTANCEBARS" 13 "END" 14 "EXITL" 15 "EXITR" 16 "FOG" 17 "GRAVEL" 18 "HAZMAT" 19 "HUMP" 20 "JAM" 21 "LORRY" 22 "EXCEPTLORRY" 23 "LOWTREE" 24 "MCYCLE" 25 "MINIMUM" 26 "NIGHT" 27 "NOSTOPSHOULDER" 28 "OILTRAIL" 29 "PRIOTURN" 30 "RADAR" 31 "RAIN" 32 "RAINSNOW" 33 "REMINDER" 34 "ROADDAMAGE" 35 "RUTS" 36 "RWORKSACCESS" 37 "RWORKSENTRY" 38 "RWORKSEXIT" 39 "SCHOOL" 40 "SECTION" 41 "SMOKE" 42 "SNOW" 43 "SOFTSHOULDERCAR" 44 "SHOFTSHOULDERLORRY" 45 "TEXT" 46 "TIME" 47 "TOWING" 48 "TRACTOR" 49 "TRACTOR_OVER" 50 "TRAILER" 51 "WEIGHT" 52 "WET" 53 "WITHIN" 54 "ZONE" 55 "EXIT" 56 "ACCESS" 57 "ALLWAY" 58 "EXCEPTBUS" 59 "EXCEPTDELIVERY" 60 "EXCEPTLOCAL" 61 "FROG" 62 "PRIOTURNL" 63 "PRIOTURNR" 64 "START" 65 "STOPIN" 66 "HAZWATER" 67 "DAY" 68 "SL" ;
VAL_ 244 VFC_TS06_AddTS4Quality 0 "Poor Quality" 1 "Good Quality" ;
VAL_ 244 VFC_TS06_AddTS4VMS 0 "Fixed" 1 "Variable" ;
VAL_ 244 VFC_TS06_AddTS5Class 0 "UNKNOWN" 1 "DETECTED" 2 "ACCIDENT" 3 "ADVICE" 4 "BEGINS" 5 "BUS" 6 "CAMPER" 7 "CAR" 8 "CARAVAN" 9 "CRASHRISK" 10 "DIRT" 11 "DISTANCE" 12 "DISTANCEBARS" 13 "END" 14 "EXITL" 15 "EXITR" 16 "FOG" 17 "GRAVEL" 18 "HAZMAT" 19 "HUMP" 20 "JAM" 21 "LORRY" 22 "EXCEPTLORRY" 23 "LOWTREE" 24 "MCYCLE" 25 "MINIMUM" 26 "NIGHT" 27 "NOSTOPSHOULDER" 28 "OILTRAIL" 29 "PRIOTURN" 30 "RADAR" 31 "RAIN" 32 "RAINSNOW" 33 "REMINDER" 34 "ROADDAMAGE" 35 "RUTS" 36 "RWORKSACCESS" 37 "RWORKSENTRY" 38 "RWORKSEXIT" 39 "SCHOOL" 40 "SECTION" 41 "SMOKE" 42 "SNOW" 43 "SOFTSHOULDERCAR" 44 "SHOFTSHOULDERLORRY" 45 "TEXT" 46 "TIME" 47 "TOWING" 48 "TRACTOR" 49 "TRACTOR_OVER" 50 "TRAILER" 51 "WEIGHT" 52 "WET" 53 "WITHIN" 54 "ZONE" 55 "EXIT" 56 "ACCESS" 57 "ALLWAY" 58 "EXCEPTBUS" 59 "EXCEPTDELIVERY" 60 "EXCEPTLOCAL" 61 "FROG" 62 "PRIOTURNL" 63 "PRIOTURNR" 64 "START" 65 "STOPIN" 66 "HAZWATER" 67 "DAY" 68 "SL" ;
VAL_ 244 VFC_TS06_AddTS5Quality 0 "Poor Quality" 1 "Good Quality" ;
VAL_ 244 VFC_TS06_AddTS5VMS 0 "Fixed" 1 "Variable" ;
VAL_ 244 VFC_TS06_AddTS6Class 0 "UNKNOWN" 1 "DETECTED" 2 "ACCIDENT" 3 "ADVICE" 4 "BEGINS" 5 "BUS" 6 "CAMPER" 7 "CAR" 8 "CARAVAN" 9 "CRASHRISK" 10 "DIRT" 11 "DISTANCE" 12 "DISTANCEBARS" 13 "END" 14 "EXITL" 15 "EXITR" 16 "FOG" 17 "GRAVEL" 18 "HAZMAT" 19 "HUMP" 20 "JAM" 21 "LORRY" 22 "EXCEPTLORRY" 23 "LOWTREE" 24 "MCYCLE" 25 "MINIMUM" 26 "NIGHT" 27 "NOSTOPSHOULDER" 28 "OILTRAIL" 29 "PRIOTURN" 30 "RADAR" 31 "RAIN" 32 "RAINSNOW" 33 "REMINDER" 34 "ROADDAMAGE" 35 "RUTS" 36 "RWORKSACCESS" 37 "RWORKSENTRY" 38 "RWORKSEXIT" 39 "SCHOOL" 40 "SECTION" 41 "SMOKE" 42 "SNOW" 43 "SOFTSHOULDERCAR" 44 "SHOFTSHOULDERLORRY" 45 "TEXT" 46 "TIME" 47 "TOWING" 48 "TRACTOR" 49 "TRACTOR_OVER" 50 "TRAILER" 51 "WEIGHT" 52 "WET" 53 "WITHIN" 54 "ZONE" 55 "EXIT" 56 "ACCESS" 57 "ALLWAY" 58 "EXCEPTBUS" 59 "EXCEPTDELIVERY" 60 "EXCEPTLOCAL" 61 "FROG" 62 "PRIOTURNL" 63 "PRIOTURNR" 64 "START" 65 "STOPIN" 66 "HAZWATER" 67 "DAY" 68 "SL" ;
VAL_ 244 VFC_TS06_AddTS6Quality 0 "Poor Quality" 1 "Good Quality" ;
VAL_ 244 VFC_TS06_AddTS6VMS 0 "Fixed" 1 "Variable" ;
VAL_ 245 VFC_TS07_ID 0 "INVALID" ;
VAL_ 245 VFC_TS07_Class 0 "UNKNOWN" 1 "SL5" 2 "SL10" 3 "SL15" 4 "SL20" 5 "SL25" 6 "SL30" 7 "SL35" 8 "SL40" 9 "SL45" 10 "SL50" 11 "SL55" 12 "SL60" 13 "SL65" 14 "SL70" 15 "SL75" 16 "SL80" 17 "SL85" 18 "SL90" 19 "SL95" 20 "SL100" 21 "SL105" 22 "SL110" 23 "SL115" 24 "SL120" 25 "SL125" 26 "SL130" 27 "SL135" 28 "SL140" 29 "SL145" 30 "SL150" 31 "SL155" 32 "SL160" 33 "ESL" 34 "EA" 35 "OP" 36 "EOP" 37 "OL" 38 "EOL" 39 "GIVEWAY" 40 "PRIOCROSS" 41 "PRIOCROSSYIELDTORIGHT" 42 "PRIOSTREET" 43 "EPRIOSTREET" 44 "STOP" 45 "AXLEWEIGHT" 46 "CARDIST" 47 "HEIGHT" 48 "LENGTH" 49 "LORRYDIST" 50 "NOALL" 51 "NOBIKE" 52 "NOBUS" 53 "NOCAR" 54 "NOCARBIKE" 55 "NOCARRIAGE" 56 "NOENTRY" 57 "NOHAZMAT" 58 "NOHAZWATER" 59 "NOLORRY" 60 "NOLORRYTRAILER" 61 "NOLTURN" 62 "NOPED" 63 "NORIDER" 64 "NORTURN" 65 "NOTRACTOR" 66 "NOTWOWAY" 67 "NOUTURN" 68 "UMWELT" 69 "EUMWELT" 70 "WEIGHT" 71 "WIDTH" 72 "WARNBIKE" 73 "WARNBUS" 74 "WARNCATTLE" 75 "WARNCONST" 76 "WARNCONSTL" 77 "WARNCONSTR" 78 "WARNCURVEL" 79 "WARNCURVER" 80 "WARNDANGER" 81 "WARNDCURVEL" 82 "WARNDCURVER" 83 "WARNDRAWBRIDGE" 84 "WARNFROG" 85 "WARNGRAVEL" 86 "WARNHUMP" 87 "WARNJAM" 88 "WARNKIDS" 89 "WARNLIGHTS" 90 "WARNLOWTREE" 91 "WARNPCROSS" 92 "WARNPED" 93 "WARNPIER" 94 "WARNPLANE" 95 "WARNRIDER" 96 "WARNROCK" 97 "WARNROUND" 98 "WARNRWORKS" 99 "WARNSKID" 100 "WARNSLOPED" 101 "WARNSLOPEU" 102 "WARNSNOW" 103 "WARNTRAIN" 104 "WARNTWOWAY" 105 "WARNWILDANIMAL" 106 "WARNWIND" 107 "ASL" 108 "EASL" 109 "CALM" 110 "ECALM" 111 "DEADEND" 112 "DOUANE" 113 "FWAY" 114 "EFWAY" 115 "HWAY" 116 "EHWAY" 117 "MSL" 118 "EMSL" 119 "NOPARK" 120 "NOSTOP" 121 "ONEWAYS" 122 "ONEWAYU" 123 "SLOWDOWN" 124 "SCHOOL" 125 "ESCHOOL" 126 "TWN" 127 "ETWN" 128 "WBBENTLEFT" 129 "WBBENTLEFTRIGHT" 130 "WBBENTRIGHT" 131 "WBDIAGL" 132 "WBDIAGLR" 133 "WBDIAGR" 134 "WBHAZWATER" 135 "WBLEFT" 136 "WBRIGHT" 137 "WBROUND" 138 "WBUP" 139 "WBUPLEFT" 140 "WBUPRIGHT" 141 "ZEBRA" 142 "HAZMAT" 143 "EMERGENCYBAY" 144 "ENDOFLANEL" 145 "ENDOFLANER" 146 "ENOPARK" 147 "EONEWAY" 148 "EPARK" 149 "ETOLL" 150 "NOPARKL" 151 "NOPARKLR" 152 "NOPARKR" 153 "NOSTOPL" 154 "NOSTOPLR" 155 "NOSTOPR" 156 "NOTURNONRED" 157 "ONEWAYL" 158 "ONEWAYR" 159 "PARK" 160 "PRIOCROSSL" 161 "PRIOCROSSR" 162 "TOLL" 163 "TUNNEL" 164 "TWOWAY" 165 "WARNCROSS" 166 "WARNCROSSL" 167 "WARNCROSSLR" 168 "WARNCROSSR" 169 "WARNCROSSRL" 170 "WARNCROSST" 171 "WARNGIVEWAYAHEAD" 172 "WARNSLAHEAD" 173 "WARNSTOPAHEAD" 174 "WBBUS" 175 "WRONGWAY" 176 "HAZWATER" 177 "GIVEWAYROUND" 178 "WARNWINDINGL" 179 "WARNWINDINGR" 180 "WARNHAIRPINL" 181 "WARNHAIRPINR" 182 "WARNPEDBIKE" 183 "WARNCROSSY" 184 "WARNBRANCHL" 185 "WARNBRANCHR" 186 "WARNAXLEWEIGHT" 187 "WARNWEIGHT" 188 "WARNHEIGHT" 189 "WARNLENGTH" 190 "WARNWIDTH" 191 "WARNBLACKSPOT" 192 "WARNMERGEL" 193 "WARNMERGER" 194 "WARNTUNNEL" 195 "WARNTRACTOR" 196 "WARNRWORKSVEHICLE" 197 "WARNNARROWBRIDGE" 198 "WARNFLAGGER" 199 "LANES" 200 "LANESHIFTL" 201 "LANESHIFTR" 202 "NEWLANEL" 203 "NEWLANER" 204 "RIGHTTURNONRED" 205 "BORDERLIMIT" 206 "EMBEDDEDRAIN" ;
VAL_ 245 VFC_TS07_EmbedFlag 0 "Unknown" 1 "Not Embedded" 2 "Border Limit" 3 "Multi Lane" 4 "Rain" 5 "Vehicle Type" 6 "Plate" 7 "Error Value" ;
VAL_ 245 VFC_TS07_Quality 0 "Poor Quality" 1 "Good Quality" ;
VAL_ 245 VFC_TS07_VMS 0 "Fixed" 1 "Variable" ;
VAL_ 245 VFC_TS07_Stable 0 "Object Is Not Stable" 1 "Object Is Stable" ;
VAL_ 245 VFC_TS07_VehicleSticker 0 "not_sticker_on_vehicle" 1 "Sign is a sticker on a vehicle" ;
VAL_ 245 VFC_TS07_InternalTrack 0 "Sign is not an internal track" 1 "Sign is an internal track" ;
VAL_ 245 VFC_TS07_AddTS1Class 0 "UNKNOWN" 1 "DETECTED" 2 "ACCIDENT" 3 "ADVICE" 4 "BEGINS" 5 "BUS" 6 "CAMPER" 7 "CAR" 8 "CARAVAN" 9 "CRASHRISK" 10 "DIRT" 11 "DISTANCE" 12 "DISTANCEBARS" 13 "END" 14 "EXITL" 15 "EXITR" 16 "FOG" 17 "GRAVEL" 18 "HAZMAT" 19 "HUMP" 20 "JAM" 21 "LORRY" 22 "EXCEPTLORRY" 23 "LOWTREE" 24 "MCYCLE" 25 "MINIMUM" 26 "NIGHT" 27 "NOSTOPSHOULDER" 28 "OILTRAIL" 29 "PRIOTURN" 30 "RADAR" 31 "RAIN" 32 "RAINSNOW" 33 "REMINDER" 34 "ROADDAMAGE" 35 "RUTS" 36 "RWORKSACCESS" 37 "RWORKSENTRY" 38 "RWORKSEXIT" 39 "SCHOOL" 40 "SECTION" 41 "SMOKE" 42 "SNOW" 43 "SOFTSHOULDERCAR" 44 "SHOFTSHOULDERLORRY" 45 "TEXT" 46 "TIME" 47 "TOWING" 48 "TRACTOR" 49 "TRACTOR_OVER" 50 "TRAILER" 51 "WEIGHT" 52 "WET" 53 "WITHIN" 54 "ZONE" 55 "EXIT" 56 "ACCESS" 57 "ALLWAY" 58 "EXCEPTBUS" 59 "EXCEPTDELIVERY" 60 "EXCEPTLOCAL" 61 "FROG" 62 "PRIOTURNL" 63 "PRIOTURNR" 64 "START" 65 "STOPIN" 66 "HAZWATER" 67 "DAY" 68 "SL" ;
VAL_ 245 VFC_TS07_AddTS1Quality 0 "Poor Quality" 1 "Good Quality" ;
VAL_ 245 VFC_TS07_AddTS1VMS 0 "Fixed" 1 "Variable" ;
VAL_ 245 VFC_TS07_AddTS2Class 0 "UNKNOWN" 1 "DETECTED" 2 "ACCIDENT" 3 "ADVICE" 4 "BEGINS" 5 "BUS" 6 "CAMPER" 7 "CAR" 8 "CARAVAN" 9 "CRASHRISK" 10 "DIRT" 11 "DISTANCE" 12 "DISTANCEBARS" 13 "END" 14 "EXITL" 15 "EXITR" 16 "FOG" 17 "GRAVEL" 18 "HAZMAT" 19 "HUMP" 20 "JAM" 21 "LORRY" 22 "EXCEPTLORRY" 23 "LOWTREE" 24 "MCYCLE" 25 "MINIMUM" 26 "NIGHT" 27 "NOSTOPSHOULDER" 28 "OILTRAIL" 29 "PRIOTURN" 30 "RADAR" 31 "RAIN" 32 "RAINSNOW" 33 "REMINDER" 34 "ROADDAMAGE" 35 "RUTS" 36 "RWORKSACCESS" 37 "RWORKSENTRY" 38 "RWORKSEXIT" 39 "SCHOOL" 40 "SECTION" 41 "SMOKE" 42 "SNOW" 43 "SOFTSHOULDERCAR" 44 "SHOFTSHOULDERLORRY" 45 "TEXT" 46 "TIME" 47 "TOWING" 48 "TRACTOR" 49 "TRACTOR_OVER" 50 "TRAILER" 51 "WEIGHT" 52 "WET" 53 "WITHIN" 54 "ZONE" 55 "EXIT" 56 "ACCESS" 57 "ALLWAY" 58 "EXCEPTBUS" 59 "EXCEPTDELIVERY" 60 "EXCEPTLOCAL" 61 "FROG" 62 "PRIOTURNL" 63 "PRIOTURNR" 64 "START" 65 "STOPIN" 66 "HAZWATER" 67 "DAY" 68 "SL" ;
VAL_ 245 VFC_TS07_AddTS2Quality 0 "Poor Quality" 1 "Good Quality" ;
VAL_ 245 VFC_TS07_AddTS2VMS 0 "Fixed" 1 "Variable" ;
VAL_ 245 VFC_TS07_AddTS3Class 0 "UNKNOWN" 1 "DETECTED" 2 "ACCIDENT" 3 "ADVICE" 4 "BEGINS" 5 "BUS" 6 "CAMPER" 7 "CAR" 8 "CARAVAN" 9 "CRASHRISK" 10 "DIRT" 11 "DISTANCE" 12 "DISTANCEBARS" 13 "END" 14 "EXITL" 15 "EXITR" 16 "FOG" 17 "GRAVEL" 18 "HAZMAT" 19 "HUMP" 20 "JAM" 21 "LORRY" 22 "EXCEPTLORRY" 23 "LOWTREE" 24 "MCYCLE" 25 "MINIMUM" 26 "NIGHT" 27 "NOSTOPSHOULDER" 28 "OILTRAIL" 29 "PRIOTURN" 30 "RADAR" 31 "RAIN" 32 "RAINSNOW" 33 "REMINDER" 34 "ROADDAMAGE" 35 "RUTS" 36 "RWORKSACCESS" 37 "RWORKSENTRY" 38 "RWORKSEXIT" 39 "SCHOOL" 40 "SECTION" 41 "SMOKE" 42 "SNOW" 43 "SOFTSHOULDERCAR" 44 "SHOFTSHOULDERLORRY" 45 "TEXT" 46 "TIME" 47 "TOWING" 48 "TRACTOR" 49 "TRACTOR_OVER" 50 "TRAILER" 51 "WEIGHT" 52 "WET" 53 "WITHIN" 54 "ZONE" 55 "EXIT" 56 "ACCESS" 57 "ALLWAY" 58 "EXCEPTBUS" 59 "EXCEPTDELIVERY" 60 "EXCEPTLOCAL" 61 "FROG" 62 "PRIOTURNL" 63 "PRIOTURNR" 64 "START" 65 "STOPIN" 66 "HAZWATER" 67 "DAY" 68 "SL" ;
VAL_ 245 VFC_TS07_AddTS3Quality 0 "Poor Quality" 1 "Good Quality" ;
VAL_ 245 VFC_TS07_AddTS3VMS 0 "Fixed" 1 "Variable" ;
VAL_ 245 VFC_TS07_AddTS4Class 0 "UNKNOWN" 1 "DETECTED" 2 "ACCIDENT" 3 "ADVICE" 4 "BEGINS" 5 "BUS" 6 "CAMPER" 7 "CAR" 8 "CARAVAN" 9 "CRASHRISK" 10 "DIRT" 11 "DISTANCE" 12 "DISTANCEBARS" 13 "END" 14 "EXITL" 15 "EXITR" 16 "FOG" 17 "GRAVEL" 18 "HAZMAT" 19 "HUMP" 20 "JAM" 21 "LORRY" 22 "EXCEPTLORRY" 23 "LOWTREE" 24 "MCYCLE" 25 "MINIMUM" 26 "NIGHT" 27 "NOSTOPSHOULDER" 28 "OILTRAIL" 29 "PRIOTURN" 30 "RADAR" 31 "RAIN" 32 "RAINSNOW" 33 "REMINDER" 34 "ROADDAMAGE" 35 "RUTS" 36 "RWORKSACCESS" 37 "RWORKSENTRY" 38 "RWORKSEXIT" 39 "SCHOOL" 40 "SECTION" 41 "SMOKE" 42 "SNOW" 43 "SOFTSHOULDERCAR" 44 "SHOFTSHOULDERLORRY" 45 "TEXT" 46 "TIME" 47 "TOWING" 48 "TRACTOR" 49 "TRACTOR_OVER" 50 "TRAILER" 51 "WEIGHT" 52 "WET" 53 "WITHIN" 54 "ZONE" 55 "EXIT" 56 "ACCESS" 57 "ALLWAY" 58 "EXCEPTBUS" 59 "EXCEPTDELIVERY" 60 "EXCEPTLOCAL" 61 "FROG" 62 "PRIOTURNL" 63 "PRIOTURNR" 64 "START" 65 "STOPIN" 66 "HAZWATER" 67 "DAY" 68 "SL" ;
VAL_ 245 VFC_TS07_AddTS4Quality 0 "Poor Quality" 1 "Good Quality" ;
VAL_ 245 VFC_TS07_AddTS4VMS 0 "Fixed" 1 "Variable" ;
VAL_ 245 VFC_TS07_AddTS5Class 0 "UNKNOWN" 1 "DETECTED" 2 "ACCIDENT" 3 "ADVICE" 4 "BEGINS" 5 "BUS" 6 "CAMPER" 7 "CAR" 8 "CARAVAN" 9 "CRASHRISK" 10 "DIRT" 11 "DISTANCE" 12 "DISTANCEBARS" 13 "END" 14 "EXITL" 15 "EXITR" 16 "FOG" 17 "GRAVEL" 18 "HAZMAT" 19 "HUMP" 20 "JAM" 21 "LORRY" 22 "EXCEPTLORRY" 23 "LOWTREE" 24 "MCYCLE" 25 "MINIMUM" 26 "NIGHT" 27 "NOSTOPSHOULDER" 28 "OILTRAIL" 29 "PRIOTURN" 30 "RADAR" 31 "RAIN" 32 "RAINSNOW" 33 "REMINDER" 34 "ROADDAMAGE" 35 "RUTS" 36 "RWORKSACCESS" 37 "RWORKSENTRY" 38 "RWORKSEXIT" 39 "SCHOOL" 40 "SECTION" 41 "SMOKE" 42 "SNOW" 43 "SOFTSHOULDERCAR" 44 "SHOFTSHOULDERLORRY" 45 "TEXT" 46 "TIME" 47 "TOWING" 48 "TRACTOR" 49 "TRACTOR_OVER" 50 "TRAILER" 51 "WEIGHT" 52 "WET" 53 "WITHIN" 54 "ZONE" 55 "EXIT" 56 "ACCESS" 57 "ALLWAY" 58 "EXCEPTBUS" 59 "EXCEPTDELIVERY" 60 "EXCEPTLOCAL" 61 "FROG" 62 "PRIOTURNL" 63 "PRIOTURNR" 64 "START" 65 "STOPIN" 66 "HAZWATER" 67 "DAY" 68 "SL" ;
VAL_ 245 VFC_TS07_AddTS5Quality 0 "Poor Quality" 1 "Good Quality" ;
VAL_ 245 VFC_TS07_AddTS5VMS 0 "Fixed" 1 "Variable" ;
VAL_ 245 VFC_TS07_AddTS6Class 0 "UNKNOWN" 1 "DETECTED" 2 "ACCIDENT" 3 "ADVICE" 4 "BEGINS" 5 "BUS" 6 "CAMPER" 7 "CAR" 8 "CARAVAN" 9 "CRASHRISK" 10 "DIRT" 11 "DISTANCE" 12 "DISTANCEBARS" 13 "END" 14 "EXITL" 15 "EXITR" 16 "FOG" 17 "GRAVEL" 18 "HAZMAT" 19 "HUMP" 20 "JAM" 21 "LORRY" 22 "EXCEPTLORRY" 23 "LOWTREE" 24 "MCYCLE" 25 "MINIMUM" 26 "NIGHT" 27 "NOSTOPSHOULDER" 28 "OILTRAIL" 29 "PRIOTURN" 30 "RADAR" 31 "RAIN" 32 "RAINSNOW" 33 "REMINDER" 34 "ROADDAMAGE" 35 "RUTS" 36 "RWORKSACCESS" 37 "RWORKSENTRY" 38 "RWORKSEXIT" 39 "SCHOOL" 40 "SECTION" 41 "SMOKE" 42 "SNOW" 43 "SOFTSHOULDERCAR" 44 "SHOFTSHOULDERLORRY" 45 "TEXT" 46 "TIME" 47 "TOWING" 48 "TRACTOR" 49 "TRACTOR_OVER" 50 "TRAILER" 51 "WEIGHT" 52 "WET" 53 "WITHIN" 54 "ZONE" 55 "EXIT" 56 "ACCESS" 57 "ALLWAY" 58 "EXCEPTBUS" 59 "EXCEPTDELIVERY" 60 "EXCEPTLOCAL" 61 "FROG" 62 "PRIOTURNL" 63 "PRIOTURNR" 64 "START" 65 "STOPIN" 66 "HAZWATER" 67 "DAY" 68 "SL" ;
VAL_ 245 VFC_TS07_AddTS6Quality 0 "Poor Quality" 1 "Good Quality" ;
VAL_ 245 VFC_TS07_AddTS6VMS 0 "Fixed" 1 "Variable" ;
VAL_ 246 VFC_TS08_ID 0 "INVALID" ;
VAL_ 246 VFC_TS08_Class 0 "UNKNOWN" 1 "SL5" 2 "SL10" 3 "SL15" 4 "SL20" 5 "SL25" 6 "SL30" 7 "SL35" 8 "SL40" 9 "SL45" 10 "SL50" 11 "SL55" 12 "SL60" 13 "SL65" 14 "SL70" 15 "SL75" 16 "SL80" 17 "SL85" 18 "SL90" 19 "SL95" 20 "SL100" 21 "SL105" 22 "SL110" 23 "SL115" 24 "SL120" 25 "SL125" 26 "SL130" 27 "SL135" 28 "SL140" 29 "SL145" 30 "SL150" 31 "SL155" 32 "SL160" 33 "ESL" 34 "EA" 35 "OP" 36 "EOP" 37 "OL" 38 "EOL" 39 "GIVEWAY" 40 "PRIOCROSS" 41 "PRIOCROSSYIELDTORIGHT" 42 "PRIOSTREET" 43 "EPRIOSTREET" 44 "STOP" 45 "AXLEWEIGHT" 46 "CARDIST" 47 "HEIGHT" 48 "LENGTH" 49 "LORRYDIST" 50 "NOALL" 51 "NOBIKE" 52 "NOBUS" 53 "NOCAR" 54 "NOCARBIKE" 55 "NOCARRIAGE" 56 "NOENTRY" 57 "NOHAZMAT" 58 "NOHAZWATER" 59 "NOLORRY" 60 "NOLORRYTRAILER" 61 "NOLTURN" 62 "NOPED" 63 "NORIDER" 64 "NORTURN" 65 "NOTRACTOR" 66 "NOTWOWAY" 67 "NOUTURN" 68 "UMWELT" 69 "EUMWELT" 70 "WEIGHT" 71 "WIDTH" 72 "WARNBIKE" 73 "WARNBUS" 74 "WARNCATTLE" 75 "WARNCONST" 76 "WARNCONSTL" 77 "WARNCONSTR" 78 "WARNCURVEL" 79 "WARNCURVER" 80 "WARNDANGER" 81 "WARNDCURVEL" 82 "WARNDCURVER" 83 "WARNDRAWBRIDGE" 84 "WARNFROG" 85 "WARNGRAVEL" 86 "WARNHUMP" 87 "WARNJAM" 88 "WARNKIDS" 89 "WARNLIGHTS" 90 "WARNLOWTREE" 91 "WARNPCROSS" 92 "WARNPED" 93 "WARNPIER" 94 "WARNPLANE" 95 "WARNRIDER" 96 "WARNROCK" 97 "WARNROUND" 98 "WARNRWORKS" 99 "WARNSKID" 100 "WARNSLOPED" 101 "WARNSLOPEU" 102 "WARNSNOW" 103 "WARNTRAIN" 104 "WARNTWOWAY" 105 "WARNWILDANIMAL" 106 "WARNWIND" 107 "ASL" 108 "EASL" 109 "CALM" 110 "ECALM" 111 "DEADEND" 112 "DOUANE" 113 "FWAY" 114 "EFWAY" 115 "HWAY" 116 "EHWAY" 117 "MSL" 118 "EMSL" 119 "NOPARK" 120 "NOSTOP" 121 "ONEWAYS" 122 "ONEWAYU" 123 "SLOWDOWN" 124 "SCHOOL" 125 "ESCHOOL" 126 "TWN" 127 "ETWN" 128 "WBBENTLEFT" 129 "WBBENTLEFTRIGHT" 130 "WBBENTRIGHT" 131 "WBDIAGL" 132 "WBDIAGLR" 133 "WBDIAGR" 134 "WBHAZWATER" 135 "WBLEFT" 136 "WBRIGHT" 137 "WBROUND" 138 "WBUP" 139 "WBUPLEFT" 140 "WBUPRIGHT" 141 "ZEBRA" 142 "HAZMAT" 143 "EMERGENCYBAY" 144 "ENDOFLANEL" 145 "ENDOFLANER" 146 "ENOPARK" 147 "EONEWAY" 148 "EPARK" 149 "ETOLL" 150 "NOPARKL" 151 "NOPARKLR" 152 "NOPARKR" 153 "NOSTOPL" 154 "NOSTOPLR" 155 "NOSTOPR" 156 "NOTURNONRED" 157 "ONEWAYL" 158 "ONEWAYR" 159 "PARK" 160 "PRIOCROSSL" 161 "PRIOCROSSR" 162 "TOLL" 163 "TUNNEL" 164 "TWOWAY" 165 "WARNCROSS" 166 "WARNCROSSL" 167 "WARNCROSSLR" 168 "WARNCROSSR" 169 "WARNCROSSRL" 170 "WARNCROSST" 171 "WARNGIVEWAYAHEAD" 172 "WARNSLAHEAD" 173 "WARNSTOPAHEAD" 174 "WBBUS" 175 "WRONGWAY" 176 "HAZWATER" 177 "GIVEWAYROUND" 178 "WARNWINDINGL" 179 "WARNWINDINGR" 180 "WARNHAIRPINL" 181 "WARNHAIRPINR" 182 "WARNPEDBIKE" 183 "WARNCROSSY" 184 "WARNBRANCHL" 185 "WARNBRANCHR" 186 "WARNAXLEWEIGHT" 187 "WARNWEIGHT" 188 "WARNHEIGHT" 189 "WARNLENGTH" 190 "WARNWIDTH" 191 "WARNBLACKSPOT" 192 "WARNMERGEL" 193 "WARNMERGER" 194 "WARNTUNNEL" 195 "WARNTRACTOR" 196 "WARNRWORKSVEHICLE" 197 "WARNNARROWBRIDGE" 198 "WARNFLAGGER" 199 "LANES" 200 "LANESHIFTL" 201 "LANESHIFTR" 202 "NEWLANEL" 203 "NEWLANER" 204 "RIGHTTURNONRED" 205 "BORDERLIMIT" 206 "EMBEDDEDRAIN" ;
VAL_ 246 VFC_TS08_EmbedFlag 0 "Unknown" 1 "Not Embedded" 2 "Border Limit" 3 "Multi Lane" 4 "Rain" 5 "Vehicle Type" 6 "Plate" 7 "Error Value" ;
VAL_ 246 VFC_TS08_Quality 0 "Poor Quality" 1 "Good Quality" ;
VAL_ 246 VFC_TS08_VMS 0 "Fixed" 1 "Variable" ;
VAL_ 246 VFC_TS08_Stable 0 "Object Is Not Stable" 1 "Object Is Stable" ;
VAL_ 246 VFC_TS08_VehicleSticker 0 "not_sticker_on_vehicle" 1 "Sign is a sticker on a vehicle" ;
VAL_ 246 VFC_TS08_InternalTrack 0 "Sign is not an internal track" 1 "Sign is an internal track" ;
VAL_ 246 VFC_TS08_AddTS1Class 0 "UNKNOWN" 1 "DETECTED" 2 "ACCIDENT" 3 "ADVICE" 4 "BEGINS" 5 "BUS" 6 "CAMPER" 7 "CAR" 8 "CARAVAN" 9 "CRASHRISK" 10 "DIRT" 11 "DISTANCE" 12 "DISTANCEBARS" 13 "END" 14 "EXITL" 15 "EXITR" 16 "FOG" 17 "GRAVEL" 18 "HAZMAT" 19 "HUMP" 20 "JAM" 21 "LORRY" 22 "EXCEPTLORRY" 23 "LOWTREE" 24 "MCYCLE" 25 "MINIMUM" 26 "NIGHT" 27 "NOSTOPSHOULDER" 28 "OILTRAIL" 29 "PRIOTURN" 30 "RADAR" 31 "RAIN" 32 "RAINSNOW" 33 "REMINDER" 34 "ROADDAMAGE" 35 "RUTS" 36 "RWORKSACCESS" 37 "RWORKSENTRY" 38 "RWORKSEXIT" 39 "SCHOOL" 40 "SECTION" 41 "SMOKE" 42 "SNOW" 43 "SOFTSHOULDERCAR" 44 "SHOFTSHOULDERLORRY" 45 "TEXT" 46 "TIME" 47 "TOWING" 48 "TRACTOR" 49 "TRACTOR_OVER" 50 "TRAILER" 51 "WEIGHT" 52 "WET" 53 "WITHIN" 54 "ZONE" 55 "EXIT" 56 "ACCESS" 57 "ALLWAY" 58 "EXCEPTBUS" 59 "EXCEPTDELIVERY" 60 "EXCEPTLOCAL" 61 "FROG" 62 "PRIOTURNL" 63 "PRIOTURNR" 64 "START" 65 "STOPIN" 66 "HAZWATER" 67 "DAY" 68 "SL" ;
VAL_ 246 VFC_TS08_AddTS1Quality 0 "Poor Quality" 1 "Good Quality" ;
VAL_ 246 VFC_TS08_AddTS1VMS 0 "Fixed" 1 "Variable" ;
VAL_ 246 VFC_TS08_AddTS2Class 0 "UNKNOWN" 1 "DETECTED" 2 "ACCIDENT" 3 "ADVICE" 4 "BEGINS" 5 "BUS" 6 "CAMPER" 7 "CAR" 8 "CARAVAN" 9 "CRASHRISK" 10 "DIRT" 11 "DISTANCE" 12 "DISTANCEBARS" 13 "END" 14 "EXITL" 15 "EXITR" 16 "FOG" 17 "GRAVEL" 18 "HAZMAT" 19 "HUMP" 20 "JAM" 21 "LORRY" 22 "EXCEPTLORRY" 23 "LOWTREE" 24 "MCYCLE" 25 "MINIMUM" 26 "NIGHT" 27 "NOSTOPSHOULDER" 28 "OILTRAIL" 29 "PRIOTURN" 30 "RADAR" 31 "RAIN" 32 "RAINSNOW" 33 "REMINDER" 34 "ROADDAMAGE" 35 "RUTS" 36 "RWORKSACCESS" 37 "RWORKSENTRY" 38 "RWORKSEXIT" 39 "SCHOOL" 40 "SECTION" 41 "SMOKE" 42 "SNOW" 43 "SOFTSHOULDERCAR" 44 "SHOFTSHOULDERLORRY" 45 "TEXT" 46 "TIME" 47 "TOWING" 48 "TRACTOR" 49 "TRACTOR_OVER" 50 "TRAILER" 51 "WEIGHT" 52 "WET" 53 "WITHIN" 54 "ZONE" 55 "EXIT" 56 "ACCESS" 57 "ALLWAY" 58 "EXCEPTBUS" 59 "EXCEPTDELIVERY" 60 "EXCEPTLOCAL" 61 "FROG" 62 "PRIOTURNL" 63 "PRIOTURNR" 64 "START" 65 "STOPIN" 66 "HAZWATER" 67 "DAY" 68 "SL" ;
VAL_ 246 VFC_TS08_AddTS2Quality 0 "Poor Quality" 1 "Good Quality" ;
VAL_ 246 VFC_TS08_AddTS2VMS 0 "Fixed" 1 "Variable" ;
VAL_ 246 VFC_TS08_AddTS3Class 0 "UNKNOWN" 1 "DETECTED" 2 "ACCIDENT" 3 "ADVICE" 4 "BEGINS" 5 "BUS" 6 "CAMPER" 7 "CAR" 8 "CARAVAN" 9 "CRASHRISK" 10 "DIRT" 11 "DISTANCE" 12 "DISTANCEBARS" 13 "END" 14 "EXITL" 15 "EXITR" 16 "FOG" 17 "GRAVEL" 18 "HAZMAT" 19 "HUMP" 20 "JAM" 21 "LORRY" 22 "EXCEPTLORRY" 23 "LOWTREE" 24 "MCYCLE" 25 "MINIMUM" 26 "NIGHT" 27 "NOSTOPSHOULDER" 28 "OILTRAIL" 29 "PRIOTURN" 30 "RADAR" 31 "RAIN" 32 "RAINSNOW" 33 "REMINDER" 34 "ROADDAMAGE" 35 "RUTS" 36 "RWORKSACCESS" 37 "RWORKSENTRY" 38 "RWORKSEXIT" 39 "SCHOOL" 40 "SECTION" 41 "SMOKE" 42 "SNOW" 43 "SOFTSHOULDERCAR" 44 "SHOFTSHOULDERLORRY" 45 "TEXT" 46 "TIME" 47 "TOWING" 48 "TRACTOR" 49 "TRACTOR_OVER" 50 "TRAILER" 51 "WEIGHT" 52 "WET" 53 "WITHIN" 54 "ZONE" 55 "EXIT" 56 "ACCESS" 57 "ALLWAY" 58 "EXCEPTBUS" 59 "EXCEPTDELIVERY" 60 "EXCEPTLOCAL" 61 "FROG" 62 "PRIOTURNL" 63 "PRIOTURNR" 64 "START" 65 "STOPIN" 66 "HAZWATER" 67 "DAY" 68 "SL" ;
VAL_ 246 VFC_TS08_AddTS3Quality 0 "Poor Quality" 1 "Good Quality" ;
VAL_ 246 VFC_TS08_AddTS3VMS 0 "Fixed" 1 "Variable" ;
VAL_ 246 VFC_TS08_AddTS4Class 0 "UNKNOWN" 1 "DETECTED" 2 "ACCIDENT" 3 "ADVICE" 4 "BEGINS" 5 "BUS" 6 "CAMPER" 7 "CAR" 8 "CARAVAN" 9 "CRASHRISK" 10 "DIRT" 11 "DISTANCE" 12 "DISTANCEBARS" 13 "END" 14 "EXITL" 15 "EXITR" 16 "FOG" 17 "GRAVEL" 18 "HAZMAT" 19 "HUMP" 20 "JAM" 21 "LORRY" 22 "EXCEPTLORRY" 23 "LOWTREE" 24 "MCYCLE" 25 "MINIMUM" 26 "NIGHT" 27 "NOSTOPSHOULDER" 28 "OILTRAIL" 29 "PRIOTURN" 30 "RADAR" 31 "RAIN" 32 "RAINSNOW" 33 "REMINDER" 34 "ROADDAMAGE" 35 "RUTS" 36 "RWORKSACCESS" 37 "RWORKSENTRY" 38 "RWORKSEXIT" 39 "SCHOOL" 40 "SECTION" 41 "SMOKE" 42 "SNOW" 43 "SOFTSHOULDERCAR" 44 "SHOFTSHOULDERLORRY" 45 "TEXT" 46 "TIME" 47 "TOWING" 48 "TRACTOR" 49 "TRACTOR_OVER" 50 "TRAILER" 51 "WEIGHT" 52 "WET" 53 "WITHIN" 54 "ZONE" 55 "EXIT" 56 "ACCESS" 57 "ALLWAY" 58 "EXCEPTBUS" 59 "EXCEPTDELIVERY" 60 "EXCEPTLOCAL" 61 "FROG" 62 "PRIOTURNL" 63 "PRIOTURNR" 64 "START" 65 "STOPIN" 66 "HAZWATER" 67 "DAY" 68 "SL" ;
VAL_ 246 VFC_TS08_AddTS4Quality 0 "Poor Quality" 1 "Good Quality" ;
VAL_ 246 VFC_TS08_AddTS4VMS 0 "Fixed" 1 "Variable" ;
VAL_ 246 VFC_TS08_AddTS5Class 0 "UNKNOWN" 1 "DETECTED" 2 "ACCIDENT" 3 "ADVICE" 4 "BEGINS" 5 "BUS" 6 "CAMPER" 7 "CAR" 8 "CARAVAN" 9 "CRASHRISK" 10 "DIRT" 11 "DISTANCE" 12 "DISTANCEBARS" 13 "END" 14 "EXITL" 15 "EXITR" 16 "FOG" 17 "GRAVEL" 18 "HAZMAT" 19 "HUMP" 20 "JAM" 21 "LORRY" 22 "EXCEPTLORRY" 23 "LOWTREE" 24 "MCYCLE" 25 "MINIMUM" 26 "NIGHT" 27 "NOSTOPSHOULDER" 28 "OILTRAIL" 29 "PRIOTURN" 30 "RADAR" 31 "RAIN" 32 "RAINSNOW" 33 "REMINDER" 34 "ROADDAMAGE" 35 "RUTS" 36 "RWORKSACCESS" 37 "RWORKSENTRY" 38 "RWORKSEXIT" 39 "SCHOOL" 40 "SECTION" 41 "SMOKE" 42 "SNOW" 43 "SOFTSHOULDERCAR" 44 "SHOFTSHOULDERLORRY" 45 "TEXT" 46 "TIME" 47 "TOWING" 48 "TRACTOR" 49 "TRACTOR_OVER" 50 "TRAILER" 51 "WEIGHT" 52 "WET" 53 "WITHIN" 54 "ZONE" 55 "EXIT" 56 "ACCESS" 57 "ALLWAY" 58 "EXCEPTBUS" 59 "EXCEPTDELIVERY" 60 "EXCEPTLOCAL" 61 "FROG" 62 "PRIOTURNL" 63 "PRIOTURNR" 64 "START" 65 "STOPIN" 66 "HAZWATER" 67 "DAY" 68 "SL" ;
VAL_ 246 VFC_TS08_AddTS5Quality 0 "Poor Quality" 1 "Good Quality" ;
VAL_ 246 VFC_TS08_AddTS5VMS 0 "Fixed" 1 "Variable" ;
VAL_ 246 VFC_TS08_AddTS6Class 0 "UNKNOWN" 1 "DETECTED" 2 "ACCIDENT" 3 "ADVICE" 4 "BEGINS" 5 "BUS" 6 "CAMPER" 7 "CAR" 8 "CARAVAN" 9 "CRASHRISK" 10 "DIRT" 11 "DISTANCE" 12 "DISTANCEBARS" 13 "END" 14 "EXITL" 15 "EXITR" 16 "FOG" 17 "GRAVEL" 18 "HAZMAT" 19 "HUMP" 20 "JAM" 21 "LORRY" 22 "EXCEPTLORRY" 23 "LOWTREE" 24 "MCYCLE" 25 "MINIMUM" 26 "NIGHT" 27 "NOSTOPSHOULDER" 28 "OILTRAIL" 29 "PRIOTURN" 30 "RADAR" 31 "RAIN" 32 "RAINSNOW" 33 "REMINDER" 34 "ROADDAMAGE" 35 "RUTS" 36 "RWORKSACCESS" 37 "RWORKSENTRY" 38 "RWORKSEXIT" 39 "SCHOOL" 40 "SECTION" 41 "SMOKE" 42 "SNOW" 43 "SOFTSHOULDERCAR" 44 "SHOFTSHOULDERLORRY" 45 "TEXT" 46 "TIME" 47 "TOWING" 48 "TRACTOR" 49 "TRACTOR_OVER" 50 "TRAILER" 51 "WEIGHT" 52 "WET" 53 "WITHIN" 54 "ZONE" 55 "EXIT" 56 "ACCESS" 57 "ALLWAY" 58 "EXCEPTBUS" 59 "EXCEPTDELIVERY" 60 "EXCEPTLOCAL" 61 "FROG" 62 "PRIOTURNL" 63 "PRIOTURNR" 64 "START" 65 "STOPIN" 66 "HAZWATER" 67 "DAY" 68 "SL" ;
VAL_ 246 VFC_TS08_AddTS6Quality 0 "Poor Quality" 1 "Good Quality" ;
VAL_ 246 VFC_TS08_AddTS6VMS 0 "Fixed" 1 "Variable" ;
SIG_GROUP_ 236 SG_VFC_TrafficSignHdr 1 : VFC_TSHdr_CRC VFC_TSHdr_AliveCtr VFC_TSHdr_ProtBlockCtr VFC_TSHdr_ProtTrafficSignCount VFC_TSHdr_State VFC_TSHdr_Brightness VFC_TSHdr_Country VFC_TSHdr_TimeStampStatus VFC_TSHdr_TimeStamp VFC_TSHdr_CountryMode;
SIG_GROUP_ 238 SG_VFC_TrafficSign00 1 : VFC_TS00_CRC VFC_TS00_AliveCtr VFC_TS00_ProtBlockCtr VFC_TS00_ProtOrderIndex VFC_TS00_ID VFC_TS00_Class VFC_TS00_TSProb VFC_TS00_Dx VFC_TS00_Dy VFC_TS00_Dz VFC_TS00_DxStdDev VFC_TS00_DyStdDev VFC_TS00_DzStdDev VFC_TS00_Width VFC_TS00_Height VFC_TS00_EmbedFlag VFC_TS00_Quality VFC_TS00_VMS VFC_TS00_Stable VFC_TS00_VehicleSticker VFC_TS00_InternalTrack VFC_TS00_ValidLanes VFC_TS00_ValidDay VFC_TS00_ValidTimeRange1Start VFC_TS00_ValidTimeRange1End VFC_TS00_ValidTimeRange2Start VFC_TS00_ValidTimeRange2End VFC_TS00_ValidInDist VFC_TS00_ValidDist VFC_TS00_AddTSCount VFC_TS00_AddTS1Class VFC_TS00_AddTS1Prob VFC_TS00_AddTS1Quality VFC_TS00_AddTS1VMS VFC_TS00_AddTS2Class VFC_TS00_AddTS2Prob VFC_TS00_AddTS2Quality VFC_TS00_AddTS2VMS VFC_TS00_AddTS3Class VFC_TS00_AddTS3Prob VFC_TS00_AddTS3Quality VFC_TS00_AddTS3VMS VFC_TS00_AddTS4Class VFC_TS00_AddTS4Prob VFC_TS00_AddTS4Quality VFC_TS00_AddTS4VMS VFC_TS00_AddTS5Class VFC_TS00_AddTS5Prob VFC_TS00_AddTS5Quality VFC_TS00_AddTS5VMS VFC_TS00_AddTS6Class VFC_TS00_AddTS6Prob VFC_TS00_AddTS6Quality VFC_TS00_AddTS6VMS;
SIG_GROUP_ 239 SG_VFC_TrafficSign01 1 : VFC_TS01_CRC VFC_TS01_AliveCtr VFC_TS01_ProtBlockCtr VFC_TS01_ProtOrderIndex VFC_TS01_ID VFC_TS01_Class VFC_TS01_TSProb VFC_TS01_Dx VFC_TS01_Dy VFC_TS01_Dz VFC_TS01_DxStdDev VFC_TS01_DyStdDev VFC_TS01_DzStdDev VFC_TS01_Width VFC_TS01_Height VFC_TS01_EmbedFlag VFC_TS01_Quality VFC_TS01_VMS VFC_TS01_Stable VFC_TS01_VehicleSticker VFC_TS01_InternalTrack VFC_TS01_ValidLanes VFC_TS01_ValidDay VFC_TS01_ValidTimeRange1Start VFC_TS01_ValidTimeRange1End VFC_TS01_ValidTimeRange2Start VFC_TS01_ValidTimeRange2End VFC_TS01_ValidInDist VFC_TS01_ValidDist VFC_TS01_AddTSCount VFC_TS01_AddTS1Class VFC_TS01_AddTS1Prob VFC_TS01_AddTS1Quality VFC_TS01_AddTS1VMS VFC_TS01_AddTS2Class VFC_TS01_AddTS2Prob VFC_TS01_AddTS2Quality VFC_TS01_AddTS2VMS VFC_TS01_AddTS3Class VFC_TS01_AddTS3Prob VFC_TS01_AddTS3Quality VFC_TS01_AddTS3VMS VFC_TS01_AddTS4Class VFC_TS01_AddTS4Prob VFC_TS01_AddTS4Quality VFC_TS01_AddTS4VMS VFC_TS01_AddTS5Class VFC_TS01_AddTS5Prob VFC_TS01_AddTS5Quality VFC_TS01_AddTS5VMS VFC_TS01_AddTS6Class VFC_TS01_AddTS6Prob VFC_TS01_AddTS6Quality VFC_TS01_AddTS6VMS;
SIG_GROUP_ 240 SG_VFC_TrafficSign02 1 : VFC_TS02_CRC VFC_TS02_AliveCtr VFC_TS02_ProtBlockCtr VFC_TS02_ProtOrderIndex VFC_TS02_ID VFC_TS02_Class VFC_TS02_TSProb VFC_TS02_Dx VFC_TS02_Dy VFC_TS02_Dz VFC_TS02_DxStdDev VFC_TS02_DyStdDev VFC_TS02_DzStdDev VFC_TS02_Width VFC_TS02_Height VFC_TS02_EmbedFlag VFC_TS02_Quality VFC_TS02_VMS VFC_TS02_Stable VFC_TS02_VehicleSticker VFC_TS02_InternalTrack VFC_TS02_ValidLanes VFC_TS02_ValidDay VFC_TS02_ValidTimeRange1Start VFC_TS02_ValidTimeRange1End VFC_TS02_ValidTimeRange2Start VFC_TS02_ValidTimeRange2End VFC_TS02_ValidInDist VFC_TS02_ValidDist VFC_TS02_AddTSCount VFC_TS02_AddTS1Class VFC_TS02_AddTS1Prob VFC_TS02_AddTS1Quality VFC_TS02_AddTS1VMS VFC_TS02_AddTS2Class VFC_TS02_AddTS2Prob VFC_TS02_AddTS2Quality VFC_TS02_AddTS2VMS VFC_TS02_AddTS3Class VFC_TS02_AddTS3Prob VFC_TS02_AddTS3Quality VFC_TS02_AddTS3VMS VFC_TS02_AddTS4Class VFC_TS02_AddTS4Prob VFC_TS02_AddTS4Quality VFC_TS02_AddTS4VMS VFC_TS02_AddTS5Class VFC_TS02_AddTS5Prob VFC_TS02_AddTS5Quality VFC_TS02_AddTS5VMS VFC_TS02_AddTS6Class VFC_TS02_AddTS6Prob VFC_TS02_AddTS6Quality VFC_TS02_AddTS6VMS;
SIG_GROUP_ 241 SG_VFC_TrafficSign03 1 : VFC_TS03_CRC VFC_TS03_AliveCtr VFC_TS03_ProtBlockCtr VFC_TS03_ProtOrderIndex VFC_TS03_ID VFC_TS03_Class VFC_TS03_TSProb VFC_TS03_Dx VFC_TS03_Dy VFC_TS03_Dz VFC_TS03_DxStdDev VFC_TS03_DyStdDev VFC_TS03_DzStdDev VFC_TS03_Width VFC_TS03_Height VFC_TS03_EmbedFlag VFC_TS03_Quality VFC_TS03_VMS VFC_TS03_Stable VFC_TS03_VehicleSticker VFC_TS03_InternalTrack VFC_TS03_ValidLanes VFC_TS03_ValidDay VFC_TS03_ValidTimeRange1Start VFC_TS03_ValidTimeRange1End VFC_TS03_ValidTimeRange2Start VFC_TS03_ValidTimeRange2End VFC_TS03_ValidInDist VFC_TS03_ValidDist VFC_TS03_AddTSCount VFC_TS03_AddTS1Class VFC_TS03_AddTS1Prob VFC_TS03_AddTS1Quality VFC_TS03_AddTS1VMS VFC_TS03_AddTS2Class VFC_TS03_AddTS2Prob VFC_TS03_AddTS2Quality VFC_TS03_AddTS2VMS VFC_TS03_AddTS3Class VFC_TS03_AddTS3Prob VFC_TS03_AddTS3Quality VFC_TS03_AddTS3VMS VFC_TS03_AddTS4Class VFC_TS03_AddTS4Prob VFC_TS03_AddTS4Quality VFC_TS03_AddTS4VMS VFC_TS03_AddTS5Class VFC_TS03_AddTS5Prob VFC_TS03_AddTS5Quality VFC_TS03_AddTS5VMS VFC_TS03_AddTS6Class VFC_TS03_AddTS6Prob VFC_TS03_AddTS6Quality VFC_TS03_AddTS6VMS;
SIG_GROUP_ 242 SG_VFC_TrafficSign04 1 : VFC_TS04_CRC VFC_TS04_AliveCtr VFC_TS04_ProtBlockCtr VFC_TS04_ProtOrderIndex VFC_TS04_ID VFC_TS04_Class VFC_TS04_TSProb VFC_TS04_Dx VFC_TS04_Dy VFC_TS04_Dz VFC_TS04_DxStdDev VFC_TS04_DyStdDev VFC_TS04_DzStdDev VFC_TS04_Width VFC_TS04_Height VFC_TS04_EmbedFlag VFC_TS04_Quality VFC_TS04_VMS VFC_TS04_Stable VFC_TS04_VehicleSticker VFC_TS04_InternalTrack VFC_TS04_ValidLanes VFC_TS04_ValidDay VFC_TS04_ValidTimeRange1Start VFC_TS04_ValidTimeRange1End VFC_TS04_ValidTimeRange2Start VFC_TS04_ValidTimeRange2End VFC_TS04_ValidInDist VFC_TS04_ValidDist VFC_TS04_AddTSCount VFC_TS04_AddTS1Class VFC_TS04_AddTS1Prob VFC_TS04_AddTS1Quality VFC_TS04_AddTS1VMS VFC_TS04_AddTS2Class VFC_TS04_AddTS2Prob VFC_TS04_AddTS2Quality VFC_TS04_AddTS2VMS VFC_TS04_AddTS3Class VFC_TS04_AddTS3Prob VFC_TS04_AddTS3Quality VFC_TS04_AddTS3VMS VFC_TS04_AddTS4Class VFC_TS04_AddTS4Prob VFC_TS04_AddTS4Quality VFC_TS04_AddTS4VMS VFC_TS04_AddTS5Class VFC_TS04_AddTS5Prob VFC_TS04_AddTS5Quality VFC_TS04_AddTS5VMS VFC_TS04_AddTS6Class VFC_TS04_AddTS6Prob VFC_TS04_AddTS6Quality VFC_TS04_AddTS6VMS;
SIG_GROUP_ 243 SG_VFC_TrafficSign05 1 : VFC_TS05_CRC VFC_TS05_AliveCtr VFC_TS05_ProtBlockCtr VFC_TS05_ProtOrderIndex VFC_TS05_ID VFC_TS05_Class VFC_TS05_TSProb VFC_TS05_Dx VFC_TS05_Dy VFC_TS05_Dz VFC_TS05_DxStdDev VFC_TS05_DyStdDev VFC_TS05_DzStdDev VFC_TS05_Width VFC_TS05_Height VFC_TS05_EmbedFlag VFC_TS05_Quality VFC_TS05_VMS VFC_TS05_Stable VFC_TS05_VehicleSticker VFC_TS05_InternalTrack VFC_TS05_ValidLanes VFC_TS05_ValidDay VFC_TS05_ValidTimeRange1Start VFC_TS05_ValidTimeRange1End VFC_TS05_ValidTimeRange2Start VFC_TS05_ValidTimeRange2End VFC_TS05_ValidInDist VFC_TS05_ValidDist VFC_TS05_AddTSCount VFC_TS05_AddTS1Class VFC_TS05_AddTS1Prob VFC_TS05_AddTS1Quality VFC_TS05_AddTS1VMS VFC_TS05_AddTS2Class VFC_TS05_AddTS2Prob VFC_TS05_AddTS2Quality VFC_TS05_AddTS2VMS VFC_TS05_AddTS3Class VFC_TS05_AddTS3Prob VFC_TS05_AddTS3Quality VFC_TS05_AddTS3VMS VFC_TS05_AddTS4Class VFC_TS05_AddTS4Prob VFC_TS05_AddTS4Quality VFC_TS05_AddTS4VMS VFC_TS05_AddTS5Class VFC_TS05_AddTS5Prob VFC_TS05_AddTS5Quality VFC_TS05_AddTS5VMS VFC_TS05_AddTS6Class VFC_TS05_AddTS6Prob VFC_TS05_AddTS6Quality VFC_TS05_AddTS6VMS;
SIG_GROUP_ 244 SG_VFC_TrafficSign06 1 : VFC_TS06_CRC VFC_TS06_AliveCtr VFC_TS06_ProtBlockCtr VFC_TS06_ProtOrderIndex VFC_TS06_ID VFC_TS06_Class VFC_TS06_TSProb VFC_TS06_Dx VFC_TS06_Dy VFC_TS06_Dz VFC_TS06_DxStdDev VFC_TS06_DyStdDev VFC_TS06_DzStdDev VFC_TS06_Width VFC_TS06_Height VFC_TS06_EmbedFlag VFC_TS06_Quality VFC_TS06_VMS VFC_TS06_Stable VFC_TS06_VehicleSticker VFC_TS06_InternalTrack VFC_TS06_ValidLanes VFC_TS06_ValidDay VFC_TS06_ValidTimeRange1Start VFC_TS06_ValidTimeRange1End VFC_TS06_ValidTimeRange2Start VFC_TS06_ValidTimeRange2End VFC_TS06_ValidInDist VFC_TS06_ValidDist VFC_TS06_AddTSCount VFC_TS06_AddTS1Class VFC_TS06_AddTS1Prob VFC_TS06_AddTS1Quality VFC_TS06_AddTS1VMS VFC_TS06_AddTS2Class VFC_TS06_AddTS2Prob VFC_TS06_AddTS2Quality VFC_TS06_AddTS2VMS VFC_TS06_AddTS3Class VFC_TS06_AddTS3Prob VFC_TS06_AddTS3Quality VFC_TS06_AddTS3VMS VFC_TS06_AddTS4Class VFC_TS06_AddTS4Prob VFC_TS06_AddTS4Quality VFC_TS06_AddTS4VMS VFC_TS06_AddTS5Class VFC_TS06_AddTS5Prob VFC_TS06_AddTS5Quality VFC_TS06_AddTS5VMS VFC_TS06_AddTS6Class VFC_TS06_AddTS6Prob VFC_TS06_AddTS6Quality VFC_TS06_AddTS6VMS;
SIG_GROUP_ 245 SG_VFC_TrafficSign07 1 : VFC_TS07_CRC VFC_TS07_AliveCtr VFC_TS07_ProtBlockCtr VFC_TS07_ProtOrderIndex VFC_TS07_ID VFC_TS07_Class VFC_TS07_TSProb VFC_TS07_Dx VFC_TS07_Dy VFC_TS07_Dz VFC_TS07_DxStdDev VFC_TS07_DyStdDev VFC_TS07_DzStdDev VFC_TS07_Width VFC_TS07_Height VFC_TS07_EmbedFlag VFC_TS07_Quality VFC_TS07_VMS VFC_TS07_Stable VFC_TS07_VehicleSticker VFC_TS07_InternalTrack VFC_TS07_ValidLanes VFC_TS07_ValidDay VFC_TS07_ValidTimeRange1Start VFC_TS07_ValidTimeRange1End VFC_TS07_ValidTimeRange2Start VFC_TS07_ValidTimeRange2End VFC_TS07_ValidInDist VFC_TS07_ValidDist VFC_TS07_AddTSCount VFC_TS07_AddTS1Class VFC_TS07_AddTS1Prob VFC_TS07_AddTS1Quality VFC_TS07_AddTS1VMS VFC_TS07_AddTS2Class VFC_TS07_AddTS2Prob VFC_TS07_AddTS2Quality VFC_TS07_AddTS2VMS VFC_TS07_AddTS3Class VFC_TS07_AddTS3Prob VFC_TS07_AddTS3Quality VFC_TS07_AddTS3VMS VFC_TS07_AddTS4Class VFC_TS07_AddTS4Prob VFC_TS07_AddTS4Quality VFC_TS07_AddTS4VMS VFC_TS07_AddTS5Class VFC_TS07_AddTS5Prob VFC_TS07_AddTS5Quality VFC_TS07_AddTS5VMS VFC_TS07_AddTS6Class VFC_TS07_AddTS6Prob VFC_TS07_AddTS6Quality VFC_TS07_AddTS6VMS;
SIG_GROUP_ 246 SG_VFC_TrafficSign08 1 : VFC_TS08_CRC VFC_TS08_AliveCtr VFC_TS08_ProtBlockCtr VFC_TS08_ProtOrderIndex VFC_TS08_ID VFC_TS08_Class VFC_TS08_TSProb VFC_TS08_Dx VFC_TS08_Dy VFC_TS08_Dz VFC_TS08_DxStdDev VFC_TS08_DyStdDev VFC_TS08_DzStdDev VFC_TS08_Width VFC_TS08_Height VFC_TS08_EmbedFlag VFC_TS08_Quality VFC_TS08_VMS VFC_TS08_Stable VFC_TS08_VehicleSticker VFC_TS08_InternalTrack VFC_TS08_ValidLanes VFC_TS08_ValidDay VFC_TS08_ValidTimeRange1Start VFC_TS08_ValidTimeRange1End VFC_TS08_ValidTimeRange2Start VFC_TS08_ValidTimeRange2End VFC_TS08_ValidInDist VFC_TS08_ValidDist VFC_TS08_AddTSCount VFC_TS08_AddTS1Class VFC_TS08_AddTS1Prob VFC_TS08_AddTS1Quality VFC_TS08_AddTS1VMS VFC_TS08_AddTS2Class VFC_TS08_AddTS2Prob VFC_TS08_AddTS2Quality VFC_TS08_AddTS2VMS VFC_TS08_AddTS3Class VFC_TS08_AddTS3Prob VFC_TS08_AddTS3Quality VFC_TS08_AddTS3VMS VFC_TS08_AddTS4Class VFC_TS08_AddTS4Prob VFC_TS08_AddTS4Quality VFC_TS08_AddTS4VMS VFC_TS08_AddTS5Class VFC_TS08_AddTS5Prob VFC_TS08_AddTS5Quality VFC_TS08_AddTS5VMS VFC_TS08_AddTS6Class VFC_TS08_AddTS6Prob VFC_TS08_AddTS6Quality VFC_TS08_AddTS6VMS;
