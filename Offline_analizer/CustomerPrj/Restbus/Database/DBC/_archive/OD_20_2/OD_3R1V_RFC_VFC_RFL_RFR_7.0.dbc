VERSION "created by canmatrix"

NS_ :

BS_:

BU_: RadarFrontCenter VideoFrontCenter RadarFrontLeft RadarFrontRight ReceiveECU

BO_ 128 VFC_RoadHdr: 24 VideoFrontCenter
 SG_ VFC_RoadHdr_CRC : 0|16@1+ (1,0) [0|65535] ""  RadarFrontCenter
 SG_ VFC_RoadHdr_AliveCtr : 16|8@1+ (1,0) [0|255] ""  RadarFrontCenter
 SG_ VFC_RoadHdr_ProtBlockCtr : 24|4@1+ (1,0) [0|15] ""  RadarFrontCenter
 SG_ VFC_RoadHdr_IfVersionIdMajor : 32|8@1+ (1,0) [0|255] ""  RadarFrontCenter
 SG_ VFC_RoadHdr_IfVersionIdMinor : 40|8@1+ (1,0) [0|255] ""  RadarFrontCenter
 SG_ VFC_RoadHdr_NumValidPolynomials : 48|5@1+ (1,0) [0|31] ""  RadarFrontCenter
 SG_ VFC_RoadHdr_RoadType : 54|2@1+ (1,0) [0|3] ""  RadarFrontCenter
 SG_ VFC_RoadHdr_TimeStampStatus : 56|8@1+ (1,0) [0|255] ""  RadarFrontCenter
 SG_ VFC_RoadHdr_TimeStamp : 64|26@1+ (1,0) [0|67108863] "ms"  RadarFrontCenter
 SG_ VFC_RoadHdr_SensorStatus : 96|3@1+ (1,0) [0|7] ""  RadarFrontCenter
 SG_ VFC_RoadHdr_NumValid2DPolynomial : 112|5@1+ (1,0) [0|31] ""  RadarFrontCenter
 SG_ VFC_RoadHdr_RoadSurfCondType : 118|2@1+ (1,0) [0|3] ""  RadarFrontCenter
 SG_ VFC_RoadHdr_NumValidRoadMarkings : 120|5@1+ (1,0) [0|31] ""  RadarFrontCenter
 SG_ VFC_RoadHdr_RoadTypeConf : 126|1@1+ (100,0) [0|100] "%"  RadarFrontCenter
 SG_ VFC_RoadHdr_RoadSurCondTypeConf : 127|1@1+ (100,0) [0|100] "%"  RadarFrontCenter
 SG_ VFC_RoadHdr_2DNormVMean : 128|12@1+ (1,0) [0|4095] "pixel"  RadarFrontCenter
 SG_ VFC_RoadHdr_2DNormVMeanStdDev : 140|11@1+ (1,0) [0|2047] "pixel"  RadarFrontCenter
 SG_ VFC_RoadHdr_NumValidClothoids : 151|5@1+ (1,0) [0|31] ""  RadarFrontCenter

BO_ 130 VFC_RoadClothoid_00_02: 64 VideoFrontCenter
 SG_ VFC_Cloth_00_02_CRC : 0|16@1+ (1,0) [0|65535] ""  RadarFrontCenter
 SG_ VFC_Cloth_00_02_AliveCtr : 16|8@1+ (1,0) [0|255] ""  RadarFrontCenter
 SG_ VFC_Cloth_00_02_ProtBlockCtr : 24|4@1+ (1,0) [0|15] ""  RadarFrontCenter
 SG_ VFC_Cloth00_LaneAssociation : 32|4@1+ (1,0) [0|15] ""  RadarFrontCenter
 SG_ VFC_Cloth00_Colour : 37|3@1+ (1,0) [0|7] ""  RadarFrontCenter
 SG_ VFC_Cloth00_RangeXBegin : 40|9@1+ (0.25,0) [0|127.75] "m"  RadarFrontCenter
 SG_ VFC_Cloth00_RangeXEnd : 49|9@1+ (0.5,0) [0|255.5] "m"  RadarFrontCenter
 SG_ VFC_Cloth00_ExistProb : 58|6@1+ (2,0) [0|100] "%"  RadarFrontCenter
 SG_ VFC_Cloth00_CurvChange : 64|24@1+ (1.86264514923096E-009,-0.015625) [-0.015625|0.0156249981373549] "1/m^2"  RadarFrontCenter
 SG_ VFC_Cloth00_Curv : 88|15@1+ (3.814697265625E-006,-0.0625) [-0.0625|0.0624961853027344] "1/m"  RadarFrontCenter
 SG_ VFC_Cloth00_PyStdDev : 103|9@1+ (0.0078125,0) [0|3.9921875] "m"  RadarFrontCenter
 SG_ VFC_Cloth00_Py : 112|12@1+ (0.0078125,-16) [-16|15.9921875] "m"  RadarFrontCenter
 SG_ VFC_Cloth00_OrientationYaw : 124|12@1+ (0.00048828125,-1) [-1|0.99951171875] "rad"  RadarFrontCenter
 SG_ VFC_Cloth00_Width : 136|8@1+ (0.01,0) [0|2.55] "m"  RadarFrontCenter
 SG_ VFC_Cloth00_Type : 144|4@1+ (1,0) [0|15] ""  RadarFrontCenter
 SG_ VFC_Cloth01_LaneAssociation : 192|4@1+ (1,0) [0|15] ""  RadarFrontCenter
 SG_ VFC_Cloth01_Colour : 197|3@1+ (1,0) [0|7] ""  RadarFrontCenter
 SG_ VFC_Cloth01_RangeXBegin : 200|9@1+ (0.25,0) [0|127.75] "m"  RadarFrontCenter
 SG_ VFC_Cloth01_RangeXEnd : 209|9@1+ (0.5,0) [0|255.5] "m"  RadarFrontCenter
 SG_ VFC_Cloth01_ExistProb : 218|6@1+ (2,0) [0|100] "%"  RadarFrontCenter
 SG_ VFC_Cloth01_CurvChange : 224|24@1+ (1.86264514923096E-009,-0.015625) [-0.015625|0.0156249981373549] "1/m^2"  RadarFrontCenter
 SG_ VFC_Cloth01_Curv : 248|15@1+ (3.814697265625E-006,-0.0625) [-0.0625|0.0624961853027344] "1/m"  RadarFrontCenter
 SG_ VFC_Cloth01_PyStdDev : 263|9@1+ (0.0078125,0) [0|3.9921875] "m"  RadarFrontCenter
 SG_ VFC_Cloth01_Py : 272|12@1+ (0.0078125,-16) [-16|15.9921875] "m"  RadarFrontCenter
 SG_ VFC_Cloth01_OrientationYaw : 284|12@1+ (0.00048828125,-1) [-1|0.99951171875] "rad"  RadarFrontCenter
 SG_ VFC_Cloth01_Width : 296|8@1+ (0.01,0) [0|2.55] "m"  RadarFrontCenter
 SG_ VFC_Cloth01_Type : 304|4@1+ (1,0) [0|15] ""  RadarFrontCenter
 SG_ VFC_Cloth02_LaneAssociation : 352|4@1+ (1,0) [0|15] ""  RadarFrontCenter
 SG_ VFC_Cloth02_Colour : 357|3@1+ (1,0) [0|7] ""  RadarFrontCenter
 SG_ VFC_Cloth02_RangeXBegin : 360|9@1+ (0.25,0) [0|127.75] "m"  RadarFrontCenter
 SG_ VFC_Cloth02_RangeXEnd : 369|9@1+ (0.5,0) [0|255.5] "m"  RadarFrontCenter
 SG_ VFC_Cloth02_ExistProb : 378|6@1+ (2,0) [0|100] "%"  RadarFrontCenter
 SG_ VFC_Cloth02_CurvChange : 384|24@1+ (1.86264514923096E-009,-0.015625) [-0.015625|0.0156249981373549] "1/m^2"  RadarFrontCenter
 SG_ VFC_Cloth02_Curv : 408|15@1+ (3.814697265625E-006,-0.0625) [-0.0625|0.0624961853027344] "1/m"  RadarFrontCenter
 SG_ VFC_Cloth02_PyStdDev : 423|9@1+ (0.0078125,0) [0|3.9921875] "m"  RadarFrontCenter
 SG_ VFC_Cloth02_Py : 432|12@1+ (0.0078125,-16) [-16|15.9921875] "m"  RadarFrontCenter
 SG_ VFC_Cloth02_OrientationYaw : 444|12@1+ (0.00048828125,-1) [-1|0.99951171875] "rad"  RadarFrontCenter
 SG_ VFC_Cloth02_Width : 456|8@1+ (0.01,0) [0|2.55] "m"  RadarFrontCenter
 SG_ VFC_Cloth02_Type : 464|4@1+ (1,0) [0|15] ""  RadarFrontCenter

BO_ 131 VFC_RoadClothoid_03_05: 64 VideoFrontCenter
 SG_ VFC_Cloth_03_05_CRC : 0|16@1+ (1,0) [0|65535] ""  RadarFrontCenter
 SG_ VFC_Cloth_03_05_AliveCtr : 16|8@1+ (1,0) [0|255] ""  RadarFrontCenter
 SG_ VFC_Cloth_03_05_ProtBlockCtr : 24|4@1+ (1,0) [0|15] ""  RadarFrontCenter
 SG_ VFC_Cloth03_LaneAssociation : 32|4@1+ (1,0) [0|15] ""  RadarFrontCenter
 SG_ VFC_Cloth03_Colour : 37|3@1+ (1,0) [0|7] ""  RadarFrontCenter
 SG_ VFC_Cloth03_RangeXBegin : 40|9@1+ (0.25,0) [0|127.75] "m"  RadarFrontCenter
 SG_ VFC_Cloth03_RangeXEnd : 49|9@1+ (0.5,0) [0|255.5] "m"  RadarFrontCenter
 SG_ VFC_Cloth03_ExistProb : 58|6@1+ (2,0) [0|100] "%"  RadarFrontCenter
 SG_ VFC_Cloth03_CurvChange : 64|24@1+ (1.86264514923096E-009,-0.015625) [-0.015625|0.0156249981373549] "1/m^2"  RadarFrontCenter
 SG_ VFC_Cloth03_Curv : 88|15@1+ (3.814697265625E-006,-0.0625) [-0.0625|0.0624961853027344] "1/m"  RadarFrontCenter
 SG_ VFC_Cloth03_PyStdDev : 103|9@1+ (0.0078125,0) [0|3.9921875] "m"  RadarFrontCenter
 SG_ VFC_Cloth03_Py : 112|12@1+ (0.0078125,-16) [-16|15.9921875] "m"  RadarFrontCenter
 SG_ VFC_Cloth03_OrientationYaw : 124|12@1+ (0.00048828125,-1) [-1|0.99951171875] "rad"  RadarFrontCenter
 SG_ VFC_Cloth03_Width : 136|8@1+ (0.01,0) [0|2.55] "m"  RadarFrontCenter
 SG_ VFC_Cloth03_Type : 144|4@1+ (1,0) [0|15] ""  RadarFrontCenter
 SG_ VFC_Cloth04_LaneAssociation : 192|4@1+ (1,0) [0|15] ""  RadarFrontCenter
 SG_ VFC_Cloth04_Colour : 197|3@1+ (1,0) [0|7] ""  RadarFrontCenter
 SG_ VFC_Cloth04_RangeXBegin : 200|9@1+ (0.25,0) [0|127.75] "m"  RadarFrontCenter
 SG_ VFC_Cloth04_RangeXEnd : 209|9@1+ (0.5,0) [0|255.5] "m"  RadarFrontCenter
 SG_ VFC_Cloth04_ExistProb : 218|6@1+ (2,0) [0|100] "%"  RadarFrontCenter
 SG_ VFC_Cloth04_CurvChange : 224|24@1+ (1.86264514923096E-009,-0.015625) [-0.015625|0.0156249981373549] "1/m^2"  RadarFrontCenter
 SG_ VFC_Cloth04_Curv : 248|15@1+ (3.814697265625E-006,-0.0625) [-0.0625|0.0624961853027344] "1/m"  RadarFrontCenter
 SG_ VFC_Cloth04_PyStdDev : 263|9@1+ (0.0078125,0) [0|3.9921875] "m"  RadarFrontCenter
 SG_ VFC_Cloth04_Py : 272|12@1+ (0.0078125,-16) [-16|15.9921875] "m"  RadarFrontCenter
 SG_ VFC_Cloth04_OrientationYaw : 284|12@1+ (0.00048828125,-1) [-1|0.99951171875] "rad"  RadarFrontCenter
 SG_ VFC_Cloth04_Width : 296|8@1+ (0.01,0) [0|2.55] "m"  RadarFrontCenter
 SG_ VFC_Cloth04_Type : 304|4@1+ (1,0) [0|15] ""  RadarFrontCenter
 SG_ VFC_Cloth05_LaneAssociation : 352|4@1+ (1,0) [0|15] ""  RadarFrontCenter
 SG_ VFC_Cloth05_Colour : 357|3@1+ (1,0) [0|7] ""  RadarFrontCenter
 SG_ VFC_Cloth05_RangeXBegin : 360|9@1+ (0.25,0) [0|127.75] "m"  RadarFrontCenter
 SG_ VFC_Cloth05_RangeXEnd : 369|9@1+ (0.5,0) [0|255.5] "m"  RadarFrontCenter
 SG_ VFC_Cloth05_ExistProb : 378|6@1+ (2,0) [0|100] "%"  RadarFrontCenter
 SG_ VFC_Cloth05_CurvChange : 384|24@1+ (1.86264514923096E-009,-0.015625) [-0.015625|0.0156249981373549] "1/m^2"  RadarFrontCenter
 SG_ VFC_Cloth05_Curv : 408|15@1+ (3.814697265625E-006,-0.0625) [-0.0625|0.0624961853027344] "1/m"  RadarFrontCenter
 SG_ VFC_Cloth05_PyStdDev : 423|9@1+ (0.0078125,0) [0|3.9921875] "m"  RadarFrontCenter
 SG_ VFC_Cloth05_Py : 432|12@1+ (0.0078125,-16) [-16|15.9921875] "m"  RadarFrontCenter
 SG_ VFC_Cloth05_OrientationYaw : 444|12@1+ (0.00048828125,-1) [-1|0.99951171875] "rad"  RadarFrontCenter
 SG_ VFC_Cloth05_Width : 456|8@1+ (0.01,0) [0|2.55] "m"  RadarFrontCenter
 SG_ VFC_Cloth05_Type : 464|4@1+ (1,0) [0|15] ""  RadarFrontCenter

BO_ 132 VFC_RoadClothoid_06_08: 64 VideoFrontCenter
 SG_ VFC_Cloth_06_08_CRC : 0|16@1+ (1,0) [0|65535] ""  RadarFrontCenter
 SG_ VFC_Cloth_06_08_AliveCtr : 16|8@1+ (1,0) [0|255] ""  RadarFrontCenter
 SG_ VFC_Cloth_06_08_ProtBlockCtr : 24|4@1+ (1,0) [0|15] ""  RadarFrontCenter
 SG_ VFC_Cloth06_LaneAssociation : 32|4@1+ (1,0) [0|15] ""  RadarFrontCenter
 SG_ VFC_Cloth06_Colour : 37|3@1+ (1,0) [0|7] ""  RadarFrontCenter
 SG_ VFC_Cloth06_RangeXBegin : 40|9@1+ (0.25,0) [0|127.75] "m"  RadarFrontCenter
 SG_ VFC_Cloth06_RangeXEnd : 49|9@1+ (0.5,0) [0|255.5] "m"  RadarFrontCenter
 SG_ VFC_Cloth06_ExistProb : 58|6@1+ (2,0) [0|100] "%"  RadarFrontCenter
 SG_ VFC_Cloth06_CurvChange : 64|24@1+ (1.86264514923096E-009,-0.015625) [-0.015625|0.0156249981373549] "1/m^2"  RadarFrontCenter
 SG_ VFC_Cloth06_Curv : 88|15@1+ (3.814697265625E-006,-0.0625) [-0.0625|0.0624961853027344] "1/m"  RadarFrontCenter
 SG_ VFC_Cloth06_PyStdDev : 103|9@1+ (0.0078125,0) [0|3.9921875] "m"  RadarFrontCenter
 SG_ VFC_Cloth06_Py : 112|12@1+ (0.0078125,-16) [-16|15.9921875] "m"  RadarFrontCenter
 SG_ VFC_Cloth06_OrientationYaw : 124|12@1+ (0.00048828125,-1) [-1|0.99951171875] "rad"  RadarFrontCenter
 SG_ VFC_Cloth06_Width : 136|8@1+ (0.01,0) [0|2.55] "m"  RadarFrontCenter
 SG_ VFC_Cloth06_Type : 144|4@1+ (1,0) [0|15] ""  RadarFrontCenter
 SG_ VFC_Cloth07_LaneAssociation : 192|4@1+ (1,0) [0|15] ""  RadarFrontCenter
 SG_ VFC_Cloth07_Colour : 197|3@1+ (1,0) [0|7] ""  RadarFrontCenter
 SG_ VFC_Cloth07_RangeXBegin : 200|9@1+ (0.25,0) [0|127.75] "m"  RadarFrontCenter
 SG_ VFC_Cloth07_RangeXEnd : 209|9@1+ (0.5,0) [0|255.5] "m"  RadarFrontCenter
 SG_ VFC_Cloth07_ExistProb : 218|6@1+ (2,0) [0|100] "%"  RadarFrontCenter
 SG_ VFC_Cloth07_CurvChange : 224|24@1+ (1.86264514923096E-009,-0.015625) [-0.015625|0.0156249981373549] "1/m^2"  RadarFrontCenter
 SG_ VFC_Cloth07_Curv : 248|15@1+ (3.814697265625E-006,-0.0625) [-0.0625|0.0624961853027344] "1/m"  RadarFrontCenter
 SG_ VFC_Cloth07_PyStdDev : 263|9@1+ (0.0078125,0) [0|3.9921875] "m"  RadarFrontCenter
 SG_ VFC_Cloth07_Py : 272|12@1+ (0.0078125,-16) [-16|15.9921875] "m"  RadarFrontCenter
 SG_ VFC_Cloth07_OrientationYaw : 284|12@1+ (0.00048828125,-1) [-1|0.99951171875] "rad"  RadarFrontCenter
 SG_ VFC_Cloth07_Width : 296|8@1+ (0.01,0) [0|2.55] "m"  RadarFrontCenter
 SG_ VFC_Cloth07_Type : 304|4@1+ (1,0) [0|15] ""  RadarFrontCenter
 SG_ VFC_Cloth08_LaneAssociation : 352|4@1+ (1,0) [0|15] ""  RadarFrontCenter
 SG_ VFC_Cloth08_Colour : 357|3@1+ (1,0) [0|7] ""  RadarFrontCenter
 SG_ VFC_Cloth08_RangeXBegin : 360|9@1+ (0.25,0) [0|127.75] "m"  RadarFrontCenter
 SG_ VFC_Cloth08_RangeXEnd : 369|9@1+ (0.5,0) [0|255.5] "m"  RadarFrontCenter
 SG_ VFC_Cloth08_ExistProb : 378|6@1+ (2,0) [0|100] "%"  RadarFrontCenter
 SG_ VFC_Cloth08_CurvChange : 384|24@1+ (1.86264514923096E-009,-0.015625) [-0.015625|0.0156249981373549] "1/m^2"  RadarFrontCenter
 SG_ VFC_Cloth08_Curv : 408|15@1+ (3.814697265625E-006,-0.0625) [-0.0625|0.0624961853027344] "1/m"  RadarFrontCenter
 SG_ VFC_Cloth08_PyStdDev : 423|9@1+ (0.0078125,0) [0|3.9921875] "m"  RadarFrontCenter
 SG_ VFC_Cloth08_Py : 432|12@1+ (0.0078125,-16) [-16|15.9921875] "m"  RadarFrontCenter
 SG_ VFC_Cloth08_OrientationYaw : 444|12@1+ (0.00048828125,-1) [-1|0.99951171875] "rad"  RadarFrontCenter
 SG_ VFC_Cloth08_Width : 456|8@1+ (0.01,0) [0|2.55] "m"  RadarFrontCenter
 SG_ VFC_Cloth08_Type : 464|4@1+ (1,0) [0|15] ""  RadarFrontCenter

BO_ 133 VFC_RoadClothoid_09_11: 64 VideoFrontCenter
 SG_ VFC_Cloth_09_11_CRC : 0|16@1+ (1,0) [0|65535] ""  RadarFrontCenter
 SG_ VFC_Cloth_09_11_AliveCtr : 16|8@1+ (1,0) [0|255] ""  RadarFrontCenter
 SG_ VFC_Cloth_09_11_ProtBlockCtr : 24|4@1+ (1,0) [0|15] ""  RadarFrontCenter
 SG_ VFC_Cloth09_LaneAssociation : 32|4@1+ (1,0) [0|15] ""  RadarFrontCenter
 SG_ VFC_Cloth09_Colour : 37|3@1+ (1,0) [0|7] ""  RadarFrontCenter
 SG_ VFC_Cloth09_RangeXBegin : 40|9@1+ (0.25,0) [0|127.75] "m"  RadarFrontCenter
 SG_ VFC_Cloth09_RangeXEnd : 49|9@1+ (0.5,0) [0|255.5] "m"  RadarFrontCenter
 SG_ VFC_Cloth09_ExistProb : 58|6@1+ (2,0) [0|100] "%"  RadarFrontCenter
 SG_ VFC_Cloth09_CurvChange : 64|24@1+ (1.86264514923096E-009,-0.015625) [-0.015625|0.0156249981373549] "1/m^2"  RadarFrontCenter
 SG_ VFC_Cloth09_Curv : 88|15@1+ (3.814697265625E-006,-0.0625) [-0.0625|0.0624961853027344] "1/m"  RadarFrontCenter
 SG_ VFC_Cloth09_PyStdDev : 103|9@1+ (0.0078125,0) [0|3.9921875] "m"  RadarFrontCenter
 SG_ VFC_Cloth09_Py : 112|12@1+ (0.0078125,-16) [-16|15.9921875] "m"  RadarFrontCenter
 SG_ VFC_Cloth09_OrientationYaw : 124|12@1+ (0.00048828125,-1) [-1|0.99951171875] "rad"  RadarFrontCenter
 SG_ VFC_Cloth09_Width : 136|8@1+ (0.01,0) [0|2.55] "m"  RadarFrontCenter
 SG_ VFC_Cloth09_Type : 144|4@1+ (1,0) [0|15] ""  RadarFrontCenter
 SG_ VFC_Cloth10_LaneAssociation : 192|4@1+ (1,0) [0|15] ""  RadarFrontCenter
 SG_ VFC_Cloth10_Colour : 197|3@1+ (1,0) [0|7] ""  RadarFrontCenter
 SG_ VFC_Cloth10_RangeXBegin : 200|9@1+ (0.25,0) [0|127.75] "m"  RadarFrontCenter
 SG_ VFC_Cloth10_RangeXEnd : 209|9@1+ (0.5,0) [0|255.5] "m"  RadarFrontCenter
 SG_ VFC_Cloth10_ExistProb : 218|6@1+ (2,0) [0|100] "%"  RadarFrontCenter
 SG_ VFC_Cloth10_CurvChange : 224|24@1+ (1.86264514923096E-009,-0.015625) [-0.015625|0.0156249981373549] "1/m^2"  RadarFrontCenter
 SG_ VFC_Cloth10_Curv : 248|15@1+ (3.814697265625E-006,-0.0625) [-0.0625|0.0624961853027344] "1/m"  RadarFrontCenter
 SG_ VFC_Cloth10_PyStdDev : 263|9@1+ (0.0078125,0) [0|3.9921875] "m"  RadarFrontCenter
 SG_ VFC_Cloth10_Py : 272|12@1+ (0.0078125,-16) [-16|15.9921875] "m"  RadarFrontCenter
 SG_ VFC_Cloth10_OrientationYaw : 284|12@1+ (0.00048828125,-1) [-1|0.99951171875] "rad"  RadarFrontCenter
 SG_ VFC_Cloth10_Width : 296|8@1+ (0.01,0) [0|2.55] "m"  RadarFrontCenter
 SG_ VFC_Cloth10_Type : 304|4@1+ (1,0) [0|15] ""  RadarFrontCenter
 SG_ VFC_Cloth11_LaneAssociation : 352|4@1+ (1,0) [0|15] ""  RadarFrontCenter
 SG_ VFC_Cloth11_Colour : 357|3@1+ (1,0) [0|7] ""  RadarFrontCenter
 SG_ VFC_Cloth11_RangeXBegin : 360|9@1+ (0.25,0) [0|127.75] "m"  RadarFrontCenter
 SG_ VFC_Cloth11_RangeXEnd : 369|9@1+ (0.5,0) [0|255.5] "m"  RadarFrontCenter
 SG_ VFC_Cloth11_ExistProb : 378|6@1+ (2,0) [0|100] "%"  RadarFrontCenter
 SG_ VFC_Cloth11_CurvChange : 384|24@1+ (1.86264514923096E-009,-0.015625) [-0.015625|0.0156249981373549] "1/m^2"  RadarFrontCenter
 SG_ VFC_Cloth11_Curv : 408|15@1+ (3.814697265625E-006,-0.0625) [-0.0625|0.0624961853027344] "1/m"  RadarFrontCenter
 SG_ VFC_Cloth11_PyStdDev : 423|9@1+ (0.0078125,0) [0|3.9921875] "m"  RadarFrontCenter
 SG_ VFC_Cloth11_Py : 432|12@1+ (0.0078125,-16) [-16|15.9921875] "m"  RadarFrontCenter
 SG_ VFC_Cloth11_OrientationYaw : 444|12@1+ (0.00048828125,-1) [-1|0.99951171875] "rad"  RadarFrontCenter
 SG_ VFC_Cloth11_Width : 456|8@1+ (0.01,0) [0|2.55] "m"  RadarFrontCenter
 SG_ VFC_Cloth11_Type : 464|4@1+ (1,0) [0|15] ""  RadarFrontCenter

BO_ 146 VFC_RoadPolynomial_00_02: 64 VideoFrontCenter
 SG_ VFC_Poly_00_02_CRC : 0|16@1+ (1,0) [0|65535] ""  RadarFrontCenter
 SG_ VFC_Poly_00_02_AliveCtr : 16|8@1+ (1,0) [0|255] ""  RadarFrontCenter
 SG_ VFC_Poly_00_02_ProtBlockCtr : 24|4@1+ (1,0) [0|15] ""  RadarFrontCenter
 SG_ VFC_Poly00_LaneAssociation : 32|4@1+ (1,0) [0|15] ""  RadarFrontCenter
 SG_ VFC_Poly00_Type : 36|4@1+ (1,0) [0|15] ""  RadarFrontCenter
 SG_ VFC_Poly00_ExistProb : 40|6@1+ (2,0) [0|100] "%"  RadarFrontCenter
 SG_ VFC_Poly00_CoefficientYc3 : 46|18@1+ (1.49011611938476E-008,-0.001953125) [-0.001953125|0.00195311009883879] "1/m^2"  RadarFrontCenter
 SG_ VFC_Poly00_Colour : 64|3@1+ (1,0) [0|7] ""  RadarFrontCenter
 SG_ VFC_Poly00_CoefficientYc2 : 67|17@1+ (9.5367431640625E-007,-0.0625) [-0.0625|0.0624990463256836] "1/m"  RadarFrontCenter
 SG_ VFC_Poly00_CoefficientYc0 : 84|12@1+ (0.0078125,-16) [-16|15.9921875] "m"  RadarFrontCenter
 SG_ VFC_Poly00_CoefficientYc1 : 96|15@1+ (6.103515625E-005,-1) [-1|0.99993896484375] "1"  RadarFrontCenter
 SG_ VFC_Poly00_CoefficientYc2Corr : 111|17@1+ (9.5367431640625E-007,-0.0625) [-0.0625|0.0624990463256836] "1/m"  RadarFrontCenter
 SG_ VFC_Poly00_CoefficientYc3Corr : 128|18@1+ (1.49011611938476E-008,-0.001953125) [-0.001953125|0.00195311009883879] "1/m^2"  RadarFrontCenter
 SG_ VFC_Poly00_Width : 146|6@1+ (0.01,0) [0|0.63] "m"  RadarFrontCenter
 SG_ VFC_Poly00_RangeXCorrectionPoint : 152|8@1+ (1,0) [0|255] "m"  RadarFrontCenter
 SG_ VFC_Poly00_RangeXBegin : 160|9@1+ (0.25,0) [0|127.75] "m"  RadarFrontCenter
 SG_ VFC_Poly00_Reserved0 : 169|7@1+ (1,0) [0|127] "unitless"  RadarFrontCenter
 SG_ VFC_Poly00_RangeXEnd : 176|9@1+ (0.5,0) [0|255.5] "m"  RadarFrontCenter
 SG_ VFC_Poly00_Reserved1 : 185|7@1+ (1,0) [0|127] "unitless"  RadarFrontCenter
 SG_ VFC_Poly01_LaneAssociation : 192|4@1+ (1,0) [0|15] ""  RadarFrontCenter
 SG_ VFC_Poly01_Type : 196|4@1+ (1,0) [0|15] ""  RadarFrontCenter
 SG_ VFC_Poly01_ExistProb : 200|6@1+ (2,0) [0|100] "%"  RadarFrontCenter
 SG_ VFC_Poly01_CoefficientYc3 : 206|18@1+ (1.49011611938476E-008,-0.001953125) [-0.001953125|0.00195311009883879] "1/m^2"  RadarFrontCenter
 SG_ VFC_Poly01_Colour : 224|3@1+ (1,0) [0|7] ""  RadarFrontCenter
 SG_ VFC_Poly01_CoefficientYc2 : 227|17@1+ (9.5367431640625E-007,-0.0625) [-0.0625|0.0624990463256836] "1/m"  RadarFrontCenter
 SG_ VFC_Poly01_CoefficientYc0 : 244|12@1+ (0.0078125,-16) [-16|15.9921875] "m"  RadarFrontCenter
 SG_ VFC_Poly01_CoefficientYc1 : 256|15@1+ (6.103515625E-005,-1) [-1|0.99993896484375] "1"  RadarFrontCenter
 SG_ VFC_Poly01_CoefficientYc2Corr : 271|17@1+ (9.5367431640625E-007,-0.0625) [-0.0625|0.0624990463256836] "1/m"  RadarFrontCenter
 SG_ VFC_Poly01_CoefficientYc3Corr : 288|18@1+ (1.49011611938476E-008,-0.001953125) [-0.001953125|0.00195311009883879] "1/m^2"  RadarFrontCenter
 SG_ VFC_Poly01_Width : 306|6@1+ (0.01,0) [0|0.63] "m"  RadarFrontCenter
 SG_ VFC_Poly01_RangeXCorrectionPoint : 312|8@1+ (1,0) [0|255] "m"  RadarFrontCenter
 SG_ VFC_Poly01_RangeXBegin : 320|9@1+ (0.25,0) [0|127.75] "m"  RadarFrontCenter
 SG_ VFC_Poly01_Reserved0 : 329|7@1+ (1,0) [0|127] "unitless"  RadarFrontCenter
 SG_ VFC_Poly01_RangeXEnd : 336|9@1+ (0.5,0) [0|255.5] "m"  RadarFrontCenter
 SG_ VFC_Poly01_Reserved1 : 345|7@1+ (1,0) [0|127] "unitless"  RadarFrontCenter
 SG_ VFC_Poly02_LaneAssociation : 352|4@1+ (1,0) [0|15] ""  RadarFrontCenter
 SG_ VFC_Poly02_Type : 356|4@1+ (1,0) [0|15] ""  RadarFrontCenter
 SG_ VFC_Poly02_ExistProb : 360|6@1+ (2,0) [0|100] "%"  RadarFrontCenter
 SG_ VFC_Poly02_CoefficientYc3 : 366|18@1+ (1.49011611938476E-008,-0.001953125) [-0.001953125|0.00195311009883879] "1/m^2"  RadarFrontCenter
 SG_ VFC_Poly02_Colour : 384|3@1+ (1,0) [0|7] ""  RadarFrontCenter
 SG_ VFC_Poly02_CoefficientYc2 : 387|17@1+ (9.5367431640625E-007,-0.0625) [-0.0625|0.0624990463256836] "1/m"  RadarFrontCenter
 SG_ VFC_Poly02_CoefficientYc0 : 404|12@1+ (0.0078125,-16) [-16|15.9921875] "m"  RadarFrontCenter
 SG_ VFC_Poly02_CoefficientYc1 : 416|15@1+ (6.103515625E-005,-1) [-1|0.99993896484375] "1"  RadarFrontCenter
 SG_ VFC_Poly02_CoefficientYc2Corr : 431|17@1+ (9.5367431640625E-007,-0.0625) [-0.0625|0.0624990463256836] "1/m"  RadarFrontCenter
 SG_ VFC_Poly02_CoefficientYc3Corr : 448|18@1+ (1.49011611938476E-008,-0.001953125) [-0.001953125|0.00195311009883879] "1/m^2"  RadarFrontCenter
 SG_ VFC_Poly02_Width : 466|6@1+ (0.01,0) [0|0.63] "m"  RadarFrontCenter
 SG_ VFC_Poly02_RangeXCorrectionPoint : 472|8@1+ (1,0) [0|255] "m"  RadarFrontCenter
 SG_ VFC_Poly02_RangeXBegin : 480|9@1+ (0.25,0) [0|127.75] "m"  RadarFrontCenter
 SG_ VFC_Poly02_Reserved0 : 489|7@1+ (1,0) [0|127] "unitless"  RadarFrontCenter
 SG_ VFC_Poly02_RangeXEnd : 496|9@1+ (0.5,0) [0|255.5] "m"  RadarFrontCenter
 SG_ VFC_Poly02_Reserved1 : 505|7@1+ (1,0) [0|127] "unitless"  RadarFrontCenter

BO_ 147 VFC_RoadPolynomial_03_05: 64 VideoFrontCenter
 SG_ VFC_Poly_03_05_CRC : 0|16@1+ (1,0) [0|65535] ""  RadarFrontCenter
 SG_ VFC_Poly_03_05_AliveCtr : 16|8@1+ (1,0) [0|255] ""  RadarFrontCenter
 SG_ VFC_Poly_03_05_ProtBlockCtr : 24|4@1+ (1,0) [0|15] ""  RadarFrontCenter
 SG_ VFC_Poly03_LaneAssociation : 32|4@1+ (1,0) [0|15] ""  RadarFrontCenter
 SG_ VFC_Poly03_Type : 36|4@1+ (1,0) [0|15] ""  RadarFrontCenter
 SG_ VFC_Poly03_ExistProb : 40|6@1+ (2,0) [0|100] "%"  RadarFrontCenter
 SG_ VFC_Poly03_CoefficientYc3 : 46|18@1+ (1.49011611938476E-008,-0.001953125) [-0.001953125|0.00195311009883879] "1/m^2"  RadarFrontCenter
 SG_ VFC_Poly03_Colour : 64|3@1+ (1,0) [0|7] ""  RadarFrontCenter
 SG_ VFC_Poly03_CoefficientYc2 : 67|17@1+ (9.5367431640625E-007,-0.0625) [-0.0625|0.0624990463256836] "1/m"  RadarFrontCenter
 SG_ VFC_Poly03_CoefficientYc0 : 84|12@1+ (0.0078125,-16) [-16|15.9921875] "m"  RadarFrontCenter
 SG_ VFC_Poly03_CoefficientYc1 : 96|15@1+ (6.103515625E-005,-1) [-1|0.99993896484375] "1"  RadarFrontCenter
 SG_ VFC_Poly03_CoefficientYc2Corr : 111|17@1+ (9.5367431640625E-007,-0.0625) [-0.0625|0.0624990463256836] "1/m"  RadarFrontCenter
 SG_ VFC_Poly03_CoefficientYc3Corr : 128|18@1+ (1.49011611938476E-008,-0.001953125) [-0.001953125|0.00195311009883879] "1/m^2"  RadarFrontCenter
 SG_ VFC_Poly03_Width : 146|6@1+ (0.01,0) [0|0.63] "m"  RadarFrontCenter
 SG_ VFC_Poly03_RangeXCorrectionPoint : 152|8@1+ (1,0) [0|255] "m"  RadarFrontCenter
 SG_ VFC_Poly03_RangeXBegin : 160|9@1+ (0.25,0) [0|127.75] "m"  RadarFrontCenter
 SG_ VFC_Poly03_Reserved0 : 169|7@1+ (1,0) [0|127] "unitless"  RadarFrontCenter
 SG_ VFC_Poly03_RangeXEnd : 176|9@1+ (0.5,0) [0|255.5] "m"  RadarFrontCenter
 SG_ VFC_Poly03_Reserved1 : 185|7@1+ (1,0) [0|127] "unitless"  RadarFrontCenter
 SG_ VFC_Poly04_LaneAssociation : 192|4@1+ (1,0) [0|15] ""  RadarFrontCenter
 SG_ VFC_Poly04_Type : 196|4@1+ (1,0) [0|15] ""  RadarFrontCenter
 SG_ VFC_Poly04_ExistProb : 200|6@1+ (2,0) [0|100] "%"  RadarFrontCenter
 SG_ VFC_Poly04_CoefficientYc3 : 206|18@1+ (1.49011611938476E-008,-0.001953125) [-0.001953125|0.00195311009883879] "1/m^2"  RadarFrontCenter
 SG_ VFC_Poly04_Colour : 224|3@1+ (1,0) [0|7] ""  RadarFrontCenter
 SG_ VFC_Poly04_CoefficientYc2 : 227|17@1+ (9.5367431640625E-007,-0.0625) [-0.0625|0.0624990463256836] "1/m"  RadarFrontCenter
 SG_ VFC_Poly04_CoefficientYc0 : 244|12@1+ (0.0078125,-16) [-16|15.9921875] "m"  RadarFrontCenter
 SG_ VFC_Poly04_CoefficientYc1 : 256|15@1+ (6.103515625E-005,-1) [-1|0.99993896484375] "1"  RadarFrontCenter
 SG_ VFC_Poly04_CoefficientYc2Corr : 271|17@1+ (9.5367431640625E-007,-0.0625) [-0.0625|0.0624990463256836] "1/m"  RadarFrontCenter
 SG_ VFC_Poly04_CoefficientYc3Corr : 288|18@1+ (1.49011611938476E-008,-0.001953125) [-0.001953125|0.00195311009883879] "1/m^2"  RadarFrontCenter
 SG_ VFC_Poly04_Width : 306|6@1+ (0.01,0) [0|0.63] "m"  RadarFrontCenter
 SG_ VFC_Poly04_RangeXCorrectionPoint : 312|8@1+ (1,0) [0|255] "m"  RadarFrontCenter
 SG_ VFC_Poly04_RangeXBegin : 320|9@1+ (0.25,0) [0|127.75] "m"  RadarFrontCenter
 SG_ VFC_Poly04_Reserved0 : 329|7@1+ (1,0) [0|127] "unitless"  RadarFrontCenter
 SG_ VFC_Poly04_RangeXEnd : 336|9@1+ (0.5,0) [0|255.5] "m"  RadarFrontCenter
 SG_ VFC_Poly04_Reserved1 : 345|7@1+ (1,0) [0|127] "unitless"  RadarFrontCenter
 SG_ VFC_Poly05_LaneAssociation : 352|4@1+ (1,0) [0|15] ""  RadarFrontCenter
 SG_ VFC_Poly05_Type : 356|4@1+ (1,0) [0|15] ""  RadarFrontCenter
 SG_ VFC_Poly05_ExistProb : 360|6@1+ (2,0) [0|100] "%"  RadarFrontCenter
 SG_ VFC_Poly05_CoefficientYc3 : 366|18@1+ (1.49011611938476E-008,-0.001953125) [-0.001953125|0.00195311009883879] "1/m^2"  RadarFrontCenter
 SG_ VFC_Poly05_Colour : 384|3@1+ (1,0) [0|7] ""  RadarFrontCenter
 SG_ VFC_Poly05_CoefficientYc2 : 387|17@1+ (9.5367431640625E-007,-0.0625) [-0.0625|0.0624990463256836] "1/m"  RadarFrontCenter
 SG_ VFC_Poly05_CoefficientYc0 : 404|12@1+ (0.0078125,-16) [-16|15.9921875] "m"  RadarFrontCenter
 SG_ VFC_Poly05_CoefficientYc1 : 416|15@1+ (6.103515625E-005,-1) [-1|0.99993896484375] "1"  RadarFrontCenter
 SG_ VFC_Poly05_CoefficientYc2Corr : 431|17@1+ (9.5367431640625E-007,-0.0625) [-0.0625|0.0624990463256836] "1/m"  RadarFrontCenter
 SG_ VFC_Poly05_CoefficientYc3Corr : 448|18@1+ (1.49011611938476E-008,-0.001953125) [-0.001953125|0.00195311009883879] "1/m^2"  RadarFrontCenter
 SG_ VFC_Poly05_Width : 466|6@1+ (0.01,0) [0|0.63] "m"  RadarFrontCenter
 SG_ VFC_Poly05_RangeXCorrectionPoint : 472|8@1+ (1,0) [0|255] "m"  RadarFrontCenter
 SG_ VFC_Poly05_RangeXBegin : 480|9@1+ (0.25,0) [0|127.75] "m"  RadarFrontCenter
 SG_ VFC_Poly05_Reserved0 : 489|7@1+ (1,0) [0|127] "unitless"  RadarFrontCenter
 SG_ VFC_Poly05_RangeXEnd : 496|9@1+ (0.5,0) [0|255.5] "m"  RadarFrontCenter
 SG_ VFC_Poly05_Reserved1 : 505|7@1+ (1,0) [0|127] "unitless"  RadarFrontCenter

BO_ 148 VFC_RoadPolynomial_06_08: 64 VideoFrontCenter
 SG_ VFC_Poly_06_08_CRC : 0|16@1+ (1,0) [0|65535] ""  RadarFrontCenter
 SG_ VFC_Poly_06_08_AliveCtr : 16|8@1+ (1,0) [0|255] ""  RadarFrontCenter
 SG_ VFC_Poly_06_08_ProtBlockCtr : 24|4@1+ (1,0) [0|15] ""  RadarFrontCenter
 SG_ VFC_Poly06_LaneAssociation : 32|4@1+ (1,0) [0|15] ""  RadarFrontCenter
 SG_ VFC_Poly06_Type : 36|4@1+ (1,0) [0|15] ""  RadarFrontCenter
 SG_ VFC_Poly06_ExistProb : 40|6@1+ (2,0) [0|100] "%"  RadarFrontCenter
 SG_ VFC_Poly06_CoefficientYc3 : 46|18@1+ (1.49011611938476E-008,-0.001953125) [-0.001953125|0.00195311009883879] "1/m^2"  RadarFrontCenter
 SG_ VFC_Poly06_Colour : 64|3@1+ (1,0) [0|7] ""  RadarFrontCenter
 SG_ VFC_Poly06_CoefficientYc2 : 67|17@1+ (9.5367431640625E-007,-0.0625) [-0.0625|0.0624990463256836] "1/m"  RadarFrontCenter
 SG_ VFC_Poly06_CoefficientYc0 : 84|12@1+ (0.0078125,-16) [-16|15.9921875] "m"  RadarFrontCenter
 SG_ VFC_Poly06_CoefficientYc1 : 96|15@1+ (6.103515625E-005,-1) [-1|0.99993896484375] "1"  RadarFrontCenter
 SG_ VFC_Poly06_CoefficientYc2Corr : 111|17@1+ (9.5367431640625E-007,-0.0625) [-0.0625|0.0624990463256836] "1/m"  RadarFrontCenter
 SG_ VFC_Poly06_CoefficientYc3Corr : 128|18@1+ (1.49011611938476E-008,-0.001953125) [-0.001953125|0.00195311009883879] "1/m^2"  RadarFrontCenter
 SG_ VFC_Poly06_Width : 146|6@1+ (0.01,0) [0|0.63] "m"  RadarFrontCenter
 SG_ VFC_Poly06_RangeXCorrectionPoint : 152|8@1+ (1,0) [0|255] "m"  RadarFrontCenter
 SG_ VFC_Poly06_RangeXBegin : 160|9@1+ (0.25,0) [0|127.75] "m"  RadarFrontCenter
 SG_ VFC_Poly06_Reserved0 : 169|7@1+ (1,0) [0|127] "unitless"  RadarFrontCenter
 SG_ VFC_Poly06_RangeXEnd : 176|9@1+ (0.5,0) [0|255.5] "m"  RadarFrontCenter
 SG_ VFC_Poly06_Reserved1 : 185|7@1+ (1,0) [0|127] "unitless"  RadarFrontCenter
 SG_ VFC_Poly07_LaneAssociation : 192|4@1+ (1,0) [0|15] ""  RadarFrontCenter
 SG_ VFC_Poly07_Type : 196|4@1+ (1,0) [0|15] ""  RadarFrontCenter
 SG_ VFC_Poly07_ExistProb : 200|6@1+ (2,0) [0|100] "%"  RadarFrontCenter
 SG_ VFC_Poly07_CoefficientYc3 : 206|18@1+ (1.49011611938476E-008,-0.001953125) [-0.001953125|0.00195311009883879] "1/m^2"  RadarFrontCenter
 SG_ VFC_Poly07_Colour : 224|3@1+ (1,0) [0|7] ""  RadarFrontCenter
 SG_ VFC_Poly07_CoefficientYc2 : 227|17@1+ (9.5367431640625E-007,-0.0625) [-0.0625|0.0624990463256836] "1/m"  RadarFrontCenter
 SG_ VFC_Poly07_CoefficientYc0 : 244|12@1+ (0.0078125,-16) [-16|15.9921875] "m"  RadarFrontCenter
 SG_ VFC_Poly07_CoefficientYc1 : 256|15@1+ (6.103515625E-005,-1) [-1|0.99993896484375] "1"  RadarFrontCenter
 SG_ VFC_Poly07_CoefficientYc2Corr : 271|17@1+ (9.5367431640625E-007,-0.0625) [-0.0625|0.0624990463256836] "1/m"  RadarFrontCenter
 SG_ VFC_Poly07_CoefficientYc3Corr : 288|18@1+ (1.49011611938476E-008,-0.001953125) [-0.001953125|0.00195311009883879] "1/m^2"  RadarFrontCenter
 SG_ VFC_Poly07_Width : 306|6@1+ (0.01,0) [0|0.63] "m"  RadarFrontCenter
 SG_ VFC_Poly07_RangeXCorrectionPoint : 312|8@1+ (1,0) [0|255] "m"  RadarFrontCenter
 SG_ VFC_Poly07_RangeXBegin : 320|9@1+ (0.25,0) [0|127.75] "m"  RadarFrontCenter
 SG_ VFC_Poly07_Reserved0 : 329|7@1+ (1,0) [0|127] "unitless"  RadarFrontCenter
 SG_ VFC_Poly07_RangeXEnd : 336|9@1+ (0.5,0) [0|255.5] "m"  RadarFrontCenter
 SG_ VFC_Poly07_Reserved1 : 345|7@1+ (1,0) [0|127] "unitless"  RadarFrontCenter
 SG_ VFC_Poly08_LaneAssociation : 352|4@1+ (1,0) [0|15] ""  RadarFrontCenter
 SG_ VFC_Poly08_Type : 356|4@1+ (1,0) [0|15] ""  RadarFrontCenter
 SG_ VFC_Poly08_ExistProb : 360|6@1+ (2,0) [0|100] "%"  RadarFrontCenter
 SG_ VFC_Poly08_CoefficientYc3 : 366|18@1+ (1.49011611938476E-008,-0.001953125) [-0.001953125|0.00195311009883879] "1/m^2"  RadarFrontCenter
 SG_ VFC_Poly08_Colour : 384|3@1+ (1,0) [0|7] ""  RadarFrontCenter
 SG_ VFC_Poly08_CoefficientYc2 : 387|17@1+ (9.5367431640625E-007,-0.0625) [-0.0625|0.0624990463256836] "1/m"  RadarFrontCenter
 SG_ VFC_Poly08_CoefficientYc0 : 404|12@1+ (0.0078125,-16) [-16|15.9921875] "m"  RadarFrontCenter
 SG_ VFC_Poly08_CoefficientYc1 : 416|15@1+ (6.103515625E-005,-1) [-1|0.99993896484375] "1"  RadarFrontCenter
 SG_ VFC_Poly08_CoefficientYc2Corr : 431|17@1+ (9.5367431640625E-007,-0.0625) [-0.0625|0.0624990463256836] "1/m"  RadarFrontCenter
 SG_ VFC_Poly08_CoefficientYc3Corr : 448|18@1+ (1.49011611938476E-008,-0.001953125) [-0.001953125|0.00195311009883879] "1/m^2"  RadarFrontCenter
 SG_ VFC_Poly08_Width : 466|6@1+ (0.01,0) [0|0.63] "m"  RadarFrontCenter
 SG_ VFC_Poly08_RangeXCorrectionPoint : 472|8@1+ (1,0) [0|255] "m"  RadarFrontCenter
 SG_ VFC_Poly08_RangeXBegin : 480|9@1+ (0.25,0) [0|127.75] "m"  RadarFrontCenter
 SG_ VFC_Poly08_Reserved0 : 489|7@1+ (1,0) [0|127] "unitless"  RadarFrontCenter
 SG_ VFC_Poly08_RangeXEnd : 496|9@1+ (0.5,0) [0|255.5] "m"  RadarFrontCenter
 SG_ VFC_Poly08_Reserved1 : 505|7@1+ (1,0) [0|127] "unitless"  RadarFrontCenter

BO_ 149 VFC_RoadPolynomial_09_11: 64 VideoFrontCenter
 SG_ VFC_Poly_09_11_CRC : 0|16@1+ (1,0) [0|65535] ""  RadarFrontCenter
 SG_ VFC_Poly_09_11_AliveCtr : 16|8@1+ (1,0) [0|255] ""  RadarFrontCenter
 SG_ VFC_Poly_09_11_ProtBlockCtr : 24|4@1+ (1,0) [0|15] ""  RadarFrontCenter
 SG_ VFC_Poly09_LaneAssociation : 32|4@1+ (1,0) [0|15] ""  RadarFrontCenter
 SG_ VFC_Poly09_Type : 36|4@1+ (1,0) [0|15] ""  RadarFrontCenter
 SG_ VFC_Poly09_ExistProb : 40|6@1+ (2,0) [0|100] "%"  RadarFrontCenter
 SG_ VFC_Poly09_CoefficientYc3 : 46|18@1+ (1.49011611938476E-008,-0.001953125) [-0.001953125|0.00195311009883879] "1/m^2"  RadarFrontCenter
 SG_ VFC_Poly09_Colour : 64|3@1+ (1,0) [0|7] ""  RadarFrontCenter
 SG_ VFC_Poly09_CoefficientYc2 : 67|17@1+ (9.5367431640625E-007,-0.0625) [-0.0625|0.0624990463256836] "1/m"  RadarFrontCenter
 SG_ VFC_Poly09_CoefficientYc0 : 84|12@1+ (0.0078125,-16) [-16|15.9921875] "m"  RadarFrontCenter
 SG_ VFC_Poly09_CoefficientYc1 : 96|15@1+ (6.103515625E-005,-1) [-1|0.99993896484375] "1"  RadarFrontCenter
 SG_ VFC_Poly09_CoefficientYc2Corr : 111|17@1+ (9.5367431640625E-007,-0.0625) [-0.0625|0.0624990463256836] "1/m"  RadarFrontCenter
 SG_ VFC_Poly09_CoefficientYc3Corr : 128|18@1+ (1.49011611938476E-008,-0.001953125) [-0.001953125|0.00195311009883879] "1/m^2"  RadarFrontCenter
 SG_ VFC_Poly09_Width : 146|6@1+ (0.01,0) [0|0.63] "m"  RadarFrontCenter
 SG_ VFC_Poly09_RangeXCorrectionPoint : 152|8@1+ (1,0) [0|255] "m"  RadarFrontCenter
 SG_ VFC_Poly09_RangeXBegin : 160|9@1+ (0.25,0) [0|127.75] "m"  RadarFrontCenter
 SG_ VFC_Poly09_Reserved0 : 169|7@1+ (1,0) [0|127] "unitless"  RadarFrontCenter
 SG_ VFC_Poly09_RangeXEnd : 176|9@1+ (0.5,0) [0|255.5] "m"  RadarFrontCenter
 SG_ VFC_Poly09_Reserved1 : 185|7@1+ (1,0) [0|127] "unitless"  RadarFrontCenter
 SG_ VFC_Poly10_LaneAssociation : 192|4@1+ (1,0) [0|15] ""  RadarFrontCenter
 SG_ VFC_Poly10_Type : 196|4@1+ (1,0) [0|15] ""  RadarFrontCenter
 SG_ VFC_Poly10_ExistProb : 200|6@1+ (2,0) [0|100] "%"  RadarFrontCenter
 SG_ VFC_Poly10_CoefficientYc3 : 206|18@1+ (1.49011611938476E-008,-0.001953125) [-0.001953125|0.00195311009883879] "1/m^2"  RadarFrontCenter
 SG_ VFC_Poly10_Colour : 224|3@1+ (1,0) [0|7] ""  RadarFrontCenter
 SG_ VFC_Poly10_CoefficientYc2 : 227|17@1+ (9.5367431640625E-007,-0.0625) [-0.0625|0.0624990463256836] "1/m"  RadarFrontCenter
 SG_ VFC_Poly10_CoefficientYc0 : 244|12@1+ (0.0078125,-16) [-16|15.9921875] "m"  RadarFrontCenter
 SG_ VFC_Poly10_CoefficientYc1 : 256|15@1+ (6.103515625E-005,-1) [-1|0.99993896484375] "1"  RadarFrontCenter
 SG_ VFC_Poly10_CoefficientYc2Corr : 271|17@1+ (9.5367431640625E-007,-0.0625) [-0.0625|0.0624990463256836] "1/m"  RadarFrontCenter
 SG_ VFC_Poly10_CoefficientYc3Corr : 288|18@1+ (1.49011611938476E-008,-0.001953125) [-0.001953125|0.00195311009883879] "1/m^2"  RadarFrontCenter
 SG_ VFC_Poly10_Width : 306|6@1+ (0.01,0) [0|0.63] "m"  RadarFrontCenter
 SG_ VFC_Poly10_RangeXCorrectionPoint : 312|8@1+ (1,0) [0|255] "m"  RadarFrontCenter
 SG_ VFC_Poly10_RangeXBegin : 320|9@1+ (0.25,0) [0|127.75] "m"  RadarFrontCenter
 SG_ VFC_Poly10_Reserved0 : 329|7@1+ (1,0) [0|127] "unitless"  RadarFrontCenter
 SG_ VFC_Poly10_RangeXEnd : 336|9@1+ (0.5,0) [0|255.5] "m"  RadarFrontCenter
 SG_ VFC_Poly10_Reserved1 : 345|7@1+ (1,0) [0|127] "unitless"  RadarFrontCenter
 SG_ VFC_Poly11_LaneAssociation : 352|4@1+ (1,0) [0|15] ""  RadarFrontCenter
 SG_ VFC_Poly11_Type : 356|4@1+ (1,0) [0|15] ""  RadarFrontCenter
 SG_ VFC_Poly11_ExistProb : 360|6@1+ (2,0) [0|100] "%"  RadarFrontCenter
 SG_ VFC_Poly11_CoefficientYc3 : 366|18@1+ (1.49011611938476E-008,-0.001953125) [-0.001953125|0.00195311009883879] "1/m^2"  RadarFrontCenter
 SG_ VFC_Poly11_Colour : 384|3@1+ (1,0) [0|7] ""  RadarFrontCenter
 SG_ VFC_Poly11_CoefficientYc2 : 387|17@1+ (9.5367431640625E-007,-0.0625) [-0.0625|0.0624990463256836] "1/m"  RadarFrontCenter
 SG_ VFC_Poly11_CoefficientYc0 : 404|12@1+ (0.0078125,-16) [-16|15.9921875] "m"  RadarFrontCenter
 SG_ VFC_Poly11_CoefficientYc1 : 416|15@1+ (6.103515625E-005,-1) [-1|0.99993896484375] "1"  RadarFrontCenter
 SG_ VFC_Poly11_CoefficientYc2Corr : 431|17@1+ (9.5367431640625E-007,-0.0625) [-0.0625|0.0624990463256836] "1/m"  RadarFrontCenter
 SG_ VFC_Poly11_CoefficientYc3Corr : 448|18@1+ (1.49011611938476E-008,-0.001953125) [-0.001953125|0.00195311009883879] "1/m^2"  RadarFrontCenter
 SG_ VFC_Poly11_Width : 466|6@1+ (0.01,0) [0|0.63] "m"  RadarFrontCenter
 SG_ VFC_Poly11_RangeXCorrectionPoint : 472|8@1+ (1,0) [0|255] "m"  RadarFrontCenter
 SG_ VFC_Poly11_RangeXBegin : 480|9@1+ (0.25,0) [0|127.75] "m"  RadarFrontCenter
 SG_ VFC_Poly11_Reserved0 : 489|7@1+ (1,0) [0|127] "unitless"  RadarFrontCenter
 SG_ VFC_Poly11_RangeXEnd : 496|9@1+ (0.5,0) [0|255.5] "m"  RadarFrontCenter
 SG_ VFC_Poly11_Reserved1 : 505|7@1+ (1,0) [0|127] "unitless"  RadarFrontCenter

BO_ 150 VFC_RoadPolynomial_12_14: 64 VideoFrontCenter
 SG_ VFC_Poly_12_14_CRC : 0|16@1+ (1,0) [0|65535] ""  RadarFrontCenter
 SG_ VFC_Poly_12_14_AliveCtr : 16|8@1+ (1,0) [0|255] ""  RadarFrontCenter
 SG_ VFC_Poly_12_14_ProtBlockCtr : 24|4@1+ (1,0) [0|15] ""  RadarFrontCenter
 SG_ VFC_Poly12_LaneAssociation : 32|4@1+ (1,0) [0|15] ""  RadarFrontCenter
 SG_ VFC_Poly12_Type : 36|4@1+ (1,0) [0|15] ""  RadarFrontCenter
 SG_ VFC_Poly12_ExistProb : 40|6@1+ (2,0) [0|100] "%"  RadarFrontCenter
 SG_ VFC_Poly12_CoefficientYc3 : 46|18@1+ (1.49011611938476E-008,-0.001953125) [-0.001953125|0.00195311009883879] "1/m^2"  RadarFrontCenter
 SG_ VFC_Poly12_Colour : 64|3@1+ (1,0) [0|7] ""  RadarFrontCenter
 SG_ VFC_Poly12_CoefficientYc2 : 67|17@1+ (9.5367431640625E-007,-0.0625) [-0.0625|0.0624990463256836] "1/m"  RadarFrontCenter
 SG_ VFC_Poly12_CoefficientYc0 : 84|12@1+ (0.0078125,-16) [-16|15.9921875] "m"  RadarFrontCenter
 SG_ VFC_Poly12_CoefficientYc1 : 96|15@1+ (6.103515625E-005,-1) [-1|0.99993896484375] "1"  RadarFrontCenter
 SG_ VFC_Poly12_CoefficientYc2Corr : 111|17@1+ (9.5367431640625E-007,-0.0625) [-0.0625|0.0624990463256836] "1/m"  RadarFrontCenter
 SG_ VFC_Poly12_CoefficientYc3Corr : 128|18@1+ (1.49011611938476E-008,-0.001953125) [-0.001953125|0.00195311009883879] "1/m^2"  RadarFrontCenter
 SG_ VFC_Poly12_Width : 146|6@1+ (0.01,0) [0|0.63] "m"  RadarFrontCenter
 SG_ VFC_Poly12_RangeXCorrectionPoint : 152|8@1+ (1,0) [0|255] "m"  RadarFrontCenter
 SG_ VFC_Poly12_RangeXBegin : 160|9@1+ (0.25,0) [0|127.75] "m"  RadarFrontCenter
 SG_ VFC_Poly12_Reserved0 : 169|7@1+ (1,0) [0|127] "unitless"  RadarFrontCenter
 SG_ VFC_Poly12_RangeXEnd : 176|9@1+ (0.5,0) [0|255.5] "m"  RadarFrontCenter
 SG_ VFC_Poly12_Reserved1 : 185|7@1+ (1,0) [0|127] "unitless"  RadarFrontCenter
 SG_ VFC_Poly13_LaneAssociation : 192|4@1+ (1,0) [0|15] ""  RadarFrontCenter
 SG_ VFC_Poly13_Type : 196|4@1+ (1,0) [0|15] ""  RadarFrontCenter
 SG_ VFC_Poly13_ExistProb : 200|6@1+ (2,0) [0|100] "%"  RadarFrontCenter
 SG_ VFC_Poly13_CoefficientYc3 : 206|18@1+ (1.49011611938476E-008,-0.001953125) [-0.001953125|0.00195311009883879] "1/m^2"  RadarFrontCenter
 SG_ VFC_Poly13_Colour : 224|3@1+ (1,0) [0|7] ""  RadarFrontCenter
 SG_ VFC_Poly13_CoefficientYc2 : 227|17@1+ (9.5367431640625E-007,-0.0625) [-0.0625|0.0624990463256836] "1/m"  RadarFrontCenter
 SG_ VFC_Poly13_CoefficientYc0 : 244|12@1+ (0.0078125,-16) [-16|15.9921875] "m"  RadarFrontCenter
 SG_ VFC_Poly13_CoefficientYc1 : 256|15@1+ (6.103515625E-005,-1) [-1|0.99993896484375] "1"  RadarFrontCenter
 SG_ VFC_Poly13_CoefficientYc2Corr : 271|17@1+ (9.5367431640625E-007,-0.0625) [-0.0625|0.0624990463256836] "1/m"  RadarFrontCenter
 SG_ VFC_Poly13_CoefficientYc3Corr : 288|18@1+ (1.49011611938476E-008,-0.001953125) [-0.001953125|0.00195311009883879] "1/m^2"  RadarFrontCenter
 SG_ VFC_Poly13_Width : 306|6@1+ (0.01,0) [0|0.63] "m"  RadarFrontCenter
 SG_ VFC_Poly13_RangeXCorrectionPoint : 312|8@1+ (1,0) [0|255] "m"  RadarFrontCenter
 SG_ VFC_Poly13_RangeXBegin : 320|9@1+ (0.25,0) [0|127.75] "m"  RadarFrontCenter
 SG_ VFC_Poly13_Reserved0 : 329|7@1+ (1,0) [0|127] "unitless"  RadarFrontCenter
 SG_ VFC_Poly13_RangeXEnd : 336|9@1+ (0.5,0) [0|255.5] "m"  RadarFrontCenter
 SG_ VFC_Poly13_Reserved1 : 345|7@1+ (1,0) [0|127] "unitless"  RadarFrontCenter
 SG_ VFC_Poly14_LaneAssociation : 352|4@1+ (1,0) [0|15] ""  RadarFrontCenter
 SG_ VFC_Poly14_Type : 356|4@1+ (1,0) [0|15] ""  RadarFrontCenter
 SG_ VFC_Poly14_ExistProb : 360|6@1+ (2,0) [0|100] "%"  RadarFrontCenter
 SG_ VFC_Poly14_CoefficientYc3 : 366|18@1+ (1.49011611938476E-008,-0.001953125) [-0.001953125|0.00195311009883879] "1/m^2"  RadarFrontCenter
 SG_ VFC_Poly14_Colour : 384|3@1+ (1,0) [0|7] ""  RadarFrontCenter
 SG_ VFC_Poly14_CoefficientYc2 : 387|17@1+ (9.5367431640625E-007,-0.0625) [-0.0625|0.0624990463256836] "1/m"  RadarFrontCenter
 SG_ VFC_Poly14_CoefficientYc0 : 404|12@1+ (0.0078125,-16) [-16|15.9921875] "m"  RadarFrontCenter
 SG_ VFC_Poly14_CoefficientYc1 : 416|15@1+ (6.103515625E-005,-1) [-1|0.99993896484375] "1"  RadarFrontCenter
 SG_ VFC_Poly14_CoefficientYc2Corr : 431|17@1+ (9.5367431640625E-007,-0.0625) [-0.0625|0.0624990463256836] "1/m"  RadarFrontCenter
 SG_ VFC_Poly14_CoefficientYc3Corr : 448|18@1+ (1.49011611938476E-008,-0.001953125) [-0.001953125|0.00195311009883879] "1/m^2"  RadarFrontCenter
 SG_ VFC_Poly14_Width : 466|6@1+ (0.01,0) [0|0.63] "m"  RadarFrontCenter
 SG_ VFC_Poly14_RangeXCorrectionPoint : 472|8@1+ (1,0) [0|255] "m"  RadarFrontCenter
 SG_ VFC_Poly14_RangeXBegin : 480|9@1+ (0.25,0) [0|127.75] "m"  RadarFrontCenter
 SG_ VFC_Poly14_Reserved0 : 489|7@1+ (1,0) [0|127] "unitless"  RadarFrontCenter
 SG_ VFC_Poly14_RangeXEnd : 496|9@1+ (0.5,0) [0|255.5] "m"  RadarFrontCenter
 SG_ VFC_Poly14_Reserved1 : 505|7@1+ (1,0) [0|127] "unitless"  RadarFrontCenter

BO_ 162 VFC_Road2DPolynomial_00_02: 64 VideoFrontCenter
 SG_ VFC_2DPoly_00_02_CRC : 0|16@1+ (1,0) [0|65535] ""  RadarFrontCenter
 SG_ VFC_2DPoly_00_02_AliveCtr : 16|8@1+ (1,0) [0|255] ""  RadarFrontCenter
 SG_ VFC_2DPoly_00_02_ProtBlockCtr : 24|4@1+ (1,0) [0|15] ""  RadarFrontCenter
 SG_ VFC_2DPoly00_LaneAssociation : 32|4@1+ (1,0) [0|15] ""  RadarFrontCenter
 SG_ VFC_2DPoly00_ExistProb : 38|6@1+ (2,0) [0|100] "%"  RadarFrontCenter
 SG_ VFC_2DPoly00_Type : 44|4@1+ (1,0) [0|15] ""  RadarFrontCenter
 SG_ VFC_2DPoly00_CoefficientUc0 : 48|16@1+ (0.25,-8192) [-8192|8191.75] "pixel"  RadarFrontCenter
 SG_ VFC_2DPoly00_CoefficientUc1 : 64|16@1+ (0.25,-8192) [-8192|8191.75] "pixel"  RadarFrontCenter
 SG_ VFC_2DPoly00_CoefficientUc2 : 80|16@1+ (0.25,-8192) [-8192|8191.75] "pixel"  RadarFrontCenter
 SG_ VFC_2DPoly00_CoefficientUc3 : 96|16@1+ (0.25,-8192) [-8192|8191.75] "pixel"  RadarFrontCenter
 SG_ VFC_2DPoly00_CoefficientUc4 : 112|16@1+ (0.25,-8192) [-8192|8191.75] "pixel"  RadarFrontCenter
 SG_ VFC_2DPoly00_CoefficientUc5 : 128|16@1+ (0.25,-8192) [-8192|8191.75] "pixel"  RadarFrontCenter
 SG_ VFC_2DPoly00_RangeVBegin : 144|12@1+ (1,0) [0|4095] "pixel"  RadarFrontCenter
 SG_ VFC_2DPoly00_RangeVEnd : 156|12@1+ (1,0) [0|4095] "pixel"  RadarFrontCenter
 SG_ VFC_2DPoly01_LaneAssociation : 192|4@1+ (1,0) [0|15] ""  RadarFrontCenter
 SG_ VFC_2DPoly01_ExistProb : 198|6@1+ (2,0) [0|100] "%"  RadarFrontCenter
 SG_ VFC_2DPoly01_Type : 204|4@1+ (1,0) [0|15] ""  RadarFrontCenter
 SG_ VFC_2DPoly01_CoefficientUc0 : 208|16@1+ (0.25,-8192) [-8192|8191.75] "pixel"  RadarFrontCenter
 SG_ VFC_2DPoly01_CoefficientUc1 : 224|16@1+ (0.25,-8192) [-8192|8191.75] "pixel"  RadarFrontCenter
 SG_ VFC_2DPoly01_CoefficientUc2 : 240|16@1+ (0.25,-8192) [-8192|8191.75] "pixel"  RadarFrontCenter
 SG_ VFC_2DPoly01_CoefficientUc3 : 256|16@1+ (0.25,-8192) [-8192|8191.75] "pixel"  RadarFrontCenter
 SG_ VFC_2DPoly01_CoefficientUc4 : 272|16@1+ (0.25,-8192) [-8192|8191.75] "pixel"  RadarFrontCenter
 SG_ VFC_2DPoly01_CoefficientUc5 : 288|16@1+ (0.25,-8192) [-8192|8191.75] "pixel"  RadarFrontCenter
 SG_ VFC_2DPoly01_RangeVBegin : 304|12@1+ (1,0) [0|4095] "pixel"  RadarFrontCenter
 SG_ VFC_2DPoly01_RangeVEnd : 316|12@1+ (1,0) [0|4095] "pixel"  RadarFrontCenter
 SG_ VFC_2DPoly02_LaneAssociation : 352|4@1+ (1,0) [0|15] ""  RadarFrontCenter
 SG_ VFC_2DPoly02_ExistProb : 358|6@1+ (2,0) [0|100] "%"  RadarFrontCenter
 SG_ VFC_2DPoly02_Type : 364|4@1+ (1,0) [0|15] ""  RadarFrontCenter
 SG_ VFC_2DPoly02_CoefficientUc0 : 368|16@1+ (0.25,-8192) [-8192|8191.75] "pixel"  RadarFrontCenter
 SG_ VFC_2DPoly02_CoefficientUc1 : 384|16@1+ (0.25,-8192) [-8192|8191.75] "pixel"  RadarFrontCenter
 SG_ VFC_2DPoly02_CoefficientUc2 : 400|16@1+ (0.25,-8192) [-8192|8191.75] "pixel"  RadarFrontCenter
 SG_ VFC_2DPoly02_CoefficientUc3 : 416|16@1+ (0.25,-8192) [-8192|8191.75] "pixel"  RadarFrontCenter
 SG_ VFC_2DPoly02_CoefficientUc4 : 432|16@1+ (0.25,-8192) [-8192|8191.75] "pixel"  RadarFrontCenter
 SG_ VFC_2DPoly02_CoefficientUc5 : 448|16@1+ (0.25,-8192) [-8192|8191.75] "pixel"  RadarFrontCenter
 SG_ VFC_2DPoly02_RangeVBegin : 464|12@1+ (1,0) [0|4095] "pixel"  RadarFrontCenter
 SG_ VFC_2DPoly02_RangeVEnd : 476|12@1+ (1,0) [0|4095] "pixel"  RadarFrontCenter

BO_ 163 VFC_Road2DPolynomial_03_05: 64 VideoFrontCenter
 SG_ VFC_2DPoly_03_05_CRC : 0|16@1+ (1,0) [0|65535] ""  RadarFrontCenter
 SG_ VFC_2DPoly_03_05_AliveCtr : 16|8@1+ (1,0) [0|255] ""  RadarFrontCenter
 SG_ VFC_2DPoly_03_05_ProtBlockCtr : 24|4@1+ (1,0) [0|15] ""  RadarFrontCenter
 SG_ VFC_2DPoly03_LaneAssociation : 32|4@1+ (1,0) [0|15] ""  RadarFrontCenter
 SG_ VFC_2DPoly03_ExistProb : 38|6@1+ (2,0) [0|100] "%"  RadarFrontCenter
 SG_ VFC_2DPoly03_Type : 44|4@1+ (1,0) [0|15] ""  RadarFrontCenter
 SG_ VFC_2DPoly03_CoefficientUc0 : 48|16@1+ (0.25,-8192) [-8192|8191.75] "pixel"  RadarFrontCenter
 SG_ VFC_2DPoly03_CoefficientUc1 : 64|16@1+ (0.25,-8192) [-8192|8191.75] "pixel"  RadarFrontCenter
 SG_ VFC_2DPoly03_CoefficientUc2 : 80|16@1+ (0.25,-8192) [-8192|8191.75] "pixel"  RadarFrontCenter
 SG_ VFC_2DPoly03_CoefficientUc3 : 96|16@1+ (0.25,-8192) [-8192|8191.75] "pixel"  RadarFrontCenter
 SG_ VFC_2DPoly03_CoefficientUc4 : 112|16@1+ (0.25,-8192) [-8192|8191.75] "pixel"  RadarFrontCenter
 SG_ VFC_2DPoly03_CoefficientUc5 : 128|16@1+ (0.25,-8192) [-8192|8191.75] "pixel"  RadarFrontCenter
 SG_ VFC_2DPoly03_RangeVBegin : 144|12@1+ (1,0) [0|4095] "pixel"  RadarFrontCenter
 SG_ VFC_2DPoly03_RangeVEnd : 156|12@1+ (1,0) [0|4095] "pixel"  RadarFrontCenter
 SG_ VFC_2DPoly04_LaneAssociation : 192|4@1+ (1,0) [0|15] ""  RadarFrontCenter
 SG_ VFC_2DPoly04_ExistProb : 198|6@1+ (2,0) [0|100] "%"  RadarFrontCenter
 SG_ VFC_2DPoly04_Type : 204|4@1+ (1,0) [0|15] ""  RadarFrontCenter
 SG_ VFC_2DPoly04_CoefficientUc0 : 208|16@1+ (0.25,-8192) [-8192|8191.75] "pixel"  RadarFrontCenter
 SG_ VFC_2DPoly04_CoefficientUc1 : 224|16@1+ (0.25,-8192) [-8192|8191.75] "pixel"  RadarFrontCenter
 SG_ VFC_2DPoly04_CoefficientUc2 : 240|16@1+ (0.25,-8192) [-8192|8191.75] "pixel"  RadarFrontCenter
 SG_ VFC_2DPoly04_CoefficientUc3 : 256|16@1+ (0.25,-8192) [-8192|8191.75] "pixel"  RadarFrontCenter
 SG_ VFC_2DPoly04_CoefficientUc4 : 272|16@1+ (0.25,-8192) [-8192|8191.75] "pixel"  RadarFrontCenter
 SG_ VFC_2DPoly04_CoefficientUc5 : 288|16@1+ (0.25,-8192) [-8192|8191.75] "pixel"  RadarFrontCenter
 SG_ VFC_2DPoly04_RangeVBegin : 304|12@1+ (1,0) [0|4095] "pixel"  RadarFrontCenter
 SG_ VFC_2DPoly04_RangeVEnd : 316|12@1+ (1,0) [0|4095] "pixel"  RadarFrontCenter
 SG_ VFC_2DPoly05_LaneAssociation : 352|4@1+ (1,0) [0|15] ""  RadarFrontCenter
 SG_ VFC_2DPoly05_ExistProb : 358|6@1+ (2,0) [0|100] "%"  RadarFrontCenter
 SG_ VFC_2DPoly05_Type : 364|4@1+ (1,0) [0|15] ""  RadarFrontCenter
 SG_ VFC_2DPoly05_CoefficientUc0 : 368|16@1+ (0.25,-8192) [-8192|8191.75] "pixel"  RadarFrontCenter
 SG_ VFC_2DPoly05_CoefficientUc1 : 384|16@1+ (0.25,-8192) [-8192|8191.75] "pixel"  RadarFrontCenter
 SG_ VFC_2DPoly05_CoefficientUc2 : 400|16@1+ (0.25,-8192) [-8192|8191.75] "pixel"  RadarFrontCenter
 SG_ VFC_2DPoly05_CoefficientUc3 : 416|16@1+ (0.25,-8192) [-8192|8191.75] "pixel"  RadarFrontCenter
 SG_ VFC_2DPoly05_CoefficientUc4 : 432|16@1+ (0.25,-8192) [-8192|8191.75] "pixel"  RadarFrontCenter
 SG_ VFC_2DPoly05_CoefficientUc5 : 448|16@1+ (0.25,-8192) [-8192|8191.75] "pixel"  RadarFrontCenter
 SG_ VFC_2DPoly05_RangeVBegin : 464|12@1+ (1,0) [0|4095] "pixel"  RadarFrontCenter
 SG_ VFC_2DPoly05_RangeVEnd : 476|12@1+ (1,0) [0|4095] "pixel"  RadarFrontCenter

CM_ SG_ 128 VFC_RoadHdr_CRC "CRC - Autosar E2E Profile 5";
CM_ SG_ 128 VFC_RoadHdr_AliveCtr "Alive counter - Autosar E2E Profile 5";
CM_ SG_ 128 VFC_RoadHdr_ProtBlockCtr "Protocol-Signal: Block-Counter";
CM_ SG_ 128 VFC_RoadHdr_IfVersionIdMajor "Version information of the interface. e. g. version 1.0: Major = 1. ISO 23150:2022(E): Interface version ID {major, minor, patch} (A.1.1)";
CM_ SG_ 128 VFC_RoadHdr_IfVersionIdMinor "Version information of the interface. e. g. version 1.0: Minor = 0. ISO 23150:2022(E): Interface version ID {major, minor, patch} (A.1.1)";
CM_ SG_ 128 VFC_RoadHdr_NumValidPolynomials "Number of valid polynomials. ISO 23150:2022(E): Number of valid road markings (A.1.12.2)";
CM_ SG_ 128 VFC_RoadHdr_RoadType "ISO 23150:2022(E): Road type (A.2.81)";
CM_ SG_ 128 VFC_RoadHdr_TimeStampStatus "Autosar StbM_TimeBaseStatusType bitfield with extension:
Bit 0: TIMEOUT
Bit 1: Reserved1
Bit 2: SYNC_TO_GATEWAY
Bit 3: GLOBAL_TIME_BASE
Bit 4: TIMELEAP_FUTURE
Bit 5: TIMELEAP_PAST
Bit 6: Reserved6
Bit 7: Extension: GENERAL_ERROR";
CM_ SG_ 128 VFC_RoadHdr_TimeStamp "ISO 23150:2022(E): Time stamp - prediction (A.1.5.1)";
CM_ SG_ 128 VFC_RoadHdr_SensorStatus "Informs the system of the current status of the road detection system";
CM_ SG_ 128 VFC_RoadHdr_NumValid2DPolynomial "Number of valid 2D polynomials. ISO 23150:2022(E): Number of valid road markings (A.1.12.2)";
CM_ SG_ 128 VFC_RoadHdr_RoadSurfCondType "ISO 23150:2022(E): Road surface condition classification type (A.2.88)";
CM_ SG_ 128 VFC_RoadHdr_NumValidRoadMarkings "Number of valid road markings. ISO 23150:2022(E): Number of valid road markings (A.1.12.2)";
CM_ SG_ 128 VFC_RoadHdr_RoadTypeConf "ISO 23150:2022(E): Road type - confidence (A.2.82)";
CM_ SG_ 128 VFC_RoadHdr_RoadSurCondTypeConf "ISO 23150:2022(E): Road surface condition classification type - confidence (A.2.89)";
CM_ SG_ 128 VFC_RoadHdr_2DNormVMean "V-coordinate normalization mean value (in CV coordinates, origin top left)";
CM_ SG_ 128 VFC_RoadHdr_2DNormVMeanStdDev "Standard deviation of v-coordinate normalization mean value (in CV coordinates, origin top left)";
CM_ SG_ 128 VFC_RoadHdr_NumValidClothoids "Number of valid clothoids. ISO 23150:2022(E): Number of valid road markings (A.1.12.2)";
CM_ SG_ 130 VFC_Cloth_00_02_CRC "CRC - Autosar E2E Profile 5";
CM_ SG_ 130 VFC_Cloth_00_02_AliveCtr "Alive counter - Autosar E2E Profile 5";
CM_ SG_ 130 VFC_Cloth_00_02_ProtBlockCtr "Protocol-Signal: Block-Counter";
CM_ SG_ 130 VFC_Cloth00_LaneAssociation "Position relative to the ego lane. ISO 23150:2022(E): Road object lane association (A.2.93)";
CM_ SG_ 130 VFC_Cloth00_Colour "The color of the line. Similar to ISO 23150:2022(E): Colour value - object level (A.2.107)";
CM_ SG_ 130 VFC_Cloth00_RangeXBegin "Longitudinal begin of the clothoid. ISO 23150:2022(E): Polynomial range x {begin, end} (A.2.120)";
CM_ SG_ 130 VFC_Cloth00_RangeXEnd "Longitudinal end of the clothoid. ISO 23150:2022(E): Polynomial range x {begin, end} (A.2.120)";
CM_ SG_ 130 VFC_Cloth00_ExistProb "Confidence for this clothoid, probability that it describes the true lane boundary. ISO 23150:2022(E): Existence probability - object level (A.2.1)";
CM_ SG_ 130 VFC_Cloth00_CurvChange "Curvature change or alteration of the clothoid, also called kappaDt (resolution = 2^-29)";
CM_ SG_ 130 VFC_Cloth00_Curv "Curvature of the clothoid, also called kappa (resolution = 2^-18)";
CM_ SG_ 130 VFC_Cloth00_PyStdDev "Standard deviation at x=0 of the lateral offset (resolution = 2^-7)";
CM_ SG_ 130 VFC_Cloth00_Py "Lateral offset at x=0, also called LatDeviation (resolution = 2^-7)";
CM_ SG_ 130 VFC_Cloth00_OrientationYaw "Heading angle, difference in yaw angle between vehicle heading and clothoid (resolution = 2^-11). ISO 23150:2022(E): Orientation {yaw, pitch, roll} (A.2.17)";
CM_ SG_ 130 VFC_Cloth00_Width "Width of the line. ISO 23150:2022(E): Extent {width} - polynomial (A.2.121)";
CM_ SG_ 130 VFC_Cloth00_Type "Type of the Line. ISO 23150:2022(E): Road marking type (A.2.91)";
CM_ SG_ 130 VFC_Cloth01_LaneAssociation "Position relative to the ego lane. ISO 23150:2022(E): Road object lane association (A.2.93)";
CM_ SG_ 130 VFC_Cloth01_Colour "The color of the line. Similar to ISO 23150:2022(E): Colour value - object level (A.2.107)";
CM_ SG_ 130 VFC_Cloth01_RangeXBegin "Longitudinal begin of the clothoid. ISO 23150:2022(E): Polynomial range x {begin, end} (A.2.120)";
CM_ SG_ 130 VFC_Cloth01_RangeXEnd "Longitudinal end of the clothoid. ISO 23150:2022(E): Polynomial range x {begin, end} (A.2.120)";
CM_ SG_ 130 VFC_Cloth01_ExistProb "Confidence for this clothoid, probability that it describes the true lane boundary. ISO 23150:2022(E): Existence probability - object level (A.2.1)";
CM_ SG_ 130 VFC_Cloth01_CurvChange "Curvature change or alteration of the clothoid, also called kappaDt (resolution = 2^-29)";
CM_ SG_ 130 VFC_Cloth01_Curv "Curvature of the clothoid, also called kappa (resolution = 2^-18)";
CM_ SG_ 130 VFC_Cloth01_PyStdDev "Standard deviation at x=0 of the lateral offset (resolution = 2^-7)";
CM_ SG_ 130 VFC_Cloth01_Py "Lateral offset at x=0, also called LatDeviation (resolution = 2^-7)";
CM_ SG_ 130 VFC_Cloth01_OrientationYaw "Heading angle, difference in yaw angle between vehicle heading and clothoid (resolution = 2^-11). ISO 23150:2022(E): Orientation {yaw, pitch, roll} (A.2.17)";
CM_ SG_ 130 VFC_Cloth01_Width "Width of the line. ISO 23150:2022(E): Extent {width} - polynomial (A.2.121)";
CM_ SG_ 130 VFC_Cloth01_Type "Type of the Line. ISO 23150:2022(E): Road marking type (A.2.91)";
CM_ SG_ 130 VFC_Cloth02_LaneAssociation "Position relative to the ego lane. ISO 23150:2022(E): Road object lane association (A.2.93)";
CM_ SG_ 130 VFC_Cloth02_Colour "The color of the line. Similar to ISO 23150:2022(E): Colour value - object level (A.2.107)";
CM_ SG_ 130 VFC_Cloth02_RangeXBegin "Longitudinal begin of the clothoid. ISO 23150:2022(E): Polynomial range x {begin, end} (A.2.120)";
CM_ SG_ 130 VFC_Cloth02_RangeXEnd "Longitudinal end of the clothoid. ISO 23150:2022(E): Polynomial range x {begin, end} (A.2.120)";
CM_ SG_ 130 VFC_Cloth02_ExistProb "Confidence for this clothoid, probability that it describes the true lane boundary. ISO 23150:2022(E): Existence probability - object level (A.2.1)";
CM_ SG_ 130 VFC_Cloth02_CurvChange "Curvature change or alteration of the clothoid, also called kappaDt (resolution = 2^-29)";
CM_ SG_ 130 VFC_Cloth02_Curv "Curvature of the clothoid, also called kappa (resolution = 2^-18)";
CM_ SG_ 130 VFC_Cloth02_PyStdDev "Standard deviation at x=0 of the lateral offset (resolution = 2^-7)";
CM_ SG_ 130 VFC_Cloth02_Py "Lateral offset at x=0, also called LatDeviation (resolution = 2^-7)";
CM_ SG_ 130 VFC_Cloth02_OrientationYaw "Heading angle, difference in yaw angle between vehicle heading and clothoid (resolution = 2^-11). ISO 23150:2022(E): Orientation {yaw, pitch, roll} (A.2.17)";
CM_ SG_ 130 VFC_Cloth02_Width "Width of the line. ISO 23150:2022(E): Extent {width} - polynomial (A.2.121)";
CM_ SG_ 130 VFC_Cloth02_Type "Type of the Line. ISO 23150:2022(E): Road marking type (A.2.91)";
CM_ SG_ 131 VFC_Cloth_03_05_CRC "CRC - Autosar E2E Profile 5";
CM_ SG_ 131 VFC_Cloth_03_05_AliveCtr "Alive counter - Autosar E2E Profile 5";
CM_ SG_ 131 VFC_Cloth_03_05_ProtBlockCtr "Protocol-Signal: Block-Counter";
CM_ SG_ 131 VFC_Cloth03_LaneAssociation "Position relative to the ego lane. ISO 23150:2022(E): Road object lane association (A.2.93)";
CM_ SG_ 131 VFC_Cloth03_Colour "The color of the line. Similar to ISO 23150:2022(E): Colour value - object level (A.2.107)";
CM_ SG_ 131 VFC_Cloth03_RangeXBegin "Longitudinal begin of the clothoid. ISO 23150:2022(E): Polynomial range x {begin, end} (A.2.120)";
CM_ SG_ 131 VFC_Cloth03_RangeXEnd "Longitudinal end of the clothoid. ISO 23150:2022(E): Polynomial range x {begin, end} (A.2.120)";
CM_ SG_ 131 VFC_Cloth03_ExistProb "Confidence for this clothoid, probability that it describes the true lane boundary. ISO 23150:2022(E): Existence probability - object level (A.2.1)";
CM_ SG_ 131 VFC_Cloth03_CurvChange "Curvature change or alteration of the clothoid, also called kappaDt (resolution = 2^-29)";
CM_ SG_ 131 VFC_Cloth03_Curv "Curvature of the clothoid, also called kappa (resolution = 2^-18)";
CM_ SG_ 131 VFC_Cloth03_PyStdDev "Standard deviation at x=0 of the lateral offset (resolution = 2^-7)";
CM_ SG_ 131 VFC_Cloth03_Py "Lateral offset at x=0, also called LatDeviation (resolution = 2^-7)";
CM_ SG_ 131 VFC_Cloth03_OrientationYaw "Heading angle, difference in yaw angle between vehicle heading and clothoid (resolution = 2^-11). ISO 23150:2022(E): Orientation {yaw, pitch, roll} (A.2.17)";
CM_ SG_ 131 VFC_Cloth03_Width "Width of the line. ISO 23150:2022(E): Extent {width} - polynomial (A.2.121)";
CM_ SG_ 131 VFC_Cloth03_Type "Type of the Line. ISO 23150:2022(E): Road marking type (A.2.91)";
CM_ SG_ 131 VFC_Cloth04_LaneAssociation "Position relative to the ego lane. ISO 23150:2022(E): Road object lane association (A.2.93)";
CM_ SG_ 131 VFC_Cloth04_Colour "The color of the line. Similar to ISO 23150:2022(E): Colour value - object level (A.2.107)";
CM_ SG_ 131 VFC_Cloth04_RangeXBegin "Longitudinal begin of the clothoid. ISO 23150:2022(E): Polynomial range x {begin, end} (A.2.120)";
CM_ SG_ 131 VFC_Cloth04_RangeXEnd "Longitudinal end of the clothoid. ISO 23150:2022(E): Polynomial range x {begin, end} (A.2.120)";
CM_ SG_ 131 VFC_Cloth04_ExistProb "Confidence for this clothoid, probability that it describes the true lane boundary. ISO 23150:2022(E): Existence probability - object level (A.2.1)";
CM_ SG_ 131 VFC_Cloth04_CurvChange "Curvature change or alteration of the clothoid, also called kappaDt (resolution = 2^-29)";
CM_ SG_ 131 VFC_Cloth04_Curv "Curvature of the clothoid, also called kappa (resolution = 2^-18)";
CM_ SG_ 131 VFC_Cloth04_PyStdDev "Standard deviation at x=0 of the lateral offset (resolution = 2^-7)";
CM_ SG_ 131 VFC_Cloth04_Py "Lateral offset at x=0, also called LatDeviation (resolution = 2^-7)";
CM_ SG_ 131 VFC_Cloth04_OrientationYaw "Heading angle, difference in yaw angle between vehicle heading and clothoid (resolution = 2^-11). ISO 23150:2022(E): Orientation {yaw, pitch, roll} (A.2.17)";
CM_ SG_ 131 VFC_Cloth04_Width "Width of the line. ISO 23150:2022(E): Extent {width} - polynomial (A.2.121)";
CM_ SG_ 131 VFC_Cloth04_Type "Type of the Line. ISO 23150:2022(E): Road marking type (A.2.91)";
CM_ SG_ 131 VFC_Cloth05_LaneAssociation "Position relative to the ego lane. ISO 23150:2022(E): Road object lane association (A.2.93)";
CM_ SG_ 131 VFC_Cloth05_Colour "The color of the line. Similar to ISO 23150:2022(E): Colour value - object level (A.2.107)";
CM_ SG_ 131 VFC_Cloth05_RangeXBegin "Longitudinal begin of the clothoid. ISO 23150:2022(E): Polynomial range x {begin, end} (A.2.120)";
CM_ SG_ 131 VFC_Cloth05_RangeXEnd "Longitudinal end of the clothoid. ISO 23150:2022(E): Polynomial range x {begin, end} (A.2.120)";
CM_ SG_ 131 VFC_Cloth05_ExistProb "Confidence for this clothoid, probability that it describes the true lane boundary. ISO 23150:2022(E): Existence probability - object level (A.2.1)";
CM_ SG_ 131 VFC_Cloth05_CurvChange "Curvature change or alteration of the clothoid, also called kappaDt (resolution = 2^-29)";
CM_ SG_ 131 VFC_Cloth05_Curv "Curvature of the clothoid, also called kappa (resolution = 2^-18)";
CM_ SG_ 131 VFC_Cloth05_PyStdDev "Standard deviation at x=0 of the lateral offset (resolution = 2^-7)";
CM_ SG_ 131 VFC_Cloth05_Py "Lateral offset at x=0, also called LatDeviation (resolution = 2^-7)";
CM_ SG_ 131 VFC_Cloth05_OrientationYaw "Heading angle, difference in yaw angle between vehicle heading and clothoid (resolution = 2^-11). ISO 23150:2022(E): Orientation {yaw, pitch, roll} (A.2.17)";
CM_ SG_ 131 VFC_Cloth05_Width "Width of the line. ISO 23150:2022(E): Extent {width} - polynomial (A.2.121)";
CM_ SG_ 131 VFC_Cloth05_Type "Type of the Line. ISO 23150:2022(E): Road marking type (A.2.91)";
CM_ SG_ 132 VFC_Cloth_06_08_CRC "CRC - Autosar E2E Profile 5";
CM_ SG_ 132 VFC_Cloth_06_08_AliveCtr "Alive counter - Autosar E2E Profile 5";
CM_ SG_ 132 VFC_Cloth_06_08_ProtBlockCtr "Protocol-Signal: Block-Counter";
CM_ SG_ 132 VFC_Cloth06_LaneAssociation "Position relative to the ego lane. ISO 23150:2022(E): Road object lane association (A.2.93)";
CM_ SG_ 132 VFC_Cloth06_Colour "The color of the line. Similar to ISO 23150:2022(E): Colour value - object level (A.2.107)";
CM_ SG_ 132 VFC_Cloth06_RangeXBegin "Longitudinal begin of the clothoid. ISO 23150:2022(E): Polynomial range x {begin, end} (A.2.120)";
CM_ SG_ 132 VFC_Cloth06_RangeXEnd "Longitudinal end of the clothoid. ISO 23150:2022(E): Polynomial range x {begin, end} (A.2.120)";
CM_ SG_ 132 VFC_Cloth06_ExistProb "Confidence for this clothoid, probability that it describes the true lane boundary. ISO 23150:2022(E): Existence probability - object level (A.2.1)";
CM_ SG_ 132 VFC_Cloth06_CurvChange "Curvature change or alteration of the clothoid, also called kappaDt (resolution = 2^-29)";
CM_ SG_ 132 VFC_Cloth06_Curv "Curvature of the clothoid, also called kappa (resolution = 2^-18)";
CM_ SG_ 132 VFC_Cloth06_PyStdDev "Standard deviation at x=0 of the lateral offset (resolution = 2^-7)";
CM_ SG_ 132 VFC_Cloth06_Py "Lateral offset at x=0, also called LatDeviation (resolution = 2^-7)";
CM_ SG_ 132 VFC_Cloth06_OrientationYaw "Heading angle, difference in yaw angle between vehicle heading and clothoid (resolution = 2^-11). ISO 23150:2022(E): Orientation {yaw, pitch, roll} (A.2.17)";
CM_ SG_ 132 VFC_Cloth06_Width "Width of the line. ISO 23150:2022(E): Extent {width} - polynomial (A.2.121)";
CM_ SG_ 132 VFC_Cloth06_Type "Type of the Line. ISO 23150:2022(E): Road marking type (A.2.91)";
CM_ SG_ 132 VFC_Cloth07_LaneAssociation "Position relative to the ego lane. ISO 23150:2022(E): Road object lane association (A.2.93)";
CM_ SG_ 132 VFC_Cloth07_Colour "The color of the line. Similar to ISO 23150:2022(E): Colour value - object level (A.2.107)";
CM_ SG_ 132 VFC_Cloth07_RangeXBegin "Longitudinal begin of the clothoid. ISO 23150:2022(E): Polynomial range x {begin, end} (A.2.120)";
CM_ SG_ 132 VFC_Cloth07_RangeXEnd "Longitudinal end of the clothoid. ISO 23150:2022(E): Polynomial range x {begin, end} (A.2.120)";
CM_ SG_ 132 VFC_Cloth07_ExistProb "Confidence for this clothoid, probability that it describes the true lane boundary. ISO 23150:2022(E): Existence probability - object level (A.2.1)";
CM_ SG_ 132 VFC_Cloth07_CurvChange "Curvature change or alteration of the clothoid, also called kappaDt (resolution = 2^-29)";
CM_ SG_ 132 VFC_Cloth07_Curv "Curvature of the clothoid, also called kappa (resolution = 2^-18)";
CM_ SG_ 132 VFC_Cloth07_PyStdDev "Standard deviation at x=0 of the lateral offset (resolution = 2^-7)";
CM_ SG_ 132 VFC_Cloth07_Py "Lateral offset at x=0, also called LatDeviation (resolution = 2^-7)";
CM_ SG_ 132 VFC_Cloth07_OrientationYaw "Heading angle, difference in yaw angle between vehicle heading and clothoid (resolution = 2^-11). ISO 23150:2022(E): Orientation {yaw, pitch, roll} (A.2.17)";
CM_ SG_ 132 VFC_Cloth07_Width "Width of the line. ISO 23150:2022(E): Extent {width} - polynomial (A.2.121)";
CM_ SG_ 132 VFC_Cloth07_Type "Type of the Line. ISO 23150:2022(E): Road marking type (A.2.91)";
CM_ SG_ 132 VFC_Cloth08_LaneAssociation "Position relative to the ego lane. ISO 23150:2022(E): Road object lane association (A.2.93)";
CM_ SG_ 132 VFC_Cloth08_Colour "The color of the line. Similar to ISO 23150:2022(E): Colour value - object level (A.2.107)";
CM_ SG_ 132 VFC_Cloth08_RangeXBegin "Longitudinal begin of the clothoid. ISO 23150:2022(E): Polynomial range x {begin, end} (A.2.120)";
CM_ SG_ 132 VFC_Cloth08_RangeXEnd "Longitudinal end of the clothoid. ISO 23150:2022(E): Polynomial range x {begin, end} (A.2.120)";
CM_ SG_ 132 VFC_Cloth08_ExistProb "Confidence for this clothoid, probability that it describes the true lane boundary. ISO 23150:2022(E): Existence probability - object level (A.2.1)";
CM_ SG_ 132 VFC_Cloth08_CurvChange "Curvature change or alteration of the clothoid, also called kappaDt (resolution = 2^-29)";
CM_ SG_ 132 VFC_Cloth08_Curv "Curvature of the clothoid, also called kappa (resolution = 2^-18)";
CM_ SG_ 132 VFC_Cloth08_PyStdDev "Standard deviation at x=0 of the lateral offset (resolution = 2^-7)";
CM_ SG_ 132 VFC_Cloth08_Py "Lateral offset at x=0, also called LatDeviation (resolution = 2^-7)";
CM_ SG_ 132 VFC_Cloth08_OrientationYaw "Heading angle, difference in yaw angle between vehicle heading and clothoid (resolution = 2^-11). ISO 23150:2022(E): Orientation {yaw, pitch, roll} (A.2.17)";
CM_ SG_ 132 VFC_Cloth08_Width "Width of the line. ISO 23150:2022(E): Extent {width} - polynomial (A.2.121)";
CM_ SG_ 132 VFC_Cloth08_Type "Type of the Line. ISO 23150:2022(E): Road marking type (A.2.91)";
CM_ SG_ 133 VFC_Cloth_09_11_CRC "CRC - Autosar E2E Profile 5";
CM_ SG_ 133 VFC_Cloth_09_11_AliveCtr "Alive counter - Autosar E2E Profile 5";
CM_ SG_ 133 VFC_Cloth_09_11_ProtBlockCtr "Protocol-Signal: Block-Counter";
CM_ SG_ 133 VFC_Cloth09_LaneAssociation "Position relative to the ego lane. ISO 23150:2022(E): Road object lane association (A.2.93)";
CM_ SG_ 133 VFC_Cloth09_Colour "The color of the line. Similar to ISO 23150:2022(E): Colour value - object level (A.2.107)";
CM_ SG_ 133 VFC_Cloth09_RangeXBegin "Longitudinal begin of the clothoid. ISO 23150:2022(E): Polynomial range x {begin, end} (A.2.120)";
CM_ SG_ 133 VFC_Cloth09_RangeXEnd "Longitudinal end of the clothoid. ISO 23150:2022(E): Polynomial range x {begin, end} (A.2.120)";
CM_ SG_ 133 VFC_Cloth09_ExistProb "Confidence for this clothoid, probability that it describes the true lane boundary. ISO 23150:2022(E): Existence probability - object level (A.2.1)";
CM_ SG_ 133 VFC_Cloth09_CurvChange "Curvature change or alteration of the clothoid, also called kappaDt (resolution = 2^-29)";
CM_ SG_ 133 VFC_Cloth09_Curv "Curvature of the clothoid, also called kappa (resolution = 2^-18)";
CM_ SG_ 133 VFC_Cloth09_PyStdDev "Standard deviation at x=0 of the lateral offset (resolution = 2^-7)";
CM_ SG_ 133 VFC_Cloth09_Py "Lateral offset at x=0, also called LatDeviation (resolution = 2^-7)";
CM_ SG_ 133 VFC_Cloth09_OrientationYaw "Heading angle, difference in yaw angle between vehicle heading and clothoid (resolution = 2^-11). ISO 23150:2022(E): Orientation {yaw, pitch, roll} (A.2.17)";
CM_ SG_ 133 VFC_Cloth09_Width "Width of the line. ISO 23150:2022(E): Extent {width} - polynomial (A.2.121)";
CM_ SG_ 133 VFC_Cloth09_Type "Type of the Line. ISO 23150:2022(E): Road marking type (A.2.91)";
CM_ SG_ 133 VFC_Cloth10_LaneAssociation "Position relative to the ego lane. ISO 23150:2022(E): Road object lane association (A.2.93)";
CM_ SG_ 133 VFC_Cloth10_Colour "The color of the line. Similar to ISO 23150:2022(E): Colour value - object level (A.2.107)";
CM_ SG_ 133 VFC_Cloth10_RangeXBegin "Longitudinal begin of the clothoid. ISO 23150:2022(E): Polynomial range x {begin, end} (A.2.120)";
CM_ SG_ 133 VFC_Cloth10_RangeXEnd "Longitudinal end of the clothoid. ISO 23150:2022(E): Polynomial range x {begin, end} (A.2.120)";
CM_ SG_ 133 VFC_Cloth10_ExistProb "Confidence for this clothoid, probability that it describes the true lane boundary. ISO 23150:2022(E): Existence probability - object level (A.2.1)";
CM_ SG_ 133 VFC_Cloth10_CurvChange "Curvature change or alteration of the clothoid, also called kappaDt (resolution = 2^-29)";
CM_ SG_ 133 VFC_Cloth10_Curv "Curvature of the clothoid, also called kappa (resolution = 2^-18)";
CM_ SG_ 133 VFC_Cloth10_PyStdDev "Standard deviation at x=0 of the lateral offset (resolution = 2^-7)";
CM_ SG_ 133 VFC_Cloth10_Py "Lateral offset at x=0, also called LatDeviation (resolution = 2^-7)";
CM_ SG_ 133 VFC_Cloth10_OrientationYaw "Heading angle, difference in yaw angle between vehicle heading and clothoid (resolution = 2^-11). ISO 23150:2022(E): Orientation {yaw, pitch, roll} (A.2.17)";
CM_ SG_ 133 VFC_Cloth10_Width "Width of the line. ISO 23150:2022(E): Extent {width} - polynomial (A.2.121)";
CM_ SG_ 133 VFC_Cloth10_Type "Type of the Line. ISO 23150:2022(E): Road marking type (A.2.91)";
CM_ SG_ 133 VFC_Cloth11_LaneAssociation "Position relative to the ego lane. ISO 23150:2022(E): Road object lane association (A.2.93)";
CM_ SG_ 133 VFC_Cloth11_Colour "The color of the line. Similar to ISO 23150:2022(E): Colour value - object level (A.2.107)";
CM_ SG_ 133 VFC_Cloth11_RangeXBegin "Longitudinal begin of the clothoid. ISO 23150:2022(E): Polynomial range x {begin, end} (A.2.120)";
CM_ SG_ 133 VFC_Cloth11_RangeXEnd "Longitudinal end of the clothoid. ISO 23150:2022(E): Polynomial range x {begin, end} (A.2.120)";
CM_ SG_ 133 VFC_Cloth11_ExistProb "Confidence for this clothoid, probability that it describes the true lane boundary. ISO 23150:2022(E): Existence probability - object level (A.2.1)";
CM_ SG_ 133 VFC_Cloth11_CurvChange "Curvature change or alteration of the clothoid, also called kappaDt (resolution = 2^-29)";
CM_ SG_ 133 VFC_Cloth11_Curv "Curvature of the clothoid, also called kappa (resolution = 2^-18)";
CM_ SG_ 133 VFC_Cloth11_PyStdDev "Standard deviation at x=0 of the lateral offset (resolution = 2^-7)";
CM_ SG_ 133 VFC_Cloth11_Py "Lateral offset at x=0, also called LatDeviation (resolution = 2^-7)";
CM_ SG_ 133 VFC_Cloth11_OrientationYaw "Heading angle, difference in yaw angle between vehicle heading and clothoid (resolution = 2^-11). ISO 23150:2022(E): Orientation {yaw, pitch, roll} (A.2.17)";
CM_ SG_ 133 VFC_Cloth11_Width "Width of the line. ISO 23150:2022(E): Extent {width} - polynomial (A.2.121)";
CM_ SG_ 133 VFC_Cloth11_Type "Type of the Line. ISO 23150:2022(E): Road marking type (A.2.91)";
CM_ SG_ 146 VFC_Poly_00_02_CRC "CRC - Autosar E2E Profile 5";
CM_ SG_ 146 VFC_Poly_00_02_AliveCtr "Alive counter - Autosar E2E Profile 5";
CM_ SG_ 146 VFC_Poly_00_02_ProtBlockCtr "Protocol-Signal: Block-Counter";
CM_ SG_ 146 VFC_Poly00_LaneAssociation "Position relative to the ego lane. ISO 23150:2022(E): Road object lane association (A.2.93)";
CM_ SG_ 146 VFC_Poly00_Type "Type of the Line. ISO 23150:2022(E): Road marking type (A.2.91)";
CM_ SG_ 146 VFC_Poly00_ExistProb "Confidence for this line, probability that it describes the true lane boundary. ISO 23150:2022(E): Existence probability - object level (A.2.1)";
CM_ SG_ 146 VFC_Poly00_CoefficientYc3 "c3 coefficient of the  lateral polynomial.(resolution = 2^-26)  ISO 23150:2022(E): Polynomial coefficient y {c0,c1,c2,c3} (A.2.116)";
CM_ SG_ 146 VFC_Poly00_Colour "The color of the line. Similar to ISO 23150:2022(E): Colour value - object level (A.2.107)";
CM_ SG_ 146 VFC_Poly00_CoefficientYc2 "c2 coefficient of  the  lateral polynomial.(resolution = 2^-20) ISO 23150:2022(E): Polynomial coefficient y {c0,c1,c2,c3} (A.2.116)";
CM_ SG_ 146 VFC_Poly00_CoefficientYc0 "c0 coefficient of the lateral polynomial. (resolution = 2^-7) ISO 23150:2022(E): Polynomial coefficient y {c0,c1,c2,c3} (A.2.116)";
CM_ SG_ 146 VFC_Poly00_CoefficientYc1 "c1 coefficient of  the lateral polynomial. (resolution = 2^-14) ISO 23150:2022(E): Polynomial coefficient y {c0,c1,c2,c3} (A.2.116)";
CM_ SG_ 146 VFC_Poly00_CoefficientYc2Corr "c2 correction coefficient for lateral polynomial. (resolution = 2^-20) If X > XCorrectionPoint then Yc2Corr*(X-XCorrectionPoint)^2 shall be added to Y value. Deviation form ISO 23150:2022(E) polynomial representation";
CM_ SG_ 146 VFC_Poly00_CoefficientYc3Corr "c3 correction coefficient for lateral polynomial. (resolution = 2^-26) If X > XCorrectionPoint then Yc3Corr*(X-XCorrectionPoint)^3 shall be added to Y value. Deviation form 23150:2022(E) polynomial representation";
CM_ SG_ 146 VFC_Poly00_Width "Width of the line. ISO 23150:2022(E): Extent {width} - polynomial (A.2.121)";
CM_ SG_ 146 VFC_Poly00_RangeXCorrectionPoint "Transition point along the X axis the correction parameters shall be applied on the polynomial.  ISO 23150:2022(E): Polynomial range x {begin, end} (A.2.120)";
CM_ SG_ 146 VFC_Poly00_RangeXBegin "Longitudinal begin of the polynomial. ISO 23150:2022(E): Polynomial range x {begin, end} (A.2.120)";
CM_ SG_ 146 VFC_Poly00_Reserved0 "Reserved for future use";
CM_ SG_ 146 VFC_Poly00_RangeXEnd "Longitudinal end of the polynomial. ISO 23150:2022(E): Polynomial range x {begin, end} (A.2.120)";
CM_ SG_ 146 VFC_Poly00_Reserved1 "Reserved for future use";
CM_ SG_ 146 VFC_Poly01_LaneAssociation "Position relative to the ego lane. ISO 23150:2022(E): Road object lane association (A.2.93)";
CM_ SG_ 146 VFC_Poly01_Type "Type of the Line. ISO 23150:2022(E): Road marking type (A.2.91)";
CM_ SG_ 146 VFC_Poly01_ExistProb "Confidence for this line, probability that it describes the true lane boundary. ISO 23150:2022(E): Existence probability - object level (A.2.1)";
CM_ SG_ 146 VFC_Poly01_CoefficientYc3 "c3 coefficient of the  lateral polynomial.(resolution = 2^-26)  ISO 23150:2022(E): Polynomial coefficient y {c0,c1,c2,c3} (A.2.116)";
CM_ SG_ 146 VFC_Poly01_Colour "The color of the line. Similar to ISO 23150:2022(E): Colour value - object level (A.2.107)";
CM_ SG_ 146 VFC_Poly01_CoefficientYc2 "c2 coefficient of  the  lateral polynomial.(resolution = 2^-20) ISO 23150:2022(E): Polynomial coefficient y {c0,c1,c2,c3} (A.2.116)";
CM_ SG_ 146 VFC_Poly01_CoefficientYc0 "c0 coefficient of the lateral polynomial. (resolution = 2^-7) ISO 23150:2022(E): Polynomial coefficient y {c0,c1,c2,c3} (A.2.116)";
CM_ SG_ 146 VFC_Poly01_CoefficientYc1 "c1 coefficient of  the lateral polynomial. (resolution = 2^-14) ISO 23150:2022(E): Polynomial coefficient y {c0,c1,c2,c3} (A.2.116)";
CM_ SG_ 146 VFC_Poly01_CoefficientYc2Corr "c2 correction coefficient for lateral polynomial. (resolution = 2^-20) If X > XCorrectionPoint then Yc2Corr*(X-XCorrectionPoint)^2 shall be added to Y value. Deviation form ISO 23150:2022(E) polynomial representation";
CM_ SG_ 146 VFC_Poly01_CoefficientYc3Corr "c3 correction coefficient for lateral polynomial. (resolution = 2^-26) If X > XCorrectionPoint then Yc3Corr*(X-XCorrectionPoint)^3 shall be added to Y value. Deviation form 23150:2022(E) polynomial representation";
CM_ SG_ 146 VFC_Poly01_Width "Width of the line. ISO 23150:2022(E): Extent {width} - polynomial (A.2.121)";
CM_ SG_ 146 VFC_Poly01_RangeXCorrectionPoint "Transition point along the X axis the correction parameters shall be applied on the polynomial.  ISO 23150:2022(E): Polynomial range x {begin, end} (A.2.120)";
CM_ SG_ 146 VFC_Poly01_RangeXBegin "Longitudinal begin of the polynomial. ISO 23150:2022(E): Polynomial range x {begin, end} (A.2.120)";
CM_ SG_ 146 VFC_Poly01_Reserved0 "Reserved for future use";
CM_ SG_ 146 VFC_Poly01_RangeXEnd "Longitudinal end of the polynomial. ISO 23150:2022(E): Polynomial range x {begin, end} (A.2.120)";
CM_ SG_ 146 VFC_Poly01_Reserved1 "Reserved for future use";
CM_ SG_ 146 VFC_Poly02_LaneAssociation "Position relative to the ego lane. ISO 23150:2022(E): Road object lane association (A.2.93)";
CM_ SG_ 146 VFC_Poly02_Type "Type of the Line. ISO 23150:2022(E): Road marking type (A.2.91)";
CM_ SG_ 146 VFC_Poly02_ExistProb "Confidence for this line, probability that it describes the true lane boundary. ISO 23150:2022(E): Existence probability - object level (A.2.1)";
CM_ SG_ 146 VFC_Poly02_CoefficientYc3 "c3 coefficient of the  lateral polynomial.(resolution = 2^-26)  ISO 23150:2022(E): Polynomial coefficient y {c0,c1,c2,c3} (A.2.116)";
CM_ SG_ 146 VFC_Poly02_Colour "The color of the line. Similar to ISO 23150:2022(E): Colour value - object level (A.2.107)";
CM_ SG_ 146 VFC_Poly02_CoefficientYc2 "c2 coefficient of  the  lateral polynomial.(resolution = 2^-20) ISO 23150:2022(E): Polynomial coefficient y {c0,c1,c2,c3} (A.2.116)";
CM_ SG_ 146 VFC_Poly02_CoefficientYc0 "c0 coefficient of the lateral polynomial. (resolution = 2^-7) ISO 23150:2022(E): Polynomial coefficient y {c0,c1,c2,c3} (A.2.116)";
CM_ SG_ 146 VFC_Poly02_CoefficientYc1 "c1 coefficient of  the lateral polynomial. (resolution = 2^-14) ISO 23150:2022(E): Polynomial coefficient y {c0,c1,c2,c3} (A.2.116)";
CM_ SG_ 146 VFC_Poly02_CoefficientYc2Corr "c2 correction coefficient for lateral polynomial. (resolution = 2^-20) If X > XCorrectionPoint then Yc2Corr*(X-XCorrectionPoint)^2 shall be added to Y value. Deviation form ISO 23150:2022(E) polynomial representation";
CM_ SG_ 146 VFC_Poly02_CoefficientYc3Corr "c3 correction coefficient for lateral polynomial. (resolution = 2^-26) If X > XCorrectionPoint then Yc3Corr*(X-XCorrectionPoint)^3 shall be added to Y value. Deviation form 23150:2022(E) polynomial representation";
CM_ SG_ 146 VFC_Poly02_Width "Width of the line. ISO 23150:2022(E): Extent {width} - polynomial (A.2.121)";
CM_ SG_ 146 VFC_Poly02_RangeXCorrectionPoint "Transition point along the X axis the correction parameters shall be applied on the polynomial.  ISO 23150:2022(E): Polynomial range x {begin, end} (A.2.120)";
CM_ SG_ 146 VFC_Poly02_RangeXBegin "Longitudinal begin of the polynomial. ISO 23150:2022(E): Polynomial range x {begin, end} (A.2.120)";
CM_ SG_ 146 VFC_Poly02_Reserved0 "Reserved for future use";
CM_ SG_ 146 VFC_Poly02_RangeXEnd "Longitudinal end of the polynomial. ISO 23150:2022(E): Polynomial range x {begin, end} (A.2.120)";
CM_ SG_ 146 VFC_Poly02_Reserved1 "Reserved for future use";
CM_ SG_ 147 VFC_Poly_03_05_CRC "CRC - Autosar E2E Profile 5";
CM_ SG_ 147 VFC_Poly_03_05_AliveCtr "Alive counter - Autosar E2E Profile 5";
CM_ SG_ 147 VFC_Poly_03_05_ProtBlockCtr "Protocol-Signal: Block-Counter";
CM_ SG_ 147 VFC_Poly03_LaneAssociation "Position relative to the ego lane. ISO 23150:2022(E): Road object lane association (A.2.93)";
CM_ SG_ 147 VFC_Poly03_Type "Type of the Line. ISO 23150:2022(E): Road marking type (A.2.91)";
CM_ SG_ 147 VFC_Poly03_ExistProb "Confidence for this line, probability that it describes the true lane boundary. ISO 23150:2022(E): Existence probability - object level (A.2.1)";
CM_ SG_ 147 VFC_Poly03_CoefficientYc3 "c3 coefficient of the  lateral polynomial.(resolution = 2^-26)  ISO 23150:2022(E): Polynomial coefficient y {c0,c1,c2,c3} (A.2.116)";
CM_ SG_ 147 VFC_Poly03_Colour "The color of the line. Similar to ISO 23150:2022(E): Colour value - object level (A.2.107)";
CM_ SG_ 147 VFC_Poly03_CoefficientYc2 "c2 coefficient of  the  lateral polynomial.(resolution = 2^-20) ISO 23150:2022(E): Polynomial coefficient y {c0,c1,c2,c3} (A.2.116)";
CM_ SG_ 147 VFC_Poly03_CoefficientYc0 "c0 coefficient of the lateral polynomial. (resolution = 2^-7) ISO 23150:2022(E): Polynomial coefficient y {c0,c1,c2,c3} (A.2.116)";
CM_ SG_ 147 VFC_Poly03_CoefficientYc1 "c1 coefficient of  the lateral polynomial. (resolution = 2^-14) ISO 23150:2022(E): Polynomial coefficient y {c0,c1,c2,c3} (A.2.116)";
CM_ SG_ 147 VFC_Poly03_CoefficientYc2Corr "c2 correction coefficient for lateral polynomial. (resolution = 2^-20) If X > XCorrectionPoint then Yc2Corr*(X-XCorrectionPoint)^2 shall be added to Y value. Deviation form ISO 23150:2022(E) polynomial representation";
CM_ SG_ 147 VFC_Poly03_CoefficientYc3Corr "c3 correction coefficient for lateral polynomial. (resolution = 2^-26) If X > XCorrectionPoint then Yc3Corr*(X-XCorrectionPoint)^3 shall be added to Y value. Deviation form 23150:2022(E) polynomial representation";
CM_ SG_ 147 VFC_Poly03_Width "Width of the line. ISO 23150:2022(E): Extent {width} - polynomial (A.2.121)";
CM_ SG_ 147 VFC_Poly03_RangeXCorrectionPoint "Transition point along the X axis the correction parameters shall be applied on the polynomial.  ISO 23150:2022(E): Polynomial range x {begin, end} (A.2.120)";
CM_ SG_ 147 VFC_Poly03_RangeXBegin "Longitudinal begin of the polynomial. ISO 23150:2022(E): Polynomial range x {begin, end} (A.2.120)";
CM_ SG_ 147 VFC_Poly03_Reserved0 "Reserved for future use";
CM_ SG_ 147 VFC_Poly03_RangeXEnd "Longitudinal end of the polynomial. ISO 23150:2022(E): Polynomial range x {begin, end} (A.2.120)";
CM_ SG_ 147 VFC_Poly03_Reserved1 "Reserved for future use";
CM_ SG_ 147 VFC_Poly04_LaneAssociation "Position relative to the ego lane. ISO 23150:2022(E): Road object lane association (A.2.93)";
CM_ SG_ 147 VFC_Poly04_Type "Type of the Line. ISO 23150:2022(E): Road marking type (A.2.91)";
CM_ SG_ 147 VFC_Poly04_ExistProb "Confidence for this line, probability that it describes the true lane boundary. ISO 23150:2022(E): Existence probability - object level (A.2.1)";
CM_ SG_ 147 VFC_Poly04_CoefficientYc3 "c3 coefficient of the  lateral polynomial.(resolution = 2^-26)  ISO 23150:2022(E): Polynomial coefficient y {c0,c1,c2,c3} (A.2.116)";
CM_ SG_ 147 VFC_Poly04_Colour "The color of the line. Similar to ISO 23150:2022(E): Colour value - object level (A.2.107)";
CM_ SG_ 147 VFC_Poly04_CoefficientYc2 "c2 coefficient of  the  lateral polynomial.(resolution = 2^-20) ISO 23150:2022(E): Polynomial coefficient y {c0,c1,c2,c3} (A.2.116)";
CM_ SG_ 147 VFC_Poly04_CoefficientYc0 "c0 coefficient of the lateral polynomial. (resolution = 2^-7) ISO 23150:2022(E): Polynomial coefficient y {c0,c1,c2,c3} (A.2.116)";
CM_ SG_ 147 VFC_Poly04_CoefficientYc1 "c1 coefficient of  the lateral polynomial. (resolution = 2^-14) ISO 23150:2022(E): Polynomial coefficient y {c0,c1,c2,c3} (A.2.116)";
CM_ SG_ 147 VFC_Poly04_CoefficientYc2Corr "c2 correction coefficient for lateral polynomial. (resolution = 2^-20) If X > XCorrectionPoint then Yc2Corr*(X-XCorrectionPoint)^2 shall be added to Y value. Deviation form ISO 23150:2022(E) polynomial representation";
CM_ SG_ 147 VFC_Poly04_CoefficientYc3Corr "c3 correction coefficient for lateral polynomial. (resolution = 2^-26) If X > XCorrectionPoint then Yc3Corr*(X-XCorrectionPoint)^3 shall be added to Y value. Deviation form 23150:2022(E) polynomial representation";
CM_ SG_ 147 VFC_Poly04_Width "Width of the line. ISO 23150:2022(E): Extent {width} - polynomial (A.2.121)";
CM_ SG_ 147 VFC_Poly04_RangeXCorrectionPoint "Transition point along the X axis the correction parameters shall be applied on the polynomial.  ISO 23150:2022(E): Polynomial range x {begin, end} (A.2.120)";
CM_ SG_ 147 VFC_Poly04_RangeXBegin "Longitudinal begin of the polynomial. ISO 23150:2022(E): Polynomial range x {begin, end} (A.2.120)";
CM_ SG_ 147 VFC_Poly04_Reserved0 "Reserved for future use";
CM_ SG_ 147 VFC_Poly04_RangeXEnd "Longitudinal end of the polynomial. ISO 23150:2022(E): Polynomial range x {begin, end} (A.2.120)";
CM_ SG_ 147 VFC_Poly04_Reserved1 "Reserved for future use";
CM_ SG_ 147 VFC_Poly05_LaneAssociation "Position relative to the ego lane. ISO 23150:2022(E): Road object lane association (A.2.93)";
CM_ SG_ 147 VFC_Poly05_Type "Type of the Line. ISO 23150:2022(E): Road marking type (A.2.91)";
CM_ SG_ 147 VFC_Poly05_ExistProb "Confidence for this line, probability that it describes the true lane boundary. ISO 23150:2022(E): Existence probability - object level (A.2.1)";
CM_ SG_ 147 VFC_Poly05_CoefficientYc3 "c3 coefficient of the  lateral polynomial.(resolution = 2^-26)  ISO 23150:2022(E): Polynomial coefficient y {c0,c1,c2,c3} (A.2.116)";
CM_ SG_ 147 VFC_Poly05_Colour "The color of the line. Similar to ISO 23150:2022(E): Colour value - object level (A.2.107)";
CM_ SG_ 147 VFC_Poly05_CoefficientYc2 "c2 coefficient of  the  lateral polynomial.(resolution = 2^-20) ISO 23150:2022(E): Polynomial coefficient y {c0,c1,c2,c3} (A.2.116)";
CM_ SG_ 147 VFC_Poly05_CoefficientYc0 "c0 coefficient of the lateral polynomial. (resolution = 2^-7) ISO 23150:2022(E): Polynomial coefficient y {c0,c1,c2,c3} (A.2.116)";
CM_ SG_ 147 VFC_Poly05_CoefficientYc1 "c1 coefficient of  the lateral polynomial. (resolution = 2^-14) ISO 23150:2022(E): Polynomial coefficient y {c0,c1,c2,c3} (A.2.116)";
CM_ SG_ 147 VFC_Poly05_CoefficientYc2Corr "c2 correction coefficient for lateral polynomial. (resolution = 2^-20) If X > XCorrectionPoint then Yc2Corr*(X-XCorrectionPoint)^2 shall be added to Y value. Deviation form ISO 23150:2022(E) polynomial representation";
CM_ SG_ 147 VFC_Poly05_CoefficientYc3Corr "c3 correction coefficient for lateral polynomial. (resolution = 2^-26) If X > XCorrectionPoint then Yc3Corr*(X-XCorrectionPoint)^3 shall be added to Y value. Deviation form 23150:2022(E) polynomial representation";
CM_ SG_ 147 VFC_Poly05_Width "Width of the line. ISO 23150:2022(E): Extent {width} - polynomial (A.2.121)";
CM_ SG_ 147 VFC_Poly05_RangeXCorrectionPoint "Transition point along the X axis the correction parameters shall be applied on the polynomial.  ISO 23150:2022(E): Polynomial range x {begin, end} (A.2.120)";
CM_ SG_ 147 VFC_Poly05_RangeXBegin "Longitudinal begin of the polynomial. ISO 23150:2022(E): Polynomial range x {begin, end} (A.2.120)";
CM_ SG_ 147 VFC_Poly05_Reserved0 "Reserved for future use";
CM_ SG_ 147 VFC_Poly05_RangeXEnd "Longitudinal end of the polynomial. ISO 23150:2022(E): Polynomial range x {begin, end} (A.2.120)";
CM_ SG_ 147 VFC_Poly05_Reserved1 "Reserved for future use";
CM_ SG_ 148 VFC_Poly_06_08_CRC "CRC - Autosar E2E Profile 5";
CM_ SG_ 148 VFC_Poly_06_08_AliveCtr "Alive counter - Autosar E2E Profile 5";
CM_ SG_ 148 VFC_Poly_06_08_ProtBlockCtr "Protocol-Signal: Block-Counter";
CM_ SG_ 148 VFC_Poly06_LaneAssociation "Position relative to the ego lane. ISO 23150:2022(E): Road object lane association (A.2.93)";
CM_ SG_ 148 VFC_Poly06_Type "Type of the Line. ISO 23150:2022(E): Road marking type (A.2.91)";
CM_ SG_ 148 VFC_Poly06_ExistProb "Confidence for this line, probability that it describes the true lane boundary. ISO 23150:2022(E): Existence probability - object level (A.2.1)";
CM_ SG_ 148 VFC_Poly06_CoefficientYc3 "c3 coefficient of the  lateral polynomial.(resolution = 2^-26)  ISO 23150:2022(E): Polynomial coefficient y {c0,c1,c2,c3} (A.2.116)";
CM_ SG_ 148 VFC_Poly06_Colour "The color of the line. Similar to ISO 23150:2022(E): Colour value - object level (A.2.107)";
CM_ SG_ 148 VFC_Poly06_CoefficientYc2 "c2 coefficient of  the  lateral polynomial.(resolution = 2^-20) ISO 23150:2022(E): Polynomial coefficient y {c0,c1,c2,c3} (A.2.116)";
CM_ SG_ 148 VFC_Poly06_CoefficientYc0 "c0 coefficient of the lateral polynomial. (resolution = 2^-7) ISO 23150:2022(E): Polynomial coefficient y {c0,c1,c2,c3} (A.2.116)";
CM_ SG_ 148 VFC_Poly06_CoefficientYc1 "c1 coefficient of  the lateral polynomial. (resolution = 2^-14) ISO 23150:2022(E): Polynomial coefficient y {c0,c1,c2,c3} (A.2.116)";
CM_ SG_ 148 VFC_Poly06_CoefficientYc2Corr "c2 correction coefficient for lateral polynomial. (resolution = 2^-20) If X > XCorrectionPoint then Yc2Corr*(X-XCorrectionPoint)^2 shall be added to Y value. Deviation form ISO 23150:2022(E) polynomial representation";
CM_ SG_ 148 VFC_Poly06_CoefficientYc3Corr "c3 correction coefficient for lateral polynomial. (resolution = 2^-26) If X > XCorrectionPoint then Yc3Corr*(X-XCorrectionPoint)^3 shall be added to Y value. Deviation form 23150:2022(E) polynomial representation";
CM_ SG_ 148 VFC_Poly06_Width "Width of the line. ISO 23150:2022(E): Extent {width} - polynomial (A.2.121)";
CM_ SG_ 148 VFC_Poly06_RangeXCorrectionPoint "Transition point along the X axis the correction parameters shall be applied on the polynomial.  ISO 23150:2022(E): Polynomial range x {begin, end} (A.2.120)";
CM_ SG_ 148 VFC_Poly06_RangeXBegin "Longitudinal begin of the polynomial. ISO 23150:2022(E): Polynomial range x {begin, end} (A.2.120)";
CM_ SG_ 148 VFC_Poly06_Reserved0 "Reserved for future use";
CM_ SG_ 148 VFC_Poly06_RangeXEnd "Longitudinal end of the polynomial. ISO 23150:2022(E): Polynomial range x {begin, end} (A.2.120)";
CM_ SG_ 148 VFC_Poly06_Reserved1 "Reserved for future use";
CM_ SG_ 148 VFC_Poly07_LaneAssociation "Position relative to the ego lane. ISO 23150:2022(E): Road object lane association (A.2.93)";
CM_ SG_ 148 VFC_Poly07_Type "Type of the Line. ISO 23150:2022(E): Road marking type (A.2.91)";
CM_ SG_ 148 VFC_Poly07_ExistProb "Confidence for this line, probability that it describes the true lane boundary. ISO 23150:2022(E): Existence probability - object level (A.2.1)";
CM_ SG_ 148 VFC_Poly07_CoefficientYc3 "c3 coefficient of the  lateral polynomial.(resolution = 2^-26)  ISO 23150:2022(E): Polynomial coefficient y {c0,c1,c2,c3} (A.2.116)";
CM_ SG_ 148 VFC_Poly07_Colour "The color of the line. Similar to ISO 23150:2022(E): Colour value - object level (A.2.107)";
CM_ SG_ 148 VFC_Poly07_CoefficientYc2 "c2 coefficient of  the  lateral polynomial.(resolution = 2^-20) ISO 23150:2022(E): Polynomial coefficient y {c0,c1,c2,c3} (A.2.116)";
CM_ SG_ 148 VFC_Poly07_CoefficientYc0 "c0 coefficient of the lateral polynomial. (resolution = 2^-7) ISO 23150:2022(E): Polynomial coefficient y {c0,c1,c2,c3} (A.2.116)";
CM_ SG_ 148 VFC_Poly07_CoefficientYc1 "c1 coefficient of  the lateral polynomial. (resolution = 2^-14) ISO 23150:2022(E): Polynomial coefficient y {c0,c1,c2,c3} (A.2.116)";
CM_ SG_ 148 VFC_Poly07_CoefficientYc2Corr "c2 correction coefficient for lateral polynomial. (resolution = 2^-20) If X > XCorrectionPoint then Yc2Corr*(X-XCorrectionPoint)^2 shall be added to Y value. Deviation form ISO 23150:2022(E) polynomial representation";
CM_ SG_ 148 VFC_Poly07_CoefficientYc3Corr "c3 correction coefficient for lateral polynomial. (resolution = 2^-26) If X > XCorrectionPoint then Yc3Corr*(X-XCorrectionPoint)^3 shall be added to Y value. Deviation form 23150:2022(E) polynomial representation";
CM_ SG_ 148 VFC_Poly07_Width "Width of the line. ISO 23150:2022(E): Extent {width} - polynomial (A.2.121)";
CM_ SG_ 148 VFC_Poly07_RangeXCorrectionPoint "Transition point along the X axis the correction parameters shall be applied on the polynomial.  ISO 23150:2022(E): Polynomial range x {begin, end} (A.2.120)";
CM_ SG_ 148 VFC_Poly07_RangeXBegin "Longitudinal begin of the polynomial. ISO 23150:2022(E): Polynomial range x {begin, end} (A.2.120)";
CM_ SG_ 148 VFC_Poly07_Reserved0 "Reserved for future use";
CM_ SG_ 148 VFC_Poly07_RangeXEnd "Longitudinal end of the polynomial. ISO 23150:2022(E): Polynomial range x {begin, end} (A.2.120)";
CM_ SG_ 148 VFC_Poly07_Reserved1 "Reserved for future use";
CM_ SG_ 148 VFC_Poly08_LaneAssociation "Position relative to the ego lane. ISO 23150:2022(E): Road object lane association (A.2.93)";
CM_ SG_ 148 VFC_Poly08_Type "Type of the Line. ISO 23150:2022(E): Road marking type (A.2.91)";
CM_ SG_ 148 VFC_Poly08_ExistProb "Confidence for this line, probability that it describes the true lane boundary. ISO 23150:2022(E): Existence probability - object level (A.2.1)";
CM_ SG_ 148 VFC_Poly08_CoefficientYc3 "c3 coefficient of the  lateral polynomial.(resolution = 2^-26)  ISO 23150:2022(E): Polynomial coefficient y {c0,c1,c2,c3} (A.2.116)";
CM_ SG_ 148 VFC_Poly08_Colour "The color of the line. Similar to ISO 23150:2022(E): Colour value - object level (A.2.107)";
CM_ SG_ 148 VFC_Poly08_CoefficientYc2 "c2 coefficient of  the  lateral polynomial.(resolution = 2^-20) ISO 23150:2022(E): Polynomial coefficient y {c0,c1,c2,c3} (A.2.116)";
CM_ SG_ 148 VFC_Poly08_CoefficientYc0 "c0 coefficient of the lateral polynomial. (resolution = 2^-7) ISO 23150:2022(E): Polynomial coefficient y {c0,c1,c2,c3} (A.2.116)";
CM_ SG_ 148 VFC_Poly08_CoefficientYc1 "c1 coefficient of  the lateral polynomial. (resolution = 2^-14) ISO 23150:2022(E): Polynomial coefficient y {c0,c1,c2,c3} (A.2.116)";
CM_ SG_ 148 VFC_Poly08_CoefficientYc2Corr "c2 correction coefficient for lateral polynomial. (resolution = 2^-20) If X > XCorrectionPoint then Yc2Corr*(X-XCorrectionPoint)^2 shall be added to Y value. Deviation form ISO 23150:2022(E) polynomial representation";
CM_ SG_ 148 VFC_Poly08_CoefficientYc3Corr "c3 correction coefficient for lateral polynomial. (resolution = 2^-26) If X > XCorrectionPoint then Yc3Corr*(X-XCorrectionPoint)^3 shall be added to Y value. Deviation form 23150:2022(E) polynomial representation";
CM_ SG_ 148 VFC_Poly08_Width "Width of the line. ISO 23150:2022(E): Extent {width} - polynomial (A.2.121)";
CM_ SG_ 148 VFC_Poly08_RangeXCorrectionPoint "Transition point along the X axis the correction parameters shall be applied on the polynomial.  ISO 23150:2022(E): Polynomial range x {begin, end} (A.2.120)";
CM_ SG_ 148 VFC_Poly08_RangeXBegin "Longitudinal begin of the polynomial. ISO 23150:2022(E): Polynomial range x {begin, end} (A.2.120)";
CM_ SG_ 148 VFC_Poly08_Reserved0 "Reserved for future use";
CM_ SG_ 148 VFC_Poly08_RangeXEnd "Longitudinal end of the polynomial. ISO 23150:2022(E): Polynomial range x {begin, end} (A.2.120)";
CM_ SG_ 148 VFC_Poly08_Reserved1 "Reserved for future use";
CM_ SG_ 149 VFC_Poly_09_11_CRC "CRC - Autosar E2E Profile 5";
CM_ SG_ 149 VFC_Poly_09_11_AliveCtr "Alive counter - Autosar E2E Profile 5";
CM_ SG_ 149 VFC_Poly_09_11_ProtBlockCtr "Protocol-Signal: Block-Counter";
CM_ SG_ 149 VFC_Poly09_LaneAssociation "Position relative to the ego lane. ISO 23150:2022(E): Road object lane association (A.2.93)";
CM_ SG_ 149 VFC_Poly09_Type "Type of the Line. ISO 23150:2022(E): Road marking type (A.2.91)";
CM_ SG_ 149 VFC_Poly09_ExistProb "Confidence for this line, probability that it describes the true lane boundary. ISO 23150:2022(E): Existence probability - object level (A.2.1)";
CM_ SG_ 149 VFC_Poly09_CoefficientYc3 "c3 coefficient of the  lateral polynomial.(resolution = 2^-26)  ISO 23150:2022(E): Polynomial coefficient y {c0,c1,c2,c3} (A.2.116)";
CM_ SG_ 149 VFC_Poly09_Colour "The color of the line. Similar to ISO 23150:2022(E): Colour value - object level (A.2.107)";
CM_ SG_ 149 VFC_Poly09_CoefficientYc2 "c2 coefficient of  the  lateral polynomial.(resolution = 2^-20) ISO 23150:2022(E): Polynomial coefficient y {c0,c1,c2,c3} (A.2.116)";
CM_ SG_ 149 VFC_Poly09_CoefficientYc0 "c0 coefficient of the lateral polynomial. (resolution = 2^-7) ISO 23150:2022(E): Polynomial coefficient y {c0,c1,c2,c3} (A.2.116)";
CM_ SG_ 149 VFC_Poly09_CoefficientYc1 "c1 coefficient of  the lateral polynomial. (resolution = 2^-14) ISO 23150:2022(E): Polynomial coefficient y {c0,c1,c2,c3} (A.2.116)";
CM_ SG_ 149 VFC_Poly09_CoefficientYc2Corr "c2 correction coefficient for lateral polynomial. (resolution = 2^-20) If X > XCorrectionPoint then Yc2Corr*(X-XCorrectionPoint)^2 shall be added to Y value. Deviation form ISO 23150:2022(E) polynomial representation";
CM_ SG_ 149 VFC_Poly09_CoefficientYc3Corr "c3 correction coefficient for lateral polynomial. (resolution = 2^-26) If X > XCorrectionPoint then Yc3Corr*(X-XCorrectionPoint)^3 shall be added to Y value. Deviation form 23150:2022(E) polynomial representation";
CM_ SG_ 149 VFC_Poly09_Width "Width of the line. ISO 23150:2022(E): Extent {width} - polynomial (A.2.121)";
CM_ SG_ 149 VFC_Poly09_RangeXCorrectionPoint "Transition point along the X axis the correction parameters shall be applied on the polynomial.  ISO 23150:2022(E): Polynomial range x {begin, end} (A.2.120)";
CM_ SG_ 149 VFC_Poly09_RangeXBegin "Longitudinal begin of the polynomial. ISO 23150:2022(E): Polynomial range x {begin, end} (A.2.120)";
CM_ SG_ 149 VFC_Poly09_Reserved0 "Reserved for future use";
CM_ SG_ 149 VFC_Poly09_RangeXEnd "Longitudinal end of the polynomial. ISO 23150:2022(E): Polynomial range x {begin, end} (A.2.120)";
CM_ SG_ 149 VFC_Poly09_Reserved1 "Reserved for future use";
CM_ SG_ 149 VFC_Poly10_LaneAssociation "Position relative to the ego lane. ISO 23150:2022(E): Road object lane association (A.2.93)";
CM_ SG_ 149 VFC_Poly10_Type "Type of the Line. ISO 23150:2022(E): Road marking type (A.2.91)";
CM_ SG_ 149 VFC_Poly10_ExistProb "Confidence for this line, probability that it describes the true lane boundary. ISO 23150:2022(E): Existence probability - object level (A.2.1)";
CM_ SG_ 149 VFC_Poly10_CoefficientYc3 "c3 coefficient of the  lateral polynomial.(resolution = 2^-26)  ISO 23150:2022(E): Polynomial coefficient y {c0,c1,c2,c3} (A.2.116)";
CM_ SG_ 149 VFC_Poly10_Colour "The color of the line. Similar to ISO 23150:2022(E): Colour value - object level (A.2.107)";
CM_ SG_ 149 VFC_Poly10_CoefficientYc2 "c2 coefficient of  the  lateral polynomial.(resolution = 2^-20) ISO 23150:2022(E): Polynomial coefficient y {c0,c1,c2,c3} (A.2.116)";
CM_ SG_ 149 VFC_Poly10_CoefficientYc0 "c0 coefficient of the lateral polynomial. (resolution = 2^-7) ISO 23150:2022(E): Polynomial coefficient y {c0,c1,c2,c3} (A.2.116)";
CM_ SG_ 149 VFC_Poly10_CoefficientYc1 "c1 coefficient of  the lateral polynomial. (resolution = 2^-14) ISO 23150:2022(E): Polynomial coefficient y {c0,c1,c2,c3} (A.2.116)";
CM_ SG_ 149 VFC_Poly10_CoefficientYc2Corr "c2 correction coefficient for lateral polynomial. (resolution = 2^-20) If X > XCorrectionPoint then Yc2Corr*(X-XCorrectionPoint)^2 shall be added to Y value. Deviation form ISO 23150:2022(E) polynomial representation";
CM_ SG_ 149 VFC_Poly10_CoefficientYc3Corr "c3 correction coefficient for lateral polynomial. (resolution = 2^-26) If X > XCorrectionPoint then Yc3Corr*(X-XCorrectionPoint)^3 shall be added to Y value. Deviation form 23150:2022(E) polynomial representation";
CM_ SG_ 149 VFC_Poly10_Width "Width of the line. ISO 23150:2022(E): Extent {width} - polynomial (A.2.121)";
CM_ SG_ 149 VFC_Poly10_RangeXCorrectionPoint "Transition point along the X axis the correction parameters shall be applied on the polynomial.  ISO 23150:2022(E): Polynomial range x {begin, end} (A.2.120)";
CM_ SG_ 149 VFC_Poly10_RangeXBegin "Longitudinal begin of the polynomial. ISO 23150:2022(E): Polynomial range x {begin, end} (A.2.120)";
CM_ SG_ 149 VFC_Poly10_Reserved0 "Reserved for future use";
CM_ SG_ 149 VFC_Poly10_RangeXEnd "Longitudinal end of the polynomial. ISO 23150:2022(E): Polynomial range x {begin, end} (A.2.120)";
CM_ SG_ 149 VFC_Poly10_Reserved1 "Reserved for future use";
CM_ SG_ 149 VFC_Poly11_LaneAssociation "Position relative to the ego lane. ISO 23150:2022(E): Road object lane association (A.2.93)";
CM_ SG_ 149 VFC_Poly11_Type "Type of the Line. ISO 23150:2022(E): Road marking type (A.2.91)";
CM_ SG_ 149 VFC_Poly11_ExistProb "Confidence for this line, probability that it describes the true lane boundary. ISO 23150:2022(E): Existence probability - object level (A.2.1)";
CM_ SG_ 149 VFC_Poly11_CoefficientYc3 "c3 coefficient of the  lateral polynomial.(resolution = 2^-26)  ISO 23150:2022(E): Polynomial coefficient y {c0,c1,c2,c3} (A.2.116)";
CM_ SG_ 149 VFC_Poly11_Colour "The color of the line. Similar to ISO 23150:2022(E): Colour value - object level (A.2.107)";
CM_ SG_ 149 VFC_Poly11_CoefficientYc2 "c2 coefficient of  the  lateral polynomial.(resolution = 2^-20) ISO 23150:2022(E): Polynomial coefficient y {c0,c1,c2,c3} (A.2.116)";
CM_ SG_ 149 VFC_Poly11_CoefficientYc0 "c0 coefficient of the lateral polynomial. (resolution = 2^-7) ISO 23150:2022(E): Polynomial coefficient y {c0,c1,c2,c3} (A.2.116)";
CM_ SG_ 149 VFC_Poly11_CoefficientYc1 "c1 coefficient of  the lateral polynomial. (resolution = 2^-14) ISO 23150:2022(E): Polynomial coefficient y {c0,c1,c2,c3} (A.2.116)";
CM_ SG_ 149 VFC_Poly11_CoefficientYc2Corr "c2 correction coefficient for lateral polynomial. (resolution = 2^-20) If X > XCorrectionPoint then Yc2Corr*(X-XCorrectionPoint)^2 shall be added to Y value. Deviation form ISO 23150:2022(E) polynomial representation";
CM_ SG_ 149 VFC_Poly11_CoefficientYc3Corr "c3 correction coefficient for lateral polynomial. (resolution = 2^-26) If X > XCorrectionPoint then Yc3Corr*(X-XCorrectionPoint)^3 shall be added to Y value. Deviation form 23150:2022(E) polynomial representation";
CM_ SG_ 149 VFC_Poly11_Width "Width of the line. ISO 23150:2022(E): Extent {width} - polynomial (A.2.121)";
CM_ SG_ 149 VFC_Poly11_RangeXCorrectionPoint "Transition point along the X axis the correction parameters shall be applied on the polynomial.  ISO 23150:2022(E): Polynomial range x {begin, end} (A.2.120)";
CM_ SG_ 149 VFC_Poly11_RangeXBegin "Longitudinal begin of the polynomial. ISO 23150:2022(E): Polynomial range x {begin, end} (A.2.120)";
CM_ SG_ 149 VFC_Poly11_Reserved0 "Reserved for future use";
CM_ SG_ 149 VFC_Poly11_RangeXEnd "Longitudinal end of the polynomial. ISO 23150:2022(E): Polynomial range x {begin, end} (A.2.120)";
CM_ SG_ 149 VFC_Poly11_Reserved1 "Reserved for future use";
CM_ SG_ 150 VFC_Poly_12_14_CRC "CRC - Autosar E2E Profile 5";
CM_ SG_ 150 VFC_Poly_12_14_AliveCtr "Alive counter - Autosar E2E Profile 5";
CM_ SG_ 150 VFC_Poly_12_14_ProtBlockCtr "Protocol-Signal: Block-Counter";
CM_ SG_ 150 VFC_Poly12_LaneAssociation "Position relative to the ego lane. ISO 23150:2022(E): Road object lane association (A.2.93)";
CM_ SG_ 150 VFC_Poly12_Type "Type of the Line. ISO 23150:2022(E): Road marking type (A.2.91)";
CM_ SG_ 150 VFC_Poly12_ExistProb "Confidence for this line, probability that it describes the true lane boundary. ISO 23150:2022(E): Existence probability - object level (A.2.1)";
CM_ SG_ 150 VFC_Poly12_CoefficientYc3 "c3 coefficient of the  lateral polynomial.(resolution = 2^-26)  ISO 23150:2022(E): Polynomial coefficient y {c0,c1,c2,c3} (A.2.116)";
CM_ SG_ 150 VFC_Poly12_Colour "The color of the line. Similar to ISO 23150:2022(E): Colour value - object level (A.2.107)";
CM_ SG_ 150 VFC_Poly12_CoefficientYc2 "c2 coefficient of  the  lateral polynomial.(resolution = 2^-20) ISO 23150:2022(E): Polynomial coefficient y {c0,c1,c2,c3} (A.2.116)";
CM_ SG_ 150 VFC_Poly12_CoefficientYc0 "c0 coefficient of the lateral polynomial. (resolution = 2^-7) ISO 23150:2022(E): Polynomial coefficient y {c0,c1,c2,c3} (A.2.116)";
CM_ SG_ 150 VFC_Poly12_CoefficientYc1 "c1 coefficient of  the lateral polynomial. (resolution = 2^-14) ISO 23150:2022(E): Polynomial coefficient y {c0,c1,c2,c3} (A.2.116)";
CM_ SG_ 150 VFC_Poly12_CoefficientYc2Corr "c2 correction coefficient for lateral polynomial. (resolution = 2^-20) If X > XCorrectionPoint then Yc2Corr*(X-XCorrectionPoint)^2 shall be added to Y value. Deviation form ISO 23150:2022(E) polynomial representation";
CM_ SG_ 150 VFC_Poly12_CoefficientYc3Corr "c3 correction coefficient for lateral polynomial. (resolution = 2^-26) If X > XCorrectionPoint then Yc3Corr*(X-XCorrectionPoint)^3 shall be added to Y value. Deviation form 23150:2022(E) polynomial representation";
CM_ SG_ 150 VFC_Poly12_Width "Width of the line. ISO 23150:2022(E): Extent {width} - polynomial (A.2.121)";
CM_ SG_ 150 VFC_Poly12_RangeXCorrectionPoint "Transition point along the X axis the correction parameters shall be applied on the polynomial.  ISO 23150:2022(E): Polynomial range x {begin, end} (A.2.120)";
CM_ SG_ 150 VFC_Poly12_RangeXBegin "Longitudinal begin of the polynomial. ISO 23150:2022(E): Polynomial range x {begin, end} (A.2.120)";
CM_ SG_ 150 VFC_Poly12_Reserved0 "Reserved for future use";
CM_ SG_ 150 VFC_Poly12_RangeXEnd "Longitudinal end of the polynomial. ISO 23150:2022(E): Polynomial range x {begin, end} (A.2.120)";
CM_ SG_ 150 VFC_Poly12_Reserved1 "Reserved for future use";
CM_ SG_ 150 VFC_Poly13_LaneAssociation "Position relative to the ego lane. ISO 23150:2022(E): Road object lane association (A.2.93)";
CM_ SG_ 150 VFC_Poly13_Type "Type of the Line. ISO 23150:2022(E): Road marking type (A.2.91)";
CM_ SG_ 150 VFC_Poly13_ExistProb "Confidence for this line, probability that it describes the true lane boundary. ISO 23150:2022(E): Existence probability - object level (A.2.1)";
CM_ SG_ 150 VFC_Poly13_CoefficientYc3 "c3 coefficient of the  lateral polynomial.(resolution = 2^-26)  ISO 23150:2022(E): Polynomial coefficient y {c0,c1,c2,c3} (A.2.116)";
CM_ SG_ 150 VFC_Poly13_Colour "The color of the line. Similar to ISO 23150:2022(E): Colour value - object level (A.2.107)";
CM_ SG_ 150 VFC_Poly13_CoefficientYc2 "c2 coefficient of  the  lateral polynomial.(resolution = 2^-20) ISO 23150:2022(E): Polynomial coefficient y {c0,c1,c2,c3} (A.2.116)";
CM_ SG_ 150 VFC_Poly13_CoefficientYc0 "c0 coefficient of the lateral polynomial. (resolution = 2^-7) ISO 23150:2022(E): Polynomial coefficient y {c0,c1,c2,c3} (A.2.116)";
CM_ SG_ 150 VFC_Poly13_CoefficientYc1 "c1 coefficient of  the lateral polynomial. (resolution = 2^-14) ISO 23150:2022(E): Polynomial coefficient y {c0,c1,c2,c3} (A.2.116)";
CM_ SG_ 150 VFC_Poly13_CoefficientYc2Corr "c2 correction coefficient for lateral polynomial. (resolution = 2^-20) If X > XCorrectionPoint then Yc2Corr*(X-XCorrectionPoint)^2 shall be added to Y value. Deviation form ISO 23150:2022(E) polynomial representation";
CM_ SG_ 150 VFC_Poly13_CoefficientYc3Corr "c3 correction coefficient for lateral polynomial. (resolution = 2^-26) If X > XCorrectionPoint then Yc3Corr*(X-XCorrectionPoint)^3 shall be added to Y value. Deviation form 23150:2022(E) polynomial representation";
CM_ SG_ 150 VFC_Poly13_Width "Width of the line. ISO 23150:2022(E): Extent {width} - polynomial (A.2.121)";
CM_ SG_ 150 VFC_Poly13_RangeXCorrectionPoint "Transition point along the X axis the correction parameters shall be applied on the polynomial.  ISO 23150:2022(E): Polynomial range x {begin, end} (A.2.120)";
CM_ SG_ 150 VFC_Poly13_RangeXBegin "Longitudinal begin of the polynomial. ISO 23150:2022(E): Polynomial range x {begin, end} (A.2.120)";
CM_ SG_ 150 VFC_Poly13_Reserved0 "Reserved for future use";
CM_ SG_ 150 VFC_Poly13_RangeXEnd "Longitudinal end of the polynomial. ISO 23150:2022(E): Polynomial range x {begin, end} (A.2.120)";
CM_ SG_ 150 VFC_Poly13_Reserved1 "Reserved for future use";
CM_ SG_ 150 VFC_Poly14_LaneAssociation "Position relative to the ego lane. ISO 23150:2022(E): Road object lane association (A.2.93)";
CM_ SG_ 150 VFC_Poly14_Type "Type of the Line. ISO 23150:2022(E): Road marking type (A.2.91)";
CM_ SG_ 150 VFC_Poly14_ExistProb "Confidence for this line, probability that it describes the true lane boundary. ISO 23150:2022(E): Existence probability - object level (A.2.1)";
CM_ SG_ 150 VFC_Poly14_CoefficientYc3 "c3 coefficient of the  lateral polynomial.(resolution = 2^-26)  ISO 23150:2022(E): Polynomial coefficient y {c0,c1,c2,c3} (A.2.116)";
CM_ SG_ 150 VFC_Poly14_Colour "The color of the line. Similar to ISO 23150:2022(E): Colour value - object level (A.2.107)";
CM_ SG_ 150 VFC_Poly14_CoefficientYc2 "c2 coefficient of  the  lateral polynomial.(resolution = 2^-20) ISO 23150:2022(E): Polynomial coefficient y {c0,c1,c2,c3} (A.2.116)";
CM_ SG_ 150 VFC_Poly14_CoefficientYc0 "c0 coefficient of the lateral polynomial. (resolution = 2^-7) ISO 23150:2022(E): Polynomial coefficient y {c0,c1,c2,c3} (A.2.116)";
CM_ SG_ 150 VFC_Poly14_CoefficientYc1 "c1 coefficient of  the lateral polynomial. (resolution = 2^-14) ISO 23150:2022(E): Polynomial coefficient y {c0,c1,c2,c3} (A.2.116)";
CM_ SG_ 150 VFC_Poly14_CoefficientYc2Corr "c2 correction coefficient for lateral polynomial. (resolution = 2^-20) If X > XCorrectionPoint then Yc2Corr*(X-XCorrectionPoint)^2 shall be added to Y value. Deviation form ISO 23150:2022(E) polynomial representation";
CM_ SG_ 150 VFC_Poly14_CoefficientYc3Corr "c3 correction coefficient for lateral polynomial. (resolution = 2^-26) If X > XCorrectionPoint then Yc3Corr*(X-XCorrectionPoint)^3 shall be added to Y value. Deviation form 23150:2022(E) polynomial representation";
CM_ SG_ 150 VFC_Poly14_Width "Width of the line. ISO 23150:2022(E): Extent {width} - polynomial (A.2.121)";
CM_ SG_ 150 VFC_Poly14_RangeXCorrectionPoint "Transition point along the X axis the correction parameters shall be applied on the polynomial.  ISO 23150:2022(E): Polynomial range x {begin, end} (A.2.120)";
CM_ SG_ 150 VFC_Poly14_RangeXBegin "Longitudinal begin of the polynomial. ISO 23150:2022(E): Polynomial range x {begin, end} (A.2.120)";
CM_ SG_ 150 VFC_Poly14_Reserved0 "Reserved for future use";
CM_ SG_ 150 VFC_Poly14_RangeXEnd "Longitudinal end of the polynomial. ISO 23150:2022(E): Polynomial range x {begin, end} (A.2.120)";
CM_ SG_ 150 VFC_Poly14_Reserved1 "Reserved for future use";
CM_ SG_ 162 VFC_2DPoly_00_02_CRC "CRC - Autosar E2E Profile 5";
CM_ SG_ 162 VFC_2DPoly_00_02_AliveCtr "Alive counter - Autosar E2E Profile 5";
CM_ SG_ 162 VFC_2DPoly_00_02_ProtBlockCtr "Protocol-Signal: Block-Counter";
CM_ SG_ 162 VFC_2DPoly00_LaneAssociation "Position relative to the ego lane. ISO 23150:2022(E): Road object lane association (A.2.93)";
CM_ SG_ 162 VFC_2DPoly00_ExistProb "ISO 23150:2022(E): Existence probability - object level (A.2.1)";
CM_ SG_ 162 VFC_2DPoly00_Type "Type of the Line. ISO 23150:2022(E): Road marking type (A.2.91)";
CM_ SG_ 162 VFC_2DPoly00_CoefficientUc0 "Polynomial coefficient for the u-axis value (in CV coordinates, origin top left). Similar to ISO 23150:2022(E): Polynomial coefficient y {c0,c1,c2,c3} (A.2.116)";
CM_ SG_ 162 VFC_2DPoly00_CoefficientUc1 "Polynomial coefficient for the u-axis value (in CV coordinates, origin top left). Similar to ISO 23150:2022(E): Polynomial coefficient y {c0,c1,c2,c3} (A.2.116)";
CM_ SG_ 162 VFC_2DPoly00_CoefficientUc2 "Polynomial coefficient for the u-axis value (in CV coordinates, origin top left). Similar to ISO 23150:2022(E): Polynomial coefficient y {c0,c1,c2,c3} (A.2.116)";
CM_ SG_ 162 VFC_2DPoly00_CoefficientUc3 "Polynomial coefficient for the u-axis value (in CV coordinates, origin top left). Similar to ISO 23150:2022(E): Polynomial coefficient y {c0,c1,c2,c3} (A.2.116)";
CM_ SG_ 162 VFC_2DPoly00_CoefficientUc4 "Polynomial coefficient for the u-axis value (in CV coordinates, origin top left). Similar to ISO 23150:2022(E): Polynomial coefficient y {c0,c1,c2,c3} (A.2.116)";
CM_ SG_ 162 VFC_2DPoly00_CoefficientUc5 "Polynomial coefficient for the u-axis value (in CV coordinates, origin top left). Similar to ISO 23150:2022(E): Polynomial coefficient y {c0,c1,c2,c3} (A.2.116)";
CM_ SG_ 162 VFC_2DPoly00_RangeVBegin "Longitudinal begin of the polynomial (big v value) (in CV coordinates, origin top left). Similar to ISO 23150:2022(E): Polynomial range x {begin, end} (A.2.120)";
CM_ SG_ 162 VFC_2DPoly00_RangeVEnd "Longitudinal end of the polynomial (small v value) (in CV coordinates, origin top left). Similar to ISO 23150:2022(E): Polynomial range x {begin, end} (A.2.120)";
CM_ SG_ 162 VFC_2DPoly01_LaneAssociation "Position relative to the ego lane. ISO 23150:2022(E): Road object lane association (A.2.93)";
CM_ SG_ 162 VFC_2DPoly01_ExistProb "ISO 23150:2022(E): Existence probability - object level (A.2.1)";
CM_ SG_ 162 VFC_2DPoly01_Type "Type of the Line. ISO 23150:2022(E): Road marking type (A.2.91)";
CM_ SG_ 162 VFC_2DPoly01_CoefficientUc0 "Polynomial coefficient for the u-axis value (in CV coordinates, origin top left). Similar to ISO 23150:2022(E): Polynomial coefficient y {c0,c1,c2,c3} (A.2.116)";
CM_ SG_ 162 VFC_2DPoly01_CoefficientUc1 "Polynomial coefficient for the u-axis value (in CV coordinates, origin top left). Similar to ISO 23150:2022(E): Polynomial coefficient y {c0,c1,c2,c3} (A.2.116)";
CM_ SG_ 162 VFC_2DPoly01_CoefficientUc2 "Polynomial coefficient for the u-axis value (in CV coordinates, origin top left). Similar to ISO 23150:2022(E): Polynomial coefficient y {c0,c1,c2,c3} (A.2.116)";
CM_ SG_ 162 VFC_2DPoly01_CoefficientUc3 "Polynomial coefficient for the u-axis value (in CV coordinates, origin top left). Similar to ISO 23150:2022(E): Polynomial coefficient y {c0,c1,c2,c3} (A.2.116)";
CM_ SG_ 162 VFC_2DPoly01_CoefficientUc4 "Polynomial coefficient for the u-axis value (in CV coordinates, origin top left). Similar to ISO 23150:2022(E): Polynomial coefficient y {c0,c1,c2,c3} (A.2.116)";
CM_ SG_ 162 VFC_2DPoly01_CoefficientUc5 "Polynomial coefficient for the u-axis value (in CV coordinates, origin top left). Similar to ISO 23150:2022(E): Polynomial coefficient y {c0,c1,c2,c3} (A.2.116)";
CM_ SG_ 162 VFC_2DPoly01_RangeVBegin "Longitudinal begin of the polynomial (big v value) (in CV coordinates, origin top left). Similar to ISO 23150:2022(E): Polynomial range x {begin, end} (A.2.120)";
CM_ SG_ 162 VFC_2DPoly01_RangeVEnd "Longitudinal end of the polynomial (small v value) (in CV coordinates, origin top left). Similar to ISO 23150:2022(E): Polynomial range x {begin, end} (A.2.120)";
CM_ SG_ 162 VFC_2DPoly02_LaneAssociation "Position relative to the ego lane. ISO 23150:2022(E): Road object lane association (A.2.93)";
CM_ SG_ 162 VFC_2DPoly02_ExistProb "ISO 23150:2022(E): Existence probability - object level (A.2.1)";
CM_ SG_ 162 VFC_2DPoly02_Type "Type of the Line. ISO 23150:2022(E): Road marking type (A.2.91)";
CM_ SG_ 162 VFC_2DPoly02_CoefficientUc0 "Polynomial coefficient for the u-axis value (in CV coordinates, origin top left). Similar to ISO 23150:2022(E): Polynomial coefficient y {c0,c1,c2,c3} (A.2.116)";
CM_ SG_ 162 VFC_2DPoly02_CoefficientUc1 "Polynomial coefficient for the u-axis value (in CV coordinates, origin top left). Similar to ISO 23150:2022(E): Polynomial coefficient y {c0,c1,c2,c3} (A.2.116)";
CM_ SG_ 162 VFC_2DPoly02_CoefficientUc2 "Polynomial coefficient for the u-axis value (in CV coordinates, origin top left). Similar to ISO 23150:2022(E): Polynomial coefficient y {c0,c1,c2,c3} (A.2.116)";
CM_ SG_ 162 VFC_2DPoly02_CoefficientUc3 "Polynomial coefficient for the u-axis value (in CV coordinates, origin top left). Similar to ISO 23150:2022(E): Polynomial coefficient y {c0,c1,c2,c3} (A.2.116)";
CM_ SG_ 162 VFC_2DPoly02_CoefficientUc4 "Polynomial coefficient for the u-axis value (in CV coordinates, origin top left). Similar to ISO 23150:2022(E): Polynomial coefficient y {c0,c1,c2,c3} (A.2.116)";
CM_ SG_ 162 VFC_2DPoly02_CoefficientUc5 "Polynomial coefficient for the u-axis value (in CV coordinates, origin top left). Similar to ISO 23150:2022(E): Polynomial coefficient y {c0,c1,c2,c3} (A.2.116)";
CM_ SG_ 162 VFC_2DPoly02_RangeVBegin "Longitudinal begin of the polynomial (big v value) (in CV coordinates, origin top left). Similar to ISO 23150:2022(E): Polynomial range x {begin, end} (A.2.120)";
CM_ SG_ 162 VFC_2DPoly02_RangeVEnd "Longitudinal end of the polynomial (small v value) (in CV coordinates, origin top left). Similar to ISO 23150:2022(E): Polynomial range x {begin, end} (A.2.120)";
CM_ SG_ 163 VFC_2DPoly_03_05_CRC "CRC - Autosar E2E Profile 5";
CM_ SG_ 163 VFC_2DPoly_03_05_AliveCtr "Alive counter - Autosar E2E Profile 5";
CM_ SG_ 163 VFC_2DPoly_03_05_ProtBlockCtr "Protocol-Signal: Block-Counter";
CM_ SG_ 163 VFC_2DPoly03_LaneAssociation "Position relative to the ego lane. ISO 23150:2022(E): Road object lane association (A.2.93)";
CM_ SG_ 163 VFC_2DPoly03_ExistProb "ISO 23150:2022(E): Existence probability - object level (A.2.1)";
CM_ SG_ 163 VFC_2DPoly03_Type "Type of the Line. ISO 23150:2022(E): Road marking type (A.2.91)";
CM_ SG_ 163 VFC_2DPoly03_CoefficientUc0 "Polynomial coefficient for the u-axis value (in CV coordinates, origin top left). Similar to ISO 23150:2022(E): Polynomial coefficient y {c0,c1,c2,c3} (A.2.116)";
CM_ SG_ 163 VFC_2DPoly03_CoefficientUc1 "Polynomial coefficient for the u-axis value (in CV coordinates, origin top left). Similar to ISO 23150:2022(E): Polynomial coefficient y {c0,c1,c2,c3} (A.2.116)";
CM_ SG_ 163 VFC_2DPoly03_CoefficientUc2 "Polynomial coefficient for the u-axis value (in CV coordinates, origin top left). Similar to ISO 23150:2022(E): Polynomial coefficient y {c0,c1,c2,c3} (A.2.116)";
CM_ SG_ 163 VFC_2DPoly03_CoefficientUc3 "Polynomial coefficient for the u-axis value (in CV coordinates, origin top left). Similar to ISO 23150:2022(E): Polynomial coefficient y {c0,c1,c2,c3} (A.2.116)";
CM_ SG_ 163 VFC_2DPoly03_CoefficientUc4 "Polynomial coefficient for the u-axis value (in CV coordinates, origin top left). Similar to ISO 23150:2022(E): Polynomial coefficient y {c0,c1,c2,c3} (A.2.116)";
CM_ SG_ 163 VFC_2DPoly03_CoefficientUc5 "Polynomial coefficient for the u-axis value (in CV coordinates, origin top left). Similar to ISO 23150:2022(E): Polynomial coefficient y {c0,c1,c2,c3} (A.2.116)";
CM_ SG_ 163 VFC_2DPoly03_RangeVBegin "Longitudinal begin of the polynomial (big v value) (in CV coordinates, origin top left). Similar to ISO 23150:2022(E): Polynomial range x {begin, end} (A.2.120)";
CM_ SG_ 163 VFC_2DPoly03_RangeVEnd "Longitudinal end of the polynomial (small v value) (in CV coordinates, origin top left). Similar to ISO 23150:2022(E): Polynomial range x {begin, end} (A.2.120)";
CM_ SG_ 163 VFC_2DPoly04_LaneAssociation "Position relative to the ego lane. ISO 23150:2022(E): Road object lane association (A.2.93)";
CM_ SG_ 163 VFC_2DPoly04_ExistProb "ISO 23150:2022(E): Existence probability - object level (A.2.1)";
CM_ SG_ 163 VFC_2DPoly04_Type "Type of the Line. ISO 23150:2022(E): Road marking type (A.2.91)";
CM_ SG_ 163 VFC_2DPoly04_CoefficientUc0 "Polynomial coefficient for the u-axis value (in CV coordinates, origin top left). Similar to ISO 23150:2022(E): Polynomial coefficient y {c0,c1,c2,c3} (A.2.116)";
CM_ SG_ 163 VFC_2DPoly04_CoefficientUc1 "Polynomial coefficient for the u-axis value (in CV coordinates, origin top left). Similar to ISO 23150:2022(E): Polynomial coefficient y {c0,c1,c2,c3} (A.2.116)";
CM_ SG_ 163 VFC_2DPoly04_CoefficientUc2 "Polynomial coefficient for the u-axis value (in CV coordinates, origin top left). Similar to ISO 23150:2022(E): Polynomial coefficient y {c0,c1,c2,c3} (A.2.116)";
CM_ SG_ 163 VFC_2DPoly04_CoefficientUc3 "Polynomial coefficient for the u-axis value (in CV coordinates, origin top left). Similar to ISO 23150:2022(E): Polynomial coefficient y {c0,c1,c2,c3} (A.2.116)";
CM_ SG_ 163 VFC_2DPoly04_CoefficientUc4 "Polynomial coefficient for the u-axis value (in CV coordinates, origin top left). Similar to ISO 23150:2022(E): Polynomial coefficient y {c0,c1,c2,c3} (A.2.116)";
CM_ SG_ 163 VFC_2DPoly04_CoefficientUc5 "Polynomial coefficient for the u-axis value (in CV coordinates, origin top left). Similar to ISO 23150:2022(E): Polynomial coefficient y {c0,c1,c2,c3} (A.2.116)";
CM_ SG_ 163 VFC_2DPoly04_RangeVBegin "Longitudinal begin of the polynomial (big v value) (in CV coordinates, origin top left). Similar to ISO 23150:2022(E): Polynomial range x {begin, end} (A.2.120)";
CM_ SG_ 163 VFC_2DPoly04_RangeVEnd "Longitudinal end of the polynomial (small v value) (in CV coordinates, origin top left). Similar to ISO 23150:2022(E): Polynomial range x {begin, end} (A.2.120)";
CM_ SG_ 163 VFC_2DPoly05_LaneAssociation "Position relative to the ego lane. ISO 23150:2022(E): Road object lane association (A.2.93)";
CM_ SG_ 163 VFC_2DPoly05_ExistProb "ISO 23150:2022(E): Existence probability - object level (A.2.1)";
CM_ SG_ 163 VFC_2DPoly05_Type "Type of the Line. ISO 23150:2022(E): Road marking type (A.2.91)";
CM_ SG_ 163 VFC_2DPoly05_CoefficientUc0 "Polynomial coefficient for the u-axis value (in CV coordinates, origin top left). Similar to ISO 23150:2022(E): Polynomial coefficient y {c0,c1,c2,c3} (A.2.116)";
CM_ SG_ 163 VFC_2DPoly05_CoefficientUc1 "Polynomial coefficient for the u-axis value (in CV coordinates, origin top left). Similar to ISO 23150:2022(E): Polynomial coefficient y {c0,c1,c2,c3} (A.2.116)";
CM_ SG_ 163 VFC_2DPoly05_CoefficientUc2 "Polynomial coefficient for the u-axis value (in CV coordinates, origin top left). Similar to ISO 23150:2022(E): Polynomial coefficient y {c0,c1,c2,c3} (A.2.116)";
CM_ SG_ 163 VFC_2DPoly05_CoefficientUc3 "Polynomial coefficient for the u-axis value (in CV coordinates, origin top left). Similar to ISO 23150:2022(E): Polynomial coefficient y {c0,c1,c2,c3} (A.2.116)";
CM_ SG_ 163 VFC_2DPoly05_CoefficientUc4 "Polynomial coefficient for the u-axis value (in CV coordinates, origin top left). Similar to ISO 23150:2022(E): Polynomial coefficient y {c0,c1,c2,c3} (A.2.116)";
CM_ SG_ 163 VFC_2DPoly05_CoefficientUc5 "Polynomial coefficient for the u-axis value (in CV coordinates, origin top left). Similar to ISO 23150:2022(E): Polynomial coefficient y {c0,c1,c2,c3} (A.2.116)";
CM_ SG_ 163 VFC_2DPoly05_RangeVBegin "Longitudinal begin of the polynomial (big v value) (in CV coordinates, origin top left). Similar to ISO 23150:2022(E): Polynomial range x {begin, end} (A.2.120)";
CM_ SG_ 163 VFC_2DPoly05_RangeVEnd "Longitudinal end of the polynomial (small v value) (in CV coordinates, origin top left). Similar to ISO 23150:2022(E): Polynomial range x {begin, end} (A.2.120)";
BA_DEF_ SG_  "GenSigSendType" ENUM  "Cyclic","OnWrite","OnWriteWithRepetition","OnChange","OnChangeWithRepetition","IfActive","IfActiveWithRepetition";
BA_DEF_ BO_  "GenMsgCycleTimeFast" INT 2 50000;
BA_DEF_ BO_  "GenMsgILSupport" ENUM  "No","Yes";
BA_DEF_ BO_  "CANFD_BRS" ENUM  "0","1";
BA_DEF_ BO_  "GenMsgCycleTime" INT 0 65535;
BA_DEF_ BO_  "GenMsgSendType" ENUM  "Event","cyclic";
BA_DEF_ BO_  "VFrameFormat" ENUM  "StandardCAN","ExtendedCAN","reserved","reserved","reserved","reserved","reserved","reserved","reserved","reserved","reserved","reserved","reserved","reserved","StandardCAN_FD","ExtendedCAN_FD";
BA_DEF_ BO_  "E2Eprofile" STRING ;
BA_DEF_ BO_  "DataID" HEX 0 655535;
BA_DEF_ SG_  "GenSigStartValue" FLOAT 0 100000000000;
BA_DEF_DEF_  "GenSigSendType" "Cyclic";
BA_DEF_DEF_  "GenMsgCycleTimeFast" 100;
BA_DEF_DEF_  "GenMsgILSupport" "Yes";
BA_DEF_DEF_  "CANFD_BRS" "1";
BA_DEF_DEF_  "GenMsgCycleTime" 0;
BA_DEF_DEF_  "GenMsgSendType" "";
BA_DEF_DEF_  "VFrameFormat" "";
BA_DEF_DEF_  "E2Eprofile" "None";
BA_DEF_DEF_  "DataID" 0;
BA_DEF_DEF_  "GenSigStartValue" 0;
BA_ "GenMsgSendType" BO_ 128 0;
BA_ "E2Eprofile" BO_ 128 "AUTOSAR Profile 5";
BA_ "DataID" BO_ 128 8320;
BA_ "VFrameFormat" BO_ 128 14;
BA_ "GenMsgSendType" BO_ 130 0;
BA_ "E2Eprofile" BO_ 130 "AUTOSAR Profile 5";
BA_ "DataID" BO_ 130 8322;
BA_ "VFrameFormat" BO_ 130 14;
BA_ "GenMsgSendType" BO_ 131 0;
BA_ "E2Eprofile" BO_ 131 "AUTOSAR Profile 5";
BA_ "DataID" BO_ 131 8323;
BA_ "VFrameFormat" BO_ 131 14;
BA_ "GenMsgSendType" BO_ 132 0;
BA_ "E2Eprofile" BO_ 132 "AUTOSAR Profile 5";
BA_ "DataID" BO_ 132 8324;
BA_ "VFrameFormat" BO_ 132 14;
BA_ "GenMsgSendType" BO_ 133 0;
BA_ "E2Eprofile" BO_ 133 "AUTOSAR Profile 5";
BA_ "DataID" BO_ 133 8325;
BA_ "VFrameFormat" BO_ 133 14;
BA_ "GenMsgSendType" BO_ 146 0;
BA_ "E2Eprofile" BO_ 146 "AUTOSAR Profile 5";
BA_ "DataID" BO_ 146 8338;
BA_ "VFrameFormat" BO_ 146 14;
BA_ "GenMsgSendType" BO_ 147 0;
BA_ "E2Eprofile" BO_ 147 "AUTOSAR Profile 5";
BA_ "DataID" BO_ 147 8339;
BA_ "VFrameFormat" BO_ 147 14;
BA_ "GenMsgSendType" BO_ 148 0;
BA_ "E2Eprofile" BO_ 148 "AUTOSAR Profile 5";
BA_ "DataID" BO_ 148 8340;
BA_ "VFrameFormat" BO_ 148 14;
BA_ "GenMsgSendType" BO_ 149 0;
BA_ "E2Eprofile" BO_ 149 "AUTOSAR Profile 5";
BA_ "DataID" BO_ 149 8341;
BA_ "VFrameFormat" BO_ 149 14;
BA_ "GenMsgSendType" BO_ 150 0;
BA_ "E2Eprofile" BO_ 150 "AUTOSAR Profile 5";
BA_ "DataID" BO_ 150 8342;
BA_ "VFrameFormat" BO_ 150 14;
BA_ "GenMsgSendType" BO_ 162 0;
BA_ "E2Eprofile" BO_ 162 "AUTOSAR Profile 5";
BA_ "DataID" BO_ 162 8354;
BA_ "VFrameFormat" BO_ 162 14;
BA_ "GenMsgSendType" BO_ 163 0;
BA_ "E2Eprofile" BO_ 163 "AUTOSAR Profile 5";
BA_ "DataID" BO_ 163 8355;
BA_ "VFrameFormat" BO_ 163 14;
BA_ "GenSigStartValue" SG_ 128 VFC_RoadHdr_IfVersionIdMajor 3;
BA_ "GenSigStartValue" SG_ 130 VFC_Cloth00_CurvChange 8388607;
BA_ "GenSigStartValue" SG_ 130 VFC_Cloth00_Curv 16384;
BA_ "GenSigStartValue" SG_ 130 VFC_Cloth00_Py 2048;
BA_ "GenSigStartValue" SG_ 130 VFC_Cloth00_OrientationYaw 2048;
BA_ "GenSigStartValue" SG_ 130 VFC_Cloth01_CurvChange 8388607;
BA_ "GenSigStartValue" SG_ 130 VFC_Cloth01_Curv 16384;
BA_ "GenSigStartValue" SG_ 130 VFC_Cloth01_Py 2048;
BA_ "GenSigStartValue" SG_ 130 VFC_Cloth01_OrientationYaw 2048;
BA_ "GenSigStartValue" SG_ 130 VFC_Cloth02_CurvChange 8388607;
BA_ "GenSigStartValue" SG_ 130 VFC_Cloth02_Curv 16384;
BA_ "GenSigStartValue" SG_ 130 VFC_Cloth02_Py 2048;
BA_ "GenSigStartValue" SG_ 130 VFC_Cloth02_OrientationYaw 2048;
BA_ "GenSigStartValue" SG_ 131 VFC_Cloth03_CurvChange 8388607;
BA_ "GenSigStartValue" SG_ 131 VFC_Cloth03_Curv 16384;
BA_ "GenSigStartValue" SG_ 131 VFC_Cloth03_Py 2048;
BA_ "GenSigStartValue" SG_ 131 VFC_Cloth03_OrientationYaw 2048;
BA_ "GenSigStartValue" SG_ 131 VFC_Cloth04_CurvChange 8388607;
BA_ "GenSigStartValue" SG_ 131 VFC_Cloth04_Curv 16384;
BA_ "GenSigStartValue" SG_ 131 VFC_Cloth04_Py 2048;
BA_ "GenSigStartValue" SG_ 131 VFC_Cloth04_OrientationYaw 2048;
BA_ "GenSigStartValue" SG_ 131 VFC_Cloth05_CurvChange 8388607;
BA_ "GenSigStartValue" SG_ 131 VFC_Cloth05_Curv 16384;
BA_ "GenSigStartValue" SG_ 131 VFC_Cloth05_Py 2048;
BA_ "GenSigStartValue" SG_ 131 VFC_Cloth05_OrientationYaw 2048;
BA_ "GenSigStartValue" SG_ 132 VFC_Cloth06_CurvChange 8388607;
BA_ "GenSigStartValue" SG_ 132 VFC_Cloth06_Curv 16384;
BA_ "GenSigStartValue" SG_ 132 VFC_Cloth06_Py 2048;
BA_ "GenSigStartValue" SG_ 132 VFC_Cloth06_OrientationYaw 2048;
BA_ "GenSigStartValue" SG_ 132 VFC_Cloth07_CurvChange 8388607;
BA_ "GenSigStartValue" SG_ 132 VFC_Cloth07_Curv 16384;
BA_ "GenSigStartValue" SG_ 132 VFC_Cloth07_Py 2048;
BA_ "GenSigStartValue" SG_ 132 VFC_Cloth07_OrientationYaw 2048;
BA_ "GenSigStartValue" SG_ 132 VFC_Cloth08_CurvChange 8388607;
BA_ "GenSigStartValue" SG_ 132 VFC_Cloth08_Curv 16384;
BA_ "GenSigStartValue" SG_ 132 VFC_Cloth08_Py 2048;
BA_ "GenSigStartValue" SG_ 132 VFC_Cloth08_OrientationYaw 2048;
BA_ "GenSigStartValue" SG_ 133 VFC_Cloth09_CurvChange 8388607;
BA_ "GenSigStartValue" SG_ 133 VFC_Cloth09_Curv 16384;
BA_ "GenSigStartValue" SG_ 133 VFC_Cloth09_Py 2048;
BA_ "GenSigStartValue" SG_ 133 VFC_Cloth09_OrientationYaw 2048;
BA_ "GenSigStartValue" SG_ 133 VFC_Cloth10_CurvChange 8388607;
BA_ "GenSigStartValue" SG_ 133 VFC_Cloth10_Curv 16384;
BA_ "GenSigStartValue" SG_ 133 VFC_Cloth10_Py 2048;
BA_ "GenSigStartValue" SG_ 133 VFC_Cloth10_OrientationYaw 2048;
BA_ "GenSigStartValue" SG_ 133 VFC_Cloth11_CurvChange 8388607;
BA_ "GenSigStartValue" SG_ 133 VFC_Cloth11_Curv 16384;
BA_ "GenSigStartValue" SG_ 133 VFC_Cloth11_Py 2048;
BA_ "GenSigStartValue" SG_ 133 VFC_Cloth11_OrientationYaw 2048;
BA_ "GenSigStartValue" SG_ 146 VFC_Poly00_CoefficientYc3 131072;
BA_ "GenSigStartValue" SG_ 146 VFC_Poly00_CoefficientYc2 65536;
BA_ "GenSigStartValue" SG_ 146 VFC_Poly00_CoefficientYc0 2048;
BA_ "GenSigStartValue" SG_ 146 VFC_Poly00_CoefficientYc1 16384;
BA_ "GenSigStartValue" SG_ 146 VFC_Poly00_CoefficientYc2Corr 65536;
BA_ "GenSigStartValue" SG_ 146 VFC_Poly00_CoefficientYc3Corr 131072;
BA_ "GenSigStartValue" SG_ 146 VFC_Poly01_CoefficientYc3 131072;
BA_ "GenSigStartValue" SG_ 146 VFC_Poly01_CoefficientYc2 65536;
BA_ "GenSigStartValue" SG_ 146 VFC_Poly01_CoefficientYc0 2048;
BA_ "GenSigStartValue" SG_ 146 VFC_Poly01_CoefficientYc1 16384;
BA_ "GenSigStartValue" SG_ 146 VFC_Poly01_CoefficientYc2Corr 65536;
BA_ "GenSigStartValue" SG_ 146 VFC_Poly01_CoefficientYc3Corr 131072;
BA_ "GenSigStartValue" SG_ 146 VFC_Poly02_CoefficientYc3 131072;
BA_ "GenSigStartValue" SG_ 146 VFC_Poly02_CoefficientYc2 65536;
BA_ "GenSigStartValue" SG_ 146 VFC_Poly02_CoefficientYc0 2048;
BA_ "GenSigStartValue" SG_ 146 VFC_Poly02_CoefficientYc1 16384;
BA_ "GenSigStartValue" SG_ 146 VFC_Poly02_CoefficientYc2Corr 65536;
BA_ "GenSigStartValue" SG_ 146 VFC_Poly02_CoefficientYc3Corr 131072;
BA_ "GenSigStartValue" SG_ 147 VFC_Poly03_CoefficientYc3 131072;
BA_ "GenSigStartValue" SG_ 147 VFC_Poly03_CoefficientYc2 65536;
BA_ "GenSigStartValue" SG_ 147 VFC_Poly03_CoefficientYc0 2048;
BA_ "GenSigStartValue" SG_ 147 VFC_Poly03_CoefficientYc1 16384;
BA_ "GenSigStartValue" SG_ 147 VFC_Poly03_CoefficientYc2Corr 65536;
BA_ "GenSigStartValue" SG_ 147 VFC_Poly03_CoefficientYc3Corr 131072;
BA_ "GenSigStartValue" SG_ 147 VFC_Poly04_CoefficientYc3 131072;
BA_ "GenSigStartValue" SG_ 147 VFC_Poly04_CoefficientYc2 65536;
BA_ "GenSigStartValue" SG_ 147 VFC_Poly04_CoefficientYc0 2048;
BA_ "GenSigStartValue" SG_ 147 VFC_Poly04_CoefficientYc1 16384;
BA_ "GenSigStartValue" SG_ 147 VFC_Poly04_CoefficientYc2Corr 65536;
BA_ "GenSigStartValue" SG_ 147 VFC_Poly04_CoefficientYc3Corr 131072;
BA_ "GenSigStartValue" SG_ 147 VFC_Poly05_CoefficientYc3 131072;
BA_ "GenSigStartValue" SG_ 147 VFC_Poly05_CoefficientYc2 65536;
BA_ "GenSigStartValue" SG_ 147 VFC_Poly05_CoefficientYc0 2048;
BA_ "GenSigStartValue" SG_ 147 VFC_Poly05_CoefficientYc1 16384;
BA_ "GenSigStartValue" SG_ 147 VFC_Poly05_CoefficientYc2Corr 65536;
BA_ "GenSigStartValue" SG_ 147 VFC_Poly05_CoefficientYc3Corr 131072;
BA_ "GenSigStartValue" SG_ 148 VFC_Poly06_CoefficientYc3 131072;
BA_ "GenSigStartValue" SG_ 148 VFC_Poly06_CoefficientYc2 65536;
BA_ "GenSigStartValue" SG_ 148 VFC_Poly06_CoefficientYc0 2048;
BA_ "GenSigStartValue" SG_ 148 VFC_Poly06_CoefficientYc1 16384;
BA_ "GenSigStartValue" SG_ 148 VFC_Poly06_CoefficientYc2Corr 65536;
BA_ "GenSigStartValue" SG_ 148 VFC_Poly06_CoefficientYc3Corr 131072;
BA_ "GenSigStartValue" SG_ 148 VFC_Poly07_CoefficientYc3 131072;
BA_ "GenSigStartValue" SG_ 148 VFC_Poly07_CoefficientYc2 65536;
BA_ "GenSigStartValue" SG_ 148 VFC_Poly07_CoefficientYc0 2048;
BA_ "GenSigStartValue" SG_ 148 VFC_Poly07_CoefficientYc1 16384;
BA_ "GenSigStartValue" SG_ 148 VFC_Poly07_CoefficientYc2Corr 65536;
BA_ "GenSigStartValue" SG_ 148 VFC_Poly07_CoefficientYc3Corr 131072;
BA_ "GenSigStartValue" SG_ 148 VFC_Poly08_CoefficientYc3 131072;
BA_ "GenSigStartValue" SG_ 148 VFC_Poly08_CoefficientYc2 65536;
BA_ "GenSigStartValue" SG_ 148 VFC_Poly08_CoefficientYc0 2048;
BA_ "GenSigStartValue" SG_ 148 VFC_Poly08_CoefficientYc1 16384;
BA_ "GenSigStartValue" SG_ 148 VFC_Poly08_CoefficientYc2Corr 65536;
BA_ "GenSigStartValue" SG_ 148 VFC_Poly08_CoefficientYc3Corr 131072;
BA_ "GenSigStartValue" SG_ 149 VFC_Poly09_CoefficientYc3 131072;
BA_ "GenSigStartValue" SG_ 149 VFC_Poly09_CoefficientYc2 65536;
BA_ "GenSigStartValue" SG_ 149 VFC_Poly09_CoefficientYc0 2048;
BA_ "GenSigStartValue" SG_ 149 VFC_Poly09_CoefficientYc1 16384;
BA_ "GenSigStartValue" SG_ 149 VFC_Poly09_CoefficientYc2Corr 65536;
BA_ "GenSigStartValue" SG_ 149 VFC_Poly09_CoefficientYc3Corr 131072;
BA_ "GenSigStartValue" SG_ 149 VFC_Poly10_CoefficientYc3 131072;
BA_ "GenSigStartValue" SG_ 149 VFC_Poly10_CoefficientYc2 65536;
BA_ "GenSigStartValue" SG_ 149 VFC_Poly10_CoefficientYc0 2048;
BA_ "GenSigStartValue" SG_ 149 VFC_Poly10_CoefficientYc1 16384;
BA_ "GenSigStartValue" SG_ 149 VFC_Poly10_CoefficientYc2Corr 65536;
BA_ "GenSigStartValue" SG_ 149 VFC_Poly10_CoefficientYc3Corr 131072;
BA_ "GenSigStartValue" SG_ 149 VFC_Poly11_CoefficientYc3 131072;
BA_ "GenSigStartValue" SG_ 149 VFC_Poly11_CoefficientYc2 65536;
BA_ "GenSigStartValue" SG_ 149 VFC_Poly11_CoefficientYc0 2048;
BA_ "GenSigStartValue" SG_ 149 VFC_Poly11_CoefficientYc1 16384;
BA_ "GenSigStartValue" SG_ 149 VFC_Poly11_CoefficientYc2Corr 65536;
BA_ "GenSigStartValue" SG_ 149 VFC_Poly11_CoefficientYc3Corr 131072;
BA_ "GenSigStartValue" SG_ 150 VFC_Poly12_CoefficientYc3 131072;
BA_ "GenSigStartValue" SG_ 150 VFC_Poly12_CoefficientYc2 65536;
BA_ "GenSigStartValue" SG_ 150 VFC_Poly12_CoefficientYc0 2048;
BA_ "GenSigStartValue" SG_ 150 VFC_Poly12_CoefficientYc1 16384;
BA_ "GenSigStartValue" SG_ 150 VFC_Poly12_CoefficientYc2Corr 65536;
BA_ "GenSigStartValue" SG_ 150 VFC_Poly12_CoefficientYc3Corr 131072;
BA_ "GenSigStartValue" SG_ 150 VFC_Poly13_CoefficientYc3 131072;
BA_ "GenSigStartValue" SG_ 150 VFC_Poly13_CoefficientYc2 65536;
BA_ "GenSigStartValue" SG_ 150 VFC_Poly13_CoefficientYc0 2048;
BA_ "GenSigStartValue" SG_ 150 VFC_Poly13_CoefficientYc1 16384;
BA_ "GenSigStartValue" SG_ 150 VFC_Poly13_CoefficientYc2Corr 65536;
BA_ "GenSigStartValue" SG_ 150 VFC_Poly13_CoefficientYc3Corr 131072;
BA_ "GenSigStartValue" SG_ 150 VFC_Poly14_CoefficientYc3 131072;
BA_ "GenSigStartValue" SG_ 150 VFC_Poly14_CoefficientYc2 65536;
BA_ "GenSigStartValue" SG_ 150 VFC_Poly14_CoefficientYc0 2048;
BA_ "GenSigStartValue" SG_ 150 VFC_Poly14_CoefficientYc1 16384;
BA_ "GenSigStartValue" SG_ 150 VFC_Poly14_CoefficientYc2Corr 65536;
BA_ "GenSigStartValue" SG_ 150 VFC_Poly14_CoefficientYc3Corr 131072;
BA_ "GenSigStartValue" SG_ 162 VFC_2DPoly00_CoefficientUc0 32768;
BA_ "GenSigStartValue" SG_ 162 VFC_2DPoly00_CoefficientUc1 32768;
BA_ "GenSigStartValue" SG_ 162 VFC_2DPoly00_CoefficientUc2 32768;
BA_ "GenSigStartValue" SG_ 162 VFC_2DPoly00_CoefficientUc3 32768;
BA_ "GenSigStartValue" SG_ 162 VFC_2DPoly00_CoefficientUc4 32768;
BA_ "GenSigStartValue" SG_ 162 VFC_2DPoly00_CoefficientUc5 32768;
BA_ "GenSigStartValue" SG_ 162 VFC_2DPoly01_CoefficientUc0 32768;
BA_ "GenSigStartValue" SG_ 162 VFC_2DPoly01_CoefficientUc1 32768;
BA_ "GenSigStartValue" SG_ 162 VFC_2DPoly01_CoefficientUc2 32768;
BA_ "GenSigStartValue" SG_ 162 VFC_2DPoly01_CoefficientUc3 32768;
BA_ "GenSigStartValue" SG_ 162 VFC_2DPoly01_CoefficientUc4 32768;
BA_ "GenSigStartValue" SG_ 162 VFC_2DPoly01_CoefficientUc5 32768;
BA_ "GenSigStartValue" SG_ 162 VFC_2DPoly02_CoefficientUc0 32768;
BA_ "GenSigStartValue" SG_ 162 VFC_2DPoly02_CoefficientUc1 32768;
BA_ "GenSigStartValue" SG_ 162 VFC_2DPoly02_CoefficientUc2 32768;
BA_ "GenSigStartValue" SG_ 162 VFC_2DPoly02_CoefficientUc3 32768;
BA_ "GenSigStartValue" SG_ 162 VFC_2DPoly02_CoefficientUc4 32768;
BA_ "GenSigStartValue" SG_ 162 VFC_2DPoly02_CoefficientUc5 32768;
BA_ "GenSigStartValue" SG_ 163 VFC_2DPoly03_CoefficientUc0 32768;
BA_ "GenSigStartValue" SG_ 163 VFC_2DPoly03_CoefficientUc1 32768;
BA_ "GenSigStartValue" SG_ 163 VFC_2DPoly03_CoefficientUc2 32768;
BA_ "GenSigStartValue" SG_ 163 VFC_2DPoly03_CoefficientUc3 32768;
BA_ "GenSigStartValue" SG_ 163 VFC_2DPoly03_CoefficientUc4 32768;
BA_ "GenSigStartValue" SG_ 163 VFC_2DPoly03_CoefficientUc5 32768;
BA_ "GenSigStartValue" SG_ 163 VFC_2DPoly04_CoefficientUc0 32768;
BA_ "GenSigStartValue" SG_ 163 VFC_2DPoly04_CoefficientUc1 32768;
BA_ "GenSigStartValue" SG_ 163 VFC_2DPoly04_CoefficientUc2 32768;
BA_ "GenSigStartValue" SG_ 163 VFC_2DPoly04_CoefficientUc3 32768;
BA_ "GenSigStartValue" SG_ 163 VFC_2DPoly04_CoefficientUc4 32768;
BA_ "GenSigStartValue" SG_ 163 VFC_2DPoly04_CoefficientUc5 32768;
BA_ "GenSigStartValue" SG_ 163 VFC_2DPoly05_CoefficientUc0 32768;
BA_ "GenSigStartValue" SG_ 163 VFC_2DPoly05_CoefficientUc1 32768;
BA_ "GenSigStartValue" SG_ 163 VFC_2DPoly05_CoefficientUc2 32768;
BA_ "GenSigStartValue" SG_ 163 VFC_2DPoly05_CoefficientUc3 32768;
BA_ "GenSigStartValue" SG_ 163 VFC_2DPoly05_CoefficientUc4 32768;
BA_ "GenSigStartValue" SG_ 163 VFC_2DPoly05_CoefficientUc5 32768;
VAL_ 128 VFC_RoadHdr_RoadType 0 "Motorway" 1 "Motorway roadworks" 2 "Rural" 3 "Urban" ;
VAL_ 128 VFC_RoadHdr_SensorStatus 0 "Off" 1 "On" 2 "Reduced" 3 "HW_Error" 4 "SW_Error" 5 "FID_Active" 6 "Reserved6" 7 "Reserved7" ;
VAL_ 128 VFC_RoadHdr_RoadSurfCondType 0 "Dry" 1 "Wet" 2 "Snow covered" 3 "Reserved3" ;
VAL_ 130 VFC_Cloth00_LaneAssociation 0 "LEFT_EGO_LINE" 1 "RIGHT_EGO_LINE" 2 "LEFT_LEFT_LINE" 3 "RIGHT_RIGHT_LINE" 4 "ROAD_EDGE_LEFT" 5 "ROAD_EDGE_RIGHT" 6 "RAISED_LEFT" 7 "RAISED_RIGHT" 8 "NOT_SELECTED_CANDIDATE" 9 "EGO_TRACK_LEFT" 10 "EGO_TRACK_RIGHT" 11 "HOLISTIC_EGO_LINE" 12 "Reserved12" 13 "Reserved13" 14 "Reserved14" 15 "Reserved15" ;
VAL_ 130 VFC_Cloth00_Colour 0 "COLOR_WHITE" 1 "COLOR_YELLOW" 2 "COLOR_RED" 3 "COLOR_BLUE" 4 "COLOR_GREEN" 5 "RESERVED5" 6 "RESERVED6" 7 "COLOR_UNKNOWN" ;
VAL_ 130 VFC_Cloth00_Type 0 "TYPE_SOLID_LINE" 1 "TYPE_DASHED_LINE" 2 "TYPE_DOUBLE_DASHED_DASHED" 3 "TYPE_DOUBLE_DASHED_SOLID" 4 "TYPE_DOUBLE_SOLID_DASHED" 5 "TYPE_DOUBLE_SOLID_SOLID" 6 "TYPE_MULTIPLE" 7 "TYPE_MULTIPLE_WARNING" 8 "TYPE_BOTTS_DOTS" 9 "TYPE_ROAD_EDGE" 10 "TYPE_ROAD_FURNITURE" 11 "TYPE_CURBSTONE" 12 "TYPE_TRAFFIC_STATIC" 13 "TYPE_UNKNOWN_RAISED" 14 "TYPE_UNKNOWN" 15 "Reserved15" ;
VAL_ 130 VFC_Cloth01_LaneAssociation 0 "LEFT_EGO_LINE" 1 "RIGHT_EGO_LINE" 2 "LEFT_LEFT_LINE" 3 "RIGHT_RIGHT_LINE" 4 "ROAD_EDGE_LEFT" 5 "ROAD_EDGE_RIGHT" 6 "RAISED_LEFT" 7 "RAISED_RIGHT" 8 "NOT_SELECTED_CANDIDATE" 9 "EGO_TRACK_LEFT" 10 "EGO_TRACK_RIGHT" 11 "HOLISTIC_EGO_LINE" 12 "Reserved12" 13 "Reserved13" 14 "Reserved14" 15 "Reserved15" ;
VAL_ 130 VFC_Cloth01_Colour 0 "COLOR_WHITE" 1 "COLOR_YELLOW" 2 "COLOR_RED" 3 "COLOR_BLUE" 4 "COLOR_GREEN" 5 "RESERVED5" 6 "RESERVED6" 7 "COLOR_UNKNOWN" ;
VAL_ 130 VFC_Cloth01_Type 0 "TYPE_SOLID_LINE" 1 "TYPE_DASHED_LINE" 2 "TYPE_DOUBLE_DASHED_DASHED" 3 "TYPE_DOUBLE_DASHED_SOLID" 4 "TYPE_DOUBLE_SOLID_DASHED" 5 "TYPE_DOUBLE_SOLID_SOLID" 6 "TYPE_MULTIPLE" 7 "TYPE_MULTIPLE_WARNING" 8 "TYPE_BOTTS_DOTS" 9 "TYPE_ROAD_EDGE" 10 "TYPE_ROAD_FURNITURE" 11 "TYPE_CURBSTONE" 12 "TYPE_TRAFFIC_STATIC" 13 "TYPE_UNKNOWN_RAISED" 14 "TYPE_UNKNOWN" 15 "Reserved15" ;
VAL_ 130 VFC_Cloth02_LaneAssociation 0 "LEFT_EGO_LINE" 1 "RIGHT_EGO_LINE" 2 "LEFT_LEFT_LINE" 3 "RIGHT_RIGHT_LINE" 4 "ROAD_EDGE_LEFT" 5 "ROAD_EDGE_RIGHT" 6 "RAISED_LEFT" 7 "RAISED_RIGHT" 8 "NOT_SELECTED_CANDIDATE" 9 "EGO_TRACK_LEFT" 10 "EGO_TRACK_RIGHT" 11 "HOLISTIC_EGO_LINE" 12 "Reserved12" 13 "Reserved13" 14 "Reserved14" 15 "Reserved15" ;
VAL_ 130 VFC_Cloth02_Colour 0 "COLOR_WHITE" 1 "COLOR_YELLOW" 2 "COLOR_RED" 3 "COLOR_BLUE" 4 "COLOR_GREEN" 5 "RESERVED5" 6 "RESERVED6" 7 "COLOR_UNKNOWN" ;
VAL_ 130 VFC_Cloth02_Type 0 "TYPE_SOLID_LINE" 1 "TYPE_DASHED_LINE" 2 "TYPE_DOUBLE_DASHED_DASHED" 3 "TYPE_DOUBLE_DASHED_SOLID" 4 "TYPE_DOUBLE_SOLID_DASHED" 5 "TYPE_DOUBLE_SOLID_SOLID" 6 "TYPE_MULTIPLE" 7 "TYPE_MULTIPLE_WARNING" 8 "TYPE_BOTTS_DOTS" 9 "TYPE_ROAD_EDGE" 10 "TYPE_ROAD_FURNITURE" 11 "TYPE_CURBSTONE" 12 "TYPE_TRAFFIC_STATIC" 13 "TYPE_UNKNOWN_RAISED" 14 "TYPE_UNKNOWN" 15 "Reserved15" ;
VAL_ 131 VFC_Cloth03_LaneAssociation 0 "LEFT_EGO_LINE" 1 "RIGHT_EGO_LINE" 2 "LEFT_LEFT_LINE" 3 "RIGHT_RIGHT_LINE" 4 "ROAD_EDGE_LEFT" 5 "ROAD_EDGE_RIGHT" 6 "RAISED_LEFT" 7 "RAISED_RIGHT" 8 "NOT_SELECTED_CANDIDATE" 9 "EGO_TRACK_LEFT" 10 "EGO_TRACK_RIGHT" 11 "HOLISTIC_EGO_LINE" 12 "Reserved12" 13 "Reserved13" 14 "Reserved14" 15 "Reserved15" ;
VAL_ 131 VFC_Cloth03_Colour 0 "COLOR_WHITE" 1 "COLOR_YELLOW" 2 "COLOR_RED" 3 "COLOR_BLUE" 4 "COLOR_GREEN" 5 "RESERVED5" 6 "RESERVED6" 7 "COLOR_UNKNOWN" ;
VAL_ 131 VFC_Cloth03_Type 0 "TYPE_SOLID_LINE" 1 "TYPE_DASHED_LINE" 2 "TYPE_DOUBLE_DASHED_DASHED" 3 "TYPE_DOUBLE_DASHED_SOLID" 4 "TYPE_DOUBLE_SOLID_DASHED" 5 "TYPE_DOUBLE_SOLID_SOLID" 6 "TYPE_MULTIPLE" 7 "TYPE_MULTIPLE_WARNING" 8 "TYPE_BOTTS_DOTS" 9 "TYPE_ROAD_EDGE" 10 "TYPE_ROAD_FURNITURE" 11 "TYPE_CURBSTONE" 12 "TYPE_TRAFFIC_STATIC" 13 "TYPE_UNKNOWN_RAISED" 14 "TYPE_UNKNOWN" 15 "Reserved15" ;
VAL_ 131 VFC_Cloth04_LaneAssociation 0 "LEFT_EGO_LINE" 1 "RIGHT_EGO_LINE" 2 "LEFT_LEFT_LINE" 3 "RIGHT_RIGHT_LINE" 4 "ROAD_EDGE_LEFT" 5 "ROAD_EDGE_RIGHT" 6 "RAISED_LEFT" 7 "RAISED_RIGHT" 8 "NOT_SELECTED_CANDIDATE" 9 "EGO_TRACK_LEFT" 10 "EGO_TRACK_RIGHT" 11 "HOLISTIC_EGO_LINE" 12 "Reserved12" 13 "Reserved13" 14 "Reserved14" 15 "Reserved15" ;
VAL_ 131 VFC_Cloth04_Colour 0 "COLOR_WHITE" 1 "COLOR_YELLOW" 2 "COLOR_RED" 3 "COLOR_BLUE" 4 "COLOR_GREEN" 5 "RESERVED5" 6 "RESERVED6" 7 "COLOR_UNKNOWN" ;
VAL_ 131 VFC_Cloth04_Type 0 "TYPE_SOLID_LINE" 1 "TYPE_DASHED_LINE" 2 "TYPE_DOUBLE_DASHED_DASHED" 3 "TYPE_DOUBLE_DASHED_SOLID" 4 "TYPE_DOUBLE_SOLID_DASHED" 5 "TYPE_DOUBLE_SOLID_SOLID" 6 "TYPE_MULTIPLE" 7 "TYPE_MULTIPLE_WARNING" 8 "TYPE_BOTTS_DOTS" 9 "TYPE_ROAD_EDGE" 10 "TYPE_ROAD_FURNITURE" 11 "TYPE_CURBSTONE" 12 "TYPE_TRAFFIC_STATIC" 13 "TYPE_UNKNOWN_RAISED" 14 "TYPE_UNKNOWN" 15 "Reserved15" ;
VAL_ 131 VFC_Cloth05_LaneAssociation 0 "LEFT_EGO_LINE" 1 "RIGHT_EGO_LINE" 2 "LEFT_LEFT_LINE" 3 "RIGHT_RIGHT_LINE" 4 "ROAD_EDGE_LEFT" 5 "ROAD_EDGE_RIGHT" 6 "RAISED_LEFT" 7 "RAISED_RIGHT" 8 "NOT_SELECTED_CANDIDATE" 9 "EGO_TRACK_LEFT" 10 "EGO_TRACK_RIGHT" 11 "HOLISTIC_EGO_LINE" 12 "Reserved12" 13 "Reserved13" 14 "Reserved14" 15 "Reserved15" ;
VAL_ 131 VFC_Cloth05_Colour 0 "COLOR_WHITE" 1 "COLOR_YELLOW" 2 "COLOR_RED" 3 "COLOR_BLUE" 4 "COLOR_GREEN" 5 "RESERVED5" 6 "RESERVED6" 7 "COLOR_UNKNOWN" ;
VAL_ 131 VFC_Cloth05_Type 0 "TYPE_SOLID_LINE" 1 "TYPE_DASHED_LINE" 2 "TYPE_DOUBLE_DASHED_DASHED" 3 "TYPE_DOUBLE_DASHED_SOLID" 4 "TYPE_DOUBLE_SOLID_DASHED" 5 "TYPE_DOUBLE_SOLID_SOLID" 6 "TYPE_MULTIPLE" 7 "TYPE_MULTIPLE_WARNING" 8 "TYPE_BOTTS_DOTS" 9 "TYPE_ROAD_EDGE" 10 "TYPE_ROAD_FURNITURE" 11 "TYPE_CURBSTONE" 12 "TYPE_TRAFFIC_STATIC" 13 "TYPE_UNKNOWN_RAISED" 14 "TYPE_UNKNOWN" 15 "Reserved15" ;
VAL_ 132 VFC_Cloth06_LaneAssociation 0 "LEFT_EGO_LINE" 1 "RIGHT_EGO_LINE" 2 "LEFT_LEFT_LINE" 3 "RIGHT_RIGHT_LINE" 4 "ROAD_EDGE_LEFT" 5 "ROAD_EDGE_RIGHT" 6 "RAISED_LEFT" 7 "RAISED_RIGHT" 8 "NOT_SELECTED_CANDIDATE" 9 "EGO_TRACK_LEFT" 10 "EGO_TRACK_RIGHT" 11 "HOLISTIC_EGO_LINE" 12 "Reserved12" 13 "Reserved13" 14 "Reserved14" 15 "Reserved15" ;
VAL_ 132 VFC_Cloth06_Colour 0 "COLOR_WHITE" 1 "COLOR_YELLOW" 2 "COLOR_RED" 3 "COLOR_BLUE" 4 "COLOR_GREEN" 5 "RESERVED5" 6 "RESERVED6" 7 "COLOR_UNKNOWN" ;
VAL_ 132 VFC_Cloth06_Type 0 "TYPE_SOLID_LINE" 1 "TYPE_DASHED_LINE" 2 "TYPE_DOUBLE_DASHED_DASHED" 3 "TYPE_DOUBLE_DASHED_SOLID" 4 "TYPE_DOUBLE_SOLID_DASHED" 5 "TYPE_DOUBLE_SOLID_SOLID" 6 "TYPE_MULTIPLE" 7 "TYPE_MULTIPLE_WARNING" 8 "TYPE_BOTTS_DOTS" 9 "TYPE_ROAD_EDGE" 10 "TYPE_ROAD_FURNITURE" 11 "TYPE_CURBSTONE" 12 "TYPE_TRAFFIC_STATIC" 13 "TYPE_UNKNOWN_RAISED" 14 "TYPE_UNKNOWN" 15 "Reserved15" ;
VAL_ 132 VFC_Cloth07_LaneAssociation 0 "LEFT_EGO_LINE" 1 "RIGHT_EGO_LINE" 2 "LEFT_LEFT_LINE" 3 "RIGHT_RIGHT_LINE" 4 "ROAD_EDGE_LEFT" 5 "ROAD_EDGE_RIGHT" 6 "RAISED_LEFT" 7 "RAISED_RIGHT" 8 "NOT_SELECTED_CANDIDATE" 9 "EGO_TRACK_LEFT" 10 "EGO_TRACK_RIGHT" 11 "HOLISTIC_EGO_LINE" 12 "Reserved12" 13 "Reserved13" 14 "Reserved14" 15 "Reserved15" ;
VAL_ 132 VFC_Cloth07_Colour 0 "COLOR_WHITE" 1 "COLOR_YELLOW" 2 "COLOR_RED" 3 "COLOR_BLUE" 4 "COLOR_GREEN" 5 "RESERVED5" 6 "RESERVED6" 7 "COLOR_UNKNOWN" ;
VAL_ 132 VFC_Cloth07_Type 0 "TYPE_SOLID_LINE" 1 "TYPE_DASHED_LINE" 2 "TYPE_DOUBLE_DASHED_DASHED" 3 "TYPE_DOUBLE_DASHED_SOLID" 4 "TYPE_DOUBLE_SOLID_DASHED" 5 "TYPE_DOUBLE_SOLID_SOLID" 6 "TYPE_MULTIPLE" 7 "TYPE_MULTIPLE_WARNING" 8 "TYPE_BOTTS_DOTS" 9 "TYPE_ROAD_EDGE" 10 "TYPE_ROAD_FURNITURE" 11 "TYPE_CURBSTONE" 12 "TYPE_TRAFFIC_STATIC" 13 "TYPE_UNKNOWN_RAISED" 14 "TYPE_UNKNOWN" 15 "Reserved15" ;
VAL_ 132 VFC_Cloth08_LaneAssociation 0 "LEFT_EGO_LINE" 1 "RIGHT_EGO_LINE" 2 "LEFT_LEFT_LINE" 3 "RIGHT_RIGHT_LINE" 4 "ROAD_EDGE_LEFT" 5 "ROAD_EDGE_RIGHT" 6 "RAISED_LEFT" 7 "RAISED_RIGHT" 8 "NOT_SELECTED_CANDIDATE" 9 "EGO_TRACK_LEFT" 10 "EGO_TRACK_RIGHT" 11 "HOLISTIC_EGO_LINE" 12 "Reserved12" 13 "Reserved13" 14 "Reserved14" 15 "Reserved15" ;
VAL_ 132 VFC_Cloth08_Colour 0 "COLOR_WHITE" 1 "COLOR_YELLOW" 2 "COLOR_RED" 3 "COLOR_BLUE" 4 "COLOR_GREEN" 5 "RESERVED5" 6 "RESERVED6" 7 "COLOR_UNKNOWN" ;
VAL_ 132 VFC_Cloth08_Type 0 "TYPE_SOLID_LINE" 1 "TYPE_DASHED_LINE" 2 "TYPE_DOUBLE_DASHED_DASHED" 3 "TYPE_DOUBLE_DASHED_SOLID" 4 "TYPE_DOUBLE_SOLID_DASHED" 5 "TYPE_DOUBLE_SOLID_SOLID" 6 "TYPE_MULTIPLE" 7 "TYPE_MULTIPLE_WARNING" 8 "TYPE_BOTTS_DOTS" 9 "TYPE_ROAD_EDGE" 10 "TYPE_ROAD_FURNITURE" 11 "TYPE_CURBSTONE" 12 "TYPE_TRAFFIC_STATIC" 13 "TYPE_UNKNOWN_RAISED" 14 "TYPE_UNKNOWN" 15 "Reserved15" ;
VAL_ 133 VFC_Cloth09_LaneAssociation 0 "LEFT_EGO_LINE" 1 "RIGHT_EGO_LINE" 2 "LEFT_LEFT_LINE" 3 "RIGHT_RIGHT_LINE" 4 "ROAD_EDGE_LEFT" 5 "ROAD_EDGE_RIGHT" 6 "RAISED_LEFT" 7 "RAISED_RIGHT" 8 "NOT_SELECTED_CANDIDATE" 9 "EGO_TRACK_LEFT" 10 "EGO_TRACK_RIGHT" 11 "HOLISTIC_EGO_LINE" 12 "Reserved12" 13 "Reserved13" 14 "Reserved14" 15 "Reserved15" ;
VAL_ 133 VFC_Cloth09_Colour 0 "COLOR_WHITE" 1 "COLOR_YELLOW" 2 "COLOR_RED" 3 "COLOR_BLUE" 4 "COLOR_GREEN" 5 "RESERVED5" 6 "RESERVED6" 7 "COLOR_UNKNOWN" ;
VAL_ 133 VFC_Cloth09_Type 0 "TYPE_SOLID_LINE" 1 "TYPE_DASHED_LINE" 2 "TYPE_DOUBLE_DASHED_DASHED" 3 "TYPE_DOUBLE_DASHED_SOLID" 4 "TYPE_DOUBLE_SOLID_DASHED" 5 "TYPE_DOUBLE_SOLID_SOLID" 6 "TYPE_MULTIPLE" 7 "TYPE_MULTIPLE_WARNING" 8 "TYPE_BOTTS_DOTS" 9 "TYPE_ROAD_EDGE" 10 "TYPE_ROAD_FURNITURE" 11 "TYPE_CURBSTONE" 12 "TYPE_TRAFFIC_STATIC" 13 "TYPE_UNKNOWN_RAISED" 14 "TYPE_UNKNOWN" 15 "Reserved15" ;
VAL_ 133 VFC_Cloth10_LaneAssociation 0 "LEFT_EGO_LINE" 1 "RIGHT_EGO_LINE" 2 "LEFT_LEFT_LINE" 3 "RIGHT_RIGHT_LINE" 4 "ROAD_EDGE_LEFT" 5 "ROAD_EDGE_RIGHT" 6 "RAISED_LEFT" 7 "RAISED_RIGHT" 8 "NOT_SELECTED_CANDIDATE" 9 "EGO_TRACK_LEFT" 10 "EGO_TRACK_RIGHT" 11 "HOLISTIC_EGO_LINE" 12 "Reserved12" 13 "Reserved13" 14 "Reserved14" 15 "Reserved15" ;
VAL_ 133 VFC_Cloth10_Colour 0 "COLOR_WHITE" 1 "COLOR_YELLOW" 2 "COLOR_RED" 3 "COLOR_BLUE" 4 "COLOR_GREEN" 5 "RESERVED5" 6 "RESERVED6" 7 "COLOR_UNKNOWN" ;
VAL_ 133 VFC_Cloth10_Type 0 "TYPE_SOLID_LINE" 1 "TYPE_DASHED_LINE" 2 "TYPE_DOUBLE_DASHED_DASHED" 3 "TYPE_DOUBLE_DASHED_SOLID" 4 "TYPE_DOUBLE_SOLID_DASHED" 5 "TYPE_DOUBLE_SOLID_SOLID" 6 "TYPE_MULTIPLE" 7 "TYPE_MULTIPLE_WARNING" 8 "TYPE_BOTTS_DOTS" 9 "TYPE_ROAD_EDGE" 10 "TYPE_ROAD_FURNITURE" 11 "TYPE_CURBSTONE" 12 "TYPE_TRAFFIC_STATIC" 13 "TYPE_UNKNOWN_RAISED" 14 "TYPE_UNKNOWN" 15 "Reserved15" ;
VAL_ 133 VFC_Cloth11_LaneAssociation 0 "LEFT_EGO_LINE" 1 "RIGHT_EGO_LINE" 2 "LEFT_LEFT_LINE" 3 "RIGHT_RIGHT_LINE" 4 "ROAD_EDGE_LEFT" 5 "ROAD_EDGE_RIGHT" 6 "RAISED_LEFT" 7 "RAISED_RIGHT" 8 "NOT_SELECTED_CANDIDATE" 9 "EGO_TRACK_LEFT" 10 "EGO_TRACK_RIGHT" 11 "HOLISTIC_EGO_LINE" 12 "Reserved12" 13 "Reserved13" 14 "Reserved14" 15 "Reserved15" ;
VAL_ 133 VFC_Cloth11_Colour 0 "COLOR_WHITE" 1 "COLOR_YELLOW" 2 "COLOR_RED" 3 "COLOR_BLUE" 4 "COLOR_GREEN" 5 "RESERVED5" 6 "RESERVED6" 7 "COLOR_UNKNOWN" ;
VAL_ 133 VFC_Cloth11_Type 0 "TYPE_SOLID_LINE" 1 "TYPE_DASHED_LINE" 2 "TYPE_DOUBLE_DASHED_DASHED" 3 "TYPE_DOUBLE_DASHED_SOLID" 4 "TYPE_DOUBLE_SOLID_DASHED" 5 "TYPE_DOUBLE_SOLID_SOLID" 6 "TYPE_MULTIPLE" 7 "TYPE_MULTIPLE_WARNING" 8 "TYPE_BOTTS_DOTS" 9 "TYPE_ROAD_EDGE" 10 "TYPE_ROAD_FURNITURE" 11 "TYPE_CURBSTONE" 12 "TYPE_TRAFFIC_STATIC" 13 "TYPE_UNKNOWN_RAISED" 14 "TYPE_UNKNOWN" 15 "Reserved15" ;
VAL_ 146 VFC_Poly00_LaneAssociation 0 "LEFT_EGO_LINE" 1 "RIGHT_EGO_LINE" 2 "LEFT_LEFT_LINE" 3 "RIGHT_RIGHT_LINE" 4 "ROAD_EDGE_LEFT" 5 "ROAD_EDGE_RIGHT" 6 "RAISED_LEFT" 7 "RAISED_RIGHT" 8 "NOT_SELECTED_CANDIDATE" 9 "EGO_TRACK_LEFT" 10 "EGO_TRACK_RIGHT" 11 "HOLISTIC_EGO_LINE" 12 "Reserved12" 13 "Reserved13" 14 "Reserved14" 15 "Reserved15" ;
VAL_ 146 VFC_Poly00_Type 0 "TYPE_SOLID_LINE" 1 "TYPE_DASHED_LINE" 2 "TYPE_DOUBLE_DASHED_DASHED" 3 "TYPE_DOUBLE_DASHED_SOLID" 4 "TYPE_DOUBLE_SOLID_DASHED" 5 "TYPE_DOUBLE_SOLID_SOLID" 6 "TYPE_MULTIPLE" 7 "TYPE_MULTIPLE_WARNING" 8 "TYPE_BOTTS_DOTS" 9 "TYPE_ROAD_EDGE" 10 "TYPE_ROAD_FURNITURE" 11 "TYPE_CURBSTONE" 12 "TYPE_TRAFFIC_STATIC" 13 "TYPE_UNKNOWN_RAISED" 14 "TYPE_UNKNOWN" 15 "Reserved15" ;
VAL_ 146 VFC_Poly00_Colour 0 "COLOR_WHITE" 1 "COLOR_YELLOW" 2 "COLOR_RED" 3 "COLOR_BLUE" 4 "COLOR_GREEN" 5 "RESERVED5" 6 "RESERVED6" 7 "COLOR_UNKNOWN" ;
VAL_ 146 VFC_Poly01_LaneAssociation 0 "LEFT_EGO_LINE" 1 "RIGHT_EGO_LINE" 2 "LEFT_LEFT_LINE" 3 "RIGHT_RIGHT_LINE" 4 "ROAD_EDGE_LEFT" 5 "ROAD_EDGE_RIGHT" 6 "RAISED_LEFT" 7 "RAISED_RIGHT" 8 "NOT_SELECTED_CANDIDATE" 9 "EGO_TRACK_LEFT" 10 "EGO_TRACK_RIGHT" 11 "HOLISTIC_EGO_LINE" 12 "Reserved12" 13 "Reserved13" 14 "Reserved14" 15 "Reserved15" ;
VAL_ 146 VFC_Poly01_Type 0 "TYPE_SOLID_LINE" 1 "TYPE_DASHED_LINE" 2 "TYPE_DOUBLE_DASHED_DASHED" 3 "TYPE_DOUBLE_DASHED_SOLID" 4 "TYPE_DOUBLE_SOLID_DASHED" 5 "TYPE_DOUBLE_SOLID_SOLID" 6 "TYPE_MULTIPLE" 7 "TYPE_MULTIPLE_WARNING" 8 "TYPE_BOTTS_DOTS" 9 "TYPE_ROAD_EDGE" 10 "TYPE_ROAD_FURNITURE" 11 "TYPE_CURBSTONE" 12 "TYPE_TRAFFIC_STATIC" 13 "TYPE_UNKNOWN_RAISED" 14 "TYPE_UNKNOWN" 15 "Reserved15" ;
VAL_ 146 VFC_Poly01_Colour 0 "COLOR_WHITE" 1 "COLOR_YELLOW" 2 "COLOR_RED" 3 "COLOR_BLUE" 4 "COLOR_GREEN" 5 "RESERVED5" 6 "RESERVED6" 7 "COLOR_UNKNOWN" ;
VAL_ 146 VFC_Poly02_LaneAssociation 0 "LEFT_EGO_LINE" 1 "RIGHT_EGO_LINE" 2 "LEFT_LEFT_LINE" 3 "RIGHT_RIGHT_LINE" 4 "ROAD_EDGE_LEFT" 5 "ROAD_EDGE_RIGHT" 6 "RAISED_LEFT" 7 "RAISED_RIGHT" 8 "NOT_SELECTED_CANDIDATE" 9 "EGO_TRACK_LEFT" 10 "EGO_TRACK_RIGHT" 11 "HOLISTIC_EGO_LINE" 12 "Reserved12" 13 "Reserved13" 14 "Reserved14" 15 "Reserved15" ;
VAL_ 146 VFC_Poly02_Type 0 "TYPE_SOLID_LINE" 1 "TYPE_DASHED_LINE" 2 "TYPE_DOUBLE_DASHED_DASHED" 3 "TYPE_DOUBLE_DASHED_SOLID" 4 "TYPE_DOUBLE_SOLID_DASHED" 5 "TYPE_DOUBLE_SOLID_SOLID" 6 "TYPE_MULTIPLE" 7 "TYPE_MULTIPLE_WARNING" 8 "TYPE_BOTTS_DOTS" 9 "TYPE_ROAD_EDGE" 10 "TYPE_ROAD_FURNITURE" 11 "TYPE_CURBSTONE" 12 "TYPE_TRAFFIC_STATIC" 13 "TYPE_UNKNOWN_RAISED" 14 "TYPE_UNKNOWN" 15 "Reserved15" ;
VAL_ 146 VFC_Poly02_Colour 0 "COLOR_WHITE" 1 "COLOR_YELLOW" 2 "COLOR_RED" 3 "COLOR_BLUE" 4 "COLOR_GREEN" 5 "RESERVED5" 6 "RESERVED6" 7 "COLOR_UNKNOWN" ;
VAL_ 147 VFC_Poly03_LaneAssociation 0 "LEFT_EGO_LINE" 1 "RIGHT_EGO_LINE" 2 "LEFT_LEFT_LINE" 3 "RIGHT_RIGHT_LINE" 4 "ROAD_EDGE_LEFT" 5 "ROAD_EDGE_RIGHT" 6 "RAISED_LEFT" 7 "RAISED_RIGHT" 8 "NOT_SELECTED_CANDIDATE" 9 "EGO_TRACK_LEFT" 10 "EGO_TRACK_RIGHT" 11 "HOLISTIC_EGO_LINE" 12 "Reserved12" 13 "Reserved13" 14 "Reserved14" 15 "Reserved15" ;
VAL_ 147 VFC_Poly03_Type 0 "TYPE_SOLID_LINE" 1 "TYPE_DASHED_LINE" 2 "TYPE_DOUBLE_DASHED_DASHED" 3 "TYPE_DOUBLE_DASHED_SOLID" 4 "TYPE_DOUBLE_SOLID_DASHED" 5 "TYPE_DOUBLE_SOLID_SOLID" 6 "TYPE_MULTIPLE" 7 "TYPE_MULTIPLE_WARNING" 8 "TYPE_BOTTS_DOTS" 9 "TYPE_ROAD_EDGE" 10 "TYPE_ROAD_FURNITURE" 11 "TYPE_CURBSTONE" 12 "TYPE_TRAFFIC_STATIC" 13 "TYPE_UNKNOWN_RAISED" 14 "TYPE_UNKNOWN" 15 "Reserved15" ;
VAL_ 147 VFC_Poly03_Colour 0 "COLOR_WHITE" 1 "COLOR_YELLOW" 2 "COLOR_RED" 3 "COLOR_BLUE" 4 "COLOR_GREEN" 5 "RESERVED5" 6 "RESERVED6" 7 "COLOR_UNKNOWN" ;
VAL_ 147 VFC_Poly04_LaneAssociation 0 "LEFT_EGO_LINE" 1 "RIGHT_EGO_LINE" 2 "LEFT_LEFT_LINE" 3 "RIGHT_RIGHT_LINE" 4 "ROAD_EDGE_LEFT" 5 "ROAD_EDGE_RIGHT" 6 "RAISED_LEFT" 7 "RAISED_RIGHT" 8 "NOT_SELECTED_CANDIDATE" 9 "EGO_TRACK_LEFT" 10 "EGO_TRACK_RIGHT" 11 "HOLISTIC_EGO_LINE" 12 "Reserved12" 13 "Reserved13" 14 "Reserved14" 15 "Reserved15" ;
VAL_ 147 VFC_Poly04_Type 0 "TYPE_SOLID_LINE" 1 "TYPE_DASHED_LINE" 2 "TYPE_DOUBLE_DASHED_DASHED" 3 "TYPE_DOUBLE_DASHED_SOLID" 4 "TYPE_DOUBLE_SOLID_DASHED" 5 "TYPE_DOUBLE_SOLID_SOLID" 6 "TYPE_MULTIPLE" 7 "TYPE_MULTIPLE_WARNING" 8 "TYPE_BOTTS_DOTS" 9 "TYPE_ROAD_EDGE" 10 "TYPE_ROAD_FURNITURE" 11 "TYPE_CURBSTONE" 12 "TYPE_TRAFFIC_STATIC" 13 "TYPE_UNKNOWN_RAISED" 14 "TYPE_UNKNOWN" 15 "Reserved15" ;
VAL_ 147 VFC_Poly04_Colour 0 "COLOR_WHITE" 1 "COLOR_YELLOW" 2 "COLOR_RED" 3 "COLOR_BLUE" 4 "COLOR_GREEN" 5 "RESERVED5" 6 "RESERVED6" 7 "COLOR_UNKNOWN" ;
VAL_ 147 VFC_Poly05_LaneAssociation 0 "LEFT_EGO_LINE" 1 "RIGHT_EGO_LINE" 2 "LEFT_LEFT_LINE" 3 "RIGHT_RIGHT_LINE" 4 "ROAD_EDGE_LEFT" 5 "ROAD_EDGE_RIGHT" 6 "RAISED_LEFT" 7 "RAISED_RIGHT" 8 "NOT_SELECTED_CANDIDATE" 9 "EGO_TRACK_LEFT" 10 "EGO_TRACK_RIGHT" 11 "HOLISTIC_EGO_LINE" 12 "Reserved12" 13 "Reserved13" 14 "Reserved14" 15 "Reserved15" ;
VAL_ 147 VFC_Poly05_Type 0 "TYPE_SOLID_LINE" 1 "TYPE_DASHED_LINE" 2 "TYPE_DOUBLE_DASHED_DASHED" 3 "TYPE_DOUBLE_DASHED_SOLID" 4 "TYPE_DOUBLE_SOLID_DASHED" 5 "TYPE_DOUBLE_SOLID_SOLID" 6 "TYPE_MULTIPLE" 7 "TYPE_MULTIPLE_WARNING" 8 "TYPE_BOTTS_DOTS" 9 "TYPE_ROAD_EDGE" 10 "TYPE_ROAD_FURNITURE" 11 "TYPE_CURBSTONE" 12 "TYPE_TRAFFIC_STATIC" 13 "TYPE_UNKNOWN_RAISED" 14 "TYPE_UNKNOWN" 15 "Reserved15" ;
VAL_ 147 VFC_Poly05_Colour 0 "COLOR_WHITE" 1 "COLOR_YELLOW" 2 "COLOR_RED" 3 "COLOR_BLUE" 4 "COLOR_GREEN" 5 "RESERVED5" 6 "RESERVED6" 7 "COLOR_UNKNOWN" ;
VAL_ 148 VFC_Poly06_LaneAssociation 0 "LEFT_EGO_LINE" 1 "RIGHT_EGO_LINE" 2 "LEFT_LEFT_LINE" 3 "RIGHT_RIGHT_LINE" 4 "ROAD_EDGE_LEFT" 5 "ROAD_EDGE_RIGHT" 6 "RAISED_LEFT" 7 "RAISED_RIGHT" 8 "NOT_SELECTED_CANDIDATE" 9 "EGO_TRACK_LEFT" 10 "EGO_TRACK_RIGHT" 11 "HOLISTIC_EGO_LINE" 12 "Reserved12" 13 "Reserved13" 14 "Reserved14" 15 "Reserved15" ;
VAL_ 148 VFC_Poly06_Type 0 "TYPE_SOLID_LINE" 1 "TYPE_DASHED_LINE" 2 "TYPE_DOUBLE_DASHED_DASHED" 3 "TYPE_DOUBLE_DASHED_SOLID" 4 "TYPE_DOUBLE_SOLID_DASHED" 5 "TYPE_DOUBLE_SOLID_SOLID" 6 "TYPE_MULTIPLE" 7 "TYPE_MULTIPLE_WARNING" 8 "TYPE_BOTTS_DOTS" 9 "TYPE_ROAD_EDGE" 10 "TYPE_ROAD_FURNITURE" 11 "TYPE_CURBSTONE" 12 "TYPE_TRAFFIC_STATIC" 13 "TYPE_UNKNOWN_RAISED" 14 "TYPE_UNKNOWN" 15 "Reserved15" ;
VAL_ 148 VFC_Poly06_Colour 0 "COLOR_WHITE" 1 "COLOR_YELLOW" 2 "COLOR_RED" 3 "COLOR_BLUE" 4 "COLOR_GREEN" 5 "RESERVED5" 6 "RESERVED6" 7 "COLOR_UNKNOWN" ;
VAL_ 148 VFC_Poly07_LaneAssociation 0 "LEFT_EGO_LINE" 1 "RIGHT_EGO_LINE" 2 "LEFT_LEFT_LINE" 3 "RIGHT_RIGHT_LINE" 4 "ROAD_EDGE_LEFT" 5 "ROAD_EDGE_RIGHT" 6 "RAISED_LEFT" 7 "RAISED_RIGHT" 8 "NOT_SELECTED_CANDIDATE" 9 "EGO_TRACK_LEFT" 10 "EGO_TRACK_RIGHT" 11 "HOLISTIC_EGO_LINE" 12 "Reserved12" 13 "Reserved13" 14 "Reserved14" 15 "Reserved15" ;
VAL_ 148 VFC_Poly07_Type 0 "TYPE_SOLID_LINE" 1 "TYPE_DASHED_LINE" 2 "TYPE_DOUBLE_DASHED_DASHED" 3 "TYPE_DOUBLE_DASHED_SOLID" 4 "TYPE_DOUBLE_SOLID_DASHED" 5 "TYPE_DOUBLE_SOLID_SOLID" 6 "TYPE_MULTIPLE" 7 "TYPE_MULTIPLE_WARNING" 8 "TYPE_BOTTS_DOTS" 9 "TYPE_ROAD_EDGE" 10 "TYPE_ROAD_FURNITURE" 11 "TYPE_CURBSTONE" 12 "TYPE_TRAFFIC_STATIC" 13 "TYPE_UNKNOWN_RAISED" 14 "TYPE_UNKNOWN" 15 "Reserved15" ;
VAL_ 148 VFC_Poly07_Colour 0 "COLOR_WHITE" 1 "COLOR_YELLOW" 2 "COLOR_RED" 3 "COLOR_BLUE" 4 "COLOR_GREEN" 5 "RESERVED5" 6 "RESERVED6" 7 "COLOR_UNKNOWN" ;
VAL_ 148 VFC_Poly08_LaneAssociation 0 "LEFT_EGO_LINE" 1 "RIGHT_EGO_LINE" 2 "LEFT_LEFT_LINE" 3 "RIGHT_RIGHT_LINE" 4 "ROAD_EDGE_LEFT" 5 "ROAD_EDGE_RIGHT" 6 "RAISED_LEFT" 7 "RAISED_RIGHT" 8 "NOT_SELECTED_CANDIDATE" 9 "EGO_TRACK_LEFT" 10 "EGO_TRACK_RIGHT" 11 "HOLISTIC_EGO_LINE" 12 "Reserved12" 13 "Reserved13" 14 "Reserved14" 15 "Reserved15" ;
VAL_ 148 VFC_Poly08_Type 0 "TYPE_SOLID_LINE" 1 "TYPE_DASHED_LINE" 2 "TYPE_DOUBLE_DASHED_DASHED" 3 "TYPE_DOUBLE_DASHED_SOLID" 4 "TYPE_DOUBLE_SOLID_DASHED" 5 "TYPE_DOUBLE_SOLID_SOLID" 6 "TYPE_MULTIPLE" 7 "TYPE_MULTIPLE_WARNING" 8 "TYPE_BOTTS_DOTS" 9 "TYPE_ROAD_EDGE" 10 "TYPE_ROAD_FURNITURE" 11 "TYPE_CURBSTONE" 12 "TYPE_TRAFFIC_STATIC" 13 "TYPE_UNKNOWN_RAISED" 14 "TYPE_UNKNOWN" 15 "Reserved15" ;
VAL_ 148 VFC_Poly08_Colour 0 "COLOR_WHITE" 1 "COLOR_YELLOW" 2 "COLOR_RED" 3 "COLOR_BLUE" 4 "COLOR_GREEN" 5 "RESERVED5" 6 "RESERVED6" 7 "COLOR_UNKNOWN" ;
VAL_ 149 VFC_Poly09_LaneAssociation 0 "LEFT_EGO_LINE" 1 "RIGHT_EGO_LINE" 2 "LEFT_LEFT_LINE" 3 "RIGHT_RIGHT_LINE" 4 "ROAD_EDGE_LEFT" 5 "ROAD_EDGE_RIGHT" 6 "RAISED_LEFT" 7 "RAISED_RIGHT" 8 "NOT_SELECTED_CANDIDATE" 9 "EGO_TRACK_LEFT" 10 "EGO_TRACK_RIGHT" 11 "HOLISTIC_EGO_LINE" 12 "Reserved12" 13 "Reserved13" 14 "Reserved14" 15 "Reserved15" ;
VAL_ 149 VFC_Poly09_Type 0 "TYPE_SOLID_LINE" 1 "TYPE_DASHED_LINE" 2 "TYPE_DOUBLE_DASHED_DASHED" 3 "TYPE_DOUBLE_DASHED_SOLID" 4 "TYPE_DOUBLE_SOLID_DASHED" 5 "TYPE_DOUBLE_SOLID_SOLID" 6 "TYPE_MULTIPLE" 7 "TYPE_MULTIPLE_WARNING" 8 "TYPE_BOTTS_DOTS" 9 "TYPE_ROAD_EDGE" 10 "TYPE_ROAD_FURNITURE" 11 "TYPE_CURBSTONE" 12 "TYPE_TRAFFIC_STATIC" 13 "TYPE_UNKNOWN_RAISED" 14 "TYPE_UNKNOWN" 15 "Reserved15" ;
VAL_ 149 VFC_Poly09_Colour 0 "COLOR_WHITE" 1 "COLOR_YELLOW" 2 "COLOR_RED" 3 "COLOR_BLUE" 4 "COLOR_GREEN" 5 "RESERVED5" 6 "RESERVED6" 7 "COLOR_UNKNOWN" ;
VAL_ 149 VFC_Poly10_LaneAssociation 0 "LEFT_EGO_LINE" 1 "RIGHT_EGO_LINE" 2 "LEFT_LEFT_LINE" 3 "RIGHT_RIGHT_LINE" 4 "ROAD_EDGE_LEFT" 5 "ROAD_EDGE_RIGHT" 6 "RAISED_LEFT" 7 "RAISED_RIGHT" 8 "NOT_SELECTED_CANDIDATE" 9 "EGO_TRACK_LEFT" 10 "EGO_TRACK_RIGHT" 11 "HOLISTIC_EGO_LINE" 12 "Reserved12" 13 "Reserved13" 14 "Reserved14" 15 "Reserved15" ;
VAL_ 149 VFC_Poly10_Type 0 "TYPE_SOLID_LINE" 1 "TYPE_DASHED_LINE" 2 "TYPE_DOUBLE_DASHED_DASHED" 3 "TYPE_DOUBLE_DASHED_SOLID" 4 "TYPE_DOUBLE_SOLID_DASHED" 5 "TYPE_DOUBLE_SOLID_SOLID" 6 "TYPE_MULTIPLE" 7 "TYPE_MULTIPLE_WARNING" 8 "TYPE_BOTTS_DOTS" 9 "TYPE_ROAD_EDGE" 10 "TYPE_ROAD_FURNITURE" 11 "TYPE_CURBSTONE" 12 "TYPE_TRAFFIC_STATIC" 13 "TYPE_UNKNOWN_RAISED" 14 "TYPE_UNKNOWN" 15 "Reserved15" ;
VAL_ 149 VFC_Poly10_Colour 0 "COLOR_WHITE" 1 "COLOR_YELLOW" 2 "COLOR_RED" 3 "COLOR_BLUE" 4 "COLOR_GREEN" 5 "RESERVED5" 6 "RESERVED6" 7 "COLOR_UNKNOWN" ;
VAL_ 149 VFC_Poly11_LaneAssociation 0 "LEFT_EGO_LINE" 1 "RIGHT_EGO_LINE" 2 "LEFT_LEFT_LINE" 3 "RIGHT_RIGHT_LINE" 4 "ROAD_EDGE_LEFT" 5 "ROAD_EDGE_RIGHT" 6 "RAISED_LEFT" 7 "RAISED_RIGHT" 8 "NOT_SELECTED_CANDIDATE" 9 "EGO_TRACK_LEFT" 10 "EGO_TRACK_RIGHT" 11 "HOLISTIC_EGO_LINE" 12 "Reserved12" 13 "Reserved13" 14 "Reserved14" 15 "Reserved15" ;
VAL_ 149 VFC_Poly11_Type 0 "TYPE_SOLID_LINE" 1 "TYPE_DASHED_LINE" 2 "TYPE_DOUBLE_DASHED_DASHED" 3 "TYPE_DOUBLE_DASHED_SOLID" 4 "TYPE_DOUBLE_SOLID_DASHED" 5 "TYPE_DOUBLE_SOLID_SOLID" 6 "TYPE_MULTIPLE" 7 "TYPE_MULTIPLE_WARNING" 8 "TYPE_BOTTS_DOTS" 9 "TYPE_ROAD_EDGE" 10 "TYPE_ROAD_FURNITURE" 11 "TYPE_CURBSTONE" 12 "TYPE_TRAFFIC_STATIC" 13 "TYPE_UNKNOWN_RAISED" 14 "TYPE_UNKNOWN" 15 "Reserved15" ;
VAL_ 149 VFC_Poly11_Colour 0 "COLOR_WHITE" 1 "COLOR_YELLOW" 2 "COLOR_RED" 3 "COLOR_BLUE" 4 "COLOR_GREEN" 5 "RESERVED5" 6 "RESERVED6" 7 "COLOR_UNKNOWN" ;
VAL_ 150 VFC_Poly12_LaneAssociation 0 "LEFT_EGO_LINE" 1 "RIGHT_EGO_LINE" 2 "LEFT_LEFT_LINE" 3 "RIGHT_RIGHT_LINE" 4 "ROAD_EDGE_LEFT" 5 "ROAD_EDGE_RIGHT" 6 "RAISED_LEFT" 7 "RAISED_RIGHT" 8 "NOT_SELECTED_CANDIDATE" 9 "EGO_TRACK_LEFT" 10 "EGO_TRACK_RIGHT" 11 "HOLISTIC_EGO_LINE" 12 "Reserved12" 13 "Reserved13" 14 "Reserved14" 15 "Reserved15" ;
VAL_ 150 VFC_Poly12_Type 0 "TYPE_SOLID_LINE" 1 "TYPE_DASHED_LINE" 2 "TYPE_DOUBLE_DASHED_DASHED" 3 "TYPE_DOUBLE_DASHED_SOLID" 4 "TYPE_DOUBLE_SOLID_DASHED" 5 "TYPE_DOUBLE_SOLID_SOLID" 6 "TYPE_MULTIPLE" 7 "TYPE_MULTIPLE_WARNING" 8 "TYPE_BOTTS_DOTS" 9 "TYPE_ROAD_EDGE" 10 "TYPE_ROAD_FURNITURE" 11 "TYPE_CURBSTONE" 12 "TYPE_TRAFFIC_STATIC" 13 "TYPE_UNKNOWN_RAISED" 14 "TYPE_UNKNOWN" 15 "Reserved15" ;
VAL_ 150 VFC_Poly12_Colour 0 "COLOR_WHITE" 1 "COLOR_YELLOW" 2 "COLOR_RED" 3 "COLOR_BLUE" 4 "COLOR_GREEN" 5 "RESERVED5" 6 "RESERVED6" 7 "COLOR_UNKNOWN" ;
VAL_ 150 VFC_Poly13_LaneAssociation 0 "LEFT_EGO_LINE" 1 "RIGHT_EGO_LINE" 2 "LEFT_LEFT_LINE" 3 "RIGHT_RIGHT_LINE" 4 "ROAD_EDGE_LEFT" 5 "ROAD_EDGE_RIGHT" 6 "RAISED_LEFT" 7 "RAISED_RIGHT" 8 "NOT_SELECTED_CANDIDATE" 9 "EGO_TRACK_LEFT" 10 "EGO_TRACK_RIGHT" 11 "HOLISTIC_EGO_LINE" 12 "Reserved12" 13 "Reserved13" 14 "Reserved14" 15 "Reserved15" ;
VAL_ 150 VFC_Poly13_Type 0 "TYPE_SOLID_LINE" 1 "TYPE_DASHED_LINE" 2 "TYPE_DOUBLE_DASHED_DASHED" 3 "TYPE_DOUBLE_DASHED_SOLID" 4 "TYPE_DOUBLE_SOLID_DASHED" 5 "TYPE_DOUBLE_SOLID_SOLID" 6 "TYPE_MULTIPLE" 7 "TYPE_MULTIPLE_WARNING" 8 "TYPE_BOTTS_DOTS" 9 "TYPE_ROAD_EDGE" 10 "TYPE_ROAD_FURNITURE" 11 "TYPE_CURBSTONE" 12 "TYPE_TRAFFIC_STATIC" 13 "TYPE_UNKNOWN_RAISED" 14 "TYPE_UNKNOWN" 15 "Reserved15" ;
VAL_ 150 VFC_Poly13_Colour 0 "COLOR_WHITE" 1 "COLOR_YELLOW" 2 "COLOR_RED" 3 "COLOR_BLUE" 4 "COLOR_GREEN" 5 "RESERVED5" 6 "RESERVED6" 7 "COLOR_UNKNOWN" ;
VAL_ 150 VFC_Poly14_LaneAssociation 0 "LEFT_EGO_LINE" 1 "RIGHT_EGO_LINE" 2 "LEFT_LEFT_LINE" 3 "RIGHT_RIGHT_LINE" 4 "ROAD_EDGE_LEFT" 5 "ROAD_EDGE_RIGHT" 6 "RAISED_LEFT" 7 "RAISED_RIGHT" 8 "NOT_SELECTED_CANDIDATE" 9 "EGO_TRACK_LEFT" 10 "EGO_TRACK_RIGHT" 11 "HOLISTIC_EGO_LINE" 12 "Reserved12" 13 "Reserved13" 14 "Reserved14" 15 "Reserved15" ;
VAL_ 150 VFC_Poly14_Type 0 "TYPE_SOLID_LINE" 1 "TYPE_DASHED_LINE" 2 "TYPE_DOUBLE_DASHED_DASHED" 3 "TYPE_DOUBLE_DASHED_SOLID" 4 "TYPE_DOUBLE_SOLID_DASHED" 5 "TYPE_DOUBLE_SOLID_SOLID" 6 "TYPE_MULTIPLE" 7 "TYPE_MULTIPLE_WARNING" 8 "TYPE_BOTTS_DOTS" 9 "TYPE_ROAD_EDGE" 10 "TYPE_ROAD_FURNITURE" 11 "TYPE_CURBSTONE" 12 "TYPE_TRAFFIC_STATIC" 13 "TYPE_UNKNOWN_RAISED" 14 "TYPE_UNKNOWN" 15 "Reserved15" ;
VAL_ 150 VFC_Poly14_Colour 0 "COLOR_WHITE" 1 "COLOR_YELLOW" 2 "COLOR_RED" 3 "COLOR_BLUE" 4 "COLOR_GREEN" 5 "RESERVED5" 6 "RESERVED6" 7 "COLOR_UNKNOWN" ;
VAL_ 162 VFC_2DPoly00_LaneAssociation 0 "LEFT_EGO_LINE" 1 "RIGHT_EGO_LINE" 2 "LEFT_LEFT_LINE" 3 "RIGHT_RIGHT_LINE" 4 "ROAD_EDGE_LEFT" 5 "ROAD_EDGE_RIGHT" 6 "RAISED_LEFT" 7 "RAISED_RIGHT" 8 "NOT_SELECTED_CANDIDATE" 9 "EGO_TRACK_LEFT" 10 "EGO_TRACK_RIGHT" 11 "HOLISTIC_EGO_LINE" 12 "Reserved12" 13 "Reserved13" 14 "Reserved14" 15 "Reserved15" ;
VAL_ 162 VFC_2DPoly00_Type 0 "TYPE_SOLID_LINE" 1 "TYPE_DASHED_LINE" 2 "TYPE_DOUBLE_DASHED_DASHED" 3 "TYPE_DOUBLE_DASHED_SOLID" 4 "TYPE_DOUBLE_SOLID_DASHED" 5 "TYPE_DOUBLE_SOLID_SOLID" 6 "TYPE_MULTIPLE" 7 "TYPE_MULTIPLE_WARNING" 8 "TYPE_BOTTS_DOTS" 9 "TYPE_ROAD_EDGE" 10 "TYPE_ROAD_FURNITURE" 11 "TYPE_CURBSTONE" 12 "TYPE_TRAFFIC_STATIC" 13 "TYPE_UNKNOWN_RAISED" 14 "TYPE_UNKNOWN" 15 "Reserved15" ;
VAL_ 162 VFC_2DPoly01_LaneAssociation 0 "LEFT_EGO_LINE" 1 "RIGHT_EGO_LINE" 2 "LEFT_LEFT_LINE" 3 "RIGHT_RIGHT_LINE" 4 "ROAD_EDGE_LEFT" 5 "ROAD_EDGE_RIGHT" 6 "RAISED_LEFT" 7 "RAISED_RIGHT" 8 "NOT_SELECTED_CANDIDATE" 9 "EGO_TRACK_LEFT" 10 "EGO_TRACK_RIGHT" 11 "HOLISTIC_EGO_LINE" 12 "Reserved12" 13 "Reserved13" 14 "Reserved14" 15 "Reserved15" ;
VAL_ 162 VFC_2DPoly01_Type 0 "TYPE_SOLID_LINE" 1 "TYPE_DASHED_LINE" 2 "TYPE_DOUBLE_DASHED_DASHED" 3 "TYPE_DOUBLE_DASHED_SOLID" 4 "TYPE_DOUBLE_SOLID_DASHED" 5 "TYPE_DOUBLE_SOLID_SOLID" 6 "TYPE_MULTIPLE" 7 "TYPE_MULTIPLE_WARNING" 8 "TYPE_BOTTS_DOTS" 9 "TYPE_ROAD_EDGE" 10 "TYPE_ROAD_FURNITURE" 11 "TYPE_CURBSTONE" 12 "TYPE_TRAFFIC_STATIC" 13 "TYPE_UNKNOWN_RAISED" 14 "TYPE_UNKNOWN" 15 "Reserved15" ;
VAL_ 162 VFC_2DPoly02_LaneAssociation 0 "LEFT_EGO_LINE" 1 "RIGHT_EGO_LINE" 2 "LEFT_LEFT_LINE" 3 "RIGHT_RIGHT_LINE" 4 "ROAD_EDGE_LEFT" 5 "ROAD_EDGE_RIGHT" 6 "RAISED_LEFT" 7 "RAISED_RIGHT" 8 "NOT_SELECTED_CANDIDATE" 9 "EGO_TRACK_LEFT" 10 "EGO_TRACK_RIGHT" 11 "HOLISTIC_EGO_LINE" 12 "Reserved12" 13 "Reserved13" 14 "Reserved14" 15 "Reserved15" ;
VAL_ 162 VFC_2DPoly02_Type 0 "TYPE_SOLID_LINE" 1 "TYPE_DASHED_LINE" 2 "TYPE_DOUBLE_DASHED_DASHED" 3 "TYPE_DOUBLE_DASHED_SOLID" 4 "TYPE_DOUBLE_SOLID_DASHED" 5 "TYPE_DOUBLE_SOLID_SOLID" 6 "TYPE_MULTIPLE" 7 "TYPE_MULTIPLE_WARNING" 8 "TYPE_BOTTS_DOTS" 9 "TYPE_ROAD_EDGE" 10 "TYPE_ROAD_FURNITURE" 11 "TYPE_CURBSTONE" 12 "TYPE_TRAFFIC_STATIC" 13 "TYPE_UNKNOWN_RAISED" 14 "TYPE_UNKNOWN" 15 "Reserved15" ;
VAL_ 163 VFC_2DPoly03_LaneAssociation 0 "LEFT_EGO_LINE" 1 "RIGHT_EGO_LINE" 2 "LEFT_LEFT_LINE" 3 "RIGHT_RIGHT_LINE" 4 "ROAD_EDGE_LEFT" 5 "ROAD_EDGE_RIGHT" 6 "RAISED_LEFT" 7 "RAISED_RIGHT" 8 "NOT_SELECTED_CANDIDATE" 9 "EGO_TRACK_LEFT" 10 "EGO_TRACK_RIGHT" 11 "HOLISTIC_EGO_LINE" 12 "Reserved12" 13 "Reserved13" 14 "Reserved14" 15 "Reserved15" ;
VAL_ 163 VFC_2DPoly03_Type 0 "TYPE_SOLID_LINE" 1 "TYPE_DASHED_LINE" 2 "TYPE_DOUBLE_DASHED_DASHED" 3 "TYPE_DOUBLE_DASHED_SOLID" 4 "TYPE_DOUBLE_SOLID_DASHED" 5 "TYPE_DOUBLE_SOLID_SOLID" 6 "TYPE_MULTIPLE" 7 "TYPE_MULTIPLE_WARNING" 8 "TYPE_BOTTS_DOTS" 9 "TYPE_ROAD_EDGE" 10 "TYPE_ROAD_FURNITURE" 11 "TYPE_CURBSTONE" 12 "TYPE_TRAFFIC_STATIC" 13 "TYPE_UNKNOWN_RAISED" 14 "TYPE_UNKNOWN" 15 "Reserved15" ;
VAL_ 163 VFC_2DPoly04_LaneAssociation 0 "LEFT_EGO_LINE" 1 "RIGHT_EGO_LINE" 2 "LEFT_LEFT_LINE" 3 "RIGHT_RIGHT_LINE" 4 "ROAD_EDGE_LEFT" 5 "ROAD_EDGE_RIGHT" 6 "RAISED_LEFT" 7 "RAISED_RIGHT" 8 "NOT_SELECTED_CANDIDATE" 9 "EGO_TRACK_LEFT" 10 "EGO_TRACK_RIGHT" 11 "HOLISTIC_EGO_LINE" 12 "Reserved12" 13 "Reserved13" 14 "Reserved14" 15 "Reserved15" ;
VAL_ 163 VFC_2DPoly04_Type 0 "TYPE_SOLID_LINE" 1 "TYPE_DASHED_LINE" 2 "TYPE_DOUBLE_DASHED_DASHED" 3 "TYPE_DOUBLE_DASHED_SOLID" 4 "TYPE_DOUBLE_SOLID_DASHED" 5 "TYPE_DOUBLE_SOLID_SOLID" 6 "TYPE_MULTIPLE" 7 "TYPE_MULTIPLE_WARNING" 8 "TYPE_BOTTS_DOTS" 9 "TYPE_ROAD_EDGE" 10 "TYPE_ROAD_FURNITURE" 11 "TYPE_CURBSTONE" 12 "TYPE_TRAFFIC_STATIC" 13 "TYPE_UNKNOWN_RAISED" 14 "TYPE_UNKNOWN" 15 "Reserved15" ;
VAL_ 163 VFC_2DPoly05_LaneAssociation 0 "LEFT_EGO_LINE" 1 "RIGHT_EGO_LINE" 2 "LEFT_LEFT_LINE" 3 "RIGHT_RIGHT_LINE" 4 "ROAD_EDGE_LEFT" 5 "ROAD_EDGE_RIGHT" 6 "RAISED_LEFT" 7 "RAISED_RIGHT" 8 "NOT_SELECTED_CANDIDATE" 9 "EGO_TRACK_LEFT" 10 "EGO_TRACK_RIGHT" 11 "HOLISTIC_EGO_LINE" 12 "Reserved12" 13 "Reserved13" 14 "Reserved14" 15 "Reserved15" ;
VAL_ 163 VFC_2DPoly05_Type 0 "TYPE_SOLID_LINE" 1 "TYPE_DASHED_LINE" 2 "TYPE_DOUBLE_DASHED_DASHED" 3 "TYPE_DOUBLE_DASHED_SOLID" 4 "TYPE_DOUBLE_SOLID_DASHED" 5 "TYPE_DOUBLE_SOLID_SOLID" 6 "TYPE_MULTIPLE" 7 "TYPE_MULTIPLE_WARNING" 8 "TYPE_BOTTS_DOTS" 9 "TYPE_ROAD_EDGE" 10 "TYPE_ROAD_FURNITURE" 11 "TYPE_CURBSTONE" 12 "TYPE_TRAFFIC_STATIC" 13 "TYPE_UNKNOWN_RAISED" 14 "TYPE_UNKNOWN" 15 "Reserved15" ;
SIG_GROUP_ 128 SG_VFC_RoadHdr 1 : VFC_RoadHdr_CRC VFC_RoadHdr_AliveCtr VFC_RoadHdr_ProtBlockCtr VFC_RoadHdr_IfVersionIdMajor VFC_RoadHdr_IfVersionIdMinor VFC_RoadHdr_NumValidPolynomials VFC_RoadHdr_RoadType VFC_RoadHdr_TimeStampStatus VFC_RoadHdr_TimeStamp VFC_RoadHdr_SensorStatus VFC_RoadHdr_NumValid2DPolynomial VFC_RoadHdr_RoadSurfCondType VFC_RoadHdr_NumValidRoadMarkings VFC_RoadHdr_RoadTypeConf VFC_RoadHdr_RoadSurCondTypeConf VFC_RoadHdr_2DNormVMean VFC_RoadHdr_2DNormVMeanStdDev VFC_RoadHdr_NumValidClothoids;
SIG_GROUP_ 130 SG_VFC_RoadClothoid_00_02 1 : VFC_Cloth_00_02_CRC VFC_Cloth_00_02_AliveCtr VFC_Cloth_00_02_ProtBlockCtr VFC_Cloth00_LaneAssociation VFC_Cloth00_Colour VFC_Cloth00_RangeXBegin VFC_Cloth00_RangeXEnd VFC_Cloth00_ExistProb VFC_Cloth00_CurvChange VFC_Cloth00_Curv VFC_Cloth00_PyStdDev VFC_Cloth00_Py VFC_Cloth00_OrientationYaw VFC_Cloth00_Width VFC_Cloth00_Type VFC_Cloth01_LaneAssociation VFC_Cloth01_Colour VFC_Cloth01_RangeXBegin VFC_Cloth01_RangeXEnd VFC_Cloth01_ExistProb VFC_Cloth01_CurvChange VFC_Cloth01_Curv VFC_Cloth01_PyStdDev VFC_Cloth01_Py VFC_Cloth01_OrientationYaw VFC_Cloth01_Width VFC_Cloth01_Type VFC_Cloth02_LaneAssociation VFC_Cloth02_Colour VFC_Cloth02_RangeXBegin VFC_Cloth02_RangeXEnd VFC_Cloth02_ExistProb VFC_Cloth02_CurvChange VFC_Cloth02_Curv VFC_Cloth02_PyStdDev VFC_Cloth02_Py VFC_Cloth02_OrientationYaw VFC_Cloth02_Width VFC_Cloth02_Type;
SIG_GROUP_ 131 SG_VFC_RoadClothoid_03_05 1 : VFC_Cloth_03_05_CRC VFC_Cloth_03_05_AliveCtr VFC_Cloth_03_05_ProtBlockCtr VFC_Cloth03_LaneAssociation VFC_Cloth03_Colour VFC_Cloth03_RangeXBegin VFC_Cloth03_RangeXEnd VFC_Cloth03_ExistProb VFC_Cloth03_CurvChange VFC_Cloth03_Curv VFC_Cloth03_PyStdDev VFC_Cloth03_Py VFC_Cloth03_OrientationYaw VFC_Cloth03_Width VFC_Cloth03_Type VFC_Cloth04_LaneAssociation VFC_Cloth04_Colour VFC_Cloth04_RangeXBegin VFC_Cloth04_RangeXEnd VFC_Cloth04_ExistProb VFC_Cloth04_CurvChange VFC_Cloth04_Curv VFC_Cloth04_PyStdDev VFC_Cloth04_Py VFC_Cloth04_OrientationYaw VFC_Cloth04_Width VFC_Cloth04_Type VFC_Cloth05_LaneAssociation VFC_Cloth05_Colour VFC_Cloth05_RangeXBegin VFC_Cloth05_RangeXEnd VFC_Cloth05_ExistProb VFC_Cloth05_CurvChange VFC_Cloth05_Curv VFC_Cloth05_PyStdDev VFC_Cloth05_Py VFC_Cloth05_OrientationYaw VFC_Cloth05_Width VFC_Cloth05_Type;
SIG_GROUP_ 132 SG_VFC_RoadClothoid_06_08 1 : VFC_Cloth_06_08_CRC VFC_Cloth_06_08_AliveCtr VFC_Cloth_06_08_ProtBlockCtr VFC_Cloth06_LaneAssociation VFC_Cloth06_Colour VFC_Cloth06_RangeXBegin VFC_Cloth06_RangeXEnd VFC_Cloth06_ExistProb VFC_Cloth06_CurvChange VFC_Cloth06_Curv VFC_Cloth06_PyStdDev VFC_Cloth06_Py VFC_Cloth06_OrientationYaw VFC_Cloth06_Width VFC_Cloth06_Type VFC_Cloth07_LaneAssociation VFC_Cloth07_Colour VFC_Cloth07_RangeXBegin VFC_Cloth07_RangeXEnd VFC_Cloth07_ExistProb VFC_Cloth07_CurvChange VFC_Cloth07_Curv VFC_Cloth07_PyStdDev VFC_Cloth07_Py VFC_Cloth07_OrientationYaw VFC_Cloth07_Width VFC_Cloth07_Type VFC_Cloth08_LaneAssociation VFC_Cloth08_Colour VFC_Cloth08_RangeXBegin VFC_Cloth08_RangeXEnd VFC_Cloth08_ExistProb VFC_Cloth08_CurvChange VFC_Cloth08_Curv VFC_Cloth08_PyStdDev VFC_Cloth08_Py VFC_Cloth08_OrientationYaw VFC_Cloth08_Width VFC_Cloth08_Type;
SIG_GROUP_ 133 SG_VFC_RoadClothoid_09_11 1 : VFC_Cloth_09_11_CRC VFC_Cloth_09_11_AliveCtr VFC_Cloth_09_11_ProtBlockCtr VFC_Cloth09_LaneAssociation VFC_Cloth09_Colour VFC_Cloth09_RangeXBegin VFC_Cloth09_RangeXEnd VFC_Cloth09_ExistProb VFC_Cloth09_CurvChange VFC_Cloth09_Curv VFC_Cloth09_PyStdDev VFC_Cloth09_Py VFC_Cloth09_OrientationYaw VFC_Cloth09_Width VFC_Cloth09_Type VFC_Cloth10_LaneAssociation VFC_Cloth10_Colour VFC_Cloth10_RangeXBegin VFC_Cloth10_RangeXEnd VFC_Cloth10_ExistProb VFC_Cloth10_CurvChange VFC_Cloth10_Curv VFC_Cloth10_PyStdDev VFC_Cloth10_Py VFC_Cloth10_OrientationYaw VFC_Cloth10_Width VFC_Cloth10_Type VFC_Cloth11_LaneAssociation VFC_Cloth11_Colour VFC_Cloth11_RangeXBegin VFC_Cloth11_RangeXEnd VFC_Cloth11_ExistProb VFC_Cloth11_CurvChange VFC_Cloth11_Curv VFC_Cloth11_PyStdDev VFC_Cloth11_Py VFC_Cloth11_OrientationYaw VFC_Cloth11_Width VFC_Cloth11_Type;
SIG_GROUP_ 146 SG_VFC_RoadPolynomial_00_02 1 : VFC_Poly_00_02_CRC VFC_Poly_00_02_AliveCtr VFC_Poly_00_02_ProtBlockCtr VFC_Poly00_LaneAssociation VFC_Poly00_Type VFC_Poly00_ExistProb VFC_Poly00_CoefficientYc3 VFC_Poly00_Colour VFC_Poly00_CoefficientYc2 VFC_Poly00_CoefficientYc0 VFC_Poly00_CoefficientYc1 VFC_Poly00_CoefficientYc2Corr VFC_Poly00_CoefficientYc3Corr VFC_Poly00_Width VFC_Poly00_RangeXCorrectionPoint VFC_Poly00_RangeXBegin VFC_Poly00_Reserved0 VFC_Poly00_RangeXEnd VFC_Poly00_Reserved1 VFC_Poly01_LaneAssociation VFC_Poly01_Type VFC_Poly01_ExistProb VFC_Poly01_CoefficientYc3 VFC_Poly01_Colour VFC_Poly01_CoefficientYc2 VFC_Poly01_CoefficientYc0 VFC_Poly01_CoefficientYc1 VFC_Poly01_CoefficientYc2Corr VFC_Poly01_CoefficientYc3Corr VFC_Poly01_Width VFC_Poly01_RangeXCorrectionPoint VFC_Poly01_RangeXBegin VFC_Poly01_Reserved0 VFC_Poly01_RangeXEnd VFC_Poly01_Reserved1 VFC_Poly02_LaneAssociation VFC_Poly02_Type VFC_Poly02_ExistProb VFC_Poly02_CoefficientYc3 VFC_Poly02_Colour VFC_Poly02_CoefficientYc2 VFC_Poly02_CoefficientYc0 VFC_Poly02_CoefficientYc1 VFC_Poly02_CoefficientYc2Corr VFC_Poly02_CoefficientYc3Corr VFC_Poly02_Width VFC_Poly02_RangeXCorrectionPoint VFC_Poly02_RangeXBegin VFC_Poly02_Reserved0 VFC_Poly02_RangeXEnd VFC_Poly02_Reserved1;
SIG_GROUP_ 147 SG_VFC_RoadPolynomial_03_05 1 : VFC_Poly_03_05_CRC VFC_Poly_03_05_AliveCtr VFC_Poly_03_05_ProtBlockCtr VFC_Poly03_LaneAssociation VFC_Poly03_Type VFC_Poly03_ExistProb VFC_Poly03_CoefficientYc3 VFC_Poly03_Colour VFC_Poly03_CoefficientYc2 VFC_Poly03_CoefficientYc0 VFC_Poly03_CoefficientYc1 VFC_Poly03_CoefficientYc2Corr VFC_Poly03_CoefficientYc3Corr VFC_Poly03_Width VFC_Poly03_RangeXCorrectionPoint VFC_Poly03_RangeXBegin VFC_Poly03_Reserved0 VFC_Poly03_RangeXEnd VFC_Poly03_Reserved1 VFC_Poly04_LaneAssociation VFC_Poly04_Type VFC_Poly04_ExistProb VFC_Poly04_CoefficientYc3 VFC_Poly04_Colour VFC_Poly04_CoefficientYc2 VFC_Poly04_CoefficientYc0 VFC_Poly04_CoefficientYc1 VFC_Poly04_CoefficientYc2Corr VFC_Poly04_CoefficientYc3Corr VFC_Poly04_Width VFC_Poly04_RangeXCorrectionPoint VFC_Poly04_RangeXBegin VFC_Poly04_Reserved0 VFC_Poly04_RangeXEnd VFC_Poly04_Reserved1 VFC_Poly05_LaneAssociation VFC_Poly05_Type VFC_Poly05_ExistProb VFC_Poly05_CoefficientYc3 VFC_Poly05_Colour VFC_Poly05_CoefficientYc2 VFC_Poly05_CoefficientYc0 VFC_Poly05_CoefficientYc1 VFC_Poly05_CoefficientYc2Corr VFC_Poly05_CoefficientYc3Corr VFC_Poly05_Width VFC_Poly05_RangeXCorrectionPoint VFC_Poly05_RangeXBegin VFC_Poly05_Reserved0 VFC_Poly05_RangeXEnd VFC_Poly05_Reserved1;
SIG_GROUP_ 148 SG_VFC_RoadPolynomial_06_08 1 : VFC_Poly_06_08_CRC VFC_Poly_06_08_AliveCtr VFC_Poly_06_08_ProtBlockCtr VFC_Poly06_LaneAssociation VFC_Poly06_Type VFC_Poly06_ExistProb VFC_Poly06_CoefficientYc3 VFC_Poly06_Colour VFC_Poly06_CoefficientYc2 VFC_Poly06_CoefficientYc0 VFC_Poly06_CoefficientYc1 VFC_Poly06_CoefficientYc2Corr VFC_Poly06_CoefficientYc3Corr VFC_Poly06_Width VFC_Poly06_RangeXCorrectionPoint VFC_Poly06_RangeXBegin VFC_Poly06_Reserved0 VFC_Poly06_RangeXEnd VFC_Poly06_Reserved1 VFC_Poly07_LaneAssociation VFC_Poly07_Type VFC_Poly07_ExistProb VFC_Poly07_CoefficientYc3 VFC_Poly07_Colour VFC_Poly07_CoefficientYc2 VFC_Poly07_CoefficientYc0 VFC_Poly07_CoefficientYc1 VFC_Poly07_CoefficientYc2Corr VFC_Poly07_CoefficientYc3Corr VFC_Poly07_Width VFC_Poly07_RangeXCorrectionPoint VFC_Poly07_RangeXBegin VFC_Poly07_Reserved0 VFC_Poly07_RangeXEnd VFC_Poly07_Reserved1 VFC_Poly08_LaneAssociation VFC_Poly08_Type VFC_Poly08_ExistProb VFC_Poly08_CoefficientYc3 VFC_Poly08_Colour VFC_Poly08_CoefficientYc2 VFC_Poly08_CoefficientYc0 VFC_Poly08_CoefficientYc1 VFC_Poly08_CoefficientYc2Corr VFC_Poly08_CoefficientYc3Corr VFC_Poly08_Width VFC_Poly08_RangeXCorrectionPoint VFC_Poly08_RangeXBegin VFC_Poly08_Reserved0 VFC_Poly08_RangeXEnd VFC_Poly08_Reserved1;
SIG_GROUP_ 149 SG_VFC_RoadPolynomial_09_11 1 : VFC_Poly_09_11_CRC VFC_Poly_09_11_AliveCtr VFC_Poly_09_11_ProtBlockCtr VFC_Poly09_LaneAssociation VFC_Poly09_Type VFC_Poly09_ExistProb VFC_Poly09_CoefficientYc3 VFC_Poly09_Colour VFC_Poly09_CoefficientYc2 VFC_Poly09_CoefficientYc0 VFC_Poly09_CoefficientYc1 VFC_Poly09_CoefficientYc2Corr VFC_Poly09_CoefficientYc3Corr VFC_Poly09_Width VFC_Poly09_RangeXCorrectionPoint VFC_Poly09_RangeXBegin VFC_Poly09_Reserved0 VFC_Poly09_RangeXEnd VFC_Poly09_Reserved1 VFC_Poly10_LaneAssociation VFC_Poly10_Type VFC_Poly10_ExistProb VFC_Poly10_CoefficientYc3 VFC_Poly10_Colour VFC_Poly10_CoefficientYc2 VFC_Poly10_CoefficientYc0 VFC_Poly10_CoefficientYc1 VFC_Poly10_CoefficientYc2Corr VFC_Poly10_CoefficientYc3Corr VFC_Poly10_Width VFC_Poly10_RangeXCorrectionPoint VFC_Poly10_RangeXBegin VFC_Poly10_Reserved0 VFC_Poly10_RangeXEnd VFC_Poly10_Reserved1 VFC_Poly11_LaneAssociation VFC_Poly11_Type VFC_Poly11_ExistProb VFC_Poly11_CoefficientYc3 VFC_Poly11_Colour VFC_Poly11_CoefficientYc2 VFC_Poly11_CoefficientYc0 VFC_Poly11_CoefficientYc1 VFC_Poly11_CoefficientYc2Corr VFC_Poly11_CoefficientYc3Corr VFC_Poly11_Width VFC_Poly11_RangeXCorrectionPoint VFC_Poly11_RangeXBegin VFC_Poly11_Reserved0 VFC_Poly11_RangeXEnd VFC_Poly11_Reserved1;
SIG_GROUP_ 150 SG_VFC_RoadPolynomial_12_14 1 : VFC_Poly_12_14_CRC VFC_Poly_12_14_AliveCtr VFC_Poly_12_14_ProtBlockCtr VFC_Poly12_LaneAssociation VFC_Poly12_Type VFC_Poly12_ExistProb VFC_Poly12_CoefficientYc3 VFC_Poly12_Colour VFC_Poly12_CoefficientYc2 VFC_Poly12_CoefficientYc0 VFC_Poly12_CoefficientYc1 VFC_Poly12_CoefficientYc2Corr VFC_Poly12_CoefficientYc3Corr VFC_Poly12_Width VFC_Poly12_RangeXCorrectionPoint VFC_Poly12_RangeXBegin VFC_Poly12_Reserved0 VFC_Poly12_RangeXEnd VFC_Poly12_Reserved1 VFC_Poly13_LaneAssociation VFC_Poly13_Type VFC_Poly13_ExistProb VFC_Poly13_CoefficientYc3 VFC_Poly13_Colour VFC_Poly13_CoefficientYc2 VFC_Poly13_CoefficientYc0 VFC_Poly13_CoefficientYc1 VFC_Poly13_CoefficientYc2Corr VFC_Poly13_CoefficientYc3Corr VFC_Poly13_Width VFC_Poly13_RangeXCorrectionPoint VFC_Poly13_RangeXBegin VFC_Poly13_Reserved0 VFC_Poly13_RangeXEnd VFC_Poly13_Reserved1 VFC_Poly14_LaneAssociation VFC_Poly14_Type VFC_Poly14_ExistProb VFC_Poly14_CoefficientYc3 VFC_Poly14_Colour VFC_Poly14_CoefficientYc2 VFC_Poly14_CoefficientYc0 VFC_Poly14_CoefficientYc1 VFC_Poly14_CoefficientYc2Corr VFC_Poly14_CoefficientYc3Corr VFC_Poly14_Width VFC_Poly14_RangeXCorrectionPoint VFC_Poly14_RangeXBegin VFC_Poly14_Reserved0 VFC_Poly14_RangeXEnd VFC_Poly14_Reserved1;
SIG_GROUP_ 162 SG_VFC_Road2DPolynomial_00_02 1 : VFC_2DPoly_00_02_CRC VFC_2DPoly_00_02_AliveCtr VFC_2DPoly_00_02_ProtBlockCtr VFC_2DPoly00_LaneAssociation VFC_2DPoly00_ExistProb VFC_2DPoly00_Type VFC_2DPoly00_CoefficientUc0 VFC_2DPoly00_CoefficientUc1 VFC_2DPoly00_CoefficientUc2 VFC_2DPoly00_CoefficientUc3 VFC_2DPoly00_CoefficientUc4 VFC_2DPoly00_CoefficientUc5 VFC_2DPoly00_RangeVBegin VFC_2DPoly00_RangeVEnd VFC_2DPoly01_LaneAssociation VFC_2DPoly01_ExistProb VFC_2DPoly01_Type VFC_2DPoly01_CoefficientUc0 VFC_2DPoly01_CoefficientUc1 VFC_2DPoly01_CoefficientUc2 VFC_2DPoly01_CoefficientUc3 VFC_2DPoly01_CoefficientUc4 VFC_2DPoly01_CoefficientUc5 VFC_2DPoly01_RangeVBegin VFC_2DPoly01_RangeVEnd VFC_2DPoly02_LaneAssociation VFC_2DPoly02_ExistProb VFC_2DPoly02_Type VFC_2DPoly02_CoefficientUc0 VFC_2DPoly02_CoefficientUc1 VFC_2DPoly02_CoefficientUc2 VFC_2DPoly02_CoefficientUc3 VFC_2DPoly02_CoefficientUc4 VFC_2DPoly02_CoefficientUc5 VFC_2DPoly02_RangeVBegin VFC_2DPoly02_RangeVEnd;
SIG_GROUP_ 163 SG_VFC_Road2DPolynomial_03_05 1 : VFC_2DPoly_03_05_CRC VFC_2DPoly_03_05_AliveCtr VFC_2DPoly_03_05_ProtBlockCtr VFC_2DPoly03_LaneAssociation VFC_2DPoly03_ExistProb VFC_2DPoly03_Type VFC_2DPoly03_CoefficientUc0 VFC_2DPoly03_CoefficientUc1 VFC_2DPoly03_CoefficientUc2 VFC_2DPoly03_CoefficientUc3 VFC_2DPoly03_CoefficientUc4 VFC_2DPoly03_CoefficientUc5 VFC_2DPoly03_RangeVBegin VFC_2DPoly03_RangeVEnd VFC_2DPoly04_LaneAssociation VFC_2DPoly04_ExistProb VFC_2DPoly04_Type VFC_2DPoly04_CoefficientUc0 VFC_2DPoly04_CoefficientUc1 VFC_2DPoly04_CoefficientUc2 VFC_2DPoly04_CoefficientUc3 VFC_2DPoly04_CoefficientUc4 VFC_2DPoly04_CoefficientUc5 VFC_2DPoly04_RangeVBegin VFC_2DPoly04_RangeVEnd VFC_2DPoly05_LaneAssociation VFC_2DPoly05_ExistProb VFC_2DPoly05_Type VFC_2DPoly05_CoefficientUc0 VFC_2DPoly05_CoefficientUc1 VFC_2DPoly05_CoefficientUc2 VFC_2DPoly05_CoefficientUc3 VFC_2DPoly05_CoefficientUc4 VFC_2DPoly05_CoefficientUc5 VFC_2DPoly05_RangeVBegin VFC_2DPoly05_RangeVEnd;
