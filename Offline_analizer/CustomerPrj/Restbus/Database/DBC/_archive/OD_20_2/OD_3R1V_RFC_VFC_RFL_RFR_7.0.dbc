VERSION "created by canmatrix"

NS_ :

BS_:

BU_: RadarFrontCenter VideoFrontCenter RadarFrontLeft RadarFrontRight ReceiveECU

BO_ 241 VFC_TrafficSign_06_07: 64 VideoFrontCenter
 SG_ VFC_TS_06_07_CRC : 0|16@1+ (1,0) [0|65535] ""  RadarFrontCenter
 SG_ VFC_TS_06_07_AliveCtr : 16|8@1+ (1,0) [0|255] ""  RadarFrontCenter
 SG_ VFC_TS_06_07_ProtBlockCtr : 24|4@1+ (1,0) [0|15] ""  RadarFrontCenter
 SG_ VFC_TS06_ObjId : 32|8@1+ (1,0) [0|255] ""  RadarFrontCenter
 SG_ VFC_TS06_Type : 40|10@1+ (1,0) [0|1023] ""  RadarFrontCenter
 SG_ VFC_TS06_ExistProb : 50|5@1+ (5,0) [0|100] "%"  RadarFrontCenter
 SG_ VFC_TS06_Px : 55|9@1+ (0.25,0) [0|127.75] "m"  RadarFrontCenter
 SG_ VFC_TS06_Py : 64|8@1+ (0.2,-25.6) [-25.6|25.4] "m"  RadarFrontCenter
 SG_ VFC_TS06_Pz : 72|6@1+ (0.2,0) [0|12.6] "m"  RadarFrontCenter
 SG_ VFC_TS06_PxStdDev : 78|9@1+ (0.25,0) [0|127.75] "m"  RadarFrontCenter
 SG_ VFC_TS06_Width : 87|4@1+ (0.2,0) [0|3] "m"  RadarFrontCenter
 SG_ VFC_TS06_Height : 91|4@1+ (0.2,0) [0|3] "m"  RadarFrontCenter
 SG_ VFC_TS06_EmbeddedInfo : 95|4@1+ (1,0) [0|15] ""  RadarFrontCenter
 SG_ VFC_TS06_ValidLane : 99|5@1+ (1,0) [0|31] ""  RadarFrontCenter
 SG_ VFC_TS06_ValidDay : 104|7@1+ (1,0) [0|127] ""  RadarFrontCenter
 SG_ VFC_TS06_ValidTimeRange1Start : 111|7@1+ (15,0) [0|1440] "min"  RadarFrontCenter
 SG_ VFC_TS06_ValidTimeRange1End : 118|7@1+ (15,0) [0|1440] "min"  RadarFrontCenter
 SG_ VFC_TS06_ValidTimeRange2Start : 125|7@1+ (15,0) [0|1440] "min"  RadarFrontCenter
 SG_ VFC_TS06_ValidTimeRange2End : 132|7@1+ (15,0) [0|1440] "min"  RadarFrontCenter
 SG_ VFC_TS06_ValidInDist : 139|15@1+ (0.1,0) [0|3276.7] ""  RadarFrontCenter
 SG_ VFC_TS06_ValidInDistUnit : 154|3@1+ (1,0) [0|7] ""  RadarFrontCenter
 SG_ VFC_TS06_ValidSection : 157|15@1+ (0.1,0) [0|3276.7] ""  RadarFrontCenter
 SG_ VFC_TS06_ValidSectionUnit : 172|3@1+ (1,0) [0|7] ""  RadarFrontCenter
 SG_ VFC_TS06_NumValidSupSigns : 175|3@1+ (1,0) [0|6] ""  RadarFrontCenter
 SG_ VFC_TS06_SupSign0ExistProb : 178|5@1+ (5,0) [0|100] "%"  RadarFrontCenter
 SG_ VFC_TS06_SupSign1ExistProb : 183|5@1+ (5,0) [0|100] "%"  RadarFrontCenter
 SG_ VFC_TS06_SupSign2ExistProb : 188|5@1+ (5,0) [0|100] "%"  RadarFrontCenter
 SG_ VFC_TS06_SupSign3ExistProb : 193|5@1+ (5,0) [0|100] "%"  RadarFrontCenter
 SG_ VFC_TS06_SupSign4ExistProb : 198|5@1+ (5,0) [0|100] "%"  RadarFrontCenter
 SG_ VFC_TS06_SupSign5ExistProb : 203|5@1+ (5,0) [0|100] "%"  RadarFrontCenter
 SG_ VFC_TS06_SupSign0Type : 208|8@1+ (1,0) [0|255] ""  RadarFrontCenter
 SG_ VFC_TS06_SupSign1Type : 216|8@1+ (1,0) [0|255] ""  RadarFrontCenter
 SG_ VFC_TS06_SupSign2Type : 224|8@1+ (1,0) [0|255] ""  RadarFrontCenter
 SG_ VFC_TS06_SupSign3Type : 232|8@1+ (1,0) [0|255] ""  RadarFrontCenter
 SG_ VFC_TS06_SupSign4Type : 240|8@1+ (1,0) [0|255] ""  RadarFrontCenter
 SG_ VFC_TS06_SupSign5Type : 248|8@1+ (1,0) [0|255] ""  RadarFrontCenter
 SG_ VFC_TS07_ObjId : 272|8@1+ (1,0) [0|255] ""  RadarFrontCenter
 SG_ VFC_TS07_Type : 280|10@1+ (1,0) [0|1023] ""  RadarFrontCenter
 SG_ VFC_TS07_ExistProb : 290|5@1+ (5,0) [0|100] "%"  RadarFrontCenter
 SG_ VFC_TS07_Px : 295|9@1+ (0.25,0) [0|127.75] "m"  RadarFrontCenter
 SG_ VFC_TS07_Py : 304|8@1+ (0.2,-25.6) [-25.6|25.4] "m"  RadarFrontCenter
 SG_ VFC_TS07_Pz : 312|6@1+ (0.2,0) [0|12.6] "m"  RadarFrontCenter
 SG_ VFC_TS07_PxStdDev : 318|9@1+ (0.25,0) [0|127.75] "m"  RadarFrontCenter
 SG_ VFC_TS07_Width : 327|4@1+ (0.2,0) [0|3] "m"  RadarFrontCenter
 SG_ VFC_TS07_Height : 331|4@1+ (0.2,0) [0|3] "m"  RadarFrontCenter
 SG_ VFC_TS07_EmbeddedInfo : 335|4@1+ (1,0) [0|15] ""  RadarFrontCenter
 SG_ VFC_TS07_ValidLane : 339|5@1+ (1,0) [0|31] ""  RadarFrontCenter
 SG_ VFC_TS07_ValidDay : 344|7@1+ (1,0) [0|127] ""  RadarFrontCenter
 SG_ VFC_TS07_ValidTimeRange1Start : 351|7@1+ (15,0) [0|1440] "min"  RadarFrontCenter
 SG_ VFC_TS07_ValidTimeRange1End : 358|7@1+ (15,0) [0|1440] "min"  RadarFrontCenter
 SG_ VFC_TS07_ValidTimeRange2Start : 365|7@1+ (15,0) [0|1440] "min"  RadarFrontCenter
 SG_ VFC_TS07_ValidTimeRange2End : 372|7@1+ (15,0) [0|1440] "min"  RadarFrontCenter
 SG_ VFC_TS07_ValidInDist : 379|15@1+ (0.1,0) [0|3276.7] ""  RadarFrontCenter
 SG_ VFC_TS07_ValidInDistUnit : 394|3@1+ (1,0) [0|7] ""  RadarFrontCenter
 SG_ VFC_TS07_ValidSection : 397|15@1+ (0.1,0) [0|3276.7] ""  RadarFrontCenter
 SG_ VFC_TS07_ValidSectionUnit : 412|3@1+ (1,0) [0|7] ""  RadarFrontCenter
 SG_ VFC_TS07_NumValidSupSigns : 415|3@1+ (1,0) [0|6] ""  RadarFrontCenter
 SG_ VFC_TS07_SupSign0ExistProb : 418|5@1+ (5,0) [0|100] "%"  RadarFrontCenter
 SG_ VFC_TS07_SupSign1ExistProb : 423|5@1+ (5,0) [0|100] "%"  RadarFrontCenter
 SG_ VFC_TS07_SupSign2ExistProb : 428|5@1+ (5,0) [0|100] "%"  RadarFrontCenter
 SG_ VFC_TS07_SupSign3ExistProb : 433|5@1+ (5,0) [0|100] "%"  RadarFrontCenter
 SG_ VFC_TS07_SupSign4ExistProb : 438|5@1+ (5,0) [0|100] "%"  RadarFrontCenter
 SG_ VFC_TS07_SupSign5ExistProb : 443|5@1+ (5,0) [0|100] "%"  RadarFrontCenter
 SG_ VFC_TS07_SupSign0Type : 448|8@1+ (1,0) [0|255] ""  RadarFrontCenter
 SG_ VFC_TS07_SupSign1Type : 456|8@1+ (1,0) [0|255] ""  RadarFrontCenter
 SG_ VFC_TS07_SupSign2Type : 464|8@1+ (1,0) [0|255] ""  RadarFrontCenter
 SG_ VFC_TS07_SupSign3Type : 472|8@1+ (1,0) [0|255] ""  RadarFrontCenter
 SG_ VFC_TS07_SupSign4Type : 480|8@1+ (1,0) [0|255] ""  RadarFrontCenter
 SG_ VFC_TS07_SupSign5Type : 488|8@1+ (1,0) [0|255] ""  RadarFrontCenter

BO_ 242 VFC_TrafficSign_08_09: 64 VideoFrontCenter
 SG_ VFC_TS_08_09_CRC : 0|16@1+ (1,0) [0|65535] ""  RadarFrontCenter
 SG_ VFC_TS_08_09_AliveCtr : 16|8@1+ (1,0) [0|255] ""  RadarFrontCenter
 SG_ VFC_TS_08_09_ProtBlockCtr : 24|4@1+ (1,0) [0|15] ""  RadarFrontCenter
 SG_ VFC_TS08_ObjId : 32|8@1+ (1,0) [0|255] ""  RadarFrontCenter
 SG_ VFC_TS08_Type : 40|10@1+ (1,0) [0|1023] ""  RadarFrontCenter
 SG_ VFC_TS08_ExistProb : 50|5@1+ (5,0) [0|100] "%"  RadarFrontCenter
 SG_ VFC_TS08_Px : 55|9@1+ (0.25,0) [0|127.75] "m"  RadarFrontCenter
 SG_ VFC_TS08_Py : 64|8@1+ (0.2,-25.6) [-25.6|25.4] "m"  RadarFrontCenter
 SG_ VFC_TS08_Pz : 72|6@1+ (0.2,0) [0|12.6] "m"  RadarFrontCenter
 SG_ VFC_TS08_PxStdDev : 78|9@1+ (0.25,0) [0|127.75] "m"  RadarFrontCenter
 SG_ VFC_TS08_Width : 87|4@1+ (0.2,0) [0|3] "m"  RadarFrontCenter
 SG_ VFC_TS08_Height : 91|4@1+ (0.2,0) [0|3] "m"  RadarFrontCenter
 SG_ VFC_TS08_EmbeddedInfo : 95|4@1+ (1,0) [0|15] ""  RadarFrontCenter
 SG_ VFC_TS08_ValidLane : 99|5@1+ (1,0) [0|31] ""  RadarFrontCenter
 SG_ VFC_TS08_ValidDay : 104|7@1+ (1,0) [0|127] ""  RadarFrontCenter
 SG_ VFC_TS08_ValidTimeRange1Start : 111|7@1+ (15,0) [0|1440] "min"  RadarFrontCenter
 SG_ VFC_TS08_ValidTimeRange1End : 118|7@1+ (15,0) [0|1440] "min"  RadarFrontCenter
 SG_ VFC_TS08_ValidTimeRange2Start : 125|7@1+ (15,0) [0|1440] "min"  RadarFrontCenter
 SG_ VFC_TS08_ValidTimeRange2End : 132|7@1+ (15,0) [0|1440] "min"  RadarFrontCenter
 SG_ VFC_TS08_ValidInDist : 139|15@1+ (0.1,0) [0|3276.7] ""  RadarFrontCenter
 SG_ VFC_TS08_ValidInDistUnit : 154|3@1+ (1,0) [0|7] ""  RadarFrontCenter
 SG_ VFC_TS08_ValidSection : 157|15@1+ (0.1,0) [0|3276.7] ""  RadarFrontCenter
 SG_ VFC_TS08_ValidSectionUnit : 172|3@1+ (1,0) [0|7] ""  RadarFrontCenter
 SG_ VFC_TS08_NumValidSupSigns : 175|3@1+ (1,0) [0|6] ""  RadarFrontCenter
 SG_ VFC_TS08_SupSign0ExistProb : 178|5@1+ (5,0) [0|100] "%"  RadarFrontCenter
 SG_ VFC_TS08_SupSign1ExistProb : 183|5@1+ (5,0) [0|100] "%"  RadarFrontCenter
 SG_ VFC_TS08_SupSign2ExistProb : 188|5@1+ (5,0) [0|100] "%"  RadarFrontCenter
 SG_ VFC_TS08_SupSign3ExistProb : 193|5@1+ (5,0) [0|100] "%"  RadarFrontCenter
 SG_ VFC_TS08_SupSign4ExistProb : 198|5@1+ (5,0) [0|100] "%"  RadarFrontCenter
 SG_ VFC_TS08_SupSign5ExistProb : 203|5@1+ (5,0) [0|100] "%"  RadarFrontCenter
 SG_ VFC_TS08_SupSign0Type : 208|8@1+ (1,0) [0|255] ""  RadarFrontCenter
 SG_ VFC_TS08_SupSign1Type : 216|8@1+ (1,0) [0|255] ""  RadarFrontCenter
 SG_ VFC_TS08_SupSign2Type : 224|8@1+ (1,0) [0|255] ""  RadarFrontCenter
 SG_ VFC_TS08_SupSign3Type : 232|8@1+ (1,0) [0|255] ""  RadarFrontCenter
 SG_ VFC_TS08_SupSign4Type : 240|8@1+ (1,0) [0|255] ""  RadarFrontCenter
 SG_ VFC_TS08_SupSign5Type : 248|8@1+ (1,0) [0|255] ""  RadarFrontCenter
 SG_ VFC_TS09_ObjId : 272|8@1+ (1,0) [0|255] ""  RadarFrontCenter
 SG_ VFC_TS09_Type : 280|10@1+ (1,0) [0|1023] ""  RadarFrontCenter
 SG_ VFC_TS09_ExistProb : 290|5@1+ (5,0) [0|100] "%"  RadarFrontCenter
 SG_ VFC_TS09_Px : 295|9@1+ (0.25,0) [0|127.75] "m"  RadarFrontCenter
 SG_ VFC_TS09_Py : 304|8@1+ (0.2,-25.6) [-25.6|25.4] "m"  RadarFrontCenter
 SG_ VFC_TS09_Pz : 312|6@1+ (0.2,0) [0|12.6] "m"  RadarFrontCenter
 SG_ VFC_TS09_PxStdDev : 318|9@1+ (0.25,0) [0|127.75] "m"  RadarFrontCenter
 SG_ VFC_TS09_Width : 327|4@1+ (0.2,0) [0|3] "m"  RadarFrontCenter
 SG_ VFC_TS09_Height : 331|4@1+ (0.2,0) [0|3] "m"  RadarFrontCenter
 SG_ VFC_TS09_EmbeddedInfo : 335|4@1+ (1,0) [0|15] ""  RadarFrontCenter
 SG_ VFC_TS09_ValidLane : 339|5@1+ (1,0) [0|31] ""  RadarFrontCenter
 SG_ VFC_TS09_ValidDay : 344|7@1+ (1,0) [0|127] ""  RadarFrontCenter
 SG_ VFC_TS09_ValidTimeRange1Start : 351|7@1+ (15,0) [0|1440] "min"  RadarFrontCenter
 SG_ VFC_TS09_ValidTimeRange1End : 358|7@1+ (15,0) [0|1440] "min"  RadarFrontCenter
 SG_ VFC_TS09_ValidTimeRange2Start : 365|7@1+ (15,0) [0|1440] "min"  RadarFrontCenter
 SG_ VFC_TS09_ValidTimeRange2End : 372|7@1+ (15,0) [0|1440] "min"  RadarFrontCenter
 SG_ VFC_TS09_ValidInDist : 379|15@1+ (0.1,0) [0|3276.7] ""  RadarFrontCenter
 SG_ VFC_TS09_ValidInDistUnit : 394|3@1+ (1,0) [0|7] ""  RadarFrontCenter
 SG_ VFC_TS09_ValidSection : 397|15@1+ (0.1,0) [0|3276.7] ""  RadarFrontCenter
 SG_ VFC_TS09_ValidSectionUnit : 412|3@1+ (1,0) [0|7] ""  RadarFrontCenter
 SG_ VFC_TS09_NumValidSupSigns : 415|3@1+ (1,0) [0|6] ""  RadarFrontCenter
 SG_ VFC_TS09_SupSign0ExistProb : 418|5@1+ (5,0) [0|100] "%"  RadarFrontCenter
 SG_ VFC_TS09_SupSign1ExistProb : 423|5@1+ (5,0) [0|100] "%"  RadarFrontCenter
 SG_ VFC_TS09_SupSign2ExistProb : 428|5@1+ (5,0) [0|100] "%"  RadarFrontCenter
 SG_ VFC_TS09_SupSign3ExistProb : 433|5@1+ (5,0) [0|100] "%"  RadarFrontCenter
 SG_ VFC_TS09_SupSign4ExistProb : 438|5@1+ (5,0) [0|100] "%"  RadarFrontCenter
 SG_ VFC_TS09_SupSign5ExistProb : 443|5@1+ (5,0) [0|100] "%"  RadarFrontCenter
 SG_ VFC_TS09_SupSign0Type : 448|8@1+ (1,0) [0|255] ""  RadarFrontCenter
 SG_ VFC_TS09_SupSign1Type : 456|8@1+ (1,0) [0|255] ""  RadarFrontCenter
 SG_ VFC_TS09_SupSign2Type : 464|8@1+ (1,0) [0|255] ""  RadarFrontCenter
 SG_ VFC_TS09_SupSign3Type : 472|8@1+ (1,0) [0|255] ""  RadarFrontCenter
 SG_ VFC_TS09_SupSign4Type : 480|8@1+ (1,0) [0|255] ""  RadarFrontCenter
 SG_ VFC_TS09_SupSign5Type : 488|8@1+ (1,0) [0|255] ""  RadarFrontCenter

CM_ SG_ 241 VFC_TS_06_07_CRC "CRC - Autosar E2E Profile 5";
CM_ SG_ 241 VFC_TS_06_07_AliveCtr "Alive counter - Autosar E2E Profile 5";
CM_ SG_ 241 VFC_TS_06_07_ProtBlockCtr "Protocol-Signal: Block-Counter";
CM_ SG_ 241 VFC_TS06_ObjId "Unique Traffic Sign ID. ISO 23150:2022(E): Object ID (A.2.2)";
CM_ SG_ 241 VFC_TS06_Type "The type of main sign. ISO 23150:2022(E): Sign classification type (A.2.98)";
CM_ SG_ 241 VFC_TS06_ExistProb "Probability that the sign is a traffic sign. ISO 23150:2022(E): Existence probability - object level (A.2.1)";
CM_ SG_ 241 VFC_TS06_Px "Traffic sign position in longitudinal direction. ISO 23150:2022(E): Position - object level {x, y, z} (A.2.15)";
CM_ SG_ 241 VFC_TS06_Py "Traffic sign position in lateral direction. ISO 23150:2022(E): Position - object level {x, y, z} (A.2.15)";
CM_ SG_ 241 VFC_TS06_Pz "Traffic sign position in vertical direction. ISO 23150:2022(E): Position - object level {x, y, z} (A.2.15)";
CM_ SG_ 241 VFC_TS06_PxStdDev "Standard deviation of Traffic sign position in longitudinal direction. ISO 23150:2022(E): Position - object level {x, y, z} - error (A.2.16)";
CM_ SG_ 241 VFC_TS06_Width "Width of the traffic sign. ISO 23150:2022(E): Bounding box extent {length, width, height} (A.2.20)";
CM_ SG_ 241 VFC_TS06_Height "Height of the traffic sign. ISO 23150:2022(E): Bounding box extent {length, width, height} (A.2.20)";
CM_ SG_ 241 VFC_TS06_EmbeddedInfo "Information how the sign is embedded or not";
CM_ SG_ 241 VFC_TS06_ValidLane "Indicates on which lane the detected sign is valid. If traffic sign is generally valid, all bits shall be set. No relevance to ego lane, signal related to ISO 23150:2022(E): Lane relevance classification type (A.2.147)
Bitfield:
Bit 0: valid on first right hand lane
Bit 1: valid on second right hand lane
Bit 2: valid on third right hand lane
Bit 3: valid on fourth right hand lane
Bit 4: valid on fifth right hand lane";
CM_ SG_ 241 VFC_TS06_ValidDay "The week days for which the main traffic sign is valid. If traffic sign is generally valid, all bits shall be set. Related to ISO 23150:2022(E): Sign text (A.2.102)
Bitfield:
Bit 0: MONDAY
Bit 1: TUESDAY
Bit 2: WEDNESDAY
Bit 3: THURSDAY
Bit 4: FRIDAY
Bit 5: SATURDAY
Bit 6: SUNDAY";
CM_ SG_ 241 VFC_TS06_ValidTimeRange1Start "Start time for the first time range in which the main traffic sign is valid. Minutes since midnight. Related to ISO 23150:2022(E): Sign text (A.2.102)";
CM_ SG_ 241 VFC_TS06_ValidTimeRange1End "End time for the first time range in which the main traffic sign is valid. Minutes since midnight. Related to ISO 23150:2022(E): Sign text (A.2.102)";
CM_ SG_ 241 VFC_TS06_ValidTimeRange2Start "Start time for the second time range in which the main traffic sign is valid. Minutes since midnight. Related to ISO 23150:2022(E): Sign text (A.2.102)";
CM_ SG_ 241 VFC_TS06_ValidTimeRange2End "End time for the second time range in which the main traffic sign is valid. Minutes since midnight. Related to ISO 23150:2022(E): Sign text (A.2.102)";
CM_ SG_ 241 VFC_TS06_ValidInDist "Indicates the longitudinal distance in which the validity of the main traffic sign starts. Unit is set in signal ValidInDistUnit. Related to ISO 23150:2022(E): Sign text (A.2.102)";
CM_ SG_ 241 VFC_TS06_ValidInDistUnit "Unit for signal ValidInDist. ISO 23150:2022(E): Sign value unit (A.2.101)";
CM_ SG_ 241 VFC_TS06_ValidSection "Indicates the longitudinal section for which the main traffic sign is valid. Unit is set in signal ValidSectionUnit. Related to ISO 23150:2022(E): Sign text (A.2.102)";
CM_ SG_ 241 VFC_TS06_ValidSectionUnit "Unit for signal ValidSection. ISO 23150:2022(E): Sign value unit (A.2.101)";
CM_ SG_ 241 VFC_TS06_NumValidSupSigns "Number of valid supplementary signs attached to the main sign. ISO 23150:2022(E): Number of valid traffic supplementary signs (A.2.149)";
CM_ SG_ 241 VFC_TS06_SupSign0ExistProb "Probability that the sign is a supplementary traffic sign. ISO 23150:2022(E): Existence probability - object level (A.2.1)";
CM_ SG_ 241 VFC_TS06_SupSign1ExistProb "Probability that the sign is a supplementary traffic sign. ISO 23150:2022(E): Existence probability - object level (A.2.1)";
CM_ SG_ 241 VFC_TS06_SupSign2ExistProb "Probability that the sign is a supplementary traffic sign. ISO 23150:2022(E): Existence probability - object level (A.2.1)";
CM_ SG_ 241 VFC_TS06_SupSign3ExistProb "Probability that the sign is a supplementary traffic sign. ISO 23150:2022(E): Existence probability - object level (A.2.1)";
CM_ SG_ 241 VFC_TS06_SupSign4ExistProb "Probability that the sign is a supplementary traffic sign. ISO 23150:2022(E): Existence probability - object level (A.2.1)";
CM_ SG_ 241 VFC_TS06_SupSign5ExistProb "Probability that the sign is a supplementary traffic sign. ISO 23150:2022(E): Existence probability - object level (A.2.1)";
CM_ SG_ 241 VFC_TS06_SupSign0Type "The type of supplementary sign. ISO 23150:2022(E): Supplementary sign classification type (A.2.151)";
CM_ SG_ 241 VFC_TS06_SupSign1Type "The type of supplementary sign. ISO 23150:2022(E): Supplementary sign classification type (A.2.151)";
CM_ SG_ 241 VFC_TS06_SupSign2Type "The type of supplementary sign. ISO 23150:2022(E): Supplementary sign classification type (A.2.151)";
CM_ SG_ 241 VFC_TS06_SupSign3Type "The type of supplementary sign. ISO 23150:2022(E): Supplementary sign classification type (A.2.151)";
CM_ SG_ 241 VFC_TS06_SupSign4Type "The type of supplementary sign. ISO 23150:2022(E): Supplementary sign classification type (A.2.151)";
CM_ SG_ 241 VFC_TS06_SupSign5Type "The type of supplementary sign. ISO 23150:2022(E): Supplementary sign classification type (A.2.151)";
CM_ SG_ 241 VFC_TS07_ObjId "Unique Traffic Sign ID. ISO 23150:2022(E): Object ID (A.2.2)";
CM_ SG_ 241 VFC_TS07_Type "The type of main sign. ISO 23150:2022(E): Sign classification type (A.2.98)";
CM_ SG_ 241 VFC_TS07_ExistProb "Probability that the sign is a traffic sign. ISO 23150:2022(E): Existence probability - object level (A.2.1)";
CM_ SG_ 241 VFC_TS07_Px "Traffic sign position in longitudinal direction. ISO 23150:2022(E): Position - object level {x, y, z} (A.2.15)";
CM_ SG_ 241 VFC_TS07_Py "Traffic sign position in lateral direction. ISO 23150:2022(E): Position - object level {x, y, z} (A.2.15)";
CM_ SG_ 241 VFC_TS07_Pz "Traffic sign position in vertical direction. ISO 23150:2022(E): Position - object level {x, y, z} (A.2.15)";
CM_ SG_ 241 VFC_TS07_PxStdDev "Standard deviation of Traffic sign position in longitudinal direction. ISO 23150:2022(E): Position - object level {x, y, z} - error (A.2.16)";
CM_ SG_ 241 VFC_TS07_Width "Width of the traffic sign. ISO 23150:2022(E): Bounding box extent {length, width, height} (A.2.20)";
CM_ SG_ 241 VFC_TS07_Height "Height of the traffic sign. ISO 23150:2022(E): Bounding box extent {length, width, height} (A.2.20)";
CM_ SG_ 241 VFC_TS07_EmbeddedInfo "Information how the sign is embedded or not";
CM_ SG_ 241 VFC_TS07_ValidLane "Indicates on which lane the detected sign is valid. If traffic sign is generally valid, all bits shall be set. No relevance to ego lane, signal related to ISO 23150:2022(E): Lane relevance classification type (A.2.147)
Bitfield:
Bit 0: valid on first right hand lane
Bit 1: valid on second right hand lane
Bit 2: valid on third right hand lane
Bit 3: valid on fourth right hand lane
Bit 4: valid on fifth right hand lane";
CM_ SG_ 241 VFC_TS07_ValidDay "The week days for which the main traffic sign is valid. If traffic sign is generally valid, all bits shall be set. Related to ISO 23150:2022(E): Sign text (A.2.102)
Bitfield:
Bit 0: MONDAY
Bit 1: TUESDAY
Bit 2: WEDNESDAY
Bit 3: THURSDAY
Bit 4: FRIDAY
Bit 5: SATURDAY
Bit 6: SUNDAY";
CM_ SG_ 241 VFC_TS07_ValidTimeRange1Start "Start time for the first time range in which the main traffic sign is valid. Minutes since midnight. Related to ISO 23150:2022(E): Sign text (A.2.102)";
CM_ SG_ 241 VFC_TS07_ValidTimeRange1End "End time for the first time range in which the main traffic sign is valid. Minutes since midnight. Related to ISO 23150:2022(E): Sign text (A.2.102)";
CM_ SG_ 241 VFC_TS07_ValidTimeRange2Start "Start time for the second time range in which the main traffic sign is valid. Minutes since midnight. Related to ISO 23150:2022(E): Sign text (A.2.102)";
CM_ SG_ 241 VFC_TS07_ValidTimeRange2End "End time for the second time range in which the main traffic sign is valid. Minutes since midnight. Related to ISO 23150:2022(E): Sign text (A.2.102)";
CM_ SG_ 241 VFC_TS07_ValidInDist "Indicates the longitudinal distance in which the validity of the main traffic sign starts. Unit is set in signal ValidInDistUnit. Related to ISO 23150:2022(E): Sign text (A.2.102)";
CM_ SG_ 241 VFC_TS07_ValidInDistUnit "Unit for signal ValidInDist. ISO 23150:2022(E): Sign value unit (A.2.101)";
CM_ SG_ 241 VFC_TS07_ValidSection "Indicates the longitudinal section for which the main traffic sign is valid. Unit is set in signal ValidSectionUnit. Related to ISO 23150:2022(E): Sign text (A.2.102)";
CM_ SG_ 241 VFC_TS07_ValidSectionUnit "Unit for signal ValidSection. ISO 23150:2022(E): Sign value unit (A.2.101)";
CM_ SG_ 241 VFC_TS07_NumValidSupSigns "Number of valid supplementary signs attached to the main sign. ISO 23150:2022(E): Number of valid traffic supplementary signs (A.2.149)";
CM_ SG_ 241 VFC_TS07_SupSign0ExistProb "Probability that the sign is a supplementary traffic sign. ISO 23150:2022(E): Existence probability - object level (A.2.1)";
CM_ SG_ 241 VFC_TS07_SupSign1ExistProb "Probability that the sign is a supplementary traffic sign. ISO 23150:2022(E): Existence probability - object level (A.2.1)";
CM_ SG_ 241 VFC_TS07_SupSign2ExistProb "Probability that the sign is a supplementary traffic sign. ISO 23150:2022(E): Existence probability - object level (A.2.1)";
CM_ SG_ 241 VFC_TS07_SupSign3ExistProb "Probability that the sign is a supplementary traffic sign. ISO 23150:2022(E): Existence probability - object level (A.2.1)";
CM_ SG_ 241 VFC_TS07_SupSign4ExistProb "Probability that the sign is a supplementary traffic sign. ISO 23150:2022(E): Existence probability - object level (A.2.1)";
CM_ SG_ 241 VFC_TS07_SupSign5ExistProb "Probability that the sign is a supplementary traffic sign. ISO 23150:2022(E): Existence probability - object level (A.2.1)";
CM_ SG_ 241 VFC_TS07_SupSign0Type "The type of supplementary sign. ISO 23150:2022(E): Supplementary sign classification type (A.2.151)";
CM_ SG_ 241 VFC_TS07_SupSign1Type "The type of supplementary sign. ISO 23150:2022(E): Supplementary sign classification type (A.2.151)";
CM_ SG_ 241 VFC_TS07_SupSign2Type "The type of supplementary sign. ISO 23150:2022(E): Supplementary sign classification type (A.2.151)";
CM_ SG_ 241 VFC_TS07_SupSign3Type "The type of supplementary sign. ISO 23150:2022(E): Supplementary sign classification type (A.2.151)";
CM_ SG_ 241 VFC_TS07_SupSign4Type "The type of supplementary sign. ISO 23150:2022(E): Supplementary sign classification type (A.2.151)";
CM_ SG_ 241 VFC_TS07_SupSign5Type "The type of supplementary sign. ISO 23150:2022(E): Supplementary sign classification type (A.2.151)";
CM_ SG_ 242 VFC_TS_08_09_CRC "CRC - Autosar E2E Profile 5";
CM_ SG_ 242 VFC_TS_08_09_AliveCtr "Alive counter - Autosar E2E Profile 5";
CM_ SG_ 242 VFC_TS_08_09_ProtBlockCtr "Protocol-Signal: Block-Counter";
CM_ SG_ 242 VFC_TS08_ObjId "Unique Traffic Sign ID. ISO 23150:2022(E): Object ID (A.2.2)";
CM_ SG_ 242 VFC_TS08_Type "The type of main sign. ISO 23150:2022(E): Sign classification type (A.2.98)";
CM_ SG_ 242 VFC_TS08_ExistProb "Probability that the sign is a traffic sign. ISO 23150:2022(E): Existence probability - object level (A.2.1)";
CM_ SG_ 242 VFC_TS08_Px "Traffic sign position in longitudinal direction. ISO 23150:2022(E): Position - object level {x, y, z} (A.2.15)";
CM_ SG_ 242 VFC_TS08_Py "Traffic sign position in lateral direction. ISO 23150:2022(E): Position - object level {x, y, z} (A.2.15)";
CM_ SG_ 242 VFC_TS08_Pz "Traffic sign position in vertical direction. ISO 23150:2022(E): Position - object level {x, y, z} (A.2.15)";
CM_ SG_ 242 VFC_TS08_PxStdDev "Standard deviation of Traffic sign position in longitudinal direction. ISO 23150:2022(E): Position - object level {x, y, z} - error (A.2.16)";
CM_ SG_ 242 VFC_TS08_Width "Width of the traffic sign. ISO 23150:2022(E): Bounding box extent {length, width, height} (A.2.20)";
CM_ SG_ 242 VFC_TS08_Height "Height of the traffic sign. ISO 23150:2022(E): Bounding box extent {length, width, height} (A.2.20)";
CM_ SG_ 242 VFC_TS08_EmbeddedInfo "Information how the sign is embedded or not";
CM_ SG_ 242 VFC_TS08_ValidLane "Indicates on which lane the detected sign is valid. If traffic sign is generally valid, all bits shall be set. No relevance to ego lane, signal related to ISO 23150:2022(E): Lane relevance classification type (A.2.147)
Bitfield:
Bit 0: valid on first right hand lane
Bit 1: valid on second right hand lane
Bit 2: valid on third right hand lane
Bit 3: valid on fourth right hand lane
Bit 4: valid on fifth right hand lane";
CM_ SG_ 242 VFC_TS08_ValidDay "The week days for which the main traffic sign is valid. If traffic sign is generally valid, all bits shall be set. Related to ISO 23150:2022(E): Sign text (A.2.102)
Bitfield:
Bit 0: MONDAY
Bit 1: TUESDAY
Bit 2: WEDNESDAY
Bit 3: THURSDAY
Bit 4: FRIDAY
Bit 5: SATURDAY
Bit 6: SUNDAY";
CM_ SG_ 242 VFC_TS08_ValidTimeRange1Start "Start time for the first time range in which the main traffic sign is valid. Minutes since midnight. Related to ISO 23150:2022(E): Sign text (A.2.102)";
CM_ SG_ 242 VFC_TS08_ValidTimeRange1End "End time for the first time range in which the main traffic sign is valid. Minutes since midnight. Related to ISO 23150:2022(E): Sign text (A.2.102)";
CM_ SG_ 242 VFC_TS08_ValidTimeRange2Start "Start time for the second time range in which the main traffic sign is valid. Minutes since midnight. Related to ISO 23150:2022(E): Sign text (A.2.102)";
CM_ SG_ 242 VFC_TS08_ValidTimeRange2End "End time for the second time range in which the main traffic sign is valid. Minutes since midnight. Related to ISO 23150:2022(E): Sign text (A.2.102)";
CM_ SG_ 242 VFC_TS08_ValidInDist "Indicates the longitudinal distance in which the validity of the main traffic sign starts. Unit is set in signal ValidInDistUnit. Related to ISO 23150:2022(E): Sign text (A.2.102)";
CM_ SG_ 242 VFC_TS08_ValidInDistUnit "Unit for signal ValidInDist. ISO 23150:2022(E): Sign value unit (A.2.101)";
CM_ SG_ 242 VFC_TS08_ValidSection "Indicates the longitudinal section for which the main traffic sign is valid. Unit is set in signal ValidSectionUnit. Related to ISO 23150:2022(E): Sign text (A.2.102)";
CM_ SG_ 242 VFC_TS08_ValidSectionUnit "Unit for signal ValidSection. ISO 23150:2022(E): Sign value unit (A.2.101)";
CM_ SG_ 242 VFC_TS08_NumValidSupSigns "Number of valid supplementary signs attached to the main sign. ISO 23150:2022(E): Number of valid traffic supplementary signs (A.2.149)";
CM_ SG_ 242 VFC_TS08_SupSign0ExistProb "Probability that the sign is a supplementary traffic sign. ISO 23150:2022(E): Existence probability - object level (A.2.1)";
CM_ SG_ 242 VFC_TS08_SupSign1ExistProb "Probability that the sign is a supplementary traffic sign. ISO 23150:2022(E): Existence probability - object level (A.2.1)";
CM_ SG_ 242 VFC_TS08_SupSign2ExistProb "Probability that the sign is a supplementary traffic sign. ISO 23150:2022(E): Existence probability - object level (A.2.1)";
CM_ SG_ 242 VFC_TS08_SupSign3ExistProb "Probability that the sign is a supplementary traffic sign. ISO 23150:2022(E): Existence probability - object level (A.2.1)";
CM_ SG_ 242 VFC_TS08_SupSign4ExistProb "Probability that the sign is a supplementary traffic sign. ISO 23150:2022(E): Existence probability - object level (A.2.1)";
CM_ SG_ 242 VFC_TS08_SupSign5ExistProb "Probability that the sign is a supplementary traffic sign. ISO 23150:2022(E): Existence probability - object level (A.2.1)";
CM_ SG_ 242 VFC_TS08_SupSign0Type "The type of supplementary sign. ISO 23150:2022(E): Supplementary sign classification type (A.2.151)";
CM_ SG_ 242 VFC_TS08_SupSign1Type "The type of supplementary sign. ISO 23150:2022(E): Supplementary sign classification type (A.2.151)";
CM_ SG_ 242 VFC_TS08_SupSign2Type "The type of supplementary sign. ISO 23150:2022(E): Supplementary sign classification type (A.2.151)";
CM_ SG_ 242 VFC_TS08_SupSign3Type "The type of supplementary sign. ISO 23150:2022(E): Supplementary sign classification type (A.2.151)";
CM_ SG_ 242 VFC_TS08_SupSign4Type "The type of supplementary sign. ISO 23150:2022(E): Supplementary sign classification type (A.2.151)";
CM_ SG_ 242 VFC_TS08_SupSign5Type "The type of supplementary sign. ISO 23150:2022(E): Supplementary sign classification type (A.2.151)";
CM_ SG_ 242 VFC_TS09_ObjId "Unique Traffic Sign ID. ISO 23150:2022(E): Object ID (A.2.2)";
CM_ SG_ 242 VFC_TS09_Type "The type of main sign. ISO 23150:2022(E): Sign classification type (A.2.98)";
CM_ SG_ 242 VFC_TS09_ExistProb "Probability that the sign is a traffic sign. ISO 23150:2022(E): Existence probability - object level (A.2.1)";
CM_ SG_ 242 VFC_TS09_Px "Traffic sign position in longitudinal direction. ISO 23150:2022(E): Position - object level {x, y, z} (A.2.15)";
CM_ SG_ 242 VFC_TS09_Py "Traffic sign position in lateral direction. ISO 23150:2022(E): Position - object level {x, y, z} (A.2.15)";
CM_ SG_ 242 VFC_TS09_Pz "Traffic sign position in vertical direction. ISO 23150:2022(E): Position - object level {x, y, z} (A.2.15)";
CM_ SG_ 242 VFC_TS09_PxStdDev "Standard deviation of Traffic sign position in longitudinal direction. ISO 23150:2022(E): Position - object level {x, y, z} - error (A.2.16)";
CM_ SG_ 242 VFC_TS09_Width "Width of the traffic sign. ISO 23150:2022(E): Bounding box extent {length, width, height} (A.2.20)";
CM_ SG_ 242 VFC_TS09_Height "Height of the traffic sign. ISO 23150:2022(E): Bounding box extent {length, width, height} (A.2.20)";
CM_ SG_ 242 VFC_TS09_EmbeddedInfo "Information how the sign is embedded or not";
CM_ SG_ 242 VFC_TS09_ValidLane "Indicates on which lane the detected sign is valid. If traffic sign is generally valid, all bits shall be set. No relevance to ego lane, signal related to ISO 23150:2022(E): Lane relevance classification type (A.2.147)
Bitfield:
Bit 0: valid on first right hand lane
Bit 1: valid on second right hand lane
Bit 2: valid on third right hand lane
Bit 3: valid on fourth right hand lane
Bit 4: valid on fifth right hand lane";
CM_ SG_ 242 VFC_TS09_ValidDay "The week days for which the main traffic sign is valid. If traffic sign is generally valid, all bits shall be set. Related to ISO 23150:2022(E): Sign text (A.2.102)
Bitfield:
Bit 0: MONDAY
Bit 1: TUESDAY
Bit 2: WEDNESDAY
Bit 3: THURSDAY
Bit 4: FRIDAY
Bit 5: SATURDAY
Bit 6: SUNDAY";
CM_ SG_ 242 VFC_TS09_ValidTimeRange1Start "Start time for the first time range in which the main traffic sign is valid. Minutes since midnight. Related to ISO 23150:2022(E): Sign text (A.2.102)";
CM_ SG_ 242 VFC_TS09_ValidTimeRange1End "End time for the first time range in which the main traffic sign is valid. Minutes since midnight. Related to ISO 23150:2022(E): Sign text (A.2.102)";
CM_ SG_ 242 VFC_TS09_ValidTimeRange2Start "Start time for the second time range in which the main traffic sign is valid. Minutes since midnight. Related to ISO 23150:2022(E): Sign text (A.2.102)";
CM_ SG_ 242 VFC_TS09_ValidTimeRange2End "End time for the second time range in which the main traffic sign is valid. Minutes since midnight. Related to ISO 23150:2022(E): Sign text (A.2.102)";
CM_ SG_ 242 VFC_TS09_ValidInDist "Indicates the longitudinal distance in which the validity of the main traffic sign starts. Unit is set in signal ValidInDistUnit. Related to ISO 23150:2022(E): Sign text (A.2.102)";
CM_ SG_ 242 VFC_TS09_ValidInDistUnit "Unit for signal ValidInDist. ISO 23150:2022(E): Sign value unit (A.2.101)";
CM_ SG_ 242 VFC_TS09_ValidSection "Indicates the longitudinal section for which the main traffic sign is valid. Unit is set in signal ValidSectionUnit. Related to ISO 23150:2022(E): Sign text (A.2.102)";
CM_ SG_ 242 VFC_TS09_ValidSectionUnit "Unit for signal ValidSection. ISO 23150:2022(E): Sign value unit (A.2.101)";
CM_ SG_ 242 VFC_TS09_NumValidSupSigns "Number of valid supplementary signs attached to the main sign. ISO 23150:2022(E): Number of valid traffic supplementary signs (A.2.149)";
CM_ SG_ 242 VFC_TS09_SupSign0ExistProb "Probability that the sign is a supplementary traffic sign. ISO 23150:2022(E): Existence probability - object level (A.2.1)";
CM_ SG_ 242 VFC_TS09_SupSign1ExistProb "Probability that the sign is a supplementary traffic sign. ISO 23150:2022(E): Existence probability - object level (A.2.1)";
CM_ SG_ 242 VFC_TS09_SupSign2ExistProb "Probability that the sign is a supplementary traffic sign. ISO 23150:2022(E): Existence probability - object level (A.2.1)";
CM_ SG_ 242 VFC_TS09_SupSign3ExistProb "Probability that the sign is a supplementary traffic sign. ISO 23150:2022(E): Existence probability - object level (A.2.1)";
CM_ SG_ 242 VFC_TS09_SupSign4ExistProb "Probability that the sign is a supplementary traffic sign. ISO 23150:2022(E): Existence probability - object level (A.2.1)";
CM_ SG_ 242 VFC_TS09_SupSign5ExistProb "Probability that the sign is a supplementary traffic sign. ISO 23150:2022(E): Existence probability - object level (A.2.1)";
CM_ SG_ 242 VFC_TS09_SupSign0Type "The type of supplementary sign. ISO 23150:2022(E): Supplementary sign classification type (A.2.151)";
CM_ SG_ 242 VFC_TS09_SupSign1Type "The type of supplementary sign. ISO 23150:2022(E): Supplementary sign classification type (A.2.151)";
CM_ SG_ 242 VFC_TS09_SupSign2Type "The type of supplementary sign. ISO 23150:2022(E): Supplementary sign classification type (A.2.151)";
CM_ SG_ 242 VFC_TS09_SupSign3Type "The type of supplementary sign. ISO 23150:2022(E): Supplementary sign classification type (A.2.151)";
CM_ SG_ 242 VFC_TS09_SupSign4Type "The type of supplementary sign. ISO 23150:2022(E): Supplementary sign classification type (A.2.151)";
CM_ SG_ 242 VFC_TS09_SupSign5Type "The type of supplementary sign. ISO 23150:2022(E): Supplementary sign classification type (A.2.151)";
BA_DEF_ SG_  "GenSigSendType" ENUM  "Cyclic","OnWrite","OnWriteWithRepetition","OnChange","OnChangeWithRepetition","IfActive","IfActiveWithRepetition";
BA_DEF_ BO_  "GenMsgCycleTimeFast" INT 2 50000;
BA_DEF_ BO_  "GenMsgILSupport" ENUM  "No","Yes";
BA_DEF_ BO_  "CANFD_BRS" ENUM  "0","1";
BA_DEF_ BO_  "GenMsgCycleTime" INT 0 65535;
BA_DEF_ BO_  "GenMsgSendType" ENUM  "Event","cyclic";
BA_DEF_ BO_  "VFrameFormat" ENUM  "StandardCAN","ExtendedCAN","reserved","reserved","reserved","reserved","reserved","reserved","reserved","reserved","reserved","reserved","reserved","reserved","StandardCAN_FD","ExtendedCAN_FD";
BA_DEF_ BO_  "E2Eprofile" STRING ;
BA_DEF_ BO_  "DataID" HEX 0 655535;
BA_DEF_ SG_  "GenSigStartValue" FLOAT 0 100000000000;
BA_DEF_DEF_  "GenSigSendType" "Cyclic";
BA_DEF_DEF_  "GenMsgCycleTimeFast" 100;
BA_DEF_DEF_  "GenMsgILSupport" "Yes";
BA_DEF_DEF_  "CANFD_BRS" "1";
BA_DEF_DEF_  "GenMsgCycleTime" 0;
BA_DEF_DEF_  "GenMsgSendType" "";
BA_DEF_DEF_  "VFrameFormat" "";
BA_DEF_DEF_  "E2Eprofile" "None";
BA_DEF_DEF_  "DataID" 0;
BA_DEF_DEF_  "GenSigStartValue" 0;
BA_ "GenMsgSendType" BO_ 241 0;
BA_ "E2Eprofile" BO_ 241 "AUTOSAR Profile 5";
BA_ "DataID" BO_ 241 8433;
BA_ "VFrameFormat" BO_ 241 14;
BA_ "GenMsgSendType" BO_ 242 0;
BA_ "E2Eprofile" BO_ 242 "AUTOSAR Profile 5";
BA_ "DataID" BO_ 242 8434;
BA_ "VFrameFormat" BO_ 242 14;
BA_ "GenSigStartValue" SG_ 241 VFC_TS06_Py 128;
BA_ "GenSigStartValue" SG_ 241 VFC_TS07_Py 128;
BA_ "GenSigStartValue" SG_ 242 VFC_TS08_Py 128;
BA_ "GenSigStartValue" SG_ 242 VFC_TS09_Py 128;
VAL_ 241 VFC_TS06_Type 0 "UNKNOWN" 1 "SL5" 2 "SL10" 3 "SL15" 4 "SL20" 5 "SL25" 6 "SL30" 7 "SL35" 8 "SL40" 9 "SL45" 10 "SL50" 11 "SL55" 12 "SL60" 13 "SL65" 14 "SL70" 15 "SL75" 16 "SL80" 17 "SL85" 18 "SL90" 19 "SL95" 20 "SL100" 21 "SL105" 22 "SL110" 23 "SL115" 24 "SL120" 25 "SL125" 26 "SL130" 27 "SL135" 28 "SL140" 29 "SL145" 30 "SL150" 31 "SL155" 32 "SL160" 33 "OP" 34 "OL" 35 "ESL" 36 "EOP" 37 "EOL" 38 "EA" 39 "VSL5" 40 "VSL10" 41 "VSL15" 42 "VSL20" 43 "VSL25" 44 "VSL30" 45 "VSL35" 46 "VSL40" 47 "VSL45" 48 "VSL50" 49 "VSL55" 50 "VSL60" 51 "VSL65" 52 "VSL70" 53 "VSL75" 54 "VSL80" 55 "VSL85" 56 "VSL90" 57 "VSL95" 58 "VSL100" 59 "VSL105" 60 "VSL110" 61 "VSL115" 62 "VSL120" 63 "VSL125" 64 "VSL130" 65 "VSL135" 66 "VSL140" 67 "VSL145" 68 "VSL150" 69 "VSL155" 70 "VSL160" 71 "VOP" 72 "VOL" 73 "VESL" 74 "VEOP" 75 "VEOL" 76 "VEA" 77 "NOENTRY" 78 "NOALL" 79 "NOCAR" 80 "NOLORRY" 81 "NOHAZMAT" 82 "NOBIKE" 83 "NOPED" 84 "NOCARBIKE" 85 "NOTWOWAY" 86 "WEIGHT" 87 "HEIGHT" 88 "WIDTH" 89 "LENGTH" 90 "PRIOCROSS" 91 "GIVEWAY" 92 "PRIOCROSSYIELDTORIGHT" 93 "WARNDANGER" 94 "WARNCURVEL" 95 "WARNCURVER" 96 "WARNDCURVEL" 97 "WARNDCURVER" 98 "WARNTRAIN" 99 "WARNJAM" 100 "WARNANIMAL_DEPRECATED" 101 "WARNRWORKS" 102 "WARNSLOPED" 103 "WARNSLOPEU" 104 "PRIOSTREET" 105 "EPRIOSTREET" 106 "STOP" 107 "ASL" 108 "EASL" 109 "MSL" 110 "EMSL" 111 "MLC" 112 "WBDIAGL" 113 "WBDIAGR" 114 "WBROUND" 115 "NOLTURN" 116 "NORTURN" 117 "NOUTURN" 118 "NOPARK" 119 "NOSTOP" 120 "SMOG" 121 "UMWELT" 122 "EUMWELT" 123 "DOUANE" 124 "FWAY" 125 "EFWAY" 126 "HWAY" 127 "EHWAY" 128 "NORIDER" 129 "WARNCONST" 130 "WARNCONSTL" 131 "WARNCONSTR" 132 "WARNPED" 133 "WARNKIDS" 134 "WARNBIKE" 135 "WARNSKID" 136 "ZEBRA" 137 "ONEWAYS" 138 "ONEWAYU" 139 "SLOWDOWN" 140 "NOCARRIAGE" 141 "NOLORRYTRAILER" 142 "NOBUS" 143 "NOTRACTOR" 144 "LORRYDIST" 145 "CARDIST" 146 "WARNROUND" 147 "WARNWILDANIMAL" 148 "WARNCATTLE" 149 "WARNFROG" 150 "WARNBUS" 151 "WARNWIND" 152 "WARNSNOW" 153 "WARNPCROSS" 154 "WARNHUMP" 155 "WARNROCK" 156 "WARNLOWTREE" 157 "WARNGRAVEL" 158 "WARNTWOWAY" 159 "WARNLIGHTS" 160 "WARNPLANE" 161 "VNOENTRY" 162 "VNOALL" 163 "VNOCAR" 164 "VNOLORRY" 165 "VNOCARBIKE" 166 "VWEIGHT" 167 "VHEIGHT" 168 "VWIDTH" 169 "VLENGTH" 170 "VWARNDANGER" 171 "VWARNJAM" 172 "VWARNRWORKS" 173 "VWARNSKID" 174 "VASL" 175 "VEASL" 176 "VNOLORRYTRAILER" 177 "VNOBUS" 178 "VLORRYDIST" 179 "VCARDIST" 180 "VWARNSNOW" 181 "VWARNHUMP" 182 "VWARNGRAVEL" 183 "CALM" 184 "ECALM" 185 "TWN" 186 "ETWN" 187 "DEADEND" 188 "AXLEWEIGHT" 189 "WARNRIDER" 190 "WARNDRAWBRIDGE" 191 "WARNPIER" 192 "TRINATURE" 193 "VWARNCONST" 194 "VWARNCONSTL" 195 "VWARNCONSTR" 196 "VWARNCURVEL" 197 "VWARNCURVER" 198 "VWARNDCURVEL" 199 "VWARNDCURVER" 200 "VWARNLIGHTS" 201 "WBBENTLEFT" 202 "WBBENTLEFTRIGHT" 203 "WBBENTRIGHT" 204 "WBDIAGLR" 205 "WBLEFT" 206 "WBRIGHT" 207 "WBUP" 208 "WBUPLEFT" 209 "WBUPRIGHT" 210 "WBHAZWATER" 211 "NOHAZWATER" 212 "SCHOOL" 213 "ESCHOOL" 214 "HAZMAT" 215 "EMERGENCYBAY" 216 "ENDOFLANEL" 217 "ENDOFLANER" 218 "ENOPARK" 219 "EONEWAY" 220 "EPARK" 221 "ETOLL" 222 "NOPARKL" 223 "NOPARKLR" 224 "NOPARKR" 225 "NOSTOPL" 226 "NOSTOPLR" 227 "NOSTOPR" 228 "NOTURNONRED" 229 "ONEWAYL" 230 "ONEWAYR" 231 "PARK" 232 "PRIOCROSSL" 233 "PRIOCROSSR" 234 "TOLL" 235 "TUNNEL" 236 "TWOWAY" 237 "WARNCROSS" 238 "WARNCROSSL" 239 "WARNCROSSLR" 240 "WARNCROSSR" 241 "WARNCROSSRL" 242 "WARNCROSST" 243 "WARNGIVEWAYAHEAD" 244 "WARNSLAHEAD" 245 "WARNSTOPAHEAD" 246 "WBBUS" 247 "WRONGWAY" 248 "HAZWATER" 249 "GIVEWAYROUND" 250 "WARNWINDINGL" 251 "WARNWINDINGR" 252 "WARNHAIRPINL" 253 "WARNHAIRPINR" 254 "WARNPEDBIKE" 255 "WARNCROSSY" 256 "WARNBRANCHL" 257 "WARNBRANCHR" 258 "WARNAXLEWEIGHT" 259 "WARNWEIGHT" 260 "WARNHEIGHT" 261 "WARNLENGTH" 262 "WARNWIDTH" 263 "WARNBLACKSPOT" 264 "WARNMERGEL" 265 "WARNMERGER" 266 "WARNTUNNEL" 267 "WARNTRACTOR" 268 "WARNRWORKSVEHICLE" 269 "WARNNARROWBRIDGE" 270 "WARNFLAGGER" 271 "LANES" 272 "LANESHIFTL" 273 "LANESHIFTR" 274 "NEWLANEL" 275 "NEWLANER" 276 "RIGHTTURNONRED" 277 "BORDERLIMIT" 278 "EMBEDDEDRAIN" 279 "VWARNWEIGHT" 280 "VWARNHEIGHT" 281 "VWARNLENGTH" 282 "VWARNWIDTH" 283 "VENDOFLANEL" 284 "VENDOFLANER" 285 "VLANES" 286 "VLANESHIFTL" 287 "VLANESHIFTR" 288 "VNEWLANEL" 289 "VNEWLANER" 290 "NOUP" 291 "VOFF" 292 "ASL5" 293 "ASL10" 294 "ASL15" 295 "ASL20" 296 "ASL25" 297 "ASL30" 298 "ASL35" 299 "ASL40" 300 "ASL45" 301 "ASL50" 302 "ASL55" 303 "ASL60" 304 "ASL65" 305 "ASL70" 306 "ASL75" 307 "ASL80" 308 "ASL85" 309 "ASL90" 310 "ASL95" 311 "ASL100" 312 "ASL105" 313 "ASL110" 314 "ASL115" 315 "ASL120" 316 "ASL125" 317 "ASL130" 318 "ASL135" 319 "ASL140" 320 "ASL145" 321 "ASL150" 322 "ASL155" 323 "ASL160" 324 "VASL5" 325 "VASL10" 326 "VASL15" 327 "VASL20" 328 "VASL25" 329 "VASL30" 330 "VASL35" 331 "VASL40" 332 "VASL45" 333 "VASL50" 334 "VASL55" 335 "VASL60" 336 "VASL65" 337 "VASL70" 338 "VASL75" 339 "VASL80" 340 "VASL85" 341 "VASL90" 342 "VASL95" 343 "VASL100" 344 "VASL105" 345 "VASL110" 346 "VASL115" 347 "VASL120" 348 "VASL125" 349 "VASL130" 350 "VASL135" 351 "VASL140" 352 "VASL145" 353 "VASL150" 354 "VASL155" 355 "VASL160" 356 "WARNTRAINGATED" 357 "KEEPRIGHTCAR" 358 "ASLCURVE5" 359 "ASLCURVE10" 360 "ASLCURVE15" 361 "ASLCURVE20" 362 "ASLCURVE25" 363 "ASLCURVE30" 364 "ASLCURVE35" 365 "ASLCURVE40" 366 "ASLCURVE45" 367 "ASLCURVE50" 368 "ASLCURVE55" 369 "ASLCURVE60" 370 "ASLCURVE65" 371 "ASLCURVE70" 372 "ASLCURVE75" 373 "ASLCURVE80" 374 "ASLCURVE85" 375 "ASLCURVE90" 376 "ASLCURVE95" 377 "ASLCURVE100" 378 "ASLCURVE105" 379 "ASLCURVE110" 380 "ASLCURVE115" 381 "ASLCURVE120" 382 "ASLCURVE125" 383 "ASLCURVE130" 384 "ASLCURVE135" 385 "ASLCURVE140" 386 "ASLCURVE145" 387 "ASLCURVE150" 388 "ASLCURVE155" 389 "ASLCURVE160" 390 "KIDS" 391 "EKIDS" 392 "BIKEROAD" 393 "EBIKEROAD" 394 "PEDSTREET" 395 "EPEDSTREET" 396 "PEDBIKESTREET" 397 "EPEDBIKESTREET" 398 "EWARNKIDS" 399 "CALM20" 400 "CALM30" 401 "ECALM20" 402 "ECALM30" 403 "FWAYGREEN" 404 "TWN40" 405 "TWN50" 406 "TWN60" 407 "TWN70" 408 "ETWN40" 409 "ETWN50" 410 "ETWN60" 411 "ETWN70" 412 "WBBIKE" 413 "EWBBIKE" 414 "WBPED" 415 "EWBPED" 416 "WBPEDBIKESEP" 417 "EWBPEDBIKESEP" 418 "WBPEDBIKESHARED" 419 "EWBPEDBIKESHARED" 420 "EFWAYGREEN" 421 "Reserved0421" 422 "Reserved0422" 423 "Reserved0423" 424 "Reserved0424" 425 "Reserved0425" 426 "Reserved0426" 427 "Reserved0427" 428 "Reserved0428" 429 "Reserved0429" 430 "Reserved0430" 431 "Reserved0431" 432 "Reserved0432" 433 "Reserved0433" 434 "Reserved0434" 435 "Reserved0435" 436 "Reserved0436" 437 "Reserved0437" 438 "Reserved0438" 439 "Reserved0439" 440 "Reserved0440" 441 "Reserved0441" 442 "Reserved0442" 443 "Reserved0443" 444 "Reserved0444" 445 "Reserved0445" 446 "Reserved0446" 447 "Reserved0447" 448 "Reserved0448" 449 "Reserved0449" ;
VAL_ 241 VFC_TS06_EmbeddedInfo 0 "Unknown" 1 "Not Embedded" 2 "Border Limit" 3 "Multi Lane" 4 "Rain" 5 "Vehicle Type" 6 "Plate" 7 "Error Value" 8 "Vehicle Sticker" 9 "Reserved09" 10 "Reserved10" 11 "Reserved11" 12 "Reserved12" 13 "Reserved13" 14 "Reserved14" 15 "Reserved15" ;
VAL_ 241 VFC_TS06_ValidTimeRange1Start 127 "Unknown" ;
VAL_ 241 VFC_TS06_ValidTimeRange1End 127 "Unknown" ;
VAL_ 241 VFC_TS06_ValidTimeRange2Start 127 "Unknown" ;
VAL_ 241 VFC_TS06_ValidTimeRange2End 127 "Unknown" ;
VAL_ 241 VFC_TS06_ValidInDistUnit 0 "Unknown" ;
VAL_ 241 VFC_TS06_ValidSectionUnit 0 "Unknown" 1 "Meter" 2 "Kilometer" 3 "Foot" 4 "Yard" 5 "Mile" 6 "Reserved6" 7 "Reserved7" ;
VAL_ 241 VFC_TS06_SupSign0Type 0 "UNKNOWN" 1 "ADDCAR" 2 "ADDLORRY" 3 "ADDTRAILER" 4 "ADDCARAVAN" 5 "ADDBUS" 6 "ADDTRACTOR" 7 "ADDMCYCLE" 8 "ADDLORRYBUSTRAILER_DEPRECATED" 9 "ADDLORRYBUS_DEPRECATED" 10 "ADDHAZMAT" 11 "ADDTANK" 12 "ADDTRAM" 13 "ADDWET" 14 "ADDFOG" 15 "ADDRAIN" 16 "ADDSNOW" 17 "ADDTIME" 18 "ADDSECTION" 19 "ADDDISTANCE" 20 "ADDWEIGHT" 21 "ADDEXITL" 22 "ADDEXITR" 23 "ADDLANES" 24 "ADDRADAR" 25 "ADDRAPPEL" 26 "ADDPRIOTURN" 27 "ADDLORRY_EXCEPT" 28 "ADDTRACTOR_OVER" 29 "ADDTEXT" 30 "ADDSIGN" 31 "ADDRAINSNOW" 32 "ADDHUMP" 33 "VADDLORRYBUSTRAILER_DEPRECATED" 34 "VADDLORRYBUS_DEPRECATED" 35 "VADDLORRYTRAILER_DEPRECATED" 36 "ADDLORRYTRAILER_DEPRECATED" 37 "ADDCAMPER" 38 "ADDZONE" 39 "ADDCRASHRISK" 40 "ADDACCIDENT" 41 "ADDJAM" 42 "ADDSMOKE" 43 "ADDOILTRAIL" 44 "ADDGRAVEL" 45 "ADDDIRT" 46 "ADDRWORKSEXIT" 47 "ADDROADDAMAGE" 48 "ADDRWORKSENTRY" 49 "ADDLOWTREE" 50 "ADDRWORKSACCESS" 51 "ADDRUTS" 52 "ADDSOFTSHOULDERCAR" 53 "ADDSOFTSHOULDERLORRY" 54 "VADDSIGN" 55 "VADDCAR" 56 "VADDLORRY" 57 "VADDTRAILER" 58 "VADDCARAVAN" 59 "VADDBUS" 60 "VADDWET" 61 "VADDFOG" 62 "VADDRAIN" 63 "VADDSNOW" 64 "VADDRAINSNOW" 65 "VADDTEXT" 66 "VADDSECTION" 67 "VADDDISTANCE" 68 "VADDWEIGHT" 69 "VADDZONE" 70 "VADDCRASHRISK" 71 "VADDACCIDENT" 72 "VADDJAM" 73 "VADDOILTRAIL" 74 "VADDGRAVEL" 75 "VADDDIRT" 76 "VADDROADDAMAGE" 77 "VADDRUTS" 78 "ADDNOSTOPSHOULDER" 79 "ADDTOWING" 80 "ADDSCHOOL" 81 "ADDNIGHT" 82 "ADDEND" 83 "ADDBEGINS" 84 "ADDWITHIN" 85 "ADDDISTANCEBARS" 86 "ADDMINIMUM" 87 "ADDADVICE" 88 "ADDACCESS" 89 "ADDALLWAY" 90 "ADDBUS_EXCEPT" 91 "ADDEXCEPTDELIVERY" 92 "ADDEXCEPTLOCAL" 93 "ADDFROG" 94 "ADDPRIOTURNL" 95 "ADDPRIOTURNR" 96 "ADDSTART" 97 "ADDSTOPIN" 98 "ADDEXIT" 99 "ADDHAZWATER" 100 "ADDDAY" 101 "ADDSL" 102 "ADDLORRYTRAILER" 103 "ADDLORRYSEMI" 104 "VADDLORRYTRAILER" 105 "VADDLORRYSEMI" 106 "ADDSLOW" 107 "ADDSL5" 108 "ADDSL10" 109 "ADDSL15" 110 "ADDSL20" 111 "ADDSL25" 112 "ADDSL30" 113 "ADDSL35" 114 "ADDSL40" 115 "ADDSL45" 116 "ADDSL50" 117 "ADDSL55" 118 "ADDSL60" 119 "ADDSL65" 120 "ADDSL70" 121 "ADDSL75" 122 "ADDSL80" 123 "ADDSL85" 124 "ADDSL90" 125 "ADDSL95" 126 "ADDSL100" 127 "ADDSL105" 128 "ADDSL110" 129 "ADDSL115" 130 "ADDSL120" 131 "ADDSL125" 132 "ADDSL130" 133 "ADDSL135" 134 "ADDSL140" 135 "ADDSL145" 136 "ADDSL150" 137 "ADDSL155" 138 "ADDSL160" 139 "ADDBIKEROAD" 140 "ADDLORRYTRAILER_EXCEPT" 141 "ADDLORRYSEMI_EXCEPT" 142 "Reserved142" 143 "Reserved143" 144 "Reserved144" 145 "Reserved145" 146 "Reserved146" 147 "Reserved147" 148 "Reserved148" 149 "Reserved149" 150 "Reserved150" 151 "Reserved151" 152 "Reserved152" 153 "Reserved153" 154 "Reserved154" 155 "Reserved155" 156 "Reserved156" 157 "Reserved157" 158 "Reserved158" 159 "Reserved159" 160 "Reserved160" 161 "Reserved161" 162 "Reserved162" 163 "Reserved163" 164 "Reserved164" 165 "Reserved165" 166 "Reserved166" 167 "Reserved167" 168 "Reserved168" 169 "Reserved169" ;
VAL_ 241 VFC_TS06_SupSign1Type 0 "UNKNOWN" 1 "ADDCAR" 2 "ADDLORRY" 3 "ADDTRAILER" 4 "ADDCARAVAN" 5 "ADDBUS" 6 "ADDTRACTOR" 7 "ADDMCYCLE" 8 "ADDLORRYBUSTRAILER_DEPRECATED" 9 "ADDLORRYBUS_DEPRECATED" 10 "ADDHAZMAT" 11 "ADDTANK" 12 "ADDTRAM" 13 "ADDWET" 14 "ADDFOG" 15 "ADDRAIN" 16 "ADDSNOW" 17 "ADDTIME" 18 "ADDSECTION" 19 "ADDDISTANCE" 20 "ADDWEIGHT" 21 "ADDEXITL" 22 "ADDEXITR" 23 "ADDLANES" 24 "ADDRADAR" 25 "ADDRAPPEL" 26 "ADDPRIOTURN" 27 "ADDLORRY_EXCEPT" 28 "ADDTRACTOR_OVER" 29 "ADDTEXT" 30 "ADDSIGN" 31 "ADDRAINSNOW" 32 "ADDHUMP" 33 "VADDLORRYBUSTRAILER_DEPRECATED" 34 "VADDLORRYBUS_DEPRECATED" 35 "VADDLORRYTRAILER_DEPRECATED" 36 "ADDLORRYTRAILER_DEPRECATED" 37 "ADDCAMPER" 38 "ADDZONE" 39 "ADDCRASHRISK" 40 "ADDACCIDENT" 41 "ADDJAM" 42 "ADDSMOKE" 43 "ADDOILTRAIL" 44 "ADDGRAVEL" 45 "ADDDIRT" 46 "ADDRWORKSEXIT" 47 "ADDROADDAMAGE" 48 "ADDRWORKSENTRY" 49 "ADDLOWTREE" 50 "ADDRWORKSACCESS" 51 "ADDRUTS" 52 "ADDSOFTSHOULDERCAR" 53 "ADDSOFTSHOULDERLORRY" 54 "VADDSIGN" 55 "VADDCAR" 56 "VADDLORRY" 57 "VADDTRAILER" 58 "VADDCARAVAN" 59 "VADDBUS" 60 "VADDWET" 61 "VADDFOG" 62 "VADDRAIN" 63 "VADDSNOW" 64 "VADDRAINSNOW" 65 "VADDTEXT" 66 "VADDSECTION" 67 "VADDDISTANCE" 68 "VADDWEIGHT" 69 "VADDZONE" 70 "VADDCRASHRISK" 71 "VADDACCIDENT" 72 "VADDJAM" 73 "VADDOILTRAIL" 74 "VADDGRAVEL" 75 "VADDDIRT" 76 "VADDROADDAMAGE" 77 "VADDRUTS" 78 "ADDNOSTOPSHOULDER" 79 "ADDTOWING" 80 "ADDSCHOOL" 81 "ADDNIGHT" 82 "ADDEND" 83 "ADDBEGINS" 84 "ADDWITHIN" 85 "ADDDISTANCEBARS" 86 "ADDMINIMUM" 87 "ADDADVICE" 88 "ADDACCESS" 89 "ADDALLWAY" 90 "ADDBUS_EXCEPT" 91 "ADDEXCEPTDELIVERY" 92 "ADDEXCEPTLOCAL" 93 "ADDFROG" 94 "ADDPRIOTURNL" 95 "ADDPRIOTURNR" 96 "ADDSTART" 97 "ADDSTOPIN" 98 "ADDEXIT" 99 "ADDHAZWATER" 100 "ADDDAY" 101 "ADDSL" 102 "ADDLORRYTRAILER" 103 "ADDLORRYSEMI" 104 "VADDLORRYTRAILER" 105 "VADDLORRYSEMI" 106 "ADDSLOW" 107 "ADDSL5" 108 "ADDSL10" 109 "ADDSL15" 110 "ADDSL20" 111 "ADDSL25" 112 "ADDSL30" 113 "ADDSL35" 114 "ADDSL40" 115 "ADDSL45" 116 "ADDSL50" 117 "ADDSL55" 118 "ADDSL60" 119 "ADDSL65" 120 "ADDSL70" 121 "ADDSL75" 122 "ADDSL80" 123 "ADDSL85" 124 "ADDSL90" 125 "ADDSL95" 126 "ADDSL100" 127 "ADDSL105" 128 "ADDSL110" 129 "ADDSL115" 130 "ADDSL120" 131 "ADDSL125" 132 "ADDSL130" 133 "ADDSL135" 134 "ADDSL140" 135 "ADDSL145" 136 "ADDSL150" 137 "ADDSL155" 138 "ADDSL160" 139 "ADDBIKEROAD" 140 "ADDLORRYTRAILER_EXCEPT" 141 "ADDLORRYSEMI_EXCEPT" 142 "Reserved142" 143 "Reserved143" 144 "Reserved144" 145 "Reserved145" 146 "Reserved146" 147 "Reserved147" 148 "Reserved148" 149 "Reserved149" 150 "Reserved150" 151 "Reserved151" 152 "Reserved152" 153 "Reserved153" 154 "Reserved154" 155 "Reserved155" 156 "Reserved156" 157 "Reserved157" 158 "Reserved158" 159 "Reserved159" 160 "Reserved160" 161 "Reserved161" 162 "Reserved162" 163 "Reserved163" 164 "Reserved164" 165 "Reserved165" 166 "Reserved166" 167 "Reserved167" 168 "Reserved168" 169 "Reserved169" ;
VAL_ 241 VFC_TS06_SupSign2Type 0 "UNKNOWN" 1 "ADDCAR" 2 "ADDLORRY" 3 "ADDTRAILER" 4 "ADDCARAVAN" 5 "ADDBUS" 6 "ADDTRACTOR" 7 "ADDMCYCLE" 8 "ADDLORRYBUSTRAILER_DEPRECATED" 9 "ADDLORRYBUS_DEPRECATED" 10 "ADDHAZMAT" 11 "ADDTANK" 12 "ADDTRAM" 13 "ADDWET" 14 "ADDFOG" 15 "ADDRAIN" 16 "ADDSNOW" 17 "ADDTIME" 18 "ADDSECTION" 19 "ADDDISTANCE" 20 "ADDWEIGHT" 21 "ADDEXITL" 22 "ADDEXITR" 23 "ADDLANES" 24 "ADDRADAR" 25 "ADDRAPPEL" 26 "ADDPRIOTURN" 27 "ADDLORRY_EXCEPT" 28 "ADDTRACTOR_OVER" 29 "ADDTEXT" 30 "ADDSIGN" 31 "ADDRAINSNOW" 32 "ADDHUMP" 33 "VADDLORRYBUSTRAILER_DEPRECATED" 34 "VADDLORRYBUS_DEPRECATED" 35 "VADDLORRYTRAILER_DEPRECATED" 36 "ADDLORRYTRAILER_DEPRECATED" 37 "ADDCAMPER" 38 "ADDZONE" 39 "ADDCRASHRISK" 40 "ADDACCIDENT" 41 "ADDJAM" 42 "ADDSMOKE" 43 "ADDOILTRAIL" 44 "ADDGRAVEL" 45 "ADDDIRT" 46 "ADDRWORKSEXIT" 47 "ADDROADDAMAGE" 48 "ADDRWORKSENTRY" 49 "ADDLOWTREE" 50 "ADDRWORKSACCESS" 51 "ADDRUTS" 52 "ADDSOFTSHOULDERCAR" 53 "ADDSOFTSHOULDERLORRY" 54 "VADDSIGN" 55 "VADDCAR" 56 "VADDLORRY" 57 "VADDTRAILER" 58 "VADDCARAVAN" 59 "VADDBUS" 60 "VADDWET" 61 "VADDFOG" 62 "VADDRAIN" 63 "VADDSNOW" 64 "VADDRAINSNOW" 65 "VADDTEXT" 66 "VADDSECTION" 67 "VADDDISTANCE" 68 "VADDWEIGHT" 69 "VADDZONE" 70 "VADDCRASHRISK" 71 "VADDACCIDENT" 72 "VADDJAM" 73 "VADDOILTRAIL" 74 "VADDGRAVEL" 75 "VADDDIRT" 76 "VADDROADDAMAGE" 77 "VADDRUTS" 78 "ADDNOSTOPSHOULDER" 79 "ADDTOWING" 80 "ADDSCHOOL" 81 "ADDNIGHT" 82 "ADDEND" 83 "ADDBEGINS" 84 "ADDWITHIN" 85 "ADDDISTANCEBARS" 86 "ADDMINIMUM" 87 "ADDADVICE" 88 "ADDACCESS" 89 "ADDALLWAY" 90 "ADDBUS_EXCEPT" 91 "ADDEXCEPTDELIVERY" 92 "ADDEXCEPTLOCAL" 93 "ADDFROG" 94 "ADDPRIOTURNL" 95 "ADDPRIOTURNR" 96 "ADDSTART" 97 "ADDSTOPIN" 98 "ADDEXIT" 99 "ADDHAZWATER" 100 "ADDDAY" 101 "ADDSL" 102 "ADDLORRYTRAILER" 103 "ADDLORRYSEMI" 104 "VADDLORRYTRAILER" 105 "VADDLORRYSEMI" 106 "ADDSLOW" 107 "ADDSL5" 108 "ADDSL10" 109 "ADDSL15" 110 "ADDSL20" 111 "ADDSL25" 112 "ADDSL30" 113 "ADDSL35" 114 "ADDSL40" 115 "ADDSL45" 116 "ADDSL50" 117 "ADDSL55" 118 "ADDSL60" 119 "ADDSL65" 120 "ADDSL70" 121 "ADDSL75" 122 "ADDSL80" 123 "ADDSL85" 124 "ADDSL90" 125 "ADDSL95" 126 "ADDSL100" 127 "ADDSL105" 128 "ADDSL110" 129 "ADDSL115" 130 "ADDSL120" 131 "ADDSL125" 132 "ADDSL130" 133 "ADDSL135" 134 "ADDSL140" 135 "ADDSL145" 136 "ADDSL150" 137 "ADDSL155" 138 "ADDSL160" 139 "ADDBIKEROAD" 140 "ADDLORRYTRAILER_EXCEPT" 141 "ADDLORRYSEMI_EXCEPT" 142 "Reserved142" 143 "Reserved143" 144 "Reserved144" 145 "Reserved145" 146 "Reserved146" 147 "Reserved147" 148 "Reserved148" 149 "Reserved149" 150 "Reserved150" 151 "Reserved151" 152 "Reserved152" 153 "Reserved153" 154 "Reserved154" 155 "Reserved155" 156 "Reserved156" 157 "Reserved157" 158 "Reserved158" 159 "Reserved159" 160 "Reserved160" 161 "Reserved161" 162 "Reserved162" 163 "Reserved163" 164 "Reserved164" 165 "Reserved165" 166 "Reserved166" 167 "Reserved167" 168 "Reserved168" 169 "Reserved169" ;
VAL_ 241 VFC_TS06_SupSign3Type 0 "UNKNOWN" 1 "ADDCAR" 2 "ADDLORRY" 3 "ADDTRAILER" 4 "ADDCARAVAN" 5 "ADDBUS" 6 "ADDTRACTOR" 7 "ADDMCYCLE" 8 "ADDLORRYBUSTRAILER_DEPRECATED" 9 "ADDLORRYBUS_DEPRECATED" 10 "ADDHAZMAT" 11 "ADDTANK" 12 "ADDTRAM" 13 "ADDWET" 14 "ADDFOG" 15 "ADDRAIN" 16 "ADDSNOW" 17 "ADDTIME" 18 "ADDSECTION" 19 "ADDDISTANCE" 20 "ADDWEIGHT" 21 "ADDEXITL" 22 "ADDEXITR" 23 "ADDLANES" 24 "ADDRADAR" 25 "ADDRAPPEL" 26 "ADDPRIOTURN" 27 "ADDLORRY_EXCEPT" 28 "ADDTRACTOR_OVER" 29 "ADDTEXT" 30 "ADDSIGN" 31 "ADDRAINSNOW" 32 "ADDHUMP" 33 "VADDLORRYBUSTRAILER_DEPRECATED" 34 "VADDLORRYBUS_DEPRECATED" 35 "VADDLORRYTRAILER_DEPRECATED" 36 "ADDLORRYTRAILER_DEPRECATED" 37 "ADDCAMPER" 38 "ADDZONE" 39 "ADDCRASHRISK" 40 "ADDACCIDENT" 41 "ADDJAM" 42 "ADDSMOKE" 43 "ADDOILTRAIL" 44 "ADDGRAVEL" 45 "ADDDIRT" 46 "ADDRWORKSEXIT" 47 "ADDROADDAMAGE" 48 "ADDRWORKSENTRY" 49 "ADDLOWTREE" 50 "ADDRWORKSACCESS" 51 "ADDRUTS" 52 "ADDSOFTSHOULDERCAR" 53 "ADDSOFTSHOULDERLORRY" 54 "VADDSIGN" 55 "VADDCAR" 56 "VADDLORRY" 57 "VADDTRAILER" 58 "VADDCARAVAN" 59 "VADDBUS" 60 "VADDWET" 61 "VADDFOG" 62 "VADDRAIN" 63 "VADDSNOW" 64 "VADDRAINSNOW" 65 "VADDTEXT" 66 "VADDSECTION" 67 "VADDDISTANCE" 68 "VADDWEIGHT" 69 "VADDZONE" 70 "VADDCRASHRISK" 71 "VADDACCIDENT" 72 "VADDJAM" 73 "VADDOILTRAIL" 74 "VADDGRAVEL" 75 "VADDDIRT" 76 "VADDROADDAMAGE" 77 "VADDRUTS" 78 "ADDNOSTOPSHOULDER" 79 "ADDTOWING" 80 "ADDSCHOOL" 81 "ADDNIGHT" 82 "ADDEND" 83 "ADDBEGINS" 84 "ADDWITHIN" 85 "ADDDISTANCEBARS" 86 "ADDMINIMUM" 87 "ADDADVICE" 88 "ADDACCESS" 89 "ADDALLWAY" 90 "ADDBUS_EXCEPT" 91 "ADDEXCEPTDELIVERY" 92 "ADDEXCEPTLOCAL" 93 "ADDFROG" 94 "ADDPRIOTURNL" 95 "ADDPRIOTURNR" 96 "ADDSTART" 97 "ADDSTOPIN" 98 "ADDEXIT" 99 "ADDHAZWATER" 100 "ADDDAY" 101 "ADDSL" 102 "ADDLORRYTRAILER" 103 "ADDLORRYSEMI" 104 "VADDLORRYTRAILER" 105 "VADDLORRYSEMI" 106 "ADDSLOW" 107 "ADDSL5" 108 "ADDSL10" 109 "ADDSL15" 110 "ADDSL20" 111 "ADDSL25" 112 "ADDSL30" 113 "ADDSL35" 114 "ADDSL40" 115 "ADDSL45" 116 "ADDSL50" 117 "ADDSL55" 118 "ADDSL60" 119 "ADDSL65" 120 "ADDSL70" 121 "ADDSL75" 122 "ADDSL80" 123 "ADDSL85" 124 "ADDSL90" 125 "ADDSL95" 126 "ADDSL100" 127 "ADDSL105" 128 "ADDSL110" 129 "ADDSL115" 130 "ADDSL120" 131 "ADDSL125" 132 "ADDSL130" 133 "ADDSL135" 134 "ADDSL140" 135 "ADDSL145" 136 "ADDSL150" 137 "ADDSL155" 138 "ADDSL160" 139 "ADDBIKEROAD" 140 "ADDLORRYTRAILER_EXCEPT" 141 "ADDLORRYSEMI_EXCEPT" 142 "Reserved142" 143 "Reserved143" 144 "Reserved144" 145 "Reserved145" 146 "Reserved146" 147 "Reserved147" 148 "Reserved148" 149 "Reserved149" 150 "Reserved150" 151 "Reserved151" 152 "Reserved152" 153 "Reserved153" 154 "Reserved154" 155 "Reserved155" 156 "Reserved156" 157 "Reserved157" 158 "Reserved158" 159 "Reserved159" 160 "Reserved160" 161 "Reserved161" 162 "Reserved162" 163 "Reserved163" 164 "Reserved164" 165 "Reserved165" 166 "Reserved166" 167 "Reserved167" 168 "Reserved168" 169 "Reserved169" ;
VAL_ 241 VFC_TS06_SupSign4Type 0 "UNKNOWN" 1 "ADDCAR" 2 "ADDLORRY" 3 "ADDTRAILER" 4 "ADDCARAVAN" 5 "ADDBUS" 6 "ADDTRACTOR" 7 "ADDMCYCLE" 8 "ADDLORRYBUSTRAILER_DEPRECATED" 9 "ADDLORRYBUS_DEPRECATED" 10 "ADDHAZMAT" 11 "ADDTANK" 12 "ADDTRAM" 13 "ADDWET" 14 "ADDFOG" 15 "ADDRAIN" 16 "ADDSNOW" 17 "ADDTIME" 18 "ADDSECTION" 19 "ADDDISTANCE" 20 "ADDWEIGHT" 21 "ADDEXITL" 22 "ADDEXITR" 23 "ADDLANES" 24 "ADDRADAR" 25 "ADDRAPPEL" 26 "ADDPRIOTURN" 27 "ADDLORRY_EXCEPT" 28 "ADDTRACTOR_OVER" 29 "ADDTEXT" 30 "ADDSIGN" 31 "ADDRAINSNOW" 32 "ADDHUMP" 33 "VADDLORRYBUSTRAILER_DEPRECATED" 34 "VADDLORRYBUS_DEPRECATED" 35 "VADDLORRYTRAILER_DEPRECATED" 36 "ADDLORRYTRAILER_DEPRECATED" 37 "ADDCAMPER" 38 "ADDZONE" 39 "ADDCRASHRISK" 40 "ADDACCIDENT" 41 "ADDJAM" 42 "ADDSMOKE" 43 "ADDOILTRAIL" 44 "ADDGRAVEL" 45 "ADDDIRT" 46 "ADDRWORKSEXIT" 47 "ADDROADDAMAGE" 48 "ADDRWORKSENTRY" 49 "ADDLOWTREE" 50 "ADDRWORKSACCESS" 51 "ADDRUTS" 52 "ADDSOFTSHOULDERCAR" 53 "ADDSOFTSHOULDERLORRY" 54 "VADDSIGN" 55 "VADDCAR" 56 "VADDLORRY" 57 "VADDTRAILER" 58 "VADDCARAVAN" 59 "VADDBUS" 60 "VADDWET" 61 "VADDFOG" 62 "VADDRAIN" 63 "VADDSNOW" 64 "VADDRAINSNOW" 65 "VADDTEXT" 66 "VADDSECTION" 67 "VADDDISTANCE" 68 "VADDWEIGHT" 69 "VADDZONE" 70 "VADDCRASHRISK" 71 "VADDACCIDENT" 72 "VADDJAM" 73 "VADDOILTRAIL" 74 "VADDGRAVEL" 75 "VADDDIRT" 76 "VADDROADDAMAGE" 77 "VADDRUTS" 78 "ADDNOSTOPSHOULDER" 79 "ADDTOWING" 80 "ADDSCHOOL" 81 "ADDNIGHT" 82 "ADDEND" 83 "ADDBEGINS" 84 "ADDWITHIN" 85 "ADDDISTANCEBARS" 86 "ADDMINIMUM" 87 "ADDADVICE" 88 "ADDACCESS" 89 "ADDALLWAY" 90 "ADDBUS_EXCEPT" 91 "ADDEXCEPTDELIVERY" 92 "ADDEXCEPTLOCAL" 93 "ADDFROG" 94 "ADDPRIOTURNL" 95 "ADDPRIOTURNR" 96 "ADDSTART" 97 "ADDSTOPIN" 98 "ADDEXIT" 99 "ADDHAZWATER" 100 "ADDDAY" 101 "ADDSL" 102 "ADDLORRYTRAILER" 103 "ADDLORRYSEMI" 104 "VADDLORRYTRAILER" 105 "VADDLORRYSEMI" 106 "ADDSLOW" 107 "ADDSL5" 108 "ADDSL10" 109 "ADDSL15" 110 "ADDSL20" 111 "ADDSL25" 112 "ADDSL30" 113 "ADDSL35" 114 "ADDSL40" 115 "ADDSL45" 116 "ADDSL50" 117 "ADDSL55" 118 "ADDSL60" 119 "ADDSL65" 120 "ADDSL70" 121 "ADDSL75" 122 "ADDSL80" 123 "ADDSL85" 124 "ADDSL90" 125 "ADDSL95" 126 "ADDSL100" 127 "ADDSL105" 128 "ADDSL110" 129 "ADDSL115" 130 "ADDSL120" 131 "ADDSL125" 132 "ADDSL130" 133 "ADDSL135" 134 "ADDSL140" 135 "ADDSL145" 136 "ADDSL150" 137 "ADDSL155" 138 "ADDSL160" 139 "ADDBIKEROAD" 140 "ADDLORRYTRAILER_EXCEPT" 141 "ADDLORRYSEMI_EXCEPT" 142 "Reserved142" 143 "Reserved143" 144 "Reserved144" 145 "Reserved145" 146 "Reserved146" 147 "Reserved147" 148 "Reserved148" 149 "Reserved149" 150 "Reserved150" 151 "Reserved151" 152 "Reserved152" 153 "Reserved153" 154 "Reserved154" 155 "Reserved155" 156 "Reserved156" 157 "Reserved157" 158 "Reserved158" 159 "Reserved159" 160 "Reserved160" 161 "Reserved161" 162 "Reserved162" 163 "Reserved163" 164 "Reserved164" 165 "Reserved165" 166 "Reserved166" 167 "Reserved167" 168 "Reserved168" 169 "Reserved169" ;
VAL_ 241 VFC_TS06_SupSign5Type 0 "UNKNOWN" 1 "ADDCAR" 2 "ADDLORRY" 3 "ADDTRAILER" 4 "ADDCARAVAN" 5 "ADDBUS" 6 "ADDTRACTOR" 7 "ADDMCYCLE" 8 "ADDLORRYBUSTRAILER_DEPRECATED" 9 "ADDLORRYBUS_DEPRECATED" 10 "ADDHAZMAT" 11 "ADDTANK" 12 "ADDTRAM" 13 "ADDWET" 14 "ADDFOG" 15 "ADDRAIN" 16 "ADDSNOW" 17 "ADDTIME" 18 "ADDSECTION" 19 "ADDDISTANCE" 20 "ADDWEIGHT" 21 "ADDEXITL" 22 "ADDEXITR" 23 "ADDLANES" 24 "ADDRADAR" 25 "ADDRAPPEL" 26 "ADDPRIOTURN" 27 "ADDLORRY_EXCEPT" 28 "ADDTRACTOR_OVER" 29 "ADDTEXT" 30 "ADDSIGN" 31 "ADDRAINSNOW" 32 "ADDHUMP" 33 "VADDLORRYBUSTRAILER_DEPRECATED" 34 "VADDLORRYBUS_DEPRECATED" 35 "VADDLORRYTRAILER_DEPRECATED" 36 "ADDLORRYTRAILER_DEPRECATED" 37 "ADDCAMPER" 38 "ADDZONE" 39 "ADDCRASHRISK" 40 "ADDACCIDENT" 41 "ADDJAM" 42 "ADDSMOKE" 43 "ADDOILTRAIL" 44 "ADDGRAVEL" 45 "ADDDIRT" 46 "ADDRWORKSEXIT" 47 "ADDROADDAMAGE" 48 "ADDRWORKSENTRY" 49 "ADDLOWTREE" 50 "ADDRWORKSACCESS" 51 "ADDRUTS" 52 "ADDSOFTSHOULDERCAR" 53 "ADDSOFTSHOULDERLORRY" 54 "VADDSIGN" 55 "VADDCAR" 56 "VADDLORRY" 57 "VADDTRAILER" 58 "VADDCARAVAN" 59 "VADDBUS" 60 "VADDWET" 61 "VADDFOG" 62 "VADDRAIN" 63 "VADDSNOW" 64 "VADDRAINSNOW" 65 "VADDTEXT" 66 "VADDSECTION" 67 "VADDDISTANCE" 68 "VADDWEIGHT" 69 "VADDZONE" 70 "VADDCRASHRISK" 71 "VADDACCIDENT" 72 "VADDJAM" 73 "VADDOILTRAIL" 74 "VADDGRAVEL" 75 "VADDDIRT" 76 "VADDROADDAMAGE" 77 "VADDRUTS" 78 "ADDNOSTOPSHOULDER" 79 "ADDTOWING" 80 "ADDSCHOOL" 81 "ADDNIGHT" 82 "ADDEND" 83 "ADDBEGINS" 84 "ADDWITHIN" 85 "ADDDISTANCEBARS" 86 "ADDMINIMUM" 87 "ADDADVICE" 88 "ADDACCESS" 89 "ADDALLWAY" 90 "ADDBUS_EXCEPT" 91 "ADDEXCEPTDELIVERY" 92 "ADDEXCEPTLOCAL" 93 "ADDFROG" 94 "ADDPRIOTURNL" 95 "ADDPRIOTURNR" 96 "ADDSTART" 97 "ADDSTOPIN" 98 "ADDEXIT" 99 "ADDHAZWATER" 100 "ADDDAY" 101 "ADDSL" 102 "ADDLORRYTRAILER" 103 "ADDLORRYSEMI" 104 "VADDLORRYTRAILER" 105 "VADDLORRYSEMI" 106 "ADDSLOW" 107 "ADDSL5" 108 "ADDSL10" 109 "ADDSL15" 110 "ADDSL20" 111 "ADDSL25" 112 "ADDSL30" 113 "ADDSL35" 114 "ADDSL40" 115 "ADDSL45" 116 "ADDSL50" 117 "ADDSL55" 118 "ADDSL60" 119 "ADDSL65" 120 "ADDSL70" 121 "ADDSL75" 122 "ADDSL80" 123 "ADDSL85" 124 "ADDSL90" 125 "ADDSL95" 126 "ADDSL100" 127 "ADDSL105" 128 "ADDSL110" 129 "ADDSL115" 130 "ADDSL120" 131 "ADDSL125" 132 "ADDSL130" 133 "ADDSL135" 134 "ADDSL140" 135 "ADDSL145" 136 "ADDSL150" 137 "ADDSL155" 138 "ADDSL160" 139 "ADDBIKEROAD" 140 "ADDLORRYTRAILER_EXCEPT" 141 "ADDLORRYSEMI_EXCEPT" 142 "Reserved142" 143 "Reserved143" 144 "Reserved144" 145 "Reserved145" 146 "Reserved146" 147 "Reserved147" 148 "Reserved148" 149 "Reserved149" 150 "Reserved150" 151 "Reserved151" 152 "Reserved152" 153 "Reserved153" 154 "Reserved154" 155 "Reserved155" 156 "Reserved156" 157 "Reserved157" 158 "Reserved158" 159 "Reserved159" 160 "Reserved160" 161 "Reserved161" 162 "Reserved162" 163 "Reserved163" 164 "Reserved164" 165 "Reserved165" 166 "Reserved166" 167 "Reserved167" 168 "Reserved168" 169 "Reserved169" ;
VAL_ 241 VFC_TS07_Type 0 "UNKNOWN" 1 "SL5" 2 "SL10" 3 "SL15" 4 "SL20" 5 "SL25" 6 "SL30" 7 "SL35" 8 "SL40" 9 "SL45" 10 "SL50" 11 "SL55" 12 "SL60" 13 "SL65" 14 "SL70" 15 "SL75" 16 "SL80" 17 "SL85" 18 "SL90" 19 "SL95" 20 "SL100" 21 "SL105" 22 "SL110" 23 "SL115" 24 "SL120" 25 "SL125" 26 "SL130" 27 "SL135" 28 "SL140" 29 "SL145" 30 "SL150" 31 "SL155" 32 "SL160" 33 "OP" 34 "OL" 35 "ESL" 36 "EOP" 37 "EOL" 38 "EA" 39 "VSL5" 40 "VSL10" 41 "VSL15" 42 "VSL20" 43 "VSL25" 44 "VSL30" 45 "VSL35" 46 "VSL40" 47 "VSL45" 48 "VSL50" 49 "VSL55" 50 "VSL60" 51 "VSL65" 52 "VSL70" 53 "VSL75" 54 "VSL80" 55 "VSL85" 56 "VSL90" 57 "VSL95" 58 "VSL100" 59 "VSL105" 60 "VSL110" 61 "VSL115" 62 "VSL120" 63 "VSL125" 64 "VSL130" 65 "VSL135" 66 "VSL140" 67 "VSL145" 68 "VSL150" 69 "VSL155" 70 "VSL160" 71 "VOP" 72 "VOL" 73 "VESL" 74 "VEOP" 75 "VEOL" 76 "VEA" 77 "NOENTRY" 78 "NOALL" 79 "NOCAR" 80 "NOLORRY" 81 "NOHAZMAT" 82 "NOBIKE" 83 "NOPED" 84 "NOCARBIKE" 85 "NOTWOWAY" 86 "WEIGHT" 87 "HEIGHT" 88 "WIDTH" 89 "LENGTH" 90 "PRIOCROSS" 91 "GIVEWAY" 92 "PRIOCROSSYIELDTORIGHT" 93 "WARNDANGER" 94 "WARNCURVEL" 95 "WARNCURVER" 96 "WARNDCURVEL" 97 "WARNDCURVER" 98 "WARNTRAIN" 99 "WARNJAM" 100 "WARNANIMAL_DEPRECATED" 101 "WARNRWORKS" 102 "WARNSLOPED" 103 "WARNSLOPEU" 104 "PRIOSTREET" 105 "EPRIOSTREET" 106 "STOP" 107 "ASL" 108 "EASL" 109 "MSL" 110 "EMSL" 111 "MLC" 112 "WBDIAGL" 113 "WBDIAGR" 114 "WBROUND" 115 "NOLTURN" 116 "NORTURN" 117 "NOUTURN" 118 "NOPARK" 119 "NOSTOP" 120 "SMOG" 121 "UMWELT" 122 "EUMWELT" 123 "DOUANE" 124 "FWAY" 125 "EFWAY" 126 "HWAY" 127 "EHWAY" 128 "NORIDER" 129 "WARNCONST" 130 "WARNCONSTL" 131 "WARNCONSTR" 132 "WARNPED" 133 "WARNKIDS" 134 "WARNBIKE" 135 "WARNSKID" 136 "ZEBRA" 137 "ONEWAYS" 138 "ONEWAYU" 139 "SLOWDOWN" 140 "NOCARRIAGE" 141 "NOLORRYTRAILER" 142 "NOBUS" 143 "NOTRACTOR" 144 "LORRYDIST" 145 "CARDIST" 146 "WARNROUND" 147 "WARNWILDANIMAL" 148 "WARNCATTLE" 149 "WARNFROG" 150 "WARNBUS" 151 "WARNWIND" 152 "WARNSNOW" 153 "WARNPCROSS" 154 "WARNHUMP" 155 "WARNROCK" 156 "WARNLOWTREE" 157 "WARNGRAVEL" 158 "WARNTWOWAY" 159 "WARNLIGHTS" 160 "WARNPLANE" 161 "VNOENTRY" 162 "VNOALL" 163 "VNOCAR" 164 "VNOLORRY" 165 "VNOCARBIKE" 166 "VWEIGHT" 167 "VHEIGHT" 168 "VWIDTH" 169 "VLENGTH" 170 "VWARNDANGER" 171 "VWARNJAM" 172 "VWARNRWORKS" 173 "VWARNSKID" 174 "VASL" 175 "VEASL" 176 "VNOLORRYTRAILER" 177 "VNOBUS" 178 "VLORRYDIST" 179 "VCARDIST" 180 "VWARNSNOW" 181 "VWARNHUMP" 182 "VWARNGRAVEL" 183 "CALM" 184 "ECALM" 185 "TWN" 186 "ETWN" 187 "DEADEND" 188 "AXLEWEIGHT" 189 "WARNRIDER" 190 "WARNDRAWBRIDGE" 191 "WARNPIER" 192 "TRINATURE" 193 "VWARNCONST" 194 "VWARNCONSTL" 195 "VWARNCONSTR" 196 "VWARNCURVEL" 197 "VWARNCURVER" 198 "VWARNDCURVEL" 199 "VWARNDCURVER" 200 "VWARNLIGHTS" 201 "WBBENTLEFT" 202 "WBBENTLEFTRIGHT" 203 "WBBENTRIGHT" 204 "WBDIAGLR" 205 "WBLEFT" 206 "WBRIGHT" 207 "WBUP" 208 "WBUPLEFT" 209 "WBUPRIGHT" 210 "WBHAZWATER" 211 "NOHAZWATER" 212 "SCHOOL" 213 "ESCHOOL" 214 "HAZMAT" 215 "EMERGENCYBAY" 216 "ENDOFLANEL" 217 "ENDOFLANER" 218 "ENOPARK" 219 "EONEWAY" 220 "EPARK" 221 "ETOLL" 222 "NOPARKL" 223 "NOPARKLR" 224 "NOPARKR" 225 "NOSTOPL" 226 "NOSTOPLR" 227 "NOSTOPR" 228 "NOTURNONRED" 229 "ONEWAYL" 230 "ONEWAYR" 231 "PARK" 232 "PRIOCROSSL" 233 "PRIOCROSSR" 234 "TOLL" 235 "TUNNEL" 236 "TWOWAY" 237 "WARNCROSS" 238 "WARNCROSSL" 239 "WARNCROSSLR" 240 "WARNCROSSR" 241 "WARNCROSSRL" 242 "WARNCROSST" 243 "WARNGIVEWAYAHEAD" 244 "WARNSLAHEAD" 245 "WARNSTOPAHEAD" 246 "WBBUS" 247 "WRONGWAY" 248 "HAZWATER" 249 "GIVEWAYROUND" 250 "WARNWINDINGL" 251 "WARNWINDINGR" 252 "WARNHAIRPINL" 253 "WARNHAIRPINR" 254 "WARNPEDBIKE" 255 "WARNCROSSY" 256 "WARNBRANCHL" 257 "WARNBRANCHR" 258 "WARNAXLEWEIGHT" 259 "WARNWEIGHT" 260 "WARNHEIGHT" 261 "WARNLENGTH" 262 "WARNWIDTH" 263 "WARNBLACKSPOT" 264 "WARNMERGEL" 265 "WARNMERGER" 266 "WARNTUNNEL" 267 "WARNTRACTOR" 268 "WARNRWORKSVEHICLE" 269 "WARNNARROWBRIDGE" 270 "WARNFLAGGER" 271 "LANES" 272 "LANESHIFTL" 273 "LANESHIFTR" 274 "NEWLANEL" 275 "NEWLANER" 276 "RIGHTTURNONRED" 277 "BORDERLIMIT" 278 "EMBEDDEDRAIN" 279 "VWARNWEIGHT" 280 "VWARNHEIGHT" 281 "VWARNLENGTH" 282 "VWARNWIDTH" 283 "VENDOFLANEL" 284 "VENDOFLANER" 285 "VLANES" 286 "VLANESHIFTL" 287 "VLANESHIFTR" 288 "VNEWLANEL" 289 "VNEWLANER" 290 "NOUP" 291 "VOFF" 292 "ASL5" 293 "ASL10" 294 "ASL15" 295 "ASL20" 296 "ASL25" 297 "ASL30" 298 "ASL35" 299 "ASL40" 300 "ASL45" 301 "ASL50" 302 "ASL55" 303 "ASL60" 304 "ASL65" 305 "ASL70" 306 "ASL75" 307 "ASL80" 308 "ASL85" 309 "ASL90" 310 "ASL95" 311 "ASL100" 312 "ASL105" 313 "ASL110" 314 "ASL115" 315 "ASL120" 316 "ASL125" 317 "ASL130" 318 "ASL135" 319 "ASL140" 320 "ASL145" 321 "ASL150" 322 "ASL155" 323 "ASL160" 324 "VASL5" 325 "VASL10" 326 "VASL15" 327 "VASL20" 328 "VASL25" 329 "VASL30" 330 "VASL35" 331 "VASL40" 332 "VASL45" 333 "VASL50" 334 "VASL55" 335 "VASL60" 336 "VASL65" 337 "VASL70" 338 "VASL75" 339 "VASL80" 340 "VASL85" 341 "VASL90" 342 "VASL95" 343 "VASL100" 344 "VASL105" 345 "VASL110" 346 "VASL115" 347 "VASL120" 348 "VASL125" 349 "VASL130" 350 "VASL135" 351 "VASL140" 352 "VASL145" 353 "VASL150" 354 "VASL155" 355 "VASL160" 356 "WARNTRAINGATED" 357 "KEEPRIGHTCAR" 358 "ASLCURVE5" 359 "ASLCURVE10" 360 "ASLCURVE15" 361 "ASLCURVE20" 362 "ASLCURVE25" 363 "ASLCURVE30" 364 "ASLCURVE35" 365 "ASLCURVE40" 366 "ASLCURVE45" 367 "ASLCURVE50" 368 "ASLCURVE55" 369 "ASLCURVE60" 370 "ASLCURVE65" 371 "ASLCURVE70" 372 "ASLCURVE75" 373 "ASLCURVE80" 374 "ASLCURVE85" 375 "ASLCURVE90" 376 "ASLCURVE95" 377 "ASLCURVE100" 378 "ASLCURVE105" 379 "ASLCURVE110" 380 "ASLCURVE115" 381 "ASLCURVE120" 382 "ASLCURVE125" 383 "ASLCURVE130" 384 "ASLCURVE135" 385 "ASLCURVE140" 386 "ASLCURVE145" 387 "ASLCURVE150" 388 "ASLCURVE155" 389 "ASLCURVE160" 390 "KIDS" 391 "EKIDS" 392 "BIKEROAD" 393 "EBIKEROAD" 394 "PEDSTREET" 395 "EPEDSTREET" 396 "PEDBIKESTREET" 397 "EPEDBIKESTREET" 398 "EWARNKIDS" 399 "CALM20" 400 "CALM30" 401 "ECALM20" 402 "ECALM30" 403 "FWAYGREEN" 404 "TWN40" 405 "TWN50" 406 "TWN60" 407 "TWN70" 408 "ETWN40" 409 "ETWN50" 410 "ETWN60" 411 "ETWN70" 412 "WBBIKE" 413 "EWBBIKE" 414 "WBPED" 415 "EWBPED" 416 "WBPEDBIKESEP" 417 "EWBPEDBIKESEP" 418 "WBPEDBIKESHARED" 419 "EWBPEDBIKESHARED" 420 "EFWAYGREEN" 421 "Reserved0421" 422 "Reserved0422" 423 "Reserved0423" 424 "Reserved0424" 425 "Reserved0425" 426 "Reserved0426" 427 "Reserved0427" 428 "Reserved0428" 429 "Reserved0429" 430 "Reserved0430" 431 "Reserved0431" 432 "Reserved0432" 433 "Reserved0433" 434 "Reserved0434" 435 "Reserved0435" 436 "Reserved0436" 437 "Reserved0437" 438 "Reserved0438" 439 "Reserved0439" 440 "Reserved0440" 441 "Reserved0441" 442 "Reserved0442" 443 "Reserved0443" 444 "Reserved0444" 445 "Reserved0445" 446 "Reserved0446" 447 "Reserved0447" 448 "Reserved0448" 449 "Reserved0449" ;
VAL_ 241 VFC_TS07_EmbeddedInfo 0 "Unknown" 1 "Not Embedded" 2 "Border Limit" 3 "Multi Lane" 4 "Rain" 5 "Vehicle Type" 6 "Plate" 7 "Error Value" 8 "Vehicle Sticker" 9 "Reserved09" 10 "Reserved10" 11 "Reserved11" 12 "Reserved12" 13 "Reserved13" 14 "Reserved14" 15 "Reserved15" ;
VAL_ 241 VFC_TS07_ValidTimeRange1Start 127 "Unknown" ;
VAL_ 241 VFC_TS07_ValidTimeRange1End 127 "Unknown" ;
VAL_ 241 VFC_TS07_ValidTimeRange2Start 127 "Unknown" ;
VAL_ 241 VFC_TS07_ValidTimeRange2End 127 "Unknown" ;
VAL_ 241 VFC_TS07_ValidInDistUnit 0 "Unknown" ;
VAL_ 241 VFC_TS07_ValidSectionUnit 0 "Unknown" 1 "Meter" 2 "Kilometer" 3 "Foot" 4 "Yard" 5 "Mile" 6 "Reserved6" 7 "Reserved7" ;
VAL_ 241 VFC_TS07_SupSign0Type 0 "UNKNOWN" 1 "ADDCAR" 2 "ADDLORRY" 3 "ADDTRAILER" 4 "ADDCARAVAN" 5 "ADDBUS" 6 "ADDTRACTOR" 7 "ADDMCYCLE" 8 "ADDLORRYBUSTRAILER_DEPRECATED" 9 "ADDLORRYBUS_DEPRECATED" 10 "ADDHAZMAT" 11 "ADDTANK" 12 "ADDTRAM" 13 "ADDWET" 14 "ADDFOG" 15 "ADDRAIN" 16 "ADDSNOW" 17 "ADDTIME" 18 "ADDSECTION" 19 "ADDDISTANCE" 20 "ADDWEIGHT" 21 "ADDEXITL" 22 "ADDEXITR" 23 "ADDLANES" 24 "ADDRADAR" 25 "ADDRAPPEL" 26 "ADDPRIOTURN" 27 "ADDLORRY_EXCEPT" 28 "ADDTRACTOR_OVER" 29 "ADDTEXT" 30 "ADDSIGN" 31 "ADDRAINSNOW" 32 "ADDHUMP" 33 "VADDLORRYBUSTRAILER_DEPRECATED" 34 "VADDLORRYBUS_DEPRECATED" 35 "VADDLORRYTRAILER_DEPRECATED" 36 "ADDLORRYTRAILER_DEPRECATED" 37 "ADDCAMPER" 38 "ADDZONE" 39 "ADDCRASHRISK" 40 "ADDACCIDENT" 41 "ADDJAM" 42 "ADDSMOKE" 43 "ADDOILTRAIL" 44 "ADDGRAVEL" 45 "ADDDIRT" 46 "ADDRWORKSEXIT" 47 "ADDROADDAMAGE" 48 "ADDRWORKSENTRY" 49 "ADDLOWTREE" 50 "ADDRWORKSACCESS" 51 "ADDRUTS" 52 "ADDSOFTSHOULDERCAR" 53 "ADDSOFTSHOULDERLORRY" 54 "VADDSIGN" 55 "VADDCAR" 56 "VADDLORRY" 57 "VADDTRAILER" 58 "VADDCARAVAN" 59 "VADDBUS" 60 "VADDWET" 61 "VADDFOG" 62 "VADDRAIN" 63 "VADDSNOW" 64 "VADDRAINSNOW" 65 "VADDTEXT" 66 "VADDSECTION" 67 "VADDDISTANCE" 68 "VADDWEIGHT" 69 "VADDZONE" 70 "VADDCRASHRISK" 71 "VADDACCIDENT" 72 "VADDJAM" 73 "VADDOILTRAIL" 74 "VADDGRAVEL" 75 "VADDDIRT" 76 "VADDROADDAMAGE" 77 "VADDRUTS" 78 "ADDNOSTOPSHOULDER" 79 "ADDTOWING" 80 "ADDSCHOOL" 81 "ADDNIGHT" 82 "ADDEND" 83 "ADDBEGINS" 84 "ADDWITHIN" 85 "ADDDISTANCEBARS" 86 "ADDMINIMUM" 87 "ADDADVICE" 88 "ADDACCESS" 89 "ADDALLWAY" 90 "ADDBUS_EXCEPT" 91 "ADDEXCEPTDELIVERY" 92 "ADDEXCEPTLOCAL" 93 "ADDFROG" 94 "ADDPRIOTURNL" 95 "ADDPRIOTURNR" 96 "ADDSTART" 97 "ADDSTOPIN" 98 "ADDEXIT" 99 "ADDHAZWATER" 100 "ADDDAY" 101 "ADDSL" 102 "ADDLORRYTRAILER" 103 "ADDLORRYSEMI" 104 "VADDLORRYTRAILER" 105 "VADDLORRYSEMI" 106 "ADDSLOW" 107 "ADDSL5" 108 "ADDSL10" 109 "ADDSL15" 110 "ADDSL20" 111 "ADDSL25" 112 "ADDSL30" 113 "ADDSL35" 114 "ADDSL40" 115 "ADDSL45" 116 "ADDSL50" 117 "ADDSL55" 118 "ADDSL60" 119 "ADDSL65" 120 "ADDSL70" 121 "ADDSL75" 122 "ADDSL80" 123 "ADDSL85" 124 "ADDSL90" 125 "ADDSL95" 126 "ADDSL100" 127 "ADDSL105" 128 "ADDSL110" 129 "ADDSL115" 130 "ADDSL120" 131 "ADDSL125" 132 "ADDSL130" 133 "ADDSL135" 134 "ADDSL140" 135 "ADDSL145" 136 "ADDSL150" 137 "ADDSL155" 138 "ADDSL160" 139 "ADDBIKEROAD" 140 "ADDLORRYTRAILER_EXCEPT" 141 "ADDLORRYSEMI_EXCEPT" 142 "Reserved142" 143 "Reserved143" 144 "Reserved144" 145 "Reserved145" 146 "Reserved146" 147 "Reserved147" 148 "Reserved148" 149 "Reserved149" 150 "Reserved150" 151 "Reserved151" 152 "Reserved152" 153 "Reserved153" 154 "Reserved154" 155 "Reserved155" 156 "Reserved156" 157 "Reserved157" 158 "Reserved158" 159 "Reserved159" 160 "Reserved160" 161 "Reserved161" 162 "Reserved162" 163 "Reserved163" 164 "Reserved164" 165 "Reserved165" 166 "Reserved166" 167 "Reserved167" 168 "Reserved168" 169 "Reserved169" ;
VAL_ 241 VFC_TS07_SupSign1Type 0 "UNKNOWN" 1 "ADDCAR" 2 "ADDLORRY" 3 "ADDTRAILER" 4 "ADDCARAVAN" 5 "ADDBUS" 6 "ADDTRACTOR" 7 "ADDMCYCLE" 8 "ADDLORRYBUSTRAILER_DEPRECATED" 9 "ADDLORRYBUS_DEPRECATED" 10 "ADDHAZMAT" 11 "ADDTANK" 12 "ADDTRAM" 13 "ADDWET" 14 "ADDFOG" 15 "ADDRAIN" 16 "ADDSNOW" 17 "ADDTIME" 18 "ADDSECTION" 19 "ADDDISTANCE" 20 "ADDWEIGHT" 21 "ADDEXITL" 22 "ADDEXITR" 23 "ADDLANES" 24 "ADDRADAR" 25 "ADDRAPPEL" 26 "ADDPRIOTURN" 27 "ADDLORRY_EXCEPT" 28 "ADDTRACTOR_OVER" 29 "ADDTEXT" 30 "ADDSIGN" 31 "ADDRAINSNOW" 32 "ADDHUMP" 33 "VADDLORRYBUSTRAILER_DEPRECATED" 34 "VADDLORRYBUS_DEPRECATED" 35 "VADDLORRYTRAILER_DEPRECATED" 36 "ADDLORRYTRAILER_DEPRECATED" 37 "ADDCAMPER" 38 "ADDZONE" 39 "ADDCRASHRISK" 40 "ADDACCIDENT" 41 "ADDJAM" 42 "ADDSMOKE" 43 "ADDOILTRAIL" 44 "ADDGRAVEL" 45 "ADDDIRT" 46 "ADDRWORKSEXIT" 47 "ADDROADDAMAGE" 48 "ADDRWORKSENTRY" 49 "ADDLOWTREE" 50 "ADDRWORKSACCESS" 51 "ADDRUTS" 52 "ADDSOFTSHOULDERCAR" 53 "ADDSOFTSHOULDERLORRY" 54 "VADDSIGN" 55 "VADDCAR" 56 "VADDLORRY" 57 "VADDTRAILER" 58 "VADDCARAVAN" 59 "VADDBUS" 60 "VADDWET" 61 "VADDFOG" 62 "VADDRAIN" 63 "VADDSNOW" 64 "VADDRAINSNOW" 65 "VADDTEXT" 66 "VADDSECTION" 67 "VADDDISTANCE" 68 "VADDWEIGHT" 69 "VADDZONE" 70 "VADDCRASHRISK" 71 "VADDACCIDENT" 72 "VADDJAM" 73 "VADDOILTRAIL" 74 "VADDGRAVEL" 75 "VADDDIRT" 76 "VADDROADDAMAGE" 77 "VADDRUTS" 78 "ADDNOSTOPSHOULDER" 79 "ADDTOWING" 80 "ADDSCHOOL" 81 "ADDNIGHT" 82 "ADDEND" 83 "ADDBEGINS" 84 "ADDWITHIN" 85 "ADDDISTANCEBARS" 86 "ADDMINIMUM" 87 "ADDADVICE" 88 "ADDACCESS" 89 "ADDALLWAY" 90 "ADDBUS_EXCEPT" 91 "ADDEXCEPTDELIVERY" 92 "ADDEXCEPTLOCAL" 93 "ADDFROG" 94 "ADDPRIOTURNL" 95 "ADDPRIOTURNR" 96 "ADDSTART" 97 "ADDSTOPIN" 98 "ADDEXIT" 99 "ADDHAZWATER" 100 "ADDDAY" 101 "ADDSL" 102 "ADDLORRYTRAILER" 103 "ADDLORRYSEMI" 104 "VADDLORRYTRAILER" 105 "VADDLORRYSEMI" 106 "ADDSLOW" 107 "ADDSL5" 108 "ADDSL10" 109 "ADDSL15" 110 "ADDSL20" 111 "ADDSL25" 112 "ADDSL30" 113 "ADDSL35" 114 "ADDSL40" 115 "ADDSL45" 116 "ADDSL50" 117 "ADDSL55" 118 "ADDSL60" 119 "ADDSL65" 120 "ADDSL70" 121 "ADDSL75" 122 "ADDSL80" 123 "ADDSL85" 124 "ADDSL90" 125 "ADDSL95" 126 "ADDSL100" 127 "ADDSL105" 128 "ADDSL110" 129 "ADDSL115" 130 "ADDSL120" 131 "ADDSL125" 132 "ADDSL130" 133 "ADDSL135" 134 "ADDSL140" 135 "ADDSL145" 136 "ADDSL150" 137 "ADDSL155" 138 "ADDSL160" 139 "ADDBIKEROAD" 140 "ADDLORRYTRAILER_EXCEPT" 141 "ADDLORRYSEMI_EXCEPT" 142 "Reserved142" 143 "Reserved143" 144 "Reserved144" 145 "Reserved145" 146 "Reserved146" 147 "Reserved147" 148 "Reserved148" 149 "Reserved149" 150 "Reserved150" 151 "Reserved151" 152 "Reserved152" 153 "Reserved153" 154 "Reserved154" 155 "Reserved155" 156 "Reserved156" 157 "Reserved157" 158 "Reserved158" 159 "Reserved159" 160 "Reserved160" 161 "Reserved161" 162 "Reserved162" 163 "Reserved163" 164 "Reserved164" 165 "Reserved165" 166 "Reserved166" 167 "Reserved167" 168 "Reserved168" 169 "Reserved169" ;
VAL_ 241 VFC_TS07_SupSign2Type 0 "UNKNOWN" 1 "ADDCAR" 2 "ADDLORRY" 3 "ADDTRAILER" 4 "ADDCARAVAN" 5 "ADDBUS" 6 "ADDTRACTOR" 7 "ADDMCYCLE" 8 "ADDLORRYBUSTRAILER_DEPRECATED" 9 "ADDLORRYBUS_DEPRECATED" 10 "ADDHAZMAT" 11 "ADDTANK" 12 "ADDTRAM" 13 "ADDWET" 14 "ADDFOG" 15 "ADDRAIN" 16 "ADDSNOW" 17 "ADDTIME" 18 "ADDSECTION" 19 "ADDDISTANCE" 20 "ADDWEIGHT" 21 "ADDEXITL" 22 "ADDEXITR" 23 "ADDLANES" 24 "ADDRADAR" 25 "ADDRAPPEL" 26 "ADDPRIOTURN" 27 "ADDLORRY_EXCEPT" 28 "ADDTRACTOR_OVER" 29 "ADDTEXT" 30 "ADDSIGN" 31 "ADDRAINSNOW" 32 "ADDHUMP" 33 "VADDLORRYBUSTRAILER_DEPRECATED" 34 "VADDLORRYBUS_DEPRECATED" 35 "VADDLORRYTRAILER_DEPRECATED" 36 "ADDLORRYTRAILER_DEPRECATED" 37 "ADDCAMPER" 38 "ADDZONE" 39 "ADDCRASHRISK" 40 "ADDACCIDENT" 41 "ADDJAM" 42 "ADDSMOKE" 43 "ADDOILTRAIL" 44 "ADDGRAVEL" 45 "ADDDIRT" 46 "ADDRWORKSEXIT" 47 "ADDROADDAMAGE" 48 "ADDRWORKSENTRY" 49 "ADDLOWTREE" 50 "ADDRWORKSACCESS" 51 "ADDRUTS" 52 "ADDSOFTSHOULDERCAR" 53 "ADDSOFTSHOULDERLORRY" 54 "VADDSIGN" 55 "VADDCAR" 56 "VADDLORRY" 57 "VADDTRAILER" 58 "VADDCARAVAN" 59 "VADDBUS" 60 "VADDWET" 61 "VADDFOG" 62 "VADDRAIN" 63 "VADDSNOW" 64 "VADDRAINSNOW" 65 "VADDTEXT" 66 "VADDSECTION" 67 "VADDDISTANCE" 68 "VADDWEIGHT" 69 "VADDZONE" 70 "VADDCRASHRISK" 71 "VADDACCIDENT" 72 "VADDJAM" 73 "VADDOILTRAIL" 74 "VADDGRAVEL" 75 "VADDDIRT" 76 "VADDROADDAMAGE" 77 "VADDRUTS" 78 "ADDNOSTOPSHOULDER" 79 "ADDTOWING" 80 "ADDSCHOOL" 81 "ADDNIGHT" 82 "ADDEND" 83 "ADDBEGINS" 84 "ADDWITHIN" 85 "ADDDISTANCEBARS" 86 "ADDMINIMUM" 87 "ADDADVICE" 88 "ADDACCESS" 89 "ADDALLWAY" 90 "ADDBUS_EXCEPT" 91 "ADDEXCEPTDELIVERY" 92 "ADDEXCEPTLOCAL" 93 "ADDFROG" 94 "ADDPRIOTURNL" 95 "ADDPRIOTURNR" 96 "ADDSTART" 97 "ADDSTOPIN" 98 "ADDEXIT" 99 "ADDHAZWATER" 100 "ADDDAY" 101 "ADDSL" 102 "ADDLORRYTRAILER" 103 "ADDLORRYSEMI" 104 "VADDLORRYTRAILER" 105 "VADDLORRYSEMI" 106 "ADDSLOW" 107 "ADDSL5" 108 "ADDSL10" 109 "ADDSL15" 110 "ADDSL20" 111 "ADDSL25" 112 "ADDSL30" 113 "ADDSL35" 114 "ADDSL40" 115 "ADDSL45" 116 "ADDSL50" 117 "ADDSL55" 118 "ADDSL60" 119 "ADDSL65" 120 "ADDSL70" 121 "ADDSL75" 122 "ADDSL80" 123 "ADDSL85" 124 "ADDSL90" 125 "ADDSL95" 126 "ADDSL100" 127 "ADDSL105" 128 "ADDSL110" 129 "ADDSL115" 130 "ADDSL120" 131 "ADDSL125" 132 "ADDSL130" 133 "ADDSL135" 134 "ADDSL140" 135 "ADDSL145" 136 "ADDSL150" 137 "ADDSL155" 138 "ADDSL160" 139 "ADDBIKEROAD" 140 "ADDLORRYTRAILER_EXCEPT" 141 "ADDLORRYSEMI_EXCEPT" 142 "Reserved142" 143 "Reserved143" 144 "Reserved144" 145 "Reserved145" 146 "Reserved146" 147 "Reserved147" 148 "Reserved148" 149 "Reserved149" 150 "Reserved150" 151 "Reserved151" 152 "Reserved152" 153 "Reserved153" 154 "Reserved154" 155 "Reserved155" 156 "Reserved156" 157 "Reserved157" 158 "Reserved158" 159 "Reserved159" 160 "Reserved160" 161 "Reserved161" 162 "Reserved162" 163 "Reserved163" 164 "Reserved164" 165 "Reserved165" 166 "Reserved166" 167 "Reserved167" 168 "Reserved168" 169 "Reserved169" ;
VAL_ 241 VFC_TS07_SupSign3Type 0 "UNKNOWN" 1 "ADDCAR" 2 "ADDLORRY" 3 "ADDTRAILER" 4 "ADDCARAVAN" 5 "ADDBUS" 6 "ADDTRACTOR" 7 "ADDMCYCLE" 8 "ADDLORRYBUSTRAILER_DEPRECATED" 9 "ADDLORRYBUS_DEPRECATED" 10 "ADDHAZMAT" 11 "ADDTANK" 12 "ADDTRAM" 13 "ADDWET" 14 "ADDFOG" 15 "ADDRAIN" 16 "ADDSNOW" 17 "ADDTIME" 18 "ADDSECTION" 19 "ADDDISTANCE" 20 "ADDWEIGHT" 21 "ADDEXITL" 22 "ADDEXITR" 23 "ADDLANES" 24 "ADDRADAR" 25 "ADDRAPPEL" 26 "ADDPRIOTURN" 27 "ADDLORRY_EXCEPT" 28 "ADDTRACTOR_OVER" 29 "ADDTEXT" 30 "ADDSIGN" 31 "ADDRAINSNOW" 32 "ADDHUMP" 33 "VADDLORRYBUSTRAILER_DEPRECATED" 34 "VADDLORRYBUS_DEPRECATED" 35 "VADDLORRYTRAILER_DEPRECATED" 36 "ADDLORRYTRAILER_DEPRECATED" 37 "ADDCAMPER" 38 "ADDZONE" 39 "ADDCRASHRISK" 40 "ADDACCIDENT" 41 "ADDJAM" 42 "ADDSMOKE" 43 "ADDOILTRAIL" 44 "ADDGRAVEL" 45 "ADDDIRT" 46 "ADDRWORKSEXIT" 47 "ADDROADDAMAGE" 48 "ADDRWORKSENTRY" 49 "ADDLOWTREE" 50 "ADDRWORKSACCESS" 51 "ADDRUTS" 52 "ADDSOFTSHOULDERCAR" 53 "ADDSOFTSHOULDERLORRY" 54 "VADDSIGN" 55 "VADDCAR" 56 "VADDLORRY" 57 "VADDTRAILER" 58 "VADDCARAVAN" 59 "VADDBUS" 60 "VADDWET" 61 "VADDFOG" 62 "VADDRAIN" 63 "VADDSNOW" 64 "VADDRAINSNOW" 65 "VADDTEXT" 66 "VADDSECTION" 67 "VADDDISTANCE" 68 "VADDWEIGHT" 69 "VADDZONE" 70 "VADDCRASHRISK" 71 "VADDACCIDENT" 72 "VADDJAM" 73 "VADDOILTRAIL" 74 "VADDGRAVEL" 75 "VADDDIRT" 76 "VADDROADDAMAGE" 77 "VADDRUTS" 78 "ADDNOSTOPSHOULDER" 79 "ADDTOWING" 80 "ADDSCHOOL" 81 "ADDNIGHT" 82 "ADDEND" 83 "ADDBEGINS" 84 "ADDWITHIN" 85 "ADDDISTANCEBARS" 86 "ADDMINIMUM" 87 "ADDADVICE" 88 "ADDACCESS" 89 "ADDALLWAY" 90 "ADDBUS_EXCEPT" 91 "ADDEXCEPTDELIVERY" 92 "ADDEXCEPTLOCAL" 93 "ADDFROG" 94 "ADDPRIOTURNL" 95 "ADDPRIOTURNR" 96 "ADDSTART" 97 "ADDSTOPIN" 98 "ADDEXIT" 99 "ADDHAZWATER" 100 "ADDDAY" 101 "ADDSL" 102 "ADDLORRYTRAILER" 103 "ADDLORRYSEMI" 104 "VADDLORRYTRAILER" 105 "VADDLORRYSEMI" 106 "ADDSLOW" 107 "ADDSL5" 108 "ADDSL10" 109 "ADDSL15" 110 "ADDSL20" 111 "ADDSL25" 112 "ADDSL30" 113 "ADDSL35" 114 "ADDSL40" 115 "ADDSL45" 116 "ADDSL50" 117 "ADDSL55" 118 "ADDSL60" 119 "ADDSL65" 120 "ADDSL70" 121 "ADDSL75" 122 "ADDSL80" 123 "ADDSL85" 124 "ADDSL90" 125 "ADDSL95" 126 "ADDSL100" 127 "ADDSL105" 128 "ADDSL110" 129 "ADDSL115" 130 "ADDSL120" 131 "ADDSL125" 132 "ADDSL130" 133 "ADDSL135" 134 "ADDSL140" 135 "ADDSL145" 136 "ADDSL150" 137 "ADDSL155" 138 "ADDSL160" 139 "ADDBIKEROAD" 140 "ADDLORRYTRAILER_EXCEPT" 141 "ADDLORRYSEMI_EXCEPT" 142 "Reserved142" 143 "Reserved143" 144 "Reserved144" 145 "Reserved145" 146 "Reserved146" 147 "Reserved147" 148 "Reserved148" 149 "Reserved149" 150 "Reserved150" 151 "Reserved151" 152 "Reserved152" 153 "Reserved153" 154 "Reserved154" 155 "Reserved155" 156 "Reserved156" 157 "Reserved157" 158 "Reserved158" 159 "Reserved159" 160 "Reserved160" 161 "Reserved161" 162 "Reserved162" 163 "Reserved163" 164 "Reserved164" 165 "Reserved165" 166 "Reserved166" 167 "Reserved167" 168 "Reserved168" 169 "Reserved169" ;
VAL_ 241 VFC_TS07_SupSign4Type 0 "UNKNOWN" 1 "ADDCAR" 2 "ADDLORRY" 3 "ADDTRAILER" 4 "ADDCARAVAN" 5 "ADDBUS" 6 "ADDTRACTOR" 7 "ADDMCYCLE" 8 "ADDLORRYBUSTRAILER_DEPRECATED" 9 "ADDLORRYBUS_DEPRECATED" 10 "ADDHAZMAT" 11 "ADDTANK" 12 "ADDTRAM" 13 "ADDWET" 14 "ADDFOG" 15 "ADDRAIN" 16 "ADDSNOW" 17 "ADDTIME" 18 "ADDSECTION" 19 "ADDDISTANCE" 20 "ADDWEIGHT" 21 "ADDEXITL" 22 "ADDEXITR" 23 "ADDLANES" 24 "ADDRADAR" 25 "ADDRAPPEL" 26 "ADDPRIOTURN" 27 "ADDLORRY_EXCEPT" 28 "ADDTRACTOR_OVER" 29 "ADDTEXT" 30 "ADDSIGN" 31 "ADDRAINSNOW" 32 "ADDHUMP" 33 "VADDLORRYBUSTRAILER_DEPRECATED" 34 "VADDLORRYBUS_DEPRECATED" 35 "VADDLORRYTRAILER_DEPRECATED" 36 "ADDLORRYTRAILER_DEPRECATED" 37 "ADDCAMPER" 38 "ADDZONE" 39 "ADDCRASHRISK" 40 "ADDACCIDENT" 41 "ADDJAM" 42 "ADDSMOKE" 43 "ADDOILTRAIL" 44 "ADDGRAVEL" 45 "ADDDIRT" 46 "ADDRWORKSEXIT" 47 "ADDROADDAMAGE" 48 "ADDRWORKSENTRY" 49 "ADDLOWTREE" 50 "ADDRWORKSACCESS" 51 "ADDRUTS" 52 "ADDSOFTSHOULDERCAR" 53 "ADDSOFTSHOULDERLORRY" 54 "VADDSIGN" 55 "VADDCAR" 56 "VADDLORRY" 57 "VADDTRAILER" 58 "VADDCARAVAN" 59 "VADDBUS" 60 "VADDWET" 61 "VADDFOG" 62 "VADDRAIN" 63 "VADDSNOW" 64 "VADDRAINSNOW" 65 "VADDTEXT" 66 "VADDSECTION" 67 "VADDDISTANCE" 68 "VADDWEIGHT" 69 "VADDZONE" 70 "VADDCRASHRISK" 71 "VADDACCIDENT" 72 "VADDJAM" 73 "VADDOILTRAIL" 74 "VADDGRAVEL" 75 "VADDDIRT" 76 "VADDROADDAMAGE" 77 "VADDRUTS" 78 "ADDNOSTOPSHOULDER" 79 "ADDTOWING" 80 "ADDSCHOOL" 81 "ADDNIGHT" 82 "ADDEND" 83 "ADDBEGINS" 84 "ADDWITHIN" 85 "ADDDISTANCEBARS" 86 "ADDMINIMUM" 87 "ADDADVICE" 88 "ADDACCESS" 89 "ADDALLWAY" 90 "ADDBUS_EXCEPT" 91 "ADDEXCEPTDELIVERY" 92 "ADDEXCEPTLOCAL" 93 "ADDFROG" 94 "ADDPRIOTURNL" 95 "ADDPRIOTURNR" 96 "ADDSTART" 97 "ADDSTOPIN" 98 "ADDEXIT" 99 "ADDHAZWATER" 100 "ADDDAY" 101 "ADDSL" 102 "ADDLORRYTRAILER" 103 "ADDLORRYSEMI" 104 "VADDLORRYTRAILER" 105 "VADDLORRYSEMI" 106 "ADDSLOW" 107 "ADDSL5" 108 "ADDSL10" 109 "ADDSL15" 110 "ADDSL20" 111 "ADDSL25" 112 "ADDSL30" 113 "ADDSL35" 114 "ADDSL40" 115 "ADDSL45" 116 "ADDSL50" 117 "ADDSL55" 118 "ADDSL60" 119 "ADDSL65" 120 "ADDSL70" 121 "ADDSL75" 122 "ADDSL80" 123 "ADDSL85" 124 "ADDSL90" 125 "ADDSL95" 126 "ADDSL100" 127 "ADDSL105" 128 "ADDSL110" 129 "ADDSL115" 130 "ADDSL120" 131 "ADDSL125" 132 "ADDSL130" 133 "ADDSL135" 134 "ADDSL140" 135 "ADDSL145" 136 "ADDSL150" 137 "ADDSL155" 138 "ADDSL160" 139 "ADDBIKEROAD" 140 "ADDLORRYTRAILER_EXCEPT" 141 "ADDLORRYSEMI_EXCEPT" 142 "Reserved142" 143 "Reserved143" 144 "Reserved144" 145 "Reserved145" 146 "Reserved146" 147 "Reserved147" 148 "Reserved148" 149 "Reserved149" 150 "Reserved150" 151 "Reserved151" 152 "Reserved152" 153 "Reserved153" 154 "Reserved154" 155 "Reserved155" 156 "Reserved156" 157 "Reserved157" 158 "Reserved158" 159 "Reserved159" 160 "Reserved160" 161 "Reserved161" 162 "Reserved162" 163 "Reserved163" 164 "Reserved164" 165 "Reserved165" 166 "Reserved166" 167 "Reserved167" 168 "Reserved168" 169 "Reserved169" ;
VAL_ 241 VFC_TS07_SupSign5Type 0 "UNKNOWN" 1 "ADDCAR" 2 "ADDLORRY" 3 "ADDTRAILER" 4 "ADDCARAVAN" 5 "ADDBUS" 6 "ADDTRACTOR" 7 "ADDMCYCLE" 8 "ADDLORRYBUSTRAILER_DEPRECATED" 9 "ADDLORRYBUS_DEPRECATED" 10 "ADDHAZMAT" 11 "ADDTANK" 12 "ADDTRAM" 13 "ADDWET" 14 "ADDFOG" 15 "ADDRAIN" 16 "ADDSNOW" 17 "ADDTIME" 18 "ADDSECTION" 19 "ADDDISTANCE" 20 "ADDWEIGHT" 21 "ADDEXITL" 22 "ADDEXITR" 23 "ADDLANES" 24 "ADDRADAR" 25 "ADDRAPPEL" 26 "ADDPRIOTURN" 27 "ADDLORRY_EXCEPT" 28 "ADDTRACTOR_OVER" 29 "ADDTEXT" 30 "ADDSIGN" 31 "ADDRAINSNOW" 32 "ADDHUMP" 33 "VADDLORRYBUSTRAILER_DEPRECATED" 34 "VADDLORRYBUS_DEPRECATED" 35 "VADDLORRYTRAILER_DEPRECATED" 36 "ADDLORRYTRAILER_DEPRECATED" 37 "ADDCAMPER" 38 "ADDZONE" 39 "ADDCRASHRISK" 40 "ADDACCIDENT" 41 "ADDJAM" 42 "ADDSMOKE" 43 "ADDOILTRAIL" 44 "ADDGRAVEL" 45 "ADDDIRT" 46 "ADDRWORKSEXIT" 47 "ADDROADDAMAGE" 48 "ADDRWORKSENTRY" 49 "ADDLOWTREE" 50 "ADDRWORKSACCESS" 51 "ADDRUTS" 52 "ADDSOFTSHOULDERCAR" 53 "ADDSOFTSHOULDERLORRY" 54 "VADDSIGN" 55 "VADDCAR" 56 "VADDLORRY" 57 "VADDTRAILER" 58 "VADDCARAVAN" 59 "VADDBUS" 60 "VADDWET" 61 "VADDFOG" 62 "VADDRAIN" 63 "VADDSNOW" 64 "VADDRAINSNOW" 65 "VADDTEXT" 66 "VADDSECTION" 67 "VADDDISTANCE" 68 "VADDWEIGHT" 69 "VADDZONE" 70 "VADDCRASHRISK" 71 "VADDACCIDENT" 72 "VADDJAM" 73 "VADDOILTRAIL" 74 "VADDGRAVEL" 75 "VADDDIRT" 76 "VADDROADDAMAGE" 77 "VADDRUTS" 78 "ADDNOSTOPSHOULDER" 79 "ADDTOWING" 80 "ADDSCHOOL" 81 "ADDNIGHT" 82 "ADDEND" 83 "ADDBEGINS" 84 "ADDWITHIN" 85 "ADDDISTANCEBARS" 86 "ADDMINIMUM" 87 "ADDADVICE" 88 "ADDACCESS" 89 "ADDALLWAY" 90 "ADDBUS_EXCEPT" 91 "ADDEXCEPTDELIVERY" 92 "ADDEXCEPTLOCAL" 93 "ADDFROG" 94 "ADDPRIOTURNL" 95 "ADDPRIOTURNR" 96 "ADDSTART" 97 "ADDSTOPIN" 98 "ADDEXIT" 99 "ADDHAZWATER" 100 "ADDDAY" 101 "ADDSL" 102 "ADDLORRYTRAILER" 103 "ADDLORRYSEMI" 104 "VADDLORRYTRAILER" 105 "VADDLORRYSEMI" 106 "ADDSLOW" 107 "ADDSL5" 108 "ADDSL10" 109 "ADDSL15" 110 "ADDSL20" 111 "ADDSL25" 112 "ADDSL30" 113 "ADDSL35" 114 "ADDSL40" 115 "ADDSL45" 116 "ADDSL50" 117 "ADDSL55" 118 "ADDSL60" 119 "ADDSL65" 120 "ADDSL70" 121 "ADDSL75" 122 "ADDSL80" 123 "ADDSL85" 124 "ADDSL90" 125 "ADDSL95" 126 "ADDSL100" 127 "ADDSL105" 128 "ADDSL110" 129 "ADDSL115" 130 "ADDSL120" 131 "ADDSL125" 132 "ADDSL130" 133 "ADDSL135" 134 "ADDSL140" 135 "ADDSL145" 136 "ADDSL150" 137 "ADDSL155" 138 "ADDSL160" 139 "ADDBIKEROAD" 140 "ADDLORRYTRAILER_EXCEPT" 141 "ADDLORRYSEMI_EXCEPT" 142 "Reserved142" 143 "Reserved143" 144 "Reserved144" 145 "Reserved145" 146 "Reserved146" 147 "Reserved147" 148 "Reserved148" 149 "Reserved149" 150 "Reserved150" 151 "Reserved151" 152 "Reserved152" 153 "Reserved153" 154 "Reserved154" 155 "Reserved155" 156 "Reserved156" 157 "Reserved157" 158 "Reserved158" 159 "Reserved159" 160 "Reserved160" 161 "Reserved161" 162 "Reserved162" 163 "Reserved163" 164 "Reserved164" 165 "Reserved165" 166 "Reserved166" 167 "Reserved167" 168 "Reserved168" 169 "Reserved169" ;
VAL_ 242 VFC_TS08_Type 0 "UNKNOWN" 1 "SL5" 2 "SL10" 3 "SL15" 4 "SL20" 5 "SL25" 6 "SL30" 7 "SL35" 8 "SL40" 9 "SL45" 10 "SL50" 11 "SL55" 12 "SL60" 13 "SL65" 14 "SL70" 15 "SL75" 16 "SL80" 17 "SL85" 18 "SL90" 19 "SL95" 20 "SL100" 21 "SL105" 22 "SL110" 23 "SL115" 24 "SL120" 25 "SL125" 26 "SL130" 27 "SL135" 28 "SL140" 29 "SL145" 30 "SL150" 31 "SL155" 32 "SL160" 33 "OP" 34 "OL" 35 "ESL" 36 "EOP" 37 "EOL" 38 "EA" 39 "VSL5" 40 "VSL10" 41 "VSL15" 42 "VSL20" 43 "VSL25" 44 "VSL30" 45 "VSL35" 46 "VSL40" 47 "VSL45" 48 "VSL50" 49 "VSL55" 50 "VSL60" 51 "VSL65" 52 "VSL70" 53 "VSL75" 54 "VSL80" 55 "VSL85" 56 "VSL90" 57 "VSL95" 58 "VSL100" 59 "VSL105" 60 "VSL110" 61 "VSL115" 62 "VSL120" 63 "VSL125" 64 "VSL130" 65 "VSL135" 66 "VSL140" 67 "VSL145" 68 "VSL150" 69 "VSL155" 70 "VSL160" 71 "VOP" 72 "VOL" 73 "VESL" 74 "VEOP" 75 "VEOL" 76 "VEA" 77 "NOENTRY" 78 "NOALL" 79 "NOCAR" 80 "NOLORRY" 81 "NOHAZMAT" 82 "NOBIKE" 83 "NOPED" 84 "NOCARBIKE" 85 "NOTWOWAY" 86 "WEIGHT" 87 "HEIGHT" 88 "WIDTH" 89 "LENGTH" 90 "PRIOCROSS" 91 "GIVEWAY" 92 "PRIOCROSSYIELDTORIGHT" 93 "WARNDANGER" 94 "WARNCURVEL" 95 "WARNCURVER" 96 "WARNDCURVEL" 97 "WARNDCURVER" 98 "WARNTRAIN" 99 "WARNJAM" 100 "WARNANIMAL_DEPRECATED" 101 "WARNRWORKS" 102 "WARNSLOPED" 103 "WARNSLOPEU" 104 "PRIOSTREET" 105 "EPRIOSTREET" 106 "STOP" 107 "ASL" 108 "EASL" 109 "MSL" 110 "EMSL" 111 "MLC" 112 "WBDIAGL" 113 "WBDIAGR" 114 "WBROUND" 115 "NOLTURN" 116 "NORTURN" 117 "NOUTURN" 118 "NOPARK" 119 "NOSTOP" 120 "SMOG" 121 "UMWELT" 122 "EUMWELT" 123 "DOUANE" 124 "FWAY" 125 "EFWAY" 126 "HWAY" 127 "EHWAY" 128 "NORIDER" 129 "WARNCONST" 130 "WARNCONSTL" 131 "WARNCONSTR" 132 "WARNPED" 133 "WARNKIDS" 134 "WARNBIKE" 135 "WARNSKID" 136 "ZEBRA" 137 "ONEWAYS" 138 "ONEWAYU" 139 "SLOWDOWN" 140 "NOCARRIAGE" 141 "NOLORRYTRAILER" 142 "NOBUS" 143 "NOTRACTOR" 144 "LORRYDIST" 145 "CARDIST" 146 "WARNROUND" 147 "WARNWILDANIMAL" 148 "WARNCATTLE" 149 "WARNFROG" 150 "WARNBUS" 151 "WARNWIND" 152 "WARNSNOW" 153 "WARNPCROSS" 154 "WARNHUMP" 155 "WARNROCK" 156 "WARNLOWTREE" 157 "WARNGRAVEL" 158 "WARNTWOWAY" 159 "WARNLIGHTS" 160 "WARNPLANE" 161 "VNOENTRY" 162 "VNOALL" 163 "VNOCAR" 164 "VNOLORRY" 165 "VNOCARBIKE" 166 "VWEIGHT" 167 "VHEIGHT" 168 "VWIDTH" 169 "VLENGTH" 170 "VWARNDANGER" 171 "VWARNJAM" 172 "VWARNRWORKS" 173 "VWARNSKID" 174 "VASL" 175 "VEASL" 176 "VNOLORRYTRAILER" 177 "VNOBUS" 178 "VLORRYDIST" 179 "VCARDIST" 180 "VWARNSNOW" 181 "VWARNHUMP" 182 "VWARNGRAVEL" 183 "CALM" 184 "ECALM" 185 "TWN" 186 "ETWN" 187 "DEADEND" 188 "AXLEWEIGHT" 189 "WARNRIDER" 190 "WARNDRAWBRIDGE" 191 "WARNPIER" 192 "TRINATURE" 193 "VWARNCONST" 194 "VWARNCONSTL" 195 "VWARNCONSTR" 196 "VWARNCURVEL" 197 "VWARNCURVER" 198 "VWARNDCURVEL" 199 "VWARNDCURVER" 200 "VWARNLIGHTS" 201 "WBBENTLEFT" 202 "WBBENTLEFTRIGHT" 203 "WBBENTRIGHT" 204 "WBDIAGLR" 205 "WBLEFT" 206 "WBRIGHT" 207 "WBUP" 208 "WBUPLEFT" 209 "WBUPRIGHT" 210 "WBHAZWATER" 211 "NOHAZWATER" 212 "SCHOOL" 213 "ESCHOOL" 214 "HAZMAT" 215 "EMERGENCYBAY" 216 "ENDOFLANEL" 217 "ENDOFLANER" 218 "ENOPARK" 219 "EONEWAY" 220 "EPARK" 221 "ETOLL" 222 "NOPARKL" 223 "NOPARKLR" 224 "NOPARKR" 225 "NOSTOPL" 226 "NOSTOPLR" 227 "NOSTOPR" 228 "NOTURNONRED" 229 "ONEWAYL" 230 "ONEWAYR" 231 "PARK" 232 "PRIOCROSSL" 233 "PRIOCROSSR" 234 "TOLL" 235 "TUNNEL" 236 "TWOWAY" 237 "WARNCROSS" 238 "WARNCROSSL" 239 "WARNCROSSLR" 240 "WARNCROSSR" 241 "WARNCROSSRL" 242 "WARNCROSST" 243 "WARNGIVEWAYAHEAD" 244 "WARNSLAHEAD" 245 "WARNSTOPAHEAD" 246 "WBBUS" 247 "WRONGWAY" 248 "HAZWATER" 249 "GIVEWAYROUND" 250 "WARNWINDINGL" 251 "WARNWINDINGR" 252 "WARNHAIRPINL" 253 "WARNHAIRPINR" 254 "WARNPEDBIKE" 255 "WARNCROSSY" 256 "WARNBRANCHL" 257 "WARNBRANCHR" 258 "WARNAXLEWEIGHT" 259 "WARNWEIGHT" 260 "WARNHEIGHT" 261 "WARNLENGTH" 262 "WARNWIDTH" 263 "WARNBLACKSPOT" 264 "WARNMERGEL" 265 "WARNMERGER" 266 "WARNTUNNEL" 267 "WARNTRACTOR" 268 "WARNRWORKSVEHICLE" 269 "WARNNARROWBRIDGE" 270 "WARNFLAGGER" 271 "LANES" 272 "LANESHIFTL" 273 "LANESHIFTR" 274 "NEWLANEL" 275 "NEWLANER" 276 "RIGHTTURNONRED" 277 "BORDERLIMIT" 278 "EMBEDDEDRAIN" 279 "VWARNWEIGHT" 280 "VWARNHEIGHT" 281 "VWARNLENGTH" 282 "VWARNWIDTH" 283 "VENDOFLANEL" 284 "VENDOFLANER" 285 "VLANES" 286 "VLANESHIFTL" 287 "VLANESHIFTR" 288 "VNEWLANEL" 289 "VNEWLANER" 290 "NOUP" 291 "VOFF" 292 "ASL5" 293 "ASL10" 294 "ASL15" 295 "ASL20" 296 "ASL25" 297 "ASL30" 298 "ASL35" 299 "ASL40" 300 "ASL45" 301 "ASL50" 302 "ASL55" 303 "ASL60" 304 "ASL65" 305 "ASL70" 306 "ASL75" 307 "ASL80" 308 "ASL85" 309 "ASL90" 310 "ASL95" 311 "ASL100" 312 "ASL105" 313 "ASL110" 314 "ASL115" 315 "ASL120" 316 "ASL125" 317 "ASL130" 318 "ASL135" 319 "ASL140" 320 "ASL145" 321 "ASL150" 322 "ASL155" 323 "ASL160" 324 "VASL5" 325 "VASL10" 326 "VASL15" 327 "VASL20" 328 "VASL25" 329 "VASL30" 330 "VASL35" 331 "VASL40" 332 "VASL45" 333 "VASL50" 334 "VASL55" 335 "VASL60" 336 "VASL65" 337 "VASL70" 338 "VASL75" 339 "VASL80" 340 "VASL85" 341 "VASL90" 342 "VASL95" 343 "VASL100" 344 "VASL105" 345 "VASL110" 346 "VASL115" 347 "VASL120" 348 "VASL125" 349 "VASL130" 350 "VASL135" 351 "VASL140" 352 "VASL145" 353 "VASL150" 354 "VASL155" 355 "VASL160" 356 "WARNTRAINGATED" 357 "KEEPRIGHTCAR" 358 "ASLCURVE5" 359 "ASLCURVE10" 360 "ASLCURVE15" 361 "ASLCURVE20" 362 "ASLCURVE25" 363 "ASLCURVE30" 364 "ASLCURVE35" 365 "ASLCURVE40" 366 "ASLCURVE45" 367 "ASLCURVE50" 368 "ASLCURVE55" 369 "ASLCURVE60" 370 "ASLCURVE65" 371 "ASLCURVE70" 372 "ASLCURVE75" 373 "ASLCURVE80" 374 "ASLCURVE85" 375 "ASLCURVE90" 376 "ASLCURVE95" 377 "ASLCURVE100" 378 "ASLCURVE105" 379 "ASLCURVE110" 380 "ASLCURVE115" 381 "ASLCURVE120" 382 "ASLCURVE125" 383 "ASLCURVE130" 384 "ASLCURVE135" 385 "ASLCURVE140" 386 "ASLCURVE145" 387 "ASLCURVE150" 388 "ASLCURVE155" 389 "ASLCURVE160" 390 "KIDS" 391 "EKIDS" 392 "BIKEROAD" 393 "EBIKEROAD" 394 "PEDSTREET" 395 "EPEDSTREET" 396 "PEDBIKESTREET" 397 "EPEDBIKESTREET" 398 "EWARNKIDS" 399 "CALM20" 400 "CALM30" 401 "ECALM20" 402 "ECALM30" 403 "FWAYGREEN" 404 "TWN40" 405 "TWN50" 406 "TWN60" 407 "TWN70" 408 "ETWN40" 409 "ETWN50" 410 "ETWN60" 411 "ETWN70" 412 "WBBIKE" 413 "EWBBIKE" 414 "WBPED" 415 "EWBPED" 416 "WBPEDBIKESEP" 417 "EWBPEDBIKESEP" 418 "WBPEDBIKESHARED" 419 "EWBPEDBIKESHARED" 420 "EFWAYGREEN" 421 "Reserved0421" 422 "Reserved0422" 423 "Reserved0423" 424 "Reserved0424" 425 "Reserved0425" 426 "Reserved0426" 427 "Reserved0427" 428 "Reserved0428" 429 "Reserved0429" 430 "Reserved0430" 431 "Reserved0431" 432 "Reserved0432" 433 "Reserved0433" 434 "Reserved0434" 435 "Reserved0435" 436 "Reserved0436" 437 "Reserved0437" 438 "Reserved0438" 439 "Reserved0439" 440 "Reserved0440" 441 "Reserved0441" 442 "Reserved0442" 443 "Reserved0443" 444 "Reserved0444" 445 "Reserved0445" 446 "Reserved0446" 447 "Reserved0447" 448 "Reserved0448" 449 "Reserved0449" ;
VAL_ 242 VFC_TS08_EmbeddedInfo 0 "Unknown" 1 "Not Embedded" 2 "Border Limit" 3 "Multi Lane" 4 "Rain" 5 "Vehicle Type" 6 "Plate" 7 "Error Value" 8 "Vehicle Sticker" 9 "Reserved09" 10 "Reserved10" 11 "Reserved11" 12 "Reserved12" 13 "Reserved13" 14 "Reserved14" 15 "Reserved15" ;
VAL_ 242 VFC_TS08_ValidTimeRange1Start 127 "Unknown" ;
VAL_ 242 VFC_TS08_ValidTimeRange1End 127 "Unknown" ;
VAL_ 242 VFC_TS08_ValidTimeRange2Start 127 "Unknown" ;
VAL_ 242 VFC_TS08_ValidTimeRange2End 127 "Unknown" ;
VAL_ 242 VFC_TS08_ValidInDistUnit 0 "Unknown" ;
VAL_ 242 VFC_TS08_ValidSectionUnit 0 "Unknown" 1 "Meter" 2 "Kilometer" 3 "Foot" 4 "Yard" 5 "Mile" 6 "Reserved6" 7 "Reserved7" ;
VAL_ 242 VFC_TS08_SupSign0Type 0 "UNKNOWN" 1 "ADDCAR" 2 "ADDLORRY" 3 "ADDTRAILER" 4 "ADDCARAVAN" 5 "ADDBUS" 6 "ADDTRACTOR" 7 "ADDMCYCLE" 8 "ADDLORRYBUSTRAILER_DEPRECATED" 9 "ADDLORRYBUS_DEPRECATED" 10 "ADDHAZMAT" 11 "ADDTANK" 12 "ADDTRAM" 13 "ADDWET" 14 "ADDFOG" 15 "ADDRAIN" 16 "ADDSNOW" 17 "ADDTIME" 18 "ADDSECTION" 19 "ADDDISTANCE" 20 "ADDWEIGHT" 21 "ADDEXITL" 22 "ADDEXITR" 23 "ADDLANES" 24 "ADDRADAR" 25 "ADDRAPPEL" 26 "ADDPRIOTURN" 27 "ADDLORRY_EXCEPT" 28 "ADDTRACTOR_OVER" 29 "ADDTEXT" 30 "ADDSIGN" 31 "ADDRAINSNOW" 32 "ADDHUMP" 33 "VADDLORRYBUSTRAILER_DEPRECATED" 34 "VADDLORRYBUS_DEPRECATED" 35 "VADDLORRYTRAILER_DEPRECATED" 36 "ADDLORRYTRAILER_DEPRECATED" 37 "ADDCAMPER" 38 "ADDZONE" 39 "ADDCRASHRISK" 40 "ADDACCIDENT" 41 "ADDJAM" 42 "ADDSMOKE" 43 "ADDOILTRAIL" 44 "ADDGRAVEL" 45 "ADDDIRT" 46 "ADDRWORKSEXIT" 47 "ADDROADDAMAGE" 48 "ADDRWORKSENTRY" 49 "ADDLOWTREE" 50 "ADDRWORKSACCESS" 51 "ADDRUTS" 52 "ADDSOFTSHOULDERCAR" 53 "ADDSOFTSHOULDERLORRY" 54 "VADDSIGN" 55 "VADDCAR" 56 "VADDLORRY" 57 "VADDTRAILER" 58 "VADDCARAVAN" 59 "VADDBUS" 60 "VADDWET" 61 "VADDFOG" 62 "VADDRAIN" 63 "VADDSNOW" 64 "VADDRAINSNOW" 65 "VADDTEXT" 66 "VADDSECTION" 67 "VADDDISTANCE" 68 "VADDWEIGHT" 69 "VADDZONE" 70 "VADDCRASHRISK" 71 "VADDACCIDENT" 72 "VADDJAM" 73 "VADDOILTRAIL" 74 "VADDGRAVEL" 75 "VADDDIRT" 76 "VADDROADDAMAGE" 77 "VADDRUTS" 78 "ADDNOSTOPSHOULDER" 79 "ADDTOWING" 80 "ADDSCHOOL" 81 "ADDNIGHT" 82 "ADDEND" 83 "ADDBEGINS" 84 "ADDWITHIN" 85 "ADDDISTANCEBARS" 86 "ADDMINIMUM" 87 "ADDADVICE" 88 "ADDACCESS" 89 "ADDALLWAY" 90 "ADDBUS_EXCEPT" 91 "ADDEXCEPTDELIVERY" 92 "ADDEXCEPTLOCAL" 93 "ADDFROG" 94 "ADDPRIOTURNL" 95 "ADDPRIOTURNR" 96 "ADDSTART" 97 "ADDSTOPIN" 98 "ADDEXIT" 99 "ADDHAZWATER" 100 "ADDDAY" 101 "ADDSL" 102 "ADDLORRYTRAILER" 103 "ADDLORRYSEMI" 104 "VADDLORRYTRAILER" 105 "VADDLORRYSEMI" 106 "ADDSLOW" 107 "ADDSL5" 108 "ADDSL10" 109 "ADDSL15" 110 "ADDSL20" 111 "ADDSL25" 112 "ADDSL30" 113 "ADDSL35" 114 "ADDSL40" 115 "ADDSL45" 116 "ADDSL50" 117 "ADDSL55" 118 "ADDSL60" 119 "ADDSL65" 120 "ADDSL70" 121 "ADDSL75" 122 "ADDSL80" 123 "ADDSL85" 124 "ADDSL90" 125 "ADDSL95" 126 "ADDSL100" 127 "ADDSL105" 128 "ADDSL110" 129 "ADDSL115" 130 "ADDSL120" 131 "ADDSL125" 132 "ADDSL130" 133 "ADDSL135" 134 "ADDSL140" 135 "ADDSL145" 136 "ADDSL150" 137 "ADDSL155" 138 "ADDSL160" 139 "ADDBIKEROAD" 140 "ADDLORRYTRAILER_EXCEPT" 141 "ADDLORRYSEMI_EXCEPT" 142 "Reserved142" 143 "Reserved143" 144 "Reserved144" 145 "Reserved145" 146 "Reserved146" 147 "Reserved147" 148 "Reserved148" 149 "Reserved149" 150 "Reserved150" 151 "Reserved151" 152 "Reserved152" 153 "Reserved153" 154 "Reserved154" 155 "Reserved155" 156 "Reserved156" 157 "Reserved157" 158 "Reserved158" 159 "Reserved159" 160 "Reserved160" 161 "Reserved161" 162 "Reserved162" 163 "Reserved163" 164 "Reserved164" 165 "Reserved165" 166 "Reserved166" 167 "Reserved167" 168 "Reserved168" 169 "Reserved169" ;
VAL_ 242 VFC_TS08_SupSign1Type 0 "UNKNOWN" 1 "ADDCAR" 2 "ADDLORRY" 3 "ADDTRAILER" 4 "ADDCARAVAN" 5 "ADDBUS" 6 "ADDTRACTOR" 7 "ADDMCYCLE" 8 "ADDLORRYBUSTRAILER_DEPRECATED" 9 "ADDLORRYBUS_DEPRECATED" 10 "ADDHAZMAT" 11 "ADDTANK" 12 "ADDTRAM" 13 "ADDWET" 14 "ADDFOG" 15 "ADDRAIN" 16 "ADDSNOW" 17 "ADDTIME" 18 "ADDSECTION" 19 "ADDDISTANCE" 20 "ADDWEIGHT" 21 "ADDEXITL" 22 "ADDEXITR" 23 "ADDLANES" 24 "ADDRADAR" 25 "ADDRAPPEL" 26 "ADDPRIOTURN" 27 "ADDLORRY_EXCEPT" 28 "ADDTRACTOR_OVER" 29 "ADDTEXT" 30 "ADDSIGN" 31 "ADDRAINSNOW" 32 "ADDHUMP" 33 "VADDLORRYBUSTRAILER_DEPRECATED" 34 "VADDLORRYBUS_DEPRECATED" 35 "VADDLORRYTRAILER_DEPRECATED" 36 "ADDLORRYTRAILER_DEPRECATED" 37 "ADDCAMPER" 38 "ADDZONE" 39 "ADDCRASHRISK" 40 "ADDACCIDENT" 41 "ADDJAM" 42 "ADDSMOKE" 43 "ADDOILTRAIL" 44 "ADDGRAVEL" 45 "ADDDIRT" 46 "ADDRWORKSEXIT" 47 "ADDROADDAMAGE" 48 "ADDRWORKSENTRY" 49 "ADDLOWTREE" 50 "ADDRWORKSACCESS" 51 "ADDRUTS" 52 "ADDSOFTSHOULDERCAR" 53 "ADDSOFTSHOULDERLORRY" 54 "VADDSIGN" 55 "VADDCAR" 56 "VADDLORRY" 57 "VADDTRAILER" 58 "VADDCARAVAN" 59 "VADDBUS" 60 "VADDWET" 61 "VADDFOG" 62 "VADDRAIN" 63 "VADDSNOW" 64 "VADDRAINSNOW" 65 "VADDTEXT" 66 "VADDSECTION" 67 "VADDDISTANCE" 68 "VADDWEIGHT" 69 "VADDZONE" 70 "VADDCRASHRISK" 71 "VADDACCIDENT" 72 "VADDJAM" 73 "VADDOILTRAIL" 74 "VADDGRAVEL" 75 "VADDDIRT" 76 "VADDROADDAMAGE" 77 "VADDRUTS" 78 "ADDNOSTOPSHOULDER" 79 "ADDTOWING" 80 "ADDSCHOOL" 81 "ADDNIGHT" 82 "ADDEND" 83 "ADDBEGINS" 84 "ADDWITHIN" 85 "ADDDISTANCEBARS" 86 "ADDMINIMUM" 87 "ADDADVICE" 88 "ADDACCESS" 89 "ADDALLWAY" 90 "ADDBUS_EXCEPT" 91 "ADDEXCEPTDELIVERY" 92 "ADDEXCEPTLOCAL" 93 "ADDFROG" 94 "ADDPRIOTURNL" 95 "ADDPRIOTURNR" 96 "ADDSTART" 97 "ADDSTOPIN" 98 "ADDEXIT" 99 "ADDHAZWATER" 100 "ADDDAY" 101 "ADDSL" 102 "ADDLORRYTRAILER" 103 "ADDLORRYSEMI" 104 "VADDLORRYTRAILER" 105 "VADDLORRYSEMI" 106 "ADDSLOW" 107 "ADDSL5" 108 "ADDSL10" 109 "ADDSL15" 110 "ADDSL20" 111 "ADDSL25" 112 "ADDSL30" 113 "ADDSL35" 114 "ADDSL40" 115 "ADDSL45" 116 "ADDSL50" 117 "ADDSL55" 118 "ADDSL60" 119 "ADDSL65" 120 "ADDSL70" 121 "ADDSL75" 122 "ADDSL80" 123 "ADDSL85" 124 "ADDSL90" 125 "ADDSL95" 126 "ADDSL100" 127 "ADDSL105" 128 "ADDSL110" 129 "ADDSL115" 130 "ADDSL120" 131 "ADDSL125" 132 "ADDSL130" 133 "ADDSL135" 134 "ADDSL140" 135 "ADDSL145" 136 "ADDSL150" 137 "ADDSL155" 138 "ADDSL160" 139 "ADDBIKEROAD" 140 "ADDLORRYTRAILER_EXCEPT" 141 "ADDLORRYSEMI_EXCEPT" 142 "Reserved142" 143 "Reserved143" 144 "Reserved144" 145 "Reserved145" 146 "Reserved146" 147 "Reserved147" 148 "Reserved148" 149 "Reserved149" 150 "Reserved150" 151 "Reserved151" 152 "Reserved152" 153 "Reserved153" 154 "Reserved154" 155 "Reserved155" 156 "Reserved156" 157 "Reserved157" 158 "Reserved158" 159 "Reserved159" 160 "Reserved160" 161 "Reserved161" 162 "Reserved162" 163 "Reserved163" 164 "Reserved164" 165 "Reserved165" 166 "Reserved166" 167 "Reserved167" 168 "Reserved168" 169 "Reserved169" ;
VAL_ 242 VFC_TS08_SupSign2Type 0 "UNKNOWN" 1 "ADDCAR" 2 "ADDLORRY" 3 "ADDTRAILER" 4 "ADDCARAVAN" 5 "ADDBUS" 6 "ADDTRACTOR" 7 "ADDMCYCLE" 8 "ADDLORRYBUSTRAILER_DEPRECATED" 9 "ADDLORRYBUS_DEPRECATED" 10 "ADDHAZMAT" 11 "ADDTANK" 12 "ADDTRAM" 13 "ADDWET" 14 "ADDFOG" 15 "ADDRAIN" 16 "ADDSNOW" 17 "ADDTIME" 18 "ADDSECTION" 19 "ADDDISTANCE" 20 "ADDWEIGHT" 21 "ADDEXITL" 22 "ADDEXITR" 23 "ADDLANES" 24 "ADDRADAR" 25 "ADDRAPPEL" 26 "ADDPRIOTURN" 27 "ADDLORRY_EXCEPT" 28 "ADDTRACTOR_OVER" 29 "ADDTEXT" 30 "ADDSIGN" 31 "ADDRAINSNOW" 32 "ADDHUMP" 33 "VADDLORRYBUSTRAILER_DEPRECATED" 34 "VADDLORRYBUS_DEPRECATED" 35 "VADDLORRYTRAILER_DEPRECATED" 36 "ADDLORRYTRAILER_DEPRECATED" 37 "ADDCAMPER" 38 "ADDZONE" 39 "ADDCRASHRISK" 40 "ADDACCIDENT" 41 "ADDJAM" 42 "ADDSMOKE" 43 "ADDOILTRAIL" 44 "ADDGRAVEL" 45 "ADDDIRT" 46 "ADDRWORKSEXIT" 47 "ADDROADDAMAGE" 48 "ADDRWORKSENTRY" 49 "ADDLOWTREE" 50 "ADDRWORKSACCESS" 51 "ADDRUTS" 52 "ADDSOFTSHOULDERCAR" 53 "ADDSOFTSHOULDERLORRY" 54 "VADDSIGN" 55 "VADDCAR" 56 "VADDLORRY" 57 "VADDTRAILER" 58 "VADDCARAVAN" 59 "VADDBUS" 60 "VADDWET" 61 "VADDFOG" 62 "VADDRAIN" 63 "VADDSNOW" 64 "VADDRAINSNOW" 65 "VADDTEXT" 66 "VADDSECTION" 67 "VADDDISTANCE" 68 "VADDWEIGHT" 69 "VADDZONE" 70 "VADDCRASHRISK" 71 "VADDACCIDENT" 72 "VADDJAM" 73 "VADDOILTRAIL" 74 "VADDGRAVEL" 75 "VADDDIRT" 76 "VADDROADDAMAGE" 77 "VADDRUTS" 78 "ADDNOSTOPSHOULDER" 79 "ADDTOWING" 80 "ADDSCHOOL" 81 "ADDNIGHT" 82 "ADDEND" 83 "ADDBEGINS" 84 "ADDWITHIN" 85 "ADDDISTANCEBARS" 86 "ADDMINIMUM" 87 "ADDADVICE" 88 "ADDACCESS" 89 "ADDALLWAY" 90 "ADDBUS_EXCEPT" 91 "ADDEXCEPTDELIVERY" 92 "ADDEXCEPTLOCAL" 93 "ADDFROG" 94 "ADDPRIOTURNL" 95 "ADDPRIOTURNR" 96 "ADDSTART" 97 "ADDSTOPIN" 98 "ADDEXIT" 99 "ADDHAZWATER" 100 "ADDDAY" 101 "ADDSL" 102 "ADDLORRYTRAILER" 103 "ADDLORRYSEMI" 104 "VADDLORRYTRAILER" 105 "VADDLORRYSEMI" 106 "ADDSLOW" 107 "ADDSL5" 108 "ADDSL10" 109 "ADDSL15" 110 "ADDSL20" 111 "ADDSL25" 112 "ADDSL30" 113 "ADDSL35" 114 "ADDSL40" 115 "ADDSL45" 116 "ADDSL50" 117 "ADDSL55" 118 "ADDSL60" 119 "ADDSL65" 120 "ADDSL70" 121 "ADDSL75" 122 "ADDSL80" 123 "ADDSL85" 124 "ADDSL90" 125 "ADDSL95" 126 "ADDSL100" 127 "ADDSL105" 128 "ADDSL110" 129 "ADDSL115" 130 "ADDSL120" 131 "ADDSL125" 132 "ADDSL130" 133 "ADDSL135" 134 "ADDSL140" 135 "ADDSL145" 136 "ADDSL150" 137 "ADDSL155" 138 "ADDSL160" 139 "ADDBIKEROAD" 140 "ADDLORRYTRAILER_EXCEPT" 141 "ADDLORRYSEMI_EXCEPT" 142 "Reserved142" 143 "Reserved143" 144 "Reserved144" 145 "Reserved145" 146 "Reserved146" 147 "Reserved147" 148 "Reserved148" 149 "Reserved149" 150 "Reserved150" 151 "Reserved151" 152 "Reserved152" 153 "Reserved153" 154 "Reserved154" 155 "Reserved155" 156 "Reserved156" 157 "Reserved157" 158 "Reserved158" 159 "Reserved159" 160 "Reserved160" 161 "Reserved161" 162 "Reserved162" 163 "Reserved163" 164 "Reserved164" 165 "Reserved165" 166 "Reserved166" 167 "Reserved167" 168 "Reserved168" 169 "Reserved169" ;
VAL_ 242 VFC_TS08_SupSign3Type 0 "UNKNOWN" 1 "ADDCAR" 2 "ADDLORRY" 3 "ADDTRAILER" 4 "ADDCARAVAN" 5 "ADDBUS" 6 "ADDTRACTOR" 7 "ADDMCYCLE" 8 "ADDLORRYBUSTRAILER_DEPRECATED" 9 "ADDLORRYBUS_DEPRECATED" 10 "ADDHAZMAT" 11 "ADDTANK" 12 "ADDTRAM" 13 "ADDWET" 14 "ADDFOG" 15 "ADDRAIN" 16 "ADDSNOW" 17 "ADDTIME" 18 "ADDSECTION" 19 "ADDDISTANCE" 20 "ADDWEIGHT" 21 "ADDEXITL" 22 "ADDEXITR" 23 "ADDLANES" 24 "ADDRADAR" 25 "ADDRAPPEL" 26 "ADDPRIOTURN" 27 "ADDLORRY_EXCEPT" 28 "ADDTRACTOR_OVER" 29 "ADDTEXT" 30 "ADDSIGN" 31 "ADDRAINSNOW" 32 "ADDHUMP" 33 "VADDLORRYBUSTRAILER_DEPRECATED" 34 "VADDLORRYBUS_DEPRECATED" 35 "VADDLORRYTRAILER_DEPRECATED" 36 "ADDLORRYTRAILER_DEPRECATED" 37 "ADDCAMPER" 38 "ADDZONE" 39 "ADDCRASHRISK" 40 "ADDACCIDENT" 41 "ADDJAM" 42 "ADDSMOKE" 43 "ADDOILTRAIL" 44 "ADDGRAVEL" 45 "ADDDIRT" 46 "ADDRWORKSEXIT" 47 "ADDROADDAMAGE" 48 "ADDRWORKSENTRY" 49 "ADDLOWTREE" 50 "ADDRWORKSACCESS" 51 "ADDRUTS" 52 "ADDSOFTSHOULDERCAR" 53 "ADDSOFTSHOULDERLORRY" 54 "VADDSIGN" 55 "VADDCAR" 56 "VADDLORRY" 57 "VADDTRAILER" 58 "VADDCARAVAN" 59 "VADDBUS" 60 "VADDWET" 61 "VADDFOG" 62 "VADDRAIN" 63 "VADDSNOW" 64 "VADDRAINSNOW" 65 "VADDTEXT" 66 "VADDSECTION" 67 "VADDDISTANCE" 68 "VADDWEIGHT" 69 "VADDZONE" 70 "VADDCRASHRISK" 71 "VADDACCIDENT" 72 "VADDJAM" 73 "VADDOILTRAIL" 74 "VADDGRAVEL" 75 "VADDDIRT" 76 "VADDROADDAMAGE" 77 "VADDRUTS" 78 "ADDNOSTOPSHOULDER" 79 "ADDTOWING" 80 "ADDSCHOOL" 81 "ADDNIGHT" 82 "ADDEND" 83 "ADDBEGINS" 84 "ADDWITHIN" 85 "ADDDISTANCEBARS" 86 "ADDMINIMUM" 87 "ADDADVICE" 88 "ADDACCESS" 89 "ADDALLWAY" 90 "ADDBUS_EXCEPT" 91 "ADDEXCEPTDELIVERY" 92 "ADDEXCEPTLOCAL" 93 "ADDFROG" 94 "ADDPRIOTURNL" 95 "ADDPRIOTURNR" 96 "ADDSTART" 97 "ADDSTOPIN" 98 "ADDEXIT" 99 "ADDHAZWATER" 100 "ADDDAY" 101 "ADDSL" 102 "ADDLORRYTRAILER" 103 "ADDLORRYSEMI" 104 "VADDLORRYTRAILER" 105 "VADDLORRYSEMI" 106 "ADDSLOW" 107 "ADDSL5" 108 "ADDSL10" 109 "ADDSL15" 110 "ADDSL20" 111 "ADDSL25" 112 "ADDSL30" 113 "ADDSL35" 114 "ADDSL40" 115 "ADDSL45" 116 "ADDSL50" 117 "ADDSL55" 118 "ADDSL60" 119 "ADDSL65" 120 "ADDSL70" 121 "ADDSL75" 122 "ADDSL80" 123 "ADDSL85" 124 "ADDSL90" 125 "ADDSL95" 126 "ADDSL100" 127 "ADDSL105" 128 "ADDSL110" 129 "ADDSL115" 130 "ADDSL120" 131 "ADDSL125" 132 "ADDSL130" 133 "ADDSL135" 134 "ADDSL140" 135 "ADDSL145" 136 "ADDSL150" 137 "ADDSL155" 138 "ADDSL160" 139 "ADDBIKEROAD" 140 "ADDLORRYTRAILER_EXCEPT" 141 "ADDLORRYSEMI_EXCEPT" 142 "Reserved142" 143 "Reserved143" 144 "Reserved144" 145 "Reserved145" 146 "Reserved146" 147 "Reserved147" 148 "Reserved148" 149 "Reserved149" 150 "Reserved150" 151 "Reserved151" 152 "Reserved152" 153 "Reserved153" 154 "Reserved154" 155 "Reserved155" 156 "Reserved156" 157 "Reserved157" 158 "Reserved158" 159 "Reserved159" 160 "Reserved160" 161 "Reserved161" 162 "Reserved162" 163 "Reserved163" 164 "Reserved164" 165 "Reserved165" 166 "Reserved166" 167 "Reserved167" 168 "Reserved168" 169 "Reserved169" ;
VAL_ 242 VFC_TS08_SupSign4Type 0 "UNKNOWN" 1 "ADDCAR" 2 "ADDLORRY" 3 "ADDTRAILER" 4 "ADDCARAVAN" 5 "ADDBUS" 6 "ADDTRACTOR" 7 "ADDMCYCLE" 8 "ADDLORRYBUSTRAILER_DEPRECATED" 9 "ADDLORRYBUS_DEPRECATED" 10 "ADDHAZMAT" 11 "ADDTANK" 12 "ADDTRAM" 13 "ADDWET" 14 "ADDFOG" 15 "ADDRAIN" 16 "ADDSNOW" 17 "ADDTIME" 18 "ADDSECTION" 19 "ADDDISTANCE" 20 "ADDWEIGHT" 21 "ADDEXITL" 22 "ADDEXITR" 23 "ADDLANES" 24 "ADDRADAR" 25 "ADDRAPPEL" 26 "ADDPRIOTURN" 27 "ADDLORRY_EXCEPT" 28 "ADDTRACTOR_OVER" 29 "ADDTEXT" 30 "ADDSIGN" 31 "ADDRAINSNOW" 32 "ADDHUMP" 33 "VADDLORRYBUSTRAILER_DEPRECATED" 34 "VADDLORRYBUS_DEPRECATED" 35 "VADDLORRYTRAILER_DEPRECATED" 36 "ADDLORRYTRAILER_DEPRECATED" 37 "ADDCAMPER" 38 "ADDZONE" 39 "ADDCRASHRISK" 40 "ADDACCIDENT" 41 "ADDJAM" 42 "ADDSMOKE" 43 "ADDOILTRAIL" 44 "ADDGRAVEL" 45 "ADDDIRT" 46 "ADDRWORKSEXIT" 47 "ADDROADDAMAGE" 48 "ADDRWORKSENTRY" 49 "ADDLOWTREE" 50 "ADDRWORKSACCESS" 51 "ADDRUTS" 52 "ADDSOFTSHOULDERCAR" 53 "ADDSOFTSHOULDERLORRY" 54 "VADDSIGN" 55 "VADDCAR" 56 "VADDLORRY" 57 "VADDTRAILER" 58 "VADDCARAVAN" 59 "VADDBUS" 60 "VADDWET" 61 "VADDFOG" 62 "VADDRAIN" 63 "VADDSNOW" 64 "VADDRAINSNOW" 65 "VADDTEXT" 66 "VADDSECTION" 67 "VADDDISTANCE" 68 "VADDWEIGHT" 69 "VADDZONE" 70 "VADDCRASHRISK" 71 "VADDACCIDENT" 72 "VADDJAM" 73 "VADDOILTRAIL" 74 "VADDGRAVEL" 75 "VADDDIRT" 76 "VADDROADDAMAGE" 77 "VADDRUTS" 78 "ADDNOSTOPSHOULDER" 79 "ADDTOWING" 80 "ADDSCHOOL" 81 "ADDNIGHT" 82 "ADDEND" 83 "ADDBEGINS" 84 "ADDWITHIN" 85 "ADDDISTANCEBARS" 86 "ADDMINIMUM" 87 "ADDADVICE" 88 "ADDACCESS" 89 "ADDALLWAY" 90 "ADDBUS_EXCEPT" 91 "ADDEXCEPTDELIVERY" 92 "ADDEXCEPTLOCAL" 93 "ADDFROG" 94 "ADDPRIOTURNL" 95 "ADDPRIOTURNR" 96 "ADDSTART" 97 "ADDSTOPIN" 98 "ADDEXIT" 99 "ADDHAZWATER" 100 "ADDDAY" 101 "ADDSL" 102 "ADDLORRYTRAILER" 103 "ADDLORRYSEMI" 104 "VADDLORRYTRAILER" 105 "VADDLORRYSEMI" 106 "ADDSLOW" 107 "ADDSL5" 108 "ADDSL10" 109 "ADDSL15" 110 "ADDSL20" 111 "ADDSL25" 112 "ADDSL30" 113 "ADDSL35" 114 "ADDSL40" 115 "ADDSL45" 116 "ADDSL50" 117 "ADDSL55" 118 "ADDSL60" 119 "ADDSL65" 120 "ADDSL70" 121 "ADDSL75" 122 "ADDSL80" 123 "ADDSL85" 124 "ADDSL90" 125 "ADDSL95" 126 "ADDSL100" 127 "ADDSL105" 128 "ADDSL110" 129 "ADDSL115" 130 "ADDSL120" 131 "ADDSL125" 132 "ADDSL130" 133 "ADDSL135" 134 "ADDSL140" 135 "ADDSL145" 136 "ADDSL150" 137 "ADDSL155" 138 "ADDSL160" 139 "ADDBIKEROAD" 140 "ADDLORRYTRAILER_EXCEPT" 141 "ADDLORRYSEMI_EXCEPT" 142 "Reserved142" 143 "Reserved143" 144 "Reserved144" 145 "Reserved145" 146 "Reserved146" 147 "Reserved147" 148 "Reserved148" 149 "Reserved149" 150 "Reserved150" 151 "Reserved151" 152 "Reserved152" 153 "Reserved153" 154 "Reserved154" 155 "Reserved155" 156 "Reserved156" 157 "Reserved157" 158 "Reserved158" 159 "Reserved159" 160 "Reserved160" 161 "Reserved161" 162 "Reserved162" 163 "Reserved163" 164 "Reserved164" 165 "Reserved165" 166 "Reserved166" 167 "Reserved167" 168 "Reserved168" 169 "Reserved169" ;
VAL_ 242 VFC_TS08_SupSign5Type 0 "UNKNOWN" 1 "ADDCAR" 2 "ADDLORRY" 3 "ADDTRAILER" 4 "ADDCARAVAN" 5 "ADDBUS" 6 "ADDTRACTOR" 7 "ADDMCYCLE" 8 "ADDLORRYBUSTRAILER_DEPRECATED" 9 "ADDLORRYBUS_DEPRECATED" 10 "ADDHAZMAT" 11 "ADDTANK" 12 "ADDTRAM" 13 "ADDWET" 14 "ADDFOG" 15 "ADDRAIN" 16 "ADDSNOW" 17 "ADDTIME" 18 "ADDSECTION" 19 "ADDDISTANCE" 20 "ADDWEIGHT" 21 "ADDEXITL" 22 "ADDEXITR" 23 "ADDLANES" 24 "ADDRADAR" 25 "ADDRAPPEL" 26 "ADDPRIOTURN" 27 "ADDLORRY_EXCEPT" 28 "ADDTRACTOR_OVER" 29 "ADDTEXT" 30 "ADDSIGN" 31 "ADDRAINSNOW" 32 "ADDHUMP" 33 "VADDLORRYBUSTRAILER_DEPRECATED" 34 "VADDLORRYBUS_DEPRECATED" 35 "VADDLORRYTRAILER_DEPRECATED" 36 "ADDLORRYTRAILER_DEPRECATED" 37 "ADDCAMPER" 38 "ADDZONE" 39 "ADDCRASHRISK" 40 "ADDACCIDENT" 41 "ADDJAM" 42 "ADDSMOKE" 43 "ADDOILTRAIL" 44 "ADDGRAVEL" 45 "ADDDIRT" 46 "ADDRWORKSEXIT" 47 "ADDROADDAMAGE" 48 "ADDRWORKSENTRY" 49 "ADDLOWTREE" 50 "ADDRWORKSACCESS" 51 "ADDRUTS" 52 "ADDSOFTSHOULDERCAR" 53 "ADDSOFTSHOULDERLORRY" 54 "VADDSIGN" 55 "VADDCAR" 56 "VADDLORRY" 57 "VADDTRAILER" 58 "VADDCARAVAN" 59 "VADDBUS" 60 "VADDWET" 61 "VADDFOG" 62 "VADDRAIN" 63 "VADDSNOW" 64 "VADDRAINSNOW" 65 "VADDTEXT" 66 "VADDSECTION" 67 "VADDDISTANCE" 68 "VADDWEIGHT" 69 "VADDZONE" 70 "VADDCRASHRISK" 71 "VADDACCIDENT" 72 "VADDJAM" 73 "VADDOILTRAIL" 74 "VADDGRAVEL" 75 "VADDDIRT" 76 "VADDROADDAMAGE" 77 "VADDRUTS" 78 "ADDNOSTOPSHOULDER" 79 "ADDTOWING" 80 "ADDSCHOOL" 81 "ADDNIGHT" 82 "ADDEND" 83 "ADDBEGINS" 84 "ADDWITHIN" 85 "ADDDISTANCEBARS" 86 "ADDMINIMUM" 87 "ADDADVICE" 88 "ADDACCESS" 89 "ADDALLWAY" 90 "ADDBUS_EXCEPT" 91 "ADDEXCEPTDELIVERY" 92 "ADDEXCEPTLOCAL" 93 "ADDFROG" 94 "ADDPRIOTURNL" 95 "ADDPRIOTURNR" 96 "ADDSTART" 97 "ADDSTOPIN" 98 "ADDEXIT" 99 "ADDHAZWATER" 100 "ADDDAY" 101 "ADDSL" 102 "ADDLORRYTRAILER" 103 "ADDLORRYSEMI" 104 "VADDLORRYTRAILER" 105 "VADDLORRYSEMI" 106 "ADDSLOW" 107 "ADDSL5" 108 "ADDSL10" 109 "ADDSL15" 110 "ADDSL20" 111 "ADDSL25" 112 "ADDSL30" 113 "ADDSL35" 114 "ADDSL40" 115 "ADDSL45" 116 "ADDSL50" 117 "ADDSL55" 118 "ADDSL60" 119 "ADDSL65" 120 "ADDSL70" 121 "ADDSL75" 122 "ADDSL80" 123 "ADDSL85" 124 "ADDSL90" 125 "ADDSL95" 126 "ADDSL100" 127 "ADDSL105" 128 "ADDSL110" 129 "ADDSL115" 130 "ADDSL120" 131 "ADDSL125" 132 "ADDSL130" 133 "ADDSL135" 134 "ADDSL140" 135 "ADDSL145" 136 "ADDSL150" 137 "ADDSL155" 138 "ADDSL160" 139 "ADDBIKEROAD" 140 "ADDLORRYTRAILER_EXCEPT" 141 "ADDLORRYSEMI_EXCEPT" 142 "Reserved142" 143 "Reserved143" 144 "Reserved144" 145 "Reserved145" 146 "Reserved146" 147 "Reserved147" 148 "Reserved148" 149 "Reserved149" 150 "Reserved150" 151 "Reserved151" 152 "Reserved152" 153 "Reserved153" 154 "Reserved154" 155 "Reserved155" 156 "Reserved156" 157 "Reserved157" 158 "Reserved158" 159 "Reserved159" 160 "Reserved160" 161 "Reserved161" 162 "Reserved162" 163 "Reserved163" 164 "Reserved164" 165 "Reserved165" 166 "Reserved166" 167 "Reserved167" 168 "Reserved168" 169 "Reserved169" ;
VAL_ 242 VFC_TS09_Type 0 "UNKNOWN" 1 "SL5" 2 "SL10" 3 "SL15" 4 "SL20" 5 "SL25" 6 "SL30" 7 "SL35" 8 "SL40" 9 "SL45" 10 "SL50" 11 "SL55" 12 "SL60" 13 "SL65" 14 "SL70" 15 "SL75" 16 "SL80" 17 "SL85" 18 "SL90" 19 "SL95" 20 "SL100" 21 "SL105" 22 "SL110" 23 "SL115" 24 "SL120" 25 "SL125" 26 "SL130" 27 "SL135" 28 "SL140" 29 "SL145" 30 "SL150" 31 "SL155" 32 "SL160" 33 "OP" 34 "OL" 35 "ESL" 36 "EOP" 37 "EOL" 38 "EA" 39 "VSL5" 40 "VSL10" 41 "VSL15" 42 "VSL20" 43 "VSL25" 44 "VSL30" 45 "VSL35" 46 "VSL40" 47 "VSL45" 48 "VSL50" 49 "VSL55" 50 "VSL60" 51 "VSL65" 52 "VSL70" 53 "VSL75" 54 "VSL80" 55 "VSL85" 56 "VSL90" 57 "VSL95" 58 "VSL100" 59 "VSL105" 60 "VSL110" 61 "VSL115" 62 "VSL120" 63 "VSL125" 64 "VSL130" 65 "VSL135" 66 "VSL140" 67 "VSL145" 68 "VSL150" 69 "VSL155" 70 "VSL160" 71 "VOP" 72 "VOL" 73 "VESL" 74 "VEOP" 75 "VEOL" 76 "VEA" 77 "NOENTRY" 78 "NOALL" 79 "NOCAR" 80 "NOLORRY" 81 "NOHAZMAT" 82 "NOBIKE" 83 "NOPED" 84 "NOCARBIKE" 85 "NOTWOWAY" 86 "WEIGHT" 87 "HEIGHT" 88 "WIDTH" 89 "LENGTH" 90 "PRIOCROSS" 91 "GIVEWAY" 92 "PRIOCROSSYIELDTORIGHT" 93 "WARNDANGER" 94 "WARNCURVEL" 95 "WARNCURVER" 96 "WARNDCURVEL" 97 "WARNDCURVER" 98 "WARNTRAIN" 99 "WARNJAM" 100 "WARNANIMAL_DEPRECATED" 101 "WARNRWORKS" 102 "WARNSLOPED" 103 "WARNSLOPEU" 104 "PRIOSTREET" 105 "EPRIOSTREET" 106 "STOP" 107 "ASL" 108 "EASL" 109 "MSL" 110 "EMSL" 111 "MLC" 112 "WBDIAGL" 113 "WBDIAGR" 114 "WBROUND" 115 "NOLTURN" 116 "NORTURN" 117 "NOUTURN" 118 "NOPARK" 119 "NOSTOP" 120 "SMOG" 121 "UMWELT" 122 "EUMWELT" 123 "DOUANE" 124 "FWAY" 125 "EFWAY" 126 "HWAY" 127 "EHWAY" 128 "NORIDER" 129 "WARNCONST" 130 "WARNCONSTL" 131 "WARNCONSTR" 132 "WARNPED" 133 "WARNKIDS" 134 "WARNBIKE" 135 "WARNSKID" 136 "ZEBRA" 137 "ONEWAYS" 138 "ONEWAYU" 139 "SLOWDOWN" 140 "NOCARRIAGE" 141 "NOLORRYTRAILER" 142 "NOBUS" 143 "NOTRACTOR" 144 "LORRYDIST" 145 "CARDIST" 146 "WARNROUND" 147 "WARNWILDANIMAL" 148 "WARNCATTLE" 149 "WARNFROG" 150 "WARNBUS" 151 "WARNWIND" 152 "WARNSNOW" 153 "WARNPCROSS" 154 "WARNHUMP" 155 "WARNROCK" 156 "WARNLOWTREE" 157 "WARNGRAVEL" 158 "WARNTWOWAY" 159 "WARNLIGHTS" 160 "WARNPLANE" 161 "VNOENTRY" 162 "VNOALL" 163 "VNOCAR" 164 "VNOLORRY" 165 "VNOCARBIKE" 166 "VWEIGHT" 167 "VHEIGHT" 168 "VWIDTH" 169 "VLENGTH" 170 "VWARNDANGER" 171 "VWARNJAM" 172 "VWARNRWORKS" 173 "VWARNSKID" 174 "VASL" 175 "VEASL" 176 "VNOLORRYTRAILER" 177 "VNOBUS" 178 "VLORRYDIST" 179 "VCARDIST" 180 "VWARNSNOW" 181 "VWARNHUMP" 182 "VWARNGRAVEL" 183 "CALM" 184 "ECALM" 185 "TWN" 186 "ETWN" 187 "DEADEND" 188 "AXLEWEIGHT" 189 "WARNRIDER" 190 "WARNDRAWBRIDGE" 191 "WARNPIER" 192 "TRINATURE" 193 "VWARNCONST" 194 "VWARNCONSTL" 195 "VWARNCONSTR" 196 "VWARNCURVEL" 197 "VWARNCURVER" 198 "VWARNDCURVEL" 199 "VWARNDCURVER" 200 "VWARNLIGHTS" 201 "WBBENTLEFT" 202 "WBBENTLEFTRIGHT" 203 "WBBENTRIGHT" 204 "WBDIAGLR" 205 "WBLEFT" 206 "WBRIGHT" 207 "WBUP" 208 "WBUPLEFT" 209 "WBUPRIGHT" 210 "WBHAZWATER" 211 "NOHAZWATER" 212 "SCHOOL" 213 "ESCHOOL" 214 "HAZMAT" 215 "EMERGENCYBAY" 216 "ENDOFLANEL" 217 "ENDOFLANER" 218 "ENOPARK" 219 "EONEWAY" 220 "EPARK" 221 "ETOLL" 222 "NOPARKL" 223 "NOPARKLR" 224 "NOPARKR" 225 "NOSTOPL" 226 "NOSTOPLR" 227 "NOSTOPR" 228 "NOTURNONRED" 229 "ONEWAYL" 230 "ONEWAYR" 231 "PARK" 232 "PRIOCROSSL" 233 "PRIOCROSSR" 234 "TOLL" 235 "TUNNEL" 236 "TWOWAY" 237 "WARNCROSS" 238 "WARNCROSSL" 239 "WARNCROSSLR" 240 "WARNCROSSR" 241 "WARNCROSSRL" 242 "WARNCROSST" 243 "WARNGIVEWAYAHEAD" 244 "WARNSLAHEAD" 245 "WARNSTOPAHEAD" 246 "WBBUS" 247 "WRONGWAY" 248 "HAZWATER" 249 "GIVEWAYROUND" 250 "WARNWINDINGL" 251 "WARNWINDINGR" 252 "WARNHAIRPINL" 253 "WARNHAIRPINR" 254 "WARNPEDBIKE" 255 "WARNCROSSY" 256 "WARNBRANCHL" 257 "WARNBRANCHR" 258 "WARNAXLEWEIGHT" 259 "WARNWEIGHT" 260 "WARNHEIGHT" 261 "WARNLENGTH" 262 "WARNWIDTH" 263 "WARNBLACKSPOT" 264 "WARNMERGEL" 265 "WARNMERGER" 266 "WARNTUNNEL" 267 "WARNTRACTOR" 268 "WARNRWORKSVEHICLE" 269 "WARNNARROWBRIDGE" 270 "WARNFLAGGER" 271 "LANES" 272 "LANESHIFTL" 273 "LANESHIFTR" 274 "NEWLANEL" 275 "NEWLANER" 276 "RIGHTTURNONRED" 277 "BORDERLIMIT" 278 "EMBEDDEDRAIN" 279 "VWARNWEIGHT" 280 "VWARNHEIGHT" 281 "VWARNLENGTH" 282 "VWARNWIDTH" 283 "VENDOFLANEL" 284 "VENDOFLANER" 285 "VLANES" 286 "VLANESHIFTL" 287 "VLANESHIFTR" 288 "VNEWLANEL" 289 "VNEWLANER" 290 "NOUP" 291 "VOFF" 292 "ASL5" 293 "ASL10" 294 "ASL15" 295 "ASL20" 296 "ASL25" 297 "ASL30" 298 "ASL35" 299 "ASL40" 300 "ASL45" 301 "ASL50" 302 "ASL55" 303 "ASL60" 304 "ASL65" 305 "ASL70" 306 "ASL75" 307 "ASL80" 308 "ASL85" 309 "ASL90" 310 "ASL95" 311 "ASL100" 312 "ASL105" 313 "ASL110" 314 "ASL115" 315 "ASL120" 316 "ASL125" 317 "ASL130" 318 "ASL135" 319 "ASL140" 320 "ASL145" 321 "ASL150" 322 "ASL155" 323 "ASL160" 324 "VASL5" 325 "VASL10" 326 "VASL15" 327 "VASL20" 328 "VASL25" 329 "VASL30" 330 "VASL35" 331 "VASL40" 332 "VASL45" 333 "VASL50" 334 "VASL55" 335 "VASL60" 336 "VASL65" 337 "VASL70" 338 "VASL75" 339 "VASL80" 340 "VASL85" 341 "VASL90" 342 "VASL95" 343 "VASL100" 344 "VASL105" 345 "VASL110" 346 "VASL115" 347 "VASL120" 348 "VASL125" 349 "VASL130" 350 "VASL135" 351 "VASL140" 352 "VASL145" 353 "VASL150" 354 "VASL155" 355 "VASL160" 356 "WARNTRAINGATED" 357 "KEEPRIGHTCAR" 358 "ASLCURVE5" 359 "ASLCURVE10" 360 "ASLCURVE15" 361 "ASLCURVE20" 362 "ASLCURVE25" 363 "ASLCURVE30" 364 "ASLCURVE35" 365 "ASLCURVE40" 366 "ASLCURVE45" 367 "ASLCURVE50" 368 "ASLCURVE55" 369 "ASLCURVE60" 370 "ASLCURVE65" 371 "ASLCURVE70" 372 "ASLCURVE75" 373 "ASLCURVE80" 374 "ASLCURVE85" 375 "ASLCURVE90" 376 "ASLCURVE95" 377 "ASLCURVE100" 378 "ASLCURVE105" 379 "ASLCURVE110" 380 "ASLCURVE115" 381 "ASLCURVE120" 382 "ASLCURVE125" 383 "ASLCURVE130" 384 "ASLCURVE135" 385 "ASLCURVE140" 386 "ASLCURVE145" 387 "ASLCURVE150" 388 "ASLCURVE155" 389 "ASLCURVE160" 390 "KIDS" 391 "EKIDS" 392 "BIKEROAD" 393 "EBIKEROAD" 394 "PEDSTREET" 395 "EPEDSTREET" 396 "PEDBIKESTREET" 397 "EPEDBIKESTREET" 398 "EWARNKIDS" 399 "CALM20" 400 "CALM30" 401 "ECALM20" 402 "ECALM30" 403 "FWAYGREEN" 404 "TWN40" 405 "TWN50" 406 "TWN60" 407 "TWN70" 408 "ETWN40" 409 "ETWN50" 410 "ETWN60" 411 "ETWN70" 412 "WBBIKE" 413 "EWBBIKE" 414 "WBPED" 415 "EWBPED" 416 "WBPEDBIKESEP" 417 "EWBPEDBIKESEP" 418 "WBPEDBIKESHARED" 419 "EWBPEDBIKESHARED" 420 "EFWAYGREEN" 421 "Reserved0421" 422 "Reserved0422" 423 "Reserved0423" 424 "Reserved0424" 425 "Reserved0425" 426 "Reserved0426" 427 "Reserved0427" 428 "Reserved0428" 429 "Reserved0429" 430 "Reserved0430" 431 "Reserved0431" 432 "Reserved0432" 433 "Reserved0433" 434 "Reserved0434" 435 "Reserved0435" 436 "Reserved0436" 437 "Reserved0437" 438 "Reserved0438" 439 "Reserved0439" 440 "Reserved0440" 441 "Reserved0441" 442 "Reserved0442" 443 "Reserved0443" 444 "Reserved0444" 445 "Reserved0445" 446 "Reserved0446" 447 "Reserved0447" 448 "Reserved0448" 449 "Reserved0449" ;
VAL_ 242 VFC_TS09_EmbeddedInfo 0 "Unknown" 1 "Not Embedded" 2 "Border Limit" 3 "Multi Lane" 4 "Rain" 5 "Vehicle Type" 6 "Plate" 7 "Error Value" 8 "Vehicle Sticker" 9 "Reserved09" 10 "Reserved10" 11 "Reserved11" 12 "Reserved12" 13 "Reserved13" 14 "Reserved14" 15 "Reserved15" ;
VAL_ 242 VFC_TS09_ValidTimeRange1Start 127 "Unknown" ;
VAL_ 242 VFC_TS09_ValidTimeRange1End 127 "Unknown" ;
VAL_ 242 VFC_TS09_ValidTimeRange2Start 127 "Unknown" ;
VAL_ 242 VFC_TS09_ValidTimeRange2End 127 "Unknown" ;
VAL_ 242 VFC_TS09_ValidInDistUnit 0 "Unknown" ;
VAL_ 242 VFC_TS09_ValidSectionUnit 0 "Unknown" 1 "Meter" 2 "Kilometer" 3 "Foot" 4 "Yard" 5 "Mile" 6 "Reserved6" 7 "Reserved7" ;
VAL_ 242 VFC_TS09_SupSign0Type 0 "UNKNOWN" 1 "ADDCAR" 2 "ADDLORRY" 3 "ADDTRAILER" 4 "ADDCARAVAN" 5 "ADDBUS" 6 "ADDTRACTOR" 7 "ADDMCYCLE" 8 "ADDLORRYBUSTRAILER_DEPRECATED" 9 "ADDLORRYBUS_DEPRECATED" 10 "ADDHAZMAT" 11 "ADDTANK" 12 "ADDTRAM" 13 "ADDWET" 14 "ADDFOG" 15 "ADDRAIN" 16 "ADDSNOW" 17 "ADDTIME" 18 "ADDSECTION" 19 "ADDDISTANCE" 20 "ADDWEIGHT" 21 "ADDEXITL" 22 "ADDEXITR" 23 "ADDLANES" 24 "ADDRADAR" 25 "ADDRAPPEL" 26 "ADDPRIOTURN" 27 "ADDLORRY_EXCEPT" 28 "ADDTRACTOR_OVER" 29 "ADDTEXT" 30 "ADDSIGN" 31 "ADDRAINSNOW" 32 "ADDHUMP" 33 "VADDLORRYBUSTRAILER_DEPRECATED" 34 "VADDLORRYBUS_DEPRECATED" 35 "VADDLORRYTRAILER_DEPRECATED" 36 "ADDLORRYTRAILER_DEPRECATED" 37 "ADDCAMPER" 38 "ADDZONE" 39 "ADDCRASHRISK" 40 "ADDACCIDENT" 41 "ADDJAM" 42 "ADDSMOKE" 43 "ADDOILTRAIL" 44 "ADDGRAVEL" 45 "ADDDIRT" 46 "ADDRWORKSEXIT" 47 "ADDROADDAMAGE" 48 "ADDRWORKSENTRY" 49 "ADDLOWTREE" 50 "ADDRWORKSACCESS" 51 "ADDRUTS" 52 "ADDSOFTSHOULDERCAR" 53 "ADDSOFTSHOULDERLORRY" 54 "VADDSIGN" 55 "VADDCAR" 56 "VADDLORRY" 57 "VADDTRAILER" 58 "VADDCARAVAN" 59 "VADDBUS" 60 "VADDWET" 61 "VADDFOG" 62 "VADDRAIN" 63 "VADDSNOW" 64 "VADDRAINSNOW" 65 "VADDTEXT" 66 "VADDSECTION" 67 "VADDDISTANCE" 68 "VADDWEIGHT" 69 "VADDZONE" 70 "VADDCRASHRISK" 71 "VADDACCIDENT" 72 "VADDJAM" 73 "VADDOILTRAIL" 74 "VADDGRAVEL" 75 "VADDDIRT" 76 "VADDROADDAMAGE" 77 "VADDRUTS" 78 "ADDNOSTOPSHOULDER" 79 "ADDTOWING" 80 "ADDSCHOOL" 81 "ADDNIGHT" 82 "ADDEND" 83 "ADDBEGINS" 84 "ADDWITHIN" 85 "ADDDISTANCEBARS" 86 "ADDMINIMUM" 87 "ADDADVICE" 88 "ADDACCESS" 89 "ADDALLWAY" 90 "ADDBUS_EXCEPT" 91 "ADDEXCEPTDELIVERY" 92 "ADDEXCEPTLOCAL" 93 "ADDFROG" 94 "ADDPRIOTURNL" 95 "ADDPRIOTURNR" 96 "ADDSTART" 97 "ADDSTOPIN" 98 "ADDEXIT" 99 "ADDHAZWATER" 100 "ADDDAY" 101 "ADDSL" 102 "ADDLORRYTRAILER" 103 "ADDLORRYSEMI" 104 "VADDLORRYTRAILER" 105 "VADDLORRYSEMI" 106 "ADDSLOW" 107 "ADDSL5" 108 "ADDSL10" 109 "ADDSL15" 110 "ADDSL20" 111 "ADDSL25" 112 "ADDSL30" 113 "ADDSL35" 114 "ADDSL40" 115 "ADDSL45" 116 "ADDSL50" 117 "ADDSL55" 118 "ADDSL60" 119 "ADDSL65" 120 "ADDSL70" 121 "ADDSL75" 122 "ADDSL80" 123 "ADDSL85" 124 "ADDSL90" 125 "ADDSL95" 126 "ADDSL100" 127 "ADDSL105" 128 "ADDSL110" 129 "ADDSL115" 130 "ADDSL120" 131 "ADDSL125" 132 "ADDSL130" 133 "ADDSL135" 134 "ADDSL140" 135 "ADDSL145" 136 "ADDSL150" 137 "ADDSL155" 138 "ADDSL160" 139 "ADDBIKEROAD" 140 "ADDLORRYTRAILER_EXCEPT" 141 "ADDLORRYSEMI_EXCEPT" 142 "Reserved142" 143 "Reserved143" 144 "Reserved144" 145 "Reserved145" 146 "Reserved146" 147 "Reserved147" 148 "Reserved148" 149 "Reserved149" 150 "Reserved150" 151 "Reserved151" 152 "Reserved152" 153 "Reserved153" 154 "Reserved154" 155 "Reserved155" 156 "Reserved156" 157 "Reserved157" 158 "Reserved158" 159 "Reserved159" 160 "Reserved160" 161 "Reserved161" 162 "Reserved162" 163 "Reserved163" 164 "Reserved164" 165 "Reserved165" 166 "Reserved166" 167 "Reserved167" 168 "Reserved168" 169 "Reserved169" ;
VAL_ 242 VFC_TS09_SupSign1Type 0 "UNKNOWN" 1 "ADDCAR" 2 "ADDLORRY" 3 "ADDTRAILER" 4 "ADDCARAVAN" 5 "ADDBUS" 6 "ADDTRACTOR" 7 "ADDMCYCLE" 8 "ADDLORRYBUSTRAILER_DEPRECATED" 9 "ADDLORRYBUS_DEPRECATED" 10 "ADDHAZMAT" 11 "ADDTANK" 12 "ADDTRAM" 13 "ADDWET" 14 "ADDFOG" 15 "ADDRAIN" 16 "ADDSNOW" 17 "ADDTIME" 18 "ADDSECTION" 19 "ADDDISTANCE" 20 "ADDWEIGHT" 21 "ADDEXITL" 22 "ADDEXITR" 23 "ADDLANES" 24 "ADDRADAR" 25 "ADDRAPPEL" 26 "ADDPRIOTURN" 27 "ADDLORRY_EXCEPT" 28 "ADDTRACTOR_OVER" 29 "ADDTEXT" 30 "ADDSIGN" 31 "ADDRAINSNOW" 32 "ADDHUMP" 33 "VADDLORRYBUSTRAILER_DEPRECATED" 34 "VADDLORRYBUS_DEPRECATED" 35 "VADDLORRYTRAILER_DEPRECATED" 36 "ADDLORRYTRAILER_DEPRECATED" 37 "ADDCAMPER" 38 "ADDZONE" 39 "ADDCRASHRISK" 40 "ADDACCIDENT" 41 "ADDJAM" 42 "ADDSMOKE" 43 "ADDOILTRAIL" 44 "ADDGRAVEL" 45 "ADDDIRT" 46 "ADDRWORKSEXIT" 47 "ADDROADDAMAGE" 48 "ADDRWORKSENTRY" 49 "ADDLOWTREE" 50 "ADDRWORKSACCESS" 51 "ADDRUTS" 52 "ADDSOFTSHOULDERCAR" 53 "ADDSOFTSHOULDERLORRY" 54 "VADDSIGN" 55 "VADDCAR" 56 "VADDLORRY" 57 "VADDTRAILER" 58 "VADDCARAVAN" 59 "VADDBUS" 60 "VADDWET" 61 "VADDFOG" 62 "VADDRAIN" 63 "VADDSNOW" 64 "VADDRAINSNOW" 65 "VADDTEXT" 66 "VADDSECTION" 67 "VADDDISTANCE" 68 "VADDWEIGHT" 69 "VADDZONE" 70 "VADDCRASHRISK" 71 "VADDACCIDENT" 72 "VADDJAM" 73 "VADDOILTRAIL" 74 "VADDGRAVEL" 75 "VADDDIRT" 76 "VADDROADDAMAGE" 77 "VADDRUTS" 78 "ADDNOSTOPSHOULDER" 79 "ADDTOWING" 80 "ADDSCHOOL" 81 "ADDNIGHT" 82 "ADDEND" 83 "ADDBEGINS" 84 "ADDWITHIN" 85 "ADDDISTANCEBARS" 86 "ADDMINIMUM" 87 "ADDADVICE" 88 "ADDACCESS" 89 "ADDALLWAY" 90 "ADDBUS_EXCEPT" 91 "ADDEXCEPTDELIVERY" 92 "ADDEXCEPTLOCAL" 93 "ADDFROG" 94 "ADDPRIOTURNL" 95 "ADDPRIOTURNR" 96 "ADDSTART" 97 "ADDSTOPIN" 98 "ADDEXIT" 99 "ADDHAZWATER" 100 "ADDDAY" 101 "ADDSL" 102 "ADDLORRYTRAILER" 103 "ADDLORRYSEMI" 104 "VADDLORRYTRAILER" 105 "VADDLORRYSEMI" 106 "ADDSLOW" 107 "ADDSL5" 108 "ADDSL10" 109 "ADDSL15" 110 "ADDSL20" 111 "ADDSL25" 112 "ADDSL30" 113 "ADDSL35" 114 "ADDSL40" 115 "ADDSL45" 116 "ADDSL50" 117 "ADDSL55" 118 "ADDSL60" 119 "ADDSL65" 120 "ADDSL70" 121 "ADDSL75" 122 "ADDSL80" 123 "ADDSL85" 124 "ADDSL90" 125 "ADDSL95" 126 "ADDSL100" 127 "ADDSL105" 128 "ADDSL110" 129 "ADDSL115" 130 "ADDSL120" 131 "ADDSL125" 132 "ADDSL130" 133 "ADDSL135" 134 "ADDSL140" 135 "ADDSL145" 136 "ADDSL150" 137 "ADDSL155" 138 "ADDSL160" 139 "ADDBIKEROAD" 140 "ADDLORRYTRAILER_EXCEPT" 141 "ADDLORRYSEMI_EXCEPT" 142 "Reserved142" 143 "Reserved143" 144 "Reserved144" 145 "Reserved145" 146 "Reserved146" 147 "Reserved147" 148 "Reserved148" 149 "Reserved149" 150 "Reserved150" 151 "Reserved151" 152 "Reserved152" 153 "Reserved153" 154 "Reserved154" 155 "Reserved155" 156 "Reserved156" 157 "Reserved157" 158 "Reserved158" 159 "Reserved159" 160 "Reserved160" 161 "Reserved161" 162 "Reserved162" 163 "Reserved163" 164 "Reserved164" 165 "Reserved165" 166 "Reserved166" 167 "Reserved167" 168 "Reserved168" 169 "Reserved169" ;
VAL_ 242 VFC_TS09_SupSign2Type 0 "UNKNOWN" 1 "ADDCAR" 2 "ADDLORRY" 3 "ADDTRAILER" 4 "ADDCARAVAN" 5 "ADDBUS" 6 "ADDTRACTOR" 7 "ADDMCYCLE" 8 "ADDLORRYBUSTRAILER_DEPRECATED" 9 "ADDLORRYBUS_DEPRECATED" 10 "ADDHAZMAT" 11 "ADDTANK" 12 "ADDTRAM" 13 "ADDWET" 14 "ADDFOG" 15 "ADDRAIN" 16 "ADDSNOW" 17 "ADDTIME" 18 "ADDSECTION" 19 "ADDDISTANCE" 20 "ADDWEIGHT" 21 "ADDEXITL" 22 "ADDEXITR" 23 "ADDLANES" 24 "ADDRADAR" 25 "ADDRAPPEL" 26 "ADDPRIOTURN" 27 "ADDLORRY_EXCEPT" 28 "ADDTRACTOR_OVER" 29 "ADDTEXT" 30 "ADDSIGN" 31 "ADDRAINSNOW" 32 "ADDHUMP" 33 "VADDLORRYBUSTRAILER_DEPRECATED" 34 "VADDLORRYBUS_DEPRECATED" 35 "VADDLORRYTRAILER_DEPRECATED" 36 "ADDLORRYTRAILER_DEPRECATED" 37 "ADDCAMPER" 38 "ADDZONE" 39 "ADDCRASHRISK" 40 "ADDACCIDENT" 41 "ADDJAM" 42 "ADDSMOKE" 43 "ADDOILTRAIL" 44 "ADDGRAVEL" 45 "ADDDIRT" 46 "ADDRWORKSEXIT" 47 "ADDROADDAMAGE" 48 "ADDRWORKSENTRY" 49 "ADDLOWTREE" 50 "ADDRWORKSACCESS" 51 "ADDRUTS" 52 "ADDSOFTSHOULDERCAR" 53 "ADDSOFTSHOULDERLORRY" 54 "VADDSIGN" 55 "VADDCAR" 56 "VADDLORRY" 57 "VADDTRAILER" 58 "VADDCARAVAN" 59 "VADDBUS" 60 "VADDWET" 61 "VADDFOG" 62 "VADDRAIN" 63 "VADDSNOW" 64 "VADDRAINSNOW" 65 "VADDTEXT" 66 "VADDSECTION" 67 "VADDDISTANCE" 68 "VADDWEIGHT" 69 "VADDZONE" 70 "VADDCRASHRISK" 71 "VADDACCIDENT" 72 "VADDJAM" 73 "VADDOILTRAIL" 74 "VADDGRAVEL" 75 "VADDDIRT" 76 "VADDROADDAMAGE" 77 "VADDRUTS" 78 "ADDNOSTOPSHOULDER" 79 "ADDTOWING" 80 "ADDSCHOOL" 81 "ADDNIGHT" 82 "ADDEND" 83 "ADDBEGINS" 84 "ADDWITHIN" 85 "ADDDISTANCEBARS" 86 "ADDMINIMUM" 87 "ADDADVICE" 88 "ADDACCESS" 89 "ADDALLWAY" 90 "ADDBUS_EXCEPT" 91 "ADDEXCEPTDELIVERY" 92 "ADDEXCEPTLOCAL" 93 "ADDFROG" 94 "ADDPRIOTURNL" 95 "ADDPRIOTURNR" 96 "ADDSTART" 97 "ADDSTOPIN" 98 "ADDEXIT" 99 "ADDHAZWATER" 100 "ADDDAY" 101 "ADDSL" 102 "ADDLORRYTRAILER" 103 "ADDLORRYSEMI" 104 "VADDLORRYTRAILER" 105 "VADDLORRYSEMI" 106 "ADDSLOW" 107 "ADDSL5" 108 "ADDSL10" 109 "ADDSL15" 110 "ADDSL20" 111 "ADDSL25" 112 "ADDSL30" 113 "ADDSL35" 114 "ADDSL40" 115 "ADDSL45" 116 "ADDSL50" 117 "ADDSL55" 118 "ADDSL60" 119 "ADDSL65" 120 "ADDSL70" 121 "ADDSL75" 122 "ADDSL80" 123 "ADDSL85" 124 "ADDSL90" 125 "ADDSL95" 126 "ADDSL100" 127 "ADDSL105" 128 "ADDSL110" 129 "ADDSL115" 130 "ADDSL120" 131 "ADDSL125" 132 "ADDSL130" 133 "ADDSL135" 134 "ADDSL140" 135 "ADDSL145" 136 "ADDSL150" 137 "ADDSL155" 138 "ADDSL160" 139 "ADDBIKEROAD" 140 "ADDLORRYTRAILER_EXCEPT" 141 "ADDLORRYSEMI_EXCEPT" 142 "Reserved142" 143 "Reserved143" 144 "Reserved144" 145 "Reserved145" 146 "Reserved146" 147 "Reserved147" 148 "Reserved148" 149 "Reserved149" 150 "Reserved150" 151 "Reserved151" 152 "Reserved152" 153 "Reserved153" 154 "Reserved154" 155 "Reserved155" 156 "Reserved156" 157 "Reserved157" 158 "Reserved158" 159 "Reserved159" 160 "Reserved160" 161 "Reserved161" 162 "Reserved162" 163 "Reserved163" 164 "Reserved164" 165 "Reserved165" 166 "Reserved166" 167 "Reserved167" 168 "Reserved168" 169 "Reserved169" ;
VAL_ 242 VFC_TS09_SupSign3Type 0 "UNKNOWN" 1 "ADDCAR" 2 "ADDLORRY" 3 "ADDTRAILER" 4 "ADDCARAVAN" 5 "ADDBUS" 6 "ADDTRACTOR" 7 "ADDMCYCLE" 8 "ADDLORRYBUSTRAILER_DEPRECATED" 9 "ADDLORRYBUS_DEPRECATED" 10 "ADDHAZMAT" 11 "ADDTANK" 12 "ADDTRAM" 13 "ADDWET" 14 "ADDFOG" 15 "ADDRAIN" 16 "ADDSNOW" 17 "ADDTIME" 18 "ADDSECTION" 19 "ADDDISTANCE" 20 "ADDWEIGHT" 21 "ADDEXITL" 22 "ADDEXITR" 23 "ADDLANES" 24 "ADDRADAR" 25 "ADDRAPPEL" 26 "ADDPRIOTURN" 27 "ADDLORRY_EXCEPT" 28 "ADDTRACTOR_OVER" 29 "ADDTEXT" 30 "ADDSIGN" 31 "ADDRAINSNOW" 32 "ADDHUMP" 33 "VADDLORRYBUSTRAILER_DEPRECATED" 34 "VADDLORRYBUS_DEPRECATED" 35 "VADDLORRYTRAILER_DEPRECATED" 36 "ADDLORRYTRAILER_DEPRECATED" 37 "ADDCAMPER" 38 "ADDZONE" 39 "ADDCRASHRISK" 40 "ADDACCIDENT" 41 "ADDJAM" 42 "ADDSMOKE" 43 "ADDOILTRAIL" 44 "ADDGRAVEL" 45 "ADDDIRT" 46 "ADDRWORKSEXIT" 47 "ADDROADDAMAGE" 48 "ADDRWORKSENTRY" 49 "ADDLOWTREE" 50 "ADDRWORKSACCESS" 51 "ADDRUTS" 52 "ADDSOFTSHOULDERCAR" 53 "ADDSOFTSHOULDERLORRY" 54 "VADDSIGN" 55 "VADDCAR" 56 "VADDLORRY" 57 "VADDTRAILER" 58 "VADDCARAVAN" 59 "VADDBUS" 60 "VADDWET" 61 "VADDFOG" 62 "VADDRAIN" 63 "VADDSNOW" 64 "VADDRAINSNOW" 65 "VADDTEXT" 66 "VADDSECTION" 67 "VADDDISTANCE" 68 "VADDWEIGHT" 69 "VADDZONE" 70 "VADDCRASHRISK" 71 "VADDACCIDENT" 72 "VADDJAM" 73 "VADDOILTRAIL" 74 "VADDGRAVEL" 75 "VADDDIRT" 76 "VADDROADDAMAGE" 77 "VADDRUTS" 78 "ADDNOSTOPSHOULDER" 79 "ADDTOWING" 80 "ADDSCHOOL" 81 "ADDNIGHT" 82 "ADDEND" 83 "ADDBEGINS" 84 "ADDWITHIN" 85 "ADDDISTANCEBARS" 86 "ADDMINIMUM" 87 "ADDADVICE" 88 "ADDACCESS" 89 "ADDALLWAY" 90 "ADDBUS_EXCEPT" 91 "ADDEXCEPTDELIVERY" 92 "ADDEXCEPTLOCAL" 93 "ADDFROG" 94 "ADDPRIOTURNL" 95 "ADDPRIOTURNR" 96 "ADDSTART" 97 "ADDSTOPIN" 98 "ADDEXIT" 99 "ADDHAZWATER" 100 "ADDDAY" 101 "ADDSL" 102 "ADDLORRYTRAILER" 103 "ADDLORRYSEMI" 104 "VADDLORRYTRAILER" 105 "VADDLORRYSEMI" 106 "ADDSLOW" 107 "ADDSL5" 108 "ADDSL10" 109 "ADDSL15" 110 "ADDSL20" 111 "ADDSL25" 112 "ADDSL30" 113 "ADDSL35" 114 "ADDSL40" 115 "ADDSL45" 116 "ADDSL50" 117 "ADDSL55" 118 "ADDSL60" 119 "ADDSL65" 120 "ADDSL70" 121 "ADDSL75" 122 "ADDSL80" 123 "ADDSL85" 124 "ADDSL90" 125 "ADDSL95" 126 "ADDSL100" 127 "ADDSL105" 128 "ADDSL110" 129 "ADDSL115" 130 "ADDSL120" 131 "ADDSL125" 132 "ADDSL130" 133 "ADDSL135" 134 "ADDSL140" 135 "ADDSL145" 136 "ADDSL150" 137 "ADDSL155" 138 "ADDSL160" 139 "ADDBIKEROAD" 140 "ADDLORRYTRAILER_EXCEPT" 141 "ADDLORRYSEMI_EXCEPT" 142 "Reserved142" 143 "Reserved143" 144 "Reserved144" 145 "Reserved145" 146 "Reserved146" 147 "Reserved147" 148 "Reserved148" 149 "Reserved149" 150 "Reserved150" 151 "Reserved151" 152 "Reserved152" 153 "Reserved153" 154 "Reserved154" 155 "Reserved155" 156 "Reserved156" 157 "Reserved157" 158 "Reserved158" 159 "Reserved159" 160 "Reserved160" 161 "Reserved161" 162 "Reserved162" 163 "Reserved163" 164 "Reserved164" 165 "Reserved165" 166 "Reserved166" 167 "Reserved167" 168 "Reserved168" 169 "Reserved169" ;
VAL_ 242 VFC_TS09_SupSign4Type 0 "UNKNOWN" 1 "ADDCAR" 2 "ADDLORRY" 3 "ADDTRAILER" 4 "ADDCARAVAN" 5 "ADDBUS" 6 "ADDTRACTOR" 7 "ADDMCYCLE" 8 "ADDLORRYBUSTRAILER_DEPRECATED" 9 "ADDLORRYBUS_DEPRECATED" 10 "ADDHAZMAT" 11 "ADDTANK" 12 "ADDTRAM" 13 "ADDWET" 14 "ADDFOG" 15 "ADDRAIN" 16 "ADDSNOW" 17 "ADDTIME" 18 "ADDSECTION" 19 "ADDDISTANCE" 20 "ADDWEIGHT" 21 "ADDEXITL" 22 "ADDEXITR" 23 "ADDLANES" 24 "ADDRADAR" 25 "ADDRAPPEL" 26 "ADDPRIOTURN" 27 "ADDLORRY_EXCEPT" 28 "ADDTRACTOR_OVER" 29 "ADDTEXT" 30 "ADDSIGN" 31 "ADDRAINSNOW" 32 "ADDHUMP" 33 "VADDLORRYBUSTRAILER_DEPRECATED" 34 "VADDLORRYBUS_DEPRECATED" 35 "VADDLORRYTRAILER_DEPRECATED" 36 "ADDLORRYTRAILER_DEPRECATED" 37 "ADDCAMPER" 38 "ADDZONE" 39 "ADDCRASHRISK" 40 "ADDACCIDENT" 41 "ADDJAM" 42 "ADDSMOKE" 43 "ADDOILTRAIL" 44 "ADDGRAVEL" 45 "ADDDIRT" 46 "ADDRWORKSEXIT" 47 "ADDROADDAMAGE" 48 "ADDRWORKSENTRY" 49 "ADDLOWTREE" 50 "ADDRWORKSACCESS" 51 "ADDRUTS" 52 "ADDSOFTSHOULDERCAR" 53 "ADDSOFTSHOULDERLORRY" 54 "VADDSIGN" 55 "VADDCAR" 56 "VADDLORRY" 57 "VADDTRAILER" 58 "VADDCARAVAN" 59 "VADDBUS" 60 "VADDWET" 61 "VADDFOG" 62 "VADDRAIN" 63 "VADDSNOW" 64 "VADDRAINSNOW" 65 "VADDTEXT" 66 "VADDSECTION" 67 "VADDDISTANCE" 68 "VADDWEIGHT" 69 "VADDZONE" 70 "VADDCRASHRISK" 71 "VADDACCIDENT" 72 "VADDJAM" 73 "VADDOILTRAIL" 74 "VADDGRAVEL" 75 "VADDDIRT" 76 "VADDROADDAMAGE" 77 "VADDRUTS" 78 "ADDNOSTOPSHOULDER" 79 "ADDTOWING" 80 "ADDSCHOOL" 81 "ADDNIGHT" 82 "ADDEND" 83 "ADDBEGINS" 84 "ADDWITHIN" 85 "ADDDISTANCEBARS" 86 "ADDMINIMUM" 87 "ADDADVICE" 88 "ADDACCESS" 89 "ADDALLWAY" 90 "ADDBUS_EXCEPT" 91 "ADDEXCEPTDELIVERY" 92 "ADDEXCEPTLOCAL" 93 "ADDFROG" 94 "ADDPRIOTURNL" 95 "ADDPRIOTURNR" 96 "ADDSTART" 97 "ADDSTOPIN" 98 "ADDEXIT" 99 "ADDHAZWATER" 100 "ADDDAY" 101 "ADDSL" 102 "ADDLORRYTRAILER" 103 "ADDLORRYSEMI" 104 "VADDLORRYTRAILER" 105 "VADDLORRYSEMI" 106 "ADDSLOW" 107 "ADDSL5" 108 "ADDSL10" 109 "ADDSL15" 110 "ADDSL20" 111 "ADDSL25" 112 "ADDSL30" 113 "ADDSL35" 114 "ADDSL40" 115 "ADDSL45" 116 "ADDSL50" 117 "ADDSL55" 118 "ADDSL60" 119 "ADDSL65" 120 "ADDSL70" 121 "ADDSL75" 122 "ADDSL80" 123 "ADDSL85" 124 "ADDSL90" 125 "ADDSL95" 126 "ADDSL100" 127 "ADDSL105" 128 "ADDSL110" 129 "ADDSL115" 130 "ADDSL120" 131 "ADDSL125" 132 "ADDSL130" 133 "ADDSL135" 134 "ADDSL140" 135 "ADDSL145" 136 "ADDSL150" 137 "ADDSL155" 138 "ADDSL160" 139 "ADDBIKEROAD" 140 "ADDLORRYTRAILER_EXCEPT" 141 "ADDLORRYSEMI_EXCEPT" 142 "Reserved142" 143 "Reserved143" 144 "Reserved144" 145 "Reserved145" 146 "Reserved146" 147 "Reserved147" 148 "Reserved148" 149 "Reserved149" 150 "Reserved150" 151 "Reserved151" 152 "Reserved152" 153 "Reserved153" 154 "Reserved154" 155 "Reserved155" 156 "Reserved156" 157 "Reserved157" 158 "Reserved158" 159 "Reserved159" 160 "Reserved160" 161 "Reserved161" 162 "Reserved162" 163 "Reserved163" 164 "Reserved164" 165 "Reserved165" 166 "Reserved166" 167 "Reserved167" 168 "Reserved168" 169 "Reserved169" ;
VAL_ 242 VFC_TS09_SupSign5Type 0 "UNKNOWN" 1 "ADDCAR" 2 "ADDLORRY" 3 "ADDTRAILER" 4 "ADDCARAVAN" 5 "ADDBUS" 6 "ADDTRACTOR" 7 "ADDMCYCLE" 8 "ADDLORRYBUSTRAILER_DEPRECATED" 9 "ADDLORRYBUS_DEPRECATED" 10 "ADDHAZMAT" 11 "ADDTANK" 12 "ADDTRAM" 13 "ADDWET" 14 "ADDFOG" 15 "ADDRAIN" 16 "ADDSNOW" 17 "ADDTIME" 18 "ADDSECTION" 19 "ADDDISTANCE" 20 "ADDWEIGHT" 21 "ADDEXITL" 22 "ADDEXITR" 23 "ADDLANES" 24 "ADDRADAR" 25 "ADDRAPPEL" 26 "ADDPRIOTURN" 27 "ADDLORRY_EXCEPT" 28 "ADDTRACTOR_OVER" 29 "ADDTEXT" 30 "ADDSIGN" 31 "ADDRAINSNOW" 32 "ADDHUMP" 33 "VADDLORRYBUSTRAILER_DEPRECATED" 34 "VADDLORRYBUS_DEPRECATED" 35 "VADDLORRYTRAILER_DEPRECATED" 36 "ADDLORRYTRAILER_DEPRECATED" 37 "ADDCAMPER" 38 "ADDZONE" 39 "ADDCRASHRISK" 40 "ADDACCIDENT" 41 "ADDJAM" 42 "ADDSMOKE" 43 "ADDOILTRAIL" 44 "ADDGRAVEL" 45 "ADDDIRT" 46 "ADDRWORKSEXIT" 47 "ADDROADDAMAGE" 48 "ADDRWORKSENTRY" 49 "ADDLOWTREE" 50 "ADDRWORKSACCESS" 51 "ADDRUTS" 52 "ADDSOFTSHOULDERCAR" 53 "ADDSOFTSHOULDERLORRY" 54 "VADDSIGN" 55 "VADDCAR" 56 "VADDLORRY" 57 "VADDTRAILER" 58 "VADDCARAVAN" 59 "VADDBUS" 60 "VADDWET" 61 "VADDFOG" 62 "VADDRAIN" 63 "VADDSNOW" 64 "VADDRAINSNOW" 65 "VADDTEXT" 66 "VADDSECTION" 67 "VADDDISTANCE" 68 "VADDWEIGHT" 69 "VADDZONE" 70 "VADDCRASHRISK" 71 "VADDACCIDENT" 72 "VADDJAM" 73 "VADDOILTRAIL" 74 "VADDGRAVEL" 75 "VADDDIRT" 76 "VADDROADDAMAGE" 77 "VADDRUTS" 78 "ADDNOSTOPSHOULDER" 79 "ADDTOWING" 80 "ADDSCHOOL" 81 "ADDNIGHT" 82 "ADDEND" 83 "ADDBEGINS" 84 "ADDWITHIN" 85 "ADDDISTANCEBARS" 86 "ADDMINIMUM" 87 "ADDADVICE" 88 "ADDACCESS" 89 "ADDALLWAY" 90 "ADDBUS_EXCEPT" 91 "ADDEXCEPTDELIVERY" 92 "ADDEXCEPTLOCAL" 93 "ADDFROG" 94 "ADDPRIOTURNL" 95 "ADDPRIOTURNR" 96 "ADDSTART" 97 "ADDSTOPIN" 98 "ADDEXIT" 99 "ADDHAZWATER" 100 "ADDDAY" 101 "ADDSL" 102 "ADDLORRYTRAILER" 103 "ADDLORRYSEMI" 104 "VADDLORRYTRAILER" 105 "VADDLORRYSEMI" 106 "ADDSLOW" 107 "ADDSL5" 108 "ADDSL10" 109 "ADDSL15" 110 "ADDSL20" 111 "ADDSL25" 112 "ADDSL30" 113 "ADDSL35" 114 "ADDSL40" 115 "ADDSL45" 116 "ADDSL50" 117 "ADDSL55" 118 "ADDSL60" 119 "ADDSL65" 120 "ADDSL70" 121 "ADDSL75" 122 "ADDSL80" 123 "ADDSL85" 124 "ADDSL90" 125 "ADDSL95" 126 "ADDSL100" 127 "ADDSL105" 128 "ADDSL110" 129 "ADDSL115" 130 "ADDSL120" 131 "ADDSL125" 132 "ADDSL130" 133 "ADDSL135" 134 "ADDSL140" 135 "ADDSL145" 136 "ADDSL150" 137 "ADDSL155" 138 "ADDSL160" 139 "ADDBIKEROAD" 140 "ADDLORRYTRAILER_EXCEPT" 141 "ADDLORRYSEMI_EXCEPT" 142 "Reserved142" 143 "Reserved143" 144 "Reserved144" 145 "Reserved145" 146 "Reserved146" 147 "Reserved147" 148 "Reserved148" 149 "Reserved149" 150 "Reserved150" 151 "Reserved151" 152 "Reserved152" 153 "Reserved153" 154 "Reserved154" 155 "Reserved155" 156 "Reserved156" 157 "Reserved157" 158 "Reserved158" 159 "Reserved159" 160 "Reserved160" 161 "Reserved161" 162 "Reserved162" 163 "Reserved163" 164 "Reserved164" 165 "Reserved165" 166 "Reserved166" 167 "Reserved167" 168 "Reserved168" 169 "Reserved169" ;
SIG_GROUP_ 241 SG_VFC_TrafficSign_06_07 1 : VFC_TS_06_07_CRC VFC_TS_06_07_AliveCtr VFC_TS_06_07_ProtBlockCtr VFC_TS06_ObjId VFC_TS06_Type VFC_TS06_ExistProb VFC_TS06_Px VFC_TS06_Py VFC_TS06_Pz VFC_TS06_PxStdDev VFC_TS06_Width VFC_TS06_Height VFC_TS06_EmbeddedInfo VFC_TS06_ValidLane VFC_TS06_ValidDay VFC_TS06_ValidTimeRange1Start VFC_TS06_ValidTimeRange1End VFC_TS06_ValidTimeRange2Start VFC_TS06_ValidTimeRange2End VFC_TS06_ValidInDist VFC_TS06_ValidInDistUnit VFC_TS06_ValidSection VFC_TS06_ValidSectionUnit VFC_TS06_NumValidSupSigns VFC_TS06_SupSign0ExistProb VFC_TS06_SupSign1ExistProb VFC_TS06_SupSign2ExistProb VFC_TS06_SupSign3ExistProb VFC_TS06_SupSign4ExistProb VFC_TS06_SupSign5ExistProb VFC_TS06_SupSign0Type VFC_TS06_SupSign1Type VFC_TS06_SupSign2Type VFC_TS06_SupSign3Type VFC_TS06_SupSign4Type VFC_TS06_SupSign5Type VFC_TS07_ObjId VFC_TS07_Type VFC_TS07_ExistProb VFC_TS07_Px VFC_TS07_Py VFC_TS07_Pz VFC_TS07_PxStdDev VFC_TS07_Width VFC_TS07_Height VFC_TS07_EmbeddedInfo VFC_TS07_ValidLane VFC_TS07_ValidDay VFC_TS07_ValidTimeRange1Start VFC_TS07_ValidTimeRange1End VFC_TS07_ValidTimeRange2Start VFC_TS07_ValidTimeRange2End VFC_TS07_ValidInDist VFC_TS07_ValidInDistUnit VFC_TS07_ValidSection VFC_TS07_ValidSectionUnit VFC_TS07_NumValidSupSigns VFC_TS07_SupSign0ExistProb VFC_TS07_SupSign1ExistProb VFC_TS07_SupSign2ExistProb VFC_TS07_SupSign3ExistProb VFC_TS07_SupSign4ExistProb VFC_TS07_SupSign5ExistProb VFC_TS07_SupSign0Type VFC_TS07_SupSign1Type VFC_TS07_SupSign2Type VFC_TS07_SupSign3Type VFC_TS07_SupSign4Type VFC_TS07_SupSign5Type;
SIG_GROUP_ 242 SG_VFC_TrafficSign_08_09 1 : VFC_TS_08_09_CRC VFC_TS_08_09_AliveCtr VFC_TS_08_09_ProtBlockCtr VFC_TS08_ObjId VFC_TS08_Type VFC_TS08_ExistProb VFC_TS08_Px VFC_TS08_Py VFC_TS08_Pz VFC_TS08_PxStdDev VFC_TS08_Width VFC_TS08_Height VFC_TS08_EmbeddedInfo VFC_TS08_ValidLane VFC_TS08_ValidDay VFC_TS08_ValidTimeRange1Start VFC_TS08_ValidTimeRange1End VFC_TS08_ValidTimeRange2Start VFC_TS08_ValidTimeRange2End VFC_TS08_ValidInDist VFC_TS08_ValidInDistUnit VFC_TS08_ValidSection VFC_TS08_ValidSectionUnit VFC_TS08_NumValidSupSigns VFC_TS08_SupSign0ExistProb VFC_TS08_SupSign1ExistProb VFC_TS08_SupSign2ExistProb VFC_TS08_SupSign3ExistProb VFC_TS08_SupSign4ExistProb VFC_TS08_SupSign5ExistProb VFC_TS08_SupSign0Type VFC_TS08_SupSign1Type VFC_TS08_SupSign2Type VFC_TS08_SupSign3Type VFC_TS08_SupSign4Type VFC_TS08_SupSign5Type VFC_TS09_ObjId VFC_TS09_Type VFC_TS09_ExistProb VFC_TS09_Px VFC_TS09_Py VFC_TS09_Pz VFC_TS09_PxStdDev VFC_TS09_Width VFC_TS09_Height VFC_TS09_EmbeddedInfo VFC_TS09_ValidLane VFC_TS09_ValidDay VFC_TS09_ValidTimeRange1Start VFC_TS09_ValidTimeRange1End VFC_TS09_ValidTimeRange2Start VFC_TS09_ValidTimeRange2End VFC_TS09_ValidInDist VFC_TS09_ValidInDistUnit VFC_TS09_ValidSection VFC_TS09_ValidSectionUnit VFC_TS09_NumValidSupSigns VFC_TS09_SupSign0ExistProb VFC_TS09_SupSign1ExistProb VFC_TS09_SupSign2ExistProb VFC_TS09_SupSign3ExistProb VFC_TS09_SupSign4ExistProb VFC_TS09_SupSign5ExistProb VFC_TS09_SupSign0Type VFC_TS09_SupSign1Type VFC_TS09_SupSign2Type VFC_TS09_SupSign3Type VFC_TS09_SupSign4Type VFC_TS09_SupSign5Type;
