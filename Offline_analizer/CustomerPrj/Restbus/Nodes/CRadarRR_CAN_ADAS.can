/*@!Encoding:1252*/
/**
 * @file CRadarRR_CAN_ADAS.can
 * @author ADAS_HIL_TEAM
 * @date 10-04-2022
 * @brief 
 *
 * ################################################################
 * C O P Y R I G H T S
 * ----------------------------------------------------------------
 * Copyright (c) 2022-2023 by Robert Bosch GmbH. All rights reserved.
 
 * The reproduction, distribution and utilization of this file as
 * well as the communication of its contents to others without express
 * authorization is prohibited. Offenders will be held liable for the
 * payment of damages. All rights reserved in the event of the grant
 * of a patent, utility model or design.
 *
 * ################################################################
*/

// Autogenerated by -> Platform\Classe\Scripts\Rbs_Scripts\create_nodes.py
includes
{
  #pragma library ("C:\ProgramData\Vector\AddOn Packages\Vector AddOn\vModules\CANoeILNLVector.vmodule")
  #include "CAPL\DataHandling.cin" /*DataHandling for IL*/
  #include "CAPL\E2E.cin" /*OD Specific for CRC calculation */
}

variables {

}

on preStart {
  long result;
  result=ILControlInit ();//Initialization of CANoe IL,to prevent the IL autostart function.
  switch(result)
  {
    case  0   : write("ILControlInit :: CRadarRR :: No error."); break;
    case -1   : write("ILControlInit :: CRadarRR :: Momentary state of the IL does not permit this query."); break;
    case -50  : write("ILControlInit :: CRadarRR :: Nodelayer is inactive - possibly deactivated in the nodes configuration dialog.");  break;
   }

  CRadarRR_sim_Disable();
  CRadarRR_sim_SetCycleTimeOffset();
}

on start {

  ILControlSimulationOn();//Starts the simulation of the IL.
  CRadarRR_sim_SetCANFDParameter();
  ILControlStart ();//Cyclical sending starts; setting signals is now possible.
  CRadarRR_sim_Reset();
}

on stopMeasurement {

  CRadarRR_sim_DisableMsg();
  CRadarRR_sim_Disable();
  ILControlStop();//Cyclical sending is stopped; setting signals is now no longer possible.
  ILControlSimulationOff();//Stops the simulation of the IL. After that no other function to control the IL has an effect to the IL.

}

on sysvar_update hil_ctrl::radar_rr_sim
{
  CRadarRR_sim_Reset();
}

on sysvar_update hil_ctrl::variant
{
  CRadarRR_sim_Reset();
}

on sysvar_update Cus_bus::bus_CAN_ADAS_ON_OFF
{
  CRadarRR_sim_Reset();
}

void CRadarRR_sim_Reset()
{

  CRadarRR_sim_DisableMsg();
  CRadarRR_sim_Disable();

  if ((@Cus_bus::bus_CAN_ADAS_ON_OFF == 1) && (@hil_ctrl::radar_rr_sim == 1))
  {
    switch(@hil_ctrl::variant)
    {
      case a_variant:CRadarRR_sim_start_a_variant();break;
      case b_variant:CRadarRR_sim_start_b_variant();break;
    }
    if (@hil_ctrl::hil_mode == @hil_ctrl::hil_mode::Restbus) 
    {
       CRadarRR_sim_EnableEventMsg();
    }
    else
    {
       CRadarRR_sim_DisableEventMsg();
    }
  }
}

void CRadarRR_sim_start_a_variant()
{
}

void CRadarRR_sim_start_b_variant()
{
}

void CRadarRR_sim_Disable()
{
}

void CRadarRR_sim_DisableMsg()
{
}
on sysvar hil_ctrl::hil_mode
{
  CRadarRR_sim_Reset();
}

void CRadarRR_sim_DisableEventMsg()
{

}

void CRadarRR_sim_EnableEventMsg()
{

}
void CRadarRR_sim_SetCANParameter()
{
  //For future purpose
  //ILFaultInjectionSetMsgDlc(dbMsg msg, dword dlc)
  //ILFaultInjectionSetMsgLength(dbMsg msg, dword msgLength)
  //ILFaultInjectionResetMsgDlc(dbMsg msg)
  //ILFaultInjectionResetMsgLength (dbMsg msg)
}

void CRadarRR_sim_SetCANFDParameter()
{
   //CAN FD Parameter Setting
   int FDF =1;
   int BRS =1;
}

dword applILTxPending (long aId, dword aDlc, byte data[])//This callback is being called before the IL sends a message to the bus
{
  switch(aId)
  {
    default :;//write("Node:CRadarRR ::No Cyclic event");
           break;
  }
  return 1; // don't prevent sending of the message
}

void CRadarRR_sim_SetCycleTimeOffset()
{

//  ILNodeSetPDUTimingCyclic (dbMsg dbMessage, long TrueOrFalse, long offset, long period, long disturbanceCount, long flags);
//  TrueOrFalse ; 0: denotes the False timing; 1: denotes the True timing; 3: denotes the True and the False timing.
//  offset :Defines the delay in [ms] from now when the first cyclic transmission will start.
//  period :Defines the period in [ms] for the cyclic transmission.
//  disturbanceCount :Reserved/unused; should be set to -1 (infinite).
//  flags :Reserved; should be set to 0.

}