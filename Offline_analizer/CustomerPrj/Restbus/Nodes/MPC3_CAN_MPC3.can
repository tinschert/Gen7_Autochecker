/*@!Encoding:1252*/
/**
 * @file MPC3_CAN_MPC3.can
 * @author ADAS_HIL_TEAM
 * @date 04-26-2023
 * @brief 
 *
 * ################################################################
 * C O P Y R I G H T S
 * ----------------------------------------------------------------
 * Copyright (c) 2023 by Robert Bosch GmbH. All rights reserved.
 
 * The reproduction, distribution and utilization of this file as
 * well as the communication of its contents to others without express
 * authorization is prohibited. Offenders will be held liable for the
 * payment of damages. All rights reserved in the event of the grant
 * of a patent, utility model or design.
 *
 * ################################################################
*/

// Autogenerated by -> Platform\Classe\Scripts\Rbs_Scripts\create_nodes.py
includes
{
  #pragma library ("C:\ProgramData\Vector\AddOn Packages\Vector AddOn\vModules\CANoeILNLVector.vmodule")
  #include "CAPL\DataHandling.cin" /*DataHandling for IL*/
  #include "CAPL\E2E.cin" /*OD Specific for CRC calculation */
}

variables {
  message Vehicle_CAN_01 Msg_Vehicle_CAN_01;
  message ABS_UN_PR_6 Msg_ABS_UN_PR_6;
  message Vehicle_CAN_09 Msg_Vehicle_CAN_09;
  message DADCA_UN_PR_3 Msg_DADCA_UN_PR_3;
  message ABS_UN_PR_GW_3 Msg_ABS_UN_PR_GW_3;
  message CHCM_FR_PR_GW_2_UN Msg_CHCM_FR_PR_GW_2_UN;
  message ABS_UN_PR_GW_2 Msg_ABS_UN_PR_GW_2;
  message GWM_UN_PR_1 Msg_GWM_UN_PR_1;
  message Vehicle_CAN_15 Msg_Vehicle_CAN_15;
  message Vehicle_CAN_17 Msg_Vehicle_CAN_17;
  message ABS_UN_PR_11 Msg_ABS_UN_PR_11;
  message Vehicle_CAN_21 Msg_Vehicle_CAN_21;
  message Vehicle_CAN_25 Msg_Vehicle_CAN_25;
  message Vehicle_CAN_29 Msg_Vehicle_CAN_29;
  message HCMB_PR_1 Msg_HCMB_PR_1;
  message Vehicle_CAN_31 Msg_Vehicle_CAN_31;
  message Vehicle_CAN_37 Msg_Vehicle_CAN_37;
  message IPC_PR_GW_5_UN Msg_IPC_PR_GW_5_UN;
  message Vehicle_CAN_41 Msg_Vehicle_CAN_41;
  message Vehicle_CAN_43 Msg_Vehicle_CAN_43;
  message Vehicle_CAN_47 Msg_Vehicle_CAN_47;
  message Vehicle_CAN_48 Msg_Vehicle_CAN_48;
  message VLC_01 Msg_VLC_01;
  message VLC_02 Msg_VLC_02;
  message ACC_01 Msg_ACC_01;
  message SignalGW_PR_1_UN Msg_SignalGW_PR_1_UN;
  message SignalGW_PR_3_UN Msg_SignalGW_PR_3_UN;
  message DADCA_UN_SP_5 Msg_DADCA_UN_SP_5;
  message IGM_PR_GW_7_UN Msg_IGM_PR_GW_7_UN;
  message GSR_ISA_CAN_RX_01 Msg_GSR_ISA_CAN_RX_01;
  message LHSWS_PR_GW_1_UN Msg_LHSWS_PR_GW_1_UN;
  message IMU_TX1 Msg_IMU_TX1;
  message IMU_TX2 Msg_IMU_TX2;
  message SignalGW_PR_4_UN Msg_SignalGW_PR_4_UN;
  message BCM_PR_GW_16_UN Msg_BCM_PR_GW_16_UN;
  message CHCM_FR_PR_GW_3_UN Msg_CHCM_FR_PR_GW_3_UN;
  message PSCM_FR_PR_GW_1_UN Msg_PSCM_FR_PR_GW_1_UN;
  message LANE_02 Msg_LANE_02;
  message LANE_05 Msg_LANE_05;
  message PSCM_FR_PR_GW_2_UN Msg_PSCM_FR_PR_GW_2_UN;
  message TPM_PR_GW_4 Msg_TPM_PR_GW_4;
  message PCM_FR_PR_PedalPos_UN Msg_PCM_FR_PR_PedalPos_UN;
  message AEB_01 Msg_AEB_01;
  message LIGHT_01 Msg_LIGHT_01;
  message VEHCONFIG_400UN_AS Msg_VEHCONFIG_400UN_AS;
  message Snapshot_Data Msg_Snapshot_Data;
  message RCM_FR_PR_TXID1_UN Msg_RCM_FR_PR_TXID1_UN;
  message RCM_FR_PR_TXID2_UN Msg_RCM_FR_PR_TXID2_UN;
  message TransmissionControl_A_GW_UN Msg_TransmissionControl_A_GW_UN;
  message SASM_FR_GW_1_UN Msg_SASM_FR_GW_1_UN;
  message DADCA_FR_PR_GW_4_UN Msg_DADCA_FR_PR_GW_4_UN;
  message HCMA_PR_1 Msg_HCMA_PR_1;
  message HCMA_PR_2 Msg_HCMA_PR_2;
  message DBC_Version Msg_DBC_Version;
  message PCM_FR_PR_Core_B_UN Msg_PCM_FR_PR_Core_B_UN;
  message ABS_UN_PR_4 Msg_ABS_UN_PR_4;
  message IGM_SP_GW_10_UN Msg_IGM_SP_GW_10_UN;
  message RCM_FR_PR_GW_1_UN Msg_RCM_FR_PR_GW_1_UN;
  message PCM_FR_PR_WhlTorqTgt_UN Msg_PCM_FR_PR_WhlTorqTgt_UN;
  message BCM_SP_GW_2_UN Msg_BCM_SP_GW_2_UN;
  message ABS_UN_PR_GW_5_1 Msg_ABS_UN_PR_GW_5_1;
  message ABS_UN_PR_GW_5_2 Msg_ABS_UN_PR_GW_5_2;
  message SignalGW_PR_6_UN Msg_SignalGW_PR_6_UN;
  message DADCA_UN_PR_GW_2 Msg_DADCA_UN_PR_GW_2;
  message DADCA_UN_PR_GW_3 Msg_DADCA_UN_PR_GW_3;
  message BCM_PR_GW_1_UN Msg_BCM_PR_GW_1_UN;

  word counter_Vehicle_CAN_09_Vehicle_CAN_09_Counter;
  word counter_ABS_UN_PR_GW_3_VehMovementCounter;
  word counter_ABS_UN_PR_GW_2_ABSAliveCounter;
  word counter_Vehicle_CAN_15_Vehicle_CAN_15_Counter;
  word counter_Vehicle_CAN_17_Vehicle_CAN_17_Counter;
  word counter_Vehicle_CAN_21_Vehicle_CAN_21_Counter;
  word counter_Vehicle_CAN_25_Vehicle_CAN_25_Counter;
  word counter_IPC_PR_GW_5_UN_IPCAliveCnt;
  word counter_PSCM_FR_PR_GW_1_UN_TorsionBarTorqueCtr;
  word counter_PSCM_FR_PR_GW_2_UN_ActRoadWheelAngleAC;
  word counter_PCM_FR_PR_PedalPos_UN_PedalPosProAliveCounter;
  word counter_RCM_FR_PR_TXID1_UN_MSG_CNT1;
  word counter_RCM_FR_PR_TXID2_UN_MSG_CNT2;
  word counter_TransmissionControl_A_GW_UN_TCMPosAliveCounter;
  word counter_SASM_FR_GW_1_UN_SteeringWheelAngMsgCnt;
  word counter_PCM_FR_PR_Core_B_UN_EMSAliveCounter;
  word counter_PCM_FR_PR_WhlTorqTgt_UN_WheelTorqTgtGpCounter;
  word counter_ABS_UN_PR_GW_5_1_WheelSpeedFrGpCounter;
  word counter_ABS_UN_PR_GW_5_2_WheelSpeedReGpCounter;
  word counter_DADCA_UN_PR_GW_2_RWSSysAliveCnt1;
  word counter_DADCA_UN_PR_GW_3_RWSSysAliveCnt2;

  byte crc_Vehicle_CAN_09_Vehicle_CAN_09_CRC;
  byte chksum_ABS_UN_PR_GW_3_VehMovementChecksum;
  byte chksum_ABS_UN_PR_GW_2_ABSChecksum;
  byte crc_Vehicle_CAN_15_Vehicle_CAN_15_CRC;
  byte crc_Vehicle_CAN_17_Vehicle_CAN_17_CRC;
  byte crc_Vehicle_CAN_21_Vehicle_CAN_21_CRC;
  byte crc_Vehicle_CAN_25_Vehicle_CAN_25_CRC;
  byte chksum_PSCM_FR_PR_GW_1_UN_TorsionBarTorqueCS;
  byte chksum_PSCM_FR_PR_GW_2_UN_ActRoadWheelAngleCS;
  byte chksum_PCM_FR_PR_PedalPos_UN_PedalPosProChecksum;
  byte chksum_RCM_FR_PR_TXID1_UN_CRC1;
  byte chksum_RCM_FR_PR_TXID2_UN_CRC2;
  byte chksum_TransmissionControl_A_GW_UN_TCMPosChecksum;
  byte chksum_SASM_FR_GW_1_UN_SteeringWheelAngleCS;
  byte chksum_PCM_FR_PR_Core_B_UN_EMSChecksum;
  byte chksum_PCM_FR_PR_WhlTorqTgt_UN_WheelTorqTgtGpCS;
  byte chksum_ABS_UN_PR_GW_5_1_WheelSpeedFrGpCS;
  byte chksum_ABS_UN_PR_GW_5_2_WheelSpeedReGpCS;
  byte chksum_DADCA_UN_PR_GW_2_RWSSysCS1;
  byte chksum_DADCA_UN_PR_GW_3_RWSSysCS2;

}

on preStart {
  long result;
  result=ILControlInit ();//Initialization of CANoe IL,to prevent the IL autostart function.
  switch(result)
  {
    case  0   : write("ILControlInit :: MPC3 :: No error."); break;
    case -1   : write("ILControlInit :: MPC3 :: Momentary state of the IL does not permit this query."); break;
    case -50  : write("ILControlInit :: MPC3 :: Nodelayer is inactive - possibly deactivated in the nodes configuration dialog.");  break;
   }

  MPC3_sim_Disable();
  MPC3_sim_SetCycleTimeOffset();
}

on start {

  ILControlSimulationOn();//Starts the simulation of the IL.
  MPC3_sim_SetCANParameter();
  ILControlStart ();//Cyclical sending starts; setting signals is now possible.
  MPC3_sim_Reset();
}

on stopMeasurement {

  MPC3_sim_DisableMsg();
  MPC3_sim_Disable();
  ILControlStop();//Cyclical sending is stopped; setting signals is now no longer possible.
  ILControlSimulationOff();//Stops the simulation of the IL. After that no other function to control the IL has an effect to the IL.

}

on sysvar_update hil_ctrl::mpc3_sim
{
  MPC3_sim_Reset();
}

on sysvar_update hil_ctrl::variant
{
  MPC3_sim_Reset();
}

on sysvar_update Cus_bus::bus_CAN_MPC3_ON_OFF
{
  MPC3_sim_Reset();
}

void MPC3_sim_Reset()
{

  MPC3_sim_DisableMsg();
  MPC3_sim_Disable();

  if ((@Cus_bus::bus_CAN_MPC3_ON_OFF == 1) && (@hil_ctrl::mpc3_sim == 1))
  {
    switch(@hil_ctrl::variant)
    {
      case a_variant:MPC3_sim_start_a_variant();break;
      case b_variant:MPC3_sim_start_b_variant();break;
    }
    if (@hil_ctrl::hil_mode == @hil_ctrl::hil_mode::Restbus) 
    {
       MPC3_sim_EnableEventMsg();
    }
    else
    {
       MPC3_sim_DisableEventMsg();
    }
  }
}

void MPC3_sim_start_a_variant()
{
  @CAN_MPC3::Vehicle_CAN_01::Vehicle_CAN_01_ON_OFF = 1;
  @CAN_MPC3::ABS_UN_PR_6::ABS_UN_PR_6_ON_OFF = 1;
  @CAN_MPC3::Vehicle_CAN_09::Vehicle_CAN_09_ON_OFF = 1;
  @CAN_MPC3::DADCA_UN_PR_3::DADCA_UN_PR_3_ON_OFF = 1;
  @CAN_MPC3::ABS_UN_PR_GW_3::ABS_UN_PR_GW_3_ON_OFF = 1;
  @CAN_MPC3::CHCM_FR_PR_GW_2_UN::CHCM_FR_PR_GW_2_UN_ON_OFF = 1;
  @CAN_MPC3::ABS_UN_PR_GW_2::ABS_UN_PR_GW_2_ON_OFF = 1;
  @CAN_MPC3::GWM_UN_PR_1::GWM_UN_PR_1_ON_OFF = 1;
  @CAN_MPC3::Vehicle_CAN_15::Vehicle_CAN_15_ON_OFF = 1;
  @CAN_MPC3::Vehicle_CAN_17::Vehicle_CAN_17_ON_OFF = 1;
  @CAN_MPC3::ABS_UN_PR_11::ABS_UN_PR_11_ON_OFF = 1;
  @CAN_MPC3::Vehicle_CAN_21::Vehicle_CAN_21_ON_OFF = 1;
  @CAN_MPC3::Vehicle_CAN_25::Vehicle_CAN_25_ON_OFF = 1;
  @CAN_MPC3::Vehicle_CAN_29::Vehicle_CAN_29_ON_OFF = 1;
  @CAN_MPC3::HCMB_PR_1::HCMB_PR_1_ON_OFF = 1;
  @CAN_MPC3::Vehicle_CAN_31::Vehicle_CAN_31_ON_OFF = 1;
  @CAN_MPC3::Vehicle_CAN_37::Vehicle_CAN_37_ON_OFF = 1;
  @CAN_MPC3::IPC_PR_GW_5_UN::IPC_PR_GW_5_UN_ON_OFF = 1;
  @CAN_MPC3::Vehicle_CAN_41::Vehicle_CAN_41_ON_OFF = 1;
  @CAN_MPC3::Vehicle_CAN_43::Vehicle_CAN_43_ON_OFF = 1;
  @CAN_MPC3::Vehicle_CAN_47::Vehicle_CAN_47_ON_OFF = 1;
  @CAN_MPC3::Vehicle_CAN_48::Vehicle_CAN_48_ON_OFF = 1;
  @CAN_MPC3::VLC_01::VLC_01_ON_OFF = 1;
  @CAN_MPC3::VLC_02::VLC_02_ON_OFF = 1;
  @CAN_MPC3::ACC_01::ACC_01_ON_OFF = 1;
  @CAN_MPC3::SignalGW_PR_1_UN::SignalGW_PR_1_UN_ON_OFF = 1;
  @CAN_MPC3::SignalGW_PR_3_UN::SignalGW_PR_3_UN_ON_OFF = 1;
  @CAN_MPC3::DADCA_UN_SP_5::DADCA_UN_SP_5_ON_OFF = 1;
  @CAN_MPC3::IGM_PR_GW_7_UN::IGM_PR_GW_7_UN_ON_OFF = 1;
  @CAN_MPC3::IMU_TX1::IMU_TX1_ON_OFF = 1;
  @CAN_MPC3::IMU_TX2::IMU_TX2_ON_OFF = 1;
  @CAN_MPC3::SignalGW_PR_4_UN::SignalGW_PR_4_UN_ON_OFF = 1;
  @CAN_MPC3::BCM_PR_GW_16_UN::BCM_PR_GW_16_UN_ON_OFF = 1;
  @CAN_MPC3::CHCM_FR_PR_GW_3_UN::CHCM_FR_PR_GW_3_UN_ON_OFF = 1;
  @CAN_MPC3::PSCM_FR_PR_GW_1_UN::PSCM_FR_PR_GW_1_UN_ON_OFF = 1;
  @CAN_MPC3::LANE_02::LANE_02_ON_OFF = 1;
  @CAN_MPC3::LANE_05::LANE_05_ON_OFF = 1;
  @CAN_MPC3::PSCM_FR_PR_GW_2_UN::PSCM_FR_PR_GW_2_UN_ON_OFF = 1;
  @CAN_MPC3::TPM_PR_GW_4::TPM_PR_GW_4_ON_OFF = 1;
  @CAN_MPC3::PCM_FR_PR_PedalPos_UN::PCM_FR_PR_PedalPos_UN_ON_OFF = 1;
  @CAN_MPC3::AEB_01::AEB_01_ON_OFF = 1;
  @CAN_MPC3::LIGHT_01::LIGHT_01_ON_OFF = 1;
  @CAN_MPC3::VEHCONFIG_400UN_AS::VEHCONFIG_400UN_AS_ON_OFF = 1;
  @CAN_MPC3::RCM_FR_PR_TXID1_UN::RCM_FR_PR_TXID1_UN_ON_OFF = 1;
  @CAN_MPC3::RCM_FR_PR_TXID2_UN::RCM_FR_PR_TXID2_UN_ON_OFF = 1;
  @CAN_MPC3::TransmissionControl_A_GW_UN::TransmissionControl_A_GW_UN_ON_OFF = 1;
  @CAN_MPC3::SASM_FR_GW_1_UN::SASM_FR_GW_1_UN_ON_OFF = 1;
  @CAN_MPC3::DADCA_FR_PR_GW_4_UN::DADCA_FR_PR_GW_4_UN_ON_OFF = 1;
  @CAN_MPC3::HCMA_PR_1::HCMA_PR_1_ON_OFF = 1;
  @CAN_MPC3::HCMA_PR_2::HCMA_PR_2_ON_OFF = 1;
  @CAN_MPC3::DBC_Version::DBC_Version_ON_OFF = 1;
  @CAN_MPC3::PCM_FR_PR_Core_B_UN::PCM_FR_PR_Core_B_UN_ON_OFF = 1;
  @CAN_MPC3::ABS_UN_PR_4::ABS_UN_PR_4_ON_OFF = 1;
  @CAN_MPC3::IGM_SP_GW_10_UN::IGM_SP_GW_10_UN_ON_OFF = 1;
  @CAN_MPC3::RCM_FR_PR_GW_1_UN::RCM_FR_PR_GW_1_UN_ON_OFF = 1;
  @CAN_MPC3::PCM_FR_PR_WhlTorqTgt_UN::PCM_FR_PR_WhlTorqTgt_UN_ON_OFF = 1;
  @CAN_MPC3::BCM_SP_GW_2_UN::BCM_SP_GW_2_UN_ON_OFF = 1;
  @CAN_MPC3::ABS_UN_PR_GW_5_1::ABS_UN_PR_GW_5_1_ON_OFF = 1;
  @CAN_MPC3::ABS_UN_PR_GW_5_2::ABS_UN_PR_GW_5_2_ON_OFF = 1;
  @CAN_MPC3::SignalGW_PR_6_UN::SignalGW_PR_6_UN_ON_OFF = 1;
  @CAN_MPC3::DADCA_UN_PR_GW_2::DADCA_UN_PR_GW_2_ON_OFF = 1;
  @CAN_MPC3::DADCA_UN_PR_GW_3::DADCA_UN_PR_GW_3_ON_OFF = 1;
  @CAN_MPC3::BCM_PR_GW_1_UN::BCM_PR_GW_1_UN_ON_OFF = 1;
}

void MPC3_sim_start_b_variant()
{
  @CAN_MPC3::Vehicle_CAN_01::Vehicle_CAN_01_ON_OFF = 1;
  @CAN_MPC3::ABS_UN_PR_6::ABS_UN_PR_6_ON_OFF = 1;
  @CAN_MPC3::Vehicle_CAN_09::Vehicle_CAN_09_ON_OFF = 1;
  @CAN_MPC3::DADCA_UN_PR_3::DADCA_UN_PR_3_ON_OFF = 1;
  @CAN_MPC3::ABS_UN_PR_GW_3::ABS_UN_PR_GW_3_ON_OFF = 1;
  @CAN_MPC3::CHCM_FR_PR_GW_2_UN::CHCM_FR_PR_GW_2_UN_ON_OFF = 1;
  @CAN_MPC3::ABS_UN_PR_GW_2::ABS_UN_PR_GW_2_ON_OFF = 1;
  @CAN_MPC3::GWM_UN_PR_1::GWM_UN_PR_1_ON_OFF = 1;
  @CAN_MPC3::Vehicle_CAN_15::Vehicle_CAN_15_ON_OFF = 1;
  @CAN_MPC3::Vehicle_CAN_17::Vehicle_CAN_17_ON_OFF = 1;
  @CAN_MPC3::ABS_UN_PR_11::ABS_UN_PR_11_ON_OFF = 1;
  @CAN_MPC3::Vehicle_CAN_21::Vehicle_CAN_21_ON_OFF = 1;
  @CAN_MPC3::Vehicle_CAN_25::Vehicle_CAN_25_ON_OFF = 1;
  @CAN_MPC3::Vehicle_CAN_29::Vehicle_CAN_29_ON_OFF = 1;
  @CAN_MPC3::HCMB_PR_1::HCMB_PR_1_ON_OFF = 1;
  @CAN_MPC3::Vehicle_CAN_31::Vehicle_CAN_31_ON_OFF = 1;
  @CAN_MPC3::Vehicle_CAN_37::Vehicle_CAN_37_ON_OFF = 1;
  @CAN_MPC3::IPC_PR_GW_5_UN::IPC_PR_GW_5_UN_ON_OFF = 1;
  @CAN_MPC3::Vehicle_CAN_41::Vehicle_CAN_41_ON_OFF = 1;
  @CAN_MPC3::Vehicle_CAN_43::Vehicle_CAN_43_ON_OFF = 1;
  @CAN_MPC3::Vehicle_CAN_47::Vehicle_CAN_47_ON_OFF = 1;
  @CAN_MPC3::Vehicle_CAN_48::Vehicle_CAN_48_ON_OFF = 1;
  @CAN_MPC3::VLC_01::VLC_01_ON_OFF = 1;
  @CAN_MPC3::VLC_02::VLC_02_ON_OFF = 1;
  @CAN_MPC3::ACC_01::ACC_01_ON_OFF = 1;
  @CAN_MPC3::SignalGW_PR_1_UN::SignalGW_PR_1_UN_ON_OFF = 1;
  @CAN_MPC3::SignalGW_PR_3_UN::SignalGW_PR_3_UN_ON_OFF = 1;
  @CAN_MPC3::DADCA_UN_SP_5::DADCA_UN_SP_5_ON_OFF = 1;
  @CAN_MPC3::IGM_PR_GW_7_UN::IGM_PR_GW_7_UN_ON_OFF = 1;
  @CAN_MPC3::IMU_TX1::IMU_TX1_ON_OFF = 1;
  @CAN_MPC3::IMU_TX2::IMU_TX2_ON_OFF = 1;
  @CAN_MPC3::SignalGW_PR_4_UN::SignalGW_PR_4_UN_ON_OFF = 1;
  @CAN_MPC3::BCM_PR_GW_16_UN::BCM_PR_GW_16_UN_ON_OFF = 1;
  @CAN_MPC3::CHCM_FR_PR_GW_3_UN::CHCM_FR_PR_GW_3_UN_ON_OFF = 1;
  @CAN_MPC3::PSCM_FR_PR_GW_1_UN::PSCM_FR_PR_GW_1_UN_ON_OFF = 1;
  @CAN_MPC3::LANE_02::LANE_02_ON_OFF = 1;
  @CAN_MPC3::LANE_05::LANE_05_ON_OFF = 1;
  @CAN_MPC3::PSCM_FR_PR_GW_2_UN::PSCM_FR_PR_GW_2_UN_ON_OFF = 1;
  @CAN_MPC3::TPM_PR_GW_4::TPM_PR_GW_4_ON_OFF = 1;
  @CAN_MPC3::PCM_FR_PR_PedalPos_UN::PCM_FR_PR_PedalPos_UN_ON_OFF = 1;
  @CAN_MPC3::AEB_01::AEB_01_ON_OFF = 1;
  @CAN_MPC3::LIGHT_01::LIGHT_01_ON_OFF = 1;
  @CAN_MPC3::VEHCONFIG_400UN_AS::VEHCONFIG_400UN_AS_ON_OFF = 1;
  @CAN_MPC3::RCM_FR_PR_TXID1_UN::RCM_FR_PR_TXID1_UN_ON_OFF = 1;
  @CAN_MPC3::RCM_FR_PR_TXID2_UN::RCM_FR_PR_TXID2_UN_ON_OFF = 1;
  @CAN_MPC3::TransmissionControl_A_GW_UN::TransmissionControl_A_GW_UN_ON_OFF = 1;
  @CAN_MPC3::SASM_FR_GW_1_UN::SASM_FR_GW_1_UN_ON_OFF = 1;
  @CAN_MPC3::DADCA_FR_PR_GW_4_UN::DADCA_FR_PR_GW_4_UN_ON_OFF = 1;
  @CAN_MPC3::HCMA_PR_1::HCMA_PR_1_ON_OFF = 1;
  @CAN_MPC3::HCMA_PR_2::HCMA_PR_2_ON_OFF = 1;
  @CAN_MPC3::DBC_Version::DBC_Version_ON_OFF = 1;
  @CAN_MPC3::PCM_FR_PR_Core_B_UN::PCM_FR_PR_Core_B_UN_ON_OFF = 1;
  @CAN_MPC3::ABS_UN_PR_4::ABS_UN_PR_4_ON_OFF = 1;
  @CAN_MPC3::IGM_SP_GW_10_UN::IGM_SP_GW_10_UN_ON_OFF = 1;
  @CAN_MPC3::RCM_FR_PR_GW_1_UN::RCM_FR_PR_GW_1_UN_ON_OFF = 1;
  @CAN_MPC3::PCM_FR_PR_WhlTorqTgt_UN::PCM_FR_PR_WhlTorqTgt_UN_ON_OFF = 1;
  @CAN_MPC3::BCM_SP_GW_2_UN::BCM_SP_GW_2_UN_ON_OFF = 1;
  @CAN_MPC3::ABS_UN_PR_GW_5_1::ABS_UN_PR_GW_5_1_ON_OFF = 1;
  @CAN_MPC3::ABS_UN_PR_GW_5_2::ABS_UN_PR_GW_5_2_ON_OFF = 1;
  @CAN_MPC3::SignalGW_PR_6_UN::SignalGW_PR_6_UN_ON_OFF = 1;
  @CAN_MPC3::DADCA_UN_PR_GW_2::DADCA_UN_PR_GW_2_ON_OFF = 1;
  @CAN_MPC3::DADCA_UN_PR_GW_3::DADCA_UN_PR_GW_3_ON_OFF = 1;
  @CAN_MPC3::BCM_PR_GW_1_UN::BCM_PR_GW_1_UN_ON_OFF = 1;
}

void MPC3_sim_Disable()
{
  @CAN_MPC3::Vehicle_CAN_01::Vehicle_CAN_01_ON_OFF = 0;
  @CAN_MPC3::ABS_UN_PR_6::ABS_UN_PR_6_ON_OFF = 0;
  @CAN_MPC3::Vehicle_CAN_09::Vehicle_CAN_09_ON_OFF = 0;
  @CAN_MPC3::DADCA_UN_PR_3::DADCA_UN_PR_3_ON_OFF = 0;
  @CAN_MPC3::ABS_UN_PR_GW_3::ABS_UN_PR_GW_3_ON_OFF = 0;
  @CAN_MPC3::CHCM_FR_PR_GW_2_UN::CHCM_FR_PR_GW_2_UN_ON_OFF = 0;
  @CAN_MPC3::ABS_UN_PR_GW_2::ABS_UN_PR_GW_2_ON_OFF = 0;
  @CAN_MPC3::GWM_UN_PR_1::GWM_UN_PR_1_ON_OFF = 0;
  @CAN_MPC3::Vehicle_CAN_15::Vehicle_CAN_15_ON_OFF = 0;
  @CAN_MPC3::Vehicle_CAN_17::Vehicle_CAN_17_ON_OFF = 0;
  @CAN_MPC3::ABS_UN_PR_11::ABS_UN_PR_11_ON_OFF = 0;
  @CAN_MPC3::Vehicle_CAN_21::Vehicle_CAN_21_ON_OFF = 0;
  @CAN_MPC3::Vehicle_CAN_25::Vehicle_CAN_25_ON_OFF = 0;
  @CAN_MPC3::Vehicle_CAN_29::Vehicle_CAN_29_ON_OFF = 0;
  @CAN_MPC3::HCMB_PR_1::HCMB_PR_1_ON_OFF = 0;
  @CAN_MPC3::Vehicle_CAN_31::Vehicle_CAN_31_ON_OFF = 0;
  @CAN_MPC3::Vehicle_CAN_37::Vehicle_CAN_37_ON_OFF = 0;
  @CAN_MPC3::IPC_PR_GW_5_UN::IPC_PR_GW_5_UN_ON_OFF = 0;
  @CAN_MPC3::Vehicle_CAN_41::Vehicle_CAN_41_ON_OFF = 0;
  @CAN_MPC3::Vehicle_CAN_43::Vehicle_CAN_43_ON_OFF = 0;
  @CAN_MPC3::Vehicle_CAN_47::Vehicle_CAN_47_ON_OFF = 0;
  @CAN_MPC3::Vehicle_CAN_48::Vehicle_CAN_48_ON_OFF = 0;
  @CAN_MPC3::VLC_01::VLC_01_ON_OFF = 0;
  @CAN_MPC3::VLC_02::VLC_02_ON_OFF = 0;
  @CAN_MPC3::ACC_01::ACC_01_ON_OFF = 0;
  @CAN_MPC3::SignalGW_PR_1_UN::SignalGW_PR_1_UN_ON_OFF = 0;
  @CAN_MPC3::SignalGW_PR_3_UN::SignalGW_PR_3_UN_ON_OFF = 0;
  @CAN_MPC3::DADCA_UN_SP_5::DADCA_UN_SP_5_ON_OFF = 0;
  @CAN_MPC3::IGM_PR_GW_7_UN::IGM_PR_GW_7_UN_ON_OFF = 0;
  @CAN_MPC3::GSR_ISA_CAN_RX_01::GSR_ISA_CAN_RX_01_ON_OFF = 0;
  @CAN_MPC3::LHSWS_PR_GW_1_UN::LHSWS_PR_GW_1_UN_ON_OFF = 0;
  @CAN_MPC3::IMU_TX1::IMU_TX1_ON_OFF = 0;
  @CAN_MPC3::IMU_TX2::IMU_TX2_ON_OFF = 0;
  @CAN_MPC3::SignalGW_PR_4_UN::SignalGW_PR_4_UN_ON_OFF = 0;
  @CAN_MPC3::BCM_PR_GW_16_UN::BCM_PR_GW_16_UN_ON_OFF = 0;
  @CAN_MPC3::CHCM_FR_PR_GW_3_UN::CHCM_FR_PR_GW_3_UN_ON_OFF = 0;
  @CAN_MPC3::PSCM_FR_PR_GW_1_UN::PSCM_FR_PR_GW_1_UN_ON_OFF = 0;
  @CAN_MPC3::LANE_02::LANE_02_ON_OFF = 0;
  @CAN_MPC3::LANE_05::LANE_05_ON_OFF = 0;
  @CAN_MPC3::PSCM_FR_PR_GW_2_UN::PSCM_FR_PR_GW_2_UN_ON_OFF = 0;
  @CAN_MPC3::TPM_PR_GW_4::TPM_PR_GW_4_ON_OFF = 0;
  @CAN_MPC3::PCM_FR_PR_PedalPos_UN::PCM_FR_PR_PedalPos_UN_ON_OFF = 0;
  @CAN_MPC3::AEB_01::AEB_01_ON_OFF = 0;
  @CAN_MPC3::LIGHT_01::LIGHT_01_ON_OFF = 0;
  @CAN_MPC3::VEHCONFIG_400UN_AS::VEHCONFIG_400UN_AS_ON_OFF = 0;
  @CAN_MPC3::Snapshot_Data::Snapshot_Data_ON_OFF = 0;
  @CAN_MPC3::RCM_FR_PR_TXID1_UN::RCM_FR_PR_TXID1_UN_ON_OFF = 0;
  @CAN_MPC3::RCM_FR_PR_TXID2_UN::RCM_FR_PR_TXID2_UN_ON_OFF = 0;
  @CAN_MPC3::TransmissionControl_A_GW_UN::TransmissionControl_A_GW_UN_ON_OFF = 0;
  @CAN_MPC3::SASM_FR_GW_1_UN::SASM_FR_GW_1_UN_ON_OFF = 0;
  @CAN_MPC3::DADCA_FR_PR_GW_4_UN::DADCA_FR_PR_GW_4_UN_ON_OFF = 0;
  @CAN_MPC3::HCMA_PR_1::HCMA_PR_1_ON_OFF = 0;
  @CAN_MPC3::HCMA_PR_2::HCMA_PR_2_ON_OFF = 0;
  @CAN_MPC3::DBC_Version::DBC_Version_ON_OFF = 0;
  @CAN_MPC3::PCM_FR_PR_Core_B_UN::PCM_FR_PR_Core_B_UN_ON_OFF = 0;
  @CAN_MPC3::ABS_UN_PR_4::ABS_UN_PR_4_ON_OFF = 0;
  @CAN_MPC3::IGM_SP_GW_10_UN::IGM_SP_GW_10_UN_ON_OFF = 0;
  @CAN_MPC3::RCM_FR_PR_GW_1_UN::RCM_FR_PR_GW_1_UN_ON_OFF = 0;
  @CAN_MPC3::PCM_FR_PR_WhlTorqTgt_UN::PCM_FR_PR_WhlTorqTgt_UN_ON_OFF = 0;
  @CAN_MPC3::BCM_SP_GW_2_UN::BCM_SP_GW_2_UN_ON_OFF = 0;
  @CAN_MPC3::ABS_UN_PR_GW_5_1::ABS_UN_PR_GW_5_1_ON_OFF = 0;
  @CAN_MPC3::ABS_UN_PR_GW_5_2::ABS_UN_PR_GW_5_2_ON_OFF = 0;
  @CAN_MPC3::SignalGW_PR_6_UN::SignalGW_PR_6_UN_ON_OFF = 0;
  @CAN_MPC3::DADCA_UN_PR_GW_2::DADCA_UN_PR_GW_2_ON_OFF = 0;
  @CAN_MPC3::DADCA_UN_PR_GW_3::DADCA_UN_PR_GW_3_ON_OFF = 0;
  @CAN_MPC3::BCM_PR_GW_1_UN::BCM_PR_GW_1_UN_ON_OFF = 0;
}

void MPC3_sim_DisableMsg()
{
   ILFaultInjectionDisableMsg(CAN_MPC3::Vehicle_CAN_01);
   ILFaultInjectionDisableMsg(CAN_MPC3::ABS_UN_PR_6);
   ILFaultInjectionDisableMsg(CAN_MPC3::Vehicle_CAN_09);
   ILFaultInjectionDisableMsg(CAN_MPC3::DADCA_UN_PR_3);
   ILFaultInjectionDisableMsg(CAN_MPC3::ABS_UN_PR_GW_3);
   ILFaultInjectionDisableMsg(CAN_MPC3::CHCM_FR_PR_GW_2_UN);
   ILFaultInjectionDisableMsg(CAN_MPC3::ABS_UN_PR_GW_2);
   ILFaultInjectionDisableMsg(CAN_MPC3::GWM_UN_PR_1);
   ILFaultInjectionDisableMsg(CAN_MPC3::Vehicle_CAN_15);
   ILFaultInjectionDisableMsg(CAN_MPC3::Vehicle_CAN_17);
   ILFaultInjectionDisableMsg(CAN_MPC3::ABS_UN_PR_11);
   ILFaultInjectionDisableMsg(CAN_MPC3::Vehicle_CAN_21);
   ILFaultInjectionDisableMsg(CAN_MPC3::Vehicle_CAN_25);
   ILFaultInjectionDisableMsg(CAN_MPC3::Vehicle_CAN_29);
   ILFaultInjectionDisableMsg(CAN_MPC3::HCMB_PR_1);
   ILFaultInjectionDisableMsg(CAN_MPC3::Vehicle_CAN_31);
   ILFaultInjectionDisableMsg(CAN_MPC3::Vehicle_CAN_37);
   ILFaultInjectionDisableMsg(CAN_MPC3::IPC_PR_GW_5_UN);
   ILFaultInjectionDisableMsg(CAN_MPC3::Vehicle_CAN_41);
   ILFaultInjectionDisableMsg(CAN_MPC3::Vehicle_CAN_43);
   ILFaultInjectionDisableMsg(CAN_MPC3::Vehicle_CAN_47);
   ILFaultInjectionDisableMsg(CAN_MPC3::Vehicle_CAN_48);
   ILFaultInjectionDisableMsg(CAN_MPC3::VLC_01);
   ILFaultInjectionDisableMsg(CAN_MPC3::VLC_02);
   ILFaultInjectionDisableMsg(CAN_MPC3::ACC_01);
   ILFaultInjectionDisableMsg(CAN_MPC3::SignalGW_PR_1_UN);
   ILFaultInjectionDisableMsg(CAN_MPC3::SignalGW_PR_3_UN);
   ILFaultInjectionDisableMsg(CAN_MPC3::DADCA_UN_SP_5);
   ILFaultInjectionDisableMsg(CAN_MPC3::IGM_PR_GW_7_UN);
   ILFaultInjectionDisableMsg(CAN_MPC3::TimeSync);
   ILFaultInjectionDisableMsg(CAN_MPC3::GSR_ISA_CAN_RX_01);
   ILFaultInjectionDisableMsg(CAN_MPC3::LHSWS_PR_GW_1_UN);
   ILFaultInjectionDisableMsg(CAN_MPC3::IMU_TX1);
   ILFaultInjectionDisableMsg(CAN_MPC3::IMU_TX2);
   ILFaultInjectionDisableMsg(CAN_MPC3::SignalGW_PR_4_UN);
   ILFaultInjectionDisableMsg(CAN_MPC3::BCM_PR_GW_16_UN);
   ILFaultInjectionDisableMsg(CAN_MPC3::CHCM_FR_PR_GW_3_UN);
   ILFaultInjectionDisableMsg(CAN_MPC3::PSCM_FR_PR_GW_1_UN);
   ILFaultInjectionDisableMsg(CAN_MPC3::LANE_02);
   ILFaultInjectionDisableMsg(CAN_MPC3::LANE_05);
   ILFaultInjectionDisableMsg(CAN_MPC3::PSCM_FR_PR_GW_2_UN);
   ILFaultInjectionDisableMsg(CAN_MPC3::TPM_PR_GW_4);
   ILFaultInjectionDisableMsg(CAN_MPC3::PCM_FR_PR_PedalPos_UN);
   ILFaultInjectionDisableMsg(CAN_MPC3::AEB_01);
   ILFaultInjectionDisableMsg(CAN_MPC3::LIGHT_01);
   ILFaultInjectionDisableMsg(CAN_MPC3::VEHCONFIG_400UN_AS);
   ILFaultInjectionDisableMsg(CAN_MPC3::Snapshot_Data);
   ILFaultInjectionDisableMsg(CAN_MPC3::RCM_FR_PR_TXID1_UN);
   ILFaultInjectionDisableMsg(CAN_MPC3::RCM_FR_PR_TXID2_UN);
   ILFaultInjectionDisableMsg(CAN_MPC3::TransmissionControl_A_GW_UN);
   ILFaultInjectionDisableMsg(CAN_MPC3::SASM_FR_GW_1_UN);
   ILFaultInjectionDisableMsg(CAN_MPC3::DADCA_FR_PR_GW_4_UN);
   ILFaultInjectionDisableMsg(CAN_MPC3::HCMA_PR_1);
   ILFaultInjectionDisableMsg(CAN_MPC3::HCMA_PR_2);
   ILFaultInjectionDisableMsg(CAN_MPC3::DBC_Version);
   ILFaultInjectionDisableMsg(CAN_MPC3::PCM_FR_PR_Core_B_UN);
   ILFaultInjectionDisableMsg(CAN_MPC3::ABS_UN_PR_4);
   ILFaultInjectionDisableMsg(CAN_MPC3::IGM_SP_GW_10_UN);
   ILFaultInjectionDisableMsg(CAN_MPC3::RCM_FR_PR_GW_1_UN);
   ILFaultInjectionDisableMsg(CAN_MPC3::PCM_FR_PR_WhlTorqTgt_UN);
   ILFaultInjectionDisableMsg(CAN_MPC3::BCM_SP_GW_2_UN);
   ILFaultInjectionDisableMsg(CAN_MPC3::ABS_UN_PR_GW_5_1);
   ILFaultInjectionDisableMsg(CAN_MPC3::ABS_UN_PR_GW_5_2);
   ILFaultInjectionDisableMsg(CAN_MPC3::SignalGW_PR_6_UN);
   ILFaultInjectionDisableMsg(CAN_MPC3::DADCA_UN_PR_GW_2);
   ILFaultInjectionDisableMsg(CAN_MPC3::DADCA_UN_PR_GW_3);
   ILFaultInjectionDisableMsg(CAN_MPC3::BCM_PR_GW_1_UN);
}
on sysvar hil_ctrl::hil_mode
{
  MPC3_sim_Reset();
}

void MPC3_sim_DisableEventMsg()
{
   ILFaultInjectionDisableMsg(CAN_MPC3::GSR_ISA_CAN_RX_01);
   ILFaultInjectionDisableMsg(CAN_MPC3::LHSWS_PR_GW_1_UN);
   ILFaultInjectionDisableMsg(CAN_MPC3::Snapshot_Data);

}

void MPC3_sim_EnableEventMsg()
{
   ILFaultInjectionEnableMsg(CAN_MPC3::GSR_ISA_CAN_RX_01);
   ILFaultInjectionEnableMsg(CAN_MPC3::LHSWS_PR_GW_1_UN);
   ILFaultInjectionEnableMsg(CAN_MPC3::Snapshot_Data);

}
void MPC3_sim_SetCANParameter()
{
  //For future purpose
  //ILFaultInjectionSetMsgDlc(dbMsg msg, dword dlc)
  //ILFaultInjectionSetMsgLength(dbMsg msg, dword msgLength)
  //ILFaultInjectionResetMsgDlc(dbMsg msg)
  //ILFaultInjectionResetMsgLength (dbMsg msg)
}

dword applILTxPending (long aId, dword aDlc, byte data[])//This callback is being called before the IL sends a message to the bus
{
  switch(aId)
  {
    case CAN_MPC3::Vehicle_CAN_01.id:cfg_Msg_Vehicle_CAN_01(aDlc, data);break;
    case CAN_MPC3::ABS_UN_PR_6.id:cfg_Msg_ABS_UN_PR_6(aDlc, data);break;
    case CAN_MPC3::Vehicle_CAN_09.id:cfg_Msg_Vehicle_CAN_09(aDlc, data);break;
    case CAN_MPC3::DADCA_UN_PR_3.id:cfg_Msg_DADCA_UN_PR_3(aDlc, data);break;
    case CAN_MPC3::ABS_UN_PR_GW_3.id:cfg_Msg_ABS_UN_PR_GW_3(aDlc, data);break;
    case CAN_MPC3::CHCM_FR_PR_GW_2_UN.id:cfg_Msg_CHCM_FR_PR_GW_2_UN(aDlc, data);break;
    case CAN_MPC3::ABS_UN_PR_GW_2.id:cfg_Msg_ABS_UN_PR_GW_2(aDlc, data);break;
    case CAN_MPC3::GWM_UN_PR_1.id:cfg_Msg_GWM_UN_PR_1(aDlc, data);break;
    case CAN_MPC3::Vehicle_CAN_15.id:cfg_Msg_Vehicle_CAN_15(aDlc, data);break;
    case CAN_MPC3::Vehicle_CAN_17.id:cfg_Msg_Vehicle_CAN_17(aDlc, data);break;
    case CAN_MPC3::ABS_UN_PR_11.id:cfg_Msg_ABS_UN_PR_11(aDlc, data);break;
    case CAN_MPC3::Vehicle_CAN_21.id:cfg_Msg_Vehicle_CAN_21(aDlc, data);break;
    case CAN_MPC3::Vehicle_CAN_25.id:cfg_Msg_Vehicle_CAN_25(aDlc, data);break;
    case CAN_MPC3::Vehicle_CAN_29.id:cfg_Msg_Vehicle_CAN_29(aDlc, data);break;
    case CAN_MPC3::HCMB_PR_1.id:cfg_Msg_HCMB_PR_1(aDlc, data);break;
    case CAN_MPC3::Vehicle_CAN_31.id:cfg_Msg_Vehicle_CAN_31(aDlc, data);break;
    case CAN_MPC3::Vehicle_CAN_37.id:cfg_Msg_Vehicle_CAN_37(aDlc, data);break;
    case CAN_MPC3::IPC_PR_GW_5_UN.id:cfg_Msg_IPC_PR_GW_5_UN(aDlc, data);break;
    case CAN_MPC3::Vehicle_CAN_41.id:cfg_Msg_Vehicle_CAN_41(aDlc, data);break;
    case CAN_MPC3::Vehicle_CAN_43.id:cfg_Msg_Vehicle_CAN_43(aDlc, data);break;
    case CAN_MPC3::Vehicle_CAN_47.id:cfg_Msg_Vehicle_CAN_47(aDlc, data);break;
    case CAN_MPC3::Vehicle_CAN_48.id:cfg_Msg_Vehicle_CAN_48(aDlc, data);break;
    case CAN_MPC3::VLC_01.id:cfg_Msg_VLC_01(aDlc, data);break;
    case CAN_MPC3::VLC_02.id:cfg_Msg_VLC_02(aDlc, data);break;
    case CAN_MPC3::ACC_01.id:cfg_Msg_ACC_01(aDlc, data);break;
    case CAN_MPC3::SignalGW_PR_1_UN.id:cfg_Msg_SignalGW_PR_1_UN(aDlc, data);break;
    case CAN_MPC3::SignalGW_PR_3_UN.id:cfg_Msg_SignalGW_PR_3_UN(aDlc, data);break;
    case CAN_MPC3::DADCA_UN_SP_5.id:cfg_Msg_DADCA_UN_SP_5(aDlc, data);break;
    case CAN_MPC3::IGM_PR_GW_7_UN.id:cfg_Msg_IGM_PR_GW_7_UN(aDlc, data);break;
    case CAN_MPC3::GSR_ISA_CAN_RX_01.id:cfg_Msg_GSR_ISA_CAN_RX_01(aDlc, data);break;
    case CAN_MPC3::LHSWS_PR_GW_1_UN.id:cfg_Msg_LHSWS_PR_GW_1_UN(aDlc, data);break;
    case CAN_MPC3::IMU_TX1.id:cfg_Msg_IMU_TX1(aDlc, data);break;
    case CAN_MPC3::IMU_TX2.id:cfg_Msg_IMU_TX2(aDlc, data);break;
    case CAN_MPC3::SignalGW_PR_4_UN.id:cfg_Msg_SignalGW_PR_4_UN(aDlc, data);break;
    case CAN_MPC3::BCM_PR_GW_16_UN.id:cfg_Msg_BCM_PR_GW_16_UN(aDlc, data);break;
    case CAN_MPC3::CHCM_FR_PR_GW_3_UN.id:cfg_Msg_CHCM_FR_PR_GW_3_UN(aDlc, data);break;
    case CAN_MPC3::PSCM_FR_PR_GW_1_UN.id:cfg_Msg_PSCM_FR_PR_GW_1_UN(aDlc, data);break;
    case CAN_MPC3::LANE_02.id:cfg_Msg_LANE_02(aDlc, data);break;
    case CAN_MPC3::LANE_05.id:cfg_Msg_LANE_05(aDlc, data);break;
    case CAN_MPC3::PSCM_FR_PR_GW_2_UN.id:cfg_Msg_PSCM_FR_PR_GW_2_UN(aDlc, data);break;
    case CAN_MPC3::TPM_PR_GW_4.id:cfg_Msg_TPM_PR_GW_4(aDlc, data);break;
    case CAN_MPC3::PCM_FR_PR_PedalPos_UN.id:cfg_Msg_PCM_FR_PR_PedalPos_UN(aDlc, data);break;
    case CAN_MPC3::AEB_01.id:cfg_Msg_AEB_01(aDlc, data);break;
    case CAN_MPC3::LIGHT_01.id:cfg_Msg_LIGHT_01(aDlc, data);break;
    case CAN_MPC3::VEHCONFIG_400UN_AS.id:cfg_Msg_VEHCONFIG_400UN_AS(aDlc, data);break;
    case CAN_MPC3::Snapshot_Data.id:cfg_Msg_Snapshot_Data(aDlc, data);break;
    case CAN_MPC3::RCM_FR_PR_TXID1_UN.id:cfg_Msg_RCM_FR_PR_TXID1_UN(aDlc, data);break;
    case CAN_MPC3::RCM_FR_PR_TXID2_UN.id:cfg_Msg_RCM_FR_PR_TXID2_UN(aDlc, data);break;
    case CAN_MPC3::TransmissionControl_A_GW_UN.id:cfg_Msg_TransmissionControl_A_GW_UN(aDlc, data);break;
    case CAN_MPC3::SASM_FR_GW_1_UN.id:cfg_Msg_SASM_FR_GW_1_UN(aDlc, data);break;
    case CAN_MPC3::DADCA_FR_PR_GW_4_UN.id:cfg_Msg_DADCA_FR_PR_GW_4_UN(aDlc, data);break;
    case CAN_MPC3::HCMA_PR_1.id:cfg_Msg_HCMA_PR_1(aDlc, data);break;
    case CAN_MPC3::HCMA_PR_2.id:cfg_Msg_HCMA_PR_2(aDlc, data);break;
    case CAN_MPC3::DBC_Version.id:cfg_Msg_DBC_Version(aDlc, data);break;
    case CAN_MPC3::PCM_FR_PR_Core_B_UN.id:cfg_Msg_PCM_FR_PR_Core_B_UN(aDlc, data);break;
    case CAN_MPC3::ABS_UN_PR_4.id:cfg_Msg_ABS_UN_PR_4(aDlc, data);break;
    case CAN_MPC3::IGM_SP_GW_10_UN.id:cfg_Msg_IGM_SP_GW_10_UN(aDlc, data);break;
    case CAN_MPC3::RCM_FR_PR_GW_1_UN.id:cfg_Msg_RCM_FR_PR_GW_1_UN(aDlc, data);break;
    case CAN_MPC3::PCM_FR_PR_WhlTorqTgt_UN.id:cfg_Msg_PCM_FR_PR_WhlTorqTgt_UN(aDlc, data);break;
    case CAN_MPC3::BCM_SP_GW_2_UN.id:cfg_Msg_BCM_SP_GW_2_UN(aDlc, data);break;
    case CAN_MPC3::ABS_UN_PR_GW_5_1.id:cfg_Msg_ABS_UN_PR_GW_5_1(aDlc, data);break;
    case CAN_MPC3::ABS_UN_PR_GW_5_2.id:cfg_Msg_ABS_UN_PR_GW_5_2(aDlc, data);break;
    case CAN_MPC3::SignalGW_PR_6_UN.id:cfg_Msg_SignalGW_PR_6_UN(aDlc, data);break;
    case CAN_MPC3::DADCA_UN_PR_GW_2.id:cfg_Msg_DADCA_UN_PR_GW_2(aDlc, data);break;
    case CAN_MPC3::DADCA_UN_PR_GW_3.id:cfg_Msg_DADCA_UN_PR_GW_3(aDlc, data);break;
    case CAN_MPC3::BCM_PR_GW_1_UN.id:cfg_Msg_BCM_PR_GW_1_UN(aDlc, data);break;
    default :;//write("Node:MPC3 ::No Cyclic event");
           break;
  }
  return 1; // don't prevent sending of the message
}

on sysvar CAN_MPC3::ABS_UN_PR_11::ABS_UN_PR_11_ON_OFF
{
  if (@this == 1)
  {
    ILFaultInjectionEnableMsg(CAN_MPC3::ABS_UN_PR_11);
  }
  else{
         ILFaultInjectionDisableMsg(CAN_MPC3::ABS_UN_PR_11);
      }
}

void cfg_Msg_ABS_UN_PR_11(dword aDlc, byte data[])
{
   byte messagebytes[10];
   byte byte_count=0,crc_byte_no =0;
   int loop_index;
   int64 i,k;//For looping
   byte xor,data_byte;
   dword crcTemp;
   byte DataLength;
   dword Msg_id;
   
   DataLength = Msg_ABS_UN_PR_11.DataLength;//Message Data Length
   Msg_id  = Msg_ABS_UN_PR_11.id;//Message ID
   
}


on sysvar CAN_MPC3::ABS_UN_PR_4::ABS_UN_PR_4_ON_OFF
{
  if (@this == 1)
  {
    ILFaultInjectionEnableMsg(CAN_MPC3::ABS_UN_PR_4);
  }
  else{
         ILFaultInjectionDisableMsg(CAN_MPC3::ABS_UN_PR_4);
      }
}

void cfg_Msg_ABS_UN_PR_4(dword aDlc, byte data[])
{
   byte messagebytes[10];
   byte byte_count=0,crc_byte_no =0;
   int loop_index;
   int64 i,k;//For looping
   byte xor,data_byte;
   dword crcTemp;
   byte DataLength;
   dword Msg_id;
   
   DataLength = Msg_ABS_UN_PR_4.DataLength;//Message Data Length
   Msg_id  = Msg_ABS_UN_PR_4.id;//Message ID
   
}


on sysvar CAN_MPC3::ABS_UN_PR_6::ABS_UN_PR_6_ON_OFF
{
  if (@this == 1)
  {
    ILFaultInjectionEnableMsg(CAN_MPC3::ABS_UN_PR_6);
  }
  else{
         ILFaultInjectionDisableMsg(CAN_MPC3::ABS_UN_PR_6);
      }
}

void cfg_Msg_ABS_UN_PR_6(dword aDlc, byte data[])
{
   byte messagebytes[10];
   byte byte_count=0,crc_byte_no =0;
   int loop_index;
   int64 i,k;//For looping
   byte xor,data_byte;
   dword crcTemp;
   byte DataLength;
   dword Msg_id;
   
   DataLength = Msg_ABS_UN_PR_6.DataLength;//Message Data Length
   Msg_id  = Msg_ABS_UN_PR_6.id;//Message ID
   
}


on sysvar CAN_MPC3::ABS_UN_PR_GW_2::ABS_UN_PR_GW_2_ON_OFF
{
  if (@this == 1)
  {
    ILFaultInjectionEnableMsg(CAN_MPC3::ABS_UN_PR_GW_2);
  }
  else{
         ILFaultInjectionDisableMsg(CAN_MPC3::ABS_UN_PR_GW_2);
      }
}

void cfg_Msg_ABS_UN_PR_GW_2(dword aDlc, byte data[])
{
   byte messagebytes[10];
   byte byte_count=0,crc_byte_no =0;
   int loop_index;
   int64 i,k;//For looping
   byte xor,data_byte;
   dword crcTemp;
   byte DataLength;
   dword Msg_id;
   
   DataLength = Msg_ABS_UN_PR_GW_2.DataLength;//Message Data Length
   Msg_id  = Msg_ABS_UN_PR_GW_2.id;//Message ID
   
    if (@CAN_MPC3::ABS_UN_PR_GW_2::ABSAliveCounter_FaultInject != 3)//AC: user defined value
    {

    clearBitsInByteArrayBE(data,8,11,4); //Motorola / Big-endian

    }
    if (@CAN_MPC3::ABS_UN_PR_GW_2::ABSAliveCounter_FaultInject == 0)//AC: No Error, calculate AC
    {
      ++counter_ABS_UN_PR_GW_2_ABSAliveCounter;
      counter_ABS_UN_PR_GW_2_ABSAliveCounter %=15;

      copyBitsToByteArrayBE(counter_ABS_UN_PR_GW_2_ABSAliveCounter,data,8,4); //Motorola / Big-endian
    }
    else if (@CAN_MPC3::ABS_UN_PR_GW_2::ABSAliveCounter_FaultInject == 1)//AC: Error sequence: set AC = 0
    {

      copyBitsToByteArrayBE(0,data,8,4); //Motorola / Big-endian
    }
    else if (@CAN_MPC3::ABS_UN_PR_GW_2::ABSAliveCounter_FaultInject == 2)//AC: Error sequence: Freeze last valid value
    {

      copyBitsToByteArrayBE(counter_ABS_UN_PR_GW_2_ABSAliveCounter,data,8,4); //Motorola / Big-endian
    }
    if (@CAN_MPC3::ABS_UN_PR_GW_2::ABSChecksum_FaultInject != 3)//CRC: user defined value
    {

    clearBitsInByteArrayBE(data,0,7,8); //Motorola / Big-endian

    }
   messagebytes[0] = Data_ID_Lookup(Msg_id);
   messagebytes[1] = 0x00;
   crc_byte_no = 6;
   for(loop_index=0;loop_index < 5 ;loop_index++)
       messagebytes[loop_index+2] = data[loop_index+1];
   
    if(@CAN_MPC3::ABS_UN_PR_GW_2::ABSChecksum_FaultInject == 0)//CRC: No Error, calculate CRC
    {
      chksum_ABS_UN_PR_GW_2_ABSChecksum = CRC_Calc_SAEJ1850(crc_byte_no, messagebytes);

      copyBitsToByteArrayBE(chksum_ABS_UN_PR_GW_2_ABSChecksum,data,0,8); //Motorola / Big-endian
    }
    else if(@CAN_MPC3::ABS_UN_PR_GW_2::ABSChecksum_FaultInject == 1)//CRC: Error, set to Zero
    {

      copyBitsToByteArrayBE(0,data,0,8); //Motorola / Big-endian
    }
    else if(@CAN_MPC3::ABS_UN_PR_GW_2::ABSChecksum_FaultInject == 2)//CRC: Error, Freeze last valid value
    {

      copyBitsToByteArrayBE(chksum_ABS_UN_PR_GW_2_ABSChecksum,data,0,8); //Motorola / Big-endian
    }
}


on sysvar CAN_MPC3::ABS_UN_PR_GW_3::ABS_UN_PR_GW_3_ON_OFF
{
  if (@this == 1)
  {
    ILFaultInjectionEnableMsg(CAN_MPC3::ABS_UN_PR_GW_3);
  }
  else{
         ILFaultInjectionDisableMsg(CAN_MPC3::ABS_UN_PR_GW_3);
      }
}

void cfg_Msg_ABS_UN_PR_GW_3(dword aDlc, byte data[])
{
   byte messagebytes[10];
   byte byte_count=0,crc_byte_no =0;
   int loop_index;
   int64 i,k;//For looping
   byte xor,data_byte;
   dword crcTemp;
   byte DataLength;
   dword Msg_id;
   
   DataLength = Msg_ABS_UN_PR_GW_3.DataLength;//Message Data Length
   Msg_id  = Msg_ABS_UN_PR_GW_3.id;//Message ID
   
    if (@CAN_MPC3::ABS_UN_PR_GW_3::VehMovementCounter_FaultInject != 3)//AC: user defined value
    {

    clearBitsInByteArrayBE(data,8,11,4); //Motorola / Big-endian

    }
    if (@CAN_MPC3::ABS_UN_PR_GW_3::VehMovementCounter_FaultInject == 0)//AC: No Error, calculate AC
    {
      ++counter_ABS_UN_PR_GW_3_VehMovementCounter;
      counter_ABS_UN_PR_GW_3_VehMovementCounter %=15;

      copyBitsToByteArrayBE(counter_ABS_UN_PR_GW_3_VehMovementCounter,data,8,4); //Motorola / Big-endian
    }
    else if (@CAN_MPC3::ABS_UN_PR_GW_3::VehMovementCounter_FaultInject == 1)//AC: Error sequence: set AC = 0
    {

      copyBitsToByteArrayBE(0,data,8,4); //Motorola / Big-endian
    }
    else if (@CAN_MPC3::ABS_UN_PR_GW_3::VehMovementCounter_FaultInject == 2)//AC: Error sequence: Freeze last valid value
    {

      copyBitsToByteArrayBE(counter_ABS_UN_PR_GW_3_VehMovementCounter,data,8,4); //Motorola / Big-endian
    }
    if (@CAN_MPC3::ABS_UN_PR_GW_3::VehMovementChecksum_FaultInject != 3)//CRC: user defined value
    {

    clearBitsInByteArrayBE(data,0,7,8); //Motorola / Big-endian

    }
   messagebytes[0] = Data_ID_Lookup(Msg_id);
   messagebytes[1] = 0x00;
   crc_byte_no = 3;
   for(loop_index=0;loop_index < 2 ;loop_index++)
       messagebytes[loop_index+2] = data[loop_index+1];
   
    if(@CAN_MPC3::ABS_UN_PR_GW_3::VehMovementChecksum_FaultInject == 0)//CRC: No Error, calculate CRC
    {
      chksum_ABS_UN_PR_GW_3_VehMovementChecksum = CRC_Calc_SAEJ1850(crc_byte_no, messagebytes);

      copyBitsToByteArrayBE(chksum_ABS_UN_PR_GW_3_VehMovementChecksum,data,0,8); //Motorola / Big-endian
    }
    else if(@CAN_MPC3::ABS_UN_PR_GW_3::VehMovementChecksum_FaultInject == 1)//CRC: Error, set to Zero
    {

      copyBitsToByteArrayBE(0,data,0,8); //Motorola / Big-endian
    }
    else if(@CAN_MPC3::ABS_UN_PR_GW_3::VehMovementChecksum_FaultInject == 2)//CRC: Error, Freeze last valid value
    {

      copyBitsToByteArrayBE(chksum_ABS_UN_PR_GW_3_VehMovementChecksum,data,0,8); //Motorola / Big-endian
    }
}


on sysvar CAN_MPC3::ABS_UN_PR_GW_5_1::ABS_UN_PR_GW_5_1_ON_OFF
{
  if (@this == 1)
  {
    ILFaultInjectionEnableMsg(CAN_MPC3::ABS_UN_PR_GW_5_1);
  }
  else{
         ILFaultInjectionDisableMsg(CAN_MPC3::ABS_UN_PR_GW_5_1);
      }
}

void cfg_Msg_ABS_UN_PR_GW_5_1(dword aDlc, byte data[])
{
   byte messagebytes[10];
   byte byte_count=0,crc_byte_no =0;
   int loop_index;
   int64 i,k;//For looping
   byte xor,data_byte;
   dword crcTemp;
   byte DataLength;
   dword Msg_id;
   
   DataLength = Msg_ABS_UN_PR_GW_5_1.DataLength;//Message Data Length
   Msg_id  = Msg_ABS_UN_PR_GW_5_1.id;//Message ID
   
    if (@CAN_MPC3::ABS_UN_PR_GW_5_1::WheelSpeedFrGpCounter_FaultInject != 3)//AC: user defined value
    {

    clearBitsInByteArrayBE(data,8,11,4); //Motorola / Big-endian

    }
    if (@CAN_MPC3::ABS_UN_PR_GW_5_1::WheelSpeedFrGpCounter_FaultInject == 0)//AC: No Error, calculate AC
    {
      ++counter_ABS_UN_PR_GW_5_1_WheelSpeedFrGpCounter;
      counter_ABS_UN_PR_GW_5_1_WheelSpeedFrGpCounter %=15;

      copyBitsToByteArrayBE(counter_ABS_UN_PR_GW_5_1_WheelSpeedFrGpCounter,data,8,4); //Motorola / Big-endian
    }
    else if (@CAN_MPC3::ABS_UN_PR_GW_5_1::WheelSpeedFrGpCounter_FaultInject == 1)//AC: Error sequence: set AC = 0
    {

      copyBitsToByteArrayBE(0,data,8,4); //Motorola / Big-endian
    }
    else if (@CAN_MPC3::ABS_UN_PR_GW_5_1::WheelSpeedFrGpCounter_FaultInject == 2)//AC: Error sequence: Freeze last valid value
    {

      copyBitsToByteArrayBE(counter_ABS_UN_PR_GW_5_1_WheelSpeedFrGpCounter,data,8,4); //Motorola / Big-endian
    }
    if (@CAN_MPC3::ABS_UN_PR_GW_5_1::WheelSpeedFrGpCS_FaultInject != 3)//CRC: user defined value
    {

    clearBitsInByteArrayBE(data,0,7,8); //Motorola / Big-endian

    }
   messagebytes[0] = Data_ID_Lookup(Msg_id);
   messagebytes[1] = 0x00;
   crc_byte_no = 6;
   for(loop_index=0;loop_index < 5 ;loop_index++)
       messagebytes[loop_index+2] = data[loop_index+1];
   
    if(@CAN_MPC3::ABS_UN_PR_GW_5_1::WheelSpeedFrGpCS_FaultInject == 0)//CRC: No Error, calculate CRC
    {
      chksum_ABS_UN_PR_GW_5_1_WheelSpeedFrGpCS = CRC_Calc_SAEJ1850(crc_byte_no, messagebytes);

      copyBitsToByteArrayBE(chksum_ABS_UN_PR_GW_5_1_WheelSpeedFrGpCS,data,0,8); //Motorola / Big-endian
    }
    else if(@CAN_MPC3::ABS_UN_PR_GW_5_1::WheelSpeedFrGpCS_FaultInject == 1)//CRC: Error, set to Zero
    {

      copyBitsToByteArrayBE(0,data,0,8); //Motorola / Big-endian
    }
    else if(@CAN_MPC3::ABS_UN_PR_GW_5_1::WheelSpeedFrGpCS_FaultInject == 2)//CRC: Error, Freeze last valid value
    {

      copyBitsToByteArrayBE(chksum_ABS_UN_PR_GW_5_1_WheelSpeedFrGpCS,data,0,8); //Motorola / Big-endian
    }
}


on sysvar CAN_MPC3::ABS_UN_PR_GW_5_2::ABS_UN_PR_GW_5_2_ON_OFF
{
  if (@this == 1)
  {
    ILFaultInjectionEnableMsg(CAN_MPC3::ABS_UN_PR_GW_5_2);
  }
  else{
         ILFaultInjectionDisableMsg(CAN_MPC3::ABS_UN_PR_GW_5_2);
      }
}

void cfg_Msg_ABS_UN_PR_GW_5_2(dword aDlc, byte data[])
{
   byte messagebytes[10];
   byte byte_count=0,crc_byte_no =0;
   int loop_index;
   int64 i,k;//For looping
   byte xor,data_byte;
   dword crcTemp;
   byte DataLength;
   dword Msg_id;
   
   DataLength = Msg_ABS_UN_PR_GW_5_2.DataLength;//Message Data Length
   Msg_id  = Msg_ABS_UN_PR_GW_5_2.id;//Message ID
   
    if (@CAN_MPC3::ABS_UN_PR_GW_5_2::WheelSpeedReGpCounter_FaultInject != 3)//AC: user defined value
    {

    clearBitsInByteArrayBE(data,8,11,4); //Motorola / Big-endian

    }
    if (@CAN_MPC3::ABS_UN_PR_GW_5_2::WheelSpeedReGpCounter_FaultInject == 0)//AC: No Error, calculate AC
    {
      ++counter_ABS_UN_PR_GW_5_2_WheelSpeedReGpCounter;
      counter_ABS_UN_PR_GW_5_2_WheelSpeedReGpCounter %=15;

      copyBitsToByteArrayBE(counter_ABS_UN_PR_GW_5_2_WheelSpeedReGpCounter,data,8,4); //Motorola / Big-endian
    }
    else if (@CAN_MPC3::ABS_UN_PR_GW_5_2::WheelSpeedReGpCounter_FaultInject == 1)//AC: Error sequence: set AC = 0
    {

      copyBitsToByteArrayBE(0,data,8,4); //Motorola / Big-endian
    }
    else if (@CAN_MPC3::ABS_UN_PR_GW_5_2::WheelSpeedReGpCounter_FaultInject == 2)//AC: Error sequence: Freeze last valid value
    {

      copyBitsToByteArrayBE(counter_ABS_UN_PR_GW_5_2_WheelSpeedReGpCounter,data,8,4); //Motorola / Big-endian
    }
    if (@CAN_MPC3::ABS_UN_PR_GW_5_2::WheelSpeedReGpCS_FaultInject != 3)//CRC: user defined value
    {

    clearBitsInByteArrayBE(data,0,7,8); //Motorola / Big-endian

    }
   messagebytes[0] = Data_ID_Lookup(Msg_id);
   messagebytes[1] = 0x00;
   crc_byte_no = 6;
   for(loop_index=0;loop_index < 5 ;loop_index++)
       messagebytes[loop_index+2] = data[loop_index+1];
   
    if(@CAN_MPC3::ABS_UN_PR_GW_5_2::WheelSpeedReGpCS_FaultInject == 0)//CRC: No Error, calculate CRC
    {
      chksum_ABS_UN_PR_GW_5_2_WheelSpeedReGpCS = CRC_Calc_SAEJ1850(crc_byte_no, messagebytes);

      copyBitsToByteArrayBE(chksum_ABS_UN_PR_GW_5_2_WheelSpeedReGpCS,data,0,8); //Motorola / Big-endian
    }
    else if(@CAN_MPC3::ABS_UN_PR_GW_5_2::WheelSpeedReGpCS_FaultInject == 1)//CRC: Error, set to Zero
    {

      copyBitsToByteArrayBE(0,data,0,8); //Motorola / Big-endian
    }
    else if(@CAN_MPC3::ABS_UN_PR_GW_5_2::WheelSpeedReGpCS_FaultInject == 2)//CRC: Error, Freeze last valid value
    {

      copyBitsToByteArrayBE(chksum_ABS_UN_PR_GW_5_2_WheelSpeedReGpCS,data,0,8); //Motorola / Big-endian
    }
}


on sysvar CAN_MPC3::ACC_01::ACC_01_ON_OFF
{
  if (@this == 1)
  {
    ILFaultInjectionEnableMsg(CAN_MPC3::ACC_01);
  }
  else{
         ILFaultInjectionDisableMsg(CAN_MPC3::ACC_01);
      }
}

void cfg_Msg_ACC_01(dword aDlc, byte data[])
{
   byte messagebytes[10];
   byte byte_count=0,crc_byte_no =0;
   int loop_index;
   int64 i,k;//For looping
   byte xor,data_byte;
   dword crcTemp;
   byte DataLength;
   dword Msg_id;
   
   DataLength = Msg_ACC_01.DataLength;//Message Data Length
   Msg_id  = Msg_ACC_01.id;//Message ID
   
}


on sysvar CAN_MPC3::AEB_01::AEB_01_ON_OFF
{
  if (@this == 1)
  {
    ILFaultInjectionEnableMsg(CAN_MPC3::AEB_01);
  }
  else{
         ILFaultInjectionDisableMsg(CAN_MPC3::AEB_01);
      }
}

void cfg_Msg_AEB_01(dword aDlc, byte data[])
{
   byte messagebytes[10];
   byte byte_count=0,crc_byte_no =0;
   int loop_index;
   int64 i,k;//For looping
   byte xor,data_byte;
   dword crcTemp;
   byte DataLength;
   dword Msg_id;
   
   DataLength = Msg_AEB_01.DataLength;//Message Data Length
   Msg_id  = Msg_AEB_01.id;//Message ID
   
}


on sysvar CAN_MPC3::BCM_PR_GW_16_UN::BCM_PR_GW_16_UN_ON_OFF
{
  if (@this == 1)
  {
    ILFaultInjectionEnableMsg(CAN_MPC3::BCM_PR_GW_16_UN);
  }
  else{
         ILFaultInjectionDisableMsg(CAN_MPC3::BCM_PR_GW_16_UN);
      }
}

void cfg_Msg_BCM_PR_GW_16_UN(dword aDlc, byte data[])
{
   byte messagebytes[10];
   byte byte_count=0,crc_byte_no =0;
   int loop_index;
   int64 i,k;//For looping
   byte xor,data_byte;
   dword crcTemp;
   byte DataLength;
   dword Msg_id;
   
   DataLength = Msg_BCM_PR_GW_16_UN.DataLength;//Message Data Length
   Msg_id  = Msg_BCM_PR_GW_16_UN.id;//Message ID
   
}


on sysvar CAN_MPC3::BCM_PR_GW_1_UN::BCM_PR_GW_1_UN_ON_OFF
{
  if (@this == 1)
  {
    ILFaultInjectionEnableMsg(CAN_MPC3::BCM_PR_GW_1_UN);
  }
  else{
         ILFaultInjectionDisableMsg(CAN_MPC3::BCM_PR_GW_1_UN);
      }
}

void cfg_Msg_BCM_PR_GW_1_UN(dword aDlc, byte data[])
{
   byte messagebytes[10];
   byte byte_count=0,crc_byte_no =0;
   int loop_index;
   int64 i,k;//For looping
   byte xor,data_byte;
   dword crcTemp;
   byte DataLength;
   dword Msg_id;
   
   DataLength = Msg_BCM_PR_GW_1_UN.DataLength;//Message Data Length
   Msg_id  = Msg_BCM_PR_GW_1_UN.id;//Message ID
   
}


on sysvar CAN_MPC3::BCM_SP_GW_2_UN::BCM_SP_GW_2_UN_ON_OFF
{
  if (@this == 1)
  {
    ILFaultInjectionEnableMsg(CAN_MPC3::BCM_SP_GW_2_UN);
  }
  else{
         ILFaultInjectionDisableMsg(CAN_MPC3::BCM_SP_GW_2_UN);
      }
}

void cfg_Msg_BCM_SP_GW_2_UN(dword aDlc, byte data[])
{
   byte messagebytes[10];
   byte byte_count=0,crc_byte_no =0;
   int loop_index;
   int64 i,k;//For looping
   byte xor,data_byte;
   dword crcTemp;
   byte DataLength;
   dword Msg_id;
   
   DataLength = Msg_BCM_SP_GW_2_UN.DataLength;//Message Data Length
   Msg_id  = Msg_BCM_SP_GW_2_UN.id;//Message ID
   
}


on sysvar CAN_MPC3::CHCM_FR_PR_GW_2_UN::CHCM_FR_PR_GW_2_UN_ON_OFF
{
  if (@this == 1)
  {
    ILFaultInjectionEnableMsg(CAN_MPC3::CHCM_FR_PR_GW_2_UN);
  }
  else{
         ILFaultInjectionDisableMsg(CAN_MPC3::CHCM_FR_PR_GW_2_UN);
      }
}

void cfg_Msg_CHCM_FR_PR_GW_2_UN(dword aDlc, byte data[])
{
   byte messagebytes[10];
   byte byte_count=0,crc_byte_no =0;
   int loop_index;
   int64 i,k;//For looping
   byte xor,data_byte;
   dword crcTemp;
   byte DataLength;
   dword Msg_id;
   
   DataLength = Msg_CHCM_FR_PR_GW_2_UN.DataLength;//Message Data Length
   Msg_id  = Msg_CHCM_FR_PR_GW_2_UN.id;//Message ID
   
}


on sysvar CAN_MPC3::CHCM_FR_PR_GW_3_UN::CHCM_FR_PR_GW_3_UN_ON_OFF
{
  if (@this == 1)
  {
    ILFaultInjectionEnableMsg(CAN_MPC3::CHCM_FR_PR_GW_3_UN);
  }
  else{
         ILFaultInjectionDisableMsg(CAN_MPC3::CHCM_FR_PR_GW_3_UN);
      }
}

void cfg_Msg_CHCM_FR_PR_GW_3_UN(dword aDlc, byte data[])
{
   byte messagebytes[10];
   byte byte_count=0,crc_byte_no =0;
   int loop_index;
   int64 i,k;//For looping
   byte xor,data_byte;
   dword crcTemp;
   byte DataLength;
   dword Msg_id;
   
   DataLength = Msg_CHCM_FR_PR_GW_3_UN.DataLength;//Message Data Length
   Msg_id  = Msg_CHCM_FR_PR_GW_3_UN.id;//Message ID
   
}


on sysvar CAN_MPC3::DADCA_FR_PR_GW_4_UN::DADCA_FR_PR_GW_4_UN_ON_OFF
{
  if (@this == 1)
  {
    ILFaultInjectionEnableMsg(CAN_MPC3::DADCA_FR_PR_GW_4_UN);
  }
  else{
         ILFaultInjectionDisableMsg(CAN_MPC3::DADCA_FR_PR_GW_4_UN);
      }
}

void cfg_Msg_DADCA_FR_PR_GW_4_UN(dword aDlc, byte data[])
{
   byte messagebytes[10];
   byte byte_count=0,crc_byte_no =0;
   int loop_index;
   int64 i,k;//For looping
   byte xor,data_byte;
   dword crcTemp;
   byte DataLength;
   dword Msg_id;
   
   DataLength = Msg_DADCA_FR_PR_GW_4_UN.DataLength;//Message Data Length
   Msg_id  = Msg_DADCA_FR_PR_GW_4_UN.id;//Message ID
   
}


on sysvar CAN_MPC3::DADCA_UN_PR_3::DADCA_UN_PR_3_ON_OFF
{
  if (@this == 1)
  {
    ILFaultInjectionEnableMsg(CAN_MPC3::DADCA_UN_PR_3);
  }
  else{
         ILFaultInjectionDisableMsg(CAN_MPC3::DADCA_UN_PR_3);
      }
}

void cfg_Msg_DADCA_UN_PR_3(dword aDlc, byte data[])
{
   byte messagebytes[10];
   byte byte_count=0,crc_byte_no =0;
   int loop_index;
   int64 i,k;//For looping
   byte xor,data_byte;
   dword crcTemp;
   byte DataLength;
   dword Msg_id;
   
   DataLength = Msg_DADCA_UN_PR_3.DataLength;//Message Data Length
   Msg_id  = Msg_DADCA_UN_PR_3.id;//Message ID
   
}


on sysvar CAN_MPC3::DADCA_UN_PR_GW_2::DADCA_UN_PR_GW_2_ON_OFF
{
  if (@this == 1)
  {
    ILFaultInjectionEnableMsg(CAN_MPC3::DADCA_UN_PR_GW_2);
  }
  else{
         ILFaultInjectionDisableMsg(CAN_MPC3::DADCA_UN_PR_GW_2);
      }
}

void cfg_Msg_DADCA_UN_PR_GW_2(dword aDlc, byte data[])
{
   byte messagebytes[10];
   byte byte_count=0,crc_byte_no =0;
   int loop_index;
   int64 i,k;//For looping
   byte xor,data_byte;
   dword crcTemp;
   byte DataLength;
   dword Msg_id;
   
   DataLength = Msg_DADCA_UN_PR_GW_2.DataLength;//Message Data Length
   Msg_id  = Msg_DADCA_UN_PR_GW_2.id;//Message ID
   
    if (@CAN_MPC3::DADCA_UN_PR_GW_2::RWSSysAliveCnt1_FaultInject != 3)//AC: user defined value
    {

    clearBitsInByteArrayBE(data,8,11,4); //Motorola / Big-endian

    }
    if (@CAN_MPC3::DADCA_UN_PR_GW_2::RWSSysAliveCnt1_FaultInject == 0)//AC: No Error, calculate AC
    {
      ++counter_DADCA_UN_PR_GW_2_RWSSysAliveCnt1;
      counter_DADCA_UN_PR_GW_2_RWSSysAliveCnt1 %=15;

      copyBitsToByteArrayBE(counter_DADCA_UN_PR_GW_2_RWSSysAliveCnt1,data,8,4); //Motorola / Big-endian
    }
    else if (@CAN_MPC3::DADCA_UN_PR_GW_2::RWSSysAliveCnt1_FaultInject == 1)//AC: Error sequence: set AC = 0
    {

      copyBitsToByteArrayBE(0,data,8,4); //Motorola / Big-endian
    }
    else if (@CAN_MPC3::DADCA_UN_PR_GW_2::RWSSysAliveCnt1_FaultInject == 2)//AC: Error sequence: Freeze last valid value
    {

      copyBitsToByteArrayBE(counter_DADCA_UN_PR_GW_2_RWSSysAliveCnt1,data,8,4); //Motorola / Big-endian
    }
    if (@CAN_MPC3::DADCA_UN_PR_GW_2::RWSSysCS1_FaultInject != 3)//CRC: user defined value
    {

    clearBitsInByteArrayBE(data,0,7,8); //Motorola / Big-endian

    }
   messagebytes[0] = Data_ID_Lookup(Msg_id);
   messagebytes[1] = 0x00;
   crc_byte_no = 8;
   for(loop_index=0;loop_index < 7 ;loop_index++)
       messagebytes[loop_index+2] = data[loop_index+1];
   
    if(@CAN_MPC3::DADCA_UN_PR_GW_2::RWSSysCS1_FaultInject == 0)//CRC: No Error, calculate CRC
    {
      chksum_DADCA_UN_PR_GW_2_RWSSysCS1 = CRC_Calc_SAEJ1850(crc_byte_no, messagebytes);

      copyBitsToByteArrayBE(chksum_DADCA_UN_PR_GW_2_RWSSysCS1,data,0,8); //Motorola / Big-endian
    }
    else if(@CAN_MPC3::DADCA_UN_PR_GW_2::RWSSysCS1_FaultInject == 1)//CRC: Error, set to Zero
    {

      copyBitsToByteArrayBE(0,data,0,8); //Motorola / Big-endian
    }
    else if(@CAN_MPC3::DADCA_UN_PR_GW_2::RWSSysCS1_FaultInject == 2)//CRC: Error, Freeze last valid value
    {

      copyBitsToByteArrayBE(chksum_DADCA_UN_PR_GW_2_RWSSysCS1,data,0,8); //Motorola / Big-endian
    }
}


on sysvar CAN_MPC3::DADCA_UN_PR_GW_3::DADCA_UN_PR_GW_3_ON_OFF
{
  if (@this == 1)
  {
    ILFaultInjectionEnableMsg(CAN_MPC3::DADCA_UN_PR_GW_3);
  }
  else{
         ILFaultInjectionDisableMsg(CAN_MPC3::DADCA_UN_PR_GW_3);
      }
}

void cfg_Msg_DADCA_UN_PR_GW_3(dword aDlc, byte data[])
{
   byte messagebytes[10];
   byte byte_count=0,crc_byte_no =0;
   int loop_index;
   int64 i,k;//For looping
   byte xor,data_byte;
   dword crcTemp;
   byte DataLength;
   dword Msg_id;
   
   DataLength = Msg_DADCA_UN_PR_GW_3.DataLength;//Message Data Length
   Msg_id  = Msg_DADCA_UN_PR_GW_3.id;//Message ID
   
    if (@CAN_MPC3::DADCA_UN_PR_GW_3::RWSSysAliveCnt2_FaultInject != 3)//AC: user defined value
    {

    clearBitsInByteArrayBE(data,8,11,4); //Motorola / Big-endian

    }
    if (@CAN_MPC3::DADCA_UN_PR_GW_3::RWSSysAliveCnt2_FaultInject == 0)//AC: No Error, calculate AC
    {
      ++counter_DADCA_UN_PR_GW_3_RWSSysAliveCnt2;
      counter_DADCA_UN_PR_GW_3_RWSSysAliveCnt2 %=15;

      copyBitsToByteArrayBE(counter_DADCA_UN_PR_GW_3_RWSSysAliveCnt2,data,8,4); //Motorola / Big-endian
    }
    else if (@CAN_MPC3::DADCA_UN_PR_GW_3::RWSSysAliveCnt2_FaultInject == 1)//AC: Error sequence: set AC = 0
    {

      copyBitsToByteArrayBE(0,data,8,4); //Motorola / Big-endian
    }
    else if (@CAN_MPC3::DADCA_UN_PR_GW_3::RWSSysAliveCnt2_FaultInject == 2)//AC: Error sequence: Freeze last valid value
    {

      copyBitsToByteArrayBE(counter_DADCA_UN_PR_GW_3_RWSSysAliveCnt2,data,8,4); //Motorola / Big-endian
    }
    if (@CAN_MPC3::DADCA_UN_PR_GW_3::RWSSysCS2_FaultInject != 3)//CRC: user defined value
    {

    clearBitsInByteArrayBE(data,0,7,8); //Motorola / Big-endian

    }
   messagebytes[0] = Data_ID_Lookup(Msg_id);
   messagebytes[1] = 0x00;
   crc_byte_no = 8;
   for(loop_index=0;loop_index < 7 ;loop_index++)
       messagebytes[loop_index+2] = data[loop_index+1];
   
    if(@CAN_MPC3::DADCA_UN_PR_GW_3::RWSSysCS2_FaultInject == 0)//CRC: No Error, calculate CRC
    {
      chksum_DADCA_UN_PR_GW_3_RWSSysCS2 = CRC_Calc_SAEJ1850(crc_byte_no, messagebytes);

      copyBitsToByteArrayBE(chksum_DADCA_UN_PR_GW_3_RWSSysCS2,data,0,8); //Motorola / Big-endian
    }
    else if(@CAN_MPC3::DADCA_UN_PR_GW_3::RWSSysCS2_FaultInject == 1)//CRC: Error, set to Zero
    {

      copyBitsToByteArrayBE(0,data,0,8); //Motorola / Big-endian
    }
    else if(@CAN_MPC3::DADCA_UN_PR_GW_3::RWSSysCS2_FaultInject == 2)//CRC: Error, Freeze last valid value
    {

      copyBitsToByteArrayBE(chksum_DADCA_UN_PR_GW_3_RWSSysCS2,data,0,8); //Motorola / Big-endian
    }
}


on sysvar CAN_MPC3::DADCA_UN_SP_5::DADCA_UN_SP_5_ON_OFF
{
  if (@this == 1)
  {
    ILFaultInjectionEnableMsg(CAN_MPC3::DADCA_UN_SP_5);
  }
  else{
         ILFaultInjectionDisableMsg(CAN_MPC3::DADCA_UN_SP_5);
      }
}

void cfg_Msg_DADCA_UN_SP_5(dword aDlc, byte data[])
{
   byte messagebytes[10];
   byte byte_count=0,crc_byte_no =0;
   int loop_index;
   int64 i,k;//For looping
   byte xor,data_byte;
   dword crcTemp;
   byte DataLength;
   dword Msg_id;
   
   DataLength = Msg_DADCA_UN_SP_5.DataLength;//Message Data Length
   Msg_id  = Msg_DADCA_UN_SP_5.id;//Message ID
   
}


on sysvar CAN_MPC3::DBC_Version::DBC_Version_ON_OFF
{
  if (@this == 1)
  {
    ILFaultInjectionEnableMsg(CAN_MPC3::DBC_Version);
  }
  else{
         ILFaultInjectionDisableMsg(CAN_MPC3::DBC_Version);
      }
}

void cfg_Msg_DBC_Version(dword aDlc, byte data[])
{
   byte messagebytes[10];
   byte byte_count=0,crc_byte_no =0;
   int loop_index;
   int64 i,k;//For looping
   byte xor,data_byte;
   dword crcTemp;
   byte DataLength;
   dword Msg_id;
   
   DataLength = Msg_DBC_Version.DataLength;//Message Data Length
   Msg_id  = Msg_DBC_Version.id;//Message ID
   
}


on sysvar CAN_MPC3::GSR_ISA_CAN_RX_01::GSR_ISA_CAN_RX_01_ON_OFF
{
  if (@this == 1)
  {
     ILSetMsgEvent(CAN_MPC3::GSR_ISA_CAN_RX_01);
     @CAN_MPC3::GSR_ISA_CAN_RX_01::GSR_ISA_CAN_RX_01_ON_OFF = 0;
  }
}

void cfg_Msg_GSR_ISA_CAN_RX_01(dword aDlc, byte data[])
{
   byte messagebytes[10];
   byte byte_count=0,crc_byte_no =0;
   int loop_index;
   int64 i,k;//For looping
   byte xor,data_byte;
   dword crcTemp;
   byte DataLength;
   dword Msg_id;
   
   DataLength = Msg_GSR_ISA_CAN_RX_01.DataLength;//Message Data Length
   Msg_id  = Msg_GSR_ISA_CAN_RX_01.id;//Message ID
   
}


on sysvar CAN_MPC3::GWM_UN_PR_1::GWM_UN_PR_1_ON_OFF
{
  if (@this == 1)
  {
    ILFaultInjectionEnableMsg(CAN_MPC3::GWM_UN_PR_1);
  }
  else{
         ILFaultInjectionDisableMsg(CAN_MPC3::GWM_UN_PR_1);
      }
}

void cfg_Msg_GWM_UN_PR_1(dword aDlc, byte data[])
{
   byte messagebytes[10];
   byte byte_count=0,crc_byte_no =0;
   int loop_index;
   int64 i,k;//For looping
   byte xor,data_byte;
   dword crcTemp;
   byte DataLength;
   dword Msg_id;
   
   DataLength = Msg_GWM_UN_PR_1.DataLength;//Message Data Length
   Msg_id  = Msg_GWM_UN_PR_1.id;//Message ID
   
}


on sysvar CAN_MPC3::HCMA_PR_1::HCMA_PR_1_ON_OFF
{
  if (@this == 1)
  {
    ILFaultInjectionEnableMsg(CAN_MPC3::HCMA_PR_1);
  }
  else{
         ILFaultInjectionDisableMsg(CAN_MPC3::HCMA_PR_1);
      }
}

void cfg_Msg_HCMA_PR_1(dword aDlc, byte data[])
{
   byte messagebytes[10];
   byte byte_count=0,crc_byte_no =0;
   int loop_index;
   int64 i,k;//For looping
   byte xor,data_byte;
   dword crcTemp;
   byte DataLength;
   dword Msg_id;
   
   DataLength = Msg_HCMA_PR_1.DataLength;//Message Data Length
   Msg_id  = Msg_HCMA_PR_1.id;//Message ID
   
}


on sysvar CAN_MPC3::HCMA_PR_2::HCMA_PR_2_ON_OFF
{
  if (@this == 1)
  {
    ILFaultInjectionEnableMsg(CAN_MPC3::HCMA_PR_2);
  }
  else{
         ILFaultInjectionDisableMsg(CAN_MPC3::HCMA_PR_2);
      }
}

void cfg_Msg_HCMA_PR_2(dword aDlc, byte data[])
{
   byte messagebytes[10];
   byte byte_count=0,crc_byte_no =0;
   int loop_index;
   int64 i,k;//For looping
   byte xor,data_byte;
   dword crcTemp;
   byte DataLength;
   dword Msg_id;
   
   DataLength = Msg_HCMA_PR_2.DataLength;//Message Data Length
   Msg_id  = Msg_HCMA_PR_2.id;//Message ID
   
}


on sysvar CAN_MPC3::HCMB_PR_1::HCMB_PR_1_ON_OFF
{
  if (@this == 1)
  {
    ILFaultInjectionEnableMsg(CAN_MPC3::HCMB_PR_1);
  }
  else{
         ILFaultInjectionDisableMsg(CAN_MPC3::HCMB_PR_1);
      }
}

void cfg_Msg_HCMB_PR_1(dword aDlc, byte data[])
{
   byte messagebytes[10];
   byte byte_count=0,crc_byte_no =0;
   int loop_index;
   int64 i,k;//For looping
   byte xor,data_byte;
   dword crcTemp;
   byte DataLength;
   dword Msg_id;
   
   DataLength = Msg_HCMB_PR_1.DataLength;//Message Data Length
   Msg_id  = Msg_HCMB_PR_1.id;//Message ID
   
}


on sysvar CAN_MPC3::IGM_PR_GW_7_UN::IGM_PR_GW_7_UN_ON_OFF
{
  if (@this == 1)
  {
    ILFaultInjectionEnableMsg(CAN_MPC3::IGM_PR_GW_7_UN);
  }
  else{
         ILFaultInjectionDisableMsg(CAN_MPC3::IGM_PR_GW_7_UN);
      }
}

void cfg_Msg_IGM_PR_GW_7_UN(dword aDlc, byte data[])
{
   byte messagebytes[10];
   byte byte_count=0,crc_byte_no =0;
   int loop_index;
   int64 i,k;//For looping
   byte xor,data_byte;
   dword crcTemp;
   byte DataLength;
   dword Msg_id;
   
   DataLength = Msg_IGM_PR_GW_7_UN.DataLength;//Message Data Length
   Msg_id  = Msg_IGM_PR_GW_7_UN.id;//Message ID
   
}


on sysvar CAN_MPC3::IGM_SP_GW_10_UN::IGM_SP_GW_10_UN_ON_OFF
{
  if (@this == 1)
  {
    ILFaultInjectionEnableMsg(CAN_MPC3::IGM_SP_GW_10_UN);
  }
  else{
         ILFaultInjectionDisableMsg(CAN_MPC3::IGM_SP_GW_10_UN);
      }
}

void cfg_Msg_IGM_SP_GW_10_UN(dword aDlc, byte data[])
{
   byte messagebytes[10];
   byte byte_count=0,crc_byte_no =0;
   int loop_index;
   int64 i,k;//For looping
   byte xor,data_byte;
   dword crcTemp;
   byte DataLength;
   dword Msg_id;
   
   DataLength = Msg_IGM_SP_GW_10_UN.DataLength;//Message Data Length
   Msg_id  = Msg_IGM_SP_GW_10_UN.id;//Message ID
   
}


on sysvar CAN_MPC3::IMU_TX1::IMU_TX1_ON_OFF
{
  if (@this == 1)
  {
    ILFaultInjectionEnableMsg(CAN_MPC3::IMU_TX1);
  }
  else{
         ILFaultInjectionDisableMsg(CAN_MPC3::IMU_TX1);
      }
}

void cfg_Msg_IMU_TX1(dword aDlc, byte data[])
{
   byte messagebytes[10];
   byte byte_count=0,crc_byte_no =0;
   int loop_index;
   int64 i,k;//For looping
   byte xor,data_byte;
   dword crcTemp;
   byte DataLength;
   dword Msg_id;
   
   DataLength = Msg_IMU_TX1.DataLength;//Message Data Length
   Msg_id  = Msg_IMU_TX1.id;//Message ID
   
}


on sysvar CAN_MPC3::IMU_TX2::IMU_TX2_ON_OFF
{
  if (@this == 1)
  {
    ILFaultInjectionEnableMsg(CAN_MPC3::IMU_TX2);
  }
  else{
         ILFaultInjectionDisableMsg(CAN_MPC3::IMU_TX2);
      }
}

void cfg_Msg_IMU_TX2(dword aDlc, byte data[])
{
   byte messagebytes[10];
   byte byte_count=0,crc_byte_no =0;
   int loop_index;
   int64 i,k;//For looping
   byte xor,data_byte;
   dword crcTemp;
   byte DataLength;
   dword Msg_id;
   
   DataLength = Msg_IMU_TX2.DataLength;//Message Data Length
   Msg_id  = Msg_IMU_TX2.id;//Message ID
   
}


on sysvar CAN_MPC3::IPC_PR_GW_5_UN::IPC_PR_GW_5_UN_ON_OFF
{
  if (@this == 1)
  {
    ILFaultInjectionEnableMsg(CAN_MPC3::IPC_PR_GW_5_UN);
  }
  else{
         ILFaultInjectionDisableMsg(CAN_MPC3::IPC_PR_GW_5_UN);
      }
}

void cfg_Msg_IPC_PR_GW_5_UN(dword aDlc, byte data[])
{
   byte messagebytes[10];
   byte byte_count=0,crc_byte_no =0;
   int loop_index;
   int64 i,k;//For looping
   byte xor,data_byte;
   dword crcTemp;
   byte DataLength;
   dword Msg_id;
   
   DataLength = Msg_IPC_PR_GW_5_UN.DataLength;//Message Data Length
   Msg_id  = Msg_IPC_PR_GW_5_UN.id;//Message ID
   
    if (@CAN_MPC3::IPC_PR_GW_5_UN::IPCAliveCnt_FaultInject != 3)//AC: user defined value
    {

    clearBitsInByteArrayBE(data,8,11,4); //Motorola / Big-endian

    }
    if (@CAN_MPC3::IPC_PR_GW_5_UN::IPCAliveCnt_FaultInject == 0)//AC: No Error, calculate AC
    {
      ++counter_IPC_PR_GW_5_UN_IPCAliveCnt;
      counter_IPC_PR_GW_5_UN_IPCAliveCnt %=15;

      copyBitsToByteArrayBE(counter_IPC_PR_GW_5_UN_IPCAliveCnt,data,8,4); //Motorola / Big-endian
    }
    else if (@CAN_MPC3::IPC_PR_GW_5_UN::IPCAliveCnt_FaultInject == 1)//AC: Error sequence: set AC = 0
    {

      copyBitsToByteArrayBE(0,data,8,4); //Motorola / Big-endian
    }
    else if (@CAN_MPC3::IPC_PR_GW_5_UN::IPCAliveCnt_FaultInject == 2)//AC: Error sequence: Freeze last valid value
    {

      copyBitsToByteArrayBE(counter_IPC_PR_GW_5_UN_IPCAliveCnt,data,8,4); //Motorola / Big-endian
    }
}


on sysvar CAN_MPC3::LANE_02::LANE_02_ON_OFF
{
  if (@this == 1)
  {
    ILFaultInjectionEnableMsg(CAN_MPC3::LANE_02);
  }
  else{
         ILFaultInjectionDisableMsg(CAN_MPC3::LANE_02);
      }
}

void cfg_Msg_LANE_02(dword aDlc, byte data[])
{
   byte messagebytes[10];
   byte byte_count=0,crc_byte_no =0;
   int loop_index;
   int64 i,k;//For looping
   byte xor,data_byte;
   dword crcTemp;
   byte DataLength;
   dword Msg_id;
   
   DataLength = Msg_LANE_02.DataLength;//Message Data Length
   Msg_id  = Msg_LANE_02.id;//Message ID
   
}


on sysvar CAN_MPC3::LANE_05::LANE_05_ON_OFF
{
  if (@this == 1)
  {
    ILFaultInjectionEnableMsg(CAN_MPC3::LANE_05);
  }
  else{
         ILFaultInjectionDisableMsg(CAN_MPC3::LANE_05);
      }
}

void cfg_Msg_LANE_05(dword aDlc, byte data[])
{
   byte messagebytes[10];
   byte byte_count=0,crc_byte_no =0;
   int loop_index;
   int64 i,k;//For looping
   byte xor,data_byte;
   dword crcTemp;
   byte DataLength;
   dword Msg_id;
   
   DataLength = Msg_LANE_05.DataLength;//Message Data Length
   Msg_id  = Msg_LANE_05.id;//Message ID
   
}


on sysvar CAN_MPC3::LHSWS_PR_GW_1_UN::LHSWS_PR_GW_1_UN_ON_OFF
{
  if (@this == 1)
  {
     ILSetMsgEvent(CAN_MPC3::LHSWS_PR_GW_1_UN);
     @CAN_MPC3::LHSWS_PR_GW_1_UN::LHSWS_PR_GW_1_UN_ON_OFF = 0;
  }
}

void cfg_Msg_LHSWS_PR_GW_1_UN(dword aDlc, byte data[])
{
   byte messagebytes[10];
   byte byte_count=0,crc_byte_no =0;
   int loop_index;
   int64 i,k;//For looping
   byte xor,data_byte;
   dword crcTemp;
   byte DataLength;
   dword Msg_id;
   
   DataLength = Msg_LHSWS_PR_GW_1_UN.DataLength;//Message Data Length
   Msg_id  = Msg_LHSWS_PR_GW_1_UN.id;//Message ID
   
}


on sysvar CAN_MPC3::LIGHT_01::LIGHT_01_ON_OFF
{
  if (@this == 1)
  {
    ILFaultInjectionEnableMsg(CAN_MPC3::LIGHT_01);
  }
  else{
         ILFaultInjectionDisableMsg(CAN_MPC3::LIGHT_01);
      }
}

void cfg_Msg_LIGHT_01(dword aDlc, byte data[])
{
   byte messagebytes[10];
   byte byte_count=0,crc_byte_no =0;
   int loop_index;
   int64 i,k;//For looping
   byte xor,data_byte;
   dword crcTemp;
   byte DataLength;
   dword Msg_id;
   
   DataLength = Msg_LIGHT_01.DataLength;//Message Data Length
   Msg_id  = Msg_LIGHT_01.id;//Message ID
   
}


on sysvar CAN_MPC3::PCM_FR_PR_Core_B_UN::PCM_FR_PR_Core_B_UN_ON_OFF
{
  if (@this == 1)
  {
    ILFaultInjectionEnableMsg(CAN_MPC3::PCM_FR_PR_Core_B_UN);
  }
  else{
         ILFaultInjectionDisableMsg(CAN_MPC3::PCM_FR_PR_Core_B_UN);
      }
}

void cfg_Msg_PCM_FR_PR_Core_B_UN(dword aDlc, byte data[])
{
   byte messagebytes[10];
   byte byte_count=0,crc_byte_no =0;
   int loop_index;
   int64 i,k;//For looping
   byte xor,data_byte;
   dword crcTemp;
   byte DataLength;
   dword Msg_id;
   
   DataLength = Msg_PCM_FR_PR_Core_B_UN.DataLength;//Message Data Length
   Msg_id  = Msg_PCM_FR_PR_Core_B_UN.id;//Message ID
   
    if (@CAN_MPC3::PCM_FR_PR_Core_B_UN::EMSAliveCounter_FaultInject != 3)//AC: user defined value
    {

    clearBitsInByteArrayBE(data,8,11,4); //Motorola / Big-endian

    }
    if (@CAN_MPC3::PCM_FR_PR_Core_B_UN::EMSAliveCounter_FaultInject == 0)//AC: No Error, calculate AC
    {
      ++counter_PCM_FR_PR_Core_B_UN_EMSAliveCounter;
      counter_PCM_FR_PR_Core_B_UN_EMSAliveCounter %=15;

      copyBitsToByteArrayBE(counter_PCM_FR_PR_Core_B_UN_EMSAliveCounter,data,8,4); //Motorola / Big-endian
    }
    else if (@CAN_MPC3::PCM_FR_PR_Core_B_UN::EMSAliveCounter_FaultInject == 1)//AC: Error sequence: set AC = 0
    {

      copyBitsToByteArrayBE(0,data,8,4); //Motorola / Big-endian
    }
    else if (@CAN_MPC3::PCM_FR_PR_Core_B_UN::EMSAliveCounter_FaultInject == 2)//AC: Error sequence: Freeze last valid value
    {

      copyBitsToByteArrayBE(counter_PCM_FR_PR_Core_B_UN_EMSAliveCounter,data,8,4); //Motorola / Big-endian
    }
    if (@CAN_MPC3::PCM_FR_PR_Core_B_UN::EMSChecksum_FaultInject != 3)//CRC: user defined value
    {

    clearBitsInByteArrayBE(data,0,7,8); //Motorola / Big-endian

    }
   messagebytes[0] = Data_ID_Lookup(Msg_id);
   messagebytes[1] = 0x00;
   crc_byte_no = 5;
   for(loop_index=0;loop_index < 4 ;loop_index++)
       messagebytes[loop_index+2] = data[loop_index+1];
   
    if(@CAN_MPC3::PCM_FR_PR_Core_B_UN::EMSChecksum_FaultInject == 0)//CRC: No Error, calculate CRC
    {
      chksum_PCM_FR_PR_Core_B_UN_EMSChecksum = CRC_Calc_SAEJ1850(crc_byte_no, messagebytes);

      copyBitsToByteArrayBE(chksum_PCM_FR_PR_Core_B_UN_EMSChecksum,data,0,8); //Motorola / Big-endian
    }
    else if(@CAN_MPC3::PCM_FR_PR_Core_B_UN::EMSChecksum_FaultInject == 1)//CRC: Error, set to Zero
    {

      copyBitsToByteArrayBE(0,data,0,8); //Motorola / Big-endian
    }
    else if(@CAN_MPC3::PCM_FR_PR_Core_B_UN::EMSChecksum_FaultInject == 2)//CRC: Error, Freeze last valid value
    {

      copyBitsToByteArrayBE(chksum_PCM_FR_PR_Core_B_UN_EMSChecksum,data,0,8); //Motorola / Big-endian
    }
}


on sysvar CAN_MPC3::PCM_FR_PR_PedalPos_UN::PCM_FR_PR_PedalPos_UN_ON_OFF
{
  if (@this == 1)
  {
    ILFaultInjectionEnableMsg(CAN_MPC3::PCM_FR_PR_PedalPos_UN);
  }
  else{
         ILFaultInjectionDisableMsg(CAN_MPC3::PCM_FR_PR_PedalPos_UN);
      }
}

void cfg_Msg_PCM_FR_PR_PedalPos_UN(dword aDlc, byte data[])
{
   byte messagebytes[10];
   byte byte_count=0,crc_byte_no =0;
   int loop_index;
   int64 i,k;//For looping
   byte xor,data_byte;
   dword crcTemp;
   byte DataLength;
   dword Msg_id;
   
   DataLength = Msg_PCM_FR_PR_PedalPos_UN.DataLength;//Message Data Length
   Msg_id  = Msg_PCM_FR_PR_PedalPos_UN.id;//Message ID
   
    if (@CAN_MPC3::PCM_FR_PR_PedalPos_UN::PedalPosProAliveCounter_FaultInject != 3)//AC: user defined value
    {

    clearBitsInByteArrayBE(data,8,11,4); //Motorola / Big-endian

    }
    if (@CAN_MPC3::PCM_FR_PR_PedalPos_UN::PedalPosProAliveCounter_FaultInject == 0)//AC: No Error, calculate AC
    {
      ++counter_PCM_FR_PR_PedalPos_UN_PedalPosProAliveCounter;
      counter_PCM_FR_PR_PedalPos_UN_PedalPosProAliveCounter %=15;

      copyBitsToByteArrayBE(counter_PCM_FR_PR_PedalPos_UN_PedalPosProAliveCounter,data,8,4); //Motorola / Big-endian
    }
    else if (@CAN_MPC3::PCM_FR_PR_PedalPos_UN::PedalPosProAliveCounter_FaultInject == 1)//AC: Error sequence: set AC = 0
    {

      copyBitsToByteArrayBE(0,data,8,4); //Motorola / Big-endian
    }
    else if (@CAN_MPC3::PCM_FR_PR_PedalPos_UN::PedalPosProAliveCounter_FaultInject == 2)//AC: Error sequence: Freeze last valid value
    {

      copyBitsToByteArrayBE(counter_PCM_FR_PR_PedalPos_UN_PedalPosProAliveCounter,data,8,4); //Motorola / Big-endian
    }
    if (@CAN_MPC3::PCM_FR_PR_PedalPos_UN::PedalPosProChecksum_FaultInject != 3)//CRC: user defined value
    {

    clearBitsInByteArrayBE(data,0,7,8); //Motorola / Big-endian

    }
   messagebytes[0] = Data_ID_Lookup(Msg_id);
   messagebytes[1] = 0x00;
   crc_byte_no = 2;
   for(loop_index=0;loop_index < 1 ;loop_index++)
       messagebytes[loop_index+2] = data[loop_index+1];
   
    if(@CAN_MPC3::PCM_FR_PR_PedalPos_UN::PedalPosProChecksum_FaultInject == 0)//CRC: No Error, calculate CRC
    {
      chksum_PCM_FR_PR_PedalPos_UN_PedalPosProChecksum = CRC_Calc_SAEJ1850(crc_byte_no, messagebytes);

      copyBitsToByteArrayBE(chksum_PCM_FR_PR_PedalPos_UN_PedalPosProChecksum,data,0,8); //Motorola / Big-endian
    }
    else if(@CAN_MPC3::PCM_FR_PR_PedalPos_UN::PedalPosProChecksum_FaultInject == 1)//CRC: Error, set to Zero
    {

      copyBitsToByteArrayBE(0,data,0,8); //Motorola / Big-endian
    }
    else if(@CAN_MPC3::PCM_FR_PR_PedalPos_UN::PedalPosProChecksum_FaultInject == 2)//CRC: Error, Freeze last valid value
    {

      copyBitsToByteArrayBE(chksum_PCM_FR_PR_PedalPos_UN_PedalPosProChecksum,data,0,8); //Motorola / Big-endian
    }
}


on sysvar CAN_MPC3::PCM_FR_PR_WhlTorqTgt_UN::PCM_FR_PR_WhlTorqTgt_UN_ON_OFF
{
  if (@this == 1)
  {
    ILFaultInjectionEnableMsg(CAN_MPC3::PCM_FR_PR_WhlTorqTgt_UN);
  }
  else{
         ILFaultInjectionDisableMsg(CAN_MPC3::PCM_FR_PR_WhlTorqTgt_UN);
      }
}

void cfg_Msg_PCM_FR_PR_WhlTorqTgt_UN(dword aDlc, byte data[])
{
   byte messagebytes[10];
   byte byte_count=0,crc_byte_no =0;
   int loop_index;
   int64 i,k;//For looping
   byte xor,data_byte;
   dword crcTemp;
   byte DataLength;
   dword Msg_id;
   
   DataLength = Msg_PCM_FR_PR_WhlTorqTgt_UN.DataLength;//Message Data Length
   Msg_id  = Msg_PCM_FR_PR_WhlTorqTgt_UN.id;//Message ID
   
    if (@CAN_MPC3::PCM_FR_PR_WhlTorqTgt_UN::WheelTorqTgtGpCounter_FaultInject != 3)//AC: user defined value
    {

    clearBitsInByteArrayBE(data,8,11,4); //Motorola / Big-endian

    }
    if (@CAN_MPC3::PCM_FR_PR_WhlTorqTgt_UN::WheelTorqTgtGpCounter_FaultInject == 0)//AC: No Error, calculate AC
    {
      ++counter_PCM_FR_PR_WhlTorqTgt_UN_WheelTorqTgtGpCounter;
      counter_PCM_FR_PR_WhlTorqTgt_UN_WheelTorqTgtGpCounter %=15;

      copyBitsToByteArrayBE(counter_PCM_FR_PR_WhlTorqTgt_UN_WheelTorqTgtGpCounter,data,8,4); //Motorola / Big-endian
    }
    else if (@CAN_MPC3::PCM_FR_PR_WhlTorqTgt_UN::WheelTorqTgtGpCounter_FaultInject == 1)//AC: Error sequence: set AC = 0
    {

      copyBitsToByteArrayBE(0,data,8,4); //Motorola / Big-endian
    }
    else if (@CAN_MPC3::PCM_FR_PR_WhlTorqTgt_UN::WheelTorqTgtGpCounter_FaultInject == 2)//AC: Error sequence: Freeze last valid value
    {

      copyBitsToByteArrayBE(counter_PCM_FR_PR_WhlTorqTgt_UN_WheelTorqTgtGpCounter,data,8,4); //Motorola / Big-endian
    }
    if (@CAN_MPC3::PCM_FR_PR_WhlTorqTgt_UN::WheelTorqTgtGpCS_FaultInject != 3)//CRC: user defined value
    {

    clearBitsInByteArrayBE(data,0,7,8); //Motorola / Big-endian

    }
   messagebytes[0] = Data_ID_Lookup(Msg_id);
   messagebytes[1] = 0x00;
   crc_byte_no = 6;
   for(loop_index=0;loop_index < 5 ;loop_index++)
       messagebytes[loop_index+2] = data[loop_index+1];
   
    if(@CAN_MPC3::PCM_FR_PR_WhlTorqTgt_UN::WheelTorqTgtGpCS_FaultInject == 0)//CRC: No Error, calculate CRC
    {
      chksum_PCM_FR_PR_WhlTorqTgt_UN_WheelTorqTgtGpCS = CRC_Calc_SAEJ1850(crc_byte_no, messagebytes);

      copyBitsToByteArrayBE(chksum_PCM_FR_PR_WhlTorqTgt_UN_WheelTorqTgtGpCS,data,0,8); //Motorola / Big-endian
    }
    else if(@CAN_MPC3::PCM_FR_PR_WhlTorqTgt_UN::WheelTorqTgtGpCS_FaultInject == 1)//CRC: Error, set to Zero
    {

      copyBitsToByteArrayBE(0,data,0,8); //Motorola / Big-endian
    }
    else if(@CAN_MPC3::PCM_FR_PR_WhlTorqTgt_UN::WheelTorqTgtGpCS_FaultInject == 2)//CRC: Error, Freeze last valid value
    {

      copyBitsToByteArrayBE(chksum_PCM_FR_PR_WhlTorqTgt_UN_WheelTorqTgtGpCS,data,0,8); //Motorola / Big-endian
    }
}


on sysvar CAN_MPC3::PSCM_FR_PR_GW_1_UN::PSCM_FR_PR_GW_1_UN_ON_OFF
{
  if (@this == 1)
  {
    ILFaultInjectionEnableMsg(CAN_MPC3::PSCM_FR_PR_GW_1_UN);
  }
  else{
         ILFaultInjectionDisableMsg(CAN_MPC3::PSCM_FR_PR_GW_1_UN);
      }
}

void cfg_Msg_PSCM_FR_PR_GW_1_UN(dword aDlc, byte data[])
{
   byte messagebytes[10];
   byte byte_count=0,crc_byte_no =0;
   int loop_index;
   int64 i,k;//For looping
   byte xor,data_byte;
   dword crcTemp;
   byte DataLength;
   dword Msg_id;
   
   DataLength = Msg_PSCM_FR_PR_GW_1_UN.DataLength;//Message Data Length
   Msg_id  = Msg_PSCM_FR_PR_GW_1_UN.id;//Message ID
   
    if (@CAN_MPC3::PSCM_FR_PR_GW_1_UN::TorsionBarTorqueCtr_FaultInject != 3)//AC: user defined value
    {

    clearBitsInByteArrayBE(data,8,11,4); //Motorola / Big-endian

    }
    if (@CAN_MPC3::PSCM_FR_PR_GW_1_UN::TorsionBarTorqueCtr_FaultInject == 0)//AC: No Error, calculate AC
    {
      ++counter_PSCM_FR_PR_GW_1_UN_TorsionBarTorqueCtr;
      counter_PSCM_FR_PR_GW_1_UN_TorsionBarTorqueCtr %=15;

      copyBitsToByteArrayBE(counter_PSCM_FR_PR_GW_1_UN_TorsionBarTorqueCtr,data,8,4); //Motorola / Big-endian
    }
    else if (@CAN_MPC3::PSCM_FR_PR_GW_1_UN::TorsionBarTorqueCtr_FaultInject == 1)//AC: Error sequence: set AC = 0
    {

      copyBitsToByteArrayBE(0,data,8,4); //Motorola / Big-endian
    }
    else if (@CAN_MPC3::PSCM_FR_PR_GW_1_UN::TorsionBarTorqueCtr_FaultInject == 2)//AC: Error sequence: Freeze last valid value
    {

      copyBitsToByteArrayBE(counter_PSCM_FR_PR_GW_1_UN_TorsionBarTorqueCtr,data,8,4); //Motorola / Big-endian
    }
    if (@CAN_MPC3::PSCM_FR_PR_GW_1_UN::TorsionBarTorqueCS_FaultInject != 3)//CRC: user defined value
    {

    clearBitsInByteArrayBE(data,0,7,8); //Motorola / Big-endian

    }
   messagebytes[0] = Data_ID_Lookup(Msg_id);
   messagebytes[1] = 0x00;
   crc_byte_no = 4;
   for(loop_index=0;loop_index < 3 ;loop_index++)
       messagebytes[loop_index+2] = data[loop_index+1];
   
    if(@CAN_MPC3::PSCM_FR_PR_GW_1_UN::TorsionBarTorqueCS_FaultInject == 0)//CRC: No Error, calculate CRC
    {
      chksum_PSCM_FR_PR_GW_1_UN_TorsionBarTorqueCS = CRC_Calc_SAEJ1850(crc_byte_no, messagebytes);

      copyBitsToByteArrayBE(chksum_PSCM_FR_PR_GW_1_UN_TorsionBarTorqueCS,data,0,8); //Motorola / Big-endian
    }
    else if(@CAN_MPC3::PSCM_FR_PR_GW_1_UN::TorsionBarTorqueCS_FaultInject == 1)//CRC: Error, set to Zero
    {

      copyBitsToByteArrayBE(0,data,0,8); //Motorola / Big-endian
    }
    else if(@CAN_MPC3::PSCM_FR_PR_GW_1_UN::TorsionBarTorqueCS_FaultInject == 2)//CRC: Error, Freeze last valid value
    {

      copyBitsToByteArrayBE(chksum_PSCM_FR_PR_GW_1_UN_TorsionBarTorqueCS,data,0,8); //Motorola / Big-endian
    }
}


on sysvar CAN_MPC3::PSCM_FR_PR_GW_2_UN::PSCM_FR_PR_GW_2_UN_ON_OFF
{
  if (@this == 1)
  {
    ILFaultInjectionEnableMsg(CAN_MPC3::PSCM_FR_PR_GW_2_UN);
  }
  else{
         ILFaultInjectionDisableMsg(CAN_MPC3::PSCM_FR_PR_GW_2_UN);
      }
}

void cfg_Msg_PSCM_FR_PR_GW_2_UN(dword aDlc, byte data[])
{
   byte messagebytes[10];
   byte byte_count=0,crc_byte_no =0;
   int loop_index;
   int64 i,k;//For looping
   byte xor,data_byte;
   dword crcTemp;
   byte DataLength;
   dword Msg_id;
   
   DataLength = Msg_PSCM_FR_PR_GW_2_UN.DataLength;//Message Data Length
   Msg_id  = Msg_PSCM_FR_PR_GW_2_UN.id;//Message ID
   
    if (@CAN_MPC3::PSCM_FR_PR_GW_2_UN::ActRoadWheelAngleAC_FaultInject != 3)//AC: user defined value
    {

    clearBitsInByteArrayBE(data,8,11,4); //Motorola / Big-endian

    }
    if (@CAN_MPC3::PSCM_FR_PR_GW_2_UN::ActRoadWheelAngleAC_FaultInject == 0)//AC: No Error, calculate AC
    {
      ++counter_PSCM_FR_PR_GW_2_UN_ActRoadWheelAngleAC;
      counter_PSCM_FR_PR_GW_2_UN_ActRoadWheelAngleAC %=15;

      copyBitsToByteArrayBE(counter_PSCM_FR_PR_GW_2_UN_ActRoadWheelAngleAC,data,8,4); //Motorola / Big-endian
    }
    else if (@CAN_MPC3::PSCM_FR_PR_GW_2_UN::ActRoadWheelAngleAC_FaultInject == 1)//AC: Error sequence: set AC = 0
    {

      copyBitsToByteArrayBE(0,data,8,4); //Motorola / Big-endian
    }
    else if (@CAN_MPC3::PSCM_FR_PR_GW_2_UN::ActRoadWheelAngleAC_FaultInject == 2)//AC: Error sequence: Freeze last valid value
    {

      copyBitsToByteArrayBE(counter_PSCM_FR_PR_GW_2_UN_ActRoadWheelAngleAC,data,8,4); //Motorola / Big-endian
    }
    if (@CAN_MPC3::PSCM_FR_PR_GW_2_UN::ActRoadWheelAngleCS_FaultInject != 3)//CRC: user defined value
    {

    clearBitsInByteArrayBE(data,0,7,8); //Motorola / Big-endian

    }
   messagebytes[0] = Data_ID_Lookup(Msg_id);
   messagebytes[1] = 0x00;
   crc_byte_no = 4;
   for(loop_index=0;loop_index < 3 ;loop_index++)
       messagebytes[loop_index+2] = data[loop_index+1];
   
    if(@CAN_MPC3::PSCM_FR_PR_GW_2_UN::ActRoadWheelAngleCS_FaultInject == 0)//CRC: No Error, calculate CRC
    {
      chksum_PSCM_FR_PR_GW_2_UN_ActRoadWheelAngleCS = CRC_Calc_SAEJ1850(crc_byte_no, messagebytes);

      copyBitsToByteArrayBE(chksum_PSCM_FR_PR_GW_2_UN_ActRoadWheelAngleCS,data,0,8); //Motorola / Big-endian
    }
    else if(@CAN_MPC3::PSCM_FR_PR_GW_2_UN::ActRoadWheelAngleCS_FaultInject == 1)//CRC: Error, set to Zero
    {

      copyBitsToByteArrayBE(0,data,0,8); //Motorola / Big-endian
    }
    else if(@CAN_MPC3::PSCM_FR_PR_GW_2_UN::ActRoadWheelAngleCS_FaultInject == 2)//CRC: Error, Freeze last valid value
    {

      copyBitsToByteArrayBE(chksum_PSCM_FR_PR_GW_2_UN_ActRoadWheelAngleCS,data,0,8); //Motorola / Big-endian
    }
}


on sysvar CAN_MPC3::RCM_FR_PR_GW_1_UN::RCM_FR_PR_GW_1_UN_ON_OFF
{
  if (@this == 1)
  {
    ILFaultInjectionEnableMsg(CAN_MPC3::RCM_FR_PR_GW_1_UN);
  }
  else{
         ILFaultInjectionDisableMsg(CAN_MPC3::RCM_FR_PR_GW_1_UN);
      }
}

void cfg_Msg_RCM_FR_PR_GW_1_UN(dword aDlc, byte data[])
{
   byte messagebytes[10];
   byte byte_count=0,crc_byte_no =0;
   int loop_index;
   int64 i,k;//For looping
   byte xor,data_byte;
   dword crcTemp;
   byte DataLength;
   dword Msg_id;
   
   DataLength = Msg_RCM_FR_PR_GW_1_UN.DataLength;//Message Data Length
   Msg_id  = Msg_RCM_FR_PR_GW_1_UN.id;//Message ID
   
}


on sysvar CAN_MPC3::RCM_FR_PR_TXID1_UN::RCM_FR_PR_TXID1_UN_ON_OFF
{
  if (@this == 1)
  {
    ILFaultInjectionEnableMsg(CAN_MPC3::RCM_FR_PR_TXID1_UN);
  }
  else{
         ILFaultInjectionDisableMsg(CAN_MPC3::RCM_FR_PR_TXID1_UN);
      }
}

void cfg_Msg_RCM_FR_PR_TXID1_UN(dword aDlc, byte data[])
{
   byte messagebytes[10];
   byte byte_count=0,crc_byte_no =0;
   int loop_index;
   int64 i,k;//For looping
   byte xor,data_byte;
   dword crcTemp;
   byte DataLength;
   dword Msg_id;
   
   DataLength = Msg_RCM_FR_PR_TXID1_UN.DataLength;//Message Data Length
   Msg_id  = Msg_RCM_FR_PR_TXID1_UN.id;//Message ID
   
    if (@CAN_MPC3::RCM_FR_PR_TXID1_UN::MSG_CNT1_FaultInject != 3)//AC: user defined value
    {

    clearBitsInByteArrayBE(data,8,11,4); //Motorola / Big-endian

    }
    if (@CAN_MPC3::RCM_FR_PR_TXID1_UN::MSG_CNT1_FaultInject == 0)//AC: No Error, calculate AC
    {
      ++counter_RCM_FR_PR_TXID1_UN_MSG_CNT1;
      counter_RCM_FR_PR_TXID1_UN_MSG_CNT1 %=15;

      copyBitsToByteArrayBE(counter_RCM_FR_PR_TXID1_UN_MSG_CNT1,data,8,4); //Motorola / Big-endian
    }
    else if (@CAN_MPC3::RCM_FR_PR_TXID1_UN::MSG_CNT1_FaultInject == 1)//AC: Error sequence: set AC = 0
    {

      copyBitsToByteArrayBE(0,data,8,4); //Motorola / Big-endian
    }
    else if (@CAN_MPC3::RCM_FR_PR_TXID1_UN::MSG_CNT1_FaultInject == 2)//AC: Error sequence: Freeze last valid value
    {

      copyBitsToByteArrayBE(counter_RCM_FR_PR_TXID1_UN_MSG_CNT1,data,8,4); //Motorola / Big-endian
    }
    if (@CAN_MPC3::RCM_FR_PR_TXID1_UN::CRC1_FaultInject != 3)//CRC: user defined value
    {

    clearBitsInByteArrayBE(data,0,7,8); //Motorola / Big-endian

    }
   messagebytes[0] = Data_ID_Lookup(Msg_id);
   messagebytes[1] = 0x00;
   crc_byte_no = 8;
   for(loop_index=0;loop_index < 7 ;loop_index++)
       messagebytes[loop_index+2] = data[loop_index+1];
   
    if(@CAN_MPC3::RCM_FR_PR_TXID1_UN::CRC1_FaultInject == 0)//CRC: No Error, calculate CRC
    {
      chksum_RCM_FR_PR_TXID1_UN_CRC1 = CRC_Calc_SAEJ1850(crc_byte_no, messagebytes);

      copyBitsToByteArrayBE(chksum_RCM_FR_PR_TXID1_UN_CRC1,data,0,8); //Motorola / Big-endian
    }
    else if(@CAN_MPC3::RCM_FR_PR_TXID1_UN::CRC1_FaultInject == 1)//CRC: Error, set to Zero
    {

      copyBitsToByteArrayBE(0,data,0,8); //Motorola / Big-endian
    }
    else if(@CAN_MPC3::RCM_FR_PR_TXID1_UN::CRC1_FaultInject == 2)//CRC: Error, Freeze last valid value
    {

      copyBitsToByteArrayBE(chksum_RCM_FR_PR_TXID1_UN_CRC1,data,0,8); //Motorola / Big-endian
    }
}


on sysvar CAN_MPC3::RCM_FR_PR_TXID2_UN::RCM_FR_PR_TXID2_UN_ON_OFF
{
  if (@this == 1)
  {
    ILFaultInjectionEnableMsg(CAN_MPC3::RCM_FR_PR_TXID2_UN);
  }
  else{
         ILFaultInjectionDisableMsg(CAN_MPC3::RCM_FR_PR_TXID2_UN);
      }
}

void cfg_Msg_RCM_FR_PR_TXID2_UN(dword aDlc, byte data[])
{
   byte messagebytes[10];
   byte byte_count=0,crc_byte_no =0;
   int loop_index;
   int64 i,k;//For looping
   byte xor,data_byte;
   dword crcTemp;
   byte DataLength;
   dword Msg_id;
   
   DataLength = Msg_RCM_FR_PR_TXID2_UN.DataLength;//Message Data Length
   Msg_id  = Msg_RCM_FR_PR_TXID2_UN.id;//Message ID
   
    if (@CAN_MPC3::RCM_FR_PR_TXID2_UN::MSG_CNT2_FaultInject != 3)//AC: user defined value
    {

    clearBitsInByteArrayBE(data,8,11,4); //Motorola / Big-endian

    }
    if (@CAN_MPC3::RCM_FR_PR_TXID2_UN::MSG_CNT2_FaultInject == 0)//AC: No Error, calculate AC
    {
      ++counter_RCM_FR_PR_TXID2_UN_MSG_CNT2;
      counter_RCM_FR_PR_TXID2_UN_MSG_CNT2 %=15;

      copyBitsToByteArrayBE(counter_RCM_FR_PR_TXID2_UN_MSG_CNT2,data,8,4); //Motorola / Big-endian
    }
    else if (@CAN_MPC3::RCM_FR_PR_TXID2_UN::MSG_CNT2_FaultInject == 1)//AC: Error sequence: set AC = 0
    {

      copyBitsToByteArrayBE(0,data,8,4); //Motorola / Big-endian
    }
    else if (@CAN_MPC3::RCM_FR_PR_TXID2_UN::MSG_CNT2_FaultInject == 2)//AC: Error sequence: Freeze last valid value
    {

      copyBitsToByteArrayBE(counter_RCM_FR_PR_TXID2_UN_MSG_CNT2,data,8,4); //Motorola / Big-endian
    }
    if (@CAN_MPC3::RCM_FR_PR_TXID2_UN::CRC2_FaultInject != 3)//CRC: user defined value
    {

    clearBitsInByteArrayBE(data,0,7,8); //Motorola / Big-endian

    }
   messagebytes[0] = Data_ID_Lookup(Msg_id);
   messagebytes[1] = 0x00;
   crc_byte_no = 8;
   for(loop_index=0;loop_index < 7 ;loop_index++)
       messagebytes[loop_index+2] = data[loop_index+1];
   
    if(@CAN_MPC3::RCM_FR_PR_TXID2_UN::CRC2_FaultInject == 0)//CRC: No Error, calculate CRC
    {
      chksum_RCM_FR_PR_TXID2_UN_CRC2 = CRC_Calc_SAEJ1850(crc_byte_no, messagebytes);

      copyBitsToByteArrayBE(chksum_RCM_FR_PR_TXID2_UN_CRC2,data,0,8); //Motorola / Big-endian
    }
    else if(@CAN_MPC3::RCM_FR_PR_TXID2_UN::CRC2_FaultInject == 1)//CRC: Error, set to Zero
    {

      copyBitsToByteArrayBE(0,data,0,8); //Motorola / Big-endian
    }
    else if(@CAN_MPC3::RCM_FR_PR_TXID2_UN::CRC2_FaultInject == 2)//CRC: Error, Freeze last valid value
    {

      copyBitsToByteArrayBE(chksum_RCM_FR_PR_TXID2_UN_CRC2,data,0,8); //Motorola / Big-endian
    }
}


on sysvar CAN_MPC3::SASM_FR_GW_1_UN::SASM_FR_GW_1_UN_ON_OFF
{
  if (@this == 1)
  {
    ILFaultInjectionEnableMsg(CAN_MPC3::SASM_FR_GW_1_UN);
  }
  else{
         ILFaultInjectionDisableMsg(CAN_MPC3::SASM_FR_GW_1_UN);
      }
}

void cfg_Msg_SASM_FR_GW_1_UN(dword aDlc, byte data[])
{
   byte messagebytes[10];
   byte byte_count=0,crc_byte_no =0;
   int loop_index;
   int64 i,k;//For looping
   byte xor,data_byte;
   dword crcTemp;
   byte DataLength;
   dword Msg_id;
   
   DataLength = Msg_SASM_FR_GW_1_UN.DataLength;//Message Data Length
   Msg_id  = Msg_SASM_FR_GW_1_UN.id;//Message ID
   
    if (@CAN_MPC3::SASM_FR_GW_1_UN::SteeringWheelAngMsgCnt_FaultInject != 3)//AC: user defined value
    {

    clearBitsInByteArrayBE(data,8,11,4); //Motorola / Big-endian

    }
    if (@CAN_MPC3::SASM_FR_GW_1_UN::SteeringWheelAngMsgCnt_FaultInject == 0)//AC: No Error, calculate AC
    {
      ++counter_SASM_FR_GW_1_UN_SteeringWheelAngMsgCnt;
      counter_SASM_FR_GW_1_UN_SteeringWheelAngMsgCnt %=15;

      copyBitsToByteArrayBE(counter_SASM_FR_GW_1_UN_SteeringWheelAngMsgCnt,data,8,4); //Motorola / Big-endian
    }
    else if (@CAN_MPC3::SASM_FR_GW_1_UN::SteeringWheelAngMsgCnt_FaultInject == 1)//AC: Error sequence: set AC = 0
    {

      copyBitsToByteArrayBE(0,data,8,4); //Motorola / Big-endian
    }
    else if (@CAN_MPC3::SASM_FR_GW_1_UN::SteeringWheelAngMsgCnt_FaultInject == 2)//AC: Error sequence: Freeze last valid value
    {

      copyBitsToByteArrayBE(counter_SASM_FR_GW_1_UN_SteeringWheelAngMsgCnt,data,8,4); //Motorola / Big-endian
    }
    if (@CAN_MPC3::SASM_FR_GW_1_UN::SteeringWheelAngleCS_FaultInject != 3)//CRC: user defined value
    {

    clearBitsInByteArrayBE(data,0,7,8); //Motorola / Big-endian

    }
   messagebytes[0] = Data_ID_Lookup(Msg_id);
   messagebytes[1] = 0x00;
   crc_byte_no = 5;
   for(loop_index=0;loop_index < 4 ;loop_index++)
       messagebytes[loop_index+2] = data[loop_index+1];
   
    if(@CAN_MPC3::SASM_FR_GW_1_UN::SteeringWheelAngleCS_FaultInject == 0)//CRC: No Error, calculate CRC
    {
      chksum_SASM_FR_GW_1_UN_SteeringWheelAngleCS = CRC_Calc_SAEJ1850(crc_byte_no, messagebytes);

      copyBitsToByteArrayBE(chksum_SASM_FR_GW_1_UN_SteeringWheelAngleCS,data,0,8); //Motorola / Big-endian
    }
    else if(@CAN_MPC3::SASM_FR_GW_1_UN::SteeringWheelAngleCS_FaultInject == 1)//CRC: Error, set to Zero
    {

      copyBitsToByteArrayBE(0,data,0,8); //Motorola / Big-endian
    }
    else if(@CAN_MPC3::SASM_FR_GW_1_UN::SteeringWheelAngleCS_FaultInject == 2)//CRC: Error, Freeze last valid value
    {

      copyBitsToByteArrayBE(chksum_SASM_FR_GW_1_UN_SteeringWheelAngleCS,data,0,8); //Motorola / Big-endian
    }
}


on sysvar CAN_MPC3::SignalGW_PR_1_UN::SignalGW_PR_1_UN_ON_OFF
{
  if (@this == 1)
  {
    ILFaultInjectionEnableMsg(CAN_MPC3::SignalGW_PR_1_UN);
  }
  else{
         ILFaultInjectionDisableMsg(CAN_MPC3::SignalGW_PR_1_UN);
      }
}

void cfg_Msg_SignalGW_PR_1_UN(dword aDlc, byte data[])
{
   byte messagebytes[10];
   byte byte_count=0,crc_byte_no =0;
   int loop_index;
   int64 i,k;//For looping
   byte xor,data_byte;
   dword crcTemp;
   byte DataLength;
   dword Msg_id;
   
   DataLength = Msg_SignalGW_PR_1_UN.DataLength;//Message Data Length
   Msg_id  = Msg_SignalGW_PR_1_UN.id;//Message ID
   
}


on sysvar CAN_MPC3::SignalGW_PR_3_UN::SignalGW_PR_3_UN_ON_OFF
{
  if (@this == 1)
  {
    ILFaultInjectionEnableMsg(CAN_MPC3::SignalGW_PR_3_UN);
  }
  else{
         ILFaultInjectionDisableMsg(CAN_MPC3::SignalGW_PR_3_UN);
      }
}

void cfg_Msg_SignalGW_PR_3_UN(dword aDlc, byte data[])
{
   byte messagebytes[10];
   byte byte_count=0,crc_byte_no =0;
   int loop_index;
   int64 i,k;//For looping
   byte xor,data_byte;
   dword crcTemp;
   byte DataLength;
   dword Msg_id;
   
   DataLength = Msg_SignalGW_PR_3_UN.DataLength;//Message Data Length
   Msg_id  = Msg_SignalGW_PR_3_UN.id;//Message ID
   
}


on sysvar CAN_MPC3::SignalGW_PR_4_UN::SignalGW_PR_4_UN_ON_OFF
{
  if (@this == 1)
  {
    ILFaultInjectionEnableMsg(CAN_MPC3::SignalGW_PR_4_UN);
  }
  else{
         ILFaultInjectionDisableMsg(CAN_MPC3::SignalGW_PR_4_UN);
      }
}

void cfg_Msg_SignalGW_PR_4_UN(dword aDlc, byte data[])
{
   byte messagebytes[10];
   byte byte_count=0,crc_byte_no =0;
   int loop_index;
   int64 i,k;//For looping
   byte xor,data_byte;
   dword crcTemp;
   byte DataLength;
   dword Msg_id;
   
   DataLength = Msg_SignalGW_PR_4_UN.DataLength;//Message Data Length
   Msg_id  = Msg_SignalGW_PR_4_UN.id;//Message ID
   
}


on sysvar CAN_MPC3::SignalGW_PR_6_UN::SignalGW_PR_6_UN_ON_OFF
{
  if (@this == 1)
  {
    ILFaultInjectionEnableMsg(CAN_MPC3::SignalGW_PR_6_UN);
  }
  else{
         ILFaultInjectionDisableMsg(CAN_MPC3::SignalGW_PR_6_UN);
      }
}

void cfg_Msg_SignalGW_PR_6_UN(dword aDlc, byte data[])
{
   byte messagebytes[10];
   byte byte_count=0,crc_byte_no =0;
   int loop_index;
   int64 i,k;//For looping
   byte xor,data_byte;
   dword crcTemp;
   byte DataLength;
   dword Msg_id;
   
   DataLength = Msg_SignalGW_PR_6_UN.DataLength;//Message Data Length
   Msg_id  = Msg_SignalGW_PR_6_UN.id;//Message ID
   
}


on sysvar CAN_MPC3::Snapshot_Data::Snapshot_Data_ON_OFF
{
  if (@this == 1)
  {
     ILSetMsgEvent(CAN_MPC3::Snapshot_Data);
     @CAN_MPC3::Snapshot_Data::Snapshot_Data_ON_OFF = 0;
  }
}

void cfg_Msg_Snapshot_Data(dword aDlc, byte data[])
{
   byte messagebytes[10];
   byte byte_count=0,crc_byte_no =0;
   int loop_index;
   int64 i,k;//For looping
   byte xor,data_byte;
   dword crcTemp;
   byte DataLength;
   dword Msg_id;
   
   DataLength = Msg_Snapshot_Data.DataLength;//Message Data Length
   Msg_id  = Msg_Snapshot_Data.id;//Message ID
   
}


on sysvar CAN_MPC3::TPM_PR_GW_4::TPM_PR_GW_4_ON_OFF
{
  if (@this == 1)
  {
    ILFaultInjectionEnableMsg(CAN_MPC3::TPM_PR_GW_4);
  }
  else{
         ILFaultInjectionDisableMsg(CAN_MPC3::TPM_PR_GW_4);
      }
}

void cfg_Msg_TPM_PR_GW_4(dword aDlc, byte data[])
{
   byte messagebytes[10];
   byte byte_count=0,crc_byte_no =0;
   int loop_index;
   int64 i,k;//For looping
   byte xor,data_byte;
   dword crcTemp;
   byte DataLength;
   dword Msg_id;
   
   DataLength = Msg_TPM_PR_GW_4.DataLength;//Message Data Length
   Msg_id  = Msg_TPM_PR_GW_4.id;//Message ID
   
}


on sysvar CAN_MPC3::TransmissionControl_A_GW_UN::TransmissionControl_A_GW_UN_ON_OFF
{
  if (@this == 1)
  {
    ILFaultInjectionEnableMsg(CAN_MPC3::TransmissionControl_A_GW_UN);
  }
  else{
         ILFaultInjectionDisableMsg(CAN_MPC3::TransmissionControl_A_GW_UN);
      }
}

void cfg_Msg_TransmissionControl_A_GW_UN(dword aDlc, byte data[])
{
   byte messagebytes[10];
   byte byte_count=0,crc_byte_no =0;
   int loop_index;
   int64 i,k;//For looping
   byte xor,data_byte;
   dword crcTemp;
   byte DataLength;
   dword Msg_id;
   
   DataLength = Msg_TransmissionControl_A_GW_UN.DataLength;//Message Data Length
   Msg_id  = Msg_TransmissionControl_A_GW_UN.id;//Message ID
   
    if (@CAN_MPC3::TransmissionControl_A_GW_UN::TCMPosAliveCounter_FaultInject != 3)//AC: user defined value
    {

    clearBitsInByteArrayBE(data,8,11,4); //Motorola / Big-endian

    }
    if (@CAN_MPC3::TransmissionControl_A_GW_UN::TCMPosAliveCounter_FaultInject == 0)//AC: No Error, calculate AC
    {
      ++counter_TransmissionControl_A_GW_UN_TCMPosAliveCounter;
      counter_TransmissionControl_A_GW_UN_TCMPosAliveCounter %=15;

      copyBitsToByteArrayBE(counter_TransmissionControl_A_GW_UN_TCMPosAliveCounter,data,8,4); //Motorola / Big-endian
    }
    else if (@CAN_MPC3::TransmissionControl_A_GW_UN::TCMPosAliveCounter_FaultInject == 1)//AC: Error sequence: set AC = 0
    {

      copyBitsToByteArrayBE(0,data,8,4); //Motorola / Big-endian
    }
    else if (@CAN_MPC3::TransmissionControl_A_GW_UN::TCMPosAliveCounter_FaultInject == 2)//AC: Error sequence: Freeze last valid value
    {

      copyBitsToByteArrayBE(counter_TransmissionControl_A_GW_UN_TCMPosAliveCounter,data,8,4); //Motorola / Big-endian
    }
    if (@CAN_MPC3::TransmissionControl_A_GW_UN::TCMPosChecksum_FaultInject != 3)//CRC: user defined value
    {

    clearBitsInByteArrayBE(data,0,7,8); //Motorola / Big-endian

    }
   messagebytes[0] = Data_ID_Lookup(Msg_id);
   messagebytes[1] = 0x00;
   crc_byte_no = 6;
   for(loop_index=0;loop_index < 5 ;loop_index++)
       messagebytes[loop_index+2] = data[loop_index+1];
   
    if(@CAN_MPC3::TransmissionControl_A_GW_UN::TCMPosChecksum_FaultInject == 0)//CRC: No Error, calculate CRC
    {
      chksum_TransmissionControl_A_GW_UN_TCMPosChecksum = CRC_Calc_SAEJ1850(crc_byte_no, messagebytes);

      copyBitsToByteArrayBE(chksum_TransmissionControl_A_GW_UN_TCMPosChecksum,data,0,8); //Motorola / Big-endian
    }
    else if(@CAN_MPC3::TransmissionControl_A_GW_UN::TCMPosChecksum_FaultInject == 1)//CRC: Error, set to Zero
    {

      copyBitsToByteArrayBE(0,data,0,8); //Motorola / Big-endian
    }
    else if(@CAN_MPC3::TransmissionControl_A_GW_UN::TCMPosChecksum_FaultInject == 2)//CRC: Error, Freeze last valid value
    {

      copyBitsToByteArrayBE(chksum_TransmissionControl_A_GW_UN_TCMPosChecksum,data,0,8); //Motorola / Big-endian
    }
}


on sysvar CAN_MPC3::VEHCONFIG_400UN_AS::VEHCONFIG_400UN_AS_ON_OFF
{
  if (@this == 1)
  {
    ILFaultInjectionEnableMsg(CAN_MPC3::VEHCONFIG_400UN_AS);
  }
  else{
         ILFaultInjectionDisableMsg(CAN_MPC3::VEHCONFIG_400UN_AS);
      }
}

void cfg_Msg_VEHCONFIG_400UN_AS(dword aDlc, byte data[])
{
   byte messagebytes[10];
   byte byte_count=0,crc_byte_no =0;
   int loop_index;
   int64 i,k;//For looping
   byte xor,data_byte;
   dword crcTemp;
   byte DataLength;
   dword Msg_id;
   
   DataLength = Msg_VEHCONFIG_400UN_AS.DataLength;//Message Data Length
   Msg_id  = Msg_VEHCONFIG_400UN_AS.id;//Message ID
   
}


on sysvar CAN_MPC3::VLC_01::VLC_01_ON_OFF
{
  if (@this == 1)
  {
    ILFaultInjectionEnableMsg(CAN_MPC3::VLC_01);
  }
  else{
         ILFaultInjectionDisableMsg(CAN_MPC3::VLC_01);
      }
}

void cfg_Msg_VLC_01(dword aDlc, byte data[])
{
   byte messagebytes[10];
   byte byte_count=0,crc_byte_no =0;
   int loop_index;
   int64 i,k;//For looping
   byte xor,data_byte;
   dword crcTemp;
   byte DataLength;
   dword Msg_id;
   
   DataLength = Msg_VLC_01.DataLength;//Message Data Length
   Msg_id  = Msg_VLC_01.id;//Message ID
   
}


on sysvar CAN_MPC3::VLC_02::VLC_02_ON_OFF
{
  if (@this == 1)
  {
    ILFaultInjectionEnableMsg(CAN_MPC3::VLC_02);
  }
  else{
         ILFaultInjectionDisableMsg(CAN_MPC3::VLC_02);
      }
}

void cfg_Msg_VLC_02(dword aDlc, byte data[])
{
   byte messagebytes[10];
   byte byte_count=0,crc_byte_no =0;
   int loop_index;
   int64 i,k;//For looping
   byte xor,data_byte;
   dword crcTemp;
   byte DataLength;
   dword Msg_id;
   
   DataLength = Msg_VLC_02.DataLength;//Message Data Length
   Msg_id  = Msg_VLC_02.id;//Message ID
   
}


on sysvar CAN_MPC3::Vehicle_CAN_01::Vehicle_CAN_01_ON_OFF
{
  if (@this == 1)
  {
    ILFaultInjectionEnableMsg(CAN_MPC3::Vehicle_CAN_01);
  }
  else{
         ILFaultInjectionDisableMsg(CAN_MPC3::Vehicle_CAN_01);
      }
}

void cfg_Msg_Vehicle_CAN_01(dword aDlc, byte data[])
{
   byte messagebytes[10];
   byte byte_count=0,crc_byte_no =0;
   int loop_index;
   int64 i,k;//For looping
   byte xor,data_byte;
   dword crcTemp;
   byte DataLength;
   dword Msg_id;
   
   DataLength = Msg_Vehicle_CAN_01.DataLength;//Message Data Length
   Msg_id  = Msg_Vehicle_CAN_01.id;//Message ID
   
}


on sysvar CAN_MPC3::Vehicle_CAN_09::Vehicle_CAN_09_ON_OFF
{
  if (@this == 1)
  {
    ILFaultInjectionEnableMsg(CAN_MPC3::Vehicle_CAN_09);
  }
  else{
         ILFaultInjectionDisableMsg(CAN_MPC3::Vehicle_CAN_09);
      }
}

void cfg_Msg_Vehicle_CAN_09(dword aDlc, byte data[])
{
   byte messagebytes[10];
   byte byte_count=0,crc_byte_no =0;
   int loop_index;
   int64 i,k;//For looping
   byte xor,data_byte;
   dword crcTemp;
   byte DataLength;
   dword Msg_id;
   
   DataLength = Msg_Vehicle_CAN_09.DataLength;//Message Data Length
   Msg_id  = Msg_Vehicle_CAN_09.id;//Message ID
   
    if (@CAN_MPC3::Vehicle_CAN_09::Vehicle_CAN_09_Counter_FaultInject != 3)//AC: user defined value
    {

    clearBitsInByteArrayBE(data,12,15,4); //Motorola / Big-endian

    }
    if (@CAN_MPC3::Vehicle_CAN_09::Vehicle_CAN_09_Counter_FaultInject == 0)//AC: No Error, calculate AC
    {
      ++counter_Vehicle_CAN_09_Vehicle_CAN_09_Counter;
      counter_Vehicle_CAN_09_Vehicle_CAN_09_Counter %=15;

      copyBitsToByteArrayBE(counter_Vehicle_CAN_09_Vehicle_CAN_09_Counter,data,12,4); //Motorola / Big-endian
    }
    else if (@CAN_MPC3::Vehicle_CAN_09::Vehicle_CAN_09_Counter_FaultInject == 1)//AC: Error sequence: set AC = 0
    {

      copyBitsToByteArrayBE(0,data,12,4); //Motorola / Big-endian
    }
    else if (@CAN_MPC3::Vehicle_CAN_09::Vehicle_CAN_09_Counter_FaultInject == 2)//AC: Error sequence: Freeze last valid value
    {

      copyBitsToByteArrayBE(counter_Vehicle_CAN_09_Vehicle_CAN_09_Counter,data,12,4); //Motorola / Big-endian
    }
    if (@CAN_MPC3::Vehicle_CAN_09::Vehicle_CAN_09_CRC_FaultInject != 3)//CRC: user defined value
    {

    clearBitsInByteArrayBE(data,0,7,8); //Motorola / Big-endian

    }
   messagebytes[0] = Data_ID_Lookup(Msg_id);
   messagebytes[1] = 0x00;
   crc_byte_no = 8;
   for(loop_index=0;loop_index < 7 ;loop_index++)
       messagebytes[loop_index+2] = data[loop_index+1];
   
    if(@CAN_MPC3::Vehicle_CAN_09::Vehicle_CAN_09_CRC_FaultInject == 0)//CRC: No Error, calculate CRC
    {
      crc_Vehicle_CAN_09_Vehicle_CAN_09_CRC = CRC_Calc_SAEJ1850(crc_byte_no, messagebytes);

      copyBitsToByteArrayBE(crc_Vehicle_CAN_09_Vehicle_CAN_09_CRC,data,0,8); //Motorola / Big-endian
    }
    else if(@CAN_MPC3::Vehicle_CAN_09::Vehicle_CAN_09_CRC_FaultInject == 1)//CRC: Error, set to Zero
    {

      copyBitsToByteArrayBE(0,data,0,8); //Motorola / Big-endian
    }
    else if(@CAN_MPC3::Vehicle_CAN_09::Vehicle_CAN_09_CRC_FaultInject == 2)//CRC: Error, Freeze last valid value
    {

      copyBitsToByteArrayBE(crc_Vehicle_CAN_09_Vehicle_CAN_09_CRC,data,0,8); //Motorola / Big-endian
    }
}


on sysvar CAN_MPC3::Vehicle_CAN_15::Vehicle_CAN_15_ON_OFF
{
  if (@this == 1)
  {
    ILFaultInjectionEnableMsg(CAN_MPC3::Vehicle_CAN_15);
  }
  else{
         ILFaultInjectionDisableMsg(CAN_MPC3::Vehicle_CAN_15);
      }
}

void cfg_Msg_Vehicle_CAN_15(dword aDlc, byte data[])
{
   byte messagebytes[10];
   byte byte_count=0,crc_byte_no =0;
   int loop_index;
   int64 i,k;//For looping
   byte xor,data_byte;
   dword crcTemp;
   byte DataLength;
   dword Msg_id;
   
   DataLength = Msg_Vehicle_CAN_15.DataLength;//Message Data Length
   Msg_id  = Msg_Vehicle_CAN_15.id;//Message ID
   
    if (@CAN_MPC3::Vehicle_CAN_15::Vehicle_CAN_15_Counter_FaultInject != 3)//AC: user defined value
    {

    clearBitsInByteArrayBE(data,12,15,4); //Motorola / Big-endian

    }
    if (@CAN_MPC3::Vehicle_CAN_15::Vehicle_CAN_15_Counter_FaultInject == 0)//AC: No Error, calculate AC
    {
      ++counter_Vehicle_CAN_15_Vehicle_CAN_15_Counter;
      counter_Vehicle_CAN_15_Vehicle_CAN_15_Counter %=15;

      copyBitsToByteArrayBE(counter_Vehicle_CAN_15_Vehicle_CAN_15_Counter,data,12,4); //Motorola / Big-endian
    }
    else if (@CAN_MPC3::Vehicle_CAN_15::Vehicle_CAN_15_Counter_FaultInject == 1)//AC: Error sequence: set AC = 0
    {

      copyBitsToByteArrayBE(0,data,12,4); //Motorola / Big-endian
    }
    else if (@CAN_MPC3::Vehicle_CAN_15::Vehicle_CAN_15_Counter_FaultInject == 2)//AC: Error sequence: Freeze last valid value
    {

      copyBitsToByteArrayBE(counter_Vehicle_CAN_15_Vehicle_CAN_15_Counter,data,12,4); //Motorola / Big-endian
    }
    if (@CAN_MPC3::Vehicle_CAN_15::Vehicle_CAN_15_CRC_FaultInject != 3)//CRC: user defined value
    {

    clearBitsInByteArrayBE(data,0,7,8); //Motorola / Big-endian

    }
   messagebytes[0] = Data_ID_Lookup(Msg_id);
   messagebytes[1] = 0x00;
   crc_byte_no = 8;
   for(loop_index=0;loop_index < 7 ;loop_index++)
       messagebytes[loop_index+2] = data[loop_index+1];
   
    if(@CAN_MPC3::Vehicle_CAN_15::Vehicle_CAN_15_CRC_FaultInject == 0)//CRC: No Error, calculate CRC
    {
      crc_Vehicle_CAN_15_Vehicle_CAN_15_CRC = CRC_Calc_SAEJ1850(crc_byte_no, messagebytes);

      copyBitsToByteArrayBE(crc_Vehicle_CAN_15_Vehicle_CAN_15_CRC,data,0,8); //Motorola / Big-endian
    }
    else if(@CAN_MPC3::Vehicle_CAN_15::Vehicle_CAN_15_CRC_FaultInject == 1)//CRC: Error, set to Zero
    {

      copyBitsToByteArrayBE(0,data,0,8); //Motorola / Big-endian
    }
    else if(@CAN_MPC3::Vehicle_CAN_15::Vehicle_CAN_15_CRC_FaultInject == 2)//CRC: Error, Freeze last valid value
    {

      copyBitsToByteArrayBE(crc_Vehicle_CAN_15_Vehicle_CAN_15_CRC,data,0,8); //Motorola / Big-endian
    }
}


on sysvar CAN_MPC3::Vehicle_CAN_17::Vehicle_CAN_17_ON_OFF
{
  if (@this == 1)
  {
    ILFaultInjectionEnableMsg(CAN_MPC3::Vehicle_CAN_17);
  }
  else{
         ILFaultInjectionDisableMsg(CAN_MPC3::Vehicle_CAN_17);
      }
}

void cfg_Msg_Vehicle_CAN_17(dword aDlc, byte data[])
{
   byte messagebytes[10];
   byte byte_count=0,crc_byte_no =0;
   int loop_index;
   int64 i,k;//For looping
   byte xor,data_byte;
   dword crcTemp;
   byte DataLength;
   dword Msg_id;
   
   DataLength = Msg_Vehicle_CAN_17.DataLength;//Message Data Length
   Msg_id  = Msg_Vehicle_CAN_17.id;//Message ID
   
    if (@CAN_MPC3::Vehicle_CAN_17::Vehicle_CAN_17_Counter_FaultInject != 3)//AC: user defined value
    {

    clearBitsInByteArrayBE(data,12,15,4); //Motorola / Big-endian

    }
    if (@CAN_MPC3::Vehicle_CAN_17::Vehicle_CAN_17_Counter_FaultInject == 0)//AC: No Error, calculate AC
    {
      ++counter_Vehicle_CAN_17_Vehicle_CAN_17_Counter;
      counter_Vehicle_CAN_17_Vehicle_CAN_17_Counter %=15;

      copyBitsToByteArrayBE(counter_Vehicle_CAN_17_Vehicle_CAN_17_Counter,data,12,4); //Motorola / Big-endian
    }
    else if (@CAN_MPC3::Vehicle_CAN_17::Vehicle_CAN_17_Counter_FaultInject == 1)//AC: Error sequence: set AC = 0
    {

      copyBitsToByteArrayBE(0,data,12,4); //Motorola / Big-endian
    }
    else if (@CAN_MPC3::Vehicle_CAN_17::Vehicle_CAN_17_Counter_FaultInject == 2)//AC: Error sequence: Freeze last valid value
    {

      copyBitsToByteArrayBE(counter_Vehicle_CAN_17_Vehicle_CAN_17_Counter,data,12,4); //Motorola / Big-endian
    }
    if (@CAN_MPC3::Vehicle_CAN_17::Vehicle_CAN_17_CRC_FaultInject != 3)//CRC: user defined value
    {

    clearBitsInByteArrayBE(data,0,7,8); //Motorola / Big-endian

    }
   messagebytes[0] = Data_ID_Lookup(Msg_id);
   messagebytes[1] = 0x00;
   crc_byte_no = 7;
   for(loop_index=0;loop_index < 6 ;loop_index++)
       messagebytes[loop_index+2] = data[loop_index+1];
   
    if(@CAN_MPC3::Vehicle_CAN_17::Vehicle_CAN_17_CRC_FaultInject == 0)//CRC: No Error, calculate CRC
    {
      crc_Vehicle_CAN_17_Vehicle_CAN_17_CRC = CRC_Calc_SAEJ1850(crc_byte_no, messagebytes);

      copyBitsToByteArrayBE(crc_Vehicle_CAN_17_Vehicle_CAN_17_CRC,data,0,8); //Motorola / Big-endian
    }
    else if(@CAN_MPC3::Vehicle_CAN_17::Vehicle_CAN_17_CRC_FaultInject == 1)//CRC: Error, set to Zero
    {

      copyBitsToByteArrayBE(0,data,0,8); //Motorola / Big-endian
    }
    else if(@CAN_MPC3::Vehicle_CAN_17::Vehicle_CAN_17_CRC_FaultInject == 2)//CRC: Error, Freeze last valid value
    {

      copyBitsToByteArrayBE(crc_Vehicle_CAN_17_Vehicle_CAN_17_CRC,data,0,8); //Motorola / Big-endian
    }
}


on sysvar CAN_MPC3::Vehicle_CAN_21::Vehicle_CAN_21_ON_OFF
{
  if (@this == 1)
  {
    ILFaultInjectionEnableMsg(CAN_MPC3::Vehicle_CAN_21);
  }
  else{
         ILFaultInjectionDisableMsg(CAN_MPC3::Vehicle_CAN_21);
      }
}

void cfg_Msg_Vehicle_CAN_21(dword aDlc, byte data[])
{
   byte messagebytes[10];
   byte byte_count=0,crc_byte_no =0;
   int loop_index;
   int64 i,k;//For looping
   byte xor,data_byte;
   dword crcTemp;
   byte DataLength;
   dword Msg_id;
   
   DataLength = Msg_Vehicle_CAN_21.DataLength;//Message Data Length
   Msg_id  = Msg_Vehicle_CAN_21.id;//Message ID
   
    if (@CAN_MPC3::Vehicle_CAN_21::Vehicle_CAN_21_Counter_FaultInject != 3)//AC: user defined value
    {

    clearBitsInByteArrayBE(data,12,15,4); //Motorola / Big-endian

    }
    if (@CAN_MPC3::Vehicle_CAN_21::Vehicle_CAN_21_Counter_FaultInject == 0)//AC: No Error, calculate AC
    {
      ++counter_Vehicle_CAN_21_Vehicle_CAN_21_Counter;
      counter_Vehicle_CAN_21_Vehicle_CAN_21_Counter %=15;

      copyBitsToByteArrayBE(counter_Vehicle_CAN_21_Vehicle_CAN_21_Counter,data,12,4); //Motorola / Big-endian
    }
    else if (@CAN_MPC3::Vehicle_CAN_21::Vehicle_CAN_21_Counter_FaultInject == 1)//AC: Error sequence: set AC = 0
    {

      copyBitsToByteArrayBE(0,data,12,4); //Motorola / Big-endian
    }
    else if (@CAN_MPC3::Vehicle_CAN_21::Vehicle_CAN_21_Counter_FaultInject == 2)//AC: Error sequence: Freeze last valid value
    {

      copyBitsToByteArrayBE(counter_Vehicle_CAN_21_Vehicle_CAN_21_Counter,data,12,4); //Motorola / Big-endian
    }
    if (@CAN_MPC3::Vehicle_CAN_21::Vehicle_CAN_21_CRC_FaultInject != 3)//CRC: user defined value
    {

    clearBitsInByteArrayBE(data,0,7,8); //Motorola / Big-endian

    }
   messagebytes[0] = Data_ID_Lookup(Msg_id);
   messagebytes[1] = 0x00;
   crc_byte_no = 7;
   for(loop_index=0;loop_index < 6 ;loop_index++)
       messagebytes[loop_index+2] = data[loop_index+1];
   
    if(@CAN_MPC3::Vehicle_CAN_21::Vehicle_CAN_21_CRC_FaultInject == 0)//CRC: No Error, calculate CRC
    {
      crc_Vehicle_CAN_21_Vehicle_CAN_21_CRC = CRC_Calc_SAEJ1850(crc_byte_no, messagebytes);

      copyBitsToByteArrayBE(crc_Vehicle_CAN_21_Vehicle_CAN_21_CRC,data,0,8); //Motorola / Big-endian
    }
    else if(@CAN_MPC3::Vehicle_CAN_21::Vehicle_CAN_21_CRC_FaultInject == 1)//CRC: Error, set to Zero
    {

      copyBitsToByteArrayBE(0,data,0,8); //Motorola / Big-endian
    }
    else if(@CAN_MPC3::Vehicle_CAN_21::Vehicle_CAN_21_CRC_FaultInject == 2)//CRC: Error, Freeze last valid value
    {

      copyBitsToByteArrayBE(crc_Vehicle_CAN_21_Vehicle_CAN_21_CRC,data,0,8); //Motorola / Big-endian
    }
}


on sysvar CAN_MPC3::Vehicle_CAN_25::Vehicle_CAN_25_ON_OFF
{
  if (@this == 1)
  {
    ILFaultInjectionEnableMsg(CAN_MPC3::Vehicle_CAN_25);
  }
  else{
         ILFaultInjectionDisableMsg(CAN_MPC3::Vehicle_CAN_25);
      }
}

void cfg_Msg_Vehicle_CAN_25(dword aDlc, byte data[])
{
   byte messagebytes[10];
   byte byte_count=0,crc_byte_no =0;
   int loop_index;
   int64 i,k;//For looping
   byte xor,data_byte;
   dword crcTemp;
   byte DataLength;
   dword Msg_id;
   
   DataLength = Msg_Vehicle_CAN_25.DataLength;//Message Data Length
   Msg_id  = Msg_Vehicle_CAN_25.id;//Message ID
   
    if (@CAN_MPC3::Vehicle_CAN_25::Vehicle_CAN_25_Counter_FaultInject != 3)//AC: user defined value
    {

    clearBitsInByteArrayBE(data,12,15,4); //Motorola / Big-endian

    }
    if (@CAN_MPC3::Vehicle_CAN_25::Vehicle_CAN_25_Counter_FaultInject == 0)//AC: No Error, calculate AC
    {
      ++counter_Vehicle_CAN_25_Vehicle_CAN_25_Counter;
      counter_Vehicle_CAN_25_Vehicle_CAN_25_Counter %=15;

      copyBitsToByteArrayBE(counter_Vehicle_CAN_25_Vehicle_CAN_25_Counter,data,12,4); //Motorola / Big-endian
    }
    else if (@CAN_MPC3::Vehicle_CAN_25::Vehicle_CAN_25_Counter_FaultInject == 1)//AC: Error sequence: set AC = 0
    {

      copyBitsToByteArrayBE(0,data,12,4); //Motorola / Big-endian
    }
    else if (@CAN_MPC3::Vehicle_CAN_25::Vehicle_CAN_25_Counter_FaultInject == 2)//AC: Error sequence: Freeze last valid value
    {

      copyBitsToByteArrayBE(counter_Vehicle_CAN_25_Vehicle_CAN_25_Counter,data,12,4); //Motorola / Big-endian
    }
    if (@CAN_MPC3::Vehicle_CAN_25::Vehicle_CAN_25_CRC_FaultInject != 3)//CRC: user defined value
    {

    clearBitsInByteArrayBE(data,0,7,8); //Motorola / Big-endian

    }
   messagebytes[0] = Data_ID_Lookup(Msg_id);
   messagebytes[1] = 0x00;
   crc_byte_no = 7;
   for(loop_index=0;loop_index < 6 ;loop_index++)
       messagebytes[loop_index+2] = data[loop_index+1];
   
    if(@CAN_MPC3::Vehicle_CAN_25::Vehicle_CAN_25_CRC_FaultInject == 0)//CRC: No Error, calculate CRC
    {
      crc_Vehicle_CAN_25_Vehicle_CAN_25_CRC = CRC_Calc_SAEJ1850(crc_byte_no, messagebytes);

      copyBitsToByteArrayBE(crc_Vehicle_CAN_25_Vehicle_CAN_25_CRC,data,0,8); //Motorola / Big-endian
    }
    else if(@CAN_MPC3::Vehicle_CAN_25::Vehicle_CAN_25_CRC_FaultInject == 1)//CRC: Error, set to Zero
    {

      copyBitsToByteArrayBE(0,data,0,8); //Motorola / Big-endian
    }
    else if(@CAN_MPC3::Vehicle_CAN_25::Vehicle_CAN_25_CRC_FaultInject == 2)//CRC: Error, Freeze last valid value
    {

      copyBitsToByteArrayBE(crc_Vehicle_CAN_25_Vehicle_CAN_25_CRC,data,0,8); //Motorola / Big-endian
    }
}


on sysvar CAN_MPC3::Vehicle_CAN_29::Vehicle_CAN_29_ON_OFF
{
  if (@this == 1)
  {
    ILFaultInjectionEnableMsg(CAN_MPC3::Vehicle_CAN_29);
  }
  else{
         ILFaultInjectionDisableMsg(CAN_MPC3::Vehicle_CAN_29);
      }
}

void cfg_Msg_Vehicle_CAN_29(dword aDlc, byte data[])
{
   byte messagebytes[10];
   byte byte_count=0,crc_byte_no =0;
   int loop_index;
   int64 i,k;//For looping
   byte xor,data_byte;
   dword crcTemp;
   byte DataLength;
   dword Msg_id;
   
   DataLength = Msg_Vehicle_CAN_29.DataLength;//Message Data Length
   Msg_id  = Msg_Vehicle_CAN_29.id;//Message ID
   
}


on sysvar CAN_MPC3::Vehicle_CAN_31::Vehicle_CAN_31_ON_OFF
{
  if (@this == 1)
  {
    ILFaultInjectionEnableMsg(CAN_MPC3::Vehicle_CAN_31);
  }
  else{
         ILFaultInjectionDisableMsg(CAN_MPC3::Vehicle_CAN_31);
      }
}

void cfg_Msg_Vehicle_CAN_31(dword aDlc, byte data[])
{
   byte messagebytes[10];
   byte byte_count=0,crc_byte_no =0;
   int loop_index;
   int64 i,k;//For looping
   byte xor,data_byte;
   dword crcTemp;
   byte DataLength;
   dword Msg_id;
   
   DataLength = Msg_Vehicle_CAN_31.DataLength;//Message Data Length
   Msg_id  = Msg_Vehicle_CAN_31.id;//Message ID
   
}


on sysvar CAN_MPC3::Vehicle_CAN_37::Vehicle_CAN_37_ON_OFF
{
  if (@this == 1)
  {
    ILFaultInjectionEnableMsg(CAN_MPC3::Vehicle_CAN_37);
  }
  else{
         ILFaultInjectionDisableMsg(CAN_MPC3::Vehicle_CAN_37);
      }
}

void cfg_Msg_Vehicle_CAN_37(dword aDlc, byte data[])
{
   byte messagebytes[10];
   byte byte_count=0,crc_byte_no =0;
   int loop_index;
   int64 i,k;//For looping
   byte xor,data_byte;
   dword crcTemp;
   byte DataLength;
   dword Msg_id;
   
   DataLength = Msg_Vehicle_CAN_37.DataLength;//Message Data Length
   Msg_id  = Msg_Vehicle_CAN_37.id;//Message ID
   
}


on sysvar CAN_MPC3::Vehicle_CAN_41::Vehicle_CAN_41_ON_OFF
{
  if (@this == 1)
  {
    ILFaultInjectionEnableMsg(CAN_MPC3::Vehicle_CAN_41);
  }
  else{
         ILFaultInjectionDisableMsg(CAN_MPC3::Vehicle_CAN_41);
      }
}

void cfg_Msg_Vehicle_CAN_41(dword aDlc, byte data[])
{
   byte messagebytes[10];
   byte byte_count=0,crc_byte_no =0;
   int loop_index;
   int64 i,k;//For looping
   byte xor,data_byte;
   dword crcTemp;
   byte DataLength;
   dword Msg_id;
   
   DataLength = Msg_Vehicle_CAN_41.DataLength;//Message Data Length
   Msg_id  = Msg_Vehicle_CAN_41.id;//Message ID
   
}


on sysvar CAN_MPC3::Vehicle_CAN_43::Vehicle_CAN_43_ON_OFF
{
  if (@this == 1)
  {
    ILFaultInjectionEnableMsg(CAN_MPC3::Vehicle_CAN_43);
  }
  else{
         ILFaultInjectionDisableMsg(CAN_MPC3::Vehicle_CAN_43);
      }
}

void cfg_Msg_Vehicle_CAN_43(dword aDlc, byte data[])
{
   byte messagebytes[10];
   byte byte_count=0,crc_byte_no =0;
   int loop_index;
   int64 i,k;//For looping
   byte xor,data_byte;
   dword crcTemp;
   byte DataLength;
   dword Msg_id;
   
   DataLength = Msg_Vehicle_CAN_43.DataLength;//Message Data Length
   Msg_id  = Msg_Vehicle_CAN_43.id;//Message ID
   
}


on sysvar CAN_MPC3::Vehicle_CAN_47::Vehicle_CAN_47_ON_OFF
{
  if (@this == 1)
  {
    ILFaultInjectionEnableMsg(CAN_MPC3::Vehicle_CAN_47);
  }
  else{
         ILFaultInjectionDisableMsg(CAN_MPC3::Vehicle_CAN_47);
      }
}

void cfg_Msg_Vehicle_CAN_47(dword aDlc, byte data[])
{
   byte messagebytes[10];
   byte byte_count=0,crc_byte_no =0;
   int loop_index;
   int64 i,k;//For looping
   byte xor,data_byte;
   dword crcTemp;
   byte DataLength;
   dword Msg_id;
   
   DataLength = Msg_Vehicle_CAN_47.DataLength;//Message Data Length
   Msg_id  = Msg_Vehicle_CAN_47.id;//Message ID
   
}


on sysvar CAN_MPC3::Vehicle_CAN_48::Vehicle_CAN_48_ON_OFF
{
  if (@this == 1)
  {
    ILFaultInjectionEnableMsg(CAN_MPC3::Vehicle_CAN_48);
  }
  else{
         ILFaultInjectionDisableMsg(CAN_MPC3::Vehicle_CAN_48);
      }
}

void cfg_Msg_Vehicle_CAN_48(dword aDlc, byte data[])
{
   byte messagebytes[10];
   byte byte_count=0,crc_byte_no =0;
   int loop_index;
   int64 i,k;//For looping
   byte xor,data_byte;
   dword crcTemp;
   byte DataLength;
   dword Msg_id;
   
   DataLength = Msg_Vehicle_CAN_48.DataLength;//Message Data Length
   Msg_id  = Msg_Vehicle_CAN_48.id;//Message ID
   
}


on sysvar CAN_MPC3::Vehicle_CAN_01::Vehicle_CAN_01_CycleTime
{
  ILFaultInjectionSetMsgCycleTime(CAN_MPC3::Vehicle_CAN_01,@this);
  //ILFaultInjectionResetMsgCycleTime(Vehicle_CAN_01);
}

on sysvar CAN_MPC3::ABS_UN_PR_6::ABS_UN_PR_6_CycleTime
{
  ILFaultInjectionSetMsgCycleTime(CAN_MPC3::ABS_UN_PR_6,@this);
  //ILFaultInjectionResetMsgCycleTime(ABS_UN_PR_6);
}

on sysvar CAN_MPC3::Vehicle_CAN_09::Vehicle_CAN_09_CycleTime
{
  ILFaultInjectionSetMsgCycleTime(CAN_MPC3::Vehicle_CAN_09,@this);
  //ILFaultInjectionResetMsgCycleTime(Vehicle_CAN_09);
}

on sysvar CAN_MPC3::DADCA_UN_PR_3::DADCA_UN_PR_3_CycleTime
{
  ILFaultInjectionSetMsgCycleTime(CAN_MPC3::DADCA_UN_PR_3,@this);
  //ILFaultInjectionResetMsgCycleTime(DADCA_UN_PR_3);
}

on sysvar CAN_MPC3::ABS_UN_PR_GW_3::ABS_UN_PR_GW_3_CycleTime
{
  ILFaultInjectionSetMsgCycleTime(CAN_MPC3::ABS_UN_PR_GW_3,@this);
  //ILFaultInjectionResetMsgCycleTime(ABS_UN_PR_GW_3);
}

on sysvar CAN_MPC3::CHCM_FR_PR_GW_2_UN::CHCM_FR_PR_GW_2_UN_CycleTime
{
  ILFaultInjectionSetMsgCycleTime(CAN_MPC3::CHCM_FR_PR_GW_2_UN,@this);
  //ILFaultInjectionResetMsgCycleTime(CHCM_FR_PR_GW_2_UN);
}

on sysvar CAN_MPC3::ABS_UN_PR_GW_2::ABS_UN_PR_GW_2_CycleTime
{
  ILFaultInjectionSetMsgCycleTime(CAN_MPC3::ABS_UN_PR_GW_2,@this);
  //ILFaultInjectionResetMsgCycleTime(ABS_UN_PR_GW_2);
}

on sysvar CAN_MPC3::GWM_UN_PR_1::GWM_UN_PR_1_CycleTime
{
  ILFaultInjectionSetMsgCycleTime(CAN_MPC3::GWM_UN_PR_1,@this);
  //ILFaultInjectionResetMsgCycleTime(GWM_UN_PR_1);
}

on sysvar CAN_MPC3::Vehicle_CAN_15::Vehicle_CAN_15_CycleTime
{
  ILFaultInjectionSetMsgCycleTime(CAN_MPC3::Vehicle_CAN_15,@this);
  //ILFaultInjectionResetMsgCycleTime(Vehicle_CAN_15);
}

on sysvar CAN_MPC3::Vehicle_CAN_17::Vehicle_CAN_17_CycleTime
{
  ILFaultInjectionSetMsgCycleTime(CAN_MPC3::Vehicle_CAN_17,@this);
  //ILFaultInjectionResetMsgCycleTime(Vehicle_CAN_17);
}

on sysvar CAN_MPC3::ABS_UN_PR_11::ABS_UN_PR_11_CycleTime
{
  ILFaultInjectionSetMsgCycleTime(CAN_MPC3::ABS_UN_PR_11,@this);
  //ILFaultInjectionResetMsgCycleTime(ABS_UN_PR_11);
}

on sysvar CAN_MPC3::Vehicle_CAN_21::Vehicle_CAN_21_CycleTime
{
  ILFaultInjectionSetMsgCycleTime(CAN_MPC3::Vehicle_CAN_21,@this);
  //ILFaultInjectionResetMsgCycleTime(Vehicle_CAN_21);
}

on sysvar CAN_MPC3::Vehicle_CAN_25::Vehicle_CAN_25_CycleTime
{
  ILFaultInjectionSetMsgCycleTime(CAN_MPC3::Vehicle_CAN_25,@this);
  //ILFaultInjectionResetMsgCycleTime(Vehicle_CAN_25);
}

on sysvar CAN_MPC3::Vehicle_CAN_29::Vehicle_CAN_29_CycleTime
{
  ILFaultInjectionSetMsgCycleTime(CAN_MPC3::Vehicle_CAN_29,@this);
  //ILFaultInjectionResetMsgCycleTime(Vehicle_CAN_29);
}

on sysvar CAN_MPC3::HCMB_PR_1::HCMB_PR_1_CycleTime
{
  ILFaultInjectionSetMsgCycleTime(CAN_MPC3::HCMB_PR_1,@this);
  //ILFaultInjectionResetMsgCycleTime(HCMB_PR_1);
}

on sysvar CAN_MPC3::Vehicle_CAN_31::Vehicle_CAN_31_CycleTime
{
  ILFaultInjectionSetMsgCycleTime(CAN_MPC3::Vehicle_CAN_31,@this);
  //ILFaultInjectionResetMsgCycleTime(Vehicle_CAN_31);
}

on sysvar CAN_MPC3::Vehicle_CAN_37::Vehicle_CAN_37_CycleTime
{
  ILFaultInjectionSetMsgCycleTime(CAN_MPC3::Vehicle_CAN_37,@this);
  //ILFaultInjectionResetMsgCycleTime(Vehicle_CAN_37);
}

on sysvar CAN_MPC3::IPC_PR_GW_5_UN::IPC_PR_GW_5_UN_CycleTime
{
  ILFaultInjectionSetMsgCycleTime(CAN_MPC3::IPC_PR_GW_5_UN,@this);
  //ILFaultInjectionResetMsgCycleTime(IPC_PR_GW_5_UN);
}

on sysvar CAN_MPC3::Vehicle_CAN_41::Vehicle_CAN_41_CycleTime
{
  ILFaultInjectionSetMsgCycleTime(CAN_MPC3::Vehicle_CAN_41,@this);
  //ILFaultInjectionResetMsgCycleTime(Vehicle_CAN_41);
}

on sysvar CAN_MPC3::Vehicle_CAN_43::Vehicle_CAN_43_CycleTime
{
  ILFaultInjectionSetMsgCycleTime(CAN_MPC3::Vehicle_CAN_43,@this);
  //ILFaultInjectionResetMsgCycleTime(Vehicle_CAN_43);
}

on sysvar CAN_MPC3::Vehicle_CAN_47::Vehicle_CAN_47_CycleTime
{
  ILFaultInjectionSetMsgCycleTime(CAN_MPC3::Vehicle_CAN_47,@this);
  //ILFaultInjectionResetMsgCycleTime(Vehicle_CAN_47);
}

on sysvar CAN_MPC3::Vehicle_CAN_48::Vehicle_CAN_48_CycleTime
{
  ILFaultInjectionSetMsgCycleTime(CAN_MPC3::Vehicle_CAN_48,@this);
  //ILFaultInjectionResetMsgCycleTime(Vehicle_CAN_48);
}

on sysvar CAN_MPC3::VLC_01::VLC_01_CycleTime
{
  ILFaultInjectionSetMsgCycleTime(CAN_MPC3::VLC_01,@this);
  //ILFaultInjectionResetMsgCycleTime(VLC_01);
}

on sysvar CAN_MPC3::VLC_02::VLC_02_CycleTime
{
  ILFaultInjectionSetMsgCycleTime(CAN_MPC3::VLC_02,@this);
  //ILFaultInjectionResetMsgCycleTime(VLC_02);
}

on sysvar CAN_MPC3::ACC_01::ACC_01_CycleTime
{
  ILFaultInjectionSetMsgCycleTime(CAN_MPC3::ACC_01,@this);
  //ILFaultInjectionResetMsgCycleTime(ACC_01);
}

on sysvar CAN_MPC3::SignalGW_PR_1_UN::SignalGW_PR_1_UN_CycleTime
{
  ILFaultInjectionSetMsgCycleTime(CAN_MPC3::SignalGW_PR_1_UN,@this);
  //ILFaultInjectionResetMsgCycleTime(SignalGW_PR_1_UN);
}

on sysvar CAN_MPC3::SignalGW_PR_3_UN::SignalGW_PR_3_UN_CycleTime
{
  ILFaultInjectionSetMsgCycleTime(CAN_MPC3::SignalGW_PR_3_UN,@this);
  //ILFaultInjectionResetMsgCycleTime(SignalGW_PR_3_UN);
}

on sysvar CAN_MPC3::DADCA_UN_SP_5::DADCA_UN_SP_5_CycleTime
{
  ILFaultInjectionSetMsgCycleTime(CAN_MPC3::DADCA_UN_SP_5,@this);
  //ILFaultInjectionResetMsgCycleTime(DADCA_UN_SP_5);
}

on sysvar CAN_MPC3::IGM_PR_GW_7_UN::IGM_PR_GW_7_UN_CycleTime
{
  ILFaultInjectionSetMsgCycleTime(CAN_MPC3::IGM_PR_GW_7_UN,@this);
  //ILFaultInjectionResetMsgCycleTime(IGM_PR_GW_7_UN);
}

on sysvar CAN_MPC3::IMU_TX1::IMU_TX1_CycleTime
{
  ILFaultInjectionSetMsgCycleTime(CAN_MPC3::IMU_TX1,@this);
  //ILFaultInjectionResetMsgCycleTime(IMU_TX1);
}

on sysvar CAN_MPC3::IMU_TX2::IMU_TX2_CycleTime
{
  ILFaultInjectionSetMsgCycleTime(CAN_MPC3::IMU_TX2,@this);
  //ILFaultInjectionResetMsgCycleTime(IMU_TX2);
}

on sysvar CAN_MPC3::SignalGW_PR_4_UN::SignalGW_PR_4_UN_CycleTime
{
  ILFaultInjectionSetMsgCycleTime(CAN_MPC3::SignalGW_PR_4_UN,@this);
  //ILFaultInjectionResetMsgCycleTime(SignalGW_PR_4_UN);
}

on sysvar CAN_MPC3::BCM_PR_GW_16_UN::BCM_PR_GW_16_UN_CycleTime
{
  ILFaultInjectionSetMsgCycleTime(CAN_MPC3::BCM_PR_GW_16_UN,@this);
  //ILFaultInjectionResetMsgCycleTime(BCM_PR_GW_16_UN);
}

on sysvar CAN_MPC3::CHCM_FR_PR_GW_3_UN::CHCM_FR_PR_GW_3_UN_CycleTime
{
  ILFaultInjectionSetMsgCycleTime(CAN_MPC3::CHCM_FR_PR_GW_3_UN,@this);
  //ILFaultInjectionResetMsgCycleTime(CHCM_FR_PR_GW_3_UN);
}

on sysvar CAN_MPC3::PSCM_FR_PR_GW_1_UN::PSCM_FR_PR_GW_1_UN_CycleTime
{
  ILFaultInjectionSetMsgCycleTime(CAN_MPC3::PSCM_FR_PR_GW_1_UN,@this);
  //ILFaultInjectionResetMsgCycleTime(PSCM_FR_PR_GW_1_UN);
}

on sysvar CAN_MPC3::LANE_02::LANE_02_CycleTime
{
  ILFaultInjectionSetMsgCycleTime(CAN_MPC3::LANE_02,@this);
  //ILFaultInjectionResetMsgCycleTime(LANE_02);
}

on sysvar CAN_MPC3::LANE_05::LANE_05_CycleTime
{
  ILFaultInjectionSetMsgCycleTime(CAN_MPC3::LANE_05,@this);
  //ILFaultInjectionResetMsgCycleTime(LANE_05);
}

on sysvar CAN_MPC3::PSCM_FR_PR_GW_2_UN::PSCM_FR_PR_GW_2_UN_CycleTime
{
  ILFaultInjectionSetMsgCycleTime(CAN_MPC3::PSCM_FR_PR_GW_2_UN,@this);
  //ILFaultInjectionResetMsgCycleTime(PSCM_FR_PR_GW_2_UN);
}

on sysvar CAN_MPC3::TPM_PR_GW_4::TPM_PR_GW_4_CycleTime
{
  ILFaultInjectionSetMsgCycleTime(CAN_MPC3::TPM_PR_GW_4,@this);
  //ILFaultInjectionResetMsgCycleTime(TPM_PR_GW_4);
}

on sysvar CAN_MPC3::PCM_FR_PR_PedalPos_UN::PCM_FR_PR_PedalPos_UN_CycleTime
{
  ILFaultInjectionSetMsgCycleTime(CAN_MPC3::PCM_FR_PR_PedalPos_UN,@this);
  //ILFaultInjectionResetMsgCycleTime(PCM_FR_PR_PedalPos_UN);
}

on sysvar CAN_MPC3::AEB_01::AEB_01_CycleTime
{
  ILFaultInjectionSetMsgCycleTime(CAN_MPC3::AEB_01,@this);
  //ILFaultInjectionResetMsgCycleTime(AEB_01);
}

on sysvar CAN_MPC3::LIGHT_01::LIGHT_01_CycleTime
{
  ILFaultInjectionSetMsgCycleTime(CAN_MPC3::LIGHT_01,@this);
  //ILFaultInjectionResetMsgCycleTime(LIGHT_01);
}

on sysvar CAN_MPC3::VEHCONFIG_400UN_AS::VEHCONFIG_400UN_AS_CycleTime
{
  ILFaultInjectionSetMsgCycleTime(CAN_MPC3::VEHCONFIG_400UN_AS,@this);
  //ILFaultInjectionResetMsgCycleTime(VEHCONFIG_400UN_AS);
}

on sysvar CAN_MPC3::RCM_FR_PR_TXID1_UN::RCM_FR_PR_TXID1_UN_CycleTime
{
  ILFaultInjectionSetMsgCycleTime(CAN_MPC3::RCM_FR_PR_TXID1_UN,@this);
  //ILFaultInjectionResetMsgCycleTime(RCM_FR_PR_TXID1_UN);
}

on sysvar CAN_MPC3::RCM_FR_PR_TXID2_UN::RCM_FR_PR_TXID2_UN_CycleTime
{
  ILFaultInjectionSetMsgCycleTime(CAN_MPC3::RCM_FR_PR_TXID2_UN,@this);
  //ILFaultInjectionResetMsgCycleTime(RCM_FR_PR_TXID2_UN);
}

on sysvar CAN_MPC3::TransmissionControl_A_GW_UN::TransmissionControl_A_GW_UN_CycleTime
{
  ILFaultInjectionSetMsgCycleTime(CAN_MPC3::TransmissionControl_A_GW_UN,@this);
  //ILFaultInjectionResetMsgCycleTime(TransmissionControl_A_GW_UN);
}

on sysvar CAN_MPC3::SASM_FR_GW_1_UN::SASM_FR_GW_1_UN_CycleTime
{
  ILFaultInjectionSetMsgCycleTime(CAN_MPC3::SASM_FR_GW_1_UN,@this);
  //ILFaultInjectionResetMsgCycleTime(SASM_FR_GW_1_UN);
}

on sysvar CAN_MPC3::DADCA_FR_PR_GW_4_UN::DADCA_FR_PR_GW_4_UN_CycleTime
{
  ILFaultInjectionSetMsgCycleTime(CAN_MPC3::DADCA_FR_PR_GW_4_UN,@this);
  //ILFaultInjectionResetMsgCycleTime(DADCA_FR_PR_GW_4_UN);
}

on sysvar CAN_MPC3::HCMA_PR_1::HCMA_PR_1_CycleTime
{
  ILFaultInjectionSetMsgCycleTime(CAN_MPC3::HCMA_PR_1,@this);
  //ILFaultInjectionResetMsgCycleTime(HCMA_PR_1);
}

on sysvar CAN_MPC3::HCMA_PR_2::HCMA_PR_2_CycleTime
{
  ILFaultInjectionSetMsgCycleTime(CAN_MPC3::HCMA_PR_2,@this);
  //ILFaultInjectionResetMsgCycleTime(HCMA_PR_2);
}

on sysvar CAN_MPC3::DBC_Version::DBC_Version_CycleTime
{
  ILFaultInjectionSetMsgCycleTime(CAN_MPC3::DBC_Version,@this);
  //ILFaultInjectionResetMsgCycleTime(DBC_Version);
}

on sysvar CAN_MPC3::PCM_FR_PR_Core_B_UN::PCM_FR_PR_Core_B_UN_CycleTime
{
  ILFaultInjectionSetMsgCycleTime(CAN_MPC3::PCM_FR_PR_Core_B_UN,@this);
  //ILFaultInjectionResetMsgCycleTime(PCM_FR_PR_Core_B_UN);
}

on sysvar CAN_MPC3::ABS_UN_PR_4::ABS_UN_PR_4_CycleTime
{
  ILFaultInjectionSetMsgCycleTime(CAN_MPC3::ABS_UN_PR_4,@this);
  //ILFaultInjectionResetMsgCycleTime(ABS_UN_PR_4);
}

on sysvar CAN_MPC3::IGM_SP_GW_10_UN::IGM_SP_GW_10_UN_CycleTime
{
  ILFaultInjectionSetMsgCycleTime(CAN_MPC3::IGM_SP_GW_10_UN,@this);
  //ILFaultInjectionResetMsgCycleTime(IGM_SP_GW_10_UN);
}

on sysvar CAN_MPC3::RCM_FR_PR_GW_1_UN::RCM_FR_PR_GW_1_UN_CycleTime
{
  ILFaultInjectionSetMsgCycleTime(CAN_MPC3::RCM_FR_PR_GW_1_UN,@this);
  //ILFaultInjectionResetMsgCycleTime(RCM_FR_PR_GW_1_UN);
}

on sysvar CAN_MPC3::PCM_FR_PR_WhlTorqTgt_UN::PCM_FR_PR_WhlTorqTgt_UN_CycleTime
{
  ILFaultInjectionSetMsgCycleTime(CAN_MPC3::PCM_FR_PR_WhlTorqTgt_UN,@this);
  //ILFaultInjectionResetMsgCycleTime(PCM_FR_PR_WhlTorqTgt_UN);
}

on sysvar CAN_MPC3::BCM_SP_GW_2_UN::BCM_SP_GW_2_UN_CycleTime
{
  ILFaultInjectionSetMsgCycleTime(CAN_MPC3::BCM_SP_GW_2_UN,@this);
  //ILFaultInjectionResetMsgCycleTime(BCM_SP_GW_2_UN);
}

on sysvar CAN_MPC3::ABS_UN_PR_GW_5_1::ABS_UN_PR_GW_5_1_CycleTime
{
  ILFaultInjectionSetMsgCycleTime(CAN_MPC3::ABS_UN_PR_GW_5_1,@this);
  //ILFaultInjectionResetMsgCycleTime(ABS_UN_PR_GW_5_1);
}

on sysvar CAN_MPC3::ABS_UN_PR_GW_5_2::ABS_UN_PR_GW_5_2_CycleTime
{
  ILFaultInjectionSetMsgCycleTime(CAN_MPC3::ABS_UN_PR_GW_5_2,@this);
  //ILFaultInjectionResetMsgCycleTime(ABS_UN_PR_GW_5_2);
}

on sysvar CAN_MPC3::SignalGW_PR_6_UN::SignalGW_PR_6_UN_CycleTime
{
  ILFaultInjectionSetMsgCycleTime(CAN_MPC3::SignalGW_PR_6_UN,@this);
  //ILFaultInjectionResetMsgCycleTime(SignalGW_PR_6_UN);
}

on sysvar CAN_MPC3::DADCA_UN_PR_GW_2::DADCA_UN_PR_GW_2_CycleTime
{
  ILFaultInjectionSetMsgCycleTime(CAN_MPC3::DADCA_UN_PR_GW_2,@this);
  //ILFaultInjectionResetMsgCycleTime(DADCA_UN_PR_GW_2);
}

on sysvar CAN_MPC3::DADCA_UN_PR_GW_3::DADCA_UN_PR_GW_3_CycleTime
{
  ILFaultInjectionSetMsgCycleTime(CAN_MPC3::DADCA_UN_PR_GW_3,@this);
  //ILFaultInjectionResetMsgCycleTime(DADCA_UN_PR_GW_3);
}

on sysvar CAN_MPC3::BCM_PR_GW_1_UN::BCM_PR_GW_1_UN_CycleTime
{
  ILFaultInjectionSetMsgCycleTime(CAN_MPC3::BCM_PR_GW_1_UN,@this);
  //ILFaultInjectionResetMsgCycleTime(BCM_PR_GW_1_UN);
}

void MPC3_sim_SetCycleTimeOffset()
{

//  ILNodeSetPDUTimingCyclic (dbMsg dbMessage, long TrueOrFalse, long offset, long period, long disturbanceCount, long flags);
//  TrueOrFalse ; 0: denotes the False timing; 1: denotes the True timing; 3: denotes the True and the False timing.
//  offset :Defines the delay in [ms] from now when the first cyclic transmission will start.
//  period :Defines the period in [ms] for the cyclic transmission.
//  disturbanceCount :Reserved/unused; should be set to -1 (infinite).
//  flags :Reserved; should be set to 0.

}