/*@!Encoding:1252*/
/**
 * @file PSA_CRC_Lib.cin
 * @author ADAS_HIL_TEAM
 * @date 10-04-2022
 * @brief This program sends all relevant messages on CAN for the emulation
 *			of all control devices that communicate with the ACC-device. These 
 *			messages includes information from driver, environment and the vehicle.
 *			The ACC-messages are evaluated by this program and used for a closed
 *			loop emulation with a vehicle-model.
 *
 * ################################################################
 * C O P Y R I G H T S
 * ----------------------------------------------------------------
 * Copyright (c) 2022-2023 by Robert Bosch GmbH. All rights reserved.
 
 * The reproduction, distribution and utilization of this file as
 * well as the communication of its contents to others without express
 * authorization is prohibited. Offenders will be held liable for the
 * payment of damages. All rights reserved in the event of the grant
 * of a patent, utility model or design.
 *
 * ################################################################
*/

Variables 
{
  // const for CRC8 Checksum calculation
  byte CRC_8_H1D_Tbl[256] = {
    /*  0:*/ 0x00, 0x1d, 0x3a, 0x27, 0x74, 0x69, 0x4e, 0x53,
    /*  8:*/ 0xe8, 0xf5, 0xd2, 0xcf, 0x9c, 0x81, 0xa6, 0xbb,
    /* 16:*/ 0xcd, 0xd0, 0xf7, 0xea, 0xb9, 0xa4, 0x83, 0x9e,
    /* 24:*/ 0x25, 0x38, 0x1f, 0x02, 0x51, 0x4c, 0x6b, 0x76,
    /* 32:*/ 0x87, 0x9a, 0xbd, 0xa0, 0xf3, 0xee, 0xc9, 0xd4,
    /* 40:*/ 0x6f, 0x72, 0x55, 0x48, 0x1b, 0x06, 0x21, 0x3c,
    /* 48:*/ 0x4a, 0x57, 0x70, 0x6d, 0x3e, 0x23, 0x04, 0x19,
    /* 56:*/ 0xa2, 0xbf, 0x98, 0x85, 0xd6, 0xcb, 0xec, 0xf1,
    /* 64:*/ 0x13, 0x0e, 0x29, 0x34, 0x67, 0x7a, 0x5d, 0x40,
    /* 72:*/ 0xfb, 0xe6, 0xc1, 0xdc, 0x8f, 0x92, 0xb5, 0xa8,
    /* 80:*/ 0xde, 0xc3, 0xe4, 0xf9, 0xaa, 0xb7, 0x90, 0x8d,
    /* 88:*/ 0x36, 0x2b, 0x0c, 0x11, 0x42, 0x5f, 0x78, 0x65,
    /* 96:*/ 0x94, 0x89, 0xae, 0xb3, 0xe0, 0xfd, 0xda, 0xc7,
    /*104:*/ 0x7c, 0x61, 0x46, 0x5b, 0x08, 0x15, 0x32, 0x2f,
    /*112:*/ 0x59, 0x44, 0x63, 0x7e, 0x2d, 0x30, 0x17, 0x0a,
    /*120:*/ 0xb1, 0xac, 0x8b, 0x96, 0xc5, 0xd8, 0xff, 0xe2,
    /*128:*/ 0x26, 0x3b, 0x1c, 0x01, 0x52, 0x4f, 0x68, 0x75,
    /*136:*/ 0xce, 0xd3, 0xf4, 0xe9, 0xba, 0xa7, 0x80, 0x9d,
    /*144:*/ 0xeb, 0xf6, 0xd1, 0xcc, 0x9f, 0x82, 0xa5, 0xb8,
    /*152:*/ 0x03, 0x1e, 0x39, 0x24, 0x77, 0x6a, 0x4d, 0x50,
    /*160:*/ 0xa1, 0xbc, 0x9b, 0x86, 0xd5, 0xc8, 0xef, 0xf2,
    /*168:*/ 0x49, 0x54, 0x73, 0x6e, 0x3d, 0x20, 0x07, 0x1a,
    /*176:*/ 0x6c, 0x71, 0x56, 0x4b, 0x18, 0x05, 0x22, 0x3f,
    /*184:*/ 0x84, 0x99, 0xbe, 0xa3, 0xf0, 0xed, 0xca, 0xd7,
    /*192:*/ 0x35, 0x28, 0x0f, 0x12, 0x41, 0x5c, 0x7b, 0x66,
    /*200:*/ 0xdd, 0xc0, 0xe7, 0xfa, 0xa9, 0xb4, 0x93, 0x8e,
    /*208:*/ 0xf8, 0xe5, 0xc2, 0xdf, 0x8c, 0x91, 0xb6, 0xab,
    /*216:*/ 0x10, 0x0d, 0x2a, 0x37, 0x64, 0x79, 0x5e, 0x43,
    /*224:*/ 0xb2, 0xaf, 0x88, 0x95, 0xc6, 0xdb, 0xfc, 0xe1,
    /*232:*/ 0x5a, 0x47, 0x60, 0x7d, 0x2e, 0x33, 0x14, 0x09,
    /*240:*/ 0x7f, 0x62, 0x45, 0x58, 0x0b, 0x16, 0x31, 0x2c,
    /*248:*/ 0x97, 0x8a, 0xad, 0xb0, 0xe3, 0xfe, 0xd9, 0xc4
    };
  
}


//CRC-checksum of signal group according to AUTOSAR Profile 1A
byte PROJ_CRC_UpdateChecksumCRC8_E2E_P01A (message *data, dword start_pos, dword stop_pos,int CRC_field_pos, dword Data_ID)
{
    byte crcTemp;
    dword index;
    byte dataID_au8[2];
  
    /* Data ID: low byte [0], high byte[1] */
    dataID_au8[0] = Data_ID;
    dataID_au8[1] = Data_ID >> 8;
  
    //  crcTemp = 0xFF;//Initial CRC value
    crcTemp = 0x00;//Initial CRC value
  
    // Calculate the CRC for the Data_ID bytes for the DATA_ID_Both mode for Autosar P01-A
    for (index = 0; index < 2; ++index)
    {
        //Calculate CRC for the DataIds
        crcTemp = crcTemp ^ dataID_au8[index];

        //Calculate CRC is matched with the look up table
        crcTemp  = CRC_8_H1D_Tbl[crcTemp];
    }
   
    //Calculate 8 bit CRC over data excluding the CRC byte, considering range of data bytes specified from start to stop
    for (index = start_pos; index < stop_pos; ++index)
    {
       if (index == CRC_field_pos){} //If index is the CRC field, then skip the CRC calc for that byte
       else{
      //Calculate CRC for Data bytes
         crcTemp = crcTemp ^ data.byte(index);
        //Calculate CRC is matched with the look up table
        crcTemp  = CRC_8_H1D_Tbl[crcTemp];
      }
    }    
    //  crcTemp = crcTemp ^ 0xFF; // Final CRC masked with initial value considered.(Removed based on input from Puneeth)
    
    return(crcTemp);        
}


byte PROJ_CRC_UpdateChecksumCRC4bit_E2E_PSA_3F(message *Message_Name, dword start_pos, dword stop_pos)
{
		byte ByteIndex_ub;
		byte Crc_ub ;  
    byte Alpha_b ; 
    Crc_ub = 0; 
    Alpha_b =0;

    //Initial value of CRC field made 0
    // Assumption is that the CRC field before calculation is made 0

    // CRC calculation excluding CRC field
		for (ByteIndex_ub = start_pos; ByteIndex_ub <stop_pos ; ByteIndex_ub++ )            
		{        
      Alpha_b ^= Message_Name.byte(ByteIndex_ub);
		}
    Crc_ub= ((Alpha_b & 0xF0) >> 0x4) ^ (Alpha_b & 0x0F) ^ (Message_Name.byte(4)& 0x0F);  
    
    return(Crc_ub);

}


byte PROJ_CRC_UpdateChecksumCRC4bit_E2E_PSA (message *Message_Name, dword start_pos, dword stop_pos, byte CHK_INI)
{
		byte ByteIndex_ub;
		byte Crc_ub ;                                                                     
		byte Sum_low_nibbles_b ;
    byte Sum_high_nibbles_b; 
    dword MessageID;
  
    Crc_ub = 0; 
    Sum_low_nibbles_b=0;
    Sum_high_nibbles_b= 0;
				
    //Initial value of CRC field made 0
    // Assumption is that the CRC field before calculation is made 0

    // CRC calculation including CRC field
		for (ByteIndex_ub = start_pos; ByteIndex_ub <stop_pos ; ByteIndex_ub++ )            
		{        
			Sum_low_nibbles_b+= (Message_Name.byte(ByteIndex_ub) & 0x0F);                     
			Sum_high_nibbles_b+= ((Message_Name.byte(ByteIndex_ub)& 0xF0) >> 0x4);  
		}                                                                                    
		Crc_ub = ( Sum_low_nibbles_b + Sum_high_nibbles_b + 1 + CHK_INI ) ;// Mod 16 is used hence added 1
		Crc_ub = 16 - (Crc_ub % 16); 		// Final CRC - PSA specific in byte ( shall be typecasted to Nibble)
  
    return(Crc_ub); 
    
}

