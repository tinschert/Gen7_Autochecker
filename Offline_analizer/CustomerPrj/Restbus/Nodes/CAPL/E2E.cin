/*@!Encoding:1252*/
/**
 * @file E2E.cin
 * @author ADAS_HIL_TEAM
 * @date 10-04-2022
 * @brief 
 *
 * ################################################################
 * C O P Y R I G H T S
 * ----------------------------------------------------------------
 * Copyright (c) 2022-2023 by Robert Bosch GmbH. All rights reserved.
 
 * The reproduction, distribution and utilization of this file as
 * well as the communication of its contents to others without express
 * authorization is prohibited. Offenders will be held liable for the
 * payment of damages. All rights reserved in the event of the grant
 * of a patent, utility model or design.
 *
 * ################################################################
*/

includes
{
  
}

variables
{ 
  
  // Reference: E2E requirement - Q-BJEV 03.7001.12018X ????E2E??????.docx
  // SharePoint link: https://sites.inside-share.bosch.com/sites/036839/default.aspx?RootFolder=%2Fsites%2F036839%2FDocuments%2F02%5FDASy%2F04%5FSoftware%2F10%5FBaseSW%2FBL2%2E1%5FFULL%5FDIAG%2F01%2ERequirements%2FE2E&FolderCTID=0x012000EEB095C206F067418E9F32198349473C&View=%7BB13E859C%2DBBD8%2D4F7C%2D8A1B%2DF106C533ED98%7D
  byte initialization_value = (0xFF ^ 0xFF);
  byte result_XOR_value = (0xFF ^ 0xFF);
  
  byte CRC_Calc_SAEJ1850_StartValue = 0xFF;
  
  dword CRC16_INIT = 0xFFFF;
  dword CRC16_XOR = 0x0000;
  
  byte CRC8_8H2F_INIT = 0xFF ;
  byte CRC8_8H2F_XOR = 0xFF ;
  
  byte CRC8_SAE_J1850_Poly_1D_Lookup[256] = 
  {  
    0x00, 0x1D, 0x3A, 0x27, 0x74, 0x69, 0x4E, 0x53, 0xE8, 0xF5, 0xD2, 0xCF, 0x9C, 0x81, 0xA6, 0xBB, 
    0xCD, 0xD0, 0xF7, 0xEA, 0xB9, 0xA4, 0x83, 0x9E, 0x25, 0x38, 0x1F, 0x02, 0x51, 0x4C, 0x6B, 0x76, 
    0x87, 0x9A, 0xBD, 0xA0, 0xF3, 0xEE, 0xC9, 0xD4, 0x6F, 0x72, 0x55, 0x48, 0x1B, 0x06, 0x21, 0x3C, 
    0x4A, 0x57, 0x70, 0x6D, 0x3E, 0x23, 0x04, 0x19, 0xA2, 0xBF, 0x98, 0x85, 0xD6, 0xCB, 0xEC, 0xF1, 
    0x13, 0x0E, 0x29, 0x34, 0x67, 0x7A, 0x5D, 0x40, 0xFB, 0xE6, 0xC1, 0xDC, 0x8F, 0x92, 0xB5, 0xA8,
    0xDE, 0xC3, 0xE4, 0xF9, 0xAA, 0xB7, 0x90, 0x8D, 0x36, 0x2B, 0x0C, 0x11, 0x42, 0x5F, 0x78, 0x65, 
    0x94, 0x89, 0xAE, 0xB3, 0xE0, 0xFD, 0xDA, 0xC7, 0x7C, 0x61, 0x46, 0x5B, 0x08, 0x15, 0x32, 0x2F,
    0x59, 0x44, 0x63, 0x7E, 0x2D, 0x30, 0x17, 0x0A, 0xB1, 0xAC, 0x8B, 0x96, 0xC5, 0xD8, 0xFF, 0xE2, 
    0x26, 0x3B, 0x1C, 0x01, 0x52, 0x4F, 0x68, 0x75, 0xCE, 0xD3, 0xF4, 0xE9, 0xBA, 0xA7, 0x80, 0x9D, 
    0xEB, 0xF6, 0xD1, 0xCC, 0x9F, 0x82, 0xA5, 0xB8, 0x03, 0x1E, 0x39, 0x24, 0x77, 0x6A, 0x4D, 0x50, 
    0xA1, 0xBC, 0x9B, 0x86, 0xD5, 0xC8, 0xEF, 0xF2, 0x49, 0x54, 0x73, 0x6E, 0x3D, 0x20, 0x07, 0x1A, 
    0x6C, 0x71, 0x56, 0x4B, 0x18, 0x05, 0x22, 0x3F, 0x84, 0x99, 0xBE, 0xA3, 0xF0, 0xED, 0xCA, 0xD7, 
    0x35, 0x28, 0x0F, 0x12, 0x41, 0x5C, 0x7B, 0x66, 0xDD, 0xC0, 0xE7, 0xFA, 0xA9, 0xB4, 0x93, 0x8E, 
    0xF8, 0xE5, 0xC2, 0xDF, 0x8C, 0x91, 0xB6, 0xAB, 0x10, 0x0D, 0x2A, 0x37, 0x64, 0x79, 0x5E, 0x43, 
    0xB2, 0xAF, 0x88, 0x95, 0xC6, 0xDB, 0xFC, 0xE1, 0x5A, 0x47, 0x60, 0x7D, 0x2E, 0x33, 0x14, 0x09, 
    0x7F, 0x62, 0x45, 0x58, 0x0B, 0x16, 0x31, 0x2C, 0x97, 0x8A, 0xAD, 0xB0, 0xE3, 0xFE, 0xD9, 0xC4  
  };
  
  dword CRC16_CCITT_FALSE_POLY_1021H_Lookup[256] = 
  {  
    0x0000, 0x1021, 0x2042, 0x3063, 0x4084, 0x50A5, 0x60C6, 0x70E7, 0x8108, 0x9129, 0xA14A, 0xB16B, 0xC18C, 0xD1AD, 0xE1CE, 0xF1EF, 
    0x1231, 0x0210, 0x3273, 0x2252, 0x52B5, 0x4294, 0x72F7, 0x62D6, 0x9339, 0x8318, 0xB37B, 0xA35A, 0xD3BD, 0xC39C, 0xF3FF, 0xE3DE,
    0x2462, 0x3443, 0x0420, 0x1401, 0x64E6, 0x74C7, 0x44A4, 0x5485, 0xA56A, 0xB54B, 0x8528, 0x9509, 0xE5EE, 0xF5CF, 0xC5AC, 0xD58D, 
    0x3653, 0x2672, 0x1611, 0x0630, 0x76D7, 0x66F6, 0x5695, 0x46B4, 0xB75B, 0xA77A, 0x9719, 0x8738, 0xF7DF, 0xE7FE, 0xD79D, 0xC7BC, 
    0x48C4, 0x58E5, 0x6886, 0x78A7, 0x0840, 0x1861, 0x2802, 0x3823, 0xC9CC, 0xD9ED, 0xE98E, 0xF9AF, 0x8948, 0x9969, 0xA90A, 0xB92B, 
    0x5AF5, 0x4AD4, 0x7AB7, 0x6A96, 0x1A71, 0x0A50, 0x3A33, 0x2A12, 0xDBFD, 0xCBDC, 0xFBBF, 0xEB9E, 0x9B79, 0x8B58, 0xBB3B, 0xAB1A, 
    0x6CA6, 0x7C87, 0x4CE4, 0x5CC5, 0x2C22, 0x3C03, 0x0C60, 0x1C41, 0xEDAE, 0xFD8F, 0xCDEC, 0xDDCD, 0xAD2A, 0xBD0B, 0x8D68, 0x9D49, 
    0x7E97, 0x6EB6, 0x5ED5, 0x4EF4, 0x3E13, 0x2E32, 0x1E51, 0x0E70, 0xFF9F, 0xEFBE, 0xDFDD, 0xCFFC, 0xBF1B, 0xAF3A, 0x9F59, 0x8F78, 
    0x9188, 0x81A9, 0xB1CA, 0xA1EB, 0xD10C, 0xC12D, 0xF14E, 0xE16F, 0x1080, 0x00A1, 0x30C2, 0x20E3, 0x5004, 0x4025, 0x7046, 0x6067, 
    0x83B9, 0x9398, 0xA3FB, 0xB3DA, 0xC33D, 0xD31C, 0xE37F, 0xF35E, 0x02B1, 0x1290, 0x22F3, 0x32D2, 0x4235, 0x5214, 0x6277, 0x7256, 
    0xB5EA, 0xA5CB, 0x95A8, 0x8589, 0xF56E, 0xE54F, 0xD52C, 0xC50D, 0x34E2, 0x24C3, 0x14A0, 0x0481, 0x7466, 0x6447, 0x5424, 0x4405, 
    0xA7DB, 0xB7FA, 0x8799, 0x97B8, 0xE75F, 0xF77E, 0xC71D, 0xD73C, 0x26D3, 0x36F2, 0x0691, 0x16B0, 0x6657, 0x7676, 0x4615, 0x5634, 
    0xD94C, 0xC96D, 0xF90E, 0xE92F, 0x99C8, 0x89E9, 0xB98A, 0xA9AB, 0x5844, 0x4865, 0x7806, 0x6827, 0x18C0, 0x08E1, 0x3882, 0x28A3, 
    0xCB7D, 0xDB5C, 0xEB3F, 0xFB1E, 0x8BF9, 0x9BD8, 0xABBB, 0xBB9A, 0x4A75, 0x5A54, 0x6A37, 0x7A16, 0x0AF1, 0x1AD0, 0x2AB3, 0x3A92, 
    0xFD2E, 0xED0F, 0xDD6C, 0xCD4D, 0xBDAA, 0xAD8B, 0x9DE8, 0x8DC9, 0x7C26, 0x6C07, 0x5C64, 0x4C45, 0x3CA2, 0x2C83, 0x1CE0, 0x0CC1, 
    0xEF1F, 0xFF3E, 0xCF5D, 0xDF7C, 0xAF9B, 0xBFBA, 0x8FD9, 0x9FF8, 0x6E17, 0x7E36, 0x4E55, 0x5E74, 0x2E93, 0x3EB2, 0x0ED1, 0x1EF0 
  };
  
  byte CRC8_8H2F_Poly_2F_Lookup[256] = 
  {  
	  0x00, 0x2F, 0x5E, 0x71, 0xBC, 0x93, 0xE2, 0xCD, 0x57, 0x78, 0x09, 0x26, 0xEB, 0xC4, 0xB5, 0x9A, 
    0xAE, 0x81, 0xF0, 0xDF, 0x12, 0x3D, 0x4C, 0x63, 0xF9, 0xD6, 0xA7, 0x88, 0x45, 0x6A, 0x1B, 0x34, 
    0x73, 0x5C, 0x2D, 0x02, 0xCF, 0xE0, 0x91, 0xBE, 0x24, 0x0B, 0x7A, 0x55, 0x98, 0xB7, 0xC6, 0xE9, 
    0xDD, 0xF2, 0x83, 0xAC, 0x61, 0x4E, 0x3F, 0x10, 0x8A, 0xA5, 0xD4, 0xFB, 0x36, 0x19, 0x68, 0x47, 
    0xE6, 0xC9, 0xB8, 0x97, 0x5A, 0x75, 0x04, 0x2B, 0xB1, 0x9E, 0xEF, 0xC0, 0x0D, 0x22, 0x53, 0x7C, 
    0x48, 0x67, 0x16, 0x39, 0xF4, 0xDB, 0xAA, 0x85, 0x1F, 0x30, 0x41, 0x6E, 0xA3, 0x8C, 0xFD, 0xD2, 
    0x95, 0xBA, 0xCB, 0xE4, 0x29, 0x06, 0x77, 0x58, 0xC2, 0xED, 0x9C, 0xB3, 0x7E, 0x51, 0x20, 0x0F, 
    0x3B, 0x14, 0x65, 0x4A, 0x87, 0xA8, 0xD9, 0xF6, 0x6C, 0x43, 0x32, 0x1D, 0xD0, 0xFF, 0x8E, 0xA1, 
    0xE3, 0xCC, 0xBD, 0x92, 0x5F, 0x70, 0x01, 0x2E, 0xB4, 0x9B, 0xEA, 0xC5, 0x08, 0x27, 0x56, 0x79, 
    0x4D, 0x62, 0x13, 0x3C, 0xF1, 0xDE, 0xAF, 0x80, 0x1A, 0x35, 0x44, 0x6B, 0xA6, 0x89, 0xF8, 0xD7, 
    0x90, 0xBF, 0xCE, 0xE1, 0x2C, 0x03, 0x72, 0x5D, 0xC7, 0xE8, 0x99, 0xB6, 0x7B, 0x54, 0x25, 0x0A, 
    0x3E, 0x11, 0x60, 0x4F, 0x82, 0xAD, 0xDC, 0xF3, 0x69, 0x46, 0x37, 0x18, 0xD5, 0xFA, 0x8B, 0xA4, 
    0x05, 0x2A, 0x5B, 0x74, 0xB9, 0x96, 0xE7, 0xC8, 0x52, 0x7D, 0x0C, 0x23, 0xEE, 0xC1, 0xB0, 0x9F, 
    0xAB, 0x84, 0xF5, 0xDA, 0x17, 0x38, 0x49, 0x66, 0xFC, 0xD3, 0xA2, 0x8D, 0x40, 0x6F, 0x1E, 0x31, 
    0x76, 0x59, 0x28, 0x07, 0xCA, 0xE5, 0x94, 0xBB, 0x21, 0x0E, 0x7F, 0x50, 0x9D, 0xB2, 0xC3, 0xEC, 
    0xD8, 0xF7, 0x86, 0xA9, 0x64, 0x4B, 0x3A, 0x15, 0x8F, 0xA0, 0xD1, 0xFE, 0x33, 0x1C, 0x6D, 0x42 
  };
}



byte CRC_Calc_SAEJ1850 (int f_DataLength, byte f_RxData[]) //6   array of 10
{
    byte calced_crc;
    int   l_idx;

    calced_crc = CRC_Calc_SAEJ1850_StartValue;  // 0xFF
    for (l_idx=0; l_idx<=f_DataLength; l_idx++)
    {
        calced_crc = CRC8_SAE_J1850_Poly_1D_Lookup[((f_RxData[l_idx])^calced_crc)];
    }
    /* invert result */
    return (~calced_crc);
}



byte Data_ID_Lookup(long msg_ID)
{
  //Data ID from CAN matrix Signal Description 
  if(msg_ID == 0x1B0) return 0x2B;
  else if(msg_ID == 0x292) return 0xA3;
  else if(msg_ID == 0x558) return 0xCF;  
  else if(msg_ID == 0x335) return 0xD4;
  else if(msg_ID == 0x343) return 0xD7;
  else if(msg_ID == 0x310) return 0xC8;
  else if(msg_ID == 0x1C2) return 0x90;
  else if(msg_ID == 0x1C4) return 0x9C;
  else if(msg_ID == 0x120) return 0xB1;
  else if(msg_ID == 0x122) return 0xF4;
  else if(msg_ID == 0x261) return 0x72;
  else if(msg_ID == 0x268) return 0x7B;
  else if(msg_ID == 0x305) return 0x8A;
  else if(msg_ID == 0x306) return 0x9F;
  else if(msg_ID == 0x30A) return 0x74;
  else if(msg_ID == 0x318) return 0x79;
  else if(msg_ID == 0x332) return 0x8C;
  else if(msg_ID == 0x271) return 0xA4;
  else if(msg_ID == 0x336) return 0xE5;
  else if(msg_ID == 0x525) return 0xF9;
  else if(msg_ID == 0x150) return 0x29;
  else if(msg_ID == 0x151) return 0x34;
  else if(msg_ID == 0x333) return 0xCB;
  else if(msg_ID == 0x319) return 0x98;
  else if(msg_ID == 0x1BA) return 0x75;
  else if(msg_ID == 0x214) return 0x12;
  else if(msg_ID == 0x225) return 0x2A;
  else if(msg_ID == 0x242) return 0xA1;
  else if(msg_ID == 0x246) return 0xB8;
  else if(msg_ID == 0x1C0) return 0xC3;
  else if(msg_ID == 0x254) return 0x48;
  else if(msg_ID == 0x10C) return 0x0C;
  else if(msg_ID == 0x11) return 0x08;
  else if(msg_ID == 0x2E) return 0x76;
  else if(msg_ID == 0x32) return 0xC5;
  else if(msg_ID == 0x36) return 0x29;
  else if(msg_ID == 0x4A) return 0x1B;
  else if(msg_ID == 0x4C) return 0x1C;
  else if(msg_ID == 0x56) return 0x62;
  else if(msg_ID == 0x84) return 0x20;
  else if(msg_ID == 0xD) return 0x4D;
  else if(msg_ID == 0xED) return 0x09;
  else if(msg_ID == 0xF0) return 0x0A;
  else if(msg_ID == 0xFD) return 0x96;
  else if(msg_ID == 0xFE) return 0x97;
  
  else{return 0;}
}

word Data_ID_Lookup_PRIVATE(long msg_ID)
{  
  /*
  Data ID's reference: BJEV_5R1V1D_E2E_Profile5_DataID_20190530.xlsx
  Link: https://sites.inside-share.bosch.com/sites/036839/Documents/01_SoS_ADAS_System/02_Engineering/01_Architecture_Desgin/07_SFCAN/03_5R1V1D_BL04
  */
  
  // Radar Front Center(locations) (93)
  if(msg_ID == 0x180) return 0x1180;
  else if(msg_ID == 0x181) return 0x1181;
  else if(msg_ID == 0x182) return 0x1182;
  else if(msg_ID == 0x183) return 0x1183;
  else if(msg_ID == 0x184) return 0x1184;
  else if(msg_ID == 0x190) return 0x1190;
  else if(msg_ID == 0x191) return 0x1191;
  else if(msg_ID == 0x192) return 0x1192;
  else if(msg_ID == 0x193) return 0x1193;
  else if(msg_ID == 0x194) return 0x1194;
  else if(msg_ID == 0x195) return 0x1195;
  else if(msg_ID == 0x196) return 0x1196;
  else if(msg_ID == 0x197) return 0x1197;
  else if(msg_ID == 0x198) return 0x1198;
  else if(msg_ID == 0x199) return 0x1199;
  else if(msg_ID == 0x19A) return 0x119A;
  else if(msg_ID == 0x19B) return 0x119B;
  else if(msg_ID == 0x19C) return 0x119C;
  else if(msg_ID == 0x19D) return 0x119D;
  else if(msg_ID == 0x19E) return 0x119E;
  else if(msg_ID == 0x19F) return 0x119F;
  else if(msg_ID == 0x1A0) return 0x11A0;
  else if(msg_ID == 0x1A1) return 0x11A1;
  else if(msg_ID == 0x1A2) return 0x11A2;
  else if(msg_ID == 0x1A3) return 0x11A3;
  else if(msg_ID == 0x1A4) return 0x11A4;
  else if(msg_ID == 0x1A5) return 0x11A5;
  else if(msg_ID == 0x1A6) return 0x11A6;
  else if(msg_ID == 0x1A7) return 0x11A7;
  else if(msg_ID == 0x1A8) return 0x11A8;
  else if(msg_ID == 0x1A9) return 0x11A9;
  else if(msg_ID == 0x1AA) return 0x11AA;
  else if(msg_ID == 0x1AB) return 0x11AB;
  else if(msg_ID == 0x1AC) return 0x11AC;
  else if(msg_ID == 0x1AD) return 0x11AD;
  else if(msg_ID == 0x1AE) return 0x11AE;
  else if(msg_ID == 0x1AF) return 0x11AF;
  else if(msg_ID == 0x1B0) return 0x11B0;
  else if(msg_ID == 0x1B1) return 0x11B1;
  else if(msg_ID == 0x1B2) return 0x11B2;
  else if(msg_ID == 0x1B3) return 0x11B3;
  else if(msg_ID == 0x1B4) return 0x11B4;
  else if(msg_ID == 0x1B5) return 0x11B5;
  else if(msg_ID == 0x1B6) return 0x11B6;
  else if(msg_ID == 0x1B7) return 0x11B7;
  else if(msg_ID == 0x1B8) return 0x11B8;
  else if(msg_ID == 0x1B9) return 0x11B9;
  else if(msg_ID == 0x1BA) return 0x11BA;
  else if(msg_ID == 0x1BB) return 0x11BB;
  else if(msg_ID == 0x1BC) return 0x11BC;
  else if(msg_ID == 0x1BD) return 0x11BD;
  else if(msg_ID == 0x1BE) return 0x11BE;
  else if(msg_ID == 0x1BF) return 0x11BF;
  else if(msg_ID == 0x1C0) return 0x11C0;
  else if(msg_ID == 0x1C1) return 0x11C1;
  else if(msg_ID == 0x1C2) return 0x11C2;
  else if(msg_ID == 0x1C3) return 0x11C3;
  else if(msg_ID == 0x1C4) return 0x11C4;
  else if(msg_ID == 0x1C5) return 0x11C5;
  else if(msg_ID == 0x1C6) return 0x11C6;
  else if(msg_ID == 0x1C7) return 0x11C7;
  else if(msg_ID == 0x1C8) return 0x11C8;
  else if(msg_ID == 0x1C9) return 0x11C9;
  else if(msg_ID == 0x1CA) return 0x11CA;
  else if(msg_ID == 0x1CB) return 0x11CB;
  else if(msg_ID == 0x1CC) return 0x11CC;
  else if(msg_ID == 0x1CD) return 0x11CD;
  else if(msg_ID == 0x1CE) return 0x11CE;
  else if(msg_ID == 0x1CF) return 0x11CF;
  else if(msg_ID == 0x1D0) return 0x11D0;
  else if(msg_ID == 0x1D1) return 0x11D1;
  else if(msg_ID == 0x1D2) return 0x11D2;
  else if(msg_ID == 0x1D3) return 0x11D3;
  else if(msg_ID == 0x1D4) return 0x11D4;
  else if(msg_ID == 0x1D5) return 0x11D5;
  else if(msg_ID == 0x1D6) return 0x11D6;
  else if(msg_ID == 0x1D7) return 0x11D7;
  else if(msg_ID == 0x1D8) return 0x11D8;
  else if(msg_ID == 0x1D9) return 0x11D9;
  else if(msg_ID == 0x1DA) return 0x11DA;
  else if(msg_ID == 0x1DB) return 0x11DB;
  else if(msg_ID == 0x1DC) return 0x11DC;
  else if(msg_ID == 0x1DD) return 0x11DD;
  else if(msg_ID == 0x1DE) return 0x11DE;
  else if(msg_ID == 0x1DF) return 0x11DF;
  else if(msg_ID == 0x1E0) return 0x11E0;
  else if(msg_ID == 0x1E1) return 0x11E1;
  else if(msg_ID == 0x1E2) return 0x11E2;
  else if(msg_ID == 0x1E3) return 0x11E3;
  else if(msg_ID == 0x1E4) return 0x11E4;
  else if(msg_ID == 0x51) return 0x1051;
  else if(msg_ID == 0x4A)	return 0x104A;
  else if(msg_ID == 0x4B) return 0x104B;
    
  // Video Front Center (53)
  else if(msg_ID == 0x20) return 0x1050;
  else if(msg_ID == 0x34) return 0x1060;
  else if(msg_ID == 0x36) return 0x1062;
  else if(msg_ID == 0x37) return 0x1064;
  else if(msg_ID == 0x38) return 0x1066;
  else if(msg_ID == 0x39) return 0x1068;
  else if(msg_ID == 0x3A) return 0x106A;
  else if(msg_ID == 0x3B) return 0x106C;
  else if(msg_ID == 0x3C) return 0x106E;
  else if(msg_ID == 0x3D) return 0x1070;
  else if(msg_ID == 0x3E) return 0x1072;
  else if(msg_ID == 0x3F) return 0x1074;
  else if(msg_ID == 0x40) return 0x1076;
  else if(msg_ID == 0x41) return 0x1078;
  else if(msg_ID == 0x42) return 0x107A;
  else if(msg_ID == 0x43) return 0x107C;
  else if(msg_ID == 0x44) return 0x107E;
  else if(msg_ID == 0x45) return 0x1080;
  else if(msg_ID == 0x46) return 0x1082;
  else if(msg_ID == 0x47) return 0x1084;
  else if(msg_ID == 0x48) return 0x1086;
  else if(msg_ID == 0x49) return 0x1088;
  else if(msg_ID == 0x4A) return 0x108A;
  else if(msg_ID == 0x4B) return 0x108C;
  else if(msg_ID == 0x4C) return 0x108E;
  else if(msg_ID == 0x4D) return 0x1090;
  else if(msg_ID == 0x80) return 0x2080;
  else if(msg_ID == 0x82) return 0x2082;
  else if(msg_ID == 0x83) return 0x2083;
  else if(msg_ID == 0x84) return 0x2084;
  else if(msg_ID == 0x85) return 0x2085;
  else if(msg_ID == 0xA2) return 0x20A2;
  else if(msg_ID == 0xA3) return 0x20A3;
  else if(msg_ID == 0xA4) return 0x20A4;
  else if(msg_ID == 0xA5) return 0x20A5;
  else if(msg_ID == 0x92) return 0x2092;
  else if(msg_ID == 0x93) return 0x2093;
  else if(msg_ID == 0x94) return 0x2094;
  else if(msg_ID == 0x95) return 0x2095;
  else if(msg_ID == 0xB2) return 0x20B2;
  else if(msg_ID == 0xE0) return 0x20E0;
  else if(msg_ID == 0xEC) return 0x20EC;
  else if(msg_ID == 0xEE) return 0x10EE;
  else if(msg_ID == 0xEF) return 0x10EF;
  else if(msg_ID == 0xF0) return 0x10F0;
  else if(msg_ID == 0xF1) return 0x10F1;
  else if(msg_ID == 0xF2) return 0x10F2;
  else if(msg_ID == 0xF3) return 0x10F3;
  else if(msg_ID == 0xF4) return 0x10F4;
  else if(msg_ID == 0xF5) return 0x10F5;
  else if(msg_ID == 0xF6) return 0x10F6;
  else if(msg_ID == 0xF7) return 0x10F7;
  else if(msg_ID == 0xF8) return 0x10F8;
  else if(msg_ID == 0xF9) return 0x10F9;
  else if(msg_ID == 0xFA) return 0x10FA;
  else if(msg_ID == 0xFB) return 0x10FB;
  else if(msg_ID == 0xFC) return 0x10FC;
  else if(msg_ID == 0xFD) return 0x10FD;
  else if(msg_ID == 0xFF) return 0xFF; // TimeSync Msg (Data ID : 0x10FF - Only LSB is considered for CRC calc)
  
  // Radar Front Left-Right / Radar Front Corners (84)
  else if(msg_ID == 0x205) return 0x1205;
  else if(msg_ID == 0x210) return 0x1210;
  else if(msg_ID == 0x211) return 0x1211;
  else if(msg_ID == 0x212) return 0x1212;
  else if(msg_ID == 0x213) return 0x1213;
  else if(msg_ID == 0x214) return 0x1214;
  else if(msg_ID == 0x215) return 0x1215;
  else if(msg_ID == 0x216) return 0x1216;
  else if(msg_ID == 0x217) return 0x1217;
  else if(msg_ID == 0x218) return 0x1218;
  else if(msg_ID == 0x219) return 0x1219;
  else if(msg_ID == 0x21A) return 0x121A;
  else if(msg_ID == 0x21B) return 0x121B;
  else if(msg_ID == 0x21C) return 0x121C;
  else if(msg_ID == 0x21D) return 0x121D;
  else if(msg_ID == 0x21E) return 0x121E;
  else if(msg_ID == 0x21F) return 0x121F;
  else if(msg_ID == 0x220) return 0x1220;
  else if(msg_ID == 0x221) return 0x1221;
  else if(msg_ID == 0x222) return 0x1222;
  else if(msg_ID == 0x223) return 0x1223;
  else if(msg_ID == 0x224) return 0x1224;
  else if(msg_ID == 0x225) return 0x1225;
  else if(msg_ID == 0x226) return 0x1226;
  else if(msg_ID == 0x227) return 0x1227;
  else if(msg_ID == 0x228) return 0x1228;
  else if(msg_ID == 0x229) return 0x1229;
  else if(msg_ID == 0x22A) return 0x122A;
  else if(msg_ID == 0x22B) return 0x122B;
  else if(msg_ID == 0x22C) return 0x122C;
  else if(msg_ID == 0x22D) return 0x122D;
  else if(msg_ID == 0x22E) return 0x122E;
  else if(msg_ID == 0x22F) return 0x122F;
  else if(msg_ID == 0x230) return 0x1230;
  else if(msg_ID == 0x231) return 0x1231;
  else if(msg_ID == 0x232) return 0x1232;
  else if(msg_ID == 0x233) return 0x1233;
  else if(msg_ID == 0x234) return 0x1234;
  else if(msg_ID == 0x235) return 0x1235;
  else if(msg_ID == 0x236) return 0x1236;
  else if(msg_ID == 0x237) return 0x1237;
  else if(msg_ID == 0x605) return 0x1605;
  else if(msg_ID == 0x610) return 0x1610;
  else if(msg_ID == 0x611) return 0x1611;
  else if(msg_ID == 0x612) return 0x1612;
  else if(msg_ID == 0x613) return 0x1613;
  else if(msg_ID == 0x614) return 0x1614;
  else if(msg_ID == 0x615) return 0x1615;
  else if(msg_ID == 0x616) return 0x1616;
  else if(msg_ID == 0x617) return 0x1617;
  else if(msg_ID == 0x618) return 0x1618;
  else if(msg_ID == 0x619) return 0x1619;
  else if(msg_ID == 0x61A) return 0x161A;
  else if(msg_ID == 0x61B) return 0x161B;
  else if(msg_ID == 0x61C) return 0x161C;
  else if(msg_ID == 0x61D) return 0x161D;
  else if(msg_ID == 0x61E) return 0x161E;
  else if(msg_ID == 0x61F) return 0x161F;
  else if(msg_ID == 0x620) return 0x1620;
  else if(msg_ID == 0x621) return 0x1621;
  else if(msg_ID == 0x622) return 0x1622;
  else if(msg_ID == 0x623) return 0x1623;
  else if(msg_ID == 0x624) return 0x1624;
  else if(msg_ID == 0x625) return 0x1625;
  else if(msg_ID == 0x626) return 0x1626;
  else if(msg_ID == 0x627) return 0x1627;
  else if(msg_ID == 0x628) return 0x1628;
  else if(msg_ID == 0x629) return 0x1629;
  else if(msg_ID == 0x62A) return 0x162A;
  else if(msg_ID == 0x62B) return 0x162B;
  else if(msg_ID == 0x62C) return 0x162C;
  else if(msg_ID == 0x62D) return 0x162D;
  else if(msg_ID == 0x62E) return 0x162E;
  else if(msg_ID == 0x62F) return 0x162F;
  else if(msg_ID == 0x630) return 0x1630;
  else if(msg_ID == 0x631) return 0x1631;
  else if(msg_ID == 0x632) return 0x1632;
  else if(msg_ID == 0x633) return 0x1633;
  else if(msg_ID == 0x634) return 0x1634;
  else if(msg_ID == 0x635) return 0x1635;
  else if(msg_ID == 0x636) return 0x1636;
  else if(msg_ID == 0x637) return 0x1637;
  else if(msg_ID == 0x52) return 0x52;
  else if(msg_ID == 0x56) return 0x56;
  else if(msg_ID == 0x4C) return 0x104C;
  else if(msg_ID == 0x6FC) return 0xFC; // TimeSync Msg(Data ID : 16FC - Only LSB is considered for CRC calc)
  

  // Radar Rear Left-Right / Radar Rear Corners (84)
  else if(msg_ID == 0x305) return 0x1305;
  else if(msg_ID == 0x310) return 0x1310;
  else if(msg_ID == 0x311) return 0x1311;
  else if(msg_ID == 0x312) return 0x1312;
  else if(msg_ID == 0x313) return 0x1313;
  else if(msg_ID == 0x314) return 0x1314;
  else if(msg_ID == 0x315) return 0x1315;
  else if(msg_ID == 0x316) return 0x1316;
  else if(msg_ID == 0x317) return 0x1317;
  else if(msg_ID == 0x318) return 0x1318;
  else if(msg_ID == 0x319) return 0x1319;
  else if(msg_ID == 0x31A) return 0x131A;
  else if(msg_ID == 0x31B) return 0x131B;
  else if(msg_ID == 0x31C) return 0x131C;
  else if(msg_ID == 0x31D) return 0x131D;
  else if(msg_ID == 0x31E) return 0x131E;
  else if(msg_ID == 0x31F) return 0x131F;
  else if(msg_ID == 0x320) return 0x1320;
  else if(msg_ID == 0x321) return 0x1321;
  else if(msg_ID == 0x322) return 0x1322;
  else if(msg_ID == 0x323) return 0x1323;
  else if(msg_ID == 0x324) return 0x1324;
  else if(msg_ID == 0x325) return 0x1325;
  else if(msg_ID == 0x326) return 0x1326;
  else if(msg_ID == 0x327) return 0x1327;
  else if(msg_ID == 0x328) return 0x1328;
  else if(msg_ID == 0x329) return 0x1329;
  else if(msg_ID == 0x32A) return 0x132A;
  else if(msg_ID == 0x32B) return 0x132B;
  else if(msg_ID == 0x32C) return 0x132C;
  else if(msg_ID == 0x32D) return 0x132D;
  else if(msg_ID == 0x32E) return 0x132E;
  else if(msg_ID == 0x32F) return 0x132F;
  else if(msg_ID == 0x330) return 0x1330;
  else if(msg_ID == 0x331) return 0x1331;
  else if(msg_ID == 0x332) return 0x1332;
  else if(msg_ID == 0x333) return 0x1333;
  else if(msg_ID == 0x334) return 0x1334;
  else if(msg_ID == 0x335) return 0x1335;
  else if(msg_ID == 0x336) return 0x1336;
  else if(msg_ID == 0x337) return 0x1337;
  else if(msg_ID == 0x505) return 0x1505;
  else if(msg_ID == 0x510) return 0x1510;
  else if(msg_ID == 0x511) return 0x1511;
  else if(msg_ID == 0x512) return 0x1512;
  else if(msg_ID == 0x513) return 0x1513;
  else if(msg_ID == 0x514) return 0x1514;
  else if(msg_ID == 0x515) return 0x1515;
  else if(msg_ID == 0x516) return 0x1516;
  else if(msg_ID == 0x517) return 0x1517;
  else if(msg_ID == 0x518) return 0x1518;
  else if(msg_ID == 0x519) return 0x1519;
  else if(msg_ID == 0x51A) return 0x151A;
  else if(msg_ID == 0x51B) return 0x151B;
  else if(msg_ID == 0x51C) return 0x151C;
  else if(msg_ID == 0x51D) return 0x151D;
  else if(msg_ID == 0x51E) return 0x151E;
  else if(msg_ID == 0x51F) return 0x151F;
  else if(msg_ID == 0x520) return 0x1520;
  else if(msg_ID == 0x521) return 0x1521;
  else if(msg_ID == 0x522) return 0x1522;
  else if(msg_ID == 0x523) return 0x1523;
  else if(msg_ID == 0x524) return 0x1524;
  else if(msg_ID == 0x525) return 0x1525;
  else if(msg_ID == 0x526) return 0x1526;
  else if(msg_ID == 0x527) return 0x1527;
  else if(msg_ID == 0x528) return 0x1528;
  else if(msg_ID == 0x529) return 0x1529;
  else if(msg_ID == 0x52A) return 0x152A;
  else if(msg_ID == 0x52B) return 0x152B;
  else if(msg_ID == 0x52C) return 0x152C;
  else if(msg_ID == 0x52D) return 0x152D;
  else if(msg_ID == 0x52E) return 0x152E;
  else if(msg_ID == 0x52F) return 0x152F;
  else if(msg_ID == 0x530) return 0x1530;
  else if(msg_ID == 0x531) return 0x1531;
  else if(msg_ID == 0x532) return 0x1532;
  else if(msg_ID == 0x533) return 0x1533;
  else if(msg_ID == 0x534) return 0x1534;
  else if(msg_ID == 0x535) return 0x1535;
  else if(msg_ID == 0x536) return 0x1536;
  else if(msg_ID == 0x537) return 0x1537;		
  else if(msg_ID == 0x53) return 0x53;
  else if(msg_ID == 0x55) return 0x55;
  else if(msg_ID == 0x6FE) return 0xFE; // TimeSync Msg(Data ID : 16FE - Only LSB is considered for CRC calc)
  
  else {return 0;}
}

void copysignalvalueTobytearray(qword signalvalue,byte data[],int64 startbit,int64 bitlength)
{
  //Under construction
}

