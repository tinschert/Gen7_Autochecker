/*@!Encoding:1252*/
// Autogenerated by -> Platform\Classe\Scripts\Rbs_Scripts\create_nodes.py
includes
{
  #pragma library ("C:\ProgramData\Vector\AddOn Packages\Vector AddOn\vModules\AsrPDUIL2.vmodule")
  #include "CAPL\DataHandling.cin" /*DataHandling for IL*/
  #include "CAPL\E2E.cin" /*OD Specific for CRC calculation */
  #include "OSEKTP\OSEKTP.cin"  //common definations for osektp
  #include "OSEKTP\OSEKTP_CAN_PrivMain_Toliman_RFL_Object_NPdu_FC.cin"  ///For handling  pdu RFL_Object_NPdu_FC with OSEKtp
  #include "OSEKTP\OSEKTP_CAN_PrivMain_Toliman_RFR_Object_NPdu_FC.cin"  ///For handling  pdu RFR_Object_NPdu_FC with OSEKtp
  #include "Opaque_Byte_Order\Opaque_CAN_PrivMain_Toliman_RXX_Config_Mgmt_RXX_Config_Mgmt.cin" /*Signal Opaque byte order handling*/
}

variables {
  int i;
  char sysvarElementName[256];
  char mSysVarNameSpace_CAN_PrivMain_RFL_Object[50] = "CAN_PrivMain::RFL_Object";
  char mSysVarNameSpace_CAN_PrivMain_RFR_Object[50] = "CAN_PrivMain::RFR_Object";
  message RXX_Config_Mgmt Msg_RXX_Config_Mgmt;
  message RXX_VehInput Msg_RXX_VehInput;
  message RXX_VehConfig_RFL Msg_RXX_VehConfig_RFL;
  message RXX_VehConfig_RFR Msg_RXX_VehConfig_RFR;

  dword crc_RXX_VehInput_RXX_VehInput_CRC;
  dword crc_RXX_VehConfig_RFL_RXX_VehConfig_CRC;
  dword crc_RXX_VehConfig_RFR_RXX_VehConfig_CRC;

}

on preStart {
  long result;
  result=ARILControlInit ();//Initialization of AUTOSAR PDU IL,to prevent the IL autostart function.
  switch(result)
  {
    case  0    : write("ARILControlInit :: Toliman :: No error."); break;
    case -1    : write("ARILControlInit :: Toliman :: IL is in a state that ignores the given request: State graph of the IL (Link)."); break;
    case -2    : write("ARILControlInit :: Toliman :: Allowed value range of a signal exceeded. (The exceeded value is transmitted to the bus nevertheless).");  break;
    case -50   : write("ARILControlInit :: Toliman :: Node layer is not active. Presumably it is deactivated in the node’s configuration dialog."); break;
    case -51   : write("ARILControlInit :: Toliman :: The node is connected to another bus like the CAN Bus."); break;
    case -100  : write("ARILControlInit :: Toliman :: Signal/message not found in DB, or not mapped to the node."); break;
    case -101  : write("ARILControlInit :: Toliman :: Maximum possible value range exceeded. (There is no transmission to the bus)."); break;
    case -102  : write("ARILControlInit :: Toliman :: A network management-, diagnostic, or transport protocol signal was set. IL declines such types of signals, because it is not intended to connect these layers to the IL."); break;
    case -103  : write("ARILControlInit :: Toliman :: Invalid value supplied (for all types of requests)."); break;
    case -104  : write("ARILControlInit :: Toliman :: General error for invalid requests that are not described furthermore."); break;
   }

  Toliman_sim_Disable();
  Toliman_sim_SetCycleTimeOffset();
}

on start {

  ARILControlSimulationOn();//Starts the simulation of the IL. The IL is operational and started. The IL will send PDUs.
  Toliman_sim_DisableMsg();
  Toliman_sim_Disable();
  ARILControlStart ();//When the IL is started, then it is fully operating and sending.
  Toliman_sim_Reset();
  OnStart_init_CANTP_Toliman();
  OnStart_callTx_Toliman_RFL_Object_NPdu_FC();
  OnStart_callTx_Toliman_RFR_Object_NPdu_FC();
}

OnStart_init_CANTP_Toliman()
{
  long dbHandle; 
  dbHandle = CanTpGetDBConnection();
  if (dbHandle > 0) 
  { 
    CanTpCloseConnection(dbHandle); 
  }
}

on stopMeasurement {

  Toliman_sim_DisableMsg();
  Toliman_sim_Disable();
  ARILControlStop();//Stops sending of PDUs.
  ARILControlSimulationOff();//Stops the simulation of the IL. The IL is not operational. All API function except function ARILControlSimulationOn will not work.

}

on sysvar_update hil_ctrl::adas_sim
{
  Toliman_sim_Reset();
}

on sysvar_update hil_ctrl::variant
{
  Toliman_sim_Reset();
}

on sysvar_update Cus_bus::bus_CAN_PrivMain_ON_OFF
{
  Toliman_sim_Reset();
}

void Toliman_sim_Reset()
{

  Toliman_sim_DisableMsg();
  Toliman_sim_Disable();

  if ((@Cus_bus::bus_CAN_PrivMain_ON_OFF == 1) && (@hil_ctrl::adas_sim == 1))
  {
    switch(@hil_ctrl::variant)
    {
      case a_variant:Toliman_sim_start_a_variant();break;
      case b_variant:Toliman_sim_start_b_variant();break;
    }
    if (@hil_ctrl::hil_mode == @hil_ctrl::hil_mode::Restbus) 
    {
       Toliman_sim_EnableEventMsg();
    }
    else
    {
       Toliman_sim_DisableEventMsg();
    }
  }
}

void Toliman_sim_start_a_variant()
{
  @CAN_PrivMain::RXX_Config_Mgmt::RXX_Config_Mgmt_ON_OFF = 1;
  @CAN_PrivMain::RXX_VehInput::RXX_VehInput_ON_OFF = 1;
//  OnStart_callTx_Toliman_RFL_Object_NPdu_FC();
//  OnStart_callTx_Toliman_RFR_Object_NPdu_FC();
}

void Toliman_sim_start_b_variant()
{
  @CAN_PrivMain::RXX_Config_Mgmt::RXX_Config_Mgmt_ON_OFF = 1;
  @CAN_PrivMain::RXX_VehInput::RXX_VehInput_ON_OFF = 1;
//  OnStart_callTx_Toliman_RFL_Object_NPdu_FC();
//  OnStart_callTx_Toliman_RFR_Object_NPdu_FC();
}

void Toliman_sim_Disable()
{
  @CAN_PrivMain::RXX_Config_Mgmt::RXX_Config_Mgmt_ON_OFF = 0;
  @CAN_PrivMain::RXX_VehInput::RXX_VehInput_ON_OFF = 0;
  @CAN_PrivMain::RXX_VehConfig_RFL::RXX_VehConfig_RFL_ON_OFF = 0;
  @CAN_PrivMain::RXX_VehConfig_RFR::RXX_VehConfig_RFR_ON_OFF = 0;
}

void Toliman_sim_DisableMsg()
{
   ARILFaultInjectionDisablePDU(RXX_Config_Mgmt);
   ARILFaultInjectionDisablePDU(RXX_VehInput);
   ARILFaultInjectionDisablePDU(RXX_VehConfig_RFL);
//   if (gHandle_Toliman_RFL_Object_NPdu_FC > 0)
//    {
//       CanTpCloseConnection(gHandle_Toliman_RFL_Object_NPdu_FC);
//    }
//   if (gHandle_Toliman_RFR_Object_NPdu_FC > 0)
//    {
//       CanTpCloseConnection(gHandle_Toliman_RFR_Object_NPdu_FC);
//    }
   ARILFaultInjectionDisablePDU(RXX_VehConfig_RFR);
}
on sysvar hil_ctrl::hil_mode
{
  Toliman_sim_Reset();
}

void Toliman_sim_DisableEventMsg()
{
   ARILFaultInjectionDisablePDU(RXX_VehConfig_RFL);
   ARILFaultInjectionDisablePDU(RXX_VehConfig_RFR);

}

void Toliman_sim_EnableEventMsg()
{
   ARILFaultInjectionEnablePDU(RXX_VehConfig_RFL);
   ARILFaultInjectionEnablePDU(RXX_VehConfig_RFR);

}

dword applPDUILTxPending (dword busContext, dword shortID, dword longID, char name[], dword & aPDULength, byte data[])//This callback is being called before the IL sends a PDU to the bus
{
  if(strncmp(name, "RXX_Config_Mgmt", elcount(name)) == 0)
  {
    cfg_Pdu_RXX_Config_Mgmt(aPDULength, data);
    return 1; // don't prevent sending of the pdu
  }
  if(strncmp(name, "RXX_VehInput", elcount(name)) == 0)
  {
    cfg_Pdu_RXX_VehInput(aPDULength, data);
    return 1; // don't prevent sending of the pdu
  }
  if(strncmp(name, "RXX_VehConfig_RFL", elcount(name)) == 0)
  {
    cfg_Pdu_RXX_VehConfig_RFL(aPDULength, data);
    return 1; // don't prevent sending of the pdu
  }
  if(strncmp(name, "RXX_VehConfig_RFR", elcount(name)) == 0)
  {
    cfg_Pdu_RXX_VehConfig_RFR(aPDULength, data);
    return 1; // don't prevent sending of the pdu
  }
  return 1; // don't prevent sending of the pdu
}

on sysvar CAN_PrivMain::RXX_Config_Mgmt::RXX_Config_Mgmt_ON_OFF
{
  if (@this == 1)
  {
    ARILFaultInjectionEnablePDU(RXX_Config_Mgmt);
  }
  else{
         ARILFaultInjectionDisablePDU(RXX_Config_Mgmt);
      }
}

void cfg_Pdu_RXX_Config_Mgmt(dword & aPDULength, byte data[])
{
   int64 i,k;//For looping
   byte xor,data_byte;
   dword crcTemp;
   byte DataLength;
   dword Msg_id;
   byte sendString[38]; 
   long copiedBytes; 
   long TxLength; 
   byte RXX_Config_Mgmt_array[38];
   
   DataLength = Msg_RXX_Config_Mgmt.DataLength;//Message Data Length
   Msg_id  = Msg_RXX_Config_Mgmt.id;//Message ID
   
   // Initialize RXX_Config_Mgmt_array to zero
   for (i = 0; i < elcount(RXX_Config_Mgmt_array); i++)
   {
     RXX_Config_Mgmt_array[i] = 0;
   }
   if (sysGetVariableData(sysvar::CAN_PrivMain::RXX_Config_Mgmt::RXX_Config_Mgmt::SignalValue, sendString, copiedBytes) == 0)
   { 
     TxLength=copiedBytes;
     memcpy( RXX_Config_Mgmt_array, sendString, TxLength);
   }
   // Output the destination array for verification
   // for (i = 0; i < elcount(RXX_Config_Mgmt_array); i++)
   // {
    // write("0x%02X ", RXX_Config_Mgmt_array[i]);
   // }
   
   copyByteArrayToByteArray(RXX_Config_Mgmt_array, data, 0, 160);
   
}


on sysvar CAN_PrivMain::RXX_VehConfig_RFL::RXX_VehConfig_RFL_ON_OFF
{
  if (@this == 1)
  {
     ARILSetPDUEvent(RXX_VehConfig_RFL);
     @CAN_PrivMain::RXX_VehConfig_RFL::RXX_VehConfig_RFL_ON_OFF = 0;
  }
}

void cfg_Pdu_RXX_VehConfig_RFL(dword & aPDULength, byte data[])
{
   int64 i,k;//For looping
   byte xor,data_byte;
   dword crcTemp;
   byte DataLength;
   dword Msg_id;
   
   DataLength = Msg_RXX_VehConfig_RFL.DataLength;//Message Data Length
   Msg_id  = Msg_RXX_VehConfig_RFL.id;//Message ID
   
    if (@CAN_PrivMain::RXX_VehConfig_RFL::RXX_VehConfig_CRC_FaultInject != 3)//CRC: user defined value
    {

    clearBitsInByteArrayLE(data,0,16); //Intel / little-endian

    }
    if(@CAN_PrivMain::RXX_VehConfig_RFL::RXX_VehConfig_CRC_FaultInject == 0)//CRC: No Error, calculate CRC
    {
      crcTemp = CRC16_INIT;
      for(i = 2; i < (DataLength+2); i++)
      {
        if(i < DataLength)
          data_byte = data[i] ;
        else if(i == DataLength)
          data_byte = (Data_ID_Lookup_PRIVATE(Msg_id) & 0x00FF);
        else if(i == (DataLength+1))
          data_byte = (Data_ID_Lookup_PRIVATE(Msg_id) & 0xFF00) >> 8;
        else
          write("Error: DLC exceeded in CRC calculation");
        crcTemp ^= data_byte << 8;
        crcTemp = (crcTemp << (8)) ^ CRC16_CCITT_FALSE_POLY_1021H_Lookup[(crcTemp >> (8)) & (0xFF)];
      }
      crcTemp ^= CRC16_XOR;
      crc_RXX_VehConfig_RFL_RXX_VehConfig_CRC = crcTemp;

      copyBitsToByteArrayLE(crc_RXX_VehConfig_RFL_RXX_VehConfig_CRC,data,0,16); //Intel / little-endian;
    }
    else if(@CAN_PrivMain::RXX_VehConfig_RFL::RXX_VehConfig_CRC_FaultInject == 1)//CRC: Error, set to Zero
    {

      copyBitsToByteArrayLE(0,data,0,16); //Intel / little-endian;
    }
    else if(@CAN_PrivMain::RXX_VehConfig_RFL::RXX_VehConfig_CRC_FaultInject == 2)//CRC: Error, Freeze last valid value
    {

      copyBitsToByteArrayLE(crc_RXX_VehConfig_RFL_RXX_VehConfig_CRC,data,0,16); //Intel / little-endian;
    }
}


on sysvar CAN_PrivMain::RXX_VehConfig_RFR::RXX_VehConfig_RFR_ON_OFF
{
  if (@this == 1)
  {
     ARILSetPDUEvent(RXX_VehConfig_RFR);
     @CAN_PrivMain::RXX_VehConfig_RFR::RXX_VehConfig_RFR_ON_OFF = 0;
  }
}

void cfg_Pdu_RXX_VehConfig_RFR(dword & aPDULength, byte data[])
{
   int64 i,k;//For looping
   byte xor,data_byte;
   dword crcTemp;
   byte DataLength;
   dword Msg_id;
   long result;
   long type=0;//reserved (should be set to 0).
   long disturbanceMode  =0; //0 :: set to disturbanceValue //2 :: set to Random value //3 :: Offset Signal value is increased by disturbanceValue
   long disturbanceCount =0;//-1 ::Infinite Disturbance is continuously applied //0 ::Stop An active disturbance is stopped and the SequenceCounter/crc will be calculated again appropriately //n > 0 ::Count Do exactly n Repetition/disturbances
   long disturbanceValue =0;//According to the disturbance mode the SequenceCounter/crc will optionally be set to this value
   dword crc[1];
   
   DataLength = Msg_RXX_VehConfig_RFR.DataLength;//Message Data Length
   Msg_id  = Msg_RXX_VehConfig_RFR.id;//Message ID
   
{
   if (@CAN_PrivMain::RXX_VehConfig_RFR::RXX_VehConfig_CRC_FaultInject == 0)//CRC: No Error, calculate CRC
   {
      disturbanceCount  = 1;//Once Disturbance is applied
      disturbanceMode   = 0;//Sets the CRC fix to the value of parameter disturbanceValue.
      ARILCalculateCRC("RXX_VehConfig_RFR","SG_RXX_VehConfig_RFR",data,aPDULength,crc);//Profile 11A
      disturbanceValue=crc_RXX_VehConfig_RFR_RXX_VehConfig_CRC=crc[0]^0xFF;
      result=ARILFaultInjectionDisturbChecksum (RXX_VehConfig_RFR, "SG_RXX_VehConfig_RFR", type, disturbanceMode, disturbanceCount, disturbanceValue);
      //write("ARILFaultInjectionDisturbChecksum :: RXX_VehConfig_RFR :: SG_RXX_VehConfig_RFR :: RXX_VehConfig_CRC :: No Error");
   }
   else if (@CAN_PrivMain::RXX_VehConfig_RFR::RXX_VehConfig_CRC_FaultInject == 1)//CRC: Error , set CRC = 0
   {
      disturbanceCount  = 1;//Once Disturbance is continuously applied
      disturbanceMode   = 0;//Sets the CRC fix to the value of parameter disturbanceValue.
      disturbanceValue  = 0;//set CRC = 0
      result=ARILFaultInjectionDisturbChecksum (RXX_VehConfig_RFR, "SG_RXX_VehConfig_RFR", type, disturbanceMode, disturbanceCount, disturbanceValue);
      //write("ARILFaultInjectionDisturbChecksum :: RXX_VehConfig_RFR :: SG_RXX_VehConfig_RFR :: RXX_VehConfig_CRC :: AC = 0");
   }
   else if (@CAN_PrivMain::RXX_VehConfig_RFR::RXX_VehConfig_CRC_FaultInject == 2)//CRC: Error , Freeze last valid value
   {
      disturbanceCount  = 1;//Once Disturbance is  applied
      disturbanceMode   = 0;//Sets the CRC fix to the value of parameter disturbanceValue.
      disturbanceValue  = crc_RXX_VehConfig_RFR_RXX_VehConfig_CRC;
      result=ARILFaultInjectionDisturbChecksum (RXX_VehConfig_RFR, "SG_RXX_VehConfig_RFR", type, disturbanceMode, disturbanceCount, disturbanceValue);
      //write("ARILFaultInjectionDisturbChecksum :: RXX_VehConfig_RFR :: SG_RXX_VehConfig_RFR :: RXX_VehConfig_CRC :: Freeze");
    }
}
}


on sysvar CAN_PrivMain::RXX_VehInput::RXX_VehInput_ON_OFF
{
  if (@this == 1)
  {
    ARILFaultInjectionEnablePDU(RXX_VehInput);
  }
  else{
         ARILFaultInjectionDisablePDU(RXX_VehInput);
      }
}

void cfg_Pdu_RXX_VehInput(dword & aPDULength, byte data[])
{
   int64 i,k;//For looping
   byte xor,data_byte;
   dword crcTemp;
   byte DataLength;
   dword Msg_id;
   long result;
   long type=0;//reserved (should be set to 0).
   long disturbanceMode  =0; //0 :: set to disturbanceValue //2 :: set to Random value //3 :: Offset Signal value is increased by disturbanceValue
   long disturbanceCount =0;//-1 ::Infinite Disturbance is continuously applied //0 ::Stop An active disturbance is stopped and the SequenceCounter/crc will be calculated again appropriately //n > 0 ::Count Do exactly n Repetition/disturbances
   long disturbanceValue =0;//According to the disturbance mode the SequenceCounter/crc will optionally be set to this value
   dword crc[1];
   
   DataLength = Msg_RXX_VehInput.DataLength;//Message Data Length
   Msg_id  = Msg_RXX_VehInput.id;//Message ID
   
{
   if (@CAN_PrivMain::RXX_VehInput::RXX_VehInput_CRC_FaultInject == 0)//CRC: No Error, calculate CRC
   {
      disturbanceCount  = 1;//Once Disturbance is applied
      disturbanceMode   = 0;//Sets the CRC fix to the value of parameter disturbanceValue.
      ARILCalculateCRC("RXX_VehInput","SG_RXX_VehInput",data,aPDULength,crc);//Profile 11A
      disturbanceValue=crc_RXX_VehInput_RXX_VehInput_CRC=crc[0]^0xFF;
      result=ARILFaultInjectionDisturbChecksum (RXX_VehInput, "SG_RXX_VehInput", type, disturbanceMode, disturbanceCount, disturbanceValue);
      //write("ARILFaultInjectionDisturbChecksum :: RXX_VehInput :: SG_RXX_VehInput :: RXX_VehInput_CRC :: No Error");
   }
   else if (@CAN_PrivMain::RXX_VehInput::RXX_VehInput_CRC_FaultInject == 1)//CRC: Error , set CRC = 0
   {
      disturbanceCount  = 1;//Once Disturbance is continuously applied
      disturbanceMode   = 0;//Sets the CRC fix to the value of parameter disturbanceValue.
      disturbanceValue  = 0;//set CRC = 0
      result=ARILFaultInjectionDisturbChecksum (RXX_VehInput, "SG_RXX_VehInput", type, disturbanceMode, disturbanceCount, disturbanceValue);
      //write("ARILFaultInjectionDisturbChecksum :: RXX_VehInput :: SG_RXX_VehInput :: RXX_VehInput_CRC :: AC = 0");
   }
   else if (@CAN_PrivMain::RXX_VehInput::RXX_VehInput_CRC_FaultInject == 2)//CRC: Error , Freeze last valid value
   {
      disturbanceCount  = 1;//Once Disturbance is  applied
      disturbanceMode   = 0;//Sets the CRC fix to the value of parameter disturbanceValue.
      disturbanceValue  = crc_RXX_VehInput_RXX_VehInput_CRC;
      result=ARILFaultInjectionDisturbChecksum (RXX_VehInput, "SG_RXX_VehInput", type, disturbanceMode, disturbanceCount, disturbanceValue);
      //write("ARILFaultInjectionDisturbChecksum :: RXX_VehInput :: SG_RXX_VehInput :: RXX_VehInput_CRC :: Freeze");
    }
}
}

//  ARILSetPDUTimingCyclic (dbMsg dbMessage, long TrueOrFalse, long offset, long period, long disturbanceCount, long flags);
//  TrueOrFalse ; 0: denotes the False timing; 1: denotes the True timing; 3: denotes the True and the False timing.
//  offset :Defines the delay in [ms] from now when the first cyclic transmission will start.
//  period :Defines the period in [ms] for the cyclic transmission.
//  disturbanceCount :Reserved/unused; should be set to -1 (infinite).
//  flags :Reserved; should be set to 0.

on sysvar CAN_PrivMain::RXX_Config_Mgmt::RXX_Config_Mgmt_CycleTime
{
  ARILSetPDUTimingCyclic (RXX_Config_Mgmt, 3, 0, @this, -1, 0);//TrueOrFalse=3,offset=0;disturbanceCount =-1;flags=0
  //ARILResetPDUTimingCyclic(RXX_Config_Mgmt,3);//TrueOrFalse=3
}

on sysvar CAN_PrivMain::RXX_VehInput::RXX_VehInput_CycleTime
{
  ARILSetPDUTimingCyclic (RXX_VehInput, 3, 1, @this, -1, 0);//TrueOrFalse=3,offset=1;disturbanceCount =-1;flags=0
  //ARILResetPDUTimingCyclic(RXX_VehInput,3);//TrueOrFalse=3
}

void Toliman_sim_SetCycleTimeOffset()
{

//  ARILSetPDUTimingCyclic (dbMsg dbMessage, long TrueOrFalse, long offset, long period, long disturbanceCount, long flags);
//  TrueOrFalse ; 0: denotes the False timing; 1: denotes the True timing; 3: denotes the True and the False timing.
//  offset :Defines the delay in [ms] from now when the first cyclic transmission will start.
//  period :Defines the period in [ms] for the cyclic transmission.
//  disturbanceCount :Reserved/unused; should be set to -1 (infinite).
//  flags :Reserved; should be set to 0.
  ARILSetPDUTimingCyclic (RXX_Config_Mgmt, 3, 0, 20, -1, 0);//TrueOrFalse=3;offset=0;cycletime=20;disturbanceCount =-1;flags=0
  //ARILResetPDUTimingCyclic(RXX_Config_Mgmt,3);//TrueOrFalse=3
  ARILSetPDUTimingCyclic (RXX_VehInput, 3, 1, 20, -1, 0);//TrueOrFalse=3;offset=1;cycletime=20;disturbanceCount =-1;flags=0
  //ARILResetPDUTimingCyclic(RXX_VehInput,3);//TrueOrFalse=3

}

void OnSecurityLocalPDUPreTx(char pduName[], dword dataId, byte payload[], dword payloadLength, qword& authInfoHigh, qword& authInfo, dword authInfoBitLength, qword& freshness, dword freshnessBitLength, dword freshnessValueId)//This callback handler is called, after all data updates and the automatic Authenticator (CMAC) calculation has be done
{
}

CanTp_ReceptionInd(long connHandle, byte data[])//This function is called when data has been received on the connection with the given handle. The number of bytes received is available as length of the byte array.
{
  // Output of Source Address
  long rxCount;
  byte connId;
  
  rxCount = elcount(data);
  

  if (connHandle == gHandle_Toliman_RFL_Object_NPdu_FC)
  {
   connId = kId_Toliman_RFL_Object_NPdu_FC;
   if ((@hil_ctrl::adas_sim == 1) & (@hil_ctrl::ra6_fl_sgu_obj_sim == 1))
   {
   if(@CAN_PrivMain_RFL_Object::TP_enable_loopback_reading)
   {
       SetDataReceived_Toliman_RFL_Object(data, rxCount);
   }
   }
   else if ((@hil_ctrl::adas_sim == 2) & (@hil_ctrl::ra6_fl_sgu_obj_sim == 1))
   {
   if(@CAN_PrivMain_RFL_Object::TP_enable_loopback_reading)
   {
       SetDataReceived_Toliman_RFL_Object(data, rxCount);
   }
   }
   else if ((@hil_ctrl::adas_sim == 2) & (@hil_ctrl::ra6_fl_sgu_obj_sim == 2))
   {
   SetDataReceived_Toliman_RFL_Object(data, rxCount);
   }
   else if ((@hil_ctrl::adas_sim == 1) & (@hil_ctrl::ra6_fl_sgu_obj_sim == 2))
   {
   SetDataReceived_Toliman_RFL_Object(data, rxCount);
   }
  }


  if (connHandle == gHandle_Toliman_RFR_Object_NPdu_FC)
  {
   connId = kId_Toliman_RFR_Object_NPdu_FC;
   if ((@hil_ctrl::adas_sim == 1) & (@hil_ctrl::ra6_fr_sgu_obj_sim == 1))
   {
   if(@CAN_PrivMain_RFR_Object::TP_enable_loopback_reading)
   {
       SetDataReceived_Toliman_RFR_Object(data, rxCount);
   }
   }
   else if ((@hil_ctrl::adas_sim == 2) & (@hil_ctrl::ra6_fr_sgu_obj_sim == 1))
   {
   if(@CAN_PrivMain_RFR_Object::TP_enable_loopback_reading)
   {
       SetDataReceived_Toliman_RFR_Object(data, rxCount);
   }
   }
   else if ((@hil_ctrl::adas_sim == 2) & (@hil_ctrl::ra6_fr_sgu_obj_sim == 2))
   {
   SetDataReceived_Toliman_RFR_Object(data, rxCount);
   }
   else if ((@hil_ctrl::adas_sim == 1) & (@hil_ctrl::ra6_fr_sgu_obj_sim == 2))
   {
   SetDataReceived_Toliman_RFR_Object(data, rxCount);
   }
  }

   //write("%s, connection %d: Reception indication for %d bytes", "CAN_PrivMain", connId, rxCount);
}

void CRadarFL_RXX_Object_Obj1_SetDataReceived(byte byteArray[])
{
    qword raw_value;

    raw_value=copyBitsFromByteArrayLE( byteArray, 1504, 32);
    @CAN_PrivMain::RFL_Object::RXX_Object_Obj1.Age = convertRawToPhysical(raw_value, 1.0, 0.0);

    raw_value=copyBitsFromByteArrayLE( byteArray, 1100, 10);
    @CAN_PrivMain::RFL_Object::RXX_Object_Obj1.Ax = convertRawToPhysical(raw_value, 0.03125, -16.0);

    raw_value=copyBitsFromByteArrayLE( byteArray, 1484, 12);
    @CAN_PrivMain::RFL_Object::RXX_Object_Obj1.AxAyCoVnce = convertRawToPhysical(raw_value, 0.01, 0.0);

    raw_value=copyBitsFromByteArrayLE( byteArray, 1120, 12);
    @CAN_PrivMain::RFL_Object::RXX_Object_Obj1.AxVnce = convertRawToPhysical(raw_value, 0.01, 0.0);

    raw_value=copyBitsFromByteArrayLE( byteArray, 1174, 9);
    @CAN_PrivMain::RFL_Object::RXX_Object_Obj1.Ay = convertRawToPhysical(raw_value, 0.0625, -16.0);

    raw_value=copyBitsFromByteArrayLE( byteArray, 1184, 12);
    @CAN_PrivMain::RFL_Object::RXX_Object_Obj1.AyVnce = convertRawToPhysical(raw_value, 0.01, 0.0);

    raw_value=copyBitsFromByteArrayLE( byteArray, 1240, 6);
    @CAN_PrivMain::RFL_Object::RXX_Object_Obj1.ExistProb = convertRawToPhysical(raw_value, 2.0, 0.0);

    raw_value=copyBitsFromByteArrayLE( byteArray, 1304, 8);
    @CAN_PrivMain::RFL_Object::RXX_Object_Obj1.FilterInformation = convertRawToPhysical(raw_value, 1.0, 0.0);

    raw_value=copyBitsFromByteArrayLE( byteArray, 1080, 7);
    @CAN_PrivMain::RFL_Object::RXX_Object_Obj1.Length = convertRawToPhysical(raw_value, 0.125, 0.0);

    raw_value=copyBitsFromByteArrayLE( byteArray, 1088, 12);
    @CAN_PrivMain::RFL_Object::RXX_Object_Obj1.LengthVnce = convertRawToPhysical(raw_value, 0.01, 0.0);

    raw_value=copyBitsFromByteArrayLE( byteArray, 1272, 3);
    @CAN_PrivMain::RFL_Object::RXX_Object_Obj1.MeasurementStatus = convertRawToPhysical(raw_value, 1.0, 0.0);

    raw_value=copyBitsFromByteArrayLE( byteArray, 1228, 2);
    @CAN_PrivMain::RFL_Object::RXX_Object_Obj1.MovingStatus = convertRawToPhysical(raw_value, 1.0, 0.0);

    raw_value=copyBitsFromByteArrayLE( byteArray, 1208, 7);
    @CAN_PrivMain::RFL_Object::RXX_Object_Obj1.ObjId = convertRawToPhysical(raw_value, 1.0, 0.0);

    raw_value=copyBitsFromByteArrayLE( byteArray, 1110, 9);
    @CAN_PrivMain::RFL_Object::RXX_Object_Obj1.OrientationYaw = convertRawToPhysical(raw_value, 0.0175, -4.48);

    raw_value=copyBitsFromByteArrayLE( byteArray, 1132, 12);
    @CAN_PrivMain::RFL_Object::RXX_Object_Obj1.OrientationYawVnce = convertRawToPhysical(raw_value, 0.0003, 0.0);

    raw_value=copyBitsFromByteArrayLE( byteArray, 1024, 6);
    @CAN_PrivMain::RFL_Object::RXX_Object_Obj1.ProbClassConfidence = convertRawToPhysical(raw_value, 2.0, 0.0);

    raw_value=copyBitsFromByteArrayLE( byteArray, 1275, 4);
    @CAN_PrivMain::RFL_Object::RXX_Object_Obj1.ProbClassType = convertRawToPhysical(raw_value, 1.0, 0.0);

    raw_value=copyBitsFromByteArrayLE( byteArray, 1030, 14);
    @CAN_PrivMain::RFL_Object::RXX_Object_Obj1.Px = convertRawToPhysical(raw_value, 0.0625, -512.0);

    raw_value=copyBitsFromByteArrayLE( byteArray, 1344, 12);
    @CAN_PrivMain::RFL_Object::RXX_Object_Obj1.PxAxCoVnce = convertRawToPhysical(raw_value, 0.01, 0.0);

    raw_value=copyBitsFromByteArrayLE( byteArray, 1356, 12);
    @CAN_PrivMain::RFL_Object::RXX_Object_Obj1.PxAyCoVnce = convertRawToPhysical(raw_value, 0.01, 0.0);

    raw_value=copyBitsFromByteArrayLE( byteArray, 1260, 12);
    @CAN_PrivMain::RFL_Object::RXX_Object_Obj1.PxPyCoVnce = convertRawToPhysical(raw_value, 0.01, 0.0);

    raw_value=copyBitsFromByteArrayLE( byteArray, 1044, 12);
    @CAN_PrivMain::RFL_Object::RXX_Object_Obj1.PxVnce = convertRawToPhysical(raw_value, 0.1, 0.0);

    raw_value=copyBitsFromByteArrayLE( byteArray, 1280, 12);
    @CAN_PrivMain::RFL_Object::RXX_Object_Obj1.PxVxCoVnce = convertRawToPhysical(raw_value, 0.01, 0.0);

    raw_value=copyBitsFromByteArrayLE( byteArray, 1292, 12);
    @CAN_PrivMain::RFL_Object::RXX_Object_Obj1.PxVyCoVnce = convertRawToPhysical(raw_value, 0.01, 0.0);

    raw_value=copyBitsFromByteArrayLE( byteArray, 1056, 12);
    @CAN_PrivMain::RFL_Object::RXX_Object_Obj1.Py = convertRawToPhysical(raw_value, 0.0625, -128.0);

    raw_value=copyBitsFromByteArrayLE( byteArray, 1376, 12);
    @CAN_PrivMain::RFL_Object::RXX_Object_Obj1.PyAxCoVnce = convertRawToPhysical(raw_value, 0.01, 0.0);

    raw_value=copyBitsFromByteArrayLE( byteArray, 1388, 12);
    @CAN_PrivMain::RFL_Object::RXX_Object_Obj1.PyAyCoVnce = convertRawToPhysical(raw_value, 0.01, 0.0);

    raw_value=copyBitsFromByteArrayLE( byteArray, 1068, 12);
    @CAN_PrivMain::RFL_Object::RXX_Object_Obj1.PyVnce = convertRawToPhysical(raw_value, 0.1, 0.0);

    raw_value=copyBitsFromByteArrayLE( byteArray, 1312, 12);
    @CAN_PrivMain::RFL_Object::RXX_Object_Obj1.PyVxCoVnce = convertRawToPhysical(raw_value, 0.01, 0.0);

    raw_value=copyBitsFromByteArrayLE( byteArray, 1324, 12);
    @CAN_PrivMain::RFL_Object::RXX_Object_Obj1.PyVyCoVnce = convertRawToPhysical(raw_value, 0.01, 0.0);

    raw_value=copyBitsFromByteArrayLE( byteArray, 1164, 10);
    @CAN_PrivMain::RFL_Object::RXX_Object_Obj1.RCS = convertRawToPhysical(raw_value, 0.2, -102.4);

    raw_value=copyBitsFromByteArrayLE( byteArray, 1336, 4);
    @CAN_PrivMain::RFL_Object::RXX_Object_Obj1.ReferencePoint = convertRawToPhysical(raw_value, 1.0, 0.0);

    raw_value=copyBitsFromByteArrayLE( byteArray, 1196, 12);
    @CAN_PrivMain::RFL_Object::RXX_Object_Obj1.Vx = convertRawToPhysical(raw_value, 0.0625, -128.0);

    raw_value=copyBitsFromByteArrayLE( byteArray, 1420, 12);
    @CAN_PrivMain::RFL_Object::RXX_Object_Obj1.VxAxCoVnce = convertRawToPhysical(raw_value, 0.01, 0.0);

    raw_value=copyBitsFromByteArrayLE( byteArray, 1440, 12);
    @CAN_PrivMain::RFL_Object::RXX_Object_Obj1.VxAyCoVnce = convertRawToPhysical(raw_value, 0.01, 0.0);

    raw_value=copyBitsFromByteArrayLE( byteArray, 1216, 12);
    @CAN_PrivMain::RFL_Object::RXX_Object_Obj1.VxVnce = convertRawToPhysical(raw_value, 0.01, 0.0);

    raw_value=copyBitsFromByteArrayLE( byteArray, 1408, 12);
    @CAN_PrivMain::RFL_Object::RXX_Object_Obj1.VxVyCoVnce = convertRawToPhysical(raw_value, 0.01, 0.0);

    raw_value=copyBitsFromByteArrayLE( byteArray, 1230, 10);
    @CAN_PrivMain::RFL_Object::RXX_Object_Obj1.Vy = convertRawToPhysical(raw_value, 0.125, -64.0);

    raw_value=copyBitsFromByteArrayLE( byteArray, 1452, 12);
    @CAN_PrivMain::RFL_Object::RXX_Object_Obj1.VyAxCoVnce = convertRawToPhysical(raw_value, 0.01, 0.0);

    raw_value=copyBitsFromByteArrayLE( byteArray, 1472, 12);
    @CAN_PrivMain::RFL_Object::RXX_Object_Obj1.VyAyCoVnce = convertRawToPhysical(raw_value, 0.01, 0.0);

    raw_value=copyBitsFromByteArrayLE( byteArray, 1248, 12);
    @CAN_PrivMain::RFL_Object::RXX_Object_Obj1.VyVnce = convertRawToPhysical(raw_value, 0.01, 0.0);

    raw_value=copyBitsFromByteArrayLE( byteArray, 1144, 7);
    @CAN_PrivMain::RFL_Object::RXX_Object_Obj1.Width = convertRawToPhysical(raw_value, 0.125, 0.0);

    raw_value=copyBitsFromByteArrayLE( byteArray, 1152, 12);
    @CAN_PrivMain::RFL_Object::RXX_Object_Obj1.WidthVnce = convertRawToPhysical(raw_value, 0.01, 0.0);
}


void CRadarFL_RXX_Object_Obj10_SetDataReceived(byte byteArray[])
{
    qword raw_value;

    raw_value=copyBitsFromByteArrayLE( byteArray, 6112, 32);
    @CAN_PrivMain::RFL_Object::RXX_Object_Obj10.Age = convertRawToPhysical(raw_value, 1.0, 0.0);

    raw_value=copyBitsFromByteArrayLE( byteArray, 5708, 10);
    @CAN_PrivMain::RFL_Object::RXX_Object_Obj10.Ax = convertRawToPhysical(raw_value, 0.03125, -16.0);

    raw_value=copyBitsFromByteArrayLE( byteArray, 6092, 12);
    @CAN_PrivMain::RFL_Object::RXX_Object_Obj10.AxAyCoVnce = convertRawToPhysical(raw_value, 0.01, 0.0);

    raw_value=copyBitsFromByteArrayLE( byteArray, 5728, 12);
    @CAN_PrivMain::RFL_Object::RXX_Object_Obj10.AxVnce = convertRawToPhysical(raw_value, 0.01, 0.0);

    raw_value=copyBitsFromByteArrayLE( byteArray, 5782, 9);
    @CAN_PrivMain::RFL_Object::RXX_Object_Obj10.Ay = convertRawToPhysical(raw_value, 0.0625, -16.0);

    raw_value=copyBitsFromByteArrayLE( byteArray, 5792, 12);
    @CAN_PrivMain::RFL_Object::RXX_Object_Obj10.AyVnce = convertRawToPhysical(raw_value, 0.01, 0.0);

    raw_value=copyBitsFromByteArrayLE( byteArray, 5848, 6);
    @CAN_PrivMain::RFL_Object::RXX_Object_Obj10.ExistProb = convertRawToPhysical(raw_value, 2.0, 0.0);

    raw_value=copyBitsFromByteArrayLE( byteArray, 5912, 8);
    @CAN_PrivMain::RFL_Object::RXX_Object_Obj10.FilterInformation = convertRawToPhysical(raw_value, 1.0, 0.0);

    raw_value=copyBitsFromByteArrayLE( byteArray, 5688, 7);
    @CAN_PrivMain::RFL_Object::RXX_Object_Obj10.Length = convertRawToPhysical(raw_value, 0.125, 0.0);

    raw_value=copyBitsFromByteArrayLE( byteArray, 5696, 12);
    @CAN_PrivMain::RFL_Object::RXX_Object_Obj10.LengthVnce = convertRawToPhysical(raw_value, 0.01, 0.0);

    raw_value=copyBitsFromByteArrayLE( byteArray, 5880, 3);
    @CAN_PrivMain::RFL_Object::RXX_Object_Obj10.MeasurementStatus = convertRawToPhysical(raw_value, 1.0, 0.0);

    raw_value=copyBitsFromByteArrayLE( byteArray, 5836, 2);
    @CAN_PrivMain::RFL_Object::RXX_Object_Obj10.MovingStatus = convertRawToPhysical(raw_value, 1.0, 0.0);

    raw_value=copyBitsFromByteArrayLE( byteArray, 5816, 7);
    @CAN_PrivMain::RFL_Object::RXX_Object_Obj10.ObjId = convertRawToPhysical(raw_value, 1.0, 0.0);

    raw_value=copyBitsFromByteArrayLE( byteArray, 5718, 9);
    @CAN_PrivMain::RFL_Object::RXX_Object_Obj10.OrientationYaw = convertRawToPhysical(raw_value, 0.0175, -4.48);

    raw_value=copyBitsFromByteArrayLE( byteArray, 5740, 12);
    @CAN_PrivMain::RFL_Object::RXX_Object_Obj10.OrientationYawVnce = convertRawToPhysical(raw_value, 0.0003, 0.0);

    raw_value=copyBitsFromByteArrayLE( byteArray, 5632, 6);
    @CAN_PrivMain::RFL_Object::RXX_Object_Obj10.ProbClassConfidence = convertRawToPhysical(raw_value, 2.0, 0.0);

    raw_value=copyBitsFromByteArrayLE( byteArray, 5883, 4);
    @CAN_PrivMain::RFL_Object::RXX_Object_Obj10.ProbClassType = convertRawToPhysical(raw_value, 1.0, 0.0);

    raw_value=copyBitsFromByteArrayLE( byteArray, 5638, 14);
    @CAN_PrivMain::RFL_Object::RXX_Object_Obj10.Px = convertRawToPhysical(raw_value, 0.0625, -512.0);

    raw_value=copyBitsFromByteArrayLE( byteArray, 5952, 12);
    @CAN_PrivMain::RFL_Object::RXX_Object_Obj10.PxAxCoVnce = convertRawToPhysical(raw_value, 0.01, 0.0);

    raw_value=copyBitsFromByteArrayLE( byteArray, 5964, 12);
    @CAN_PrivMain::RFL_Object::RXX_Object_Obj10.PxAyCoVnce = convertRawToPhysical(raw_value, 0.01, 0.0);

    raw_value=copyBitsFromByteArrayLE( byteArray, 5868, 12);
    @CAN_PrivMain::RFL_Object::RXX_Object_Obj10.PxPyCoVnce = convertRawToPhysical(raw_value, 0.01, 0.0);

    raw_value=copyBitsFromByteArrayLE( byteArray, 5652, 12);
    @CAN_PrivMain::RFL_Object::RXX_Object_Obj10.PxVnce = convertRawToPhysical(raw_value, 0.1, 0.0);

    raw_value=copyBitsFromByteArrayLE( byteArray, 5888, 12);
    @CAN_PrivMain::RFL_Object::RXX_Object_Obj10.PxVxCoVnce = convertRawToPhysical(raw_value, 0.01, 0.0);

    raw_value=copyBitsFromByteArrayLE( byteArray, 5900, 12);
    @CAN_PrivMain::RFL_Object::RXX_Object_Obj10.PxVyCoVnce = convertRawToPhysical(raw_value, 0.01, 0.0);

    raw_value=copyBitsFromByteArrayLE( byteArray, 5664, 12);
    @CAN_PrivMain::RFL_Object::RXX_Object_Obj10.Py = convertRawToPhysical(raw_value, 0.0625, -128.0);

    raw_value=copyBitsFromByteArrayLE( byteArray, 5984, 12);
    @CAN_PrivMain::RFL_Object::RXX_Object_Obj10.PyAxCoVnce = convertRawToPhysical(raw_value, 0.01, 0.0);

    raw_value=copyBitsFromByteArrayLE( byteArray, 5996, 12);
    @CAN_PrivMain::RFL_Object::RXX_Object_Obj10.PyAyCoVnce = convertRawToPhysical(raw_value, 0.01, 0.0);

    raw_value=copyBitsFromByteArrayLE( byteArray, 5676, 12);
    @CAN_PrivMain::RFL_Object::RXX_Object_Obj10.PyVnce = convertRawToPhysical(raw_value, 0.1, 0.0);

    raw_value=copyBitsFromByteArrayLE( byteArray, 5920, 12);
    @CAN_PrivMain::RFL_Object::RXX_Object_Obj10.PyVxCoVnce = convertRawToPhysical(raw_value, 0.01, 0.0);

    raw_value=copyBitsFromByteArrayLE( byteArray, 5932, 12);
    @CAN_PrivMain::RFL_Object::RXX_Object_Obj10.PyVyCoVnce = convertRawToPhysical(raw_value, 0.01, 0.0);

    raw_value=copyBitsFromByteArrayLE( byteArray, 5772, 10);
    @CAN_PrivMain::RFL_Object::RXX_Object_Obj10.RCS = convertRawToPhysical(raw_value, 0.2, -102.4);

    raw_value=copyBitsFromByteArrayLE( byteArray, 5944, 4);
    @CAN_PrivMain::RFL_Object::RXX_Object_Obj10.ReferencePoint = convertRawToPhysical(raw_value, 1.0, 0.0);

    raw_value=copyBitsFromByteArrayLE( byteArray, 5804, 12);
    @CAN_PrivMain::RFL_Object::RXX_Object_Obj10.Vx = convertRawToPhysical(raw_value, 0.0625, -128.0);

    raw_value=copyBitsFromByteArrayLE( byteArray, 6028, 12);
    @CAN_PrivMain::RFL_Object::RXX_Object_Obj10.VxAxCoVnce = convertRawToPhysical(raw_value, 0.01, 0.0);

    raw_value=copyBitsFromByteArrayLE( byteArray, 6048, 12);
    @CAN_PrivMain::RFL_Object::RXX_Object_Obj10.VxAyCoVnce = convertRawToPhysical(raw_value, 0.01, 0.0);

    raw_value=copyBitsFromByteArrayLE( byteArray, 5824, 12);
    @CAN_PrivMain::RFL_Object::RXX_Object_Obj10.VxVnce = convertRawToPhysical(raw_value, 0.01, 0.0);

    raw_value=copyBitsFromByteArrayLE( byteArray, 6016, 12);
    @CAN_PrivMain::RFL_Object::RXX_Object_Obj10.VxVyCoVnce = convertRawToPhysical(raw_value, 0.01, 0.0);

    raw_value=copyBitsFromByteArrayLE( byteArray, 5838, 10);
    @CAN_PrivMain::RFL_Object::RXX_Object_Obj10.Vy = convertRawToPhysical(raw_value, 0.125, -64.0);

    raw_value=copyBitsFromByteArrayLE( byteArray, 6060, 12);
    @CAN_PrivMain::RFL_Object::RXX_Object_Obj10.VyAxCoVnce = convertRawToPhysical(raw_value, 0.01, 0.0);

    raw_value=copyBitsFromByteArrayLE( byteArray, 6080, 12);
    @CAN_PrivMain::RFL_Object::RXX_Object_Obj10.VyAyCoVnce = convertRawToPhysical(raw_value, 0.01, 0.0);

    raw_value=copyBitsFromByteArrayLE( byteArray, 5856, 12);
    @CAN_PrivMain::RFL_Object::RXX_Object_Obj10.VyVnce = convertRawToPhysical(raw_value, 0.01, 0.0);

    raw_value=copyBitsFromByteArrayLE( byteArray, 5752, 7);
    @CAN_PrivMain::RFL_Object::RXX_Object_Obj10.Width = convertRawToPhysical(raw_value, 0.125, 0.0);

    raw_value=copyBitsFromByteArrayLE( byteArray, 5760, 12);
    @CAN_PrivMain::RFL_Object::RXX_Object_Obj10.WidthVnce = convertRawToPhysical(raw_value, 0.01, 0.0);
}


void CRadarFL_RXX_Object_Obj11_SetDataReceived(byte byteArray[])
{
    qword raw_value;

    raw_value=copyBitsFromByteArrayLE( byteArray, 6624, 32);
    @CAN_PrivMain::RFL_Object::RXX_Object_Obj11.Age = convertRawToPhysical(raw_value, 1.0, 0.0);

    raw_value=copyBitsFromByteArrayLE( byteArray, 6220, 10);
    @CAN_PrivMain::RFL_Object::RXX_Object_Obj11.Ax = convertRawToPhysical(raw_value, 0.03125, -16.0);

    raw_value=copyBitsFromByteArrayLE( byteArray, 6604, 12);
    @CAN_PrivMain::RFL_Object::RXX_Object_Obj11.AxAyCoVnce = convertRawToPhysical(raw_value, 0.01, 0.0);

    raw_value=copyBitsFromByteArrayLE( byteArray, 6240, 12);
    @CAN_PrivMain::RFL_Object::RXX_Object_Obj11.AxVnce = convertRawToPhysical(raw_value, 0.01, 0.0);

    raw_value=copyBitsFromByteArrayLE( byteArray, 6294, 9);
    @CAN_PrivMain::RFL_Object::RXX_Object_Obj11.Ay = convertRawToPhysical(raw_value, 0.0625, -16.0);

    raw_value=copyBitsFromByteArrayLE( byteArray, 6304, 12);
    @CAN_PrivMain::RFL_Object::RXX_Object_Obj11.AyVnce = convertRawToPhysical(raw_value, 0.01, 0.0);

    raw_value=copyBitsFromByteArrayLE( byteArray, 6360, 6);
    @CAN_PrivMain::RFL_Object::RXX_Object_Obj11.ExistProb = convertRawToPhysical(raw_value, 2.0, 0.0);

    raw_value=copyBitsFromByteArrayLE( byteArray, 6424, 8);
    @CAN_PrivMain::RFL_Object::RXX_Object_Obj11.FilterInformation = convertRawToPhysical(raw_value, 1.0, 0.0);

    raw_value=copyBitsFromByteArrayLE( byteArray, 6200, 7);
    @CAN_PrivMain::RFL_Object::RXX_Object_Obj11.Length = convertRawToPhysical(raw_value, 0.125, 0.0);

    raw_value=copyBitsFromByteArrayLE( byteArray, 6208, 12);
    @CAN_PrivMain::RFL_Object::RXX_Object_Obj11.LengthVnce = convertRawToPhysical(raw_value, 0.01, 0.0);

    raw_value=copyBitsFromByteArrayLE( byteArray, 6392, 3);
    @CAN_PrivMain::RFL_Object::RXX_Object_Obj11.MeasurementStatus = convertRawToPhysical(raw_value, 1.0, 0.0);

    raw_value=copyBitsFromByteArrayLE( byteArray, 6348, 2);
    @CAN_PrivMain::RFL_Object::RXX_Object_Obj11.MovingStatus = convertRawToPhysical(raw_value, 1.0, 0.0);

    raw_value=copyBitsFromByteArrayLE( byteArray, 6328, 7);
    @CAN_PrivMain::RFL_Object::RXX_Object_Obj11.ObjId = convertRawToPhysical(raw_value, 1.0, 0.0);

    raw_value=copyBitsFromByteArrayLE( byteArray, 6230, 9);
    @CAN_PrivMain::RFL_Object::RXX_Object_Obj11.OrientationYaw = convertRawToPhysical(raw_value, 0.0175, -4.48);

    raw_value=copyBitsFromByteArrayLE( byteArray, 6252, 12);
    @CAN_PrivMain::RFL_Object::RXX_Object_Obj11.OrientationYawVnce = convertRawToPhysical(raw_value, 0.0003, 0.0);

    raw_value=copyBitsFromByteArrayLE( byteArray, 6144, 6);
    @CAN_PrivMain::RFL_Object::RXX_Object_Obj11.ProbClassConfidence = convertRawToPhysical(raw_value, 2.0, 0.0);

    raw_value=copyBitsFromByteArrayLE( byteArray, 6395, 4);
    @CAN_PrivMain::RFL_Object::RXX_Object_Obj11.ProbClassType = convertRawToPhysical(raw_value, 1.0, 0.0);

    raw_value=copyBitsFromByteArrayLE( byteArray, 6150, 14);
    @CAN_PrivMain::RFL_Object::RXX_Object_Obj11.Px = convertRawToPhysical(raw_value, 0.0625, -512.0);

    raw_value=copyBitsFromByteArrayLE( byteArray, 6464, 12);
    @CAN_PrivMain::RFL_Object::RXX_Object_Obj11.PxAxCoVnce = convertRawToPhysical(raw_value, 0.01, 0.0);

    raw_value=copyBitsFromByteArrayLE( byteArray, 6476, 12);
    @CAN_PrivMain::RFL_Object::RXX_Object_Obj11.PxAyCoVnce = convertRawToPhysical(raw_value, 0.01, 0.0);

    raw_value=copyBitsFromByteArrayLE( byteArray, 6380, 12);
    @CAN_PrivMain::RFL_Object::RXX_Object_Obj11.PxPyCoVnce = convertRawToPhysical(raw_value, 0.01, 0.0);

    raw_value=copyBitsFromByteArrayLE( byteArray, 6164, 12);
    @CAN_PrivMain::RFL_Object::RXX_Object_Obj11.PxVnce = convertRawToPhysical(raw_value, 0.1, 0.0);

    raw_value=copyBitsFromByteArrayLE( byteArray, 6400, 12);
    @CAN_PrivMain::RFL_Object::RXX_Object_Obj11.PxVxCoVnce = convertRawToPhysical(raw_value, 0.01, 0.0);

    raw_value=copyBitsFromByteArrayLE( byteArray, 6412, 12);
    @CAN_PrivMain::RFL_Object::RXX_Object_Obj11.PxVyCoVnce = convertRawToPhysical(raw_value, 0.01, 0.0);

    raw_value=copyBitsFromByteArrayLE( byteArray, 6176, 12);
    @CAN_PrivMain::RFL_Object::RXX_Object_Obj11.Py = convertRawToPhysical(raw_value, 0.0625, -128.0);

    raw_value=copyBitsFromByteArrayLE( byteArray, 6496, 12);
    @CAN_PrivMain::RFL_Object::RXX_Object_Obj11.PyAxCoVnce = convertRawToPhysical(raw_value, 0.01, 0.0);

    raw_value=copyBitsFromByteArrayLE( byteArray, 6508, 12);
    @CAN_PrivMain::RFL_Object::RXX_Object_Obj11.PyAyCoVnce = convertRawToPhysical(raw_value, 0.01, 0.0);

    raw_value=copyBitsFromByteArrayLE( byteArray, 6188, 12);
    @CAN_PrivMain::RFL_Object::RXX_Object_Obj11.PyVnce = convertRawToPhysical(raw_value, 0.1, 0.0);

    raw_value=copyBitsFromByteArrayLE( byteArray, 6432, 12);
    @CAN_PrivMain::RFL_Object::RXX_Object_Obj11.PyVxCoVnce = convertRawToPhysical(raw_value, 0.01, 0.0);

    raw_value=copyBitsFromByteArrayLE( byteArray, 6444, 12);
    @CAN_PrivMain::RFL_Object::RXX_Object_Obj11.PyVyCoVnce = convertRawToPhysical(raw_value, 0.01, 0.0);

    raw_value=copyBitsFromByteArrayLE( byteArray, 6284, 10);
    @CAN_PrivMain::RFL_Object::RXX_Object_Obj11.RCS = convertRawToPhysical(raw_value, 0.2, -102.4);

    raw_value=copyBitsFromByteArrayLE( byteArray, 6456, 4);
    @CAN_PrivMain::RFL_Object::RXX_Object_Obj11.ReferencePoint = convertRawToPhysical(raw_value, 1.0, 0.0);

    raw_value=copyBitsFromByteArrayLE( byteArray, 6316, 12);
    @CAN_PrivMain::RFL_Object::RXX_Object_Obj11.Vx = convertRawToPhysical(raw_value, 0.0625, -128.0);

    raw_value=copyBitsFromByteArrayLE( byteArray, 6540, 12);
    @CAN_PrivMain::RFL_Object::RXX_Object_Obj11.VxAxCoVnce = convertRawToPhysical(raw_value, 0.01, 0.0);

    raw_value=copyBitsFromByteArrayLE( byteArray, 6560, 12);
    @CAN_PrivMain::RFL_Object::RXX_Object_Obj11.VxAyCoVnce = convertRawToPhysical(raw_value, 0.01, 0.0);

    raw_value=copyBitsFromByteArrayLE( byteArray, 6336, 12);
    @CAN_PrivMain::RFL_Object::RXX_Object_Obj11.VxVnce = convertRawToPhysical(raw_value, 0.01, 0.0);

    raw_value=copyBitsFromByteArrayLE( byteArray, 6528, 12);
    @CAN_PrivMain::RFL_Object::RXX_Object_Obj11.VxVyCoVnce = convertRawToPhysical(raw_value, 0.01, 0.0);

    raw_value=copyBitsFromByteArrayLE( byteArray, 6350, 10);
    @CAN_PrivMain::RFL_Object::RXX_Object_Obj11.Vy = convertRawToPhysical(raw_value, 0.125, -64.0);

    raw_value=copyBitsFromByteArrayLE( byteArray, 6572, 12);
    @CAN_PrivMain::RFL_Object::RXX_Object_Obj11.VyAxCoVnce = convertRawToPhysical(raw_value, 0.01, 0.0);

    raw_value=copyBitsFromByteArrayLE( byteArray, 6592, 12);
    @CAN_PrivMain::RFL_Object::RXX_Object_Obj11.VyAyCoVnce = convertRawToPhysical(raw_value, 0.01, 0.0);

    raw_value=copyBitsFromByteArrayLE( byteArray, 6368, 12);
    @CAN_PrivMain::RFL_Object::RXX_Object_Obj11.VyVnce = convertRawToPhysical(raw_value, 0.01, 0.0);

    raw_value=copyBitsFromByteArrayLE( byteArray, 6264, 7);
    @CAN_PrivMain::RFL_Object::RXX_Object_Obj11.Width = convertRawToPhysical(raw_value, 0.125, 0.0);

    raw_value=copyBitsFromByteArrayLE( byteArray, 6272, 12);
    @CAN_PrivMain::RFL_Object::RXX_Object_Obj11.WidthVnce = convertRawToPhysical(raw_value, 0.01, 0.0);
}


void CRadarFL_RXX_Object_Obj12_SetDataReceived(byte byteArray[])
{
    qword raw_value;

    raw_value=copyBitsFromByteArrayLE( byteArray, 7136, 32);
    @CAN_PrivMain::RFL_Object::RXX_Object_Obj12.Age = convertRawToPhysical(raw_value, 1.0, 0.0);

    raw_value=copyBitsFromByteArrayLE( byteArray, 6732, 10);
    @CAN_PrivMain::RFL_Object::RXX_Object_Obj12.Ax = convertRawToPhysical(raw_value, 0.03125, -16.0);

    raw_value=copyBitsFromByteArrayLE( byteArray, 7116, 12);
    @CAN_PrivMain::RFL_Object::RXX_Object_Obj12.AxAyCoVnce = convertRawToPhysical(raw_value, 0.01, 0.0);

    raw_value=copyBitsFromByteArrayLE( byteArray, 6752, 12);
    @CAN_PrivMain::RFL_Object::RXX_Object_Obj12.AxVnce = convertRawToPhysical(raw_value, 0.01, 0.0);

    raw_value=copyBitsFromByteArrayLE( byteArray, 6806, 9);
    @CAN_PrivMain::RFL_Object::RXX_Object_Obj12.Ay = convertRawToPhysical(raw_value, 0.0625, -16.0);

    raw_value=copyBitsFromByteArrayLE( byteArray, 6816, 12);
    @CAN_PrivMain::RFL_Object::RXX_Object_Obj12.AyVnce = convertRawToPhysical(raw_value, 0.01, 0.0);

    raw_value=copyBitsFromByteArrayLE( byteArray, 6872, 6);
    @CAN_PrivMain::RFL_Object::RXX_Object_Obj12.ExistProb = convertRawToPhysical(raw_value, 2.0, 0.0);

    raw_value=copyBitsFromByteArrayLE( byteArray, 6936, 8);
    @CAN_PrivMain::RFL_Object::RXX_Object_Obj12.FilterInformation = convertRawToPhysical(raw_value, 1.0, 0.0);

    raw_value=copyBitsFromByteArrayLE( byteArray, 6712, 7);
    @CAN_PrivMain::RFL_Object::RXX_Object_Obj12.Length = convertRawToPhysical(raw_value, 0.125, 0.0);

    raw_value=copyBitsFromByteArrayLE( byteArray, 6720, 12);
    @CAN_PrivMain::RFL_Object::RXX_Object_Obj12.LengthVnce = convertRawToPhysical(raw_value, 0.01, 0.0);

    raw_value=copyBitsFromByteArrayLE( byteArray, 6904, 3);
    @CAN_PrivMain::RFL_Object::RXX_Object_Obj12.MeasurementStatus = convertRawToPhysical(raw_value, 1.0, 0.0);

    raw_value=copyBitsFromByteArrayLE( byteArray, 6860, 2);
    @CAN_PrivMain::RFL_Object::RXX_Object_Obj12.MovingStatus = convertRawToPhysical(raw_value, 1.0, 0.0);

    raw_value=copyBitsFromByteArrayLE( byteArray, 6840, 7);
    @CAN_PrivMain::RFL_Object::RXX_Object_Obj12.ObjId = convertRawToPhysical(raw_value, 1.0, 0.0);

    raw_value=copyBitsFromByteArrayLE( byteArray, 6742, 9);
    @CAN_PrivMain::RFL_Object::RXX_Object_Obj12.OrientationYaw = convertRawToPhysical(raw_value, 0.0175, -4.48);

    raw_value=copyBitsFromByteArrayLE( byteArray, 6764, 12);
    @CAN_PrivMain::RFL_Object::RXX_Object_Obj12.OrientationYawVnce = convertRawToPhysical(raw_value, 0.0003, 0.0);

    raw_value=copyBitsFromByteArrayLE( byteArray, 6656, 6);
    @CAN_PrivMain::RFL_Object::RXX_Object_Obj12.ProbClassConfidence = convertRawToPhysical(raw_value, 2.0, 0.0);

    raw_value=copyBitsFromByteArrayLE( byteArray, 6907, 4);
    @CAN_PrivMain::RFL_Object::RXX_Object_Obj12.ProbClassType = convertRawToPhysical(raw_value, 1.0, 0.0);

    raw_value=copyBitsFromByteArrayLE( byteArray, 6662, 14);
    @CAN_PrivMain::RFL_Object::RXX_Object_Obj12.Px = convertRawToPhysical(raw_value, 0.0625, -512.0);

    raw_value=copyBitsFromByteArrayLE( byteArray, 6976, 12);
    @CAN_PrivMain::RFL_Object::RXX_Object_Obj12.PxAxCoVnce = convertRawToPhysical(raw_value, 0.01, 0.0);

    raw_value=copyBitsFromByteArrayLE( byteArray, 6988, 12);
    @CAN_PrivMain::RFL_Object::RXX_Object_Obj12.PxAyCoVnce = convertRawToPhysical(raw_value, 0.01, 0.0);

    raw_value=copyBitsFromByteArrayLE( byteArray, 6892, 12);
    @CAN_PrivMain::RFL_Object::RXX_Object_Obj12.PxPyCoVnce = convertRawToPhysical(raw_value, 0.01, 0.0);

    raw_value=copyBitsFromByteArrayLE( byteArray, 6676, 12);
    @CAN_PrivMain::RFL_Object::RXX_Object_Obj12.PxVnce = convertRawToPhysical(raw_value, 0.1, 0.0);

    raw_value=copyBitsFromByteArrayLE( byteArray, 6912, 12);
    @CAN_PrivMain::RFL_Object::RXX_Object_Obj12.PxVxCoVnce = convertRawToPhysical(raw_value, 0.01, 0.0);

    raw_value=copyBitsFromByteArrayLE( byteArray, 6924, 12);
    @CAN_PrivMain::RFL_Object::RXX_Object_Obj12.PxVyCoVnce = convertRawToPhysical(raw_value, 0.01, 0.0);

    raw_value=copyBitsFromByteArrayLE( byteArray, 6688, 12);
    @CAN_PrivMain::RFL_Object::RXX_Object_Obj12.Py = convertRawToPhysical(raw_value, 0.0625, -128.0);

    raw_value=copyBitsFromByteArrayLE( byteArray, 7008, 12);
    @CAN_PrivMain::RFL_Object::RXX_Object_Obj12.PyAxCoVnce = convertRawToPhysical(raw_value, 0.01, 0.0);

    raw_value=copyBitsFromByteArrayLE( byteArray, 7020, 12);
    @CAN_PrivMain::RFL_Object::RXX_Object_Obj12.PyAyCoVnce = convertRawToPhysical(raw_value, 0.01, 0.0);

    raw_value=copyBitsFromByteArrayLE( byteArray, 6700, 12);
    @CAN_PrivMain::RFL_Object::RXX_Object_Obj12.PyVnce = convertRawToPhysical(raw_value, 0.1, 0.0);

    raw_value=copyBitsFromByteArrayLE( byteArray, 6944, 12);
    @CAN_PrivMain::RFL_Object::RXX_Object_Obj12.PyVxCoVnce = convertRawToPhysical(raw_value, 0.01, 0.0);

    raw_value=copyBitsFromByteArrayLE( byteArray, 6956, 12);
    @CAN_PrivMain::RFL_Object::RXX_Object_Obj12.PyVyCoVnce = convertRawToPhysical(raw_value, 0.01, 0.0);

    raw_value=copyBitsFromByteArrayLE( byteArray, 6796, 10);
    @CAN_PrivMain::RFL_Object::RXX_Object_Obj12.RCS = convertRawToPhysical(raw_value, 0.2, -102.4);

    raw_value=copyBitsFromByteArrayLE( byteArray, 6968, 4);
    @CAN_PrivMain::RFL_Object::RXX_Object_Obj12.ReferencePoint = convertRawToPhysical(raw_value, 1.0, 0.0);

    raw_value=copyBitsFromByteArrayLE( byteArray, 6828, 12);
    @CAN_PrivMain::RFL_Object::RXX_Object_Obj12.Vx = convertRawToPhysical(raw_value, 0.0625, -128.0);

    raw_value=copyBitsFromByteArrayLE( byteArray, 7052, 12);
    @CAN_PrivMain::RFL_Object::RXX_Object_Obj12.VxAxCoVnce = convertRawToPhysical(raw_value, 0.01, 0.0);

    raw_value=copyBitsFromByteArrayLE( byteArray, 7072, 12);
    @CAN_PrivMain::RFL_Object::RXX_Object_Obj12.VxAyCoVnce = convertRawToPhysical(raw_value, 0.01, 0.0);

    raw_value=copyBitsFromByteArrayLE( byteArray, 6848, 12);
    @CAN_PrivMain::RFL_Object::RXX_Object_Obj12.VxVnce = convertRawToPhysical(raw_value, 0.01, 0.0);

    raw_value=copyBitsFromByteArrayLE( byteArray, 7040, 12);
    @CAN_PrivMain::RFL_Object::RXX_Object_Obj12.VxVyCoVnce = convertRawToPhysical(raw_value, 0.01, 0.0);

    raw_value=copyBitsFromByteArrayLE( byteArray, 6862, 10);
    @CAN_PrivMain::RFL_Object::RXX_Object_Obj12.Vy = convertRawToPhysical(raw_value, 0.125, -64.0);

    raw_value=copyBitsFromByteArrayLE( byteArray, 7084, 12);
    @CAN_PrivMain::RFL_Object::RXX_Object_Obj12.VyAxCoVnce = convertRawToPhysical(raw_value, 0.01, 0.0);

    raw_value=copyBitsFromByteArrayLE( byteArray, 7104, 12);
    @CAN_PrivMain::RFL_Object::RXX_Object_Obj12.VyAyCoVnce = convertRawToPhysical(raw_value, 0.01, 0.0);

    raw_value=copyBitsFromByteArrayLE( byteArray, 6880, 12);
    @CAN_PrivMain::RFL_Object::RXX_Object_Obj12.VyVnce = convertRawToPhysical(raw_value, 0.01, 0.0);

    raw_value=copyBitsFromByteArrayLE( byteArray, 6776, 7);
    @CAN_PrivMain::RFL_Object::RXX_Object_Obj12.Width = convertRawToPhysical(raw_value, 0.125, 0.0);

    raw_value=copyBitsFromByteArrayLE( byteArray, 6784, 12);
    @CAN_PrivMain::RFL_Object::RXX_Object_Obj12.WidthVnce = convertRawToPhysical(raw_value, 0.01, 0.0);
}


void CRadarFL_RXX_Object_Obj13_SetDataReceived(byte byteArray[])
{
    qword raw_value;

    raw_value=copyBitsFromByteArrayLE( byteArray, 7648, 32);
    @CAN_PrivMain::RFL_Object::RXX_Object_Obj13.Age = convertRawToPhysical(raw_value, 1.0, 0.0);

    raw_value=copyBitsFromByteArrayLE( byteArray, 7244, 10);
    @CAN_PrivMain::RFL_Object::RXX_Object_Obj13.Ax = convertRawToPhysical(raw_value, 0.03125, -16.0);

    raw_value=copyBitsFromByteArrayLE( byteArray, 7628, 12);
    @CAN_PrivMain::RFL_Object::RXX_Object_Obj13.AxAyCoVnce = convertRawToPhysical(raw_value, 0.01, 0.0);

    raw_value=copyBitsFromByteArrayLE( byteArray, 7264, 12);
    @CAN_PrivMain::RFL_Object::RXX_Object_Obj13.AxVnce = convertRawToPhysical(raw_value, 0.01, 0.0);

    raw_value=copyBitsFromByteArrayLE( byteArray, 7318, 9);
    @CAN_PrivMain::RFL_Object::RXX_Object_Obj13.Ay = convertRawToPhysical(raw_value, 0.0625, -16.0);

    raw_value=copyBitsFromByteArrayLE( byteArray, 7328, 12);
    @CAN_PrivMain::RFL_Object::RXX_Object_Obj13.AyVnce = convertRawToPhysical(raw_value, 0.01, 0.0);

    raw_value=copyBitsFromByteArrayLE( byteArray, 7384, 6);
    @CAN_PrivMain::RFL_Object::RXX_Object_Obj13.ExistProb = convertRawToPhysical(raw_value, 2.0, 0.0);

    raw_value=copyBitsFromByteArrayLE( byteArray, 7448, 8);
    @CAN_PrivMain::RFL_Object::RXX_Object_Obj13.FilterInformation = convertRawToPhysical(raw_value, 1.0, 0.0);

    raw_value=copyBitsFromByteArrayLE( byteArray, 7224, 7);
    @CAN_PrivMain::RFL_Object::RXX_Object_Obj13.Length = convertRawToPhysical(raw_value, 0.125, 0.0);

    raw_value=copyBitsFromByteArrayLE( byteArray, 7232, 12);
    @CAN_PrivMain::RFL_Object::RXX_Object_Obj13.LengthVnce = convertRawToPhysical(raw_value, 0.01, 0.0);

    raw_value=copyBitsFromByteArrayLE( byteArray, 7416, 3);
    @CAN_PrivMain::RFL_Object::RXX_Object_Obj13.MeasurementStatus = convertRawToPhysical(raw_value, 1.0, 0.0);

    raw_value=copyBitsFromByteArrayLE( byteArray, 7372, 2);
    @CAN_PrivMain::RFL_Object::RXX_Object_Obj13.MovingStatus = convertRawToPhysical(raw_value, 1.0, 0.0);

    raw_value=copyBitsFromByteArrayLE( byteArray, 7352, 7);
    @CAN_PrivMain::RFL_Object::RXX_Object_Obj13.ObjId = convertRawToPhysical(raw_value, 1.0, 0.0);

    raw_value=copyBitsFromByteArrayLE( byteArray, 7254, 9);
    @CAN_PrivMain::RFL_Object::RXX_Object_Obj13.OrientationYaw = convertRawToPhysical(raw_value, 0.0175, -4.48);

    raw_value=copyBitsFromByteArrayLE( byteArray, 7276, 12);
    @CAN_PrivMain::RFL_Object::RXX_Object_Obj13.OrientationYawVnce = convertRawToPhysical(raw_value, 0.0003, 0.0);

    raw_value=copyBitsFromByteArrayLE( byteArray, 7168, 6);
    @CAN_PrivMain::RFL_Object::RXX_Object_Obj13.ProbClassConfidence = convertRawToPhysical(raw_value, 2.0, 0.0);

    raw_value=copyBitsFromByteArrayLE( byteArray, 7419, 4);
    @CAN_PrivMain::RFL_Object::RXX_Object_Obj13.ProbClassType = convertRawToPhysical(raw_value, 1.0, 0.0);

    raw_value=copyBitsFromByteArrayLE( byteArray, 7174, 14);
    @CAN_PrivMain::RFL_Object::RXX_Object_Obj13.Px = convertRawToPhysical(raw_value, 0.0625, -512.0);

    raw_value=copyBitsFromByteArrayLE( byteArray, 7488, 12);
    @CAN_PrivMain::RFL_Object::RXX_Object_Obj13.PxAxCoVnce = convertRawToPhysical(raw_value, 0.01, 0.0);

    raw_value=copyBitsFromByteArrayLE( byteArray, 7500, 12);
    @CAN_PrivMain::RFL_Object::RXX_Object_Obj13.PxAyCoVnce = convertRawToPhysical(raw_value, 0.01, 0.0);

    raw_value=copyBitsFromByteArrayLE( byteArray, 7404, 12);
    @CAN_PrivMain::RFL_Object::RXX_Object_Obj13.PxPyCoVnce = convertRawToPhysical(raw_value, 0.01, 0.0);

    raw_value=copyBitsFromByteArrayLE( byteArray, 7188, 12);
    @CAN_PrivMain::RFL_Object::RXX_Object_Obj13.PxVnce = convertRawToPhysical(raw_value, 0.1, 0.0);

    raw_value=copyBitsFromByteArrayLE( byteArray, 7424, 12);
    @CAN_PrivMain::RFL_Object::RXX_Object_Obj13.PxVxCoVnce = convertRawToPhysical(raw_value, 0.01, 0.0);

    raw_value=copyBitsFromByteArrayLE( byteArray, 7436, 12);
    @CAN_PrivMain::RFL_Object::RXX_Object_Obj13.PxVyCoVnce = convertRawToPhysical(raw_value, 0.01, 0.0);

    raw_value=copyBitsFromByteArrayLE( byteArray, 7200, 12);
    @CAN_PrivMain::RFL_Object::RXX_Object_Obj13.Py = convertRawToPhysical(raw_value, 0.0625, -128.0);

    raw_value=copyBitsFromByteArrayLE( byteArray, 7520, 12);
    @CAN_PrivMain::RFL_Object::RXX_Object_Obj13.PyAxCoVnce = convertRawToPhysical(raw_value, 0.01, 0.0);

    raw_value=copyBitsFromByteArrayLE( byteArray, 7532, 12);
    @CAN_PrivMain::RFL_Object::RXX_Object_Obj13.PyAyCoVnce = convertRawToPhysical(raw_value, 0.01, 0.0);

    raw_value=copyBitsFromByteArrayLE( byteArray, 7212, 12);
    @CAN_PrivMain::RFL_Object::RXX_Object_Obj13.PyVnce = convertRawToPhysical(raw_value, 0.1, 0.0);

    raw_value=copyBitsFromByteArrayLE( byteArray, 7456, 12);
    @CAN_PrivMain::RFL_Object::RXX_Object_Obj13.PyVxCoVnce = convertRawToPhysical(raw_value, 0.01, 0.0);

    raw_value=copyBitsFromByteArrayLE( byteArray, 7468, 12);
    @CAN_PrivMain::RFL_Object::RXX_Object_Obj13.PyVyCoVnce = convertRawToPhysical(raw_value, 0.01, 0.0);

    raw_value=copyBitsFromByteArrayLE( byteArray, 7308, 10);
    @CAN_PrivMain::RFL_Object::RXX_Object_Obj13.RCS = convertRawToPhysical(raw_value, 0.2, -102.4);

    raw_value=copyBitsFromByteArrayLE( byteArray, 7480, 4);
    @CAN_PrivMain::RFL_Object::RXX_Object_Obj13.ReferencePoint = convertRawToPhysical(raw_value, 1.0, 0.0);

    raw_value=copyBitsFromByteArrayLE( byteArray, 7340, 12);
    @CAN_PrivMain::RFL_Object::RXX_Object_Obj13.Vx = convertRawToPhysical(raw_value, 0.0625, -128.0);

    raw_value=copyBitsFromByteArrayLE( byteArray, 7564, 12);
    @CAN_PrivMain::RFL_Object::RXX_Object_Obj13.VxAxCoVnce = convertRawToPhysical(raw_value, 0.01, 0.0);

    raw_value=copyBitsFromByteArrayLE( byteArray, 7584, 12);
    @CAN_PrivMain::RFL_Object::RXX_Object_Obj13.VxAyCoVnce = convertRawToPhysical(raw_value, 0.01, 0.0);

    raw_value=copyBitsFromByteArrayLE( byteArray, 7360, 12);
    @CAN_PrivMain::RFL_Object::RXX_Object_Obj13.VxVnce = convertRawToPhysical(raw_value, 0.01, 0.0);

    raw_value=copyBitsFromByteArrayLE( byteArray, 7552, 12);
    @CAN_PrivMain::RFL_Object::RXX_Object_Obj13.VxVyCoVnce = convertRawToPhysical(raw_value, 0.01, 0.0);

    raw_value=copyBitsFromByteArrayLE( byteArray, 7374, 10);
    @CAN_PrivMain::RFL_Object::RXX_Object_Obj13.Vy = convertRawToPhysical(raw_value, 0.125, -64.0);

    raw_value=copyBitsFromByteArrayLE( byteArray, 7596, 12);
    @CAN_PrivMain::RFL_Object::RXX_Object_Obj13.VyAxCoVnce = convertRawToPhysical(raw_value, 0.01, 0.0);

    raw_value=copyBitsFromByteArrayLE( byteArray, 7616, 12);
    @CAN_PrivMain::RFL_Object::RXX_Object_Obj13.VyAyCoVnce = convertRawToPhysical(raw_value, 0.01, 0.0);

    raw_value=copyBitsFromByteArrayLE( byteArray, 7392, 12);
    @CAN_PrivMain::RFL_Object::RXX_Object_Obj13.VyVnce = convertRawToPhysical(raw_value, 0.01, 0.0);

    raw_value=copyBitsFromByteArrayLE( byteArray, 7288, 7);
    @CAN_PrivMain::RFL_Object::RXX_Object_Obj13.Width = convertRawToPhysical(raw_value, 0.125, 0.0);

    raw_value=copyBitsFromByteArrayLE( byteArray, 7296, 12);
    @CAN_PrivMain::RFL_Object::RXX_Object_Obj13.WidthVnce = convertRawToPhysical(raw_value, 0.01, 0.0);
}


void CRadarFL_RXX_Object_Obj14_SetDataReceived(byte byteArray[])
{
    qword raw_value;

    raw_value=copyBitsFromByteArrayLE( byteArray, 8160, 32);
    @CAN_PrivMain::RFL_Object::RXX_Object_Obj14.Age = convertRawToPhysical(raw_value, 1.0, 0.0);

    raw_value=copyBitsFromByteArrayLE( byteArray, 7756, 10);
    @CAN_PrivMain::RFL_Object::RXX_Object_Obj14.Ax = convertRawToPhysical(raw_value, 0.03125, -16.0);

    raw_value=copyBitsFromByteArrayLE( byteArray, 8140, 12);
    @CAN_PrivMain::RFL_Object::RXX_Object_Obj14.AxAyCoVnce = convertRawToPhysical(raw_value, 0.01, 0.0);

    raw_value=copyBitsFromByteArrayLE( byteArray, 7776, 12);
    @CAN_PrivMain::RFL_Object::RXX_Object_Obj14.AxVnce = convertRawToPhysical(raw_value, 0.01, 0.0);

    raw_value=copyBitsFromByteArrayLE( byteArray, 7830, 9);
    @CAN_PrivMain::RFL_Object::RXX_Object_Obj14.Ay = convertRawToPhysical(raw_value, 0.0625, -16.0);

    raw_value=copyBitsFromByteArrayLE( byteArray, 7840, 12);
    @CAN_PrivMain::RFL_Object::RXX_Object_Obj14.AyVnce = convertRawToPhysical(raw_value, 0.01, 0.0);

    raw_value=copyBitsFromByteArrayLE( byteArray, 7896, 6);
    @CAN_PrivMain::RFL_Object::RXX_Object_Obj14.ExistProb = convertRawToPhysical(raw_value, 2.0, 0.0);

    raw_value=copyBitsFromByteArrayLE( byteArray, 7960, 8);
    @CAN_PrivMain::RFL_Object::RXX_Object_Obj14.FilterInformation = convertRawToPhysical(raw_value, 1.0, 0.0);

    raw_value=copyBitsFromByteArrayLE( byteArray, 7736, 7);
    @CAN_PrivMain::RFL_Object::RXX_Object_Obj14.Length = convertRawToPhysical(raw_value, 0.125, 0.0);

    raw_value=copyBitsFromByteArrayLE( byteArray, 7744, 12);
    @CAN_PrivMain::RFL_Object::RXX_Object_Obj14.LengthVnce = convertRawToPhysical(raw_value, 0.01, 0.0);

    raw_value=copyBitsFromByteArrayLE( byteArray, 7928, 3);
    @CAN_PrivMain::RFL_Object::RXX_Object_Obj14.MeasurementStatus = convertRawToPhysical(raw_value, 1.0, 0.0);

    raw_value=copyBitsFromByteArrayLE( byteArray, 7884, 2);
    @CAN_PrivMain::RFL_Object::RXX_Object_Obj14.MovingStatus = convertRawToPhysical(raw_value, 1.0, 0.0);

    raw_value=copyBitsFromByteArrayLE( byteArray, 7864, 7);
    @CAN_PrivMain::RFL_Object::RXX_Object_Obj14.ObjId = convertRawToPhysical(raw_value, 1.0, 0.0);

    raw_value=copyBitsFromByteArrayLE( byteArray, 7766, 9);
    @CAN_PrivMain::RFL_Object::RXX_Object_Obj14.OrientationYaw = convertRawToPhysical(raw_value, 0.0175, -4.48);

    raw_value=copyBitsFromByteArrayLE( byteArray, 7788, 12);
    @CAN_PrivMain::RFL_Object::RXX_Object_Obj14.OrientationYawVnce = convertRawToPhysical(raw_value, 0.0003, 0.0);

    raw_value=copyBitsFromByteArrayLE( byteArray, 7680, 6);
    @CAN_PrivMain::RFL_Object::RXX_Object_Obj14.ProbClassConfidence = convertRawToPhysical(raw_value, 2.0, 0.0);

    raw_value=copyBitsFromByteArrayLE( byteArray, 7931, 4);
    @CAN_PrivMain::RFL_Object::RXX_Object_Obj14.ProbClassType = convertRawToPhysical(raw_value, 1.0, 0.0);

    raw_value=copyBitsFromByteArrayLE( byteArray, 7686, 14);
    @CAN_PrivMain::RFL_Object::RXX_Object_Obj14.Px = convertRawToPhysical(raw_value, 0.0625, -512.0);

    raw_value=copyBitsFromByteArrayLE( byteArray, 8000, 12);
    @CAN_PrivMain::RFL_Object::RXX_Object_Obj14.PxAxCoVnce = convertRawToPhysical(raw_value, 0.01, 0.0);

    raw_value=copyBitsFromByteArrayLE( byteArray, 8012, 12);
    @CAN_PrivMain::RFL_Object::RXX_Object_Obj14.PxAyCoVnce = convertRawToPhysical(raw_value, 0.01, 0.0);

    raw_value=copyBitsFromByteArrayLE( byteArray, 7916, 12);
    @CAN_PrivMain::RFL_Object::RXX_Object_Obj14.PxPyCoVnce = convertRawToPhysical(raw_value, 0.01, 0.0);

    raw_value=copyBitsFromByteArrayLE( byteArray, 7700, 12);
    @CAN_PrivMain::RFL_Object::RXX_Object_Obj14.PxVnce = convertRawToPhysical(raw_value, 0.1, 0.0);

    raw_value=copyBitsFromByteArrayLE( byteArray, 7936, 12);
    @CAN_PrivMain::RFL_Object::RXX_Object_Obj14.PxVxCoVnce = convertRawToPhysical(raw_value, 0.01, 0.0);

    raw_value=copyBitsFromByteArrayLE( byteArray, 7948, 12);
    @CAN_PrivMain::RFL_Object::RXX_Object_Obj14.PxVyCoVnce = convertRawToPhysical(raw_value, 0.01, 0.0);

    raw_value=copyBitsFromByteArrayLE( byteArray, 7712, 12);
    @CAN_PrivMain::RFL_Object::RXX_Object_Obj14.Py = convertRawToPhysical(raw_value, 0.0625, -128.0);

    raw_value=copyBitsFromByteArrayLE( byteArray, 8032, 12);
    @CAN_PrivMain::RFL_Object::RXX_Object_Obj14.PyAxCoVnce = convertRawToPhysical(raw_value, 0.01, 0.0);

    raw_value=copyBitsFromByteArrayLE( byteArray, 8044, 12);
    @CAN_PrivMain::RFL_Object::RXX_Object_Obj14.PyAyCoVnce = convertRawToPhysical(raw_value, 0.01, 0.0);

    raw_value=copyBitsFromByteArrayLE( byteArray, 7724, 12);
    @CAN_PrivMain::RFL_Object::RXX_Object_Obj14.PyVnce = convertRawToPhysical(raw_value, 0.1, 0.0);

    raw_value=copyBitsFromByteArrayLE( byteArray, 7968, 12);
    @CAN_PrivMain::RFL_Object::RXX_Object_Obj14.PyVxCoVnce = convertRawToPhysical(raw_value, 0.01, 0.0);

    raw_value=copyBitsFromByteArrayLE( byteArray, 7980, 12);
    @CAN_PrivMain::RFL_Object::RXX_Object_Obj14.PyVyCoVnce = convertRawToPhysical(raw_value, 0.01, 0.0);

    raw_value=copyBitsFromByteArrayLE( byteArray, 7820, 10);
    @CAN_PrivMain::RFL_Object::RXX_Object_Obj14.RCS = convertRawToPhysical(raw_value, 0.2, -102.4);

    raw_value=copyBitsFromByteArrayLE( byteArray, 7992, 4);
    @CAN_PrivMain::RFL_Object::RXX_Object_Obj14.ReferencePoint = convertRawToPhysical(raw_value, 1.0, 0.0);

    raw_value=copyBitsFromByteArrayLE( byteArray, 7852, 12);
    @CAN_PrivMain::RFL_Object::RXX_Object_Obj14.Vx = convertRawToPhysical(raw_value, 0.0625, -128.0);

    raw_value=copyBitsFromByteArrayLE( byteArray, 8076, 12);
    @CAN_PrivMain::RFL_Object::RXX_Object_Obj14.VxAxCoVnce = convertRawToPhysical(raw_value, 0.01, 0.0);

    raw_value=copyBitsFromByteArrayLE( byteArray, 8096, 12);
    @CAN_PrivMain::RFL_Object::RXX_Object_Obj14.VxAyCoVnce = convertRawToPhysical(raw_value, 0.01, 0.0);

    raw_value=copyBitsFromByteArrayLE( byteArray, 7872, 12);
    @CAN_PrivMain::RFL_Object::RXX_Object_Obj14.VxVnce = convertRawToPhysical(raw_value, 0.01, 0.0);

    raw_value=copyBitsFromByteArrayLE( byteArray, 8064, 12);
    @CAN_PrivMain::RFL_Object::RXX_Object_Obj14.VxVyCoVnce = convertRawToPhysical(raw_value, 0.01, 0.0);

    raw_value=copyBitsFromByteArrayLE( byteArray, 7886, 10);
    @CAN_PrivMain::RFL_Object::RXX_Object_Obj14.Vy = convertRawToPhysical(raw_value, 0.125, -64.0);

    raw_value=copyBitsFromByteArrayLE( byteArray, 8108, 12);
    @CAN_PrivMain::RFL_Object::RXX_Object_Obj14.VyAxCoVnce = convertRawToPhysical(raw_value, 0.01, 0.0);

    raw_value=copyBitsFromByteArrayLE( byteArray, 8128, 12);
    @CAN_PrivMain::RFL_Object::RXX_Object_Obj14.VyAyCoVnce = convertRawToPhysical(raw_value, 0.01, 0.0);

    raw_value=copyBitsFromByteArrayLE( byteArray, 7904, 12);
    @CAN_PrivMain::RFL_Object::RXX_Object_Obj14.VyVnce = convertRawToPhysical(raw_value, 0.01, 0.0);

    raw_value=copyBitsFromByteArrayLE( byteArray, 7800, 7);
    @CAN_PrivMain::RFL_Object::RXX_Object_Obj14.Width = convertRawToPhysical(raw_value, 0.125, 0.0);

    raw_value=copyBitsFromByteArrayLE( byteArray, 7808, 12);
    @CAN_PrivMain::RFL_Object::RXX_Object_Obj14.WidthVnce = convertRawToPhysical(raw_value, 0.01, 0.0);
}


void CRadarFL_RXX_Object_Obj15_SetDataReceived(byte byteArray[])
{
    qword raw_value;

    raw_value=copyBitsFromByteArrayLE( byteArray, 8672, 32);
    @CAN_PrivMain::RFL_Object::RXX_Object_Obj15.Age = convertRawToPhysical(raw_value, 1.0, 0.0);

    raw_value=copyBitsFromByteArrayLE( byteArray, 8268, 10);
    @CAN_PrivMain::RFL_Object::RXX_Object_Obj15.Ax = convertRawToPhysical(raw_value, 0.03125, -16.0);

    raw_value=copyBitsFromByteArrayLE( byteArray, 8652, 12);
    @CAN_PrivMain::RFL_Object::RXX_Object_Obj15.AxAyCoVnce = convertRawToPhysical(raw_value, 0.01, 0.0);

    raw_value=copyBitsFromByteArrayLE( byteArray, 8288, 12);
    @CAN_PrivMain::RFL_Object::RXX_Object_Obj15.AxVnce = convertRawToPhysical(raw_value, 0.01, 0.0);

    raw_value=copyBitsFromByteArrayLE( byteArray, 8342, 9);
    @CAN_PrivMain::RFL_Object::RXX_Object_Obj15.Ay = convertRawToPhysical(raw_value, 0.0625, -16.0);

    raw_value=copyBitsFromByteArrayLE( byteArray, 8352, 12);
    @CAN_PrivMain::RFL_Object::RXX_Object_Obj15.AyVnce = convertRawToPhysical(raw_value, 0.01, 0.0);

    raw_value=copyBitsFromByteArrayLE( byteArray, 8408, 6);
    @CAN_PrivMain::RFL_Object::RXX_Object_Obj15.ExistProb = convertRawToPhysical(raw_value, 2.0, 0.0);

    raw_value=copyBitsFromByteArrayLE( byteArray, 8472, 8);
    @CAN_PrivMain::RFL_Object::RXX_Object_Obj15.FilterInformation = convertRawToPhysical(raw_value, 1.0, 0.0);

    raw_value=copyBitsFromByteArrayLE( byteArray, 8248, 7);
    @CAN_PrivMain::RFL_Object::RXX_Object_Obj15.Length = convertRawToPhysical(raw_value, 0.125, 0.0);

    raw_value=copyBitsFromByteArrayLE( byteArray, 8256, 12);
    @CAN_PrivMain::RFL_Object::RXX_Object_Obj15.LengthVnce = convertRawToPhysical(raw_value, 0.01, 0.0);

    raw_value=copyBitsFromByteArrayLE( byteArray, 8440, 3);
    @CAN_PrivMain::RFL_Object::RXX_Object_Obj15.MeasurementStatus = convertRawToPhysical(raw_value, 1.0, 0.0);

    raw_value=copyBitsFromByteArrayLE( byteArray, 8396, 2);
    @CAN_PrivMain::RFL_Object::RXX_Object_Obj15.MovingStatus = convertRawToPhysical(raw_value, 1.0, 0.0);

    raw_value=copyBitsFromByteArrayLE( byteArray, 8376, 7);
    @CAN_PrivMain::RFL_Object::RXX_Object_Obj15.ObjId = convertRawToPhysical(raw_value, 1.0, 0.0);

    raw_value=copyBitsFromByteArrayLE( byteArray, 8278, 9);
    @CAN_PrivMain::RFL_Object::RXX_Object_Obj15.OrientationYaw = convertRawToPhysical(raw_value, 0.0175, -4.48);

    raw_value=copyBitsFromByteArrayLE( byteArray, 8300, 12);
    @CAN_PrivMain::RFL_Object::RXX_Object_Obj15.OrientationYawVnce = convertRawToPhysical(raw_value, 0.0003, 0.0);

    raw_value=copyBitsFromByteArrayLE( byteArray, 8192, 6);
    @CAN_PrivMain::RFL_Object::RXX_Object_Obj15.ProbClassConfidence = convertRawToPhysical(raw_value, 2.0, 0.0);

    raw_value=copyBitsFromByteArrayLE( byteArray, 8443, 4);
    @CAN_PrivMain::RFL_Object::RXX_Object_Obj15.ProbClassType = convertRawToPhysical(raw_value, 1.0, 0.0);

    raw_value=copyBitsFromByteArrayLE( byteArray, 8198, 14);
    @CAN_PrivMain::RFL_Object::RXX_Object_Obj15.Px = convertRawToPhysical(raw_value, 0.0625, -512.0);

    raw_value=copyBitsFromByteArrayLE( byteArray, 8512, 12);
    @CAN_PrivMain::RFL_Object::RXX_Object_Obj15.PxAxCoVnce = convertRawToPhysical(raw_value, 0.01, 0.0);

    raw_value=copyBitsFromByteArrayLE( byteArray, 8524, 12);
    @CAN_PrivMain::RFL_Object::RXX_Object_Obj15.PxAyCoVnce = convertRawToPhysical(raw_value, 0.01, 0.0);

    raw_value=copyBitsFromByteArrayLE( byteArray, 8428, 12);
    @CAN_PrivMain::RFL_Object::RXX_Object_Obj15.PxPyCoVnce = convertRawToPhysical(raw_value, 0.01, 0.0);

    raw_value=copyBitsFromByteArrayLE( byteArray, 8212, 12);
    @CAN_PrivMain::RFL_Object::RXX_Object_Obj15.PxVnce = convertRawToPhysical(raw_value, 0.1, 0.0);

    raw_value=copyBitsFromByteArrayLE( byteArray, 8448, 12);
    @CAN_PrivMain::RFL_Object::RXX_Object_Obj15.PxVxCoVnce = convertRawToPhysical(raw_value, 0.01, 0.0);

    raw_value=copyBitsFromByteArrayLE( byteArray, 8460, 12);
    @CAN_PrivMain::RFL_Object::RXX_Object_Obj15.PxVyCoVnce = convertRawToPhysical(raw_value, 0.01, 0.0);

    raw_value=copyBitsFromByteArrayLE( byteArray, 8224, 12);
    @CAN_PrivMain::RFL_Object::RXX_Object_Obj15.Py = convertRawToPhysical(raw_value, 0.0625, -128.0);

    raw_value=copyBitsFromByteArrayLE( byteArray, 8544, 12);
    @CAN_PrivMain::RFL_Object::RXX_Object_Obj15.PyAxCoVnce = convertRawToPhysical(raw_value, 0.01, 0.0);

    raw_value=copyBitsFromByteArrayLE( byteArray, 8556, 12);
    @CAN_PrivMain::RFL_Object::RXX_Object_Obj15.PyAyCoVnce = convertRawToPhysical(raw_value, 0.01, 0.0);

    raw_value=copyBitsFromByteArrayLE( byteArray, 8236, 12);
    @CAN_PrivMain::RFL_Object::RXX_Object_Obj15.PyVnce = convertRawToPhysical(raw_value, 0.1, 0.0);

    raw_value=copyBitsFromByteArrayLE( byteArray, 8480, 12);
    @CAN_PrivMain::RFL_Object::RXX_Object_Obj15.PyVxCoVnce = convertRawToPhysical(raw_value, 0.01, 0.0);

    raw_value=copyBitsFromByteArrayLE( byteArray, 8492, 12);
    @CAN_PrivMain::RFL_Object::RXX_Object_Obj15.PyVyCoVnce = convertRawToPhysical(raw_value, 0.01, 0.0);

    raw_value=copyBitsFromByteArrayLE( byteArray, 8332, 10);
    @CAN_PrivMain::RFL_Object::RXX_Object_Obj15.RCS = convertRawToPhysical(raw_value, 0.2, -102.4);

    raw_value=copyBitsFromByteArrayLE( byteArray, 8504, 4);
    @CAN_PrivMain::RFL_Object::RXX_Object_Obj15.ReferencePoint = convertRawToPhysical(raw_value, 1.0, 0.0);

    raw_value=copyBitsFromByteArrayLE( byteArray, 8364, 12);
    @CAN_PrivMain::RFL_Object::RXX_Object_Obj15.Vx = convertRawToPhysical(raw_value, 0.0625, -128.0);

    raw_value=copyBitsFromByteArrayLE( byteArray, 8588, 12);
    @CAN_PrivMain::RFL_Object::RXX_Object_Obj15.VxAxCoVnce = convertRawToPhysical(raw_value, 0.01, 0.0);

    raw_value=copyBitsFromByteArrayLE( byteArray, 8608, 12);
    @CAN_PrivMain::RFL_Object::RXX_Object_Obj15.VxAyCoVnce = convertRawToPhysical(raw_value, 0.01, 0.0);

    raw_value=copyBitsFromByteArrayLE( byteArray, 8384, 12);
    @CAN_PrivMain::RFL_Object::RXX_Object_Obj15.VxVnce = convertRawToPhysical(raw_value, 0.01, 0.0);

    raw_value=copyBitsFromByteArrayLE( byteArray, 8576, 12);
    @CAN_PrivMain::RFL_Object::RXX_Object_Obj15.VxVyCoVnce = convertRawToPhysical(raw_value, 0.01, 0.0);

    raw_value=copyBitsFromByteArrayLE( byteArray, 8398, 10);
    @CAN_PrivMain::RFL_Object::RXX_Object_Obj15.Vy = convertRawToPhysical(raw_value, 0.125, -64.0);

    raw_value=copyBitsFromByteArrayLE( byteArray, 8620, 12);
    @CAN_PrivMain::RFL_Object::RXX_Object_Obj15.VyAxCoVnce = convertRawToPhysical(raw_value, 0.01, 0.0);

    raw_value=copyBitsFromByteArrayLE( byteArray, 8640, 12);
    @CAN_PrivMain::RFL_Object::RXX_Object_Obj15.VyAyCoVnce = convertRawToPhysical(raw_value, 0.01, 0.0);

    raw_value=copyBitsFromByteArrayLE( byteArray, 8416, 12);
    @CAN_PrivMain::RFL_Object::RXX_Object_Obj15.VyVnce = convertRawToPhysical(raw_value, 0.01, 0.0);

    raw_value=copyBitsFromByteArrayLE( byteArray, 8312, 7);
    @CAN_PrivMain::RFL_Object::RXX_Object_Obj15.Width = convertRawToPhysical(raw_value, 0.125, 0.0);

    raw_value=copyBitsFromByteArrayLE( byteArray, 8320, 12);
    @CAN_PrivMain::RFL_Object::RXX_Object_Obj15.WidthVnce = convertRawToPhysical(raw_value, 0.01, 0.0);
}


void CRadarFL_RXX_Object_Obj16_SetDataReceived(byte byteArray[])
{
    qword raw_value;

    raw_value=copyBitsFromByteArrayLE( byteArray, 9184, 32);
    @CAN_PrivMain::RFL_Object::RXX_Object_Obj16.Age = convertRawToPhysical(raw_value, 1.0, 0.0);

    raw_value=copyBitsFromByteArrayLE( byteArray, 8780, 10);
    @CAN_PrivMain::RFL_Object::RXX_Object_Obj16.Ax = convertRawToPhysical(raw_value, 0.03125, -16.0);

    raw_value=copyBitsFromByteArrayLE( byteArray, 9164, 12);
    @CAN_PrivMain::RFL_Object::RXX_Object_Obj16.AxAyCoVnce = convertRawToPhysical(raw_value, 0.01, 0.0);

    raw_value=copyBitsFromByteArrayLE( byteArray, 8800, 12);
    @CAN_PrivMain::RFL_Object::RXX_Object_Obj16.AxVnce = convertRawToPhysical(raw_value, 0.01, 0.0);

    raw_value=copyBitsFromByteArrayLE( byteArray, 8854, 9);
    @CAN_PrivMain::RFL_Object::RXX_Object_Obj16.Ay = convertRawToPhysical(raw_value, 0.0625, -16.0);

    raw_value=copyBitsFromByteArrayLE( byteArray, 8864, 12);
    @CAN_PrivMain::RFL_Object::RXX_Object_Obj16.AyVnce = convertRawToPhysical(raw_value, 0.01, 0.0);

    raw_value=copyBitsFromByteArrayLE( byteArray, 8920, 6);
    @CAN_PrivMain::RFL_Object::RXX_Object_Obj16.ExistProb = convertRawToPhysical(raw_value, 2.0, 0.0);

    raw_value=copyBitsFromByteArrayLE( byteArray, 8984, 8);
    @CAN_PrivMain::RFL_Object::RXX_Object_Obj16.FilterInformation = convertRawToPhysical(raw_value, 1.0, 0.0);

    raw_value=copyBitsFromByteArrayLE( byteArray, 8760, 7);
    @CAN_PrivMain::RFL_Object::RXX_Object_Obj16.Length = convertRawToPhysical(raw_value, 0.125, 0.0);

    raw_value=copyBitsFromByteArrayLE( byteArray, 8768, 12);
    @CAN_PrivMain::RFL_Object::RXX_Object_Obj16.LengthVnce = convertRawToPhysical(raw_value, 0.01, 0.0);

    raw_value=copyBitsFromByteArrayLE( byteArray, 8952, 3);
    @CAN_PrivMain::RFL_Object::RXX_Object_Obj16.MeasurementStatus = convertRawToPhysical(raw_value, 1.0, 0.0);

    raw_value=copyBitsFromByteArrayLE( byteArray, 8908, 2);
    @CAN_PrivMain::RFL_Object::RXX_Object_Obj16.MovingStatus = convertRawToPhysical(raw_value, 1.0, 0.0);

    raw_value=copyBitsFromByteArrayLE( byteArray, 8888, 7);
    @CAN_PrivMain::RFL_Object::RXX_Object_Obj16.ObjId = convertRawToPhysical(raw_value, 1.0, 0.0);

    raw_value=copyBitsFromByteArrayLE( byteArray, 8790, 9);
    @CAN_PrivMain::RFL_Object::RXX_Object_Obj16.OrientationYaw = convertRawToPhysical(raw_value, 0.0175, -4.48);

    raw_value=copyBitsFromByteArrayLE( byteArray, 8812, 12);
    @CAN_PrivMain::RFL_Object::RXX_Object_Obj16.OrientationYawVnce = convertRawToPhysical(raw_value, 0.0003, 0.0);

    raw_value=copyBitsFromByteArrayLE( byteArray, 8704, 6);
    @CAN_PrivMain::RFL_Object::RXX_Object_Obj16.ProbClassConfidence = convertRawToPhysical(raw_value, 2.0, 0.0);

    raw_value=copyBitsFromByteArrayLE( byteArray, 8955, 4);
    @CAN_PrivMain::RFL_Object::RXX_Object_Obj16.ProbClassType = convertRawToPhysical(raw_value, 1.0, 0.0);

    raw_value=copyBitsFromByteArrayLE( byteArray, 8710, 14);
    @CAN_PrivMain::RFL_Object::RXX_Object_Obj16.Px = convertRawToPhysical(raw_value, 0.0625, -512.0);

    raw_value=copyBitsFromByteArrayLE( byteArray, 9024, 12);
    @CAN_PrivMain::RFL_Object::RXX_Object_Obj16.PxAxCoVnce = convertRawToPhysical(raw_value, 0.01, 0.0);

    raw_value=copyBitsFromByteArrayLE( byteArray, 9036, 12);
    @CAN_PrivMain::RFL_Object::RXX_Object_Obj16.PxAyCoVnce = convertRawToPhysical(raw_value, 0.01, 0.0);

    raw_value=copyBitsFromByteArrayLE( byteArray, 8940, 12);
    @CAN_PrivMain::RFL_Object::RXX_Object_Obj16.PxPyCoVnce = convertRawToPhysical(raw_value, 0.01, 0.0);

    raw_value=copyBitsFromByteArrayLE( byteArray, 8724, 12);
    @CAN_PrivMain::RFL_Object::RXX_Object_Obj16.PxVnce = convertRawToPhysical(raw_value, 0.1, 0.0);

    raw_value=copyBitsFromByteArrayLE( byteArray, 8960, 12);
    @CAN_PrivMain::RFL_Object::RXX_Object_Obj16.PxVxCoVnce = convertRawToPhysical(raw_value, 0.01, 0.0);

    raw_value=copyBitsFromByteArrayLE( byteArray, 8972, 12);
    @CAN_PrivMain::RFL_Object::RXX_Object_Obj16.PxVyCoVnce = convertRawToPhysical(raw_value, 0.01, 0.0);

    raw_value=copyBitsFromByteArrayLE( byteArray, 8736, 12);
    @CAN_PrivMain::RFL_Object::RXX_Object_Obj16.Py = convertRawToPhysical(raw_value, 0.0625, -128.0);

    raw_value=copyBitsFromByteArrayLE( byteArray, 9056, 12);
    @CAN_PrivMain::RFL_Object::RXX_Object_Obj16.PyAxCoVnce = convertRawToPhysical(raw_value, 0.01, 0.0);

    raw_value=copyBitsFromByteArrayLE( byteArray, 9068, 12);
    @CAN_PrivMain::RFL_Object::RXX_Object_Obj16.PyAyCoVnce = convertRawToPhysical(raw_value, 0.01, 0.0);

    raw_value=copyBitsFromByteArrayLE( byteArray, 8748, 12);
    @CAN_PrivMain::RFL_Object::RXX_Object_Obj16.PyVnce = convertRawToPhysical(raw_value, 0.1, 0.0);

    raw_value=copyBitsFromByteArrayLE( byteArray, 8992, 12);
    @CAN_PrivMain::RFL_Object::RXX_Object_Obj16.PyVxCoVnce = convertRawToPhysical(raw_value, 0.01, 0.0);

    raw_value=copyBitsFromByteArrayLE( byteArray, 9004, 12);
    @CAN_PrivMain::RFL_Object::RXX_Object_Obj16.PyVyCoVnce = convertRawToPhysical(raw_value, 0.01, 0.0);

    raw_value=copyBitsFromByteArrayLE( byteArray, 8844, 10);
    @CAN_PrivMain::RFL_Object::RXX_Object_Obj16.RCS = convertRawToPhysical(raw_value, 0.2, -102.4);

    raw_value=copyBitsFromByteArrayLE( byteArray, 9016, 4);
    @CAN_PrivMain::RFL_Object::RXX_Object_Obj16.ReferencePoint = convertRawToPhysical(raw_value, 1.0, 0.0);

    raw_value=copyBitsFromByteArrayLE( byteArray, 8876, 12);
    @CAN_PrivMain::RFL_Object::RXX_Object_Obj16.Vx = convertRawToPhysical(raw_value, 0.0625, -128.0);

    raw_value=copyBitsFromByteArrayLE( byteArray, 9100, 12);
    @CAN_PrivMain::RFL_Object::RXX_Object_Obj16.VxAxCoVnce = convertRawToPhysical(raw_value, 0.01, 0.0);

    raw_value=copyBitsFromByteArrayLE( byteArray, 9120, 12);
    @CAN_PrivMain::RFL_Object::RXX_Object_Obj16.VxAyCoVnce = convertRawToPhysical(raw_value, 0.01, 0.0);

    raw_value=copyBitsFromByteArrayLE( byteArray, 8896, 12);
    @CAN_PrivMain::RFL_Object::RXX_Object_Obj16.VxVnce = convertRawToPhysical(raw_value, 0.01, 0.0);

    raw_value=copyBitsFromByteArrayLE( byteArray, 9088, 12);
    @CAN_PrivMain::RFL_Object::RXX_Object_Obj16.VxVyCoVnce = convertRawToPhysical(raw_value, 0.01, 0.0);

    raw_value=copyBitsFromByteArrayLE( byteArray, 8910, 10);
    @CAN_PrivMain::RFL_Object::RXX_Object_Obj16.Vy = convertRawToPhysical(raw_value, 0.125, -64.0);

    raw_value=copyBitsFromByteArrayLE( byteArray, 9132, 12);
    @CAN_PrivMain::RFL_Object::RXX_Object_Obj16.VyAxCoVnce = convertRawToPhysical(raw_value, 0.01, 0.0);

    raw_value=copyBitsFromByteArrayLE( byteArray, 9152, 12);
    @CAN_PrivMain::RFL_Object::RXX_Object_Obj16.VyAyCoVnce = convertRawToPhysical(raw_value, 0.01, 0.0);

    raw_value=copyBitsFromByteArrayLE( byteArray, 8928, 12);
    @CAN_PrivMain::RFL_Object::RXX_Object_Obj16.VyVnce = convertRawToPhysical(raw_value, 0.01, 0.0);

    raw_value=copyBitsFromByteArrayLE( byteArray, 8824, 7);
    @CAN_PrivMain::RFL_Object::RXX_Object_Obj16.Width = convertRawToPhysical(raw_value, 0.125, 0.0);

    raw_value=copyBitsFromByteArrayLE( byteArray, 8832, 12);
    @CAN_PrivMain::RFL_Object::RXX_Object_Obj16.WidthVnce = convertRawToPhysical(raw_value, 0.01, 0.0);
}


void CRadarFL_RXX_Object_Obj17_SetDataReceived(byte byteArray[])
{
    qword raw_value;

    raw_value=copyBitsFromByteArrayLE( byteArray, 9696, 32);
    @CAN_PrivMain::RFL_Object::RXX_Object_Obj17.Age = convertRawToPhysical(raw_value, 1.0, 0.0);

    raw_value=copyBitsFromByteArrayLE( byteArray, 9292, 10);
    @CAN_PrivMain::RFL_Object::RXX_Object_Obj17.Ax = convertRawToPhysical(raw_value, 0.03125, -16.0);

    raw_value=copyBitsFromByteArrayLE( byteArray, 9676, 12);
    @CAN_PrivMain::RFL_Object::RXX_Object_Obj17.AxAyCoVnce = convertRawToPhysical(raw_value, 0.01, 0.0);

    raw_value=copyBitsFromByteArrayLE( byteArray, 9312, 12);
    @CAN_PrivMain::RFL_Object::RXX_Object_Obj17.AxVnce = convertRawToPhysical(raw_value, 0.01, 0.0);

    raw_value=copyBitsFromByteArrayLE( byteArray, 9366, 9);
    @CAN_PrivMain::RFL_Object::RXX_Object_Obj17.Ay = convertRawToPhysical(raw_value, 0.0625, -16.0);

    raw_value=copyBitsFromByteArrayLE( byteArray, 9376, 12);
    @CAN_PrivMain::RFL_Object::RXX_Object_Obj17.AyVnce = convertRawToPhysical(raw_value, 0.01, 0.0);

    raw_value=copyBitsFromByteArrayLE( byteArray, 9432, 6);
    @CAN_PrivMain::RFL_Object::RXX_Object_Obj17.ExistProb = convertRawToPhysical(raw_value, 2.0, 0.0);

    raw_value=copyBitsFromByteArrayLE( byteArray, 9496, 8);
    @CAN_PrivMain::RFL_Object::RXX_Object_Obj17.FilterInformation = convertRawToPhysical(raw_value, 1.0, 0.0);

    raw_value=copyBitsFromByteArrayLE( byteArray, 9272, 7);
    @CAN_PrivMain::RFL_Object::RXX_Object_Obj17.Length = convertRawToPhysical(raw_value, 0.125, 0.0);

    raw_value=copyBitsFromByteArrayLE( byteArray, 9280, 12);
    @CAN_PrivMain::RFL_Object::RXX_Object_Obj17.LengthVnce = convertRawToPhysical(raw_value, 0.01, 0.0);

    raw_value=copyBitsFromByteArrayLE( byteArray, 9464, 3);
    @CAN_PrivMain::RFL_Object::RXX_Object_Obj17.MeasurementStatus = convertRawToPhysical(raw_value, 1.0, 0.0);

    raw_value=copyBitsFromByteArrayLE( byteArray, 9420, 2);
    @CAN_PrivMain::RFL_Object::RXX_Object_Obj17.MovingStatus = convertRawToPhysical(raw_value, 1.0, 0.0);

    raw_value=copyBitsFromByteArrayLE( byteArray, 9400, 7);
    @CAN_PrivMain::RFL_Object::RXX_Object_Obj17.ObjId = convertRawToPhysical(raw_value, 1.0, 0.0);

    raw_value=copyBitsFromByteArrayLE( byteArray, 9302, 9);
    @CAN_PrivMain::RFL_Object::RXX_Object_Obj17.OrientationYaw = convertRawToPhysical(raw_value, 0.0175, -4.48);

    raw_value=copyBitsFromByteArrayLE( byteArray, 9324, 12);
    @CAN_PrivMain::RFL_Object::RXX_Object_Obj17.OrientationYawVnce = convertRawToPhysical(raw_value, 0.0003, 0.0);

    raw_value=copyBitsFromByteArrayLE( byteArray, 9216, 6);
    @CAN_PrivMain::RFL_Object::RXX_Object_Obj17.ProbClassConfidence = convertRawToPhysical(raw_value, 2.0, 0.0);

    raw_value=copyBitsFromByteArrayLE( byteArray, 9467, 4);
    @CAN_PrivMain::RFL_Object::RXX_Object_Obj17.ProbClassType = convertRawToPhysical(raw_value, 1.0, 0.0);

    raw_value=copyBitsFromByteArrayLE( byteArray, 9222, 14);
    @CAN_PrivMain::RFL_Object::RXX_Object_Obj17.Px = convertRawToPhysical(raw_value, 0.0625, -512.0);

    raw_value=copyBitsFromByteArrayLE( byteArray, 9536, 12);
    @CAN_PrivMain::RFL_Object::RXX_Object_Obj17.PxAxCoVnce = convertRawToPhysical(raw_value, 0.01, 0.0);

    raw_value=copyBitsFromByteArrayLE( byteArray, 9548, 12);
    @CAN_PrivMain::RFL_Object::RXX_Object_Obj17.PxAyCoVnce = convertRawToPhysical(raw_value, 0.01, 0.0);

    raw_value=copyBitsFromByteArrayLE( byteArray, 9452, 12);
    @CAN_PrivMain::RFL_Object::RXX_Object_Obj17.PxPyCoVnce = convertRawToPhysical(raw_value, 0.01, 0.0);

    raw_value=copyBitsFromByteArrayLE( byteArray, 9236, 12);
    @CAN_PrivMain::RFL_Object::RXX_Object_Obj17.PxVnce = convertRawToPhysical(raw_value, 0.1, 0.0);

    raw_value=copyBitsFromByteArrayLE( byteArray, 9472, 12);
    @CAN_PrivMain::RFL_Object::RXX_Object_Obj17.PxVxCoVnce = convertRawToPhysical(raw_value, 0.01, 0.0);

    raw_value=copyBitsFromByteArrayLE( byteArray, 9484, 12);
    @CAN_PrivMain::RFL_Object::RXX_Object_Obj17.PxVyCoVnce = convertRawToPhysical(raw_value, 0.01, 0.0);

    raw_value=copyBitsFromByteArrayLE( byteArray, 9248, 12);
    @CAN_PrivMain::RFL_Object::RXX_Object_Obj17.Py = convertRawToPhysical(raw_value, 0.0625, -128.0);

    raw_value=copyBitsFromByteArrayLE( byteArray, 9568, 12);
    @CAN_PrivMain::RFL_Object::RXX_Object_Obj17.PyAxCoVnce = convertRawToPhysical(raw_value, 0.01, 0.0);

    raw_value=copyBitsFromByteArrayLE( byteArray, 9580, 12);
    @CAN_PrivMain::RFL_Object::RXX_Object_Obj17.PyAyCoVnce = convertRawToPhysical(raw_value, 0.01, 0.0);

    raw_value=copyBitsFromByteArrayLE( byteArray, 9260, 12);
    @CAN_PrivMain::RFL_Object::RXX_Object_Obj17.PyVnce = convertRawToPhysical(raw_value, 0.1, 0.0);

    raw_value=copyBitsFromByteArrayLE( byteArray, 9504, 12);
    @CAN_PrivMain::RFL_Object::RXX_Object_Obj17.PyVxCoVnce = convertRawToPhysical(raw_value, 0.01, 0.0);

    raw_value=copyBitsFromByteArrayLE( byteArray, 9516, 12);
    @CAN_PrivMain::RFL_Object::RXX_Object_Obj17.PyVyCoVnce = convertRawToPhysical(raw_value, 0.01, 0.0);

    raw_value=copyBitsFromByteArrayLE( byteArray, 9356, 10);
    @CAN_PrivMain::RFL_Object::RXX_Object_Obj17.RCS = convertRawToPhysical(raw_value, 0.2, -102.4);

    raw_value=copyBitsFromByteArrayLE( byteArray, 9528, 4);
    @CAN_PrivMain::RFL_Object::RXX_Object_Obj17.ReferencePoint = convertRawToPhysical(raw_value, 1.0, 0.0);

    raw_value=copyBitsFromByteArrayLE( byteArray, 9388, 12);
    @CAN_PrivMain::RFL_Object::RXX_Object_Obj17.Vx = convertRawToPhysical(raw_value, 0.0625, -128.0);

    raw_value=copyBitsFromByteArrayLE( byteArray, 9612, 12);
    @CAN_PrivMain::RFL_Object::RXX_Object_Obj17.VxAxCoVnce = convertRawToPhysical(raw_value, 0.01, 0.0);

    raw_value=copyBitsFromByteArrayLE( byteArray, 9632, 12);
    @CAN_PrivMain::RFL_Object::RXX_Object_Obj17.VxAyCoVnce = convertRawToPhysical(raw_value, 0.01, 0.0);

    raw_value=copyBitsFromByteArrayLE( byteArray, 9408, 12);
    @CAN_PrivMain::RFL_Object::RXX_Object_Obj17.VxVnce = convertRawToPhysical(raw_value, 0.01, 0.0);

    raw_value=copyBitsFromByteArrayLE( byteArray, 9600, 12);
    @CAN_PrivMain::RFL_Object::RXX_Object_Obj17.VxVyCoVnce = convertRawToPhysical(raw_value, 0.01, 0.0);

    raw_value=copyBitsFromByteArrayLE( byteArray, 9422, 10);
    @CAN_PrivMain::RFL_Object::RXX_Object_Obj17.Vy = convertRawToPhysical(raw_value, 0.125, -64.0);

    raw_value=copyBitsFromByteArrayLE( byteArray, 9644, 12);
    @CAN_PrivMain::RFL_Object::RXX_Object_Obj17.VyAxCoVnce = convertRawToPhysical(raw_value, 0.01, 0.0);

    raw_value=copyBitsFromByteArrayLE( byteArray, 9664, 12);
    @CAN_PrivMain::RFL_Object::RXX_Object_Obj17.VyAyCoVnce = convertRawToPhysical(raw_value, 0.01, 0.0);

    raw_value=copyBitsFromByteArrayLE( byteArray, 9440, 12);
    @CAN_PrivMain::RFL_Object::RXX_Object_Obj17.VyVnce = convertRawToPhysical(raw_value, 0.01, 0.0);

    raw_value=copyBitsFromByteArrayLE( byteArray, 9336, 7);
    @CAN_PrivMain::RFL_Object::RXX_Object_Obj17.Width = convertRawToPhysical(raw_value, 0.125, 0.0);

    raw_value=copyBitsFromByteArrayLE( byteArray, 9344, 12);
    @CAN_PrivMain::RFL_Object::RXX_Object_Obj17.WidthVnce = convertRawToPhysical(raw_value, 0.01, 0.0);
}


void CRadarFL_RXX_Object_Obj18_SetDataReceived(byte byteArray[])
{
    qword raw_value;

    raw_value=copyBitsFromByteArrayLE( byteArray, 10208, 32);
    @CAN_PrivMain::RFL_Object::RXX_Object_Obj18.Age = convertRawToPhysical(raw_value, 1.0, 0.0);

    raw_value=copyBitsFromByteArrayLE( byteArray, 9804, 10);
    @CAN_PrivMain::RFL_Object::RXX_Object_Obj18.Ax = convertRawToPhysical(raw_value, 0.03125, -16.0);

    raw_value=copyBitsFromByteArrayLE( byteArray, 10188, 12);
    @CAN_PrivMain::RFL_Object::RXX_Object_Obj18.AxAyCoVnce = convertRawToPhysical(raw_value, 0.01, 0.0);

    raw_value=copyBitsFromByteArrayLE( byteArray, 9824, 12);
    @CAN_PrivMain::RFL_Object::RXX_Object_Obj18.AxVnce = convertRawToPhysical(raw_value, 0.01, 0.0);

    raw_value=copyBitsFromByteArrayLE( byteArray, 9878, 9);
    @CAN_PrivMain::RFL_Object::RXX_Object_Obj18.Ay = convertRawToPhysical(raw_value, 0.0625, -16.0);

    raw_value=copyBitsFromByteArrayLE( byteArray, 9888, 12);
    @CAN_PrivMain::RFL_Object::RXX_Object_Obj18.AyVnce = convertRawToPhysical(raw_value, 0.01, 0.0);

    raw_value=copyBitsFromByteArrayLE( byteArray, 9944, 6);
    @CAN_PrivMain::RFL_Object::RXX_Object_Obj18.ExistProb = convertRawToPhysical(raw_value, 2.0, 0.0);

    raw_value=copyBitsFromByteArrayLE( byteArray, 10008, 8);
    @CAN_PrivMain::RFL_Object::RXX_Object_Obj18.FilterInformation = convertRawToPhysical(raw_value, 1.0, 0.0);

    raw_value=copyBitsFromByteArrayLE( byteArray, 9784, 7);
    @CAN_PrivMain::RFL_Object::RXX_Object_Obj18.Length = convertRawToPhysical(raw_value, 0.125, 0.0);

    raw_value=copyBitsFromByteArrayLE( byteArray, 9792, 12);
    @CAN_PrivMain::RFL_Object::RXX_Object_Obj18.LengthVnce = convertRawToPhysical(raw_value, 0.01, 0.0);

    raw_value=copyBitsFromByteArrayLE( byteArray, 9976, 3);
    @CAN_PrivMain::RFL_Object::RXX_Object_Obj18.MeasurementStatus = convertRawToPhysical(raw_value, 1.0, 0.0);

    raw_value=copyBitsFromByteArrayLE( byteArray, 9932, 2);
    @CAN_PrivMain::RFL_Object::RXX_Object_Obj18.MovingStatus = convertRawToPhysical(raw_value, 1.0, 0.0);

    raw_value=copyBitsFromByteArrayLE( byteArray, 9912, 7);
    @CAN_PrivMain::RFL_Object::RXX_Object_Obj18.ObjId = convertRawToPhysical(raw_value, 1.0, 0.0);

    raw_value=copyBitsFromByteArrayLE( byteArray, 9814, 9);
    @CAN_PrivMain::RFL_Object::RXX_Object_Obj18.OrientationYaw = convertRawToPhysical(raw_value, 0.0175, -4.48);

    raw_value=copyBitsFromByteArrayLE( byteArray, 9836, 12);
    @CAN_PrivMain::RFL_Object::RXX_Object_Obj18.OrientationYawVnce = convertRawToPhysical(raw_value, 0.0003, 0.0);

    raw_value=copyBitsFromByteArrayLE( byteArray, 9728, 6);
    @CAN_PrivMain::RFL_Object::RXX_Object_Obj18.ProbClassConfidence = convertRawToPhysical(raw_value, 2.0, 0.0);

    raw_value=copyBitsFromByteArrayLE( byteArray, 9979, 4);
    @CAN_PrivMain::RFL_Object::RXX_Object_Obj18.ProbClassType = convertRawToPhysical(raw_value, 1.0, 0.0);

    raw_value=copyBitsFromByteArrayLE( byteArray, 9734, 14);
    @CAN_PrivMain::RFL_Object::RXX_Object_Obj18.Px = convertRawToPhysical(raw_value, 0.0625, -512.0);

    raw_value=copyBitsFromByteArrayLE( byteArray, 10048, 12);
    @CAN_PrivMain::RFL_Object::RXX_Object_Obj18.PxAxCoVnce = convertRawToPhysical(raw_value, 0.01, 0.0);

    raw_value=copyBitsFromByteArrayLE( byteArray, 10060, 12);
    @CAN_PrivMain::RFL_Object::RXX_Object_Obj18.PxAyCoVnce = convertRawToPhysical(raw_value, 0.01, 0.0);

    raw_value=copyBitsFromByteArrayLE( byteArray, 9964, 12);
    @CAN_PrivMain::RFL_Object::RXX_Object_Obj18.PxPyCoVnce = convertRawToPhysical(raw_value, 0.01, 0.0);

    raw_value=copyBitsFromByteArrayLE( byteArray, 9748, 12);
    @CAN_PrivMain::RFL_Object::RXX_Object_Obj18.PxVnce = convertRawToPhysical(raw_value, 0.1, 0.0);

    raw_value=copyBitsFromByteArrayLE( byteArray, 9984, 12);
    @CAN_PrivMain::RFL_Object::RXX_Object_Obj18.PxVxCoVnce = convertRawToPhysical(raw_value, 0.01, 0.0);

    raw_value=copyBitsFromByteArrayLE( byteArray, 9996, 12);
    @CAN_PrivMain::RFL_Object::RXX_Object_Obj18.PxVyCoVnce = convertRawToPhysical(raw_value, 0.01, 0.0);

    raw_value=copyBitsFromByteArrayLE( byteArray, 9760, 12);
    @CAN_PrivMain::RFL_Object::RXX_Object_Obj18.Py = convertRawToPhysical(raw_value, 0.0625, -128.0);

    raw_value=copyBitsFromByteArrayLE( byteArray, 10080, 12);
    @CAN_PrivMain::RFL_Object::RXX_Object_Obj18.PyAxCoVnce = convertRawToPhysical(raw_value, 0.01, 0.0);

    raw_value=copyBitsFromByteArrayLE( byteArray, 10092, 12);
    @CAN_PrivMain::RFL_Object::RXX_Object_Obj18.PyAyCoVnce = convertRawToPhysical(raw_value, 0.01, 0.0);

    raw_value=copyBitsFromByteArrayLE( byteArray, 9772, 12);
    @CAN_PrivMain::RFL_Object::RXX_Object_Obj18.PyVnce = convertRawToPhysical(raw_value, 0.1, 0.0);

    raw_value=copyBitsFromByteArrayLE( byteArray, 10016, 12);
    @CAN_PrivMain::RFL_Object::RXX_Object_Obj18.PyVxCoVnce = convertRawToPhysical(raw_value, 0.01, 0.0);

    raw_value=copyBitsFromByteArrayLE( byteArray, 10028, 12);
    @CAN_PrivMain::RFL_Object::RXX_Object_Obj18.PyVyCoVnce = convertRawToPhysical(raw_value, 0.01, 0.0);

    raw_value=copyBitsFromByteArrayLE( byteArray, 9868, 10);
    @CAN_PrivMain::RFL_Object::RXX_Object_Obj18.RCS = convertRawToPhysical(raw_value, 0.2, -102.4);

    raw_value=copyBitsFromByteArrayLE( byteArray, 10040, 4);
    @CAN_PrivMain::RFL_Object::RXX_Object_Obj18.ReferencePoint = convertRawToPhysical(raw_value, 1.0, 0.0);

    raw_value=copyBitsFromByteArrayLE( byteArray, 9900, 12);
    @CAN_PrivMain::RFL_Object::RXX_Object_Obj18.Vx = convertRawToPhysical(raw_value, 0.0625, -128.0);

    raw_value=copyBitsFromByteArrayLE( byteArray, 10124, 12);
    @CAN_PrivMain::RFL_Object::RXX_Object_Obj18.VxAxCoVnce = convertRawToPhysical(raw_value, 0.01, 0.0);

    raw_value=copyBitsFromByteArrayLE( byteArray, 10144, 12);
    @CAN_PrivMain::RFL_Object::RXX_Object_Obj18.VxAyCoVnce = convertRawToPhysical(raw_value, 0.01, 0.0);

    raw_value=copyBitsFromByteArrayLE( byteArray, 9920, 12);
    @CAN_PrivMain::RFL_Object::RXX_Object_Obj18.VxVnce = convertRawToPhysical(raw_value, 0.01, 0.0);

    raw_value=copyBitsFromByteArrayLE( byteArray, 10112, 12);
    @CAN_PrivMain::RFL_Object::RXX_Object_Obj18.VxVyCoVnce = convertRawToPhysical(raw_value, 0.01, 0.0);

    raw_value=copyBitsFromByteArrayLE( byteArray, 9934, 10);
    @CAN_PrivMain::RFL_Object::RXX_Object_Obj18.Vy = convertRawToPhysical(raw_value, 0.125, -64.0);

    raw_value=copyBitsFromByteArrayLE( byteArray, 10156, 12);
    @CAN_PrivMain::RFL_Object::RXX_Object_Obj18.VyAxCoVnce = convertRawToPhysical(raw_value, 0.01, 0.0);

    raw_value=copyBitsFromByteArrayLE( byteArray, 10176, 12);
    @CAN_PrivMain::RFL_Object::RXX_Object_Obj18.VyAyCoVnce = convertRawToPhysical(raw_value, 0.01, 0.0);

    raw_value=copyBitsFromByteArrayLE( byteArray, 9952, 12);
    @CAN_PrivMain::RFL_Object::RXX_Object_Obj18.VyVnce = convertRawToPhysical(raw_value, 0.01, 0.0);

    raw_value=copyBitsFromByteArrayLE( byteArray, 9848, 7);
    @CAN_PrivMain::RFL_Object::RXX_Object_Obj18.Width = convertRawToPhysical(raw_value, 0.125, 0.0);

    raw_value=copyBitsFromByteArrayLE( byteArray, 9856, 12);
    @CAN_PrivMain::RFL_Object::RXX_Object_Obj18.WidthVnce = convertRawToPhysical(raw_value, 0.01, 0.0);
}


void CRadarFL_RXX_Object_Obj19_SetDataReceived(byte byteArray[])
{
    qword raw_value;

    raw_value=copyBitsFromByteArrayLE( byteArray, 10720, 32);
    @CAN_PrivMain::RFL_Object::RXX_Object_Obj19.Age = convertRawToPhysical(raw_value, 1.0, 0.0);

    raw_value=copyBitsFromByteArrayLE( byteArray, 10316, 10);
    @CAN_PrivMain::RFL_Object::RXX_Object_Obj19.Ax = convertRawToPhysical(raw_value, 0.03125, -16.0);

    raw_value=copyBitsFromByteArrayLE( byteArray, 10700, 12);
    @CAN_PrivMain::RFL_Object::RXX_Object_Obj19.AxAyCoVnce = convertRawToPhysical(raw_value, 0.01, 0.0);

    raw_value=copyBitsFromByteArrayLE( byteArray, 10336, 12);
    @CAN_PrivMain::RFL_Object::RXX_Object_Obj19.AxVnce = convertRawToPhysical(raw_value, 0.01, 0.0);

    raw_value=copyBitsFromByteArrayLE( byteArray, 10390, 9);
    @CAN_PrivMain::RFL_Object::RXX_Object_Obj19.Ay = convertRawToPhysical(raw_value, 0.0625, -16.0);

    raw_value=copyBitsFromByteArrayLE( byteArray, 10400, 12);
    @CAN_PrivMain::RFL_Object::RXX_Object_Obj19.AyVnce = convertRawToPhysical(raw_value, 0.01, 0.0);

    raw_value=copyBitsFromByteArrayLE( byteArray, 10456, 6);
    @CAN_PrivMain::RFL_Object::RXX_Object_Obj19.ExistProb = convertRawToPhysical(raw_value, 2.0, 0.0);

    raw_value=copyBitsFromByteArrayLE( byteArray, 10520, 8);
    @CAN_PrivMain::RFL_Object::RXX_Object_Obj19.FilterInformation = convertRawToPhysical(raw_value, 1.0, 0.0);

    raw_value=copyBitsFromByteArrayLE( byteArray, 10296, 7);
    @CAN_PrivMain::RFL_Object::RXX_Object_Obj19.Length = convertRawToPhysical(raw_value, 0.125, 0.0);

    raw_value=copyBitsFromByteArrayLE( byteArray, 10304, 12);
    @CAN_PrivMain::RFL_Object::RXX_Object_Obj19.LengthVnce = convertRawToPhysical(raw_value, 0.01, 0.0);

    raw_value=copyBitsFromByteArrayLE( byteArray, 10488, 3);
    @CAN_PrivMain::RFL_Object::RXX_Object_Obj19.MeasurementStatus = convertRawToPhysical(raw_value, 1.0, 0.0);

    raw_value=copyBitsFromByteArrayLE( byteArray, 10444, 2);
    @CAN_PrivMain::RFL_Object::RXX_Object_Obj19.MovingStatus = convertRawToPhysical(raw_value, 1.0, 0.0);

    raw_value=copyBitsFromByteArrayLE( byteArray, 10424, 7);
    @CAN_PrivMain::RFL_Object::RXX_Object_Obj19.ObjId = convertRawToPhysical(raw_value, 1.0, 0.0);

    raw_value=copyBitsFromByteArrayLE( byteArray, 10326, 9);
    @CAN_PrivMain::RFL_Object::RXX_Object_Obj19.OrientationYaw = convertRawToPhysical(raw_value, 0.0175, -4.48);

    raw_value=copyBitsFromByteArrayLE( byteArray, 10348, 12);
    @CAN_PrivMain::RFL_Object::RXX_Object_Obj19.OrientationYawVnce = convertRawToPhysical(raw_value, 0.0003, 0.0);

    raw_value=copyBitsFromByteArrayLE( byteArray, 10240, 6);
    @CAN_PrivMain::RFL_Object::RXX_Object_Obj19.ProbClassConfidence = convertRawToPhysical(raw_value, 2.0, 0.0);

    raw_value=copyBitsFromByteArrayLE( byteArray, 10491, 4);
    @CAN_PrivMain::RFL_Object::RXX_Object_Obj19.ProbClassType = convertRawToPhysical(raw_value, 1.0, 0.0);

    raw_value=copyBitsFromByteArrayLE( byteArray, 10246, 14);
    @CAN_PrivMain::RFL_Object::RXX_Object_Obj19.Px = convertRawToPhysical(raw_value, 0.0625, -512.0);

    raw_value=copyBitsFromByteArrayLE( byteArray, 10560, 12);
    @CAN_PrivMain::RFL_Object::RXX_Object_Obj19.PxAxCoVnce = convertRawToPhysical(raw_value, 0.01, 0.0);

    raw_value=copyBitsFromByteArrayLE( byteArray, 10572, 12);
    @CAN_PrivMain::RFL_Object::RXX_Object_Obj19.PxAyCoVnce = convertRawToPhysical(raw_value, 0.01, 0.0);

    raw_value=copyBitsFromByteArrayLE( byteArray, 10476, 12);
    @CAN_PrivMain::RFL_Object::RXX_Object_Obj19.PxPyCoVnce = convertRawToPhysical(raw_value, 0.01, 0.0);

    raw_value=copyBitsFromByteArrayLE( byteArray, 10260, 12);
    @CAN_PrivMain::RFL_Object::RXX_Object_Obj19.PxVnce = convertRawToPhysical(raw_value, 0.1, 0.0);

    raw_value=copyBitsFromByteArrayLE( byteArray, 10496, 12);
    @CAN_PrivMain::RFL_Object::RXX_Object_Obj19.PxVxCoVnce = convertRawToPhysical(raw_value, 0.01, 0.0);

    raw_value=copyBitsFromByteArrayLE( byteArray, 10508, 12);
    @CAN_PrivMain::RFL_Object::RXX_Object_Obj19.PxVyCoVnce = convertRawToPhysical(raw_value, 0.01, 0.0);

    raw_value=copyBitsFromByteArrayLE( byteArray, 10272, 12);
    @CAN_PrivMain::RFL_Object::RXX_Object_Obj19.Py = convertRawToPhysical(raw_value, 0.0625, -128.0);

    raw_value=copyBitsFromByteArrayLE( byteArray, 10592, 12);
    @CAN_PrivMain::RFL_Object::RXX_Object_Obj19.PyAxCoVnce = convertRawToPhysical(raw_value, 0.01, 0.0);

    raw_value=copyBitsFromByteArrayLE( byteArray, 10604, 12);
    @CAN_PrivMain::RFL_Object::RXX_Object_Obj19.PyAyCoVnce = convertRawToPhysical(raw_value, 0.01, 0.0);

    raw_value=copyBitsFromByteArrayLE( byteArray, 10284, 12);
    @CAN_PrivMain::RFL_Object::RXX_Object_Obj19.PyVnce = convertRawToPhysical(raw_value, 0.1, 0.0);

    raw_value=copyBitsFromByteArrayLE( byteArray, 10528, 12);
    @CAN_PrivMain::RFL_Object::RXX_Object_Obj19.PyVxCoVnce = convertRawToPhysical(raw_value, 0.01, 0.0);

    raw_value=copyBitsFromByteArrayLE( byteArray, 10540, 12);
    @CAN_PrivMain::RFL_Object::RXX_Object_Obj19.PyVyCoVnce = convertRawToPhysical(raw_value, 0.01, 0.0);

    raw_value=copyBitsFromByteArrayLE( byteArray, 10380, 10);
    @CAN_PrivMain::RFL_Object::RXX_Object_Obj19.RCS = convertRawToPhysical(raw_value, 0.2, -102.4);

    raw_value=copyBitsFromByteArrayLE( byteArray, 10552, 4);
    @CAN_PrivMain::RFL_Object::RXX_Object_Obj19.ReferencePoint = convertRawToPhysical(raw_value, 1.0, 0.0);

    raw_value=copyBitsFromByteArrayLE( byteArray, 10412, 12);
    @CAN_PrivMain::RFL_Object::RXX_Object_Obj19.Vx = convertRawToPhysical(raw_value, 0.0625, -128.0);

    raw_value=copyBitsFromByteArrayLE( byteArray, 10636, 12);
    @CAN_PrivMain::RFL_Object::RXX_Object_Obj19.VxAxCoVnce = convertRawToPhysical(raw_value, 0.01, 0.0);

    raw_value=copyBitsFromByteArrayLE( byteArray, 10656, 12);
    @CAN_PrivMain::RFL_Object::RXX_Object_Obj19.VxAyCoVnce = convertRawToPhysical(raw_value, 0.01, 0.0);

    raw_value=copyBitsFromByteArrayLE( byteArray, 10432, 12);
    @CAN_PrivMain::RFL_Object::RXX_Object_Obj19.VxVnce = convertRawToPhysical(raw_value, 0.01, 0.0);

    raw_value=copyBitsFromByteArrayLE( byteArray, 10624, 12);
    @CAN_PrivMain::RFL_Object::RXX_Object_Obj19.VxVyCoVnce = convertRawToPhysical(raw_value, 0.01, 0.0);

    raw_value=copyBitsFromByteArrayLE( byteArray, 10446, 10);
    @CAN_PrivMain::RFL_Object::RXX_Object_Obj19.Vy = convertRawToPhysical(raw_value, 0.125, -64.0);

    raw_value=copyBitsFromByteArrayLE( byteArray, 10668, 12);
    @CAN_PrivMain::RFL_Object::RXX_Object_Obj19.VyAxCoVnce = convertRawToPhysical(raw_value, 0.01, 0.0);

    raw_value=copyBitsFromByteArrayLE( byteArray, 10688, 12);
    @CAN_PrivMain::RFL_Object::RXX_Object_Obj19.VyAyCoVnce = convertRawToPhysical(raw_value, 0.01, 0.0);

    raw_value=copyBitsFromByteArrayLE( byteArray, 10464, 12);
    @CAN_PrivMain::RFL_Object::RXX_Object_Obj19.VyVnce = convertRawToPhysical(raw_value, 0.01, 0.0);

    raw_value=copyBitsFromByteArrayLE( byteArray, 10360, 7);
    @CAN_PrivMain::RFL_Object::RXX_Object_Obj19.Width = convertRawToPhysical(raw_value, 0.125, 0.0);

    raw_value=copyBitsFromByteArrayLE( byteArray, 10368, 12);
    @CAN_PrivMain::RFL_Object::RXX_Object_Obj19.WidthVnce = convertRawToPhysical(raw_value, 0.01, 0.0);
}


void CRadarFL_RXX_Object_Obj2_SetDataReceived(byte byteArray[])
{
    qword raw_value;

    raw_value=copyBitsFromByteArrayLE( byteArray, 2016, 32);
    @CAN_PrivMain::RFL_Object::RXX_Object_Obj2.Age = convertRawToPhysical(raw_value, 1.0, 0.0);

    raw_value=copyBitsFromByteArrayLE( byteArray, 1612, 10);
    @CAN_PrivMain::RFL_Object::RXX_Object_Obj2.Ax = convertRawToPhysical(raw_value, 0.03125, -16.0);

    raw_value=copyBitsFromByteArrayLE( byteArray, 1996, 12);
    @CAN_PrivMain::RFL_Object::RXX_Object_Obj2.AxAyCoVnce = convertRawToPhysical(raw_value, 0.01, 0.0);

    raw_value=copyBitsFromByteArrayLE( byteArray, 1632, 12);
    @CAN_PrivMain::RFL_Object::RXX_Object_Obj2.AxVnce = convertRawToPhysical(raw_value, 0.01, 0.0);

    raw_value=copyBitsFromByteArrayLE( byteArray, 1686, 9);
    @CAN_PrivMain::RFL_Object::RXX_Object_Obj2.Ay = convertRawToPhysical(raw_value, 0.0625, -16.0);

    raw_value=copyBitsFromByteArrayLE( byteArray, 1696, 12);
    @CAN_PrivMain::RFL_Object::RXX_Object_Obj2.AyVnce = convertRawToPhysical(raw_value, 0.01, 0.0);

    raw_value=copyBitsFromByteArrayLE( byteArray, 1752, 6);
    @CAN_PrivMain::RFL_Object::RXX_Object_Obj2.ExistProb = convertRawToPhysical(raw_value, 2.0, 0.0);

    raw_value=copyBitsFromByteArrayLE( byteArray, 1816, 8);
    @CAN_PrivMain::RFL_Object::RXX_Object_Obj2.FilterInformation = convertRawToPhysical(raw_value, 1.0, 0.0);

    raw_value=copyBitsFromByteArrayLE( byteArray, 1592, 7);
    @CAN_PrivMain::RFL_Object::RXX_Object_Obj2.Length = convertRawToPhysical(raw_value, 0.125, 0.0);

    raw_value=copyBitsFromByteArrayLE( byteArray, 1600, 12);
    @CAN_PrivMain::RFL_Object::RXX_Object_Obj2.LengthVnce = convertRawToPhysical(raw_value, 0.01, 0.0);

    raw_value=copyBitsFromByteArrayLE( byteArray, 1784, 3);
    @CAN_PrivMain::RFL_Object::RXX_Object_Obj2.MeasurementStatus = convertRawToPhysical(raw_value, 1.0, 0.0);

    raw_value=copyBitsFromByteArrayLE( byteArray, 1740, 2);
    @CAN_PrivMain::RFL_Object::RXX_Object_Obj2.MovingStatus = convertRawToPhysical(raw_value, 1.0, 0.0);

    raw_value=copyBitsFromByteArrayLE( byteArray, 1720, 7);
    @CAN_PrivMain::RFL_Object::RXX_Object_Obj2.ObjId = convertRawToPhysical(raw_value, 1.0, 0.0);

    raw_value=copyBitsFromByteArrayLE( byteArray, 1622, 9);
    @CAN_PrivMain::RFL_Object::RXX_Object_Obj2.OrientationYaw = convertRawToPhysical(raw_value, 0.0175, -4.48);

    raw_value=copyBitsFromByteArrayLE( byteArray, 1644, 12);
    @CAN_PrivMain::RFL_Object::RXX_Object_Obj2.OrientationYawVnce = convertRawToPhysical(raw_value, 0.0003, 0.0);

    raw_value=copyBitsFromByteArrayLE( byteArray, 1536, 6);
    @CAN_PrivMain::RFL_Object::RXX_Object_Obj2.ProbClassConfidence = convertRawToPhysical(raw_value, 2.0, 0.0);

    raw_value=copyBitsFromByteArrayLE( byteArray, 1787, 4);
    @CAN_PrivMain::RFL_Object::RXX_Object_Obj2.ProbClassType = convertRawToPhysical(raw_value, 1.0, 0.0);

    raw_value=copyBitsFromByteArrayLE( byteArray, 1542, 14);
    @CAN_PrivMain::RFL_Object::RXX_Object_Obj2.Px = convertRawToPhysical(raw_value, 0.0625, -512.0);

    raw_value=copyBitsFromByteArrayLE( byteArray, 1856, 12);
    @CAN_PrivMain::RFL_Object::RXX_Object_Obj2.PxAxCoVnce = convertRawToPhysical(raw_value, 0.01, 0.0);

    raw_value=copyBitsFromByteArrayLE( byteArray, 1868, 12);
    @CAN_PrivMain::RFL_Object::RXX_Object_Obj2.PxAyCoVnce = convertRawToPhysical(raw_value, 0.01, 0.0);

    raw_value=copyBitsFromByteArrayLE( byteArray, 1772, 12);
    @CAN_PrivMain::RFL_Object::RXX_Object_Obj2.PxPyCoVnce = convertRawToPhysical(raw_value, 0.01, 0.0);

    raw_value=copyBitsFromByteArrayLE( byteArray, 1556, 12);
    @CAN_PrivMain::RFL_Object::RXX_Object_Obj2.PxVnce = convertRawToPhysical(raw_value, 0.1, 0.0);

    raw_value=copyBitsFromByteArrayLE( byteArray, 1792, 12);
    @CAN_PrivMain::RFL_Object::RXX_Object_Obj2.PxVxCoVnce = convertRawToPhysical(raw_value, 0.01, 0.0);

    raw_value=copyBitsFromByteArrayLE( byteArray, 1804, 12);
    @CAN_PrivMain::RFL_Object::RXX_Object_Obj2.PxVyCoVnce = convertRawToPhysical(raw_value, 0.01, 0.0);

    raw_value=copyBitsFromByteArrayLE( byteArray, 1568, 12);
    @CAN_PrivMain::RFL_Object::RXX_Object_Obj2.Py = convertRawToPhysical(raw_value, 0.0625, -128.0);

    raw_value=copyBitsFromByteArrayLE( byteArray, 1888, 12);
    @CAN_PrivMain::RFL_Object::RXX_Object_Obj2.PyAxCoVnce = convertRawToPhysical(raw_value, 0.01, 0.0);

    raw_value=copyBitsFromByteArrayLE( byteArray, 1900, 12);
    @CAN_PrivMain::RFL_Object::RXX_Object_Obj2.PyAyCoVnce = convertRawToPhysical(raw_value, 0.01, 0.0);

    raw_value=copyBitsFromByteArrayLE( byteArray, 1580, 12);
    @CAN_PrivMain::RFL_Object::RXX_Object_Obj2.PyVnce = convertRawToPhysical(raw_value, 0.1, 0.0);

    raw_value=copyBitsFromByteArrayLE( byteArray, 1824, 12);
    @CAN_PrivMain::RFL_Object::RXX_Object_Obj2.PyVxCoVnce = convertRawToPhysical(raw_value, 0.01, 0.0);

    raw_value=copyBitsFromByteArrayLE( byteArray, 1836, 12);
    @CAN_PrivMain::RFL_Object::RXX_Object_Obj2.PyVyCoVnce = convertRawToPhysical(raw_value, 0.01, 0.0);

    raw_value=copyBitsFromByteArrayLE( byteArray, 1676, 10);
    @CAN_PrivMain::RFL_Object::RXX_Object_Obj2.RCS = convertRawToPhysical(raw_value, 0.2, -102.4);

    raw_value=copyBitsFromByteArrayLE( byteArray, 1848, 4);
    @CAN_PrivMain::RFL_Object::RXX_Object_Obj2.ReferencePoint = convertRawToPhysical(raw_value, 1.0, 0.0);

    raw_value=copyBitsFromByteArrayLE( byteArray, 1708, 12);
    @CAN_PrivMain::RFL_Object::RXX_Object_Obj2.Vx = convertRawToPhysical(raw_value, 0.0625, -128.0);

    raw_value=copyBitsFromByteArrayLE( byteArray, 1932, 12);
    @CAN_PrivMain::RFL_Object::RXX_Object_Obj2.VxAxCoVnce = convertRawToPhysical(raw_value, 0.01, 0.0);

    raw_value=copyBitsFromByteArrayLE( byteArray, 1952, 12);
    @CAN_PrivMain::RFL_Object::RXX_Object_Obj2.VxAyCoVnce = convertRawToPhysical(raw_value, 0.01, 0.0);

    raw_value=copyBitsFromByteArrayLE( byteArray, 1728, 12);
    @CAN_PrivMain::RFL_Object::RXX_Object_Obj2.VxVnce = convertRawToPhysical(raw_value, 0.01, 0.0);

    raw_value=copyBitsFromByteArrayLE( byteArray, 1920, 12);
    @CAN_PrivMain::RFL_Object::RXX_Object_Obj2.VxVyCoVnce = convertRawToPhysical(raw_value, 0.01, 0.0);

    raw_value=copyBitsFromByteArrayLE( byteArray, 1742, 10);
    @CAN_PrivMain::RFL_Object::RXX_Object_Obj2.Vy = convertRawToPhysical(raw_value, 0.125, -64.0);

    raw_value=copyBitsFromByteArrayLE( byteArray, 1964, 12);
    @CAN_PrivMain::RFL_Object::RXX_Object_Obj2.VyAxCoVnce = convertRawToPhysical(raw_value, 0.01, 0.0);

    raw_value=copyBitsFromByteArrayLE( byteArray, 1984, 12);
    @CAN_PrivMain::RFL_Object::RXX_Object_Obj2.VyAyCoVnce = convertRawToPhysical(raw_value, 0.01, 0.0);

    raw_value=copyBitsFromByteArrayLE( byteArray, 1760, 12);
    @CAN_PrivMain::RFL_Object::RXX_Object_Obj2.VyVnce = convertRawToPhysical(raw_value, 0.01, 0.0);

    raw_value=copyBitsFromByteArrayLE( byteArray, 1656, 7);
    @CAN_PrivMain::RFL_Object::RXX_Object_Obj2.Width = convertRawToPhysical(raw_value, 0.125, 0.0);

    raw_value=copyBitsFromByteArrayLE( byteArray, 1664, 12);
    @CAN_PrivMain::RFL_Object::RXX_Object_Obj2.WidthVnce = convertRawToPhysical(raw_value, 0.01, 0.0);
}


void CRadarFL_RXX_Object_Obj20_SetDataReceived(byte byteArray[])
{
    qword raw_value;

    raw_value=copyBitsFromByteArrayLE( byteArray, 11232, 32);
    @CAN_PrivMain::RFL_Object::RXX_Object_Obj20.Age = convertRawToPhysical(raw_value, 1.0, 0.0);

    raw_value=copyBitsFromByteArrayLE( byteArray, 10828, 10);
    @CAN_PrivMain::RFL_Object::RXX_Object_Obj20.Ax = convertRawToPhysical(raw_value, 0.03125, -16.0);

    raw_value=copyBitsFromByteArrayLE( byteArray, 11212, 12);
    @CAN_PrivMain::RFL_Object::RXX_Object_Obj20.AxAyCoVnce = convertRawToPhysical(raw_value, 0.01, 0.0);

    raw_value=copyBitsFromByteArrayLE( byteArray, 10848, 12);
    @CAN_PrivMain::RFL_Object::RXX_Object_Obj20.AxVnce = convertRawToPhysical(raw_value, 0.01, 0.0);

    raw_value=copyBitsFromByteArrayLE( byteArray, 10902, 9);
    @CAN_PrivMain::RFL_Object::RXX_Object_Obj20.Ay = convertRawToPhysical(raw_value, 0.0625, -16.0);

    raw_value=copyBitsFromByteArrayLE( byteArray, 10912, 12);
    @CAN_PrivMain::RFL_Object::RXX_Object_Obj20.AyVnce = convertRawToPhysical(raw_value, 0.01, 0.0);

    raw_value=copyBitsFromByteArrayLE( byteArray, 10968, 6);
    @CAN_PrivMain::RFL_Object::RXX_Object_Obj20.ExistProb = convertRawToPhysical(raw_value, 2.0, 0.0);

    raw_value=copyBitsFromByteArrayLE( byteArray, 11032, 8);
    @CAN_PrivMain::RFL_Object::RXX_Object_Obj20.FilterInformation = convertRawToPhysical(raw_value, 1.0, 0.0);

    raw_value=copyBitsFromByteArrayLE( byteArray, 10808, 7);
    @CAN_PrivMain::RFL_Object::RXX_Object_Obj20.Length = convertRawToPhysical(raw_value, 0.125, 0.0);

    raw_value=copyBitsFromByteArrayLE( byteArray, 10816, 12);
    @CAN_PrivMain::RFL_Object::RXX_Object_Obj20.LengthVnce = convertRawToPhysical(raw_value, 0.01, 0.0);

    raw_value=copyBitsFromByteArrayLE( byteArray, 11000, 3);
    @CAN_PrivMain::RFL_Object::RXX_Object_Obj20.MeasurementStatus = convertRawToPhysical(raw_value, 1.0, 0.0);

    raw_value=copyBitsFromByteArrayLE( byteArray, 10956, 2);
    @CAN_PrivMain::RFL_Object::RXX_Object_Obj20.MovingStatus = convertRawToPhysical(raw_value, 1.0, 0.0);

    raw_value=copyBitsFromByteArrayLE( byteArray, 10936, 7);
    @CAN_PrivMain::RFL_Object::RXX_Object_Obj20.ObjId = convertRawToPhysical(raw_value, 1.0, 0.0);

    raw_value=copyBitsFromByteArrayLE( byteArray, 10838, 9);
    @CAN_PrivMain::RFL_Object::RXX_Object_Obj20.OrientationYaw = convertRawToPhysical(raw_value, 0.0175, -4.48);

    raw_value=copyBitsFromByteArrayLE( byteArray, 10860, 12);
    @CAN_PrivMain::RFL_Object::RXX_Object_Obj20.OrientationYawVnce = convertRawToPhysical(raw_value, 0.0003, 0.0);

    raw_value=copyBitsFromByteArrayLE( byteArray, 10752, 6);
    @CAN_PrivMain::RFL_Object::RXX_Object_Obj20.ProbClassConfidence = convertRawToPhysical(raw_value, 2.0, 0.0);

    raw_value=copyBitsFromByteArrayLE( byteArray, 11003, 4);
    @CAN_PrivMain::RFL_Object::RXX_Object_Obj20.ProbClassType = convertRawToPhysical(raw_value, 1.0, 0.0);

    raw_value=copyBitsFromByteArrayLE( byteArray, 10758, 14);
    @CAN_PrivMain::RFL_Object::RXX_Object_Obj20.Px = convertRawToPhysical(raw_value, 0.0625, -512.0);

    raw_value=copyBitsFromByteArrayLE( byteArray, 11072, 12);
    @CAN_PrivMain::RFL_Object::RXX_Object_Obj20.PxAxCoVnce = convertRawToPhysical(raw_value, 0.01, 0.0);

    raw_value=copyBitsFromByteArrayLE( byteArray, 11084, 12);
    @CAN_PrivMain::RFL_Object::RXX_Object_Obj20.PxAyCoVnce = convertRawToPhysical(raw_value, 0.01, 0.0);

    raw_value=copyBitsFromByteArrayLE( byteArray, 10988, 12);
    @CAN_PrivMain::RFL_Object::RXX_Object_Obj20.PxPyCoVnce = convertRawToPhysical(raw_value, 0.01, 0.0);

    raw_value=copyBitsFromByteArrayLE( byteArray, 10772, 12);
    @CAN_PrivMain::RFL_Object::RXX_Object_Obj20.PxVnce = convertRawToPhysical(raw_value, 0.1, 0.0);

    raw_value=copyBitsFromByteArrayLE( byteArray, 11008, 12);
    @CAN_PrivMain::RFL_Object::RXX_Object_Obj20.PxVxCoVnce = convertRawToPhysical(raw_value, 0.01, 0.0);

    raw_value=copyBitsFromByteArrayLE( byteArray, 11020, 12);
    @CAN_PrivMain::RFL_Object::RXX_Object_Obj20.PxVyCoVnce = convertRawToPhysical(raw_value, 0.01, 0.0);

    raw_value=copyBitsFromByteArrayLE( byteArray, 10784, 12);
    @CAN_PrivMain::RFL_Object::RXX_Object_Obj20.Py = convertRawToPhysical(raw_value, 0.0625, -128.0);

    raw_value=copyBitsFromByteArrayLE( byteArray, 11104, 12);
    @CAN_PrivMain::RFL_Object::RXX_Object_Obj20.PyAxCoVnce = convertRawToPhysical(raw_value, 0.01, 0.0);

    raw_value=copyBitsFromByteArrayLE( byteArray, 11116, 12);
    @CAN_PrivMain::RFL_Object::RXX_Object_Obj20.PyAyCoVnce = convertRawToPhysical(raw_value, 0.01, 0.0);

    raw_value=copyBitsFromByteArrayLE( byteArray, 10796, 12);
    @CAN_PrivMain::RFL_Object::RXX_Object_Obj20.PyVnce = convertRawToPhysical(raw_value, 0.1, 0.0);

    raw_value=copyBitsFromByteArrayLE( byteArray, 11040, 12);
    @CAN_PrivMain::RFL_Object::RXX_Object_Obj20.PyVxCoVnce = convertRawToPhysical(raw_value, 0.01, 0.0);

    raw_value=copyBitsFromByteArrayLE( byteArray, 11052, 12);
    @CAN_PrivMain::RFL_Object::RXX_Object_Obj20.PyVyCoVnce = convertRawToPhysical(raw_value, 0.01, 0.0);

    raw_value=copyBitsFromByteArrayLE( byteArray, 10892, 10);
    @CAN_PrivMain::RFL_Object::RXX_Object_Obj20.RCS = convertRawToPhysical(raw_value, 0.2, -102.4);

    raw_value=copyBitsFromByteArrayLE( byteArray, 11064, 4);
    @CAN_PrivMain::RFL_Object::RXX_Object_Obj20.ReferencePoint = convertRawToPhysical(raw_value, 1.0, 0.0);

    raw_value=copyBitsFromByteArrayLE( byteArray, 10924, 12);
    @CAN_PrivMain::RFL_Object::RXX_Object_Obj20.Vx = convertRawToPhysical(raw_value, 0.0625, -128.0);

    raw_value=copyBitsFromByteArrayLE( byteArray, 11148, 12);
    @CAN_PrivMain::RFL_Object::RXX_Object_Obj20.VxAxCoVnce = convertRawToPhysical(raw_value, 0.01, 0.0);

    raw_value=copyBitsFromByteArrayLE( byteArray, 11168, 12);
    @CAN_PrivMain::RFL_Object::RXX_Object_Obj20.VxAyCoVnce = convertRawToPhysical(raw_value, 0.01, 0.0);

    raw_value=copyBitsFromByteArrayLE( byteArray, 10944, 12);
    @CAN_PrivMain::RFL_Object::RXX_Object_Obj20.VxVnce = convertRawToPhysical(raw_value, 0.01, 0.0);

    raw_value=copyBitsFromByteArrayLE( byteArray, 11136, 12);
    @CAN_PrivMain::RFL_Object::RXX_Object_Obj20.VxVyCoVnce = convertRawToPhysical(raw_value, 0.01, 0.0);

    raw_value=copyBitsFromByteArrayLE( byteArray, 10958, 10);
    @CAN_PrivMain::RFL_Object::RXX_Object_Obj20.Vy = convertRawToPhysical(raw_value, 0.125, -64.0);

    raw_value=copyBitsFromByteArrayLE( byteArray, 11180, 12);
    @CAN_PrivMain::RFL_Object::RXX_Object_Obj20.VyAxCoVnce = convertRawToPhysical(raw_value, 0.01, 0.0);

    raw_value=copyBitsFromByteArrayLE( byteArray, 11200, 12);
    @CAN_PrivMain::RFL_Object::RXX_Object_Obj20.VyAyCoVnce = convertRawToPhysical(raw_value, 0.01, 0.0);

    raw_value=copyBitsFromByteArrayLE( byteArray, 10976, 12);
    @CAN_PrivMain::RFL_Object::RXX_Object_Obj20.VyVnce = convertRawToPhysical(raw_value, 0.01, 0.0);

    raw_value=copyBitsFromByteArrayLE( byteArray, 10872, 7);
    @CAN_PrivMain::RFL_Object::RXX_Object_Obj20.Width = convertRawToPhysical(raw_value, 0.125, 0.0);

    raw_value=copyBitsFromByteArrayLE( byteArray, 10880, 12);
    @CAN_PrivMain::RFL_Object::RXX_Object_Obj20.WidthVnce = convertRawToPhysical(raw_value, 0.01, 0.0);
}


void CRadarFL_RXX_Object_Obj21_SetDataReceived(byte byteArray[])
{
    qword raw_value;

    raw_value=copyBitsFromByteArrayLE( byteArray, 11744, 32);
    @CAN_PrivMain::RFL_Object::RXX_Object_Obj21.Age = convertRawToPhysical(raw_value, 1.0, 0.0);

    raw_value=copyBitsFromByteArrayLE( byteArray, 11340, 10);
    @CAN_PrivMain::RFL_Object::RXX_Object_Obj21.Ax = convertRawToPhysical(raw_value, 0.03125, -16.0);

    raw_value=copyBitsFromByteArrayLE( byteArray, 11724, 12);
    @CAN_PrivMain::RFL_Object::RXX_Object_Obj21.AxAyCoVnce = convertRawToPhysical(raw_value, 0.01, 0.0);

    raw_value=copyBitsFromByteArrayLE( byteArray, 11360, 12);
    @CAN_PrivMain::RFL_Object::RXX_Object_Obj21.AxVnce = convertRawToPhysical(raw_value, 0.01, 0.0);

    raw_value=copyBitsFromByteArrayLE( byteArray, 11414, 9);
    @CAN_PrivMain::RFL_Object::RXX_Object_Obj21.Ay = convertRawToPhysical(raw_value, 0.0625, -16.0);

    raw_value=copyBitsFromByteArrayLE( byteArray, 11424, 12);
    @CAN_PrivMain::RFL_Object::RXX_Object_Obj21.AyVnce = convertRawToPhysical(raw_value, 0.01, 0.0);

    raw_value=copyBitsFromByteArrayLE( byteArray, 11480, 6);
    @CAN_PrivMain::RFL_Object::RXX_Object_Obj21.ExistProb = convertRawToPhysical(raw_value, 2.0, 0.0);

    raw_value=copyBitsFromByteArrayLE( byteArray, 11544, 8);
    @CAN_PrivMain::RFL_Object::RXX_Object_Obj21.FilterInformation = convertRawToPhysical(raw_value, 1.0, 0.0);

    raw_value=copyBitsFromByteArrayLE( byteArray, 11320, 7);
    @CAN_PrivMain::RFL_Object::RXX_Object_Obj21.Length = convertRawToPhysical(raw_value, 0.125, 0.0);

    raw_value=copyBitsFromByteArrayLE( byteArray, 11328, 12);
    @CAN_PrivMain::RFL_Object::RXX_Object_Obj21.LengthVnce = convertRawToPhysical(raw_value, 0.01, 0.0);

    raw_value=copyBitsFromByteArrayLE( byteArray, 11512, 3);
    @CAN_PrivMain::RFL_Object::RXX_Object_Obj21.MeasurementStatus = convertRawToPhysical(raw_value, 1.0, 0.0);

    raw_value=copyBitsFromByteArrayLE( byteArray, 11468, 2);
    @CAN_PrivMain::RFL_Object::RXX_Object_Obj21.MovingStatus = convertRawToPhysical(raw_value, 1.0, 0.0);

    raw_value=copyBitsFromByteArrayLE( byteArray, 11448, 7);
    @CAN_PrivMain::RFL_Object::RXX_Object_Obj21.ObjId = convertRawToPhysical(raw_value, 1.0, 0.0);

    raw_value=copyBitsFromByteArrayLE( byteArray, 11350, 9);
    @CAN_PrivMain::RFL_Object::RXX_Object_Obj21.OrientationYaw = convertRawToPhysical(raw_value, 0.0175, -4.48);

    raw_value=copyBitsFromByteArrayLE( byteArray, 11372, 12);
    @CAN_PrivMain::RFL_Object::RXX_Object_Obj21.OrientationYawVnce = convertRawToPhysical(raw_value, 0.0003, 0.0);

    raw_value=copyBitsFromByteArrayLE( byteArray, 11264, 6);
    @CAN_PrivMain::RFL_Object::RXX_Object_Obj21.ProbClassConfidence = convertRawToPhysical(raw_value, 2.0, 0.0);

    raw_value=copyBitsFromByteArrayLE( byteArray, 11515, 4);
    @CAN_PrivMain::RFL_Object::RXX_Object_Obj21.ProbClassType = convertRawToPhysical(raw_value, 1.0, 0.0);

    raw_value=copyBitsFromByteArrayLE( byteArray, 11270, 14);
    @CAN_PrivMain::RFL_Object::RXX_Object_Obj21.Px = convertRawToPhysical(raw_value, 0.0625, -512.0);

    raw_value=copyBitsFromByteArrayLE( byteArray, 11584, 12);
    @CAN_PrivMain::RFL_Object::RXX_Object_Obj21.PxAxCoVnce = convertRawToPhysical(raw_value, 0.01, 0.0);

    raw_value=copyBitsFromByteArrayLE( byteArray, 11596, 12);
    @CAN_PrivMain::RFL_Object::RXX_Object_Obj21.PxAyCoVnce = convertRawToPhysical(raw_value, 0.01, 0.0);

    raw_value=copyBitsFromByteArrayLE( byteArray, 11500, 12);
    @CAN_PrivMain::RFL_Object::RXX_Object_Obj21.PxPyCoVnce = convertRawToPhysical(raw_value, 0.01, 0.0);

    raw_value=copyBitsFromByteArrayLE( byteArray, 11284, 12);
    @CAN_PrivMain::RFL_Object::RXX_Object_Obj21.PxVnce = convertRawToPhysical(raw_value, 0.1, 0.0);

    raw_value=copyBitsFromByteArrayLE( byteArray, 11520, 12);
    @CAN_PrivMain::RFL_Object::RXX_Object_Obj21.PxVxCoVnce = convertRawToPhysical(raw_value, 0.01, 0.0);

    raw_value=copyBitsFromByteArrayLE( byteArray, 11532, 12);
    @CAN_PrivMain::RFL_Object::RXX_Object_Obj21.PxVyCoVnce = convertRawToPhysical(raw_value, 0.01, 0.0);

    raw_value=copyBitsFromByteArrayLE( byteArray, 11296, 12);
    @CAN_PrivMain::RFL_Object::RXX_Object_Obj21.Py = convertRawToPhysical(raw_value, 0.0625, -128.0);

    raw_value=copyBitsFromByteArrayLE( byteArray, 11616, 12);
    @CAN_PrivMain::RFL_Object::RXX_Object_Obj21.PyAxCoVnce = convertRawToPhysical(raw_value, 0.01, 0.0);

    raw_value=copyBitsFromByteArrayLE( byteArray, 11628, 12);
    @CAN_PrivMain::RFL_Object::RXX_Object_Obj21.PyAyCoVnce = convertRawToPhysical(raw_value, 0.01, 0.0);

    raw_value=copyBitsFromByteArrayLE( byteArray, 11308, 12);
    @CAN_PrivMain::RFL_Object::RXX_Object_Obj21.PyVnce = convertRawToPhysical(raw_value, 0.1, 0.0);

    raw_value=copyBitsFromByteArrayLE( byteArray, 11552, 12);
    @CAN_PrivMain::RFL_Object::RXX_Object_Obj21.PyVxCoVnce = convertRawToPhysical(raw_value, 0.01, 0.0);

    raw_value=copyBitsFromByteArrayLE( byteArray, 11564, 12);
    @CAN_PrivMain::RFL_Object::RXX_Object_Obj21.PyVyCoVnce = convertRawToPhysical(raw_value, 0.01, 0.0);

    raw_value=copyBitsFromByteArrayLE( byteArray, 11404, 10);
    @CAN_PrivMain::RFL_Object::RXX_Object_Obj21.RCS = convertRawToPhysical(raw_value, 0.2, -102.4);

    raw_value=copyBitsFromByteArrayLE( byteArray, 11576, 4);
    @CAN_PrivMain::RFL_Object::RXX_Object_Obj21.ReferencePoint = convertRawToPhysical(raw_value, 1.0, 0.0);

    raw_value=copyBitsFromByteArrayLE( byteArray, 11436, 12);
    @CAN_PrivMain::RFL_Object::RXX_Object_Obj21.Vx = convertRawToPhysical(raw_value, 0.0625, -128.0);

    raw_value=copyBitsFromByteArrayLE( byteArray, 11660, 12);
    @CAN_PrivMain::RFL_Object::RXX_Object_Obj21.VxAxCoVnce = convertRawToPhysical(raw_value, 0.01, 0.0);

    raw_value=copyBitsFromByteArrayLE( byteArray, 11680, 12);
    @CAN_PrivMain::RFL_Object::RXX_Object_Obj21.VxAyCoVnce = convertRawToPhysical(raw_value, 0.01, 0.0);

    raw_value=copyBitsFromByteArrayLE( byteArray, 11456, 12);
    @CAN_PrivMain::RFL_Object::RXX_Object_Obj21.VxVnce = convertRawToPhysical(raw_value, 0.01, 0.0);

    raw_value=copyBitsFromByteArrayLE( byteArray, 11648, 12);
    @CAN_PrivMain::RFL_Object::RXX_Object_Obj21.VxVyCoVnce = convertRawToPhysical(raw_value, 0.01, 0.0);

    raw_value=copyBitsFromByteArrayLE( byteArray, 11470, 10);
    @CAN_PrivMain::RFL_Object::RXX_Object_Obj21.Vy = convertRawToPhysical(raw_value, 0.125, -64.0);

    raw_value=copyBitsFromByteArrayLE( byteArray, 11692, 12);
    @CAN_PrivMain::RFL_Object::RXX_Object_Obj21.VyAxCoVnce = convertRawToPhysical(raw_value, 0.01, 0.0);

    raw_value=copyBitsFromByteArrayLE( byteArray, 11712, 12);
    @CAN_PrivMain::RFL_Object::RXX_Object_Obj21.VyAyCoVnce = convertRawToPhysical(raw_value, 0.01, 0.0);

    raw_value=copyBitsFromByteArrayLE( byteArray, 11488, 12);
    @CAN_PrivMain::RFL_Object::RXX_Object_Obj21.VyVnce = convertRawToPhysical(raw_value, 0.01, 0.0);

    raw_value=copyBitsFromByteArrayLE( byteArray, 11384, 7);
    @CAN_PrivMain::RFL_Object::RXX_Object_Obj21.Width = convertRawToPhysical(raw_value, 0.125, 0.0);

    raw_value=copyBitsFromByteArrayLE( byteArray, 11392, 12);
    @CAN_PrivMain::RFL_Object::RXX_Object_Obj21.WidthVnce = convertRawToPhysical(raw_value, 0.01, 0.0);
}


void CRadarFL_RXX_Object_Obj22_SetDataReceived(byte byteArray[])
{
    qword raw_value;

    raw_value=copyBitsFromByteArrayLE( byteArray, 12256, 32);
    @CAN_PrivMain::RFL_Object::RXX_Object_Obj22.Age = convertRawToPhysical(raw_value, 1.0, 0.0);

    raw_value=copyBitsFromByteArrayLE( byteArray, 11852, 10);
    @CAN_PrivMain::RFL_Object::RXX_Object_Obj22.Ax = convertRawToPhysical(raw_value, 0.03125, -16.0);

    raw_value=copyBitsFromByteArrayLE( byteArray, 12236, 12);
    @CAN_PrivMain::RFL_Object::RXX_Object_Obj22.AxAyCoVnce = convertRawToPhysical(raw_value, 0.01, 0.0);

    raw_value=copyBitsFromByteArrayLE( byteArray, 11872, 12);
    @CAN_PrivMain::RFL_Object::RXX_Object_Obj22.AxVnce = convertRawToPhysical(raw_value, 0.01, 0.0);

    raw_value=copyBitsFromByteArrayLE( byteArray, 11926, 9);
    @CAN_PrivMain::RFL_Object::RXX_Object_Obj22.Ay = convertRawToPhysical(raw_value, 0.0625, -16.0);

    raw_value=copyBitsFromByteArrayLE( byteArray, 11936, 12);
    @CAN_PrivMain::RFL_Object::RXX_Object_Obj22.AyVnce = convertRawToPhysical(raw_value, 0.01, 0.0);

    raw_value=copyBitsFromByteArrayLE( byteArray, 11992, 6);
    @CAN_PrivMain::RFL_Object::RXX_Object_Obj22.ExistProb = convertRawToPhysical(raw_value, 2.0, 0.0);

    raw_value=copyBitsFromByteArrayLE( byteArray, 12056, 8);
    @CAN_PrivMain::RFL_Object::RXX_Object_Obj22.FilterInformation = convertRawToPhysical(raw_value, 1.0, 0.0);

    raw_value=copyBitsFromByteArrayLE( byteArray, 11832, 7);
    @CAN_PrivMain::RFL_Object::RXX_Object_Obj22.Length = convertRawToPhysical(raw_value, 0.125, 0.0);

    raw_value=copyBitsFromByteArrayLE( byteArray, 11840, 12);
    @CAN_PrivMain::RFL_Object::RXX_Object_Obj22.LengthVnce = convertRawToPhysical(raw_value, 0.01, 0.0);

    raw_value=copyBitsFromByteArrayLE( byteArray, 12024, 3);
    @CAN_PrivMain::RFL_Object::RXX_Object_Obj22.MeasurementStatus = convertRawToPhysical(raw_value, 1.0, 0.0);

    raw_value=copyBitsFromByteArrayLE( byteArray, 11980, 2);
    @CAN_PrivMain::RFL_Object::RXX_Object_Obj22.MovingStatus = convertRawToPhysical(raw_value, 1.0, 0.0);

    raw_value=copyBitsFromByteArrayLE( byteArray, 11960, 7);
    @CAN_PrivMain::RFL_Object::RXX_Object_Obj22.ObjId = convertRawToPhysical(raw_value, 1.0, 0.0);

    raw_value=copyBitsFromByteArrayLE( byteArray, 11862, 9);
    @CAN_PrivMain::RFL_Object::RXX_Object_Obj22.OrientationYaw = convertRawToPhysical(raw_value, 0.0175, -4.48);

    raw_value=copyBitsFromByteArrayLE( byteArray, 11884, 12);
    @CAN_PrivMain::RFL_Object::RXX_Object_Obj22.OrientationYawVnce = convertRawToPhysical(raw_value, 0.0003, 0.0);

    raw_value=copyBitsFromByteArrayLE( byteArray, 11776, 6);
    @CAN_PrivMain::RFL_Object::RXX_Object_Obj22.ProbClassConfidence = convertRawToPhysical(raw_value, 2.0, 0.0);

    raw_value=copyBitsFromByteArrayLE( byteArray, 12027, 4);
    @CAN_PrivMain::RFL_Object::RXX_Object_Obj22.ProbClassType = convertRawToPhysical(raw_value, 1.0, 0.0);

    raw_value=copyBitsFromByteArrayLE( byteArray, 11782, 14);
    @CAN_PrivMain::RFL_Object::RXX_Object_Obj22.Px = convertRawToPhysical(raw_value, 0.0625, -512.0);

    raw_value=copyBitsFromByteArrayLE( byteArray, 12096, 12);
    @CAN_PrivMain::RFL_Object::RXX_Object_Obj22.PxAxCoVnce = convertRawToPhysical(raw_value, 0.01, 0.0);

    raw_value=copyBitsFromByteArrayLE( byteArray, 12108, 12);
    @CAN_PrivMain::RFL_Object::RXX_Object_Obj22.PxAyCoVnce = convertRawToPhysical(raw_value, 0.01, 0.0);

    raw_value=copyBitsFromByteArrayLE( byteArray, 12012, 12);
    @CAN_PrivMain::RFL_Object::RXX_Object_Obj22.PxPyCoVnce = convertRawToPhysical(raw_value, 0.01, 0.0);

    raw_value=copyBitsFromByteArrayLE( byteArray, 11796, 12);
    @CAN_PrivMain::RFL_Object::RXX_Object_Obj22.PxVnce = convertRawToPhysical(raw_value, 0.1, 0.0);

    raw_value=copyBitsFromByteArrayLE( byteArray, 12032, 12);
    @CAN_PrivMain::RFL_Object::RXX_Object_Obj22.PxVxCoVnce = convertRawToPhysical(raw_value, 0.01, 0.0);

    raw_value=copyBitsFromByteArrayLE( byteArray, 12044, 12);
    @CAN_PrivMain::RFL_Object::RXX_Object_Obj22.PxVyCoVnce = convertRawToPhysical(raw_value, 0.01, 0.0);

    raw_value=copyBitsFromByteArrayLE( byteArray, 11808, 12);
    @CAN_PrivMain::RFL_Object::RXX_Object_Obj22.Py = convertRawToPhysical(raw_value, 0.0625, -128.0);

    raw_value=copyBitsFromByteArrayLE( byteArray, 12128, 12);
    @CAN_PrivMain::RFL_Object::RXX_Object_Obj22.PyAxCoVnce = convertRawToPhysical(raw_value, 0.01, 0.0);

    raw_value=copyBitsFromByteArrayLE( byteArray, 12140, 12);
    @CAN_PrivMain::RFL_Object::RXX_Object_Obj22.PyAyCoVnce = convertRawToPhysical(raw_value, 0.01, 0.0);

    raw_value=copyBitsFromByteArrayLE( byteArray, 11820, 12);
    @CAN_PrivMain::RFL_Object::RXX_Object_Obj22.PyVnce = convertRawToPhysical(raw_value, 0.1, 0.0);

    raw_value=copyBitsFromByteArrayLE( byteArray, 12064, 12);
    @CAN_PrivMain::RFL_Object::RXX_Object_Obj22.PyVxCoVnce = convertRawToPhysical(raw_value, 0.01, 0.0);

    raw_value=copyBitsFromByteArrayLE( byteArray, 12076, 12);
    @CAN_PrivMain::RFL_Object::RXX_Object_Obj22.PyVyCoVnce = convertRawToPhysical(raw_value, 0.01, 0.0);

    raw_value=copyBitsFromByteArrayLE( byteArray, 11916, 10);
    @CAN_PrivMain::RFL_Object::RXX_Object_Obj22.RCS = convertRawToPhysical(raw_value, 0.2, -102.4);

    raw_value=copyBitsFromByteArrayLE( byteArray, 12088, 4);
    @CAN_PrivMain::RFL_Object::RXX_Object_Obj22.ReferencePoint = convertRawToPhysical(raw_value, 1.0, 0.0);

    raw_value=copyBitsFromByteArrayLE( byteArray, 11948, 12);
    @CAN_PrivMain::RFL_Object::RXX_Object_Obj22.Vx = convertRawToPhysical(raw_value, 0.0625, -128.0);

    raw_value=copyBitsFromByteArrayLE( byteArray, 12172, 12);
    @CAN_PrivMain::RFL_Object::RXX_Object_Obj22.VxAxCoVnce = convertRawToPhysical(raw_value, 0.01, 0.0);

    raw_value=copyBitsFromByteArrayLE( byteArray, 12192, 12);
    @CAN_PrivMain::RFL_Object::RXX_Object_Obj22.VxAyCoVnce = convertRawToPhysical(raw_value, 0.01, 0.0);

    raw_value=copyBitsFromByteArrayLE( byteArray, 11968, 12);
    @CAN_PrivMain::RFL_Object::RXX_Object_Obj22.VxVnce = convertRawToPhysical(raw_value, 0.01, 0.0);

    raw_value=copyBitsFromByteArrayLE( byteArray, 12160, 12);
    @CAN_PrivMain::RFL_Object::RXX_Object_Obj22.VxVyCoVnce = convertRawToPhysical(raw_value, 0.01, 0.0);

    raw_value=copyBitsFromByteArrayLE( byteArray, 11982, 10);
    @CAN_PrivMain::RFL_Object::RXX_Object_Obj22.Vy = convertRawToPhysical(raw_value, 0.125, -64.0);

    raw_value=copyBitsFromByteArrayLE( byteArray, 12204, 12);
    @CAN_PrivMain::RFL_Object::RXX_Object_Obj22.VyAxCoVnce = convertRawToPhysical(raw_value, 0.01, 0.0);

    raw_value=copyBitsFromByteArrayLE( byteArray, 12224, 12);
    @CAN_PrivMain::RFL_Object::RXX_Object_Obj22.VyAyCoVnce = convertRawToPhysical(raw_value, 0.01, 0.0);

    raw_value=copyBitsFromByteArrayLE( byteArray, 12000, 12);
    @CAN_PrivMain::RFL_Object::RXX_Object_Obj22.VyVnce = convertRawToPhysical(raw_value, 0.01, 0.0);

    raw_value=copyBitsFromByteArrayLE( byteArray, 11896, 7);
    @CAN_PrivMain::RFL_Object::RXX_Object_Obj22.Width = convertRawToPhysical(raw_value, 0.125, 0.0);

    raw_value=copyBitsFromByteArrayLE( byteArray, 11904, 12);
    @CAN_PrivMain::RFL_Object::RXX_Object_Obj22.WidthVnce = convertRawToPhysical(raw_value, 0.01, 0.0);
}


void CRadarFL_RXX_Object_Obj23_SetDataReceived(byte byteArray[])
{
    qword raw_value;

    raw_value=copyBitsFromByteArrayLE( byteArray, 12768, 32);
    @CAN_PrivMain::RFL_Object::RXX_Object_Obj23.Age = convertRawToPhysical(raw_value, 1.0, 0.0);

    raw_value=copyBitsFromByteArrayLE( byteArray, 12364, 10);
    @CAN_PrivMain::RFL_Object::RXX_Object_Obj23.Ax = convertRawToPhysical(raw_value, 0.03125, -16.0);

    raw_value=copyBitsFromByteArrayLE( byteArray, 12748, 12);
    @CAN_PrivMain::RFL_Object::RXX_Object_Obj23.AxAyCoVnce = convertRawToPhysical(raw_value, 0.01, 0.0);

    raw_value=copyBitsFromByteArrayLE( byteArray, 12384, 12);
    @CAN_PrivMain::RFL_Object::RXX_Object_Obj23.AxVnce = convertRawToPhysical(raw_value, 0.01, 0.0);

    raw_value=copyBitsFromByteArrayLE( byteArray, 12438, 9);
    @CAN_PrivMain::RFL_Object::RXX_Object_Obj23.Ay = convertRawToPhysical(raw_value, 0.0625, -16.0);

    raw_value=copyBitsFromByteArrayLE( byteArray, 12448, 12);
    @CAN_PrivMain::RFL_Object::RXX_Object_Obj23.AyVnce = convertRawToPhysical(raw_value, 0.01, 0.0);

    raw_value=copyBitsFromByteArrayLE( byteArray, 12504, 6);
    @CAN_PrivMain::RFL_Object::RXX_Object_Obj23.ExistProb = convertRawToPhysical(raw_value, 2.0, 0.0);

    raw_value=copyBitsFromByteArrayLE( byteArray, 12568, 8);
    @CAN_PrivMain::RFL_Object::RXX_Object_Obj23.FilterInformation = convertRawToPhysical(raw_value, 1.0, 0.0);

    raw_value=copyBitsFromByteArrayLE( byteArray, 12344, 7);
    @CAN_PrivMain::RFL_Object::RXX_Object_Obj23.Length = convertRawToPhysical(raw_value, 0.125, 0.0);

    raw_value=copyBitsFromByteArrayLE( byteArray, 12352, 12);
    @CAN_PrivMain::RFL_Object::RXX_Object_Obj23.LengthVnce = convertRawToPhysical(raw_value, 0.01, 0.0);

    raw_value=copyBitsFromByteArrayLE( byteArray, 12536, 3);
    @CAN_PrivMain::RFL_Object::RXX_Object_Obj23.MeasurementStatus = convertRawToPhysical(raw_value, 1.0, 0.0);

    raw_value=copyBitsFromByteArrayLE( byteArray, 12492, 2);
    @CAN_PrivMain::RFL_Object::RXX_Object_Obj23.MovingStatus = convertRawToPhysical(raw_value, 1.0, 0.0);

    raw_value=copyBitsFromByteArrayLE( byteArray, 12472, 7);
    @CAN_PrivMain::RFL_Object::RXX_Object_Obj23.ObjId = convertRawToPhysical(raw_value, 1.0, 0.0);

    raw_value=copyBitsFromByteArrayLE( byteArray, 12374, 9);
    @CAN_PrivMain::RFL_Object::RXX_Object_Obj23.OrientationYaw = convertRawToPhysical(raw_value, 0.0175, -4.48);

    raw_value=copyBitsFromByteArrayLE( byteArray, 12396, 12);
    @CAN_PrivMain::RFL_Object::RXX_Object_Obj23.OrientationYawVnce = convertRawToPhysical(raw_value, 0.0003, 0.0);

    raw_value=copyBitsFromByteArrayLE( byteArray, 12288, 6);
    @CAN_PrivMain::RFL_Object::RXX_Object_Obj23.ProbClassConfidence = convertRawToPhysical(raw_value, 2.0, 0.0);

    raw_value=copyBitsFromByteArrayLE( byteArray, 12539, 4);
    @CAN_PrivMain::RFL_Object::RXX_Object_Obj23.ProbClassType = convertRawToPhysical(raw_value, 1.0, 0.0);

    raw_value=copyBitsFromByteArrayLE( byteArray, 12294, 14);
    @CAN_PrivMain::RFL_Object::RXX_Object_Obj23.Px = convertRawToPhysical(raw_value, 0.0625, -512.0);

    raw_value=copyBitsFromByteArrayLE( byteArray, 12608, 12);
    @CAN_PrivMain::RFL_Object::RXX_Object_Obj23.PxAxCoVnce = convertRawToPhysical(raw_value, 0.01, 0.0);

    raw_value=copyBitsFromByteArrayLE( byteArray, 12620, 12);
    @CAN_PrivMain::RFL_Object::RXX_Object_Obj23.PxAyCoVnce = convertRawToPhysical(raw_value, 0.01, 0.0);

    raw_value=copyBitsFromByteArrayLE( byteArray, 12524, 12);
    @CAN_PrivMain::RFL_Object::RXX_Object_Obj23.PxPyCoVnce = convertRawToPhysical(raw_value, 0.01, 0.0);

    raw_value=copyBitsFromByteArrayLE( byteArray, 12308, 12);
    @CAN_PrivMain::RFL_Object::RXX_Object_Obj23.PxVnce = convertRawToPhysical(raw_value, 0.1, 0.0);

    raw_value=copyBitsFromByteArrayLE( byteArray, 12544, 12);
    @CAN_PrivMain::RFL_Object::RXX_Object_Obj23.PxVxCoVnce = convertRawToPhysical(raw_value, 0.01, 0.0);

    raw_value=copyBitsFromByteArrayLE( byteArray, 12556, 12);
    @CAN_PrivMain::RFL_Object::RXX_Object_Obj23.PxVyCoVnce = convertRawToPhysical(raw_value, 0.01, 0.0);

    raw_value=copyBitsFromByteArrayLE( byteArray, 12320, 12);
    @CAN_PrivMain::RFL_Object::RXX_Object_Obj23.Py = convertRawToPhysical(raw_value, 0.0625, -128.0);

    raw_value=copyBitsFromByteArrayLE( byteArray, 12640, 12);
    @CAN_PrivMain::RFL_Object::RXX_Object_Obj23.PyAxCoVnce = convertRawToPhysical(raw_value, 0.01, 0.0);

    raw_value=copyBitsFromByteArrayLE( byteArray, 12652, 12);
    @CAN_PrivMain::RFL_Object::RXX_Object_Obj23.PyAyCoVnce = convertRawToPhysical(raw_value, 0.01, 0.0);

    raw_value=copyBitsFromByteArrayLE( byteArray, 12332, 12);
    @CAN_PrivMain::RFL_Object::RXX_Object_Obj23.PyVnce = convertRawToPhysical(raw_value, 0.1, 0.0);

    raw_value=copyBitsFromByteArrayLE( byteArray, 12576, 12);
    @CAN_PrivMain::RFL_Object::RXX_Object_Obj23.PyVxCoVnce = convertRawToPhysical(raw_value, 0.01, 0.0);

    raw_value=copyBitsFromByteArrayLE( byteArray, 12588, 12);
    @CAN_PrivMain::RFL_Object::RXX_Object_Obj23.PyVyCoVnce = convertRawToPhysical(raw_value, 0.01, 0.0);

    raw_value=copyBitsFromByteArrayLE( byteArray, 12428, 10);
    @CAN_PrivMain::RFL_Object::RXX_Object_Obj23.RCS = convertRawToPhysical(raw_value, 0.2, -102.4);

    raw_value=copyBitsFromByteArrayLE( byteArray, 12600, 4);
    @CAN_PrivMain::RFL_Object::RXX_Object_Obj23.ReferencePoint = convertRawToPhysical(raw_value, 1.0, 0.0);

    raw_value=copyBitsFromByteArrayLE( byteArray, 12460, 12);
    @CAN_PrivMain::RFL_Object::RXX_Object_Obj23.Vx = convertRawToPhysical(raw_value, 0.0625, -128.0);

    raw_value=copyBitsFromByteArrayLE( byteArray, 12684, 12);
    @CAN_PrivMain::RFL_Object::RXX_Object_Obj23.VxAxCoVnce = convertRawToPhysical(raw_value, 0.01, 0.0);

    raw_value=copyBitsFromByteArrayLE( byteArray, 12704, 12);
    @CAN_PrivMain::RFL_Object::RXX_Object_Obj23.VxAyCoVnce = convertRawToPhysical(raw_value, 0.01, 0.0);

    raw_value=copyBitsFromByteArrayLE( byteArray, 12480, 12);
    @CAN_PrivMain::RFL_Object::RXX_Object_Obj23.VxVnce = convertRawToPhysical(raw_value, 0.01, 0.0);

    raw_value=copyBitsFromByteArrayLE( byteArray, 12672, 12);
    @CAN_PrivMain::RFL_Object::RXX_Object_Obj23.VxVyCoVnce = convertRawToPhysical(raw_value, 0.01, 0.0);

    raw_value=copyBitsFromByteArrayLE( byteArray, 12494, 10);
    @CAN_PrivMain::RFL_Object::RXX_Object_Obj23.Vy = convertRawToPhysical(raw_value, 0.125, -64.0);

    raw_value=copyBitsFromByteArrayLE( byteArray, 12716, 12);
    @CAN_PrivMain::RFL_Object::RXX_Object_Obj23.VyAxCoVnce = convertRawToPhysical(raw_value, 0.01, 0.0);

    raw_value=copyBitsFromByteArrayLE( byteArray, 12736, 12);
    @CAN_PrivMain::RFL_Object::RXX_Object_Obj23.VyAyCoVnce = convertRawToPhysical(raw_value, 0.01, 0.0);

    raw_value=copyBitsFromByteArrayLE( byteArray, 12512, 12);
    @CAN_PrivMain::RFL_Object::RXX_Object_Obj23.VyVnce = convertRawToPhysical(raw_value, 0.01, 0.0);

    raw_value=copyBitsFromByteArrayLE( byteArray, 12408, 7);
    @CAN_PrivMain::RFL_Object::RXX_Object_Obj23.Width = convertRawToPhysical(raw_value, 0.125, 0.0);

    raw_value=copyBitsFromByteArrayLE( byteArray, 12416, 12);
    @CAN_PrivMain::RFL_Object::RXX_Object_Obj23.WidthVnce = convertRawToPhysical(raw_value, 0.01, 0.0);
}


void CRadarFL_RXX_Object_Obj24_SetDataReceived(byte byteArray[])
{
    qword raw_value;

    raw_value=copyBitsFromByteArrayLE( byteArray, 13280, 32);
    @CAN_PrivMain::RFL_Object::RXX_Object_Obj24.Age = convertRawToPhysical(raw_value, 1.0, 0.0);

    raw_value=copyBitsFromByteArrayLE( byteArray, 12876, 10);
    @CAN_PrivMain::RFL_Object::RXX_Object_Obj24.Ax = convertRawToPhysical(raw_value, 0.03125, -16.0);

    raw_value=copyBitsFromByteArrayLE( byteArray, 13260, 12);
    @CAN_PrivMain::RFL_Object::RXX_Object_Obj24.AxAyCoVnce = convertRawToPhysical(raw_value, 0.01, 0.0);

    raw_value=copyBitsFromByteArrayLE( byteArray, 12896, 12);
    @CAN_PrivMain::RFL_Object::RXX_Object_Obj24.AxVnce = convertRawToPhysical(raw_value, 0.01, 0.0);

    raw_value=copyBitsFromByteArrayLE( byteArray, 12950, 9);
    @CAN_PrivMain::RFL_Object::RXX_Object_Obj24.Ay = convertRawToPhysical(raw_value, 0.0625, -16.0);

    raw_value=copyBitsFromByteArrayLE( byteArray, 12960, 12);
    @CAN_PrivMain::RFL_Object::RXX_Object_Obj24.AyVnce = convertRawToPhysical(raw_value, 0.01, 0.0);

    raw_value=copyBitsFromByteArrayLE( byteArray, 13016, 6);
    @CAN_PrivMain::RFL_Object::RXX_Object_Obj24.ExistProb = convertRawToPhysical(raw_value, 2.0, 0.0);

    raw_value=copyBitsFromByteArrayLE( byteArray, 13080, 8);
    @CAN_PrivMain::RFL_Object::RXX_Object_Obj24.FilterInformation = convertRawToPhysical(raw_value, 1.0, 0.0);

    raw_value=copyBitsFromByteArrayLE( byteArray, 12856, 7);
    @CAN_PrivMain::RFL_Object::RXX_Object_Obj24.Length = convertRawToPhysical(raw_value, 0.125, 0.0);

    raw_value=copyBitsFromByteArrayLE( byteArray, 12864, 12);
    @CAN_PrivMain::RFL_Object::RXX_Object_Obj24.LengthVnce = convertRawToPhysical(raw_value, 0.01, 0.0);

    raw_value=copyBitsFromByteArrayLE( byteArray, 13048, 3);
    @CAN_PrivMain::RFL_Object::RXX_Object_Obj24.MeasurementStatus = convertRawToPhysical(raw_value, 1.0, 0.0);

    raw_value=copyBitsFromByteArrayLE( byteArray, 13004, 2);
    @CAN_PrivMain::RFL_Object::RXX_Object_Obj24.MovingStatus = convertRawToPhysical(raw_value, 1.0, 0.0);

    raw_value=copyBitsFromByteArrayLE( byteArray, 12984, 7);
    @CAN_PrivMain::RFL_Object::RXX_Object_Obj24.ObjId = convertRawToPhysical(raw_value, 1.0, 0.0);

    raw_value=copyBitsFromByteArrayLE( byteArray, 12886, 9);
    @CAN_PrivMain::RFL_Object::RXX_Object_Obj24.OrientationYaw = convertRawToPhysical(raw_value, 0.0175, -4.48);

    raw_value=copyBitsFromByteArrayLE( byteArray, 12908, 12);
    @CAN_PrivMain::RFL_Object::RXX_Object_Obj24.OrientationYawVnce = convertRawToPhysical(raw_value, 0.0003, 0.0);

    raw_value=copyBitsFromByteArrayLE( byteArray, 12800, 6);
    @CAN_PrivMain::RFL_Object::RXX_Object_Obj24.ProbClassConfidence = convertRawToPhysical(raw_value, 2.0, 0.0);

    raw_value=copyBitsFromByteArrayLE( byteArray, 13051, 4);
    @CAN_PrivMain::RFL_Object::RXX_Object_Obj24.ProbClassType = convertRawToPhysical(raw_value, 1.0, 0.0);

    raw_value=copyBitsFromByteArrayLE( byteArray, 12806, 14);
    @CAN_PrivMain::RFL_Object::RXX_Object_Obj24.Px = convertRawToPhysical(raw_value, 0.0625, -512.0);

    raw_value=copyBitsFromByteArrayLE( byteArray, 13120, 12);
    @CAN_PrivMain::RFL_Object::RXX_Object_Obj24.PxAxCoVnce = convertRawToPhysical(raw_value, 0.01, 0.0);

    raw_value=copyBitsFromByteArrayLE( byteArray, 13132, 12);
    @CAN_PrivMain::RFL_Object::RXX_Object_Obj24.PxAyCoVnce = convertRawToPhysical(raw_value, 0.01, 0.0);

    raw_value=copyBitsFromByteArrayLE( byteArray, 13036, 12);
    @CAN_PrivMain::RFL_Object::RXX_Object_Obj24.PxPyCoVnce = convertRawToPhysical(raw_value, 0.01, 0.0);

    raw_value=copyBitsFromByteArrayLE( byteArray, 12820, 12);
    @CAN_PrivMain::RFL_Object::RXX_Object_Obj24.PxVnce = convertRawToPhysical(raw_value, 0.1, 0.0);

    raw_value=copyBitsFromByteArrayLE( byteArray, 13056, 12);
    @CAN_PrivMain::RFL_Object::RXX_Object_Obj24.PxVxCoVnce = convertRawToPhysical(raw_value, 0.01, 0.0);

    raw_value=copyBitsFromByteArrayLE( byteArray, 13068, 12);
    @CAN_PrivMain::RFL_Object::RXX_Object_Obj24.PxVyCoVnce = convertRawToPhysical(raw_value, 0.01, 0.0);

    raw_value=copyBitsFromByteArrayLE( byteArray, 12832, 12);
    @CAN_PrivMain::RFL_Object::RXX_Object_Obj24.Py = convertRawToPhysical(raw_value, 0.0625, -128.0);

    raw_value=copyBitsFromByteArrayLE( byteArray, 13152, 12);
    @CAN_PrivMain::RFL_Object::RXX_Object_Obj24.PyAxCoVnce = convertRawToPhysical(raw_value, 0.01, 0.0);

    raw_value=copyBitsFromByteArrayLE( byteArray, 13164, 12);
    @CAN_PrivMain::RFL_Object::RXX_Object_Obj24.PyAyCoVnce = convertRawToPhysical(raw_value, 0.01, 0.0);

    raw_value=copyBitsFromByteArrayLE( byteArray, 12844, 12);
    @CAN_PrivMain::RFL_Object::RXX_Object_Obj24.PyVnce = convertRawToPhysical(raw_value, 0.1, 0.0);

    raw_value=copyBitsFromByteArrayLE( byteArray, 13088, 12);
    @CAN_PrivMain::RFL_Object::RXX_Object_Obj24.PyVxCoVnce = convertRawToPhysical(raw_value, 0.01, 0.0);

    raw_value=copyBitsFromByteArrayLE( byteArray, 13100, 12);
    @CAN_PrivMain::RFL_Object::RXX_Object_Obj24.PyVyCoVnce = convertRawToPhysical(raw_value, 0.01, 0.0);

    raw_value=copyBitsFromByteArrayLE( byteArray, 12940, 10);
    @CAN_PrivMain::RFL_Object::RXX_Object_Obj24.RCS = convertRawToPhysical(raw_value, 0.2, -102.4);

    raw_value=copyBitsFromByteArrayLE( byteArray, 13112, 4);
    @CAN_PrivMain::RFL_Object::RXX_Object_Obj24.ReferencePoint = convertRawToPhysical(raw_value, 1.0, 0.0);

    raw_value=copyBitsFromByteArrayLE( byteArray, 12972, 12);
    @CAN_PrivMain::RFL_Object::RXX_Object_Obj24.Vx = convertRawToPhysical(raw_value, 0.0625, -128.0);

    raw_value=copyBitsFromByteArrayLE( byteArray, 13196, 12);
    @CAN_PrivMain::RFL_Object::RXX_Object_Obj24.VxAxCoVnce = convertRawToPhysical(raw_value, 0.01, 0.0);

    raw_value=copyBitsFromByteArrayLE( byteArray, 13216, 12);
    @CAN_PrivMain::RFL_Object::RXX_Object_Obj24.VxAyCoVnce = convertRawToPhysical(raw_value, 0.01, 0.0);

    raw_value=copyBitsFromByteArrayLE( byteArray, 12992, 12);
    @CAN_PrivMain::RFL_Object::RXX_Object_Obj24.VxVnce = convertRawToPhysical(raw_value, 0.01, 0.0);

    raw_value=copyBitsFromByteArrayLE( byteArray, 13184, 12);
    @CAN_PrivMain::RFL_Object::RXX_Object_Obj24.VxVyCoVnce = convertRawToPhysical(raw_value, 0.01, 0.0);

    raw_value=copyBitsFromByteArrayLE( byteArray, 13006, 10);
    @CAN_PrivMain::RFL_Object::RXX_Object_Obj24.Vy = convertRawToPhysical(raw_value, 0.125, -64.0);

    raw_value=copyBitsFromByteArrayLE( byteArray, 13228, 12);
    @CAN_PrivMain::RFL_Object::RXX_Object_Obj24.VyAxCoVnce = convertRawToPhysical(raw_value, 0.01, 0.0);

    raw_value=copyBitsFromByteArrayLE( byteArray, 13248, 12);
    @CAN_PrivMain::RFL_Object::RXX_Object_Obj24.VyAyCoVnce = convertRawToPhysical(raw_value, 0.01, 0.0);

    raw_value=copyBitsFromByteArrayLE( byteArray, 13024, 12);
    @CAN_PrivMain::RFL_Object::RXX_Object_Obj24.VyVnce = convertRawToPhysical(raw_value, 0.01, 0.0);

    raw_value=copyBitsFromByteArrayLE( byteArray, 12920, 7);
    @CAN_PrivMain::RFL_Object::RXX_Object_Obj24.Width = convertRawToPhysical(raw_value, 0.125, 0.0);

    raw_value=copyBitsFromByteArrayLE( byteArray, 12928, 12);
    @CAN_PrivMain::RFL_Object::RXX_Object_Obj24.WidthVnce = convertRawToPhysical(raw_value, 0.01, 0.0);
}


void CRadarFL_RXX_Object_Obj25_SetDataReceived(byte byteArray[])
{
    qword raw_value;

    raw_value=copyBitsFromByteArrayLE( byteArray, 13792, 32);
    @CAN_PrivMain::RFL_Object::RXX_Object_Obj25.Age = convertRawToPhysical(raw_value, 1.0, 0.0);

    raw_value=copyBitsFromByteArrayLE( byteArray, 13388, 10);
    @CAN_PrivMain::RFL_Object::RXX_Object_Obj25.Ax = convertRawToPhysical(raw_value, 0.03125, -16.0);

    raw_value=copyBitsFromByteArrayLE( byteArray, 13772, 12);
    @CAN_PrivMain::RFL_Object::RXX_Object_Obj25.AxAyCoVnce = convertRawToPhysical(raw_value, 0.01, 0.0);

    raw_value=copyBitsFromByteArrayLE( byteArray, 13408, 12);
    @CAN_PrivMain::RFL_Object::RXX_Object_Obj25.AxVnce = convertRawToPhysical(raw_value, 0.01, 0.0);

    raw_value=copyBitsFromByteArrayLE( byteArray, 13462, 9);
    @CAN_PrivMain::RFL_Object::RXX_Object_Obj25.Ay = convertRawToPhysical(raw_value, 0.0625, -16.0);

    raw_value=copyBitsFromByteArrayLE( byteArray, 13472, 12);
    @CAN_PrivMain::RFL_Object::RXX_Object_Obj25.AyVnce = convertRawToPhysical(raw_value, 0.01, 0.0);

    raw_value=copyBitsFromByteArrayLE( byteArray, 13528, 6);
    @CAN_PrivMain::RFL_Object::RXX_Object_Obj25.ExistProb = convertRawToPhysical(raw_value, 2.0, 0.0);

    raw_value=copyBitsFromByteArrayLE( byteArray, 13592, 8);
    @CAN_PrivMain::RFL_Object::RXX_Object_Obj25.FilterInformation = convertRawToPhysical(raw_value, 1.0, 0.0);

    raw_value=copyBitsFromByteArrayLE( byteArray, 13368, 7);
    @CAN_PrivMain::RFL_Object::RXX_Object_Obj25.Length = convertRawToPhysical(raw_value, 0.125, 0.0);

    raw_value=copyBitsFromByteArrayLE( byteArray, 13376, 12);
    @CAN_PrivMain::RFL_Object::RXX_Object_Obj25.LengthVnce = convertRawToPhysical(raw_value, 0.01, 0.0);

    raw_value=copyBitsFromByteArrayLE( byteArray, 13560, 3);
    @CAN_PrivMain::RFL_Object::RXX_Object_Obj25.MeasurementStatus = convertRawToPhysical(raw_value, 1.0, 0.0);

    raw_value=copyBitsFromByteArrayLE( byteArray, 13516, 2);
    @CAN_PrivMain::RFL_Object::RXX_Object_Obj25.MovingStatus = convertRawToPhysical(raw_value, 1.0, 0.0);

    raw_value=copyBitsFromByteArrayLE( byteArray, 13496, 7);
    @CAN_PrivMain::RFL_Object::RXX_Object_Obj25.ObjId = convertRawToPhysical(raw_value, 1.0, 0.0);

    raw_value=copyBitsFromByteArrayLE( byteArray, 13398, 9);
    @CAN_PrivMain::RFL_Object::RXX_Object_Obj25.OrientationYaw = convertRawToPhysical(raw_value, 0.0175, -4.48);

    raw_value=copyBitsFromByteArrayLE( byteArray, 13420, 12);
    @CAN_PrivMain::RFL_Object::RXX_Object_Obj25.OrientationYawVnce = convertRawToPhysical(raw_value, 0.0003, 0.0);

    raw_value=copyBitsFromByteArrayLE( byteArray, 13312, 6);
    @CAN_PrivMain::RFL_Object::RXX_Object_Obj25.ProbClassConfidence = convertRawToPhysical(raw_value, 2.0, 0.0);

    raw_value=copyBitsFromByteArrayLE( byteArray, 13563, 4);
    @CAN_PrivMain::RFL_Object::RXX_Object_Obj25.ProbClassType = convertRawToPhysical(raw_value, 1.0, 0.0);

    raw_value=copyBitsFromByteArrayLE( byteArray, 13318, 14);
    @CAN_PrivMain::RFL_Object::RXX_Object_Obj25.Px = convertRawToPhysical(raw_value, 0.0625, -512.0);

    raw_value=copyBitsFromByteArrayLE( byteArray, 13632, 12);
    @CAN_PrivMain::RFL_Object::RXX_Object_Obj25.PxAxCoVnce = convertRawToPhysical(raw_value, 0.01, 0.0);

    raw_value=copyBitsFromByteArrayLE( byteArray, 13644, 12);
    @CAN_PrivMain::RFL_Object::RXX_Object_Obj25.PxAyCoVnce = convertRawToPhysical(raw_value, 0.01, 0.0);

    raw_value=copyBitsFromByteArrayLE( byteArray, 13548, 12);
    @CAN_PrivMain::RFL_Object::RXX_Object_Obj25.PxPyCoVnce = convertRawToPhysical(raw_value, 0.01, 0.0);

    raw_value=copyBitsFromByteArrayLE( byteArray, 13332, 12);
    @CAN_PrivMain::RFL_Object::RXX_Object_Obj25.PxVnce = convertRawToPhysical(raw_value, 0.1, 0.0);

    raw_value=copyBitsFromByteArrayLE( byteArray, 13568, 12);
    @CAN_PrivMain::RFL_Object::RXX_Object_Obj25.PxVxCoVnce = convertRawToPhysical(raw_value, 0.01, 0.0);

    raw_value=copyBitsFromByteArrayLE( byteArray, 13580, 12);
    @CAN_PrivMain::RFL_Object::RXX_Object_Obj25.PxVyCoVnce = convertRawToPhysical(raw_value, 0.01, 0.0);

    raw_value=copyBitsFromByteArrayLE( byteArray, 13344, 12);
    @CAN_PrivMain::RFL_Object::RXX_Object_Obj25.Py = convertRawToPhysical(raw_value, 0.0625, -128.0);

    raw_value=copyBitsFromByteArrayLE( byteArray, 13664, 12);
    @CAN_PrivMain::RFL_Object::RXX_Object_Obj25.PyAxCoVnce = convertRawToPhysical(raw_value, 0.01, 0.0);

    raw_value=copyBitsFromByteArrayLE( byteArray, 13676, 12);
    @CAN_PrivMain::RFL_Object::RXX_Object_Obj25.PyAyCoVnce = convertRawToPhysical(raw_value, 0.01, 0.0);

    raw_value=copyBitsFromByteArrayLE( byteArray, 13356, 12);
    @CAN_PrivMain::RFL_Object::RXX_Object_Obj25.PyVnce = convertRawToPhysical(raw_value, 0.1, 0.0);

    raw_value=copyBitsFromByteArrayLE( byteArray, 13600, 12);
    @CAN_PrivMain::RFL_Object::RXX_Object_Obj25.PyVxCoVnce = convertRawToPhysical(raw_value, 0.01, 0.0);

    raw_value=copyBitsFromByteArrayLE( byteArray, 13612, 12);
    @CAN_PrivMain::RFL_Object::RXX_Object_Obj25.PyVyCoVnce = convertRawToPhysical(raw_value, 0.01, 0.0);

    raw_value=copyBitsFromByteArrayLE( byteArray, 13452, 10);
    @CAN_PrivMain::RFL_Object::RXX_Object_Obj25.RCS = convertRawToPhysical(raw_value, 0.2, -102.4);

    raw_value=copyBitsFromByteArrayLE( byteArray, 13624, 4);
    @CAN_PrivMain::RFL_Object::RXX_Object_Obj25.ReferencePoint = convertRawToPhysical(raw_value, 1.0, 0.0);

    raw_value=copyBitsFromByteArrayLE( byteArray, 13484, 12);
    @CAN_PrivMain::RFL_Object::RXX_Object_Obj25.Vx = convertRawToPhysical(raw_value, 0.0625, -128.0);

    raw_value=copyBitsFromByteArrayLE( byteArray, 13708, 12);
    @CAN_PrivMain::RFL_Object::RXX_Object_Obj25.VxAxCoVnce = convertRawToPhysical(raw_value, 0.01, 0.0);

    raw_value=copyBitsFromByteArrayLE( byteArray, 13728, 12);
    @CAN_PrivMain::RFL_Object::RXX_Object_Obj25.VxAyCoVnce = convertRawToPhysical(raw_value, 0.01, 0.0);

    raw_value=copyBitsFromByteArrayLE( byteArray, 13504, 12);
    @CAN_PrivMain::RFL_Object::RXX_Object_Obj25.VxVnce = convertRawToPhysical(raw_value, 0.01, 0.0);

    raw_value=copyBitsFromByteArrayLE( byteArray, 13696, 12);
    @CAN_PrivMain::RFL_Object::RXX_Object_Obj25.VxVyCoVnce = convertRawToPhysical(raw_value, 0.01, 0.0);

    raw_value=copyBitsFromByteArrayLE( byteArray, 13518, 10);
    @CAN_PrivMain::RFL_Object::RXX_Object_Obj25.Vy = convertRawToPhysical(raw_value, 0.125, -64.0);

    raw_value=copyBitsFromByteArrayLE( byteArray, 13740, 12);
    @CAN_PrivMain::RFL_Object::RXX_Object_Obj25.VyAxCoVnce = convertRawToPhysical(raw_value, 0.01, 0.0);

    raw_value=copyBitsFromByteArrayLE( byteArray, 13760, 12);
    @CAN_PrivMain::RFL_Object::RXX_Object_Obj25.VyAyCoVnce = convertRawToPhysical(raw_value, 0.01, 0.0);

    raw_value=copyBitsFromByteArrayLE( byteArray, 13536, 12);
    @CAN_PrivMain::RFL_Object::RXX_Object_Obj25.VyVnce = convertRawToPhysical(raw_value, 0.01, 0.0);

    raw_value=copyBitsFromByteArrayLE( byteArray, 13432, 7);
    @CAN_PrivMain::RFL_Object::RXX_Object_Obj25.Width = convertRawToPhysical(raw_value, 0.125, 0.0);

    raw_value=copyBitsFromByteArrayLE( byteArray, 13440, 12);
    @CAN_PrivMain::RFL_Object::RXX_Object_Obj25.WidthVnce = convertRawToPhysical(raw_value, 0.01, 0.0);
}


void CRadarFL_RXX_Object_Obj26_SetDataReceived(byte byteArray[])
{
    qword raw_value;

    raw_value=copyBitsFromByteArrayLE( byteArray, 14304, 32);
    @CAN_PrivMain::RFL_Object::RXX_Object_Obj26.Age = convertRawToPhysical(raw_value, 1.0, 0.0);

    raw_value=copyBitsFromByteArrayLE( byteArray, 13900, 10);
    @CAN_PrivMain::RFL_Object::RXX_Object_Obj26.Ax = convertRawToPhysical(raw_value, 0.03125, -16.0);

    raw_value=copyBitsFromByteArrayLE( byteArray, 14284, 12);
    @CAN_PrivMain::RFL_Object::RXX_Object_Obj26.AxAyCoVnce = convertRawToPhysical(raw_value, 0.01, 0.0);

    raw_value=copyBitsFromByteArrayLE( byteArray, 13920, 12);
    @CAN_PrivMain::RFL_Object::RXX_Object_Obj26.AxVnce = convertRawToPhysical(raw_value, 0.01, 0.0);

    raw_value=copyBitsFromByteArrayLE( byteArray, 13974, 9);
    @CAN_PrivMain::RFL_Object::RXX_Object_Obj26.Ay = convertRawToPhysical(raw_value, 0.0625, -16.0);

    raw_value=copyBitsFromByteArrayLE( byteArray, 13984, 12);
    @CAN_PrivMain::RFL_Object::RXX_Object_Obj26.AyVnce = convertRawToPhysical(raw_value, 0.01, 0.0);

    raw_value=copyBitsFromByteArrayLE( byteArray, 14040, 6);
    @CAN_PrivMain::RFL_Object::RXX_Object_Obj26.ExistProb = convertRawToPhysical(raw_value, 2.0, 0.0);

    raw_value=copyBitsFromByteArrayLE( byteArray, 14104, 8);
    @CAN_PrivMain::RFL_Object::RXX_Object_Obj26.FilterInformation = convertRawToPhysical(raw_value, 1.0, 0.0);

    raw_value=copyBitsFromByteArrayLE( byteArray, 13880, 7);
    @CAN_PrivMain::RFL_Object::RXX_Object_Obj26.Length = convertRawToPhysical(raw_value, 0.125, 0.0);

    raw_value=copyBitsFromByteArrayLE( byteArray, 13888, 12);
    @CAN_PrivMain::RFL_Object::RXX_Object_Obj26.LengthVnce = convertRawToPhysical(raw_value, 0.01, 0.0);

    raw_value=copyBitsFromByteArrayLE( byteArray, 14072, 3);
    @CAN_PrivMain::RFL_Object::RXX_Object_Obj26.MeasurementStatus = convertRawToPhysical(raw_value, 1.0, 0.0);

    raw_value=copyBitsFromByteArrayLE( byteArray, 14028, 2);
    @CAN_PrivMain::RFL_Object::RXX_Object_Obj26.MovingStatus = convertRawToPhysical(raw_value, 1.0, 0.0);

    raw_value=copyBitsFromByteArrayLE( byteArray, 14008, 7);
    @CAN_PrivMain::RFL_Object::RXX_Object_Obj26.ObjId = convertRawToPhysical(raw_value, 1.0, 0.0);

    raw_value=copyBitsFromByteArrayLE( byteArray, 13910, 9);
    @CAN_PrivMain::RFL_Object::RXX_Object_Obj26.OrientationYaw = convertRawToPhysical(raw_value, 0.0175, -4.48);

    raw_value=copyBitsFromByteArrayLE( byteArray, 13932, 12);
    @CAN_PrivMain::RFL_Object::RXX_Object_Obj26.OrientationYawVnce = convertRawToPhysical(raw_value, 0.0003, 0.0);

    raw_value=copyBitsFromByteArrayLE( byteArray, 13824, 6);
    @CAN_PrivMain::RFL_Object::RXX_Object_Obj26.ProbClassConfidence = convertRawToPhysical(raw_value, 2.0, 0.0);

    raw_value=copyBitsFromByteArrayLE( byteArray, 14075, 4);
    @CAN_PrivMain::RFL_Object::RXX_Object_Obj26.ProbClassType = convertRawToPhysical(raw_value, 1.0, 0.0);

    raw_value=copyBitsFromByteArrayLE( byteArray, 13830, 14);
    @CAN_PrivMain::RFL_Object::RXX_Object_Obj26.Px = convertRawToPhysical(raw_value, 0.0625, -512.0);

    raw_value=copyBitsFromByteArrayLE( byteArray, 14144, 12);
    @CAN_PrivMain::RFL_Object::RXX_Object_Obj26.PxAxCoVnce = convertRawToPhysical(raw_value, 0.01, 0.0);

    raw_value=copyBitsFromByteArrayLE( byteArray, 14156, 12);
    @CAN_PrivMain::RFL_Object::RXX_Object_Obj26.PxAyCoVnce = convertRawToPhysical(raw_value, 0.01, 0.0);

    raw_value=copyBitsFromByteArrayLE( byteArray, 14060, 12);
    @CAN_PrivMain::RFL_Object::RXX_Object_Obj26.PxPyCoVnce = convertRawToPhysical(raw_value, 0.01, 0.0);

    raw_value=copyBitsFromByteArrayLE( byteArray, 13844, 12);
    @CAN_PrivMain::RFL_Object::RXX_Object_Obj26.PxVnce = convertRawToPhysical(raw_value, 0.1, 0.0);

    raw_value=copyBitsFromByteArrayLE( byteArray, 14080, 12);
    @CAN_PrivMain::RFL_Object::RXX_Object_Obj26.PxVxCoVnce = convertRawToPhysical(raw_value, 0.01, 0.0);

    raw_value=copyBitsFromByteArrayLE( byteArray, 14092, 12);
    @CAN_PrivMain::RFL_Object::RXX_Object_Obj26.PxVyCoVnce = convertRawToPhysical(raw_value, 0.01, 0.0);

    raw_value=copyBitsFromByteArrayLE( byteArray, 13856, 12);
    @CAN_PrivMain::RFL_Object::RXX_Object_Obj26.Py = convertRawToPhysical(raw_value, 0.0625, -128.0);

    raw_value=copyBitsFromByteArrayLE( byteArray, 14176, 12);
    @CAN_PrivMain::RFL_Object::RXX_Object_Obj26.PyAxCoVnce = convertRawToPhysical(raw_value, 0.01, 0.0);

    raw_value=copyBitsFromByteArrayLE( byteArray, 14188, 12);
    @CAN_PrivMain::RFL_Object::RXX_Object_Obj26.PyAyCoVnce = convertRawToPhysical(raw_value, 0.01, 0.0);

    raw_value=copyBitsFromByteArrayLE( byteArray, 13868, 12);
    @CAN_PrivMain::RFL_Object::RXX_Object_Obj26.PyVnce = convertRawToPhysical(raw_value, 0.1, 0.0);

    raw_value=copyBitsFromByteArrayLE( byteArray, 14112, 12);
    @CAN_PrivMain::RFL_Object::RXX_Object_Obj26.PyVxCoVnce = convertRawToPhysical(raw_value, 0.01, 0.0);

    raw_value=copyBitsFromByteArrayLE( byteArray, 14124, 12);
    @CAN_PrivMain::RFL_Object::RXX_Object_Obj26.PyVyCoVnce = convertRawToPhysical(raw_value, 0.01, 0.0);

    raw_value=copyBitsFromByteArrayLE( byteArray, 13964, 10);
    @CAN_PrivMain::RFL_Object::RXX_Object_Obj26.RCS = convertRawToPhysical(raw_value, 0.2, -102.4);

    raw_value=copyBitsFromByteArrayLE( byteArray, 14136, 4);
    @CAN_PrivMain::RFL_Object::RXX_Object_Obj26.ReferencePoint = convertRawToPhysical(raw_value, 1.0, 0.0);

    raw_value=copyBitsFromByteArrayLE( byteArray, 13996, 12);
    @CAN_PrivMain::RFL_Object::RXX_Object_Obj26.Vx = convertRawToPhysical(raw_value, 0.0625, -128.0);

    raw_value=copyBitsFromByteArrayLE( byteArray, 14220, 12);
    @CAN_PrivMain::RFL_Object::RXX_Object_Obj26.VxAxCoVnce = convertRawToPhysical(raw_value, 0.01, 0.0);

    raw_value=copyBitsFromByteArrayLE( byteArray, 14240, 12);
    @CAN_PrivMain::RFL_Object::RXX_Object_Obj26.VxAyCoVnce = convertRawToPhysical(raw_value, 0.01, 0.0);

    raw_value=copyBitsFromByteArrayLE( byteArray, 14016, 12);
    @CAN_PrivMain::RFL_Object::RXX_Object_Obj26.VxVnce = convertRawToPhysical(raw_value, 0.01, 0.0);

    raw_value=copyBitsFromByteArrayLE( byteArray, 14208, 12);
    @CAN_PrivMain::RFL_Object::RXX_Object_Obj26.VxVyCoVnce = convertRawToPhysical(raw_value, 0.01, 0.0);

    raw_value=copyBitsFromByteArrayLE( byteArray, 14030, 10);
    @CAN_PrivMain::RFL_Object::RXX_Object_Obj26.Vy = convertRawToPhysical(raw_value, 0.125, -64.0);

    raw_value=copyBitsFromByteArrayLE( byteArray, 14252, 12);
    @CAN_PrivMain::RFL_Object::RXX_Object_Obj26.VyAxCoVnce = convertRawToPhysical(raw_value, 0.01, 0.0);

    raw_value=copyBitsFromByteArrayLE( byteArray, 14272, 12);
    @CAN_PrivMain::RFL_Object::RXX_Object_Obj26.VyAyCoVnce = convertRawToPhysical(raw_value, 0.01, 0.0);

    raw_value=copyBitsFromByteArrayLE( byteArray, 14048, 12);
    @CAN_PrivMain::RFL_Object::RXX_Object_Obj26.VyVnce = convertRawToPhysical(raw_value, 0.01, 0.0);

    raw_value=copyBitsFromByteArrayLE( byteArray, 13944, 7);
    @CAN_PrivMain::RFL_Object::RXX_Object_Obj26.Width = convertRawToPhysical(raw_value, 0.125, 0.0);

    raw_value=copyBitsFromByteArrayLE( byteArray, 13952, 12);
    @CAN_PrivMain::RFL_Object::RXX_Object_Obj26.WidthVnce = convertRawToPhysical(raw_value, 0.01, 0.0);
}


void CRadarFL_RXX_Object_Obj27_SetDataReceived(byte byteArray[])
{
    qword raw_value;

    raw_value=copyBitsFromByteArrayLE( byteArray, 14816, 32);
    @CAN_PrivMain::RFL_Object::RXX_Object_Obj27.Age = convertRawToPhysical(raw_value, 1.0, 0.0);

    raw_value=copyBitsFromByteArrayLE( byteArray, 14412, 10);
    @CAN_PrivMain::RFL_Object::RXX_Object_Obj27.Ax = convertRawToPhysical(raw_value, 0.03125, -16.0);

    raw_value=copyBitsFromByteArrayLE( byteArray, 14796, 12);
    @CAN_PrivMain::RFL_Object::RXX_Object_Obj27.AxAyCoVnce = convertRawToPhysical(raw_value, 0.01, 0.0);

    raw_value=copyBitsFromByteArrayLE( byteArray, 14432, 12);
    @CAN_PrivMain::RFL_Object::RXX_Object_Obj27.AxVnce = convertRawToPhysical(raw_value, 0.01, 0.0);

    raw_value=copyBitsFromByteArrayLE( byteArray, 14486, 9);
    @CAN_PrivMain::RFL_Object::RXX_Object_Obj27.Ay = convertRawToPhysical(raw_value, 0.0625, -16.0);

    raw_value=copyBitsFromByteArrayLE( byteArray, 14496, 12);
    @CAN_PrivMain::RFL_Object::RXX_Object_Obj27.AyVnce = convertRawToPhysical(raw_value, 0.01, 0.0);

    raw_value=copyBitsFromByteArrayLE( byteArray, 14552, 6);
    @CAN_PrivMain::RFL_Object::RXX_Object_Obj27.ExistProb = convertRawToPhysical(raw_value, 2.0, 0.0);

    raw_value=copyBitsFromByteArrayLE( byteArray, 14616, 8);
    @CAN_PrivMain::RFL_Object::RXX_Object_Obj27.FilterInformation = convertRawToPhysical(raw_value, 1.0, 0.0);

    raw_value=copyBitsFromByteArrayLE( byteArray, 14392, 7);
    @CAN_PrivMain::RFL_Object::RXX_Object_Obj27.Length = convertRawToPhysical(raw_value, 0.125, 0.0);

    raw_value=copyBitsFromByteArrayLE( byteArray, 14400, 12);
    @CAN_PrivMain::RFL_Object::RXX_Object_Obj27.LengthVnce = convertRawToPhysical(raw_value, 0.01, 0.0);

    raw_value=copyBitsFromByteArrayLE( byteArray, 14584, 3);
    @CAN_PrivMain::RFL_Object::RXX_Object_Obj27.MeasurementStatus = convertRawToPhysical(raw_value, 1.0, 0.0);

    raw_value=copyBitsFromByteArrayLE( byteArray, 14540, 2);
    @CAN_PrivMain::RFL_Object::RXX_Object_Obj27.MovingStatus = convertRawToPhysical(raw_value, 1.0, 0.0);

    raw_value=copyBitsFromByteArrayLE( byteArray, 14520, 7);
    @CAN_PrivMain::RFL_Object::RXX_Object_Obj27.ObjId = convertRawToPhysical(raw_value, 1.0, 0.0);

    raw_value=copyBitsFromByteArrayLE( byteArray, 14422, 9);
    @CAN_PrivMain::RFL_Object::RXX_Object_Obj27.OrientationYaw = convertRawToPhysical(raw_value, 0.0175, -4.48);

    raw_value=copyBitsFromByteArrayLE( byteArray, 14444, 12);
    @CAN_PrivMain::RFL_Object::RXX_Object_Obj27.OrientationYawVnce = convertRawToPhysical(raw_value, 0.0003, 0.0);

    raw_value=copyBitsFromByteArrayLE( byteArray, 14336, 6);
    @CAN_PrivMain::RFL_Object::RXX_Object_Obj27.ProbClassConfidence = convertRawToPhysical(raw_value, 2.0, 0.0);

    raw_value=copyBitsFromByteArrayLE( byteArray, 14587, 4);
    @CAN_PrivMain::RFL_Object::RXX_Object_Obj27.ProbClassType = convertRawToPhysical(raw_value, 1.0, 0.0);

    raw_value=copyBitsFromByteArrayLE( byteArray, 14342, 14);
    @CAN_PrivMain::RFL_Object::RXX_Object_Obj27.Px = convertRawToPhysical(raw_value, 0.0625, -512.0);

    raw_value=copyBitsFromByteArrayLE( byteArray, 14656, 12);
    @CAN_PrivMain::RFL_Object::RXX_Object_Obj27.PxAxCoVnce = convertRawToPhysical(raw_value, 0.01, 0.0);

    raw_value=copyBitsFromByteArrayLE( byteArray, 14668, 12);
    @CAN_PrivMain::RFL_Object::RXX_Object_Obj27.PxAyCoVnce = convertRawToPhysical(raw_value, 0.01, 0.0);

    raw_value=copyBitsFromByteArrayLE( byteArray, 14572, 12);
    @CAN_PrivMain::RFL_Object::RXX_Object_Obj27.PxPyCoVnce = convertRawToPhysical(raw_value, 0.01, 0.0);

    raw_value=copyBitsFromByteArrayLE( byteArray, 14356, 12);
    @CAN_PrivMain::RFL_Object::RXX_Object_Obj27.PxVnce = convertRawToPhysical(raw_value, 0.1, 0.0);

    raw_value=copyBitsFromByteArrayLE( byteArray, 14592, 12);
    @CAN_PrivMain::RFL_Object::RXX_Object_Obj27.PxVxCoVnce = convertRawToPhysical(raw_value, 0.01, 0.0);

    raw_value=copyBitsFromByteArrayLE( byteArray, 14604, 12);
    @CAN_PrivMain::RFL_Object::RXX_Object_Obj27.PxVyCoVnce = convertRawToPhysical(raw_value, 0.01, 0.0);

    raw_value=copyBitsFromByteArrayLE( byteArray, 14368, 12);
    @CAN_PrivMain::RFL_Object::RXX_Object_Obj27.Py = convertRawToPhysical(raw_value, 0.0625, -128.0);

    raw_value=copyBitsFromByteArrayLE( byteArray, 14688, 12);
    @CAN_PrivMain::RFL_Object::RXX_Object_Obj27.PyAxCoVnce = convertRawToPhysical(raw_value, 0.01, 0.0);

    raw_value=copyBitsFromByteArrayLE( byteArray, 14700, 12);
    @CAN_PrivMain::RFL_Object::RXX_Object_Obj27.PyAyCoVnce = convertRawToPhysical(raw_value, 0.01, 0.0);

    raw_value=copyBitsFromByteArrayLE( byteArray, 14380, 12);
    @CAN_PrivMain::RFL_Object::RXX_Object_Obj27.PyVnce = convertRawToPhysical(raw_value, 0.1, 0.0);

    raw_value=copyBitsFromByteArrayLE( byteArray, 14624, 12);
    @CAN_PrivMain::RFL_Object::RXX_Object_Obj27.PyVxCoVnce = convertRawToPhysical(raw_value, 0.01, 0.0);

    raw_value=copyBitsFromByteArrayLE( byteArray, 14636, 12);
    @CAN_PrivMain::RFL_Object::RXX_Object_Obj27.PyVyCoVnce = convertRawToPhysical(raw_value, 0.01, 0.0);

    raw_value=copyBitsFromByteArrayLE( byteArray, 14476, 10);
    @CAN_PrivMain::RFL_Object::RXX_Object_Obj27.RCS = convertRawToPhysical(raw_value, 0.2, -102.4);

    raw_value=copyBitsFromByteArrayLE( byteArray, 14648, 4);
    @CAN_PrivMain::RFL_Object::RXX_Object_Obj27.ReferencePoint = convertRawToPhysical(raw_value, 1.0, 0.0);

    raw_value=copyBitsFromByteArrayLE( byteArray, 14508, 12);
    @CAN_PrivMain::RFL_Object::RXX_Object_Obj27.Vx = convertRawToPhysical(raw_value, 0.0625, -128.0);

    raw_value=copyBitsFromByteArrayLE( byteArray, 14732, 12);
    @CAN_PrivMain::RFL_Object::RXX_Object_Obj27.VxAxCoVnce = convertRawToPhysical(raw_value, 0.01, 0.0);

    raw_value=copyBitsFromByteArrayLE( byteArray, 14752, 12);
    @CAN_PrivMain::RFL_Object::RXX_Object_Obj27.VxAyCoVnce = convertRawToPhysical(raw_value, 0.01, 0.0);

    raw_value=copyBitsFromByteArrayLE( byteArray, 14528, 12);
    @CAN_PrivMain::RFL_Object::RXX_Object_Obj27.VxVnce = convertRawToPhysical(raw_value, 0.01, 0.0);

    raw_value=copyBitsFromByteArrayLE( byteArray, 14720, 12);
    @CAN_PrivMain::RFL_Object::RXX_Object_Obj27.VxVyCoVnce = convertRawToPhysical(raw_value, 0.01, 0.0);

    raw_value=copyBitsFromByteArrayLE( byteArray, 14542, 10);
    @CAN_PrivMain::RFL_Object::RXX_Object_Obj27.Vy = convertRawToPhysical(raw_value, 0.125, -64.0);

    raw_value=copyBitsFromByteArrayLE( byteArray, 14764, 12);
    @CAN_PrivMain::RFL_Object::RXX_Object_Obj27.VyAxCoVnce = convertRawToPhysical(raw_value, 0.01, 0.0);

    raw_value=copyBitsFromByteArrayLE( byteArray, 14784, 12);
    @CAN_PrivMain::RFL_Object::RXX_Object_Obj27.VyAyCoVnce = convertRawToPhysical(raw_value, 0.01, 0.0);

    raw_value=copyBitsFromByteArrayLE( byteArray, 14560, 12);
    @CAN_PrivMain::RFL_Object::RXX_Object_Obj27.VyVnce = convertRawToPhysical(raw_value, 0.01, 0.0);

    raw_value=copyBitsFromByteArrayLE( byteArray, 14456, 7);
    @CAN_PrivMain::RFL_Object::RXX_Object_Obj27.Width = convertRawToPhysical(raw_value, 0.125, 0.0);

    raw_value=copyBitsFromByteArrayLE( byteArray, 14464, 12);
    @CAN_PrivMain::RFL_Object::RXX_Object_Obj27.WidthVnce = convertRawToPhysical(raw_value, 0.01, 0.0);
}


void CRadarFL_RXX_Object_Obj28_SetDataReceived(byte byteArray[])
{
    qword raw_value;

    raw_value=copyBitsFromByteArrayLE( byteArray, 15328, 32);
    @CAN_PrivMain::RFL_Object::RXX_Object_Obj28.Age = convertRawToPhysical(raw_value, 1.0, 0.0);

    raw_value=copyBitsFromByteArrayLE( byteArray, 14924, 10);
    @CAN_PrivMain::RFL_Object::RXX_Object_Obj28.Ax = convertRawToPhysical(raw_value, 0.03125, -16.0);

    raw_value=copyBitsFromByteArrayLE( byteArray, 15308, 12);
    @CAN_PrivMain::RFL_Object::RXX_Object_Obj28.AxAyCoVnce = convertRawToPhysical(raw_value, 0.01, 0.0);

    raw_value=copyBitsFromByteArrayLE( byteArray, 14944, 12);
    @CAN_PrivMain::RFL_Object::RXX_Object_Obj28.AxVnce = convertRawToPhysical(raw_value, 0.01, 0.0);

    raw_value=copyBitsFromByteArrayLE( byteArray, 14998, 9);
    @CAN_PrivMain::RFL_Object::RXX_Object_Obj28.Ay = convertRawToPhysical(raw_value, 0.0625, -16.0);

    raw_value=copyBitsFromByteArrayLE( byteArray, 15008, 12);
    @CAN_PrivMain::RFL_Object::RXX_Object_Obj28.AyVnce = convertRawToPhysical(raw_value, 0.01, 0.0);

    raw_value=copyBitsFromByteArrayLE( byteArray, 15064, 6);
    @CAN_PrivMain::RFL_Object::RXX_Object_Obj28.ExistProb = convertRawToPhysical(raw_value, 2.0, 0.0);

    raw_value=copyBitsFromByteArrayLE( byteArray, 15128, 8);
    @CAN_PrivMain::RFL_Object::RXX_Object_Obj28.FilterInformation = convertRawToPhysical(raw_value, 1.0, 0.0);

    raw_value=copyBitsFromByteArrayLE( byteArray, 14904, 7);
    @CAN_PrivMain::RFL_Object::RXX_Object_Obj28.Length = convertRawToPhysical(raw_value, 0.125, 0.0);

    raw_value=copyBitsFromByteArrayLE( byteArray, 14912, 12);
    @CAN_PrivMain::RFL_Object::RXX_Object_Obj28.LengthVnce = convertRawToPhysical(raw_value, 0.01, 0.0);

    raw_value=copyBitsFromByteArrayLE( byteArray, 15096, 3);
    @CAN_PrivMain::RFL_Object::RXX_Object_Obj28.MeasurementStatus = convertRawToPhysical(raw_value, 1.0, 0.0);

    raw_value=copyBitsFromByteArrayLE( byteArray, 15052, 2);
    @CAN_PrivMain::RFL_Object::RXX_Object_Obj28.MovingStatus = convertRawToPhysical(raw_value, 1.0, 0.0);

    raw_value=copyBitsFromByteArrayLE( byteArray, 15032, 7);
    @CAN_PrivMain::RFL_Object::RXX_Object_Obj28.ObjId = convertRawToPhysical(raw_value, 1.0, 0.0);

    raw_value=copyBitsFromByteArrayLE( byteArray, 14934, 9);
    @CAN_PrivMain::RFL_Object::RXX_Object_Obj28.OrientationYaw = convertRawToPhysical(raw_value, 0.0175, -4.48);

    raw_value=copyBitsFromByteArrayLE( byteArray, 14956, 12);
    @CAN_PrivMain::RFL_Object::RXX_Object_Obj28.OrientationYawVnce = convertRawToPhysical(raw_value, 0.0003, 0.0);

    raw_value=copyBitsFromByteArrayLE( byteArray, 14848, 6);
    @CAN_PrivMain::RFL_Object::RXX_Object_Obj28.ProbClassConfidence = convertRawToPhysical(raw_value, 2.0, 0.0);

    raw_value=copyBitsFromByteArrayLE( byteArray, 15099, 4);
    @CAN_PrivMain::RFL_Object::RXX_Object_Obj28.ProbClassType = convertRawToPhysical(raw_value, 1.0, 0.0);

    raw_value=copyBitsFromByteArrayLE( byteArray, 14854, 14);
    @CAN_PrivMain::RFL_Object::RXX_Object_Obj28.Px = convertRawToPhysical(raw_value, 0.0625, -512.0);

    raw_value=copyBitsFromByteArrayLE( byteArray, 15168, 12);
    @CAN_PrivMain::RFL_Object::RXX_Object_Obj28.PxAxCoVnce = convertRawToPhysical(raw_value, 0.01, 0.0);

    raw_value=copyBitsFromByteArrayLE( byteArray, 15180, 12);
    @CAN_PrivMain::RFL_Object::RXX_Object_Obj28.PxAyCoVnce = convertRawToPhysical(raw_value, 0.01, 0.0);

    raw_value=copyBitsFromByteArrayLE( byteArray, 15084, 12);
    @CAN_PrivMain::RFL_Object::RXX_Object_Obj28.PxPyCoVnce = convertRawToPhysical(raw_value, 0.01, 0.0);

    raw_value=copyBitsFromByteArrayLE( byteArray, 14868, 12);
    @CAN_PrivMain::RFL_Object::RXX_Object_Obj28.PxVnce = convertRawToPhysical(raw_value, 0.1, 0.0);

    raw_value=copyBitsFromByteArrayLE( byteArray, 15104, 12);
    @CAN_PrivMain::RFL_Object::RXX_Object_Obj28.PxVxCoVnce = convertRawToPhysical(raw_value, 0.01, 0.0);

    raw_value=copyBitsFromByteArrayLE( byteArray, 15116, 12);
    @CAN_PrivMain::RFL_Object::RXX_Object_Obj28.PxVyCoVnce = convertRawToPhysical(raw_value, 0.01, 0.0);

    raw_value=copyBitsFromByteArrayLE( byteArray, 14880, 12);
    @CAN_PrivMain::RFL_Object::RXX_Object_Obj28.Py = convertRawToPhysical(raw_value, 0.0625, -128.0);

    raw_value=copyBitsFromByteArrayLE( byteArray, 15200, 12);
    @CAN_PrivMain::RFL_Object::RXX_Object_Obj28.PyAxCoVnce = convertRawToPhysical(raw_value, 0.01, 0.0);

    raw_value=copyBitsFromByteArrayLE( byteArray, 15212, 12);
    @CAN_PrivMain::RFL_Object::RXX_Object_Obj28.PyAyCoVnce = convertRawToPhysical(raw_value, 0.01, 0.0);

    raw_value=copyBitsFromByteArrayLE( byteArray, 14892, 12);
    @CAN_PrivMain::RFL_Object::RXX_Object_Obj28.PyVnce = convertRawToPhysical(raw_value, 0.1, 0.0);

    raw_value=copyBitsFromByteArrayLE( byteArray, 15136, 12);
    @CAN_PrivMain::RFL_Object::RXX_Object_Obj28.PyVxCoVnce = convertRawToPhysical(raw_value, 0.01, 0.0);

    raw_value=copyBitsFromByteArrayLE( byteArray, 15148, 12);
    @CAN_PrivMain::RFL_Object::RXX_Object_Obj28.PyVyCoVnce = convertRawToPhysical(raw_value, 0.01, 0.0);

    raw_value=copyBitsFromByteArrayLE( byteArray, 14988, 10);
    @CAN_PrivMain::RFL_Object::RXX_Object_Obj28.RCS = convertRawToPhysical(raw_value, 0.2, -102.4);

    raw_value=copyBitsFromByteArrayLE( byteArray, 15160, 4);
    @CAN_PrivMain::RFL_Object::RXX_Object_Obj28.ReferencePoint = convertRawToPhysical(raw_value, 1.0, 0.0);

    raw_value=copyBitsFromByteArrayLE( byteArray, 15020, 12);
    @CAN_PrivMain::RFL_Object::RXX_Object_Obj28.Vx = convertRawToPhysical(raw_value, 0.0625, -128.0);

    raw_value=copyBitsFromByteArrayLE( byteArray, 15244, 12);
    @CAN_PrivMain::RFL_Object::RXX_Object_Obj28.VxAxCoVnce = convertRawToPhysical(raw_value, 0.01, 0.0);

    raw_value=copyBitsFromByteArrayLE( byteArray, 15264, 12);
    @CAN_PrivMain::RFL_Object::RXX_Object_Obj28.VxAyCoVnce = convertRawToPhysical(raw_value, 0.01, 0.0);

    raw_value=copyBitsFromByteArrayLE( byteArray, 15040, 12);
    @CAN_PrivMain::RFL_Object::RXX_Object_Obj28.VxVnce = convertRawToPhysical(raw_value, 0.01, 0.0);

    raw_value=copyBitsFromByteArrayLE( byteArray, 15232, 12);
    @CAN_PrivMain::RFL_Object::RXX_Object_Obj28.VxVyCoVnce = convertRawToPhysical(raw_value, 0.01, 0.0);

    raw_value=copyBitsFromByteArrayLE( byteArray, 15054, 10);
    @CAN_PrivMain::RFL_Object::RXX_Object_Obj28.Vy = convertRawToPhysical(raw_value, 0.125, -64.0);

    raw_value=copyBitsFromByteArrayLE( byteArray, 15276, 12);
    @CAN_PrivMain::RFL_Object::RXX_Object_Obj28.VyAxCoVnce = convertRawToPhysical(raw_value, 0.01, 0.0);

    raw_value=copyBitsFromByteArrayLE( byteArray, 15296, 12);
    @CAN_PrivMain::RFL_Object::RXX_Object_Obj28.VyAyCoVnce = convertRawToPhysical(raw_value, 0.01, 0.0);

    raw_value=copyBitsFromByteArrayLE( byteArray, 15072, 12);
    @CAN_PrivMain::RFL_Object::RXX_Object_Obj28.VyVnce = convertRawToPhysical(raw_value, 0.01, 0.0);

    raw_value=copyBitsFromByteArrayLE( byteArray, 14968, 7);
    @CAN_PrivMain::RFL_Object::RXX_Object_Obj28.Width = convertRawToPhysical(raw_value, 0.125, 0.0);

    raw_value=copyBitsFromByteArrayLE( byteArray, 14976, 12);
    @CAN_PrivMain::RFL_Object::RXX_Object_Obj28.WidthVnce = convertRawToPhysical(raw_value, 0.01, 0.0);
}


void CRadarFL_RXX_Object_Obj29_SetDataReceived(byte byteArray[])
{
    qword raw_value;

    raw_value=copyBitsFromByteArrayLE( byteArray, 15840, 32);
    @CAN_PrivMain::RFL_Object::RXX_Object_Obj29.Age = convertRawToPhysical(raw_value, 1.0, 0.0);

    raw_value=copyBitsFromByteArrayLE( byteArray, 15436, 10);
    @CAN_PrivMain::RFL_Object::RXX_Object_Obj29.Ax = convertRawToPhysical(raw_value, 0.03125, -16.0);

    raw_value=copyBitsFromByteArrayLE( byteArray, 15820, 12);
    @CAN_PrivMain::RFL_Object::RXX_Object_Obj29.AxAyCoVnce = convertRawToPhysical(raw_value, 0.01, 0.0);

    raw_value=copyBitsFromByteArrayLE( byteArray, 15456, 12);
    @CAN_PrivMain::RFL_Object::RXX_Object_Obj29.AxVnce = convertRawToPhysical(raw_value, 0.01, 0.0);

    raw_value=copyBitsFromByteArrayLE( byteArray, 15510, 9);
    @CAN_PrivMain::RFL_Object::RXX_Object_Obj29.Ay = convertRawToPhysical(raw_value, 0.0625, -16.0);

    raw_value=copyBitsFromByteArrayLE( byteArray, 15520, 12);
    @CAN_PrivMain::RFL_Object::RXX_Object_Obj29.AyVnce = convertRawToPhysical(raw_value, 0.01, 0.0);

    raw_value=copyBitsFromByteArrayLE( byteArray, 15576, 6);
    @CAN_PrivMain::RFL_Object::RXX_Object_Obj29.ExistProb = convertRawToPhysical(raw_value, 2.0, 0.0);

    raw_value=copyBitsFromByteArrayLE( byteArray, 15640, 8);
    @CAN_PrivMain::RFL_Object::RXX_Object_Obj29.FilterInformation = convertRawToPhysical(raw_value, 1.0, 0.0);

    raw_value=copyBitsFromByteArrayLE( byteArray, 15416, 7);
    @CAN_PrivMain::RFL_Object::RXX_Object_Obj29.Length = convertRawToPhysical(raw_value, 0.125, 0.0);

    raw_value=copyBitsFromByteArrayLE( byteArray, 15424, 12);
    @CAN_PrivMain::RFL_Object::RXX_Object_Obj29.LengthVnce = convertRawToPhysical(raw_value, 0.01, 0.0);

    raw_value=copyBitsFromByteArrayLE( byteArray, 15608, 3);
    @CAN_PrivMain::RFL_Object::RXX_Object_Obj29.MeasurementStatus = convertRawToPhysical(raw_value, 1.0, 0.0);

    raw_value=copyBitsFromByteArrayLE( byteArray, 15564, 2);
    @CAN_PrivMain::RFL_Object::RXX_Object_Obj29.MovingStatus = convertRawToPhysical(raw_value, 1.0, 0.0);

    raw_value=copyBitsFromByteArrayLE( byteArray, 15544, 7);
    @CAN_PrivMain::RFL_Object::RXX_Object_Obj29.ObjId = convertRawToPhysical(raw_value, 1.0, 0.0);

    raw_value=copyBitsFromByteArrayLE( byteArray, 15446, 9);
    @CAN_PrivMain::RFL_Object::RXX_Object_Obj29.OrientationYaw = convertRawToPhysical(raw_value, 0.0175, -4.48);

    raw_value=copyBitsFromByteArrayLE( byteArray, 15468, 12);
    @CAN_PrivMain::RFL_Object::RXX_Object_Obj29.OrientationYawVnce = convertRawToPhysical(raw_value, 0.0003, 0.0);

    raw_value=copyBitsFromByteArrayLE( byteArray, 15360, 6);
    @CAN_PrivMain::RFL_Object::RXX_Object_Obj29.ProbClassConfidence = convertRawToPhysical(raw_value, 2.0, 0.0);

    raw_value=copyBitsFromByteArrayLE( byteArray, 15611, 4);
    @CAN_PrivMain::RFL_Object::RXX_Object_Obj29.ProbClassType = convertRawToPhysical(raw_value, 1.0, 0.0);

    raw_value=copyBitsFromByteArrayLE( byteArray, 15366, 14);
    @CAN_PrivMain::RFL_Object::RXX_Object_Obj29.Px = convertRawToPhysical(raw_value, 0.0625, -512.0);

    raw_value=copyBitsFromByteArrayLE( byteArray, 15680, 12);
    @CAN_PrivMain::RFL_Object::RXX_Object_Obj29.PxAxCoVnce = convertRawToPhysical(raw_value, 0.01, 0.0);

    raw_value=copyBitsFromByteArrayLE( byteArray, 15692, 12);
    @CAN_PrivMain::RFL_Object::RXX_Object_Obj29.PxAyCoVnce = convertRawToPhysical(raw_value, 0.01, 0.0);

    raw_value=copyBitsFromByteArrayLE( byteArray, 15596, 12);
    @CAN_PrivMain::RFL_Object::RXX_Object_Obj29.PxPyCoVnce = convertRawToPhysical(raw_value, 0.01, 0.0);

    raw_value=copyBitsFromByteArrayLE( byteArray, 15380, 12);
    @CAN_PrivMain::RFL_Object::RXX_Object_Obj29.PxVnce = convertRawToPhysical(raw_value, 0.1, 0.0);

    raw_value=copyBitsFromByteArrayLE( byteArray, 15616, 12);
    @CAN_PrivMain::RFL_Object::RXX_Object_Obj29.PxVxCoVnce = convertRawToPhysical(raw_value, 0.01, 0.0);

    raw_value=copyBitsFromByteArrayLE( byteArray, 15628, 12);
    @CAN_PrivMain::RFL_Object::RXX_Object_Obj29.PxVyCoVnce = convertRawToPhysical(raw_value, 0.01, 0.0);

    raw_value=copyBitsFromByteArrayLE( byteArray, 15392, 12);
    @CAN_PrivMain::RFL_Object::RXX_Object_Obj29.Py = convertRawToPhysical(raw_value, 0.0625, -128.0);

    raw_value=copyBitsFromByteArrayLE( byteArray, 15712, 12);
    @CAN_PrivMain::RFL_Object::RXX_Object_Obj29.PyAxCoVnce = convertRawToPhysical(raw_value, 0.01, 0.0);

    raw_value=copyBitsFromByteArrayLE( byteArray, 15724, 12);
    @CAN_PrivMain::RFL_Object::RXX_Object_Obj29.PyAyCoVnce = convertRawToPhysical(raw_value, 0.01, 0.0);

    raw_value=copyBitsFromByteArrayLE( byteArray, 15404, 12);
    @CAN_PrivMain::RFL_Object::RXX_Object_Obj29.PyVnce = convertRawToPhysical(raw_value, 0.1, 0.0);

    raw_value=copyBitsFromByteArrayLE( byteArray, 15648, 12);
    @CAN_PrivMain::RFL_Object::RXX_Object_Obj29.PyVxCoVnce = convertRawToPhysical(raw_value, 0.01, 0.0);

    raw_value=copyBitsFromByteArrayLE( byteArray, 15660, 12);
    @CAN_PrivMain::RFL_Object::RXX_Object_Obj29.PyVyCoVnce = convertRawToPhysical(raw_value, 0.01, 0.0);

    raw_value=copyBitsFromByteArrayLE( byteArray, 15500, 10);
    @CAN_PrivMain::RFL_Object::RXX_Object_Obj29.RCS = convertRawToPhysical(raw_value, 0.2, -102.4);

    raw_value=copyBitsFromByteArrayLE( byteArray, 15672, 4);
    @CAN_PrivMain::RFL_Object::RXX_Object_Obj29.ReferencePoint = convertRawToPhysical(raw_value, 1.0, 0.0);

    raw_value=copyBitsFromByteArrayLE( byteArray, 15532, 12);
    @CAN_PrivMain::RFL_Object::RXX_Object_Obj29.Vx = convertRawToPhysical(raw_value, 0.0625, -128.0);

    raw_value=copyBitsFromByteArrayLE( byteArray, 15756, 12);
    @CAN_PrivMain::RFL_Object::RXX_Object_Obj29.VxAxCoVnce = convertRawToPhysical(raw_value, 0.01, 0.0);

    raw_value=copyBitsFromByteArrayLE( byteArray, 15776, 12);
    @CAN_PrivMain::RFL_Object::RXX_Object_Obj29.VxAyCoVnce = convertRawToPhysical(raw_value, 0.01, 0.0);

    raw_value=copyBitsFromByteArrayLE( byteArray, 15552, 12);
    @CAN_PrivMain::RFL_Object::RXX_Object_Obj29.VxVnce = convertRawToPhysical(raw_value, 0.01, 0.0);

    raw_value=copyBitsFromByteArrayLE( byteArray, 15744, 12);
    @CAN_PrivMain::RFL_Object::RXX_Object_Obj29.VxVyCoVnce = convertRawToPhysical(raw_value, 0.01, 0.0);

    raw_value=copyBitsFromByteArrayLE( byteArray, 15566, 10);
    @CAN_PrivMain::RFL_Object::RXX_Object_Obj29.Vy = convertRawToPhysical(raw_value, 0.125, -64.0);

    raw_value=copyBitsFromByteArrayLE( byteArray, 15788, 12);
    @CAN_PrivMain::RFL_Object::RXX_Object_Obj29.VyAxCoVnce = convertRawToPhysical(raw_value, 0.01, 0.0);

    raw_value=copyBitsFromByteArrayLE( byteArray, 15808, 12);
    @CAN_PrivMain::RFL_Object::RXX_Object_Obj29.VyAyCoVnce = convertRawToPhysical(raw_value, 0.01, 0.0);

    raw_value=copyBitsFromByteArrayLE( byteArray, 15584, 12);
    @CAN_PrivMain::RFL_Object::RXX_Object_Obj29.VyVnce = convertRawToPhysical(raw_value, 0.01, 0.0);

    raw_value=copyBitsFromByteArrayLE( byteArray, 15480, 7);
    @CAN_PrivMain::RFL_Object::RXX_Object_Obj29.Width = convertRawToPhysical(raw_value, 0.125, 0.0);

    raw_value=copyBitsFromByteArrayLE( byteArray, 15488, 12);
    @CAN_PrivMain::RFL_Object::RXX_Object_Obj29.WidthVnce = convertRawToPhysical(raw_value, 0.01, 0.0);
}


void CRadarFL_RXX_Object_Obj3_SetDataReceived(byte byteArray[])
{
    qword raw_value;

    raw_value=copyBitsFromByteArrayLE( byteArray, 2528, 32);
    @CAN_PrivMain::RFL_Object::RXX_Object_Obj3.Age = convertRawToPhysical(raw_value, 1.0, 0.0);

    raw_value=copyBitsFromByteArrayLE( byteArray, 2124, 10);
    @CAN_PrivMain::RFL_Object::RXX_Object_Obj3.Ax = convertRawToPhysical(raw_value, 0.03125, -16.0);

    raw_value=copyBitsFromByteArrayLE( byteArray, 2508, 12);
    @CAN_PrivMain::RFL_Object::RXX_Object_Obj3.AxAyCoVnce = convertRawToPhysical(raw_value, 0.01, 0.0);

    raw_value=copyBitsFromByteArrayLE( byteArray, 2144, 12);
    @CAN_PrivMain::RFL_Object::RXX_Object_Obj3.AxVnce = convertRawToPhysical(raw_value, 0.01, 0.0);

    raw_value=copyBitsFromByteArrayLE( byteArray, 2198, 9);
    @CAN_PrivMain::RFL_Object::RXX_Object_Obj3.Ay = convertRawToPhysical(raw_value, 0.0625, -16.0);

    raw_value=copyBitsFromByteArrayLE( byteArray, 2208, 12);
    @CAN_PrivMain::RFL_Object::RXX_Object_Obj3.AyVnce = convertRawToPhysical(raw_value, 0.01, 0.0);

    raw_value=copyBitsFromByteArrayLE( byteArray, 2264, 6);
    @CAN_PrivMain::RFL_Object::RXX_Object_Obj3.ExistProb = convertRawToPhysical(raw_value, 2.0, 0.0);

    raw_value=copyBitsFromByteArrayLE( byteArray, 2328, 8);
    @CAN_PrivMain::RFL_Object::RXX_Object_Obj3.FilterInformation = convertRawToPhysical(raw_value, 1.0, 0.0);

    raw_value=copyBitsFromByteArrayLE( byteArray, 2104, 7);
    @CAN_PrivMain::RFL_Object::RXX_Object_Obj3.Length = convertRawToPhysical(raw_value, 0.125, 0.0);

    raw_value=copyBitsFromByteArrayLE( byteArray, 2112, 12);
    @CAN_PrivMain::RFL_Object::RXX_Object_Obj3.LengthVnce = convertRawToPhysical(raw_value, 0.01, 0.0);

    raw_value=copyBitsFromByteArrayLE( byteArray, 2296, 3);
    @CAN_PrivMain::RFL_Object::RXX_Object_Obj3.MeasurementStatus = convertRawToPhysical(raw_value, 1.0, 0.0);

    raw_value=copyBitsFromByteArrayLE( byteArray, 2252, 2);
    @CAN_PrivMain::RFL_Object::RXX_Object_Obj3.MovingStatus = convertRawToPhysical(raw_value, 1.0, 0.0);

    raw_value=copyBitsFromByteArrayLE( byteArray, 2232, 7);
    @CAN_PrivMain::RFL_Object::RXX_Object_Obj3.ObjId = convertRawToPhysical(raw_value, 1.0, 0.0);

    raw_value=copyBitsFromByteArrayLE( byteArray, 2134, 9);
    @CAN_PrivMain::RFL_Object::RXX_Object_Obj3.OrientationYaw = convertRawToPhysical(raw_value, 0.0175, -4.48);

    raw_value=copyBitsFromByteArrayLE( byteArray, 2156, 12);
    @CAN_PrivMain::RFL_Object::RXX_Object_Obj3.OrientationYawVnce = convertRawToPhysical(raw_value, 0.0003, 0.0);

    raw_value=copyBitsFromByteArrayLE( byteArray, 2048, 6);
    @CAN_PrivMain::RFL_Object::RXX_Object_Obj3.ProbClassConfidence = convertRawToPhysical(raw_value, 2.0, 0.0);

    raw_value=copyBitsFromByteArrayLE( byteArray, 2299, 4);
    @CAN_PrivMain::RFL_Object::RXX_Object_Obj3.ProbClassType = convertRawToPhysical(raw_value, 1.0, 0.0);

    raw_value=copyBitsFromByteArrayLE( byteArray, 2054, 14);
    @CAN_PrivMain::RFL_Object::RXX_Object_Obj3.Px = convertRawToPhysical(raw_value, 0.0625, -512.0);

    raw_value=copyBitsFromByteArrayLE( byteArray, 2368, 12);
    @CAN_PrivMain::RFL_Object::RXX_Object_Obj3.PxAxCoVnce = convertRawToPhysical(raw_value, 0.01, 0.0);

    raw_value=copyBitsFromByteArrayLE( byteArray, 2380, 12);
    @CAN_PrivMain::RFL_Object::RXX_Object_Obj3.PxAyCoVnce = convertRawToPhysical(raw_value, 0.01, 0.0);

    raw_value=copyBitsFromByteArrayLE( byteArray, 2284, 12);
    @CAN_PrivMain::RFL_Object::RXX_Object_Obj3.PxPyCoVnce = convertRawToPhysical(raw_value, 0.01, 0.0);

    raw_value=copyBitsFromByteArrayLE( byteArray, 2068, 12);
    @CAN_PrivMain::RFL_Object::RXX_Object_Obj3.PxVnce = convertRawToPhysical(raw_value, 0.1, 0.0);

    raw_value=copyBitsFromByteArrayLE( byteArray, 2304, 12);
    @CAN_PrivMain::RFL_Object::RXX_Object_Obj3.PxVxCoVnce = convertRawToPhysical(raw_value, 0.01, 0.0);

    raw_value=copyBitsFromByteArrayLE( byteArray, 2316, 12);
    @CAN_PrivMain::RFL_Object::RXX_Object_Obj3.PxVyCoVnce = convertRawToPhysical(raw_value, 0.01, 0.0);

    raw_value=copyBitsFromByteArrayLE( byteArray, 2080, 12);
    @CAN_PrivMain::RFL_Object::RXX_Object_Obj3.Py = convertRawToPhysical(raw_value, 0.0625, -128.0);

    raw_value=copyBitsFromByteArrayLE( byteArray, 2400, 12);
    @CAN_PrivMain::RFL_Object::RXX_Object_Obj3.PyAxCoVnce = convertRawToPhysical(raw_value, 0.01, 0.0);

    raw_value=copyBitsFromByteArrayLE( byteArray, 2412, 12);
    @CAN_PrivMain::RFL_Object::RXX_Object_Obj3.PyAyCoVnce = convertRawToPhysical(raw_value, 0.01, 0.0);

    raw_value=copyBitsFromByteArrayLE( byteArray, 2092, 12);
    @CAN_PrivMain::RFL_Object::RXX_Object_Obj3.PyVnce = convertRawToPhysical(raw_value, 0.1, 0.0);

    raw_value=copyBitsFromByteArrayLE( byteArray, 2336, 12);
    @CAN_PrivMain::RFL_Object::RXX_Object_Obj3.PyVxCoVnce = convertRawToPhysical(raw_value, 0.01, 0.0);

    raw_value=copyBitsFromByteArrayLE( byteArray, 2348, 12);
    @CAN_PrivMain::RFL_Object::RXX_Object_Obj3.PyVyCoVnce = convertRawToPhysical(raw_value, 0.01, 0.0);

    raw_value=copyBitsFromByteArrayLE( byteArray, 2188, 10);
    @CAN_PrivMain::RFL_Object::RXX_Object_Obj3.RCS = convertRawToPhysical(raw_value, 0.2, -102.4);

    raw_value=copyBitsFromByteArrayLE( byteArray, 2360, 4);
    @CAN_PrivMain::RFL_Object::RXX_Object_Obj3.ReferencePoint = convertRawToPhysical(raw_value, 1.0, 0.0);

    raw_value=copyBitsFromByteArrayLE( byteArray, 2220, 12);
    @CAN_PrivMain::RFL_Object::RXX_Object_Obj3.Vx = convertRawToPhysical(raw_value, 0.0625, -128.0);

    raw_value=copyBitsFromByteArrayLE( byteArray, 2444, 12);
    @CAN_PrivMain::RFL_Object::RXX_Object_Obj3.VxAxCoVnce = convertRawToPhysical(raw_value, 0.01, 0.0);

    raw_value=copyBitsFromByteArrayLE( byteArray, 2464, 12);
    @CAN_PrivMain::RFL_Object::RXX_Object_Obj3.VxAyCoVnce = convertRawToPhysical(raw_value, 0.01, 0.0);

    raw_value=copyBitsFromByteArrayLE( byteArray, 2240, 12);
    @CAN_PrivMain::RFL_Object::RXX_Object_Obj3.VxVnce = convertRawToPhysical(raw_value, 0.01, 0.0);

    raw_value=copyBitsFromByteArrayLE( byteArray, 2432, 12);
    @CAN_PrivMain::RFL_Object::RXX_Object_Obj3.VxVyCoVnce = convertRawToPhysical(raw_value, 0.01, 0.0);

    raw_value=copyBitsFromByteArrayLE( byteArray, 2254, 10);
    @CAN_PrivMain::RFL_Object::RXX_Object_Obj3.Vy = convertRawToPhysical(raw_value, 0.125, -64.0);

    raw_value=copyBitsFromByteArrayLE( byteArray, 2476, 12);
    @CAN_PrivMain::RFL_Object::RXX_Object_Obj3.VyAxCoVnce = convertRawToPhysical(raw_value, 0.01, 0.0);

    raw_value=copyBitsFromByteArrayLE( byteArray, 2496, 12);
    @CAN_PrivMain::RFL_Object::RXX_Object_Obj3.VyAyCoVnce = convertRawToPhysical(raw_value, 0.01, 0.0);

    raw_value=copyBitsFromByteArrayLE( byteArray, 2272, 12);
    @CAN_PrivMain::RFL_Object::RXX_Object_Obj3.VyVnce = convertRawToPhysical(raw_value, 0.01, 0.0);

    raw_value=copyBitsFromByteArrayLE( byteArray, 2168, 7);
    @CAN_PrivMain::RFL_Object::RXX_Object_Obj3.Width = convertRawToPhysical(raw_value, 0.125, 0.0);

    raw_value=copyBitsFromByteArrayLE( byteArray, 2176, 12);
    @CAN_PrivMain::RFL_Object::RXX_Object_Obj3.WidthVnce = convertRawToPhysical(raw_value, 0.01, 0.0);
}


void CRadarFL_RXX_Object_Obj30_SetDataReceived(byte byteArray[])
{
    qword raw_value;

    raw_value=copyBitsFromByteArrayLE( byteArray, 16352, 32);
    @CAN_PrivMain::RFL_Object::RXX_Object_Obj30.Age = convertRawToPhysical(raw_value, 1.0, 0.0);

    raw_value=copyBitsFromByteArrayLE( byteArray, 15948, 10);
    @CAN_PrivMain::RFL_Object::RXX_Object_Obj30.Ax = convertRawToPhysical(raw_value, 0.03125, -16.0);

    raw_value=copyBitsFromByteArrayLE( byteArray, 16332, 12);
    @CAN_PrivMain::RFL_Object::RXX_Object_Obj30.AxAyCoVnce = convertRawToPhysical(raw_value, 0.01, 0.0);

    raw_value=copyBitsFromByteArrayLE( byteArray, 15968, 12);
    @CAN_PrivMain::RFL_Object::RXX_Object_Obj30.AxVnce = convertRawToPhysical(raw_value, 0.01, 0.0);

    raw_value=copyBitsFromByteArrayLE( byteArray, 16022, 9);
    @CAN_PrivMain::RFL_Object::RXX_Object_Obj30.Ay = convertRawToPhysical(raw_value, 0.0625, -16.0);

    raw_value=copyBitsFromByteArrayLE( byteArray, 16032, 12);
    @CAN_PrivMain::RFL_Object::RXX_Object_Obj30.AyVnce = convertRawToPhysical(raw_value, 0.01, 0.0);

    raw_value=copyBitsFromByteArrayLE( byteArray, 16088, 6);
    @CAN_PrivMain::RFL_Object::RXX_Object_Obj30.ExistProb = convertRawToPhysical(raw_value, 2.0, 0.0);

    raw_value=copyBitsFromByteArrayLE( byteArray, 16152, 8);
    @CAN_PrivMain::RFL_Object::RXX_Object_Obj30.FilterInformation = convertRawToPhysical(raw_value, 1.0, 0.0);

    raw_value=copyBitsFromByteArrayLE( byteArray, 15928, 7);
    @CAN_PrivMain::RFL_Object::RXX_Object_Obj30.Length = convertRawToPhysical(raw_value, 0.125, 0.0);

    raw_value=copyBitsFromByteArrayLE( byteArray, 15936, 12);
    @CAN_PrivMain::RFL_Object::RXX_Object_Obj30.LengthVnce = convertRawToPhysical(raw_value, 0.01, 0.0);

    raw_value=copyBitsFromByteArrayLE( byteArray, 16120, 3);
    @CAN_PrivMain::RFL_Object::RXX_Object_Obj30.MeasurementStatus = convertRawToPhysical(raw_value, 1.0, 0.0);

    raw_value=copyBitsFromByteArrayLE( byteArray, 16076, 2);
    @CAN_PrivMain::RFL_Object::RXX_Object_Obj30.MovingStatus = convertRawToPhysical(raw_value, 1.0, 0.0);

    raw_value=copyBitsFromByteArrayLE( byteArray, 16056, 7);
    @CAN_PrivMain::RFL_Object::RXX_Object_Obj30.ObjId = convertRawToPhysical(raw_value, 1.0, 0.0);

    raw_value=copyBitsFromByteArrayLE( byteArray, 15958, 9);
    @CAN_PrivMain::RFL_Object::RXX_Object_Obj30.OrientationYaw = convertRawToPhysical(raw_value, 0.0175, -4.48);

    raw_value=copyBitsFromByteArrayLE( byteArray, 15980, 12);
    @CAN_PrivMain::RFL_Object::RXX_Object_Obj30.OrientationYawVnce = convertRawToPhysical(raw_value, 0.0003, 0.0);

    raw_value=copyBitsFromByteArrayLE( byteArray, 15872, 6);
    @CAN_PrivMain::RFL_Object::RXX_Object_Obj30.ProbClassConfidence = convertRawToPhysical(raw_value, 2.0, 0.0);

    raw_value=copyBitsFromByteArrayLE( byteArray, 16123, 4);
    @CAN_PrivMain::RFL_Object::RXX_Object_Obj30.ProbClassType = convertRawToPhysical(raw_value, 1.0, 0.0);

    raw_value=copyBitsFromByteArrayLE( byteArray, 15878, 14);
    @CAN_PrivMain::RFL_Object::RXX_Object_Obj30.Px = convertRawToPhysical(raw_value, 0.0625, -512.0);

    raw_value=copyBitsFromByteArrayLE( byteArray, 16192, 12);
    @CAN_PrivMain::RFL_Object::RXX_Object_Obj30.PxAxCoVnce = convertRawToPhysical(raw_value, 0.01, 0.0);

    raw_value=copyBitsFromByteArrayLE( byteArray, 16204, 12);
    @CAN_PrivMain::RFL_Object::RXX_Object_Obj30.PxAyCoVnce = convertRawToPhysical(raw_value, 0.01, 0.0);

    raw_value=copyBitsFromByteArrayLE( byteArray, 16108, 12);
    @CAN_PrivMain::RFL_Object::RXX_Object_Obj30.PxPyCoVnce = convertRawToPhysical(raw_value, 0.01, 0.0);

    raw_value=copyBitsFromByteArrayLE( byteArray, 15892, 12);
    @CAN_PrivMain::RFL_Object::RXX_Object_Obj30.PxVnce = convertRawToPhysical(raw_value, 0.1, 0.0);

    raw_value=copyBitsFromByteArrayLE( byteArray, 16128, 12);
    @CAN_PrivMain::RFL_Object::RXX_Object_Obj30.PxVxCoVnce = convertRawToPhysical(raw_value, 0.01, 0.0);

    raw_value=copyBitsFromByteArrayLE( byteArray, 16140, 12);
    @CAN_PrivMain::RFL_Object::RXX_Object_Obj30.PxVyCoVnce = convertRawToPhysical(raw_value, 0.01, 0.0);

    raw_value=copyBitsFromByteArrayLE( byteArray, 15904, 12);
    @CAN_PrivMain::RFL_Object::RXX_Object_Obj30.Py = convertRawToPhysical(raw_value, 0.0625, -128.0);

    raw_value=copyBitsFromByteArrayLE( byteArray, 16224, 12);
    @CAN_PrivMain::RFL_Object::RXX_Object_Obj30.PyAxCoVnce = convertRawToPhysical(raw_value, 0.01, 0.0);

    raw_value=copyBitsFromByteArrayLE( byteArray, 16236, 12);
    @CAN_PrivMain::RFL_Object::RXX_Object_Obj30.PyAyCoVnce = convertRawToPhysical(raw_value, 0.01, 0.0);

    raw_value=copyBitsFromByteArrayLE( byteArray, 15916, 12);
    @CAN_PrivMain::RFL_Object::RXX_Object_Obj30.PyVnce = convertRawToPhysical(raw_value, 0.1, 0.0);

    raw_value=copyBitsFromByteArrayLE( byteArray, 16160, 12);
    @CAN_PrivMain::RFL_Object::RXX_Object_Obj30.PyVxCoVnce = convertRawToPhysical(raw_value, 0.01, 0.0);

    raw_value=copyBitsFromByteArrayLE( byteArray, 16172, 12);
    @CAN_PrivMain::RFL_Object::RXX_Object_Obj30.PyVyCoVnce = convertRawToPhysical(raw_value, 0.01, 0.0);

    raw_value=copyBitsFromByteArrayLE( byteArray, 16012, 10);
    @CAN_PrivMain::RFL_Object::RXX_Object_Obj30.RCS = convertRawToPhysical(raw_value, 0.2, -102.4);

    raw_value=copyBitsFromByteArrayLE( byteArray, 16184, 4);
    @CAN_PrivMain::RFL_Object::RXX_Object_Obj30.ReferencePoint = convertRawToPhysical(raw_value, 1.0, 0.0);

    raw_value=copyBitsFromByteArrayLE( byteArray, 16044, 12);
    @CAN_PrivMain::RFL_Object::RXX_Object_Obj30.Vx = convertRawToPhysical(raw_value, 0.0625, -128.0);

    raw_value=copyBitsFromByteArrayLE( byteArray, 16268, 12);
    @CAN_PrivMain::RFL_Object::RXX_Object_Obj30.VxAxCoVnce = convertRawToPhysical(raw_value, 0.01, 0.0);

    raw_value=copyBitsFromByteArrayLE( byteArray, 16288, 12);
    @CAN_PrivMain::RFL_Object::RXX_Object_Obj30.VxAyCoVnce = convertRawToPhysical(raw_value, 0.01, 0.0);

    raw_value=copyBitsFromByteArrayLE( byteArray, 16064, 12);
    @CAN_PrivMain::RFL_Object::RXX_Object_Obj30.VxVnce = convertRawToPhysical(raw_value, 0.01, 0.0);

    raw_value=copyBitsFromByteArrayLE( byteArray, 16256, 12);
    @CAN_PrivMain::RFL_Object::RXX_Object_Obj30.VxVyCoVnce = convertRawToPhysical(raw_value, 0.01, 0.0);

    raw_value=copyBitsFromByteArrayLE( byteArray, 16078, 10);
    @CAN_PrivMain::RFL_Object::RXX_Object_Obj30.Vy = convertRawToPhysical(raw_value, 0.125, -64.0);

    raw_value=copyBitsFromByteArrayLE( byteArray, 16300, 12);
    @CAN_PrivMain::RFL_Object::RXX_Object_Obj30.VyAxCoVnce = convertRawToPhysical(raw_value, 0.01, 0.0);

    raw_value=copyBitsFromByteArrayLE( byteArray, 16320, 12);
    @CAN_PrivMain::RFL_Object::RXX_Object_Obj30.VyAyCoVnce = convertRawToPhysical(raw_value, 0.01, 0.0);

    raw_value=copyBitsFromByteArrayLE( byteArray, 16096, 12);
    @CAN_PrivMain::RFL_Object::RXX_Object_Obj30.VyVnce = convertRawToPhysical(raw_value, 0.01, 0.0);

    raw_value=copyBitsFromByteArrayLE( byteArray, 15992, 7);
    @CAN_PrivMain::RFL_Object::RXX_Object_Obj30.Width = convertRawToPhysical(raw_value, 0.125, 0.0);

    raw_value=copyBitsFromByteArrayLE( byteArray, 16000, 12);
    @CAN_PrivMain::RFL_Object::RXX_Object_Obj30.WidthVnce = convertRawToPhysical(raw_value, 0.01, 0.0);
}


void CRadarFL_RXX_Object_Obj31_SetDataReceived(byte byteArray[])
{
    qword raw_value;

    raw_value=copyBitsFromByteArrayLE( byteArray, 16864, 32);
    @CAN_PrivMain::RFL_Object::RXX_Object_Obj31.Age = convertRawToPhysical(raw_value, 1.0, 0.0);

    raw_value=copyBitsFromByteArrayLE( byteArray, 16460, 10);
    @CAN_PrivMain::RFL_Object::RXX_Object_Obj31.Ax = convertRawToPhysical(raw_value, 0.03125, -16.0);

    raw_value=copyBitsFromByteArrayLE( byteArray, 16844, 12);
    @CAN_PrivMain::RFL_Object::RXX_Object_Obj31.AxAyCoVnce = convertRawToPhysical(raw_value, 0.01, 0.0);

    raw_value=copyBitsFromByteArrayLE( byteArray, 16480, 12);
    @CAN_PrivMain::RFL_Object::RXX_Object_Obj31.AxVnce = convertRawToPhysical(raw_value, 0.01, 0.0);

    raw_value=copyBitsFromByteArrayLE( byteArray, 16534, 9);
    @CAN_PrivMain::RFL_Object::RXX_Object_Obj31.Ay = convertRawToPhysical(raw_value, 0.0625, -16.0);

    raw_value=copyBitsFromByteArrayLE( byteArray, 16544, 12);
    @CAN_PrivMain::RFL_Object::RXX_Object_Obj31.AyVnce = convertRawToPhysical(raw_value, 0.01, 0.0);

    raw_value=copyBitsFromByteArrayLE( byteArray, 16600, 6);
    @CAN_PrivMain::RFL_Object::RXX_Object_Obj31.ExistProb = convertRawToPhysical(raw_value, 2.0, 0.0);

    raw_value=copyBitsFromByteArrayLE( byteArray, 16664, 8);
    @CAN_PrivMain::RFL_Object::RXX_Object_Obj31.FilterInformation = convertRawToPhysical(raw_value, 1.0, 0.0);

    raw_value=copyBitsFromByteArrayLE( byteArray, 16440, 7);
    @CAN_PrivMain::RFL_Object::RXX_Object_Obj31.Length = convertRawToPhysical(raw_value, 0.125, 0.0);

    raw_value=copyBitsFromByteArrayLE( byteArray, 16448, 12);
    @CAN_PrivMain::RFL_Object::RXX_Object_Obj31.LengthVnce = convertRawToPhysical(raw_value, 0.01, 0.0);

    raw_value=copyBitsFromByteArrayLE( byteArray, 16632, 3);
    @CAN_PrivMain::RFL_Object::RXX_Object_Obj31.MeasurementStatus = convertRawToPhysical(raw_value, 1.0, 0.0);

    raw_value=copyBitsFromByteArrayLE( byteArray, 16588, 2);
    @CAN_PrivMain::RFL_Object::RXX_Object_Obj31.MovingStatus = convertRawToPhysical(raw_value, 1.0, 0.0);

    raw_value=copyBitsFromByteArrayLE( byteArray, 16568, 7);
    @CAN_PrivMain::RFL_Object::RXX_Object_Obj31.ObjId = convertRawToPhysical(raw_value, 1.0, 0.0);

    raw_value=copyBitsFromByteArrayLE( byteArray, 16470, 9);
    @CAN_PrivMain::RFL_Object::RXX_Object_Obj31.OrientationYaw = convertRawToPhysical(raw_value, 0.0175, -4.48);

    raw_value=copyBitsFromByteArrayLE( byteArray, 16492, 12);
    @CAN_PrivMain::RFL_Object::RXX_Object_Obj31.OrientationYawVnce = convertRawToPhysical(raw_value, 0.0003, 0.0);

    raw_value=copyBitsFromByteArrayLE( byteArray, 16384, 6);
    @CAN_PrivMain::RFL_Object::RXX_Object_Obj31.ProbClassConfidence = convertRawToPhysical(raw_value, 2.0, 0.0);

    raw_value=copyBitsFromByteArrayLE( byteArray, 16635, 4);
    @CAN_PrivMain::RFL_Object::RXX_Object_Obj31.ProbClassType = convertRawToPhysical(raw_value, 1.0, 0.0);

    raw_value=copyBitsFromByteArrayLE( byteArray, 16390, 14);
    @CAN_PrivMain::RFL_Object::RXX_Object_Obj31.Px = convertRawToPhysical(raw_value, 0.0625, -512.0);

    raw_value=copyBitsFromByteArrayLE( byteArray, 16704, 12);
    @CAN_PrivMain::RFL_Object::RXX_Object_Obj31.PxAxCoVnce = convertRawToPhysical(raw_value, 0.01, 0.0);

    raw_value=copyBitsFromByteArrayLE( byteArray, 16716, 12);
    @CAN_PrivMain::RFL_Object::RXX_Object_Obj31.PxAyCoVnce = convertRawToPhysical(raw_value, 0.01, 0.0);

    raw_value=copyBitsFromByteArrayLE( byteArray, 16620, 12);
    @CAN_PrivMain::RFL_Object::RXX_Object_Obj31.PxPyCoVnce = convertRawToPhysical(raw_value, 0.01, 0.0);

    raw_value=copyBitsFromByteArrayLE( byteArray, 16404, 12);
    @CAN_PrivMain::RFL_Object::RXX_Object_Obj31.PxVnce = convertRawToPhysical(raw_value, 0.1, 0.0);

    raw_value=copyBitsFromByteArrayLE( byteArray, 16640, 12);
    @CAN_PrivMain::RFL_Object::RXX_Object_Obj31.PxVxCoVnce = convertRawToPhysical(raw_value, 0.01, 0.0);

    raw_value=copyBitsFromByteArrayLE( byteArray, 16652, 12);
    @CAN_PrivMain::RFL_Object::RXX_Object_Obj31.PxVyCoVnce = convertRawToPhysical(raw_value, 0.01, 0.0);

    raw_value=copyBitsFromByteArrayLE( byteArray, 16416, 12);
    @CAN_PrivMain::RFL_Object::RXX_Object_Obj31.Py = convertRawToPhysical(raw_value, 0.0625, -128.0);

    raw_value=copyBitsFromByteArrayLE( byteArray, 16736, 12);
    @CAN_PrivMain::RFL_Object::RXX_Object_Obj31.PyAxCoVnce = convertRawToPhysical(raw_value, 0.01, 0.0);

    raw_value=copyBitsFromByteArrayLE( byteArray, 16748, 12);
    @CAN_PrivMain::RFL_Object::RXX_Object_Obj31.PyAyCoVnce = convertRawToPhysical(raw_value, 0.01, 0.0);

    raw_value=copyBitsFromByteArrayLE( byteArray, 16428, 12);
    @CAN_PrivMain::RFL_Object::RXX_Object_Obj31.PyVnce = convertRawToPhysical(raw_value, 0.1, 0.0);

    raw_value=copyBitsFromByteArrayLE( byteArray, 16672, 12);
    @CAN_PrivMain::RFL_Object::RXX_Object_Obj31.PyVxCoVnce = convertRawToPhysical(raw_value, 0.01, 0.0);

    raw_value=copyBitsFromByteArrayLE( byteArray, 16684, 12);
    @CAN_PrivMain::RFL_Object::RXX_Object_Obj31.PyVyCoVnce = convertRawToPhysical(raw_value, 0.01, 0.0);

    raw_value=copyBitsFromByteArrayLE( byteArray, 16524, 10);
    @CAN_PrivMain::RFL_Object::RXX_Object_Obj31.RCS = convertRawToPhysical(raw_value, 0.2, -102.4);

    raw_value=copyBitsFromByteArrayLE( byteArray, 16696, 4);
    @CAN_PrivMain::RFL_Object::RXX_Object_Obj31.ReferencePoint = convertRawToPhysical(raw_value, 1.0, 0.0);

    raw_value=copyBitsFromByteArrayLE( byteArray, 16556, 12);
    @CAN_PrivMain::RFL_Object::RXX_Object_Obj31.Vx = convertRawToPhysical(raw_value, 0.0625, -128.0);

    raw_value=copyBitsFromByteArrayLE( byteArray, 16780, 12);
    @CAN_PrivMain::RFL_Object::RXX_Object_Obj31.VxAxCoVnce = convertRawToPhysical(raw_value, 0.01, 0.0);

    raw_value=copyBitsFromByteArrayLE( byteArray, 16800, 12);
    @CAN_PrivMain::RFL_Object::RXX_Object_Obj31.VxAyCoVnce = convertRawToPhysical(raw_value, 0.01, 0.0);

    raw_value=copyBitsFromByteArrayLE( byteArray, 16576, 12);
    @CAN_PrivMain::RFL_Object::RXX_Object_Obj31.VxVnce = convertRawToPhysical(raw_value, 0.01, 0.0);

    raw_value=copyBitsFromByteArrayLE( byteArray, 16768, 12);
    @CAN_PrivMain::RFL_Object::RXX_Object_Obj31.VxVyCoVnce = convertRawToPhysical(raw_value, 0.01, 0.0);

    raw_value=copyBitsFromByteArrayLE( byteArray, 16590, 10);
    @CAN_PrivMain::RFL_Object::RXX_Object_Obj31.Vy = convertRawToPhysical(raw_value, 0.125, -64.0);

    raw_value=copyBitsFromByteArrayLE( byteArray, 16812, 12);
    @CAN_PrivMain::RFL_Object::RXX_Object_Obj31.VyAxCoVnce = convertRawToPhysical(raw_value, 0.01, 0.0);

    raw_value=copyBitsFromByteArrayLE( byteArray, 16832, 12);
    @CAN_PrivMain::RFL_Object::RXX_Object_Obj31.VyAyCoVnce = convertRawToPhysical(raw_value, 0.01, 0.0);

    raw_value=copyBitsFromByteArrayLE( byteArray, 16608, 12);
    @CAN_PrivMain::RFL_Object::RXX_Object_Obj31.VyVnce = convertRawToPhysical(raw_value, 0.01, 0.0);

    raw_value=copyBitsFromByteArrayLE( byteArray, 16504, 7);
    @CAN_PrivMain::RFL_Object::RXX_Object_Obj31.Width = convertRawToPhysical(raw_value, 0.125, 0.0);

    raw_value=copyBitsFromByteArrayLE( byteArray, 16512, 12);
    @CAN_PrivMain::RFL_Object::RXX_Object_Obj31.WidthVnce = convertRawToPhysical(raw_value, 0.01, 0.0);
}


void CRadarFL_RXX_Object_Obj32_SetDataReceived(byte byteArray[])
{
    qword raw_value;

    raw_value=copyBitsFromByteArrayLE( byteArray, 17376, 32);
    @CAN_PrivMain::RFL_Object::RXX_Object_Obj32.Age = convertRawToPhysical(raw_value, 1.0, 0.0);

    raw_value=copyBitsFromByteArrayLE( byteArray, 16972, 10);
    @CAN_PrivMain::RFL_Object::RXX_Object_Obj32.Ax = convertRawToPhysical(raw_value, 0.03125, -16.0);

    raw_value=copyBitsFromByteArrayLE( byteArray, 17356, 12);
    @CAN_PrivMain::RFL_Object::RXX_Object_Obj32.AxAyCoVnce = convertRawToPhysical(raw_value, 0.01, 0.0);

    raw_value=copyBitsFromByteArrayLE( byteArray, 16992, 12);
    @CAN_PrivMain::RFL_Object::RXX_Object_Obj32.AxVnce = convertRawToPhysical(raw_value, 0.01, 0.0);

    raw_value=copyBitsFromByteArrayLE( byteArray, 17046, 9);
    @CAN_PrivMain::RFL_Object::RXX_Object_Obj32.Ay = convertRawToPhysical(raw_value, 0.0625, -16.0);

    raw_value=copyBitsFromByteArrayLE( byteArray, 17056, 12);
    @CAN_PrivMain::RFL_Object::RXX_Object_Obj32.AyVnce = convertRawToPhysical(raw_value, 0.01, 0.0);

    raw_value=copyBitsFromByteArrayLE( byteArray, 17112, 6);
    @CAN_PrivMain::RFL_Object::RXX_Object_Obj32.ExistProb = convertRawToPhysical(raw_value, 2.0, 0.0);

    raw_value=copyBitsFromByteArrayLE( byteArray, 17176, 8);
    @CAN_PrivMain::RFL_Object::RXX_Object_Obj32.FilterInformation = convertRawToPhysical(raw_value, 1.0, 0.0);

    raw_value=copyBitsFromByteArrayLE( byteArray, 16952, 7);
    @CAN_PrivMain::RFL_Object::RXX_Object_Obj32.Length = convertRawToPhysical(raw_value, 0.125, 0.0);

    raw_value=copyBitsFromByteArrayLE( byteArray, 16960, 12);
    @CAN_PrivMain::RFL_Object::RXX_Object_Obj32.LengthVnce = convertRawToPhysical(raw_value, 0.01, 0.0);

    raw_value=copyBitsFromByteArrayLE( byteArray, 17144, 3);
    @CAN_PrivMain::RFL_Object::RXX_Object_Obj32.MeasurementStatus = convertRawToPhysical(raw_value, 1.0, 0.0);

    raw_value=copyBitsFromByteArrayLE( byteArray, 17100, 2);
    @CAN_PrivMain::RFL_Object::RXX_Object_Obj32.MovingStatus = convertRawToPhysical(raw_value, 1.0, 0.0);

    raw_value=copyBitsFromByteArrayLE( byteArray, 17080, 7);
    @CAN_PrivMain::RFL_Object::RXX_Object_Obj32.ObjId = convertRawToPhysical(raw_value, 1.0, 0.0);

    raw_value=copyBitsFromByteArrayLE( byteArray, 16982, 9);
    @CAN_PrivMain::RFL_Object::RXX_Object_Obj32.OrientationYaw = convertRawToPhysical(raw_value, 0.0175, -4.48);

    raw_value=copyBitsFromByteArrayLE( byteArray, 17004, 12);
    @CAN_PrivMain::RFL_Object::RXX_Object_Obj32.OrientationYawVnce = convertRawToPhysical(raw_value, 0.0003, 0.0);

    raw_value=copyBitsFromByteArrayLE( byteArray, 16896, 6);
    @CAN_PrivMain::RFL_Object::RXX_Object_Obj32.ProbClassConfidence = convertRawToPhysical(raw_value, 2.0, 0.0);

    raw_value=copyBitsFromByteArrayLE( byteArray, 17147, 4);
    @CAN_PrivMain::RFL_Object::RXX_Object_Obj32.ProbClassType = convertRawToPhysical(raw_value, 1.0, 0.0);

    raw_value=copyBitsFromByteArrayLE( byteArray, 16902, 14);
    @CAN_PrivMain::RFL_Object::RXX_Object_Obj32.Px = convertRawToPhysical(raw_value, 0.0625, -512.0);

    raw_value=copyBitsFromByteArrayLE( byteArray, 17216, 12);
    @CAN_PrivMain::RFL_Object::RXX_Object_Obj32.PxAxCoVnce = convertRawToPhysical(raw_value, 0.01, 0.0);

    raw_value=copyBitsFromByteArrayLE( byteArray, 17228, 12);
    @CAN_PrivMain::RFL_Object::RXX_Object_Obj32.PxAyCoVnce = convertRawToPhysical(raw_value, 0.01, 0.0);

    raw_value=copyBitsFromByteArrayLE( byteArray, 17132, 12);
    @CAN_PrivMain::RFL_Object::RXX_Object_Obj32.PxPyCoVnce = convertRawToPhysical(raw_value, 0.01, 0.0);

    raw_value=copyBitsFromByteArrayLE( byteArray, 16916, 12);
    @CAN_PrivMain::RFL_Object::RXX_Object_Obj32.PxVnce = convertRawToPhysical(raw_value, 0.1, 0.0);

    raw_value=copyBitsFromByteArrayLE( byteArray, 17152, 12);
    @CAN_PrivMain::RFL_Object::RXX_Object_Obj32.PxVxCoVnce = convertRawToPhysical(raw_value, 0.01, 0.0);

    raw_value=copyBitsFromByteArrayLE( byteArray, 17164, 12);
    @CAN_PrivMain::RFL_Object::RXX_Object_Obj32.PxVyCoVnce = convertRawToPhysical(raw_value, 0.01, 0.0);

    raw_value=copyBitsFromByteArrayLE( byteArray, 16928, 12);
    @CAN_PrivMain::RFL_Object::RXX_Object_Obj32.Py = convertRawToPhysical(raw_value, 0.0625, -128.0);

    raw_value=copyBitsFromByteArrayLE( byteArray, 17248, 12);
    @CAN_PrivMain::RFL_Object::RXX_Object_Obj32.PyAxCoVnce = convertRawToPhysical(raw_value, 0.01, 0.0);

    raw_value=copyBitsFromByteArrayLE( byteArray, 17260, 12);
    @CAN_PrivMain::RFL_Object::RXX_Object_Obj32.PyAyCoVnce = convertRawToPhysical(raw_value, 0.01, 0.0);

    raw_value=copyBitsFromByteArrayLE( byteArray, 16940, 12);
    @CAN_PrivMain::RFL_Object::RXX_Object_Obj32.PyVnce = convertRawToPhysical(raw_value, 0.1, 0.0);

    raw_value=copyBitsFromByteArrayLE( byteArray, 17184, 12);
    @CAN_PrivMain::RFL_Object::RXX_Object_Obj32.PyVxCoVnce = convertRawToPhysical(raw_value, 0.01, 0.0);

    raw_value=copyBitsFromByteArrayLE( byteArray, 17196, 12);
    @CAN_PrivMain::RFL_Object::RXX_Object_Obj32.PyVyCoVnce = convertRawToPhysical(raw_value, 0.01, 0.0);

    raw_value=copyBitsFromByteArrayLE( byteArray, 17036, 10);
    @CAN_PrivMain::RFL_Object::RXX_Object_Obj32.RCS = convertRawToPhysical(raw_value, 0.2, -102.4);

    raw_value=copyBitsFromByteArrayLE( byteArray, 17208, 4);
    @CAN_PrivMain::RFL_Object::RXX_Object_Obj32.ReferencePoint = convertRawToPhysical(raw_value, 1.0, 0.0);

    raw_value=copyBitsFromByteArrayLE( byteArray, 17068, 12);
    @CAN_PrivMain::RFL_Object::RXX_Object_Obj32.Vx = convertRawToPhysical(raw_value, 0.0625, -128.0);

    raw_value=copyBitsFromByteArrayLE( byteArray, 17292, 12);
    @CAN_PrivMain::RFL_Object::RXX_Object_Obj32.VxAxCoVnce = convertRawToPhysical(raw_value, 0.01, 0.0);

    raw_value=copyBitsFromByteArrayLE( byteArray, 17312, 12);
    @CAN_PrivMain::RFL_Object::RXX_Object_Obj32.VxAyCoVnce = convertRawToPhysical(raw_value, 0.01, 0.0);

    raw_value=copyBitsFromByteArrayLE( byteArray, 17088, 12);
    @CAN_PrivMain::RFL_Object::RXX_Object_Obj32.VxVnce = convertRawToPhysical(raw_value, 0.01, 0.0);

    raw_value=copyBitsFromByteArrayLE( byteArray, 17280, 12);
    @CAN_PrivMain::RFL_Object::RXX_Object_Obj32.VxVyCoVnce = convertRawToPhysical(raw_value, 0.01, 0.0);

    raw_value=copyBitsFromByteArrayLE( byteArray, 17102, 10);
    @CAN_PrivMain::RFL_Object::RXX_Object_Obj32.Vy = convertRawToPhysical(raw_value, 0.125, -64.0);

    raw_value=copyBitsFromByteArrayLE( byteArray, 17324, 12);
    @CAN_PrivMain::RFL_Object::RXX_Object_Obj32.VyAxCoVnce = convertRawToPhysical(raw_value, 0.01, 0.0);

    raw_value=copyBitsFromByteArrayLE( byteArray, 17344, 12);
    @CAN_PrivMain::RFL_Object::RXX_Object_Obj32.VyAyCoVnce = convertRawToPhysical(raw_value, 0.01, 0.0);

    raw_value=copyBitsFromByteArrayLE( byteArray, 17120, 12);
    @CAN_PrivMain::RFL_Object::RXX_Object_Obj32.VyVnce = convertRawToPhysical(raw_value, 0.01, 0.0);

    raw_value=copyBitsFromByteArrayLE( byteArray, 17016, 7);
    @CAN_PrivMain::RFL_Object::RXX_Object_Obj32.Width = convertRawToPhysical(raw_value, 0.125, 0.0);

    raw_value=copyBitsFromByteArrayLE( byteArray, 17024, 12);
    @CAN_PrivMain::RFL_Object::RXX_Object_Obj32.WidthVnce = convertRawToPhysical(raw_value, 0.01, 0.0);
}


void CRadarFL_RXX_Object_Obj33_SetDataReceived(byte byteArray[])
{
    qword raw_value;

    raw_value=copyBitsFromByteArrayLE( byteArray, 17888, 32);
    @CAN_PrivMain::RFL_Object::RXX_Object_Obj33.Age = convertRawToPhysical(raw_value, 1.0, 0.0);

    raw_value=copyBitsFromByteArrayLE( byteArray, 17484, 10);
    @CAN_PrivMain::RFL_Object::RXX_Object_Obj33.Ax = convertRawToPhysical(raw_value, 0.03125, -16.0);

    raw_value=copyBitsFromByteArrayLE( byteArray, 17868, 12);
    @CAN_PrivMain::RFL_Object::RXX_Object_Obj33.AxAyCoVnce = convertRawToPhysical(raw_value, 0.01, 0.0);

    raw_value=copyBitsFromByteArrayLE( byteArray, 17504, 12);
    @CAN_PrivMain::RFL_Object::RXX_Object_Obj33.AxVnce = convertRawToPhysical(raw_value, 0.01, 0.0);

    raw_value=copyBitsFromByteArrayLE( byteArray, 17558, 9);
    @CAN_PrivMain::RFL_Object::RXX_Object_Obj33.Ay = convertRawToPhysical(raw_value, 0.0625, -16.0);

    raw_value=copyBitsFromByteArrayLE( byteArray, 17568, 12);
    @CAN_PrivMain::RFL_Object::RXX_Object_Obj33.AyVnce = convertRawToPhysical(raw_value, 0.01, 0.0);

    raw_value=copyBitsFromByteArrayLE( byteArray, 17624, 6);
    @CAN_PrivMain::RFL_Object::RXX_Object_Obj33.ExistProb = convertRawToPhysical(raw_value, 2.0, 0.0);

    raw_value=copyBitsFromByteArrayLE( byteArray, 17688, 8);
    @CAN_PrivMain::RFL_Object::RXX_Object_Obj33.FilterInformation = convertRawToPhysical(raw_value, 1.0, 0.0);

    raw_value=copyBitsFromByteArrayLE( byteArray, 17464, 7);
    @CAN_PrivMain::RFL_Object::RXX_Object_Obj33.Length = convertRawToPhysical(raw_value, 0.125, 0.0);

    raw_value=copyBitsFromByteArrayLE( byteArray, 17472, 12);
    @CAN_PrivMain::RFL_Object::RXX_Object_Obj33.LengthVnce = convertRawToPhysical(raw_value, 0.01, 0.0);

    raw_value=copyBitsFromByteArrayLE( byteArray, 17656, 3);
    @CAN_PrivMain::RFL_Object::RXX_Object_Obj33.MeasurementStatus = convertRawToPhysical(raw_value, 1.0, 0.0);

    raw_value=copyBitsFromByteArrayLE( byteArray, 17612, 2);
    @CAN_PrivMain::RFL_Object::RXX_Object_Obj33.MovingStatus = convertRawToPhysical(raw_value, 1.0, 0.0);

    raw_value=copyBitsFromByteArrayLE( byteArray, 17592, 7);
    @CAN_PrivMain::RFL_Object::RXX_Object_Obj33.ObjId = convertRawToPhysical(raw_value, 1.0, 0.0);

    raw_value=copyBitsFromByteArrayLE( byteArray, 17494, 9);
    @CAN_PrivMain::RFL_Object::RXX_Object_Obj33.OrientationYaw = convertRawToPhysical(raw_value, 0.0175, -4.48);

    raw_value=copyBitsFromByteArrayLE( byteArray, 17516, 12);
    @CAN_PrivMain::RFL_Object::RXX_Object_Obj33.OrientationYawVnce = convertRawToPhysical(raw_value, 0.0003, 0.0);

    raw_value=copyBitsFromByteArrayLE( byteArray, 17408, 6);
    @CAN_PrivMain::RFL_Object::RXX_Object_Obj33.ProbClassConfidence = convertRawToPhysical(raw_value, 2.0, 0.0);

    raw_value=copyBitsFromByteArrayLE( byteArray, 17659, 4);
    @CAN_PrivMain::RFL_Object::RXX_Object_Obj33.ProbClassType = convertRawToPhysical(raw_value, 1.0, 0.0);

    raw_value=copyBitsFromByteArrayLE( byteArray, 17414, 14);
    @CAN_PrivMain::RFL_Object::RXX_Object_Obj33.Px = convertRawToPhysical(raw_value, 0.0625, -512.0);

    raw_value=copyBitsFromByteArrayLE( byteArray, 17728, 12);
    @CAN_PrivMain::RFL_Object::RXX_Object_Obj33.PxAxCoVnce = convertRawToPhysical(raw_value, 0.01, 0.0);

    raw_value=copyBitsFromByteArrayLE( byteArray, 17740, 12);
    @CAN_PrivMain::RFL_Object::RXX_Object_Obj33.PxAyCoVnce = convertRawToPhysical(raw_value, 0.01, 0.0);

    raw_value=copyBitsFromByteArrayLE( byteArray, 17644, 12);
    @CAN_PrivMain::RFL_Object::RXX_Object_Obj33.PxPyCoVnce = convertRawToPhysical(raw_value, 0.01, 0.0);

    raw_value=copyBitsFromByteArrayLE( byteArray, 17428, 12);
    @CAN_PrivMain::RFL_Object::RXX_Object_Obj33.PxVnce = convertRawToPhysical(raw_value, 0.1, 0.0);

    raw_value=copyBitsFromByteArrayLE( byteArray, 17664, 12);
    @CAN_PrivMain::RFL_Object::RXX_Object_Obj33.PxVxCoVnce = convertRawToPhysical(raw_value, 0.01, 0.0);

    raw_value=copyBitsFromByteArrayLE( byteArray, 17676, 12);
    @CAN_PrivMain::RFL_Object::RXX_Object_Obj33.PxVyCoVnce = convertRawToPhysical(raw_value, 0.01, 0.0);

    raw_value=copyBitsFromByteArrayLE( byteArray, 17440, 12);
    @CAN_PrivMain::RFL_Object::RXX_Object_Obj33.Py = convertRawToPhysical(raw_value, 0.0625, -128.0);

    raw_value=copyBitsFromByteArrayLE( byteArray, 17760, 12);
    @CAN_PrivMain::RFL_Object::RXX_Object_Obj33.PyAxCoVnce = convertRawToPhysical(raw_value, 0.01, 0.0);

    raw_value=copyBitsFromByteArrayLE( byteArray, 17772, 12);
    @CAN_PrivMain::RFL_Object::RXX_Object_Obj33.PyAyCoVnce = convertRawToPhysical(raw_value, 0.01, 0.0);

    raw_value=copyBitsFromByteArrayLE( byteArray, 17452, 12);
    @CAN_PrivMain::RFL_Object::RXX_Object_Obj33.PyVnce = convertRawToPhysical(raw_value, 0.1, 0.0);

    raw_value=copyBitsFromByteArrayLE( byteArray, 17696, 12);
    @CAN_PrivMain::RFL_Object::RXX_Object_Obj33.PyVxCoVnce = convertRawToPhysical(raw_value, 0.01, 0.0);

    raw_value=copyBitsFromByteArrayLE( byteArray, 17708, 12);
    @CAN_PrivMain::RFL_Object::RXX_Object_Obj33.PyVyCoVnce = convertRawToPhysical(raw_value, 0.01, 0.0);

    raw_value=copyBitsFromByteArrayLE( byteArray, 17548, 10);
    @CAN_PrivMain::RFL_Object::RXX_Object_Obj33.RCS = convertRawToPhysical(raw_value, 0.2, -102.4);

    raw_value=copyBitsFromByteArrayLE( byteArray, 17720, 4);
    @CAN_PrivMain::RFL_Object::RXX_Object_Obj33.ReferencePoint = convertRawToPhysical(raw_value, 1.0, 0.0);

    raw_value=copyBitsFromByteArrayLE( byteArray, 17580, 12);
    @CAN_PrivMain::RFL_Object::RXX_Object_Obj33.Vx = convertRawToPhysical(raw_value, 0.0625, -128.0);

    raw_value=copyBitsFromByteArrayLE( byteArray, 17804, 12);
    @CAN_PrivMain::RFL_Object::RXX_Object_Obj33.VxAxCoVnce = convertRawToPhysical(raw_value, 0.01, 0.0);

    raw_value=copyBitsFromByteArrayLE( byteArray, 17824, 12);
    @CAN_PrivMain::RFL_Object::RXX_Object_Obj33.VxAyCoVnce = convertRawToPhysical(raw_value, 0.01, 0.0);

    raw_value=copyBitsFromByteArrayLE( byteArray, 17600, 12);
    @CAN_PrivMain::RFL_Object::RXX_Object_Obj33.VxVnce = convertRawToPhysical(raw_value, 0.01, 0.0);

    raw_value=copyBitsFromByteArrayLE( byteArray, 17792, 12);
    @CAN_PrivMain::RFL_Object::RXX_Object_Obj33.VxVyCoVnce = convertRawToPhysical(raw_value, 0.01, 0.0);

    raw_value=copyBitsFromByteArrayLE( byteArray, 17614, 10);
    @CAN_PrivMain::RFL_Object::RXX_Object_Obj33.Vy = convertRawToPhysical(raw_value, 0.125, -64.0);

    raw_value=copyBitsFromByteArrayLE( byteArray, 17836, 12);
    @CAN_PrivMain::RFL_Object::RXX_Object_Obj33.VyAxCoVnce = convertRawToPhysical(raw_value, 0.01, 0.0);

    raw_value=copyBitsFromByteArrayLE( byteArray, 17856, 12);
    @CAN_PrivMain::RFL_Object::RXX_Object_Obj33.VyAyCoVnce = convertRawToPhysical(raw_value, 0.01, 0.0);

    raw_value=copyBitsFromByteArrayLE( byteArray, 17632, 12);
    @CAN_PrivMain::RFL_Object::RXX_Object_Obj33.VyVnce = convertRawToPhysical(raw_value, 0.01, 0.0);

    raw_value=copyBitsFromByteArrayLE( byteArray, 17528, 7);
    @CAN_PrivMain::RFL_Object::RXX_Object_Obj33.Width = convertRawToPhysical(raw_value, 0.125, 0.0);

    raw_value=copyBitsFromByteArrayLE( byteArray, 17536, 12);
    @CAN_PrivMain::RFL_Object::RXX_Object_Obj33.WidthVnce = convertRawToPhysical(raw_value, 0.01, 0.0);
}


void CRadarFL_RXX_Object_Obj34_SetDataReceived(byte byteArray[])
{
    qword raw_value;

    raw_value=copyBitsFromByteArrayLE( byteArray, 18400, 32);
    @CAN_PrivMain::RFL_Object::RXX_Object_Obj34.Age = convertRawToPhysical(raw_value, 1.0, 0.0);

    raw_value=copyBitsFromByteArrayLE( byteArray, 17996, 10);
    @CAN_PrivMain::RFL_Object::RXX_Object_Obj34.Ax = convertRawToPhysical(raw_value, 0.03125, -16.0);

    raw_value=copyBitsFromByteArrayLE( byteArray, 18380, 12);
    @CAN_PrivMain::RFL_Object::RXX_Object_Obj34.AxAyCoVnce = convertRawToPhysical(raw_value, 0.01, 0.0);

    raw_value=copyBitsFromByteArrayLE( byteArray, 18016, 12);
    @CAN_PrivMain::RFL_Object::RXX_Object_Obj34.AxVnce = convertRawToPhysical(raw_value, 0.01, 0.0);

    raw_value=copyBitsFromByteArrayLE( byteArray, 18070, 9);
    @CAN_PrivMain::RFL_Object::RXX_Object_Obj34.Ay = convertRawToPhysical(raw_value, 0.0625, -16.0);

    raw_value=copyBitsFromByteArrayLE( byteArray, 18080, 12);
    @CAN_PrivMain::RFL_Object::RXX_Object_Obj34.AyVnce = convertRawToPhysical(raw_value, 0.01, 0.0);

    raw_value=copyBitsFromByteArrayLE( byteArray, 18136, 6);
    @CAN_PrivMain::RFL_Object::RXX_Object_Obj34.ExistProb = convertRawToPhysical(raw_value, 2.0, 0.0);

    raw_value=copyBitsFromByteArrayLE( byteArray, 18200, 8);
    @CAN_PrivMain::RFL_Object::RXX_Object_Obj34.FilterInformation = convertRawToPhysical(raw_value, 1.0, 0.0);

    raw_value=copyBitsFromByteArrayLE( byteArray, 17976, 7);
    @CAN_PrivMain::RFL_Object::RXX_Object_Obj34.Length = convertRawToPhysical(raw_value, 0.125, 0.0);

    raw_value=copyBitsFromByteArrayLE( byteArray, 17984, 12);
    @CAN_PrivMain::RFL_Object::RXX_Object_Obj34.LengthVnce = convertRawToPhysical(raw_value, 0.01, 0.0);

    raw_value=copyBitsFromByteArrayLE( byteArray, 18168, 3);
    @CAN_PrivMain::RFL_Object::RXX_Object_Obj34.MeasurementStatus = convertRawToPhysical(raw_value, 1.0, 0.0);

    raw_value=copyBitsFromByteArrayLE( byteArray, 18124, 2);
    @CAN_PrivMain::RFL_Object::RXX_Object_Obj34.MovingStatus = convertRawToPhysical(raw_value, 1.0, 0.0);

    raw_value=copyBitsFromByteArrayLE( byteArray, 18104, 7);
    @CAN_PrivMain::RFL_Object::RXX_Object_Obj34.ObjId = convertRawToPhysical(raw_value, 1.0, 0.0);

    raw_value=copyBitsFromByteArrayLE( byteArray, 18006, 9);
    @CAN_PrivMain::RFL_Object::RXX_Object_Obj34.OrientationYaw = convertRawToPhysical(raw_value, 0.0175, -4.48);

    raw_value=copyBitsFromByteArrayLE( byteArray, 18028, 12);
    @CAN_PrivMain::RFL_Object::RXX_Object_Obj34.OrientationYawVnce = convertRawToPhysical(raw_value, 0.0003, 0.0);

    raw_value=copyBitsFromByteArrayLE( byteArray, 17920, 6);
    @CAN_PrivMain::RFL_Object::RXX_Object_Obj34.ProbClassConfidence = convertRawToPhysical(raw_value, 2.0, 0.0);

    raw_value=copyBitsFromByteArrayLE( byteArray, 18171, 4);
    @CAN_PrivMain::RFL_Object::RXX_Object_Obj34.ProbClassType = convertRawToPhysical(raw_value, 1.0, 0.0);

    raw_value=copyBitsFromByteArrayLE( byteArray, 17926, 14);
    @CAN_PrivMain::RFL_Object::RXX_Object_Obj34.Px = convertRawToPhysical(raw_value, 0.0625, -512.0);

    raw_value=copyBitsFromByteArrayLE( byteArray, 18240, 12);
    @CAN_PrivMain::RFL_Object::RXX_Object_Obj34.PxAxCoVnce = convertRawToPhysical(raw_value, 0.01, 0.0);

    raw_value=copyBitsFromByteArrayLE( byteArray, 18252, 12);
    @CAN_PrivMain::RFL_Object::RXX_Object_Obj34.PxAyCoVnce = convertRawToPhysical(raw_value, 0.01, 0.0);

    raw_value=copyBitsFromByteArrayLE( byteArray, 18156, 12);
    @CAN_PrivMain::RFL_Object::RXX_Object_Obj34.PxPyCoVnce = convertRawToPhysical(raw_value, 0.01, 0.0);

    raw_value=copyBitsFromByteArrayLE( byteArray, 17940, 12);
    @CAN_PrivMain::RFL_Object::RXX_Object_Obj34.PxVnce = convertRawToPhysical(raw_value, 0.1, 0.0);

    raw_value=copyBitsFromByteArrayLE( byteArray, 18176, 12);
    @CAN_PrivMain::RFL_Object::RXX_Object_Obj34.PxVxCoVnce = convertRawToPhysical(raw_value, 0.01, 0.0);

    raw_value=copyBitsFromByteArrayLE( byteArray, 18188, 12);
    @CAN_PrivMain::RFL_Object::RXX_Object_Obj34.PxVyCoVnce = convertRawToPhysical(raw_value, 0.01, 0.0);

    raw_value=copyBitsFromByteArrayLE( byteArray, 17952, 12);
    @CAN_PrivMain::RFL_Object::RXX_Object_Obj34.Py = convertRawToPhysical(raw_value, 0.0625, -128.0);

    raw_value=copyBitsFromByteArrayLE( byteArray, 18272, 12);
    @CAN_PrivMain::RFL_Object::RXX_Object_Obj34.PyAxCoVnce = convertRawToPhysical(raw_value, 0.01, 0.0);

    raw_value=copyBitsFromByteArrayLE( byteArray, 18284, 12);
    @CAN_PrivMain::RFL_Object::RXX_Object_Obj34.PyAyCoVnce = convertRawToPhysical(raw_value, 0.01, 0.0);

    raw_value=copyBitsFromByteArrayLE( byteArray, 17964, 12);
    @CAN_PrivMain::RFL_Object::RXX_Object_Obj34.PyVnce = convertRawToPhysical(raw_value, 0.1, 0.0);

    raw_value=copyBitsFromByteArrayLE( byteArray, 18208, 12);
    @CAN_PrivMain::RFL_Object::RXX_Object_Obj34.PyVxCoVnce = convertRawToPhysical(raw_value, 0.01, 0.0);

    raw_value=copyBitsFromByteArrayLE( byteArray, 18220, 12);
    @CAN_PrivMain::RFL_Object::RXX_Object_Obj34.PyVyCoVnce = convertRawToPhysical(raw_value, 0.01, 0.0);

    raw_value=copyBitsFromByteArrayLE( byteArray, 18060, 10);
    @CAN_PrivMain::RFL_Object::RXX_Object_Obj34.RCS = convertRawToPhysical(raw_value, 0.2, -102.4);

    raw_value=copyBitsFromByteArrayLE( byteArray, 18232, 4);
    @CAN_PrivMain::RFL_Object::RXX_Object_Obj34.ReferencePoint = convertRawToPhysical(raw_value, 1.0, 0.0);

    raw_value=copyBitsFromByteArrayLE( byteArray, 18092, 12);
    @CAN_PrivMain::RFL_Object::RXX_Object_Obj34.Vx = convertRawToPhysical(raw_value, 0.0625, -128.0);

    raw_value=copyBitsFromByteArrayLE( byteArray, 18316, 12);
    @CAN_PrivMain::RFL_Object::RXX_Object_Obj34.VxAxCoVnce = convertRawToPhysical(raw_value, 0.01, 0.0);

    raw_value=copyBitsFromByteArrayLE( byteArray, 18336, 12);
    @CAN_PrivMain::RFL_Object::RXX_Object_Obj34.VxAyCoVnce = convertRawToPhysical(raw_value, 0.01, 0.0);

    raw_value=copyBitsFromByteArrayLE( byteArray, 18112, 12);
    @CAN_PrivMain::RFL_Object::RXX_Object_Obj34.VxVnce = convertRawToPhysical(raw_value, 0.01, 0.0);

    raw_value=copyBitsFromByteArrayLE( byteArray, 18304, 12);
    @CAN_PrivMain::RFL_Object::RXX_Object_Obj34.VxVyCoVnce = convertRawToPhysical(raw_value, 0.01, 0.0);

    raw_value=copyBitsFromByteArrayLE( byteArray, 18126, 10);
    @CAN_PrivMain::RFL_Object::RXX_Object_Obj34.Vy = convertRawToPhysical(raw_value, 0.125, -64.0);

    raw_value=copyBitsFromByteArrayLE( byteArray, 18348, 12);
    @CAN_PrivMain::RFL_Object::RXX_Object_Obj34.VyAxCoVnce = convertRawToPhysical(raw_value, 0.01, 0.0);

    raw_value=copyBitsFromByteArrayLE( byteArray, 18368, 12);
    @CAN_PrivMain::RFL_Object::RXX_Object_Obj34.VyAyCoVnce = convertRawToPhysical(raw_value, 0.01, 0.0);

    raw_value=copyBitsFromByteArrayLE( byteArray, 18144, 12);
    @CAN_PrivMain::RFL_Object::RXX_Object_Obj34.VyVnce = convertRawToPhysical(raw_value, 0.01, 0.0);

    raw_value=copyBitsFromByteArrayLE( byteArray, 18040, 7);
    @CAN_PrivMain::RFL_Object::RXX_Object_Obj34.Width = convertRawToPhysical(raw_value, 0.125, 0.0);

    raw_value=copyBitsFromByteArrayLE( byteArray, 18048, 12);
    @CAN_PrivMain::RFL_Object::RXX_Object_Obj34.WidthVnce = convertRawToPhysical(raw_value, 0.01, 0.0);
}


void CRadarFL_RXX_Object_Obj35_SetDataReceived(byte byteArray[])
{
    qword raw_value;

    raw_value=copyBitsFromByteArrayLE( byteArray, 18912, 32);
    @CAN_PrivMain::RFL_Object::RXX_Object_Obj35.Age = convertRawToPhysical(raw_value, 1.0, 0.0);

    raw_value=copyBitsFromByteArrayLE( byteArray, 18508, 10);
    @CAN_PrivMain::RFL_Object::RXX_Object_Obj35.Ax = convertRawToPhysical(raw_value, 0.03125, -16.0);

    raw_value=copyBitsFromByteArrayLE( byteArray, 18892, 12);
    @CAN_PrivMain::RFL_Object::RXX_Object_Obj35.AxAyCoVnce = convertRawToPhysical(raw_value, 0.01, 0.0);

    raw_value=copyBitsFromByteArrayLE( byteArray, 18528, 12);
    @CAN_PrivMain::RFL_Object::RXX_Object_Obj35.AxVnce = convertRawToPhysical(raw_value, 0.01, 0.0);

    raw_value=copyBitsFromByteArrayLE( byteArray, 18582, 9);
    @CAN_PrivMain::RFL_Object::RXX_Object_Obj35.Ay = convertRawToPhysical(raw_value, 0.0625, -16.0);

    raw_value=copyBitsFromByteArrayLE( byteArray, 18592, 12);
    @CAN_PrivMain::RFL_Object::RXX_Object_Obj35.AyVnce = convertRawToPhysical(raw_value, 0.01, 0.0);

    raw_value=copyBitsFromByteArrayLE( byteArray, 18648, 6);
    @CAN_PrivMain::RFL_Object::RXX_Object_Obj35.ExistProb = convertRawToPhysical(raw_value, 2.0, 0.0);

    raw_value=copyBitsFromByteArrayLE( byteArray, 18712, 8);
    @CAN_PrivMain::RFL_Object::RXX_Object_Obj35.FilterInformation = convertRawToPhysical(raw_value, 1.0, 0.0);

    raw_value=copyBitsFromByteArrayLE( byteArray, 18488, 7);
    @CAN_PrivMain::RFL_Object::RXX_Object_Obj35.Length = convertRawToPhysical(raw_value, 0.125, 0.0);

    raw_value=copyBitsFromByteArrayLE( byteArray, 18496, 12);
    @CAN_PrivMain::RFL_Object::RXX_Object_Obj35.LengthVnce = convertRawToPhysical(raw_value, 0.01, 0.0);

    raw_value=copyBitsFromByteArrayLE( byteArray, 18680, 3);
    @CAN_PrivMain::RFL_Object::RXX_Object_Obj35.MeasurementStatus = convertRawToPhysical(raw_value, 1.0, 0.0);

    raw_value=copyBitsFromByteArrayLE( byteArray, 18636, 2);
    @CAN_PrivMain::RFL_Object::RXX_Object_Obj35.MovingStatus = convertRawToPhysical(raw_value, 1.0, 0.0);

    raw_value=copyBitsFromByteArrayLE( byteArray, 18616, 7);
    @CAN_PrivMain::RFL_Object::RXX_Object_Obj35.ObjId = convertRawToPhysical(raw_value, 1.0, 0.0);

    raw_value=copyBitsFromByteArrayLE( byteArray, 18518, 9);
    @CAN_PrivMain::RFL_Object::RXX_Object_Obj35.OrientationYaw = convertRawToPhysical(raw_value, 0.0175, -4.48);

    raw_value=copyBitsFromByteArrayLE( byteArray, 18540, 12);
    @CAN_PrivMain::RFL_Object::RXX_Object_Obj35.OrientationYawVnce = convertRawToPhysical(raw_value, 0.0003, 0.0);

    raw_value=copyBitsFromByteArrayLE( byteArray, 18432, 6);
    @CAN_PrivMain::RFL_Object::RXX_Object_Obj35.ProbClassConfidence = convertRawToPhysical(raw_value, 2.0, 0.0);

    raw_value=copyBitsFromByteArrayLE( byteArray, 18683, 4);
    @CAN_PrivMain::RFL_Object::RXX_Object_Obj35.ProbClassType = convertRawToPhysical(raw_value, 1.0, 0.0);

    raw_value=copyBitsFromByteArrayLE( byteArray, 18438, 14);
    @CAN_PrivMain::RFL_Object::RXX_Object_Obj35.Px = convertRawToPhysical(raw_value, 0.0625, -512.0);

    raw_value=copyBitsFromByteArrayLE( byteArray, 18752, 12);
    @CAN_PrivMain::RFL_Object::RXX_Object_Obj35.PxAxCoVnce = convertRawToPhysical(raw_value, 0.01, 0.0);

    raw_value=copyBitsFromByteArrayLE( byteArray, 18764, 12);
    @CAN_PrivMain::RFL_Object::RXX_Object_Obj35.PxAyCoVnce = convertRawToPhysical(raw_value, 0.01, 0.0);

    raw_value=copyBitsFromByteArrayLE( byteArray, 18668, 12);
    @CAN_PrivMain::RFL_Object::RXX_Object_Obj35.PxPyCoVnce = convertRawToPhysical(raw_value, 0.01, 0.0);

    raw_value=copyBitsFromByteArrayLE( byteArray, 18452, 12);
    @CAN_PrivMain::RFL_Object::RXX_Object_Obj35.PxVnce = convertRawToPhysical(raw_value, 0.1, 0.0);

    raw_value=copyBitsFromByteArrayLE( byteArray, 18688, 12);
    @CAN_PrivMain::RFL_Object::RXX_Object_Obj35.PxVxCoVnce = convertRawToPhysical(raw_value, 0.01, 0.0);

    raw_value=copyBitsFromByteArrayLE( byteArray, 18700, 12);
    @CAN_PrivMain::RFL_Object::RXX_Object_Obj35.PxVyCoVnce = convertRawToPhysical(raw_value, 0.01, 0.0);

    raw_value=copyBitsFromByteArrayLE( byteArray, 18464, 12);
    @CAN_PrivMain::RFL_Object::RXX_Object_Obj35.Py = convertRawToPhysical(raw_value, 0.0625, -128.0);

    raw_value=copyBitsFromByteArrayLE( byteArray, 18784, 12);
    @CAN_PrivMain::RFL_Object::RXX_Object_Obj35.PyAxCoVnce = convertRawToPhysical(raw_value, 0.01, 0.0);

    raw_value=copyBitsFromByteArrayLE( byteArray, 18796, 12);
    @CAN_PrivMain::RFL_Object::RXX_Object_Obj35.PyAyCoVnce = convertRawToPhysical(raw_value, 0.01, 0.0);

    raw_value=copyBitsFromByteArrayLE( byteArray, 18476, 12);
    @CAN_PrivMain::RFL_Object::RXX_Object_Obj35.PyVnce = convertRawToPhysical(raw_value, 0.1, 0.0);

    raw_value=copyBitsFromByteArrayLE( byteArray, 18720, 12);
    @CAN_PrivMain::RFL_Object::RXX_Object_Obj35.PyVxCoVnce = convertRawToPhysical(raw_value, 0.01, 0.0);

    raw_value=copyBitsFromByteArrayLE( byteArray, 18732, 12);
    @CAN_PrivMain::RFL_Object::RXX_Object_Obj35.PyVyCoVnce = convertRawToPhysical(raw_value, 0.01, 0.0);

    raw_value=copyBitsFromByteArrayLE( byteArray, 18572, 10);
    @CAN_PrivMain::RFL_Object::RXX_Object_Obj35.RCS = convertRawToPhysical(raw_value, 0.2, -102.4);

    raw_value=copyBitsFromByteArrayLE( byteArray, 18744, 4);
    @CAN_PrivMain::RFL_Object::RXX_Object_Obj35.ReferencePoint = convertRawToPhysical(raw_value, 1.0, 0.0);

    raw_value=copyBitsFromByteArrayLE( byteArray, 18604, 12);
    @CAN_PrivMain::RFL_Object::RXX_Object_Obj35.Vx = convertRawToPhysical(raw_value, 0.0625, -128.0);

    raw_value=copyBitsFromByteArrayLE( byteArray, 18828, 12);
    @CAN_PrivMain::RFL_Object::RXX_Object_Obj35.VxAxCoVnce = convertRawToPhysical(raw_value, 0.01, 0.0);

    raw_value=copyBitsFromByteArrayLE( byteArray, 18848, 12);
    @CAN_PrivMain::RFL_Object::RXX_Object_Obj35.VxAyCoVnce = convertRawToPhysical(raw_value, 0.01, 0.0);

    raw_value=copyBitsFromByteArrayLE( byteArray, 18624, 12);
    @CAN_PrivMain::RFL_Object::RXX_Object_Obj35.VxVnce = convertRawToPhysical(raw_value, 0.01, 0.0);

    raw_value=copyBitsFromByteArrayLE( byteArray, 18816, 12);
    @CAN_PrivMain::RFL_Object::RXX_Object_Obj35.VxVyCoVnce = convertRawToPhysical(raw_value, 0.01, 0.0);

    raw_value=copyBitsFromByteArrayLE( byteArray, 18638, 10);
    @CAN_PrivMain::RFL_Object::RXX_Object_Obj35.Vy = convertRawToPhysical(raw_value, 0.125, -64.0);

    raw_value=copyBitsFromByteArrayLE( byteArray, 18860, 12);
    @CAN_PrivMain::RFL_Object::RXX_Object_Obj35.VyAxCoVnce = convertRawToPhysical(raw_value, 0.01, 0.0);

    raw_value=copyBitsFromByteArrayLE( byteArray, 18880, 12);
    @CAN_PrivMain::RFL_Object::RXX_Object_Obj35.VyAyCoVnce = convertRawToPhysical(raw_value, 0.01, 0.0);

    raw_value=copyBitsFromByteArrayLE( byteArray, 18656, 12);
    @CAN_PrivMain::RFL_Object::RXX_Object_Obj35.VyVnce = convertRawToPhysical(raw_value, 0.01, 0.0);

    raw_value=copyBitsFromByteArrayLE( byteArray, 18552, 7);
    @CAN_PrivMain::RFL_Object::RXX_Object_Obj35.Width = convertRawToPhysical(raw_value, 0.125, 0.0);

    raw_value=copyBitsFromByteArrayLE( byteArray, 18560, 12);
    @CAN_PrivMain::RFL_Object::RXX_Object_Obj35.WidthVnce = convertRawToPhysical(raw_value, 0.01, 0.0);
}


void CRadarFL_RXX_Object_Obj36_SetDataReceived(byte byteArray[])
{
    qword raw_value;

    raw_value=copyBitsFromByteArrayLE( byteArray, 19424, 32);
    @CAN_PrivMain::RFL_Object::RXX_Object_Obj36.Age = convertRawToPhysical(raw_value, 1.0, 0.0);

    raw_value=copyBitsFromByteArrayLE( byteArray, 19020, 10);
    @CAN_PrivMain::RFL_Object::RXX_Object_Obj36.Ax = convertRawToPhysical(raw_value, 0.03125, -16.0);

    raw_value=copyBitsFromByteArrayLE( byteArray, 19404, 12);
    @CAN_PrivMain::RFL_Object::RXX_Object_Obj36.AxAyCoVnce = convertRawToPhysical(raw_value, 0.01, 0.0);

    raw_value=copyBitsFromByteArrayLE( byteArray, 19040, 12);
    @CAN_PrivMain::RFL_Object::RXX_Object_Obj36.AxVnce = convertRawToPhysical(raw_value, 0.01, 0.0);

    raw_value=copyBitsFromByteArrayLE( byteArray, 19094, 9);
    @CAN_PrivMain::RFL_Object::RXX_Object_Obj36.Ay = convertRawToPhysical(raw_value, 0.0625, -16.0);

    raw_value=copyBitsFromByteArrayLE( byteArray, 19104, 12);
    @CAN_PrivMain::RFL_Object::RXX_Object_Obj36.AyVnce = convertRawToPhysical(raw_value, 0.01, 0.0);

    raw_value=copyBitsFromByteArrayLE( byteArray, 19160, 6);
    @CAN_PrivMain::RFL_Object::RXX_Object_Obj36.ExistProb = convertRawToPhysical(raw_value, 2.0, 0.0);

    raw_value=copyBitsFromByteArrayLE( byteArray, 19224, 8);
    @CAN_PrivMain::RFL_Object::RXX_Object_Obj36.FilterInformation = convertRawToPhysical(raw_value, 1.0, 0.0);

    raw_value=copyBitsFromByteArrayLE( byteArray, 19000, 7);
    @CAN_PrivMain::RFL_Object::RXX_Object_Obj36.Length = convertRawToPhysical(raw_value, 0.125, 0.0);

    raw_value=copyBitsFromByteArrayLE( byteArray, 19008, 12);
    @CAN_PrivMain::RFL_Object::RXX_Object_Obj36.LengthVnce = convertRawToPhysical(raw_value, 0.01, 0.0);

    raw_value=copyBitsFromByteArrayLE( byteArray, 19192, 3);
    @CAN_PrivMain::RFL_Object::RXX_Object_Obj36.MeasurementStatus = convertRawToPhysical(raw_value, 1.0, 0.0);

    raw_value=copyBitsFromByteArrayLE( byteArray, 19148, 2);
    @CAN_PrivMain::RFL_Object::RXX_Object_Obj36.MovingStatus = convertRawToPhysical(raw_value, 1.0, 0.0);

    raw_value=copyBitsFromByteArrayLE( byteArray, 19128, 7);
    @CAN_PrivMain::RFL_Object::RXX_Object_Obj36.ObjId = convertRawToPhysical(raw_value, 1.0, 0.0);

    raw_value=copyBitsFromByteArrayLE( byteArray, 19030, 9);
    @CAN_PrivMain::RFL_Object::RXX_Object_Obj36.OrientationYaw = convertRawToPhysical(raw_value, 0.0175, -4.48);

    raw_value=copyBitsFromByteArrayLE( byteArray, 19052, 12);
    @CAN_PrivMain::RFL_Object::RXX_Object_Obj36.OrientationYawVnce = convertRawToPhysical(raw_value, 0.0003, 0.0);

    raw_value=copyBitsFromByteArrayLE( byteArray, 18944, 6);
    @CAN_PrivMain::RFL_Object::RXX_Object_Obj36.ProbClassConfidence = convertRawToPhysical(raw_value, 2.0, 0.0);

    raw_value=copyBitsFromByteArrayLE( byteArray, 19195, 4);
    @CAN_PrivMain::RFL_Object::RXX_Object_Obj36.ProbClassType = convertRawToPhysical(raw_value, 1.0, 0.0);

    raw_value=copyBitsFromByteArrayLE( byteArray, 18950, 14);
    @CAN_PrivMain::RFL_Object::RXX_Object_Obj36.Px = convertRawToPhysical(raw_value, 0.0625, -512.0);

    raw_value=copyBitsFromByteArrayLE( byteArray, 19264, 12);
    @CAN_PrivMain::RFL_Object::RXX_Object_Obj36.PxAxCoVnce = convertRawToPhysical(raw_value, 0.01, 0.0);

    raw_value=copyBitsFromByteArrayLE( byteArray, 19276, 12);
    @CAN_PrivMain::RFL_Object::RXX_Object_Obj36.PxAyCoVnce = convertRawToPhysical(raw_value, 0.01, 0.0);

    raw_value=copyBitsFromByteArrayLE( byteArray, 19180, 12);
    @CAN_PrivMain::RFL_Object::RXX_Object_Obj36.PxPyCoVnce = convertRawToPhysical(raw_value, 0.01, 0.0);

    raw_value=copyBitsFromByteArrayLE( byteArray, 18964, 12);
    @CAN_PrivMain::RFL_Object::RXX_Object_Obj36.PxVnce = convertRawToPhysical(raw_value, 0.1, 0.0);

    raw_value=copyBitsFromByteArrayLE( byteArray, 19200, 12);
    @CAN_PrivMain::RFL_Object::RXX_Object_Obj36.PxVxCoVnce = convertRawToPhysical(raw_value, 0.01, 0.0);

    raw_value=copyBitsFromByteArrayLE( byteArray, 19212, 12);
    @CAN_PrivMain::RFL_Object::RXX_Object_Obj36.PxVyCoVnce = convertRawToPhysical(raw_value, 0.01, 0.0);

    raw_value=copyBitsFromByteArrayLE( byteArray, 18976, 12);
    @CAN_PrivMain::RFL_Object::RXX_Object_Obj36.Py = convertRawToPhysical(raw_value, 0.0625, -128.0);

    raw_value=copyBitsFromByteArrayLE( byteArray, 19296, 12);
    @CAN_PrivMain::RFL_Object::RXX_Object_Obj36.PyAxCoVnce = convertRawToPhysical(raw_value, 0.01, 0.0);

    raw_value=copyBitsFromByteArrayLE( byteArray, 19308, 12);
    @CAN_PrivMain::RFL_Object::RXX_Object_Obj36.PyAyCoVnce = convertRawToPhysical(raw_value, 0.01, 0.0);

    raw_value=copyBitsFromByteArrayLE( byteArray, 18988, 12);
    @CAN_PrivMain::RFL_Object::RXX_Object_Obj36.PyVnce = convertRawToPhysical(raw_value, 0.1, 0.0);

    raw_value=copyBitsFromByteArrayLE( byteArray, 19232, 12);
    @CAN_PrivMain::RFL_Object::RXX_Object_Obj36.PyVxCoVnce = convertRawToPhysical(raw_value, 0.01, 0.0);

    raw_value=copyBitsFromByteArrayLE( byteArray, 19244, 12);
    @CAN_PrivMain::RFL_Object::RXX_Object_Obj36.PyVyCoVnce = convertRawToPhysical(raw_value, 0.01, 0.0);

    raw_value=copyBitsFromByteArrayLE( byteArray, 19084, 10);
    @CAN_PrivMain::RFL_Object::RXX_Object_Obj36.RCS = convertRawToPhysical(raw_value, 0.2, -102.4);

    raw_value=copyBitsFromByteArrayLE( byteArray, 19256, 4);
    @CAN_PrivMain::RFL_Object::RXX_Object_Obj36.ReferencePoint = convertRawToPhysical(raw_value, 1.0, 0.0);

    raw_value=copyBitsFromByteArrayLE( byteArray, 19116, 12);
    @CAN_PrivMain::RFL_Object::RXX_Object_Obj36.Vx = convertRawToPhysical(raw_value, 0.0625, -128.0);

    raw_value=copyBitsFromByteArrayLE( byteArray, 19340, 12);
    @CAN_PrivMain::RFL_Object::RXX_Object_Obj36.VxAxCoVnce = convertRawToPhysical(raw_value, 0.01, 0.0);

    raw_value=copyBitsFromByteArrayLE( byteArray, 19360, 12);
    @CAN_PrivMain::RFL_Object::RXX_Object_Obj36.VxAyCoVnce = convertRawToPhysical(raw_value, 0.01, 0.0);

    raw_value=copyBitsFromByteArrayLE( byteArray, 19136, 12);
    @CAN_PrivMain::RFL_Object::RXX_Object_Obj36.VxVnce = convertRawToPhysical(raw_value, 0.01, 0.0);

    raw_value=copyBitsFromByteArrayLE( byteArray, 19328, 12);
    @CAN_PrivMain::RFL_Object::RXX_Object_Obj36.VxVyCoVnce = convertRawToPhysical(raw_value, 0.01, 0.0);

    raw_value=copyBitsFromByteArrayLE( byteArray, 19150, 10);
    @CAN_PrivMain::RFL_Object::RXX_Object_Obj36.Vy = convertRawToPhysical(raw_value, 0.125, -64.0);

    raw_value=copyBitsFromByteArrayLE( byteArray, 19372, 12);
    @CAN_PrivMain::RFL_Object::RXX_Object_Obj36.VyAxCoVnce = convertRawToPhysical(raw_value, 0.01, 0.0);

    raw_value=copyBitsFromByteArrayLE( byteArray, 19392, 12);
    @CAN_PrivMain::RFL_Object::RXX_Object_Obj36.VyAyCoVnce = convertRawToPhysical(raw_value, 0.01, 0.0);

    raw_value=copyBitsFromByteArrayLE( byteArray, 19168, 12);
    @CAN_PrivMain::RFL_Object::RXX_Object_Obj36.VyVnce = convertRawToPhysical(raw_value, 0.01, 0.0);

    raw_value=copyBitsFromByteArrayLE( byteArray, 19064, 7);
    @CAN_PrivMain::RFL_Object::RXX_Object_Obj36.Width = convertRawToPhysical(raw_value, 0.125, 0.0);

    raw_value=copyBitsFromByteArrayLE( byteArray, 19072, 12);
    @CAN_PrivMain::RFL_Object::RXX_Object_Obj36.WidthVnce = convertRawToPhysical(raw_value, 0.01, 0.0);
}


void CRadarFL_RXX_Object_Obj37_SetDataReceived(byte byteArray[])
{
    qword raw_value;

    raw_value=copyBitsFromByteArrayLE( byteArray, 19936, 32);
    @CAN_PrivMain::RFL_Object::RXX_Object_Obj37.Age = convertRawToPhysical(raw_value, 1.0, 0.0);

    raw_value=copyBitsFromByteArrayLE( byteArray, 19532, 10);
    @CAN_PrivMain::RFL_Object::RXX_Object_Obj37.Ax = convertRawToPhysical(raw_value, 0.03125, -16.0);

    raw_value=copyBitsFromByteArrayLE( byteArray, 19916, 12);
    @CAN_PrivMain::RFL_Object::RXX_Object_Obj37.AxAyCoVnce = convertRawToPhysical(raw_value, 0.01, 0.0);

    raw_value=copyBitsFromByteArrayLE( byteArray, 19552, 12);
    @CAN_PrivMain::RFL_Object::RXX_Object_Obj37.AxVnce = convertRawToPhysical(raw_value, 0.01, 0.0);

    raw_value=copyBitsFromByteArrayLE( byteArray, 19606, 9);
    @CAN_PrivMain::RFL_Object::RXX_Object_Obj37.Ay = convertRawToPhysical(raw_value, 0.0625, -16.0);

    raw_value=copyBitsFromByteArrayLE( byteArray, 19616, 12);
    @CAN_PrivMain::RFL_Object::RXX_Object_Obj37.AyVnce = convertRawToPhysical(raw_value, 0.01, 0.0);

    raw_value=copyBitsFromByteArrayLE( byteArray, 19672, 6);
    @CAN_PrivMain::RFL_Object::RXX_Object_Obj37.ExistProb = convertRawToPhysical(raw_value, 2.0, 0.0);

    raw_value=copyBitsFromByteArrayLE( byteArray, 19736, 8);
    @CAN_PrivMain::RFL_Object::RXX_Object_Obj37.FilterInformation = convertRawToPhysical(raw_value, 1.0, 0.0);

    raw_value=copyBitsFromByteArrayLE( byteArray, 19512, 7);
    @CAN_PrivMain::RFL_Object::RXX_Object_Obj37.Length = convertRawToPhysical(raw_value, 0.125, 0.0);

    raw_value=copyBitsFromByteArrayLE( byteArray, 19520, 12);
    @CAN_PrivMain::RFL_Object::RXX_Object_Obj37.LengthVnce = convertRawToPhysical(raw_value, 0.01, 0.0);

    raw_value=copyBitsFromByteArrayLE( byteArray, 19704, 3);
    @CAN_PrivMain::RFL_Object::RXX_Object_Obj37.MeasurementStatus = convertRawToPhysical(raw_value, 1.0, 0.0);

    raw_value=copyBitsFromByteArrayLE( byteArray, 19660, 2);
    @CAN_PrivMain::RFL_Object::RXX_Object_Obj37.MovingStatus = convertRawToPhysical(raw_value, 1.0, 0.0);

    raw_value=copyBitsFromByteArrayLE( byteArray, 19640, 7);
    @CAN_PrivMain::RFL_Object::RXX_Object_Obj37.ObjId = convertRawToPhysical(raw_value, 1.0, 0.0);

    raw_value=copyBitsFromByteArrayLE( byteArray, 19542, 9);
    @CAN_PrivMain::RFL_Object::RXX_Object_Obj37.OrientationYaw = convertRawToPhysical(raw_value, 0.0175, -4.48);

    raw_value=copyBitsFromByteArrayLE( byteArray, 19564, 12);
    @CAN_PrivMain::RFL_Object::RXX_Object_Obj37.OrientationYawVnce = convertRawToPhysical(raw_value, 0.0003, 0.0);

    raw_value=copyBitsFromByteArrayLE( byteArray, 19456, 6);
    @CAN_PrivMain::RFL_Object::RXX_Object_Obj37.ProbClassConfidence = convertRawToPhysical(raw_value, 2.0, 0.0);

    raw_value=copyBitsFromByteArrayLE( byteArray, 19707, 4);
    @CAN_PrivMain::RFL_Object::RXX_Object_Obj37.ProbClassType = convertRawToPhysical(raw_value, 1.0, 0.0);

    raw_value=copyBitsFromByteArrayLE( byteArray, 19462, 14);
    @CAN_PrivMain::RFL_Object::RXX_Object_Obj37.Px = convertRawToPhysical(raw_value, 0.0625, -512.0);

    raw_value=copyBitsFromByteArrayLE( byteArray, 19776, 12);
    @CAN_PrivMain::RFL_Object::RXX_Object_Obj37.PxAxCoVnce = convertRawToPhysical(raw_value, 0.01, 0.0);

    raw_value=copyBitsFromByteArrayLE( byteArray, 19788, 12);
    @CAN_PrivMain::RFL_Object::RXX_Object_Obj37.PxAyCoVnce = convertRawToPhysical(raw_value, 0.01, 0.0);

    raw_value=copyBitsFromByteArrayLE( byteArray, 19692, 12);
    @CAN_PrivMain::RFL_Object::RXX_Object_Obj37.PxPyCoVnce = convertRawToPhysical(raw_value, 0.01, 0.0);

    raw_value=copyBitsFromByteArrayLE( byteArray, 19476, 12);
    @CAN_PrivMain::RFL_Object::RXX_Object_Obj37.PxVnce = convertRawToPhysical(raw_value, 0.1, 0.0);

    raw_value=copyBitsFromByteArrayLE( byteArray, 19712, 12);
    @CAN_PrivMain::RFL_Object::RXX_Object_Obj37.PxVxCoVnce = convertRawToPhysical(raw_value, 0.01, 0.0);

    raw_value=copyBitsFromByteArrayLE( byteArray, 19724, 12);
    @CAN_PrivMain::RFL_Object::RXX_Object_Obj37.PxVyCoVnce = convertRawToPhysical(raw_value, 0.01, 0.0);

    raw_value=copyBitsFromByteArrayLE( byteArray, 19488, 12);
    @CAN_PrivMain::RFL_Object::RXX_Object_Obj37.Py = convertRawToPhysical(raw_value, 0.0625, -128.0);

    raw_value=copyBitsFromByteArrayLE( byteArray, 19808, 12);
    @CAN_PrivMain::RFL_Object::RXX_Object_Obj37.PyAxCoVnce = convertRawToPhysical(raw_value, 0.01, 0.0);

    raw_value=copyBitsFromByteArrayLE( byteArray, 19820, 12);
    @CAN_PrivMain::RFL_Object::RXX_Object_Obj37.PyAyCoVnce = convertRawToPhysical(raw_value, 0.01, 0.0);

    raw_value=copyBitsFromByteArrayLE( byteArray, 19500, 12);
    @CAN_PrivMain::RFL_Object::RXX_Object_Obj37.PyVnce = convertRawToPhysical(raw_value, 0.1, 0.0);

    raw_value=copyBitsFromByteArrayLE( byteArray, 19744, 12);
    @CAN_PrivMain::RFL_Object::RXX_Object_Obj37.PyVxCoVnce = convertRawToPhysical(raw_value, 0.01, 0.0);

    raw_value=copyBitsFromByteArrayLE( byteArray, 19756, 12);
    @CAN_PrivMain::RFL_Object::RXX_Object_Obj37.PyVyCoVnce = convertRawToPhysical(raw_value, 0.01, 0.0);

    raw_value=copyBitsFromByteArrayLE( byteArray, 19596, 10);
    @CAN_PrivMain::RFL_Object::RXX_Object_Obj37.RCS = convertRawToPhysical(raw_value, 0.2, -102.4);

    raw_value=copyBitsFromByteArrayLE( byteArray, 19768, 4);
    @CAN_PrivMain::RFL_Object::RXX_Object_Obj37.ReferencePoint = convertRawToPhysical(raw_value, 1.0, 0.0);

    raw_value=copyBitsFromByteArrayLE( byteArray, 19628, 12);
    @CAN_PrivMain::RFL_Object::RXX_Object_Obj37.Vx = convertRawToPhysical(raw_value, 0.0625, -128.0);

    raw_value=copyBitsFromByteArrayLE( byteArray, 19852, 12);
    @CAN_PrivMain::RFL_Object::RXX_Object_Obj37.VxAxCoVnce = convertRawToPhysical(raw_value, 0.01, 0.0);

    raw_value=copyBitsFromByteArrayLE( byteArray, 19872, 12);
    @CAN_PrivMain::RFL_Object::RXX_Object_Obj37.VxAyCoVnce = convertRawToPhysical(raw_value, 0.01, 0.0);

    raw_value=copyBitsFromByteArrayLE( byteArray, 19648, 12);
    @CAN_PrivMain::RFL_Object::RXX_Object_Obj37.VxVnce = convertRawToPhysical(raw_value, 0.01, 0.0);

    raw_value=copyBitsFromByteArrayLE( byteArray, 19840, 12);
    @CAN_PrivMain::RFL_Object::RXX_Object_Obj37.VxVyCoVnce = convertRawToPhysical(raw_value, 0.01, 0.0);

    raw_value=copyBitsFromByteArrayLE( byteArray, 19662, 10);
    @CAN_PrivMain::RFL_Object::RXX_Object_Obj37.Vy = convertRawToPhysical(raw_value, 0.125, -64.0);

    raw_value=copyBitsFromByteArrayLE( byteArray, 19884, 12);
    @CAN_PrivMain::RFL_Object::RXX_Object_Obj37.VyAxCoVnce = convertRawToPhysical(raw_value, 0.01, 0.0);

    raw_value=copyBitsFromByteArrayLE( byteArray, 19904, 12);
    @CAN_PrivMain::RFL_Object::RXX_Object_Obj37.VyAyCoVnce = convertRawToPhysical(raw_value, 0.01, 0.0);

    raw_value=copyBitsFromByteArrayLE( byteArray, 19680, 12);
    @CAN_PrivMain::RFL_Object::RXX_Object_Obj37.VyVnce = convertRawToPhysical(raw_value, 0.01, 0.0);

    raw_value=copyBitsFromByteArrayLE( byteArray, 19576, 7);
    @CAN_PrivMain::RFL_Object::RXX_Object_Obj37.Width = convertRawToPhysical(raw_value, 0.125, 0.0);

    raw_value=copyBitsFromByteArrayLE( byteArray, 19584, 12);
    @CAN_PrivMain::RFL_Object::RXX_Object_Obj37.WidthVnce = convertRawToPhysical(raw_value, 0.01, 0.0);
}


void CRadarFL_RXX_Object_Obj38_SetDataReceived(byte byteArray[])
{
    qword raw_value;

    raw_value=copyBitsFromByteArrayLE( byteArray, 20448, 32);
    @CAN_PrivMain::RFL_Object::RXX_Object_Obj38.Age = convertRawToPhysical(raw_value, 1.0, 0.0);

    raw_value=copyBitsFromByteArrayLE( byteArray, 20044, 10);
    @CAN_PrivMain::RFL_Object::RXX_Object_Obj38.Ax = convertRawToPhysical(raw_value, 0.03125, -16.0);

    raw_value=copyBitsFromByteArrayLE( byteArray, 20428, 12);
    @CAN_PrivMain::RFL_Object::RXX_Object_Obj38.AxAyCoVnce = convertRawToPhysical(raw_value, 0.01, 0.0);

    raw_value=copyBitsFromByteArrayLE( byteArray, 20064, 12);
    @CAN_PrivMain::RFL_Object::RXX_Object_Obj38.AxVnce = convertRawToPhysical(raw_value, 0.01, 0.0);

    raw_value=copyBitsFromByteArrayLE( byteArray, 20118, 9);
    @CAN_PrivMain::RFL_Object::RXX_Object_Obj38.Ay = convertRawToPhysical(raw_value, 0.0625, -16.0);

    raw_value=copyBitsFromByteArrayLE( byteArray, 20128, 12);
    @CAN_PrivMain::RFL_Object::RXX_Object_Obj38.AyVnce = convertRawToPhysical(raw_value, 0.01, 0.0);

    raw_value=copyBitsFromByteArrayLE( byteArray, 20184, 6);
    @CAN_PrivMain::RFL_Object::RXX_Object_Obj38.ExistProb = convertRawToPhysical(raw_value, 2.0, 0.0);

    raw_value=copyBitsFromByteArrayLE( byteArray, 20248, 8);
    @CAN_PrivMain::RFL_Object::RXX_Object_Obj38.FilterInformation = convertRawToPhysical(raw_value, 1.0, 0.0);

    raw_value=copyBitsFromByteArrayLE( byteArray, 20024, 7);
    @CAN_PrivMain::RFL_Object::RXX_Object_Obj38.Length = convertRawToPhysical(raw_value, 0.125, 0.0);

    raw_value=copyBitsFromByteArrayLE( byteArray, 20032, 12);
    @CAN_PrivMain::RFL_Object::RXX_Object_Obj38.LengthVnce = convertRawToPhysical(raw_value, 0.01, 0.0);

    raw_value=copyBitsFromByteArrayLE( byteArray, 20216, 3);
    @CAN_PrivMain::RFL_Object::RXX_Object_Obj38.MeasurementStatus = convertRawToPhysical(raw_value, 1.0, 0.0);

    raw_value=copyBitsFromByteArrayLE( byteArray, 20172, 2);
    @CAN_PrivMain::RFL_Object::RXX_Object_Obj38.MovingStatus = convertRawToPhysical(raw_value, 1.0, 0.0);

    raw_value=copyBitsFromByteArrayLE( byteArray, 20152, 7);
    @CAN_PrivMain::RFL_Object::RXX_Object_Obj38.ObjId = convertRawToPhysical(raw_value, 1.0, 0.0);

    raw_value=copyBitsFromByteArrayLE( byteArray, 20054, 9);
    @CAN_PrivMain::RFL_Object::RXX_Object_Obj38.OrientationYaw = convertRawToPhysical(raw_value, 0.0175, -4.48);

    raw_value=copyBitsFromByteArrayLE( byteArray, 20076, 12);
    @CAN_PrivMain::RFL_Object::RXX_Object_Obj38.OrientationYawVnce = convertRawToPhysical(raw_value, 0.0003, 0.0);

    raw_value=copyBitsFromByteArrayLE( byteArray, 19968, 6);
    @CAN_PrivMain::RFL_Object::RXX_Object_Obj38.ProbClassConfidence = convertRawToPhysical(raw_value, 2.0, 0.0);

    raw_value=copyBitsFromByteArrayLE( byteArray, 20219, 4);
    @CAN_PrivMain::RFL_Object::RXX_Object_Obj38.ProbClassType = convertRawToPhysical(raw_value, 1.0, 0.0);

    raw_value=copyBitsFromByteArrayLE( byteArray, 19974, 14);
    @CAN_PrivMain::RFL_Object::RXX_Object_Obj38.Px = convertRawToPhysical(raw_value, 0.0625, -512.0);

    raw_value=copyBitsFromByteArrayLE( byteArray, 20288, 12);
    @CAN_PrivMain::RFL_Object::RXX_Object_Obj38.PxAxCoVnce = convertRawToPhysical(raw_value, 0.01, 0.0);

    raw_value=copyBitsFromByteArrayLE( byteArray, 20300, 12);
    @CAN_PrivMain::RFL_Object::RXX_Object_Obj38.PxAyCoVnce = convertRawToPhysical(raw_value, 0.01, 0.0);

    raw_value=copyBitsFromByteArrayLE( byteArray, 20204, 12);
    @CAN_PrivMain::RFL_Object::RXX_Object_Obj38.PxPyCoVnce = convertRawToPhysical(raw_value, 0.01, 0.0);

    raw_value=copyBitsFromByteArrayLE( byteArray, 19988, 12);
    @CAN_PrivMain::RFL_Object::RXX_Object_Obj38.PxVnce = convertRawToPhysical(raw_value, 0.1, 0.0);

    raw_value=copyBitsFromByteArrayLE( byteArray, 20224, 12);
    @CAN_PrivMain::RFL_Object::RXX_Object_Obj38.PxVxCoVnce = convertRawToPhysical(raw_value, 0.01, 0.0);

    raw_value=copyBitsFromByteArrayLE( byteArray, 20236, 12);
    @CAN_PrivMain::RFL_Object::RXX_Object_Obj38.PxVyCoVnce = convertRawToPhysical(raw_value, 0.01, 0.0);

    raw_value=copyBitsFromByteArrayLE( byteArray, 20000, 12);
    @CAN_PrivMain::RFL_Object::RXX_Object_Obj38.Py = convertRawToPhysical(raw_value, 0.0625, -128.0);

    raw_value=copyBitsFromByteArrayLE( byteArray, 20320, 12);
    @CAN_PrivMain::RFL_Object::RXX_Object_Obj38.PyAxCoVnce = convertRawToPhysical(raw_value, 0.01, 0.0);

    raw_value=copyBitsFromByteArrayLE( byteArray, 20332, 12);
    @CAN_PrivMain::RFL_Object::RXX_Object_Obj38.PyAyCoVnce = convertRawToPhysical(raw_value, 0.01, 0.0);

    raw_value=copyBitsFromByteArrayLE( byteArray, 20012, 12);
    @CAN_PrivMain::RFL_Object::RXX_Object_Obj38.PyVnce = convertRawToPhysical(raw_value, 0.1, 0.0);

    raw_value=copyBitsFromByteArrayLE( byteArray, 20256, 12);
    @CAN_PrivMain::RFL_Object::RXX_Object_Obj38.PyVxCoVnce = convertRawToPhysical(raw_value, 0.01, 0.0);

    raw_value=copyBitsFromByteArrayLE( byteArray, 20268, 12);
    @CAN_PrivMain::RFL_Object::RXX_Object_Obj38.PyVyCoVnce = convertRawToPhysical(raw_value, 0.01, 0.0);

    raw_value=copyBitsFromByteArrayLE( byteArray, 20108, 10);
    @CAN_PrivMain::RFL_Object::RXX_Object_Obj38.RCS = convertRawToPhysical(raw_value, 0.2, -102.4);

    raw_value=copyBitsFromByteArrayLE( byteArray, 20280, 4);
    @CAN_PrivMain::RFL_Object::RXX_Object_Obj38.ReferencePoint = convertRawToPhysical(raw_value, 1.0, 0.0);

    raw_value=copyBitsFromByteArrayLE( byteArray, 20140, 12);
    @CAN_PrivMain::RFL_Object::RXX_Object_Obj38.Vx = convertRawToPhysical(raw_value, 0.0625, -128.0);

    raw_value=copyBitsFromByteArrayLE( byteArray, 20364, 12);
    @CAN_PrivMain::RFL_Object::RXX_Object_Obj38.VxAxCoVnce = convertRawToPhysical(raw_value, 0.01, 0.0);

    raw_value=copyBitsFromByteArrayLE( byteArray, 20384, 12);
    @CAN_PrivMain::RFL_Object::RXX_Object_Obj38.VxAyCoVnce = convertRawToPhysical(raw_value, 0.01, 0.0);

    raw_value=copyBitsFromByteArrayLE( byteArray, 20160, 12);
    @CAN_PrivMain::RFL_Object::RXX_Object_Obj38.VxVnce = convertRawToPhysical(raw_value, 0.01, 0.0);

    raw_value=copyBitsFromByteArrayLE( byteArray, 20352, 12);
    @CAN_PrivMain::RFL_Object::RXX_Object_Obj38.VxVyCoVnce = convertRawToPhysical(raw_value, 0.01, 0.0);

    raw_value=copyBitsFromByteArrayLE( byteArray, 20174, 10);
    @CAN_PrivMain::RFL_Object::RXX_Object_Obj38.Vy = convertRawToPhysical(raw_value, 0.125, -64.0);

    raw_value=copyBitsFromByteArrayLE( byteArray, 20396, 12);
    @CAN_PrivMain::RFL_Object::RXX_Object_Obj38.VyAxCoVnce = convertRawToPhysical(raw_value, 0.01, 0.0);

    raw_value=copyBitsFromByteArrayLE( byteArray, 20416, 12);
    @CAN_PrivMain::RFL_Object::RXX_Object_Obj38.VyAyCoVnce = convertRawToPhysical(raw_value, 0.01, 0.0);

    raw_value=copyBitsFromByteArrayLE( byteArray, 20192, 12);
    @CAN_PrivMain::RFL_Object::RXX_Object_Obj38.VyVnce = convertRawToPhysical(raw_value, 0.01, 0.0);

    raw_value=copyBitsFromByteArrayLE( byteArray, 20088, 7);
    @CAN_PrivMain::RFL_Object::RXX_Object_Obj38.Width = convertRawToPhysical(raw_value, 0.125, 0.0);

    raw_value=copyBitsFromByteArrayLE( byteArray, 20096, 12);
    @CAN_PrivMain::RFL_Object::RXX_Object_Obj38.WidthVnce = convertRawToPhysical(raw_value, 0.01, 0.0);
}


void CRadarFL_RXX_Object_Obj39_SetDataReceived(byte byteArray[])
{
    qword raw_value;

    raw_value=copyBitsFromByteArrayLE( byteArray, 20960, 32);
    @CAN_PrivMain::RFL_Object::RXX_Object_Obj39.Age = convertRawToPhysical(raw_value, 1.0, 0.0);

    raw_value=copyBitsFromByteArrayLE( byteArray, 20556, 10);
    @CAN_PrivMain::RFL_Object::RXX_Object_Obj39.Ax = convertRawToPhysical(raw_value, 0.03125, -16.0);

    raw_value=copyBitsFromByteArrayLE( byteArray, 20940, 12);
    @CAN_PrivMain::RFL_Object::RXX_Object_Obj39.AxAyCoVnce = convertRawToPhysical(raw_value, 0.01, 0.0);

    raw_value=copyBitsFromByteArrayLE( byteArray, 20576, 12);
    @CAN_PrivMain::RFL_Object::RXX_Object_Obj39.AxVnce = convertRawToPhysical(raw_value, 0.01, 0.0);

    raw_value=copyBitsFromByteArrayLE( byteArray, 20630, 9);
    @CAN_PrivMain::RFL_Object::RXX_Object_Obj39.Ay = convertRawToPhysical(raw_value, 0.0625, -16.0);

    raw_value=copyBitsFromByteArrayLE( byteArray, 20640, 12);
    @CAN_PrivMain::RFL_Object::RXX_Object_Obj39.AyVnce = convertRawToPhysical(raw_value, 0.01, 0.0);

    raw_value=copyBitsFromByteArrayLE( byteArray, 20696, 6);
    @CAN_PrivMain::RFL_Object::RXX_Object_Obj39.ExistProb = convertRawToPhysical(raw_value, 2.0, 0.0);

    raw_value=copyBitsFromByteArrayLE( byteArray, 20760, 8);
    @CAN_PrivMain::RFL_Object::RXX_Object_Obj39.FilterInformation = convertRawToPhysical(raw_value, 1.0, 0.0);

    raw_value=copyBitsFromByteArrayLE( byteArray, 20536, 7);
    @CAN_PrivMain::RFL_Object::RXX_Object_Obj39.Length = convertRawToPhysical(raw_value, 0.125, 0.0);

    raw_value=copyBitsFromByteArrayLE( byteArray, 20544, 12);
    @CAN_PrivMain::RFL_Object::RXX_Object_Obj39.LengthVnce = convertRawToPhysical(raw_value, 0.01, 0.0);

    raw_value=copyBitsFromByteArrayLE( byteArray, 20728, 3);
    @CAN_PrivMain::RFL_Object::RXX_Object_Obj39.MeasurementStatus = convertRawToPhysical(raw_value, 1.0, 0.0);

    raw_value=copyBitsFromByteArrayLE( byteArray, 20684, 2);
    @CAN_PrivMain::RFL_Object::RXX_Object_Obj39.MovingStatus = convertRawToPhysical(raw_value, 1.0, 0.0);

    raw_value=copyBitsFromByteArrayLE( byteArray, 20664, 7);
    @CAN_PrivMain::RFL_Object::RXX_Object_Obj39.ObjId = convertRawToPhysical(raw_value, 1.0, 0.0);

    raw_value=copyBitsFromByteArrayLE( byteArray, 20566, 9);
    @CAN_PrivMain::RFL_Object::RXX_Object_Obj39.OrientationYaw = convertRawToPhysical(raw_value, 0.0175, -4.48);

    raw_value=copyBitsFromByteArrayLE( byteArray, 20588, 12);
    @CAN_PrivMain::RFL_Object::RXX_Object_Obj39.OrientationYawVnce = convertRawToPhysical(raw_value, 0.0003, 0.0);

    raw_value=copyBitsFromByteArrayLE( byteArray, 20480, 6);
    @CAN_PrivMain::RFL_Object::RXX_Object_Obj39.ProbClassConfidence = convertRawToPhysical(raw_value, 2.0, 0.0);

    raw_value=copyBitsFromByteArrayLE( byteArray, 20731, 4);
    @CAN_PrivMain::RFL_Object::RXX_Object_Obj39.ProbClassType = convertRawToPhysical(raw_value, 1.0, 0.0);

    raw_value=copyBitsFromByteArrayLE( byteArray, 20486, 14);
    @CAN_PrivMain::RFL_Object::RXX_Object_Obj39.Px = convertRawToPhysical(raw_value, 0.0625, -512.0);

    raw_value=copyBitsFromByteArrayLE( byteArray, 20800, 12);
    @CAN_PrivMain::RFL_Object::RXX_Object_Obj39.PxAxCoVnce = convertRawToPhysical(raw_value, 0.01, 0.0);

    raw_value=copyBitsFromByteArrayLE( byteArray, 20812, 12);
    @CAN_PrivMain::RFL_Object::RXX_Object_Obj39.PxAyCoVnce = convertRawToPhysical(raw_value, 0.01, 0.0);

    raw_value=copyBitsFromByteArrayLE( byteArray, 20716, 12);
    @CAN_PrivMain::RFL_Object::RXX_Object_Obj39.PxPyCoVnce = convertRawToPhysical(raw_value, 0.01, 0.0);

    raw_value=copyBitsFromByteArrayLE( byteArray, 20500, 12);
    @CAN_PrivMain::RFL_Object::RXX_Object_Obj39.PxVnce = convertRawToPhysical(raw_value, 0.1, 0.0);

    raw_value=copyBitsFromByteArrayLE( byteArray, 20736, 12);
    @CAN_PrivMain::RFL_Object::RXX_Object_Obj39.PxVxCoVnce = convertRawToPhysical(raw_value, 0.01, 0.0);

    raw_value=copyBitsFromByteArrayLE( byteArray, 20748, 12);
    @CAN_PrivMain::RFL_Object::RXX_Object_Obj39.PxVyCoVnce = convertRawToPhysical(raw_value, 0.01, 0.0);

    raw_value=copyBitsFromByteArrayLE( byteArray, 20512, 12);
    @CAN_PrivMain::RFL_Object::RXX_Object_Obj39.Py = convertRawToPhysical(raw_value, 0.0625, -128.0);

    raw_value=copyBitsFromByteArrayLE( byteArray, 20832, 12);
    @CAN_PrivMain::RFL_Object::RXX_Object_Obj39.PyAxCoVnce = convertRawToPhysical(raw_value, 0.01, 0.0);

    raw_value=copyBitsFromByteArrayLE( byteArray, 20844, 12);
    @CAN_PrivMain::RFL_Object::RXX_Object_Obj39.PyAyCoVnce = convertRawToPhysical(raw_value, 0.01, 0.0);

    raw_value=copyBitsFromByteArrayLE( byteArray, 20524, 12);
    @CAN_PrivMain::RFL_Object::RXX_Object_Obj39.PyVnce = convertRawToPhysical(raw_value, 0.1, 0.0);

    raw_value=copyBitsFromByteArrayLE( byteArray, 20768, 12);
    @CAN_PrivMain::RFL_Object::RXX_Object_Obj39.PyVxCoVnce = convertRawToPhysical(raw_value, 0.01, 0.0);

    raw_value=copyBitsFromByteArrayLE( byteArray, 20780, 12);
    @CAN_PrivMain::RFL_Object::RXX_Object_Obj39.PyVyCoVnce = convertRawToPhysical(raw_value, 0.01, 0.0);

    raw_value=copyBitsFromByteArrayLE( byteArray, 20620, 10);
    @CAN_PrivMain::RFL_Object::RXX_Object_Obj39.RCS = convertRawToPhysical(raw_value, 0.2, -102.4);

    raw_value=copyBitsFromByteArrayLE( byteArray, 20792, 4);
    @CAN_PrivMain::RFL_Object::RXX_Object_Obj39.ReferencePoint = convertRawToPhysical(raw_value, 1.0, 0.0);

    raw_value=copyBitsFromByteArrayLE( byteArray, 20652, 12);
    @CAN_PrivMain::RFL_Object::RXX_Object_Obj39.Vx = convertRawToPhysical(raw_value, 0.0625, -128.0);

    raw_value=copyBitsFromByteArrayLE( byteArray, 20876, 12);
    @CAN_PrivMain::RFL_Object::RXX_Object_Obj39.VxAxCoVnce = convertRawToPhysical(raw_value, 0.01, 0.0);

    raw_value=copyBitsFromByteArrayLE( byteArray, 20896, 12);
    @CAN_PrivMain::RFL_Object::RXX_Object_Obj39.VxAyCoVnce = convertRawToPhysical(raw_value, 0.01, 0.0);

    raw_value=copyBitsFromByteArrayLE( byteArray, 20672, 12);
    @CAN_PrivMain::RFL_Object::RXX_Object_Obj39.VxVnce = convertRawToPhysical(raw_value, 0.01, 0.0);

    raw_value=copyBitsFromByteArrayLE( byteArray, 20864, 12);
    @CAN_PrivMain::RFL_Object::RXX_Object_Obj39.VxVyCoVnce = convertRawToPhysical(raw_value, 0.01, 0.0);

    raw_value=copyBitsFromByteArrayLE( byteArray, 20686, 10);
    @CAN_PrivMain::RFL_Object::RXX_Object_Obj39.Vy = convertRawToPhysical(raw_value, 0.125, -64.0);

    raw_value=copyBitsFromByteArrayLE( byteArray, 20908, 12);
    @CAN_PrivMain::RFL_Object::RXX_Object_Obj39.VyAxCoVnce = convertRawToPhysical(raw_value, 0.01, 0.0);

    raw_value=copyBitsFromByteArrayLE( byteArray, 20928, 12);
    @CAN_PrivMain::RFL_Object::RXX_Object_Obj39.VyAyCoVnce = convertRawToPhysical(raw_value, 0.01, 0.0);

    raw_value=copyBitsFromByteArrayLE( byteArray, 20704, 12);
    @CAN_PrivMain::RFL_Object::RXX_Object_Obj39.VyVnce = convertRawToPhysical(raw_value, 0.01, 0.0);

    raw_value=copyBitsFromByteArrayLE( byteArray, 20600, 7);
    @CAN_PrivMain::RFL_Object::RXX_Object_Obj39.Width = convertRawToPhysical(raw_value, 0.125, 0.0);

    raw_value=copyBitsFromByteArrayLE( byteArray, 20608, 12);
    @CAN_PrivMain::RFL_Object::RXX_Object_Obj39.WidthVnce = convertRawToPhysical(raw_value, 0.01, 0.0);
}


void CRadarFL_RXX_Object_Obj4_SetDataReceived(byte byteArray[])
{
    qword raw_value;

    raw_value=copyBitsFromByteArrayLE( byteArray, 3040, 32);
    @CAN_PrivMain::RFL_Object::RXX_Object_Obj4.Age = convertRawToPhysical(raw_value, 1.0, 0.0);

    raw_value=copyBitsFromByteArrayLE( byteArray, 2636, 10);
    @CAN_PrivMain::RFL_Object::RXX_Object_Obj4.Ax = convertRawToPhysical(raw_value, 0.03125, -16.0);

    raw_value=copyBitsFromByteArrayLE( byteArray, 3020, 12);
    @CAN_PrivMain::RFL_Object::RXX_Object_Obj4.AxAyCoVnce = convertRawToPhysical(raw_value, 0.01, 0.0);

    raw_value=copyBitsFromByteArrayLE( byteArray, 2656, 12);
    @CAN_PrivMain::RFL_Object::RXX_Object_Obj4.AxVnce = convertRawToPhysical(raw_value, 0.01, 0.0);

    raw_value=copyBitsFromByteArrayLE( byteArray, 2710, 9);
    @CAN_PrivMain::RFL_Object::RXX_Object_Obj4.Ay = convertRawToPhysical(raw_value, 0.0625, -16.0);

    raw_value=copyBitsFromByteArrayLE( byteArray, 2720, 12);
    @CAN_PrivMain::RFL_Object::RXX_Object_Obj4.AyVnce = convertRawToPhysical(raw_value, 0.01, 0.0);

    raw_value=copyBitsFromByteArrayLE( byteArray, 2776, 6);
    @CAN_PrivMain::RFL_Object::RXX_Object_Obj4.ExistProb = convertRawToPhysical(raw_value, 2.0, 0.0);

    raw_value=copyBitsFromByteArrayLE( byteArray, 2840, 8);
    @CAN_PrivMain::RFL_Object::RXX_Object_Obj4.FilterInformation = convertRawToPhysical(raw_value, 1.0, 0.0);

    raw_value=copyBitsFromByteArrayLE( byteArray, 2616, 7);
    @CAN_PrivMain::RFL_Object::RXX_Object_Obj4.Length = convertRawToPhysical(raw_value, 0.125, 0.0);

    raw_value=copyBitsFromByteArrayLE( byteArray, 2624, 12);
    @CAN_PrivMain::RFL_Object::RXX_Object_Obj4.LengthVnce = convertRawToPhysical(raw_value, 0.01, 0.0);

    raw_value=copyBitsFromByteArrayLE( byteArray, 2808, 3);
    @CAN_PrivMain::RFL_Object::RXX_Object_Obj4.MeasurementStatus = convertRawToPhysical(raw_value, 1.0, 0.0);

    raw_value=copyBitsFromByteArrayLE( byteArray, 2764, 2);
    @CAN_PrivMain::RFL_Object::RXX_Object_Obj4.MovingStatus = convertRawToPhysical(raw_value, 1.0, 0.0);

    raw_value=copyBitsFromByteArrayLE( byteArray, 2744, 7);
    @CAN_PrivMain::RFL_Object::RXX_Object_Obj4.ObjId = convertRawToPhysical(raw_value, 1.0, 0.0);

    raw_value=copyBitsFromByteArrayLE( byteArray, 2646, 9);
    @CAN_PrivMain::RFL_Object::RXX_Object_Obj4.OrientationYaw = convertRawToPhysical(raw_value, 0.0175, -4.48);

    raw_value=copyBitsFromByteArrayLE( byteArray, 2668, 12);
    @CAN_PrivMain::RFL_Object::RXX_Object_Obj4.OrientationYawVnce = convertRawToPhysical(raw_value, 0.0003, 0.0);

    raw_value=copyBitsFromByteArrayLE( byteArray, 2560, 6);
    @CAN_PrivMain::RFL_Object::RXX_Object_Obj4.ProbClassConfidence = convertRawToPhysical(raw_value, 2.0, 0.0);

    raw_value=copyBitsFromByteArrayLE( byteArray, 2811, 4);
    @CAN_PrivMain::RFL_Object::RXX_Object_Obj4.ProbClassType = convertRawToPhysical(raw_value, 1.0, 0.0);

    raw_value=copyBitsFromByteArrayLE( byteArray, 2566, 14);
    @CAN_PrivMain::RFL_Object::RXX_Object_Obj4.Px = convertRawToPhysical(raw_value, 0.0625, -512.0);

    raw_value=copyBitsFromByteArrayLE( byteArray, 2880, 12);
    @CAN_PrivMain::RFL_Object::RXX_Object_Obj4.PxAxCoVnce = convertRawToPhysical(raw_value, 0.01, 0.0);

    raw_value=copyBitsFromByteArrayLE( byteArray, 2892, 12);
    @CAN_PrivMain::RFL_Object::RXX_Object_Obj4.PxAyCoVnce = convertRawToPhysical(raw_value, 0.01, 0.0);

    raw_value=copyBitsFromByteArrayLE( byteArray, 2796, 12);
    @CAN_PrivMain::RFL_Object::RXX_Object_Obj4.PxPyCoVnce = convertRawToPhysical(raw_value, 0.01, 0.0);

    raw_value=copyBitsFromByteArrayLE( byteArray, 2580, 12);
    @CAN_PrivMain::RFL_Object::RXX_Object_Obj4.PxVnce = convertRawToPhysical(raw_value, 0.1, 0.0);

    raw_value=copyBitsFromByteArrayLE( byteArray, 2816, 12);
    @CAN_PrivMain::RFL_Object::RXX_Object_Obj4.PxVxCoVnce = convertRawToPhysical(raw_value, 0.01, 0.0);

    raw_value=copyBitsFromByteArrayLE( byteArray, 2828, 12);
    @CAN_PrivMain::RFL_Object::RXX_Object_Obj4.PxVyCoVnce = convertRawToPhysical(raw_value, 0.01, 0.0);

    raw_value=copyBitsFromByteArrayLE( byteArray, 2592, 12);
    @CAN_PrivMain::RFL_Object::RXX_Object_Obj4.Py = convertRawToPhysical(raw_value, 0.0625, -128.0);

    raw_value=copyBitsFromByteArrayLE( byteArray, 2912, 12);
    @CAN_PrivMain::RFL_Object::RXX_Object_Obj4.PyAxCoVnce = convertRawToPhysical(raw_value, 0.01, 0.0);

    raw_value=copyBitsFromByteArrayLE( byteArray, 2924, 12);
    @CAN_PrivMain::RFL_Object::RXX_Object_Obj4.PyAyCoVnce = convertRawToPhysical(raw_value, 0.01, 0.0);

    raw_value=copyBitsFromByteArrayLE( byteArray, 2604, 12);
    @CAN_PrivMain::RFL_Object::RXX_Object_Obj4.PyVnce = convertRawToPhysical(raw_value, 0.1, 0.0);

    raw_value=copyBitsFromByteArrayLE( byteArray, 2848, 12);
    @CAN_PrivMain::RFL_Object::RXX_Object_Obj4.PyVxCoVnce = convertRawToPhysical(raw_value, 0.01, 0.0);

    raw_value=copyBitsFromByteArrayLE( byteArray, 2860, 12);
    @CAN_PrivMain::RFL_Object::RXX_Object_Obj4.PyVyCoVnce = convertRawToPhysical(raw_value, 0.01, 0.0);

    raw_value=copyBitsFromByteArrayLE( byteArray, 2700, 10);
    @CAN_PrivMain::RFL_Object::RXX_Object_Obj4.RCS = convertRawToPhysical(raw_value, 0.2, -102.4);

    raw_value=copyBitsFromByteArrayLE( byteArray, 2872, 4);
    @CAN_PrivMain::RFL_Object::RXX_Object_Obj4.ReferencePoint = convertRawToPhysical(raw_value, 1.0, 0.0);

    raw_value=copyBitsFromByteArrayLE( byteArray, 2732, 12);
    @CAN_PrivMain::RFL_Object::RXX_Object_Obj4.Vx = convertRawToPhysical(raw_value, 0.0625, -128.0);

    raw_value=copyBitsFromByteArrayLE( byteArray, 2956, 12);
    @CAN_PrivMain::RFL_Object::RXX_Object_Obj4.VxAxCoVnce = convertRawToPhysical(raw_value, 0.01, 0.0);

    raw_value=copyBitsFromByteArrayLE( byteArray, 2976, 12);
    @CAN_PrivMain::RFL_Object::RXX_Object_Obj4.VxAyCoVnce = convertRawToPhysical(raw_value, 0.01, 0.0);

    raw_value=copyBitsFromByteArrayLE( byteArray, 2752, 12);
    @CAN_PrivMain::RFL_Object::RXX_Object_Obj4.VxVnce = convertRawToPhysical(raw_value, 0.01, 0.0);

    raw_value=copyBitsFromByteArrayLE( byteArray, 2944, 12);
    @CAN_PrivMain::RFL_Object::RXX_Object_Obj4.VxVyCoVnce = convertRawToPhysical(raw_value, 0.01, 0.0);

    raw_value=copyBitsFromByteArrayLE( byteArray, 2766, 10);
    @CAN_PrivMain::RFL_Object::RXX_Object_Obj4.Vy = convertRawToPhysical(raw_value, 0.125, -64.0);

    raw_value=copyBitsFromByteArrayLE( byteArray, 2988, 12);
    @CAN_PrivMain::RFL_Object::RXX_Object_Obj4.VyAxCoVnce = convertRawToPhysical(raw_value, 0.01, 0.0);

    raw_value=copyBitsFromByteArrayLE( byteArray, 3008, 12);
    @CAN_PrivMain::RFL_Object::RXX_Object_Obj4.VyAyCoVnce = convertRawToPhysical(raw_value, 0.01, 0.0);

    raw_value=copyBitsFromByteArrayLE( byteArray, 2784, 12);
    @CAN_PrivMain::RFL_Object::RXX_Object_Obj4.VyVnce = convertRawToPhysical(raw_value, 0.01, 0.0);

    raw_value=copyBitsFromByteArrayLE( byteArray, 2680, 7);
    @CAN_PrivMain::RFL_Object::RXX_Object_Obj4.Width = convertRawToPhysical(raw_value, 0.125, 0.0);

    raw_value=copyBitsFromByteArrayLE( byteArray, 2688, 12);
    @CAN_PrivMain::RFL_Object::RXX_Object_Obj4.WidthVnce = convertRawToPhysical(raw_value, 0.01, 0.0);
}


void CRadarFL_RXX_Object_Obj40_SetDataReceived(byte byteArray[])
{
    qword raw_value;

    raw_value=copyBitsFromByteArrayLE( byteArray, 21472, 32);
    @CAN_PrivMain::RFL_Object::RXX_Object_Obj40.Age = convertRawToPhysical(raw_value, 1.0, 0.0);

    raw_value=copyBitsFromByteArrayLE( byteArray, 21068, 10);
    @CAN_PrivMain::RFL_Object::RXX_Object_Obj40.Ax = convertRawToPhysical(raw_value, 0.03125, -16.0);

    raw_value=copyBitsFromByteArrayLE( byteArray, 21452, 12);
    @CAN_PrivMain::RFL_Object::RXX_Object_Obj40.AxAyCoVnce = convertRawToPhysical(raw_value, 0.01, 0.0);

    raw_value=copyBitsFromByteArrayLE( byteArray, 21088, 12);
    @CAN_PrivMain::RFL_Object::RXX_Object_Obj40.AxVnce = convertRawToPhysical(raw_value, 0.01, 0.0);

    raw_value=copyBitsFromByteArrayLE( byteArray, 21142, 9);
    @CAN_PrivMain::RFL_Object::RXX_Object_Obj40.Ay = convertRawToPhysical(raw_value, 0.0625, -16.0);

    raw_value=copyBitsFromByteArrayLE( byteArray, 21152, 12);
    @CAN_PrivMain::RFL_Object::RXX_Object_Obj40.AyVnce = convertRawToPhysical(raw_value, 0.01, 0.0);

    raw_value=copyBitsFromByteArrayLE( byteArray, 21208, 6);
    @CAN_PrivMain::RFL_Object::RXX_Object_Obj40.ExistProb = convertRawToPhysical(raw_value, 2.0, 0.0);

    raw_value=copyBitsFromByteArrayLE( byteArray, 21272, 8);
    @CAN_PrivMain::RFL_Object::RXX_Object_Obj40.FilterInformation = convertRawToPhysical(raw_value, 1.0, 0.0);

    raw_value=copyBitsFromByteArrayLE( byteArray, 21048, 7);
    @CAN_PrivMain::RFL_Object::RXX_Object_Obj40.Length = convertRawToPhysical(raw_value, 0.125, 0.0);

    raw_value=copyBitsFromByteArrayLE( byteArray, 21056, 12);
    @CAN_PrivMain::RFL_Object::RXX_Object_Obj40.LengthVnce = convertRawToPhysical(raw_value, 0.01, 0.0);

    raw_value=copyBitsFromByteArrayLE( byteArray, 21240, 3);
    @CAN_PrivMain::RFL_Object::RXX_Object_Obj40.MeasurementStatus = convertRawToPhysical(raw_value, 1.0, 0.0);

    raw_value=copyBitsFromByteArrayLE( byteArray, 21196, 2);
    @CAN_PrivMain::RFL_Object::RXX_Object_Obj40.MovingStatus = convertRawToPhysical(raw_value, 1.0, 0.0);

    raw_value=copyBitsFromByteArrayLE( byteArray, 21176, 7);
    @CAN_PrivMain::RFL_Object::RXX_Object_Obj40.ObjId = convertRawToPhysical(raw_value, 1.0, 0.0);

    raw_value=copyBitsFromByteArrayLE( byteArray, 21078, 9);
    @CAN_PrivMain::RFL_Object::RXX_Object_Obj40.OrientationYaw = convertRawToPhysical(raw_value, 0.0175, -4.48);

    raw_value=copyBitsFromByteArrayLE( byteArray, 21100, 12);
    @CAN_PrivMain::RFL_Object::RXX_Object_Obj40.OrientationYawVnce = convertRawToPhysical(raw_value, 0.0003, 0.0);

    raw_value=copyBitsFromByteArrayLE( byteArray, 20992, 6);
    @CAN_PrivMain::RFL_Object::RXX_Object_Obj40.ProbClassConfidence = convertRawToPhysical(raw_value, 2.0, 0.0);

    raw_value=copyBitsFromByteArrayLE( byteArray, 21243, 4);
    @CAN_PrivMain::RFL_Object::RXX_Object_Obj40.ProbClassType = convertRawToPhysical(raw_value, 1.0, 0.0);

    raw_value=copyBitsFromByteArrayLE( byteArray, 20998, 14);
    @CAN_PrivMain::RFL_Object::RXX_Object_Obj40.Px = convertRawToPhysical(raw_value, 0.0625, -512.0);

    raw_value=copyBitsFromByteArrayLE( byteArray, 21312, 12);
    @CAN_PrivMain::RFL_Object::RXX_Object_Obj40.PxAxCoVnce = convertRawToPhysical(raw_value, 0.01, 0.0);

    raw_value=copyBitsFromByteArrayLE( byteArray, 21324, 12);
    @CAN_PrivMain::RFL_Object::RXX_Object_Obj40.PxAyCoVnce = convertRawToPhysical(raw_value, 0.01, 0.0);

    raw_value=copyBitsFromByteArrayLE( byteArray, 21228, 12);
    @CAN_PrivMain::RFL_Object::RXX_Object_Obj40.PxPyCoVnce = convertRawToPhysical(raw_value, 0.01, 0.0);

    raw_value=copyBitsFromByteArrayLE( byteArray, 21012, 12);
    @CAN_PrivMain::RFL_Object::RXX_Object_Obj40.PxVnce = convertRawToPhysical(raw_value, 0.1, 0.0);

    raw_value=copyBitsFromByteArrayLE( byteArray, 21248, 12);
    @CAN_PrivMain::RFL_Object::RXX_Object_Obj40.PxVxCoVnce = convertRawToPhysical(raw_value, 0.01, 0.0);

    raw_value=copyBitsFromByteArrayLE( byteArray, 21260, 12);
    @CAN_PrivMain::RFL_Object::RXX_Object_Obj40.PxVyCoVnce = convertRawToPhysical(raw_value, 0.01, 0.0);

    raw_value=copyBitsFromByteArrayLE( byteArray, 21024, 12);
    @CAN_PrivMain::RFL_Object::RXX_Object_Obj40.Py = convertRawToPhysical(raw_value, 0.0625, -128.0);

    raw_value=copyBitsFromByteArrayLE( byteArray, 21344, 12);
    @CAN_PrivMain::RFL_Object::RXX_Object_Obj40.PyAxCoVnce = convertRawToPhysical(raw_value, 0.01, 0.0);

    raw_value=copyBitsFromByteArrayLE( byteArray, 21356, 12);
    @CAN_PrivMain::RFL_Object::RXX_Object_Obj40.PyAyCoVnce = convertRawToPhysical(raw_value, 0.01, 0.0);

    raw_value=copyBitsFromByteArrayLE( byteArray, 21036, 12);
    @CAN_PrivMain::RFL_Object::RXX_Object_Obj40.PyVnce = convertRawToPhysical(raw_value, 0.1, 0.0);

    raw_value=copyBitsFromByteArrayLE( byteArray, 21280, 12);
    @CAN_PrivMain::RFL_Object::RXX_Object_Obj40.PyVxCoVnce = convertRawToPhysical(raw_value, 0.01, 0.0);

    raw_value=copyBitsFromByteArrayLE( byteArray, 21292, 12);
    @CAN_PrivMain::RFL_Object::RXX_Object_Obj40.PyVyCoVnce = convertRawToPhysical(raw_value, 0.01, 0.0);

    raw_value=copyBitsFromByteArrayLE( byteArray, 21132, 10);
    @CAN_PrivMain::RFL_Object::RXX_Object_Obj40.RCS = convertRawToPhysical(raw_value, 0.2, -102.4);

    raw_value=copyBitsFromByteArrayLE( byteArray, 21304, 4);
    @CAN_PrivMain::RFL_Object::RXX_Object_Obj40.ReferencePoint = convertRawToPhysical(raw_value, 1.0, 0.0);

    raw_value=copyBitsFromByteArrayLE( byteArray, 21164, 12);
    @CAN_PrivMain::RFL_Object::RXX_Object_Obj40.Vx = convertRawToPhysical(raw_value, 0.0625, -128.0);

    raw_value=copyBitsFromByteArrayLE( byteArray, 21388, 12);
    @CAN_PrivMain::RFL_Object::RXX_Object_Obj40.VxAxCoVnce = convertRawToPhysical(raw_value, 0.01, 0.0);

    raw_value=copyBitsFromByteArrayLE( byteArray, 21408, 12);
    @CAN_PrivMain::RFL_Object::RXX_Object_Obj40.VxAyCoVnce = convertRawToPhysical(raw_value, 0.01, 0.0);

    raw_value=copyBitsFromByteArrayLE( byteArray, 21184, 12);
    @CAN_PrivMain::RFL_Object::RXX_Object_Obj40.VxVnce = convertRawToPhysical(raw_value, 0.01, 0.0);

    raw_value=copyBitsFromByteArrayLE( byteArray, 21376, 12);
    @CAN_PrivMain::RFL_Object::RXX_Object_Obj40.VxVyCoVnce = convertRawToPhysical(raw_value, 0.01, 0.0);

    raw_value=copyBitsFromByteArrayLE( byteArray, 21198, 10);
    @CAN_PrivMain::RFL_Object::RXX_Object_Obj40.Vy = convertRawToPhysical(raw_value, 0.125, -64.0);

    raw_value=copyBitsFromByteArrayLE( byteArray, 21420, 12);
    @CAN_PrivMain::RFL_Object::RXX_Object_Obj40.VyAxCoVnce = convertRawToPhysical(raw_value, 0.01, 0.0);

    raw_value=copyBitsFromByteArrayLE( byteArray, 21440, 12);
    @CAN_PrivMain::RFL_Object::RXX_Object_Obj40.VyAyCoVnce = convertRawToPhysical(raw_value, 0.01, 0.0);

    raw_value=copyBitsFromByteArrayLE( byteArray, 21216, 12);
    @CAN_PrivMain::RFL_Object::RXX_Object_Obj40.VyVnce = convertRawToPhysical(raw_value, 0.01, 0.0);

    raw_value=copyBitsFromByteArrayLE( byteArray, 21112, 7);
    @CAN_PrivMain::RFL_Object::RXX_Object_Obj40.Width = convertRawToPhysical(raw_value, 0.125, 0.0);

    raw_value=copyBitsFromByteArrayLE( byteArray, 21120, 12);
    @CAN_PrivMain::RFL_Object::RXX_Object_Obj40.WidthVnce = convertRawToPhysical(raw_value, 0.01, 0.0);
}


void CRadarFL_RXX_Object_Obj41_SetDataReceived(byte byteArray[])
{
    qword raw_value;

    raw_value=copyBitsFromByteArrayLE( byteArray, 21984, 32);
    @CAN_PrivMain::RFL_Object::RXX_Object_Obj41.Age = convertRawToPhysical(raw_value, 1.0, 0.0);

    raw_value=copyBitsFromByteArrayLE( byteArray, 21580, 10);
    @CAN_PrivMain::RFL_Object::RXX_Object_Obj41.Ax = convertRawToPhysical(raw_value, 0.03125, -16.0);

    raw_value=copyBitsFromByteArrayLE( byteArray, 21964, 12);
    @CAN_PrivMain::RFL_Object::RXX_Object_Obj41.AxAyCoVnce = convertRawToPhysical(raw_value, 0.01, 0.0);

    raw_value=copyBitsFromByteArrayLE( byteArray, 21600, 12);
    @CAN_PrivMain::RFL_Object::RXX_Object_Obj41.AxVnce = convertRawToPhysical(raw_value, 0.01, 0.0);

    raw_value=copyBitsFromByteArrayLE( byteArray, 21654, 9);
    @CAN_PrivMain::RFL_Object::RXX_Object_Obj41.Ay = convertRawToPhysical(raw_value, 0.0625, -16.0);

    raw_value=copyBitsFromByteArrayLE( byteArray, 21664, 12);
    @CAN_PrivMain::RFL_Object::RXX_Object_Obj41.AyVnce = convertRawToPhysical(raw_value, 0.01, 0.0);

    raw_value=copyBitsFromByteArrayLE( byteArray, 21720, 6);
    @CAN_PrivMain::RFL_Object::RXX_Object_Obj41.ExistProb = convertRawToPhysical(raw_value, 2.0, 0.0);

    raw_value=copyBitsFromByteArrayLE( byteArray, 21784, 8);
    @CAN_PrivMain::RFL_Object::RXX_Object_Obj41.FilterInformation = convertRawToPhysical(raw_value, 1.0, 0.0);

    raw_value=copyBitsFromByteArrayLE( byteArray, 21560, 7);
    @CAN_PrivMain::RFL_Object::RXX_Object_Obj41.Length = convertRawToPhysical(raw_value, 0.125, 0.0);

    raw_value=copyBitsFromByteArrayLE( byteArray, 21568, 12);
    @CAN_PrivMain::RFL_Object::RXX_Object_Obj41.LengthVnce = convertRawToPhysical(raw_value, 0.01, 0.0);

    raw_value=copyBitsFromByteArrayLE( byteArray, 21752, 3);
    @CAN_PrivMain::RFL_Object::RXX_Object_Obj41.MeasurementStatus = convertRawToPhysical(raw_value, 1.0, 0.0);

    raw_value=copyBitsFromByteArrayLE( byteArray, 21708, 2);
    @CAN_PrivMain::RFL_Object::RXX_Object_Obj41.MovingStatus = convertRawToPhysical(raw_value, 1.0, 0.0);

    raw_value=copyBitsFromByteArrayLE( byteArray, 21688, 7);
    @CAN_PrivMain::RFL_Object::RXX_Object_Obj41.ObjId = convertRawToPhysical(raw_value, 1.0, 0.0);

    raw_value=copyBitsFromByteArrayLE( byteArray, 21590, 9);
    @CAN_PrivMain::RFL_Object::RXX_Object_Obj41.OrientationYaw = convertRawToPhysical(raw_value, 0.0175, -4.48);

    raw_value=copyBitsFromByteArrayLE( byteArray, 21612, 12);
    @CAN_PrivMain::RFL_Object::RXX_Object_Obj41.OrientationYawVnce = convertRawToPhysical(raw_value, 0.0003, 0.0);

    raw_value=copyBitsFromByteArrayLE( byteArray, 21504, 6);
    @CAN_PrivMain::RFL_Object::RXX_Object_Obj41.ProbClassConfidence = convertRawToPhysical(raw_value, 2.0, 0.0);

    raw_value=copyBitsFromByteArrayLE( byteArray, 21755, 4);
    @CAN_PrivMain::RFL_Object::RXX_Object_Obj41.ProbClassType = convertRawToPhysical(raw_value, 1.0, 0.0);

    raw_value=copyBitsFromByteArrayLE( byteArray, 21510, 14);
    @CAN_PrivMain::RFL_Object::RXX_Object_Obj41.Px = convertRawToPhysical(raw_value, 0.0625, -512.0);

    raw_value=copyBitsFromByteArrayLE( byteArray, 21824, 12);
    @CAN_PrivMain::RFL_Object::RXX_Object_Obj41.PxAxCoVnce = convertRawToPhysical(raw_value, 0.01, 0.0);

    raw_value=copyBitsFromByteArrayLE( byteArray, 21836, 12);
    @CAN_PrivMain::RFL_Object::RXX_Object_Obj41.PxAyCoVnce = convertRawToPhysical(raw_value, 0.01, 0.0);

    raw_value=copyBitsFromByteArrayLE( byteArray, 21740, 12);
    @CAN_PrivMain::RFL_Object::RXX_Object_Obj41.PxPyCoVnce = convertRawToPhysical(raw_value, 0.01, 0.0);

    raw_value=copyBitsFromByteArrayLE( byteArray, 21524, 12);
    @CAN_PrivMain::RFL_Object::RXX_Object_Obj41.PxVnce = convertRawToPhysical(raw_value, 0.1, 0.0);

    raw_value=copyBitsFromByteArrayLE( byteArray, 21760, 12);
    @CAN_PrivMain::RFL_Object::RXX_Object_Obj41.PxVxCoVnce = convertRawToPhysical(raw_value, 0.01, 0.0);

    raw_value=copyBitsFromByteArrayLE( byteArray, 21772, 12);
    @CAN_PrivMain::RFL_Object::RXX_Object_Obj41.PxVyCoVnce = convertRawToPhysical(raw_value, 0.01, 0.0);

    raw_value=copyBitsFromByteArrayLE( byteArray, 21536, 12);
    @CAN_PrivMain::RFL_Object::RXX_Object_Obj41.Py = convertRawToPhysical(raw_value, 0.0625, -128.0);

    raw_value=copyBitsFromByteArrayLE( byteArray, 21856, 12);
    @CAN_PrivMain::RFL_Object::RXX_Object_Obj41.PyAxCoVnce = convertRawToPhysical(raw_value, 0.01, 0.0);

    raw_value=copyBitsFromByteArrayLE( byteArray, 21868, 12);
    @CAN_PrivMain::RFL_Object::RXX_Object_Obj41.PyAyCoVnce = convertRawToPhysical(raw_value, 0.01, 0.0);

    raw_value=copyBitsFromByteArrayLE( byteArray, 21548, 12);
    @CAN_PrivMain::RFL_Object::RXX_Object_Obj41.PyVnce = convertRawToPhysical(raw_value, 0.1, 0.0);

    raw_value=copyBitsFromByteArrayLE( byteArray, 21792, 12);
    @CAN_PrivMain::RFL_Object::RXX_Object_Obj41.PyVxCoVnce = convertRawToPhysical(raw_value, 0.01, 0.0);

    raw_value=copyBitsFromByteArrayLE( byteArray, 21804, 12);
    @CAN_PrivMain::RFL_Object::RXX_Object_Obj41.PyVyCoVnce = convertRawToPhysical(raw_value, 0.01, 0.0);

    raw_value=copyBitsFromByteArrayLE( byteArray, 21644, 10);
    @CAN_PrivMain::RFL_Object::RXX_Object_Obj41.RCS = convertRawToPhysical(raw_value, 0.2, -102.4);

    raw_value=copyBitsFromByteArrayLE( byteArray, 21816, 4);
    @CAN_PrivMain::RFL_Object::RXX_Object_Obj41.ReferencePoint = convertRawToPhysical(raw_value, 1.0, 0.0);

    raw_value=copyBitsFromByteArrayLE( byteArray, 21676, 12);
    @CAN_PrivMain::RFL_Object::RXX_Object_Obj41.Vx = convertRawToPhysical(raw_value, 0.0625, -128.0);

    raw_value=copyBitsFromByteArrayLE( byteArray, 21900, 12);
    @CAN_PrivMain::RFL_Object::RXX_Object_Obj41.VxAxCoVnce = convertRawToPhysical(raw_value, 0.01, 0.0);

    raw_value=copyBitsFromByteArrayLE( byteArray, 21920, 12);
    @CAN_PrivMain::RFL_Object::RXX_Object_Obj41.VxAyCoVnce = convertRawToPhysical(raw_value, 0.01, 0.0);

    raw_value=copyBitsFromByteArrayLE( byteArray, 21696, 12);
    @CAN_PrivMain::RFL_Object::RXX_Object_Obj41.VxVnce = convertRawToPhysical(raw_value, 0.01, 0.0);

    raw_value=copyBitsFromByteArrayLE( byteArray, 21888, 12);
    @CAN_PrivMain::RFL_Object::RXX_Object_Obj41.VxVyCoVnce = convertRawToPhysical(raw_value, 0.01, 0.0);

    raw_value=copyBitsFromByteArrayLE( byteArray, 21710, 10);
    @CAN_PrivMain::RFL_Object::RXX_Object_Obj41.Vy = convertRawToPhysical(raw_value, 0.125, -64.0);

    raw_value=copyBitsFromByteArrayLE( byteArray, 21932, 12);
    @CAN_PrivMain::RFL_Object::RXX_Object_Obj41.VyAxCoVnce = convertRawToPhysical(raw_value, 0.01, 0.0);

    raw_value=copyBitsFromByteArrayLE( byteArray, 21952, 12);
    @CAN_PrivMain::RFL_Object::RXX_Object_Obj41.VyAyCoVnce = convertRawToPhysical(raw_value, 0.01, 0.0);

    raw_value=copyBitsFromByteArrayLE( byteArray, 21728, 12);
    @CAN_PrivMain::RFL_Object::RXX_Object_Obj41.VyVnce = convertRawToPhysical(raw_value, 0.01, 0.0);

    raw_value=copyBitsFromByteArrayLE( byteArray, 21624, 7);
    @CAN_PrivMain::RFL_Object::RXX_Object_Obj41.Width = convertRawToPhysical(raw_value, 0.125, 0.0);

    raw_value=copyBitsFromByteArrayLE( byteArray, 21632, 12);
    @CAN_PrivMain::RFL_Object::RXX_Object_Obj41.WidthVnce = convertRawToPhysical(raw_value, 0.01, 0.0);
}


void CRadarFL_RXX_Object_Obj42_SetDataReceived(byte byteArray[])
{
    qword raw_value;

    raw_value=copyBitsFromByteArrayLE( byteArray, 22496, 32);
    @CAN_PrivMain::RFL_Object::RXX_Object_Obj42.Age = convertRawToPhysical(raw_value, 1.0, 0.0);

    raw_value=copyBitsFromByteArrayLE( byteArray, 22092, 10);
    @CAN_PrivMain::RFL_Object::RXX_Object_Obj42.Ax = convertRawToPhysical(raw_value, 0.03125, -16.0);

    raw_value=copyBitsFromByteArrayLE( byteArray, 22476, 12);
    @CAN_PrivMain::RFL_Object::RXX_Object_Obj42.AxAyCoVnce = convertRawToPhysical(raw_value, 0.01, 0.0);

    raw_value=copyBitsFromByteArrayLE( byteArray, 22112, 12);
    @CAN_PrivMain::RFL_Object::RXX_Object_Obj42.AxVnce = convertRawToPhysical(raw_value, 0.01, 0.0);

    raw_value=copyBitsFromByteArrayLE( byteArray, 22166, 9);
    @CAN_PrivMain::RFL_Object::RXX_Object_Obj42.Ay = convertRawToPhysical(raw_value, 0.0625, -16.0);

    raw_value=copyBitsFromByteArrayLE( byteArray, 22176, 12);
    @CAN_PrivMain::RFL_Object::RXX_Object_Obj42.AyVnce = convertRawToPhysical(raw_value, 0.01, 0.0);

    raw_value=copyBitsFromByteArrayLE( byteArray, 22232, 6);
    @CAN_PrivMain::RFL_Object::RXX_Object_Obj42.ExistProb = convertRawToPhysical(raw_value, 2.0, 0.0);

    raw_value=copyBitsFromByteArrayLE( byteArray, 22296, 8);
    @CAN_PrivMain::RFL_Object::RXX_Object_Obj42.FilterInformation = convertRawToPhysical(raw_value, 1.0, 0.0);

    raw_value=copyBitsFromByteArrayLE( byteArray, 22072, 7);
    @CAN_PrivMain::RFL_Object::RXX_Object_Obj42.Length = convertRawToPhysical(raw_value, 0.125, 0.0);

    raw_value=copyBitsFromByteArrayLE( byteArray, 22080, 12);
    @CAN_PrivMain::RFL_Object::RXX_Object_Obj42.LengthVnce = convertRawToPhysical(raw_value, 0.01, 0.0);

    raw_value=copyBitsFromByteArrayLE( byteArray, 22264, 3);
    @CAN_PrivMain::RFL_Object::RXX_Object_Obj42.MeasurementStatus = convertRawToPhysical(raw_value, 1.0, 0.0);

    raw_value=copyBitsFromByteArrayLE( byteArray, 22220, 2);
    @CAN_PrivMain::RFL_Object::RXX_Object_Obj42.MovingStatus = convertRawToPhysical(raw_value, 1.0, 0.0);

    raw_value=copyBitsFromByteArrayLE( byteArray, 22200, 7);
    @CAN_PrivMain::RFL_Object::RXX_Object_Obj42.ObjId = convertRawToPhysical(raw_value, 1.0, 0.0);

    raw_value=copyBitsFromByteArrayLE( byteArray, 22102, 9);
    @CAN_PrivMain::RFL_Object::RXX_Object_Obj42.OrientationYaw = convertRawToPhysical(raw_value, 0.0175, -4.48);

    raw_value=copyBitsFromByteArrayLE( byteArray, 22124, 12);
    @CAN_PrivMain::RFL_Object::RXX_Object_Obj42.OrientationYawVnce = convertRawToPhysical(raw_value, 0.0003, 0.0);

    raw_value=copyBitsFromByteArrayLE( byteArray, 22016, 6);
    @CAN_PrivMain::RFL_Object::RXX_Object_Obj42.ProbClassConfidence = convertRawToPhysical(raw_value, 2.0, 0.0);

    raw_value=copyBitsFromByteArrayLE( byteArray, 22267, 4);
    @CAN_PrivMain::RFL_Object::RXX_Object_Obj42.ProbClassType = convertRawToPhysical(raw_value, 1.0, 0.0);

    raw_value=copyBitsFromByteArrayLE( byteArray, 22022, 14);
    @CAN_PrivMain::RFL_Object::RXX_Object_Obj42.Px = convertRawToPhysical(raw_value, 0.0625, -512.0);

    raw_value=copyBitsFromByteArrayLE( byteArray, 22336, 12);
    @CAN_PrivMain::RFL_Object::RXX_Object_Obj42.PxAxCoVnce = convertRawToPhysical(raw_value, 0.01, 0.0);

    raw_value=copyBitsFromByteArrayLE( byteArray, 22348, 12);
    @CAN_PrivMain::RFL_Object::RXX_Object_Obj42.PxAyCoVnce = convertRawToPhysical(raw_value, 0.01, 0.0);

    raw_value=copyBitsFromByteArrayLE( byteArray, 22252, 12);
    @CAN_PrivMain::RFL_Object::RXX_Object_Obj42.PxPyCoVnce = convertRawToPhysical(raw_value, 0.01, 0.0);

    raw_value=copyBitsFromByteArrayLE( byteArray, 22036, 12);
    @CAN_PrivMain::RFL_Object::RXX_Object_Obj42.PxVnce = convertRawToPhysical(raw_value, 0.1, 0.0);

    raw_value=copyBitsFromByteArrayLE( byteArray, 22272, 12);
    @CAN_PrivMain::RFL_Object::RXX_Object_Obj42.PxVxCoVnce = convertRawToPhysical(raw_value, 0.01, 0.0);

    raw_value=copyBitsFromByteArrayLE( byteArray, 22284, 12);
    @CAN_PrivMain::RFL_Object::RXX_Object_Obj42.PxVyCoVnce = convertRawToPhysical(raw_value, 0.01, 0.0);

    raw_value=copyBitsFromByteArrayLE( byteArray, 22048, 12);
    @CAN_PrivMain::RFL_Object::RXX_Object_Obj42.Py = convertRawToPhysical(raw_value, 0.0625, -128.0);

    raw_value=copyBitsFromByteArrayLE( byteArray, 22368, 12);
    @CAN_PrivMain::RFL_Object::RXX_Object_Obj42.PyAxCoVnce = convertRawToPhysical(raw_value, 0.01, 0.0);

    raw_value=copyBitsFromByteArrayLE( byteArray, 22380, 12);
    @CAN_PrivMain::RFL_Object::RXX_Object_Obj42.PyAyCoVnce = convertRawToPhysical(raw_value, 0.01, 0.0);

    raw_value=copyBitsFromByteArrayLE( byteArray, 22060, 12);
    @CAN_PrivMain::RFL_Object::RXX_Object_Obj42.PyVnce = convertRawToPhysical(raw_value, 0.1, 0.0);

    raw_value=copyBitsFromByteArrayLE( byteArray, 22304, 12);
    @CAN_PrivMain::RFL_Object::RXX_Object_Obj42.PyVxCoVnce = convertRawToPhysical(raw_value, 0.01, 0.0);

    raw_value=copyBitsFromByteArrayLE( byteArray, 22316, 12);
    @CAN_PrivMain::RFL_Object::RXX_Object_Obj42.PyVyCoVnce = convertRawToPhysical(raw_value, 0.01, 0.0);

    raw_value=copyBitsFromByteArrayLE( byteArray, 22156, 10);
    @CAN_PrivMain::RFL_Object::RXX_Object_Obj42.RCS = convertRawToPhysical(raw_value, 0.2, -102.4);

    raw_value=copyBitsFromByteArrayLE( byteArray, 22328, 4);
    @CAN_PrivMain::RFL_Object::RXX_Object_Obj42.ReferencePoint = convertRawToPhysical(raw_value, 1.0, 0.0);

    raw_value=copyBitsFromByteArrayLE( byteArray, 22188, 12);
    @CAN_PrivMain::RFL_Object::RXX_Object_Obj42.Vx = convertRawToPhysical(raw_value, 0.0625, -128.0);

    raw_value=copyBitsFromByteArrayLE( byteArray, 22412, 12);
    @CAN_PrivMain::RFL_Object::RXX_Object_Obj42.VxAxCoVnce = convertRawToPhysical(raw_value, 0.01, 0.0);

    raw_value=copyBitsFromByteArrayLE( byteArray, 22432, 12);
    @CAN_PrivMain::RFL_Object::RXX_Object_Obj42.VxAyCoVnce = convertRawToPhysical(raw_value, 0.01, 0.0);

    raw_value=copyBitsFromByteArrayLE( byteArray, 22208, 12);
    @CAN_PrivMain::RFL_Object::RXX_Object_Obj42.VxVnce = convertRawToPhysical(raw_value, 0.01, 0.0);

    raw_value=copyBitsFromByteArrayLE( byteArray, 22400, 12);
    @CAN_PrivMain::RFL_Object::RXX_Object_Obj42.VxVyCoVnce = convertRawToPhysical(raw_value, 0.01, 0.0);

    raw_value=copyBitsFromByteArrayLE( byteArray, 22222, 10);
    @CAN_PrivMain::RFL_Object::RXX_Object_Obj42.Vy = convertRawToPhysical(raw_value, 0.125, -64.0);

    raw_value=copyBitsFromByteArrayLE( byteArray, 22444, 12);
    @CAN_PrivMain::RFL_Object::RXX_Object_Obj42.VyAxCoVnce = convertRawToPhysical(raw_value, 0.01, 0.0);

    raw_value=copyBitsFromByteArrayLE( byteArray, 22464, 12);
    @CAN_PrivMain::RFL_Object::RXX_Object_Obj42.VyAyCoVnce = convertRawToPhysical(raw_value, 0.01, 0.0);

    raw_value=copyBitsFromByteArrayLE( byteArray, 22240, 12);
    @CAN_PrivMain::RFL_Object::RXX_Object_Obj42.VyVnce = convertRawToPhysical(raw_value, 0.01, 0.0);

    raw_value=copyBitsFromByteArrayLE( byteArray, 22136, 7);
    @CAN_PrivMain::RFL_Object::RXX_Object_Obj42.Width = convertRawToPhysical(raw_value, 0.125, 0.0);

    raw_value=copyBitsFromByteArrayLE( byteArray, 22144, 12);
    @CAN_PrivMain::RFL_Object::RXX_Object_Obj42.WidthVnce = convertRawToPhysical(raw_value, 0.01, 0.0);
}


void CRadarFL_RXX_Object_Obj43_SetDataReceived(byte byteArray[])
{
    qword raw_value;

    raw_value=copyBitsFromByteArrayLE( byteArray, 23008, 32);
    @CAN_PrivMain::RFL_Object::RXX_Object_Obj43.Age = convertRawToPhysical(raw_value, 1.0, 0.0);

    raw_value=copyBitsFromByteArrayLE( byteArray, 22604, 10);
    @CAN_PrivMain::RFL_Object::RXX_Object_Obj43.Ax = convertRawToPhysical(raw_value, 0.03125, -16.0);

    raw_value=copyBitsFromByteArrayLE( byteArray, 22988, 12);
    @CAN_PrivMain::RFL_Object::RXX_Object_Obj43.AxAyCoVnce = convertRawToPhysical(raw_value, 0.01, 0.0);

    raw_value=copyBitsFromByteArrayLE( byteArray, 22624, 12);
    @CAN_PrivMain::RFL_Object::RXX_Object_Obj43.AxVnce = convertRawToPhysical(raw_value, 0.01, 0.0);

    raw_value=copyBitsFromByteArrayLE( byteArray, 22678, 9);
    @CAN_PrivMain::RFL_Object::RXX_Object_Obj43.Ay = convertRawToPhysical(raw_value, 0.0625, -16.0);

    raw_value=copyBitsFromByteArrayLE( byteArray, 22688, 12);
    @CAN_PrivMain::RFL_Object::RXX_Object_Obj43.AyVnce = convertRawToPhysical(raw_value, 0.01, 0.0);

    raw_value=copyBitsFromByteArrayLE( byteArray, 22744, 6);
    @CAN_PrivMain::RFL_Object::RXX_Object_Obj43.ExistProb = convertRawToPhysical(raw_value, 2.0, 0.0);

    raw_value=copyBitsFromByteArrayLE( byteArray, 22808, 8);
    @CAN_PrivMain::RFL_Object::RXX_Object_Obj43.FilterInformation = convertRawToPhysical(raw_value, 1.0, 0.0);

    raw_value=copyBitsFromByteArrayLE( byteArray, 22584, 7);
    @CAN_PrivMain::RFL_Object::RXX_Object_Obj43.Length = convertRawToPhysical(raw_value, 0.125, 0.0);

    raw_value=copyBitsFromByteArrayLE( byteArray, 22592, 12);
    @CAN_PrivMain::RFL_Object::RXX_Object_Obj43.LengthVnce = convertRawToPhysical(raw_value, 0.01, 0.0);

    raw_value=copyBitsFromByteArrayLE( byteArray, 22776, 3);
    @CAN_PrivMain::RFL_Object::RXX_Object_Obj43.MeasurementStatus = convertRawToPhysical(raw_value, 1.0, 0.0);

    raw_value=copyBitsFromByteArrayLE( byteArray, 22732, 2);
    @CAN_PrivMain::RFL_Object::RXX_Object_Obj43.MovingStatus = convertRawToPhysical(raw_value, 1.0, 0.0);

    raw_value=copyBitsFromByteArrayLE( byteArray, 22712, 7);
    @CAN_PrivMain::RFL_Object::RXX_Object_Obj43.ObjId = convertRawToPhysical(raw_value, 1.0, 0.0);

    raw_value=copyBitsFromByteArrayLE( byteArray, 22614, 9);
    @CAN_PrivMain::RFL_Object::RXX_Object_Obj43.OrientationYaw = convertRawToPhysical(raw_value, 0.0175, -4.48);

    raw_value=copyBitsFromByteArrayLE( byteArray, 22636, 12);
    @CAN_PrivMain::RFL_Object::RXX_Object_Obj43.OrientationYawVnce = convertRawToPhysical(raw_value, 0.0003, 0.0);

    raw_value=copyBitsFromByteArrayLE( byteArray, 22528, 6);
    @CAN_PrivMain::RFL_Object::RXX_Object_Obj43.ProbClassConfidence = convertRawToPhysical(raw_value, 2.0, 0.0);

    raw_value=copyBitsFromByteArrayLE( byteArray, 22779, 4);
    @CAN_PrivMain::RFL_Object::RXX_Object_Obj43.ProbClassType = convertRawToPhysical(raw_value, 1.0, 0.0);

    raw_value=copyBitsFromByteArrayLE( byteArray, 22534, 14);
    @CAN_PrivMain::RFL_Object::RXX_Object_Obj43.Px = convertRawToPhysical(raw_value, 0.0625, -512.0);

    raw_value=copyBitsFromByteArrayLE( byteArray, 22848, 12);
    @CAN_PrivMain::RFL_Object::RXX_Object_Obj43.PxAxCoVnce = convertRawToPhysical(raw_value, 0.01, 0.0);

    raw_value=copyBitsFromByteArrayLE( byteArray, 22860, 12);
    @CAN_PrivMain::RFL_Object::RXX_Object_Obj43.PxAyCoVnce = convertRawToPhysical(raw_value, 0.01, 0.0);

    raw_value=copyBitsFromByteArrayLE( byteArray, 22764, 12);
    @CAN_PrivMain::RFL_Object::RXX_Object_Obj43.PxPyCoVnce = convertRawToPhysical(raw_value, 0.01, 0.0);

    raw_value=copyBitsFromByteArrayLE( byteArray, 22548, 12);
    @CAN_PrivMain::RFL_Object::RXX_Object_Obj43.PxVnce = convertRawToPhysical(raw_value, 0.1, 0.0);

    raw_value=copyBitsFromByteArrayLE( byteArray, 22784, 12);
    @CAN_PrivMain::RFL_Object::RXX_Object_Obj43.PxVxCoVnce = convertRawToPhysical(raw_value, 0.01, 0.0);

    raw_value=copyBitsFromByteArrayLE( byteArray, 22796, 12);
    @CAN_PrivMain::RFL_Object::RXX_Object_Obj43.PxVyCoVnce = convertRawToPhysical(raw_value, 0.01, 0.0);

    raw_value=copyBitsFromByteArrayLE( byteArray, 22560, 12);
    @CAN_PrivMain::RFL_Object::RXX_Object_Obj43.Py = convertRawToPhysical(raw_value, 0.0625, -128.0);

    raw_value=copyBitsFromByteArrayLE( byteArray, 22880, 12);
    @CAN_PrivMain::RFL_Object::RXX_Object_Obj43.PyAxCoVnce = convertRawToPhysical(raw_value, 0.01, 0.0);

    raw_value=copyBitsFromByteArrayLE( byteArray, 22892, 12);
    @CAN_PrivMain::RFL_Object::RXX_Object_Obj43.PyAyCoVnce = convertRawToPhysical(raw_value, 0.01, 0.0);

    raw_value=copyBitsFromByteArrayLE( byteArray, 22572, 12);
    @CAN_PrivMain::RFL_Object::RXX_Object_Obj43.PyVnce = convertRawToPhysical(raw_value, 0.1, 0.0);

    raw_value=copyBitsFromByteArrayLE( byteArray, 22816, 12);
    @CAN_PrivMain::RFL_Object::RXX_Object_Obj43.PyVxCoVnce = convertRawToPhysical(raw_value, 0.01, 0.0);

    raw_value=copyBitsFromByteArrayLE( byteArray, 22828, 12);
    @CAN_PrivMain::RFL_Object::RXX_Object_Obj43.PyVyCoVnce = convertRawToPhysical(raw_value, 0.01, 0.0);

    raw_value=copyBitsFromByteArrayLE( byteArray, 22668, 10);
    @CAN_PrivMain::RFL_Object::RXX_Object_Obj43.RCS = convertRawToPhysical(raw_value, 0.2, -102.4);

    raw_value=copyBitsFromByteArrayLE( byteArray, 22840, 4);
    @CAN_PrivMain::RFL_Object::RXX_Object_Obj43.ReferencePoint = convertRawToPhysical(raw_value, 1.0, 0.0);

    raw_value=copyBitsFromByteArrayLE( byteArray, 22700, 12);
    @CAN_PrivMain::RFL_Object::RXX_Object_Obj43.Vx = convertRawToPhysical(raw_value, 0.0625, -128.0);

    raw_value=copyBitsFromByteArrayLE( byteArray, 22924, 12);
    @CAN_PrivMain::RFL_Object::RXX_Object_Obj43.VxAxCoVnce = convertRawToPhysical(raw_value, 0.01, 0.0);

    raw_value=copyBitsFromByteArrayLE( byteArray, 22944, 12);
    @CAN_PrivMain::RFL_Object::RXX_Object_Obj43.VxAyCoVnce = convertRawToPhysical(raw_value, 0.01, 0.0);

    raw_value=copyBitsFromByteArrayLE( byteArray, 22720, 12);
    @CAN_PrivMain::RFL_Object::RXX_Object_Obj43.VxVnce = convertRawToPhysical(raw_value, 0.01, 0.0);

    raw_value=copyBitsFromByteArrayLE( byteArray, 22912, 12);
    @CAN_PrivMain::RFL_Object::RXX_Object_Obj43.VxVyCoVnce = convertRawToPhysical(raw_value, 0.01, 0.0);

    raw_value=copyBitsFromByteArrayLE( byteArray, 22734, 10);
    @CAN_PrivMain::RFL_Object::RXX_Object_Obj43.Vy = convertRawToPhysical(raw_value, 0.125, -64.0);

    raw_value=copyBitsFromByteArrayLE( byteArray, 22956, 12);
    @CAN_PrivMain::RFL_Object::RXX_Object_Obj43.VyAxCoVnce = convertRawToPhysical(raw_value, 0.01, 0.0);

    raw_value=copyBitsFromByteArrayLE( byteArray, 22976, 12);
    @CAN_PrivMain::RFL_Object::RXX_Object_Obj43.VyAyCoVnce = convertRawToPhysical(raw_value, 0.01, 0.0);

    raw_value=copyBitsFromByteArrayLE( byteArray, 22752, 12);
    @CAN_PrivMain::RFL_Object::RXX_Object_Obj43.VyVnce = convertRawToPhysical(raw_value, 0.01, 0.0);

    raw_value=copyBitsFromByteArrayLE( byteArray, 22648, 7);
    @CAN_PrivMain::RFL_Object::RXX_Object_Obj43.Width = convertRawToPhysical(raw_value, 0.125, 0.0);

    raw_value=copyBitsFromByteArrayLE( byteArray, 22656, 12);
    @CAN_PrivMain::RFL_Object::RXX_Object_Obj43.WidthVnce = convertRawToPhysical(raw_value, 0.01, 0.0);
}


void CRadarFL_RXX_Object_Obj44_SetDataReceived(byte byteArray[])
{
    qword raw_value;

    raw_value=copyBitsFromByteArrayLE( byteArray, 23520, 32);
    @CAN_PrivMain::RFL_Object::RXX_Object_Obj44.Age = convertRawToPhysical(raw_value, 1.0, 0.0);

    raw_value=copyBitsFromByteArrayLE( byteArray, 23116, 10);
    @CAN_PrivMain::RFL_Object::RXX_Object_Obj44.Ax = convertRawToPhysical(raw_value, 0.03125, -16.0);

    raw_value=copyBitsFromByteArrayLE( byteArray, 23500, 12);
    @CAN_PrivMain::RFL_Object::RXX_Object_Obj44.AxAyCoVnce = convertRawToPhysical(raw_value, 0.01, 0.0);

    raw_value=copyBitsFromByteArrayLE( byteArray, 23136, 12);
    @CAN_PrivMain::RFL_Object::RXX_Object_Obj44.AxVnce = convertRawToPhysical(raw_value, 0.01, 0.0);

    raw_value=copyBitsFromByteArrayLE( byteArray, 23190, 9);
    @CAN_PrivMain::RFL_Object::RXX_Object_Obj44.Ay = convertRawToPhysical(raw_value, 0.0625, -16.0);

    raw_value=copyBitsFromByteArrayLE( byteArray, 23200, 12);
    @CAN_PrivMain::RFL_Object::RXX_Object_Obj44.AyVnce = convertRawToPhysical(raw_value, 0.01, 0.0);

    raw_value=copyBitsFromByteArrayLE( byteArray, 23256, 6);
    @CAN_PrivMain::RFL_Object::RXX_Object_Obj44.ExistProb = convertRawToPhysical(raw_value, 2.0, 0.0);

    raw_value=copyBitsFromByteArrayLE( byteArray, 23320, 8);
    @CAN_PrivMain::RFL_Object::RXX_Object_Obj44.FilterInformation = convertRawToPhysical(raw_value, 1.0, 0.0);

    raw_value=copyBitsFromByteArrayLE( byteArray, 23096, 7);
    @CAN_PrivMain::RFL_Object::RXX_Object_Obj44.Length = convertRawToPhysical(raw_value, 0.125, 0.0);

    raw_value=copyBitsFromByteArrayLE( byteArray, 23104, 12);
    @CAN_PrivMain::RFL_Object::RXX_Object_Obj44.LengthVnce = convertRawToPhysical(raw_value, 0.01, 0.0);

    raw_value=copyBitsFromByteArrayLE( byteArray, 23288, 3);
    @CAN_PrivMain::RFL_Object::RXX_Object_Obj44.MeasurementStatus = convertRawToPhysical(raw_value, 1.0, 0.0);

    raw_value=copyBitsFromByteArrayLE( byteArray, 23244, 2);
    @CAN_PrivMain::RFL_Object::RXX_Object_Obj44.MovingStatus = convertRawToPhysical(raw_value, 1.0, 0.0);

    raw_value=copyBitsFromByteArrayLE( byteArray, 23224, 7);
    @CAN_PrivMain::RFL_Object::RXX_Object_Obj44.ObjId = convertRawToPhysical(raw_value, 1.0, 0.0);

    raw_value=copyBitsFromByteArrayLE( byteArray, 23126, 9);
    @CAN_PrivMain::RFL_Object::RXX_Object_Obj44.OrientationYaw = convertRawToPhysical(raw_value, 0.0175, -4.48);

    raw_value=copyBitsFromByteArrayLE( byteArray, 23148, 12);
    @CAN_PrivMain::RFL_Object::RXX_Object_Obj44.OrientationYawVnce = convertRawToPhysical(raw_value, 0.0003, 0.0);

    raw_value=copyBitsFromByteArrayLE( byteArray, 23040, 6);
    @CAN_PrivMain::RFL_Object::RXX_Object_Obj44.ProbClassConfidence = convertRawToPhysical(raw_value, 2.0, 0.0);

    raw_value=copyBitsFromByteArrayLE( byteArray, 23291, 4);
    @CAN_PrivMain::RFL_Object::RXX_Object_Obj44.ProbClassType = convertRawToPhysical(raw_value, 1.0, 0.0);

    raw_value=copyBitsFromByteArrayLE( byteArray, 23046, 14);
    @CAN_PrivMain::RFL_Object::RXX_Object_Obj44.Px = convertRawToPhysical(raw_value, 0.0625, -512.0);

    raw_value=copyBitsFromByteArrayLE( byteArray, 23360, 12);
    @CAN_PrivMain::RFL_Object::RXX_Object_Obj44.PxAxCoVnce = convertRawToPhysical(raw_value, 0.01, 0.0);

    raw_value=copyBitsFromByteArrayLE( byteArray, 23372, 12);
    @CAN_PrivMain::RFL_Object::RXX_Object_Obj44.PxAyCoVnce = convertRawToPhysical(raw_value, 0.01, 0.0);

    raw_value=copyBitsFromByteArrayLE( byteArray, 23276, 12);
    @CAN_PrivMain::RFL_Object::RXX_Object_Obj44.PxPyCoVnce = convertRawToPhysical(raw_value, 0.01, 0.0);

    raw_value=copyBitsFromByteArrayLE( byteArray, 23060, 12);
    @CAN_PrivMain::RFL_Object::RXX_Object_Obj44.PxVnce = convertRawToPhysical(raw_value, 0.1, 0.0);

    raw_value=copyBitsFromByteArrayLE( byteArray, 23296, 12);
    @CAN_PrivMain::RFL_Object::RXX_Object_Obj44.PxVxCoVnce = convertRawToPhysical(raw_value, 0.01, 0.0);

    raw_value=copyBitsFromByteArrayLE( byteArray, 23308, 12);
    @CAN_PrivMain::RFL_Object::RXX_Object_Obj44.PxVyCoVnce = convertRawToPhysical(raw_value, 0.01, 0.0);

    raw_value=copyBitsFromByteArrayLE( byteArray, 23072, 12);
    @CAN_PrivMain::RFL_Object::RXX_Object_Obj44.Py = convertRawToPhysical(raw_value, 0.0625, -128.0);

    raw_value=copyBitsFromByteArrayLE( byteArray, 23392, 12);
    @CAN_PrivMain::RFL_Object::RXX_Object_Obj44.PyAxCoVnce = convertRawToPhysical(raw_value, 0.01, 0.0);

    raw_value=copyBitsFromByteArrayLE( byteArray, 23404, 12);
    @CAN_PrivMain::RFL_Object::RXX_Object_Obj44.PyAyCoVnce = convertRawToPhysical(raw_value, 0.01, 0.0);

    raw_value=copyBitsFromByteArrayLE( byteArray, 23084, 12);
    @CAN_PrivMain::RFL_Object::RXX_Object_Obj44.PyVnce = convertRawToPhysical(raw_value, 0.1, 0.0);

    raw_value=copyBitsFromByteArrayLE( byteArray, 23328, 12);
    @CAN_PrivMain::RFL_Object::RXX_Object_Obj44.PyVxCoVnce = convertRawToPhysical(raw_value, 0.01, 0.0);

    raw_value=copyBitsFromByteArrayLE( byteArray, 23340, 12);
    @CAN_PrivMain::RFL_Object::RXX_Object_Obj44.PyVyCoVnce = convertRawToPhysical(raw_value, 0.01, 0.0);

    raw_value=copyBitsFromByteArrayLE( byteArray, 23180, 10);
    @CAN_PrivMain::RFL_Object::RXX_Object_Obj44.RCS = convertRawToPhysical(raw_value, 0.2, -102.4);

    raw_value=copyBitsFromByteArrayLE( byteArray, 23352, 4);
    @CAN_PrivMain::RFL_Object::RXX_Object_Obj44.ReferencePoint = convertRawToPhysical(raw_value, 1.0, 0.0);

    raw_value=copyBitsFromByteArrayLE( byteArray, 23212, 12);
    @CAN_PrivMain::RFL_Object::RXX_Object_Obj44.Vx = convertRawToPhysical(raw_value, 0.0625, -128.0);

    raw_value=copyBitsFromByteArrayLE( byteArray, 23436, 12);
    @CAN_PrivMain::RFL_Object::RXX_Object_Obj44.VxAxCoVnce = convertRawToPhysical(raw_value, 0.01, 0.0);

    raw_value=copyBitsFromByteArrayLE( byteArray, 23456, 12);
    @CAN_PrivMain::RFL_Object::RXX_Object_Obj44.VxAyCoVnce = convertRawToPhysical(raw_value, 0.01, 0.0);

    raw_value=copyBitsFromByteArrayLE( byteArray, 23232, 12);
    @CAN_PrivMain::RFL_Object::RXX_Object_Obj44.VxVnce = convertRawToPhysical(raw_value, 0.01, 0.0);

    raw_value=copyBitsFromByteArrayLE( byteArray, 23424, 12);
    @CAN_PrivMain::RFL_Object::RXX_Object_Obj44.VxVyCoVnce = convertRawToPhysical(raw_value, 0.01, 0.0);

    raw_value=copyBitsFromByteArrayLE( byteArray, 23246, 10);
    @CAN_PrivMain::RFL_Object::RXX_Object_Obj44.Vy = convertRawToPhysical(raw_value, 0.125, -64.0);

    raw_value=copyBitsFromByteArrayLE( byteArray, 23468, 12);
    @CAN_PrivMain::RFL_Object::RXX_Object_Obj44.VyAxCoVnce = convertRawToPhysical(raw_value, 0.01, 0.0);

    raw_value=copyBitsFromByteArrayLE( byteArray, 23488, 12);
    @CAN_PrivMain::RFL_Object::RXX_Object_Obj44.VyAyCoVnce = convertRawToPhysical(raw_value, 0.01, 0.0);

    raw_value=copyBitsFromByteArrayLE( byteArray, 23264, 12);
    @CAN_PrivMain::RFL_Object::RXX_Object_Obj44.VyVnce = convertRawToPhysical(raw_value, 0.01, 0.0);

    raw_value=copyBitsFromByteArrayLE( byteArray, 23160, 7);
    @CAN_PrivMain::RFL_Object::RXX_Object_Obj44.Width = convertRawToPhysical(raw_value, 0.125, 0.0);

    raw_value=copyBitsFromByteArrayLE( byteArray, 23168, 12);
    @CAN_PrivMain::RFL_Object::RXX_Object_Obj44.WidthVnce = convertRawToPhysical(raw_value, 0.01, 0.0);
}


void CRadarFL_RXX_Object_Obj45_SetDataReceived(byte byteArray[])
{
    qword raw_value;

    raw_value=copyBitsFromByteArrayLE( byteArray, 24032, 32);
    @CAN_PrivMain::RFL_Object::RXX_Object_Obj45.Age = convertRawToPhysical(raw_value, 1.0, 0.0);

    raw_value=copyBitsFromByteArrayLE( byteArray, 23628, 10);
    @CAN_PrivMain::RFL_Object::RXX_Object_Obj45.Ax = convertRawToPhysical(raw_value, 0.03125, -16.0);

    raw_value=copyBitsFromByteArrayLE( byteArray, 24012, 12);
    @CAN_PrivMain::RFL_Object::RXX_Object_Obj45.AxAyCoVnce = convertRawToPhysical(raw_value, 0.01, 0.0);

    raw_value=copyBitsFromByteArrayLE( byteArray, 23648, 12);
    @CAN_PrivMain::RFL_Object::RXX_Object_Obj45.AxVnce = convertRawToPhysical(raw_value, 0.01, 0.0);

    raw_value=copyBitsFromByteArrayLE( byteArray, 23702, 9);
    @CAN_PrivMain::RFL_Object::RXX_Object_Obj45.Ay = convertRawToPhysical(raw_value, 0.0625, -16.0);

    raw_value=copyBitsFromByteArrayLE( byteArray, 23712, 12);
    @CAN_PrivMain::RFL_Object::RXX_Object_Obj45.AyVnce = convertRawToPhysical(raw_value, 0.01, 0.0);

    raw_value=copyBitsFromByteArrayLE( byteArray, 23768, 6);
    @CAN_PrivMain::RFL_Object::RXX_Object_Obj45.ExistProb = convertRawToPhysical(raw_value, 2.0, 0.0);

    raw_value=copyBitsFromByteArrayLE( byteArray, 23832, 8);
    @CAN_PrivMain::RFL_Object::RXX_Object_Obj45.FilterInformation = convertRawToPhysical(raw_value, 1.0, 0.0);

    raw_value=copyBitsFromByteArrayLE( byteArray, 23608, 7);
    @CAN_PrivMain::RFL_Object::RXX_Object_Obj45.Length = convertRawToPhysical(raw_value, 0.125, 0.0);

    raw_value=copyBitsFromByteArrayLE( byteArray, 23616, 12);
    @CAN_PrivMain::RFL_Object::RXX_Object_Obj45.LengthVnce = convertRawToPhysical(raw_value, 0.01, 0.0);

    raw_value=copyBitsFromByteArrayLE( byteArray, 23800, 3);
    @CAN_PrivMain::RFL_Object::RXX_Object_Obj45.MeasurementStatus = convertRawToPhysical(raw_value, 1.0, 0.0);

    raw_value=copyBitsFromByteArrayLE( byteArray, 23756, 2);
    @CAN_PrivMain::RFL_Object::RXX_Object_Obj45.MovingStatus = convertRawToPhysical(raw_value, 1.0, 0.0);

    raw_value=copyBitsFromByteArrayLE( byteArray, 23736, 7);
    @CAN_PrivMain::RFL_Object::RXX_Object_Obj45.ObjId = convertRawToPhysical(raw_value, 1.0, 0.0);

    raw_value=copyBitsFromByteArrayLE( byteArray, 23638, 9);
    @CAN_PrivMain::RFL_Object::RXX_Object_Obj45.OrientationYaw = convertRawToPhysical(raw_value, 0.0175, -4.48);

    raw_value=copyBitsFromByteArrayLE( byteArray, 23660, 12);
    @CAN_PrivMain::RFL_Object::RXX_Object_Obj45.OrientationYawVnce = convertRawToPhysical(raw_value, 0.0003, 0.0);

    raw_value=copyBitsFromByteArrayLE( byteArray, 23552, 6);
    @CAN_PrivMain::RFL_Object::RXX_Object_Obj45.ProbClassConfidence = convertRawToPhysical(raw_value, 2.0, 0.0);

    raw_value=copyBitsFromByteArrayLE( byteArray, 23803, 4);
    @CAN_PrivMain::RFL_Object::RXX_Object_Obj45.ProbClassType = convertRawToPhysical(raw_value, 1.0, 0.0);

    raw_value=copyBitsFromByteArrayLE( byteArray, 23558, 14);
    @CAN_PrivMain::RFL_Object::RXX_Object_Obj45.Px = convertRawToPhysical(raw_value, 0.0625, -512.0);

    raw_value=copyBitsFromByteArrayLE( byteArray, 23872, 12);
    @CAN_PrivMain::RFL_Object::RXX_Object_Obj45.PxAxCoVnce = convertRawToPhysical(raw_value, 0.01, 0.0);

    raw_value=copyBitsFromByteArrayLE( byteArray, 23884, 12);
    @CAN_PrivMain::RFL_Object::RXX_Object_Obj45.PxAyCoVnce = convertRawToPhysical(raw_value, 0.01, 0.0);

    raw_value=copyBitsFromByteArrayLE( byteArray, 23788, 12);
    @CAN_PrivMain::RFL_Object::RXX_Object_Obj45.PxPyCoVnce = convertRawToPhysical(raw_value, 0.01, 0.0);

    raw_value=copyBitsFromByteArrayLE( byteArray, 23572, 12);
    @CAN_PrivMain::RFL_Object::RXX_Object_Obj45.PxVnce = convertRawToPhysical(raw_value, 0.1, 0.0);

    raw_value=copyBitsFromByteArrayLE( byteArray, 23808, 12);
    @CAN_PrivMain::RFL_Object::RXX_Object_Obj45.PxVxCoVnce = convertRawToPhysical(raw_value, 0.01, 0.0);

    raw_value=copyBitsFromByteArrayLE( byteArray, 23820, 12);
    @CAN_PrivMain::RFL_Object::RXX_Object_Obj45.PxVyCoVnce = convertRawToPhysical(raw_value, 0.01, 0.0);

    raw_value=copyBitsFromByteArrayLE( byteArray, 23584, 12);
    @CAN_PrivMain::RFL_Object::RXX_Object_Obj45.Py = convertRawToPhysical(raw_value, 0.0625, -128.0);

    raw_value=copyBitsFromByteArrayLE( byteArray, 23904, 12);
    @CAN_PrivMain::RFL_Object::RXX_Object_Obj45.PyAxCoVnce = convertRawToPhysical(raw_value, 0.01, 0.0);

    raw_value=copyBitsFromByteArrayLE( byteArray, 23916, 12);
    @CAN_PrivMain::RFL_Object::RXX_Object_Obj45.PyAyCoVnce = convertRawToPhysical(raw_value, 0.01, 0.0);

    raw_value=copyBitsFromByteArrayLE( byteArray, 23596, 12);
    @CAN_PrivMain::RFL_Object::RXX_Object_Obj45.PyVnce = convertRawToPhysical(raw_value, 0.1, 0.0);

    raw_value=copyBitsFromByteArrayLE( byteArray, 23840, 12);
    @CAN_PrivMain::RFL_Object::RXX_Object_Obj45.PyVxCoVnce = convertRawToPhysical(raw_value, 0.01, 0.0);

    raw_value=copyBitsFromByteArrayLE( byteArray, 23852, 12);
    @CAN_PrivMain::RFL_Object::RXX_Object_Obj45.PyVyCoVnce = convertRawToPhysical(raw_value, 0.01, 0.0);

    raw_value=copyBitsFromByteArrayLE( byteArray, 23692, 10);
    @CAN_PrivMain::RFL_Object::RXX_Object_Obj45.RCS = convertRawToPhysical(raw_value, 0.2, -102.4);

    raw_value=copyBitsFromByteArrayLE( byteArray, 23864, 4);
    @CAN_PrivMain::RFL_Object::RXX_Object_Obj45.ReferencePoint = convertRawToPhysical(raw_value, 1.0, 0.0);

    raw_value=copyBitsFromByteArrayLE( byteArray, 23724, 12);
    @CAN_PrivMain::RFL_Object::RXX_Object_Obj45.Vx = convertRawToPhysical(raw_value, 0.0625, -128.0);

    raw_value=copyBitsFromByteArrayLE( byteArray, 23948, 12);
    @CAN_PrivMain::RFL_Object::RXX_Object_Obj45.VxAxCoVnce = convertRawToPhysical(raw_value, 0.01, 0.0);

    raw_value=copyBitsFromByteArrayLE( byteArray, 23968, 12);
    @CAN_PrivMain::RFL_Object::RXX_Object_Obj45.VxAyCoVnce = convertRawToPhysical(raw_value, 0.01, 0.0);

    raw_value=copyBitsFromByteArrayLE( byteArray, 23744, 12);
    @CAN_PrivMain::RFL_Object::RXX_Object_Obj45.VxVnce = convertRawToPhysical(raw_value, 0.01, 0.0);

    raw_value=copyBitsFromByteArrayLE( byteArray, 23936, 12);
    @CAN_PrivMain::RFL_Object::RXX_Object_Obj45.VxVyCoVnce = convertRawToPhysical(raw_value, 0.01, 0.0);

    raw_value=copyBitsFromByteArrayLE( byteArray, 23758, 10);
    @CAN_PrivMain::RFL_Object::RXX_Object_Obj45.Vy = convertRawToPhysical(raw_value, 0.125, -64.0);

    raw_value=copyBitsFromByteArrayLE( byteArray, 23980, 12);
    @CAN_PrivMain::RFL_Object::RXX_Object_Obj45.VyAxCoVnce = convertRawToPhysical(raw_value, 0.01, 0.0);

    raw_value=copyBitsFromByteArrayLE( byteArray, 24000, 12);
    @CAN_PrivMain::RFL_Object::RXX_Object_Obj45.VyAyCoVnce = convertRawToPhysical(raw_value, 0.01, 0.0);

    raw_value=copyBitsFromByteArrayLE( byteArray, 23776, 12);
    @CAN_PrivMain::RFL_Object::RXX_Object_Obj45.VyVnce = convertRawToPhysical(raw_value, 0.01, 0.0);

    raw_value=copyBitsFromByteArrayLE( byteArray, 23672, 7);
    @CAN_PrivMain::RFL_Object::RXX_Object_Obj45.Width = convertRawToPhysical(raw_value, 0.125, 0.0);

    raw_value=copyBitsFromByteArrayLE( byteArray, 23680, 12);
    @CAN_PrivMain::RFL_Object::RXX_Object_Obj45.WidthVnce = convertRawToPhysical(raw_value, 0.01, 0.0);
}


void CRadarFL_RXX_Object_Obj46_SetDataReceived(byte byteArray[])
{
    qword raw_value;

    raw_value=copyBitsFromByteArrayLE( byteArray, 24544, 32);
    @CAN_PrivMain::RFL_Object::RXX_Object_Obj46.Age = convertRawToPhysical(raw_value, 1.0, 0.0);

    raw_value=copyBitsFromByteArrayLE( byteArray, 24140, 10);
    @CAN_PrivMain::RFL_Object::RXX_Object_Obj46.Ax = convertRawToPhysical(raw_value, 0.03125, -16.0);

    raw_value=copyBitsFromByteArrayLE( byteArray, 24524, 12);
    @CAN_PrivMain::RFL_Object::RXX_Object_Obj46.AxAyCoVnce = convertRawToPhysical(raw_value, 0.01, 0.0);

    raw_value=copyBitsFromByteArrayLE( byteArray, 24160, 12);
    @CAN_PrivMain::RFL_Object::RXX_Object_Obj46.AxVnce = convertRawToPhysical(raw_value, 0.01, 0.0);

    raw_value=copyBitsFromByteArrayLE( byteArray, 24214, 9);
    @CAN_PrivMain::RFL_Object::RXX_Object_Obj46.Ay = convertRawToPhysical(raw_value, 0.0625, -16.0);

    raw_value=copyBitsFromByteArrayLE( byteArray, 24224, 12);
    @CAN_PrivMain::RFL_Object::RXX_Object_Obj46.AyVnce = convertRawToPhysical(raw_value, 0.01, 0.0);

    raw_value=copyBitsFromByteArrayLE( byteArray, 24280, 6);
    @CAN_PrivMain::RFL_Object::RXX_Object_Obj46.ExistProb = convertRawToPhysical(raw_value, 2.0, 0.0);

    raw_value=copyBitsFromByteArrayLE( byteArray, 24344, 8);
    @CAN_PrivMain::RFL_Object::RXX_Object_Obj46.FilterInformation = convertRawToPhysical(raw_value, 1.0, 0.0);

    raw_value=copyBitsFromByteArrayLE( byteArray, 24120, 7);
    @CAN_PrivMain::RFL_Object::RXX_Object_Obj46.Length = convertRawToPhysical(raw_value, 0.125, 0.0);

    raw_value=copyBitsFromByteArrayLE( byteArray, 24128, 12);
    @CAN_PrivMain::RFL_Object::RXX_Object_Obj46.LengthVnce = convertRawToPhysical(raw_value, 0.01, 0.0);

    raw_value=copyBitsFromByteArrayLE( byteArray, 24312, 3);
    @CAN_PrivMain::RFL_Object::RXX_Object_Obj46.MeasurementStatus = convertRawToPhysical(raw_value, 1.0, 0.0);

    raw_value=copyBitsFromByteArrayLE( byteArray, 24268, 2);
    @CAN_PrivMain::RFL_Object::RXX_Object_Obj46.MovingStatus = convertRawToPhysical(raw_value, 1.0, 0.0);

    raw_value=copyBitsFromByteArrayLE( byteArray, 24248, 7);
    @CAN_PrivMain::RFL_Object::RXX_Object_Obj46.ObjId = convertRawToPhysical(raw_value, 1.0, 0.0);

    raw_value=copyBitsFromByteArrayLE( byteArray, 24150, 9);
    @CAN_PrivMain::RFL_Object::RXX_Object_Obj46.OrientationYaw = convertRawToPhysical(raw_value, 0.0175, -4.48);

    raw_value=copyBitsFromByteArrayLE( byteArray, 24172, 12);
    @CAN_PrivMain::RFL_Object::RXX_Object_Obj46.OrientationYawVnce = convertRawToPhysical(raw_value, 0.0003, 0.0);

    raw_value=copyBitsFromByteArrayLE( byteArray, 24064, 6);
    @CAN_PrivMain::RFL_Object::RXX_Object_Obj46.ProbClassConfidence = convertRawToPhysical(raw_value, 2.0, 0.0);

    raw_value=copyBitsFromByteArrayLE( byteArray, 24315, 4);
    @CAN_PrivMain::RFL_Object::RXX_Object_Obj46.ProbClassType = convertRawToPhysical(raw_value, 1.0, 0.0);

    raw_value=copyBitsFromByteArrayLE( byteArray, 24070, 14);
    @CAN_PrivMain::RFL_Object::RXX_Object_Obj46.Px = convertRawToPhysical(raw_value, 0.0625, -512.0);

    raw_value=copyBitsFromByteArrayLE( byteArray, 24384, 12);
    @CAN_PrivMain::RFL_Object::RXX_Object_Obj46.PxAxCoVnce = convertRawToPhysical(raw_value, 0.01, 0.0);

    raw_value=copyBitsFromByteArrayLE( byteArray, 24396, 12);
    @CAN_PrivMain::RFL_Object::RXX_Object_Obj46.PxAyCoVnce = convertRawToPhysical(raw_value, 0.01, 0.0);

    raw_value=copyBitsFromByteArrayLE( byteArray, 24300, 12);
    @CAN_PrivMain::RFL_Object::RXX_Object_Obj46.PxPyCoVnce = convertRawToPhysical(raw_value, 0.01, 0.0);

    raw_value=copyBitsFromByteArrayLE( byteArray, 24084, 12);
    @CAN_PrivMain::RFL_Object::RXX_Object_Obj46.PxVnce = convertRawToPhysical(raw_value, 0.1, 0.0);

    raw_value=copyBitsFromByteArrayLE( byteArray, 24320, 12);
    @CAN_PrivMain::RFL_Object::RXX_Object_Obj46.PxVxCoVnce = convertRawToPhysical(raw_value, 0.01, 0.0);

    raw_value=copyBitsFromByteArrayLE( byteArray, 24332, 12);
    @CAN_PrivMain::RFL_Object::RXX_Object_Obj46.PxVyCoVnce = convertRawToPhysical(raw_value, 0.01, 0.0);

    raw_value=copyBitsFromByteArrayLE( byteArray, 24096, 12);
    @CAN_PrivMain::RFL_Object::RXX_Object_Obj46.Py = convertRawToPhysical(raw_value, 0.0625, -128.0);

    raw_value=copyBitsFromByteArrayLE( byteArray, 24416, 12);
    @CAN_PrivMain::RFL_Object::RXX_Object_Obj46.PyAxCoVnce = convertRawToPhysical(raw_value, 0.01, 0.0);

    raw_value=copyBitsFromByteArrayLE( byteArray, 24428, 12);
    @CAN_PrivMain::RFL_Object::RXX_Object_Obj46.PyAyCoVnce = convertRawToPhysical(raw_value, 0.01, 0.0);

    raw_value=copyBitsFromByteArrayLE( byteArray, 24108, 12);
    @CAN_PrivMain::RFL_Object::RXX_Object_Obj46.PyVnce = convertRawToPhysical(raw_value, 0.1, 0.0);

    raw_value=copyBitsFromByteArrayLE( byteArray, 24352, 12);
    @CAN_PrivMain::RFL_Object::RXX_Object_Obj46.PyVxCoVnce = convertRawToPhysical(raw_value, 0.01, 0.0);

    raw_value=copyBitsFromByteArrayLE( byteArray, 24364, 12);
    @CAN_PrivMain::RFL_Object::RXX_Object_Obj46.PyVyCoVnce = convertRawToPhysical(raw_value, 0.01, 0.0);

    raw_value=copyBitsFromByteArrayLE( byteArray, 24204, 10);
    @CAN_PrivMain::RFL_Object::RXX_Object_Obj46.RCS = convertRawToPhysical(raw_value, 0.2, -102.4);

    raw_value=copyBitsFromByteArrayLE( byteArray, 24376, 4);
    @CAN_PrivMain::RFL_Object::RXX_Object_Obj46.ReferencePoint = convertRawToPhysical(raw_value, 1.0, 0.0);

    raw_value=copyBitsFromByteArrayLE( byteArray, 24236, 12);
    @CAN_PrivMain::RFL_Object::RXX_Object_Obj46.Vx = convertRawToPhysical(raw_value, 0.0625, -128.0);

    raw_value=copyBitsFromByteArrayLE( byteArray, 24460, 12);
    @CAN_PrivMain::RFL_Object::RXX_Object_Obj46.VxAxCoVnce = convertRawToPhysical(raw_value, 0.01, 0.0);

    raw_value=copyBitsFromByteArrayLE( byteArray, 24480, 12);
    @CAN_PrivMain::RFL_Object::RXX_Object_Obj46.VxAyCoVnce = convertRawToPhysical(raw_value, 0.01, 0.0);

    raw_value=copyBitsFromByteArrayLE( byteArray, 24256, 12);
    @CAN_PrivMain::RFL_Object::RXX_Object_Obj46.VxVnce = convertRawToPhysical(raw_value, 0.01, 0.0);

    raw_value=copyBitsFromByteArrayLE( byteArray, 24448, 12);
    @CAN_PrivMain::RFL_Object::RXX_Object_Obj46.VxVyCoVnce = convertRawToPhysical(raw_value, 0.01, 0.0);

    raw_value=copyBitsFromByteArrayLE( byteArray, 24270, 10);
    @CAN_PrivMain::RFL_Object::RXX_Object_Obj46.Vy = convertRawToPhysical(raw_value, 0.125, -64.0);

    raw_value=copyBitsFromByteArrayLE( byteArray, 24492, 12);
    @CAN_PrivMain::RFL_Object::RXX_Object_Obj46.VyAxCoVnce = convertRawToPhysical(raw_value, 0.01, 0.0);

    raw_value=copyBitsFromByteArrayLE( byteArray, 24512, 12);
    @CAN_PrivMain::RFL_Object::RXX_Object_Obj46.VyAyCoVnce = convertRawToPhysical(raw_value, 0.01, 0.0);

    raw_value=copyBitsFromByteArrayLE( byteArray, 24288, 12);
    @CAN_PrivMain::RFL_Object::RXX_Object_Obj46.VyVnce = convertRawToPhysical(raw_value, 0.01, 0.0);

    raw_value=copyBitsFromByteArrayLE( byteArray, 24184, 7);
    @CAN_PrivMain::RFL_Object::RXX_Object_Obj46.Width = convertRawToPhysical(raw_value, 0.125, 0.0);

    raw_value=copyBitsFromByteArrayLE( byteArray, 24192, 12);
    @CAN_PrivMain::RFL_Object::RXX_Object_Obj46.WidthVnce = convertRawToPhysical(raw_value, 0.01, 0.0);
}


void CRadarFL_RXX_Object_Obj47_SetDataReceived(byte byteArray[])
{
    qword raw_value;

    raw_value=copyBitsFromByteArrayLE( byteArray, 25056, 32);
    @CAN_PrivMain::RFL_Object::RXX_Object_Obj47.Age = convertRawToPhysical(raw_value, 1.0, 0.0);

    raw_value=copyBitsFromByteArrayLE( byteArray, 24652, 10);
    @CAN_PrivMain::RFL_Object::RXX_Object_Obj47.Ax = convertRawToPhysical(raw_value, 0.03125, -16.0);

    raw_value=copyBitsFromByteArrayLE( byteArray, 25036, 12);
    @CAN_PrivMain::RFL_Object::RXX_Object_Obj47.AxAyCoVnce = convertRawToPhysical(raw_value, 0.01, 0.0);

    raw_value=copyBitsFromByteArrayLE( byteArray, 24672, 12);
    @CAN_PrivMain::RFL_Object::RXX_Object_Obj47.AxVnce = convertRawToPhysical(raw_value, 0.01, 0.0);

    raw_value=copyBitsFromByteArrayLE( byteArray, 24726, 9);
    @CAN_PrivMain::RFL_Object::RXX_Object_Obj47.Ay = convertRawToPhysical(raw_value, 0.0625, -16.0);

    raw_value=copyBitsFromByteArrayLE( byteArray, 24736, 12);
    @CAN_PrivMain::RFL_Object::RXX_Object_Obj47.AyVnce = convertRawToPhysical(raw_value, 0.01, 0.0);

    raw_value=copyBitsFromByteArrayLE( byteArray, 24792, 6);
    @CAN_PrivMain::RFL_Object::RXX_Object_Obj47.ExistProb = convertRawToPhysical(raw_value, 2.0, 0.0);

    raw_value=copyBitsFromByteArrayLE( byteArray, 24856, 8);
    @CAN_PrivMain::RFL_Object::RXX_Object_Obj47.FilterInformation = convertRawToPhysical(raw_value, 1.0, 0.0);

    raw_value=copyBitsFromByteArrayLE( byteArray, 24632, 7);
    @CAN_PrivMain::RFL_Object::RXX_Object_Obj47.Length = convertRawToPhysical(raw_value, 0.125, 0.0);

    raw_value=copyBitsFromByteArrayLE( byteArray, 24640, 12);
    @CAN_PrivMain::RFL_Object::RXX_Object_Obj47.LengthVnce = convertRawToPhysical(raw_value, 0.01, 0.0);

    raw_value=copyBitsFromByteArrayLE( byteArray, 24824, 3);
    @CAN_PrivMain::RFL_Object::RXX_Object_Obj47.MeasurementStatus = convertRawToPhysical(raw_value, 1.0, 0.0);

    raw_value=copyBitsFromByteArrayLE( byteArray, 24780, 2);
    @CAN_PrivMain::RFL_Object::RXX_Object_Obj47.MovingStatus = convertRawToPhysical(raw_value, 1.0, 0.0);

    raw_value=copyBitsFromByteArrayLE( byteArray, 24760, 7);
    @CAN_PrivMain::RFL_Object::RXX_Object_Obj47.ObjId = convertRawToPhysical(raw_value, 1.0, 0.0);

    raw_value=copyBitsFromByteArrayLE( byteArray, 24662, 9);
    @CAN_PrivMain::RFL_Object::RXX_Object_Obj47.OrientationYaw = convertRawToPhysical(raw_value, 0.0175, -4.48);

    raw_value=copyBitsFromByteArrayLE( byteArray, 24684, 12);
    @CAN_PrivMain::RFL_Object::RXX_Object_Obj47.OrientationYawVnce = convertRawToPhysical(raw_value, 0.0003, 0.0);

    raw_value=copyBitsFromByteArrayLE( byteArray, 24576, 6);
    @CAN_PrivMain::RFL_Object::RXX_Object_Obj47.ProbClassConfidence = convertRawToPhysical(raw_value, 2.0, 0.0);

    raw_value=copyBitsFromByteArrayLE( byteArray, 24827, 4);
    @CAN_PrivMain::RFL_Object::RXX_Object_Obj47.ProbClassType = convertRawToPhysical(raw_value, 1.0, 0.0);

    raw_value=copyBitsFromByteArrayLE( byteArray, 24582, 14);
    @CAN_PrivMain::RFL_Object::RXX_Object_Obj47.Px = convertRawToPhysical(raw_value, 0.0625, -512.0);

    raw_value=copyBitsFromByteArrayLE( byteArray, 24896, 12);
    @CAN_PrivMain::RFL_Object::RXX_Object_Obj47.PxAxCoVnce = convertRawToPhysical(raw_value, 0.01, 0.0);

    raw_value=copyBitsFromByteArrayLE( byteArray, 24908, 12);
    @CAN_PrivMain::RFL_Object::RXX_Object_Obj47.PxAyCoVnce = convertRawToPhysical(raw_value, 0.01, 0.0);

    raw_value=copyBitsFromByteArrayLE( byteArray, 24812, 12);
    @CAN_PrivMain::RFL_Object::RXX_Object_Obj47.PxPyCoVnce = convertRawToPhysical(raw_value, 0.01, 0.0);

    raw_value=copyBitsFromByteArrayLE( byteArray, 24596, 12);
    @CAN_PrivMain::RFL_Object::RXX_Object_Obj47.PxVnce = convertRawToPhysical(raw_value, 0.1, 0.0);

    raw_value=copyBitsFromByteArrayLE( byteArray, 24832, 12);
    @CAN_PrivMain::RFL_Object::RXX_Object_Obj47.PxVxCoVnce = convertRawToPhysical(raw_value, 0.01, 0.0);

    raw_value=copyBitsFromByteArrayLE( byteArray, 24844, 12);
    @CAN_PrivMain::RFL_Object::RXX_Object_Obj47.PxVyCoVnce = convertRawToPhysical(raw_value, 0.01, 0.0);

    raw_value=copyBitsFromByteArrayLE( byteArray, 24608, 12);
    @CAN_PrivMain::RFL_Object::RXX_Object_Obj47.Py = convertRawToPhysical(raw_value, 0.0625, -128.0);

    raw_value=copyBitsFromByteArrayLE( byteArray, 24928, 12);
    @CAN_PrivMain::RFL_Object::RXX_Object_Obj47.PyAxCoVnce = convertRawToPhysical(raw_value, 0.01, 0.0);

    raw_value=copyBitsFromByteArrayLE( byteArray, 24940, 12);
    @CAN_PrivMain::RFL_Object::RXX_Object_Obj47.PyAyCoVnce = convertRawToPhysical(raw_value, 0.01, 0.0);

    raw_value=copyBitsFromByteArrayLE( byteArray, 24620, 12);
    @CAN_PrivMain::RFL_Object::RXX_Object_Obj47.PyVnce = convertRawToPhysical(raw_value, 0.1, 0.0);

    raw_value=copyBitsFromByteArrayLE( byteArray, 24864, 12);
    @CAN_PrivMain::RFL_Object::RXX_Object_Obj47.PyVxCoVnce = convertRawToPhysical(raw_value, 0.01, 0.0);

    raw_value=copyBitsFromByteArrayLE( byteArray, 24876, 12);
    @CAN_PrivMain::RFL_Object::RXX_Object_Obj47.PyVyCoVnce = convertRawToPhysical(raw_value, 0.01, 0.0);

    raw_value=copyBitsFromByteArrayLE( byteArray, 24716, 10);
    @CAN_PrivMain::RFL_Object::RXX_Object_Obj47.RCS = convertRawToPhysical(raw_value, 0.2, -102.4);

    raw_value=copyBitsFromByteArrayLE( byteArray, 24888, 4);
    @CAN_PrivMain::RFL_Object::RXX_Object_Obj47.ReferencePoint = convertRawToPhysical(raw_value, 1.0, 0.0);

    raw_value=copyBitsFromByteArrayLE( byteArray, 24748, 12);
    @CAN_PrivMain::RFL_Object::RXX_Object_Obj47.Vx = convertRawToPhysical(raw_value, 0.0625, -128.0);

    raw_value=copyBitsFromByteArrayLE( byteArray, 24972, 12);
    @CAN_PrivMain::RFL_Object::RXX_Object_Obj47.VxAxCoVnce = convertRawToPhysical(raw_value, 0.01, 0.0);

    raw_value=copyBitsFromByteArrayLE( byteArray, 24992, 12);
    @CAN_PrivMain::RFL_Object::RXX_Object_Obj47.VxAyCoVnce = convertRawToPhysical(raw_value, 0.01, 0.0);

    raw_value=copyBitsFromByteArrayLE( byteArray, 24768, 12);
    @CAN_PrivMain::RFL_Object::RXX_Object_Obj47.VxVnce = convertRawToPhysical(raw_value, 0.01, 0.0);

    raw_value=copyBitsFromByteArrayLE( byteArray, 24960, 12);
    @CAN_PrivMain::RFL_Object::RXX_Object_Obj47.VxVyCoVnce = convertRawToPhysical(raw_value, 0.01, 0.0);

    raw_value=copyBitsFromByteArrayLE( byteArray, 24782, 10);
    @CAN_PrivMain::RFL_Object::RXX_Object_Obj47.Vy = convertRawToPhysical(raw_value, 0.125, -64.0);

    raw_value=copyBitsFromByteArrayLE( byteArray, 25004, 12);
    @CAN_PrivMain::RFL_Object::RXX_Object_Obj47.VyAxCoVnce = convertRawToPhysical(raw_value, 0.01, 0.0);

    raw_value=copyBitsFromByteArrayLE( byteArray, 25024, 12);
    @CAN_PrivMain::RFL_Object::RXX_Object_Obj47.VyAyCoVnce = convertRawToPhysical(raw_value, 0.01, 0.0);

    raw_value=copyBitsFromByteArrayLE( byteArray, 24800, 12);
    @CAN_PrivMain::RFL_Object::RXX_Object_Obj47.VyVnce = convertRawToPhysical(raw_value, 0.01, 0.0);

    raw_value=copyBitsFromByteArrayLE( byteArray, 24696, 7);
    @CAN_PrivMain::RFL_Object::RXX_Object_Obj47.Width = convertRawToPhysical(raw_value, 0.125, 0.0);

    raw_value=copyBitsFromByteArrayLE( byteArray, 24704, 12);
    @CAN_PrivMain::RFL_Object::RXX_Object_Obj47.WidthVnce = convertRawToPhysical(raw_value, 0.01, 0.0);
}


void CRadarFL_RXX_Object_Obj48_SetDataReceived(byte byteArray[])
{
    qword raw_value;

    raw_value=copyBitsFromByteArrayLE( byteArray, 25568, 32);
    @CAN_PrivMain::RFL_Object::RXX_Object_Obj48.Age = convertRawToPhysical(raw_value, 1.0, 0.0);

    raw_value=copyBitsFromByteArrayLE( byteArray, 25164, 10);
    @CAN_PrivMain::RFL_Object::RXX_Object_Obj48.Ax = convertRawToPhysical(raw_value, 0.03125, -16.0);

    raw_value=copyBitsFromByteArrayLE( byteArray, 25548, 12);
    @CAN_PrivMain::RFL_Object::RXX_Object_Obj48.AxAyCoVnce = convertRawToPhysical(raw_value, 0.01, 0.0);

    raw_value=copyBitsFromByteArrayLE( byteArray, 25184, 12);
    @CAN_PrivMain::RFL_Object::RXX_Object_Obj48.AxVnce = convertRawToPhysical(raw_value, 0.01, 0.0);

    raw_value=copyBitsFromByteArrayLE( byteArray, 25238, 9);
    @CAN_PrivMain::RFL_Object::RXX_Object_Obj48.Ay = convertRawToPhysical(raw_value, 0.0625, -16.0);

    raw_value=copyBitsFromByteArrayLE( byteArray, 25248, 12);
    @CAN_PrivMain::RFL_Object::RXX_Object_Obj48.AyVnce = convertRawToPhysical(raw_value, 0.01, 0.0);

    raw_value=copyBitsFromByteArrayLE( byteArray, 25304, 6);
    @CAN_PrivMain::RFL_Object::RXX_Object_Obj48.ExistProb = convertRawToPhysical(raw_value, 2.0, 0.0);

    raw_value=copyBitsFromByteArrayLE( byteArray, 25368, 8);
    @CAN_PrivMain::RFL_Object::RXX_Object_Obj48.FilterInformation = convertRawToPhysical(raw_value, 1.0, 0.0);

    raw_value=copyBitsFromByteArrayLE( byteArray, 25144, 7);
    @CAN_PrivMain::RFL_Object::RXX_Object_Obj48.Length = convertRawToPhysical(raw_value, 0.125, 0.0);

    raw_value=copyBitsFromByteArrayLE( byteArray, 25152, 12);
    @CAN_PrivMain::RFL_Object::RXX_Object_Obj48.LengthVnce = convertRawToPhysical(raw_value, 0.01, 0.0);

    raw_value=copyBitsFromByteArrayLE( byteArray, 25336, 3);
    @CAN_PrivMain::RFL_Object::RXX_Object_Obj48.MeasurementStatus = convertRawToPhysical(raw_value, 1.0, 0.0);

    raw_value=copyBitsFromByteArrayLE( byteArray, 25292, 2);
    @CAN_PrivMain::RFL_Object::RXX_Object_Obj48.MovingStatus = convertRawToPhysical(raw_value, 1.0, 0.0);

    raw_value=copyBitsFromByteArrayLE( byteArray, 25272, 7);
    @CAN_PrivMain::RFL_Object::RXX_Object_Obj48.ObjId = convertRawToPhysical(raw_value, 1.0, 0.0);

    raw_value=copyBitsFromByteArrayLE( byteArray, 25174, 9);
    @CAN_PrivMain::RFL_Object::RXX_Object_Obj48.OrientationYaw = convertRawToPhysical(raw_value, 0.0175, -4.48);

    raw_value=copyBitsFromByteArrayLE( byteArray, 25196, 12);
    @CAN_PrivMain::RFL_Object::RXX_Object_Obj48.OrientationYawVnce = convertRawToPhysical(raw_value, 0.0003, 0.0);

    raw_value=copyBitsFromByteArrayLE( byteArray, 25088, 6);
    @CAN_PrivMain::RFL_Object::RXX_Object_Obj48.ProbClassConfidence = convertRawToPhysical(raw_value, 2.0, 0.0);

    raw_value=copyBitsFromByteArrayLE( byteArray, 25339, 4);
    @CAN_PrivMain::RFL_Object::RXX_Object_Obj48.ProbClassType = convertRawToPhysical(raw_value, 1.0, 0.0);

    raw_value=copyBitsFromByteArrayLE( byteArray, 25094, 14);
    @CAN_PrivMain::RFL_Object::RXX_Object_Obj48.Px = convertRawToPhysical(raw_value, 0.0625, -512.0);

    raw_value=copyBitsFromByteArrayLE( byteArray, 25408, 12);
    @CAN_PrivMain::RFL_Object::RXX_Object_Obj48.PxAxCoVnce = convertRawToPhysical(raw_value, 0.01, 0.0);

    raw_value=copyBitsFromByteArrayLE( byteArray, 25420, 12);
    @CAN_PrivMain::RFL_Object::RXX_Object_Obj48.PxAyCoVnce = convertRawToPhysical(raw_value, 0.01, 0.0);

    raw_value=copyBitsFromByteArrayLE( byteArray, 25324, 12);
    @CAN_PrivMain::RFL_Object::RXX_Object_Obj48.PxPyCoVnce = convertRawToPhysical(raw_value, 0.01, 0.0);

    raw_value=copyBitsFromByteArrayLE( byteArray, 25108, 12);
    @CAN_PrivMain::RFL_Object::RXX_Object_Obj48.PxVnce = convertRawToPhysical(raw_value, 0.1, 0.0);

    raw_value=copyBitsFromByteArrayLE( byteArray, 25344, 12);
    @CAN_PrivMain::RFL_Object::RXX_Object_Obj48.PxVxCoVnce = convertRawToPhysical(raw_value, 0.01, 0.0);

    raw_value=copyBitsFromByteArrayLE( byteArray, 25356, 12);
    @CAN_PrivMain::RFL_Object::RXX_Object_Obj48.PxVyCoVnce = convertRawToPhysical(raw_value, 0.01, 0.0);

    raw_value=copyBitsFromByteArrayLE( byteArray, 25120, 12);
    @CAN_PrivMain::RFL_Object::RXX_Object_Obj48.Py = convertRawToPhysical(raw_value, 0.0625, -128.0);

    raw_value=copyBitsFromByteArrayLE( byteArray, 25440, 12);
    @CAN_PrivMain::RFL_Object::RXX_Object_Obj48.PyAxCoVnce = convertRawToPhysical(raw_value, 0.01, 0.0);

    raw_value=copyBitsFromByteArrayLE( byteArray, 25452, 12);
    @CAN_PrivMain::RFL_Object::RXX_Object_Obj48.PyAyCoVnce = convertRawToPhysical(raw_value, 0.01, 0.0);

    raw_value=copyBitsFromByteArrayLE( byteArray, 25132, 12);
    @CAN_PrivMain::RFL_Object::RXX_Object_Obj48.PyVnce = convertRawToPhysical(raw_value, 0.1, 0.0);

    raw_value=copyBitsFromByteArrayLE( byteArray, 25376, 12);
    @CAN_PrivMain::RFL_Object::RXX_Object_Obj48.PyVxCoVnce = convertRawToPhysical(raw_value, 0.01, 0.0);

    raw_value=copyBitsFromByteArrayLE( byteArray, 25388, 12);
    @CAN_PrivMain::RFL_Object::RXX_Object_Obj48.PyVyCoVnce = convertRawToPhysical(raw_value, 0.01, 0.0);

    raw_value=copyBitsFromByteArrayLE( byteArray, 25228, 10);
    @CAN_PrivMain::RFL_Object::RXX_Object_Obj48.RCS = convertRawToPhysical(raw_value, 0.2, -102.4);

    raw_value=copyBitsFromByteArrayLE( byteArray, 25400, 4);
    @CAN_PrivMain::RFL_Object::RXX_Object_Obj48.ReferencePoint = convertRawToPhysical(raw_value, 1.0, 0.0);

    raw_value=copyBitsFromByteArrayLE( byteArray, 25260, 12);
    @CAN_PrivMain::RFL_Object::RXX_Object_Obj48.Vx = convertRawToPhysical(raw_value, 0.0625, -128.0);

    raw_value=copyBitsFromByteArrayLE( byteArray, 25484, 12);
    @CAN_PrivMain::RFL_Object::RXX_Object_Obj48.VxAxCoVnce = convertRawToPhysical(raw_value, 0.01, 0.0);

    raw_value=copyBitsFromByteArrayLE( byteArray, 25504, 12);
    @CAN_PrivMain::RFL_Object::RXX_Object_Obj48.VxAyCoVnce = convertRawToPhysical(raw_value, 0.01, 0.0);

    raw_value=copyBitsFromByteArrayLE( byteArray, 25280, 12);
    @CAN_PrivMain::RFL_Object::RXX_Object_Obj48.VxVnce = convertRawToPhysical(raw_value, 0.01, 0.0);

    raw_value=copyBitsFromByteArrayLE( byteArray, 25472, 12);
    @CAN_PrivMain::RFL_Object::RXX_Object_Obj48.VxVyCoVnce = convertRawToPhysical(raw_value, 0.01, 0.0);

    raw_value=copyBitsFromByteArrayLE( byteArray, 25294, 10);
    @CAN_PrivMain::RFL_Object::RXX_Object_Obj48.Vy = convertRawToPhysical(raw_value, 0.125, -64.0);

    raw_value=copyBitsFromByteArrayLE( byteArray, 25516, 12);
    @CAN_PrivMain::RFL_Object::RXX_Object_Obj48.VyAxCoVnce = convertRawToPhysical(raw_value, 0.01, 0.0);

    raw_value=copyBitsFromByteArrayLE( byteArray, 25536, 12);
    @CAN_PrivMain::RFL_Object::RXX_Object_Obj48.VyAyCoVnce = convertRawToPhysical(raw_value, 0.01, 0.0);

    raw_value=copyBitsFromByteArrayLE( byteArray, 25312, 12);
    @CAN_PrivMain::RFL_Object::RXX_Object_Obj48.VyVnce = convertRawToPhysical(raw_value, 0.01, 0.0);

    raw_value=copyBitsFromByteArrayLE( byteArray, 25208, 7);
    @CAN_PrivMain::RFL_Object::RXX_Object_Obj48.Width = convertRawToPhysical(raw_value, 0.125, 0.0);

    raw_value=copyBitsFromByteArrayLE( byteArray, 25216, 12);
    @CAN_PrivMain::RFL_Object::RXX_Object_Obj48.WidthVnce = convertRawToPhysical(raw_value, 0.01, 0.0);
}


void CRadarFL_RXX_Object_Obj49_SetDataReceived(byte byteArray[])
{
    qword raw_value;

    raw_value=copyBitsFromByteArrayLE( byteArray, 26080, 32);
    @CAN_PrivMain::RFL_Object::RXX_Object_Obj49.Age = convertRawToPhysical(raw_value, 1.0, 0.0);

    raw_value=copyBitsFromByteArrayLE( byteArray, 25676, 10);
    @CAN_PrivMain::RFL_Object::RXX_Object_Obj49.Ax = convertRawToPhysical(raw_value, 0.03125, -16.0);

    raw_value=copyBitsFromByteArrayLE( byteArray, 26060, 12);
    @CAN_PrivMain::RFL_Object::RXX_Object_Obj49.AxAyCoVnce = convertRawToPhysical(raw_value, 0.01, 0.0);

    raw_value=copyBitsFromByteArrayLE( byteArray, 25696, 12);
    @CAN_PrivMain::RFL_Object::RXX_Object_Obj49.AxVnce = convertRawToPhysical(raw_value, 0.01, 0.0);

    raw_value=copyBitsFromByteArrayLE( byteArray, 25750, 9);
    @CAN_PrivMain::RFL_Object::RXX_Object_Obj49.Ay = convertRawToPhysical(raw_value, 0.0625, -16.0);

    raw_value=copyBitsFromByteArrayLE( byteArray, 25760, 12);
    @CAN_PrivMain::RFL_Object::RXX_Object_Obj49.AyVnce = convertRawToPhysical(raw_value, 0.01, 0.0);

    raw_value=copyBitsFromByteArrayLE( byteArray, 25816, 6);
    @CAN_PrivMain::RFL_Object::RXX_Object_Obj49.ExistProb = convertRawToPhysical(raw_value, 2.0, 0.0);

    raw_value=copyBitsFromByteArrayLE( byteArray, 25880, 8);
    @CAN_PrivMain::RFL_Object::RXX_Object_Obj49.FilterInformation = convertRawToPhysical(raw_value, 1.0, 0.0);

    raw_value=copyBitsFromByteArrayLE( byteArray, 25656, 7);
    @CAN_PrivMain::RFL_Object::RXX_Object_Obj49.Length = convertRawToPhysical(raw_value, 0.125, 0.0);

    raw_value=copyBitsFromByteArrayLE( byteArray, 25664, 12);
    @CAN_PrivMain::RFL_Object::RXX_Object_Obj49.LengthVnce = convertRawToPhysical(raw_value, 0.01, 0.0);

    raw_value=copyBitsFromByteArrayLE( byteArray, 25848, 3);
    @CAN_PrivMain::RFL_Object::RXX_Object_Obj49.MeasurementStatus = convertRawToPhysical(raw_value, 1.0, 0.0);

    raw_value=copyBitsFromByteArrayLE( byteArray, 25804, 2);
    @CAN_PrivMain::RFL_Object::RXX_Object_Obj49.MovingStatus = convertRawToPhysical(raw_value, 1.0, 0.0);

    raw_value=copyBitsFromByteArrayLE( byteArray, 25784, 7);
    @CAN_PrivMain::RFL_Object::RXX_Object_Obj49.ObjId = convertRawToPhysical(raw_value, 1.0, 0.0);

    raw_value=copyBitsFromByteArrayLE( byteArray, 25686, 9);
    @CAN_PrivMain::RFL_Object::RXX_Object_Obj49.OrientationYaw = convertRawToPhysical(raw_value, 0.0175, -4.48);

    raw_value=copyBitsFromByteArrayLE( byteArray, 25708, 12);
    @CAN_PrivMain::RFL_Object::RXX_Object_Obj49.OrientationYawVnce = convertRawToPhysical(raw_value, 0.0003, 0.0);

    raw_value=copyBitsFromByteArrayLE( byteArray, 25600, 6);
    @CAN_PrivMain::RFL_Object::RXX_Object_Obj49.ProbClassConfidence = convertRawToPhysical(raw_value, 2.0, 0.0);

    raw_value=copyBitsFromByteArrayLE( byteArray, 25851, 4);
    @CAN_PrivMain::RFL_Object::RXX_Object_Obj49.ProbClassType = convertRawToPhysical(raw_value, 1.0, 0.0);

    raw_value=copyBitsFromByteArrayLE( byteArray, 25606, 14);
    @CAN_PrivMain::RFL_Object::RXX_Object_Obj49.Px = convertRawToPhysical(raw_value, 0.0625, -512.0);

    raw_value=copyBitsFromByteArrayLE( byteArray, 25920, 12);
    @CAN_PrivMain::RFL_Object::RXX_Object_Obj49.PxAxCoVnce = convertRawToPhysical(raw_value, 0.01, 0.0);

    raw_value=copyBitsFromByteArrayLE( byteArray, 25932, 12);
    @CAN_PrivMain::RFL_Object::RXX_Object_Obj49.PxAyCoVnce = convertRawToPhysical(raw_value, 0.01, 0.0);

    raw_value=copyBitsFromByteArrayLE( byteArray, 25836, 12);
    @CAN_PrivMain::RFL_Object::RXX_Object_Obj49.PxPyCoVnce = convertRawToPhysical(raw_value, 0.01, 0.0);

    raw_value=copyBitsFromByteArrayLE( byteArray, 25620, 12);
    @CAN_PrivMain::RFL_Object::RXX_Object_Obj49.PxVnce = convertRawToPhysical(raw_value, 0.1, 0.0);

    raw_value=copyBitsFromByteArrayLE( byteArray, 25856, 12);
    @CAN_PrivMain::RFL_Object::RXX_Object_Obj49.PxVxCoVnce = convertRawToPhysical(raw_value, 0.01, 0.0);

    raw_value=copyBitsFromByteArrayLE( byteArray, 25868, 12);
    @CAN_PrivMain::RFL_Object::RXX_Object_Obj49.PxVyCoVnce = convertRawToPhysical(raw_value, 0.01, 0.0);

    raw_value=copyBitsFromByteArrayLE( byteArray, 25632, 12);
    @CAN_PrivMain::RFL_Object::RXX_Object_Obj49.Py = convertRawToPhysical(raw_value, 0.0625, -128.0);

    raw_value=copyBitsFromByteArrayLE( byteArray, 25952, 12);
    @CAN_PrivMain::RFL_Object::RXX_Object_Obj49.PyAxCoVnce = convertRawToPhysical(raw_value, 0.01, 0.0);

    raw_value=copyBitsFromByteArrayLE( byteArray, 25964, 12);
    @CAN_PrivMain::RFL_Object::RXX_Object_Obj49.PyAyCoVnce = convertRawToPhysical(raw_value, 0.01, 0.0);

    raw_value=copyBitsFromByteArrayLE( byteArray, 25644, 12);
    @CAN_PrivMain::RFL_Object::RXX_Object_Obj49.PyVnce = convertRawToPhysical(raw_value, 0.1, 0.0);

    raw_value=copyBitsFromByteArrayLE( byteArray, 25888, 12);
    @CAN_PrivMain::RFL_Object::RXX_Object_Obj49.PyVxCoVnce = convertRawToPhysical(raw_value, 0.01, 0.0);

    raw_value=copyBitsFromByteArrayLE( byteArray, 25900, 12);
    @CAN_PrivMain::RFL_Object::RXX_Object_Obj49.PyVyCoVnce = convertRawToPhysical(raw_value, 0.01, 0.0);

    raw_value=copyBitsFromByteArrayLE( byteArray, 25740, 10);
    @CAN_PrivMain::RFL_Object::RXX_Object_Obj49.RCS = convertRawToPhysical(raw_value, 0.2, -102.4);

    raw_value=copyBitsFromByteArrayLE( byteArray, 25912, 4);
    @CAN_PrivMain::RFL_Object::RXX_Object_Obj49.ReferencePoint = convertRawToPhysical(raw_value, 1.0, 0.0);

    raw_value=copyBitsFromByteArrayLE( byteArray, 25772, 12);
    @CAN_PrivMain::RFL_Object::RXX_Object_Obj49.Vx = convertRawToPhysical(raw_value, 0.0625, -128.0);

    raw_value=copyBitsFromByteArrayLE( byteArray, 25996, 12);
    @CAN_PrivMain::RFL_Object::RXX_Object_Obj49.VxAxCoVnce = convertRawToPhysical(raw_value, 0.01, 0.0);

    raw_value=copyBitsFromByteArrayLE( byteArray, 26016, 12);
    @CAN_PrivMain::RFL_Object::RXX_Object_Obj49.VxAyCoVnce = convertRawToPhysical(raw_value, 0.01, 0.0);

    raw_value=copyBitsFromByteArrayLE( byteArray, 25792, 12);
    @CAN_PrivMain::RFL_Object::RXX_Object_Obj49.VxVnce = convertRawToPhysical(raw_value, 0.01, 0.0);

    raw_value=copyBitsFromByteArrayLE( byteArray, 25984, 12);
    @CAN_PrivMain::RFL_Object::RXX_Object_Obj49.VxVyCoVnce = convertRawToPhysical(raw_value, 0.01, 0.0);

    raw_value=copyBitsFromByteArrayLE( byteArray, 25806, 10);
    @CAN_PrivMain::RFL_Object::RXX_Object_Obj49.Vy = convertRawToPhysical(raw_value, 0.125, -64.0);

    raw_value=copyBitsFromByteArrayLE( byteArray, 26028, 12);
    @CAN_PrivMain::RFL_Object::RXX_Object_Obj49.VyAxCoVnce = convertRawToPhysical(raw_value, 0.01, 0.0);

    raw_value=copyBitsFromByteArrayLE( byteArray, 26048, 12);
    @CAN_PrivMain::RFL_Object::RXX_Object_Obj49.VyAyCoVnce = convertRawToPhysical(raw_value, 0.01, 0.0);

    raw_value=copyBitsFromByteArrayLE( byteArray, 25824, 12);
    @CAN_PrivMain::RFL_Object::RXX_Object_Obj49.VyVnce = convertRawToPhysical(raw_value, 0.01, 0.0);

    raw_value=copyBitsFromByteArrayLE( byteArray, 25720, 7);
    @CAN_PrivMain::RFL_Object::RXX_Object_Obj49.Width = convertRawToPhysical(raw_value, 0.125, 0.0);

    raw_value=copyBitsFromByteArrayLE( byteArray, 25728, 12);
    @CAN_PrivMain::RFL_Object::RXX_Object_Obj49.WidthVnce = convertRawToPhysical(raw_value, 0.01, 0.0);
}


void CRadarFL_RXX_Object_Obj5_SetDataReceived(byte byteArray[])
{
    qword raw_value;

    raw_value=copyBitsFromByteArrayLE( byteArray, 3552, 32);
    @CAN_PrivMain::RFL_Object::RXX_Object_Obj5.Age = convertRawToPhysical(raw_value, 1.0, 0.0);

    raw_value=copyBitsFromByteArrayLE( byteArray, 3148, 10);
    @CAN_PrivMain::RFL_Object::RXX_Object_Obj5.Ax = convertRawToPhysical(raw_value, 0.03125, -16.0);

    raw_value=copyBitsFromByteArrayLE( byteArray, 3532, 12);
    @CAN_PrivMain::RFL_Object::RXX_Object_Obj5.AxAyCoVnce = convertRawToPhysical(raw_value, 0.01, 0.0);

    raw_value=copyBitsFromByteArrayLE( byteArray, 3168, 12);
    @CAN_PrivMain::RFL_Object::RXX_Object_Obj5.AxVnce = convertRawToPhysical(raw_value, 0.01, 0.0);

    raw_value=copyBitsFromByteArrayLE( byteArray, 3222, 9);
    @CAN_PrivMain::RFL_Object::RXX_Object_Obj5.Ay = convertRawToPhysical(raw_value, 0.0625, -16.0);

    raw_value=copyBitsFromByteArrayLE( byteArray, 3232, 12);
    @CAN_PrivMain::RFL_Object::RXX_Object_Obj5.AyVnce = convertRawToPhysical(raw_value, 0.01, 0.0);

    raw_value=copyBitsFromByteArrayLE( byteArray, 3288, 6);
    @CAN_PrivMain::RFL_Object::RXX_Object_Obj5.ExistProb = convertRawToPhysical(raw_value, 2.0, 0.0);

    raw_value=copyBitsFromByteArrayLE( byteArray, 3352, 8);
    @CAN_PrivMain::RFL_Object::RXX_Object_Obj5.FilterInformation = convertRawToPhysical(raw_value, 1.0, 0.0);

    raw_value=copyBitsFromByteArrayLE( byteArray, 3128, 7);
    @CAN_PrivMain::RFL_Object::RXX_Object_Obj5.Length = convertRawToPhysical(raw_value, 0.125, 0.0);

    raw_value=copyBitsFromByteArrayLE( byteArray, 3136, 12);
    @CAN_PrivMain::RFL_Object::RXX_Object_Obj5.LengthVnce = convertRawToPhysical(raw_value, 0.01, 0.0);

    raw_value=copyBitsFromByteArrayLE( byteArray, 3320, 3);
    @CAN_PrivMain::RFL_Object::RXX_Object_Obj5.MeasurementStatus = convertRawToPhysical(raw_value, 1.0, 0.0);

    raw_value=copyBitsFromByteArrayLE( byteArray, 3276, 2);
    @CAN_PrivMain::RFL_Object::RXX_Object_Obj5.MovingStatus = convertRawToPhysical(raw_value, 1.0, 0.0);

    raw_value=copyBitsFromByteArrayLE( byteArray, 3256, 7);
    @CAN_PrivMain::RFL_Object::RXX_Object_Obj5.ObjId = convertRawToPhysical(raw_value, 1.0, 0.0);

    raw_value=copyBitsFromByteArrayLE( byteArray, 3158, 9);
    @CAN_PrivMain::RFL_Object::RXX_Object_Obj5.OrientationYaw = convertRawToPhysical(raw_value, 0.0175, -4.48);

    raw_value=copyBitsFromByteArrayLE( byteArray, 3180, 12);
    @CAN_PrivMain::RFL_Object::RXX_Object_Obj5.OrientationYawVnce = convertRawToPhysical(raw_value, 0.0003, 0.0);

    raw_value=copyBitsFromByteArrayLE( byteArray, 3072, 6);
    @CAN_PrivMain::RFL_Object::RXX_Object_Obj5.ProbClassConfidence = convertRawToPhysical(raw_value, 2.0, 0.0);

    raw_value=copyBitsFromByteArrayLE( byteArray, 3323, 4);
    @CAN_PrivMain::RFL_Object::RXX_Object_Obj5.ProbClassType = convertRawToPhysical(raw_value, 1.0, 0.0);

    raw_value=copyBitsFromByteArrayLE( byteArray, 3078, 14);
    @CAN_PrivMain::RFL_Object::RXX_Object_Obj5.Px = convertRawToPhysical(raw_value, 0.0625, -512.0);

    raw_value=copyBitsFromByteArrayLE( byteArray, 3392, 12);
    @CAN_PrivMain::RFL_Object::RXX_Object_Obj5.PxAxCoVnce = convertRawToPhysical(raw_value, 0.01, 0.0);

    raw_value=copyBitsFromByteArrayLE( byteArray, 3404, 12);
    @CAN_PrivMain::RFL_Object::RXX_Object_Obj5.PxAyCoVnce = convertRawToPhysical(raw_value, 0.01, 0.0);

    raw_value=copyBitsFromByteArrayLE( byteArray, 3308, 12);
    @CAN_PrivMain::RFL_Object::RXX_Object_Obj5.PxPyCoVnce = convertRawToPhysical(raw_value, 0.01, 0.0);

    raw_value=copyBitsFromByteArrayLE( byteArray, 3092, 12);
    @CAN_PrivMain::RFL_Object::RXX_Object_Obj5.PxVnce = convertRawToPhysical(raw_value, 0.1, 0.0);

    raw_value=copyBitsFromByteArrayLE( byteArray, 3328, 12);
    @CAN_PrivMain::RFL_Object::RXX_Object_Obj5.PxVxCoVnce = convertRawToPhysical(raw_value, 0.01, 0.0);

    raw_value=copyBitsFromByteArrayLE( byteArray, 3340, 12);
    @CAN_PrivMain::RFL_Object::RXX_Object_Obj5.PxVyCoVnce = convertRawToPhysical(raw_value, 0.01, 0.0);

    raw_value=copyBitsFromByteArrayLE( byteArray, 3104, 12);
    @CAN_PrivMain::RFL_Object::RXX_Object_Obj5.Py = convertRawToPhysical(raw_value, 0.0625, -128.0);

    raw_value=copyBitsFromByteArrayLE( byteArray, 3424, 12);
    @CAN_PrivMain::RFL_Object::RXX_Object_Obj5.PyAxCoVnce = convertRawToPhysical(raw_value, 0.01, 0.0);

    raw_value=copyBitsFromByteArrayLE( byteArray, 3436, 12);
    @CAN_PrivMain::RFL_Object::RXX_Object_Obj5.PyAyCoVnce = convertRawToPhysical(raw_value, 0.01, 0.0);

    raw_value=copyBitsFromByteArrayLE( byteArray, 3116, 12);
    @CAN_PrivMain::RFL_Object::RXX_Object_Obj5.PyVnce = convertRawToPhysical(raw_value, 0.1, 0.0);

    raw_value=copyBitsFromByteArrayLE( byteArray, 3360, 12);
    @CAN_PrivMain::RFL_Object::RXX_Object_Obj5.PyVxCoVnce = convertRawToPhysical(raw_value, 0.01, 0.0);

    raw_value=copyBitsFromByteArrayLE( byteArray, 3372, 12);
    @CAN_PrivMain::RFL_Object::RXX_Object_Obj5.PyVyCoVnce = convertRawToPhysical(raw_value, 0.01, 0.0);

    raw_value=copyBitsFromByteArrayLE( byteArray, 3212, 10);
    @CAN_PrivMain::RFL_Object::RXX_Object_Obj5.RCS = convertRawToPhysical(raw_value, 0.2, -102.4);

    raw_value=copyBitsFromByteArrayLE( byteArray, 3384, 4);
    @CAN_PrivMain::RFL_Object::RXX_Object_Obj5.ReferencePoint = convertRawToPhysical(raw_value, 1.0, 0.0);

    raw_value=copyBitsFromByteArrayLE( byteArray, 3244, 12);
    @CAN_PrivMain::RFL_Object::RXX_Object_Obj5.Vx = convertRawToPhysical(raw_value, 0.0625, -128.0);

    raw_value=copyBitsFromByteArrayLE( byteArray, 3468, 12);
    @CAN_PrivMain::RFL_Object::RXX_Object_Obj5.VxAxCoVnce = convertRawToPhysical(raw_value, 0.01, 0.0);

    raw_value=copyBitsFromByteArrayLE( byteArray, 3488, 12);
    @CAN_PrivMain::RFL_Object::RXX_Object_Obj5.VxAyCoVnce = convertRawToPhysical(raw_value, 0.01, 0.0);

    raw_value=copyBitsFromByteArrayLE( byteArray, 3264, 12);
    @CAN_PrivMain::RFL_Object::RXX_Object_Obj5.VxVnce = convertRawToPhysical(raw_value, 0.01, 0.0);

    raw_value=copyBitsFromByteArrayLE( byteArray, 3456, 12);
    @CAN_PrivMain::RFL_Object::RXX_Object_Obj5.VxVyCoVnce = convertRawToPhysical(raw_value, 0.01, 0.0);

    raw_value=copyBitsFromByteArrayLE( byteArray, 3278, 10);
    @CAN_PrivMain::RFL_Object::RXX_Object_Obj5.Vy = convertRawToPhysical(raw_value, 0.125, -64.0);

    raw_value=copyBitsFromByteArrayLE( byteArray, 3500, 12);
    @CAN_PrivMain::RFL_Object::RXX_Object_Obj5.VyAxCoVnce = convertRawToPhysical(raw_value, 0.01, 0.0);

    raw_value=copyBitsFromByteArrayLE( byteArray, 3520, 12);
    @CAN_PrivMain::RFL_Object::RXX_Object_Obj5.VyAyCoVnce = convertRawToPhysical(raw_value, 0.01, 0.0);

    raw_value=copyBitsFromByteArrayLE( byteArray, 3296, 12);
    @CAN_PrivMain::RFL_Object::RXX_Object_Obj5.VyVnce = convertRawToPhysical(raw_value, 0.01, 0.0);

    raw_value=copyBitsFromByteArrayLE( byteArray, 3192, 7);
    @CAN_PrivMain::RFL_Object::RXX_Object_Obj5.Width = convertRawToPhysical(raw_value, 0.125, 0.0);

    raw_value=copyBitsFromByteArrayLE( byteArray, 3200, 12);
    @CAN_PrivMain::RFL_Object::RXX_Object_Obj5.WidthVnce = convertRawToPhysical(raw_value, 0.01, 0.0);
}


void CRadarFL_RXX_Object_Obj6_SetDataReceived(byte byteArray[])
{
    qword raw_value;

    raw_value=copyBitsFromByteArrayLE( byteArray, 4064, 32);
    @CAN_PrivMain::RFL_Object::RXX_Object_Obj6.Age = convertRawToPhysical(raw_value, 1.0, 0.0);

    raw_value=copyBitsFromByteArrayLE( byteArray, 3660, 10);
    @CAN_PrivMain::RFL_Object::RXX_Object_Obj6.Ax = convertRawToPhysical(raw_value, 0.03125, -16.0);

    raw_value=copyBitsFromByteArrayLE( byteArray, 4044, 12);
    @CAN_PrivMain::RFL_Object::RXX_Object_Obj6.AxAyCoVnce = convertRawToPhysical(raw_value, 0.01, 0.0);

    raw_value=copyBitsFromByteArrayLE( byteArray, 3680, 12);
    @CAN_PrivMain::RFL_Object::RXX_Object_Obj6.AxVnce = convertRawToPhysical(raw_value, 0.01, 0.0);

    raw_value=copyBitsFromByteArrayLE( byteArray, 3734, 9);
    @CAN_PrivMain::RFL_Object::RXX_Object_Obj6.Ay = convertRawToPhysical(raw_value, 0.0625, -16.0);

    raw_value=copyBitsFromByteArrayLE( byteArray, 3744, 12);
    @CAN_PrivMain::RFL_Object::RXX_Object_Obj6.AyVnce = convertRawToPhysical(raw_value, 0.01, 0.0);

    raw_value=copyBitsFromByteArrayLE( byteArray, 3800, 6);
    @CAN_PrivMain::RFL_Object::RXX_Object_Obj6.ExistProb = convertRawToPhysical(raw_value, 2.0, 0.0);

    raw_value=copyBitsFromByteArrayLE( byteArray, 3864, 8);
    @CAN_PrivMain::RFL_Object::RXX_Object_Obj6.FilterInformation = convertRawToPhysical(raw_value, 1.0, 0.0);

    raw_value=copyBitsFromByteArrayLE( byteArray, 3640, 7);
    @CAN_PrivMain::RFL_Object::RXX_Object_Obj6.Length = convertRawToPhysical(raw_value, 0.125, 0.0);

    raw_value=copyBitsFromByteArrayLE( byteArray, 3648, 12);
    @CAN_PrivMain::RFL_Object::RXX_Object_Obj6.LengthVnce = convertRawToPhysical(raw_value, 0.01, 0.0);

    raw_value=copyBitsFromByteArrayLE( byteArray, 3832, 3);
    @CAN_PrivMain::RFL_Object::RXX_Object_Obj6.MeasurementStatus = convertRawToPhysical(raw_value, 1.0, 0.0);

    raw_value=copyBitsFromByteArrayLE( byteArray, 3788, 2);
    @CAN_PrivMain::RFL_Object::RXX_Object_Obj6.MovingStatus = convertRawToPhysical(raw_value, 1.0, 0.0);

    raw_value=copyBitsFromByteArrayLE( byteArray, 3768, 7);
    @CAN_PrivMain::RFL_Object::RXX_Object_Obj6.ObjId = convertRawToPhysical(raw_value, 1.0, 0.0);

    raw_value=copyBitsFromByteArrayLE( byteArray, 3670, 9);
    @CAN_PrivMain::RFL_Object::RXX_Object_Obj6.OrientationYaw = convertRawToPhysical(raw_value, 0.0175, -4.48);

    raw_value=copyBitsFromByteArrayLE( byteArray, 3692, 12);
    @CAN_PrivMain::RFL_Object::RXX_Object_Obj6.OrientationYawVnce = convertRawToPhysical(raw_value, 0.0003, 0.0);

    raw_value=copyBitsFromByteArrayLE( byteArray, 3584, 6);
    @CAN_PrivMain::RFL_Object::RXX_Object_Obj6.ProbClassConfidence = convertRawToPhysical(raw_value, 2.0, 0.0);

    raw_value=copyBitsFromByteArrayLE( byteArray, 3835, 4);
    @CAN_PrivMain::RFL_Object::RXX_Object_Obj6.ProbClassType = convertRawToPhysical(raw_value, 1.0, 0.0);

    raw_value=copyBitsFromByteArrayLE( byteArray, 3590, 14);
    @CAN_PrivMain::RFL_Object::RXX_Object_Obj6.Px = convertRawToPhysical(raw_value, 0.0625, -512.0);

    raw_value=copyBitsFromByteArrayLE( byteArray, 3904, 12);
    @CAN_PrivMain::RFL_Object::RXX_Object_Obj6.PxAxCoVnce = convertRawToPhysical(raw_value, 0.01, 0.0);

    raw_value=copyBitsFromByteArrayLE( byteArray, 3916, 12);
    @CAN_PrivMain::RFL_Object::RXX_Object_Obj6.PxAyCoVnce = convertRawToPhysical(raw_value, 0.01, 0.0);

    raw_value=copyBitsFromByteArrayLE( byteArray, 3820, 12);
    @CAN_PrivMain::RFL_Object::RXX_Object_Obj6.PxPyCoVnce = convertRawToPhysical(raw_value, 0.01, 0.0);

    raw_value=copyBitsFromByteArrayLE( byteArray, 3604, 12);
    @CAN_PrivMain::RFL_Object::RXX_Object_Obj6.PxVnce = convertRawToPhysical(raw_value, 0.1, 0.0);

    raw_value=copyBitsFromByteArrayLE( byteArray, 3840, 12);
    @CAN_PrivMain::RFL_Object::RXX_Object_Obj6.PxVxCoVnce = convertRawToPhysical(raw_value, 0.01, 0.0);

    raw_value=copyBitsFromByteArrayLE( byteArray, 3852, 12);
    @CAN_PrivMain::RFL_Object::RXX_Object_Obj6.PxVyCoVnce = convertRawToPhysical(raw_value, 0.01, 0.0);

    raw_value=copyBitsFromByteArrayLE( byteArray, 3616, 12);
    @CAN_PrivMain::RFL_Object::RXX_Object_Obj6.Py = convertRawToPhysical(raw_value, 0.0625, -128.0);

    raw_value=copyBitsFromByteArrayLE( byteArray, 3936, 12);
    @CAN_PrivMain::RFL_Object::RXX_Object_Obj6.PyAxCoVnce = convertRawToPhysical(raw_value, 0.01, 0.0);

    raw_value=copyBitsFromByteArrayLE( byteArray, 3948, 12);
    @CAN_PrivMain::RFL_Object::RXX_Object_Obj6.PyAyCoVnce = convertRawToPhysical(raw_value, 0.01, 0.0);

    raw_value=copyBitsFromByteArrayLE( byteArray, 3628, 12);
    @CAN_PrivMain::RFL_Object::RXX_Object_Obj6.PyVnce = convertRawToPhysical(raw_value, 0.1, 0.0);

    raw_value=copyBitsFromByteArrayLE( byteArray, 3872, 12);
    @CAN_PrivMain::RFL_Object::RXX_Object_Obj6.PyVxCoVnce = convertRawToPhysical(raw_value, 0.01, 0.0);

    raw_value=copyBitsFromByteArrayLE( byteArray, 3884, 12);
    @CAN_PrivMain::RFL_Object::RXX_Object_Obj6.PyVyCoVnce = convertRawToPhysical(raw_value, 0.01, 0.0);

    raw_value=copyBitsFromByteArrayLE( byteArray, 3724, 10);
    @CAN_PrivMain::RFL_Object::RXX_Object_Obj6.RCS = convertRawToPhysical(raw_value, 0.2, -102.4);

    raw_value=copyBitsFromByteArrayLE( byteArray, 3896, 4);
    @CAN_PrivMain::RFL_Object::RXX_Object_Obj6.ReferencePoint = convertRawToPhysical(raw_value, 1.0, 0.0);

    raw_value=copyBitsFromByteArrayLE( byteArray, 3756, 12);
    @CAN_PrivMain::RFL_Object::RXX_Object_Obj6.Vx = convertRawToPhysical(raw_value, 0.0625, -128.0);

    raw_value=copyBitsFromByteArrayLE( byteArray, 3980, 12);
    @CAN_PrivMain::RFL_Object::RXX_Object_Obj6.VxAxCoVnce = convertRawToPhysical(raw_value, 0.01, 0.0);

    raw_value=copyBitsFromByteArrayLE( byteArray, 4000, 12);
    @CAN_PrivMain::RFL_Object::RXX_Object_Obj6.VxAyCoVnce = convertRawToPhysical(raw_value, 0.01, 0.0);

    raw_value=copyBitsFromByteArrayLE( byteArray, 3776, 12);
    @CAN_PrivMain::RFL_Object::RXX_Object_Obj6.VxVnce = convertRawToPhysical(raw_value, 0.01, 0.0);

    raw_value=copyBitsFromByteArrayLE( byteArray, 3968, 12);
    @CAN_PrivMain::RFL_Object::RXX_Object_Obj6.VxVyCoVnce = convertRawToPhysical(raw_value, 0.01, 0.0);

    raw_value=copyBitsFromByteArrayLE( byteArray, 3790, 10);
    @CAN_PrivMain::RFL_Object::RXX_Object_Obj6.Vy = convertRawToPhysical(raw_value, 0.125, -64.0);

    raw_value=copyBitsFromByteArrayLE( byteArray, 4012, 12);
    @CAN_PrivMain::RFL_Object::RXX_Object_Obj6.VyAxCoVnce = convertRawToPhysical(raw_value, 0.01, 0.0);

    raw_value=copyBitsFromByteArrayLE( byteArray, 4032, 12);
    @CAN_PrivMain::RFL_Object::RXX_Object_Obj6.VyAyCoVnce = convertRawToPhysical(raw_value, 0.01, 0.0);

    raw_value=copyBitsFromByteArrayLE( byteArray, 3808, 12);
    @CAN_PrivMain::RFL_Object::RXX_Object_Obj6.VyVnce = convertRawToPhysical(raw_value, 0.01, 0.0);

    raw_value=copyBitsFromByteArrayLE( byteArray, 3704, 7);
    @CAN_PrivMain::RFL_Object::RXX_Object_Obj6.Width = convertRawToPhysical(raw_value, 0.125, 0.0);

    raw_value=copyBitsFromByteArrayLE( byteArray, 3712, 12);
    @CAN_PrivMain::RFL_Object::RXX_Object_Obj6.WidthVnce = convertRawToPhysical(raw_value, 0.01, 0.0);
}


void CRadarFL_RXX_Object_Obj7_SetDataReceived(byte byteArray[])
{
    qword raw_value;

    raw_value=copyBitsFromByteArrayLE( byteArray, 4576, 32);
    @CAN_PrivMain::RFL_Object::RXX_Object_Obj7.Age = convertRawToPhysical(raw_value, 1.0, 0.0);

    raw_value=copyBitsFromByteArrayLE( byteArray, 4172, 10);
    @CAN_PrivMain::RFL_Object::RXX_Object_Obj7.Ax = convertRawToPhysical(raw_value, 0.03125, -16.0);

    raw_value=copyBitsFromByteArrayLE( byteArray, 4556, 12);
    @CAN_PrivMain::RFL_Object::RXX_Object_Obj7.AxAyCoVnce = convertRawToPhysical(raw_value, 0.01, 0.0);

    raw_value=copyBitsFromByteArrayLE( byteArray, 4192, 12);
    @CAN_PrivMain::RFL_Object::RXX_Object_Obj7.AxVnce = convertRawToPhysical(raw_value, 0.01, 0.0);

    raw_value=copyBitsFromByteArrayLE( byteArray, 4246, 9);
    @CAN_PrivMain::RFL_Object::RXX_Object_Obj7.Ay = convertRawToPhysical(raw_value, 0.0625, -16.0);

    raw_value=copyBitsFromByteArrayLE( byteArray, 4256, 12);
    @CAN_PrivMain::RFL_Object::RXX_Object_Obj7.AyVnce = convertRawToPhysical(raw_value, 0.01, 0.0);

    raw_value=copyBitsFromByteArrayLE( byteArray, 4312, 6);
    @CAN_PrivMain::RFL_Object::RXX_Object_Obj7.ExistProb = convertRawToPhysical(raw_value, 2.0, 0.0);

    raw_value=copyBitsFromByteArrayLE( byteArray, 4376, 8);
    @CAN_PrivMain::RFL_Object::RXX_Object_Obj7.FilterInformation = convertRawToPhysical(raw_value, 1.0, 0.0);

    raw_value=copyBitsFromByteArrayLE( byteArray, 4152, 7);
    @CAN_PrivMain::RFL_Object::RXX_Object_Obj7.Length = convertRawToPhysical(raw_value, 0.125, 0.0);

    raw_value=copyBitsFromByteArrayLE( byteArray, 4160, 12);
    @CAN_PrivMain::RFL_Object::RXX_Object_Obj7.LengthVnce = convertRawToPhysical(raw_value, 0.01, 0.0);

    raw_value=copyBitsFromByteArrayLE( byteArray, 4344, 3);
    @CAN_PrivMain::RFL_Object::RXX_Object_Obj7.MeasurementStatus = convertRawToPhysical(raw_value, 1.0, 0.0);

    raw_value=copyBitsFromByteArrayLE( byteArray, 4300, 2);
    @CAN_PrivMain::RFL_Object::RXX_Object_Obj7.MovingStatus = convertRawToPhysical(raw_value, 1.0, 0.0);

    raw_value=copyBitsFromByteArrayLE( byteArray, 4280, 7);
    @CAN_PrivMain::RFL_Object::RXX_Object_Obj7.ObjId = convertRawToPhysical(raw_value, 1.0, 0.0);

    raw_value=copyBitsFromByteArrayLE( byteArray, 4182, 9);
    @CAN_PrivMain::RFL_Object::RXX_Object_Obj7.OrientationYaw = convertRawToPhysical(raw_value, 0.0175, -4.48);

    raw_value=copyBitsFromByteArrayLE( byteArray, 4204, 12);
    @CAN_PrivMain::RFL_Object::RXX_Object_Obj7.OrientationYawVnce = convertRawToPhysical(raw_value, 0.0003, 0.0);

    raw_value=copyBitsFromByteArrayLE( byteArray, 4096, 6);
    @CAN_PrivMain::RFL_Object::RXX_Object_Obj7.ProbClassConfidence = convertRawToPhysical(raw_value, 2.0, 0.0);

    raw_value=copyBitsFromByteArrayLE( byteArray, 4347, 4);
    @CAN_PrivMain::RFL_Object::RXX_Object_Obj7.ProbClassType = convertRawToPhysical(raw_value, 1.0, 0.0);

    raw_value=copyBitsFromByteArrayLE( byteArray, 4102, 14);
    @CAN_PrivMain::RFL_Object::RXX_Object_Obj7.Px = convertRawToPhysical(raw_value, 0.0625, -512.0);

    raw_value=copyBitsFromByteArrayLE( byteArray, 4416, 12);
    @CAN_PrivMain::RFL_Object::RXX_Object_Obj7.PxAxCoVnce = convertRawToPhysical(raw_value, 0.01, 0.0);

    raw_value=copyBitsFromByteArrayLE( byteArray, 4428, 12);
    @CAN_PrivMain::RFL_Object::RXX_Object_Obj7.PxAyCoVnce = convertRawToPhysical(raw_value, 0.01, 0.0);

    raw_value=copyBitsFromByteArrayLE( byteArray, 4332, 12);
    @CAN_PrivMain::RFL_Object::RXX_Object_Obj7.PxPyCoVnce = convertRawToPhysical(raw_value, 0.01, 0.0);

    raw_value=copyBitsFromByteArrayLE( byteArray, 4116, 12);
    @CAN_PrivMain::RFL_Object::RXX_Object_Obj7.PxVnce = convertRawToPhysical(raw_value, 0.1, 0.0);

    raw_value=copyBitsFromByteArrayLE( byteArray, 4352, 12);
    @CAN_PrivMain::RFL_Object::RXX_Object_Obj7.PxVxCoVnce = convertRawToPhysical(raw_value, 0.01, 0.0);

    raw_value=copyBitsFromByteArrayLE( byteArray, 4364, 12);
    @CAN_PrivMain::RFL_Object::RXX_Object_Obj7.PxVyCoVnce = convertRawToPhysical(raw_value, 0.01, 0.0);

    raw_value=copyBitsFromByteArrayLE( byteArray, 4128, 12);
    @CAN_PrivMain::RFL_Object::RXX_Object_Obj7.Py = convertRawToPhysical(raw_value, 0.0625, -128.0);

    raw_value=copyBitsFromByteArrayLE( byteArray, 4448, 12);
    @CAN_PrivMain::RFL_Object::RXX_Object_Obj7.PyAxCoVnce = convertRawToPhysical(raw_value, 0.01, 0.0);

    raw_value=copyBitsFromByteArrayLE( byteArray, 4460, 12);
    @CAN_PrivMain::RFL_Object::RXX_Object_Obj7.PyAyCoVnce = convertRawToPhysical(raw_value, 0.01, 0.0);

    raw_value=copyBitsFromByteArrayLE( byteArray, 4140, 12);
    @CAN_PrivMain::RFL_Object::RXX_Object_Obj7.PyVnce = convertRawToPhysical(raw_value, 0.1, 0.0);

    raw_value=copyBitsFromByteArrayLE( byteArray, 4384, 12);
    @CAN_PrivMain::RFL_Object::RXX_Object_Obj7.PyVxCoVnce = convertRawToPhysical(raw_value, 0.01, 0.0);

    raw_value=copyBitsFromByteArrayLE( byteArray, 4396, 12);
    @CAN_PrivMain::RFL_Object::RXX_Object_Obj7.PyVyCoVnce = convertRawToPhysical(raw_value, 0.01, 0.0);

    raw_value=copyBitsFromByteArrayLE( byteArray, 4236, 10);
    @CAN_PrivMain::RFL_Object::RXX_Object_Obj7.RCS = convertRawToPhysical(raw_value, 0.2, -102.4);

    raw_value=copyBitsFromByteArrayLE( byteArray, 4408, 4);
    @CAN_PrivMain::RFL_Object::RXX_Object_Obj7.ReferencePoint = convertRawToPhysical(raw_value, 1.0, 0.0);

    raw_value=copyBitsFromByteArrayLE( byteArray, 4268, 12);
    @CAN_PrivMain::RFL_Object::RXX_Object_Obj7.Vx = convertRawToPhysical(raw_value, 0.0625, -128.0);

    raw_value=copyBitsFromByteArrayLE( byteArray, 4492, 12);
    @CAN_PrivMain::RFL_Object::RXX_Object_Obj7.VxAxCoVnce = convertRawToPhysical(raw_value, 0.01, 0.0);

    raw_value=copyBitsFromByteArrayLE( byteArray, 4512, 12);
    @CAN_PrivMain::RFL_Object::RXX_Object_Obj7.VxAyCoVnce = convertRawToPhysical(raw_value, 0.01, 0.0);

    raw_value=copyBitsFromByteArrayLE( byteArray, 4288, 12);
    @CAN_PrivMain::RFL_Object::RXX_Object_Obj7.VxVnce = convertRawToPhysical(raw_value, 0.01, 0.0);

    raw_value=copyBitsFromByteArrayLE( byteArray, 4480, 12);
    @CAN_PrivMain::RFL_Object::RXX_Object_Obj7.VxVyCoVnce = convertRawToPhysical(raw_value, 0.01, 0.0);

    raw_value=copyBitsFromByteArrayLE( byteArray, 4302, 10);
    @CAN_PrivMain::RFL_Object::RXX_Object_Obj7.Vy = convertRawToPhysical(raw_value, 0.125, -64.0);

    raw_value=copyBitsFromByteArrayLE( byteArray, 4524, 12);
    @CAN_PrivMain::RFL_Object::RXX_Object_Obj7.VyAxCoVnce = convertRawToPhysical(raw_value, 0.01, 0.0);

    raw_value=copyBitsFromByteArrayLE( byteArray, 4544, 12);
    @CAN_PrivMain::RFL_Object::RXX_Object_Obj7.VyAyCoVnce = convertRawToPhysical(raw_value, 0.01, 0.0);

    raw_value=copyBitsFromByteArrayLE( byteArray, 4320, 12);
    @CAN_PrivMain::RFL_Object::RXX_Object_Obj7.VyVnce = convertRawToPhysical(raw_value, 0.01, 0.0);

    raw_value=copyBitsFromByteArrayLE( byteArray, 4216, 7);
    @CAN_PrivMain::RFL_Object::RXX_Object_Obj7.Width = convertRawToPhysical(raw_value, 0.125, 0.0);

    raw_value=copyBitsFromByteArrayLE( byteArray, 4224, 12);
    @CAN_PrivMain::RFL_Object::RXX_Object_Obj7.WidthVnce = convertRawToPhysical(raw_value, 0.01, 0.0);
}


void CRadarFL_RXX_Object_Obj8_SetDataReceived(byte byteArray[])
{
    qword raw_value;

    raw_value=copyBitsFromByteArrayLE( byteArray, 5088, 32);
    @CAN_PrivMain::RFL_Object::RXX_Object_Obj8.Age = convertRawToPhysical(raw_value, 1.0, 0.0);

    raw_value=copyBitsFromByteArrayLE( byteArray, 4684, 10);
    @CAN_PrivMain::RFL_Object::RXX_Object_Obj8.Ax = convertRawToPhysical(raw_value, 0.03125, -16.0);

    raw_value=copyBitsFromByteArrayLE( byteArray, 5068, 12);
    @CAN_PrivMain::RFL_Object::RXX_Object_Obj8.AxAyCoVnce = convertRawToPhysical(raw_value, 0.01, 0.0);

    raw_value=copyBitsFromByteArrayLE( byteArray, 4704, 12);
    @CAN_PrivMain::RFL_Object::RXX_Object_Obj8.AxVnce = convertRawToPhysical(raw_value, 0.01, 0.0);

    raw_value=copyBitsFromByteArrayLE( byteArray, 4758, 9);
    @CAN_PrivMain::RFL_Object::RXX_Object_Obj8.Ay = convertRawToPhysical(raw_value, 0.0625, -16.0);

    raw_value=copyBitsFromByteArrayLE( byteArray, 4768, 12);
    @CAN_PrivMain::RFL_Object::RXX_Object_Obj8.AyVnce = convertRawToPhysical(raw_value, 0.01, 0.0);

    raw_value=copyBitsFromByteArrayLE( byteArray, 4824, 6);
    @CAN_PrivMain::RFL_Object::RXX_Object_Obj8.ExistProb = convertRawToPhysical(raw_value, 2.0, 0.0);

    raw_value=copyBitsFromByteArrayLE( byteArray, 4888, 8);
    @CAN_PrivMain::RFL_Object::RXX_Object_Obj8.FilterInformation = convertRawToPhysical(raw_value, 1.0, 0.0);

    raw_value=copyBitsFromByteArrayLE( byteArray, 4664, 7);
    @CAN_PrivMain::RFL_Object::RXX_Object_Obj8.Length = convertRawToPhysical(raw_value, 0.125, 0.0);

    raw_value=copyBitsFromByteArrayLE( byteArray, 4672, 12);
    @CAN_PrivMain::RFL_Object::RXX_Object_Obj8.LengthVnce = convertRawToPhysical(raw_value, 0.01, 0.0);

    raw_value=copyBitsFromByteArrayLE( byteArray, 4856, 3);
    @CAN_PrivMain::RFL_Object::RXX_Object_Obj8.MeasurementStatus = convertRawToPhysical(raw_value, 1.0, 0.0);

    raw_value=copyBitsFromByteArrayLE( byteArray, 4812, 2);
    @CAN_PrivMain::RFL_Object::RXX_Object_Obj8.MovingStatus = convertRawToPhysical(raw_value, 1.0, 0.0);

    raw_value=copyBitsFromByteArrayLE( byteArray, 4792, 7);
    @CAN_PrivMain::RFL_Object::RXX_Object_Obj8.ObjId = convertRawToPhysical(raw_value, 1.0, 0.0);

    raw_value=copyBitsFromByteArrayLE( byteArray, 4694, 9);
    @CAN_PrivMain::RFL_Object::RXX_Object_Obj8.OrientationYaw = convertRawToPhysical(raw_value, 0.0175, -4.48);

    raw_value=copyBitsFromByteArrayLE( byteArray, 4716, 12);
    @CAN_PrivMain::RFL_Object::RXX_Object_Obj8.OrientationYawVnce = convertRawToPhysical(raw_value, 0.0003, 0.0);

    raw_value=copyBitsFromByteArrayLE( byteArray, 4608, 6);
    @CAN_PrivMain::RFL_Object::RXX_Object_Obj8.ProbClassConfidence = convertRawToPhysical(raw_value, 2.0, 0.0);

    raw_value=copyBitsFromByteArrayLE( byteArray, 4859, 4);
    @CAN_PrivMain::RFL_Object::RXX_Object_Obj8.ProbClassType = convertRawToPhysical(raw_value, 1.0, 0.0);

    raw_value=copyBitsFromByteArrayLE( byteArray, 4614, 14);
    @CAN_PrivMain::RFL_Object::RXX_Object_Obj8.Px = convertRawToPhysical(raw_value, 0.0625, -512.0);

    raw_value=copyBitsFromByteArrayLE( byteArray, 4928, 12);
    @CAN_PrivMain::RFL_Object::RXX_Object_Obj8.PxAxCoVnce = convertRawToPhysical(raw_value, 0.01, 0.0);

    raw_value=copyBitsFromByteArrayLE( byteArray, 4940, 12);
    @CAN_PrivMain::RFL_Object::RXX_Object_Obj8.PxAyCoVnce = convertRawToPhysical(raw_value, 0.01, 0.0);

    raw_value=copyBitsFromByteArrayLE( byteArray, 4844, 12);
    @CAN_PrivMain::RFL_Object::RXX_Object_Obj8.PxPyCoVnce = convertRawToPhysical(raw_value, 0.01, 0.0);

    raw_value=copyBitsFromByteArrayLE( byteArray, 4628, 12);
    @CAN_PrivMain::RFL_Object::RXX_Object_Obj8.PxVnce = convertRawToPhysical(raw_value, 0.1, 0.0);

    raw_value=copyBitsFromByteArrayLE( byteArray, 4864, 12);
    @CAN_PrivMain::RFL_Object::RXX_Object_Obj8.PxVxCoVnce = convertRawToPhysical(raw_value, 0.01, 0.0);

    raw_value=copyBitsFromByteArrayLE( byteArray, 4876, 12);
    @CAN_PrivMain::RFL_Object::RXX_Object_Obj8.PxVyCoVnce = convertRawToPhysical(raw_value, 0.01, 0.0);

    raw_value=copyBitsFromByteArrayLE( byteArray, 4640, 12);
    @CAN_PrivMain::RFL_Object::RXX_Object_Obj8.Py = convertRawToPhysical(raw_value, 0.0625, -128.0);

    raw_value=copyBitsFromByteArrayLE( byteArray, 4960, 12);
    @CAN_PrivMain::RFL_Object::RXX_Object_Obj8.PyAxCoVnce = convertRawToPhysical(raw_value, 0.01, 0.0);

    raw_value=copyBitsFromByteArrayLE( byteArray, 4972, 12);
    @CAN_PrivMain::RFL_Object::RXX_Object_Obj8.PyAyCoVnce = convertRawToPhysical(raw_value, 0.01, 0.0);

    raw_value=copyBitsFromByteArrayLE( byteArray, 4652, 12);
    @CAN_PrivMain::RFL_Object::RXX_Object_Obj8.PyVnce = convertRawToPhysical(raw_value, 0.1, 0.0);

    raw_value=copyBitsFromByteArrayLE( byteArray, 4896, 12);
    @CAN_PrivMain::RFL_Object::RXX_Object_Obj8.PyVxCoVnce = convertRawToPhysical(raw_value, 0.01, 0.0);

    raw_value=copyBitsFromByteArrayLE( byteArray, 4908, 12);
    @CAN_PrivMain::RFL_Object::RXX_Object_Obj8.PyVyCoVnce = convertRawToPhysical(raw_value, 0.01, 0.0);

    raw_value=copyBitsFromByteArrayLE( byteArray, 4748, 10);
    @CAN_PrivMain::RFL_Object::RXX_Object_Obj8.RCS = convertRawToPhysical(raw_value, 0.2, -102.4);

    raw_value=copyBitsFromByteArrayLE( byteArray, 4920, 4);
    @CAN_PrivMain::RFL_Object::RXX_Object_Obj8.ReferencePoint = convertRawToPhysical(raw_value, 1.0, 0.0);

    raw_value=copyBitsFromByteArrayLE( byteArray, 4780, 12);
    @CAN_PrivMain::RFL_Object::RXX_Object_Obj8.Vx = convertRawToPhysical(raw_value, 0.0625, -128.0);

    raw_value=copyBitsFromByteArrayLE( byteArray, 5004, 12);
    @CAN_PrivMain::RFL_Object::RXX_Object_Obj8.VxAxCoVnce = convertRawToPhysical(raw_value, 0.01, 0.0);

    raw_value=copyBitsFromByteArrayLE( byteArray, 5024, 12);
    @CAN_PrivMain::RFL_Object::RXX_Object_Obj8.VxAyCoVnce = convertRawToPhysical(raw_value, 0.01, 0.0);

    raw_value=copyBitsFromByteArrayLE( byteArray, 4800, 12);
    @CAN_PrivMain::RFL_Object::RXX_Object_Obj8.VxVnce = convertRawToPhysical(raw_value, 0.01, 0.0);

    raw_value=copyBitsFromByteArrayLE( byteArray, 4992, 12);
    @CAN_PrivMain::RFL_Object::RXX_Object_Obj8.VxVyCoVnce = convertRawToPhysical(raw_value, 0.01, 0.0);

    raw_value=copyBitsFromByteArrayLE( byteArray, 4814, 10);
    @CAN_PrivMain::RFL_Object::RXX_Object_Obj8.Vy = convertRawToPhysical(raw_value, 0.125, -64.0);

    raw_value=copyBitsFromByteArrayLE( byteArray, 5036, 12);
    @CAN_PrivMain::RFL_Object::RXX_Object_Obj8.VyAxCoVnce = convertRawToPhysical(raw_value, 0.01, 0.0);

    raw_value=copyBitsFromByteArrayLE( byteArray, 5056, 12);
    @CAN_PrivMain::RFL_Object::RXX_Object_Obj8.VyAyCoVnce = convertRawToPhysical(raw_value, 0.01, 0.0);

    raw_value=copyBitsFromByteArrayLE( byteArray, 4832, 12);
    @CAN_PrivMain::RFL_Object::RXX_Object_Obj8.VyVnce = convertRawToPhysical(raw_value, 0.01, 0.0);

    raw_value=copyBitsFromByteArrayLE( byteArray, 4728, 7);
    @CAN_PrivMain::RFL_Object::RXX_Object_Obj8.Width = convertRawToPhysical(raw_value, 0.125, 0.0);

    raw_value=copyBitsFromByteArrayLE( byteArray, 4736, 12);
    @CAN_PrivMain::RFL_Object::RXX_Object_Obj8.WidthVnce = convertRawToPhysical(raw_value, 0.01, 0.0);
}


void CRadarFL_RXX_Object_Obj9_SetDataReceived(byte byteArray[])
{
    qword raw_value;

    raw_value=copyBitsFromByteArrayLE( byteArray, 5600, 32);
    @CAN_PrivMain::RFL_Object::RXX_Object_Obj9.Age = convertRawToPhysical(raw_value, 1.0, 0.0);

    raw_value=copyBitsFromByteArrayLE( byteArray, 5196, 10);
    @CAN_PrivMain::RFL_Object::RXX_Object_Obj9.Ax = convertRawToPhysical(raw_value, 0.03125, -16.0);

    raw_value=copyBitsFromByteArrayLE( byteArray, 5580, 12);
    @CAN_PrivMain::RFL_Object::RXX_Object_Obj9.AxAyCoVnce = convertRawToPhysical(raw_value, 0.01, 0.0);

    raw_value=copyBitsFromByteArrayLE( byteArray, 5216, 12);
    @CAN_PrivMain::RFL_Object::RXX_Object_Obj9.AxVnce = convertRawToPhysical(raw_value, 0.01, 0.0);

    raw_value=copyBitsFromByteArrayLE( byteArray, 5270, 9);
    @CAN_PrivMain::RFL_Object::RXX_Object_Obj9.Ay = convertRawToPhysical(raw_value, 0.0625, -16.0);

    raw_value=copyBitsFromByteArrayLE( byteArray, 5280, 12);
    @CAN_PrivMain::RFL_Object::RXX_Object_Obj9.AyVnce = convertRawToPhysical(raw_value, 0.01, 0.0);

    raw_value=copyBitsFromByteArrayLE( byteArray, 5336, 6);
    @CAN_PrivMain::RFL_Object::RXX_Object_Obj9.ExistProb = convertRawToPhysical(raw_value, 2.0, 0.0);

    raw_value=copyBitsFromByteArrayLE( byteArray, 5400, 8);
    @CAN_PrivMain::RFL_Object::RXX_Object_Obj9.FilterInformation = convertRawToPhysical(raw_value, 1.0, 0.0);

    raw_value=copyBitsFromByteArrayLE( byteArray, 5176, 7);
    @CAN_PrivMain::RFL_Object::RXX_Object_Obj9.Length = convertRawToPhysical(raw_value, 0.125, 0.0);

    raw_value=copyBitsFromByteArrayLE( byteArray, 5184, 12);
    @CAN_PrivMain::RFL_Object::RXX_Object_Obj9.LengthVnce = convertRawToPhysical(raw_value, 0.01, 0.0);

    raw_value=copyBitsFromByteArrayLE( byteArray, 5368, 3);
    @CAN_PrivMain::RFL_Object::RXX_Object_Obj9.MeasurementStatus = convertRawToPhysical(raw_value, 1.0, 0.0);

    raw_value=copyBitsFromByteArrayLE( byteArray, 5324, 2);
    @CAN_PrivMain::RFL_Object::RXX_Object_Obj9.MovingStatus = convertRawToPhysical(raw_value, 1.0, 0.0);

    raw_value=copyBitsFromByteArrayLE( byteArray, 5304, 7);
    @CAN_PrivMain::RFL_Object::RXX_Object_Obj9.ObjId = convertRawToPhysical(raw_value, 1.0, 0.0);

    raw_value=copyBitsFromByteArrayLE( byteArray, 5206, 9);
    @CAN_PrivMain::RFL_Object::RXX_Object_Obj9.OrientationYaw = convertRawToPhysical(raw_value, 0.0175, -4.48);

    raw_value=copyBitsFromByteArrayLE( byteArray, 5228, 12);
    @CAN_PrivMain::RFL_Object::RXX_Object_Obj9.OrientationYawVnce = convertRawToPhysical(raw_value, 0.0003, 0.0);

    raw_value=copyBitsFromByteArrayLE( byteArray, 5120, 6);
    @CAN_PrivMain::RFL_Object::RXX_Object_Obj9.ProbClassConfidence = convertRawToPhysical(raw_value, 2.0, 0.0);

    raw_value=copyBitsFromByteArrayLE( byteArray, 5371, 4);
    @CAN_PrivMain::RFL_Object::RXX_Object_Obj9.ProbClassType = convertRawToPhysical(raw_value, 1.0, 0.0);

    raw_value=copyBitsFromByteArrayLE( byteArray, 5126, 14);
    @CAN_PrivMain::RFL_Object::RXX_Object_Obj9.Px = convertRawToPhysical(raw_value, 0.0625, -512.0);

    raw_value=copyBitsFromByteArrayLE( byteArray, 5440, 12);
    @CAN_PrivMain::RFL_Object::RXX_Object_Obj9.PxAxCoVnce = convertRawToPhysical(raw_value, 0.01, 0.0);

    raw_value=copyBitsFromByteArrayLE( byteArray, 5452, 12);
    @CAN_PrivMain::RFL_Object::RXX_Object_Obj9.PxAyCoVnce = convertRawToPhysical(raw_value, 0.01, 0.0);

    raw_value=copyBitsFromByteArrayLE( byteArray, 5356, 12);
    @CAN_PrivMain::RFL_Object::RXX_Object_Obj9.PxPyCoVnce = convertRawToPhysical(raw_value, 0.01, 0.0);

    raw_value=copyBitsFromByteArrayLE( byteArray, 5140, 12);
    @CAN_PrivMain::RFL_Object::RXX_Object_Obj9.PxVnce = convertRawToPhysical(raw_value, 0.1, 0.0);

    raw_value=copyBitsFromByteArrayLE( byteArray, 5376, 12);
    @CAN_PrivMain::RFL_Object::RXX_Object_Obj9.PxVxCoVnce = convertRawToPhysical(raw_value, 0.01, 0.0);

    raw_value=copyBitsFromByteArrayLE( byteArray, 5388, 12);
    @CAN_PrivMain::RFL_Object::RXX_Object_Obj9.PxVyCoVnce = convertRawToPhysical(raw_value, 0.01, 0.0);

    raw_value=copyBitsFromByteArrayLE( byteArray, 5152, 12);
    @CAN_PrivMain::RFL_Object::RXX_Object_Obj9.Py = convertRawToPhysical(raw_value, 0.0625, -128.0);

    raw_value=copyBitsFromByteArrayLE( byteArray, 5472, 12);
    @CAN_PrivMain::RFL_Object::RXX_Object_Obj9.PyAxCoVnce = convertRawToPhysical(raw_value, 0.01, 0.0);

    raw_value=copyBitsFromByteArrayLE( byteArray, 5484, 12);
    @CAN_PrivMain::RFL_Object::RXX_Object_Obj9.PyAyCoVnce = convertRawToPhysical(raw_value, 0.01, 0.0);

    raw_value=copyBitsFromByteArrayLE( byteArray, 5164, 12);
    @CAN_PrivMain::RFL_Object::RXX_Object_Obj9.PyVnce = convertRawToPhysical(raw_value, 0.1, 0.0);

    raw_value=copyBitsFromByteArrayLE( byteArray, 5408, 12);
    @CAN_PrivMain::RFL_Object::RXX_Object_Obj9.PyVxCoVnce = convertRawToPhysical(raw_value, 0.01, 0.0);

    raw_value=copyBitsFromByteArrayLE( byteArray, 5420, 12);
    @CAN_PrivMain::RFL_Object::RXX_Object_Obj9.PyVyCoVnce = convertRawToPhysical(raw_value, 0.01, 0.0);

    raw_value=copyBitsFromByteArrayLE( byteArray, 5260, 10);
    @CAN_PrivMain::RFL_Object::RXX_Object_Obj9.RCS = convertRawToPhysical(raw_value, 0.2, -102.4);

    raw_value=copyBitsFromByteArrayLE( byteArray, 5432, 4);
    @CAN_PrivMain::RFL_Object::RXX_Object_Obj9.ReferencePoint = convertRawToPhysical(raw_value, 1.0, 0.0);

    raw_value=copyBitsFromByteArrayLE( byteArray, 5292, 12);
    @CAN_PrivMain::RFL_Object::RXX_Object_Obj9.Vx = convertRawToPhysical(raw_value, 0.0625, -128.0);

    raw_value=copyBitsFromByteArrayLE( byteArray, 5516, 12);
    @CAN_PrivMain::RFL_Object::RXX_Object_Obj9.VxAxCoVnce = convertRawToPhysical(raw_value, 0.01, 0.0);

    raw_value=copyBitsFromByteArrayLE( byteArray, 5536, 12);
    @CAN_PrivMain::RFL_Object::RXX_Object_Obj9.VxAyCoVnce = convertRawToPhysical(raw_value, 0.01, 0.0);

    raw_value=copyBitsFromByteArrayLE( byteArray, 5312, 12);
    @CAN_PrivMain::RFL_Object::RXX_Object_Obj9.VxVnce = convertRawToPhysical(raw_value, 0.01, 0.0);

    raw_value=copyBitsFromByteArrayLE( byteArray, 5504, 12);
    @CAN_PrivMain::RFL_Object::RXX_Object_Obj9.VxVyCoVnce = convertRawToPhysical(raw_value, 0.01, 0.0);

    raw_value=copyBitsFromByteArrayLE( byteArray, 5326, 10);
    @CAN_PrivMain::RFL_Object::RXX_Object_Obj9.Vy = convertRawToPhysical(raw_value, 0.125, -64.0);

    raw_value=copyBitsFromByteArrayLE( byteArray, 5548, 12);
    @CAN_PrivMain::RFL_Object::RXX_Object_Obj9.VyAxCoVnce = convertRawToPhysical(raw_value, 0.01, 0.0);

    raw_value=copyBitsFromByteArrayLE( byteArray, 5568, 12);
    @CAN_PrivMain::RFL_Object::RXX_Object_Obj9.VyAyCoVnce = convertRawToPhysical(raw_value, 0.01, 0.0);

    raw_value=copyBitsFromByteArrayLE( byteArray, 5344, 12);
    @CAN_PrivMain::RFL_Object::RXX_Object_Obj9.VyVnce = convertRawToPhysical(raw_value, 0.01, 0.0);

    raw_value=copyBitsFromByteArrayLE( byteArray, 5240, 7);
    @CAN_PrivMain::RFL_Object::RXX_Object_Obj9.Width = convertRawToPhysical(raw_value, 0.125, 0.0);

    raw_value=copyBitsFromByteArrayLE( byteArray, 5248, 12);
    @CAN_PrivMain::RFL_Object::RXX_Object_Obj9.WidthVnce = convertRawToPhysical(raw_value, 0.01, 0.0);
}


void SetDataReceived_Toliman_RFL_Object(byte byteArray[], long count)//I-signal-i pdu : RFL_Object->Mapped to ->N-pdu : RFL_Object
{
    qword raw_value;

    raw_value=copyBitsFromByteArrayBE( byteArray, 26128, 16);
    @CAN_PrivMain::RFL_Object::RXX_Object_E2E_p44_counter = convertRawToPhysical(raw_value, 1.0, 0.0);

    raw_value=copyBitsFromByteArrayBE( byteArray, 26176, 32);
    @CAN_PrivMain::RFL_Object::RXX_Object_E2E_p44_crc = convertRawToPhysical(raw_value, 1.0, 0.0);

    raw_value=copyBitsFromByteArrayBE( byteArray, 26144, 32);
    @CAN_PrivMain::RFL_Object::RXX_Object_E2E_p44_dataId = convertRawToPhysical(raw_value, 1.0, 0.0);

    raw_value=copyBitsFromByteArrayBE( byteArray, 26112, 16);
    @CAN_PrivMain::RFL_Object::RXX_Object_E2E_p44_length = convertRawToPhysical(raw_value, 1.0, 0.0);

    raw_value=copyBitsFromByteArrayLE( byteArray, 82, 1);
    @CAN_PrivMain::RFL_Object::RXX_Object_ObjHdr_LocDownSel = convertRawToPhysical(raw_value, 1.0, 0.0);

    raw_value=copyBitsFromByteArrayLE( byteArray, 72, 10);
    @CAN_PrivMain::RFL_Object::RXX_Object_ObjHdr_NumValidObjects = convertRawToPhysical(raw_value, 1.0, 0.0);

    raw_value=copyBitsFromByteArrayLE( byteArray, 32, 32);
    @CAN_PrivMain::RFL_Object::RXX_Object_ObjHdr_TimeStamp = convertRawToPhysical(raw_value, 1.0, 0.0);

    raw_value=copyBitsFromByteArrayLE( byteArray, 64, 8);
    @CAN_PrivMain::RFL_Object::RXX_Object_ObjHdr_TimeStampStatus = convertRawToPhysical(raw_value, 1.0, 0.0);

    raw_value=copyBitsFromByteArrayLE( byteArray, 0, 8);
    @CAN_PrivMain::RFL_Object::RXX_Object_ObjHdr_VersionIdMajor = convertRawToPhysical(raw_value, 1.0, 0.0);

    raw_value=copyBitsFromByteArrayLE( byteArray, 8, 8);
    @CAN_PrivMain::RFL_Object::RXX_Object_ObjHdr_VersionIdMinor = convertRawToPhysical(raw_value, 1.0, 0.0);

    raw_value=copyBitsFromByteArrayLE( byteArray, 960, 2);
    @CAN_PrivMain::RFL_Object::RXX_Object_ShiiHdr_DataMeasured = convertRawToPhysical(raw_value, 1.0, 0.0);

    raw_value=copyBitsFromByteArrayLE( byteArray, 976, 8);
    @CAN_PrivMain::RFL_Object::RXX_Object_ShiiHdr_MisAzOOPCause = convertRawToPhysical(raw_value, 1.0, 0.0);

    raw_value=copyBitsFromByteArrayLE( byteArray, 984, 8);
    @CAN_PrivMain::RFL_Object::RXX_Object_ShiiHdr_MisElOOPCause = convertRawToPhysical(raw_value, 1.0, 0.0);

    raw_value=copyBitsFromByteArrayLE( byteArray, 968, 1);
    @CAN_PrivMain::RFL_Object::RXX_Object_ShiiHdr_SensorCalExtStat = convertRawToPhysical(raw_value, 1.0, 0.0);

    raw_value=copyBitsFromByteArrayLE( byteArray, 969, 1);
    @CAN_PrivMain::RFL_Object::RXX_Object_ShiiHdr_SensorCalIntStat = convertRawToPhysical(raw_value, 1.0, 0.0);

    raw_value=copyBitsFromByteArrayLE( byteArray, 972, 4);
    @CAN_PrivMain::RFL_Object::RXX_Object_ShiiHdr_SensorCalOnlStat = convertRawToPhysical(raw_value, 1.0, 0.0);

    raw_value=copyBitsFromByteArrayLE( byteArray, 992, 16);
    @CAN_PrivMain::RFL_Object::RXX_Object_ShiiHdr_SensorFailureReas = convertRawToPhysical(raw_value, 1.0, 0.0);

    raw_value=copyBitsFromByteArrayLE( byteArray, 970, 2);
    @CAN_PrivMain::RFL_Object::RXX_Object_ShiiHdr_SensorHeatingStatus = convertRawToPhysical(raw_value, 1.0, 0.0);

    raw_value=copyBitsFromByteArrayLE( byteArray, 1008, 8);
    @CAN_PrivMain::RFL_Object::RXX_Object_ShiiHdr_SensorOmmOpMode = convertRawToPhysical(raw_value, 1.0, 0.0);

    raw_value=copyBitsFromByteArrayLE( byteArray, 931, 6);
    @CAN_PrivMain::RFL_Object::RXX_Object_SpiHdr_BldFov_Confidence = convertRawToPhysical(raw_value, 2.0, 0.0);

    raw_value=copyBitsFromByteArrayLE( byteArray, 928, 3);
    @CAN_PrivMain::RFL_Object::RXX_Object_SpiHdr_BldFov_Status = convertRawToPhysical(raw_value, 1.0, 0.0);

    raw_value=copyBitsFromByteArrayLE( byteArray, 208, 16);
    @CAN_PrivMain::RFL_Object::RXX_Object_SpiHdr_DistMaxProc = convertRawToPhysical(raw_value, 0.01, 0.0);

    raw_value=copyBitsFromByteArrayLE( byteArray, 192, 16);
    @CAN_PrivMain::RFL_Object::RXX_Object_SpiHdr_DistMeasMaxMod = convertRawToPhysical(raw_value, 0.01, 0.0);

    raw_value=copyBitsFromByteArrayLE( byteArray, 171, 10);
    @CAN_PrivMain::RFL_Object::RXX_Object_SpiHdr_DistMeasMinMod = convertRawToPhysical(raw_value, 0.01, 0.0);

    raw_value=copyBitsFromByteArrayLE( byteArray, 144, 13);
    @CAN_PrivMain::RFL_Object::RXX_Object_SpiHdr_DistPrec = convertRawToPhysical(raw_value, 0.0001, 0.0);

    raw_value=copyBitsFromByteArrayLE( byteArray, 115, 10);
    @CAN_PrivMain::RFL_Object::RXX_Object_SpiHdr_DistSep = convertRawToPhysical(raw_value, 0.01, 0.0);

    raw_value=copyBitsFromByteArrayLE( byteArray, 128, 16);
    @CAN_PrivMain::RFL_Object::RXX_Object_SpiHdr_DistStartProcDegraded = convertRawToPhysical(raw_value, 0.01, 0.0);

    raw_value=copyBitsFromByteArrayLE( byteArray, 96, 6);
    @CAN_PrivMain::RFL_Object::RXX_Object_SpiHdr_DmpId = convertRawToPhysical(raw_value, 1.0, 0.0);

    raw_value=copyBitsFromByteArrayLE( byteArray, 656, 10);
    @CAN_PrivMain::RFL_Object::RXX_Object_SpiHdr_FovRtrAzDetRng00 = convertRawToPhysical(raw_value, 1.0, 0.0);

    raw_value=copyBitsFromByteArrayLE( byteArray, 672, 10);
    @CAN_PrivMain::RFL_Object::RXX_Object_SpiHdr_FovRtrAzDetRng01 = convertRawToPhysical(raw_value, 1.0, 0.0);

    raw_value=copyBitsFromByteArrayLE( byteArray, 682, 10);
    @CAN_PrivMain::RFL_Object::RXX_Object_SpiHdr_FovRtrAzDetRng02 = convertRawToPhysical(raw_value, 1.0, 0.0);

    raw_value=copyBitsFromByteArrayLE( byteArray, 692, 10);
    @CAN_PrivMain::RFL_Object::RXX_Object_SpiHdr_FovRtrAzDetRng03 = convertRawToPhysical(raw_value, 1.0, 0.0);

    raw_value=copyBitsFromByteArrayLE( byteArray, 704, 10);
    @CAN_PrivMain::RFL_Object::RXX_Object_SpiHdr_FovRtrAzDetRng04 = convertRawToPhysical(raw_value, 1.0, 0.0);

    raw_value=copyBitsFromByteArrayLE( byteArray, 714, 10);
    @CAN_PrivMain::RFL_Object::RXX_Object_SpiHdr_FovRtrAzDetRng05 = convertRawToPhysical(raw_value, 1.0, 0.0);

    raw_value=copyBitsFromByteArrayLE( byteArray, 724, 10);
    @CAN_PrivMain::RFL_Object::RXX_Object_SpiHdr_FovRtrAzDetRng06 = convertRawToPhysical(raw_value, 1.0, 0.0);

    raw_value=copyBitsFromByteArrayLE( byteArray, 736, 10);
    @CAN_PrivMain::RFL_Object::RXX_Object_SpiHdr_FovRtrAzDetRng07 = convertRawToPhysical(raw_value, 1.0, 0.0);

    raw_value=copyBitsFromByteArrayLE( byteArray, 746, 10);
    @CAN_PrivMain::RFL_Object::RXX_Object_SpiHdr_FovRtrAzDetRng08 = convertRawToPhysical(raw_value, 1.0, 0.0);

    raw_value=copyBitsFromByteArrayLE( byteArray, 756, 10);
    @CAN_PrivMain::RFL_Object::RXX_Object_SpiHdr_FovRtrAzDetRng09 = convertRawToPhysical(raw_value, 1.0, 0.0);

    raw_value=copyBitsFromByteArrayLE( byteArray, 768, 10);
    @CAN_PrivMain::RFL_Object::RXX_Object_SpiHdr_FovRtrAzDetRng10 = convertRawToPhysical(raw_value, 1.0, 0.0);

    raw_value=copyBitsFromByteArrayLE( byteArray, 778, 10);
    @CAN_PrivMain::RFL_Object::RXX_Object_SpiHdr_FovRtrAzDetRng11 = convertRawToPhysical(raw_value, 1.0, 0.0);

    raw_value=copyBitsFromByteArrayLE( byteArray, 788, 10);
    @CAN_PrivMain::RFL_Object::RXX_Object_SpiHdr_FovRtrAzDetRng12 = convertRawToPhysical(raw_value, 1.0, 0.0);

    raw_value=copyBitsFromByteArrayLE( byteArray, 800, 10);
    @CAN_PrivMain::RFL_Object::RXX_Object_SpiHdr_FovRtrAzDetRng13 = convertRawToPhysical(raw_value, 1.0, 0.0);

    raw_value=copyBitsFromByteArrayLE( byteArray, 810, 10);
    @CAN_PrivMain::RFL_Object::RXX_Object_SpiHdr_FovRtrAzDetRng14 = convertRawToPhysical(raw_value, 1.0, 0.0);

    raw_value=copyBitsFromByteArrayLE( byteArray, 820, 10);
    @CAN_PrivMain::RFL_Object::RXX_Object_SpiHdr_FovRtrAzDetRng15 = convertRawToPhysical(raw_value, 1.0, 0.0);

    raw_value=copyBitsFromByteArrayLE( byteArray, 832, 10);
    @CAN_PrivMain::RFL_Object::RXX_Object_SpiHdr_FovRtrAzDetRng16 = convertRawToPhysical(raw_value, 1.0, 0.0);

    raw_value=copyBitsFromByteArrayLE( byteArray, 842, 10);
    @CAN_PrivMain::RFL_Object::RXX_Object_SpiHdr_FovRtrAzDetRng17 = convertRawToPhysical(raw_value, 1.0, 0.0);

    raw_value=copyBitsFromByteArrayLE( byteArray, 852, 10);
    @CAN_PrivMain::RFL_Object::RXX_Object_SpiHdr_FovRtrAzDetRng18 = convertRawToPhysical(raw_value, 1.0, 0.0);

    raw_value=copyBitsFromByteArrayLE( byteArray, 864, 10);
    @CAN_PrivMain::RFL_Object::RXX_Object_SpiHdr_FovRtrAzDetRng19 = convertRawToPhysical(raw_value, 1.0, 0.0);

    raw_value=copyBitsFromByteArrayLE( byteArray, 874, 10);
    @CAN_PrivMain::RFL_Object::RXX_Object_SpiHdr_FovRtrAzDetRng20 = convertRawToPhysical(raw_value, 1.0, 0.0);

    raw_value=copyBitsFromByteArrayLE( byteArray, 884, 10);
    @CAN_PrivMain::RFL_Object::RXX_Object_SpiHdr_FovRtrAzDetRng21 = convertRawToPhysical(raw_value, 1.0, 0.0);

    raw_value=copyBitsFromByteArrayLE( byteArray, 896, 10);
    @CAN_PrivMain::RFL_Object::RXX_Object_SpiHdr_FovRtrAzDetRng22 = convertRawToPhysical(raw_value, 1.0, 0.0);

    raw_value=copyBitsFromByteArrayLE( byteArray, 906, 10);
    @CAN_PrivMain::RFL_Object::RXX_Object_SpiHdr_FovRtrAzDetRng23 = convertRawToPhysical(raw_value, 1.0, 0.0);

    raw_value=copyBitsFromByteArrayLE( byteArray, 916, 10);
    @CAN_PrivMain::RFL_Object::RXX_Object_SpiHdr_FovRtrAzDetRng24 = convertRawToPhysical(raw_value, 1.0, 0.0);

    raw_value=copyBitsFromByteArrayLE( byteArray, 455, 8);
    @CAN_PrivMain::RFL_Object::RXX_Object_SpiHdr_FovRtrAzSegBrdr00 = convertRawToPhysical(raw_value, 0.0175, -2.24);

    raw_value=copyBitsFromByteArrayLE( byteArray, 463, 8);
    @CAN_PrivMain::RFL_Object::RXX_Object_SpiHdr_FovRtrAzSegBrdr01 = convertRawToPhysical(raw_value, 0.0175, -2.24);

    raw_value=copyBitsFromByteArrayLE( byteArray, 471, 8);
    @CAN_PrivMain::RFL_Object::RXX_Object_SpiHdr_FovRtrAzSegBrdr02 = convertRawToPhysical(raw_value, 0.0175, -2.24);

    raw_value=copyBitsFromByteArrayLE( byteArray, 480, 8);
    @CAN_PrivMain::RFL_Object::RXX_Object_SpiHdr_FovRtrAzSegBrdr03 = convertRawToPhysical(raw_value, 0.0175, -2.24);

    raw_value=copyBitsFromByteArrayLE( byteArray, 488, 8);
    @CAN_PrivMain::RFL_Object::RXX_Object_SpiHdr_FovRtrAzSegBrdr04 = convertRawToPhysical(raw_value, 0.0175, -2.24);

    raw_value=copyBitsFromByteArrayLE( byteArray, 496, 8);
    @CAN_PrivMain::RFL_Object::RXX_Object_SpiHdr_FovRtrAzSegBrdr05 = convertRawToPhysical(raw_value, 0.0175, -2.24);

    raw_value=copyBitsFromByteArrayLE( byteArray, 504, 8);
    @CAN_PrivMain::RFL_Object::RXX_Object_SpiHdr_FovRtrAzSegBrdr06 = convertRawToPhysical(raw_value, 0.0175, -2.24);

    raw_value=copyBitsFromByteArrayLE( byteArray, 512, 8);
    @CAN_PrivMain::RFL_Object::RXX_Object_SpiHdr_FovRtrAzSegBrdr07 = convertRawToPhysical(raw_value, 0.0175, -2.24);

    raw_value=copyBitsFromByteArrayLE( byteArray, 520, 8);
    @CAN_PrivMain::RFL_Object::RXX_Object_SpiHdr_FovRtrAzSegBrdr08 = convertRawToPhysical(raw_value, 0.0175, -2.24);

    raw_value=copyBitsFromByteArrayLE( byteArray, 528, 8);
    @CAN_PrivMain::RFL_Object::RXX_Object_SpiHdr_FovRtrAzSegBrdr09 = convertRawToPhysical(raw_value, 0.0175, -2.24);

    raw_value=copyBitsFromByteArrayLE( byteArray, 536, 8);
    @CAN_PrivMain::RFL_Object::RXX_Object_SpiHdr_FovRtrAzSegBrdr10 = convertRawToPhysical(raw_value, 0.0175, -2.24);

    raw_value=copyBitsFromByteArrayLE( byteArray, 544, 8);
    @CAN_PrivMain::RFL_Object::RXX_Object_SpiHdr_FovRtrAzSegBrdr11 = convertRawToPhysical(raw_value, 0.0175, -2.24);

    raw_value=copyBitsFromByteArrayLE( byteArray, 552, 8);
    @CAN_PrivMain::RFL_Object::RXX_Object_SpiHdr_FovRtrAzSegBrdr12 = convertRawToPhysical(raw_value, 0.0175, -2.24);

    raw_value=copyBitsFromByteArrayLE( byteArray, 560, 8);
    @CAN_PrivMain::RFL_Object::RXX_Object_SpiHdr_FovRtrAzSegBrdr13 = convertRawToPhysical(raw_value, 0.0175, -2.24);

    raw_value=copyBitsFromByteArrayLE( byteArray, 568, 8);
    @CAN_PrivMain::RFL_Object::RXX_Object_SpiHdr_FovRtrAzSegBrdr14 = convertRawToPhysical(raw_value, 0.0175, -2.24);

    raw_value=copyBitsFromByteArrayLE( byteArray, 576, 8);
    @CAN_PrivMain::RFL_Object::RXX_Object_SpiHdr_FovRtrAzSegBrdr15 = convertRawToPhysical(raw_value, 0.0175, -2.24);

    raw_value=copyBitsFromByteArrayLE( byteArray, 584, 8);
    @CAN_PrivMain::RFL_Object::RXX_Object_SpiHdr_FovRtrAzSegBrdr16 = convertRawToPhysical(raw_value, 0.0175, -2.24);

    raw_value=copyBitsFromByteArrayLE( byteArray, 592, 8);
    @CAN_PrivMain::RFL_Object::RXX_Object_SpiHdr_FovRtrAzSegBrdr17 = convertRawToPhysical(raw_value, 0.0175, -2.24);

    raw_value=copyBitsFromByteArrayLE( byteArray, 600, 8);
    @CAN_PrivMain::RFL_Object::RXX_Object_SpiHdr_FovRtrAzSegBrdr18 = convertRawToPhysical(raw_value, 0.0175, -2.24);

    raw_value=copyBitsFromByteArrayLE( byteArray, 608, 8);
    @CAN_PrivMain::RFL_Object::RXX_Object_SpiHdr_FovRtrAzSegBrdr19 = convertRawToPhysical(raw_value, 0.0175, -2.24);

    raw_value=copyBitsFromByteArrayLE( byteArray, 616, 8);
    @CAN_PrivMain::RFL_Object::RXX_Object_SpiHdr_FovRtrAzSegBrdr20 = convertRawToPhysical(raw_value, 0.0175, -2.24);

    raw_value=copyBitsFromByteArrayLE( byteArray, 624, 8);
    @CAN_PrivMain::RFL_Object::RXX_Object_SpiHdr_FovRtrAzSegBrdr21 = convertRawToPhysical(raw_value, 0.0175, -2.24);

    raw_value=copyBitsFromByteArrayLE( byteArray, 632, 8);
    @CAN_PrivMain::RFL_Object::RXX_Object_SpiHdr_FovRtrAzSegBrdr22 = convertRawToPhysical(raw_value, 0.0175, -2.24);

    raw_value=copyBitsFromByteArrayLE( byteArray, 640, 8);
    @CAN_PrivMain::RFL_Object::RXX_Object_SpiHdr_FovRtrAzSegBrdr23 = convertRawToPhysical(raw_value, 0.0175, -2.24);

    raw_value=copyBitsFromByteArrayLE( byteArray, 648, 8);
    @CAN_PrivMain::RFL_Object::RXX_Object_SpiHdr_FovRtrAzSegBrdr24 = convertRawToPhysical(raw_value, 0.0175, -2.24);

    raw_value=copyBitsFromByteArrayLE( byteArray, 320, 7);
    @CAN_PrivMain::RFL_Object::RXX_Object_SpiHdr_FovRtrElRngGEnd00 = convertRawToPhysical(raw_value, 0.01, 0.0);

    raw_value=copyBitsFromByteArrayLE( byteArray, 327, 7);
    @CAN_PrivMain::RFL_Object::RXX_Object_SpiHdr_FovRtrElRngGEnd01 = convertRawToPhysical(raw_value, 0.01, 0.0);

    raw_value=copyBitsFromByteArrayLE( byteArray, 334, 7);
    @CAN_PrivMain::RFL_Object::RXX_Object_SpiHdr_FovRtrElRngGEnd02 = convertRawToPhysical(raw_value, 0.01, 0.0);

    raw_value=copyBitsFromByteArrayLE( byteArray, 341, 7);
    @CAN_PrivMain::RFL_Object::RXX_Object_SpiHdr_FovRtrElRngGEnd03 = convertRawToPhysical(raw_value, 0.01, 0.0);

    raw_value=copyBitsFromByteArrayLE( byteArray, 352, 7);
    @CAN_PrivMain::RFL_Object::RXX_Object_SpiHdr_FovRtrElRngGEnd04 = convertRawToPhysical(raw_value, 0.01, 0.0);

    raw_value=copyBitsFromByteArrayLE( byteArray, 359, 7);
    @CAN_PrivMain::RFL_Object::RXX_Object_SpiHdr_FovRtrElRngGEnd05 = convertRawToPhysical(raw_value, 0.01, 0.0);

    raw_value=copyBitsFromByteArrayLE( byteArray, 366, 7);
    @CAN_PrivMain::RFL_Object::RXX_Object_SpiHdr_FovRtrElRngGEnd06 = convertRawToPhysical(raw_value, 0.01, 0.0);

    raw_value=copyBitsFromByteArrayLE( byteArray, 373, 7);
    @CAN_PrivMain::RFL_Object::RXX_Object_SpiHdr_FovRtrElRngGEnd07 = convertRawToPhysical(raw_value, 0.01, 0.0);

    raw_value=copyBitsFromByteArrayLE( byteArray, 384, 7);
    @CAN_PrivMain::RFL_Object::RXX_Object_SpiHdr_FovRtrElRngGEnd08 = convertRawToPhysical(raw_value, 0.01, 0.0);

    raw_value=copyBitsFromByteArrayLE( byteArray, 391, 7);
    @CAN_PrivMain::RFL_Object::RXX_Object_SpiHdr_FovRtrElRngGEnd09 = convertRawToPhysical(raw_value, 0.01, 0.0);

    raw_value=copyBitsFromByteArrayLE( byteArray, 398, 7);
    @CAN_PrivMain::RFL_Object::RXX_Object_SpiHdr_FovRtrElRngGEnd10 = convertRawToPhysical(raw_value, 0.01, 0.0);

    raw_value=copyBitsFromByteArrayLE( byteArray, 235, 7);
    @CAN_PrivMain::RFL_Object::RXX_Object_SpiHdr_FovRtrElSegBrdr00 = convertRawToPhysical(raw_value, 0.0175, -1.12);

    raw_value=copyBitsFromByteArrayLE( byteArray, 242, 7);
    @CAN_PrivMain::RFL_Object::RXX_Object_SpiHdr_FovRtrElSegBrdr01 = convertRawToPhysical(raw_value, 0.0175, -1.12);

    raw_value=copyBitsFromByteArrayLE( byteArray, 249, 7);
    @CAN_PrivMain::RFL_Object::RXX_Object_SpiHdr_FovRtrElSegBrdr02 = convertRawToPhysical(raw_value, 0.0175, -1.12);

    raw_value=copyBitsFromByteArrayLE( byteArray, 256, 7);
    @CAN_PrivMain::RFL_Object::RXX_Object_SpiHdr_FovRtrElSegBrdr03 = convertRawToPhysical(raw_value, 0.0175, -1.12);

    raw_value=copyBitsFromByteArrayLE( byteArray, 263, 7);
    @CAN_PrivMain::RFL_Object::RXX_Object_SpiHdr_FovRtrElSegBrdr04 = convertRawToPhysical(raw_value, 0.0175, -1.12);

    raw_value=copyBitsFromByteArrayLE( byteArray, 270, 7);
    @CAN_PrivMain::RFL_Object::RXX_Object_SpiHdr_FovRtrElSegBrdr05 = convertRawToPhysical(raw_value, 0.0175, -1.12);

    raw_value=copyBitsFromByteArrayLE( byteArray, 277, 7);
    @CAN_PrivMain::RFL_Object::RXX_Object_SpiHdr_FovRtrElSegBrdr06 = convertRawToPhysical(raw_value, 0.0175, -1.12);

    raw_value=copyBitsFromByteArrayLE( byteArray, 288, 7);
    @CAN_PrivMain::RFL_Object::RXX_Object_SpiHdr_FovRtrElSegBrdr07 = convertRawToPhysical(raw_value, 0.0175, -1.12);

    raw_value=copyBitsFromByteArrayLE( byteArray, 295, 7);
    @CAN_PrivMain::RFL_Object::RXX_Object_SpiHdr_FovRtrElSegBrdr08 = convertRawToPhysical(raw_value, 0.0175, -1.12);

    raw_value=copyBitsFromByteArrayLE( byteArray, 302, 7);
    @CAN_PrivMain::RFL_Object::RXX_Object_SpiHdr_FovRtrElSegBrdr09 = convertRawToPhysical(raw_value, 0.0175, -1.12);

    raw_value=copyBitsFromByteArrayLE( byteArray, 309, 7);
    @CAN_PrivMain::RFL_Object::RXX_Object_SpiHdr_FovRtrElSegBrdr10 = convertRawToPhysical(raw_value, 0.0175, -1.12);

    raw_value=copyBitsFromByteArrayLE( byteArray, 102, 13);
    @CAN_PrivMain::RFL_Object::RXX_Object_SpiHdr_ModId = convertRawToPhysical(raw_value, 1.0, 0.0);

    raw_value=copyBitsFromByteArrayLE( byteArray, 448, 7);
    @CAN_PrivMain::RFL_Object::RXX_Object_SpiHdr_RngGainRfInterfere = convertRawToPhysical(raw_value, 1.0, 0.0);

    raw_value=copyBitsFromByteArrayLE( byteArray, 444, 3);
    @CAN_PrivMain::RFL_Object::RXX_Object_SpiHdr_SensorExtDisturbed = convertRawToPhysical(raw_value, 1.0, 0.0);

    raw_value=copyBitsFromByteArrayLE( byteArray, 432, 12);
    @CAN_PrivMain::RFL_Object::RXX_Object_SpiHdr_SensorOrientPitch = convertRawToPhysical(raw_value, 0.00017, -0.34816);

    raw_value=copyBitsFromByteArrayLE( byteArray, 416, 16);
    @CAN_PrivMain::RFL_Object::RXX_Object_SpiHdr_SensorOrientYaw = convertRawToPhysical(raw_value, 0.00017, -5.57056);

    raw_value=copyBitsFromByteArrayLE( byteArray, 447, 1);
    @CAN_PrivMain::RFL_Object::RXX_Object_SpiHdr_SensorOrientation = convertRawToPhysical(raw_value, 1.0, 0.0);

    raw_value=copyBitsFromByteArrayLE( byteArray, 937, 9);
    @CAN_PrivMain::RFL_Object::RXX_Object_SpiHdr_SensorOriginPointX = convertRawToPhysical(raw_value, 0.02, -5.12);

    raw_value=copyBitsFromByteArrayLE( byteArray, 946, 8);
    @CAN_PrivMain::RFL_Object::RXX_Object_SpiHdr_SensorOriginPointY = convertRawToPhysical(raw_value, 0.01, -1.28);

    raw_value=copyBitsFromByteArrayLE( byteArray, 954, 5);
    @CAN_PrivMain::RFL_Object::RXX_Object_SpiHdr_SensorOriginPointZ = convertRawToPhysical(raw_value, 0.05, 0.0);

    raw_value=copyBitsFromByteArrayLE( byteArray, 224, 11);
    @CAN_PrivMain::RFL_Object::RXX_Object_SpiHdr_VelMeasMax = convertRawToPhysical(raw_value, 0.1, 0.0);

    raw_value=copyBitsFromByteArrayLE( byteArray, 405, 11);
    @CAN_PrivMain::RFL_Object::RXX_Object_SpiHdr_VelMeasMin = convertRawToPhysical(raw_value, 0.1, -150.0);

    raw_value=copyBitsFromByteArrayLE( byteArray, 160, 11);
    @CAN_PrivMain::RFL_Object::RXX_Object_SpiHdr_VelPrec = convertRawToPhysical(raw_value, 0.0001, 0.0);

    raw_value=copyBitsFromByteArrayLE( byteArray, 181, 10);
    @CAN_PrivMain::RFL_Object::RXX_Object_SpiHdr_VelSep = convertRawToPhysical(raw_value, 0.01, 0.0);

    if(@CAN_PrivMain::RFL_Object::RXX_Object_Obj1.Read == 1)
    {
        CRadarFL_RXX_Object_Obj1_SetDataReceived(byteArray);
    }

    if(@CAN_PrivMain::RFL_Object::RXX_Object_Obj10.Read == 1)
    {
        CRadarFL_RXX_Object_Obj10_SetDataReceived(byteArray);
    }

    if(@CAN_PrivMain::RFL_Object::RXX_Object_Obj11.Read == 1)
    {
        CRadarFL_RXX_Object_Obj11_SetDataReceived(byteArray);
    }

    if(@CAN_PrivMain::RFL_Object::RXX_Object_Obj12.Read == 1)
    {
        CRadarFL_RXX_Object_Obj12_SetDataReceived(byteArray);
    }

    if(@CAN_PrivMain::RFL_Object::RXX_Object_Obj13.Read == 1)
    {
        CRadarFL_RXX_Object_Obj13_SetDataReceived(byteArray);
    }

    if(@CAN_PrivMain::RFL_Object::RXX_Object_Obj14.Read == 1)
    {
        CRadarFL_RXX_Object_Obj14_SetDataReceived(byteArray);
    }

    if(@CAN_PrivMain::RFL_Object::RXX_Object_Obj15.Read == 1)
    {
        CRadarFL_RXX_Object_Obj15_SetDataReceived(byteArray);
    }

    if(@CAN_PrivMain::RFL_Object::RXX_Object_Obj16.Read == 1)
    {
        CRadarFL_RXX_Object_Obj16_SetDataReceived(byteArray);
    }

    if(@CAN_PrivMain::RFL_Object::RXX_Object_Obj17.Read == 1)
    {
        CRadarFL_RXX_Object_Obj17_SetDataReceived(byteArray);
    }

    if(@CAN_PrivMain::RFL_Object::RXX_Object_Obj18.Read == 1)
    {
        CRadarFL_RXX_Object_Obj18_SetDataReceived(byteArray);
    }

    if(@CAN_PrivMain::RFL_Object::RXX_Object_Obj19.Read == 1)
    {
        CRadarFL_RXX_Object_Obj19_SetDataReceived(byteArray);
    }

    if(@CAN_PrivMain::RFL_Object::RXX_Object_Obj2.Read == 1)
    {
        CRadarFL_RXX_Object_Obj2_SetDataReceived(byteArray);
    }

    if(@CAN_PrivMain::RFL_Object::RXX_Object_Obj20.Read == 1)
    {
        CRadarFL_RXX_Object_Obj20_SetDataReceived(byteArray);
    }

    if(@CAN_PrivMain::RFL_Object::RXX_Object_Obj21.Read == 1)
    {
        CRadarFL_RXX_Object_Obj21_SetDataReceived(byteArray);
    }

    if(@CAN_PrivMain::RFL_Object::RXX_Object_Obj22.Read == 1)
    {
        CRadarFL_RXX_Object_Obj22_SetDataReceived(byteArray);
    }

    if(@CAN_PrivMain::RFL_Object::RXX_Object_Obj23.Read == 1)
    {
        CRadarFL_RXX_Object_Obj23_SetDataReceived(byteArray);
    }

    if(@CAN_PrivMain::RFL_Object::RXX_Object_Obj24.Read == 1)
    {
        CRadarFL_RXX_Object_Obj24_SetDataReceived(byteArray);
    }

    if(@CAN_PrivMain::RFL_Object::RXX_Object_Obj25.Read == 1)
    {
        CRadarFL_RXX_Object_Obj25_SetDataReceived(byteArray);
    }

    if(@CAN_PrivMain::RFL_Object::RXX_Object_Obj26.Read == 1)
    {
        CRadarFL_RXX_Object_Obj26_SetDataReceived(byteArray);
    }

    if(@CAN_PrivMain::RFL_Object::RXX_Object_Obj27.Read == 1)
    {
        CRadarFL_RXX_Object_Obj27_SetDataReceived(byteArray);
    }

    if(@CAN_PrivMain::RFL_Object::RXX_Object_Obj28.Read == 1)
    {
        CRadarFL_RXX_Object_Obj28_SetDataReceived(byteArray);
    }

    if(@CAN_PrivMain::RFL_Object::RXX_Object_Obj29.Read == 1)
    {
        CRadarFL_RXX_Object_Obj29_SetDataReceived(byteArray);
    }

    if(@CAN_PrivMain::RFL_Object::RXX_Object_Obj3.Read == 1)
    {
        CRadarFL_RXX_Object_Obj3_SetDataReceived(byteArray);
    }

    if(@CAN_PrivMain::RFL_Object::RXX_Object_Obj30.Read == 1)
    {
        CRadarFL_RXX_Object_Obj30_SetDataReceived(byteArray);
    }

    if(@CAN_PrivMain::RFL_Object::RXX_Object_Obj31.Read == 1)
    {
        CRadarFL_RXX_Object_Obj31_SetDataReceived(byteArray);
    }

    if(@CAN_PrivMain::RFL_Object::RXX_Object_Obj32.Read == 1)
    {
        CRadarFL_RXX_Object_Obj32_SetDataReceived(byteArray);
    }

    if(@CAN_PrivMain::RFL_Object::RXX_Object_Obj33.Read == 1)
    {
        CRadarFL_RXX_Object_Obj33_SetDataReceived(byteArray);
    }

    if(@CAN_PrivMain::RFL_Object::RXX_Object_Obj34.Read == 1)
    {
        CRadarFL_RXX_Object_Obj34_SetDataReceived(byteArray);
    }

    if(@CAN_PrivMain::RFL_Object::RXX_Object_Obj35.Read == 1)
    {
        CRadarFL_RXX_Object_Obj35_SetDataReceived(byteArray);
    }

    if(@CAN_PrivMain::RFL_Object::RXX_Object_Obj36.Read == 1)
    {
        CRadarFL_RXX_Object_Obj36_SetDataReceived(byteArray);
    }

    if(@CAN_PrivMain::RFL_Object::RXX_Object_Obj37.Read == 1)
    {
        CRadarFL_RXX_Object_Obj37_SetDataReceived(byteArray);
    }

    if(@CAN_PrivMain::RFL_Object::RXX_Object_Obj38.Read == 1)
    {
        CRadarFL_RXX_Object_Obj38_SetDataReceived(byteArray);
    }

    if(@CAN_PrivMain::RFL_Object::RXX_Object_Obj39.Read == 1)
    {
        CRadarFL_RXX_Object_Obj39_SetDataReceived(byteArray);
    }

    if(@CAN_PrivMain::RFL_Object::RXX_Object_Obj4.Read == 1)
    {
        CRadarFL_RXX_Object_Obj4_SetDataReceived(byteArray);
    }

    if(@CAN_PrivMain::RFL_Object::RXX_Object_Obj40.Read == 1)
    {
        CRadarFL_RXX_Object_Obj40_SetDataReceived(byteArray);
    }

    if(@CAN_PrivMain::RFL_Object::RXX_Object_Obj41.Read == 1)
    {
        CRadarFL_RXX_Object_Obj41_SetDataReceived(byteArray);
    }

    if(@CAN_PrivMain::RFL_Object::RXX_Object_Obj42.Read == 1)
    {
        CRadarFL_RXX_Object_Obj42_SetDataReceived(byteArray);
    }

    if(@CAN_PrivMain::RFL_Object::RXX_Object_Obj43.Read == 1)
    {
        CRadarFL_RXX_Object_Obj43_SetDataReceived(byteArray);
    }

    if(@CAN_PrivMain::RFL_Object::RXX_Object_Obj44.Read == 1)
    {
        CRadarFL_RXX_Object_Obj44_SetDataReceived(byteArray);
    }

    if(@CAN_PrivMain::RFL_Object::RXX_Object_Obj45.Read == 1)
    {
        CRadarFL_RXX_Object_Obj45_SetDataReceived(byteArray);
    }

    if(@CAN_PrivMain::RFL_Object::RXX_Object_Obj46.Read == 1)
    {
        CRadarFL_RXX_Object_Obj46_SetDataReceived(byteArray);
    }

    if(@CAN_PrivMain::RFL_Object::RXX_Object_Obj47.Read == 1)
    {
        CRadarFL_RXX_Object_Obj47_SetDataReceived(byteArray);
    }

    if(@CAN_PrivMain::RFL_Object::RXX_Object_Obj48.Read == 1)
    {
        CRadarFL_RXX_Object_Obj48_SetDataReceived(byteArray);
    }

    if(@CAN_PrivMain::RFL_Object::RXX_Object_Obj49.Read == 1)
    {
        CRadarFL_RXX_Object_Obj49_SetDataReceived(byteArray);
    }

    if(@CAN_PrivMain::RFL_Object::RXX_Object_Obj5.Read == 1)
    {
        CRadarFL_RXX_Object_Obj5_SetDataReceived(byteArray);
    }

    if(@CAN_PrivMain::RFL_Object::RXX_Object_Obj6.Read == 1)
    {
        CRadarFL_RXX_Object_Obj6_SetDataReceived(byteArray);
    }

    if(@CAN_PrivMain::RFL_Object::RXX_Object_Obj7.Read == 1)
    {
        CRadarFL_RXX_Object_Obj7_SetDataReceived(byteArray);
    }

    if(@CAN_PrivMain::RFL_Object::RXX_Object_Obj8.Read == 1)
    {
        CRadarFL_RXX_Object_Obj8_SetDataReceived(byteArray);
    }

    if(@CAN_PrivMain::RFL_Object::RXX_Object_Obj9.Read == 1)
    {
        CRadarFL_RXX_Object_Obj9_SetDataReceived(byteArray);
    }
}

on sysvar_update CAN_PrivMain_RFL_Object::Read_No_signals
{
  for (i=1;i<=@this;i++) //enable signal read;
   {
   }
  for (i=@this;i<=500;i++) //disable signal read;
   {
   }
}

void CRadarFR_RXX_Object_Obj1_SetDataReceived(byte byteArray[])
{
    qword raw_value;

    raw_value=copyBitsFromByteArrayLE( byteArray, 1504, 32);
    @CAN_PrivMain::RFR_Object::RXX_Object_Obj1.Age = convertRawToPhysical(raw_value, 1.0, 0.0);

    raw_value=copyBitsFromByteArrayLE( byteArray, 1100, 10);
    @CAN_PrivMain::RFR_Object::RXX_Object_Obj1.Ax = convertRawToPhysical(raw_value, 0.03125, -16.0);

    raw_value=copyBitsFromByteArrayLE( byteArray, 1484, 12);
    @CAN_PrivMain::RFR_Object::RXX_Object_Obj1.AxAyCoVnce = convertRawToPhysical(raw_value, 0.01, 0.0);

    raw_value=copyBitsFromByteArrayLE( byteArray, 1120, 12);
    @CAN_PrivMain::RFR_Object::RXX_Object_Obj1.AxVnce = convertRawToPhysical(raw_value, 0.01, 0.0);

    raw_value=copyBitsFromByteArrayLE( byteArray, 1174, 9);
    @CAN_PrivMain::RFR_Object::RXX_Object_Obj1.Ay = convertRawToPhysical(raw_value, 0.0625, -16.0);

    raw_value=copyBitsFromByteArrayLE( byteArray, 1184, 12);
    @CAN_PrivMain::RFR_Object::RXX_Object_Obj1.AyVnce = convertRawToPhysical(raw_value, 0.01, 0.0);

    raw_value=copyBitsFromByteArrayLE( byteArray, 1240, 6);
    @CAN_PrivMain::RFR_Object::RXX_Object_Obj1.ExistProb = convertRawToPhysical(raw_value, 2.0, 0.0);

    raw_value=copyBitsFromByteArrayLE( byteArray, 1304, 8);
    @CAN_PrivMain::RFR_Object::RXX_Object_Obj1.FilterInformation = convertRawToPhysical(raw_value, 1.0, 0.0);

    raw_value=copyBitsFromByteArrayLE( byteArray, 1080, 7);
    @CAN_PrivMain::RFR_Object::RXX_Object_Obj1.Length = convertRawToPhysical(raw_value, 0.125, 0.0);

    raw_value=copyBitsFromByteArrayLE( byteArray, 1088, 12);
    @CAN_PrivMain::RFR_Object::RXX_Object_Obj1.LengthVnce = convertRawToPhysical(raw_value, 0.01, 0.0);

    raw_value=copyBitsFromByteArrayLE( byteArray, 1272, 3);
    @CAN_PrivMain::RFR_Object::RXX_Object_Obj1.MeasurementStatus = convertRawToPhysical(raw_value, 1.0, 0.0);

    raw_value=copyBitsFromByteArrayLE( byteArray, 1228, 2);
    @CAN_PrivMain::RFR_Object::RXX_Object_Obj1.MovingStatus = convertRawToPhysical(raw_value, 1.0, 0.0);

    raw_value=copyBitsFromByteArrayLE( byteArray, 1208, 7);
    @CAN_PrivMain::RFR_Object::RXX_Object_Obj1.ObjId = convertRawToPhysical(raw_value, 1.0, 0.0);

    raw_value=copyBitsFromByteArrayLE( byteArray, 1110, 9);
    @CAN_PrivMain::RFR_Object::RXX_Object_Obj1.OrientationYaw = convertRawToPhysical(raw_value, 0.0175, -4.48);

    raw_value=copyBitsFromByteArrayLE( byteArray, 1132, 12);
    @CAN_PrivMain::RFR_Object::RXX_Object_Obj1.OrientationYawVnce = convertRawToPhysical(raw_value, 0.0003, 0.0);

    raw_value=copyBitsFromByteArrayLE( byteArray, 1024, 6);
    @CAN_PrivMain::RFR_Object::RXX_Object_Obj1.ProbClassConfidence = convertRawToPhysical(raw_value, 2.0, 0.0);

    raw_value=copyBitsFromByteArrayLE( byteArray, 1275, 4);
    @CAN_PrivMain::RFR_Object::RXX_Object_Obj1.ProbClassType = convertRawToPhysical(raw_value, 1.0, 0.0);

    raw_value=copyBitsFromByteArrayLE( byteArray, 1030, 14);
    @CAN_PrivMain::RFR_Object::RXX_Object_Obj1.Px = convertRawToPhysical(raw_value, 0.0625, -512.0);

    raw_value=copyBitsFromByteArrayLE( byteArray, 1344, 12);
    @CAN_PrivMain::RFR_Object::RXX_Object_Obj1.PxAxCoVnce = convertRawToPhysical(raw_value, 0.01, 0.0);

    raw_value=copyBitsFromByteArrayLE( byteArray, 1356, 12);
    @CAN_PrivMain::RFR_Object::RXX_Object_Obj1.PxAyCoVnce = convertRawToPhysical(raw_value, 0.01, 0.0);

    raw_value=copyBitsFromByteArrayLE( byteArray, 1260, 12);
    @CAN_PrivMain::RFR_Object::RXX_Object_Obj1.PxPyCoVnce = convertRawToPhysical(raw_value, 0.01, 0.0);

    raw_value=copyBitsFromByteArrayLE( byteArray, 1044, 12);
    @CAN_PrivMain::RFR_Object::RXX_Object_Obj1.PxVnce = convertRawToPhysical(raw_value, 0.1, 0.0);

    raw_value=copyBitsFromByteArrayLE( byteArray, 1280, 12);
    @CAN_PrivMain::RFR_Object::RXX_Object_Obj1.PxVxCoVnce = convertRawToPhysical(raw_value, 0.01, 0.0);

    raw_value=copyBitsFromByteArrayLE( byteArray, 1292, 12);
    @CAN_PrivMain::RFR_Object::RXX_Object_Obj1.PxVyCoVnce = convertRawToPhysical(raw_value, 0.01, 0.0);

    raw_value=copyBitsFromByteArrayLE( byteArray, 1056, 12);
    @CAN_PrivMain::RFR_Object::RXX_Object_Obj1.Py = convertRawToPhysical(raw_value, 0.0625, -128.0);

    raw_value=copyBitsFromByteArrayLE( byteArray, 1376, 12);
    @CAN_PrivMain::RFR_Object::RXX_Object_Obj1.PyAxCoVnce = convertRawToPhysical(raw_value, 0.01, 0.0);

    raw_value=copyBitsFromByteArrayLE( byteArray, 1388, 12);
    @CAN_PrivMain::RFR_Object::RXX_Object_Obj1.PyAyCoVnce = convertRawToPhysical(raw_value, 0.01, 0.0);

    raw_value=copyBitsFromByteArrayLE( byteArray, 1068, 12);
    @CAN_PrivMain::RFR_Object::RXX_Object_Obj1.PyVnce = convertRawToPhysical(raw_value, 0.1, 0.0);

    raw_value=copyBitsFromByteArrayLE( byteArray, 1312, 12);
    @CAN_PrivMain::RFR_Object::RXX_Object_Obj1.PyVxCoVnce = convertRawToPhysical(raw_value, 0.01, 0.0);

    raw_value=copyBitsFromByteArrayLE( byteArray, 1324, 12);
    @CAN_PrivMain::RFR_Object::RXX_Object_Obj1.PyVyCoVnce = convertRawToPhysical(raw_value, 0.01, 0.0);

    raw_value=copyBitsFromByteArrayLE( byteArray, 1164, 10);
    @CAN_PrivMain::RFR_Object::RXX_Object_Obj1.RCS = convertRawToPhysical(raw_value, 0.2, -102.4);

    raw_value=copyBitsFromByteArrayLE( byteArray, 1336, 4);
    @CAN_PrivMain::RFR_Object::RXX_Object_Obj1.ReferencePoint = convertRawToPhysical(raw_value, 1.0, 0.0);

    raw_value=copyBitsFromByteArrayLE( byteArray, 1196, 12);
    @CAN_PrivMain::RFR_Object::RXX_Object_Obj1.Vx = convertRawToPhysical(raw_value, 0.0625, -128.0);

    raw_value=copyBitsFromByteArrayLE( byteArray, 1420, 12);
    @CAN_PrivMain::RFR_Object::RXX_Object_Obj1.VxAxCoVnce = convertRawToPhysical(raw_value, 0.01, 0.0);

    raw_value=copyBitsFromByteArrayLE( byteArray, 1440, 12);
    @CAN_PrivMain::RFR_Object::RXX_Object_Obj1.VxAyCoVnce = convertRawToPhysical(raw_value, 0.01, 0.0);

    raw_value=copyBitsFromByteArrayLE( byteArray, 1216, 12);
    @CAN_PrivMain::RFR_Object::RXX_Object_Obj1.VxVnce = convertRawToPhysical(raw_value, 0.01, 0.0);

    raw_value=copyBitsFromByteArrayLE( byteArray, 1408, 12);
    @CAN_PrivMain::RFR_Object::RXX_Object_Obj1.VxVyCoVnce = convertRawToPhysical(raw_value, 0.01, 0.0);

    raw_value=copyBitsFromByteArrayLE( byteArray, 1230, 10);
    @CAN_PrivMain::RFR_Object::RXX_Object_Obj1.Vy = convertRawToPhysical(raw_value, 0.125, -64.0);

    raw_value=copyBitsFromByteArrayLE( byteArray, 1452, 12);
    @CAN_PrivMain::RFR_Object::RXX_Object_Obj1.VyAxCoVnce = convertRawToPhysical(raw_value, 0.01, 0.0);

    raw_value=copyBitsFromByteArrayLE( byteArray, 1472, 12);
    @CAN_PrivMain::RFR_Object::RXX_Object_Obj1.VyAyCoVnce = convertRawToPhysical(raw_value, 0.01, 0.0);

    raw_value=copyBitsFromByteArrayLE( byteArray, 1248, 12);
    @CAN_PrivMain::RFR_Object::RXX_Object_Obj1.VyVnce = convertRawToPhysical(raw_value, 0.01, 0.0);

    raw_value=copyBitsFromByteArrayLE( byteArray, 1144, 7);
    @CAN_PrivMain::RFR_Object::RXX_Object_Obj1.Width = convertRawToPhysical(raw_value, 0.125, 0.0);

    raw_value=copyBitsFromByteArrayLE( byteArray, 1152, 12);
    @CAN_PrivMain::RFR_Object::RXX_Object_Obj1.WidthVnce = convertRawToPhysical(raw_value, 0.01, 0.0);
}


void CRadarFR_RXX_Object_Obj10_SetDataReceived(byte byteArray[])
{
    qword raw_value;

    raw_value=copyBitsFromByteArrayLE( byteArray, 6112, 32);
    @CAN_PrivMain::RFR_Object::RXX_Object_Obj10.Age = convertRawToPhysical(raw_value, 1.0, 0.0);

    raw_value=copyBitsFromByteArrayLE( byteArray, 5708, 10);
    @CAN_PrivMain::RFR_Object::RXX_Object_Obj10.Ax = convertRawToPhysical(raw_value, 0.03125, -16.0);

    raw_value=copyBitsFromByteArrayLE( byteArray, 6092, 12);
    @CAN_PrivMain::RFR_Object::RXX_Object_Obj10.AxAyCoVnce = convertRawToPhysical(raw_value, 0.01, 0.0);

    raw_value=copyBitsFromByteArrayLE( byteArray, 5728, 12);
    @CAN_PrivMain::RFR_Object::RXX_Object_Obj10.AxVnce = convertRawToPhysical(raw_value, 0.01, 0.0);

    raw_value=copyBitsFromByteArrayLE( byteArray, 5782, 9);
    @CAN_PrivMain::RFR_Object::RXX_Object_Obj10.Ay = convertRawToPhysical(raw_value, 0.0625, -16.0);

    raw_value=copyBitsFromByteArrayLE( byteArray, 5792, 12);
    @CAN_PrivMain::RFR_Object::RXX_Object_Obj10.AyVnce = convertRawToPhysical(raw_value, 0.01, 0.0);

    raw_value=copyBitsFromByteArrayLE( byteArray, 5848, 6);
    @CAN_PrivMain::RFR_Object::RXX_Object_Obj10.ExistProb = convertRawToPhysical(raw_value, 2.0, 0.0);

    raw_value=copyBitsFromByteArrayLE( byteArray, 5912, 8);
    @CAN_PrivMain::RFR_Object::RXX_Object_Obj10.FilterInformation = convertRawToPhysical(raw_value, 1.0, 0.0);

    raw_value=copyBitsFromByteArrayLE( byteArray, 5688, 7);
    @CAN_PrivMain::RFR_Object::RXX_Object_Obj10.Length = convertRawToPhysical(raw_value, 0.125, 0.0);

    raw_value=copyBitsFromByteArrayLE( byteArray, 5696, 12);
    @CAN_PrivMain::RFR_Object::RXX_Object_Obj10.LengthVnce = convertRawToPhysical(raw_value, 0.01, 0.0);

    raw_value=copyBitsFromByteArrayLE( byteArray, 5880, 3);
    @CAN_PrivMain::RFR_Object::RXX_Object_Obj10.MeasurementStatus = convertRawToPhysical(raw_value, 1.0, 0.0);

    raw_value=copyBitsFromByteArrayLE( byteArray, 5836, 2);
    @CAN_PrivMain::RFR_Object::RXX_Object_Obj10.MovingStatus = convertRawToPhysical(raw_value, 1.0, 0.0);

    raw_value=copyBitsFromByteArrayLE( byteArray, 5816, 7);
    @CAN_PrivMain::RFR_Object::RXX_Object_Obj10.ObjId = convertRawToPhysical(raw_value, 1.0, 0.0);

    raw_value=copyBitsFromByteArrayLE( byteArray, 5718, 9);
    @CAN_PrivMain::RFR_Object::RXX_Object_Obj10.OrientationYaw = convertRawToPhysical(raw_value, 0.0175, -4.48);

    raw_value=copyBitsFromByteArrayLE( byteArray, 5740, 12);
    @CAN_PrivMain::RFR_Object::RXX_Object_Obj10.OrientationYawVnce = convertRawToPhysical(raw_value, 0.0003, 0.0);

    raw_value=copyBitsFromByteArrayLE( byteArray, 5632, 6);
    @CAN_PrivMain::RFR_Object::RXX_Object_Obj10.ProbClassConfidence = convertRawToPhysical(raw_value, 2.0, 0.0);

    raw_value=copyBitsFromByteArrayLE( byteArray, 5883, 4);
    @CAN_PrivMain::RFR_Object::RXX_Object_Obj10.ProbClassType = convertRawToPhysical(raw_value, 1.0, 0.0);

    raw_value=copyBitsFromByteArrayLE( byteArray, 5638, 14);
    @CAN_PrivMain::RFR_Object::RXX_Object_Obj10.Px = convertRawToPhysical(raw_value, 0.0625, -512.0);

    raw_value=copyBitsFromByteArrayLE( byteArray, 5952, 12);
    @CAN_PrivMain::RFR_Object::RXX_Object_Obj10.PxAxCoVnce = convertRawToPhysical(raw_value, 0.01, 0.0);

    raw_value=copyBitsFromByteArrayLE( byteArray, 5964, 12);
    @CAN_PrivMain::RFR_Object::RXX_Object_Obj10.PxAyCoVnce = convertRawToPhysical(raw_value, 0.01, 0.0);

    raw_value=copyBitsFromByteArrayLE( byteArray, 5868, 12);
    @CAN_PrivMain::RFR_Object::RXX_Object_Obj10.PxPyCoVnce = convertRawToPhysical(raw_value, 0.01, 0.0);

    raw_value=copyBitsFromByteArrayLE( byteArray, 5652, 12);
    @CAN_PrivMain::RFR_Object::RXX_Object_Obj10.PxVnce = convertRawToPhysical(raw_value, 0.1, 0.0);

    raw_value=copyBitsFromByteArrayLE( byteArray, 5888, 12);
    @CAN_PrivMain::RFR_Object::RXX_Object_Obj10.PxVxCoVnce = convertRawToPhysical(raw_value, 0.01, 0.0);

    raw_value=copyBitsFromByteArrayLE( byteArray, 5900, 12);
    @CAN_PrivMain::RFR_Object::RXX_Object_Obj10.PxVyCoVnce = convertRawToPhysical(raw_value, 0.01, 0.0);

    raw_value=copyBitsFromByteArrayLE( byteArray, 5664, 12);
    @CAN_PrivMain::RFR_Object::RXX_Object_Obj10.Py = convertRawToPhysical(raw_value, 0.0625, -128.0);

    raw_value=copyBitsFromByteArrayLE( byteArray, 5984, 12);
    @CAN_PrivMain::RFR_Object::RXX_Object_Obj10.PyAxCoVnce = convertRawToPhysical(raw_value, 0.01, 0.0);

    raw_value=copyBitsFromByteArrayLE( byteArray, 5996, 12);
    @CAN_PrivMain::RFR_Object::RXX_Object_Obj10.PyAyCoVnce = convertRawToPhysical(raw_value, 0.01, 0.0);

    raw_value=copyBitsFromByteArrayLE( byteArray, 5676, 12);
    @CAN_PrivMain::RFR_Object::RXX_Object_Obj10.PyVnce = convertRawToPhysical(raw_value, 0.1, 0.0);

    raw_value=copyBitsFromByteArrayLE( byteArray, 5920, 12);
    @CAN_PrivMain::RFR_Object::RXX_Object_Obj10.PyVxCoVnce = convertRawToPhysical(raw_value, 0.01, 0.0);

    raw_value=copyBitsFromByteArrayLE( byteArray, 5932, 12);
    @CAN_PrivMain::RFR_Object::RXX_Object_Obj10.PyVyCoVnce = convertRawToPhysical(raw_value, 0.01, 0.0);

    raw_value=copyBitsFromByteArrayLE( byteArray, 5772, 10);
    @CAN_PrivMain::RFR_Object::RXX_Object_Obj10.RCS = convertRawToPhysical(raw_value, 0.2, -102.4);

    raw_value=copyBitsFromByteArrayLE( byteArray, 5944, 4);
    @CAN_PrivMain::RFR_Object::RXX_Object_Obj10.ReferencePoint = convertRawToPhysical(raw_value, 1.0, 0.0);

    raw_value=copyBitsFromByteArrayLE( byteArray, 5804, 12);
    @CAN_PrivMain::RFR_Object::RXX_Object_Obj10.Vx = convertRawToPhysical(raw_value, 0.0625, -128.0);

    raw_value=copyBitsFromByteArrayLE( byteArray, 6028, 12);
    @CAN_PrivMain::RFR_Object::RXX_Object_Obj10.VxAxCoVnce = convertRawToPhysical(raw_value, 0.01, 0.0);

    raw_value=copyBitsFromByteArrayLE( byteArray, 6048, 12);
    @CAN_PrivMain::RFR_Object::RXX_Object_Obj10.VxAyCoVnce = convertRawToPhysical(raw_value, 0.01, 0.0);

    raw_value=copyBitsFromByteArrayLE( byteArray, 5824, 12);
    @CAN_PrivMain::RFR_Object::RXX_Object_Obj10.VxVnce = convertRawToPhysical(raw_value, 0.01, 0.0);

    raw_value=copyBitsFromByteArrayLE( byteArray, 6016, 12);
    @CAN_PrivMain::RFR_Object::RXX_Object_Obj10.VxVyCoVnce = convertRawToPhysical(raw_value, 0.01, 0.0);

    raw_value=copyBitsFromByteArrayLE( byteArray, 5838, 10);
    @CAN_PrivMain::RFR_Object::RXX_Object_Obj10.Vy = convertRawToPhysical(raw_value, 0.125, -64.0);

    raw_value=copyBitsFromByteArrayLE( byteArray, 6060, 12);
    @CAN_PrivMain::RFR_Object::RXX_Object_Obj10.VyAxCoVnce = convertRawToPhysical(raw_value, 0.01, 0.0);

    raw_value=copyBitsFromByteArrayLE( byteArray, 6080, 12);
    @CAN_PrivMain::RFR_Object::RXX_Object_Obj10.VyAyCoVnce = convertRawToPhysical(raw_value, 0.01, 0.0);

    raw_value=copyBitsFromByteArrayLE( byteArray, 5856, 12);
    @CAN_PrivMain::RFR_Object::RXX_Object_Obj10.VyVnce = convertRawToPhysical(raw_value, 0.01, 0.0);

    raw_value=copyBitsFromByteArrayLE( byteArray, 5752, 7);
    @CAN_PrivMain::RFR_Object::RXX_Object_Obj10.Width = convertRawToPhysical(raw_value, 0.125, 0.0);

    raw_value=copyBitsFromByteArrayLE( byteArray, 5760, 12);
    @CAN_PrivMain::RFR_Object::RXX_Object_Obj10.WidthVnce = convertRawToPhysical(raw_value, 0.01, 0.0);
}


void CRadarFR_RXX_Object_Obj11_SetDataReceived(byte byteArray[])
{
    qword raw_value;

    raw_value=copyBitsFromByteArrayLE( byteArray, 6624, 32);
    @CAN_PrivMain::RFR_Object::RXX_Object_Obj11.Age = convertRawToPhysical(raw_value, 1.0, 0.0);

    raw_value=copyBitsFromByteArrayLE( byteArray, 6220, 10);
    @CAN_PrivMain::RFR_Object::RXX_Object_Obj11.Ax = convertRawToPhysical(raw_value, 0.03125, -16.0);

    raw_value=copyBitsFromByteArrayLE( byteArray, 6604, 12);
    @CAN_PrivMain::RFR_Object::RXX_Object_Obj11.AxAyCoVnce = convertRawToPhysical(raw_value, 0.01, 0.0);

    raw_value=copyBitsFromByteArrayLE( byteArray, 6240, 12);
    @CAN_PrivMain::RFR_Object::RXX_Object_Obj11.AxVnce = convertRawToPhysical(raw_value, 0.01, 0.0);

    raw_value=copyBitsFromByteArrayLE( byteArray, 6294, 9);
    @CAN_PrivMain::RFR_Object::RXX_Object_Obj11.Ay = convertRawToPhysical(raw_value, 0.0625, -16.0);

    raw_value=copyBitsFromByteArrayLE( byteArray, 6304, 12);
    @CAN_PrivMain::RFR_Object::RXX_Object_Obj11.AyVnce = convertRawToPhysical(raw_value, 0.01, 0.0);

    raw_value=copyBitsFromByteArrayLE( byteArray, 6360, 6);
    @CAN_PrivMain::RFR_Object::RXX_Object_Obj11.ExistProb = convertRawToPhysical(raw_value, 2.0, 0.0);

    raw_value=copyBitsFromByteArrayLE( byteArray, 6424, 8);
    @CAN_PrivMain::RFR_Object::RXX_Object_Obj11.FilterInformation = convertRawToPhysical(raw_value, 1.0, 0.0);

    raw_value=copyBitsFromByteArrayLE( byteArray, 6200, 7);
    @CAN_PrivMain::RFR_Object::RXX_Object_Obj11.Length = convertRawToPhysical(raw_value, 0.125, 0.0);

    raw_value=copyBitsFromByteArrayLE( byteArray, 6208, 12);
    @CAN_PrivMain::RFR_Object::RXX_Object_Obj11.LengthVnce = convertRawToPhysical(raw_value, 0.01, 0.0);

    raw_value=copyBitsFromByteArrayLE( byteArray, 6392, 3);
    @CAN_PrivMain::RFR_Object::RXX_Object_Obj11.MeasurementStatus = convertRawToPhysical(raw_value, 1.0, 0.0);

    raw_value=copyBitsFromByteArrayLE( byteArray, 6348, 2);
    @CAN_PrivMain::RFR_Object::RXX_Object_Obj11.MovingStatus = convertRawToPhysical(raw_value, 1.0, 0.0);

    raw_value=copyBitsFromByteArrayLE( byteArray, 6328, 7);
    @CAN_PrivMain::RFR_Object::RXX_Object_Obj11.ObjId = convertRawToPhysical(raw_value, 1.0, 0.0);

    raw_value=copyBitsFromByteArrayLE( byteArray, 6230, 9);
    @CAN_PrivMain::RFR_Object::RXX_Object_Obj11.OrientationYaw = convertRawToPhysical(raw_value, 0.0175, -4.48);

    raw_value=copyBitsFromByteArrayLE( byteArray, 6252, 12);
    @CAN_PrivMain::RFR_Object::RXX_Object_Obj11.OrientationYawVnce = convertRawToPhysical(raw_value, 0.0003, 0.0);

    raw_value=copyBitsFromByteArrayLE( byteArray, 6144, 6);
    @CAN_PrivMain::RFR_Object::RXX_Object_Obj11.ProbClassConfidence = convertRawToPhysical(raw_value, 2.0, 0.0);

    raw_value=copyBitsFromByteArrayLE( byteArray, 6395, 4);
    @CAN_PrivMain::RFR_Object::RXX_Object_Obj11.ProbClassType = convertRawToPhysical(raw_value, 1.0, 0.0);

    raw_value=copyBitsFromByteArrayLE( byteArray, 6150, 14);
    @CAN_PrivMain::RFR_Object::RXX_Object_Obj11.Px = convertRawToPhysical(raw_value, 0.0625, -512.0);

    raw_value=copyBitsFromByteArrayLE( byteArray, 6464, 12);
    @CAN_PrivMain::RFR_Object::RXX_Object_Obj11.PxAxCoVnce = convertRawToPhysical(raw_value, 0.01, 0.0);

    raw_value=copyBitsFromByteArrayLE( byteArray, 6476, 12);
    @CAN_PrivMain::RFR_Object::RXX_Object_Obj11.PxAyCoVnce = convertRawToPhysical(raw_value, 0.01, 0.0);

    raw_value=copyBitsFromByteArrayLE( byteArray, 6380, 12);
    @CAN_PrivMain::RFR_Object::RXX_Object_Obj11.PxPyCoVnce = convertRawToPhysical(raw_value, 0.01, 0.0);

    raw_value=copyBitsFromByteArrayLE( byteArray, 6164, 12);
    @CAN_PrivMain::RFR_Object::RXX_Object_Obj11.PxVnce = convertRawToPhysical(raw_value, 0.1, 0.0);

    raw_value=copyBitsFromByteArrayLE( byteArray, 6400, 12);
    @CAN_PrivMain::RFR_Object::RXX_Object_Obj11.PxVxCoVnce = convertRawToPhysical(raw_value, 0.01, 0.0);

    raw_value=copyBitsFromByteArrayLE( byteArray, 6412, 12);
    @CAN_PrivMain::RFR_Object::RXX_Object_Obj11.PxVyCoVnce = convertRawToPhysical(raw_value, 0.01, 0.0);

    raw_value=copyBitsFromByteArrayLE( byteArray, 6176, 12);
    @CAN_PrivMain::RFR_Object::RXX_Object_Obj11.Py = convertRawToPhysical(raw_value, 0.0625, -128.0);

    raw_value=copyBitsFromByteArrayLE( byteArray, 6496, 12);
    @CAN_PrivMain::RFR_Object::RXX_Object_Obj11.PyAxCoVnce = convertRawToPhysical(raw_value, 0.01, 0.0);

    raw_value=copyBitsFromByteArrayLE( byteArray, 6508, 12);
    @CAN_PrivMain::RFR_Object::RXX_Object_Obj11.PyAyCoVnce = convertRawToPhysical(raw_value, 0.01, 0.0);

    raw_value=copyBitsFromByteArrayLE( byteArray, 6188, 12);
    @CAN_PrivMain::RFR_Object::RXX_Object_Obj11.PyVnce = convertRawToPhysical(raw_value, 0.1, 0.0);

    raw_value=copyBitsFromByteArrayLE( byteArray, 6432, 12);
    @CAN_PrivMain::RFR_Object::RXX_Object_Obj11.PyVxCoVnce = convertRawToPhysical(raw_value, 0.01, 0.0);

    raw_value=copyBitsFromByteArrayLE( byteArray, 6444, 12);
    @CAN_PrivMain::RFR_Object::RXX_Object_Obj11.PyVyCoVnce = convertRawToPhysical(raw_value, 0.01, 0.0);

    raw_value=copyBitsFromByteArrayLE( byteArray, 6284, 10);
    @CAN_PrivMain::RFR_Object::RXX_Object_Obj11.RCS = convertRawToPhysical(raw_value, 0.2, -102.4);

    raw_value=copyBitsFromByteArrayLE( byteArray, 6456, 4);
    @CAN_PrivMain::RFR_Object::RXX_Object_Obj11.ReferencePoint = convertRawToPhysical(raw_value, 1.0, 0.0);

    raw_value=copyBitsFromByteArrayLE( byteArray, 6316, 12);
    @CAN_PrivMain::RFR_Object::RXX_Object_Obj11.Vx = convertRawToPhysical(raw_value, 0.0625, -128.0);

    raw_value=copyBitsFromByteArrayLE( byteArray, 6540, 12);
    @CAN_PrivMain::RFR_Object::RXX_Object_Obj11.VxAxCoVnce = convertRawToPhysical(raw_value, 0.01, 0.0);

    raw_value=copyBitsFromByteArrayLE( byteArray, 6560, 12);
    @CAN_PrivMain::RFR_Object::RXX_Object_Obj11.VxAyCoVnce = convertRawToPhysical(raw_value, 0.01, 0.0);

    raw_value=copyBitsFromByteArrayLE( byteArray, 6336, 12);
    @CAN_PrivMain::RFR_Object::RXX_Object_Obj11.VxVnce = convertRawToPhysical(raw_value, 0.01, 0.0);

    raw_value=copyBitsFromByteArrayLE( byteArray, 6528, 12);
    @CAN_PrivMain::RFR_Object::RXX_Object_Obj11.VxVyCoVnce = convertRawToPhysical(raw_value, 0.01, 0.0);

    raw_value=copyBitsFromByteArrayLE( byteArray, 6350, 10);
    @CAN_PrivMain::RFR_Object::RXX_Object_Obj11.Vy = convertRawToPhysical(raw_value, 0.125, -64.0);

    raw_value=copyBitsFromByteArrayLE( byteArray, 6572, 12);
    @CAN_PrivMain::RFR_Object::RXX_Object_Obj11.VyAxCoVnce = convertRawToPhysical(raw_value, 0.01, 0.0);

    raw_value=copyBitsFromByteArrayLE( byteArray, 6592, 12);
    @CAN_PrivMain::RFR_Object::RXX_Object_Obj11.VyAyCoVnce = convertRawToPhysical(raw_value, 0.01, 0.0);

    raw_value=copyBitsFromByteArrayLE( byteArray, 6368, 12);
    @CAN_PrivMain::RFR_Object::RXX_Object_Obj11.VyVnce = convertRawToPhysical(raw_value, 0.01, 0.0);

    raw_value=copyBitsFromByteArrayLE( byteArray, 6264, 7);
    @CAN_PrivMain::RFR_Object::RXX_Object_Obj11.Width = convertRawToPhysical(raw_value, 0.125, 0.0);

    raw_value=copyBitsFromByteArrayLE( byteArray, 6272, 12);
    @CAN_PrivMain::RFR_Object::RXX_Object_Obj11.WidthVnce = convertRawToPhysical(raw_value, 0.01, 0.0);
}


void CRadarFR_RXX_Object_Obj12_SetDataReceived(byte byteArray[])
{
    qword raw_value;

    raw_value=copyBitsFromByteArrayLE( byteArray, 7136, 32);
    @CAN_PrivMain::RFR_Object::RXX_Object_Obj12.Age = convertRawToPhysical(raw_value, 1.0, 0.0);

    raw_value=copyBitsFromByteArrayLE( byteArray, 6732, 10);
    @CAN_PrivMain::RFR_Object::RXX_Object_Obj12.Ax = convertRawToPhysical(raw_value, 0.03125, -16.0);

    raw_value=copyBitsFromByteArrayLE( byteArray, 7116, 12);
    @CAN_PrivMain::RFR_Object::RXX_Object_Obj12.AxAyCoVnce = convertRawToPhysical(raw_value, 0.01, 0.0);

    raw_value=copyBitsFromByteArrayLE( byteArray, 6752, 12);
    @CAN_PrivMain::RFR_Object::RXX_Object_Obj12.AxVnce = convertRawToPhysical(raw_value, 0.01, 0.0);

    raw_value=copyBitsFromByteArrayLE( byteArray, 6806, 9);
    @CAN_PrivMain::RFR_Object::RXX_Object_Obj12.Ay = convertRawToPhysical(raw_value, 0.0625, -16.0);

    raw_value=copyBitsFromByteArrayLE( byteArray, 6816, 12);
    @CAN_PrivMain::RFR_Object::RXX_Object_Obj12.AyVnce = convertRawToPhysical(raw_value, 0.01, 0.0);

    raw_value=copyBitsFromByteArrayLE( byteArray, 6872, 6);
    @CAN_PrivMain::RFR_Object::RXX_Object_Obj12.ExistProb = convertRawToPhysical(raw_value, 2.0, 0.0);

    raw_value=copyBitsFromByteArrayLE( byteArray, 6936, 8);
    @CAN_PrivMain::RFR_Object::RXX_Object_Obj12.FilterInformation = convertRawToPhysical(raw_value, 1.0, 0.0);

    raw_value=copyBitsFromByteArrayLE( byteArray, 6712, 7);
    @CAN_PrivMain::RFR_Object::RXX_Object_Obj12.Length = convertRawToPhysical(raw_value, 0.125, 0.0);

    raw_value=copyBitsFromByteArrayLE( byteArray, 6720, 12);
    @CAN_PrivMain::RFR_Object::RXX_Object_Obj12.LengthVnce = convertRawToPhysical(raw_value, 0.01, 0.0);

    raw_value=copyBitsFromByteArrayLE( byteArray, 6904, 3);
    @CAN_PrivMain::RFR_Object::RXX_Object_Obj12.MeasurementStatus = convertRawToPhysical(raw_value, 1.0, 0.0);

    raw_value=copyBitsFromByteArrayLE( byteArray, 6860, 2);
    @CAN_PrivMain::RFR_Object::RXX_Object_Obj12.MovingStatus = convertRawToPhysical(raw_value, 1.0, 0.0);

    raw_value=copyBitsFromByteArrayLE( byteArray, 6840, 7);
    @CAN_PrivMain::RFR_Object::RXX_Object_Obj12.ObjId = convertRawToPhysical(raw_value, 1.0, 0.0);

    raw_value=copyBitsFromByteArrayLE( byteArray, 6742, 9);
    @CAN_PrivMain::RFR_Object::RXX_Object_Obj12.OrientationYaw = convertRawToPhysical(raw_value, 0.0175, -4.48);

    raw_value=copyBitsFromByteArrayLE( byteArray, 6764, 12);
    @CAN_PrivMain::RFR_Object::RXX_Object_Obj12.OrientationYawVnce = convertRawToPhysical(raw_value, 0.0003, 0.0);

    raw_value=copyBitsFromByteArrayLE( byteArray, 6656, 6);
    @CAN_PrivMain::RFR_Object::RXX_Object_Obj12.ProbClassConfidence = convertRawToPhysical(raw_value, 2.0, 0.0);

    raw_value=copyBitsFromByteArrayLE( byteArray, 6907, 4);
    @CAN_PrivMain::RFR_Object::RXX_Object_Obj12.ProbClassType = convertRawToPhysical(raw_value, 1.0, 0.0);

    raw_value=copyBitsFromByteArrayLE( byteArray, 6662, 14);
    @CAN_PrivMain::RFR_Object::RXX_Object_Obj12.Px = convertRawToPhysical(raw_value, 0.0625, -512.0);

    raw_value=copyBitsFromByteArrayLE( byteArray, 6976, 12);
    @CAN_PrivMain::RFR_Object::RXX_Object_Obj12.PxAxCoVnce = convertRawToPhysical(raw_value, 0.01, 0.0);

    raw_value=copyBitsFromByteArrayLE( byteArray, 6988, 12);
    @CAN_PrivMain::RFR_Object::RXX_Object_Obj12.PxAyCoVnce = convertRawToPhysical(raw_value, 0.01, 0.0);

    raw_value=copyBitsFromByteArrayLE( byteArray, 6892, 12);
    @CAN_PrivMain::RFR_Object::RXX_Object_Obj12.PxPyCoVnce = convertRawToPhysical(raw_value, 0.01, 0.0);

    raw_value=copyBitsFromByteArrayLE( byteArray, 6676, 12);
    @CAN_PrivMain::RFR_Object::RXX_Object_Obj12.PxVnce = convertRawToPhysical(raw_value, 0.1, 0.0);

    raw_value=copyBitsFromByteArrayLE( byteArray, 6912, 12);
    @CAN_PrivMain::RFR_Object::RXX_Object_Obj12.PxVxCoVnce = convertRawToPhysical(raw_value, 0.01, 0.0);

    raw_value=copyBitsFromByteArrayLE( byteArray, 6924, 12);
    @CAN_PrivMain::RFR_Object::RXX_Object_Obj12.PxVyCoVnce = convertRawToPhysical(raw_value, 0.01, 0.0);

    raw_value=copyBitsFromByteArrayLE( byteArray, 6688, 12);
    @CAN_PrivMain::RFR_Object::RXX_Object_Obj12.Py = convertRawToPhysical(raw_value, 0.0625, -128.0);

    raw_value=copyBitsFromByteArrayLE( byteArray, 7008, 12);
    @CAN_PrivMain::RFR_Object::RXX_Object_Obj12.PyAxCoVnce = convertRawToPhysical(raw_value, 0.01, 0.0);

    raw_value=copyBitsFromByteArrayLE( byteArray, 7020, 12);
    @CAN_PrivMain::RFR_Object::RXX_Object_Obj12.PyAyCoVnce = convertRawToPhysical(raw_value, 0.01, 0.0);

    raw_value=copyBitsFromByteArrayLE( byteArray, 6700, 12);
    @CAN_PrivMain::RFR_Object::RXX_Object_Obj12.PyVnce = convertRawToPhysical(raw_value, 0.1, 0.0);

    raw_value=copyBitsFromByteArrayLE( byteArray, 6944, 12);
    @CAN_PrivMain::RFR_Object::RXX_Object_Obj12.PyVxCoVnce = convertRawToPhysical(raw_value, 0.01, 0.0);

    raw_value=copyBitsFromByteArrayLE( byteArray, 6956, 12);
    @CAN_PrivMain::RFR_Object::RXX_Object_Obj12.PyVyCoVnce = convertRawToPhysical(raw_value, 0.01, 0.0);

    raw_value=copyBitsFromByteArrayLE( byteArray, 6796, 10);
    @CAN_PrivMain::RFR_Object::RXX_Object_Obj12.RCS = convertRawToPhysical(raw_value, 0.2, -102.4);

    raw_value=copyBitsFromByteArrayLE( byteArray, 6968, 4);
    @CAN_PrivMain::RFR_Object::RXX_Object_Obj12.ReferencePoint = convertRawToPhysical(raw_value, 1.0, 0.0);

    raw_value=copyBitsFromByteArrayLE( byteArray, 6828, 12);
    @CAN_PrivMain::RFR_Object::RXX_Object_Obj12.Vx = convertRawToPhysical(raw_value, 0.0625, -128.0);

    raw_value=copyBitsFromByteArrayLE( byteArray, 7052, 12);
    @CAN_PrivMain::RFR_Object::RXX_Object_Obj12.VxAxCoVnce = convertRawToPhysical(raw_value, 0.01, 0.0);

    raw_value=copyBitsFromByteArrayLE( byteArray, 7072, 12);
    @CAN_PrivMain::RFR_Object::RXX_Object_Obj12.VxAyCoVnce = convertRawToPhysical(raw_value, 0.01, 0.0);

    raw_value=copyBitsFromByteArrayLE( byteArray, 6848, 12);
    @CAN_PrivMain::RFR_Object::RXX_Object_Obj12.VxVnce = convertRawToPhysical(raw_value, 0.01, 0.0);

    raw_value=copyBitsFromByteArrayLE( byteArray, 7040, 12);
    @CAN_PrivMain::RFR_Object::RXX_Object_Obj12.VxVyCoVnce = convertRawToPhysical(raw_value, 0.01, 0.0);

    raw_value=copyBitsFromByteArrayLE( byteArray, 6862, 10);
    @CAN_PrivMain::RFR_Object::RXX_Object_Obj12.Vy = convertRawToPhysical(raw_value, 0.125, -64.0);

    raw_value=copyBitsFromByteArrayLE( byteArray, 7084, 12);
    @CAN_PrivMain::RFR_Object::RXX_Object_Obj12.VyAxCoVnce = convertRawToPhysical(raw_value, 0.01, 0.0);

    raw_value=copyBitsFromByteArrayLE( byteArray, 7104, 12);
    @CAN_PrivMain::RFR_Object::RXX_Object_Obj12.VyAyCoVnce = convertRawToPhysical(raw_value, 0.01, 0.0);

    raw_value=copyBitsFromByteArrayLE( byteArray, 6880, 12);
    @CAN_PrivMain::RFR_Object::RXX_Object_Obj12.VyVnce = convertRawToPhysical(raw_value, 0.01, 0.0);

    raw_value=copyBitsFromByteArrayLE( byteArray, 6776, 7);
    @CAN_PrivMain::RFR_Object::RXX_Object_Obj12.Width = convertRawToPhysical(raw_value, 0.125, 0.0);

    raw_value=copyBitsFromByteArrayLE( byteArray, 6784, 12);
    @CAN_PrivMain::RFR_Object::RXX_Object_Obj12.WidthVnce = convertRawToPhysical(raw_value, 0.01, 0.0);
}


void CRadarFR_RXX_Object_Obj13_SetDataReceived(byte byteArray[])
{
    qword raw_value;

    raw_value=copyBitsFromByteArrayLE( byteArray, 7648, 32);
    @CAN_PrivMain::RFR_Object::RXX_Object_Obj13.Age = convertRawToPhysical(raw_value, 1.0, 0.0);

    raw_value=copyBitsFromByteArrayLE( byteArray, 7244, 10);
    @CAN_PrivMain::RFR_Object::RXX_Object_Obj13.Ax = convertRawToPhysical(raw_value, 0.03125, -16.0);

    raw_value=copyBitsFromByteArrayLE( byteArray, 7628, 12);
    @CAN_PrivMain::RFR_Object::RXX_Object_Obj13.AxAyCoVnce = convertRawToPhysical(raw_value, 0.01, 0.0);

    raw_value=copyBitsFromByteArrayLE( byteArray, 7264, 12);
    @CAN_PrivMain::RFR_Object::RXX_Object_Obj13.AxVnce = convertRawToPhysical(raw_value, 0.01, 0.0);

    raw_value=copyBitsFromByteArrayLE( byteArray, 7318, 9);
    @CAN_PrivMain::RFR_Object::RXX_Object_Obj13.Ay = convertRawToPhysical(raw_value, 0.0625, -16.0);

    raw_value=copyBitsFromByteArrayLE( byteArray, 7328, 12);
    @CAN_PrivMain::RFR_Object::RXX_Object_Obj13.AyVnce = convertRawToPhysical(raw_value, 0.01, 0.0);

    raw_value=copyBitsFromByteArrayLE( byteArray, 7384, 6);
    @CAN_PrivMain::RFR_Object::RXX_Object_Obj13.ExistProb = convertRawToPhysical(raw_value, 2.0, 0.0);

    raw_value=copyBitsFromByteArrayLE( byteArray, 7448, 8);
    @CAN_PrivMain::RFR_Object::RXX_Object_Obj13.FilterInformation = convertRawToPhysical(raw_value, 1.0, 0.0);

    raw_value=copyBitsFromByteArrayLE( byteArray, 7224, 7);
    @CAN_PrivMain::RFR_Object::RXX_Object_Obj13.Length = convertRawToPhysical(raw_value, 0.125, 0.0);

    raw_value=copyBitsFromByteArrayLE( byteArray, 7232, 12);
    @CAN_PrivMain::RFR_Object::RXX_Object_Obj13.LengthVnce = convertRawToPhysical(raw_value, 0.01, 0.0);

    raw_value=copyBitsFromByteArrayLE( byteArray, 7416, 3);
    @CAN_PrivMain::RFR_Object::RXX_Object_Obj13.MeasurementStatus = convertRawToPhysical(raw_value, 1.0, 0.0);

    raw_value=copyBitsFromByteArrayLE( byteArray, 7372, 2);
    @CAN_PrivMain::RFR_Object::RXX_Object_Obj13.MovingStatus = convertRawToPhysical(raw_value, 1.0, 0.0);

    raw_value=copyBitsFromByteArrayLE( byteArray, 7352, 7);
    @CAN_PrivMain::RFR_Object::RXX_Object_Obj13.ObjId = convertRawToPhysical(raw_value, 1.0, 0.0);

    raw_value=copyBitsFromByteArrayLE( byteArray, 7254, 9);
    @CAN_PrivMain::RFR_Object::RXX_Object_Obj13.OrientationYaw = convertRawToPhysical(raw_value, 0.0175, -4.48);

    raw_value=copyBitsFromByteArrayLE( byteArray, 7276, 12);
    @CAN_PrivMain::RFR_Object::RXX_Object_Obj13.OrientationYawVnce = convertRawToPhysical(raw_value, 0.0003, 0.0);

    raw_value=copyBitsFromByteArrayLE( byteArray, 7168, 6);
    @CAN_PrivMain::RFR_Object::RXX_Object_Obj13.ProbClassConfidence = convertRawToPhysical(raw_value, 2.0, 0.0);

    raw_value=copyBitsFromByteArrayLE( byteArray, 7419, 4);
    @CAN_PrivMain::RFR_Object::RXX_Object_Obj13.ProbClassType = convertRawToPhysical(raw_value, 1.0, 0.0);

    raw_value=copyBitsFromByteArrayLE( byteArray, 7174, 14);
    @CAN_PrivMain::RFR_Object::RXX_Object_Obj13.Px = convertRawToPhysical(raw_value, 0.0625, -512.0);

    raw_value=copyBitsFromByteArrayLE( byteArray, 7488, 12);
    @CAN_PrivMain::RFR_Object::RXX_Object_Obj13.PxAxCoVnce = convertRawToPhysical(raw_value, 0.01, 0.0);

    raw_value=copyBitsFromByteArrayLE( byteArray, 7500, 12);
    @CAN_PrivMain::RFR_Object::RXX_Object_Obj13.PxAyCoVnce = convertRawToPhysical(raw_value, 0.01, 0.0);

    raw_value=copyBitsFromByteArrayLE( byteArray, 7404, 12);
    @CAN_PrivMain::RFR_Object::RXX_Object_Obj13.PxPyCoVnce = convertRawToPhysical(raw_value, 0.01, 0.0);

    raw_value=copyBitsFromByteArrayLE( byteArray, 7188, 12);
    @CAN_PrivMain::RFR_Object::RXX_Object_Obj13.PxVnce = convertRawToPhysical(raw_value, 0.1, 0.0);

    raw_value=copyBitsFromByteArrayLE( byteArray, 7424, 12);
    @CAN_PrivMain::RFR_Object::RXX_Object_Obj13.PxVxCoVnce = convertRawToPhysical(raw_value, 0.01, 0.0);

    raw_value=copyBitsFromByteArrayLE( byteArray, 7436, 12);
    @CAN_PrivMain::RFR_Object::RXX_Object_Obj13.PxVyCoVnce = convertRawToPhysical(raw_value, 0.01, 0.0);

    raw_value=copyBitsFromByteArrayLE( byteArray, 7200, 12);
    @CAN_PrivMain::RFR_Object::RXX_Object_Obj13.Py = convertRawToPhysical(raw_value, 0.0625, -128.0);

    raw_value=copyBitsFromByteArrayLE( byteArray, 7520, 12);
    @CAN_PrivMain::RFR_Object::RXX_Object_Obj13.PyAxCoVnce = convertRawToPhysical(raw_value, 0.01, 0.0);

    raw_value=copyBitsFromByteArrayLE( byteArray, 7532, 12);
    @CAN_PrivMain::RFR_Object::RXX_Object_Obj13.PyAyCoVnce = convertRawToPhysical(raw_value, 0.01, 0.0);

    raw_value=copyBitsFromByteArrayLE( byteArray, 7212, 12);
    @CAN_PrivMain::RFR_Object::RXX_Object_Obj13.PyVnce = convertRawToPhysical(raw_value, 0.1, 0.0);

    raw_value=copyBitsFromByteArrayLE( byteArray, 7456, 12);
    @CAN_PrivMain::RFR_Object::RXX_Object_Obj13.PyVxCoVnce = convertRawToPhysical(raw_value, 0.01, 0.0);

    raw_value=copyBitsFromByteArrayLE( byteArray, 7468, 12);
    @CAN_PrivMain::RFR_Object::RXX_Object_Obj13.PyVyCoVnce = convertRawToPhysical(raw_value, 0.01, 0.0);

    raw_value=copyBitsFromByteArrayLE( byteArray, 7308, 10);
    @CAN_PrivMain::RFR_Object::RXX_Object_Obj13.RCS = convertRawToPhysical(raw_value, 0.2, -102.4);

    raw_value=copyBitsFromByteArrayLE( byteArray, 7480, 4);
    @CAN_PrivMain::RFR_Object::RXX_Object_Obj13.ReferencePoint = convertRawToPhysical(raw_value, 1.0, 0.0);

    raw_value=copyBitsFromByteArrayLE( byteArray, 7340, 12);
    @CAN_PrivMain::RFR_Object::RXX_Object_Obj13.Vx = convertRawToPhysical(raw_value, 0.0625, -128.0);

    raw_value=copyBitsFromByteArrayLE( byteArray, 7564, 12);
    @CAN_PrivMain::RFR_Object::RXX_Object_Obj13.VxAxCoVnce = convertRawToPhysical(raw_value, 0.01, 0.0);

    raw_value=copyBitsFromByteArrayLE( byteArray, 7584, 12);
    @CAN_PrivMain::RFR_Object::RXX_Object_Obj13.VxAyCoVnce = convertRawToPhysical(raw_value, 0.01, 0.0);

    raw_value=copyBitsFromByteArrayLE( byteArray, 7360, 12);
    @CAN_PrivMain::RFR_Object::RXX_Object_Obj13.VxVnce = convertRawToPhysical(raw_value, 0.01, 0.0);

    raw_value=copyBitsFromByteArrayLE( byteArray, 7552, 12);
    @CAN_PrivMain::RFR_Object::RXX_Object_Obj13.VxVyCoVnce = convertRawToPhysical(raw_value, 0.01, 0.0);

    raw_value=copyBitsFromByteArrayLE( byteArray, 7374, 10);
    @CAN_PrivMain::RFR_Object::RXX_Object_Obj13.Vy = convertRawToPhysical(raw_value, 0.125, -64.0);

    raw_value=copyBitsFromByteArrayLE( byteArray, 7596, 12);
    @CAN_PrivMain::RFR_Object::RXX_Object_Obj13.VyAxCoVnce = convertRawToPhysical(raw_value, 0.01, 0.0);

    raw_value=copyBitsFromByteArrayLE( byteArray, 7616, 12);
    @CAN_PrivMain::RFR_Object::RXX_Object_Obj13.VyAyCoVnce = convertRawToPhysical(raw_value, 0.01, 0.0);

    raw_value=copyBitsFromByteArrayLE( byteArray, 7392, 12);
    @CAN_PrivMain::RFR_Object::RXX_Object_Obj13.VyVnce = convertRawToPhysical(raw_value, 0.01, 0.0);

    raw_value=copyBitsFromByteArrayLE( byteArray, 7288, 7);
    @CAN_PrivMain::RFR_Object::RXX_Object_Obj13.Width = convertRawToPhysical(raw_value, 0.125, 0.0);

    raw_value=copyBitsFromByteArrayLE( byteArray, 7296, 12);
    @CAN_PrivMain::RFR_Object::RXX_Object_Obj13.WidthVnce = convertRawToPhysical(raw_value, 0.01, 0.0);
}


void CRadarFR_RXX_Object_Obj14_SetDataReceived(byte byteArray[])
{
    qword raw_value;

    raw_value=copyBitsFromByteArrayLE( byteArray, 8160, 32);
    @CAN_PrivMain::RFR_Object::RXX_Object_Obj14.Age = convertRawToPhysical(raw_value, 1.0, 0.0);

    raw_value=copyBitsFromByteArrayLE( byteArray, 7756, 10);
    @CAN_PrivMain::RFR_Object::RXX_Object_Obj14.Ax = convertRawToPhysical(raw_value, 0.03125, -16.0);

    raw_value=copyBitsFromByteArrayLE( byteArray, 8140, 12);
    @CAN_PrivMain::RFR_Object::RXX_Object_Obj14.AxAyCoVnce = convertRawToPhysical(raw_value, 0.01, 0.0);

    raw_value=copyBitsFromByteArrayLE( byteArray, 7776, 12);
    @CAN_PrivMain::RFR_Object::RXX_Object_Obj14.AxVnce = convertRawToPhysical(raw_value, 0.01, 0.0);

    raw_value=copyBitsFromByteArrayLE( byteArray, 7830, 9);
    @CAN_PrivMain::RFR_Object::RXX_Object_Obj14.Ay = convertRawToPhysical(raw_value, 0.0625, -16.0);

    raw_value=copyBitsFromByteArrayLE( byteArray, 7840, 12);
    @CAN_PrivMain::RFR_Object::RXX_Object_Obj14.AyVnce = convertRawToPhysical(raw_value, 0.01, 0.0);

    raw_value=copyBitsFromByteArrayLE( byteArray, 7896, 6);
    @CAN_PrivMain::RFR_Object::RXX_Object_Obj14.ExistProb = convertRawToPhysical(raw_value, 2.0, 0.0);

    raw_value=copyBitsFromByteArrayLE( byteArray, 7960, 8);
    @CAN_PrivMain::RFR_Object::RXX_Object_Obj14.FilterInformation = convertRawToPhysical(raw_value, 1.0, 0.0);

    raw_value=copyBitsFromByteArrayLE( byteArray, 7736, 7);
    @CAN_PrivMain::RFR_Object::RXX_Object_Obj14.Length = convertRawToPhysical(raw_value, 0.125, 0.0);

    raw_value=copyBitsFromByteArrayLE( byteArray, 7744, 12);
    @CAN_PrivMain::RFR_Object::RXX_Object_Obj14.LengthVnce = convertRawToPhysical(raw_value, 0.01, 0.0);

    raw_value=copyBitsFromByteArrayLE( byteArray, 7928, 3);
    @CAN_PrivMain::RFR_Object::RXX_Object_Obj14.MeasurementStatus = convertRawToPhysical(raw_value, 1.0, 0.0);

    raw_value=copyBitsFromByteArrayLE( byteArray, 7884, 2);
    @CAN_PrivMain::RFR_Object::RXX_Object_Obj14.MovingStatus = convertRawToPhysical(raw_value, 1.0, 0.0);

    raw_value=copyBitsFromByteArrayLE( byteArray, 7864, 7);
    @CAN_PrivMain::RFR_Object::RXX_Object_Obj14.ObjId = convertRawToPhysical(raw_value, 1.0, 0.0);

    raw_value=copyBitsFromByteArrayLE( byteArray, 7766, 9);
    @CAN_PrivMain::RFR_Object::RXX_Object_Obj14.OrientationYaw = convertRawToPhysical(raw_value, 0.0175, -4.48);

    raw_value=copyBitsFromByteArrayLE( byteArray, 7788, 12);
    @CAN_PrivMain::RFR_Object::RXX_Object_Obj14.OrientationYawVnce = convertRawToPhysical(raw_value, 0.0003, 0.0);

    raw_value=copyBitsFromByteArrayLE( byteArray, 7680, 6);
    @CAN_PrivMain::RFR_Object::RXX_Object_Obj14.ProbClassConfidence = convertRawToPhysical(raw_value, 2.0, 0.0);

    raw_value=copyBitsFromByteArrayLE( byteArray, 7931, 4);
    @CAN_PrivMain::RFR_Object::RXX_Object_Obj14.ProbClassType = convertRawToPhysical(raw_value, 1.0, 0.0);

    raw_value=copyBitsFromByteArrayLE( byteArray, 7686, 14);
    @CAN_PrivMain::RFR_Object::RXX_Object_Obj14.Px = convertRawToPhysical(raw_value, 0.0625, -512.0);

    raw_value=copyBitsFromByteArrayLE( byteArray, 8000, 12);
    @CAN_PrivMain::RFR_Object::RXX_Object_Obj14.PxAxCoVnce = convertRawToPhysical(raw_value, 0.01, 0.0);

    raw_value=copyBitsFromByteArrayLE( byteArray, 8012, 12);
    @CAN_PrivMain::RFR_Object::RXX_Object_Obj14.PxAyCoVnce = convertRawToPhysical(raw_value, 0.01, 0.0);

    raw_value=copyBitsFromByteArrayLE( byteArray, 7916, 12);
    @CAN_PrivMain::RFR_Object::RXX_Object_Obj14.PxPyCoVnce = convertRawToPhysical(raw_value, 0.01, 0.0);

    raw_value=copyBitsFromByteArrayLE( byteArray, 7700, 12);
    @CAN_PrivMain::RFR_Object::RXX_Object_Obj14.PxVnce = convertRawToPhysical(raw_value, 0.1, 0.0);

    raw_value=copyBitsFromByteArrayLE( byteArray, 7936, 12);
    @CAN_PrivMain::RFR_Object::RXX_Object_Obj14.PxVxCoVnce = convertRawToPhysical(raw_value, 0.01, 0.0);

    raw_value=copyBitsFromByteArrayLE( byteArray, 7948, 12);
    @CAN_PrivMain::RFR_Object::RXX_Object_Obj14.PxVyCoVnce = convertRawToPhysical(raw_value, 0.01, 0.0);

    raw_value=copyBitsFromByteArrayLE( byteArray, 7712, 12);
    @CAN_PrivMain::RFR_Object::RXX_Object_Obj14.Py = convertRawToPhysical(raw_value, 0.0625, -128.0);

    raw_value=copyBitsFromByteArrayLE( byteArray, 8032, 12);
    @CAN_PrivMain::RFR_Object::RXX_Object_Obj14.PyAxCoVnce = convertRawToPhysical(raw_value, 0.01, 0.0);

    raw_value=copyBitsFromByteArrayLE( byteArray, 8044, 12);
    @CAN_PrivMain::RFR_Object::RXX_Object_Obj14.PyAyCoVnce = convertRawToPhysical(raw_value, 0.01, 0.0);

    raw_value=copyBitsFromByteArrayLE( byteArray, 7724, 12);
    @CAN_PrivMain::RFR_Object::RXX_Object_Obj14.PyVnce = convertRawToPhysical(raw_value, 0.1, 0.0);

    raw_value=copyBitsFromByteArrayLE( byteArray, 7968, 12);
    @CAN_PrivMain::RFR_Object::RXX_Object_Obj14.PyVxCoVnce = convertRawToPhysical(raw_value, 0.01, 0.0);

    raw_value=copyBitsFromByteArrayLE( byteArray, 7980, 12);
    @CAN_PrivMain::RFR_Object::RXX_Object_Obj14.PyVyCoVnce = convertRawToPhysical(raw_value, 0.01, 0.0);

    raw_value=copyBitsFromByteArrayLE( byteArray, 7820, 10);
    @CAN_PrivMain::RFR_Object::RXX_Object_Obj14.RCS = convertRawToPhysical(raw_value, 0.2, -102.4);

    raw_value=copyBitsFromByteArrayLE( byteArray, 7992, 4);
    @CAN_PrivMain::RFR_Object::RXX_Object_Obj14.ReferencePoint = convertRawToPhysical(raw_value, 1.0, 0.0);

    raw_value=copyBitsFromByteArrayLE( byteArray, 7852, 12);
    @CAN_PrivMain::RFR_Object::RXX_Object_Obj14.Vx = convertRawToPhysical(raw_value, 0.0625, -128.0);

    raw_value=copyBitsFromByteArrayLE( byteArray, 8076, 12);
    @CAN_PrivMain::RFR_Object::RXX_Object_Obj14.VxAxCoVnce = convertRawToPhysical(raw_value, 0.01, 0.0);

    raw_value=copyBitsFromByteArrayLE( byteArray, 8096, 12);
    @CAN_PrivMain::RFR_Object::RXX_Object_Obj14.VxAyCoVnce = convertRawToPhysical(raw_value, 0.01, 0.0);

    raw_value=copyBitsFromByteArrayLE( byteArray, 7872, 12);
    @CAN_PrivMain::RFR_Object::RXX_Object_Obj14.VxVnce = convertRawToPhysical(raw_value, 0.01, 0.0);

    raw_value=copyBitsFromByteArrayLE( byteArray, 8064, 12);
    @CAN_PrivMain::RFR_Object::RXX_Object_Obj14.VxVyCoVnce = convertRawToPhysical(raw_value, 0.01, 0.0);

    raw_value=copyBitsFromByteArrayLE( byteArray, 7886, 10);
    @CAN_PrivMain::RFR_Object::RXX_Object_Obj14.Vy = convertRawToPhysical(raw_value, 0.125, -64.0);

    raw_value=copyBitsFromByteArrayLE( byteArray, 8108, 12);
    @CAN_PrivMain::RFR_Object::RXX_Object_Obj14.VyAxCoVnce = convertRawToPhysical(raw_value, 0.01, 0.0);

    raw_value=copyBitsFromByteArrayLE( byteArray, 8128, 12);
    @CAN_PrivMain::RFR_Object::RXX_Object_Obj14.VyAyCoVnce = convertRawToPhysical(raw_value, 0.01, 0.0);

    raw_value=copyBitsFromByteArrayLE( byteArray, 7904, 12);
    @CAN_PrivMain::RFR_Object::RXX_Object_Obj14.VyVnce = convertRawToPhysical(raw_value, 0.01, 0.0);

    raw_value=copyBitsFromByteArrayLE( byteArray, 7800, 7);
    @CAN_PrivMain::RFR_Object::RXX_Object_Obj14.Width = convertRawToPhysical(raw_value, 0.125, 0.0);

    raw_value=copyBitsFromByteArrayLE( byteArray, 7808, 12);
    @CAN_PrivMain::RFR_Object::RXX_Object_Obj14.WidthVnce = convertRawToPhysical(raw_value, 0.01, 0.0);
}


void CRadarFR_RXX_Object_Obj15_SetDataReceived(byte byteArray[])
{
    qword raw_value;

    raw_value=copyBitsFromByteArrayLE( byteArray, 8672, 32);
    @CAN_PrivMain::RFR_Object::RXX_Object_Obj15.Age = convertRawToPhysical(raw_value, 1.0, 0.0);

    raw_value=copyBitsFromByteArrayLE( byteArray, 8268, 10);
    @CAN_PrivMain::RFR_Object::RXX_Object_Obj15.Ax = convertRawToPhysical(raw_value, 0.03125, -16.0);

    raw_value=copyBitsFromByteArrayLE( byteArray, 8652, 12);
    @CAN_PrivMain::RFR_Object::RXX_Object_Obj15.AxAyCoVnce = convertRawToPhysical(raw_value, 0.01, 0.0);

    raw_value=copyBitsFromByteArrayLE( byteArray, 8288, 12);
    @CAN_PrivMain::RFR_Object::RXX_Object_Obj15.AxVnce = convertRawToPhysical(raw_value, 0.01, 0.0);

    raw_value=copyBitsFromByteArrayLE( byteArray, 8342, 9);
    @CAN_PrivMain::RFR_Object::RXX_Object_Obj15.Ay = convertRawToPhysical(raw_value, 0.0625, -16.0);

    raw_value=copyBitsFromByteArrayLE( byteArray, 8352, 12);
    @CAN_PrivMain::RFR_Object::RXX_Object_Obj15.AyVnce = convertRawToPhysical(raw_value, 0.01, 0.0);

    raw_value=copyBitsFromByteArrayLE( byteArray, 8408, 6);
    @CAN_PrivMain::RFR_Object::RXX_Object_Obj15.ExistProb = convertRawToPhysical(raw_value, 2.0, 0.0);

    raw_value=copyBitsFromByteArrayLE( byteArray, 8472, 8);
    @CAN_PrivMain::RFR_Object::RXX_Object_Obj15.FilterInformation = convertRawToPhysical(raw_value, 1.0, 0.0);

    raw_value=copyBitsFromByteArrayLE( byteArray, 8248, 7);
    @CAN_PrivMain::RFR_Object::RXX_Object_Obj15.Length = convertRawToPhysical(raw_value, 0.125, 0.0);

    raw_value=copyBitsFromByteArrayLE( byteArray, 8256, 12);
    @CAN_PrivMain::RFR_Object::RXX_Object_Obj15.LengthVnce = convertRawToPhysical(raw_value, 0.01, 0.0);

    raw_value=copyBitsFromByteArrayLE( byteArray, 8440, 3);
    @CAN_PrivMain::RFR_Object::RXX_Object_Obj15.MeasurementStatus = convertRawToPhysical(raw_value, 1.0, 0.0);

    raw_value=copyBitsFromByteArrayLE( byteArray, 8396, 2);
    @CAN_PrivMain::RFR_Object::RXX_Object_Obj15.MovingStatus = convertRawToPhysical(raw_value, 1.0, 0.0);

    raw_value=copyBitsFromByteArrayLE( byteArray, 8376, 7);
    @CAN_PrivMain::RFR_Object::RXX_Object_Obj15.ObjId = convertRawToPhysical(raw_value, 1.0, 0.0);

    raw_value=copyBitsFromByteArrayLE( byteArray, 8278, 9);
    @CAN_PrivMain::RFR_Object::RXX_Object_Obj15.OrientationYaw = convertRawToPhysical(raw_value, 0.0175, -4.48);

    raw_value=copyBitsFromByteArrayLE( byteArray, 8300, 12);
    @CAN_PrivMain::RFR_Object::RXX_Object_Obj15.OrientationYawVnce = convertRawToPhysical(raw_value, 0.0003, 0.0);

    raw_value=copyBitsFromByteArrayLE( byteArray, 8192, 6);
    @CAN_PrivMain::RFR_Object::RXX_Object_Obj15.ProbClassConfidence = convertRawToPhysical(raw_value, 2.0, 0.0);

    raw_value=copyBitsFromByteArrayLE( byteArray, 8443, 4);
    @CAN_PrivMain::RFR_Object::RXX_Object_Obj15.ProbClassType = convertRawToPhysical(raw_value, 1.0, 0.0);

    raw_value=copyBitsFromByteArrayLE( byteArray, 8198, 14);
    @CAN_PrivMain::RFR_Object::RXX_Object_Obj15.Px = convertRawToPhysical(raw_value, 0.0625, -512.0);

    raw_value=copyBitsFromByteArrayLE( byteArray, 8512, 12);
    @CAN_PrivMain::RFR_Object::RXX_Object_Obj15.PxAxCoVnce = convertRawToPhysical(raw_value, 0.01, 0.0);

    raw_value=copyBitsFromByteArrayLE( byteArray, 8524, 12);
    @CAN_PrivMain::RFR_Object::RXX_Object_Obj15.PxAyCoVnce = convertRawToPhysical(raw_value, 0.01, 0.0);

    raw_value=copyBitsFromByteArrayLE( byteArray, 8428, 12);
    @CAN_PrivMain::RFR_Object::RXX_Object_Obj15.PxPyCoVnce = convertRawToPhysical(raw_value, 0.01, 0.0);

    raw_value=copyBitsFromByteArrayLE( byteArray, 8212, 12);
    @CAN_PrivMain::RFR_Object::RXX_Object_Obj15.PxVnce = convertRawToPhysical(raw_value, 0.1, 0.0);

    raw_value=copyBitsFromByteArrayLE( byteArray, 8448, 12);
    @CAN_PrivMain::RFR_Object::RXX_Object_Obj15.PxVxCoVnce = convertRawToPhysical(raw_value, 0.01, 0.0);

    raw_value=copyBitsFromByteArrayLE( byteArray, 8460, 12);
    @CAN_PrivMain::RFR_Object::RXX_Object_Obj15.PxVyCoVnce = convertRawToPhysical(raw_value, 0.01, 0.0);

    raw_value=copyBitsFromByteArrayLE( byteArray, 8224, 12);
    @CAN_PrivMain::RFR_Object::RXX_Object_Obj15.Py = convertRawToPhysical(raw_value, 0.0625, -128.0);

    raw_value=copyBitsFromByteArrayLE( byteArray, 8544, 12);
    @CAN_PrivMain::RFR_Object::RXX_Object_Obj15.PyAxCoVnce = convertRawToPhysical(raw_value, 0.01, 0.0);

    raw_value=copyBitsFromByteArrayLE( byteArray, 8556, 12);
    @CAN_PrivMain::RFR_Object::RXX_Object_Obj15.PyAyCoVnce = convertRawToPhysical(raw_value, 0.01, 0.0);

    raw_value=copyBitsFromByteArrayLE( byteArray, 8236, 12);
    @CAN_PrivMain::RFR_Object::RXX_Object_Obj15.PyVnce = convertRawToPhysical(raw_value, 0.1, 0.0);

    raw_value=copyBitsFromByteArrayLE( byteArray, 8480, 12);
    @CAN_PrivMain::RFR_Object::RXX_Object_Obj15.PyVxCoVnce = convertRawToPhysical(raw_value, 0.01, 0.0);

    raw_value=copyBitsFromByteArrayLE( byteArray, 8492, 12);
    @CAN_PrivMain::RFR_Object::RXX_Object_Obj15.PyVyCoVnce = convertRawToPhysical(raw_value, 0.01, 0.0);

    raw_value=copyBitsFromByteArrayLE( byteArray, 8332, 10);
    @CAN_PrivMain::RFR_Object::RXX_Object_Obj15.RCS = convertRawToPhysical(raw_value, 0.2, -102.4);

    raw_value=copyBitsFromByteArrayLE( byteArray, 8504, 4);
    @CAN_PrivMain::RFR_Object::RXX_Object_Obj15.ReferencePoint = convertRawToPhysical(raw_value, 1.0, 0.0);

    raw_value=copyBitsFromByteArrayLE( byteArray, 8364, 12);
    @CAN_PrivMain::RFR_Object::RXX_Object_Obj15.Vx = convertRawToPhysical(raw_value, 0.0625, -128.0);

    raw_value=copyBitsFromByteArrayLE( byteArray, 8588, 12);
    @CAN_PrivMain::RFR_Object::RXX_Object_Obj15.VxAxCoVnce = convertRawToPhysical(raw_value, 0.01, 0.0);

    raw_value=copyBitsFromByteArrayLE( byteArray, 8608, 12);
    @CAN_PrivMain::RFR_Object::RXX_Object_Obj15.VxAyCoVnce = convertRawToPhysical(raw_value, 0.01, 0.0);

    raw_value=copyBitsFromByteArrayLE( byteArray, 8384, 12);
    @CAN_PrivMain::RFR_Object::RXX_Object_Obj15.VxVnce = convertRawToPhysical(raw_value, 0.01, 0.0);

    raw_value=copyBitsFromByteArrayLE( byteArray, 8576, 12);
    @CAN_PrivMain::RFR_Object::RXX_Object_Obj15.VxVyCoVnce = convertRawToPhysical(raw_value, 0.01, 0.0);

    raw_value=copyBitsFromByteArrayLE( byteArray, 8398, 10);
    @CAN_PrivMain::RFR_Object::RXX_Object_Obj15.Vy = convertRawToPhysical(raw_value, 0.125, -64.0);

    raw_value=copyBitsFromByteArrayLE( byteArray, 8620, 12);
    @CAN_PrivMain::RFR_Object::RXX_Object_Obj15.VyAxCoVnce = convertRawToPhysical(raw_value, 0.01, 0.0);

    raw_value=copyBitsFromByteArrayLE( byteArray, 8640, 12);
    @CAN_PrivMain::RFR_Object::RXX_Object_Obj15.VyAyCoVnce = convertRawToPhysical(raw_value, 0.01, 0.0);

    raw_value=copyBitsFromByteArrayLE( byteArray, 8416, 12);
    @CAN_PrivMain::RFR_Object::RXX_Object_Obj15.VyVnce = convertRawToPhysical(raw_value, 0.01, 0.0);

    raw_value=copyBitsFromByteArrayLE( byteArray, 8312, 7);
    @CAN_PrivMain::RFR_Object::RXX_Object_Obj15.Width = convertRawToPhysical(raw_value, 0.125, 0.0);

    raw_value=copyBitsFromByteArrayLE( byteArray, 8320, 12);
    @CAN_PrivMain::RFR_Object::RXX_Object_Obj15.WidthVnce = convertRawToPhysical(raw_value, 0.01, 0.0);
}


void CRadarFR_RXX_Object_Obj16_SetDataReceived(byte byteArray[])
{
    qword raw_value;

    raw_value=copyBitsFromByteArrayLE( byteArray, 9184, 32);
    @CAN_PrivMain::RFR_Object::RXX_Object_Obj16.Age = convertRawToPhysical(raw_value, 1.0, 0.0);

    raw_value=copyBitsFromByteArrayLE( byteArray, 8780, 10);
    @CAN_PrivMain::RFR_Object::RXX_Object_Obj16.Ax = convertRawToPhysical(raw_value, 0.03125, -16.0);

    raw_value=copyBitsFromByteArrayLE( byteArray, 9164, 12);
    @CAN_PrivMain::RFR_Object::RXX_Object_Obj16.AxAyCoVnce = convertRawToPhysical(raw_value, 0.01, 0.0);

    raw_value=copyBitsFromByteArrayLE( byteArray, 8800, 12);
    @CAN_PrivMain::RFR_Object::RXX_Object_Obj16.AxVnce = convertRawToPhysical(raw_value, 0.01, 0.0);

    raw_value=copyBitsFromByteArrayLE( byteArray, 8854, 9);
    @CAN_PrivMain::RFR_Object::RXX_Object_Obj16.Ay = convertRawToPhysical(raw_value, 0.0625, -16.0);

    raw_value=copyBitsFromByteArrayLE( byteArray, 8864, 12);
    @CAN_PrivMain::RFR_Object::RXX_Object_Obj16.AyVnce = convertRawToPhysical(raw_value, 0.01, 0.0);

    raw_value=copyBitsFromByteArrayLE( byteArray, 8920, 6);
    @CAN_PrivMain::RFR_Object::RXX_Object_Obj16.ExistProb = convertRawToPhysical(raw_value, 2.0, 0.0);

    raw_value=copyBitsFromByteArrayLE( byteArray, 8984, 8);
    @CAN_PrivMain::RFR_Object::RXX_Object_Obj16.FilterInformation = convertRawToPhysical(raw_value, 1.0, 0.0);

    raw_value=copyBitsFromByteArrayLE( byteArray, 8760, 7);
    @CAN_PrivMain::RFR_Object::RXX_Object_Obj16.Length = convertRawToPhysical(raw_value, 0.125, 0.0);

    raw_value=copyBitsFromByteArrayLE( byteArray, 8768, 12);
    @CAN_PrivMain::RFR_Object::RXX_Object_Obj16.LengthVnce = convertRawToPhysical(raw_value, 0.01, 0.0);

    raw_value=copyBitsFromByteArrayLE( byteArray, 8952, 3);
    @CAN_PrivMain::RFR_Object::RXX_Object_Obj16.MeasurementStatus = convertRawToPhysical(raw_value, 1.0, 0.0);

    raw_value=copyBitsFromByteArrayLE( byteArray, 8908, 2);
    @CAN_PrivMain::RFR_Object::RXX_Object_Obj16.MovingStatus = convertRawToPhysical(raw_value, 1.0, 0.0);

    raw_value=copyBitsFromByteArrayLE( byteArray, 8888, 7);
    @CAN_PrivMain::RFR_Object::RXX_Object_Obj16.ObjId = convertRawToPhysical(raw_value, 1.0, 0.0);

    raw_value=copyBitsFromByteArrayLE( byteArray, 8790, 9);
    @CAN_PrivMain::RFR_Object::RXX_Object_Obj16.OrientationYaw = convertRawToPhysical(raw_value, 0.0175, -4.48);

    raw_value=copyBitsFromByteArrayLE( byteArray, 8812, 12);
    @CAN_PrivMain::RFR_Object::RXX_Object_Obj16.OrientationYawVnce = convertRawToPhysical(raw_value, 0.0003, 0.0);

    raw_value=copyBitsFromByteArrayLE( byteArray, 8704, 6);
    @CAN_PrivMain::RFR_Object::RXX_Object_Obj16.ProbClassConfidence = convertRawToPhysical(raw_value, 2.0, 0.0);

    raw_value=copyBitsFromByteArrayLE( byteArray, 8955, 4);
    @CAN_PrivMain::RFR_Object::RXX_Object_Obj16.ProbClassType = convertRawToPhysical(raw_value, 1.0, 0.0);

    raw_value=copyBitsFromByteArrayLE( byteArray, 8710, 14);
    @CAN_PrivMain::RFR_Object::RXX_Object_Obj16.Px = convertRawToPhysical(raw_value, 0.0625, -512.0);

    raw_value=copyBitsFromByteArrayLE( byteArray, 9024, 12);
    @CAN_PrivMain::RFR_Object::RXX_Object_Obj16.PxAxCoVnce = convertRawToPhysical(raw_value, 0.01, 0.0);

    raw_value=copyBitsFromByteArrayLE( byteArray, 9036, 12);
    @CAN_PrivMain::RFR_Object::RXX_Object_Obj16.PxAyCoVnce = convertRawToPhysical(raw_value, 0.01, 0.0);

    raw_value=copyBitsFromByteArrayLE( byteArray, 8940, 12);
    @CAN_PrivMain::RFR_Object::RXX_Object_Obj16.PxPyCoVnce = convertRawToPhysical(raw_value, 0.01, 0.0);

    raw_value=copyBitsFromByteArrayLE( byteArray, 8724, 12);
    @CAN_PrivMain::RFR_Object::RXX_Object_Obj16.PxVnce = convertRawToPhysical(raw_value, 0.1, 0.0);

    raw_value=copyBitsFromByteArrayLE( byteArray, 8960, 12);
    @CAN_PrivMain::RFR_Object::RXX_Object_Obj16.PxVxCoVnce = convertRawToPhysical(raw_value, 0.01, 0.0);

    raw_value=copyBitsFromByteArrayLE( byteArray, 8972, 12);
    @CAN_PrivMain::RFR_Object::RXX_Object_Obj16.PxVyCoVnce = convertRawToPhysical(raw_value, 0.01, 0.0);

    raw_value=copyBitsFromByteArrayLE( byteArray, 8736, 12);
    @CAN_PrivMain::RFR_Object::RXX_Object_Obj16.Py = convertRawToPhysical(raw_value, 0.0625, -128.0);

    raw_value=copyBitsFromByteArrayLE( byteArray, 9056, 12);
    @CAN_PrivMain::RFR_Object::RXX_Object_Obj16.PyAxCoVnce = convertRawToPhysical(raw_value, 0.01, 0.0);

    raw_value=copyBitsFromByteArrayLE( byteArray, 9068, 12);
    @CAN_PrivMain::RFR_Object::RXX_Object_Obj16.PyAyCoVnce = convertRawToPhysical(raw_value, 0.01, 0.0);

    raw_value=copyBitsFromByteArrayLE( byteArray, 8748, 12);
    @CAN_PrivMain::RFR_Object::RXX_Object_Obj16.PyVnce = convertRawToPhysical(raw_value, 0.1, 0.0);

    raw_value=copyBitsFromByteArrayLE( byteArray, 8992, 12);
    @CAN_PrivMain::RFR_Object::RXX_Object_Obj16.PyVxCoVnce = convertRawToPhysical(raw_value, 0.01, 0.0);

    raw_value=copyBitsFromByteArrayLE( byteArray, 9004, 12);
    @CAN_PrivMain::RFR_Object::RXX_Object_Obj16.PyVyCoVnce = convertRawToPhysical(raw_value, 0.01, 0.0);

    raw_value=copyBitsFromByteArrayLE( byteArray, 8844, 10);
    @CAN_PrivMain::RFR_Object::RXX_Object_Obj16.RCS = convertRawToPhysical(raw_value, 0.2, -102.4);

    raw_value=copyBitsFromByteArrayLE( byteArray, 9016, 4);
    @CAN_PrivMain::RFR_Object::RXX_Object_Obj16.ReferencePoint = convertRawToPhysical(raw_value, 1.0, 0.0);

    raw_value=copyBitsFromByteArrayLE( byteArray, 8876, 12);
    @CAN_PrivMain::RFR_Object::RXX_Object_Obj16.Vx = convertRawToPhysical(raw_value, 0.0625, -128.0);

    raw_value=copyBitsFromByteArrayLE( byteArray, 9100, 12);
    @CAN_PrivMain::RFR_Object::RXX_Object_Obj16.VxAxCoVnce = convertRawToPhysical(raw_value, 0.01, 0.0);

    raw_value=copyBitsFromByteArrayLE( byteArray, 9120, 12);
    @CAN_PrivMain::RFR_Object::RXX_Object_Obj16.VxAyCoVnce = convertRawToPhysical(raw_value, 0.01, 0.0);

    raw_value=copyBitsFromByteArrayLE( byteArray, 8896, 12);
    @CAN_PrivMain::RFR_Object::RXX_Object_Obj16.VxVnce = convertRawToPhysical(raw_value, 0.01, 0.0);

    raw_value=copyBitsFromByteArrayLE( byteArray, 9088, 12);
    @CAN_PrivMain::RFR_Object::RXX_Object_Obj16.VxVyCoVnce = convertRawToPhysical(raw_value, 0.01, 0.0);

    raw_value=copyBitsFromByteArrayLE( byteArray, 8910, 10);
    @CAN_PrivMain::RFR_Object::RXX_Object_Obj16.Vy = convertRawToPhysical(raw_value, 0.125, -64.0);

    raw_value=copyBitsFromByteArrayLE( byteArray, 9132, 12);
    @CAN_PrivMain::RFR_Object::RXX_Object_Obj16.VyAxCoVnce = convertRawToPhysical(raw_value, 0.01, 0.0);

    raw_value=copyBitsFromByteArrayLE( byteArray, 9152, 12);
    @CAN_PrivMain::RFR_Object::RXX_Object_Obj16.VyAyCoVnce = convertRawToPhysical(raw_value, 0.01, 0.0);

    raw_value=copyBitsFromByteArrayLE( byteArray, 8928, 12);
    @CAN_PrivMain::RFR_Object::RXX_Object_Obj16.VyVnce = convertRawToPhysical(raw_value, 0.01, 0.0);

    raw_value=copyBitsFromByteArrayLE( byteArray, 8824, 7);
    @CAN_PrivMain::RFR_Object::RXX_Object_Obj16.Width = convertRawToPhysical(raw_value, 0.125, 0.0);

    raw_value=copyBitsFromByteArrayLE( byteArray, 8832, 12);
    @CAN_PrivMain::RFR_Object::RXX_Object_Obj16.WidthVnce = convertRawToPhysical(raw_value, 0.01, 0.0);
}


void CRadarFR_RXX_Object_Obj17_SetDataReceived(byte byteArray[])
{
    qword raw_value;

    raw_value=copyBitsFromByteArrayLE( byteArray, 9696, 32);
    @CAN_PrivMain::RFR_Object::RXX_Object_Obj17.Age = convertRawToPhysical(raw_value, 1.0, 0.0);

    raw_value=copyBitsFromByteArrayLE( byteArray, 9292, 10);
    @CAN_PrivMain::RFR_Object::RXX_Object_Obj17.Ax = convertRawToPhysical(raw_value, 0.03125, -16.0);

    raw_value=copyBitsFromByteArrayLE( byteArray, 9676, 12);
    @CAN_PrivMain::RFR_Object::RXX_Object_Obj17.AxAyCoVnce = convertRawToPhysical(raw_value, 0.01, 0.0);

    raw_value=copyBitsFromByteArrayLE( byteArray, 9312, 12);
    @CAN_PrivMain::RFR_Object::RXX_Object_Obj17.AxVnce = convertRawToPhysical(raw_value, 0.01, 0.0);

    raw_value=copyBitsFromByteArrayLE( byteArray, 9366, 9);
    @CAN_PrivMain::RFR_Object::RXX_Object_Obj17.Ay = convertRawToPhysical(raw_value, 0.0625, -16.0);

    raw_value=copyBitsFromByteArrayLE( byteArray, 9376, 12);
    @CAN_PrivMain::RFR_Object::RXX_Object_Obj17.AyVnce = convertRawToPhysical(raw_value, 0.01, 0.0);

    raw_value=copyBitsFromByteArrayLE( byteArray, 9432, 6);
    @CAN_PrivMain::RFR_Object::RXX_Object_Obj17.ExistProb = convertRawToPhysical(raw_value, 2.0, 0.0);

    raw_value=copyBitsFromByteArrayLE( byteArray, 9496, 8);
    @CAN_PrivMain::RFR_Object::RXX_Object_Obj17.FilterInformation = convertRawToPhysical(raw_value, 1.0, 0.0);

    raw_value=copyBitsFromByteArrayLE( byteArray, 9272, 7);
    @CAN_PrivMain::RFR_Object::RXX_Object_Obj17.Length = convertRawToPhysical(raw_value, 0.125, 0.0);

    raw_value=copyBitsFromByteArrayLE( byteArray, 9280, 12);
    @CAN_PrivMain::RFR_Object::RXX_Object_Obj17.LengthVnce = convertRawToPhysical(raw_value, 0.01, 0.0);

    raw_value=copyBitsFromByteArrayLE( byteArray, 9464, 3);
    @CAN_PrivMain::RFR_Object::RXX_Object_Obj17.MeasurementStatus = convertRawToPhysical(raw_value, 1.0, 0.0);

    raw_value=copyBitsFromByteArrayLE( byteArray, 9420, 2);
    @CAN_PrivMain::RFR_Object::RXX_Object_Obj17.MovingStatus = convertRawToPhysical(raw_value, 1.0, 0.0);

    raw_value=copyBitsFromByteArrayLE( byteArray, 9400, 7);
    @CAN_PrivMain::RFR_Object::RXX_Object_Obj17.ObjId = convertRawToPhysical(raw_value, 1.0, 0.0);

    raw_value=copyBitsFromByteArrayLE( byteArray, 9302, 9);
    @CAN_PrivMain::RFR_Object::RXX_Object_Obj17.OrientationYaw = convertRawToPhysical(raw_value, 0.0175, -4.48);

    raw_value=copyBitsFromByteArrayLE( byteArray, 9324, 12);
    @CAN_PrivMain::RFR_Object::RXX_Object_Obj17.OrientationYawVnce = convertRawToPhysical(raw_value, 0.0003, 0.0);

    raw_value=copyBitsFromByteArrayLE( byteArray, 9216, 6);
    @CAN_PrivMain::RFR_Object::RXX_Object_Obj17.ProbClassConfidence = convertRawToPhysical(raw_value, 2.0, 0.0);

    raw_value=copyBitsFromByteArrayLE( byteArray, 9467, 4);
    @CAN_PrivMain::RFR_Object::RXX_Object_Obj17.ProbClassType = convertRawToPhysical(raw_value, 1.0, 0.0);

    raw_value=copyBitsFromByteArrayLE( byteArray, 9222, 14);
    @CAN_PrivMain::RFR_Object::RXX_Object_Obj17.Px = convertRawToPhysical(raw_value, 0.0625, -512.0);

    raw_value=copyBitsFromByteArrayLE( byteArray, 9536, 12);
    @CAN_PrivMain::RFR_Object::RXX_Object_Obj17.PxAxCoVnce = convertRawToPhysical(raw_value, 0.01, 0.0);

    raw_value=copyBitsFromByteArrayLE( byteArray, 9548, 12);
    @CAN_PrivMain::RFR_Object::RXX_Object_Obj17.PxAyCoVnce = convertRawToPhysical(raw_value, 0.01, 0.0);

    raw_value=copyBitsFromByteArrayLE( byteArray, 9452, 12);
    @CAN_PrivMain::RFR_Object::RXX_Object_Obj17.PxPyCoVnce = convertRawToPhysical(raw_value, 0.01, 0.0);

    raw_value=copyBitsFromByteArrayLE( byteArray, 9236, 12);
    @CAN_PrivMain::RFR_Object::RXX_Object_Obj17.PxVnce = convertRawToPhysical(raw_value, 0.1, 0.0);

    raw_value=copyBitsFromByteArrayLE( byteArray, 9472, 12);
    @CAN_PrivMain::RFR_Object::RXX_Object_Obj17.PxVxCoVnce = convertRawToPhysical(raw_value, 0.01, 0.0);

    raw_value=copyBitsFromByteArrayLE( byteArray, 9484, 12);
    @CAN_PrivMain::RFR_Object::RXX_Object_Obj17.PxVyCoVnce = convertRawToPhysical(raw_value, 0.01, 0.0);

    raw_value=copyBitsFromByteArrayLE( byteArray, 9248, 12);
    @CAN_PrivMain::RFR_Object::RXX_Object_Obj17.Py = convertRawToPhysical(raw_value, 0.0625, -128.0);

    raw_value=copyBitsFromByteArrayLE( byteArray, 9568, 12);
    @CAN_PrivMain::RFR_Object::RXX_Object_Obj17.PyAxCoVnce = convertRawToPhysical(raw_value, 0.01, 0.0);

    raw_value=copyBitsFromByteArrayLE( byteArray, 9580, 12);
    @CAN_PrivMain::RFR_Object::RXX_Object_Obj17.PyAyCoVnce = convertRawToPhysical(raw_value, 0.01, 0.0);

    raw_value=copyBitsFromByteArrayLE( byteArray, 9260, 12);
    @CAN_PrivMain::RFR_Object::RXX_Object_Obj17.PyVnce = convertRawToPhysical(raw_value, 0.1, 0.0);

    raw_value=copyBitsFromByteArrayLE( byteArray, 9504, 12);
    @CAN_PrivMain::RFR_Object::RXX_Object_Obj17.PyVxCoVnce = convertRawToPhysical(raw_value, 0.01, 0.0);

    raw_value=copyBitsFromByteArrayLE( byteArray, 9516, 12);
    @CAN_PrivMain::RFR_Object::RXX_Object_Obj17.PyVyCoVnce = convertRawToPhysical(raw_value, 0.01, 0.0);

    raw_value=copyBitsFromByteArrayLE( byteArray, 9356, 10);
    @CAN_PrivMain::RFR_Object::RXX_Object_Obj17.RCS = convertRawToPhysical(raw_value, 0.2, -102.4);

    raw_value=copyBitsFromByteArrayLE( byteArray, 9528, 4);
    @CAN_PrivMain::RFR_Object::RXX_Object_Obj17.ReferencePoint = convertRawToPhysical(raw_value, 1.0, 0.0);

    raw_value=copyBitsFromByteArrayLE( byteArray, 9388, 12);
    @CAN_PrivMain::RFR_Object::RXX_Object_Obj17.Vx = convertRawToPhysical(raw_value, 0.0625, -128.0);

    raw_value=copyBitsFromByteArrayLE( byteArray, 9612, 12);
    @CAN_PrivMain::RFR_Object::RXX_Object_Obj17.VxAxCoVnce = convertRawToPhysical(raw_value, 0.01, 0.0);

    raw_value=copyBitsFromByteArrayLE( byteArray, 9632, 12);
    @CAN_PrivMain::RFR_Object::RXX_Object_Obj17.VxAyCoVnce = convertRawToPhysical(raw_value, 0.01, 0.0);

    raw_value=copyBitsFromByteArrayLE( byteArray, 9408, 12);
    @CAN_PrivMain::RFR_Object::RXX_Object_Obj17.VxVnce = convertRawToPhysical(raw_value, 0.01, 0.0);

    raw_value=copyBitsFromByteArrayLE( byteArray, 9600, 12);
    @CAN_PrivMain::RFR_Object::RXX_Object_Obj17.VxVyCoVnce = convertRawToPhysical(raw_value, 0.01, 0.0);

    raw_value=copyBitsFromByteArrayLE( byteArray, 9422, 10);
    @CAN_PrivMain::RFR_Object::RXX_Object_Obj17.Vy = convertRawToPhysical(raw_value, 0.125, -64.0);

    raw_value=copyBitsFromByteArrayLE( byteArray, 9644, 12);
    @CAN_PrivMain::RFR_Object::RXX_Object_Obj17.VyAxCoVnce = convertRawToPhysical(raw_value, 0.01, 0.0);

    raw_value=copyBitsFromByteArrayLE( byteArray, 9664, 12);
    @CAN_PrivMain::RFR_Object::RXX_Object_Obj17.VyAyCoVnce = convertRawToPhysical(raw_value, 0.01, 0.0);

    raw_value=copyBitsFromByteArrayLE( byteArray, 9440, 12);
    @CAN_PrivMain::RFR_Object::RXX_Object_Obj17.VyVnce = convertRawToPhysical(raw_value, 0.01, 0.0);

    raw_value=copyBitsFromByteArrayLE( byteArray, 9336, 7);
    @CAN_PrivMain::RFR_Object::RXX_Object_Obj17.Width = convertRawToPhysical(raw_value, 0.125, 0.0);

    raw_value=copyBitsFromByteArrayLE( byteArray, 9344, 12);
    @CAN_PrivMain::RFR_Object::RXX_Object_Obj17.WidthVnce = convertRawToPhysical(raw_value, 0.01, 0.0);
}


void CRadarFR_RXX_Object_Obj18_SetDataReceived(byte byteArray[])
{
    qword raw_value;

    raw_value=copyBitsFromByteArrayLE( byteArray, 10208, 32);
    @CAN_PrivMain::RFR_Object::RXX_Object_Obj18.Age = convertRawToPhysical(raw_value, 1.0, 0.0);

    raw_value=copyBitsFromByteArrayLE( byteArray, 9804, 10);
    @CAN_PrivMain::RFR_Object::RXX_Object_Obj18.Ax = convertRawToPhysical(raw_value, 0.03125, -16.0);

    raw_value=copyBitsFromByteArrayLE( byteArray, 10188, 12);
    @CAN_PrivMain::RFR_Object::RXX_Object_Obj18.AxAyCoVnce = convertRawToPhysical(raw_value, 0.01, 0.0);

    raw_value=copyBitsFromByteArrayLE( byteArray, 9824, 12);
    @CAN_PrivMain::RFR_Object::RXX_Object_Obj18.AxVnce = convertRawToPhysical(raw_value, 0.01, 0.0);

    raw_value=copyBitsFromByteArrayLE( byteArray, 9878, 9);
    @CAN_PrivMain::RFR_Object::RXX_Object_Obj18.Ay = convertRawToPhysical(raw_value, 0.0625, -16.0);

    raw_value=copyBitsFromByteArrayLE( byteArray, 9888, 12);
    @CAN_PrivMain::RFR_Object::RXX_Object_Obj18.AyVnce = convertRawToPhysical(raw_value, 0.01, 0.0);

    raw_value=copyBitsFromByteArrayLE( byteArray, 9944, 6);
    @CAN_PrivMain::RFR_Object::RXX_Object_Obj18.ExistProb = convertRawToPhysical(raw_value, 2.0, 0.0);

    raw_value=copyBitsFromByteArrayLE( byteArray, 10008, 8);
    @CAN_PrivMain::RFR_Object::RXX_Object_Obj18.FilterInformation = convertRawToPhysical(raw_value, 1.0, 0.0);

    raw_value=copyBitsFromByteArrayLE( byteArray, 9784, 7);
    @CAN_PrivMain::RFR_Object::RXX_Object_Obj18.Length = convertRawToPhysical(raw_value, 0.125, 0.0);

    raw_value=copyBitsFromByteArrayLE( byteArray, 9792, 12);
    @CAN_PrivMain::RFR_Object::RXX_Object_Obj18.LengthVnce = convertRawToPhysical(raw_value, 0.01, 0.0);

    raw_value=copyBitsFromByteArrayLE( byteArray, 9976, 3);
    @CAN_PrivMain::RFR_Object::RXX_Object_Obj18.MeasurementStatus = convertRawToPhysical(raw_value, 1.0, 0.0);

    raw_value=copyBitsFromByteArrayLE( byteArray, 9932, 2);
    @CAN_PrivMain::RFR_Object::RXX_Object_Obj18.MovingStatus = convertRawToPhysical(raw_value, 1.0, 0.0);

    raw_value=copyBitsFromByteArrayLE( byteArray, 9912, 7);
    @CAN_PrivMain::RFR_Object::RXX_Object_Obj18.ObjId = convertRawToPhysical(raw_value, 1.0, 0.0);

    raw_value=copyBitsFromByteArrayLE( byteArray, 9814, 9);
    @CAN_PrivMain::RFR_Object::RXX_Object_Obj18.OrientationYaw = convertRawToPhysical(raw_value, 0.0175, -4.48);

    raw_value=copyBitsFromByteArrayLE( byteArray, 9836, 12);
    @CAN_PrivMain::RFR_Object::RXX_Object_Obj18.OrientationYawVnce = convertRawToPhysical(raw_value, 0.0003, 0.0);

    raw_value=copyBitsFromByteArrayLE( byteArray, 9728, 6);
    @CAN_PrivMain::RFR_Object::RXX_Object_Obj18.ProbClassConfidence = convertRawToPhysical(raw_value, 2.0, 0.0);

    raw_value=copyBitsFromByteArrayLE( byteArray, 9979, 4);
    @CAN_PrivMain::RFR_Object::RXX_Object_Obj18.ProbClassType = convertRawToPhysical(raw_value, 1.0, 0.0);

    raw_value=copyBitsFromByteArrayLE( byteArray, 9734, 14);
    @CAN_PrivMain::RFR_Object::RXX_Object_Obj18.Px = convertRawToPhysical(raw_value, 0.0625, -512.0);

    raw_value=copyBitsFromByteArrayLE( byteArray, 10048, 12);
    @CAN_PrivMain::RFR_Object::RXX_Object_Obj18.PxAxCoVnce = convertRawToPhysical(raw_value, 0.01, 0.0);

    raw_value=copyBitsFromByteArrayLE( byteArray, 10060, 12);
    @CAN_PrivMain::RFR_Object::RXX_Object_Obj18.PxAyCoVnce = convertRawToPhysical(raw_value, 0.01, 0.0);

    raw_value=copyBitsFromByteArrayLE( byteArray, 9964, 12);
    @CAN_PrivMain::RFR_Object::RXX_Object_Obj18.PxPyCoVnce = convertRawToPhysical(raw_value, 0.01, 0.0);

    raw_value=copyBitsFromByteArrayLE( byteArray, 9748, 12);
    @CAN_PrivMain::RFR_Object::RXX_Object_Obj18.PxVnce = convertRawToPhysical(raw_value, 0.1, 0.0);

    raw_value=copyBitsFromByteArrayLE( byteArray, 9984, 12);
    @CAN_PrivMain::RFR_Object::RXX_Object_Obj18.PxVxCoVnce = convertRawToPhysical(raw_value, 0.01, 0.0);

    raw_value=copyBitsFromByteArrayLE( byteArray, 9996, 12);
    @CAN_PrivMain::RFR_Object::RXX_Object_Obj18.PxVyCoVnce = convertRawToPhysical(raw_value, 0.01, 0.0);

    raw_value=copyBitsFromByteArrayLE( byteArray, 9760, 12);
    @CAN_PrivMain::RFR_Object::RXX_Object_Obj18.Py = convertRawToPhysical(raw_value, 0.0625, -128.0);

    raw_value=copyBitsFromByteArrayLE( byteArray, 10080, 12);
    @CAN_PrivMain::RFR_Object::RXX_Object_Obj18.PyAxCoVnce = convertRawToPhysical(raw_value, 0.01, 0.0);

    raw_value=copyBitsFromByteArrayLE( byteArray, 10092, 12);
    @CAN_PrivMain::RFR_Object::RXX_Object_Obj18.PyAyCoVnce = convertRawToPhysical(raw_value, 0.01, 0.0);

    raw_value=copyBitsFromByteArrayLE( byteArray, 9772, 12);
    @CAN_PrivMain::RFR_Object::RXX_Object_Obj18.PyVnce = convertRawToPhysical(raw_value, 0.1, 0.0);

    raw_value=copyBitsFromByteArrayLE( byteArray, 10016, 12);
    @CAN_PrivMain::RFR_Object::RXX_Object_Obj18.PyVxCoVnce = convertRawToPhysical(raw_value, 0.01, 0.0);

    raw_value=copyBitsFromByteArrayLE( byteArray, 10028, 12);
    @CAN_PrivMain::RFR_Object::RXX_Object_Obj18.PyVyCoVnce = convertRawToPhysical(raw_value, 0.01, 0.0);

    raw_value=copyBitsFromByteArrayLE( byteArray, 9868, 10);
    @CAN_PrivMain::RFR_Object::RXX_Object_Obj18.RCS = convertRawToPhysical(raw_value, 0.2, -102.4);

    raw_value=copyBitsFromByteArrayLE( byteArray, 10040, 4);
    @CAN_PrivMain::RFR_Object::RXX_Object_Obj18.ReferencePoint = convertRawToPhysical(raw_value, 1.0, 0.0);

    raw_value=copyBitsFromByteArrayLE( byteArray, 9900, 12);
    @CAN_PrivMain::RFR_Object::RXX_Object_Obj18.Vx = convertRawToPhysical(raw_value, 0.0625, -128.0);

    raw_value=copyBitsFromByteArrayLE( byteArray, 10124, 12);
    @CAN_PrivMain::RFR_Object::RXX_Object_Obj18.VxAxCoVnce = convertRawToPhysical(raw_value, 0.01, 0.0);

    raw_value=copyBitsFromByteArrayLE( byteArray, 10144, 12);
    @CAN_PrivMain::RFR_Object::RXX_Object_Obj18.VxAyCoVnce = convertRawToPhysical(raw_value, 0.01, 0.0);

    raw_value=copyBitsFromByteArrayLE( byteArray, 9920, 12);
    @CAN_PrivMain::RFR_Object::RXX_Object_Obj18.VxVnce = convertRawToPhysical(raw_value, 0.01, 0.0);

    raw_value=copyBitsFromByteArrayLE( byteArray, 10112, 12);
    @CAN_PrivMain::RFR_Object::RXX_Object_Obj18.VxVyCoVnce = convertRawToPhysical(raw_value, 0.01, 0.0);

    raw_value=copyBitsFromByteArrayLE( byteArray, 9934, 10);
    @CAN_PrivMain::RFR_Object::RXX_Object_Obj18.Vy = convertRawToPhysical(raw_value, 0.125, -64.0);

    raw_value=copyBitsFromByteArrayLE( byteArray, 10156, 12);
    @CAN_PrivMain::RFR_Object::RXX_Object_Obj18.VyAxCoVnce = convertRawToPhysical(raw_value, 0.01, 0.0);

    raw_value=copyBitsFromByteArrayLE( byteArray, 10176, 12);
    @CAN_PrivMain::RFR_Object::RXX_Object_Obj18.VyAyCoVnce = convertRawToPhysical(raw_value, 0.01, 0.0);

    raw_value=copyBitsFromByteArrayLE( byteArray, 9952, 12);
    @CAN_PrivMain::RFR_Object::RXX_Object_Obj18.VyVnce = convertRawToPhysical(raw_value, 0.01, 0.0);

    raw_value=copyBitsFromByteArrayLE( byteArray, 9848, 7);
    @CAN_PrivMain::RFR_Object::RXX_Object_Obj18.Width = convertRawToPhysical(raw_value, 0.125, 0.0);

    raw_value=copyBitsFromByteArrayLE( byteArray, 9856, 12);
    @CAN_PrivMain::RFR_Object::RXX_Object_Obj18.WidthVnce = convertRawToPhysical(raw_value, 0.01, 0.0);
}


void CRadarFR_RXX_Object_Obj19_SetDataReceived(byte byteArray[])
{
    qword raw_value;

    raw_value=copyBitsFromByteArrayLE( byteArray, 10720, 32);
    @CAN_PrivMain::RFR_Object::RXX_Object_Obj19.Age = convertRawToPhysical(raw_value, 1.0, 0.0);

    raw_value=copyBitsFromByteArrayLE( byteArray, 10316, 10);
    @CAN_PrivMain::RFR_Object::RXX_Object_Obj19.Ax = convertRawToPhysical(raw_value, 0.03125, -16.0);

    raw_value=copyBitsFromByteArrayLE( byteArray, 10700, 12);
    @CAN_PrivMain::RFR_Object::RXX_Object_Obj19.AxAyCoVnce = convertRawToPhysical(raw_value, 0.01, 0.0);

    raw_value=copyBitsFromByteArrayLE( byteArray, 10336, 12);
    @CAN_PrivMain::RFR_Object::RXX_Object_Obj19.AxVnce = convertRawToPhysical(raw_value, 0.01, 0.0);

    raw_value=copyBitsFromByteArrayLE( byteArray, 10390, 9);
    @CAN_PrivMain::RFR_Object::RXX_Object_Obj19.Ay = convertRawToPhysical(raw_value, 0.0625, -16.0);

    raw_value=copyBitsFromByteArrayLE( byteArray, 10400, 12);
    @CAN_PrivMain::RFR_Object::RXX_Object_Obj19.AyVnce = convertRawToPhysical(raw_value, 0.01, 0.0);

    raw_value=copyBitsFromByteArrayLE( byteArray, 10456, 6);
    @CAN_PrivMain::RFR_Object::RXX_Object_Obj19.ExistProb = convertRawToPhysical(raw_value, 2.0, 0.0);

    raw_value=copyBitsFromByteArrayLE( byteArray, 10520, 8);
    @CAN_PrivMain::RFR_Object::RXX_Object_Obj19.FilterInformation = convertRawToPhysical(raw_value, 1.0, 0.0);

    raw_value=copyBitsFromByteArrayLE( byteArray, 10296, 7);
    @CAN_PrivMain::RFR_Object::RXX_Object_Obj19.Length = convertRawToPhysical(raw_value, 0.125, 0.0);

    raw_value=copyBitsFromByteArrayLE( byteArray, 10304, 12);
    @CAN_PrivMain::RFR_Object::RXX_Object_Obj19.LengthVnce = convertRawToPhysical(raw_value, 0.01, 0.0);

    raw_value=copyBitsFromByteArrayLE( byteArray, 10488, 3);
    @CAN_PrivMain::RFR_Object::RXX_Object_Obj19.MeasurementStatus = convertRawToPhysical(raw_value, 1.0, 0.0);

    raw_value=copyBitsFromByteArrayLE( byteArray, 10444, 2);
    @CAN_PrivMain::RFR_Object::RXX_Object_Obj19.MovingStatus = convertRawToPhysical(raw_value, 1.0, 0.0);

    raw_value=copyBitsFromByteArrayLE( byteArray, 10424, 7);
    @CAN_PrivMain::RFR_Object::RXX_Object_Obj19.ObjId = convertRawToPhysical(raw_value, 1.0, 0.0);

    raw_value=copyBitsFromByteArrayLE( byteArray, 10326, 9);
    @CAN_PrivMain::RFR_Object::RXX_Object_Obj19.OrientationYaw = convertRawToPhysical(raw_value, 0.0175, -4.48);

    raw_value=copyBitsFromByteArrayLE( byteArray, 10348, 12);
    @CAN_PrivMain::RFR_Object::RXX_Object_Obj19.OrientationYawVnce = convertRawToPhysical(raw_value, 0.0003, 0.0);

    raw_value=copyBitsFromByteArrayLE( byteArray, 10240, 6);
    @CAN_PrivMain::RFR_Object::RXX_Object_Obj19.ProbClassConfidence = convertRawToPhysical(raw_value, 2.0, 0.0);

    raw_value=copyBitsFromByteArrayLE( byteArray, 10491, 4);
    @CAN_PrivMain::RFR_Object::RXX_Object_Obj19.ProbClassType = convertRawToPhysical(raw_value, 1.0, 0.0);

    raw_value=copyBitsFromByteArrayLE( byteArray, 10246, 14);
    @CAN_PrivMain::RFR_Object::RXX_Object_Obj19.Px = convertRawToPhysical(raw_value, 0.0625, -512.0);

    raw_value=copyBitsFromByteArrayLE( byteArray, 10560, 12);
    @CAN_PrivMain::RFR_Object::RXX_Object_Obj19.PxAxCoVnce = convertRawToPhysical(raw_value, 0.01, 0.0);

    raw_value=copyBitsFromByteArrayLE( byteArray, 10572, 12);
    @CAN_PrivMain::RFR_Object::RXX_Object_Obj19.PxAyCoVnce = convertRawToPhysical(raw_value, 0.01, 0.0);

    raw_value=copyBitsFromByteArrayLE( byteArray, 10476, 12);
    @CAN_PrivMain::RFR_Object::RXX_Object_Obj19.PxPyCoVnce = convertRawToPhysical(raw_value, 0.01, 0.0);

    raw_value=copyBitsFromByteArrayLE( byteArray, 10260, 12);
    @CAN_PrivMain::RFR_Object::RXX_Object_Obj19.PxVnce = convertRawToPhysical(raw_value, 0.1, 0.0);

    raw_value=copyBitsFromByteArrayLE( byteArray, 10496, 12);
    @CAN_PrivMain::RFR_Object::RXX_Object_Obj19.PxVxCoVnce = convertRawToPhysical(raw_value, 0.01, 0.0);

    raw_value=copyBitsFromByteArrayLE( byteArray, 10508, 12);
    @CAN_PrivMain::RFR_Object::RXX_Object_Obj19.PxVyCoVnce = convertRawToPhysical(raw_value, 0.01, 0.0);

    raw_value=copyBitsFromByteArrayLE( byteArray, 10272, 12);
    @CAN_PrivMain::RFR_Object::RXX_Object_Obj19.Py = convertRawToPhysical(raw_value, 0.0625, -128.0);

    raw_value=copyBitsFromByteArrayLE( byteArray, 10592, 12);
    @CAN_PrivMain::RFR_Object::RXX_Object_Obj19.PyAxCoVnce = convertRawToPhysical(raw_value, 0.01, 0.0);

    raw_value=copyBitsFromByteArrayLE( byteArray, 10604, 12);
    @CAN_PrivMain::RFR_Object::RXX_Object_Obj19.PyAyCoVnce = convertRawToPhysical(raw_value, 0.01, 0.0);

    raw_value=copyBitsFromByteArrayLE( byteArray, 10284, 12);
    @CAN_PrivMain::RFR_Object::RXX_Object_Obj19.PyVnce = convertRawToPhysical(raw_value, 0.1, 0.0);

    raw_value=copyBitsFromByteArrayLE( byteArray, 10528, 12);
    @CAN_PrivMain::RFR_Object::RXX_Object_Obj19.PyVxCoVnce = convertRawToPhysical(raw_value, 0.01, 0.0);

    raw_value=copyBitsFromByteArrayLE( byteArray, 10540, 12);
    @CAN_PrivMain::RFR_Object::RXX_Object_Obj19.PyVyCoVnce = convertRawToPhysical(raw_value, 0.01, 0.0);

    raw_value=copyBitsFromByteArrayLE( byteArray, 10380, 10);
    @CAN_PrivMain::RFR_Object::RXX_Object_Obj19.RCS = convertRawToPhysical(raw_value, 0.2, -102.4);

    raw_value=copyBitsFromByteArrayLE( byteArray, 10552, 4);
    @CAN_PrivMain::RFR_Object::RXX_Object_Obj19.ReferencePoint = convertRawToPhysical(raw_value, 1.0, 0.0);

    raw_value=copyBitsFromByteArrayLE( byteArray, 10412, 12);
    @CAN_PrivMain::RFR_Object::RXX_Object_Obj19.Vx = convertRawToPhysical(raw_value, 0.0625, -128.0);

    raw_value=copyBitsFromByteArrayLE( byteArray, 10636, 12);
    @CAN_PrivMain::RFR_Object::RXX_Object_Obj19.VxAxCoVnce = convertRawToPhysical(raw_value, 0.01, 0.0);

    raw_value=copyBitsFromByteArrayLE( byteArray, 10656, 12);
    @CAN_PrivMain::RFR_Object::RXX_Object_Obj19.VxAyCoVnce = convertRawToPhysical(raw_value, 0.01, 0.0);

    raw_value=copyBitsFromByteArrayLE( byteArray, 10432, 12);
    @CAN_PrivMain::RFR_Object::RXX_Object_Obj19.VxVnce = convertRawToPhysical(raw_value, 0.01, 0.0);

    raw_value=copyBitsFromByteArrayLE( byteArray, 10624, 12);
    @CAN_PrivMain::RFR_Object::RXX_Object_Obj19.VxVyCoVnce = convertRawToPhysical(raw_value, 0.01, 0.0);

    raw_value=copyBitsFromByteArrayLE( byteArray, 10446, 10);
    @CAN_PrivMain::RFR_Object::RXX_Object_Obj19.Vy = convertRawToPhysical(raw_value, 0.125, -64.0);

    raw_value=copyBitsFromByteArrayLE( byteArray, 10668, 12);
    @CAN_PrivMain::RFR_Object::RXX_Object_Obj19.VyAxCoVnce = convertRawToPhysical(raw_value, 0.01, 0.0);

    raw_value=copyBitsFromByteArrayLE( byteArray, 10688, 12);
    @CAN_PrivMain::RFR_Object::RXX_Object_Obj19.VyAyCoVnce = convertRawToPhysical(raw_value, 0.01, 0.0);

    raw_value=copyBitsFromByteArrayLE( byteArray, 10464, 12);
    @CAN_PrivMain::RFR_Object::RXX_Object_Obj19.VyVnce = convertRawToPhysical(raw_value, 0.01, 0.0);

    raw_value=copyBitsFromByteArrayLE( byteArray, 10360, 7);
    @CAN_PrivMain::RFR_Object::RXX_Object_Obj19.Width = convertRawToPhysical(raw_value, 0.125, 0.0);

    raw_value=copyBitsFromByteArrayLE( byteArray, 10368, 12);
    @CAN_PrivMain::RFR_Object::RXX_Object_Obj19.WidthVnce = convertRawToPhysical(raw_value, 0.01, 0.0);
}


void CRadarFR_RXX_Object_Obj2_SetDataReceived(byte byteArray[])
{
    qword raw_value;

    raw_value=copyBitsFromByteArrayLE( byteArray, 2016, 32);
    @CAN_PrivMain::RFR_Object::RXX_Object_Obj2.Age = convertRawToPhysical(raw_value, 1.0, 0.0);

    raw_value=copyBitsFromByteArrayLE( byteArray, 1612, 10);
    @CAN_PrivMain::RFR_Object::RXX_Object_Obj2.Ax = convertRawToPhysical(raw_value, 0.03125, -16.0);

    raw_value=copyBitsFromByteArrayLE( byteArray, 1996, 12);
    @CAN_PrivMain::RFR_Object::RXX_Object_Obj2.AxAyCoVnce = convertRawToPhysical(raw_value, 0.01, 0.0);

    raw_value=copyBitsFromByteArrayLE( byteArray, 1632, 12);
    @CAN_PrivMain::RFR_Object::RXX_Object_Obj2.AxVnce = convertRawToPhysical(raw_value, 0.01, 0.0);

    raw_value=copyBitsFromByteArrayLE( byteArray, 1686, 9);
    @CAN_PrivMain::RFR_Object::RXX_Object_Obj2.Ay = convertRawToPhysical(raw_value, 0.0625, -16.0);

    raw_value=copyBitsFromByteArrayLE( byteArray, 1696, 12);
    @CAN_PrivMain::RFR_Object::RXX_Object_Obj2.AyVnce = convertRawToPhysical(raw_value, 0.01, 0.0);

    raw_value=copyBitsFromByteArrayLE( byteArray, 1752, 6);
    @CAN_PrivMain::RFR_Object::RXX_Object_Obj2.ExistProb = convertRawToPhysical(raw_value, 2.0, 0.0);

    raw_value=copyBitsFromByteArrayLE( byteArray, 1816, 8);
    @CAN_PrivMain::RFR_Object::RXX_Object_Obj2.FilterInformation = convertRawToPhysical(raw_value, 1.0, 0.0);

    raw_value=copyBitsFromByteArrayLE( byteArray, 1592, 7);
    @CAN_PrivMain::RFR_Object::RXX_Object_Obj2.Length = convertRawToPhysical(raw_value, 0.125, 0.0);

    raw_value=copyBitsFromByteArrayLE( byteArray, 1600, 12);
    @CAN_PrivMain::RFR_Object::RXX_Object_Obj2.LengthVnce = convertRawToPhysical(raw_value, 0.01, 0.0);

    raw_value=copyBitsFromByteArrayLE( byteArray, 1784, 3);
    @CAN_PrivMain::RFR_Object::RXX_Object_Obj2.MeasurementStatus = convertRawToPhysical(raw_value, 1.0, 0.0);

    raw_value=copyBitsFromByteArrayLE( byteArray, 1740, 2);
    @CAN_PrivMain::RFR_Object::RXX_Object_Obj2.MovingStatus = convertRawToPhysical(raw_value, 1.0, 0.0);

    raw_value=copyBitsFromByteArrayLE( byteArray, 1720, 7);
    @CAN_PrivMain::RFR_Object::RXX_Object_Obj2.ObjId = convertRawToPhysical(raw_value, 1.0, 0.0);

    raw_value=copyBitsFromByteArrayLE( byteArray, 1622, 9);
    @CAN_PrivMain::RFR_Object::RXX_Object_Obj2.OrientationYaw = convertRawToPhysical(raw_value, 0.0175, -4.48);

    raw_value=copyBitsFromByteArrayLE( byteArray, 1644, 12);
    @CAN_PrivMain::RFR_Object::RXX_Object_Obj2.OrientationYawVnce = convertRawToPhysical(raw_value, 0.0003, 0.0);

    raw_value=copyBitsFromByteArrayLE( byteArray, 1536, 6);
    @CAN_PrivMain::RFR_Object::RXX_Object_Obj2.ProbClassConfidence = convertRawToPhysical(raw_value, 2.0, 0.0);

    raw_value=copyBitsFromByteArrayLE( byteArray, 1787, 4);
    @CAN_PrivMain::RFR_Object::RXX_Object_Obj2.ProbClassType = convertRawToPhysical(raw_value, 1.0, 0.0);

    raw_value=copyBitsFromByteArrayLE( byteArray, 1542, 14);
    @CAN_PrivMain::RFR_Object::RXX_Object_Obj2.Px = convertRawToPhysical(raw_value, 0.0625, -512.0);

    raw_value=copyBitsFromByteArrayLE( byteArray, 1856, 12);
    @CAN_PrivMain::RFR_Object::RXX_Object_Obj2.PxAxCoVnce = convertRawToPhysical(raw_value, 0.01, 0.0);

    raw_value=copyBitsFromByteArrayLE( byteArray, 1868, 12);
    @CAN_PrivMain::RFR_Object::RXX_Object_Obj2.PxAyCoVnce = convertRawToPhysical(raw_value, 0.01, 0.0);

    raw_value=copyBitsFromByteArrayLE( byteArray, 1772, 12);
    @CAN_PrivMain::RFR_Object::RXX_Object_Obj2.PxPyCoVnce = convertRawToPhysical(raw_value, 0.01, 0.0);

    raw_value=copyBitsFromByteArrayLE( byteArray, 1556, 12);
    @CAN_PrivMain::RFR_Object::RXX_Object_Obj2.PxVnce = convertRawToPhysical(raw_value, 0.1, 0.0);

    raw_value=copyBitsFromByteArrayLE( byteArray, 1792, 12);
    @CAN_PrivMain::RFR_Object::RXX_Object_Obj2.PxVxCoVnce = convertRawToPhysical(raw_value, 0.01, 0.0);

    raw_value=copyBitsFromByteArrayLE( byteArray, 1804, 12);
    @CAN_PrivMain::RFR_Object::RXX_Object_Obj2.PxVyCoVnce = convertRawToPhysical(raw_value, 0.01, 0.0);

    raw_value=copyBitsFromByteArrayLE( byteArray, 1568, 12);
    @CAN_PrivMain::RFR_Object::RXX_Object_Obj2.Py = convertRawToPhysical(raw_value, 0.0625, -128.0);

    raw_value=copyBitsFromByteArrayLE( byteArray, 1888, 12);
    @CAN_PrivMain::RFR_Object::RXX_Object_Obj2.PyAxCoVnce = convertRawToPhysical(raw_value, 0.01, 0.0);

    raw_value=copyBitsFromByteArrayLE( byteArray, 1900, 12);
    @CAN_PrivMain::RFR_Object::RXX_Object_Obj2.PyAyCoVnce = convertRawToPhysical(raw_value, 0.01, 0.0);

    raw_value=copyBitsFromByteArrayLE( byteArray, 1580, 12);
    @CAN_PrivMain::RFR_Object::RXX_Object_Obj2.PyVnce = convertRawToPhysical(raw_value, 0.1, 0.0);

    raw_value=copyBitsFromByteArrayLE( byteArray, 1824, 12);
    @CAN_PrivMain::RFR_Object::RXX_Object_Obj2.PyVxCoVnce = convertRawToPhysical(raw_value, 0.01, 0.0);

    raw_value=copyBitsFromByteArrayLE( byteArray, 1836, 12);
    @CAN_PrivMain::RFR_Object::RXX_Object_Obj2.PyVyCoVnce = convertRawToPhysical(raw_value, 0.01, 0.0);

    raw_value=copyBitsFromByteArrayLE( byteArray, 1676, 10);
    @CAN_PrivMain::RFR_Object::RXX_Object_Obj2.RCS = convertRawToPhysical(raw_value, 0.2, -102.4);

    raw_value=copyBitsFromByteArrayLE( byteArray, 1848, 4);
    @CAN_PrivMain::RFR_Object::RXX_Object_Obj2.ReferencePoint = convertRawToPhysical(raw_value, 1.0, 0.0);

    raw_value=copyBitsFromByteArrayLE( byteArray, 1708, 12);
    @CAN_PrivMain::RFR_Object::RXX_Object_Obj2.Vx = convertRawToPhysical(raw_value, 0.0625, -128.0);

    raw_value=copyBitsFromByteArrayLE( byteArray, 1932, 12);
    @CAN_PrivMain::RFR_Object::RXX_Object_Obj2.VxAxCoVnce = convertRawToPhysical(raw_value, 0.01, 0.0);

    raw_value=copyBitsFromByteArrayLE( byteArray, 1952, 12);
    @CAN_PrivMain::RFR_Object::RXX_Object_Obj2.VxAyCoVnce = convertRawToPhysical(raw_value, 0.01, 0.0);

    raw_value=copyBitsFromByteArrayLE( byteArray, 1728, 12);
    @CAN_PrivMain::RFR_Object::RXX_Object_Obj2.VxVnce = convertRawToPhysical(raw_value, 0.01, 0.0);

    raw_value=copyBitsFromByteArrayLE( byteArray, 1920, 12);
    @CAN_PrivMain::RFR_Object::RXX_Object_Obj2.VxVyCoVnce = convertRawToPhysical(raw_value, 0.01, 0.0);

    raw_value=copyBitsFromByteArrayLE( byteArray, 1742, 10);
    @CAN_PrivMain::RFR_Object::RXX_Object_Obj2.Vy = convertRawToPhysical(raw_value, 0.125, -64.0);

    raw_value=copyBitsFromByteArrayLE( byteArray, 1964, 12);
    @CAN_PrivMain::RFR_Object::RXX_Object_Obj2.VyAxCoVnce = convertRawToPhysical(raw_value, 0.01, 0.0);

    raw_value=copyBitsFromByteArrayLE( byteArray, 1984, 12);
    @CAN_PrivMain::RFR_Object::RXX_Object_Obj2.VyAyCoVnce = convertRawToPhysical(raw_value, 0.01, 0.0);

    raw_value=copyBitsFromByteArrayLE( byteArray, 1760, 12);
    @CAN_PrivMain::RFR_Object::RXX_Object_Obj2.VyVnce = convertRawToPhysical(raw_value, 0.01, 0.0);

    raw_value=copyBitsFromByteArrayLE( byteArray, 1656, 7);
    @CAN_PrivMain::RFR_Object::RXX_Object_Obj2.Width = convertRawToPhysical(raw_value, 0.125, 0.0);

    raw_value=copyBitsFromByteArrayLE( byteArray, 1664, 12);
    @CAN_PrivMain::RFR_Object::RXX_Object_Obj2.WidthVnce = convertRawToPhysical(raw_value, 0.01, 0.0);
}


void CRadarFR_RXX_Object_Obj20_SetDataReceived(byte byteArray[])
{
    qword raw_value;

    raw_value=copyBitsFromByteArrayLE( byteArray, 11232, 32);
    @CAN_PrivMain::RFR_Object::RXX_Object_Obj20.Age = convertRawToPhysical(raw_value, 1.0, 0.0);

    raw_value=copyBitsFromByteArrayLE( byteArray, 10828, 10);
    @CAN_PrivMain::RFR_Object::RXX_Object_Obj20.Ax = convertRawToPhysical(raw_value, 0.03125, -16.0);

    raw_value=copyBitsFromByteArrayLE( byteArray, 11212, 12);
    @CAN_PrivMain::RFR_Object::RXX_Object_Obj20.AxAyCoVnce = convertRawToPhysical(raw_value, 0.01, 0.0);

    raw_value=copyBitsFromByteArrayLE( byteArray, 10848, 12);
    @CAN_PrivMain::RFR_Object::RXX_Object_Obj20.AxVnce = convertRawToPhysical(raw_value, 0.01, 0.0);

    raw_value=copyBitsFromByteArrayLE( byteArray, 10902, 9);
    @CAN_PrivMain::RFR_Object::RXX_Object_Obj20.Ay = convertRawToPhysical(raw_value, 0.0625, -16.0);

    raw_value=copyBitsFromByteArrayLE( byteArray, 10912, 12);
    @CAN_PrivMain::RFR_Object::RXX_Object_Obj20.AyVnce = convertRawToPhysical(raw_value, 0.01, 0.0);

    raw_value=copyBitsFromByteArrayLE( byteArray, 10968, 6);
    @CAN_PrivMain::RFR_Object::RXX_Object_Obj20.ExistProb = convertRawToPhysical(raw_value, 2.0, 0.0);

    raw_value=copyBitsFromByteArrayLE( byteArray, 11032, 8);
    @CAN_PrivMain::RFR_Object::RXX_Object_Obj20.FilterInformation = convertRawToPhysical(raw_value, 1.0, 0.0);

    raw_value=copyBitsFromByteArrayLE( byteArray, 10808, 7);
    @CAN_PrivMain::RFR_Object::RXX_Object_Obj20.Length = convertRawToPhysical(raw_value, 0.125, 0.0);

    raw_value=copyBitsFromByteArrayLE( byteArray, 10816, 12);
    @CAN_PrivMain::RFR_Object::RXX_Object_Obj20.LengthVnce = convertRawToPhysical(raw_value, 0.01, 0.0);

    raw_value=copyBitsFromByteArrayLE( byteArray, 11000, 3);
    @CAN_PrivMain::RFR_Object::RXX_Object_Obj20.MeasurementStatus = convertRawToPhysical(raw_value, 1.0, 0.0);

    raw_value=copyBitsFromByteArrayLE( byteArray, 10956, 2);
    @CAN_PrivMain::RFR_Object::RXX_Object_Obj20.MovingStatus = convertRawToPhysical(raw_value, 1.0, 0.0);

    raw_value=copyBitsFromByteArrayLE( byteArray, 10936, 7);
    @CAN_PrivMain::RFR_Object::RXX_Object_Obj20.ObjId = convertRawToPhysical(raw_value, 1.0, 0.0);

    raw_value=copyBitsFromByteArrayLE( byteArray, 10838, 9);
    @CAN_PrivMain::RFR_Object::RXX_Object_Obj20.OrientationYaw = convertRawToPhysical(raw_value, 0.0175, -4.48);

    raw_value=copyBitsFromByteArrayLE( byteArray, 10860, 12);
    @CAN_PrivMain::RFR_Object::RXX_Object_Obj20.OrientationYawVnce = convertRawToPhysical(raw_value, 0.0003, 0.0);

    raw_value=copyBitsFromByteArrayLE( byteArray, 10752, 6);
    @CAN_PrivMain::RFR_Object::RXX_Object_Obj20.ProbClassConfidence = convertRawToPhysical(raw_value, 2.0, 0.0);

    raw_value=copyBitsFromByteArrayLE( byteArray, 11003, 4);
    @CAN_PrivMain::RFR_Object::RXX_Object_Obj20.ProbClassType = convertRawToPhysical(raw_value, 1.0, 0.0);

    raw_value=copyBitsFromByteArrayLE( byteArray, 10758, 14);
    @CAN_PrivMain::RFR_Object::RXX_Object_Obj20.Px = convertRawToPhysical(raw_value, 0.0625, -512.0);

    raw_value=copyBitsFromByteArrayLE( byteArray, 11072, 12);
    @CAN_PrivMain::RFR_Object::RXX_Object_Obj20.PxAxCoVnce = convertRawToPhysical(raw_value, 0.01, 0.0);

    raw_value=copyBitsFromByteArrayLE( byteArray, 11084, 12);
    @CAN_PrivMain::RFR_Object::RXX_Object_Obj20.PxAyCoVnce = convertRawToPhysical(raw_value, 0.01, 0.0);

    raw_value=copyBitsFromByteArrayLE( byteArray, 10988, 12);
    @CAN_PrivMain::RFR_Object::RXX_Object_Obj20.PxPyCoVnce = convertRawToPhysical(raw_value, 0.01, 0.0);

    raw_value=copyBitsFromByteArrayLE( byteArray, 10772, 12);
    @CAN_PrivMain::RFR_Object::RXX_Object_Obj20.PxVnce = convertRawToPhysical(raw_value, 0.1, 0.0);

    raw_value=copyBitsFromByteArrayLE( byteArray, 11008, 12);
    @CAN_PrivMain::RFR_Object::RXX_Object_Obj20.PxVxCoVnce = convertRawToPhysical(raw_value, 0.01, 0.0);

    raw_value=copyBitsFromByteArrayLE( byteArray, 11020, 12);
    @CAN_PrivMain::RFR_Object::RXX_Object_Obj20.PxVyCoVnce = convertRawToPhysical(raw_value, 0.01, 0.0);

    raw_value=copyBitsFromByteArrayLE( byteArray, 10784, 12);
    @CAN_PrivMain::RFR_Object::RXX_Object_Obj20.Py = convertRawToPhysical(raw_value, 0.0625, -128.0);

    raw_value=copyBitsFromByteArrayLE( byteArray, 11104, 12);
    @CAN_PrivMain::RFR_Object::RXX_Object_Obj20.PyAxCoVnce = convertRawToPhysical(raw_value, 0.01, 0.0);

    raw_value=copyBitsFromByteArrayLE( byteArray, 11116, 12);
    @CAN_PrivMain::RFR_Object::RXX_Object_Obj20.PyAyCoVnce = convertRawToPhysical(raw_value, 0.01, 0.0);

    raw_value=copyBitsFromByteArrayLE( byteArray, 10796, 12);
    @CAN_PrivMain::RFR_Object::RXX_Object_Obj20.PyVnce = convertRawToPhysical(raw_value, 0.1, 0.0);

    raw_value=copyBitsFromByteArrayLE( byteArray, 11040, 12);
    @CAN_PrivMain::RFR_Object::RXX_Object_Obj20.PyVxCoVnce = convertRawToPhysical(raw_value, 0.01, 0.0);

    raw_value=copyBitsFromByteArrayLE( byteArray, 11052, 12);
    @CAN_PrivMain::RFR_Object::RXX_Object_Obj20.PyVyCoVnce = convertRawToPhysical(raw_value, 0.01, 0.0);

    raw_value=copyBitsFromByteArrayLE( byteArray, 10892, 10);
    @CAN_PrivMain::RFR_Object::RXX_Object_Obj20.RCS = convertRawToPhysical(raw_value, 0.2, -102.4);

    raw_value=copyBitsFromByteArrayLE( byteArray, 11064, 4);
    @CAN_PrivMain::RFR_Object::RXX_Object_Obj20.ReferencePoint = convertRawToPhysical(raw_value, 1.0, 0.0);

    raw_value=copyBitsFromByteArrayLE( byteArray, 10924, 12);
    @CAN_PrivMain::RFR_Object::RXX_Object_Obj20.Vx = convertRawToPhysical(raw_value, 0.0625, -128.0);

    raw_value=copyBitsFromByteArrayLE( byteArray, 11148, 12);
    @CAN_PrivMain::RFR_Object::RXX_Object_Obj20.VxAxCoVnce = convertRawToPhysical(raw_value, 0.01, 0.0);

    raw_value=copyBitsFromByteArrayLE( byteArray, 11168, 12);
    @CAN_PrivMain::RFR_Object::RXX_Object_Obj20.VxAyCoVnce = convertRawToPhysical(raw_value, 0.01, 0.0);

    raw_value=copyBitsFromByteArrayLE( byteArray, 10944, 12);
    @CAN_PrivMain::RFR_Object::RXX_Object_Obj20.VxVnce = convertRawToPhysical(raw_value, 0.01, 0.0);

    raw_value=copyBitsFromByteArrayLE( byteArray, 11136, 12);
    @CAN_PrivMain::RFR_Object::RXX_Object_Obj20.VxVyCoVnce = convertRawToPhysical(raw_value, 0.01, 0.0);

    raw_value=copyBitsFromByteArrayLE( byteArray, 10958, 10);
    @CAN_PrivMain::RFR_Object::RXX_Object_Obj20.Vy = convertRawToPhysical(raw_value, 0.125, -64.0);

    raw_value=copyBitsFromByteArrayLE( byteArray, 11180, 12);
    @CAN_PrivMain::RFR_Object::RXX_Object_Obj20.VyAxCoVnce = convertRawToPhysical(raw_value, 0.01, 0.0);

    raw_value=copyBitsFromByteArrayLE( byteArray, 11200, 12);
    @CAN_PrivMain::RFR_Object::RXX_Object_Obj20.VyAyCoVnce = convertRawToPhysical(raw_value, 0.01, 0.0);

    raw_value=copyBitsFromByteArrayLE( byteArray, 10976, 12);
    @CAN_PrivMain::RFR_Object::RXX_Object_Obj20.VyVnce = convertRawToPhysical(raw_value, 0.01, 0.0);

    raw_value=copyBitsFromByteArrayLE( byteArray, 10872, 7);
    @CAN_PrivMain::RFR_Object::RXX_Object_Obj20.Width = convertRawToPhysical(raw_value, 0.125, 0.0);

    raw_value=copyBitsFromByteArrayLE( byteArray, 10880, 12);
    @CAN_PrivMain::RFR_Object::RXX_Object_Obj20.WidthVnce = convertRawToPhysical(raw_value, 0.01, 0.0);
}


void CRadarFR_RXX_Object_Obj21_SetDataReceived(byte byteArray[])
{
    qword raw_value;

    raw_value=copyBitsFromByteArrayLE( byteArray, 11744, 32);
    @CAN_PrivMain::RFR_Object::RXX_Object_Obj21.Age = convertRawToPhysical(raw_value, 1.0, 0.0);

    raw_value=copyBitsFromByteArrayLE( byteArray, 11340, 10);
    @CAN_PrivMain::RFR_Object::RXX_Object_Obj21.Ax = convertRawToPhysical(raw_value, 0.03125, -16.0);

    raw_value=copyBitsFromByteArrayLE( byteArray, 11724, 12);
    @CAN_PrivMain::RFR_Object::RXX_Object_Obj21.AxAyCoVnce = convertRawToPhysical(raw_value, 0.01, 0.0);

    raw_value=copyBitsFromByteArrayLE( byteArray, 11360, 12);
    @CAN_PrivMain::RFR_Object::RXX_Object_Obj21.AxVnce = convertRawToPhysical(raw_value, 0.01, 0.0);

    raw_value=copyBitsFromByteArrayLE( byteArray, 11414, 9);
    @CAN_PrivMain::RFR_Object::RXX_Object_Obj21.Ay = convertRawToPhysical(raw_value, 0.0625, -16.0);

    raw_value=copyBitsFromByteArrayLE( byteArray, 11424, 12);
    @CAN_PrivMain::RFR_Object::RXX_Object_Obj21.AyVnce = convertRawToPhysical(raw_value, 0.01, 0.0);

    raw_value=copyBitsFromByteArrayLE( byteArray, 11480, 6);
    @CAN_PrivMain::RFR_Object::RXX_Object_Obj21.ExistProb = convertRawToPhysical(raw_value, 2.0, 0.0);

    raw_value=copyBitsFromByteArrayLE( byteArray, 11544, 8);
    @CAN_PrivMain::RFR_Object::RXX_Object_Obj21.FilterInformation = convertRawToPhysical(raw_value, 1.0, 0.0);

    raw_value=copyBitsFromByteArrayLE( byteArray, 11320, 7);
    @CAN_PrivMain::RFR_Object::RXX_Object_Obj21.Length = convertRawToPhysical(raw_value, 0.125, 0.0);

    raw_value=copyBitsFromByteArrayLE( byteArray, 11328, 12);
    @CAN_PrivMain::RFR_Object::RXX_Object_Obj21.LengthVnce = convertRawToPhysical(raw_value, 0.01, 0.0);

    raw_value=copyBitsFromByteArrayLE( byteArray, 11512, 3);
    @CAN_PrivMain::RFR_Object::RXX_Object_Obj21.MeasurementStatus = convertRawToPhysical(raw_value, 1.0, 0.0);

    raw_value=copyBitsFromByteArrayLE( byteArray, 11468, 2);
    @CAN_PrivMain::RFR_Object::RXX_Object_Obj21.MovingStatus = convertRawToPhysical(raw_value, 1.0, 0.0);

    raw_value=copyBitsFromByteArrayLE( byteArray, 11448, 7);
    @CAN_PrivMain::RFR_Object::RXX_Object_Obj21.ObjId = convertRawToPhysical(raw_value, 1.0, 0.0);

    raw_value=copyBitsFromByteArrayLE( byteArray, 11350, 9);
    @CAN_PrivMain::RFR_Object::RXX_Object_Obj21.OrientationYaw = convertRawToPhysical(raw_value, 0.0175, -4.48);

    raw_value=copyBitsFromByteArrayLE( byteArray, 11372, 12);
    @CAN_PrivMain::RFR_Object::RXX_Object_Obj21.OrientationYawVnce = convertRawToPhysical(raw_value, 0.0003, 0.0);

    raw_value=copyBitsFromByteArrayLE( byteArray, 11264, 6);
    @CAN_PrivMain::RFR_Object::RXX_Object_Obj21.ProbClassConfidence = convertRawToPhysical(raw_value, 2.0, 0.0);

    raw_value=copyBitsFromByteArrayLE( byteArray, 11515, 4);
    @CAN_PrivMain::RFR_Object::RXX_Object_Obj21.ProbClassType = convertRawToPhysical(raw_value, 1.0, 0.0);

    raw_value=copyBitsFromByteArrayLE( byteArray, 11270, 14);
    @CAN_PrivMain::RFR_Object::RXX_Object_Obj21.Px = convertRawToPhysical(raw_value, 0.0625, -512.0);

    raw_value=copyBitsFromByteArrayLE( byteArray, 11584, 12);
    @CAN_PrivMain::RFR_Object::RXX_Object_Obj21.PxAxCoVnce = convertRawToPhysical(raw_value, 0.01, 0.0);

    raw_value=copyBitsFromByteArrayLE( byteArray, 11596, 12);
    @CAN_PrivMain::RFR_Object::RXX_Object_Obj21.PxAyCoVnce = convertRawToPhysical(raw_value, 0.01, 0.0);

    raw_value=copyBitsFromByteArrayLE( byteArray, 11500, 12);
    @CAN_PrivMain::RFR_Object::RXX_Object_Obj21.PxPyCoVnce = convertRawToPhysical(raw_value, 0.01, 0.0);

    raw_value=copyBitsFromByteArrayLE( byteArray, 11284, 12);
    @CAN_PrivMain::RFR_Object::RXX_Object_Obj21.PxVnce = convertRawToPhysical(raw_value, 0.1, 0.0);

    raw_value=copyBitsFromByteArrayLE( byteArray, 11520, 12);
    @CAN_PrivMain::RFR_Object::RXX_Object_Obj21.PxVxCoVnce = convertRawToPhysical(raw_value, 0.01, 0.0);

    raw_value=copyBitsFromByteArrayLE( byteArray, 11532, 12);
    @CAN_PrivMain::RFR_Object::RXX_Object_Obj21.PxVyCoVnce = convertRawToPhysical(raw_value, 0.01, 0.0);

    raw_value=copyBitsFromByteArrayLE( byteArray, 11296, 12);
    @CAN_PrivMain::RFR_Object::RXX_Object_Obj21.Py = convertRawToPhysical(raw_value, 0.0625, -128.0);

    raw_value=copyBitsFromByteArrayLE( byteArray, 11616, 12);
    @CAN_PrivMain::RFR_Object::RXX_Object_Obj21.PyAxCoVnce = convertRawToPhysical(raw_value, 0.01, 0.0);

    raw_value=copyBitsFromByteArrayLE( byteArray, 11628, 12);
    @CAN_PrivMain::RFR_Object::RXX_Object_Obj21.PyAyCoVnce = convertRawToPhysical(raw_value, 0.01, 0.0);

    raw_value=copyBitsFromByteArrayLE( byteArray, 11308, 12);
    @CAN_PrivMain::RFR_Object::RXX_Object_Obj21.PyVnce = convertRawToPhysical(raw_value, 0.1, 0.0);

    raw_value=copyBitsFromByteArrayLE( byteArray, 11552, 12);
    @CAN_PrivMain::RFR_Object::RXX_Object_Obj21.PyVxCoVnce = convertRawToPhysical(raw_value, 0.01, 0.0);

    raw_value=copyBitsFromByteArrayLE( byteArray, 11564, 12);
    @CAN_PrivMain::RFR_Object::RXX_Object_Obj21.PyVyCoVnce = convertRawToPhysical(raw_value, 0.01, 0.0);

    raw_value=copyBitsFromByteArrayLE( byteArray, 11404, 10);
    @CAN_PrivMain::RFR_Object::RXX_Object_Obj21.RCS = convertRawToPhysical(raw_value, 0.2, -102.4);

    raw_value=copyBitsFromByteArrayLE( byteArray, 11576, 4);
    @CAN_PrivMain::RFR_Object::RXX_Object_Obj21.ReferencePoint = convertRawToPhysical(raw_value, 1.0, 0.0);

    raw_value=copyBitsFromByteArrayLE( byteArray, 11436, 12);
    @CAN_PrivMain::RFR_Object::RXX_Object_Obj21.Vx = convertRawToPhysical(raw_value, 0.0625, -128.0);

    raw_value=copyBitsFromByteArrayLE( byteArray, 11660, 12);
    @CAN_PrivMain::RFR_Object::RXX_Object_Obj21.VxAxCoVnce = convertRawToPhysical(raw_value, 0.01, 0.0);

    raw_value=copyBitsFromByteArrayLE( byteArray, 11680, 12);
    @CAN_PrivMain::RFR_Object::RXX_Object_Obj21.VxAyCoVnce = convertRawToPhysical(raw_value, 0.01, 0.0);

    raw_value=copyBitsFromByteArrayLE( byteArray, 11456, 12);
    @CAN_PrivMain::RFR_Object::RXX_Object_Obj21.VxVnce = convertRawToPhysical(raw_value, 0.01, 0.0);

    raw_value=copyBitsFromByteArrayLE( byteArray, 11648, 12);
    @CAN_PrivMain::RFR_Object::RXX_Object_Obj21.VxVyCoVnce = convertRawToPhysical(raw_value, 0.01, 0.0);

    raw_value=copyBitsFromByteArrayLE( byteArray, 11470, 10);
    @CAN_PrivMain::RFR_Object::RXX_Object_Obj21.Vy = convertRawToPhysical(raw_value, 0.125, -64.0);

    raw_value=copyBitsFromByteArrayLE( byteArray, 11692, 12);
    @CAN_PrivMain::RFR_Object::RXX_Object_Obj21.VyAxCoVnce = convertRawToPhysical(raw_value, 0.01, 0.0);

    raw_value=copyBitsFromByteArrayLE( byteArray, 11712, 12);
    @CAN_PrivMain::RFR_Object::RXX_Object_Obj21.VyAyCoVnce = convertRawToPhysical(raw_value, 0.01, 0.0);

    raw_value=copyBitsFromByteArrayLE( byteArray, 11488, 12);
    @CAN_PrivMain::RFR_Object::RXX_Object_Obj21.VyVnce = convertRawToPhysical(raw_value, 0.01, 0.0);

    raw_value=copyBitsFromByteArrayLE( byteArray, 11384, 7);
    @CAN_PrivMain::RFR_Object::RXX_Object_Obj21.Width = convertRawToPhysical(raw_value, 0.125, 0.0);

    raw_value=copyBitsFromByteArrayLE( byteArray, 11392, 12);
    @CAN_PrivMain::RFR_Object::RXX_Object_Obj21.WidthVnce = convertRawToPhysical(raw_value, 0.01, 0.0);
}


void CRadarFR_RXX_Object_Obj22_SetDataReceived(byte byteArray[])
{
    qword raw_value;

    raw_value=copyBitsFromByteArrayLE( byteArray, 12256, 32);
    @CAN_PrivMain::RFR_Object::RXX_Object_Obj22.Age = convertRawToPhysical(raw_value, 1.0, 0.0);

    raw_value=copyBitsFromByteArrayLE( byteArray, 11852, 10);
    @CAN_PrivMain::RFR_Object::RXX_Object_Obj22.Ax = convertRawToPhysical(raw_value, 0.03125, -16.0);

    raw_value=copyBitsFromByteArrayLE( byteArray, 12236, 12);
    @CAN_PrivMain::RFR_Object::RXX_Object_Obj22.AxAyCoVnce = convertRawToPhysical(raw_value, 0.01, 0.0);

    raw_value=copyBitsFromByteArrayLE( byteArray, 11872, 12);
    @CAN_PrivMain::RFR_Object::RXX_Object_Obj22.AxVnce = convertRawToPhysical(raw_value, 0.01, 0.0);

    raw_value=copyBitsFromByteArrayLE( byteArray, 11926, 9);
    @CAN_PrivMain::RFR_Object::RXX_Object_Obj22.Ay = convertRawToPhysical(raw_value, 0.0625, -16.0);

    raw_value=copyBitsFromByteArrayLE( byteArray, 11936, 12);
    @CAN_PrivMain::RFR_Object::RXX_Object_Obj22.AyVnce = convertRawToPhysical(raw_value, 0.01, 0.0);

    raw_value=copyBitsFromByteArrayLE( byteArray, 11992, 6);
    @CAN_PrivMain::RFR_Object::RXX_Object_Obj22.ExistProb = convertRawToPhysical(raw_value, 2.0, 0.0);

    raw_value=copyBitsFromByteArrayLE( byteArray, 12056, 8);
    @CAN_PrivMain::RFR_Object::RXX_Object_Obj22.FilterInformation = convertRawToPhysical(raw_value, 1.0, 0.0);

    raw_value=copyBitsFromByteArrayLE( byteArray, 11832, 7);
    @CAN_PrivMain::RFR_Object::RXX_Object_Obj22.Length = convertRawToPhysical(raw_value, 0.125, 0.0);

    raw_value=copyBitsFromByteArrayLE( byteArray, 11840, 12);
    @CAN_PrivMain::RFR_Object::RXX_Object_Obj22.LengthVnce = convertRawToPhysical(raw_value, 0.01, 0.0);

    raw_value=copyBitsFromByteArrayLE( byteArray, 12024, 3);
    @CAN_PrivMain::RFR_Object::RXX_Object_Obj22.MeasurementStatus = convertRawToPhysical(raw_value, 1.0, 0.0);

    raw_value=copyBitsFromByteArrayLE( byteArray, 11980, 2);
    @CAN_PrivMain::RFR_Object::RXX_Object_Obj22.MovingStatus = convertRawToPhysical(raw_value, 1.0, 0.0);

    raw_value=copyBitsFromByteArrayLE( byteArray, 11960, 7);
    @CAN_PrivMain::RFR_Object::RXX_Object_Obj22.ObjId = convertRawToPhysical(raw_value, 1.0, 0.0);

    raw_value=copyBitsFromByteArrayLE( byteArray, 11862, 9);
    @CAN_PrivMain::RFR_Object::RXX_Object_Obj22.OrientationYaw = convertRawToPhysical(raw_value, 0.0175, -4.48);

    raw_value=copyBitsFromByteArrayLE( byteArray, 11884, 12);
    @CAN_PrivMain::RFR_Object::RXX_Object_Obj22.OrientationYawVnce = convertRawToPhysical(raw_value, 0.0003, 0.0);

    raw_value=copyBitsFromByteArrayLE( byteArray, 11776, 6);
    @CAN_PrivMain::RFR_Object::RXX_Object_Obj22.ProbClassConfidence = convertRawToPhysical(raw_value, 2.0, 0.0);

    raw_value=copyBitsFromByteArrayLE( byteArray, 12027, 4);
    @CAN_PrivMain::RFR_Object::RXX_Object_Obj22.ProbClassType = convertRawToPhysical(raw_value, 1.0, 0.0);

    raw_value=copyBitsFromByteArrayLE( byteArray, 11782, 14);
    @CAN_PrivMain::RFR_Object::RXX_Object_Obj22.Px = convertRawToPhysical(raw_value, 0.0625, -512.0);

    raw_value=copyBitsFromByteArrayLE( byteArray, 12096, 12);
    @CAN_PrivMain::RFR_Object::RXX_Object_Obj22.PxAxCoVnce = convertRawToPhysical(raw_value, 0.01, 0.0);

    raw_value=copyBitsFromByteArrayLE( byteArray, 12108, 12);
    @CAN_PrivMain::RFR_Object::RXX_Object_Obj22.PxAyCoVnce = convertRawToPhysical(raw_value, 0.01, 0.0);

    raw_value=copyBitsFromByteArrayLE( byteArray, 12012, 12);
    @CAN_PrivMain::RFR_Object::RXX_Object_Obj22.PxPyCoVnce = convertRawToPhysical(raw_value, 0.01, 0.0);

    raw_value=copyBitsFromByteArrayLE( byteArray, 11796, 12);
    @CAN_PrivMain::RFR_Object::RXX_Object_Obj22.PxVnce = convertRawToPhysical(raw_value, 0.1, 0.0);

    raw_value=copyBitsFromByteArrayLE( byteArray, 12032, 12);
    @CAN_PrivMain::RFR_Object::RXX_Object_Obj22.PxVxCoVnce = convertRawToPhysical(raw_value, 0.01, 0.0);

    raw_value=copyBitsFromByteArrayLE( byteArray, 12044, 12);
    @CAN_PrivMain::RFR_Object::RXX_Object_Obj22.PxVyCoVnce = convertRawToPhysical(raw_value, 0.01, 0.0);

    raw_value=copyBitsFromByteArrayLE( byteArray, 11808, 12);
    @CAN_PrivMain::RFR_Object::RXX_Object_Obj22.Py = convertRawToPhysical(raw_value, 0.0625, -128.0);

    raw_value=copyBitsFromByteArrayLE( byteArray, 12128, 12);
    @CAN_PrivMain::RFR_Object::RXX_Object_Obj22.PyAxCoVnce = convertRawToPhysical(raw_value, 0.01, 0.0);

    raw_value=copyBitsFromByteArrayLE( byteArray, 12140, 12);
    @CAN_PrivMain::RFR_Object::RXX_Object_Obj22.PyAyCoVnce = convertRawToPhysical(raw_value, 0.01, 0.0);

    raw_value=copyBitsFromByteArrayLE( byteArray, 11820, 12);
    @CAN_PrivMain::RFR_Object::RXX_Object_Obj22.PyVnce = convertRawToPhysical(raw_value, 0.1, 0.0);

    raw_value=copyBitsFromByteArrayLE( byteArray, 12064, 12);
    @CAN_PrivMain::RFR_Object::RXX_Object_Obj22.PyVxCoVnce = convertRawToPhysical(raw_value, 0.01, 0.0);

    raw_value=copyBitsFromByteArrayLE( byteArray, 12076, 12);
    @CAN_PrivMain::RFR_Object::RXX_Object_Obj22.PyVyCoVnce = convertRawToPhysical(raw_value, 0.01, 0.0);

    raw_value=copyBitsFromByteArrayLE( byteArray, 11916, 10);
    @CAN_PrivMain::RFR_Object::RXX_Object_Obj22.RCS = convertRawToPhysical(raw_value, 0.2, -102.4);

    raw_value=copyBitsFromByteArrayLE( byteArray, 12088, 4);
    @CAN_PrivMain::RFR_Object::RXX_Object_Obj22.ReferencePoint = convertRawToPhysical(raw_value, 1.0, 0.0);

    raw_value=copyBitsFromByteArrayLE( byteArray, 11948, 12);
    @CAN_PrivMain::RFR_Object::RXX_Object_Obj22.Vx = convertRawToPhysical(raw_value, 0.0625, -128.0);

    raw_value=copyBitsFromByteArrayLE( byteArray, 12172, 12);
    @CAN_PrivMain::RFR_Object::RXX_Object_Obj22.VxAxCoVnce = convertRawToPhysical(raw_value, 0.01, 0.0);

    raw_value=copyBitsFromByteArrayLE( byteArray, 12192, 12);
    @CAN_PrivMain::RFR_Object::RXX_Object_Obj22.VxAyCoVnce = convertRawToPhysical(raw_value, 0.01, 0.0);

    raw_value=copyBitsFromByteArrayLE( byteArray, 11968, 12);
    @CAN_PrivMain::RFR_Object::RXX_Object_Obj22.VxVnce = convertRawToPhysical(raw_value, 0.01, 0.0);

    raw_value=copyBitsFromByteArrayLE( byteArray, 12160, 12);
    @CAN_PrivMain::RFR_Object::RXX_Object_Obj22.VxVyCoVnce = convertRawToPhysical(raw_value, 0.01, 0.0);

    raw_value=copyBitsFromByteArrayLE( byteArray, 11982, 10);
    @CAN_PrivMain::RFR_Object::RXX_Object_Obj22.Vy = convertRawToPhysical(raw_value, 0.125, -64.0);

    raw_value=copyBitsFromByteArrayLE( byteArray, 12204, 12);
    @CAN_PrivMain::RFR_Object::RXX_Object_Obj22.VyAxCoVnce = convertRawToPhysical(raw_value, 0.01, 0.0);

    raw_value=copyBitsFromByteArrayLE( byteArray, 12224, 12);
    @CAN_PrivMain::RFR_Object::RXX_Object_Obj22.VyAyCoVnce = convertRawToPhysical(raw_value, 0.01, 0.0);

    raw_value=copyBitsFromByteArrayLE( byteArray, 12000, 12);
    @CAN_PrivMain::RFR_Object::RXX_Object_Obj22.VyVnce = convertRawToPhysical(raw_value, 0.01, 0.0);

    raw_value=copyBitsFromByteArrayLE( byteArray, 11896, 7);
    @CAN_PrivMain::RFR_Object::RXX_Object_Obj22.Width = convertRawToPhysical(raw_value, 0.125, 0.0);

    raw_value=copyBitsFromByteArrayLE( byteArray, 11904, 12);
    @CAN_PrivMain::RFR_Object::RXX_Object_Obj22.WidthVnce = convertRawToPhysical(raw_value, 0.01, 0.0);
}


void CRadarFR_RXX_Object_Obj23_SetDataReceived(byte byteArray[])
{
    qword raw_value;

    raw_value=copyBitsFromByteArrayLE( byteArray, 12768, 32);
    @CAN_PrivMain::RFR_Object::RXX_Object_Obj23.Age = convertRawToPhysical(raw_value, 1.0, 0.0);

    raw_value=copyBitsFromByteArrayLE( byteArray, 12364, 10);
    @CAN_PrivMain::RFR_Object::RXX_Object_Obj23.Ax = convertRawToPhysical(raw_value, 0.03125, -16.0);

    raw_value=copyBitsFromByteArrayLE( byteArray, 12748, 12);
    @CAN_PrivMain::RFR_Object::RXX_Object_Obj23.AxAyCoVnce = convertRawToPhysical(raw_value, 0.01, 0.0);

    raw_value=copyBitsFromByteArrayLE( byteArray, 12384, 12);
    @CAN_PrivMain::RFR_Object::RXX_Object_Obj23.AxVnce = convertRawToPhysical(raw_value, 0.01, 0.0);

    raw_value=copyBitsFromByteArrayLE( byteArray, 12438, 9);
    @CAN_PrivMain::RFR_Object::RXX_Object_Obj23.Ay = convertRawToPhysical(raw_value, 0.0625, -16.0);

    raw_value=copyBitsFromByteArrayLE( byteArray, 12448, 12);
    @CAN_PrivMain::RFR_Object::RXX_Object_Obj23.AyVnce = convertRawToPhysical(raw_value, 0.01, 0.0);

    raw_value=copyBitsFromByteArrayLE( byteArray, 12504, 6);
    @CAN_PrivMain::RFR_Object::RXX_Object_Obj23.ExistProb = convertRawToPhysical(raw_value, 2.0, 0.0);

    raw_value=copyBitsFromByteArrayLE( byteArray, 12568, 8);
    @CAN_PrivMain::RFR_Object::RXX_Object_Obj23.FilterInformation = convertRawToPhysical(raw_value, 1.0, 0.0);

    raw_value=copyBitsFromByteArrayLE( byteArray, 12344, 7);
    @CAN_PrivMain::RFR_Object::RXX_Object_Obj23.Length = convertRawToPhysical(raw_value, 0.125, 0.0);

    raw_value=copyBitsFromByteArrayLE( byteArray, 12352, 12);
    @CAN_PrivMain::RFR_Object::RXX_Object_Obj23.LengthVnce = convertRawToPhysical(raw_value, 0.01, 0.0);

    raw_value=copyBitsFromByteArrayLE( byteArray, 12536, 3);
    @CAN_PrivMain::RFR_Object::RXX_Object_Obj23.MeasurementStatus = convertRawToPhysical(raw_value, 1.0, 0.0);

    raw_value=copyBitsFromByteArrayLE( byteArray, 12492, 2);
    @CAN_PrivMain::RFR_Object::RXX_Object_Obj23.MovingStatus = convertRawToPhysical(raw_value, 1.0, 0.0);

    raw_value=copyBitsFromByteArrayLE( byteArray, 12472, 7);
    @CAN_PrivMain::RFR_Object::RXX_Object_Obj23.ObjId = convertRawToPhysical(raw_value, 1.0, 0.0);

    raw_value=copyBitsFromByteArrayLE( byteArray, 12374, 9);
    @CAN_PrivMain::RFR_Object::RXX_Object_Obj23.OrientationYaw = convertRawToPhysical(raw_value, 0.0175, -4.48);

    raw_value=copyBitsFromByteArrayLE( byteArray, 12396, 12);
    @CAN_PrivMain::RFR_Object::RXX_Object_Obj23.OrientationYawVnce = convertRawToPhysical(raw_value, 0.0003, 0.0);

    raw_value=copyBitsFromByteArrayLE( byteArray, 12288, 6);
    @CAN_PrivMain::RFR_Object::RXX_Object_Obj23.ProbClassConfidence = convertRawToPhysical(raw_value, 2.0, 0.0);

    raw_value=copyBitsFromByteArrayLE( byteArray, 12539, 4);
    @CAN_PrivMain::RFR_Object::RXX_Object_Obj23.ProbClassType = convertRawToPhysical(raw_value, 1.0, 0.0);

    raw_value=copyBitsFromByteArrayLE( byteArray, 12294, 14);
    @CAN_PrivMain::RFR_Object::RXX_Object_Obj23.Px = convertRawToPhysical(raw_value, 0.0625, -512.0);

    raw_value=copyBitsFromByteArrayLE( byteArray, 12608, 12);
    @CAN_PrivMain::RFR_Object::RXX_Object_Obj23.PxAxCoVnce = convertRawToPhysical(raw_value, 0.01, 0.0);

    raw_value=copyBitsFromByteArrayLE( byteArray, 12620, 12);
    @CAN_PrivMain::RFR_Object::RXX_Object_Obj23.PxAyCoVnce = convertRawToPhysical(raw_value, 0.01, 0.0);

    raw_value=copyBitsFromByteArrayLE( byteArray, 12524, 12);
    @CAN_PrivMain::RFR_Object::RXX_Object_Obj23.PxPyCoVnce = convertRawToPhysical(raw_value, 0.01, 0.0);

    raw_value=copyBitsFromByteArrayLE( byteArray, 12308, 12);
    @CAN_PrivMain::RFR_Object::RXX_Object_Obj23.PxVnce = convertRawToPhysical(raw_value, 0.1, 0.0);

    raw_value=copyBitsFromByteArrayLE( byteArray, 12544, 12);
    @CAN_PrivMain::RFR_Object::RXX_Object_Obj23.PxVxCoVnce = convertRawToPhysical(raw_value, 0.01, 0.0);

    raw_value=copyBitsFromByteArrayLE( byteArray, 12556, 12);
    @CAN_PrivMain::RFR_Object::RXX_Object_Obj23.PxVyCoVnce = convertRawToPhysical(raw_value, 0.01, 0.0);

    raw_value=copyBitsFromByteArrayLE( byteArray, 12320, 12);
    @CAN_PrivMain::RFR_Object::RXX_Object_Obj23.Py = convertRawToPhysical(raw_value, 0.0625, -128.0);

    raw_value=copyBitsFromByteArrayLE( byteArray, 12640, 12);
    @CAN_PrivMain::RFR_Object::RXX_Object_Obj23.PyAxCoVnce = convertRawToPhysical(raw_value, 0.01, 0.0);

    raw_value=copyBitsFromByteArrayLE( byteArray, 12652, 12);
    @CAN_PrivMain::RFR_Object::RXX_Object_Obj23.PyAyCoVnce = convertRawToPhysical(raw_value, 0.01, 0.0);

    raw_value=copyBitsFromByteArrayLE( byteArray, 12332, 12);
    @CAN_PrivMain::RFR_Object::RXX_Object_Obj23.PyVnce = convertRawToPhysical(raw_value, 0.1, 0.0);

    raw_value=copyBitsFromByteArrayLE( byteArray, 12576, 12);
    @CAN_PrivMain::RFR_Object::RXX_Object_Obj23.PyVxCoVnce = convertRawToPhysical(raw_value, 0.01, 0.0);

    raw_value=copyBitsFromByteArrayLE( byteArray, 12588, 12);
    @CAN_PrivMain::RFR_Object::RXX_Object_Obj23.PyVyCoVnce = convertRawToPhysical(raw_value, 0.01, 0.0);

    raw_value=copyBitsFromByteArrayLE( byteArray, 12428, 10);
    @CAN_PrivMain::RFR_Object::RXX_Object_Obj23.RCS = convertRawToPhysical(raw_value, 0.2, -102.4);

    raw_value=copyBitsFromByteArrayLE( byteArray, 12600, 4);
    @CAN_PrivMain::RFR_Object::RXX_Object_Obj23.ReferencePoint = convertRawToPhysical(raw_value, 1.0, 0.0);

    raw_value=copyBitsFromByteArrayLE( byteArray, 12460, 12);
    @CAN_PrivMain::RFR_Object::RXX_Object_Obj23.Vx = convertRawToPhysical(raw_value, 0.0625, -128.0);

    raw_value=copyBitsFromByteArrayLE( byteArray, 12684, 12);
    @CAN_PrivMain::RFR_Object::RXX_Object_Obj23.VxAxCoVnce = convertRawToPhysical(raw_value, 0.01, 0.0);

    raw_value=copyBitsFromByteArrayLE( byteArray, 12704, 12);
    @CAN_PrivMain::RFR_Object::RXX_Object_Obj23.VxAyCoVnce = convertRawToPhysical(raw_value, 0.01, 0.0);

    raw_value=copyBitsFromByteArrayLE( byteArray, 12480, 12);
    @CAN_PrivMain::RFR_Object::RXX_Object_Obj23.VxVnce = convertRawToPhysical(raw_value, 0.01, 0.0);

    raw_value=copyBitsFromByteArrayLE( byteArray, 12672, 12);
    @CAN_PrivMain::RFR_Object::RXX_Object_Obj23.VxVyCoVnce = convertRawToPhysical(raw_value, 0.01, 0.0);

    raw_value=copyBitsFromByteArrayLE( byteArray, 12494, 10);
    @CAN_PrivMain::RFR_Object::RXX_Object_Obj23.Vy = convertRawToPhysical(raw_value, 0.125, -64.0);

    raw_value=copyBitsFromByteArrayLE( byteArray, 12716, 12);
    @CAN_PrivMain::RFR_Object::RXX_Object_Obj23.VyAxCoVnce = convertRawToPhysical(raw_value, 0.01, 0.0);

    raw_value=copyBitsFromByteArrayLE( byteArray, 12736, 12);
    @CAN_PrivMain::RFR_Object::RXX_Object_Obj23.VyAyCoVnce = convertRawToPhysical(raw_value, 0.01, 0.0);

    raw_value=copyBitsFromByteArrayLE( byteArray, 12512, 12);
    @CAN_PrivMain::RFR_Object::RXX_Object_Obj23.VyVnce = convertRawToPhysical(raw_value, 0.01, 0.0);

    raw_value=copyBitsFromByteArrayLE( byteArray, 12408, 7);
    @CAN_PrivMain::RFR_Object::RXX_Object_Obj23.Width = convertRawToPhysical(raw_value, 0.125, 0.0);

    raw_value=copyBitsFromByteArrayLE( byteArray, 12416, 12);
    @CAN_PrivMain::RFR_Object::RXX_Object_Obj23.WidthVnce = convertRawToPhysical(raw_value, 0.01, 0.0);
}


void CRadarFR_RXX_Object_Obj24_SetDataReceived(byte byteArray[])
{
    qword raw_value;

    raw_value=copyBitsFromByteArrayLE( byteArray, 13280, 32);
    @CAN_PrivMain::RFR_Object::RXX_Object_Obj24.Age = convertRawToPhysical(raw_value, 1.0, 0.0);

    raw_value=copyBitsFromByteArrayLE( byteArray, 12876, 10);
    @CAN_PrivMain::RFR_Object::RXX_Object_Obj24.Ax = convertRawToPhysical(raw_value, 0.03125, -16.0);

    raw_value=copyBitsFromByteArrayLE( byteArray, 13260, 12);
    @CAN_PrivMain::RFR_Object::RXX_Object_Obj24.AxAyCoVnce = convertRawToPhysical(raw_value, 0.01, 0.0);

    raw_value=copyBitsFromByteArrayLE( byteArray, 12896, 12);
    @CAN_PrivMain::RFR_Object::RXX_Object_Obj24.AxVnce = convertRawToPhysical(raw_value, 0.01, 0.0);

    raw_value=copyBitsFromByteArrayLE( byteArray, 12950, 9);
    @CAN_PrivMain::RFR_Object::RXX_Object_Obj24.Ay = convertRawToPhysical(raw_value, 0.0625, -16.0);

    raw_value=copyBitsFromByteArrayLE( byteArray, 12960, 12);
    @CAN_PrivMain::RFR_Object::RXX_Object_Obj24.AyVnce = convertRawToPhysical(raw_value, 0.01, 0.0);

    raw_value=copyBitsFromByteArrayLE( byteArray, 13016, 6);
    @CAN_PrivMain::RFR_Object::RXX_Object_Obj24.ExistProb = convertRawToPhysical(raw_value, 2.0, 0.0);

    raw_value=copyBitsFromByteArrayLE( byteArray, 13080, 8);
    @CAN_PrivMain::RFR_Object::RXX_Object_Obj24.FilterInformation = convertRawToPhysical(raw_value, 1.0, 0.0);

    raw_value=copyBitsFromByteArrayLE( byteArray, 12856, 7);
    @CAN_PrivMain::RFR_Object::RXX_Object_Obj24.Length = convertRawToPhysical(raw_value, 0.125, 0.0);

    raw_value=copyBitsFromByteArrayLE( byteArray, 12864, 12);
    @CAN_PrivMain::RFR_Object::RXX_Object_Obj24.LengthVnce = convertRawToPhysical(raw_value, 0.01, 0.0);

    raw_value=copyBitsFromByteArrayLE( byteArray, 13048, 3);
    @CAN_PrivMain::RFR_Object::RXX_Object_Obj24.MeasurementStatus = convertRawToPhysical(raw_value, 1.0, 0.0);

    raw_value=copyBitsFromByteArrayLE( byteArray, 13004, 2);
    @CAN_PrivMain::RFR_Object::RXX_Object_Obj24.MovingStatus = convertRawToPhysical(raw_value, 1.0, 0.0);

    raw_value=copyBitsFromByteArrayLE( byteArray, 12984, 7);
    @CAN_PrivMain::RFR_Object::RXX_Object_Obj24.ObjId = convertRawToPhysical(raw_value, 1.0, 0.0);

    raw_value=copyBitsFromByteArrayLE( byteArray, 12886, 9);
    @CAN_PrivMain::RFR_Object::RXX_Object_Obj24.OrientationYaw = convertRawToPhysical(raw_value, 0.0175, -4.48);

    raw_value=copyBitsFromByteArrayLE( byteArray, 12908, 12);
    @CAN_PrivMain::RFR_Object::RXX_Object_Obj24.OrientationYawVnce = convertRawToPhysical(raw_value, 0.0003, 0.0);

    raw_value=copyBitsFromByteArrayLE( byteArray, 12800, 6);
    @CAN_PrivMain::RFR_Object::RXX_Object_Obj24.ProbClassConfidence = convertRawToPhysical(raw_value, 2.0, 0.0);

    raw_value=copyBitsFromByteArrayLE( byteArray, 13051, 4);
    @CAN_PrivMain::RFR_Object::RXX_Object_Obj24.ProbClassType = convertRawToPhysical(raw_value, 1.0, 0.0);

    raw_value=copyBitsFromByteArrayLE( byteArray, 12806, 14);
    @CAN_PrivMain::RFR_Object::RXX_Object_Obj24.Px = convertRawToPhysical(raw_value, 0.0625, -512.0);

    raw_value=copyBitsFromByteArrayLE( byteArray, 13120, 12);
    @CAN_PrivMain::RFR_Object::RXX_Object_Obj24.PxAxCoVnce = convertRawToPhysical(raw_value, 0.01, 0.0);

    raw_value=copyBitsFromByteArrayLE( byteArray, 13132, 12);
    @CAN_PrivMain::RFR_Object::RXX_Object_Obj24.PxAyCoVnce = convertRawToPhysical(raw_value, 0.01, 0.0);

    raw_value=copyBitsFromByteArrayLE( byteArray, 13036, 12);
    @CAN_PrivMain::RFR_Object::RXX_Object_Obj24.PxPyCoVnce = convertRawToPhysical(raw_value, 0.01, 0.0);

    raw_value=copyBitsFromByteArrayLE( byteArray, 12820, 12);
    @CAN_PrivMain::RFR_Object::RXX_Object_Obj24.PxVnce = convertRawToPhysical(raw_value, 0.1, 0.0);

    raw_value=copyBitsFromByteArrayLE( byteArray, 13056, 12);
    @CAN_PrivMain::RFR_Object::RXX_Object_Obj24.PxVxCoVnce = convertRawToPhysical(raw_value, 0.01, 0.0);

    raw_value=copyBitsFromByteArrayLE( byteArray, 13068, 12);
    @CAN_PrivMain::RFR_Object::RXX_Object_Obj24.PxVyCoVnce = convertRawToPhysical(raw_value, 0.01, 0.0);

    raw_value=copyBitsFromByteArrayLE( byteArray, 12832, 12);
    @CAN_PrivMain::RFR_Object::RXX_Object_Obj24.Py = convertRawToPhysical(raw_value, 0.0625, -128.0);

    raw_value=copyBitsFromByteArrayLE( byteArray, 13152, 12);
    @CAN_PrivMain::RFR_Object::RXX_Object_Obj24.PyAxCoVnce = convertRawToPhysical(raw_value, 0.01, 0.0);

    raw_value=copyBitsFromByteArrayLE( byteArray, 13164, 12);
    @CAN_PrivMain::RFR_Object::RXX_Object_Obj24.PyAyCoVnce = convertRawToPhysical(raw_value, 0.01, 0.0);

    raw_value=copyBitsFromByteArrayLE( byteArray, 12844, 12);
    @CAN_PrivMain::RFR_Object::RXX_Object_Obj24.PyVnce = convertRawToPhysical(raw_value, 0.1, 0.0);

    raw_value=copyBitsFromByteArrayLE( byteArray, 13088, 12);
    @CAN_PrivMain::RFR_Object::RXX_Object_Obj24.PyVxCoVnce = convertRawToPhysical(raw_value, 0.01, 0.0);

    raw_value=copyBitsFromByteArrayLE( byteArray, 13100, 12);
    @CAN_PrivMain::RFR_Object::RXX_Object_Obj24.PyVyCoVnce = convertRawToPhysical(raw_value, 0.01, 0.0);

    raw_value=copyBitsFromByteArrayLE( byteArray, 12940, 10);
    @CAN_PrivMain::RFR_Object::RXX_Object_Obj24.RCS = convertRawToPhysical(raw_value, 0.2, -102.4);

    raw_value=copyBitsFromByteArrayLE( byteArray, 13112, 4);
    @CAN_PrivMain::RFR_Object::RXX_Object_Obj24.ReferencePoint = convertRawToPhysical(raw_value, 1.0, 0.0);

    raw_value=copyBitsFromByteArrayLE( byteArray, 12972, 12);
    @CAN_PrivMain::RFR_Object::RXX_Object_Obj24.Vx = convertRawToPhysical(raw_value, 0.0625, -128.0);

    raw_value=copyBitsFromByteArrayLE( byteArray, 13196, 12);
    @CAN_PrivMain::RFR_Object::RXX_Object_Obj24.VxAxCoVnce = convertRawToPhysical(raw_value, 0.01, 0.0);

    raw_value=copyBitsFromByteArrayLE( byteArray, 13216, 12);
    @CAN_PrivMain::RFR_Object::RXX_Object_Obj24.VxAyCoVnce = convertRawToPhysical(raw_value, 0.01, 0.0);

    raw_value=copyBitsFromByteArrayLE( byteArray, 12992, 12);
    @CAN_PrivMain::RFR_Object::RXX_Object_Obj24.VxVnce = convertRawToPhysical(raw_value, 0.01, 0.0);

    raw_value=copyBitsFromByteArrayLE( byteArray, 13184, 12);
    @CAN_PrivMain::RFR_Object::RXX_Object_Obj24.VxVyCoVnce = convertRawToPhysical(raw_value, 0.01, 0.0);

    raw_value=copyBitsFromByteArrayLE( byteArray, 13006, 10);
    @CAN_PrivMain::RFR_Object::RXX_Object_Obj24.Vy = convertRawToPhysical(raw_value, 0.125, -64.0);

    raw_value=copyBitsFromByteArrayLE( byteArray, 13228, 12);
    @CAN_PrivMain::RFR_Object::RXX_Object_Obj24.VyAxCoVnce = convertRawToPhysical(raw_value, 0.01, 0.0);

    raw_value=copyBitsFromByteArrayLE( byteArray, 13248, 12);
    @CAN_PrivMain::RFR_Object::RXX_Object_Obj24.VyAyCoVnce = convertRawToPhysical(raw_value, 0.01, 0.0);

    raw_value=copyBitsFromByteArrayLE( byteArray, 13024, 12);
    @CAN_PrivMain::RFR_Object::RXX_Object_Obj24.VyVnce = convertRawToPhysical(raw_value, 0.01, 0.0);

    raw_value=copyBitsFromByteArrayLE( byteArray, 12920, 7);
    @CAN_PrivMain::RFR_Object::RXX_Object_Obj24.Width = convertRawToPhysical(raw_value, 0.125, 0.0);

    raw_value=copyBitsFromByteArrayLE( byteArray, 12928, 12);
    @CAN_PrivMain::RFR_Object::RXX_Object_Obj24.WidthVnce = convertRawToPhysical(raw_value, 0.01, 0.0);
}


void CRadarFR_RXX_Object_Obj25_SetDataReceived(byte byteArray[])
{
    qword raw_value;

    raw_value=copyBitsFromByteArrayLE( byteArray, 13792, 32);
    @CAN_PrivMain::RFR_Object::RXX_Object_Obj25.Age = convertRawToPhysical(raw_value, 1.0, 0.0);

    raw_value=copyBitsFromByteArrayLE( byteArray, 13388, 10);
    @CAN_PrivMain::RFR_Object::RXX_Object_Obj25.Ax = convertRawToPhysical(raw_value, 0.03125, -16.0);

    raw_value=copyBitsFromByteArrayLE( byteArray, 13772, 12);
    @CAN_PrivMain::RFR_Object::RXX_Object_Obj25.AxAyCoVnce = convertRawToPhysical(raw_value, 0.01, 0.0);

    raw_value=copyBitsFromByteArrayLE( byteArray, 13408, 12);
    @CAN_PrivMain::RFR_Object::RXX_Object_Obj25.AxVnce = convertRawToPhysical(raw_value, 0.01, 0.0);

    raw_value=copyBitsFromByteArrayLE( byteArray, 13462, 9);
    @CAN_PrivMain::RFR_Object::RXX_Object_Obj25.Ay = convertRawToPhysical(raw_value, 0.0625, -16.0);

    raw_value=copyBitsFromByteArrayLE( byteArray, 13472, 12);
    @CAN_PrivMain::RFR_Object::RXX_Object_Obj25.AyVnce = convertRawToPhysical(raw_value, 0.01, 0.0);

    raw_value=copyBitsFromByteArrayLE( byteArray, 13528, 6);
    @CAN_PrivMain::RFR_Object::RXX_Object_Obj25.ExistProb = convertRawToPhysical(raw_value, 2.0, 0.0);

    raw_value=copyBitsFromByteArrayLE( byteArray, 13592, 8);
    @CAN_PrivMain::RFR_Object::RXX_Object_Obj25.FilterInformation = convertRawToPhysical(raw_value, 1.0, 0.0);

    raw_value=copyBitsFromByteArrayLE( byteArray, 13368, 7);
    @CAN_PrivMain::RFR_Object::RXX_Object_Obj25.Length = convertRawToPhysical(raw_value, 0.125, 0.0);

    raw_value=copyBitsFromByteArrayLE( byteArray, 13376, 12);
    @CAN_PrivMain::RFR_Object::RXX_Object_Obj25.LengthVnce = convertRawToPhysical(raw_value, 0.01, 0.0);

    raw_value=copyBitsFromByteArrayLE( byteArray, 13560, 3);
    @CAN_PrivMain::RFR_Object::RXX_Object_Obj25.MeasurementStatus = convertRawToPhysical(raw_value, 1.0, 0.0);

    raw_value=copyBitsFromByteArrayLE( byteArray, 13516, 2);
    @CAN_PrivMain::RFR_Object::RXX_Object_Obj25.MovingStatus = convertRawToPhysical(raw_value, 1.0, 0.0);

    raw_value=copyBitsFromByteArrayLE( byteArray, 13496, 7);
    @CAN_PrivMain::RFR_Object::RXX_Object_Obj25.ObjId = convertRawToPhysical(raw_value, 1.0, 0.0);

    raw_value=copyBitsFromByteArrayLE( byteArray, 13398, 9);
    @CAN_PrivMain::RFR_Object::RXX_Object_Obj25.OrientationYaw = convertRawToPhysical(raw_value, 0.0175, -4.48);

    raw_value=copyBitsFromByteArrayLE( byteArray, 13420, 12);
    @CAN_PrivMain::RFR_Object::RXX_Object_Obj25.OrientationYawVnce = convertRawToPhysical(raw_value, 0.0003, 0.0);

    raw_value=copyBitsFromByteArrayLE( byteArray, 13312, 6);
    @CAN_PrivMain::RFR_Object::RXX_Object_Obj25.ProbClassConfidence = convertRawToPhysical(raw_value, 2.0, 0.0);

    raw_value=copyBitsFromByteArrayLE( byteArray, 13563, 4);
    @CAN_PrivMain::RFR_Object::RXX_Object_Obj25.ProbClassType = convertRawToPhysical(raw_value, 1.0, 0.0);

    raw_value=copyBitsFromByteArrayLE( byteArray, 13318, 14);
    @CAN_PrivMain::RFR_Object::RXX_Object_Obj25.Px = convertRawToPhysical(raw_value, 0.0625, -512.0);

    raw_value=copyBitsFromByteArrayLE( byteArray, 13632, 12);
    @CAN_PrivMain::RFR_Object::RXX_Object_Obj25.PxAxCoVnce = convertRawToPhysical(raw_value, 0.01, 0.0);

    raw_value=copyBitsFromByteArrayLE( byteArray, 13644, 12);
    @CAN_PrivMain::RFR_Object::RXX_Object_Obj25.PxAyCoVnce = convertRawToPhysical(raw_value, 0.01, 0.0);

    raw_value=copyBitsFromByteArrayLE( byteArray, 13548, 12);
    @CAN_PrivMain::RFR_Object::RXX_Object_Obj25.PxPyCoVnce = convertRawToPhysical(raw_value, 0.01, 0.0);

    raw_value=copyBitsFromByteArrayLE( byteArray, 13332, 12);
    @CAN_PrivMain::RFR_Object::RXX_Object_Obj25.PxVnce = convertRawToPhysical(raw_value, 0.1, 0.0);

    raw_value=copyBitsFromByteArrayLE( byteArray, 13568, 12);
    @CAN_PrivMain::RFR_Object::RXX_Object_Obj25.PxVxCoVnce = convertRawToPhysical(raw_value, 0.01, 0.0);

    raw_value=copyBitsFromByteArrayLE( byteArray, 13580, 12);
    @CAN_PrivMain::RFR_Object::RXX_Object_Obj25.PxVyCoVnce = convertRawToPhysical(raw_value, 0.01, 0.0);

    raw_value=copyBitsFromByteArrayLE( byteArray, 13344, 12);
    @CAN_PrivMain::RFR_Object::RXX_Object_Obj25.Py = convertRawToPhysical(raw_value, 0.0625, -128.0);

    raw_value=copyBitsFromByteArrayLE( byteArray, 13664, 12);
    @CAN_PrivMain::RFR_Object::RXX_Object_Obj25.PyAxCoVnce = convertRawToPhysical(raw_value, 0.01, 0.0);

    raw_value=copyBitsFromByteArrayLE( byteArray, 13676, 12);
    @CAN_PrivMain::RFR_Object::RXX_Object_Obj25.PyAyCoVnce = convertRawToPhysical(raw_value, 0.01, 0.0);

    raw_value=copyBitsFromByteArrayLE( byteArray, 13356, 12);
    @CAN_PrivMain::RFR_Object::RXX_Object_Obj25.PyVnce = convertRawToPhysical(raw_value, 0.1, 0.0);

    raw_value=copyBitsFromByteArrayLE( byteArray, 13600, 12);
    @CAN_PrivMain::RFR_Object::RXX_Object_Obj25.PyVxCoVnce = convertRawToPhysical(raw_value, 0.01, 0.0);

    raw_value=copyBitsFromByteArrayLE( byteArray, 13612, 12);
    @CAN_PrivMain::RFR_Object::RXX_Object_Obj25.PyVyCoVnce = convertRawToPhysical(raw_value, 0.01, 0.0);

    raw_value=copyBitsFromByteArrayLE( byteArray, 13452, 10);
    @CAN_PrivMain::RFR_Object::RXX_Object_Obj25.RCS = convertRawToPhysical(raw_value, 0.2, -102.4);

    raw_value=copyBitsFromByteArrayLE( byteArray, 13624, 4);
    @CAN_PrivMain::RFR_Object::RXX_Object_Obj25.ReferencePoint = convertRawToPhysical(raw_value, 1.0, 0.0);

    raw_value=copyBitsFromByteArrayLE( byteArray, 13484, 12);
    @CAN_PrivMain::RFR_Object::RXX_Object_Obj25.Vx = convertRawToPhysical(raw_value, 0.0625, -128.0);

    raw_value=copyBitsFromByteArrayLE( byteArray, 13708, 12);
    @CAN_PrivMain::RFR_Object::RXX_Object_Obj25.VxAxCoVnce = convertRawToPhysical(raw_value, 0.01, 0.0);

    raw_value=copyBitsFromByteArrayLE( byteArray, 13728, 12);
    @CAN_PrivMain::RFR_Object::RXX_Object_Obj25.VxAyCoVnce = convertRawToPhysical(raw_value, 0.01, 0.0);

    raw_value=copyBitsFromByteArrayLE( byteArray, 13504, 12);
    @CAN_PrivMain::RFR_Object::RXX_Object_Obj25.VxVnce = convertRawToPhysical(raw_value, 0.01, 0.0);

    raw_value=copyBitsFromByteArrayLE( byteArray, 13696, 12);
    @CAN_PrivMain::RFR_Object::RXX_Object_Obj25.VxVyCoVnce = convertRawToPhysical(raw_value, 0.01, 0.0);

    raw_value=copyBitsFromByteArrayLE( byteArray, 13518, 10);
    @CAN_PrivMain::RFR_Object::RXX_Object_Obj25.Vy = convertRawToPhysical(raw_value, 0.125, -64.0);

    raw_value=copyBitsFromByteArrayLE( byteArray, 13740, 12);
    @CAN_PrivMain::RFR_Object::RXX_Object_Obj25.VyAxCoVnce = convertRawToPhysical(raw_value, 0.01, 0.0);

    raw_value=copyBitsFromByteArrayLE( byteArray, 13760, 12);
    @CAN_PrivMain::RFR_Object::RXX_Object_Obj25.VyAyCoVnce = convertRawToPhysical(raw_value, 0.01, 0.0);

    raw_value=copyBitsFromByteArrayLE( byteArray, 13536, 12);
    @CAN_PrivMain::RFR_Object::RXX_Object_Obj25.VyVnce = convertRawToPhysical(raw_value, 0.01, 0.0);

    raw_value=copyBitsFromByteArrayLE( byteArray, 13432, 7);
    @CAN_PrivMain::RFR_Object::RXX_Object_Obj25.Width = convertRawToPhysical(raw_value, 0.125, 0.0);

    raw_value=copyBitsFromByteArrayLE( byteArray, 13440, 12);
    @CAN_PrivMain::RFR_Object::RXX_Object_Obj25.WidthVnce = convertRawToPhysical(raw_value, 0.01, 0.0);
}


void CRadarFR_RXX_Object_Obj26_SetDataReceived(byte byteArray[])
{
    qword raw_value;

    raw_value=copyBitsFromByteArrayLE( byteArray, 14304, 32);
    @CAN_PrivMain::RFR_Object::RXX_Object_Obj26.Age = convertRawToPhysical(raw_value, 1.0, 0.0);

    raw_value=copyBitsFromByteArrayLE( byteArray, 13900, 10);
    @CAN_PrivMain::RFR_Object::RXX_Object_Obj26.Ax = convertRawToPhysical(raw_value, 0.03125, -16.0);

    raw_value=copyBitsFromByteArrayLE( byteArray, 14284, 12);
    @CAN_PrivMain::RFR_Object::RXX_Object_Obj26.AxAyCoVnce = convertRawToPhysical(raw_value, 0.01, 0.0);

    raw_value=copyBitsFromByteArrayLE( byteArray, 13920, 12);
    @CAN_PrivMain::RFR_Object::RXX_Object_Obj26.AxVnce = convertRawToPhysical(raw_value, 0.01, 0.0);

    raw_value=copyBitsFromByteArrayLE( byteArray, 13974, 9);
    @CAN_PrivMain::RFR_Object::RXX_Object_Obj26.Ay = convertRawToPhysical(raw_value, 0.0625, -16.0);

    raw_value=copyBitsFromByteArrayLE( byteArray, 13984, 12);
    @CAN_PrivMain::RFR_Object::RXX_Object_Obj26.AyVnce = convertRawToPhysical(raw_value, 0.01, 0.0);

    raw_value=copyBitsFromByteArrayLE( byteArray, 14040, 6);
    @CAN_PrivMain::RFR_Object::RXX_Object_Obj26.ExistProb = convertRawToPhysical(raw_value, 2.0, 0.0);

    raw_value=copyBitsFromByteArrayLE( byteArray, 14104, 8);
    @CAN_PrivMain::RFR_Object::RXX_Object_Obj26.FilterInformation = convertRawToPhysical(raw_value, 1.0, 0.0);

    raw_value=copyBitsFromByteArrayLE( byteArray, 13880, 7);
    @CAN_PrivMain::RFR_Object::RXX_Object_Obj26.Length = convertRawToPhysical(raw_value, 0.125, 0.0);

    raw_value=copyBitsFromByteArrayLE( byteArray, 13888, 12);
    @CAN_PrivMain::RFR_Object::RXX_Object_Obj26.LengthVnce = convertRawToPhysical(raw_value, 0.01, 0.0);

    raw_value=copyBitsFromByteArrayLE( byteArray, 14072, 3);
    @CAN_PrivMain::RFR_Object::RXX_Object_Obj26.MeasurementStatus = convertRawToPhysical(raw_value, 1.0, 0.0);

    raw_value=copyBitsFromByteArrayLE( byteArray, 14028, 2);
    @CAN_PrivMain::RFR_Object::RXX_Object_Obj26.MovingStatus = convertRawToPhysical(raw_value, 1.0, 0.0);

    raw_value=copyBitsFromByteArrayLE( byteArray, 14008, 7);
    @CAN_PrivMain::RFR_Object::RXX_Object_Obj26.ObjId = convertRawToPhysical(raw_value, 1.0, 0.0);

    raw_value=copyBitsFromByteArrayLE( byteArray, 13910, 9);
    @CAN_PrivMain::RFR_Object::RXX_Object_Obj26.OrientationYaw = convertRawToPhysical(raw_value, 0.0175, -4.48);

    raw_value=copyBitsFromByteArrayLE( byteArray, 13932, 12);
    @CAN_PrivMain::RFR_Object::RXX_Object_Obj26.OrientationYawVnce = convertRawToPhysical(raw_value, 0.0003, 0.0);

    raw_value=copyBitsFromByteArrayLE( byteArray, 13824, 6);
    @CAN_PrivMain::RFR_Object::RXX_Object_Obj26.ProbClassConfidence = convertRawToPhysical(raw_value, 2.0, 0.0);

    raw_value=copyBitsFromByteArrayLE( byteArray, 14075, 4);
    @CAN_PrivMain::RFR_Object::RXX_Object_Obj26.ProbClassType = convertRawToPhysical(raw_value, 1.0, 0.0);

    raw_value=copyBitsFromByteArrayLE( byteArray, 13830, 14);
    @CAN_PrivMain::RFR_Object::RXX_Object_Obj26.Px = convertRawToPhysical(raw_value, 0.0625, -512.0);

    raw_value=copyBitsFromByteArrayLE( byteArray, 14144, 12);
    @CAN_PrivMain::RFR_Object::RXX_Object_Obj26.PxAxCoVnce = convertRawToPhysical(raw_value, 0.01, 0.0);

    raw_value=copyBitsFromByteArrayLE( byteArray, 14156, 12);
    @CAN_PrivMain::RFR_Object::RXX_Object_Obj26.PxAyCoVnce = convertRawToPhysical(raw_value, 0.01, 0.0);

    raw_value=copyBitsFromByteArrayLE( byteArray, 14060, 12);
    @CAN_PrivMain::RFR_Object::RXX_Object_Obj26.PxPyCoVnce = convertRawToPhysical(raw_value, 0.01, 0.0);

    raw_value=copyBitsFromByteArrayLE( byteArray, 13844, 12);
    @CAN_PrivMain::RFR_Object::RXX_Object_Obj26.PxVnce = convertRawToPhysical(raw_value, 0.1, 0.0);

    raw_value=copyBitsFromByteArrayLE( byteArray, 14080, 12);
    @CAN_PrivMain::RFR_Object::RXX_Object_Obj26.PxVxCoVnce = convertRawToPhysical(raw_value, 0.01, 0.0);

    raw_value=copyBitsFromByteArrayLE( byteArray, 14092, 12);
    @CAN_PrivMain::RFR_Object::RXX_Object_Obj26.PxVyCoVnce = convertRawToPhysical(raw_value, 0.01, 0.0);

    raw_value=copyBitsFromByteArrayLE( byteArray, 13856, 12);
    @CAN_PrivMain::RFR_Object::RXX_Object_Obj26.Py = convertRawToPhysical(raw_value, 0.0625, -128.0);

    raw_value=copyBitsFromByteArrayLE( byteArray, 14176, 12);
    @CAN_PrivMain::RFR_Object::RXX_Object_Obj26.PyAxCoVnce = convertRawToPhysical(raw_value, 0.01, 0.0);

    raw_value=copyBitsFromByteArrayLE( byteArray, 14188, 12);
    @CAN_PrivMain::RFR_Object::RXX_Object_Obj26.PyAyCoVnce = convertRawToPhysical(raw_value, 0.01, 0.0);

    raw_value=copyBitsFromByteArrayLE( byteArray, 13868, 12);
    @CAN_PrivMain::RFR_Object::RXX_Object_Obj26.PyVnce = convertRawToPhysical(raw_value, 0.1, 0.0);

    raw_value=copyBitsFromByteArrayLE( byteArray, 14112, 12);
    @CAN_PrivMain::RFR_Object::RXX_Object_Obj26.PyVxCoVnce = convertRawToPhysical(raw_value, 0.01, 0.0);

    raw_value=copyBitsFromByteArrayLE( byteArray, 14124, 12);
    @CAN_PrivMain::RFR_Object::RXX_Object_Obj26.PyVyCoVnce = convertRawToPhysical(raw_value, 0.01, 0.0);

    raw_value=copyBitsFromByteArrayLE( byteArray, 13964, 10);
    @CAN_PrivMain::RFR_Object::RXX_Object_Obj26.RCS = convertRawToPhysical(raw_value, 0.2, -102.4);

    raw_value=copyBitsFromByteArrayLE( byteArray, 14136, 4);
    @CAN_PrivMain::RFR_Object::RXX_Object_Obj26.ReferencePoint = convertRawToPhysical(raw_value, 1.0, 0.0);

    raw_value=copyBitsFromByteArrayLE( byteArray, 13996, 12);
    @CAN_PrivMain::RFR_Object::RXX_Object_Obj26.Vx = convertRawToPhysical(raw_value, 0.0625, -128.0);

    raw_value=copyBitsFromByteArrayLE( byteArray, 14220, 12);
    @CAN_PrivMain::RFR_Object::RXX_Object_Obj26.VxAxCoVnce = convertRawToPhysical(raw_value, 0.01, 0.0);

    raw_value=copyBitsFromByteArrayLE( byteArray, 14240, 12);
    @CAN_PrivMain::RFR_Object::RXX_Object_Obj26.VxAyCoVnce = convertRawToPhysical(raw_value, 0.01, 0.0);

    raw_value=copyBitsFromByteArrayLE( byteArray, 14016, 12);
    @CAN_PrivMain::RFR_Object::RXX_Object_Obj26.VxVnce = convertRawToPhysical(raw_value, 0.01, 0.0);

    raw_value=copyBitsFromByteArrayLE( byteArray, 14208, 12);
    @CAN_PrivMain::RFR_Object::RXX_Object_Obj26.VxVyCoVnce = convertRawToPhysical(raw_value, 0.01, 0.0);

    raw_value=copyBitsFromByteArrayLE( byteArray, 14030, 10);
    @CAN_PrivMain::RFR_Object::RXX_Object_Obj26.Vy = convertRawToPhysical(raw_value, 0.125, -64.0);

    raw_value=copyBitsFromByteArrayLE( byteArray, 14252, 12);
    @CAN_PrivMain::RFR_Object::RXX_Object_Obj26.VyAxCoVnce = convertRawToPhysical(raw_value, 0.01, 0.0);

    raw_value=copyBitsFromByteArrayLE( byteArray, 14272, 12);
    @CAN_PrivMain::RFR_Object::RXX_Object_Obj26.VyAyCoVnce = convertRawToPhysical(raw_value, 0.01, 0.0);

    raw_value=copyBitsFromByteArrayLE( byteArray, 14048, 12);
    @CAN_PrivMain::RFR_Object::RXX_Object_Obj26.VyVnce = convertRawToPhysical(raw_value, 0.01, 0.0);

    raw_value=copyBitsFromByteArrayLE( byteArray, 13944, 7);
    @CAN_PrivMain::RFR_Object::RXX_Object_Obj26.Width = convertRawToPhysical(raw_value, 0.125, 0.0);

    raw_value=copyBitsFromByteArrayLE( byteArray, 13952, 12);
    @CAN_PrivMain::RFR_Object::RXX_Object_Obj26.WidthVnce = convertRawToPhysical(raw_value, 0.01, 0.0);
}


void CRadarFR_RXX_Object_Obj27_SetDataReceived(byte byteArray[])
{
    qword raw_value;

    raw_value=copyBitsFromByteArrayLE( byteArray, 14816, 32);
    @CAN_PrivMain::RFR_Object::RXX_Object_Obj27.Age = convertRawToPhysical(raw_value, 1.0, 0.0);

    raw_value=copyBitsFromByteArrayLE( byteArray, 14412, 10);
    @CAN_PrivMain::RFR_Object::RXX_Object_Obj27.Ax = convertRawToPhysical(raw_value, 0.03125, -16.0);

    raw_value=copyBitsFromByteArrayLE( byteArray, 14796, 12);
    @CAN_PrivMain::RFR_Object::RXX_Object_Obj27.AxAyCoVnce = convertRawToPhysical(raw_value, 0.01, 0.0);

    raw_value=copyBitsFromByteArrayLE( byteArray, 14432, 12);
    @CAN_PrivMain::RFR_Object::RXX_Object_Obj27.AxVnce = convertRawToPhysical(raw_value, 0.01, 0.0);

    raw_value=copyBitsFromByteArrayLE( byteArray, 14486, 9);
    @CAN_PrivMain::RFR_Object::RXX_Object_Obj27.Ay = convertRawToPhysical(raw_value, 0.0625, -16.0);

    raw_value=copyBitsFromByteArrayLE( byteArray, 14496, 12);
    @CAN_PrivMain::RFR_Object::RXX_Object_Obj27.AyVnce = convertRawToPhysical(raw_value, 0.01, 0.0);

    raw_value=copyBitsFromByteArrayLE( byteArray, 14552, 6);
    @CAN_PrivMain::RFR_Object::RXX_Object_Obj27.ExistProb = convertRawToPhysical(raw_value, 2.0, 0.0);

    raw_value=copyBitsFromByteArrayLE( byteArray, 14616, 8);
    @CAN_PrivMain::RFR_Object::RXX_Object_Obj27.FilterInformation = convertRawToPhysical(raw_value, 1.0, 0.0);

    raw_value=copyBitsFromByteArrayLE( byteArray, 14392, 7);
    @CAN_PrivMain::RFR_Object::RXX_Object_Obj27.Length = convertRawToPhysical(raw_value, 0.125, 0.0);

    raw_value=copyBitsFromByteArrayLE( byteArray, 14400, 12);
    @CAN_PrivMain::RFR_Object::RXX_Object_Obj27.LengthVnce = convertRawToPhysical(raw_value, 0.01, 0.0);

    raw_value=copyBitsFromByteArrayLE( byteArray, 14584, 3);
    @CAN_PrivMain::RFR_Object::RXX_Object_Obj27.MeasurementStatus = convertRawToPhysical(raw_value, 1.0, 0.0);

    raw_value=copyBitsFromByteArrayLE( byteArray, 14540, 2);
    @CAN_PrivMain::RFR_Object::RXX_Object_Obj27.MovingStatus = convertRawToPhysical(raw_value, 1.0, 0.0);

    raw_value=copyBitsFromByteArrayLE( byteArray, 14520, 7);
    @CAN_PrivMain::RFR_Object::RXX_Object_Obj27.ObjId = convertRawToPhysical(raw_value, 1.0, 0.0);

    raw_value=copyBitsFromByteArrayLE( byteArray, 14422, 9);
    @CAN_PrivMain::RFR_Object::RXX_Object_Obj27.OrientationYaw = convertRawToPhysical(raw_value, 0.0175, -4.48);

    raw_value=copyBitsFromByteArrayLE( byteArray, 14444, 12);
    @CAN_PrivMain::RFR_Object::RXX_Object_Obj27.OrientationYawVnce = convertRawToPhysical(raw_value, 0.0003, 0.0);

    raw_value=copyBitsFromByteArrayLE( byteArray, 14336, 6);
    @CAN_PrivMain::RFR_Object::RXX_Object_Obj27.ProbClassConfidence = convertRawToPhysical(raw_value, 2.0, 0.0);

    raw_value=copyBitsFromByteArrayLE( byteArray, 14587, 4);
    @CAN_PrivMain::RFR_Object::RXX_Object_Obj27.ProbClassType = convertRawToPhysical(raw_value, 1.0, 0.0);

    raw_value=copyBitsFromByteArrayLE( byteArray, 14342, 14);
    @CAN_PrivMain::RFR_Object::RXX_Object_Obj27.Px = convertRawToPhysical(raw_value, 0.0625, -512.0);

    raw_value=copyBitsFromByteArrayLE( byteArray, 14656, 12);
    @CAN_PrivMain::RFR_Object::RXX_Object_Obj27.PxAxCoVnce = convertRawToPhysical(raw_value, 0.01, 0.0);

    raw_value=copyBitsFromByteArrayLE( byteArray, 14668, 12);
    @CAN_PrivMain::RFR_Object::RXX_Object_Obj27.PxAyCoVnce = convertRawToPhysical(raw_value, 0.01, 0.0);

    raw_value=copyBitsFromByteArrayLE( byteArray, 14572, 12);
    @CAN_PrivMain::RFR_Object::RXX_Object_Obj27.PxPyCoVnce = convertRawToPhysical(raw_value, 0.01, 0.0);

    raw_value=copyBitsFromByteArrayLE( byteArray, 14356, 12);
    @CAN_PrivMain::RFR_Object::RXX_Object_Obj27.PxVnce = convertRawToPhysical(raw_value, 0.1, 0.0);

    raw_value=copyBitsFromByteArrayLE( byteArray, 14592, 12);
    @CAN_PrivMain::RFR_Object::RXX_Object_Obj27.PxVxCoVnce = convertRawToPhysical(raw_value, 0.01, 0.0);

    raw_value=copyBitsFromByteArrayLE( byteArray, 14604, 12);
    @CAN_PrivMain::RFR_Object::RXX_Object_Obj27.PxVyCoVnce = convertRawToPhysical(raw_value, 0.01, 0.0);

    raw_value=copyBitsFromByteArrayLE( byteArray, 14368, 12);
    @CAN_PrivMain::RFR_Object::RXX_Object_Obj27.Py = convertRawToPhysical(raw_value, 0.0625, -128.0);

    raw_value=copyBitsFromByteArrayLE( byteArray, 14688, 12);
    @CAN_PrivMain::RFR_Object::RXX_Object_Obj27.PyAxCoVnce = convertRawToPhysical(raw_value, 0.01, 0.0);

    raw_value=copyBitsFromByteArrayLE( byteArray, 14700, 12);
    @CAN_PrivMain::RFR_Object::RXX_Object_Obj27.PyAyCoVnce = convertRawToPhysical(raw_value, 0.01, 0.0);

    raw_value=copyBitsFromByteArrayLE( byteArray, 14380, 12);
    @CAN_PrivMain::RFR_Object::RXX_Object_Obj27.PyVnce = convertRawToPhysical(raw_value, 0.1, 0.0);

    raw_value=copyBitsFromByteArrayLE( byteArray, 14624, 12);
    @CAN_PrivMain::RFR_Object::RXX_Object_Obj27.PyVxCoVnce = convertRawToPhysical(raw_value, 0.01, 0.0);

    raw_value=copyBitsFromByteArrayLE( byteArray, 14636, 12);
    @CAN_PrivMain::RFR_Object::RXX_Object_Obj27.PyVyCoVnce = convertRawToPhysical(raw_value, 0.01, 0.0);

    raw_value=copyBitsFromByteArrayLE( byteArray, 14476, 10);
    @CAN_PrivMain::RFR_Object::RXX_Object_Obj27.RCS = convertRawToPhysical(raw_value, 0.2, -102.4);

    raw_value=copyBitsFromByteArrayLE( byteArray, 14648, 4);
    @CAN_PrivMain::RFR_Object::RXX_Object_Obj27.ReferencePoint = convertRawToPhysical(raw_value, 1.0, 0.0);

    raw_value=copyBitsFromByteArrayLE( byteArray, 14508, 12);
    @CAN_PrivMain::RFR_Object::RXX_Object_Obj27.Vx = convertRawToPhysical(raw_value, 0.0625, -128.0);

    raw_value=copyBitsFromByteArrayLE( byteArray, 14732, 12);
    @CAN_PrivMain::RFR_Object::RXX_Object_Obj27.VxAxCoVnce = convertRawToPhysical(raw_value, 0.01, 0.0);

    raw_value=copyBitsFromByteArrayLE( byteArray, 14752, 12);
    @CAN_PrivMain::RFR_Object::RXX_Object_Obj27.VxAyCoVnce = convertRawToPhysical(raw_value, 0.01, 0.0);

    raw_value=copyBitsFromByteArrayLE( byteArray, 14528, 12);
    @CAN_PrivMain::RFR_Object::RXX_Object_Obj27.VxVnce = convertRawToPhysical(raw_value, 0.01, 0.0);

    raw_value=copyBitsFromByteArrayLE( byteArray, 14720, 12);
    @CAN_PrivMain::RFR_Object::RXX_Object_Obj27.VxVyCoVnce = convertRawToPhysical(raw_value, 0.01, 0.0);

    raw_value=copyBitsFromByteArrayLE( byteArray, 14542, 10);
    @CAN_PrivMain::RFR_Object::RXX_Object_Obj27.Vy = convertRawToPhysical(raw_value, 0.125, -64.0);

    raw_value=copyBitsFromByteArrayLE( byteArray, 14764, 12);
    @CAN_PrivMain::RFR_Object::RXX_Object_Obj27.VyAxCoVnce = convertRawToPhysical(raw_value, 0.01, 0.0);

    raw_value=copyBitsFromByteArrayLE( byteArray, 14784, 12);
    @CAN_PrivMain::RFR_Object::RXX_Object_Obj27.VyAyCoVnce = convertRawToPhysical(raw_value, 0.01, 0.0);

    raw_value=copyBitsFromByteArrayLE( byteArray, 14560, 12);
    @CAN_PrivMain::RFR_Object::RXX_Object_Obj27.VyVnce = convertRawToPhysical(raw_value, 0.01, 0.0);

    raw_value=copyBitsFromByteArrayLE( byteArray, 14456, 7);
    @CAN_PrivMain::RFR_Object::RXX_Object_Obj27.Width = convertRawToPhysical(raw_value, 0.125, 0.0);

    raw_value=copyBitsFromByteArrayLE( byteArray, 14464, 12);
    @CAN_PrivMain::RFR_Object::RXX_Object_Obj27.WidthVnce = convertRawToPhysical(raw_value, 0.01, 0.0);
}


void CRadarFR_RXX_Object_Obj28_SetDataReceived(byte byteArray[])
{
    qword raw_value;

    raw_value=copyBitsFromByteArrayLE( byteArray, 15328, 32);
    @CAN_PrivMain::RFR_Object::RXX_Object_Obj28.Age = convertRawToPhysical(raw_value, 1.0, 0.0);

    raw_value=copyBitsFromByteArrayLE( byteArray, 14924, 10);
    @CAN_PrivMain::RFR_Object::RXX_Object_Obj28.Ax = convertRawToPhysical(raw_value, 0.03125, -16.0);

    raw_value=copyBitsFromByteArrayLE( byteArray, 15308, 12);
    @CAN_PrivMain::RFR_Object::RXX_Object_Obj28.AxAyCoVnce = convertRawToPhysical(raw_value, 0.01, 0.0);

    raw_value=copyBitsFromByteArrayLE( byteArray, 14944, 12);
    @CAN_PrivMain::RFR_Object::RXX_Object_Obj28.AxVnce = convertRawToPhysical(raw_value, 0.01, 0.0);

    raw_value=copyBitsFromByteArrayLE( byteArray, 14998, 9);
    @CAN_PrivMain::RFR_Object::RXX_Object_Obj28.Ay = convertRawToPhysical(raw_value, 0.0625, -16.0);

    raw_value=copyBitsFromByteArrayLE( byteArray, 15008, 12);
    @CAN_PrivMain::RFR_Object::RXX_Object_Obj28.AyVnce = convertRawToPhysical(raw_value, 0.01, 0.0);

    raw_value=copyBitsFromByteArrayLE( byteArray, 15064, 6);
    @CAN_PrivMain::RFR_Object::RXX_Object_Obj28.ExistProb = convertRawToPhysical(raw_value, 2.0, 0.0);

    raw_value=copyBitsFromByteArrayLE( byteArray, 15128, 8);
    @CAN_PrivMain::RFR_Object::RXX_Object_Obj28.FilterInformation = convertRawToPhysical(raw_value, 1.0, 0.0);

    raw_value=copyBitsFromByteArrayLE( byteArray, 14904, 7);
    @CAN_PrivMain::RFR_Object::RXX_Object_Obj28.Length = convertRawToPhysical(raw_value, 0.125, 0.0);

    raw_value=copyBitsFromByteArrayLE( byteArray, 14912, 12);
    @CAN_PrivMain::RFR_Object::RXX_Object_Obj28.LengthVnce = convertRawToPhysical(raw_value, 0.01, 0.0);

    raw_value=copyBitsFromByteArrayLE( byteArray, 15096, 3);
    @CAN_PrivMain::RFR_Object::RXX_Object_Obj28.MeasurementStatus = convertRawToPhysical(raw_value, 1.0, 0.0);

    raw_value=copyBitsFromByteArrayLE( byteArray, 15052, 2);
    @CAN_PrivMain::RFR_Object::RXX_Object_Obj28.MovingStatus = convertRawToPhysical(raw_value, 1.0, 0.0);

    raw_value=copyBitsFromByteArrayLE( byteArray, 15032, 7);
    @CAN_PrivMain::RFR_Object::RXX_Object_Obj28.ObjId = convertRawToPhysical(raw_value, 1.0, 0.0);

    raw_value=copyBitsFromByteArrayLE( byteArray, 14934, 9);
    @CAN_PrivMain::RFR_Object::RXX_Object_Obj28.OrientationYaw = convertRawToPhysical(raw_value, 0.0175, -4.48);

    raw_value=copyBitsFromByteArrayLE( byteArray, 14956, 12);
    @CAN_PrivMain::RFR_Object::RXX_Object_Obj28.OrientationYawVnce = convertRawToPhysical(raw_value, 0.0003, 0.0);

    raw_value=copyBitsFromByteArrayLE( byteArray, 14848, 6);
    @CAN_PrivMain::RFR_Object::RXX_Object_Obj28.ProbClassConfidence = convertRawToPhysical(raw_value, 2.0, 0.0);

    raw_value=copyBitsFromByteArrayLE( byteArray, 15099, 4);
    @CAN_PrivMain::RFR_Object::RXX_Object_Obj28.ProbClassType = convertRawToPhysical(raw_value, 1.0, 0.0);

    raw_value=copyBitsFromByteArrayLE( byteArray, 14854, 14);
    @CAN_PrivMain::RFR_Object::RXX_Object_Obj28.Px = convertRawToPhysical(raw_value, 0.0625, -512.0);

    raw_value=copyBitsFromByteArrayLE( byteArray, 15168, 12);
    @CAN_PrivMain::RFR_Object::RXX_Object_Obj28.PxAxCoVnce = convertRawToPhysical(raw_value, 0.01, 0.0);

    raw_value=copyBitsFromByteArrayLE( byteArray, 15180, 12);
    @CAN_PrivMain::RFR_Object::RXX_Object_Obj28.PxAyCoVnce = convertRawToPhysical(raw_value, 0.01, 0.0);

    raw_value=copyBitsFromByteArrayLE( byteArray, 15084, 12);
    @CAN_PrivMain::RFR_Object::RXX_Object_Obj28.PxPyCoVnce = convertRawToPhysical(raw_value, 0.01, 0.0);

    raw_value=copyBitsFromByteArrayLE( byteArray, 14868, 12);
    @CAN_PrivMain::RFR_Object::RXX_Object_Obj28.PxVnce = convertRawToPhysical(raw_value, 0.1, 0.0);

    raw_value=copyBitsFromByteArrayLE( byteArray, 15104, 12);
    @CAN_PrivMain::RFR_Object::RXX_Object_Obj28.PxVxCoVnce = convertRawToPhysical(raw_value, 0.01, 0.0);

    raw_value=copyBitsFromByteArrayLE( byteArray, 15116, 12);
    @CAN_PrivMain::RFR_Object::RXX_Object_Obj28.PxVyCoVnce = convertRawToPhysical(raw_value, 0.01, 0.0);

    raw_value=copyBitsFromByteArrayLE( byteArray, 14880, 12);
    @CAN_PrivMain::RFR_Object::RXX_Object_Obj28.Py = convertRawToPhysical(raw_value, 0.0625, -128.0);

    raw_value=copyBitsFromByteArrayLE( byteArray, 15200, 12);
    @CAN_PrivMain::RFR_Object::RXX_Object_Obj28.PyAxCoVnce = convertRawToPhysical(raw_value, 0.01, 0.0);

    raw_value=copyBitsFromByteArrayLE( byteArray, 15212, 12);
    @CAN_PrivMain::RFR_Object::RXX_Object_Obj28.PyAyCoVnce = convertRawToPhysical(raw_value, 0.01, 0.0);

    raw_value=copyBitsFromByteArrayLE( byteArray, 14892, 12);
    @CAN_PrivMain::RFR_Object::RXX_Object_Obj28.PyVnce = convertRawToPhysical(raw_value, 0.1, 0.0);

    raw_value=copyBitsFromByteArrayLE( byteArray, 15136, 12);
    @CAN_PrivMain::RFR_Object::RXX_Object_Obj28.PyVxCoVnce = convertRawToPhysical(raw_value, 0.01, 0.0);

    raw_value=copyBitsFromByteArrayLE( byteArray, 15148, 12);
    @CAN_PrivMain::RFR_Object::RXX_Object_Obj28.PyVyCoVnce = convertRawToPhysical(raw_value, 0.01, 0.0);

    raw_value=copyBitsFromByteArrayLE( byteArray, 14988, 10);
    @CAN_PrivMain::RFR_Object::RXX_Object_Obj28.RCS = convertRawToPhysical(raw_value, 0.2, -102.4);

    raw_value=copyBitsFromByteArrayLE( byteArray, 15160, 4);
    @CAN_PrivMain::RFR_Object::RXX_Object_Obj28.ReferencePoint = convertRawToPhysical(raw_value, 1.0, 0.0);

    raw_value=copyBitsFromByteArrayLE( byteArray, 15020, 12);
    @CAN_PrivMain::RFR_Object::RXX_Object_Obj28.Vx = convertRawToPhysical(raw_value, 0.0625, -128.0);

    raw_value=copyBitsFromByteArrayLE( byteArray, 15244, 12);
    @CAN_PrivMain::RFR_Object::RXX_Object_Obj28.VxAxCoVnce = convertRawToPhysical(raw_value, 0.01, 0.0);

    raw_value=copyBitsFromByteArrayLE( byteArray, 15264, 12);
    @CAN_PrivMain::RFR_Object::RXX_Object_Obj28.VxAyCoVnce = convertRawToPhysical(raw_value, 0.01, 0.0);

    raw_value=copyBitsFromByteArrayLE( byteArray, 15040, 12);
    @CAN_PrivMain::RFR_Object::RXX_Object_Obj28.VxVnce = convertRawToPhysical(raw_value, 0.01, 0.0);

    raw_value=copyBitsFromByteArrayLE( byteArray, 15232, 12);
    @CAN_PrivMain::RFR_Object::RXX_Object_Obj28.VxVyCoVnce = convertRawToPhysical(raw_value, 0.01, 0.0);

    raw_value=copyBitsFromByteArrayLE( byteArray, 15054, 10);
    @CAN_PrivMain::RFR_Object::RXX_Object_Obj28.Vy = convertRawToPhysical(raw_value, 0.125, -64.0);

    raw_value=copyBitsFromByteArrayLE( byteArray, 15276, 12);
    @CAN_PrivMain::RFR_Object::RXX_Object_Obj28.VyAxCoVnce = convertRawToPhysical(raw_value, 0.01, 0.0);

    raw_value=copyBitsFromByteArrayLE( byteArray, 15296, 12);
    @CAN_PrivMain::RFR_Object::RXX_Object_Obj28.VyAyCoVnce = convertRawToPhysical(raw_value, 0.01, 0.0);

    raw_value=copyBitsFromByteArrayLE( byteArray, 15072, 12);
    @CAN_PrivMain::RFR_Object::RXX_Object_Obj28.VyVnce = convertRawToPhysical(raw_value, 0.01, 0.0);

    raw_value=copyBitsFromByteArrayLE( byteArray, 14968, 7);
    @CAN_PrivMain::RFR_Object::RXX_Object_Obj28.Width = convertRawToPhysical(raw_value, 0.125, 0.0);

    raw_value=copyBitsFromByteArrayLE( byteArray, 14976, 12);
    @CAN_PrivMain::RFR_Object::RXX_Object_Obj28.WidthVnce = convertRawToPhysical(raw_value, 0.01, 0.0);
}


void CRadarFR_RXX_Object_Obj29_SetDataReceived(byte byteArray[])
{
    qword raw_value;

    raw_value=copyBitsFromByteArrayLE( byteArray, 15840, 32);
    @CAN_PrivMain::RFR_Object::RXX_Object_Obj29.Age = convertRawToPhysical(raw_value, 1.0, 0.0);

    raw_value=copyBitsFromByteArrayLE( byteArray, 15436, 10);
    @CAN_PrivMain::RFR_Object::RXX_Object_Obj29.Ax = convertRawToPhysical(raw_value, 0.03125, -16.0);

    raw_value=copyBitsFromByteArrayLE( byteArray, 15820, 12);
    @CAN_PrivMain::RFR_Object::RXX_Object_Obj29.AxAyCoVnce = convertRawToPhysical(raw_value, 0.01, 0.0);

    raw_value=copyBitsFromByteArrayLE( byteArray, 15456, 12);
    @CAN_PrivMain::RFR_Object::RXX_Object_Obj29.AxVnce = convertRawToPhysical(raw_value, 0.01, 0.0);

    raw_value=copyBitsFromByteArrayLE( byteArray, 15510, 9);
    @CAN_PrivMain::RFR_Object::RXX_Object_Obj29.Ay = convertRawToPhysical(raw_value, 0.0625, -16.0);

    raw_value=copyBitsFromByteArrayLE( byteArray, 15520, 12);
    @CAN_PrivMain::RFR_Object::RXX_Object_Obj29.AyVnce = convertRawToPhysical(raw_value, 0.01, 0.0);

    raw_value=copyBitsFromByteArrayLE( byteArray, 15576, 6);
    @CAN_PrivMain::RFR_Object::RXX_Object_Obj29.ExistProb = convertRawToPhysical(raw_value, 2.0, 0.0);

    raw_value=copyBitsFromByteArrayLE( byteArray, 15640, 8);
    @CAN_PrivMain::RFR_Object::RXX_Object_Obj29.FilterInformation = convertRawToPhysical(raw_value, 1.0, 0.0);

    raw_value=copyBitsFromByteArrayLE( byteArray, 15416, 7);
    @CAN_PrivMain::RFR_Object::RXX_Object_Obj29.Length = convertRawToPhysical(raw_value, 0.125, 0.0);

    raw_value=copyBitsFromByteArrayLE( byteArray, 15424, 12);
    @CAN_PrivMain::RFR_Object::RXX_Object_Obj29.LengthVnce = convertRawToPhysical(raw_value, 0.01, 0.0);

    raw_value=copyBitsFromByteArrayLE( byteArray, 15608, 3);
    @CAN_PrivMain::RFR_Object::RXX_Object_Obj29.MeasurementStatus = convertRawToPhysical(raw_value, 1.0, 0.0);

    raw_value=copyBitsFromByteArrayLE( byteArray, 15564, 2);
    @CAN_PrivMain::RFR_Object::RXX_Object_Obj29.MovingStatus = convertRawToPhysical(raw_value, 1.0, 0.0);

    raw_value=copyBitsFromByteArrayLE( byteArray, 15544, 7);
    @CAN_PrivMain::RFR_Object::RXX_Object_Obj29.ObjId = convertRawToPhysical(raw_value, 1.0, 0.0);

    raw_value=copyBitsFromByteArrayLE( byteArray, 15446, 9);
    @CAN_PrivMain::RFR_Object::RXX_Object_Obj29.OrientationYaw = convertRawToPhysical(raw_value, 0.0175, -4.48);

    raw_value=copyBitsFromByteArrayLE( byteArray, 15468, 12);
    @CAN_PrivMain::RFR_Object::RXX_Object_Obj29.OrientationYawVnce = convertRawToPhysical(raw_value, 0.0003, 0.0);

    raw_value=copyBitsFromByteArrayLE( byteArray, 15360, 6);
    @CAN_PrivMain::RFR_Object::RXX_Object_Obj29.ProbClassConfidence = convertRawToPhysical(raw_value, 2.0, 0.0);

    raw_value=copyBitsFromByteArrayLE( byteArray, 15611, 4);
    @CAN_PrivMain::RFR_Object::RXX_Object_Obj29.ProbClassType = convertRawToPhysical(raw_value, 1.0, 0.0);

    raw_value=copyBitsFromByteArrayLE( byteArray, 15366, 14);
    @CAN_PrivMain::RFR_Object::RXX_Object_Obj29.Px = convertRawToPhysical(raw_value, 0.0625, -512.0);

    raw_value=copyBitsFromByteArrayLE( byteArray, 15680, 12);
    @CAN_PrivMain::RFR_Object::RXX_Object_Obj29.PxAxCoVnce = convertRawToPhysical(raw_value, 0.01, 0.0);

    raw_value=copyBitsFromByteArrayLE( byteArray, 15692, 12);
    @CAN_PrivMain::RFR_Object::RXX_Object_Obj29.PxAyCoVnce = convertRawToPhysical(raw_value, 0.01, 0.0);

    raw_value=copyBitsFromByteArrayLE( byteArray, 15596, 12);
    @CAN_PrivMain::RFR_Object::RXX_Object_Obj29.PxPyCoVnce = convertRawToPhysical(raw_value, 0.01, 0.0);

    raw_value=copyBitsFromByteArrayLE( byteArray, 15380, 12);
    @CAN_PrivMain::RFR_Object::RXX_Object_Obj29.PxVnce = convertRawToPhysical(raw_value, 0.1, 0.0);

    raw_value=copyBitsFromByteArrayLE( byteArray, 15616, 12);
    @CAN_PrivMain::RFR_Object::RXX_Object_Obj29.PxVxCoVnce = convertRawToPhysical(raw_value, 0.01, 0.0);

    raw_value=copyBitsFromByteArrayLE( byteArray, 15628, 12);
    @CAN_PrivMain::RFR_Object::RXX_Object_Obj29.PxVyCoVnce = convertRawToPhysical(raw_value, 0.01, 0.0);

    raw_value=copyBitsFromByteArrayLE( byteArray, 15392, 12);
    @CAN_PrivMain::RFR_Object::RXX_Object_Obj29.Py = convertRawToPhysical(raw_value, 0.0625, -128.0);

    raw_value=copyBitsFromByteArrayLE( byteArray, 15712, 12);
    @CAN_PrivMain::RFR_Object::RXX_Object_Obj29.PyAxCoVnce = convertRawToPhysical(raw_value, 0.01, 0.0);

    raw_value=copyBitsFromByteArrayLE( byteArray, 15724, 12);
    @CAN_PrivMain::RFR_Object::RXX_Object_Obj29.PyAyCoVnce = convertRawToPhysical(raw_value, 0.01, 0.0);

    raw_value=copyBitsFromByteArrayLE( byteArray, 15404, 12);
    @CAN_PrivMain::RFR_Object::RXX_Object_Obj29.PyVnce = convertRawToPhysical(raw_value, 0.1, 0.0);

    raw_value=copyBitsFromByteArrayLE( byteArray, 15648, 12);
    @CAN_PrivMain::RFR_Object::RXX_Object_Obj29.PyVxCoVnce = convertRawToPhysical(raw_value, 0.01, 0.0);

    raw_value=copyBitsFromByteArrayLE( byteArray, 15660, 12);
    @CAN_PrivMain::RFR_Object::RXX_Object_Obj29.PyVyCoVnce = convertRawToPhysical(raw_value, 0.01, 0.0);

    raw_value=copyBitsFromByteArrayLE( byteArray, 15500, 10);
    @CAN_PrivMain::RFR_Object::RXX_Object_Obj29.RCS = convertRawToPhysical(raw_value, 0.2, -102.4);

    raw_value=copyBitsFromByteArrayLE( byteArray, 15672, 4);
    @CAN_PrivMain::RFR_Object::RXX_Object_Obj29.ReferencePoint = convertRawToPhysical(raw_value, 1.0, 0.0);

    raw_value=copyBitsFromByteArrayLE( byteArray, 15532, 12);
    @CAN_PrivMain::RFR_Object::RXX_Object_Obj29.Vx = convertRawToPhysical(raw_value, 0.0625, -128.0);

    raw_value=copyBitsFromByteArrayLE( byteArray, 15756, 12);
    @CAN_PrivMain::RFR_Object::RXX_Object_Obj29.VxAxCoVnce = convertRawToPhysical(raw_value, 0.01, 0.0);

    raw_value=copyBitsFromByteArrayLE( byteArray, 15776, 12);
    @CAN_PrivMain::RFR_Object::RXX_Object_Obj29.VxAyCoVnce = convertRawToPhysical(raw_value, 0.01, 0.0);

    raw_value=copyBitsFromByteArrayLE( byteArray, 15552, 12);
    @CAN_PrivMain::RFR_Object::RXX_Object_Obj29.VxVnce = convertRawToPhysical(raw_value, 0.01, 0.0);

    raw_value=copyBitsFromByteArrayLE( byteArray, 15744, 12);
    @CAN_PrivMain::RFR_Object::RXX_Object_Obj29.VxVyCoVnce = convertRawToPhysical(raw_value, 0.01, 0.0);

    raw_value=copyBitsFromByteArrayLE( byteArray, 15566, 10);
    @CAN_PrivMain::RFR_Object::RXX_Object_Obj29.Vy = convertRawToPhysical(raw_value, 0.125, -64.0);

    raw_value=copyBitsFromByteArrayLE( byteArray, 15788, 12);
    @CAN_PrivMain::RFR_Object::RXX_Object_Obj29.VyAxCoVnce = convertRawToPhysical(raw_value, 0.01, 0.0);

    raw_value=copyBitsFromByteArrayLE( byteArray, 15808, 12);
    @CAN_PrivMain::RFR_Object::RXX_Object_Obj29.VyAyCoVnce = convertRawToPhysical(raw_value, 0.01, 0.0);

    raw_value=copyBitsFromByteArrayLE( byteArray, 15584, 12);
    @CAN_PrivMain::RFR_Object::RXX_Object_Obj29.VyVnce = convertRawToPhysical(raw_value, 0.01, 0.0);

    raw_value=copyBitsFromByteArrayLE( byteArray, 15480, 7);
    @CAN_PrivMain::RFR_Object::RXX_Object_Obj29.Width = convertRawToPhysical(raw_value, 0.125, 0.0);

    raw_value=copyBitsFromByteArrayLE( byteArray, 15488, 12);
    @CAN_PrivMain::RFR_Object::RXX_Object_Obj29.WidthVnce = convertRawToPhysical(raw_value, 0.01, 0.0);
}


void CRadarFR_RXX_Object_Obj3_SetDataReceived(byte byteArray[])
{
    qword raw_value;

    raw_value=copyBitsFromByteArrayLE( byteArray, 2528, 32);
    @CAN_PrivMain::RFR_Object::RXX_Object_Obj3.Age = convertRawToPhysical(raw_value, 1.0, 0.0);

    raw_value=copyBitsFromByteArrayLE( byteArray, 2124, 10);
    @CAN_PrivMain::RFR_Object::RXX_Object_Obj3.Ax = convertRawToPhysical(raw_value, 0.03125, -16.0);

    raw_value=copyBitsFromByteArrayLE( byteArray, 2508, 12);
    @CAN_PrivMain::RFR_Object::RXX_Object_Obj3.AxAyCoVnce = convertRawToPhysical(raw_value, 0.01, 0.0);

    raw_value=copyBitsFromByteArrayLE( byteArray, 2144, 12);
    @CAN_PrivMain::RFR_Object::RXX_Object_Obj3.AxVnce = convertRawToPhysical(raw_value, 0.01, 0.0);

    raw_value=copyBitsFromByteArrayLE( byteArray, 2198, 9);
    @CAN_PrivMain::RFR_Object::RXX_Object_Obj3.Ay = convertRawToPhysical(raw_value, 0.0625, -16.0);

    raw_value=copyBitsFromByteArrayLE( byteArray, 2208, 12);
    @CAN_PrivMain::RFR_Object::RXX_Object_Obj3.AyVnce = convertRawToPhysical(raw_value, 0.01, 0.0);

    raw_value=copyBitsFromByteArrayLE( byteArray, 2264, 6);
    @CAN_PrivMain::RFR_Object::RXX_Object_Obj3.ExistProb = convertRawToPhysical(raw_value, 2.0, 0.0);

    raw_value=copyBitsFromByteArrayLE( byteArray, 2328, 8);
    @CAN_PrivMain::RFR_Object::RXX_Object_Obj3.FilterInformation = convertRawToPhysical(raw_value, 1.0, 0.0);

    raw_value=copyBitsFromByteArrayLE( byteArray, 2104, 7);
    @CAN_PrivMain::RFR_Object::RXX_Object_Obj3.Length = convertRawToPhysical(raw_value, 0.125, 0.0);

    raw_value=copyBitsFromByteArrayLE( byteArray, 2112, 12);
    @CAN_PrivMain::RFR_Object::RXX_Object_Obj3.LengthVnce = convertRawToPhysical(raw_value, 0.01, 0.0);

    raw_value=copyBitsFromByteArrayLE( byteArray, 2296, 3);
    @CAN_PrivMain::RFR_Object::RXX_Object_Obj3.MeasurementStatus = convertRawToPhysical(raw_value, 1.0, 0.0);

    raw_value=copyBitsFromByteArrayLE( byteArray, 2252, 2);
    @CAN_PrivMain::RFR_Object::RXX_Object_Obj3.MovingStatus = convertRawToPhysical(raw_value, 1.0, 0.0);

    raw_value=copyBitsFromByteArrayLE( byteArray, 2232, 7);
    @CAN_PrivMain::RFR_Object::RXX_Object_Obj3.ObjId = convertRawToPhysical(raw_value, 1.0, 0.0);

    raw_value=copyBitsFromByteArrayLE( byteArray, 2134, 9);
    @CAN_PrivMain::RFR_Object::RXX_Object_Obj3.OrientationYaw = convertRawToPhysical(raw_value, 0.0175, -4.48);

    raw_value=copyBitsFromByteArrayLE( byteArray, 2156, 12);
    @CAN_PrivMain::RFR_Object::RXX_Object_Obj3.OrientationYawVnce = convertRawToPhysical(raw_value, 0.0003, 0.0);

    raw_value=copyBitsFromByteArrayLE( byteArray, 2048, 6);
    @CAN_PrivMain::RFR_Object::RXX_Object_Obj3.ProbClassConfidence = convertRawToPhysical(raw_value, 2.0, 0.0);

    raw_value=copyBitsFromByteArrayLE( byteArray, 2299, 4);
    @CAN_PrivMain::RFR_Object::RXX_Object_Obj3.ProbClassType = convertRawToPhysical(raw_value, 1.0, 0.0);

    raw_value=copyBitsFromByteArrayLE( byteArray, 2054, 14);
    @CAN_PrivMain::RFR_Object::RXX_Object_Obj3.Px = convertRawToPhysical(raw_value, 0.0625, -512.0);

    raw_value=copyBitsFromByteArrayLE( byteArray, 2368, 12);
    @CAN_PrivMain::RFR_Object::RXX_Object_Obj3.PxAxCoVnce = convertRawToPhysical(raw_value, 0.01, 0.0);

    raw_value=copyBitsFromByteArrayLE( byteArray, 2380, 12);
    @CAN_PrivMain::RFR_Object::RXX_Object_Obj3.PxAyCoVnce = convertRawToPhysical(raw_value, 0.01, 0.0);

    raw_value=copyBitsFromByteArrayLE( byteArray, 2284, 12);
    @CAN_PrivMain::RFR_Object::RXX_Object_Obj3.PxPyCoVnce = convertRawToPhysical(raw_value, 0.01, 0.0);

    raw_value=copyBitsFromByteArrayLE( byteArray, 2068, 12);
    @CAN_PrivMain::RFR_Object::RXX_Object_Obj3.PxVnce = convertRawToPhysical(raw_value, 0.1, 0.0);

    raw_value=copyBitsFromByteArrayLE( byteArray, 2304, 12);
    @CAN_PrivMain::RFR_Object::RXX_Object_Obj3.PxVxCoVnce = convertRawToPhysical(raw_value, 0.01, 0.0);

    raw_value=copyBitsFromByteArrayLE( byteArray, 2316, 12);
    @CAN_PrivMain::RFR_Object::RXX_Object_Obj3.PxVyCoVnce = convertRawToPhysical(raw_value, 0.01, 0.0);

    raw_value=copyBitsFromByteArrayLE( byteArray, 2080, 12);
    @CAN_PrivMain::RFR_Object::RXX_Object_Obj3.Py = convertRawToPhysical(raw_value, 0.0625, -128.0);

    raw_value=copyBitsFromByteArrayLE( byteArray, 2400, 12);
    @CAN_PrivMain::RFR_Object::RXX_Object_Obj3.PyAxCoVnce = convertRawToPhysical(raw_value, 0.01, 0.0);

    raw_value=copyBitsFromByteArrayLE( byteArray, 2412, 12);
    @CAN_PrivMain::RFR_Object::RXX_Object_Obj3.PyAyCoVnce = convertRawToPhysical(raw_value, 0.01, 0.0);

    raw_value=copyBitsFromByteArrayLE( byteArray, 2092, 12);
    @CAN_PrivMain::RFR_Object::RXX_Object_Obj3.PyVnce = convertRawToPhysical(raw_value, 0.1, 0.0);

    raw_value=copyBitsFromByteArrayLE( byteArray, 2336, 12);
    @CAN_PrivMain::RFR_Object::RXX_Object_Obj3.PyVxCoVnce = convertRawToPhysical(raw_value, 0.01, 0.0);

    raw_value=copyBitsFromByteArrayLE( byteArray, 2348, 12);
    @CAN_PrivMain::RFR_Object::RXX_Object_Obj3.PyVyCoVnce = convertRawToPhysical(raw_value, 0.01, 0.0);

    raw_value=copyBitsFromByteArrayLE( byteArray, 2188, 10);
    @CAN_PrivMain::RFR_Object::RXX_Object_Obj3.RCS = convertRawToPhysical(raw_value, 0.2, -102.4);

    raw_value=copyBitsFromByteArrayLE( byteArray, 2360, 4);
    @CAN_PrivMain::RFR_Object::RXX_Object_Obj3.ReferencePoint = convertRawToPhysical(raw_value, 1.0, 0.0);

    raw_value=copyBitsFromByteArrayLE( byteArray, 2220, 12);
    @CAN_PrivMain::RFR_Object::RXX_Object_Obj3.Vx = convertRawToPhysical(raw_value, 0.0625, -128.0);

    raw_value=copyBitsFromByteArrayLE( byteArray, 2444, 12);
    @CAN_PrivMain::RFR_Object::RXX_Object_Obj3.VxAxCoVnce = convertRawToPhysical(raw_value, 0.01, 0.0);

    raw_value=copyBitsFromByteArrayLE( byteArray, 2464, 12);
    @CAN_PrivMain::RFR_Object::RXX_Object_Obj3.VxAyCoVnce = convertRawToPhysical(raw_value, 0.01, 0.0);

    raw_value=copyBitsFromByteArrayLE( byteArray, 2240, 12);
    @CAN_PrivMain::RFR_Object::RXX_Object_Obj3.VxVnce = convertRawToPhysical(raw_value, 0.01, 0.0);

    raw_value=copyBitsFromByteArrayLE( byteArray, 2432, 12);
    @CAN_PrivMain::RFR_Object::RXX_Object_Obj3.VxVyCoVnce = convertRawToPhysical(raw_value, 0.01, 0.0);

    raw_value=copyBitsFromByteArrayLE( byteArray, 2254, 10);
    @CAN_PrivMain::RFR_Object::RXX_Object_Obj3.Vy = convertRawToPhysical(raw_value, 0.125, -64.0);

    raw_value=copyBitsFromByteArrayLE( byteArray, 2476, 12);
    @CAN_PrivMain::RFR_Object::RXX_Object_Obj3.VyAxCoVnce = convertRawToPhysical(raw_value, 0.01, 0.0);

    raw_value=copyBitsFromByteArrayLE( byteArray, 2496, 12);
    @CAN_PrivMain::RFR_Object::RXX_Object_Obj3.VyAyCoVnce = convertRawToPhysical(raw_value, 0.01, 0.0);

    raw_value=copyBitsFromByteArrayLE( byteArray, 2272, 12);
    @CAN_PrivMain::RFR_Object::RXX_Object_Obj3.VyVnce = convertRawToPhysical(raw_value, 0.01, 0.0);

    raw_value=copyBitsFromByteArrayLE( byteArray, 2168, 7);
    @CAN_PrivMain::RFR_Object::RXX_Object_Obj3.Width = convertRawToPhysical(raw_value, 0.125, 0.0);

    raw_value=copyBitsFromByteArrayLE( byteArray, 2176, 12);
    @CAN_PrivMain::RFR_Object::RXX_Object_Obj3.WidthVnce = convertRawToPhysical(raw_value, 0.01, 0.0);
}


void CRadarFR_RXX_Object_Obj30_SetDataReceived(byte byteArray[])
{
    qword raw_value;

    raw_value=copyBitsFromByteArrayLE( byteArray, 16352, 32);
    @CAN_PrivMain::RFR_Object::RXX_Object_Obj30.Age = convertRawToPhysical(raw_value, 1.0, 0.0);

    raw_value=copyBitsFromByteArrayLE( byteArray, 15948, 10);
    @CAN_PrivMain::RFR_Object::RXX_Object_Obj30.Ax = convertRawToPhysical(raw_value, 0.03125, -16.0);

    raw_value=copyBitsFromByteArrayLE( byteArray, 16332, 12);
    @CAN_PrivMain::RFR_Object::RXX_Object_Obj30.AxAyCoVnce = convertRawToPhysical(raw_value, 0.01, 0.0);

    raw_value=copyBitsFromByteArrayLE( byteArray, 15968, 12);
    @CAN_PrivMain::RFR_Object::RXX_Object_Obj30.AxVnce = convertRawToPhysical(raw_value, 0.01, 0.0);

    raw_value=copyBitsFromByteArrayLE( byteArray, 16022, 9);
    @CAN_PrivMain::RFR_Object::RXX_Object_Obj30.Ay = convertRawToPhysical(raw_value, 0.0625, -16.0);

    raw_value=copyBitsFromByteArrayLE( byteArray, 16032, 12);
    @CAN_PrivMain::RFR_Object::RXX_Object_Obj30.AyVnce = convertRawToPhysical(raw_value, 0.01, 0.0);

    raw_value=copyBitsFromByteArrayLE( byteArray, 16088, 6);
    @CAN_PrivMain::RFR_Object::RXX_Object_Obj30.ExistProb = convertRawToPhysical(raw_value, 2.0, 0.0);

    raw_value=copyBitsFromByteArrayLE( byteArray, 16152, 8);
    @CAN_PrivMain::RFR_Object::RXX_Object_Obj30.FilterInformation = convertRawToPhysical(raw_value, 1.0, 0.0);

    raw_value=copyBitsFromByteArrayLE( byteArray, 15928, 7);
    @CAN_PrivMain::RFR_Object::RXX_Object_Obj30.Length = convertRawToPhysical(raw_value, 0.125, 0.0);

    raw_value=copyBitsFromByteArrayLE( byteArray, 15936, 12);
    @CAN_PrivMain::RFR_Object::RXX_Object_Obj30.LengthVnce = convertRawToPhysical(raw_value, 0.01, 0.0);

    raw_value=copyBitsFromByteArrayLE( byteArray, 16120, 3);
    @CAN_PrivMain::RFR_Object::RXX_Object_Obj30.MeasurementStatus = convertRawToPhysical(raw_value, 1.0, 0.0);

    raw_value=copyBitsFromByteArrayLE( byteArray, 16076, 2);
    @CAN_PrivMain::RFR_Object::RXX_Object_Obj30.MovingStatus = convertRawToPhysical(raw_value, 1.0, 0.0);

    raw_value=copyBitsFromByteArrayLE( byteArray, 16056, 7);
    @CAN_PrivMain::RFR_Object::RXX_Object_Obj30.ObjId = convertRawToPhysical(raw_value, 1.0, 0.0);

    raw_value=copyBitsFromByteArrayLE( byteArray, 15958, 9);
    @CAN_PrivMain::RFR_Object::RXX_Object_Obj30.OrientationYaw = convertRawToPhysical(raw_value, 0.0175, -4.48);

    raw_value=copyBitsFromByteArrayLE( byteArray, 15980, 12);
    @CAN_PrivMain::RFR_Object::RXX_Object_Obj30.OrientationYawVnce = convertRawToPhysical(raw_value, 0.0003, 0.0);

    raw_value=copyBitsFromByteArrayLE( byteArray, 15872, 6);
    @CAN_PrivMain::RFR_Object::RXX_Object_Obj30.ProbClassConfidence = convertRawToPhysical(raw_value, 2.0, 0.0);

    raw_value=copyBitsFromByteArrayLE( byteArray, 16123, 4);
    @CAN_PrivMain::RFR_Object::RXX_Object_Obj30.ProbClassType = convertRawToPhysical(raw_value, 1.0, 0.0);

    raw_value=copyBitsFromByteArrayLE( byteArray, 15878, 14);
    @CAN_PrivMain::RFR_Object::RXX_Object_Obj30.Px = convertRawToPhysical(raw_value, 0.0625, -512.0);

    raw_value=copyBitsFromByteArrayLE( byteArray, 16192, 12);
    @CAN_PrivMain::RFR_Object::RXX_Object_Obj30.PxAxCoVnce = convertRawToPhysical(raw_value, 0.01, 0.0);

    raw_value=copyBitsFromByteArrayLE( byteArray, 16204, 12);
    @CAN_PrivMain::RFR_Object::RXX_Object_Obj30.PxAyCoVnce = convertRawToPhysical(raw_value, 0.01, 0.0);

    raw_value=copyBitsFromByteArrayLE( byteArray, 16108, 12);
    @CAN_PrivMain::RFR_Object::RXX_Object_Obj30.PxPyCoVnce = convertRawToPhysical(raw_value, 0.01, 0.0);

    raw_value=copyBitsFromByteArrayLE( byteArray, 15892, 12);
    @CAN_PrivMain::RFR_Object::RXX_Object_Obj30.PxVnce = convertRawToPhysical(raw_value, 0.1, 0.0);

    raw_value=copyBitsFromByteArrayLE( byteArray, 16128, 12);
    @CAN_PrivMain::RFR_Object::RXX_Object_Obj30.PxVxCoVnce = convertRawToPhysical(raw_value, 0.01, 0.0);

    raw_value=copyBitsFromByteArrayLE( byteArray, 16140, 12);
    @CAN_PrivMain::RFR_Object::RXX_Object_Obj30.PxVyCoVnce = convertRawToPhysical(raw_value, 0.01, 0.0);

    raw_value=copyBitsFromByteArrayLE( byteArray, 15904, 12);
    @CAN_PrivMain::RFR_Object::RXX_Object_Obj30.Py = convertRawToPhysical(raw_value, 0.0625, -128.0);

    raw_value=copyBitsFromByteArrayLE( byteArray, 16224, 12);
    @CAN_PrivMain::RFR_Object::RXX_Object_Obj30.PyAxCoVnce = convertRawToPhysical(raw_value, 0.01, 0.0);

    raw_value=copyBitsFromByteArrayLE( byteArray, 16236, 12);
    @CAN_PrivMain::RFR_Object::RXX_Object_Obj30.PyAyCoVnce = convertRawToPhysical(raw_value, 0.01, 0.0);

    raw_value=copyBitsFromByteArrayLE( byteArray, 15916, 12);
    @CAN_PrivMain::RFR_Object::RXX_Object_Obj30.PyVnce = convertRawToPhysical(raw_value, 0.1, 0.0);

    raw_value=copyBitsFromByteArrayLE( byteArray, 16160, 12);
    @CAN_PrivMain::RFR_Object::RXX_Object_Obj30.PyVxCoVnce = convertRawToPhysical(raw_value, 0.01, 0.0);

    raw_value=copyBitsFromByteArrayLE( byteArray, 16172, 12);
    @CAN_PrivMain::RFR_Object::RXX_Object_Obj30.PyVyCoVnce = convertRawToPhysical(raw_value, 0.01, 0.0);

    raw_value=copyBitsFromByteArrayLE( byteArray, 16012, 10);
    @CAN_PrivMain::RFR_Object::RXX_Object_Obj30.RCS = convertRawToPhysical(raw_value, 0.2, -102.4);

    raw_value=copyBitsFromByteArrayLE( byteArray, 16184, 4);
    @CAN_PrivMain::RFR_Object::RXX_Object_Obj30.ReferencePoint = convertRawToPhysical(raw_value, 1.0, 0.0);

    raw_value=copyBitsFromByteArrayLE( byteArray, 16044, 12);
    @CAN_PrivMain::RFR_Object::RXX_Object_Obj30.Vx = convertRawToPhysical(raw_value, 0.0625, -128.0);

    raw_value=copyBitsFromByteArrayLE( byteArray, 16268, 12);
    @CAN_PrivMain::RFR_Object::RXX_Object_Obj30.VxAxCoVnce = convertRawToPhysical(raw_value, 0.01, 0.0);

    raw_value=copyBitsFromByteArrayLE( byteArray, 16288, 12);
    @CAN_PrivMain::RFR_Object::RXX_Object_Obj30.VxAyCoVnce = convertRawToPhysical(raw_value, 0.01, 0.0);

    raw_value=copyBitsFromByteArrayLE( byteArray, 16064, 12);
    @CAN_PrivMain::RFR_Object::RXX_Object_Obj30.VxVnce = convertRawToPhysical(raw_value, 0.01, 0.0);

    raw_value=copyBitsFromByteArrayLE( byteArray, 16256, 12);
    @CAN_PrivMain::RFR_Object::RXX_Object_Obj30.VxVyCoVnce = convertRawToPhysical(raw_value, 0.01, 0.0);

    raw_value=copyBitsFromByteArrayLE( byteArray, 16078, 10);
    @CAN_PrivMain::RFR_Object::RXX_Object_Obj30.Vy = convertRawToPhysical(raw_value, 0.125, -64.0);

    raw_value=copyBitsFromByteArrayLE( byteArray, 16300, 12);
    @CAN_PrivMain::RFR_Object::RXX_Object_Obj30.VyAxCoVnce = convertRawToPhysical(raw_value, 0.01, 0.0);

    raw_value=copyBitsFromByteArrayLE( byteArray, 16320, 12);
    @CAN_PrivMain::RFR_Object::RXX_Object_Obj30.VyAyCoVnce = convertRawToPhysical(raw_value, 0.01, 0.0);

    raw_value=copyBitsFromByteArrayLE( byteArray, 16096, 12);
    @CAN_PrivMain::RFR_Object::RXX_Object_Obj30.VyVnce = convertRawToPhysical(raw_value, 0.01, 0.0);

    raw_value=copyBitsFromByteArrayLE( byteArray, 15992, 7);
    @CAN_PrivMain::RFR_Object::RXX_Object_Obj30.Width = convertRawToPhysical(raw_value, 0.125, 0.0);

    raw_value=copyBitsFromByteArrayLE( byteArray, 16000, 12);
    @CAN_PrivMain::RFR_Object::RXX_Object_Obj30.WidthVnce = convertRawToPhysical(raw_value, 0.01, 0.0);
}


void CRadarFR_RXX_Object_Obj31_SetDataReceived(byte byteArray[])
{
    qword raw_value;

    raw_value=copyBitsFromByteArrayLE( byteArray, 16864, 32);
    @CAN_PrivMain::RFR_Object::RXX_Object_Obj31.Age = convertRawToPhysical(raw_value, 1.0, 0.0);

    raw_value=copyBitsFromByteArrayLE( byteArray, 16460, 10);
    @CAN_PrivMain::RFR_Object::RXX_Object_Obj31.Ax = convertRawToPhysical(raw_value, 0.03125, -16.0);

    raw_value=copyBitsFromByteArrayLE( byteArray, 16844, 12);
    @CAN_PrivMain::RFR_Object::RXX_Object_Obj31.AxAyCoVnce = convertRawToPhysical(raw_value, 0.01, 0.0);

    raw_value=copyBitsFromByteArrayLE( byteArray, 16480, 12);
    @CAN_PrivMain::RFR_Object::RXX_Object_Obj31.AxVnce = convertRawToPhysical(raw_value, 0.01, 0.0);

    raw_value=copyBitsFromByteArrayLE( byteArray, 16534, 9);
    @CAN_PrivMain::RFR_Object::RXX_Object_Obj31.Ay = convertRawToPhysical(raw_value, 0.0625, -16.0);

    raw_value=copyBitsFromByteArrayLE( byteArray, 16544, 12);
    @CAN_PrivMain::RFR_Object::RXX_Object_Obj31.AyVnce = convertRawToPhysical(raw_value, 0.01, 0.0);

    raw_value=copyBitsFromByteArrayLE( byteArray, 16600, 6);
    @CAN_PrivMain::RFR_Object::RXX_Object_Obj31.ExistProb = convertRawToPhysical(raw_value, 2.0, 0.0);

    raw_value=copyBitsFromByteArrayLE( byteArray, 16664, 8);
    @CAN_PrivMain::RFR_Object::RXX_Object_Obj31.FilterInformation = convertRawToPhysical(raw_value, 1.0, 0.0);

    raw_value=copyBitsFromByteArrayLE( byteArray, 16440, 7);
    @CAN_PrivMain::RFR_Object::RXX_Object_Obj31.Length = convertRawToPhysical(raw_value, 0.125, 0.0);

    raw_value=copyBitsFromByteArrayLE( byteArray, 16448, 12);
    @CAN_PrivMain::RFR_Object::RXX_Object_Obj31.LengthVnce = convertRawToPhysical(raw_value, 0.01, 0.0);

    raw_value=copyBitsFromByteArrayLE( byteArray, 16632, 3);
    @CAN_PrivMain::RFR_Object::RXX_Object_Obj31.MeasurementStatus = convertRawToPhysical(raw_value, 1.0, 0.0);

    raw_value=copyBitsFromByteArrayLE( byteArray, 16588, 2);
    @CAN_PrivMain::RFR_Object::RXX_Object_Obj31.MovingStatus = convertRawToPhysical(raw_value, 1.0, 0.0);

    raw_value=copyBitsFromByteArrayLE( byteArray, 16568, 7);
    @CAN_PrivMain::RFR_Object::RXX_Object_Obj31.ObjId = convertRawToPhysical(raw_value, 1.0, 0.0);

    raw_value=copyBitsFromByteArrayLE( byteArray, 16470, 9);
    @CAN_PrivMain::RFR_Object::RXX_Object_Obj31.OrientationYaw = convertRawToPhysical(raw_value, 0.0175, -4.48);

    raw_value=copyBitsFromByteArrayLE( byteArray, 16492, 12);
    @CAN_PrivMain::RFR_Object::RXX_Object_Obj31.OrientationYawVnce = convertRawToPhysical(raw_value, 0.0003, 0.0);

    raw_value=copyBitsFromByteArrayLE( byteArray, 16384, 6);
    @CAN_PrivMain::RFR_Object::RXX_Object_Obj31.ProbClassConfidence = convertRawToPhysical(raw_value, 2.0, 0.0);

    raw_value=copyBitsFromByteArrayLE( byteArray, 16635, 4);
    @CAN_PrivMain::RFR_Object::RXX_Object_Obj31.ProbClassType = convertRawToPhysical(raw_value, 1.0, 0.0);

    raw_value=copyBitsFromByteArrayLE( byteArray, 16390, 14);
    @CAN_PrivMain::RFR_Object::RXX_Object_Obj31.Px = convertRawToPhysical(raw_value, 0.0625, -512.0);

    raw_value=copyBitsFromByteArrayLE( byteArray, 16704, 12);
    @CAN_PrivMain::RFR_Object::RXX_Object_Obj31.PxAxCoVnce = convertRawToPhysical(raw_value, 0.01, 0.0);

    raw_value=copyBitsFromByteArrayLE( byteArray, 16716, 12);
    @CAN_PrivMain::RFR_Object::RXX_Object_Obj31.PxAyCoVnce = convertRawToPhysical(raw_value, 0.01, 0.0);

    raw_value=copyBitsFromByteArrayLE( byteArray, 16620, 12);
    @CAN_PrivMain::RFR_Object::RXX_Object_Obj31.PxPyCoVnce = convertRawToPhysical(raw_value, 0.01, 0.0);

    raw_value=copyBitsFromByteArrayLE( byteArray, 16404, 12);
    @CAN_PrivMain::RFR_Object::RXX_Object_Obj31.PxVnce = convertRawToPhysical(raw_value, 0.1, 0.0);

    raw_value=copyBitsFromByteArrayLE( byteArray, 16640, 12);
    @CAN_PrivMain::RFR_Object::RXX_Object_Obj31.PxVxCoVnce = convertRawToPhysical(raw_value, 0.01, 0.0);

    raw_value=copyBitsFromByteArrayLE( byteArray, 16652, 12);
    @CAN_PrivMain::RFR_Object::RXX_Object_Obj31.PxVyCoVnce = convertRawToPhysical(raw_value, 0.01, 0.0);

    raw_value=copyBitsFromByteArrayLE( byteArray, 16416, 12);
    @CAN_PrivMain::RFR_Object::RXX_Object_Obj31.Py = convertRawToPhysical(raw_value, 0.0625, -128.0);

    raw_value=copyBitsFromByteArrayLE( byteArray, 16736, 12);
    @CAN_PrivMain::RFR_Object::RXX_Object_Obj31.PyAxCoVnce = convertRawToPhysical(raw_value, 0.01, 0.0);

    raw_value=copyBitsFromByteArrayLE( byteArray, 16748, 12);
    @CAN_PrivMain::RFR_Object::RXX_Object_Obj31.PyAyCoVnce = convertRawToPhysical(raw_value, 0.01, 0.0);

    raw_value=copyBitsFromByteArrayLE( byteArray, 16428, 12);
    @CAN_PrivMain::RFR_Object::RXX_Object_Obj31.PyVnce = convertRawToPhysical(raw_value, 0.1, 0.0);

    raw_value=copyBitsFromByteArrayLE( byteArray, 16672, 12);
    @CAN_PrivMain::RFR_Object::RXX_Object_Obj31.PyVxCoVnce = convertRawToPhysical(raw_value, 0.01, 0.0);

    raw_value=copyBitsFromByteArrayLE( byteArray, 16684, 12);
    @CAN_PrivMain::RFR_Object::RXX_Object_Obj31.PyVyCoVnce = convertRawToPhysical(raw_value, 0.01, 0.0);

    raw_value=copyBitsFromByteArrayLE( byteArray, 16524, 10);
    @CAN_PrivMain::RFR_Object::RXX_Object_Obj31.RCS = convertRawToPhysical(raw_value, 0.2, -102.4);

    raw_value=copyBitsFromByteArrayLE( byteArray, 16696, 4);
    @CAN_PrivMain::RFR_Object::RXX_Object_Obj31.ReferencePoint = convertRawToPhysical(raw_value, 1.0, 0.0);

    raw_value=copyBitsFromByteArrayLE( byteArray, 16556, 12);
    @CAN_PrivMain::RFR_Object::RXX_Object_Obj31.Vx = convertRawToPhysical(raw_value, 0.0625, -128.0);

    raw_value=copyBitsFromByteArrayLE( byteArray, 16780, 12);
    @CAN_PrivMain::RFR_Object::RXX_Object_Obj31.VxAxCoVnce = convertRawToPhysical(raw_value, 0.01, 0.0);

    raw_value=copyBitsFromByteArrayLE( byteArray, 16800, 12);
    @CAN_PrivMain::RFR_Object::RXX_Object_Obj31.VxAyCoVnce = convertRawToPhysical(raw_value, 0.01, 0.0);

    raw_value=copyBitsFromByteArrayLE( byteArray, 16576, 12);
    @CAN_PrivMain::RFR_Object::RXX_Object_Obj31.VxVnce = convertRawToPhysical(raw_value, 0.01, 0.0);

    raw_value=copyBitsFromByteArrayLE( byteArray, 16768, 12);
    @CAN_PrivMain::RFR_Object::RXX_Object_Obj31.VxVyCoVnce = convertRawToPhysical(raw_value, 0.01, 0.0);

    raw_value=copyBitsFromByteArrayLE( byteArray, 16590, 10);
    @CAN_PrivMain::RFR_Object::RXX_Object_Obj31.Vy = convertRawToPhysical(raw_value, 0.125, -64.0);

    raw_value=copyBitsFromByteArrayLE( byteArray, 16812, 12);
    @CAN_PrivMain::RFR_Object::RXX_Object_Obj31.VyAxCoVnce = convertRawToPhysical(raw_value, 0.01, 0.0);

    raw_value=copyBitsFromByteArrayLE( byteArray, 16832, 12);
    @CAN_PrivMain::RFR_Object::RXX_Object_Obj31.VyAyCoVnce = convertRawToPhysical(raw_value, 0.01, 0.0);

    raw_value=copyBitsFromByteArrayLE( byteArray, 16608, 12);
    @CAN_PrivMain::RFR_Object::RXX_Object_Obj31.VyVnce = convertRawToPhysical(raw_value, 0.01, 0.0);

    raw_value=copyBitsFromByteArrayLE( byteArray, 16504, 7);
    @CAN_PrivMain::RFR_Object::RXX_Object_Obj31.Width = convertRawToPhysical(raw_value, 0.125, 0.0);

    raw_value=copyBitsFromByteArrayLE( byteArray, 16512, 12);
    @CAN_PrivMain::RFR_Object::RXX_Object_Obj31.WidthVnce = convertRawToPhysical(raw_value, 0.01, 0.0);
}


void CRadarFR_RXX_Object_Obj32_SetDataReceived(byte byteArray[])
{
    qword raw_value;

    raw_value=copyBitsFromByteArrayLE( byteArray, 17376, 32);
    @CAN_PrivMain::RFR_Object::RXX_Object_Obj32.Age = convertRawToPhysical(raw_value, 1.0, 0.0);

    raw_value=copyBitsFromByteArrayLE( byteArray, 16972, 10);
    @CAN_PrivMain::RFR_Object::RXX_Object_Obj32.Ax = convertRawToPhysical(raw_value, 0.03125, -16.0);

    raw_value=copyBitsFromByteArrayLE( byteArray, 17356, 12);
    @CAN_PrivMain::RFR_Object::RXX_Object_Obj32.AxAyCoVnce = convertRawToPhysical(raw_value, 0.01, 0.0);

    raw_value=copyBitsFromByteArrayLE( byteArray, 16992, 12);
    @CAN_PrivMain::RFR_Object::RXX_Object_Obj32.AxVnce = convertRawToPhysical(raw_value, 0.01, 0.0);

    raw_value=copyBitsFromByteArrayLE( byteArray, 17046, 9);
    @CAN_PrivMain::RFR_Object::RXX_Object_Obj32.Ay = convertRawToPhysical(raw_value, 0.0625, -16.0);

    raw_value=copyBitsFromByteArrayLE( byteArray, 17056, 12);
    @CAN_PrivMain::RFR_Object::RXX_Object_Obj32.AyVnce = convertRawToPhysical(raw_value, 0.01, 0.0);

    raw_value=copyBitsFromByteArrayLE( byteArray, 17112, 6);
    @CAN_PrivMain::RFR_Object::RXX_Object_Obj32.ExistProb = convertRawToPhysical(raw_value, 2.0, 0.0);

    raw_value=copyBitsFromByteArrayLE( byteArray, 17176, 8);
    @CAN_PrivMain::RFR_Object::RXX_Object_Obj32.FilterInformation = convertRawToPhysical(raw_value, 1.0, 0.0);

    raw_value=copyBitsFromByteArrayLE( byteArray, 16952, 7);
    @CAN_PrivMain::RFR_Object::RXX_Object_Obj32.Length = convertRawToPhysical(raw_value, 0.125, 0.0);

    raw_value=copyBitsFromByteArrayLE( byteArray, 16960, 12);
    @CAN_PrivMain::RFR_Object::RXX_Object_Obj32.LengthVnce = convertRawToPhysical(raw_value, 0.01, 0.0);

    raw_value=copyBitsFromByteArrayLE( byteArray, 17144, 3);
    @CAN_PrivMain::RFR_Object::RXX_Object_Obj32.MeasurementStatus = convertRawToPhysical(raw_value, 1.0, 0.0);

    raw_value=copyBitsFromByteArrayLE( byteArray, 17100, 2);
    @CAN_PrivMain::RFR_Object::RXX_Object_Obj32.MovingStatus = convertRawToPhysical(raw_value, 1.0, 0.0);

    raw_value=copyBitsFromByteArrayLE( byteArray, 17080, 7);
    @CAN_PrivMain::RFR_Object::RXX_Object_Obj32.ObjId = convertRawToPhysical(raw_value, 1.0, 0.0);

    raw_value=copyBitsFromByteArrayLE( byteArray, 16982, 9);
    @CAN_PrivMain::RFR_Object::RXX_Object_Obj32.OrientationYaw = convertRawToPhysical(raw_value, 0.0175, -4.48);

    raw_value=copyBitsFromByteArrayLE( byteArray, 17004, 12);
    @CAN_PrivMain::RFR_Object::RXX_Object_Obj32.OrientationYawVnce = convertRawToPhysical(raw_value, 0.0003, 0.0);

    raw_value=copyBitsFromByteArrayLE( byteArray, 16896, 6);
    @CAN_PrivMain::RFR_Object::RXX_Object_Obj32.ProbClassConfidence = convertRawToPhysical(raw_value, 2.0, 0.0);

    raw_value=copyBitsFromByteArrayLE( byteArray, 17147, 4);
    @CAN_PrivMain::RFR_Object::RXX_Object_Obj32.ProbClassType = convertRawToPhysical(raw_value, 1.0, 0.0);

    raw_value=copyBitsFromByteArrayLE( byteArray, 16902, 14);
    @CAN_PrivMain::RFR_Object::RXX_Object_Obj32.Px = convertRawToPhysical(raw_value, 0.0625, -512.0);

    raw_value=copyBitsFromByteArrayLE( byteArray, 17216, 12);
    @CAN_PrivMain::RFR_Object::RXX_Object_Obj32.PxAxCoVnce = convertRawToPhysical(raw_value, 0.01, 0.0);

    raw_value=copyBitsFromByteArrayLE( byteArray, 17228, 12);
    @CAN_PrivMain::RFR_Object::RXX_Object_Obj32.PxAyCoVnce = convertRawToPhysical(raw_value, 0.01, 0.0);

    raw_value=copyBitsFromByteArrayLE( byteArray, 17132, 12);
    @CAN_PrivMain::RFR_Object::RXX_Object_Obj32.PxPyCoVnce = convertRawToPhysical(raw_value, 0.01, 0.0);

    raw_value=copyBitsFromByteArrayLE( byteArray, 16916, 12);
    @CAN_PrivMain::RFR_Object::RXX_Object_Obj32.PxVnce = convertRawToPhysical(raw_value, 0.1, 0.0);

    raw_value=copyBitsFromByteArrayLE( byteArray, 17152, 12);
    @CAN_PrivMain::RFR_Object::RXX_Object_Obj32.PxVxCoVnce = convertRawToPhysical(raw_value, 0.01, 0.0);

    raw_value=copyBitsFromByteArrayLE( byteArray, 17164, 12);
    @CAN_PrivMain::RFR_Object::RXX_Object_Obj32.PxVyCoVnce = convertRawToPhysical(raw_value, 0.01, 0.0);

    raw_value=copyBitsFromByteArrayLE( byteArray, 16928, 12);
    @CAN_PrivMain::RFR_Object::RXX_Object_Obj32.Py = convertRawToPhysical(raw_value, 0.0625, -128.0);

    raw_value=copyBitsFromByteArrayLE( byteArray, 17248, 12);
    @CAN_PrivMain::RFR_Object::RXX_Object_Obj32.PyAxCoVnce = convertRawToPhysical(raw_value, 0.01, 0.0);

    raw_value=copyBitsFromByteArrayLE( byteArray, 17260, 12);
    @CAN_PrivMain::RFR_Object::RXX_Object_Obj32.PyAyCoVnce = convertRawToPhysical(raw_value, 0.01, 0.0);

    raw_value=copyBitsFromByteArrayLE( byteArray, 16940, 12);
    @CAN_PrivMain::RFR_Object::RXX_Object_Obj32.PyVnce = convertRawToPhysical(raw_value, 0.1, 0.0);

    raw_value=copyBitsFromByteArrayLE( byteArray, 17184, 12);
    @CAN_PrivMain::RFR_Object::RXX_Object_Obj32.PyVxCoVnce = convertRawToPhysical(raw_value, 0.01, 0.0);

    raw_value=copyBitsFromByteArrayLE( byteArray, 17196, 12);
    @CAN_PrivMain::RFR_Object::RXX_Object_Obj32.PyVyCoVnce = convertRawToPhysical(raw_value, 0.01, 0.0);

    raw_value=copyBitsFromByteArrayLE( byteArray, 17036, 10);
    @CAN_PrivMain::RFR_Object::RXX_Object_Obj32.RCS = convertRawToPhysical(raw_value, 0.2, -102.4);

    raw_value=copyBitsFromByteArrayLE( byteArray, 17208, 4);
    @CAN_PrivMain::RFR_Object::RXX_Object_Obj32.ReferencePoint = convertRawToPhysical(raw_value, 1.0, 0.0);

    raw_value=copyBitsFromByteArrayLE( byteArray, 17068, 12);
    @CAN_PrivMain::RFR_Object::RXX_Object_Obj32.Vx = convertRawToPhysical(raw_value, 0.0625, -128.0);

    raw_value=copyBitsFromByteArrayLE( byteArray, 17292, 12);
    @CAN_PrivMain::RFR_Object::RXX_Object_Obj32.VxAxCoVnce = convertRawToPhysical(raw_value, 0.01, 0.0);

    raw_value=copyBitsFromByteArrayLE( byteArray, 17312, 12);
    @CAN_PrivMain::RFR_Object::RXX_Object_Obj32.VxAyCoVnce = convertRawToPhysical(raw_value, 0.01, 0.0);

    raw_value=copyBitsFromByteArrayLE( byteArray, 17088, 12);
    @CAN_PrivMain::RFR_Object::RXX_Object_Obj32.VxVnce = convertRawToPhysical(raw_value, 0.01, 0.0);

    raw_value=copyBitsFromByteArrayLE( byteArray, 17280, 12);
    @CAN_PrivMain::RFR_Object::RXX_Object_Obj32.VxVyCoVnce = convertRawToPhysical(raw_value, 0.01, 0.0);

    raw_value=copyBitsFromByteArrayLE( byteArray, 17102, 10);
    @CAN_PrivMain::RFR_Object::RXX_Object_Obj32.Vy = convertRawToPhysical(raw_value, 0.125, -64.0);

    raw_value=copyBitsFromByteArrayLE( byteArray, 17324, 12);
    @CAN_PrivMain::RFR_Object::RXX_Object_Obj32.VyAxCoVnce = convertRawToPhysical(raw_value, 0.01, 0.0);

    raw_value=copyBitsFromByteArrayLE( byteArray, 17344, 12);
    @CAN_PrivMain::RFR_Object::RXX_Object_Obj32.VyAyCoVnce = convertRawToPhysical(raw_value, 0.01, 0.0);

    raw_value=copyBitsFromByteArrayLE( byteArray, 17120, 12);
    @CAN_PrivMain::RFR_Object::RXX_Object_Obj32.VyVnce = convertRawToPhysical(raw_value, 0.01, 0.0);

    raw_value=copyBitsFromByteArrayLE( byteArray, 17016, 7);
    @CAN_PrivMain::RFR_Object::RXX_Object_Obj32.Width = convertRawToPhysical(raw_value, 0.125, 0.0);

    raw_value=copyBitsFromByteArrayLE( byteArray, 17024, 12);
    @CAN_PrivMain::RFR_Object::RXX_Object_Obj32.WidthVnce = convertRawToPhysical(raw_value, 0.01, 0.0);
}


void CRadarFR_RXX_Object_Obj33_SetDataReceived(byte byteArray[])
{
    qword raw_value;

    raw_value=copyBitsFromByteArrayLE( byteArray, 17888, 32);
    @CAN_PrivMain::RFR_Object::RXX_Object_Obj33.Age = convertRawToPhysical(raw_value, 1.0, 0.0);

    raw_value=copyBitsFromByteArrayLE( byteArray, 17484, 10);
    @CAN_PrivMain::RFR_Object::RXX_Object_Obj33.Ax = convertRawToPhysical(raw_value, 0.03125, -16.0);

    raw_value=copyBitsFromByteArrayLE( byteArray, 17868, 12);
    @CAN_PrivMain::RFR_Object::RXX_Object_Obj33.AxAyCoVnce = convertRawToPhysical(raw_value, 0.01, 0.0);

    raw_value=copyBitsFromByteArrayLE( byteArray, 17504, 12);
    @CAN_PrivMain::RFR_Object::RXX_Object_Obj33.AxVnce = convertRawToPhysical(raw_value, 0.01, 0.0);

    raw_value=copyBitsFromByteArrayLE( byteArray, 17558, 9);
    @CAN_PrivMain::RFR_Object::RXX_Object_Obj33.Ay = convertRawToPhysical(raw_value, 0.0625, -16.0);

    raw_value=copyBitsFromByteArrayLE( byteArray, 17568, 12);
    @CAN_PrivMain::RFR_Object::RXX_Object_Obj33.AyVnce = convertRawToPhysical(raw_value, 0.01, 0.0);

    raw_value=copyBitsFromByteArrayLE( byteArray, 17624, 6);
    @CAN_PrivMain::RFR_Object::RXX_Object_Obj33.ExistProb = convertRawToPhysical(raw_value, 2.0, 0.0);

    raw_value=copyBitsFromByteArrayLE( byteArray, 17688, 8);
    @CAN_PrivMain::RFR_Object::RXX_Object_Obj33.FilterInformation = convertRawToPhysical(raw_value, 1.0, 0.0);

    raw_value=copyBitsFromByteArrayLE( byteArray, 17464, 7);
    @CAN_PrivMain::RFR_Object::RXX_Object_Obj33.Length = convertRawToPhysical(raw_value, 0.125, 0.0);

    raw_value=copyBitsFromByteArrayLE( byteArray, 17472, 12);
    @CAN_PrivMain::RFR_Object::RXX_Object_Obj33.LengthVnce = convertRawToPhysical(raw_value, 0.01, 0.0);

    raw_value=copyBitsFromByteArrayLE( byteArray, 17656, 3);
    @CAN_PrivMain::RFR_Object::RXX_Object_Obj33.MeasurementStatus = convertRawToPhysical(raw_value, 1.0, 0.0);

    raw_value=copyBitsFromByteArrayLE( byteArray, 17612, 2);
    @CAN_PrivMain::RFR_Object::RXX_Object_Obj33.MovingStatus = convertRawToPhysical(raw_value, 1.0, 0.0);

    raw_value=copyBitsFromByteArrayLE( byteArray, 17592, 7);
    @CAN_PrivMain::RFR_Object::RXX_Object_Obj33.ObjId = convertRawToPhysical(raw_value, 1.0, 0.0);

    raw_value=copyBitsFromByteArrayLE( byteArray, 17494, 9);
    @CAN_PrivMain::RFR_Object::RXX_Object_Obj33.OrientationYaw = convertRawToPhysical(raw_value, 0.0175, -4.48);

    raw_value=copyBitsFromByteArrayLE( byteArray, 17516, 12);
    @CAN_PrivMain::RFR_Object::RXX_Object_Obj33.OrientationYawVnce = convertRawToPhysical(raw_value, 0.0003, 0.0);

    raw_value=copyBitsFromByteArrayLE( byteArray, 17408, 6);
    @CAN_PrivMain::RFR_Object::RXX_Object_Obj33.ProbClassConfidence = convertRawToPhysical(raw_value, 2.0, 0.0);

    raw_value=copyBitsFromByteArrayLE( byteArray, 17659, 4);
    @CAN_PrivMain::RFR_Object::RXX_Object_Obj33.ProbClassType = convertRawToPhysical(raw_value, 1.0, 0.0);

    raw_value=copyBitsFromByteArrayLE( byteArray, 17414, 14);
    @CAN_PrivMain::RFR_Object::RXX_Object_Obj33.Px = convertRawToPhysical(raw_value, 0.0625, -512.0);

    raw_value=copyBitsFromByteArrayLE( byteArray, 17728, 12);
    @CAN_PrivMain::RFR_Object::RXX_Object_Obj33.PxAxCoVnce = convertRawToPhysical(raw_value, 0.01, 0.0);

    raw_value=copyBitsFromByteArrayLE( byteArray, 17740, 12);
    @CAN_PrivMain::RFR_Object::RXX_Object_Obj33.PxAyCoVnce = convertRawToPhysical(raw_value, 0.01, 0.0);

    raw_value=copyBitsFromByteArrayLE( byteArray, 17644, 12);
    @CAN_PrivMain::RFR_Object::RXX_Object_Obj33.PxPyCoVnce = convertRawToPhysical(raw_value, 0.01, 0.0);

    raw_value=copyBitsFromByteArrayLE( byteArray, 17428, 12);
    @CAN_PrivMain::RFR_Object::RXX_Object_Obj33.PxVnce = convertRawToPhysical(raw_value, 0.1, 0.0);

    raw_value=copyBitsFromByteArrayLE( byteArray, 17664, 12);
    @CAN_PrivMain::RFR_Object::RXX_Object_Obj33.PxVxCoVnce = convertRawToPhysical(raw_value, 0.01, 0.0);

    raw_value=copyBitsFromByteArrayLE( byteArray, 17676, 12);
    @CAN_PrivMain::RFR_Object::RXX_Object_Obj33.PxVyCoVnce = convertRawToPhysical(raw_value, 0.01, 0.0);

    raw_value=copyBitsFromByteArrayLE( byteArray, 17440, 12);
    @CAN_PrivMain::RFR_Object::RXX_Object_Obj33.Py = convertRawToPhysical(raw_value, 0.0625, -128.0);

    raw_value=copyBitsFromByteArrayLE( byteArray, 17760, 12);
    @CAN_PrivMain::RFR_Object::RXX_Object_Obj33.PyAxCoVnce = convertRawToPhysical(raw_value, 0.01, 0.0);

    raw_value=copyBitsFromByteArrayLE( byteArray, 17772, 12);
    @CAN_PrivMain::RFR_Object::RXX_Object_Obj33.PyAyCoVnce = convertRawToPhysical(raw_value, 0.01, 0.0);

    raw_value=copyBitsFromByteArrayLE( byteArray, 17452, 12);
    @CAN_PrivMain::RFR_Object::RXX_Object_Obj33.PyVnce = convertRawToPhysical(raw_value, 0.1, 0.0);

    raw_value=copyBitsFromByteArrayLE( byteArray, 17696, 12);
    @CAN_PrivMain::RFR_Object::RXX_Object_Obj33.PyVxCoVnce = convertRawToPhysical(raw_value, 0.01, 0.0);

    raw_value=copyBitsFromByteArrayLE( byteArray, 17708, 12);
    @CAN_PrivMain::RFR_Object::RXX_Object_Obj33.PyVyCoVnce = convertRawToPhysical(raw_value, 0.01, 0.0);

    raw_value=copyBitsFromByteArrayLE( byteArray, 17548, 10);
    @CAN_PrivMain::RFR_Object::RXX_Object_Obj33.RCS = convertRawToPhysical(raw_value, 0.2, -102.4);

    raw_value=copyBitsFromByteArrayLE( byteArray, 17720, 4);
    @CAN_PrivMain::RFR_Object::RXX_Object_Obj33.ReferencePoint = convertRawToPhysical(raw_value, 1.0, 0.0);

    raw_value=copyBitsFromByteArrayLE( byteArray, 17580, 12);
    @CAN_PrivMain::RFR_Object::RXX_Object_Obj33.Vx = convertRawToPhysical(raw_value, 0.0625, -128.0);

    raw_value=copyBitsFromByteArrayLE( byteArray, 17804, 12);
    @CAN_PrivMain::RFR_Object::RXX_Object_Obj33.VxAxCoVnce = convertRawToPhysical(raw_value, 0.01, 0.0);

    raw_value=copyBitsFromByteArrayLE( byteArray, 17824, 12);
    @CAN_PrivMain::RFR_Object::RXX_Object_Obj33.VxAyCoVnce = convertRawToPhysical(raw_value, 0.01, 0.0);

    raw_value=copyBitsFromByteArrayLE( byteArray, 17600, 12);
    @CAN_PrivMain::RFR_Object::RXX_Object_Obj33.VxVnce = convertRawToPhysical(raw_value, 0.01, 0.0);

    raw_value=copyBitsFromByteArrayLE( byteArray, 17792, 12);
    @CAN_PrivMain::RFR_Object::RXX_Object_Obj33.VxVyCoVnce = convertRawToPhysical(raw_value, 0.01, 0.0);

    raw_value=copyBitsFromByteArrayLE( byteArray, 17614, 10);
    @CAN_PrivMain::RFR_Object::RXX_Object_Obj33.Vy = convertRawToPhysical(raw_value, 0.125, -64.0);

    raw_value=copyBitsFromByteArrayLE( byteArray, 17836, 12);
    @CAN_PrivMain::RFR_Object::RXX_Object_Obj33.VyAxCoVnce = convertRawToPhysical(raw_value, 0.01, 0.0);

    raw_value=copyBitsFromByteArrayLE( byteArray, 17856, 12);
    @CAN_PrivMain::RFR_Object::RXX_Object_Obj33.VyAyCoVnce = convertRawToPhysical(raw_value, 0.01, 0.0);

    raw_value=copyBitsFromByteArrayLE( byteArray, 17632, 12);
    @CAN_PrivMain::RFR_Object::RXX_Object_Obj33.VyVnce = convertRawToPhysical(raw_value, 0.01, 0.0);

    raw_value=copyBitsFromByteArrayLE( byteArray, 17528, 7);
    @CAN_PrivMain::RFR_Object::RXX_Object_Obj33.Width = convertRawToPhysical(raw_value, 0.125, 0.0);

    raw_value=copyBitsFromByteArrayLE( byteArray, 17536, 12);
    @CAN_PrivMain::RFR_Object::RXX_Object_Obj33.WidthVnce = convertRawToPhysical(raw_value, 0.01, 0.0);
}


void CRadarFR_RXX_Object_Obj34_SetDataReceived(byte byteArray[])
{
    qword raw_value;

    raw_value=copyBitsFromByteArrayLE( byteArray, 18400, 32);
    @CAN_PrivMain::RFR_Object::RXX_Object_Obj34.Age = convertRawToPhysical(raw_value, 1.0, 0.0);

    raw_value=copyBitsFromByteArrayLE( byteArray, 17996, 10);
    @CAN_PrivMain::RFR_Object::RXX_Object_Obj34.Ax = convertRawToPhysical(raw_value, 0.03125, -16.0);

    raw_value=copyBitsFromByteArrayLE( byteArray, 18380, 12);
    @CAN_PrivMain::RFR_Object::RXX_Object_Obj34.AxAyCoVnce = convertRawToPhysical(raw_value, 0.01, 0.0);

    raw_value=copyBitsFromByteArrayLE( byteArray, 18016, 12);
    @CAN_PrivMain::RFR_Object::RXX_Object_Obj34.AxVnce = convertRawToPhysical(raw_value, 0.01, 0.0);

    raw_value=copyBitsFromByteArrayLE( byteArray, 18070, 9);
    @CAN_PrivMain::RFR_Object::RXX_Object_Obj34.Ay = convertRawToPhysical(raw_value, 0.0625, -16.0);

    raw_value=copyBitsFromByteArrayLE( byteArray, 18080, 12);
    @CAN_PrivMain::RFR_Object::RXX_Object_Obj34.AyVnce = convertRawToPhysical(raw_value, 0.01, 0.0);

    raw_value=copyBitsFromByteArrayLE( byteArray, 18136, 6);
    @CAN_PrivMain::RFR_Object::RXX_Object_Obj34.ExistProb = convertRawToPhysical(raw_value, 2.0, 0.0);

    raw_value=copyBitsFromByteArrayLE( byteArray, 18200, 8);
    @CAN_PrivMain::RFR_Object::RXX_Object_Obj34.FilterInformation = convertRawToPhysical(raw_value, 1.0, 0.0);

    raw_value=copyBitsFromByteArrayLE( byteArray, 17976, 7);
    @CAN_PrivMain::RFR_Object::RXX_Object_Obj34.Length = convertRawToPhysical(raw_value, 0.125, 0.0);

    raw_value=copyBitsFromByteArrayLE( byteArray, 17984, 12);
    @CAN_PrivMain::RFR_Object::RXX_Object_Obj34.LengthVnce = convertRawToPhysical(raw_value, 0.01, 0.0);

    raw_value=copyBitsFromByteArrayLE( byteArray, 18168, 3);
    @CAN_PrivMain::RFR_Object::RXX_Object_Obj34.MeasurementStatus = convertRawToPhysical(raw_value, 1.0, 0.0);

    raw_value=copyBitsFromByteArrayLE( byteArray, 18124, 2);
    @CAN_PrivMain::RFR_Object::RXX_Object_Obj34.MovingStatus = convertRawToPhysical(raw_value, 1.0, 0.0);

    raw_value=copyBitsFromByteArrayLE( byteArray, 18104, 7);
    @CAN_PrivMain::RFR_Object::RXX_Object_Obj34.ObjId = convertRawToPhysical(raw_value, 1.0, 0.0);

    raw_value=copyBitsFromByteArrayLE( byteArray, 18006, 9);
    @CAN_PrivMain::RFR_Object::RXX_Object_Obj34.OrientationYaw = convertRawToPhysical(raw_value, 0.0175, -4.48);

    raw_value=copyBitsFromByteArrayLE( byteArray, 18028, 12);
    @CAN_PrivMain::RFR_Object::RXX_Object_Obj34.OrientationYawVnce = convertRawToPhysical(raw_value, 0.0003, 0.0);

    raw_value=copyBitsFromByteArrayLE( byteArray, 17920, 6);
    @CAN_PrivMain::RFR_Object::RXX_Object_Obj34.ProbClassConfidence = convertRawToPhysical(raw_value, 2.0, 0.0);

    raw_value=copyBitsFromByteArrayLE( byteArray, 18171, 4);
    @CAN_PrivMain::RFR_Object::RXX_Object_Obj34.ProbClassType = convertRawToPhysical(raw_value, 1.0, 0.0);

    raw_value=copyBitsFromByteArrayLE( byteArray, 17926, 14);
    @CAN_PrivMain::RFR_Object::RXX_Object_Obj34.Px = convertRawToPhysical(raw_value, 0.0625, -512.0);

    raw_value=copyBitsFromByteArrayLE( byteArray, 18240, 12);
    @CAN_PrivMain::RFR_Object::RXX_Object_Obj34.PxAxCoVnce = convertRawToPhysical(raw_value, 0.01, 0.0);

    raw_value=copyBitsFromByteArrayLE( byteArray, 18252, 12);
    @CAN_PrivMain::RFR_Object::RXX_Object_Obj34.PxAyCoVnce = convertRawToPhysical(raw_value, 0.01, 0.0);

    raw_value=copyBitsFromByteArrayLE( byteArray, 18156, 12);
    @CAN_PrivMain::RFR_Object::RXX_Object_Obj34.PxPyCoVnce = convertRawToPhysical(raw_value, 0.01, 0.0);

    raw_value=copyBitsFromByteArrayLE( byteArray, 17940, 12);
    @CAN_PrivMain::RFR_Object::RXX_Object_Obj34.PxVnce = convertRawToPhysical(raw_value, 0.1, 0.0);

    raw_value=copyBitsFromByteArrayLE( byteArray, 18176, 12);
    @CAN_PrivMain::RFR_Object::RXX_Object_Obj34.PxVxCoVnce = convertRawToPhysical(raw_value, 0.01, 0.0);

    raw_value=copyBitsFromByteArrayLE( byteArray, 18188, 12);
    @CAN_PrivMain::RFR_Object::RXX_Object_Obj34.PxVyCoVnce = convertRawToPhysical(raw_value, 0.01, 0.0);

    raw_value=copyBitsFromByteArrayLE( byteArray, 17952, 12);
    @CAN_PrivMain::RFR_Object::RXX_Object_Obj34.Py = convertRawToPhysical(raw_value, 0.0625, -128.0);

    raw_value=copyBitsFromByteArrayLE( byteArray, 18272, 12);
    @CAN_PrivMain::RFR_Object::RXX_Object_Obj34.PyAxCoVnce = convertRawToPhysical(raw_value, 0.01, 0.0);

    raw_value=copyBitsFromByteArrayLE( byteArray, 18284, 12);
    @CAN_PrivMain::RFR_Object::RXX_Object_Obj34.PyAyCoVnce = convertRawToPhysical(raw_value, 0.01, 0.0);

    raw_value=copyBitsFromByteArrayLE( byteArray, 17964, 12);
    @CAN_PrivMain::RFR_Object::RXX_Object_Obj34.PyVnce = convertRawToPhysical(raw_value, 0.1, 0.0);

    raw_value=copyBitsFromByteArrayLE( byteArray, 18208, 12);
    @CAN_PrivMain::RFR_Object::RXX_Object_Obj34.PyVxCoVnce = convertRawToPhysical(raw_value, 0.01, 0.0);

    raw_value=copyBitsFromByteArrayLE( byteArray, 18220, 12);
    @CAN_PrivMain::RFR_Object::RXX_Object_Obj34.PyVyCoVnce = convertRawToPhysical(raw_value, 0.01, 0.0);

    raw_value=copyBitsFromByteArrayLE( byteArray, 18060, 10);
    @CAN_PrivMain::RFR_Object::RXX_Object_Obj34.RCS = convertRawToPhysical(raw_value, 0.2, -102.4);

    raw_value=copyBitsFromByteArrayLE( byteArray, 18232, 4);
    @CAN_PrivMain::RFR_Object::RXX_Object_Obj34.ReferencePoint = convertRawToPhysical(raw_value, 1.0, 0.0);

    raw_value=copyBitsFromByteArrayLE( byteArray, 18092, 12);
    @CAN_PrivMain::RFR_Object::RXX_Object_Obj34.Vx = convertRawToPhysical(raw_value, 0.0625, -128.0);

    raw_value=copyBitsFromByteArrayLE( byteArray, 18316, 12);
    @CAN_PrivMain::RFR_Object::RXX_Object_Obj34.VxAxCoVnce = convertRawToPhysical(raw_value, 0.01, 0.0);

    raw_value=copyBitsFromByteArrayLE( byteArray, 18336, 12);
    @CAN_PrivMain::RFR_Object::RXX_Object_Obj34.VxAyCoVnce = convertRawToPhysical(raw_value, 0.01, 0.0);

    raw_value=copyBitsFromByteArrayLE( byteArray, 18112, 12);
    @CAN_PrivMain::RFR_Object::RXX_Object_Obj34.VxVnce = convertRawToPhysical(raw_value, 0.01, 0.0);

    raw_value=copyBitsFromByteArrayLE( byteArray, 18304, 12);
    @CAN_PrivMain::RFR_Object::RXX_Object_Obj34.VxVyCoVnce = convertRawToPhysical(raw_value, 0.01, 0.0);

    raw_value=copyBitsFromByteArrayLE( byteArray, 18126, 10);
    @CAN_PrivMain::RFR_Object::RXX_Object_Obj34.Vy = convertRawToPhysical(raw_value, 0.125, -64.0);

    raw_value=copyBitsFromByteArrayLE( byteArray, 18348, 12);
    @CAN_PrivMain::RFR_Object::RXX_Object_Obj34.VyAxCoVnce = convertRawToPhysical(raw_value, 0.01, 0.0);

    raw_value=copyBitsFromByteArrayLE( byteArray, 18368, 12);
    @CAN_PrivMain::RFR_Object::RXX_Object_Obj34.VyAyCoVnce = convertRawToPhysical(raw_value, 0.01, 0.0);

    raw_value=copyBitsFromByteArrayLE( byteArray, 18144, 12);
    @CAN_PrivMain::RFR_Object::RXX_Object_Obj34.VyVnce = convertRawToPhysical(raw_value, 0.01, 0.0);

    raw_value=copyBitsFromByteArrayLE( byteArray, 18040, 7);
    @CAN_PrivMain::RFR_Object::RXX_Object_Obj34.Width = convertRawToPhysical(raw_value, 0.125, 0.0);

    raw_value=copyBitsFromByteArrayLE( byteArray, 18048, 12);
    @CAN_PrivMain::RFR_Object::RXX_Object_Obj34.WidthVnce = convertRawToPhysical(raw_value, 0.01, 0.0);
}


void CRadarFR_RXX_Object_Obj35_SetDataReceived(byte byteArray[])
{
    qword raw_value;

    raw_value=copyBitsFromByteArrayLE( byteArray, 18912, 32);
    @CAN_PrivMain::RFR_Object::RXX_Object_Obj35.Age = convertRawToPhysical(raw_value, 1.0, 0.0);

    raw_value=copyBitsFromByteArrayLE( byteArray, 18508, 10);
    @CAN_PrivMain::RFR_Object::RXX_Object_Obj35.Ax = convertRawToPhysical(raw_value, 0.03125, -16.0);

    raw_value=copyBitsFromByteArrayLE( byteArray, 18892, 12);
    @CAN_PrivMain::RFR_Object::RXX_Object_Obj35.AxAyCoVnce = convertRawToPhysical(raw_value, 0.01, 0.0);

    raw_value=copyBitsFromByteArrayLE( byteArray, 18528, 12);
    @CAN_PrivMain::RFR_Object::RXX_Object_Obj35.AxVnce = convertRawToPhysical(raw_value, 0.01, 0.0);

    raw_value=copyBitsFromByteArrayLE( byteArray, 18582, 9);
    @CAN_PrivMain::RFR_Object::RXX_Object_Obj35.Ay = convertRawToPhysical(raw_value, 0.0625, -16.0);

    raw_value=copyBitsFromByteArrayLE( byteArray, 18592, 12);
    @CAN_PrivMain::RFR_Object::RXX_Object_Obj35.AyVnce = convertRawToPhysical(raw_value, 0.01, 0.0);

    raw_value=copyBitsFromByteArrayLE( byteArray, 18648, 6);
    @CAN_PrivMain::RFR_Object::RXX_Object_Obj35.ExistProb = convertRawToPhysical(raw_value, 2.0, 0.0);

    raw_value=copyBitsFromByteArrayLE( byteArray, 18712, 8);
    @CAN_PrivMain::RFR_Object::RXX_Object_Obj35.FilterInformation = convertRawToPhysical(raw_value, 1.0, 0.0);

    raw_value=copyBitsFromByteArrayLE( byteArray, 18488, 7);
    @CAN_PrivMain::RFR_Object::RXX_Object_Obj35.Length = convertRawToPhysical(raw_value, 0.125, 0.0);

    raw_value=copyBitsFromByteArrayLE( byteArray, 18496, 12);
    @CAN_PrivMain::RFR_Object::RXX_Object_Obj35.LengthVnce = convertRawToPhysical(raw_value, 0.01, 0.0);

    raw_value=copyBitsFromByteArrayLE( byteArray, 18680, 3);
    @CAN_PrivMain::RFR_Object::RXX_Object_Obj35.MeasurementStatus = convertRawToPhysical(raw_value, 1.0, 0.0);

    raw_value=copyBitsFromByteArrayLE( byteArray, 18636, 2);
    @CAN_PrivMain::RFR_Object::RXX_Object_Obj35.MovingStatus = convertRawToPhysical(raw_value, 1.0, 0.0);

    raw_value=copyBitsFromByteArrayLE( byteArray, 18616, 7);
    @CAN_PrivMain::RFR_Object::RXX_Object_Obj35.ObjId = convertRawToPhysical(raw_value, 1.0, 0.0);

    raw_value=copyBitsFromByteArrayLE( byteArray, 18518, 9);
    @CAN_PrivMain::RFR_Object::RXX_Object_Obj35.OrientationYaw = convertRawToPhysical(raw_value, 0.0175, -4.48);

    raw_value=copyBitsFromByteArrayLE( byteArray, 18540, 12);
    @CAN_PrivMain::RFR_Object::RXX_Object_Obj35.OrientationYawVnce = convertRawToPhysical(raw_value, 0.0003, 0.0);

    raw_value=copyBitsFromByteArrayLE( byteArray, 18432, 6);
    @CAN_PrivMain::RFR_Object::RXX_Object_Obj35.ProbClassConfidence = convertRawToPhysical(raw_value, 2.0, 0.0);

    raw_value=copyBitsFromByteArrayLE( byteArray, 18683, 4);
    @CAN_PrivMain::RFR_Object::RXX_Object_Obj35.ProbClassType = convertRawToPhysical(raw_value, 1.0, 0.0);

    raw_value=copyBitsFromByteArrayLE( byteArray, 18438, 14);
    @CAN_PrivMain::RFR_Object::RXX_Object_Obj35.Px = convertRawToPhysical(raw_value, 0.0625, -512.0);

    raw_value=copyBitsFromByteArrayLE( byteArray, 18752, 12);
    @CAN_PrivMain::RFR_Object::RXX_Object_Obj35.PxAxCoVnce = convertRawToPhysical(raw_value, 0.01, 0.0);

    raw_value=copyBitsFromByteArrayLE( byteArray, 18764, 12);
    @CAN_PrivMain::RFR_Object::RXX_Object_Obj35.PxAyCoVnce = convertRawToPhysical(raw_value, 0.01, 0.0);

    raw_value=copyBitsFromByteArrayLE( byteArray, 18668, 12);
    @CAN_PrivMain::RFR_Object::RXX_Object_Obj35.PxPyCoVnce = convertRawToPhysical(raw_value, 0.01, 0.0);

    raw_value=copyBitsFromByteArrayLE( byteArray, 18452, 12);
    @CAN_PrivMain::RFR_Object::RXX_Object_Obj35.PxVnce = convertRawToPhysical(raw_value, 0.1, 0.0);

    raw_value=copyBitsFromByteArrayLE( byteArray, 18688, 12);
    @CAN_PrivMain::RFR_Object::RXX_Object_Obj35.PxVxCoVnce = convertRawToPhysical(raw_value, 0.01, 0.0);

    raw_value=copyBitsFromByteArrayLE( byteArray, 18700, 12);
    @CAN_PrivMain::RFR_Object::RXX_Object_Obj35.PxVyCoVnce = convertRawToPhysical(raw_value, 0.01, 0.0);

    raw_value=copyBitsFromByteArrayLE( byteArray, 18464, 12);
    @CAN_PrivMain::RFR_Object::RXX_Object_Obj35.Py = convertRawToPhysical(raw_value, 0.0625, -128.0);

    raw_value=copyBitsFromByteArrayLE( byteArray, 18784, 12);
    @CAN_PrivMain::RFR_Object::RXX_Object_Obj35.PyAxCoVnce = convertRawToPhysical(raw_value, 0.01, 0.0);

    raw_value=copyBitsFromByteArrayLE( byteArray, 18796, 12);
    @CAN_PrivMain::RFR_Object::RXX_Object_Obj35.PyAyCoVnce = convertRawToPhysical(raw_value, 0.01, 0.0);

    raw_value=copyBitsFromByteArrayLE( byteArray, 18476, 12);
    @CAN_PrivMain::RFR_Object::RXX_Object_Obj35.PyVnce = convertRawToPhysical(raw_value, 0.1, 0.0);

    raw_value=copyBitsFromByteArrayLE( byteArray, 18720, 12);
    @CAN_PrivMain::RFR_Object::RXX_Object_Obj35.PyVxCoVnce = convertRawToPhysical(raw_value, 0.01, 0.0);

    raw_value=copyBitsFromByteArrayLE( byteArray, 18732, 12);
    @CAN_PrivMain::RFR_Object::RXX_Object_Obj35.PyVyCoVnce = convertRawToPhysical(raw_value, 0.01, 0.0);

    raw_value=copyBitsFromByteArrayLE( byteArray, 18572, 10);
    @CAN_PrivMain::RFR_Object::RXX_Object_Obj35.RCS = convertRawToPhysical(raw_value, 0.2, -102.4);

    raw_value=copyBitsFromByteArrayLE( byteArray, 18744, 4);
    @CAN_PrivMain::RFR_Object::RXX_Object_Obj35.ReferencePoint = convertRawToPhysical(raw_value, 1.0, 0.0);

    raw_value=copyBitsFromByteArrayLE( byteArray, 18604, 12);
    @CAN_PrivMain::RFR_Object::RXX_Object_Obj35.Vx = convertRawToPhysical(raw_value, 0.0625, -128.0);

    raw_value=copyBitsFromByteArrayLE( byteArray, 18828, 12);
    @CAN_PrivMain::RFR_Object::RXX_Object_Obj35.VxAxCoVnce = convertRawToPhysical(raw_value, 0.01, 0.0);

    raw_value=copyBitsFromByteArrayLE( byteArray, 18848, 12);
    @CAN_PrivMain::RFR_Object::RXX_Object_Obj35.VxAyCoVnce = convertRawToPhysical(raw_value, 0.01, 0.0);

    raw_value=copyBitsFromByteArrayLE( byteArray, 18624, 12);
    @CAN_PrivMain::RFR_Object::RXX_Object_Obj35.VxVnce = convertRawToPhysical(raw_value, 0.01, 0.0);

    raw_value=copyBitsFromByteArrayLE( byteArray, 18816, 12);
    @CAN_PrivMain::RFR_Object::RXX_Object_Obj35.VxVyCoVnce = convertRawToPhysical(raw_value, 0.01, 0.0);

    raw_value=copyBitsFromByteArrayLE( byteArray, 18638, 10);
    @CAN_PrivMain::RFR_Object::RXX_Object_Obj35.Vy = convertRawToPhysical(raw_value, 0.125, -64.0);

    raw_value=copyBitsFromByteArrayLE( byteArray, 18860, 12);
    @CAN_PrivMain::RFR_Object::RXX_Object_Obj35.VyAxCoVnce = convertRawToPhysical(raw_value, 0.01, 0.0);

    raw_value=copyBitsFromByteArrayLE( byteArray, 18880, 12);
    @CAN_PrivMain::RFR_Object::RXX_Object_Obj35.VyAyCoVnce = convertRawToPhysical(raw_value, 0.01, 0.0);

    raw_value=copyBitsFromByteArrayLE( byteArray, 18656, 12);
    @CAN_PrivMain::RFR_Object::RXX_Object_Obj35.VyVnce = convertRawToPhysical(raw_value, 0.01, 0.0);

    raw_value=copyBitsFromByteArrayLE( byteArray, 18552, 7);
    @CAN_PrivMain::RFR_Object::RXX_Object_Obj35.Width = convertRawToPhysical(raw_value, 0.125, 0.0);

    raw_value=copyBitsFromByteArrayLE( byteArray, 18560, 12);
    @CAN_PrivMain::RFR_Object::RXX_Object_Obj35.WidthVnce = convertRawToPhysical(raw_value, 0.01, 0.0);
}


void CRadarFR_RXX_Object_Obj36_SetDataReceived(byte byteArray[])
{
    qword raw_value;

    raw_value=copyBitsFromByteArrayLE( byteArray, 19424, 32);
    @CAN_PrivMain::RFR_Object::RXX_Object_Obj36.Age = convertRawToPhysical(raw_value, 1.0, 0.0);

    raw_value=copyBitsFromByteArrayLE( byteArray, 19020, 10);
    @CAN_PrivMain::RFR_Object::RXX_Object_Obj36.Ax = convertRawToPhysical(raw_value, 0.03125, -16.0);

    raw_value=copyBitsFromByteArrayLE( byteArray, 19404, 12);
    @CAN_PrivMain::RFR_Object::RXX_Object_Obj36.AxAyCoVnce = convertRawToPhysical(raw_value, 0.01, 0.0);

    raw_value=copyBitsFromByteArrayLE( byteArray, 19040, 12);
    @CAN_PrivMain::RFR_Object::RXX_Object_Obj36.AxVnce = convertRawToPhysical(raw_value, 0.01, 0.0);

    raw_value=copyBitsFromByteArrayLE( byteArray, 19094, 9);
    @CAN_PrivMain::RFR_Object::RXX_Object_Obj36.Ay = convertRawToPhysical(raw_value, 0.0625, -16.0);

    raw_value=copyBitsFromByteArrayLE( byteArray, 19104, 12);
    @CAN_PrivMain::RFR_Object::RXX_Object_Obj36.AyVnce = convertRawToPhysical(raw_value, 0.01, 0.0);

    raw_value=copyBitsFromByteArrayLE( byteArray, 19160, 6);
    @CAN_PrivMain::RFR_Object::RXX_Object_Obj36.ExistProb = convertRawToPhysical(raw_value, 2.0, 0.0);

    raw_value=copyBitsFromByteArrayLE( byteArray, 19224, 8);
    @CAN_PrivMain::RFR_Object::RXX_Object_Obj36.FilterInformation = convertRawToPhysical(raw_value, 1.0, 0.0);

    raw_value=copyBitsFromByteArrayLE( byteArray, 19000, 7);
    @CAN_PrivMain::RFR_Object::RXX_Object_Obj36.Length = convertRawToPhysical(raw_value, 0.125, 0.0);

    raw_value=copyBitsFromByteArrayLE( byteArray, 19008, 12);
    @CAN_PrivMain::RFR_Object::RXX_Object_Obj36.LengthVnce = convertRawToPhysical(raw_value, 0.01, 0.0);

    raw_value=copyBitsFromByteArrayLE( byteArray, 19192, 3);
    @CAN_PrivMain::RFR_Object::RXX_Object_Obj36.MeasurementStatus = convertRawToPhysical(raw_value, 1.0, 0.0);

    raw_value=copyBitsFromByteArrayLE( byteArray, 19148, 2);
    @CAN_PrivMain::RFR_Object::RXX_Object_Obj36.MovingStatus = convertRawToPhysical(raw_value, 1.0, 0.0);

    raw_value=copyBitsFromByteArrayLE( byteArray, 19128, 7);
    @CAN_PrivMain::RFR_Object::RXX_Object_Obj36.ObjId = convertRawToPhysical(raw_value, 1.0, 0.0);

    raw_value=copyBitsFromByteArrayLE( byteArray, 19030, 9);
    @CAN_PrivMain::RFR_Object::RXX_Object_Obj36.OrientationYaw = convertRawToPhysical(raw_value, 0.0175, -4.48);

    raw_value=copyBitsFromByteArrayLE( byteArray, 19052, 12);
    @CAN_PrivMain::RFR_Object::RXX_Object_Obj36.OrientationYawVnce = convertRawToPhysical(raw_value, 0.0003, 0.0);

    raw_value=copyBitsFromByteArrayLE( byteArray, 18944, 6);
    @CAN_PrivMain::RFR_Object::RXX_Object_Obj36.ProbClassConfidence = convertRawToPhysical(raw_value, 2.0, 0.0);

    raw_value=copyBitsFromByteArrayLE( byteArray, 19195, 4);
    @CAN_PrivMain::RFR_Object::RXX_Object_Obj36.ProbClassType = convertRawToPhysical(raw_value, 1.0, 0.0);

    raw_value=copyBitsFromByteArrayLE( byteArray, 18950, 14);
    @CAN_PrivMain::RFR_Object::RXX_Object_Obj36.Px = convertRawToPhysical(raw_value, 0.0625, -512.0);

    raw_value=copyBitsFromByteArrayLE( byteArray, 19264, 12);
    @CAN_PrivMain::RFR_Object::RXX_Object_Obj36.PxAxCoVnce = convertRawToPhysical(raw_value, 0.01, 0.0);

    raw_value=copyBitsFromByteArrayLE( byteArray, 19276, 12);
    @CAN_PrivMain::RFR_Object::RXX_Object_Obj36.PxAyCoVnce = convertRawToPhysical(raw_value, 0.01, 0.0);

    raw_value=copyBitsFromByteArrayLE( byteArray, 19180, 12);
    @CAN_PrivMain::RFR_Object::RXX_Object_Obj36.PxPyCoVnce = convertRawToPhysical(raw_value, 0.01, 0.0);

    raw_value=copyBitsFromByteArrayLE( byteArray, 18964, 12);
    @CAN_PrivMain::RFR_Object::RXX_Object_Obj36.PxVnce = convertRawToPhysical(raw_value, 0.1, 0.0);

    raw_value=copyBitsFromByteArrayLE( byteArray, 19200, 12);
    @CAN_PrivMain::RFR_Object::RXX_Object_Obj36.PxVxCoVnce = convertRawToPhysical(raw_value, 0.01, 0.0);

    raw_value=copyBitsFromByteArrayLE( byteArray, 19212, 12);
    @CAN_PrivMain::RFR_Object::RXX_Object_Obj36.PxVyCoVnce = convertRawToPhysical(raw_value, 0.01, 0.0);

    raw_value=copyBitsFromByteArrayLE( byteArray, 18976, 12);
    @CAN_PrivMain::RFR_Object::RXX_Object_Obj36.Py = convertRawToPhysical(raw_value, 0.0625, -128.0);

    raw_value=copyBitsFromByteArrayLE( byteArray, 19296, 12);
    @CAN_PrivMain::RFR_Object::RXX_Object_Obj36.PyAxCoVnce = convertRawToPhysical(raw_value, 0.01, 0.0);

    raw_value=copyBitsFromByteArrayLE( byteArray, 19308, 12);
    @CAN_PrivMain::RFR_Object::RXX_Object_Obj36.PyAyCoVnce = convertRawToPhysical(raw_value, 0.01, 0.0);

    raw_value=copyBitsFromByteArrayLE( byteArray, 18988, 12);
    @CAN_PrivMain::RFR_Object::RXX_Object_Obj36.PyVnce = convertRawToPhysical(raw_value, 0.1, 0.0);

    raw_value=copyBitsFromByteArrayLE( byteArray, 19232, 12);
    @CAN_PrivMain::RFR_Object::RXX_Object_Obj36.PyVxCoVnce = convertRawToPhysical(raw_value, 0.01, 0.0);

    raw_value=copyBitsFromByteArrayLE( byteArray, 19244, 12);
    @CAN_PrivMain::RFR_Object::RXX_Object_Obj36.PyVyCoVnce = convertRawToPhysical(raw_value, 0.01, 0.0);

    raw_value=copyBitsFromByteArrayLE( byteArray, 19084, 10);
    @CAN_PrivMain::RFR_Object::RXX_Object_Obj36.RCS = convertRawToPhysical(raw_value, 0.2, -102.4);

    raw_value=copyBitsFromByteArrayLE( byteArray, 19256, 4);
    @CAN_PrivMain::RFR_Object::RXX_Object_Obj36.ReferencePoint = convertRawToPhysical(raw_value, 1.0, 0.0);

    raw_value=copyBitsFromByteArrayLE( byteArray, 19116, 12);
    @CAN_PrivMain::RFR_Object::RXX_Object_Obj36.Vx = convertRawToPhysical(raw_value, 0.0625, -128.0);

    raw_value=copyBitsFromByteArrayLE( byteArray, 19340, 12);
    @CAN_PrivMain::RFR_Object::RXX_Object_Obj36.VxAxCoVnce = convertRawToPhysical(raw_value, 0.01, 0.0);

    raw_value=copyBitsFromByteArrayLE( byteArray, 19360, 12);
    @CAN_PrivMain::RFR_Object::RXX_Object_Obj36.VxAyCoVnce = convertRawToPhysical(raw_value, 0.01, 0.0);

    raw_value=copyBitsFromByteArrayLE( byteArray, 19136, 12);
    @CAN_PrivMain::RFR_Object::RXX_Object_Obj36.VxVnce = convertRawToPhysical(raw_value, 0.01, 0.0);

    raw_value=copyBitsFromByteArrayLE( byteArray, 19328, 12);
    @CAN_PrivMain::RFR_Object::RXX_Object_Obj36.VxVyCoVnce = convertRawToPhysical(raw_value, 0.01, 0.0);

    raw_value=copyBitsFromByteArrayLE( byteArray, 19150, 10);
    @CAN_PrivMain::RFR_Object::RXX_Object_Obj36.Vy = convertRawToPhysical(raw_value, 0.125, -64.0);

    raw_value=copyBitsFromByteArrayLE( byteArray, 19372, 12);
    @CAN_PrivMain::RFR_Object::RXX_Object_Obj36.VyAxCoVnce = convertRawToPhysical(raw_value, 0.01, 0.0);

    raw_value=copyBitsFromByteArrayLE( byteArray, 19392, 12);
    @CAN_PrivMain::RFR_Object::RXX_Object_Obj36.VyAyCoVnce = convertRawToPhysical(raw_value, 0.01, 0.0);

    raw_value=copyBitsFromByteArrayLE( byteArray, 19168, 12);
    @CAN_PrivMain::RFR_Object::RXX_Object_Obj36.VyVnce = convertRawToPhysical(raw_value, 0.01, 0.0);

    raw_value=copyBitsFromByteArrayLE( byteArray, 19064, 7);
    @CAN_PrivMain::RFR_Object::RXX_Object_Obj36.Width = convertRawToPhysical(raw_value, 0.125, 0.0);

    raw_value=copyBitsFromByteArrayLE( byteArray, 19072, 12);
    @CAN_PrivMain::RFR_Object::RXX_Object_Obj36.WidthVnce = convertRawToPhysical(raw_value, 0.01, 0.0);
}


void CRadarFR_RXX_Object_Obj37_SetDataReceived(byte byteArray[])
{
    qword raw_value;

    raw_value=copyBitsFromByteArrayLE( byteArray, 19936, 32);
    @CAN_PrivMain::RFR_Object::RXX_Object_Obj37.Age = convertRawToPhysical(raw_value, 1.0, 0.0);

    raw_value=copyBitsFromByteArrayLE( byteArray, 19532, 10);
    @CAN_PrivMain::RFR_Object::RXX_Object_Obj37.Ax = convertRawToPhysical(raw_value, 0.03125, -16.0);

    raw_value=copyBitsFromByteArrayLE( byteArray, 19916, 12);
    @CAN_PrivMain::RFR_Object::RXX_Object_Obj37.AxAyCoVnce = convertRawToPhysical(raw_value, 0.01, 0.0);

    raw_value=copyBitsFromByteArrayLE( byteArray, 19552, 12);
    @CAN_PrivMain::RFR_Object::RXX_Object_Obj37.AxVnce = convertRawToPhysical(raw_value, 0.01, 0.0);

    raw_value=copyBitsFromByteArrayLE( byteArray, 19606, 9);
    @CAN_PrivMain::RFR_Object::RXX_Object_Obj37.Ay = convertRawToPhysical(raw_value, 0.0625, -16.0);

    raw_value=copyBitsFromByteArrayLE( byteArray, 19616, 12);
    @CAN_PrivMain::RFR_Object::RXX_Object_Obj37.AyVnce = convertRawToPhysical(raw_value, 0.01, 0.0);

    raw_value=copyBitsFromByteArrayLE( byteArray, 19672, 6);
    @CAN_PrivMain::RFR_Object::RXX_Object_Obj37.ExistProb = convertRawToPhysical(raw_value, 2.0, 0.0);

    raw_value=copyBitsFromByteArrayLE( byteArray, 19736, 8);
    @CAN_PrivMain::RFR_Object::RXX_Object_Obj37.FilterInformation = convertRawToPhysical(raw_value, 1.0, 0.0);

    raw_value=copyBitsFromByteArrayLE( byteArray, 19512, 7);
    @CAN_PrivMain::RFR_Object::RXX_Object_Obj37.Length = convertRawToPhysical(raw_value, 0.125, 0.0);

    raw_value=copyBitsFromByteArrayLE( byteArray, 19520, 12);
    @CAN_PrivMain::RFR_Object::RXX_Object_Obj37.LengthVnce = convertRawToPhysical(raw_value, 0.01, 0.0);

    raw_value=copyBitsFromByteArrayLE( byteArray, 19704, 3);
    @CAN_PrivMain::RFR_Object::RXX_Object_Obj37.MeasurementStatus = convertRawToPhysical(raw_value, 1.0, 0.0);

    raw_value=copyBitsFromByteArrayLE( byteArray, 19660, 2);
    @CAN_PrivMain::RFR_Object::RXX_Object_Obj37.MovingStatus = convertRawToPhysical(raw_value, 1.0, 0.0);

    raw_value=copyBitsFromByteArrayLE( byteArray, 19640, 7);
    @CAN_PrivMain::RFR_Object::RXX_Object_Obj37.ObjId = convertRawToPhysical(raw_value, 1.0, 0.0);

    raw_value=copyBitsFromByteArrayLE( byteArray, 19542, 9);
    @CAN_PrivMain::RFR_Object::RXX_Object_Obj37.OrientationYaw = convertRawToPhysical(raw_value, 0.0175, -4.48);

    raw_value=copyBitsFromByteArrayLE( byteArray, 19564, 12);
    @CAN_PrivMain::RFR_Object::RXX_Object_Obj37.OrientationYawVnce = convertRawToPhysical(raw_value, 0.0003, 0.0);

    raw_value=copyBitsFromByteArrayLE( byteArray, 19456, 6);
    @CAN_PrivMain::RFR_Object::RXX_Object_Obj37.ProbClassConfidence = convertRawToPhysical(raw_value, 2.0, 0.0);

    raw_value=copyBitsFromByteArrayLE( byteArray, 19707, 4);
    @CAN_PrivMain::RFR_Object::RXX_Object_Obj37.ProbClassType = convertRawToPhysical(raw_value, 1.0, 0.0);

    raw_value=copyBitsFromByteArrayLE( byteArray, 19462, 14);
    @CAN_PrivMain::RFR_Object::RXX_Object_Obj37.Px = convertRawToPhysical(raw_value, 0.0625, -512.0);

    raw_value=copyBitsFromByteArrayLE( byteArray, 19776, 12);
    @CAN_PrivMain::RFR_Object::RXX_Object_Obj37.PxAxCoVnce = convertRawToPhysical(raw_value, 0.01, 0.0);

    raw_value=copyBitsFromByteArrayLE( byteArray, 19788, 12);
    @CAN_PrivMain::RFR_Object::RXX_Object_Obj37.PxAyCoVnce = convertRawToPhysical(raw_value, 0.01, 0.0);

    raw_value=copyBitsFromByteArrayLE( byteArray, 19692, 12);
    @CAN_PrivMain::RFR_Object::RXX_Object_Obj37.PxPyCoVnce = convertRawToPhysical(raw_value, 0.01, 0.0);

    raw_value=copyBitsFromByteArrayLE( byteArray, 19476, 12);
    @CAN_PrivMain::RFR_Object::RXX_Object_Obj37.PxVnce = convertRawToPhysical(raw_value, 0.1, 0.0);

    raw_value=copyBitsFromByteArrayLE( byteArray, 19712, 12);
    @CAN_PrivMain::RFR_Object::RXX_Object_Obj37.PxVxCoVnce = convertRawToPhysical(raw_value, 0.01, 0.0);

    raw_value=copyBitsFromByteArrayLE( byteArray, 19724, 12);
    @CAN_PrivMain::RFR_Object::RXX_Object_Obj37.PxVyCoVnce = convertRawToPhysical(raw_value, 0.01, 0.0);

    raw_value=copyBitsFromByteArrayLE( byteArray, 19488, 12);
    @CAN_PrivMain::RFR_Object::RXX_Object_Obj37.Py = convertRawToPhysical(raw_value, 0.0625, -128.0);

    raw_value=copyBitsFromByteArrayLE( byteArray, 19808, 12);
    @CAN_PrivMain::RFR_Object::RXX_Object_Obj37.PyAxCoVnce = convertRawToPhysical(raw_value, 0.01, 0.0);

    raw_value=copyBitsFromByteArrayLE( byteArray, 19820, 12);
    @CAN_PrivMain::RFR_Object::RXX_Object_Obj37.PyAyCoVnce = convertRawToPhysical(raw_value, 0.01, 0.0);

    raw_value=copyBitsFromByteArrayLE( byteArray, 19500, 12);
    @CAN_PrivMain::RFR_Object::RXX_Object_Obj37.PyVnce = convertRawToPhysical(raw_value, 0.1, 0.0);

    raw_value=copyBitsFromByteArrayLE( byteArray, 19744, 12);
    @CAN_PrivMain::RFR_Object::RXX_Object_Obj37.PyVxCoVnce = convertRawToPhysical(raw_value, 0.01, 0.0);

    raw_value=copyBitsFromByteArrayLE( byteArray, 19756, 12);
    @CAN_PrivMain::RFR_Object::RXX_Object_Obj37.PyVyCoVnce = convertRawToPhysical(raw_value, 0.01, 0.0);

    raw_value=copyBitsFromByteArrayLE( byteArray, 19596, 10);
    @CAN_PrivMain::RFR_Object::RXX_Object_Obj37.RCS = convertRawToPhysical(raw_value, 0.2, -102.4);

    raw_value=copyBitsFromByteArrayLE( byteArray, 19768, 4);
    @CAN_PrivMain::RFR_Object::RXX_Object_Obj37.ReferencePoint = convertRawToPhysical(raw_value, 1.0, 0.0);

    raw_value=copyBitsFromByteArrayLE( byteArray, 19628, 12);
    @CAN_PrivMain::RFR_Object::RXX_Object_Obj37.Vx = convertRawToPhysical(raw_value, 0.0625, -128.0);

    raw_value=copyBitsFromByteArrayLE( byteArray, 19852, 12);
    @CAN_PrivMain::RFR_Object::RXX_Object_Obj37.VxAxCoVnce = convertRawToPhysical(raw_value, 0.01, 0.0);

    raw_value=copyBitsFromByteArrayLE( byteArray, 19872, 12);
    @CAN_PrivMain::RFR_Object::RXX_Object_Obj37.VxAyCoVnce = convertRawToPhysical(raw_value, 0.01, 0.0);

    raw_value=copyBitsFromByteArrayLE( byteArray, 19648, 12);
    @CAN_PrivMain::RFR_Object::RXX_Object_Obj37.VxVnce = convertRawToPhysical(raw_value, 0.01, 0.0);

    raw_value=copyBitsFromByteArrayLE( byteArray, 19840, 12);
    @CAN_PrivMain::RFR_Object::RXX_Object_Obj37.VxVyCoVnce = convertRawToPhysical(raw_value, 0.01, 0.0);

    raw_value=copyBitsFromByteArrayLE( byteArray, 19662, 10);
    @CAN_PrivMain::RFR_Object::RXX_Object_Obj37.Vy = convertRawToPhysical(raw_value, 0.125, -64.0);

    raw_value=copyBitsFromByteArrayLE( byteArray, 19884, 12);
    @CAN_PrivMain::RFR_Object::RXX_Object_Obj37.VyAxCoVnce = convertRawToPhysical(raw_value, 0.01, 0.0);

    raw_value=copyBitsFromByteArrayLE( byteArray, 19904, 12);
    @CAN_PrivMain::RFR_Object::RXX_Object_Obj37.VyAyCoVnce = convertRawToPhysical(raw_value, 0.01, 0.0);

    raw_value=copyBitsFromByteArrayLE( byteArray, 19680, 12);
    @CAN_PrivMain::RFR_Object::RXX_Object_Obj37.VyVnce = convertRawToPhysical(raw_value, 0.01, 0.0);

    raw_value=copyBitsFromByteArrayLE( byteArray, 19576, 7);
    @CAN_PrivMain::RFR_Object::RXX_Object_Obj37.Width = convertRawToPhysical(raw_value, 0.125, 0.0);

    raw_value=copyBitsFromByteArrayLE( byteArray, 19584, 12);
    @CAN_PrivMain::RFR_Object::RXX_Object_Obj37.WidthVnce = convertRawToPhysical(raw_value, 0.01, 0.0);
}


void CRadarFR_RXX_Object_Obj38_SetDataReceived(byte byteArray[])
{
    qword raw_value;

    raw_value=copyBitsFromByteArrayLE( byteArray, 20448, 32);
    @CAN_PrivMain::RFR_Object::RXX_Object_Obj38.Age = convertRawToPhysical(raw_value, 1.0, 0.0);

    raw_value=copyBitsFromByteArrayLE( byteArray, 20044, 10);
    @CAN_PrivMain::RFR_Object::RXX_Object_Obj38.Ax = convertRawToPhysical(raw_value, 0.03125, -16.0);

    raw_value=copyBitsFromByteArrayLE( byteArray, 20428, 12);
    @CAN_PrivMain::RFR_Object::RXX_Object_Obj38.AxAyCoVnce = convertRawToPhysical(raw_value, 0.01, 0.0);

    raw_value=copyBitsFromByteArrayLE( byteArray, 20064, 12);
    @CAN_PrivMain::RFR_Object::RXX_Object_Obj38.AxVnce = convertRawToPhysical(raw_value, 0.01, 0.0);

    raw_value=copyBitsFromByteArrayLE( byteArray, 20118, 9);
    @CAN_PrivMain::RFR_Object::RXX_Object_Obj38.Ay = convertRawToPhysical(raw_value, 0.0625, -16.0);

    raw_value=copyBitsFromByteArrayLE( byteArray, 20128, 12);
    @CAN_PrivMain::RFR_Object::RXX_Object_Obj38.AyVnce = convertRawToPhysical(raw_value, 0.01, 0.0);

    raw_value=copyBitsFromByteArrayLE( byteArray, 20184, 6);
    @CAN_PrivMain::RFR_Object::RXX_Object_Obj38.ExistProb = convertRawToPhysical(raw_value, 2.0, 0.0);

    raw_value=copyBitsFromByteArrayLE( byteArray, 20248, 8);
    @CAN_PrivMain::RFR_Object::RXX_Object_Obj38.FilterInformation = convertRawToPhysical(raw_value, 1.0, 0.0);

    raw_value=copyBitsFromByteArrayLE( byteArray, 20024, 7);
    @CAN_PrivMain::RFR_Object::RXX_Object_Obj38.Length = convertRawToPhysical(raw_value, 0.125, 0.0);

    raw_value=copyBitsFromByteArrayLE( byteArray, 20032, 12);
    @CAN_PrivMain::RFR_Object::RXX_Object_Obj38.LengthVnce = convertRawToPhysical(raw_value, 0.01, 0.0);

    raw_value=copyBitsFromByteArrayLE( byteArray, 20216, 3);
    @CAN_PrivMain::RFR_Object::RXX_Object_Obj38.MeasurementStatus = convertRawToPhysical(raw_value, 1.0, 0.0);

    raw_value=copyBitsFromByteArrayLE( byteArray, 20172, 2);
    @CAN_PrivMain::RFR_Object::RXX_Object_Obj38.MovingStatus = convertRawToPhysical(raw_value, 1.0, 0.0);

    raw_value=copyBitsFromByteArrayLE( byteArray, 20152, 7);
    @CAN_PrivMain::RFR_Object::RXX_Object_Obj38.ObjId = convertRawToPhysical(raw_value, 1.0, 0.0);

    raw_value=copyBitsFromByteArrayLE( byteArray, 20054, 9);
    @CAN_PrivMain::RFR_Object::RXX_Object_Obj38.OrientationYaw = convertRawToPhysical(raw_value, 0.0175, -4.48);

    raw_value=copyBitsFromByteArrayLE( byteArray, 20076, 12);
    @CAN_PrivMain::RFR_Object::RXX_Object_Obj38.OrientationYawVnce = convertRawToPhysical(raw_value, 0.0003, 0.0);

    raw_value=copyBitsFromByteArrayLE( byteArray, 19968, 6);
    @CAN_PrivMain::RFR_Object::RXX_Object_Obj38.ProbClassConfidence = convertRawToPhysical(raw_value, 2.0, 0.0);

    raw_value=copyBitsFromByteArrayLE( byteArray, 20219, 4);
    @CAN_PrivMain::RFR_Object::RXX_Object_Obj38.ProbClassType = convertRawToPhysical(raw_value, 1.0, 0.0);

    raw_value=copyBitsFromByteArrayLE( byteArray, 19974, 14);
    @CAN_PrivMain::RFR_Object::RXX_Object_Obj38.Px = convertRawToPhysical(raw_value, 0.0625, -512.0);

    raw_value=copyBitsFromByteArrayLE( byteArray, 20288, 12);
    @CAN_PrivMain::RFR_Object::RXX_Object_Obj38.PxAxCoVnce = convertRawToPhysical(raw_value, 0.01, 0.0);

    raw_value=copyBitsFromByteArrayLE( byteArray, 20300, 12);
    @CAN_PrivMain::RFR_Object::RXX_Object_Obj38.PxAyCoVnce = convertRawToPhysical(raw_value, 0.01, 0.0);

    raw_value=copyBitsFromByteArrayLE( byteArray, 20204, 12);
    @CAN_PrivMain::RFR_Object::RXX_Object_Obj38.PxPyCoVnce = convertRawToPhysical(raw_value, 0.01, 0.0);

    raw_value=copyBitsFromByteArrayLE( byteArray, 19988, 12);
    @CAN_PrivMain::RFR_Object::RXX_Object_Obj38.PxVnce = convertRawToPhysical(raw_value, 0.1, 0.0);

    raw_value=copyBitsFromByteArrayLE( byteArray, 20224, 12);
    @CAN_PrivMain::RFR_Object::RXX_Object_Obj38.PxVxCoVnce = convertRawToPhysical(raw_value, 0.01, 0.0);

    raw_value=copyBitsFromByteArrayLE( byteArray, 20236, 12);
    @CAN_PrivMain::RFR_Object::RXX_Object_Obj38.PxVyCoVnce = convertRawToPhysical(raw_value, 0.01, 0.0);

    raw_value=copyBitsFromByteArrayLE( byteArray, 20000, 12);
    @CAN_PrivMain::RFR_Object::RXX_Object_Obj38.Py = convertRawToPhysical(raw_value, 0.0625, -128.0);

    raw_value=copyBitsFromByteArrayLE( byteArray, 20320, 12);
    @CAN_PrivMain::RFR_Object::RXX_Object_Obj38.PyAxCoVnce = convertRawToPhysical(raw_value, 0.01, 0.0);

    raw_value=copyBitsFromByteArrayLE( byteArray, 20332, 12);
    @CAN_PrivMain::RFR_Object::RXX_Object_Obj38.PyAyCoVnce = convertRawToPhysical(raw_value, 0.01, 0.0);

    raw_value=copyBitsFromByteArrayLE( byteArray, 20012, 12);
    @CAN_PrivMain::RFR_Object::RXX_Object_Obj38.PyVnce = convertRawToPhysical(raw_value, 0.1, 0.0);

    raw_value=copyBitsFromByteArrayLE( byteArray, 20256, 12);
    @CAN_PrivMain::RFR_Object::RXX_Object_Obj38.PyVxCoVnce = convertRawToPhysical(raw_value, 0.01, 0.0);

    raw_value=copyBitsFromByteArrayLE( byteArray, 20268, 12);
    @CAN_PrivMain::RFR_Object::RXX_Object_Obj38.PyVyCoVnce = convertRawToPhysical(raw_value, 0.01, 0.0);

    raw_value=copyBitsFromByteArrayLE( byteArray, 20108, 10);
    @CAN_PrivMain::RFR_Object::RXX_Object_Obj38.RCS = convertRawToPhysical(raw_value, 0.2, -102.4);

    raw_value=copyBitsFromByteArrayLE( byteArray, 20280, 4);
    @CAN_PrivMain::RFR_Object::RXX_Object_Obj38.ReferencePoint = convertRawToPhysical(raw_value, 1.0, 0.0);

    raw_value=copyBitsFromByteArrayLE( byteArray, 20140, 12);
    @CAN_PrivMain::RFR_Object::RXX_Object_Obj38.Vx = convertRawToPhysical(raw_value, 0.0625, -128.0);

    raw_value=copyBitsFromByteArrayLE( byteArray, 20364, 12);
    @CAN_PrivMain::RFR_Object::RXX_Object_Obj38.VxAxCoVnce = convertRawToPhysical(raw_value, 0.01, 0.0);

    raw_value=copyBitsFromByteArrayLE( byteArray, 20384, 12);
    @CAN_PrivMain::RFR_Object::RXX_Object_Obj38.VxAyCoVnce = convertRawToPhysical(raw_value, 0.01, 0.0);

    raw_value=copyBitsFromByteArrayLE( byteArray, 20160, 12);
    @CAN_PrivMain::RFR_Object::RXX_Object_Obj38.VxVnce = convertRawToPhysical(raw_value, 0.01, 0.0);

    raw_value=copyBitsFromByteArrayLE( byteArray, 20352, 12);
    @CAN_PrivMain::RFR_Object::RXX_Object_Obj38.VxVyCoVnce = convertRawToPhysical(raw_value, 0.01, 0.0);

    raw_value=copyBitsFromByteArrayLE( byteArray, 20174, 10);
    @CAN_PrivMain::RFR_Object::RXX_Object_Obj38.Vy = convertRawToPhysical(raw_value, 0.125, -64.0);

    raw_value=copyBitsFromByteArrayLE( byteArray, 20396, 12);
    @CAN_PrivMain::RFR_Object::RXX_Object_Obj38.VyAxCoVnce = convertRawToPhysical(raw_value, 0.01, 0.0);

    raw_value=copyBitsFromByteArrayLE( byteArray, 20416, 12);
    @CAN_PrivMain::RFR_Object::RXX_Object_Obj38.VyAyCoVnce = convertRawToPhysical(raw_value, 0.01, 0.0);

    raw_value=copyBitsFromByteArrayLE( byteArray, 20192, 12);
    @CAN_PrivMain::RFR_Object::RXX_Object_Obj38.VyVnce = convertRawToPhysical(raw_value, 0.01, 0.0);

    raw_value=copyBitsFromByteArrayLE( byteArray, 20088, 7);
    @CAN_PrivMain::RFR_Object::RXX_Object_Obj38.Width = convertRawToPhysical(raw_value, 0.125, 0.0);

    raw_value=copyBitsFromByteArrayLE( byteArray, 20096, 12);
    @CAN_PrivMain::RFR_Object::RXX_Object_Obj38.WidthVnce = convertRawToPhysical(raw_value, 0.01, 0.0);
}


void CRadarFR_RXX_Object_Obj39_SetDataReceived(byte byteArray[])
{
    qword raw_value;

    raw_value=copyBitsFromByteArrayLE( byteArray, 20960, 32);
    @CAN_PrivMain::RFR_Object::RXX_Object_Obj39.Age = convertRawToPhysical(raw_value, 1.0, 0.0);

    raw_value=copyBitsFromByteArrayLE( byteArray, 20556, 10);
    @CAN_PrivMain::RFR_Object::RXX_Object_Obj39.Ax = convertRawToPhysical(raw_value, 0.03125, -16.0);

    raw_value=copyBitsFromByteArrayLE( byteArray, 20940, 12);
    @CAN_PrivMain::RFR_Object::RXX_Object_Obj39.AxAyCoVnce = convertRawToPhysical(raw_value, 0.01, 0.0);

    raw_value=copyBitsFromByteArrayLE( byteArray, 20576, 12);
    @CAN_PrivMain::RFR_Object::RXX_Object_Obj39.AxVnce = convertRawToPhysical(raw_value, 0.01, 0.0);

    raw_value=copyBitsFromByteArrayLE( byteArray, 20630, 9);
    @CAN_PrivMain::RFR_Object::RXX_Object_Obj39.Ay = convertRawToPhysical(raw_value, 0.0625, -16.0);

    raw_value=copyBitsFromByteArrayLE( byteArray, 20640, 12);
    @CAN_PrivMain::RFR_Object::RXX_Object_Obj39.AyVnce = convertRawToPhysical(raw_value, 0.01, 0.0);

    raw_value=copyBitsFromByteArrayLE( byteArray, 20696, 6);
    @CAN_PrivMain::RFR_Object::RXX_Object_Obj39.ExistProb = convertRawToPhysical(raw_value, 2.0, 0.0);

    raw_value=copyBitsFromByteArrayLE( byteArray, 20760, 8);
    @CAN_PrivMain::RFR_Object::RXX_Object_Obj39.FilterInformation = convertRawToPhysical(raw_value, 1.0, 0.0);

    raw_value=copyBitsFromByteArrayLE( byteArray, 20536, 7);
    @CAN_PrivMain::RFR_Object::RXX_Object_Obj39.Length = convertRawToPhysical(raw_value, 0.125, 0.0);

    raw_value=copyBitsFromByteArrayLE( byteArray, 20544, 12);
    @CAN_PrivMain::RFR_Object::RXX_Object_Obj39.LengthVnce = convertRawToPhysical(raw_value, 0.01, 0.0);

    raw_value=copyBitsFromByteArrayLE( byteArray, 20728, 3);
    @CAN_PrivMain::RFR_Object::RXX_Object_Obj39.MeasurementStatus = convertRawToPhysical(raw_value, 1.0, 0.0);

    raw_value=copyBitsFromByteArrayLE( byteArray, 20684, 2);
    @CAN_PrivMain::RFR_Object::RXX_Object_Obj39.MovingStatus = convertRawToPhysical(raw_value, 1.0, 0.0);

    raw_value=copyBitsFromByteArrayLE( byteArray, 20664, 7);
    @CAN_PrivMain::RFR_Object::RXX_Object_Obj39.ObjId = convertRawToPhysical(raw_value, 1.0, 0.0);

    raw_value=copyBitsFromByteArrayLE( byteArray, 20566, 9);
    @CAN_PrivMain::RFR_Object::RXX_Object_Obj39.OrientationYaw = convertRawToPhysical(raw_value, 0.0175, -4.48);

    raw_value=copyBitsFromByteArrayLE( byteArray, 20588, 12);
    @CAN_PrivMain::RFR_Object::RXX_Object_Obj39.OrientationYawVnce = convertRawToPhysical(raw_value, 0.0003, 0.0);

    raw_value=copyBitsFromByteArrayLE( byteArray, 20480, 6);
    @CAN_PrivMain::RFR_Object::RXX_Object_Obj39.ProbClassConfidence = convertRawToPhysical(raw_value, 2.0, 0.0);

    raw_value=copyBitsFromByteArrayLE( byteArray, 20731, 4);
    @CAN_PrivMain::RFR_Object::RXX_Object_Obj39.ProbClassType = convertRawToPhysical(raw_value, 1.0, 0.0);

    raw_value=copyBitsFromByteArrayLE( byteArray, 20486, 14);
    @CAN_PrivMain::RFR_Object::RXX_Object_Obj39.Px = convertRawToPhysical(raw_value, 0.0625, -512.0);

    raw_value=copyBitsFromByteArrayLE( byteArray, 20800, 12);
    @CAN_PrivMain::RFR_Object::RXX_Object_Obj39.PxAxCoVnce = convertRawToPhysical(raw_value, 0.01, 0.0);

    raw_value=copyBitsFromByteArrayLE( byteArray, 20812, 12);
    @CAN_PrivMain::RFR_Object::RXX_Object_Obj39.PxAyCoVnce = convertRawToPhysical(raw_value, 0.01, 0.0);

    raw_value=copyBitsFromByteArrayLE( byteArray, 20716, 12);
    @CAN_PrivMain::RFR_Object::RXX_Object_Obj39.PxPyCoVnce = convertRawToPhysical(raw_value, 0.01, 0.0);

    raw_value=copyBitsFromByteArrayLE( byteArray, 20500, 12);
    @CAN_PrivMain::RFR_Object::RXX_Object_Obj39.PxVnce = convertRawToPhysical(raw_value, 0.1, 0.0);

    raw_value=copyBitsFromByteArrayLE( byteArray, 20736, 12);
    @CAN_PrivMain::RFR_Object::RXX_Object_Obj39.PxVxCoVnce = convertRawToPhysical(raw_value, 0.01, 0.0);

    raw_value=copyBitsFromByteArrayLE( byteArray, 20748, 12);
    @CAN_PrivMain::RFR_Object::RXX_Object_Obj39.PxVyCoVnce = convertRawToPhysical(raw_value, 0.01, 0.0);

    raw_value=copyBitsFromByteArrayLE( byteArray, 20512, 12);
    @CAN_PrivMain::RFR_Object::RXX_Object_Obj39.Py = convertRawToPhysical(raw_value, 0.0625, -128.0);

    raw_value=copyBitsFromByteArrayLE( byteArray, 20832, 12);
    @CAN_PrivMain::RFR_Object::RXX_Object_Obj39.PyAxCoVnce = convertRawToPhysical(raw_value, 0.01, 0.0);

    raw_value=copyBitsFromByteArrayLE( byteArray, 20844, 12);
    @CAN_PrivMain::RFR_Object::RXX_Object_Obj39.PyAyCoVnce = convertRawToPhysical(raw_value, 0.01, 0.0);

    raw_value=copyBitsFromByteArrayLE( byteArray, 20524, 12);
    @CAN_PrivMain::RFR_Object::RXX_Object_Obj39.PyVnce = convertRawToPhysical(raw_value, 0.1, 0.0);

    raw_value=copyBitsFromByteArrayLE( byteArray, 20768, 12);
    @CAN_PrivMain::RFR_Object::RXX_Object_Obj39.PyVxCoVnce = convertRawToPhysical(raw_value, 0.01, 0.0);

    raw_value=copyBitsFromByteArrayLE( byteArray, 20780, 12);
    @CAN_PrivMain::RFR_Object::RXX_Object_Obj39.PyVyCoVnce = convertRawToPhysical(raw_value, 0.01, 0.0);

    raw_value=copyBitsFromByteArrayLE( byteArray, 20620, 10);
    @CAN_PrivMain::RFR_Object::RXX_Object_Obj39.RCS = convertRawToPhysical(raw_value, 0.2, -102.4);

    raw_value=copyBitsFromByteArrayLE( byteArray, 20792, 4);
    @CAN_PrivMain::RFR_Object::RXX_Object_Obj39.ReferencePoint = convertRawToPhysical(raw_value, 1.0, 0.0);

    raw_value=copyBitsFromByteArrayLE( byteArray, 20652, 12);
    @CAN_PrivMain::RFR_Object::RXX_Object_Obj39.Vx = convertRawToPhysical(raw_value, 0.0625, -128.0);

    raw_value=copyBitsFromByteArrayLE( byteArray, 20876, 12);
    @CAN_PrivMain::RFR_Object::RXX_Object_Obj39.VxAxCoVnce = convertRawToPhysical(raw_value, 0.01, 0.0);

    raw_value=copyBitsFromByteArrayLE( byteArray, 20896, 12);
    @CAN_PrivMain::RFR_Object::RXX_Object_Obj39.VxAyCoVnce = convertRawToPhysical(raw_value, 0.01, 0.0);

    raw_value=copyBitsFromByteArrayLE( byteArray, 20672, 12);
    @CAN_PrivMain::RFR_Object::RXX_Object_Obj39.VxVnce = convertRawToPhysical(raw_value, 0.01, 0.0);

    raw_value=copyBitsFromByteArrayLE( byteArray, 20864, 12);
    @CAN_PrivMain::RFR_Object::RXX_Object_Obj39.VxVyCoVnce = convertRawToPhysical(raw_value, 0.01, 0.0);

    raw_value=copyBitsFromByteArrayLE( byteArray, 20686, 10);
    @CAN_PrivMain::RFR_Object::RXX_Object_Obj39.Vy = convertRawToPhysical(raw_value, 0.125, -64.0);

    raw_value=copyBitsFromByteArrayLE( byteArray, 20908, 12);
    @CAN_PrivMain::RFR_Object::RXX_Object_Obj39.VyAxCoVnce = convertRawToPhysical(raw_value, 0.01, 0.0);

    raw_value=copyBitsFromByteArrayLE( byteArray, 20928, 12);
    @CAN_PrivMain::RFR_Object::RXX_Object_Obj39.VyAyCoVnce = convertRawToPhysical(raw_value, 0.01, 0.0);

    raw_value=copyBitsFromByteArrayLE( byteArray, 20704, 12);
    @CAN_PrivMain::RFR_Object::RXX_Object_Obj39.VyVnce = convertRawToPhysical(raw_value, 0.01, 0.0);

    raw_value=copyBitsFromByteArrayLE( byteArray, 20600, 7);
    @CAN_PrivMain::RFR_Object::RXX_Object_Obj39.Width = convertRawToPhysical(raw_value, 0.125, 0.0);

    raw_value=copyBitsFromByteArrayLE( byteArray, 20608, 12);
    @CAN_PrivMain::RFR_Object::RXX_Object_Obj39.WidthVnce = convertRawToPhysical(raw_value, 0.01, 0.0);
}


void CRadarFR_RXX_Object_Obj4_SetDataReceived(byte byteArray[])
{
    qword raw_value;

    raw_value=copyBitsFromByteArrayLE( byteArray, 3040, 32);
    @CAN_PrivMain::RFR_Object::RXX_Object_Obj4.Age = convertRawToPhysical(raw_value, 1.0, 0.0);

    raw_value=copyBitsFromByteArrayLE( byteArray, 2636, 10);
    @CAN_PrivMain::RFR_Object::RXX_Object_Obj4.Ax = convertRawToPhysical(raw_value, 0.03125, -16.0);

    raw_value=copyBitsFromByteArrayLE( byteArray, 3020, 12);
    @CAN_PrivMain::RFR_Object::RXX_Object_Obj4.AxAyCoVnce = convertRawToPhysical(raw_value, 0.01, 0.0);

    raw_value=copyBitsFromByteArrayLE( byteArray, 2656, 12);
    @CAN_PrivMain::RFR_Object::RXX_Object_Obj4.AxVnce = convertRawToPhysical(raw_value, 0.01, 0.0);

    raw_value=copyBitsFromByteArrayLE( byteArray, 2710, 9);
    @CAN_PrivMain::RFR_Object::RXX_Object_Obj4.Ay = convertRawToPhysical(raw_value, 0.0625, -16.0);

    raw_value=copyBitsFromByteArrayLE( byteArray, 2720, 12);
    @CAN_PrivMain::RFR_Object::RXX_Object_Obj4.AyVnce = convertRawToPhysical(raw_value, 0.01, 0.0);

    raw_value=copyBitsFromByteArrayLE( byteArray, 2776, 6);
    @CAN_PrivMain::RFR_Object::RXX_Object_Obj4.ExistProb = convertRawToPhysical(raw_value, 2.0, 0.0);

    raw_value=copyBitsFromByteArrayLE( byteArray, 2840, 8);
    @CAN_PrivMain::RFR_Object::RXX_Object_Obj4.FilterInformation = convertRawToPhysical(raw_value, 1.0, 0.0);

    raw_value=copyBitsFromByteArrayLE( byteArray, 2616, 7);
    @CAN_PrivMain::RFR_Object::RXX_Object_Obj4.Length = convertRawToPhysical(raw_value, 0.125, 0.0);

    raw_value=copyBitsFromByteArrayLE( byteArray, 2624, 12);
    @CAN_PrivMain::RFR_Object::RXX_Object_Obj4.LengthVnce = convertRawToPhysical(raw_value, 0.01, 0.0);

    raw_value=copyBitsFromByteArrayLE( byteArray, 2808, 3);
    @CAN_PrivMain::RFR_Object::RXX_Object_Obj4.MeasurementStatus = convertRawToPhysical(raw_value, 1.0, 0.0);

    raw_value=copyBitsFromByteArrayLE( byteArray, 2764, 2);
    @CAN_PrivMain::RFR_Object::RXX_Object_Obj4.MovingStatus = convertRawToPhysical(raw_value, 1.0, 0.0);

    raw_value=copyBitsFromByteArrayLE( byteArray, 2744, 7);
    @CAN_PrivMain::RFR_Object::RXX_Object_Obj4.ObjId = convertRawToPhysical(raw_value, 1.0, 0.0);

    raw_value=copyBitsFromByteArrayLE( byteArray, 2646, 9);
    @CAN_PrivMain::RFR_Object::RXX_Object_Obj4.OrientationYaw = convertRawToPhysical(raw_value, 0.0175, -4.48);

    raw_value=copyBitsFromByteArrayLE( byteArray, 2668, 12);
    @CAN_PrivMain::RFR_Object::RXX_Object_Obj4.OrientationYawVnce = convertRawToPhysical(raw_value, 0.0003, 0.0);

    raw_value=copyBitsFromByteArrayLE( byteArray, 2560, 6);
    @CAN_PrivMain::RFR_Object::RXX_Object_Obj4.ProbClassConfidence = convertRawToPhysical(raw_value, 2.0, 0.0);

    raw_value=copyBitsFromByteArrayLE( byteArray, 2811, 4);
    @CAN_PrivMain::RFR_Object::RXX_Object_Obj4.ProbClassType = convertRawToPhysical(raw_value, 1.0, 0.0);

    raw_value=copyBitsFromByteArrayLE( byteArray, 2566, 14);
    @CAN_PrivMain::RFR_Object::RXX_Object_Obj4.Px = convertRawToPhysical(raw_value, 0.0625, -512.0);

    raw_value=copyBitsFromByteArrayLE( byteArray, 2880, 12);
    @CAN_PrivMain::RFR_Object::RXX_Object_Obj4.PxAxCoVnce = convertRawToPhysical(raw_value, 0.01, 0.0);

    raw_value=copyBitsFromByteArrayLE( byteArray, 2892, 12);
    @CAN_PrivMain::RFR_Object::RXX_Object_Obj4.PxAyCoVnce = convertRawToPhysical(raw_value, 0.01, 0.0);

    raw_value=copyBitsFromByteArrayLE( byteArray, 2796, 12);
    @CAN_PrivMain::RFR_Object::RXX_Object_Obj4.PxPyCoVnce = convertRawToPhysical(raw_value, 0.01, 0.0);

    raw_value=copyBitsFromByteArrayLE( byteArray, 2580, 12);
    @CAN_PrivMain::RFR_Object::RXX_Object_Obj4.PxVnce = convertRawToPhysical(raw_value, 0.1, 0.0);

    raw_value=copyBitsFromByteArrayLE( byteArray, 2816, 12);
    @CAN_PrivMain::RFR_Object::RXX_Object_Obj4.PxVxCoVnce = convertRawToPhysical(raw_value, 0.01, 0.0);

    raw_value=copyBitsFromByteArrayLE( byteArray, 2828, 12);
    @CAN_PrivMain::RFR_Object::RXX_Object_Obj4.PxVyCoVnce = convertRawToPhysical(raw_value, 0.01, 0.0);

    raw_value=copyBitsFromByteArrayLE( byteArray, 2592, 12);
    @CAN_PrivMain::RFR_Object::RXX_Object_Obj4.Py = convertRawToPhysical(raw_value, 0.0625, -128.0);

    raw_value=copyBitsFromByteArrayLE( byteArray, 2912, 12);
    @CAN_PrivMain::RFR_Object::RXX_Object_Obj4.PyAxCoVnce = convertRawToPhysical(raw_value, 0.01, 0.0);

    raw_value=copyBitsFromByteArrayLE( byteArray, 2924, 12);
    @CAN_PrivMain::RFR_Object::RXX_Object_Obj4.PyAyCoVnce = convertRawToPhysical(raw_value, 0.01, 0.0);

    raw_value=copyBitsFromByteArrayLE( byteArray, 2604, 12);
    @CAN_PrivMain::RFR_Object::RXX_Object_Obj4.PyVnce = convertRawToPhysical(raw_value, 0.1, 0.0);

    raw_value=copyBitsFromByteArrayLE( byteArray, 2848, 12);
    @CAN_PrivMain::RFR_Object::RXX_Object_Obj4.PyVxCoVnce = convertRawToPhysical(raw_value, 0.01, 0.0);

    raw_value=copyBitsFromByteArrayLE( byteArray, 2860, 12);
    @CAN_PrivMain::RFR_Object::RXX_Object_Obj4.PyVyCoVnce = convertRawToPhysical(raw_value, 0.01, 0.0);

    raw_value=copyBitsFromByteArrayLE( byteArray, 2700, 10);
    @CAN_PrivMain::RFR_Object::RXX_Object_Obj4.RCS = convertRawToPhysical(raw_value, 0.2, -102.4);

    raw_value=copyBitsFromByteArrayLE( byteArray, 2872, 4);
    @CAN_PrivMain::RFR_Object::RXX_Object_Obj4.ReferencePoint = convertRawToPhysical(raw_value, 1.0, 0.0);

    raw_value=copyBitsFromByteArrayLE( byteArray, 2732, 12);
    @CAN_PrivMain::RFR_Object::RXX_Object_Obj4.Vx = convertRawToPhysical(raw_value, 0.0625, -128.0);

    raw_value=copyBitsFromByteArrayLE( byteArray, 2956, 12);
    @CAN_PrivMain::RFR_Object::RXX_Object_Obj4.VxAxCoVnce = convertRawToPhysical(raw_value, 0.01, 0.0);

    raw_value=copyBitsFromByteArrayLE( byteArray, 2976, 12);
    @CAN_PrivMain::RFR_Object::RXX_Object_Obj4.VxAyCoVnce = convertRawToPhysical(raw_value, 0.01, 0.0);

    raw_value=copyBitsFromByteArrayLE( byteArray, 2752, 12);
    @CAN_PrivMain::RFR_Object::RXX_Object_Obj4.VxVnce = convertRawToPhysical(raw_value, 0.01, 0.0);

    raw_value=copyBitsFromByteArrayLE( byteArray, 2944, 12);
    @CAN_PrivMain::RFR_Object::RXX_Object_Obj4.VxVyCoVnce = convertRawToPhysical(raw_value, 0.01, 0.0);

    raw_value=copyBitsFromByteArrayLE( byteArray, 2766, 10);
    @CAN_PrivMain::RFR_Object::RXX_Object_Obj4.Vy = convertRawToPhysical(raw_value, 0.125, -64.0);

    raw_value=copyBitsFromByteArrayLE( byteArray, 2988, 12);
    @CAN_PrivMain::RFR_Object::RXX_Object_Obj4.VyAxCoVnce = convertRawToPhysical(raw_value, 0.01, 0.0);

    raw_value=copyBitsFromByteArrayLE( byteArray, 3008, 12);
    @CAN_PrivMain::RFR_Object::RXX_Object_Obj4.VyAyCoVnce = convertRawToPhysical(raw_value, 0.01, 0.0);

    raw_value=copyBitsFromByteArrayLE( byteArray, 2784, 12);
    @CAN_PrivMain::RFR_Object::RXX_Object_Obj4.VyVnce = convertRawToPhysical(raw_value, 0.01, 0.0);

    raw_value=copyBitsFromByteArrayLE( byteArray, 2680, 7);
    @CAN_PrivMain::RFR_Object::RXX_Object_Obj4.Width = convertRawToPhysical(raw_value, 0.125, 0.0);

    raw_value=copyBitsFromByteArrayLE( byteArray, 2688, 12);
    @CAN_PrivMain::RFR_Object::RXX_Object_Obj4.WidthVnce = convertRawToPhysical(raw_value, 0.01, 0.0);
}


void CRadarFR_RXX_Object_Obj40_SetDataReceived(byte byteArray[])
{
    qword raw_value;

    raw_value=copyBitsFromByteArrayLE( byteArray, 21472, 32);
    @CAN_PrivMain::RFR_Object::RXX_Object_Obj40.Age = convertRawToPhysical(raw_value, 1.0, 0.0);

    raw_value=copyBitsFromByteArrayLE( byteArray, 21068, 10);
    @CAN_PrivMain::RFR_Object::RXX_Object_Obj40.Ax = convertRawToPhysical(raw_value, 0.03125, -16.0);

    raw_value=copyBitsFromByteArrayLE( byteArray, 21452, 12);
    @CAN_PrivMain::RFR_Object::RXX_Object_Obj40.AxAyCoVnce = convertRawToPhysical(raw_value, 0.01, 0.0);

    raw_value=copyBitsFromByteArrayLE( byteArray, 21088, 12);
    @CAN_PrivMain::RFR_Object::RXX_Object_Obj40.AxVnce = convertRawToPhysical(raw_value, 0.01, 0.0);

    raw_value=copyBitsFromByteArrayLE( byteArray, 21142, 9);
    @CAN_PrivMain::RFR_Object::RXX_Object_Obj40.Ay = convertRawToPhysical(raw_value, 0.0625, -16.0);

    raw_value=copyBitsFromByteArrayLE( byteArray, 21152, 12);
    @CAN_PrivMain::RFR_Object::RXX_Object_Obj40.AyVnce = convertRawToPhysical(raw_value, 0.01, 0.0);

    raw_value=copyBitsFromByteArrayLE( byteArray, 21208, 6);
    @CAN_PrivMain::RFR_Object::RXX_Object_Obj40.ExistProb = convertRawToPhysical(raw_value, 2.0, 0.0);

    raw_value=copyBitsFromByteArrayLE( byteArray, 21272, 8);
    @CAN_PrivMain::RFR_Object::RXX_Object_Obj40.FilterInformation = convertRawToPhysical(raw_value, 1.0, 0.0);

    raw_value=copyBitsFromByteArrayLE( byteArray, 21048, 7);
    @CAN_PrivMain::RFR_Object::RXX_Object_Obj40.Length = convertRawToPhysical(raw_value, 0.125, 0.0);

    raw_value=copyBitsFromByteArrayLE( byteArray, 21056, 12);
    @CAN_PrivMain::RFR_Object::RXX_Object_Obj40.LengthVnce = convertRawToPhysical(raw_value, 0.01, 0.0);

    raw_value=copyBitsFromByteArrayLE( byteArray, 21240, 3);
    @CAN_PrivMain::RFR_Object::RXX_Object_Obj40.MeasurementStatus = convertRawToPhysical(raw_value, 1.0, 0.0);

    raw_value=copyBitsFromByteArrayLE( byteArray, 21196, 2);
    @CAN_PrivMain::RFR_Object::RXX_Object_Obj40.MovingStatus = convertRawToPhysical(raw_value, 1.0, 0.0);

    raw_value=copyBitsFromByteArrayLE( byteArray, 21176, 7);
    @CAN_PrivMain::RFR_Object::RXX_Object_Obj40.ObjId = convertRawToPhysical(raw_value, 1.0, 0.0);

    raw_value=copyBitsFromByteArrayLE( byteArray, 21078, 9);
    @CAN_PrivMain::RFR_Object::RXX_Object_Obj40.OrientationYaw = convertRawToPhysical(raw_value, 0.0175, -4.48);

    raw_value=copyBitsFromByteArrayLE( byteArray, 21100, 12);
    @CAN_PrivMain::RFR_Object::RXX_Object_Obj40.OrientationYawVnce = convertRawToPhysical(raw_value, 0.0003, 0.0);

    raw_value=copyBitsFromByteArrayLE( byteArray, 20992, 6);
    @CAN_PrivMain::RFR_Object::RXX_Object_Obj40.ProbClassConfidence = convertRawToPhysical(raw_value, 2.0, 0.0);

    raw_value=copyBitsFromByteArrayLE( byteArray, 21243, 4);
    @CAN_PrivMain::RFR_Object::RXX_Object_Obj40.ProbClassType = convertRawToPhysical(raw_value, 1.0, 0.0);

    raw_value=copyBitsFromByteArrayLE( byteArray, 20998, 14);
    @CAN_PrivMain::RFR_Object::RXX_Object_Obj40.Px = convertRawToPhysical(raw_value, 0.0625, -512.0);

    raw_value=copyBitsFromByteArrayLE( byteArray, 21312, 12);
    @CAN_PrivMain::RFR_Object::RXX_Object_Obj40.PxAxCoVnce = convertRawToPhysical(raw_value, 0.01, 0.0);

    raw_value=copyBitsFromByteArrayLE( byteArray, 21324, 12);
    @CAN_PrivMain::RFR_Object::RXX_Object_Obj40.PxAyCoVnce = convertRawToPhysical(raw_value, 0.01, 0.0);

    raw_value=copyBitsFromByteArrayLE( byteArray, 21228, 12);
    @CAN_PrivMain::RFR_Object::RXX_Object_Obj40.PxPyCoVnce = convertRawToPhysical(raw_value, 0.01, 0.0);

    raw_value=copyBitsFromByteArrayLE( byteArray, 21012, 12);
    @CAN_PrivMain::RFR_Object::RXX_Object_Obj40.PxVnce = convertRawToPhysical(raw_value, 0.1, 0.0);

    raw_value=copyBitsFromByteArrayLE( byteArray, 21248, 12);
    @CAN_PrivMain::RFR_Object::RXX_Object_Obj40.PxVxCoVnce = convertRawToPhysical(raw_value, 0.01, 0.0);

    raw_value=copyBitsFromByteArrayLE( byteArray, 21260, 12);
    @CAN_PrivMain::RFR_Object::RXX_Object_Obj40.PxVyCoVnce = convertRawToPhysical(raw_value, 0.01, 0.0);

    raw_value=copyBitsFromByteArrayLE( byteArray, 21024, 12);
    @CAN_PrivMain::RFR_Object::RXX_Object_Obj40.Py = convertRawToPhysical(raw_value, 0.0625, -128.0);

    raw_value=copyBitsFromByteArrayLE( byteArray, 21344, 12);
    @CAN_PrivMain::RFR_Object::RXX_Object_Obj40.PyAxCoVnce = convertRawToPhysical(raw_value, 0.01, 0.0);

    raw_value=copyBitsFromByteArrayLE( byteArray, 21356, 12);
    @CAN_PrivMain::RFR_Object::RXX_Object_Obj40.PyAyCoVnce = convertRawToPhysical(raw_value, 0.01, 0.0);

    raw_value=copyBitsFromByteArrayLE( byteArray, 21036, 12);
    @CAN_PrivMain::RFR_Object::RXX_Object_Obj40.PyVnce = convertRawToPhysical(raw_value, 0.1, 0.0);

    raw_value=copyBitsFromByteArrayLE( byteArray, 21280, 12);
    @CAN_PrivMain::RFR_Object::RXX_Object_Obj40.PyVxCoVnce = convertRawToPhysical(raw_value, 0.01, 0.0);

    raw_value=copyBitsFromByteArrayLE( byteArray, 21292, 12);
    @CAN_PrivMain::RFR_Object::RXX_Object_Obj40.PyVyCoVnce = convertRawToPhysical(raw_value, 0.01, 0.0);

    raw_value=copyBitsFromByteArrayLE( byteArray, 21132, 10);
    @CAN_PrivMain::RFR_Object::RXX_Object_Obj40.RCS = convertRawToPhysical(raw_value, 0.2, -102.4);

    raw_value=copyBitsFromByteArrayLE( byteArray, 21304, 4);
    @CAN_PrivMain::RFR_Object::RXX_Object_Obj40.ReferencePoint = convertRawToPhysical(raw_value, 1.0, 0.0);

    raw_value=copyBitsFromByteArrayLE( byteArray, 21164, 12);
    @CAN_PrivMain::RFR_Object::RXX_Object_Obj40.Vx = convertRawToPhysical(raw_value, 0.0625, -128.0);

    raw_value=copyBitsFromByteArrayLE( byteArray, 21388, 12);
    @CAN_PrivMain::RFR_Object::RXX_Object_Obj40.VxAxCoVnce = convertRawToPhysical(raw_value, 0.01, 0.0);

    raw_value=copyBitsFromByteArrayLE( byteArray, 21408, 12);
    @CAN_PrivMain::RFR_Object::RXX_Object_Obj40.VxAyCoVnce = convertRawToPhysical(raw_value, 0.01, 0.0);

    raw_value=copyBitsFromByteArrayLE( byteArray, 21184, 12);
    @CAN_PrivMain::RFR_Object::RXX_Object_Obj40.VxVnce = convertRawToPhysical(raw_value, 0.01, 0.0);

    raw_value=copyBitsFromByteArrayLE( byteArray, 21376, 12);
    @CAN_PrivMain::RFR_Object::RXX_Object_Obj40.VxVyCoVnce = convertRawToPhysical(raw_value, 0.01, 0.0);

    raw_value=copyBitsFromByteArrayLE( byteArray, 21198, 10);
    @CAN_PrivMain::RFR_Object::RXX_Object_Obj40.Vy = convertRawToPhysical(raw_value, 0.125, -64.0);

    raw_value=copyBitsFromByteArrayLE( byteArray, 21420, 12);
    @CAN_PrivMain::RFR_Object::RXX_Object_Obj40.VyAxCoVnce = convertRawToPhysical(raw_value, 0.01, 0.0);

    raw_value=copyBitsFromByteArrayLE( byteArray, 21440, 12);
    @CAN_PrivMain::RFR_Object::RXX_Object_Obj40.VyAyCoVnce = convertRawToPhysical(raw_value, 0.01, 0.0);

    raw_value=copyBitsFromByteArrayLE( byteArray, 21216, 12);
    @CAN_PrivMain::RFR_Object::RXX_Object_Obj40.VyVnce = convertRawToPhysical(raw_value, 0.01, 0.0);

    raw_value=copyBitsFromByteArrayLE( byteArray, 21112, 7);
    @CAN_PrivMain::RFR_Object::RXX_Object_Obj40.Width = convertRawToPhysical(raw_value, 0.125, 0.0);

    raw_value=copyBitsFromByteArrayLE( byteArray, 21120, 12);
    @CAN_PrivMain::RFR_Object::RXX_Object_Obj40.WidthVnce = convertRawToPhysical(raw_value, 0.01, 0.0);
}


void CRadarFR_RXX_Object_Obj41_SetDataReceived(byte byteArray[])
{
    qword raw_value;

    raw_value=copyBitsFromByteArrayLE( byteArray, 21984, 32);
    @CAN_PrivMain::RFR_Object::RXX_Object_Obj41.Age = convertRawToPhysical(raw_value, 1.0, 0.0);

    raw_value=copyBitsFromByteArrayLE( byteArray, 21580, 10);
    @CAN_PrivMain::RFR_Object::RXX_Object_Obj41.Ax = convertRawToPhysical(raw_value, 0.03125, -16.0);

    raw_value=copyBitsFromByteArrayLE( byteArray, 21964, 12);
    @CAN_PrivMain::RFR_Object::RXX_Object_Obj41.AxAyCoVnce = convertRawToPhysical(raw_value, 0.01, 0.0);

    raw_value=copyBitsFromByteArrayLE( byteArray, 21600, 12);
    @CAN_PrivMain::RFR_Object::RXX_Object_Obj41.AxVnce = convertRawToPhysical(raw_value, 0.01, 0.0);

    raw_value=copyBitsFromByteArrayLE( byteArray, 21654, 9);
    @CAN_PrivMain::RFR_Object::RXX_Object_Obj41.Ay = convertRawToPhysical(raw_value, 0.0625, -16.0);

    raw_value=copyBitsFromByteArrayLE( byteArray, 21664, 12);
    @CAN_PrivMain::RFR_Object::RXX_Object_Obj41.AyVnce = convertRawToPhysical(raw_value, 0.01, 0.0);

    raw_value=copyBitsFromByteArrayLE( byteArray, 21720, 6);
    @CAN_PrivMain::RFR_Object::RXX_Object_Obj41.ExistProb = convertRawToPhysical(raw_value, 2.0, 0.0);

    raw_value=copyBitsFromByteArrayLE( byteArray, 21784, 8);
    @CAN_PrivMain::RFR_Object::RXX_Object_Obj41.FilterInformation = convertRawToPhysical(raw_value, 1.0, 0.0);

    raw_value=copyBitsFromByteArrayLE( byteArray, 21560, 7);
    @CAN_PrivMain::RFR_Object::RXX_Object_Obj41.Length = convertRawToPhysical(raw_value, 0.125, 0.0);

    raw_value=copyBitsFromByteArrayLE( byteArray, 21568, 12);
    @CAN_PrivMain::RFR_Object::RXX_Object_Obj41.LengthVnce = convertRawToPhysical(raw_value, 0.01, 0.0);

    raw_value=copyBitsFromByteArrayLE( byteArray, 21752, 3);
    @CAN_PrivMain::RFR_Object::RXX_Object_Obj41.MeasurementStatus = convertRawToPhysical(raw_value, 1.0, 0.0);

    raw_value=copyBitsFromByteArrayLE( byteArray, 21708, 2);
    @CAN_PrivMain::RFR_Object::RXX_Object_Obj41.MovingStatus = convertRawToPhysical(raw_value, 1.0, 0.0);

    raw_value=copyBitsFromByteArrayLE( byteArray, 21688, 7);
    @CAN_PrivMain::RFR_Object::RXX_Object_Obj41.ObjId = convertRawToPhysical(raw_value, 1.0, 0.0);

    raw_value=copyBitsFromByteArrayLE( byteArray, 21590, 9);
    @CAN_PrivMain::RFR_Object::RXX_Object_Obj41.OrientationYaw = convertRawToPhysical(raw_value, 0.0175, -4.48);

    raw_value=copyBitsFromByteArrayLE( byteArray, 21612, 12);
    @CAN_PrivMain::RFR_Object::RXX_Object_Obj41.OrientationYawVnce = convertRawToPhysical(raw_value, 0.0003, 0.0);

    raw_value=copyBitsFromByteArrayLE( byteArray, 21504, 6);
    @CAN_PrivMain::RFR_Object::RXX_Object_Obj41.ProbClassConfidence = convertRawToPhysical(raw_value, 2.0, 0.0);

    raw_value=copyBitsFromByteArrayLE( byteArray, 21755, 4);
    @CAN_PrivMain::RFR_Object::RXX_Object_Obj41.ProbClassType = convertRawToPhysical(raw_value, 1.0, 0.0);

    raw_value=copyBitsFromByteArrayLE( byteArray, 21510, 14);
    @CAN_PrivMain::RFR_Object::RXX_Object_Obj41.Px = convertRawToPhysical(raw_value, 0.0625, -512.0);

    raw_value=copyBitsFromByteArrayLE( byteArray, 21824, 12);
    @CAN_PrivMain::RFR_Object::RXX_Object_Obj41.PxAxCoVnce = convertRawToPhysical(raw_value, 0.01, 0.0);

    raw_value=copyBitsFromByteArrayLE( byteArray, 21836, 12);
    @CAN_PrivMain::RFR_Object::RXX_Object_Obj41.PxAyCoVnce = convertRawToPhysical(raw_value, 0.01, 0.0);

    raw_value=copyBitsFromByteArrayLE( byteArray, 21740, 12);
    @CAN_PrivMain::RFR_Object::RXX_Object_Obj41.PxPyCoVnce = convertRawToPhysical(raw_value, 0.01, 0.0);

    raw_value=copyBitsFromByteArrayLE( byteArray, 21524, 12);
    @CAN_PrivMain::RFR_Object::RXX_Object_Obj41.PxVnce = convertRawToPhysical(raw_value, 0.1, 0.0);

    raw_value=copyBitsFromByteArrayLE( byteArray, 21760, 12);
    @CAN_PrivMain::RFR_Object::RXX_Object_Obj41.PxVxCoVnce = convertRawToPhysical(raw_value, 0.01, 0.0);

    raw_value=copyBitsFromByteArrayLE( byteArray, 21772, 12);
    @CAN_PrivMain::RFR_Object::RXX_Object_Obj41.PxVyCoVnce = convertRawToPhysical(raw_value, 0.01, 0.0);

    raw_value=copyBitsFromByteArrayLE( byteArray, 21536, 12);
    @CAN_PrivMain::RFR_Object::RXX_Object_Obj41.Py = convertRawToPhysical(raw_value, 0.0625, -128.0);

    raw_value=copyBitsFromByteArrayLE( byteArray, 21856, 12);
    @CAN_PrivMain::RFR_Object::RXX_Object_Obj41.PyAxCoVnce = convertRawToPhysical(raw_value, 0.01, 0.0);

    raw_value=copyBitsFromByteArrayLE( byteArray, 21868, 12);
    @CAN_PrivMain::RFR_Object::RXX_Object_Obj41.PyAyCoVnce = convertRawToPhysical(raw_value, 0.01, 0.0);

    raw_value=copyBitsFromByteArrayLE( byteArray, 21548, 12);
    @CAN_PrivMain::RFR_Object::RXX_Object_Obj41.PyVnce = convertRawToPhysical(raw_value, 0.1, 0.0);

    raw_value=copyBitsFromByteArrayLE( byteArray, 21792, 12);
    @CAN_PrivMain::RFR_Object::RXX_Object_Obj41.PyVxCoVnce = convertRawToPhysical(raw_value, 0.01, 0.0);

    raw_value=copyBitsFromByteArrayLE( byteArray, 21804, 12);
    @CAN_PrivMain::RFR_Object::RXX_Object_Obj41.PyVyCoVnce = convertRawToPhysical(raw_value, 0.01, 0.0);

    raw_value=copyBitsFromByteArrayLE( byteArray, 21644, 10);
    @CAN_PrivMain::RFR_Object::RXX_Object_Obj41.RCS = convertRawToPhysical(raw_value, 0.2, -102.4);

    raw_value=copyBitsFromByteArrayLE( byteArray, 21816, 4);
    @CAN_PrivMain::RFR_Object::RXX_Object_Obj41.ReferencePoint = convertRawToPhysical(raw_value, 1.0, 0.0);

    raw_value=copyBitsFromByteArrayLE( byteArray, 21676, 12);
    @CAN_PrivMain::RFR_Object::RXX_Object_Obj41.Vx = convertRawToPhysical(raw_value, 0.0625, -128.0);

    raw_value=copyBitsFromByteArrayLE( byteArray, 21900, 12);
    @CAN_PrivMain::RFR_Object::RXX_Object_Obj41.VxAxCoVnce = convertRawToPhysical(raw_value, 0.01, 0.0);

    raw_value=copyBitsFromByteArrayLE( byteArray, 21920, 12);
    @CAN_PrivMain::RFR_Object::RXX_Object_Obj41.VxAyCoVnce = convertRawToPhysical(raw_value, 0.01, 0.0);

    raw_value=copyBitsFromByteArrayLE( byteArray, 21696, 12);
    @CAN_PrivMain::RFR_Object::RXX_Object_Obj41.VxVnce = convertRawToPhysical(raw_value, 0.01, 0.0);

    raw_value=copyBitsFromByteArrayLE( byteArray, 21888, 12);
    @CAN_PrivMain::RFR_Object::RXX_Object_Obj41.VxVyCoVnce = convertRawToPhysical(raw_value, 0.01, 0.0);

    raw_value=copyBitsFromByteArrayLE( byteArray, 21710, 10);
    @CAN_PrivMain::RFR_Object::RXX_Object_Obj41.Vy = convertRawToPhysical(raw_value, 0.125, -64.0);

    raw_value=copyBitsFromByteArrayLE( byteArray, 21932, 12);
    @CAN_PrivMain::RFR_Object::RXX_Object_Obj41.VyAxCoVnce = convertRawToPhysical(raw_value, 0.01, 0.0);

    raw_value=copyBitsFromByteArrayLE( byteArray, 21952, 12);
    @CAN_PrivMain::RFR_Object::RXX_Object_Obj41.VyAyCoVnce = convertRawToPhysical(raw_value, 0.01, 0.0);

    raw_value=copyBitsFromByteArrayLE( byteArray, 21728, 12);
    @CAN_PrivMain::RFR_Object::RXX_Object_Obj41.VyVnce = convertRawToPhysical(raw_value, 0.01, 0.0);

    raw_value=copyBitsFromByteArrayLE( byteArray, 21624, 7);
    @CAN_PrivMain::RFR_Object::RXX_Object_Obj41.Width = convertRawToPhysical(raw_value, 0.125, 0.0);

    raw_value=copyBitsFromByteArrayLE( byteArray, 21632, 12);
    @CAN_PrivMain::RFR_Object::RXX_Object_Obj41.WidthVnce = convertRawToPhysical(raw_value, 0.01, 0.0);
}


void CRadarFR_RXX_Object_Obj42_SetDataReceived(byte byteArray[])
{
    qword raw_value;

    raw_value=copyBitsFromByteArrayLE( byteArray, 22496, 32);
    @CAN_PrivMain::RFR_Object::RXX_Object_Obj42.Age = convertRawToPhysical(raw_value, 1.0, 0.0);

    raw_value=copyBitsFromByteArrayLE( byteArray, 22092, 10);
    @CAN_PrivMain::RFR_Object::RXX_Object_Obj42.Ax = convertRawToPhysical(raw_value, 0.03125, -16.0);

    raw_value=copyBitsFromByteArrayLE( byteArray, 22476, 12);
    @CAN_PrivMain::RFR_Object::RXX_Object_Obj42.AxAyCoVnce = convertRawToPhysical(raw_value, 0.01, 0.0);

    raw_value=copyBitsFromByteArrayLE( byteArray, 22112, 12);
    @CAN_PrivMain::RFR_Object::RXX_Object_Obj42.AxVnce = convertRawToPhysical(raw_value, 0.01, 0.0);

    raw_value=copyBitsFromByteArrayLE( byteArray, 22166, 9);
    @CAN_PrivMain::RFR_Object::RXX_Object_Obj42.Ay = convertRawToPhysical(raw_value, 0.0625, -16.0);

    raw_value=copyBitsFromByteArrayLE( byteArray, 22176, 12);
    @CAN_PrivMain::RFR_Object::RXX_Object_Obj42.AyVnce = convertRawToPhysical(raw_value, 0.01, 0.0);

    raw_value=copyBitsFromByteArrayLE( byteArray, 22232, 6);
    @CAN_PrivMain::RFR_Object::RXX_Object_Obj42.ExistProb = convertRawToPhysical(raw_value, 2.0, 0.0);

    raw_value=copyBitsFromByteArrayLE( byteArray, 22296, 8);
    @CAN_PrivMain::RFR_Object::RXX_Object_Obj42.FilterInformation = convertRawToPhysical(raw_value, 1.0, 0.0);

    raw_value=copyBitsFromByteArrayLE( byteArray, 22072, 7);
    @CAN_PrivMain::RFR_Object::RXX_Object_Obj42.Length = convertRawToPhysical(raw_value, 0.125, 0.0);

    raw_value=copyBitsFromByteArrayLE( byteArray, 22080, 12);
    @CAN_PrivMain::RFR_Object::RXX_Object_Obj42.LengthVnce = convertRawToPhysical(raw_value, 0.01, 0.0);

    raw_value=copyBitsFromByteArrayLE( byteArray, 22264, 3);
    @CAN_PrivMain::RFR_Object::RXX_Object_Obj42.MeasurementStatus = convertRawToPhysical(raw_value, 1.0, 0.0);

    raw_value=copyBitsFromByteArrayLE( byteArray, 22220, 2);
    @CAN_PrivMain::RFR_Object::RXX_Object_Obj42.MovingStatus = convertRawToPhysical(raw_value, 1.0, 0.0);

    raw_value=copyBitsFromByteArrayLE( byteArray, 22200, 7);
    @CAN_PrivMain::RFR_Object::RXX_Object_Obj42.ObjId = convertRawToPhysical(raw_value, 1.0, 0.0);

    raw_value=copyBitsFromByteArrayLE( byteArray, 22102, 9);
    @CAN_PrivMain::RFR_Object::RXX_Object_Obj42.OrientationYaw = convertRawToPhysical(raw_value, 0.0175, -4.48);

    raw_value=copyBitsFromByteArrayLE( byteArray, 22124, 12);
    @CAN_PrivMain::RFR_Object::RXX_Object_Obj42.OrientationYawVnce = convertRawToPhysical(raw_value, 0.0003, 0.0);

    raw_value=copyBitsFromByteArrayLE( byteArray, 22016, 6);
    @CAN_PrivMain::RFR_Object::RXX_Object_Obj42.ProbClassConfidence = convertRawToPhysical(raw_value, 2.0, 0.0);

    raw_value=copyBitsFromByteArrayLE( byteArray, 22267, 4);
    @CAN_PrivMain::RFR_Object::RXX_Object_Obj42.ProbClassType = convertRawToPhysical(raw_value, 1.0, 0.0);

    raw_value=copyBitsFromByteArrayLE( byteArray, 22022, 14);
    @CAN_PrivMain::RFR_Object::RXX_Object_Obj42.Px = convertRawToPhysical(raw_value, 0.0625, -512.0);

    raw_value=copyBitsFromByteArrayLE( byteArray, 22336, 12);
    @CAN_PrivMain::RFR_Object::RXX_Object_Obj42.PxAxCoVnce = convertRawToPhysical(raw_value, 0.01, 0.0);

    raw_value=copyBitsFromByteArrayLE( byteArray, 22348, 12);
    @CAN_PrivMain::RFR_Object::RXX_Object_Obj42.PxAyCoVnce = convertRawToPhysical(raw_value, 0.01, 0.0);

    raw_value=copyBitsFromByteArrayLE( byteArray, 22252, 12);
    @CAN_PrivMain::RFR_Object::RXX_Object_Obj42.PxPyCoVnce = convertRawToPhysical(raw_value, 0.01, 0.0);

    raw_value=copyBitsFromByteArrayLE( byteArray, 22036, 12);
    @CAN_PrivMain::RFR_Object::RXX_Object_Obj42.PxVnce = convertRawToPhysical(raw_value, 0.1, 0.0);

    raw_value=copyBitsFromByteArrayLE( byteArray, 22272, 12);
    @CAN_PrivMain::RFR_Object::RXX_Object_Obj42.PxVxCoVnce = convertRawToPhysical(raw_value, 0.01, 0.0);

    raw_value=copyBitsFromByteArrayLE( byteArray, 22284, 12);
    @CAN_PrivMain::RFR_Object::RXX_Object_Obj42.PxVyCoVnce = convertRawToPhysical(raw_value, 0.01, 0.0);

    raw_value=copyBitsFromByteArrayLE( byteArray, 22048, 12);
    @CAN_PrivMain::RFR_Object::RXX_Object_Obj42.Py = convertRawToPhysical(raw_value, 0.0625, -128.0);

    raw_value=copyBitsFromByteArrayLE( byteArray, 22368, 12);
    @CAN_PrivMain::RFR_Object::RXX_Object_Obj42.PyAxCoVnce = convertRawToPhysical(raw_value, 0.01, 0.0);

    raw_value=copyBitsFromByteArrayLE( byteArray, 22380, 12);
    @CAN_PrivMain::RFR_Object::RXX_Object_Obj42.PyAyCoVnce = convertRawToPhysical(raw_value, 0.01, 0.0);

    raw_value=copyBitsFromByteArrayLE( byteArray, 22060, 12);
    @CAN_PrivMain::RFR_Object::RXX_Object_Obj42.PyVnce = convertRawToPhysical(raw_value, 0.1, 0.0);

    raw_value=copyBitsFromByteArrayLE( byteArray, 22304, 12);
    @CAN_PrivMain::RFR_Object::RXX_Object_Obj42.PyVxCoVnce = convertRawToPhysical(raw_value, 0.01, 0.0);

    raw_value=copyBitsFromByteArrayLE( byteArray, 22316, 12);
    @CAN_PrivMain::RFR_Object::RXX_Object_Obj42.PyVyCoVnce = convertRawToPhysical(raw_value, 0.01, 0.0);

    raw_value=copyBitsFromByteArrayLE( byteArray, 22156, 10);
    @CAN_PrivMain::RFR_Object::RXX_Object_Obj42.RCS = convertRawToPhysical(raw_value, 0.2, -102.4);

    raw_value=copyBitsFromByteArrayLE( byteArray, 22328, 4);
    @CAN_PrivMain::RFR_Object::RXX_Object_Obj42.ReferencePoint = convertRawToPhysical(raw_value, 1.0, 0.0);

    raw_value=copyBitsFromByteArrayLE( byteArray, 22188, 12);
    @CAN_PrivMain::RFR_Object::RXX_Object_Obj42.Vx = convertRawToPhysical(raw_value, 0.0625, -128.0);

    raw_value=copyBitsFromByteArrayLE( byteArray, 22412, 12);
    @CAN_PrivMain::RFR_Object::RXX_Object_Obj42.VxAxCoVnce = convertRawToPhysical(raw_value, 0.01, 0.0);

    raw_value=copyBitsFromByteArrayLE( byteArray, 22432, 12);
    @CAN_PrivMain::RFR_Object::RXX_Object_Obj42.VxAyCoVnce = convertRawToPhysical(raw_value, 0.01, 0.0);

    raw_value=copyBitsFromByteArrayLE( byteArray, 22208, 12);
    @CAN_PrivMain::RFR_Object::RXX_Object_Obj42.VxVnce = convertRawToPhysical(raw_value, 0.01, 0.0);

    raw_value=copyBitsFromByteArrayLE( byteArray, 22400, 12);
    @CAN_PrivMain::RFR_Object::RXX_Object_Obj42.VxVyCoVnce = convertRawToPhysical(raw_value, 0.01, 0.0);

    raw_value=copyBitsFromByteArrayLE( byteArray, 22222, 10);
    @CAN_PrivMain::RFR_Object::RXX_Object_Obj42.Vy = convertRawToPhysical(raw_value, 0.125, -64.0);

    raw_value=copyBitsFromByteArrayLE( byteArray, 22444, 12);
    @CAN_PrivMain::RFR_Object::RXX_Object_Obj42.VyAxCoVnce = convertRawToPhysical(raw_value, 0.01, 0.0);

    raw_value=copyBitsFromByteArrayLE( byteArray, 22464, 12);
    @CAN_PrivMain::RFR_Object::RXX_Object_Obj42.VyAyCoVnce = convertRawToPhysical(raw_value, 0.01, 0.0);

    raw_value=copyBitsFromByteArrayLE( byteArray, 22240, 12);
    @CAN_PrivMain::RFR_Object::RXX_Object_Obj42.VyVnce = convertRawToPhysical(raw_value, 0.01, 0.0);

    raw_value=copyBitsFromByteArrayLE( byteArray, 22136, 7);
    @CAN_PrivMain::RFR_Object::RXX_Object_Obj42.Width = convertRawToPhysical(raw_value, 0.125, 0.0);

    raw_value=copyBitsFromByteArrayLE( byteArray, 22144, 12);
    @CAN_PrivMain::RFR_Object::RXX_Object_Obj42.WidthVnce = convertRawToPhysical(raw_value, 0.01, 0.0);
}


void CRadarFR_RXX_Object_Obj43_SetDataReceived(byte byteArray[])
{
    qword raw_value;

    raw_value=copyBitsFromByteArrayLE( byteArray, 23008, 32);
    @CAN_PrivMain::RFR_Object::RXX_Object_Obj43.Age = convertRawToPhysical(raw_value, 1.0, 0.0);

    raw_value=copyBitsFromByteArrayLE( byteArray, 22604, 10);
    @CAN_PrivMain::RFR_Object::RXX_Object_Obj43.Ax = convertRawToPhysical(raw_value, 0.03125, -16.0);

    raw_value=copyBitsFromByteArrayLE( byteArray, 22988, 12);
    @CAN_PrivMain::RFR_Object::RXX_Object_Obj43.AxAyCoVnce = convertRawToPhysical(raw_value, 0.01, 0.0);

    raw_value=copyBitsFromByteArrayLE( byteArray, 22624, 12);
    @CAN_PrivMain::RFR_Object::RXX_Object_Obj43.AxVnce = convertRawToPhysical(raw_value, 0.01, 0.0);

    raw_value=copyBitsFromByteArrayLE( byteArray, 22678, 9);
    @CAN_PrivMain::RFR_Object::RXX_Object_Obj43.Ay = convertRawToPhysical(raw_value, 0.0625, -16.0);

    raw_value=copyBitsFromByteArrayLE( byteArray, 22688, 12);
    @CAN_PrivMain::RFR_Object::RXX_Object_Obj43.AyVnce = convertRawToPhysical(raw_value, 0.01, 0.0);

    raw_value=copyBitsFromByteArrayLE( byteArray, 22744, 6);
    @CAN_PrivMain::RFR_Object::RXX_Object_Obj43.ExistProb = convertRawToPhysical(raw_value, 2.0, 0.0);

    raw_value=copyBitsFromByteArrayLE( byteArray, 22808, 8);
    @CAN_PrivMain::RFR_Object::RXX_Object_Obj43.FilterInformation = convertRawToPhysical(raw_value, 1.0, 0.0);

    raw_value=copyBitsFromByteArrayLE( byteArray, 22584, 7);
    @CAN_PrivMain::RFR_Object::RXX_Object_Obj43.Length = convertRawToPhysical(raw_value, 0.125, 0.0);

    raw_value=copyBitsFromByteArrayLE( byteArray, 22592, 12);
    @CAN_PrivMain::RFR_Object::RXX_Object_Obj43.LengthVnce = convertRawToPhysical(raw_value, 0.01, 0.0);

    raw_value=copyBitsFromByteArrayLE( byteArray, 22776, 3);
    @CAN_PrivMain::RFR_Object::RXX_Object_Obj43.MeasurementStatus = convertRawToPhysical(raw_value, 1.0, 0.0);

    raw_value=copyBitsFromByteArrayLE( byteArray, 22732, 2);
    @CAN_PrivMain::RFR_Object::RXX_Object_Obj43.MovingStatus = convertRawToPhysical(raw_value, 1.0, 0.0);

    raw_value=copyBitsFromByteArrayLE( byteArray, 22712, 7);
    @CAN_PrivMain::RFR_Object::RXX_Object_Obj43.ObjId = convertRawToPhysical(raw_value, 1.0, 0.0);

    raw_value=copyBitsFromByteArrayLE( byteArray, 22614, 9);
    @CAN_PrivMain::RFR_Object::RXX_Object_Obj43.OrientationYaw = convertRawToPhysical(raw_value, 0.0175, -4.48);

    raw_value=copyBitsFromByteArrayLE( byteArray, 22636, 12);
    @CAN_PrivMain::RFR_Object::RXX_Object_Obj43.OrientationYawVnce = convertRawToPhysical(raw_value, 0.0003, 0.0);

    raw_value=copyBitsFromByteArrayLE( byteArray, 22528, 6);
    @CAN_PrivMain::RFR_Object::RXX_Object_Obj43.ProbClassConfidence = convertRawToPhysical(raw_value, 2.0, 0.0);

    raw_value=copyBitsFromByteArrayLE( byteArray, 22779, 4);
    @CAN_PrivMain::RFR_Object::RXX_Object_Obj43.ProbClassType = convertRawToPhysical(raw_value, 1.0, 0.0);

    raw_value=copyBitsFromByteArrayLE( byteArray, 22534, 14);
    @CAN_PrivMain::RFR_Object::RXX_Object_Obj43.Px = convertRawToPhysical(raw_value, 0.0625, -512.0);

    raw_value=copyBitsFromByteArrayLE( byteArray, 22848, 12);
    @CAN_PrivMain::RFR_Object::RXX_Object_Obj43.PxAxCoVnce = convertRawToPhysical(raw_value, 0.01, 0.0);

    raw_value=copyBitsFromByteArrayLE( byteArray, 22860, 12);
    @CAN_PrivMain::RFR_Object::RXX_Object_Obj43.PxAyCoVnce = convertRawToPhysical(raw_value, 0.01, 0.0);

    raw_value=copyBitsFromByteArrayLE( byteArray, 22764, 12);
    @CAN_PrivMain::RFR_Object::RXX_Object_Obj43.PxPyCoVnce = convertRawToPhysical(raw_value, 0.01, 0.0);

    raw_value=copyBitsFromByteArrayLE( byteArray, 22548, 12);
    @CAN_PrivMain::RFR_Object::RXX_Object_Obj43.PxVnce = convertRawToPhysical(raw_value, 0.1, 0.0);

    raw_value=copyBitsFromByteArrayLE( byteArray, 22784, 12);
    @CAN_PrivMain::RFR_Object::RXX_Object_Obj43.PxVxCoVnce = convertRawToPhysical(raw_value, 0.01, 0.0);

    raw_value=copyBitsFromByteArrayLE( byteArray, 22796, 12);
    @CAN_PrivMain::RFR_Object::RXX_Object_Obj43.PxVyCoVnce = convertRawToPhysical(raw_value, 0.01, 0.0);

    raw_value=copyBitsFromByteArrayLE( byteArray, 22560, 12);
    @CAN_PrivMain::RFR_Object::RXX_Object_Obj43.Py = convertRawToPhysical(raw_value, 0.0625, -128.0);

    raw_value=copyBitsFromByteArrayLE( byteArray, 22880, 12);
    @CAN_PrivMain::RFR_Object::RXX_Object_Obj43.PyAxCoVnce = convertRawToPhysical(raw_value, 0.01, 0.0);

    raw_value=copyBitsFromByteArrayLE( byteArray, 22892, 12);
    @CAN_PrivMain::RFR_Object::RXX_Object_Obj43.PyAyCoVnce = convertRawToPhysical(raw_value, 0.01, 0.0);

    raw_value=copyBitsFromByteArrayLE( byteArray, 22572, 12);
    @CAN_PrivMain::RFR_Object::RXX_Object_Obj43.PyVnce = convertRawToPhysical(raw_value, 0.1, 0.0);

    raw_value=copyBitsFromByteArrayLE( byteArray, 22816, 12);
    @CAN_PrivMain::RFR_Object::RXX_Object_Obj43.PyVxCoVnce = convertRawToPhysical(raw_value, 0.01, 0.0);

    raw_value=copyBitsFromByteArrayLE( byteArray, 22828, 12);
    @CAN_PrivMain::RFR_Object::RXX_Object_Obj43.PyVyCoVnce = convertRawToPhysical(raw_value, 0.01, 0.0);

    raw_value=copyBitsFromByteArrayLE( byteArray, 22668, 10);
    @CAN_PrivMain::RFR_Object::RXX_Object_Obj43.RCS = convertRawToPhysical(raw_value, 0.2, -102.4);

    raw_value=copyBitsFromByteArrayLE( byteArray, 22840, 4);
    @CAN_PrivMain::RFR_Object::RXX_Object_Obj43.ReferencePoint = convertRawToPhysical(raw_value, 1.0, 0.0);

    raw_value=copyBitsFromByteArrayLE( byteArray, 22700, 12);
    @CAN_PrivMain::RFR_Object::RXX_Object_Obj43.Vx = convertRawToPhysical(raw_value, 0.0625, -128.0);

    raw_value=copyBitsFromByteArrayLE( byteArray, 22924, 12);
    @CAN_PrivMain::RFR_Object::RXX_Object_Obj43.VxAxCoVnce = convertRawToPhysical(raw_value, 0.01, 0.0);

    raw_value=copyBitsFromByteArrayLE( byteArray, 22944, 12);
    @CAN_PrivMain::RFR_Object::RXX_Object_Obj43.VxAyCoVnce = convertRawToPhysical(raw_value, 0.01, 0.0);

    raw_value=copyBitsFromByteArrayLE( byteArray, 22720, 12);
    @CAN_PrivMain::RFR_Object::RXX_Object_Obj43.VxVnce = convertRawToPhysical(raw_value, 0.01, 0.0);

    raw_value=copyBitsFromByteArrayLE( byteArray, 22912, 12);
    @CAN_PrivMain::RFR_Object::RXX_Object_Obj43.VxVyCoVnce = convertRawToPhysical(raw_value, 0.01, 0.0);

    raw_value=copyBitsFromByteArrayLE( byteArray, 22734, 10);
    @CAN_PrivMain::RFR_Object::RXX_Object_Obj43.Vy = convertRawToPhysical(raw_value, 0.125, -64.0);

    raw_value=copyBitsFromByteArrayLE( byteArray, 22956, 12);
    @CAN_PrivMain::RFR_Object::RXX_Object_Obj43.VyAxCoVnce = convertRawToPhysical(raw_value, 0.01, 0.0);

    raw_value=copyBitsFromByteArrayLE( byteArray, 22976, 12);
    @CAN_PrivMain::RFR_Object::RXX_Object_Obj43.VyAyCoVnce = convertRawToPhysical(raw_value, 0.01, 0.0);

    raw_value=copyBitsFromByteArrayLE( byteArray, 22752, 12);
    @CAN_PrivMain::RFR_Object::RXX_Object_Obj43.VyVnce = convertRawToPhysical(raw_value, 0.01, 0.0);

    raw_value=copyBitsFromByteArrayLE( byteArray, 22648, 7);
    @CAN_PrivMain::RFR_Object::RXX_Object_Obj43.Width = convertRawToPhysical(raw_value, 0.125, 0.0);

    raw_value=copyBitsFromByteArrayLE( byteArray, 22656, 12);
    @CAN_PrivMain::RFR_Object::RXX_Object_Obj43.WidthVnce = convertRawToPhysical(raw_value, 0.01, 0.0);
}


void CRadarFR_RXX_Object_Obj44_SetDataReceived(byte byteArray[])
{
    qword raw_value;

    raw_value=copyBitsFromByteArrayLE( byteArray, 23520, 32);
    @CAN_PrivMain::RFR_Object::RXX_Object_Obj44.Age = convertRawToPhysical(raw_value, 1.0, 0.0);

    raw_value=copyBitsFromByteArrayLE( byteArray, 23116, 10);
    @CAN_PrivMain::RFR_Object::RXX_Object_Obj44.Ax = convertRawToPhysical(raw_value, 0.03125, -16.0);

    raw_value=copyBitsFromByteArrayLE( byteArray, 23500, 12);
    @CAN_PrivMain::RFR_Object::RXX_Object_Obj44.AxAyCoVnce = convertRawToPhysical(raw_value, 0.01, 0.0);

    raw_value=copyBitsFromByteArrayLE( byteArray, 23136, 12);
    @CAN_PrivMain::RFR_Object::RXX_Object_Obj44.AxVnce = convertRawToPhysical(raw_value, 0.01, 0.0);

    raw_value=copyBitsFromByteArrayLE( byteArray, 23190, 9);
    @CAN_PrivMain::RFR_Object::RXX_Object_Obj44.Ay = convertRawToPhysical(raw_value, 0.0625, -16.0);

    raw_value=copyBitsFromByteArrayLE( byteArray, 23200, 12);
    @CAN_PrivMain::RFR_Object::RXX_Object_Obj44.AyVnce = convertRawToPhysical(raw_value, 0.01, 0.0);

    raw_value=copyBitsFromByteArrayLE( byteArray, 23256, 6);
    @CAN_PrivMain::RFR_Object::RXX_Object_Obj44.ExistProb = convertRawToPhysical(raw_value, 2.0, 0.0);

    raw_value=copyBitsFromByteArrayLE( byteArray, 23320, 8);
    @CAN_PrivMain::RFR_Object::RXX_Object_Obj44.FilterInformation = convertRawToPhysical(raw_value, 1.0, 0.0);

    raw_value=copyBitsFromByteArrayLE( byteArray, 23096, 7);
    @CAN_PrivMain::RFR_Object::RXX_Object_Obj44.Length = convertRawToPhysical(raw_value, 0.125, 0.0);

    raw_value=copyBitsFromByteArrayLE( byteArray, 23104, 12);
    @CAN_PrivMain::RFR_Object::RXX_Object_Obj44.LengthVnce = convertRawToPhysical(raw_value, 0.01, 0.0);

    raw_value=copyBitsFromByteArrayLE( byteArray, 23288, 3);
    @CAN_PrivMain::RFR_Object::RXX_Object_Obj44.MeasurementStatus = convertRawToPhysical(raw_value, 1.0, 0.0);

    raw_value=copyBitsFromByteArrayLE( byteArray, 23244, 2);
    @CAN_PrivMain::RFR_Object::RXX_Object_Obj44.MovingStatus = convertRawToPhysical(raw_value, 1.0, 0.0);

    raw_value=copyBitsFromByteArrayLE( byteArray, 23224, 7);
    @CAN_PrivMain::RFR_Object::RXX_Object_Obj44.ObjId = convertRawToPhysical(raw_value, 1.0, 0.0);

    raw_value=copyBitsFromByteArrayLE( byteArray, 23126, 9);
    @CAN_PrivMain::RFR_Object::RXX_Object_Obj44.OrientationYaw = convertRawToPhysical(raw_value, 0.0175, -4.48);

    raw_value=copyBitsFromByteArrayLE( byteArray, 23148, 12);
    @CAN_PrivMain::RFR_Object::RXX_Object_Obj44.OrientationYawVnce = convertRawToPhysical(raw_value, 0.0003, 0.0);

    raw_value=copyBitsFromByteArrayLE( byteArray, 23040, 6);
    @CAN_PrivMain::RFR_Object::RXX_Object_Obj44.ProbClassConfidence = convertRawToPhysical(raw_value, 2.0, 0.0);

    raw_value=copyBitsFromByteArrayLE( byteArray, 23291, 4);
    @CAN_PrivMain::RFR_Object::RXX_Object_Obj44.ProbClassType = convertRawToPhysical(raw_value, 1.0, 0.0);

    raw_value=copyBitsFromByteArrayLE( byteArray, 23046, 14);
    @CAN_PrivMain::RFR_Object::RXX_Object_Obj44.Px = convertRawToPhysical(raw_value, 0.0625, -512.0);

    raw_value=copyBitsFromByteArrayLE( byteArray, 23360, 12);
    @CAN_PrivMain::RFR_Object::RXX_Object_Obj44.PxAxCoVnce = convertRawToPhysical(raw_value, 0.01, 0.0);

    raw_value=copyBitsFromByteArrayLE( byteArray, 23372, 12);
    @CAN_PrivMain::RFR_Object::RXX_Object_Obj44.PxAyCoVnce = convertRawToPhysical(raw_value, 0.01, 0.0);

    raw_value=copyBitsFromByteArrayLE( byteArray, 23276, 12);
    @CAN_PrivMain::RFR_Object::RXX_Object_Obj44.PxPyCoVnce = convertRawToPhysical(raw_value, 0.01, 0.0);

    raw_value=copyBitsFromByteArrayLE( byteArray, 23060, 12);
    @CAN_PrivMain::RFR_Object::RXX_Object_Obj44.PxVnce = convertRawToPhysical(raw_value, 0.1, 0.0);

    raw_value=copyBitsFromByteArrayLE( byteArray, 23296, 12);
    @CAN_PrivMain::RFR_Object::RXX_Object_Obj44.PxVxCoVnce = convertRawToPhysical(raw_value, 0.01, 0.0);

    raw_value=copyBitsFromByteArrayLE( byteArray, 23308, 12);
    @CAN_PrivMain::RFR_Object::RXX_Object_Obj44.PxVyCoVnce = convertRawToPhysical(raw_value, 0.01, 0.0);

    raw_value=copyBitsFromByteArrayLE( byteArray, 23072, 12);
    @CAN_PrivMain::RFR_Object::RXX_Object_Obj44.Py = convertRawToPhysical(raw_value, 0.0625, -128.0);

    raw_value=copyBitsFromByteArrayLE( byteArray, 23392, 12);
    @CAN_PrivMain::RFR_Object::RXX_Object_Obj44.PyAxCoVnce = convertRawToPhysical(raw_value, 0.01, 0.0);

    raw_value=copyBitsFromByteArrayLE( byteArray, 23404, 12);
    @CAN_PrivMain::RFR_Object::RXX_Object_Obj44.PyAyCoVnce = convertRawToPhysical(raw_value, 0.01, 0.0);

    raw_value=copyBitsFromByteArrayLE( byteArray, 23084, 12);
    @CAN_PrivMain::RFR_Object::RXX_Object_Obj44.PyVnce = convertRawToPhysical(raw_value, 0.1, 0.0);

    raw_value=copyBitsFromByteArrayLE( byteArray, 23328, 12);
    @CAN_PrivMain::RFR_Object::RXX_Object_Obj44.PyVxCoVnce = convertRawToPhysical(raw_value, 0.01, 0.0);

    raw_value=copyBitsFromByteArrayLE( byteArray, 23340, 12);
    @CAN_PrivMain::RFR_Object::RXX_Object_Obj44.PyVyCoVnce = convertRawToPhysical(raw_value, 0.01, 0.0);

    raw_value=copyBitsFromByteArrayLE( byteArray, 23180, 10);
    @CAN_PrivMain::RFR_Object::RXX_Object_Obj44.RCS = convertRawToPhysical(raw_value, 0.2, -102.4);

    raw_value=copyBitsFromByteArrayLE( byteArray, 23352, 4);
    @CAN_PrivMain::RFR_Object::RXX_Object_Obj44.ReferencePoint = convertRawToPhysical(raw_value, 1.0, 0.0);

    raw_value=copyBitsFromByteArrayLE( byteArray, 23212, 12);
    @CAN_PrivMain::RFR_Object::RXX_Object_Obj44.Vx = convertRawToPhysical(raw_value, 0.0625, -128.0);

    raw_value=copyBitsFromByteArrayLE( byteArray, 23436, 12);
    @CAN_PrivMain::RFR_Object::RXX_Object_Obj44.VxAxCoVnce = convertRawToPhysical(raw_value, 0.01, 0.0);

    raw_value=copyBitsFromByteArrayLE( byteArray, 23456, 12);
    @CAN_PrivMain::RFR_Object::RXX_Object_Obj44.VxAyCoVnce = convertRawToPhysical(raw_value, 0.01, 0.0);

    raw_value=copyBitsFromByteArrayLE( byteArray, 23232, 12);
    @CAN_PrivMain::RFR_Object::RXX_Object_Obj44.VxVnce = convertRawToPhysical(raw_value, 0.01, 0.0);

    raw_value=copyBitsFromByteArrayLE( byteArray, 23424, 12);
    @CAN_PrivMain::RFR_Object::RXX_Object_Obj44.VxVyCoVnce = convertRawToPhysical(raw_value, 0.01, 0.0);

    raw_value=copyBitsFromByteArrayLE( byteArray, 23246, 10);
    @CAN_PrivMain::RFR_Object::RXX_Object_Obj44.Vy = convertRawToPhysical(raw_value, 0.125, -64.0);

    raw_value=copyBitsFromByteArrayLE( byteArray, 23468, 12);
    @CAN_PrivMain::RFR_Object::RXX_Object_Obj44.VyAxCoVnce = convertRawToPhysical(raw_value, 0.01, 0.0);

    raw_value=copyBitsFromByteArrayLE( byteArray, 23488, 12);
    @CAN_PrivMain::RFR_Object::RXX_Object_Obj44.VyAyCoVnce = convertRawToPhysical(raw_value, 0.01, 0.0);

    raw_value=copyBitsFromByteArrayLE( byteArray, 23264, 12);
    @CAN_PrivMain::RFR_Object::RXX_Object_Obj44.VyVnce = convertRawToPhysical(raw_value, 0.01, 0.0);

    raw_value=copyBitsFromByteArrayLE( byteArray, 23160, 7);
    @CAN_PrivMain::RFR_Object::RXX_Object_Obj44.Width = convertRawToPhysical(raw_value, 0.125, 0.0);

    raw_value=copyBitsFromByteArrayLE( byteArray, 23168, 12);
    @CAN_PrivMain::RFR_Object::RXX_Object_Obj44.WidthVnce = convertRawToPhysical(raw_value, 0.01, 0.0);
}


void CRadarFR_RXX_Object_Obj45_SetDataReceived(byte byteArray[])
{
    qword raw_value;

    raw_value=copyBitsFromByteArrayLE( byteArray, 24032, 32);
    @CAN_PrivMain::RFR_Object::RXX_Object_Obj45.Age = convertRawToPhysical(raw_value, 1.0, 0.0);

    raw_value=copyBitsFromByteArrayLE( byteArray, 23628, 10);
    @CAN_PrivMain::RFR_Object::RXX_Object_Obj45.Ax = convertRawToPhysical(raw_value, 0.03125, -16.0);

    raw_value=copyBitsFromByteArrayLE( byteArray, 24012, 12);
    @CAN_PrivMain::RFR_Object::RXX_Object_Obj45.AxAyCoVnce = convertRawToPhysical(raw_value, 0.01, 0.0);

    raw_value=copyBitsFromByteArrayLE( byteArray, 23648, 12);
    @CAN_PrivMain::RFR_Object::RXX_Object_Obj45.AxVnce = convertRawToPhysical(raw_value, 0.01, 0.0);

    raw_value=copyBitsFromByteArrayLE( byteArray, 23702, 9);
    @CAN_PrivMain::RFR_Object::RXX_Object_Obj45.Ay = convertRawToPhysical(raw_value, 0.0625, -16.0);

    raw_value=copyBitsFromByteArrayLE( byteArray, 23712, 12);
    @CAN_PrivMain::RFR_Object::RXX_Object_Obj45.AyVnce = convertRawToPhysical(raw_value, 0.01, 0.0);

    raw_value=copyBitsFromByteArrayLE( byteArray, 23768, 6);
    @CAN_PrivMain::RFR_Object::RXX_Object_Obj45.ExistProb = convertRawToPhysical(raw_value, 2.0, 0.0);

    raw_value=copyBitsFromByteArrayLE( byteArray, 23832, 8);
    @CAN_PrivMain::RFR_Object::RXX_Object_Obj45.FilterInformation = convertRawToPhysical(raw_value, 1.0, 0.0);

    raw_value=copyBitsFromByteArrayLE( byteArray, 23608, 7);
    @CAN_PrivMain::RFR_Object::RXX_Object_Obj45.Length = convertRawToPhysical(raw_value, 0.125, 0.0);

    raw_value=copyBitsFromByteArrayLE( byteArray, 23616, 12);
    @CAN_PrivMain::RFR_Object::RXX_Object_Obj45.LengthVnce = convertRawToPhysical(raw_value, 0.01, 0.0);

    raw_value=copyBitsFromByteArrayLE( byteArray, 23800, 3);
    @CAN_PrivMain::RFR_Object::RXX_Object_Obj45.MeasurementStatus = convertRawToPhysical(raw_value, 1.0, 0.0);

    raw_value=copyBitsFromByteArrayLE( byteArray, 23756, 2);
    @CAN_PrivMain::RFR_Object::RXX_Object_Obj45.MovingStatus = convertRawToPhysical(raw_value, 1.0, 0.0);

    raw_value=copyBitsFromByteArrayLE( byteArray, 23736, 7);
    @CAN_PrivMain::RFR_Object::RXX_Object_Obj45.ObjId = convertRawToPhysical(raw_value, 1.0, 0.0);

    raw_value=copyBitsFromByteArrayLE( byteArray, 23638, 9);
    @CAN_PrivMain::RFR_Object::RXX_Object_Obj45.OrientationYaw = convertRawToPhysical(raw_value, 0.0175, -4.48);

    raw_value=copyBitsFromByteArrayLE( byteArray, 23660, 12);
    @CAN_PrivMain::RFR_Object::RXX_Object_Obj45.OrientationYawVnce = convertRawToPhysical(raw_value, 0.0003, 0.0);

    raw_value=copyBitsFromByteArrayLE( byteArray, 23552, 6);
    @CAN_PrivMain::RFR_Object::RXX_Object_Obj45.ProbClassConfidence = convertRawToPhysical(raw_value, 2.0, 0.0);

    raw_value=copyBitsFromByteArrayLE( byteArray, 23803, 4);
    @CAN_PrivMain::RFR_Object::RXX_Object_Obj45.ProbClassType = convertRawToPhysical(raw_value, 1.0, 0.0);

    raw_value=copyBitsFromByteArrayLE( byteArray, 23558, 14);
    @CAN_PrivMain::RFR_Object::RXX_Object_Obj45.Px = convertRawToPhysical(raw_value, 0.0625, -512.0);

    raw_value=copyBitsFromByteArrayLE( byteArray, 23872, 12);
    @CAN_PrivMain::RFR_Object::RXX_Object_Obj45.PxAxCoVnce = convertRawToPhysical(raw_value, 0.01, 0.0);

    raw_value=copyBitsFromByteArrayLE( byteArray, 23884, 12);
    @CAN_PrivMain::RFR_Object::RXX_Object_Obj45.PxAyCoVnce = convertRawToPhysical(raw_value, 0.01, 0.0);

    raw_value=copyBitsFromByteArrayLE( byteArray, 23788, 12);
    @CAN_PrivMain::RFR_Object::RXX_Object_Obj45.PxPyCoVnce = convertRawToPhysical(raw_value, 0.01, 0.0);

    raw_value=copyBitsFromByteArrayLE( byteArray, 23572, 12);
    @CAN_PrivMain::RFR_Object::RXX_Object_Obj45.PxVnce = convertRawToPhysical(raw_value, 0.1, 0.0);

    raw_value=copyBitsFromByteArrayLE( byteArray, 23808, 12);
    @CAN_PrivMain::RFR_Object::RXX_Object_Obj45.PxVxCoVnce = convertRawToPhysical(raw_value, 0.01, 0.0);

    raw_value=copyBitsFromByteArrayLE( byteArray, 23820, 12);
    @CAN_PrivMain::RFR_Object::RXX_Object_Obj45.PxVyCoVnce = convertRawToPhysical(raw_value, 0.01, 0.0);

    raw_value=copyBitsFromByteArrayLE( byteArray, 23584, 12);
    @CAN_PrivMain::RFR_Object::RXX_Object_Obj45.Py = convertRawToPhysical(raw_value, 0.0625, -128.0);

    raw_value=copyBitsFromByteArrayLE( byteArray, 23904, 12);
    @CAN_PrivMain::RFR_Object::RXX_Object_Obj45.PyAxCoVnce = convertRawToPhysical(raw_value, 0.01, 0.0);

    raw_value=copyBitsFromByteArrayLE( byteArray, 23916, 12);
    @CAN_PrivMain::RFR_Object::RXX_Object_Obj45.PyAyCoVnce = convertRawToPhysical(raw_value, 0.01, 0.0);

    raw_value=copyBitsFromByteArrayLE( byteArray, 23596, 12);
    @CAN_PrivMain::RFR_Object::RXX_Object_Obj45.PyVnce = convertRawToPhysical(raw_value, 0.1, 0.0);

    raw_value=copyBitsFromByteArrayLE( byteArray, 23840, 12);
    @CAN_PrivMain::RFR_Object::RXX_Object_Obj45.PyVxCoVnce = convertRawToPhysical(raw_value, 0.01, 0.0);

    raw_value=copyBitsFromByteArrayLE( byteArray, 23852, 12);
    @CAN_PrivMain::RFR_Object::RXX_Object_Obj45.PyVyCoVnce = convertRawToPhysical(raw_value, 0.01, 0.0);

    raw_value=copyBitsFromByteArrayLE( byteArray, 23692, 10);
    @CAN_PrivMain::RFR_Object::RXX_Object_Obj45.RCS = convertRawToPhysical(raw_value, 0.2, -102.4);

    raw_value=copyBitsFromByteArrayLE( byteArray, 23864, 4);
    @CAN_PrivMain::RFR_Object::RXX_Object_Obj45.ReferencePoint = convertRawToPhysical(raw_value, 1.0, 0.0);

    raw_value=copyBitsFromByteArrayLE( byteArray, 23724, 12);
    @CAN_PrivMain::RFR_Object::RXX_Object_Obj45.Vx = convertRawToPhysical(raw_value, 0.0625, -128.0);

    raw_value=copyBitsFromByteArrayLE( byteArray, 23948, 12);
    @CAN_PrivMain::RFR_Object::RXX_Object_Obj45.VxAxCoVnce = convertRawToPhysical(raw_value, 0.01, 0.0);

    raw_value=copyBitsFromByteArrayLE( byteArray, 23968, 12);
    @CAN_PrivMain::RFR_Object::RXX_Object_Obj45.VxAyCoVnce = convertRawToPhysical(raw_value, 0.01, 0.0);

    raw_value=copyBitsFromByteArrayLE( byteArray, 23744, 12);
    @CAN_PrivMain::RFR_Object::RXX_Object_Obj45.VxVnce = convertRawToPhysical(raw_value, 0.01, 0.0);

    raw_value=copyBitsFromByteArrayLE( byteArray, 23936, 12);
    @CAN_PrivMain::RFR_Object::RXX_Object_Obj45.VxVyCoVnce = convertRawToPhysical(raw_value, 0.01, 0.0);

    raw_value=copyBitsFromByteArrayLE( byteArray, 23758, 10);
    @CAN_PrivMain::RFR_Object::RXX_Object_Obj45.Vy = convertRawToPhysical(raw_value, 0.125, -64.0);

    raw_value=copyBitsFromByteArrayLE( byteArray, 23980, 12);
    @CAN_PrivMain::RFR_Object::RXX_Object_Obj45.VyAxCoVnce = convertRawToPhysical(raw_value, 0.01, 0.0);

    raw_value=copyBitsFromByteArrayLE( byteArray, 24000, 12);
    @CAN_PrivMain::RFR_Object::RXX_Object_Obj45.VyAyCoVnce = convertRawToPhysical(raw_value, 0.01, 0.0);

    raw_value=copyBitsFromByteArrayLE( byteArray, 23776, 12);
    @CAN_PrivMain::RFR_Object::RXX_Object_Obj45.VyVnce = convertRawToPhysical(raw_value, 0.01, 0.0);

    raw_value=copyBitsFromByteArrayLE( byteArray, 23672, 7);
    @CAN_PrivMain::RFR_Object::RXX_Object_Obj45.Width = convertRawToPhysical(raw_value, 0.125, 0.0);

    raw_value=copyBitsFromByteArrayLE( byteArray, 23680, 12);
    @CAN_PrivMain::RFR_Object::RXX_Object_Obj45.WidthVnce = convertRawToPhysical(raw_value, 0.01, 0.0);
}


void CRadarFR_RXX_Object_Obj46_SetDataReceived(byte byteArray[])
{
    qword raw_value;

    raw_value=copyBitsFromByteArrayLE( byteArray, 24544, 32);
    @CAN_PrivMain::RFR_Object::RXX_Object_Obj46.Age = convertRawToPhysical(raw_value, 1.0, 0.0);

    raw_value=copyBitsFromByteArrayLE( byteArray, 24140, 10);
    @CAN_PrivMain::RFR_Object::RXX_Object_Obj46.Ax = convertRawToPhysical(raw_value, 0.03125, -16.0);

    raw_value=copyBitsFromByteArrayLE( byteArray, 24524, 12);
    @CAN_PrivMain::RFR_Object::RXX_Object_Obj46.AxAyCoVnce = convertRawToPhysical(raw_value, 0.01, 0.0);

    raw_value=copyBitsFromByteArrayLE( byteArray, 24160, 12);
    @CAN_PrivMain::RFR_Object::RXX_Object_Obj46.AxVnce = convertRawToPhysical(raw_value, 0.01, 0.0);

    raw_value=copyBitsFromByteArrayLE( byteArray, 24214, 9);
    @CAN_PrivMain::RFR_Object::RXX_Object_Obj46.Ay = convertRawToPhysical(raw_value, 0.0625, -16.0);

    raw_value=copyBitsFromByteArrayLE( byteArray, 24224, 12);
    @CAN_PrivMain::RFR_Object::RXX_Object_Obj46.AyVnce = convertRawToPhysical(raw_value, 0.01, 0.0);

    raw_value=copyBitsFromByteArrayLE( byteArray, 24280, 6);
    @CAN_PrivMain::RFR_Object::RXX_Object_Obj46.ExistProb = convertRawToPhysical(raw_value, 2.0, 0.0);

    raw_value=copyBitsFromByteArrayLE( byteArray, 24344, 8);
    @CAN_PrivMain::RFR_Object::RXX_Object_Obj46.FilterInformation = convertRawToPhysical(raw_value, 1.0, 0.0);

    raw_value=copyBitsFromByteArrayLE( byteArray, 24120, 7);
    @CAN_PrivMain::RFR_Object::RXX_Object_Obj46.Length = convertRawToPhysical(raw_value, 0.125, 0.0);

    raw_value=copyBitsFromByteArrayLE( byteArray, 24128, 12);
    @CAN_PrivMain::RFR_Object::RXX_Object_Obj46.LengthVnce = convertRawToPhysical(raw_value, 0.01, 0.0);

    raw_value=copyBitsFromByteArrayLE( byteArray, 24312, 3);
    @CAN_PrivMain::RFR_Object::RXX_Object_Obj46.MeasurementStatus = convertRawToPhysical(raw_value, 1.0, 0.0);

    raw_value=copyBitsFromByteArrayLE( byteArray, 24268, 2);
    @CAN_PrivMain::RFR_Object::RXX_Object_Obj46.MovingStatus = convertRawToPhysical(raw_value, 1.0, 0.0);

    raw_value=copyBitsFromByteArrayLE( byteArray, 24248, 7);
    @CAN_PrivMain::RFR_Object::RXX_Object_Obj46.ObjId = convertRawToPhysical(raw_value, 1.0, 0.0);

    raw_value=copyBitsFromByteArrayLE( byteArray, 24150, 9);
    @CAN_PrivMain::RFR_Object::RXX_Object_Obj46.OrientationYaw = convertRawToPhysical(raw_value, 0.0175, -4.48);

    raw_value=copyBitsFromByteArrayLE( byteArray, 24172, 12);
    @CAN_PrivMain::RFR_Object::RXX_Object_Obj46.OrientationYawVnce = convertRawToPhysical(raw_value, 0.0003, 0.0);

    raw_value=copyBitsFromByteArrayLE( byteArray, 24064, 6);
    @CAN_PrivMain::RFR_Object::RXX_Object_Obj46.ProbClassConfidence = convertRawToPhysical(raw_value, 2.0, 0.0);

    raw_value=copyBitsFromByteArrayLE( byteArray, 24315, 4);
    @CAN_PrivMain::RFR_Object::RXX_Object_Obj46.ProbClassType = convertRawToPhysical(raw_value, 1.0, 0.0);

    raw_value=copyBitsFromByteArrayLE( byteArray, 24070, 14);
    @CAN_PrivMain::RFR_Object::RXX_Object_Obj46.Px = convertRawToPhysical(raw_value, 0.0625, -512.0);

    raw_value=copyBitsFromByteArrayLE( byteArray, 24384, 12);
    @CAN_PrivMain::RFR_Object::RXX_Object_Obj46.PxAxCoVnce = convertRawToPhysical(raw_value, 0.01, 0.0);

    raw_value=copyBitsFromByteArrayLE( byteArray, 24396, 12);
    @CAN_PrivMain::RFR_Object::RXX_Object_Obj46.PxAyCoVnce = convertRawToPhysical(raw_value, 0.01, 0.0);

    raw_value=copyBitsFromByteArrayLE( byteArray, 24300, 12);
    @CAN_PrivMain::RFR_Object::RXX_Object_Obj46.PxPyCoVnce = convertRawToPhysical(raw_value, 0.01, 0.0);

    raw_value=copyBitsFromByteArrayLE( byteArray, 24084, 12);
    @CAN_PrivMain::RFR_Object::RXX_Object_Obj46.PxVnce = convertRawToPhysical(raw_value, 0.1, 0.0);

    raw_value=copyBitsFromByteArrayLE( byteArray, 24320, 12);
    @CAN_PrivMain::RFR_Object::RXX_Object_Obj46.PxVxCoVnce = convertRawToPhysical(raw_value, 0.01, 0.0);

    raw_value=copyBitsFromByteArrayLE( byteArray, 24332, 12);
    @CAN_PrivMain::RFR_Object::RXX_Object_Obj46.PxVyCoVnce = convertRawToPhysical(raw_value, 0.01, 0.0);

    raw_value=copyBitsFromByteArrayLE( byteArray, 24096, 12);
    @CAN_PrivMain::RFR_Object::RXX_Object_Obj46.Py = convertRawToPhysical(raw_value, 0.0625, -128.0);

    raw_value=copyBitsFromByteArrayLE( byteArray, 24416, 12);
    @CAN_PrivMain::RFR_Object::RXX_Object_Obj46.PyAxCoVnce = convertRawToPhysical(raw_value, 0.01, 0.0);

    raw_value=copyBitsFromByteArrayLE( byteArray, 24428, 12);
    @CAN_PrivMain::RFR_Object::RXX_Object_Obj46.PyAyCoVnce = convertRawToPhysical(raw_value, 0.01, 0.0);

    raw_value=copyBitsFromByteArrayLE( byteArray, 24108, 12);
    @CAN_PrivMain::RFR_Object::RXX_Object_Obj46.PyVnce = convertRawToPhysical(raw_value, 0.1, 0.0);

    raw_value=copyBitsFromByteArrayLE( byteArray, 24352, 12);
    @CAN_PrivMain::RFR_Object::RXX_Object_Obj46.PyVxCoVnce = convertRawToPhysical(raw_value, 0.01, 0.0);

    raw_value=copyBitsFromByteArrayLE( byteArray, 24364, 12);
    @CAN_PrivMain::RFR_Object::RXX_Object_Obj46.PyVyCoVnce = convertRawToPhysical(raw_value, 0.01, 0.0);

    raw_value=copyBitsFromByteArrayLE( byteArray, 24204, 10);
    @CAN_PrivMain::RFR_Object::RXX_Object_Obj46.RCS = convertRawToPhysical(raw_value, 0.2, -102.4);

    raw_value=copyBitsFromByteArrayLE( byteArray, 24376, 4);
    @CAN_PrivMain::RFR_Object::RXX_Object_Obj46.ReferencePoint = convertRawToPhysical(raw_value, 1.0, 0.0);

    raw_value=copyBitsFromByteArrayLE( byteArray, 24236, 12);
    @CAN_PrivMain::RFR_Object::RXX_Object_Obj46.Vx = convertRawToPhysical(raw_value, 0.0625, -128.0);

    raw_value=copyBitsFromByteArrayLE( byteArray, 24460, 12);
    @CAN_PrivMain::RFR_Object::RXX_Object_Obj46.VxAxCoVnce = convertRawToPhysical(raw_value, 0.01, 0.0);

    raw_value=copyBitsFromByteArrayLE( byteArray, 24480, 12);
    @CAN_PrivMain::RFR_Object::RXX_Object_Obj46.VxAyCoVnce = convertRawToPhysical(raw_value, 0.01, 0.0);

    raw_value=copyBitsFromByteArrayLE( byteArray, 24256, 12);
    @CAN_PrivMain::RFR_Object::RXX_Object_Obj46.VxVnce = convertRawToPhysical(raw_value, 0.01, 0.0);

    raw_value=copyBitsFromByteArrayLE( byteArray, 24448, 12);
    @CAN_PrivMain::RFR_Object::RXX_Object_Obj46.VxVyCoVnce = convertRawToPhysical(raw_value, 0.01, 0.0);

    raw_value=copyBitsFromByteArrayLE( byteArray, 24270, 10);
    @CAN_PrivMain::RFR_Object::RXX_Object_Obj46.Vy = convertRawToPhysical(raw_value, 0.125, -64.0);

    raw_value=copyBitsFromByteArrayLE( byteArray, 24492, 12);
    @CAN_PrivMain::RFR_Object::RXX_Object_Obj46.VyAxCoVnce = convertRawToPhysical(raw_value, 0.01, 0.0);

    raw_value=copyBitsFromByteArrayLE( byteArray, 24512, 12);
    @CAN_PrivMain::RFR_Object::RXX_Object_Obj46.VyAyCoVnce = convertRawToPhysical(raw_value, 0.01, 0.0);

    raw_value=copyBitsFromByteArrayLE( byteArray, 24288, 12);
    @CAN_PrivMain::RFR_Object::RXX_Object_Obj46.VyVnce = convertRawToPhysical(raw_value, 0.01, 0.0);

    raw_value=copyBitsFromByteArrayLE( byteArray, 24184, 7);
    @CAN_PrivMain::RFR_Object::RXX_Object_Obj46.Width = convertRawToPhysical(raw_value, 0.125, 0.0);

    raw_value=copyBitsFromByteArrayLE( byteArray, 24192, 12);
    @CAN_PrivMain::RFR_Object::RXX_Object_Obj46.WidthVnce = convertRawToPhysical(raw_value, 0.01, 0.0);
}


void CRadarFR_RXX_Object_Obj47_SetDataReceived(byte byteArray[])
{
    qword raw_value;

    raw_value=copyBitsFromByteArrayLE( byteArray, 25056, 32);
    @CAN_PrivMain::RFR_Object::RXX_Object_Obj47.Age = convertRawToPhysical(raw_value, 1.0, 0.0);

    raw_value=copyBitsFromByteArrayLE( byteArray, 24652, 10);
    @CAN_PrivMain::RFR_Object::RXX_Object_Obj47.Ax = convertRawToPhysical(raw_value, 0.03125, -16.0);

    raw_value=copyBitsFromByteArrayLE( byteArray, 25036, 12);
    @CAN_PrivMain::RFR_Object::RXX_Object_Obj47.AxAyCoVnce = convertRawToPhysical(raw_value, 0.01, 0.0);

    raw_value=copyBitsFromByteArrayLE( byteArray, 24672, 12);
    @CAN_PrivMain::RFR_Object::RXX_Object_Obj47.AxVnce = convertRawToPhysical(raw_value, 0.01, 0.0);

    raw_value=copyBitsFromByteArrayLE( byteArray, 24726, 9);
    @CAN_PrivMain::RFR_Object::RXX_Object_Obj47.Ay = convertRawToPhysical(raw_value, 0.0625, -16.0);

    raw_value=copyBitsFromByteArrayLE( byteArray, 24736, 12);
    @CAN_PrivMain::RFR_Object::RXX_Object_Obj47.AyVnce = convertRawToPhysical(raw_value, 0.01, 0.0);

    raw_value=copyBitsFromByteArrayLE( byteArray, 24792, 6);
    @CAN_PrivMain::RFR_Object::RXX_Object_Obj47.ExistProb = convertRawToPhysical(raw_value, 2.0, 0.0);

    raw_value=copyBitsFromByteArrayLE( byteArray, 24856, 8);
    @CAN_PrivMain::RFR_Object::RXX_Object_Obj47.FilterInformation = convertRawToPhysical(raw_value, 1.0, 0.0);

    raw_value=copyBitsFromByteArrayLE( byteArray, 24632, 7);
    @CAN_PrivMain::RFR_Object::RXX_Object_Obj47.Length = convertRawToPhysical(raw_value, 0.125, 0.0);

    raw_value=copyBitsFromByteArrayLE( byteArray, 24640, 12);
    @CAN_PrivMain::RFR_Object::RXX_Object_Obj47.LengthVnce = convertRawToPhysical(raw_value, 0.01, 0.0);

    raw_value=copyBitsFromByteArrayLE( byteArray, 24824, 3);
    @CAN_PrivMain::RFR_Object::RXX_Object_Obj47.MeasurementStatus = convertRawToPhysical(raw_value, 1.0, 0.0);

    raw_value=copyBitsFromByteArrayLE( byteArray, 24780, 2);
    @CAN_PrivMain::RFR_Object::RXX_Object_Obj47.MovingStatus = convertRawToPhysical(raw_value, 1.0, 0.0);

    raw_value=copyBitsFromByteArrayLE( byteArray, 24760, 7);
    @CAN_PrivMain::RFR_Object::RXX_Object_Obj47.ObjId = convertRawToPhysical(raw_value, 1.0, 0.0);

    raw_value=copyBitsFromByteArrayLE( byteArray, 24662, 9);
    @CAN_PrivMain::RFR_Object::RXX_Object_Obj47.OrientationYaw = convertRawToPhysical(raw_value, 0.0175, -4.48);

    raw_value=copyBitsFromByteArrayLE( byteArray, 24684, 12);
    @CAN_PrivMain::RFR_Object::RXX_Object_Obj47.OrientationYawVnce = convertRawToPhysical(raw_value, 0.0003, 0.0);

    raw_value=copyBitsFromByteArrayLE( byteArray, 24576, 6);
    @CAN_PrivMain::RFR_Object::RXX_Object_Obj47.ProbClassConfidence = convertRawToPhysical(raw_value, 2.0, 0.0);

    raw_value=copyBitsFromByteArrayLE( byteArray, 24827, 4);
    @CAN_PrivMain::RFR_Object::RXX_Object_Obj47.ProbClassType = convertRawToPhysical(raw_value, 1.0, 0.0);

    raw_value=copyBitsFromByteArrayLE( byteArray, 24582, 14);
    @CAN_PrivMain::RFR_Object::RXX_Object_Obj47.Px = convertRawToPhysical(raw_value, 0.0625, -512.0);

    raw_value=copyBitsFromByteArrayLE( byteArray, 24896, 12);
    @CAN_PrivMain::RFR_Object::RXX_Object_Obj47.PxAxCoVnce = convertRawToPhysical(raw_value, 0.01, 0.0);

    raw_value=copyBitsFromByteArrayLE( byteArray, 24908, 12);
    @CAN_PrivMain::RFR_Object::RXX_Object_Obj47.PxAyCoVnce = convertRawToPhysical(raw_value, 0.01, 0.0);

    raw_value=copyBitsFromByteArrayLE( byteArray, 24812, 12);
    @CAN_PrivMain::RFR_Object::RXX_Object_Obj47.PxPyCoVnce = convertRawToPhysical(raw_value, 0.01, 0.0);

    raw_value=copyBitsFromByteArrayLE( byteArray, 24596, 12);
    @CAN_PrivMain::RFR_Object::RXX_Object_Obj47.PxVnce = convertRawToPhysical(raw_value, 0.1, 0.0);

    raw_value=copyBitsFromByteArrayLE( byteArray, 24832, 12);
    @CAN_PrivMain::RFR_Object::RXX_Object_Obj47.PxVxCoVnce = convertRawToPhysical(raw_value, 0.01, 0.0);

    raw_value=copyBitsFromByteArrayLE( byteArray, 24844, 12);
    @CAN_PrivMain::RFR_Object::RXX_Object_Obj47.PxVyCoVnce = convertRawToPhysical(raw_value, 0.01, 0.0);

    raw_value=copyBitsFromByteArrayLE( byteArray, 24608, 12);
    @CAN_PrivMain::RFR_Object::RXX_Object_Obj47.Py = convertRawToPhysical(raw_value, 0.0625, -128.0);

    raw_value=copyBitsFromByteArrayLE( byteArray, 24928, 12);
    @CAN_PrivMain::RFR_Object::RXX_Object_Obj47.PyAxCoVnce = convertRawToPhysical(raw_value, 0.01, 0.0);

    raw_value=copyBitsFromByteArrayLE( byteArray, 24940, 12);
    @CAN_PrivMain::RFR_Object::RXX_Object_Obj47.PyAyCoVnce = convertRawToPhysical(raw_value, 0.01, 0.0);

    raw_value=copyBitsFromByteArrayLE( byteArray, 24620, 12);
    @CAN_PrivMain::RFR_Object::RXX_Object_Obj47.PyVnce = convertRawToPhysical(raw_value, 0.1, 0.0);

    raw_value=copyBitsFromByteArrayLE( byteArray, 24864, 12);
    @CAN_PrivMain::RFR_Object::RXX_Object_Obj47.PyVxCoVnce = convertRawToPhysical(raw_value, 0.01, 0.0);

    raw_value=copyBitsFromByteArrayLE( byteArray, 24876, 12);
    @CAN_PrivMain::RFR_Object::RXX_Object_Obj47.PyVyCoVnce = convertRawToPhysical(raw_value, 0.01, 0.0);

    raw_value=copyBitsFromByteArrayLE( byteArray, 24716, 10);
    @CAN_PrivMain::RFR_Object::RXX_Object_Obj47.RCS = convertRawToPhysical(raw_value, 0.2, -102.4);

    raw_value=copyBitsFromByteArrayLE( byteArray, 24888, 4);
    @CAN_PrivMain::RFR_Object::RXX_Object_Obj47.ReferencePoint = convertRawToPhysical(raw_value, 1.0, 0.0);

    raw_value=copyBitsFromByteArrayLE( byteArray, 24748, 12);
    @CAN_PrivMain::RFR_Object::RXX_Object_Obj47.Vx = convertRawToPhysical(raw_value, 0.0625, -128.0);

    raw_value=copyBitsFromByteArrayLE( byteArray, 24972, 12);
    @CAN_PrivMain::RFR_Object::RXX_Object_Obj47.VxAxCoVnce = convertRawToPhysical(raw_value, 0.01, 0.0);

    raw_value=copyBitsFromByteArrayLE( byteArray, 24992, 12);
    @CAN_PrivMain::RFR_Object::RXX_Object_Obj47.VxAyCoVnce = convertRawToPhysical(raw_value, 0.01, 0.0);

    raw_value=copyBitsFromByteArrayLE( byteArray, 24768, 12);
    @CAN_PrivMain::RFR_Object::RXX_Object_Obj47.VxVnce = convertRawToPhysical(raw_value, 0.01, 0.0);

    raw_value=copyBitsFromByteArrayLE( byteArray, 24960, 12);
    @CAN_PrivMain::RFR_Object::RXX_Object_Obj47.VxVyCoVnce = convertRawToPhysical(raw_value, 0.01, 0.0);

    raw_value=copyBitsFromByteArrayLE( byteArray, 24782, 10);
    @CAN_PrivMain::RFR_Object::RXX_Object_Obj47.Vy = convertRawToPhysical(raw_value, 0.125, -64.0);

    raw_value=copyBitsFromByteArrayLE( byteArray, 25004, 12);
    @CAN_PrivMain::RFR_Object::RXX_Object_Obj47.VyAxCoVnce = convertRawToPhysical(raw_value, 0.01, 0.0);

    raw_value=copyBitsFromByteArrayLE( byteArray, 25024, 12);
    @CAN_PrivMain::RFR_Object::RXX_Object_Obj47.VyAyCoVnce = convertRawToPhysical(raw_value, 0.01, 0.0);

    raw_value=copyBitsFromByteArrayLE( byteArray, 24800, 12);
    @CAN_PrivMain::RFR_Object::RXX_Object_Obj47.VyVnce = convertRawToPhysical(raw_value, 0.01, 0.0);

    raw_value=copyBitsFromByteArrayLE( byteArray, 24696, 7);
    @CAN_PrivMain::RFR_Object::RXX_Object_Obj47.Width = convertRawToPhysical(raw_value, 0.125, 0.0);

    raw_value=copyBitsFromByteArrayLE( byteArray, 24704, 12);
    @CAN_PrivMain::RFR_Object::RXX_Object_Obj47.WidthVnce = convertRawToPhysical(raw_value, 0.01, 0.0);
}


void CRadarFR_RXX_Object_Obj48_SetDataReceived(byte byteArray[])
{
    qword raw_value;

    raw_value=copyBitsFromByteArrayLE( byteArray, 25568, 32);
    @CAN_PrivMain::RFR_Object::RXX_Object_Obj48.Age = convertRawToPhysical(raw_value, 1.0, 0.0);

    raw_value=copyBitsFromByteArrayLE( byteArray, 25164, 10);
    @CAN_PrivMain::RFR_Object::RXX_Object_Obj48.Ax = convertRawToPhysical(raw_value, 0.03125, -16.0);

    raw_value=copyBitsFromByteArrayLE( byteArray, 25548, 12);
    @CAN_PrivMain::RFR_Object::RXX_Object_Obj48.AxAyCoVnce = convertRawToPhysical(raw_value, 0.01, 0.0);

    raw_value=copyBitsFromByteArrayLE( byteArray, 25184, 12);
    @CAN_PrivMain::RFR_Object::RXX_Object_Obj48.AxVnce = convertRawToPhysical(raw_value, 0.01, 0.0);

    raw_value=copyBitsFromByteArrayLE( byteArray, 25238, 9);
    @CAN_PrivMain::RFR_Object::RXX_Object_Obj48.Ay = convertRawToPhysical(raw_value, 0.0625, -16.0);

    raw_value=copyBitsFromByteArrayLE( byteArray, 25248, 12);
    @CAN_PrivMain::RFR_Object::RXX_Object_Obj48.AyVnce = convertRawToPhysical(raw_value, 0.01, 0.0);

    raw_value=copyBitsFromByteArrayLE( byteArray, 25304, 6);
    @CAN_PrivMain::RFR_Object::RXX_Object_Obj48.ExistProb = convertRawToPhysical(raw_value, 2.0, 0.0);

    raw_value=copyBitsFromByteArrayLE( byteArray, 25368, 8);
    @CAN_PrivMain::RFR_Object::RXX_Object_Obj48.FilterInformation = convertRawToPhysical(raw_value, 1.0, 0.0);

    raw_value=copyBitsFromByteArrayLE( byteArray, 25144, 7);
    @CAN_PrivMain::RFR_Object::RXX_Object_Obj48.Length = convertRawToPhysical(raw_value, 0.125, 0.0);

    raw_value=copyBitsFromByteArrayLE( byteArray, 25152, 12);
    @CAN_PrivMain::RFR_Object::RXX_Object_Obj48.LengthVnce = convertRawToPhysical(raw_value, 0.01, 0.0);

    raw_value=copyBitsFromByteArrayLE( byteArray, 25336, 3);
    @CAN_PrivMain::RFR_Object::RXX_Object_Obj48.MeasurementStatus = convertRawToPhysical(raw_value, 1.0, 0.0);

    raw_value=copyBitsFromByteArrayLE( byteArray, 25292, 2);
    @CAN_PrivMain::RFR_Object::RXX_Object_Obj48.MovingStatus = convertRawToPhysical(raw_value, 1.0, 0.0);

    raw_value=copyBitsFromByteArrayLE( byteArray, 25272, 7);
    @CAN_PrivMain::RFR_Object::RXX_Object_Obj48.ObjId = convertRawToPhysical(raw_value, 1.0, 0.0);

    raw_value=copyBitsFromByteArrayLE( byteArray, 25174, 9);
    @CAN_PrivMain::RFR_Object::RXX_Object_Obj48.OrientationYaw = convertRawToPhysical(raw_value, 0.0175, -4.48);

    raw_value=copyBitsFromByteArrayLE( byteArray, 25196, 12);
    @CAN_PrivMain::RFR_Object::RXX_Object_Obj48.OrientationYawVnce = convertRawToPhysical(raw_value, 0.0003, 0.0);

    raw_value=copyBitsFromByteArrayLE( byteArray, 25088, 6);
    @CAN_PrivMain::RFR_Object::RXX_Object_Obj48.ProbClassConfidence = convertRawToPhysical(raw_value, 2.0, 0.0);

    raw_value=copyBitsFromByteArrayLE( byteArray, 25339, 4);
    @CAN_PrivMain::RFR_Object::RXX_Object_Obj48.ProbClassType = convertRawToPhysical(raw_value, 1.0, 0.0);

    raw_value=copyBitsFromByteArrayLE( byteArray, 25094, 14);
    @CAN_PrivMain::RFR_Object::RXX_Object_Obj48.Px = convertRawToPhysical(raw_value, 0.0625, -512.0);

    raw_value=copyBitsFromByteArrayLE( byteArray, 25408, 12);
    @CAN_PrivMain::RFR_Object::RXX_Object_Obj48.PxAxCoVnce = convertRawToPhysical(raw_value, 0.01, 0.0);

    raw_value=copyBitsFromByteArrayLE( byteArray, 25420, 12);
    @CAN_PrivMain::RFR_Object::RXX_Object_Obj48.PxAyCoVnce = convertRawToPhysical(raw_value, 0.01, 0.0);

    raw_value=copyBitsFromByteArrayLE( byteArray, 25324, 12);
    @CAN_PrivMain::RFR_Object::RXX_Object_Obj48.PxPyCoVnce = convertRawToPhysical(raw_value, 0.01, 0.0);

    raw_value=copyBitsFromByteArrayLE( byteArray, 25108, 12);
    @CAN_PrivMain::RFR_Object::RXX_Object_Obj48.PxVnce = convertRawToPhysical(raw_value, 0.1, 0.0);

    raw_value=copyBitsFromByteArrayLE( byteArray, 25344, 12);
    @CAN_PrivMain::RFR_Object::RXX_Object_Obj48.PxVxCoVnce = convertRawToPhysical(raw_value, 0.01, 0.0);

    raw_value=copyBitsFromByteArrayLE( byteArray, 25356, 12);
    @CAN_PrivMain::RFR_Object::RXX_Object_Obj48.PxVyCoVnce = convertRawToPhysical(raw_value, 0.01, 0.0);

    raw_value=copyBitsFromByteArrayLE( byteArray, 25120, 12);
    @CAN_PrivMain::RFR_Object::RXX_Object_Obj48.Py = convertRawToPhysical(raw_value, 0.0625, -128.0);

    raw_value=copyBitsFromByteArrayLE( byteArray, 25440, 12);
    @CAN_PrivMain::RFR_Object::RXX_Object_Obj48.PyAxCoVnce = convertRawToPhysical(raw_value, 0.01, 0.0);

    raw_value=copyBitsFromByteArrayLE( byteArray, 25452, 12);
    @CAN_PrivMain::RFR_Object::RXX_Object_Obj48.PyAyCoVnce = convertRawToPhysical(raw_value, 0.01, 0.0);

    raw_value=copyBitsFromByteArrayLE( byteArray, 25132, 12);
    @CAN_PrivMain::RFR_Object::RXX_Object_Obj48.PyVnce = convertRawToPhysical(raw_value, 0.1, 0.0);

    raw_value=copyBitsFromByteArrayLE( byteArray, 25376, 12);
    @CAN_PrivMain::RFR_Object::RXX_Object_Obj48.PyVxCoVnce = convertRawToPhysical(raw_value, 0.01, 0.0);

    raw_value=copyBitsFromByteArrayLE( byteArray, 25388, 12);
    @CAN_PrivMain::RFR_Object::RXX_Object_Obj48.PyVyCoVnce = convertRawToPhysical(raw_value, 0.01, 0.0);

    raw_value=copyBitsFromByteArrayLE( byteArray, 25228, 10);
    @CAN_PrivMain::RFR_Object::RXX_Object_Obj48.RCS = convertRawToPhysical(raw_value, 0.2, -102.4);

    raw_value=copyBitsFromByteArrayLE( byteArray, 25400, 4);
    @CAN_PrivMain::RFR_Object::RXX_Object_Obj48.ReferencePoint = convertRawToPhysical(raw_value, 1.0, 0.0);

    raw_value=copyBitsFromByteArrayLE( byteArray, 25260, 12);
    @CAN_PrivMain::RFR_Object::RXX_Object_Obj48.Vx = convertRawToPhysical(raw_value, 0.0625, -128.0);

    raw_value=copyBitsFromByteArrayLE( byteArray, 25484, 12);
    @CAN_PrivMain::RFR_Object::RXX_Object_Obj48.VxAxCoVnce = convertRawToPhysical(raw_value, 0.01, 0.0);

    raw_value=copyBitsFromByteArrayLE( byteArray, 25504, 12);
    @CAN_PrivMain::RFR_Object::RXX_Object_Obj48.VxAyCoVnce = convertRawToPhysical(raw_value, 0.01, 0.0);

    raw_value=copyBitsFromByteArrayLE( byteArray, 25280, 12);
    @CAN_PrivMain::RFR_Object::RXX_Object_Obj48.VxVnce = convertRawToPhysical(raw_value, 0.01, 0.0);

    raw_value=copyBitsFromByteArrayLE( byteArray, 25472, 12);
    @CAN_PrivMain::RFR_Object::RXX_Object_Obj48.VxVyCoVnce = convertRawToPhysical(raw_value, 0.01, 0.0);

    raw_value=copyBitsFromByteArrayLE( byteArray, 25294, 10);
    @CAN_PrivMain::RFR_Object::RXX_Object_Obj48.Vy = convertRawToPhysical(raw_value, 0.125, -64.0);

    raw_value=copyBitsFromByteArrayLE( byteArray, 25516, 12);
    @CAN_PrivMain::RFR_Object::RXX_Object_Obj48.VyAxCoVnce = convertRawToPhysical(raw_value, 0.01, 0.0);

    raw_value=copyBitsFromByteArrayLE( byteArray, 25536, 12);
    @CAN_PrivMain::RFR_Object::RXX_Object_Obj48.VyAyCoVnce = convertRawToPhysical(raw_value, 0.01, 0.0);

    raw_value=copyBitsFromByteArrayLE( byteArray, 25312, 12);
    @CAN_PrivMain::RFR_Object::RXX_Object_Obj48.VyVnce = convertRawToPhysical(raw_value, 0.01, 0.0);

    raw_value=copyBitsFromByteArrayLE( byteArray, 25208, 7);
    @CAN_PrivMain::RFR_Object::RXX_Object_Obj48.Width = convertRawToPhysical(raw_value, 0.125, 0.0);

    raw_value=copyBitsFromByteArrayLE( byteArray, 25216, 12);
    @CAN_PrivMain::RFR_Object::RXX_Object_Obj48.WidthVnce = convertRawToPhysical(raw_value, 0.01, 0.0);
}


void CRadarFR_RXX_Object_Obj49_SetDataReceived(byte byteArray[])
{
    qword raw_value;

    raw_value=copyBitsFromByteArrayLE( byteArray, 26080, 32);
    @CAN_PrivMain::RFR_Object::RXX_Object_Obj49.Age = convertRawToPhysical(raw_value, 1.0, 0.0);

    raw_value=copyBitsFromByteArrayLE( byteArray, 25676, 10);
    @CAN_PrivMain::RFR_Object::RXX_Object_Obj49.Ax = convertRawToPhysical(raw_value, 0.03125, -16.0);

    raw_value=copyBitsFromByteArrayLE( byteArray, 26060, 12);
    @CAN_PrivMain::RFR_Object::RXX_Object_Obj49.AxAyCoVnce = convertRawToPhysical(raw_value, 0.01, 0.0);

    raw_value=copyBitsFromByteArrayLE( byteArray, 25696, 12);
    @CAN_PrivMain::RFR_Object::RXX_Object_Obj49.AxVnce = convertRawToPhysical(raw_value, 0.01, 0.0);

    raw_value=copyBitsFromByteArrayLE( byteArray, 25750, 9);
    @CAN_PrivMain::RFR_Object::RXX_Object_Obj49.Ay = convertRawToPhysical(raw_value, 0.0625, -16.0);

    raw_value=copyBitsFromByteArrayLE( byteArray, 25760, 12);
    @CAN_PrivMain::RFR_Object::RXX_Object_Obj49.AyVnce = convertRawToPhysical(raw_value, 0.01, 0.0);

    raw_value=copyBitsFromByteArrayLE( byteArray, 25816, 6);
    @CAN_PrivMain::RFR_Object::RXX_Object_Obj49.ExistProb = convertRawToPhysical(raw_value, 2.0, 0.0);

    raw_value=copyBitsFromByteArrayLE( byteArray, 25880, 8);
    @CAN_PrivMain::RFR_Object::RXX_Object_Obj49.FilterInformation = convertRawToPhysical(raw_value, 1.0, 0.0);

    raw_value=copyBitsFromByteArrayLE( byteArray, 25656, 7);
    @CAN_PrivMain::RFR_Object::RXX_Object_Obj49.Length = convertRawToPhysical(raw_value, 0.125, 0.0);

    raw_value=copyBitsFromByteArrayLE( byteArray, 25664, 12);
    @CAN_PrivMain::RFR_Object::RXX_Object_Obj49.LengthVnce = convertRawToPhysical(raw_value, 0.01, 0.0);

    raw_value=copyBitsFromByteArrayLE( byteArray, 25848, 3);
    @CAN_PrivMain::RFR_Object::RXX_Object_Obj49.MeasurementStatus = convertRawToPhysical(raw_value, 1.0, 0.0);

    raw_value=copyBitsFromByteArrayLE( byteArray, 25804, 2);
    @CAN_PrivMain::RFR_Object::RXX_Object_Obj49.MovingStatus = convertRawToPhysical(raw_value, 1.0, 0.0);

    raw_value=copyBitsFromByteArrayLE( byteArray, 25784, 7);
    @CAN_PrivMain::RFR_Object::RXX_Object_Obj49.ObjId = convertRawToPhysical(raw_value, 1.0, 0.0);

    raw_value=copyBitsFromByteArrayLE( byteArray, 25686, 9);
    @CAN_PrivMain::RFR_Object::RXX_Object_Obj49.OrientationYaw = convertRawToPhysical(raw_value, 0.0175, -4.48);

    raw_value=copyBitsFromByteArrayLE( byteArray, 25708, 12);
    @CAN_PrivMain::RFR_Object::RXX_Object_Obj49.OrientationYawVnce = convertRawToPhysical(raw_value, 0.0003, 0.0);

    raw_value=copyBitsFromByteArrayLE( byteArray, 25600, 6);
    @CAN_PrivMain::RFR_Object::RXX_Object_Obj49.ProbClassConfidence = convertRawToPhysical(raw_value, 2.0, 0.0);

    raw_value=copyBitsFromByteArrayLE( byteArray, 25851, 4);
    @CAN_PrivMain::RFR_Object::RXX_Object_Obj49.ProbClassType = convertRawToPhysical(raw_value, 1.0, 0.0);

    raw_value=copyBitsFromByteArrayLE( byteArray, 25606, 14);
    @CAN_PrivMain::RFR_Object::RXX_Object_Obj49.Px = convertRawToPhysical(raw_value, 0.0625, -512.0);

    raw_value=copyBitsFromByteArrayLE( byteArray, 25920, 12);
    @CAN_PrivMain::RFR_Object::RXX_Object_Obj49.PxAxCoVnce = convertRawToPhysical(raw_value, 0.01, 0.0);

    raw_value=copyBitsFromByteArrayLE( byteArray, 25932, 12);
    @CAN_PrivMain::RFR_Object::RXX_Object_Obj49.PxAyCoVnce = convertRawToPhysical(raw_value, 0.01, 0.0);

    raw_value=copyBitsFromByteArrayLE( byteArray, 25836, 12);
    @CAN_PrivMain::RFR_Object::RXX_Object_Obj49.PxPyCoVnce = convertRawToPhysical(raw_value, 0.01, 0.0);

    raw_value=copyBitsFromByteArrayLE( byteArray, 25620, 12);
    @CAN_PrivMain::RFR_Object::RXX_Object_Obj49.PxVnce = convertRawToPhysical(raw_value, 0.1, 0.0);

    raw_value=copyBitsFromByteArrayLE( byteArray, 25856, 12);
    @CAN_PrivMain::RFR_Object::RXX_Object_Obj49.PxVxCoVnce = convertRawToPhysical(raw_value, 0.01, 0.0);

    raw_value=copyBitsFromByteArrayLE( byteArray, 25868, 12);
    @CAN_PrivMain::RFR_Object::RXX_Object_Obj49.PxVyCoVnce = convertRawToPhysical(raw_value, 0.01, 0.0);

    raw_value=copyBitsFromByteArrayLE( byteArray, 25632, 12);
    @CAN_PrivMain::RFR_Object::RXX_Object_Obj49.Py = convertRawToPhysical(raw_value, 0.0625, -128.0);

    raw_value=copyBitsFromByteArrayLE( byteArray, 25952, 12);
    @CAN_PrivMain::RFR_Object::RXX_Object_Obj49.PyAxCoVnce = convertRawToPhysical(raw_value, 0.01, 0.0);

    raw_value=copyBitsFromByteArrayLE( byteArray, 25964, 12);
    @CAN_PrivMain::RFR_Object::RXX_Object_Obj49.PyAyCoVnce = convertRawToPhysical(raw_value, 0.01, 0.0);

    raw_value=copyBitsFromByteArrayLE( byteArray, 25644, 12);
    @CAN_PrivMain::RFR_Object::RXX_Object_Obj49.PyVnce = convertRawToPhysical(raw_value, 0.1, 0.0);

    raw_value=copyBitsFromByteArrayLE( byteArray, 25888, 12);
    @CAN_PrivMain::RFR_Object::RXX_Object_Obj49.PyVxCoVnce = convertRawToPhysical(raw_value, 0.01, 0.0);

    raw_value=copyBitsFromByteArrayLE( byteArray, 25900, 12);
    @CAN_PrivMain::RFR_Object::RXX_Object_Obj49.PyVyCoVnce = convertRawToPhysical(raw_value, 0.01, 0.0);

    raw_value=copyBitsFromByteArrayLE( byteArray, 25740, 10);
    @CAN_PrivMain::RFR_Object::RXX_Object_Obj49.RCS = convertRawToPhysical(raw_value, 0.2, -102.4);

    raw_value=copyBitsFromByteArrayLE( byteArray, 25912, 4);
    @CAN_PrivMain::RFR_Object::RXX_Object_Obj49.ReferencePoint = convertRawToPhysical(raw_value, 1.0, 0.0);

    raw_value=copyBitsFromByteArrayLE( byteArray, 25772, 12);
    @CAN_PrivMain::RFR_Object::RXX_Object_Obj49.Vx = convertRawToPhysical(raw_value, 0.0625, -128.0);

    raw_value=copyBitsFromByteArrayLE( byteArray, 25996, 12);
    @CAN_PrivMain::RFR_Object::RXX_Object_Obj49.VxAxCoVnce = convertRawToPhysical(raw_value, 0.01, 0.0);

    raw_value=copyBitsFromByteArrayLE( byteArray, 26016, 12);
    @CAN_PrivMain::RFR_Object::RXX_Object_Obj49.VxAyCoVnce = convertRawToPhysical(raw_value, 0.01, 0.0);

    raw_value=copyBitsFromByteArrayLE( byteArray, 25792, 12);
    @CAN_PrivMain::RFR_Object::RXX_Object_Obj49.VxVnce = convertRawToPhysical(raw_value, 0.01, 0.0);

    raw_value=copyBitsFromByteArrayLE( byteArray, 25984, 12);
    @CAN_PrivMain::RFR_Object::RXX_Object_Obj49.VxVyCoVnce = convertRawToPhysical(raw_value, 0.01, 0.0);

    raw_value=copyBitsFromByteArrayLE( byteArray, 25806, 10);
    @CAN_PrivMain::RFR_Object::RXX_Object_Obj49.Vy = convertRawToPhysical(raw_value, 0.125, -64.0);

    raw_value=copyBitsFromByteArrayLE( byteArray, 26028, 12);
    @CAN_PrivMain::RFR_Object::RXX_Object_Obj49.VyAxCoVnce = convertRawToPhysical(raw_value, 0.01, 0.0);

    raw_value=copyBitsFromByteArrayLE( byteArray, 26048, 12);
    @CAN_PrivMain::RFR_Object::RXX_Object_Obj49.VyAyCoVnce = convertRawToPhysical(raw_value, 0.01, 0.0);

    raw_value=copyBitsFromByteArrayLE( byteArray, 25824, 12);
    @CAN_PrivMain::RFR_Object::RXX_Object_Obj49.VyVnce = convertRawToPhysical(raw_value, 0.01, 0.0);

    raw_value=copyBitsFromByteArrayLE( byteArray, 25720, 7);
    @CAN_PrivMain::RFR_Object::RXX_Object_Obj49.Width = convertRawToPhysical(raw_value, 0.125, 0.0);

    raw_value=copyBitsFromByteArrayLE( byteArray, 25728, 12);
    @CAN_PrivMain::RFR_Object::RXX_Object_Obj49.WidthVnce = convertRawToPhysical(raw_value, 0.01, 0.0);
}


void CRadarFR_RXX_Object_Obj5_SetDataReceived(byte byteArray[])
{
    qword raw_value;

    raw_value=copyBitsFromByteArrayLE( byteArray, 3552, 32);
    @CAN_PrivMain::RFR_Object::RXX_Object_Obj5.Age = convertRawToPhysical(raw_value, 1.0, 0.0);

    raw_value=copyBitsFromByteArrayLE( byteArray, 3148, 10);
    @CAN_PrivMain::RFR_Object::RXX_Object_Obj5.Ax = convertRawToPhysical(raw_value, 0.03125, -16.0);

    raw_value=copyBitsFromByteArrayLE( byteArray, 3532, 12);
    @CAN_PrivMain::RFR_Object::RXX_Object_Obj5.AxAyCoVnce = convertRawToPhysical(raw_value, 0.01, 0.0);

    raw_value=copyBitsFromByteArrayLE( byteArray, 3168, 12);
    @CAN_PrivMain::RFR_Object::RXX_Object_Obj5.AxVnce = convertRawToPhysical(raw_value, 0.01, 0.0);

    raw_value=copyBitsFromByteArrayLE( byteArray, 3222, 9);
    @CAN_PrivMain::RFR_Object::RXX_Object_Obj5.Ay = convertRawToPhysical(raw_value, 0.0625, -16.0);

    raw_value=copyBitsFromByteArrayLE( byteArray, 3232, 12);
    @CAN_PrivMain::RFR_Object::RXX_Object_Obj5.AyVnce = convertRawToPhysical(raw_value, 0.01, 0.0);

    raw_value=copyBitsFromByteArrayLE( byteArray, 3288, 6);
    @CAN_PrivMain::RFR_Object::RXX_Object_Obj5.ExistProb = convertRawToPhysical(raw_value, 2.0, 0.0);

    raw_value=copyBitsFromByteArrayLE( byteArray, 3352, 8);
    @CAN_PrivMain::RFR_Object::RXX_Object_Obj5.FilterInformation = convertRawToPhysical(raw_value, 1.0, 0.0);

    raw_value=copyBitsFromByteArrayLE( byteArray, 3128, 7);
    @CAN_PrivMain::RFR_Object::RXX_Object_Obj5.Length = convertRawToPhysical(raw_value, 0.125, 0.0);

    raw_value=copyBitsFromByteArrayLE( byteArray, 3136, 12);
    @CAN_PrivMain::RFR_Object::RXX_Object_Obj5.LengthVnce = convertRawToPhysical(raw_value, 0.01, 0.0);

    raw_value=copyBitsFromByteArrayLE( byteArray, 3320, 3);
    @CAN_PrivMain::RFR_Object::RXX_Object_Obj5.MeasurementStatus = convertRawToPhysical(raw_value, 1.0, 0.0);

    raw_value=copyBitsFromByteArrayLE( byteArray, 3276, 2);
    @CAN_PrivMain::RFR_Object::RXX_Object_Obj5.MovingStatus = convertRawToPhysical(raw_value, 1.0, 0.0);

    raw_value=copyBitsFromByteArrayLE( byteArray, 3256, 7);
    @CAN_PrivMain::RFR_Object::RXX_Object_Obj5.ObjId = convertRawToPhysical(raw_value, 1.0, 0.0);

    raw_value=copyBitsFromByteArrayLE( byteArray, 3158, 9);
    @CAN_PrivMain::RFR_Object::RXX_Object_Obj5.OrientationYaw = convertRawToPhysical(raw_value, 0.0175, -4.48);

    raw_value=copyBitsFromByteArrayLE( byteArray, 3180, 12);
    @CAN_PrivMain::RFR_Object::RXX_Object_Obj5.OrientationYawVnce = convertRawToPhysical(raw_value, 0.0003, 0.0);

    raw_value=copyBitsFromByteArrayLE( byteArray, 3072, 6);
    @CAN_PrivMain::RFR_Object::RXX_Object_Obj5.ProbClassConfidence = convertRawToPhysical(raw_value, 2.0, 0.0);

    raw_value=copyBitsFromByteArrayLE( byteArray, 3323, 4);
    @CAN_PrivMain::RFR_Object::RXX_Object_Obj5.ProbClassType = convertRawToPhysical(raw_value, 1.0, 0.0);

    raw_value=copyBitsFromByteArrayLE( byteArray, 3078, 14);
    @CAN_PrivMain::RFR_Object::RXX_Object_Obj5.Px = convertRawToPhysical(raw_value, 0.0625, -512.0);

    raw_value=copyBitsFromByteArrayLE( byteArray, 3392, 12);
    @CAN_PrivMain::RFR_Object::RXX_Object_Obj5.PxAxCoVnce = convertRawToPhysical(raw_value, 0.01, 0.0);

    raw_value=copyBitsFromByteArrayLE( byteArray, 3404, 12);
    @CAN_PrivMain::RFR_Object::RXX_Object_Obj5.PxAyCoVnce = convertRawToPhysical(raw_value, 0.01, 0.0);

    raw_value=copyBitsFromByteArrayLE( byteArray, 3308, 12);
    @CAN_PrivMain::RFR_Object::RXX_Object_Obj5.PxPyCoVnce = convertRawToPhysical(raw_value, 0.01, 0.0);

    raw_value=copyBitsFromByteArrayLE( byteArray, 3092, 12);
    @CAN_PrivMain::RFR_Object::RXX_Object_Obj5.PxVnce = convertRawToPhysical(raw_value, 0.1, 0.0);

    raw_value=copyBitsFromByteArrayLE( byteArray, 3328, 12);
    @CAN_PrivMain::RFR_Object::RXX_Object_Obj5.PxVxCoVnce = convertRawToPhysical(raw_value, 0.01, 0.0);

    raw_value=copyBitsFromByteArrayLE( byteArray, 3340, 12);
    @CAN_PrivMain::RFR_Object::RXX_Object_Obj5.PxVyCoVnce = convertRawToPhysical(raw_value, 0.01, 0.0);

    raw_value=copyBitsFromByteArrayLE( byteArray, 3104, 12);
    @CAN_PrivMain::RFR_Object::RXX_Object_Obj5.Py = convertRawToPhysical(raw_value, 0.0625, -128.0);

    raw_value=copyBitsFromByteArrayLE( byteArray, 3424, 12);
    @CAN_PrivMain::RFR_Object::RXX_Object_Obj5.PyAxCoVnce = convertRawToPhysical(raw_value, 0.01, 0.0);

    raw_value=copyBitsFromByteArrayLE( byteArray, 3436, 12);
    @CAN_PrivMain::RFR_Object::RXX_Object_Obj5.PyAyCoVnce = convertRawToPhysical(raw_value, 0.01, 0.0);

    raw_value=copyBitsFromByteArrayLE( byteArray, 3116, 12);
    @CAN_PrivMain::RFR_Object::RXX_Object_Obj5.PyVnce = convertRawToPhysical(raw_value, 0.1, 0.0);

    raw_value=copyBitsFromByteArrayLE( byteArray, 3360, 12);
    @CAN_PrivMain::RFR_Object::RXX_Object_Obj5.PyVxCoVnce = convertRawToPhysical(raw_value, 0.01, 0.0);

    raw_value=copyBitsFromByteArrayLE( byteArray, 3372, 12);
    @CAN_PrivMain::RFR_Object::RXX_Object_Obj5.PyVyCoVnce = convertRawToPhysical(raw_value, 0.01, 0.0);

    raw_value=copyBitsFromByteArrayLE( byteArray, 3212, 10);
    @CAN_PrivMain::RFR_Object::RXX_Object_Obj5.RCS = convertRawToPhysical(raw_value, 0.2, -102.4);

    raw_value=copyBitsFromByteArrayLE( byteArray, 3384, 4);
    @CAN_PrivMain::RFR_Object::RXX_Object_Obj5.ReferencePoint = convertRawToPhysical(raw_value, 1.0, 0.0);

    raw_value=copyBitsFromByteArrayLE( byteArray, 3244, 12);
    @CAN_PrivMain::RFR_Object::RXX_Object_Obj5.Vx = convertRawToPhysical(raw_value, 0.0625, -128.0);

    raw_value=copyBitsFromByteArrayLE( byteArray, 3468, 12);
    @CAN_PrivMain::RFR_Object::RXX_Object_Obj5.VxAxCoVnce = convertRawToPhysical(raw_value, 0.01, 0.0);

    raw_value=copyBitsFromByteArrayLE( byteArray, 3488, 12);
    @CAN_PrivMain::RFR_Object::RXX_Object_Obj5.VxAyCoVnce = convertRawToPhysical(raw_value, 0.01, 0.0);

    raw_value=copyBitsFromByteArrayLE( byteArray, 3264, 12);
    @CAN_PrivMain::RFR_Object::RXX_Object_Obj5.VxVnce = convertRawToPhysical(raw_value, 0.01, 0.0);

    raw_value=copyBitsFromByteArrayLE( byteArray, 3456, 12);
    @CAN_PrivMain::RFR_Object::RXX_Object_Obj5.VxVyCoVnce = convertRawToPhysical(raw_value, 0.01, 0.0);

    raw_value=copyBitsFromByteArrayLE( byteArray, 3278, 10);
    @CAN_PrivMain::RFR_Object::RXX_Object_Obj5.Vy = convertRawToPhysical(raw_value, 0.125, -64.0);

    raw_value=copyBitsFromByteArrayLE( byteArray, 3500, 12);
    @CAN_PrivMain::RFR_Object::RXX_Object_Obj5.VyAxCoVnce = convertRawToPhysical(raw_value, 0.01, 0.0);

    raw_value=copyBitsFromByteArrayLE( byteArray, 3520, 12);
    @CAN_PrivMain::RFR_Object::RXX_Object_Obj5.VyAyCoVnce = convertRawToPhysical(raw_value, 0.01, 0.0);

    raw_value=copyBitsFromByteArrayLE( byteArray, 3296, 12);
    @CAN_PrivMain::RFR_Object::RXX_Object_Obj5.VyVnce = convertRawToPhysical(raw_value, 0.01, 0.0);

    raw_value=copyBitsFromByteArrayLE( byteArray, 3192, 7);
    @CAN_PrivMain::RFR_Object::RXX_Object_Obj5.Width = convertRawToPhysical(raw_value, 0.125, 0.0);

    raw_value=copyBitsFromByteArrayLE( byteArray, 3200, 12);
    @CAN_PrivMain::RFR_Object::RXX_Object_Obj5.WidthVnce = convertRawToPhysical(raw_value, 0.01, 0.0);
}


void CRadarFR_RXX_Object_Obj6_SetDataReceived(byte byteArray[])
{
    qword raw_value;

    raw_value=copyBitsFromByteArrayLE( byteArray, 4064, 32);
    @CAN_PrivMain::RFR_Object::RXX_Object_Obj6.Age = convertRawToPhysical(raw_value, 1.0, 0.0);

    raw_value=copyBitsFromByteArrayLE( byteArray, 3660, 10);
    @CAN_PrivMain::RFR_Object::RXX_Object_Obj6.Ax = convertRawToPhysical(raw_value, 0.03125, -16.0);

    raw_value=copyBitsFromByteArrayLE( byteArray, 4044, 12);
    @CAN_PrivMain::RFR_Object::RXX_Object_Obj6.AxAyCoVnce = convertRawToPhysical(raw_value, 0.01, 0.0);

    raw_value=copyBitsFromByteArrayLE( byteArray, 3680, 12);
    @CAN_PrivMain::RFR_Object::RXX_Object_Obj6.AxVnce = convertRawToPhysical(raw_value, 0.01, 0.0);

    raw_value=copyBitsFromByteArrayLE( byteArray, 3734, 9);
    @CAN_PrivMain::RFR_Object::RXX_Object_Obj6.Ay = convertRawToPhysical(raw_value, 0.0625, -16.0);

    raw_value=copyBitsFromByteArrayLE( byteArray, 3744, 12);
    @CAN_PrivMain::RFR_Object::RXX_Object_Obj6.AyVnce = convertRawToPhysical(raw_value, 0.01, 0.0);

    raw_value=copyBitsFromByteArrayLE( byteArray, 3800, 6);
    @CAN_PrivMain::RFR_Object::RXX_Object_Obj6.ExistProb = convertRawToPhysical(raw_value, 2.0, 0.0);

    raw_value=copyBitsFromByteArrayLE( byteArray, 3864, 8);
    @CAN_PrivMain::RFR_Object::RXX_Object_Obj6.FilterInformation = convertRawToPhysical(raw_value, 1.0, 0.0);

    raw_value=copyBitsFromByteArrayLE( byteArray, 3640, 7);
    @CAN_PrivMain::RFR_Object::RXX_Object_Obj6.Length = convertRawToPhysical(raw_value, 0.125, 0.0);

    raw_value=copyBitsFromByteArrayLE( byteArray, 3648, 12);
    @CAN_PrivMain::RFR_Object::RXX_Object_Obj6.LengthVnce = convertRawToPhysical(raw_value, 0.01, 0.0);

    raw_value=copyBitsFromByteArrayLE( byteArray, 3832, 3);
    @CAN_PrivMain::RFR_Object::RXX_Object_Obj6.MeasurementStatus = convertRawToPhysical(raw_value, 1.0, 0.0);

    raw_value=copyBitsFromByteArrayLE( byteArray, 3788, 2);
    @CAN_PrivMain::RFR_Object::RXX_Object_Obj6.MovingStatus = convertRawToPhysical(raw_value, 1.0, 0.0);

    raw_value=copyBitsFromByteArrayLE( byteArray, 3768, 7);
    @CAN_PrivMain::RFR_Object::RXX_Object_Obj6.ObjId = convertRawToPhysical(raw_value, 1.0, 0.0);

    raw_value=copyBitsFromByteArrayLE( byteArray, 3670, 9);
    @CAN_PrivMain::RFR_Object::RXX_Object_Obj6.OrientationYaw = convertRawToPhysical(raw_value, 0.0175, -4.48);

    raw_value=copyBitsFromByteArrayLE( byteArray, 3692, 12);
    @CAN_PrivMain::RFR_Object::RXX_Object_Obj6.OrientationYawVnce = convertRawToPhysical(raw_value, 0.0003, 0.0);

    raw_value=copyBitsFromByteArrayLE( byteArray, 3584, 6);
    @CAN_PrivMain::RFR_Object::RXX_Object_Obj6.ProbClassConfidence = convertRawToPhysical(raw_value, 2.0, 0.0);

    raw_value=copyBitsFromByteArrayLE( byteArray, 3835, 4);
    @CAN_PrivMain::RFR_Object::RXX_Object_Obj6.ProbClassType = convertRawToPhysical(raw_value, 1.0, 0.0);

    raw_value=copyBitsFromByteArrayLE( byteArray, 3590, 14);
    @CAN_PrivMain::RFR_Object::RXX_Object_Obj6.Px = convertRawToPhysical(raw_value, 0.0625, -512.0);

    raw_value=copyBitsFromByteArrayLE( byteArray, 3904, 12);
    @CAN_PrivMain::RFR_Object::RXX_Object_Obj6.PxAxCoVnce = convertRawToPhysical(raw_value, 0.01, 0.0);

    raw_value=copyBitsFromByteArrayLE( byteArray, 3916, 12);
    @CAN_PrivMain::RFR_Object::RXX_Object_Obj6.PxAyCoVnce = convertRawToPhysical(raw_value, 0.01, 0.0);

    raw_value=copyBitsFromByteArrayLE( byteArray, 3820, 12);
    @CAN_PrivMain::RFR_Object::RXX_Object_Obj6.PxPyCoVnce = convertRawToPhysical(raw_value, 0.01, 0.0);

    raw_value=copyBitsFromByteArrayLE( byteArray, 3604, 12);
    @CAN_PrivMain::RFR_Object::RXX_Object_Obj6.PxVnce = convertRawToPhysical(raw_value, 0.1, 0.0);

    raw_value=copyBitsFromByteArrayLE( byteArray, 3840, 12);
    @CAN_PrivMain::RFR_Object::RXX_Object_Obj6.PxVxCoVnce = convertRawToPhysical(raw_value, 0.01, 0.0);

    raw_value=copyBitsFromByteArrayLE( byteArray, 3852, 12);
    @CAN_PrivMain::RFR_Object::RXX_Object_Obj6.PxVyCoVnce = convertRawToPhysical(raw_value, 0.01, 0.0);

    raw_value=copyBitsFromByteArrayLE( byteArray, 3616, 12);
    @CAN_PrivMain::RFR_Object::RXX_Object_Obj6.Py = convertRawToPhysical(raw_value, 0.0625, -128.0);

    raw_value=copyBitsFromByteArrayLE( byteArray, 3936, 12);
    @CAN_PrivMain::RFR_Object::RXX_Object_Obj6.PyAxCoVnce = convertRawToPhysical(raw_value, 0.01, 0.0);

    raw_value=copyBitsFromByteArrayLE( byteArray, 3948, 12);
    @CAN_PrivMain::RFR_Object::RXX_Object_Obj6.PyAyCoVnce = convertRawToPhysical(raw_value, 0.01, 0.0);

    raw_value=copyBitsFromByteArrayLE( byteArray, 3628, 12);
    @CAN_PrivMain::RFR_Object::RXX_Object_Obj6.PyVnce = convertRawToPhysical(raw_value, 0.1, 0.0);

    raw_value=copyBitsFromByteArrayLE( byteArray, 3872, 12);
    @CAN_PrivMain::RFR_Object::RXX_Object_Obj6.PyVxCoVnce = convertRawToPhysical(raw_value, 0.01, 0.0);

    raw_value=copyBitsFromByteArrayLE( byteArray, 3884, 12);
    @CAN_PrivMain::RFR_Object::RXX_Object_Obj6.PyVyCoVnce = convertRawToPhysical(raw_value, 0.01, 0.0);

    raw_value=copyBitsFromByteArrayLE( byteArray, 3724, 10);
    @CAN_PrivMain::RFR_Object::RXX_Object_Obj6.RCS = convertRawToPhysical(raw_value, 0.2, -102.4);

    raw_value=copyBitsFromByteArrayLE( byteArray, 3896, 4);
    @CAN_PrivMain::RFR_Object::RXX_Object_Obj6.ReferencePoint = convertRawToPhysical(raw_value, 1.0, 0.0);

    raw_value=copyBitsFromByteArrayLE( byteArray, 3756, 12);
    @CAN_PrivMain::RFR_Object::RXX_Object_Obj6.Vx = convertRawToPhysical(raw_value, 0.0625, -128.0);

    raw_value=copyBitsFromByteArrayLE( byteArray, 3980, 12);
    @CAN_PrivMain::RFR_Object::RXX_Object_Obj6.VxAxCoVnce = convertRawToPhysical(raw_value, 0.01, 0.0);

    raw_value=copyBitsFromByteArrayLE( byteArray, 4000, 12);
    @CAN_PrivMain::RFR_Object::RXX_Object_Obj6.VxAyCoVnce = convertRawToPhysical(raw_value, 0.01, 0.0);

    raw_value=copyBitsFromByteArrayLE( byteArray, 3776, 12);
    @CAN_PrivMain::RFR_Object::RXX_Object_Obj6.VxVnce = convertRawToPhysical(raw_value, 0.01, 0.0);

    raw_value=copyBitsFromByteArrayLE( byteArray, 3968, 12);
    @CAN_PrivMain::RFR_Object::RXX_Object_Obj6.VxVyCoVnce = convertRawToPhysical(raw_value, 0.01, 0.0);

    raw_value=copyBitsFromByteArrayLE( byteArray, 3790, 10);
    @CAN_PrivMain::RFR_Object::RXX_Object_Obj6.Vy = convertRawToPhysical(raw_value, 0.125, -64.0);

    raw_value=copyBitsFromByteArrayLE( byteArray, 4012, 12);
    @CAN_PrivMain::RFR_Object::RXX_Object_Obj6.VyAxCoVnce = convertRawToPhysical(raw_value, 0.01, 0.0);

    raw_value=copyBitsFromByteArrayLE( byteArray, 4032, 12);
    @CAN_PrivMain::RFR_Object::RXX_Object_Obj6.VyAyCoVnce = convertRawToPhysical(raw_value, 0.01, 0.0);

    raw_value=copyBitsFromByteArrayLE( byteArray, 3808, 12);
    @CAN_PrivMain::RFR_Object::RXX_Object_Obj6.VyVnce = convertRawToPhysical(raw_value, 0.01, 0.0);

    raw_value=copyBitsFromByteArrayLE( byteArray, 3704, 7);
    @CAN_PrivMain::RFR_Object::RXX_Object_Obj6.Width = convertRawToPhysical(raw_value, 0.125, 0.0);

    raw_value=copyBitsFromByteArrayLE( byteArray, 3712, 12);
    @CAN_PrivMain::RFR_Object::RXX_Object_Obj6.WidthVnce = convertRawToPhysical(raw_value, 0.01, 0.0);
}


void CRadarFR_RXX_Object_Obj7_SetDataReceived(byte byteArray[])
{
    qword raw_value;

    raw_value=copyBitsFromByteArrayLE( byteArray, 4576, 32);
    @CAN_PrivMain::RFR_Object::RXX_Object_Obj7.Age = convertRawToPhysical(raw_value, 1.0, 0.0);

    raw_value=copyBitsFromByteArrayLE( byteArray, 4172, 10);
    @CAN_PrivMain::RFR_Object::RXX_Object_Obj7.Ax = convertRawToPhysical(raw_value, 0.03125, -16.0);

    raw_value=copyBitsFromByteArrayLE( byteArray, 4556, 12);
    @CAN_PrivMain::RFR_Object::RXX_Object_Obj7.AxAyCoVnce = convertRawToPhysical(raw_value, 0.01, 0.0);

    raw_value=copyBitsFromByteArrayLE( byteArray, 4192, 12);
    @CAN_PrivMain::RFR_Object::RXX_Object_Obj7.AxVnce = convertRawToPhysical(raw_value, 0.01, 0.0);

    raw_value=copyBitsFromByteArrayLE( byteArray, 4246, 9);
    @CAN_PrivMain::RFR_Object::RXX_Object_Obj7.Ay = convertRawToPhysical(raw_value, 0.0625, -16.0);

    raw_value=copyBitsFromByteArrayLE( byteArray, 4256, 12);
    @CAN_PrivMain::RFR_Object::RXX_Object_Obj7.AyVnce = convertRawToPhysical(raw_value, 0.01, 0.0);

    raw_value=copyBitsFromByteArrayLE( byteArray, 4312, 6);
    @CAN_PrivMain::RFR_Object::RXX_Object_Obj7.ExistProb = convertRawToPhysical(raw_value, 2.0, 0.0);

    raw_value=copyBitsFromByteArrayLE( byteArray, 4376, 8);
    @CAN_PrivMain::RFR_Object::RXX_Object_Obj7.FilterInformation = convertRawToPhysical(raw_value, 1.0, 0.0);

    raw_value=copyBitsFromByteArrayLE( byteArray, 4152, 7);
    @CAN_PrivMain::RFR_Object::RXX_Object_Obj7.Length = convertRawToPhysical(raw_value, 0.125, 0.0);

    raw_value=copyBitsFromByteArrayLE( byteArray, 4160, 12);
    @CAN_PrivMain::RFR_Object::RXX_Object_Obj7.LengthVnce = convertRawToPhysical(raw_value, 0.01, 0.0);

    raw_value=copyBitsFromByteArrayLE( byteArray, 4344, 3);
    @CAN_PrivMain::RFR_Object::RXX_Object_Obj7.MeasurementStatus = convertRawToPhysical(raw_value, 1.0, 0.0);

    raw_value=copyBitsFromByteArrayLE( byteArray, 4300, 2);
    @CAN_PrivMain::RFR_Object::RXX_Object_Obj7.MovingStatus = convertRawToPhysical(raw_value, 1.0, 0.0);

    raw_value=copyBitsFromByteArrayLE( byteArray, 4280, 7);
    @CAN_PrivMain::RFR_Object::RXX_Object_Obj7.ObjId = convertRawToPhysical(raw_value, 1.0, 0.0);

    raw_value=copyBitsFromByteArrayLE( byteArray, 4182, 9);
    @CAN_PrivMain::RFR_Object::RXX_Object_Obj7.OrientationYaw = convertRawToPhysical(raw_value, 0.0175, -4.48);

    raw_value=copyBitsFromByteArrayLE( byteArray, 4204, 12);
    @CAN_PrivMain::RFR_Object::RXX_Object_Obj7.OrientationYawVnce = convertRawToPhysical(raw_value, 0.0003, 0.0);

    raw_value=copyBitsFromByteArrayLE( byteArray, 4096, 6);
    @CAN_PrivMain::RFR_Object::RXX_Object_Obj7.ProbClassConfidence = convertRawToPhysical(raw_value, 2.0, 0.0);

    raw_value=copyBitsFromByteArrayLE( byteArray, 4347, 4);
    @CAN_PrivMain::RFR_Object::RXX_Object_Obj7.ProbClassType = convertRawToPhysical(raw_value, 1.0, 0.0);

    raw_value=copyBitsFromByteArrayLE( byteArray, 4102, 14);
    @CAN_PrivMain::RFR_Object::RXX_Object_Obj7.Px = convertRawToPhysical(raw_value, 0.0625, -512.0);

    raw_value=copyBitsFromByteArrayLE( byteArray, 4416, 12);
    @CAN_PrivMain::RFR_Object::RXX_Object_Obj7.PxAxCoVnce = convertRawToPhysical(raw_value, 0.01, 0.0);

    raw_value=copyBitsFromByteArrayLE( byteArray, 4428, 12);
    @CAN_PrivMain::RFR_Object::RXX_Object_Obj7.PxAyCoVnce = convertRawToPhysical(raw_value, 0.01, 0.0);

    raw_value=copyBitsFromByteArrayLE( byteArray, 4332, 12);
    @CAN_PrivMain::RFR_Object::RXX_Object_Obj7.PxPyCoVnce = convertRawToPhysical(raw_value, 0.01, 0.0);

    raw_value=copyBitsFromByteArrayLE( byteArray, 4116, 12);
    @CAN_PrivMain::RFR_Object::RXX_Object_Obj7.PxVnce = convertRawToPhysical(raw_value, 0.1, 0.0);

    raw_value=copyBitsFromByteArrayLE( byteArray, 4352, 12);
    @CAN_PrivMain::RFR_Object::RXX_Object_Obj7.PxVxCoVnce = convertRawToPhysical(raw_value, 0.01, 0.0);

    raw_value=copyBitsFromByteArrayLE( byteArray, 4364, 12);
    @CAN_PrivMain::RFR_Object::RXX_Object_Obj7.PxVyCoVnce = convertRawToPhysical(raw_value, 0.01, 0.0);

    raw_value=copyBitsFromByteArrayLE( byteArray, 4128, 12);
    @CAN_PrivMain::RFR_Object::RXX_Object_Obj7.Py = convertRawToPhysical(raw_value, 0.0625, -128.0);

    raw_value=copyBitsFromByteArrayLE( byteArray, 4448, 12);
    @CAN_PrivMain::RFR_Object::RXX_Object_Obj7.PyAxCoVnce = convertRawToPhysical(raw_value, 0.01, 0.0);

    raw_value=copyBitsFromByteArrayLE( byteArray, 4460, 12);
    @CAN_PrivMain::RFR_Object::RXX_Object_Obj7.PyAyCoVnce = convertRawToPhysical(raw_value, 0.01, 0.0);

    raw_value=copyBitsFromByteArrayLE( byteArray, 4140, 12);
    @CAN_PrivMain::RFR_Object::RXX_Object_Obj7.PyVnce = convertRawToPhysical(raw_value, 0.1, 0.0);

    raw_value=copyBitsFromByteArrayLE( byteArray, 4384, 12);
    @CAN_PrivMain::RFR_Object::RXX_Object_Obj7.PyVxCoVnce = convertRawToPhysical(raw_value, 0.01, 0.0);

    raw_value=copyBitsFromByteArrayLE( byteArray, 4396, 12);
    @CAN_PrivMain::RFR_Object::RXX_Object_Obj7.PyVyCoVnce = convertRawToPhysical(raw_value, 0.01, 0.0);

    raw_value=copyBitsFromByteArrayLE( byteArray, 4236, 10);
    @CAN_PrivMain::RFR_Object::RXX_Object_Obj7.RCS = convertRawToPhysical(raw_value, 0.2, -102.4);

    raw_value=copyBitsFromByteArrayLE( byteArray, 4408, 4);
    @CAN_PrivMain::RFR_Object::RXX_Object_Obj7.ReferencePoint = convertRawToPhysical(raw_value, 1.0, 0.0);

    raw_value=copyBitsFromByteArrayLE( byteArray, 4268, 12);
    @CAN_PrivMain::RFR_Object::RXX_Object_Obj7.Vx = convertRawToPhysical(raw_value, 0.0625, -128.0);

    raw_value=copyBitsFromByteArrayLE( byteArray, 4492, 12);
    @CAN_PrivMain::RFR_Object::RXX_Object_Obj7.VxAxCoVnce = convertRawToPhysical(raw_value, 0.01, 0.0);

    raw_value=copyBitsFromByteArrayLE( byteArray, 4512, 12);
    @CAN_PrivMain::RFR_Object::RXX_Object_Obj7.VxAyCoVnce = convertRawToPhysical(raw_value, 0.01, 0.0);

    raw_value=copyBitsFromByteArrayLE( byteArray, 4288, 12);
    @CAN_PrivMain::RFR_Object::RXX_Object_Obj7.VxVnce = convertRawToPhysical(raw_value, 0.01, 0.0);

    raw_value=copyBitsFromByteArrayLE( byteArray, 4480, 12);
    @CAN_PrivMain::RFR_Object::RXX_Object_Obj7.VxVyCoVnce = convertRawToPhysical(raw_value, 0.01, 0.0);

    raw_value=copyBitsFromByteArrayLE( byteArray, 4302, 10);
    @CAN_PrivMain::RFR_Object::RXX_Object_Obj7.Vy = convertRawToPhysical(raw_value, 0.125, -64.0);

    raw_value=copyBitsFromByteArrayLE( byteArray, 4524, 12);
    @CAN_PrivMain::RFR_Object::RXX_Object_Obj7.VyAxCoVnce = convertRawToPhysical(raw_value, 0.01, 0.0);

    raw_value=copyBitsFromByteArrayLE( byteArray, 4544, 12);
    @CAN_PrivMain::RFR_Object::RXX_Object_Obj7.VyAyCoVnce = convertRawToPhysical(raw_value, 0.01, 0.0);

    raw_value=copyBitsFromByteArrayLE( byteArray, 4320, 12);
    @CAN_PrivMain::RFR_Object::RXX_Object_Obj7.VyVnce = convertRawToPhysical(raw_value, 0.01, 0.0);

    raw_value=copyBitsFromByteArrayLE( byteArray, 4216, 7);
    @CAN_PrivMain::RFR_Object::RXX_Object_Obj7.Width = convertRawToPhysical(raw_value, 0.125, 0.0);

    raw_value=copyBitsFromByteArrayLE( byteArray, 4224, 12);
    @CAN_PrivMain::RFR_Object::RXX_Object_Obj7.WidthVnce = convertRawToPhysical(raw_value, 0.01, 0.0);
}


void CRadarFR_RXX_Object_Obj8_SetDataReceived(byte byteArray[])
{
    qword raw_value;

    raw_value=copyBitsFromByteArrayLE( byteArray, 5088, 32);
    @CAN_PrivMain::RFR_Object::RXX_Object_Obj8.Age = convertRawToPhysical(raw_value, 1.0, 0.0);

    raw_value=copyBitsFromByteArrayLE( byteArray, 4684, 10);
    @CAN_PrivMain::RFR_Object::RXX_Object_Obj8.Ax = convertRawToPhysical(raw_value, 0.03125, -16.0);

    raw_value=copyBitsFromByteArrayLE( byteArray, 5068, 12);
    @CAN_PrivMain::RFR_Object::RXX_Object_Obj8.AxAyCoVnce = convertRawToPhysical(raw_value, 0.01, 0.0);

    raw_value=copyBitsFromByteArrayLE( byteArray, 4704, 12);
    @CAN_PrivMain::RFR_Object::RXX_Object_Obj8.AxVnce = convertRawToPhysical(raw_value, 0.01, 0.0);

    raw_value=copyBitsFromByteArrayLE( byteArray, 4758, 9);
    @CAN_PrivMain::RFR_Object::RXX_Object_Obj8.Ay = convertRawToPhysical(raw_value, 0.0625, -16.0);

    raw_value=copyBitsFromByteArrayLE( byteArray, 4768, 12);
    @CAN_PrivMain::RFR_Object::RXX_Object_Obj8.AyVnce = convertRawToPhysical(raw_value, 0.01, 0.0);

    raw_value=copyBitsFromByteArrayLE( byteArray, 4824, 6);
    @CAN_PrivMain::RFR_Object::RXX_Object_Obj8.ExistProb = convertRawToPhysical(raw_value, 2.0, 0.0);

    raw_value=copyBitsFromByteArrayLE( byteArray, 4888, 8);
    @CAN_PrivMain::RFR_Object::RXX_Object_Obj8.FilterInformation = convertRawToPhysical(raw_value, 1.0, 0.0);

    raw_value=copyBitsFromByteArrayLE( byteArray, 4664, 7);
    @CAN_PrivMain::RFR_Object::RXX_Object_Obj8.Length = convertRawToPhysical(raw_value, 0.125, 0.0);

    raw_value=copyBitsFromByteArrayLE( byteArray, 4672, 12);
    @CAN_PrivMain::RFR_Object::RXX_Object_Obj8.LengthVnce = convertRawToPhysical(raw_value, 0.01, 0.0);

    raw_value=copyBitsFromByteArrayLE( byteArray, 4856, 3);
    @CAN_PrivMain::RFR_Object::RXX_Object_Obj8.MeasurementStatus = convertRawToPhysical(raw_value, 1.0, 0.0);

    raw_value=copyBitsFromByteArrayLE( byteArray, 4812, 2);
    @CAN_PrivMain::RFR_Object::RXX_Object_Obj8.MovingStatus = convertRawToPhysical(raw_value, 1.0, 0.0);

    raw_value=copyBitsFromByteArrayLE( byteArray, 4792, 7);
    @CAN_PrivMain::RFR_Object::RXX_Object_Obj8.ObjId = convertRawToPhysical(raw_value, 1.0, 0.0);

    raw_value=copyBitsFromByteArrayLE( byteArray, 4694, 9);
    @CAN_PrivMain::RFR_Object::RXX_Object_Obj8.OrientationYaw = convertRawToPhysical(raw_value, 0.0175, -4.48);

    raw_value=copyBitsFromByteArrayLE( byteArray, 4716, 12);
    @CAN_PrivMain::RFR_Object::RXX_Object_Obj8.OrientationYawVnce = convertRawToPhysical(raw_value, 0.0003, 0.0);

    raw_value=copyBitsFromByteArrayLE( byteArray, 4608, 6);
    @CAN_PrivMain::RFR_Object::RXX_Object_Obj8.ProbClassConfidence = convertRawToPhysical(raw_value, 2.0, 0.0);

    raw_value=copyBitsFromByteArrayLE( byteArray, 4859, 4);
    @CAN_PrivMain::RFR_Object::RXX_Object_Obj8.ProbClassType = convertRawToPhysical(raw_value, 1.0, 0.0);

    raw_value=copyBitsFromByteArrayLE( byteArray, 4614, 14);
    @CAN_PrivMain::RFR_Object::RXX_Object_Obj8.Px = convertRawToPhysical(raw_value, 0.0625, -512.0);

    raw_value=copyBitsFromByteArrayLE( byteArray, 4928, 12);
    @CAN_PrivMain::RFR_Object::RXX_Object_Obj8.PxAxCoVnce = convertRawToPhysical(raw_value, 0.01, 0.0);

    raw_value=copyBitsFromByteArrayLE( byteArray, 4940, 12);
    @CAN_PrivMain::RFR_Object::RXX_Object_Obj8.PxAyCoVnce = convertRawToPhysical(raw_value, 0.01, 0.0);

    raw_value=copyBitsFromByteArrayLE( byteArray, 4844, 12);
    @CAN_PrivMain::RFR_Object::RXX_Object_Obj8.PxPyCoVnce = convertRawToPhysical(raw_value, 0.01, 0.0);

    raw_value=copyBitsFromByteArrayLE( byteArray, 4628, 12);
    @CAN_PrivMain::RFR_Object::RXX_Object_Obj8.PxVnce = convertRawToPhysical(raw_value, 0.1, 0.0);

    raw_value=copyBitsFromByteArrayLE( byteArray, 4864, 12);
    @CAN_PrivMain::RFR_Object::RXX_Object_Obj8.PxVxCoVnce = convertRawToPhysical(raw_value, 0.01, 0.0);

    raw_value=copyBitsFromByteArrayLE( byteArray, 4876, 12);
    @CAN_PrivMain::RFR_Object::RXX_Object_Obj8.PxVyCoVnce = convertRawToPhysical(raw_value, 0.01, 0.0);

    raw_value=copyBitsFromByteArrayLE( byteArray, 4640, 12);
    @CAN_PrivMain::RFR_Object::RXX_Object_Obj8.Py = convertRawToPhysical(raw_value, 0.0625, -128.0);

    raw_value=copyBitsFromByteArrayLE( byteArray, 4960, 12);
    @CAN_PrivMain::RFR_Object::RXX_Object_Obj8.PyAxCoVnce = convertRawToPhysical(raw_value, 0.01, 0.0);

    raw_value=copyBitsFromByteArrayLE( byteArray, 4972, 12);
    @CAN_PrivMain::RFR_Object::RXX_Object_Obj8.PyAyCoVnce = convertRawToPhysical(raw_value, 0.01, 0.0);

    raw_value=copyBitsFromByteArrayLE( byteArray, 4652, 12);
    @CAN_PrivMain::RFR_Object::RXX_Object_Obj8.PyVnce = convertRawToPhysical(raw_value, 0.1, 0.0);

    raw_value=copyBitsFromByteArrayLE( byteArray, 4896, 12);
    @CAN_PrivMain::RFR_Object::RXX_Object_Obj8.PyVxCoVnce = convertRawToPhysical(raw_value, 0.01, 0.0);

    raw_value=copyBitsFromByteArrayLE( byteArray, 4908, 12);
    @CAN_PrivMain::RFR_Object::RXX_Object_Obj8.PyVyCoVnce = convertRawToPhysical(raw_value, 0.01, 0.0);

    raw_value=copyBitsFromByteArrayLE( byteArray, 4748, 10);
    @CAN_PrivMain::RFR_Object::RXX_Object_Obj8.RCS = convertRawToPhysical(raw_value, 0.2, -102.4);

    raw_value=copyBitsFromByteArrayLE( byteArray, 4920, 4);
    @CAN_PrivMain::RFR_Object::RXX_Object_Obj8.ReferencePoint = convertRawToPhysical(raw_value, 1.0, 0.0);

    raw_value=copyBitsFromByteArrayLE( byteArray, 4780, 12);
    @CAN_PrivMain::RFR_Object::RXX_Object_Obj8.Vx = convertRawToPhysical(raw_value, 0.0625, -128.0);

    raw_value=copyBitsFromByteArrayLE( byteArray, 5004, 12);
    @CAN_PrivMain::RFR_Object::RXX_Object_Obj8.VxAxCoVnce = convertRawToPhysical(raw_value, 0.01, 0.0);

    raw_value=copyBitsFromByteArrayLE( byteArray, 5024, 12);
    @CAN_PrivMain::RFR_Object::RXX_Object_Obj8.VxAyCoVnce = convertRawToPhysical(raw_value, 0.01, 0.0);

    raw_value=copyBitsFromByteArrayLE( byteArray, 4800, 12);
    @CAN_PrivMain::RFR_Object::RXX_Object_Obj8.VxVnce = convertRawToPhysical(raw_value, 0.01, 0.0);

    raw_value=copyBitsFromByteArrayLE( byteArray, 4992, 12);
    @CAN_PrivMain::RFR_Object::RXX_Object_Obj8.VxVyCoVnce = convertRawToPhysical(raw_value, 0.01, 0.0);

    raw_value=copyBitsFromByteArrayLE( byteArray, 4814, 10);
    @CAN_PrivMain::RFR_Object::RXX_Object_Obj8.Vy = convertRawToPhysical(raw_value, 0.125, -64.0);

    raw_value=copyBitsFromByteArrayLE( byteArray, 5036, 12);
    @CAN_PrivMain::RFR_Object::RXX_Object_Obj8.VyAxCoVnce = convertRawToPhysical(raw_value, 0.01, 0.0);

    raw_value=copyBitsFromByteArrayLE( byteArray, 5056, 12);
    @CAN_PrivMain::RFR_Object::RXX_Object_Obj8.VyAyCoVnce = convertRawToPhysical(raw_value, 0.01, 0.0);

    raw_value=copyBitsFromByteArrayLE( byteArray, 4832, 12);
    @CAN_PrivMain::RFR_Object::RXX_Object_Obj8.VyVnce = convertRawToPhysical(raw_value, 0.01, 0.0);

    raw_value=copyBitsFromByteArrayLE( byteArray, 4728, 7);
    @CAN_PrivMain::RFR_Object::RXX_Object_Obj8.Width = convertRawToPhysical(raw_value, 0.125, 0.0);

    raw_value=copyBitsFromByteArrayLE( byteArray, 4736, 12);
    @CAN_PrivMain::RFR_Object::RXX_Object_Obj8.WidthVnce = convertRawToPhysical(raw_value, 0.01, 0.0);
}


void CRadarFR_RXX_Object_Obj9_SetDataReceived(byte byteArray[])
{
    qword raw_value;

    raw_value=copyBitsFromByteArrayLE( byteArray, 5600, 32);
    @CAN_PrivMain::RFR_Object::RXX_Object_Obj9.Age = convertRawToPhysical(raw_value, 1.0, 0.0);

    raw_value=copyBitsFromByteArrayLE( byteArray, 5196, 10);
    @CAN_PrivMain::RFR_Object::RXX_Object_Obj9.Ax = convertRawToPhysical(raw_value, 0.03125, -16.0);

    raw_value=copyBitsFromByteArrayLE( byteArray, 5580, 12);
    @CAN_PrivMain::RFR_Object::RXX_Object_Obj9.AxAyCoVnce = convertRawToPhysical(raw_value, 0.01, 0.0);

    raw_value=copyBitsFromByteArrayLE( byteArray, 5216, 12);
    @CAN_PrivMain::RFR_Object::RXX_Object_Obj9.AxVnce = convertRawToPhysical(raw_value, 0.01, 0.0);

    raw_value=copyBitsFromByteArrayLE( byteArray, 5270, 9);
    @CAN_PrivMain::RFR_Object::RXX_Object_Obj9.Ay = convertRawToPhysical(raw_value, 0.0625, -16.0);

    raw_value=copyBitsFromByteArrayLE( byteArray, 5280, 12);
    @CAN_PrivMain::RFR_Object::RXX_Object_Obj9.AyVnce = convertRawToPhysical(raw_value, 0.01, 0.0);

    raw_value=copyBitsFromByteArrayLE( byteArray, 5336, 6);
    @CAN_PrivMain::RFR_Object::RXX_Object_Obj9.ExistProb = convertRawToPhysical(raw_value, 2.0, 0.0);

    raw_value=copyBitsFromByteArrayLE( byteArray, 5400, 8);
    @CAN_PrivMain::RFR_Object::RXX_Object_Obj9.FilterInformation = convertRawToPhysical(raw_value, 1.0, 0.0);

    raw_value=copyBitsFromByteArrayLE( byteArray, 5176, 7);
    @CAN_PrivMain::RFR_Object::RXX_Object_Obj9.Length = convertRawToPhysical(raw_value, 0.125, 0.0);

    raw_value=copyBitsFromByteArrayLE( byteArray, 5184, 12);
    @CAN_PrivMain::RFR_Object::RXX_Object_Obj9.LengthVnce = convertRawToPhysical(raw_value, 0.01, 0.0);

    raw_value=copyBitsFromByteArrayLE( byteArray, 5368, 3);
    @CAN_PrivMain::RFR_Object::RXX_Object_Obj9.MeasurementStatus = convertRawToPhysical(raw_value, 1.0, 0.0);

    raw_value=copyBitsFromByteArrayLE( byteArray, 5324, 2);
    @CAN_PrivMain::RFR_Object::RXX_Object_Obj9.MovingStatus = convertRawToPhysical(raw_value, 1.0, 0.0);

    raw_value=copyBitsFromByteArrayLE( byteArray, 5304, 7);
    @CAN_PrivMain::RFR_Object::RXX_Object_Obj9.ObjId = convertRawToPhysical(raw_value, 1.0, 0.0);

    raw_value=copyBitsFromByteArrayLE( byteArray, 5206, 9);
    @CAN_PrivMain::RFR_Object::RXX_Object_Obj9.OrientationYaw = convertRawToPhysical(raw_value, 0.0175, -4.48);

    raw_value=copyBitsFromByteArrayLE( byteArray, 5228, 12);
    @CAN_PrivMain::RFR_Object::RXX_Object_Obj9.OrientationYawVnce = convertRawToPhysical(raw_value, 0.0003, 0.0);

    raw_value=copyBitsFromByteArrayLE( byteArray, 5120, 6);
    @CAN_PrivMain::RFR_Object::RXX_Object_Obj9.ProbClassConfidence = convertRawToPhysical(raw_value, 2.0, 0.0);

    raw_value=copyBitsFromByteArrayLE( byteArray, 5371, 4);
    @CAN_PrivMain::RFR_Object::RXX_Object_Obj9.ProbClassType = convertRawToPhysical(raw_value, 1.0, 0.0);

    raw_value=copyBitsFromByteArrayLE( byteArray, 5126, 14);
    @CAN_PrivMain::RFR_Object::RXX_Object_Obj9.Px = convertRawToPhysical(raw_value, 0.0625, -512.0);

    raw_value=copyBitsFromByteArrayLE( byteArray, 5440, 12);
    @CAN_PrivMain::RFR_Object::RXX_Object_Obj9.PxAxCoVnce = convertRawToPhysical(raw_value, 0.01, 0.0);

    raw_value=copyBitsFromByteArrayLE( byteArray, 5452, 12);
    @CAN_PrivMain::RFR_Object::RXX_Object_Obj9.PxAyCoVnce = convertRawToPhysical(raw_value, 0.01, 0.0);

    raw_value=copyBitsFromByteArrayLE( byteArray, 5356, 12);
    @CAN_PrivMain::RFR_Object::RXX_Object_Obj9.PxPyCoVnce = convertRawToPhysical(raw_value, 0.01, 0.0);

    raw_value=copyBitsFromByteArrayLE( byteArray, 5140, 12);
    @CAN_PrivMain::RFR_Object::RXX_Object_Obj9.PxVnce = convertRawToPhysical(raw_value, 0.1, 0.0);

    raw_value=copyBitsFromByteArrayLE( byteArray, 5376, 12);
    @CAN_PrivMain::RFR_Object::RXX_Object_Obj9.PxVxCoVnce = convertRawToPhysical(raw_value, 0.01, 0.0);

    raw_value=copyBitsFromByteArrayLE( byteArray, 5388, 12);
    @CAN_PrivMain::RFR_Object::RXX_Object_Obj9.PxVyCoVnce = convertRawToPhysical(raw_value, 0.01, 0.0);

    raw_value=copyBitsFromByteArrayLE( byteArray, 5152, 12);
    @CAN_PrivMain::RFR_Object::RXX_Object_Obj9.Py = convertRawToPhysical(raw_value, 0.0625, -128.0);

    raw_value=copyBitsFromByteArrayLE( byteArray, 5472, 12);
    @CAN_PrivMain::RFR_Object::RXX_Object_Obj9.PyAxCoVnce = convertRawToPhysical(raw_value, 0.01, 0.0);

    raw_value=copyBitsFromByteArrayLE( byteArray, 5484, 12);
    @CAN_PrivMain::RFR_Object::RXX_Object_Obj9.PyAyCoVnce = convertRawToPhysical(raw_value, 0.01, 0.0);

    raw_value=copyBitsFromByteArrayLE( byteArray, 5164, 12);
    @CAN_PrivMain::RFR_Object::RXX_Object_Obj9.PyVnce = convertRawToPhysical(raw_value, 0.1, 0.0);

    raw_value=copyBitsFromByteArrayLE( byteArray, 5408, 12);
    @CAN_PrivMain::RFR_Object::RXX_Object_Obj9.PyVxCoVnce = convertRawToPhysical(raw_value, 0.01, 0.0);

    raw_value=copyBitsFromByteArrayLE( byteArray, 5420, 12);
    @CAN_PrivMain::RFR_Object::RXX_Object_Obj9.PyVyCoVnce = convertRawToPhysical(raw_value, 0.01, 0.0);

    raw_value=copyBitsFromByteArrayLE( byteArray, 5260, 10);
    @CAN_PrivMain::RFR_Object::RXX_Object_Obj9.RCS = convertRawToPhysical(raw_value, 0.2, -102.4);

    raw_value=copyBitsFromByteArrayLE( byteArray, 5432, 4);
    @CAN_PrivMain::RFR_Object::RXX_Object_Obj9.ReferencePoint = convertRawToPhysical(raw_value, 1.0, 0.0);

    raw_value=copyBitsFromByteArrayLE( byteArray, 5292, 12);
    @CAN_PrivMain::RFR_Object::RXX_Object_Obj9.Vx = convertRawToPhysical(raw_value, 0.0625, -128.0);

    raw_value=copyBitsFromByteArrayLE( byteArray, 5516, 12);
    @CAN_PrivMain::RFR_Object::RXX_Object_Obj9.VxAxCoVnce = convertRawToPhysical(raw_value, 0.01, 0.0);

    raw_value=copyBitsFromByteArrayLE( byteArray, 5536, 12);
    @CAN_PrivMain::RFR_Object::RXX_Object_Obj9.VxAyCoVnce = convertRawToPhysical(raw_value, 0.01, 0.0);

    raw_value=copyBitsFromByteArrayLE( byteArray, 5312, 12);
    @CAN_PrivMain::RFR_Object::RXX_Object_Obj9.VxVnce = convertRawToPhysical(raw_value, 0.01, 0.0);

    raw_value=copyBitsFromByteArrayLE( byteArray, 5504, 12);
    @CAN_PrivMain::RFR_Object::RXX_Object_Obj9.VxVyCoVnce = convertRawToPhysical(raw_value, 0.01, 0.0);

    raw_value=copyBitsFromByteArrayLE( byteArray, 5326, 10);
    @CAN_PrivMain::RFR_Object::RXX_Object_Obj9.Vy = convertRawToPhysical(raw_value, 0.125, -64.0);

    raw_value=copyBitsFromByteArrayLE( byteArray, 5548, 12);
    @CAN_PrivMain::RFR_Object::RXX_Object_Obj9.VyAxCoVnce = convertRawToPhysical(raw_value, 0.01, 0.0);

    raw_value=copyBitsFromByteArrayLE( byteArray, 5568, 12);
    @CAN_PrivMain::RFR_Object::RXX_Object_Obj9.VyAyCoVnce = convertRawToPhysical(raw_value, 0.01, 0.0);

    raw_value=copyBitsFromByteArrayLE( byteArray, 5344, 12);
    @CAN_PrivMain::RFR_Object::RXX_Object_Obj9.VyVnce = convertRawToPhysical(raw_value, 0.01, 0.0);

    raw_value=copyBitsFromByteArrayLE( byteArray, 5240, 7);
    @CAN_PrivMain::RFR_Object::RXX_Object_Obj9.Width = convertRawToPhysical(raw_value, 0.125, 0.0);

    raw_value=copyBitsFromByteArrayLE( byteArray, 5248, 12);
    @CAN_PrivMain::RFR_Object::RXX_Object_Obj9.WidthVnce = convertRawToPhysical(raw_value, 0.01, 0.0);
}


void SetDataReceived_Toliman_RFR_Object(byte byteArray[], long count)//I-signal-i pdu : RFR_Object->Mapped to ->N-pdu : RFR_Object
{
    qword raw_value;

    raw_value=copyBitsFromByteArrayBE( byteArray, 26128, 16);
    @CAN_PrivMain::RFR_Object::RXX_Object_E2E_p44_counter = convertRawToPhysical(raw_value, 1.0, 0.0);

    raw_value=copyBitsFromByteArrayBE( byteArray, 26176, 32);
    @CAN_PrivMain::RFR_Object::RXX_Object_E2E_p44_crc = convertRawToPhysical(raw_value, 1.0, 0.0);

    raw_value=copyBitsFromByteArrayBE( byteArray, 26144, 32);
    @CAN_PrivMain::RFR_Object::RXX_Object_E2E_p44_dataId = convertRawToPhysical(raw_value, 1.0, 0.0);

    raw_value=copyBitsFromByteArrayBE( byteArray, 26112, 16);
    @CAN_PrivMain::RFR_Object::RXX_Object_E2E_p44_length = convertRawToPhysical(raw_value, 1.0, 0.0);

    raw_value=copyBitsFromByteArrayLE( byteArray, 82, 1);
    @CAN_PrivMain::RFR_Object::RXX_Object_ObjHdr_LocDownSel = convertRawToPhysical(raw_value, 1.0, 0.0);

    raw_value=copyBitsFromByteArrayLE( byteArray, 72, 10);
    @CAN_PrivMain::RFR_Object::RXX_Object_ObjHdr_NumValidObjects = convertRawToPhysical(raw_value, 1.0, 0.0);

    raw_value=copyBitsFromByteArrayLE( byteArray, 32, 32);
    @CAN_PrivMain::RFR_Object::RXX_Object_ObjHdr_TimeStamp = convertRawToPhysical(raw_value, 1.0, 0.0);

    raw_value=copyBitsFromByteArrayLE( byteArray, 64, 8);
    @CAN_PrivMain::RFR_Object::RXX_Object_ObjHdr_TimeStampStatus = convertRawToPhysical(raw_value, 1.0, 0.0);

    raw_value=copyBitsFromByteArrayLE( byteArray, 0, 8);
    @CAN_PrivMain::RFR_Object::RXX_Object_ObjHdr_VersionIdMajor = convertRawToPhysical(raw_value, 1.0, 0.0);

    raw_value=copyBitsFromByteArrayLE( byteArray, 8, 8);
    @CAN_PrivMain::RFR_Object::RXX_Object_ObjHdr_VersionIdMinor = convertRawToPhysical(raw_value, 1.0, 0.0);

    raw_value=copyBitsFromByteArrayLE( byteArray, 960, 2);
    @CAN_PrivMain::RFR_Object::RXX_Object_ShiiHdr_DataMeasured = convertRawToPhysical(raw_value, 1.0, 0.0);

    raw_value=copyBitsFromByteArrayLE( byteArray, 976, 8);
    @CAN_PrivMain::RFR_Object::RXX_Object_ShiiHdr_MisAzOOPCause = convertRawToPhysical(raw_value, 1.0, 0.0);

    raw_value=copyBitsFromByteArrayLE( byteArray, 984, 8);
    @CAN_PrivMain::RFR_Object::RXX_Object_ShiiHdr_MisElOOPCause = convertRawToPhysical(raw_value, 1.0, 0.0);

    raw_value=copyBitsFromByteArrayLE( byteArray, 968, 1);
    @CAN_PrivMain::RFR_Object::RXX_Object_ShiiHdr_SensorCalExtStat = convertRawToPhysical(raw_value, 1.0, 0.0);

    raw_value=copyBitsFromByteArrayLE( byteArray, 969, 1);
    @CAN_PrivMain::RFR_Object::RXX_Object_ShiiHdr_SensorCalIntStat = convertRawToPhysical(raw_value, 1.0, 0.0);

    raw_value=copyBitsFromByteArrayLE( byteArray, 972, 4);
    @CAN_PrivMain::RFR_Object::RXX_Object_ShiiHdr_SensorCalOnlStat = convertRawToPhysical(raw_value, 1.0, 0.0);

    raw_value=copyBitsFromByteArrayLE( byteArray, 992, 16);
    @CAN_PrivMain::RFR_Object::RXX_Object_ShiiHdr_SensorFailureReas = convertRawToPhysical(raw_value, 1.0, 0.0);

    raw_value=copyBitsFromByteArrayLE( byteArray, 970, 2);
    @CAN_PrivMain::RFR_Object::RXX_Object_ShiiHdr_SensorHeatingStatus = convertRawToPhysical(raw_value, 1.0, 0.0);

    raw_value=copyBitsFromByteArrayLE( byteArray, 1008, 8);
    @CAN_PrivMain::RFR_Object::RXX_Object_ShiiHdr_SensorOmmOpMode = convertRawToPhysical(raw_value, 1.0, 0.0);

    raw_value=copyBitsFromByteArrayLE( byteArray, 931, 6);
    @CAN_PrivMain::RFR_Object::RXX_Object_SpiHdr_BldFov_Confidence = convertRawToPhysical(raw_value, 2.0, 0.0);

    raw_value=copyBitsFromByteArrayLE( byteArray, 928, 3);
    @CAN_PrivMain::RFR_Object::RXX_Object_SpiHdr_BldFov_Status = convertRawToPhysical(raw_value, 1.0, 0.0);

    raw_value=copyBitsFromByteArrayLE( byteArray, 208, 16);
    @CAN_PrivMain::RFR_Object::RXX_Object_SpiHdr_DistMaxProc = convertRawToPhysical(raw_value, 0.01, 0.0);

    raw_value=copyBitsFromByteArrayLE( byteArray, 192, 16);
    @CAN_PrivMain::RFR_Object::RXX_Object_SpiHdr_DistMeasMaxMod = convertRawToPhysical(raw_value, 0.01, 0.0);

    raw_value=copyBitsFromByteArrayLE( byteArray, 171, 10);
    @CAN_PrivMain::RFR_Object::RXX_Object_SpiHdr_DistMeasMinMod = convertRawToPhysical(raw_value, 0.01, 0.0);

    raw_value=copyBitsFromByteArrayLE( byteArray, 144, 13);
    @CAN_PrivMain::RFR_Object::RXX_Object_SpiHdr_DistPrec = convertRawToPhysical(raw_value, 0.0001, 0.0);

    raw_value=copyBitsFromByteArrayLE( byteArray, 115, 10);
    @CAN_PrivMain::RFR_Object::RXX_Object_SpiHdr_DistSep = convertRawToPhysical(raw_value, 0.01, 0.0);

    raw_value=copyBitsFromByteArrayLE( byteArray, 128, 16);
    @CAN_PrivMain::RFR_Object::RXX_Object_SpiHdr_DistStartProcDegraded = convertRawToPhysical(raw_value, 0.01, 0.0);

    raw_value=copyBitsFromByteArrayLE( byteArray, 96, 6);
    @CAN_PrivMain::RFR_Object::RXX_Object_SpiHdr_DmpId = convertRawToPhysical(raw_value, 1.0, 0.0);

    raw_value=copyBitsFromByteArrayLE( byteArray, 656, 10);
    @CAN_PrivMain::RFR_Object::RXX_Object_SpiHdr_FovRtrAzDetRng00 = convertRawToPhysical(raw_value, 1.0, 0.0);

    raw_value=copyBitsFromByteArrayLE( byteArray, 672, 10);
    @CAN_PrivMain::RFR_Object::RXX_Object_SpiHdr_FovRtrAzDetRng01 = convertRawToPhysical(raw_value, 1.0, 0.0);

    raw_value=copyBitsFromByteArrayLE( byteArray, 682, 10);
    @CAN_PrivMain::RFR_Object::RXX_Object_SpiHdr_FovRtrAzDetRng02 = convertRawToPhysical(raw_value, 1.0, 0.0);

    raw_value=copyBitsFromByteArrayLE( byteArray, 692, 10);
    @CAN_PrivMain::RFR_Object::RXX_Object_SpiHdr_FovRtrAzDetRng03 = convertRawToPhysical(raw_value, 1.0, 0.0);

    raw_value=copyBitsFromByteArrayLE( byteArray, 704, 10);
    @CAN_PrivMain::RFR_Object::RXX_Object_SpiHdr_FovRtrAzDetRng04 = convertRawToPhysical(raw_value, 1.0, 0.0);

    raw_value=copyBitsFromByteArrayLE( byteArray, 714, 10);
    @CAN_PrivMain::RFR_Object::RXX_Object_SpiHdr_FovRtrAzDetRng05 = convertRawToPhysical(raw_value, 1.0, 0.0);

    raw_value=copyBitsFromByteArrayLE( byteArray, 724, 10);
    @CAN_PrivMain::RFR_Object::RXX_Object_SpiHdr_FovRtrAzDetRng06 = convertRawToPhysical(raw_value, 1.0, 0.0);

    raw_value=copyBitsFromByteArrayLE( byteArray, 736, 10);
    @CAN_PrivMain::RFR_Object::RXX_Object_SpiHdr_FovRtrAzDetRng07 = convertRawToPhysical(raw_value, 1.0, 0.0);

    raw_value=copyBitsFromByteArrayLE( byteArray, 746, 10);
    @CAN_PrivMain::RFR_Object::RXX_Object_SpiHdr_FovRtrAzDetRng08 = convertRawToPhysical(raw_value, 1.0, 0.0);

    raw_value=copyBitsFromByteArrayLE( byteArray, 756, 10);
    @CAN_PrivMain::RFR_Object::RXX_Object_SpiHdr_FovRtrAzDetRng09 = convertRawToPhysical(raw_value, 1.0, 0.0);

    raw_value=copyBitsFromByteArrayLE( byteArray, 768, 10);
    @CAN_PrivMain::RFR_Object::RXX_Object_SpiHdr_FovRtrAzDetRng10 = convertRawToPhysical(raw_value, 1.0, 0.0);

    raw_value=copyBitsFromByteArrayLE( byteArray, 778, 10);
    @CAN_PrivMain::RFR_Object::RXX_Object_SpiHdr_FovRtrAzDetRng11 = convertRawToPhysical(raw_value, 1.0, 0.0);

    raw_value=copyBitsFromByteArrayLE( byteArray, 788, 10);
    @CAN_PrivMain::RFR_Object::RXX_Object_SpiHdr_FovRtrAzDetRng12 = convertRawToPhysical(raw_value, 1.0, 0.0);

    raw_value=copyBitsFromByteArrayLE( byteArray, 800, 10);
    @CAN_PrivMain::RFR_Object::RXX_Object_SpiHdr_FovRtrAzDetRng13 = convertRawToPhysical(raw_value, 1.0, 0.0);

    raw_value=copyBitsFromByteArrayLE( byteArray, 810, 10);
    @CAN_PrivMain::RFR_Object::RXX_Object_SpiHdr_FovRtrAzDetRng14 = convertRawToPhysical(raw_value, 1.0, 0.0);

    raw_value=copyBitsFromByteArrayLE( byteArray, 820, 10);
    @CAN_PrivMain::RFR_Object::RXX_Object_SpiHdr_FovRtrAzDetRng15 = convertRawToPhysical(raw_value, 1.0, 0.0);

    raw_value=copyBitsFromByteArrayLE( byteArray, 832, 10);
    @CAN_PrivMain::RFR_Object::RXX_Object_SpiHdr_FovRtrAzDetRng16 = convertRawToPhysical(raw_value, 1.0, 0.0);

    raw_value=copyBitsFromByteArrayLE( byteArray, 842, 10);
    @CAN_PrivMain::RFR_Object::RXX_Object_SpiHdr_FovRtrAzDetRng17 = convertRawToPhysical(raw_value, 1.0, 0.0);

    raw_value=copyBitsFromByteArrayLE( byteArray, 852, 10);
    @CAN_PrivMain::RFR_Object::RXX_Object_SpiHdr_FovRtrAzDetRng18 = convertRawToPhysical(raw_value, 1.0, 0.0);

    raw_value=copyBitsFromByteArrayLE( byteArray, 864, 10);
    @CAN_PrivMain::RFR_Object::RXX_Object_SpiHdr_FovRtrAzDetRng19 = convertRawToPhysical(raw_value, 1.0, 0.0);

    raw_value=copyBitsFromByteArrayLE( byteArray, 874, 10);
    @CAN_PrivMain::RFR_Object::RXX_Object_SpiHdr_FovRtrAzDetRng20 = convertRawToPhysical(raw_value, 1.0, 0.0);

    raw_value=copyBitsFromByteArrayLE( byteArray, 884, 10);
    @CAN_PrivMain::RFR_Object::RXX_Object_SpiHdr_FovRtrAzDetRng21 = convertRawToPhysical(raw_value, 1.0, 0.0);

    raw_value=copyBitsFromByteArrayLE( byteArray, 896, 10);
    @CAN_PrivMain::RFR_Object::RXX_Object_SpiHdr_FovRtrAzDetRng22 = convertRawToPhysical(raw_value, 1.0, 0.0);

    raw_value=copyBitsFromByteArrayLE( byteArray, 906, 10);
    @CAN_PrivMain::RFR_Object::RXX_Object_SpiHdr_FovRtrAzDetRng23 = convertRawToPhysical(raw_value, 1.0, 0.0);

    raw_value=copyBitsFromByteArrayLE( byteArray, 916, 10);
    @CAN_PrivMain::RFR_Object::RXX_Object_SpiHdr_FovRtrAzDetRng24 = convertRawToPhysical(raw_value, 1.0, 0.0);

    raw_value=copyBitsFromByteArrayLE( byteArray, 455, 8);
    @CAN_PrivMain::RFR_Object::RXX_Object_SpiHdr_FovRtrAzSegBrdr00 = convertRawToPhysical(raw_value, 0.0175, -2.24);

    raw_value=copyBitsFromByteArrayLE( byteArray, 463, 8);
    @CAN_PrivMain::RFR_Object::RXX_Object_SpiHdr_FovRtrAzSegBrdr01 = convertRawToPhysical(raw_value, 0.0175, -2.24);

    raw_value=copyBitsFromByteArrayLE( byteArray, 471, 8);
    @CAN_PrivMain::RFR_Object::RXX_Object_SpiHdr_FovRtrAzSegBrdr02 = convertRawToPhysical(raw_value, 0.0175, -2.24);

    raw_value=copyBitsFromByteArrayLE( byteArray, 480, 8);
    @CAN_PrivMain::RFR_Object::RXX_Object_SpiHdr_FovRtrAzSegBrdr03 = convertRawToPhysical(raw_value, 0.0175, -2.24);

    raw_value=copyBitsFromByteArrayLE( byteArray, 488, 8);
    @CAN_PrivMain::RFR_Object::RXX_Object_SpiHdr_FovRtrAzSegBrdr04 = convertRawToPhysical(raw_value, 0.0175, -2.24);

    raw_value=copyBitsFromByteArrayLE( byteArray, 496, 8);
    @CAN_PrivMain::RFR_Object::RXX_Object_SpiHdr_FovRtrAzSegBrdr05 = convertRawToPhysical(raw_value, 0.0175, -2.24);

    raw_value=copyBitsFromByteArrayLE( byteArray, 504, 8);
    @CAN_PrivMain::RFR_Object::RXX_Object_SpiHdr_FovRtrAzSegBrdr06 = convertRawToPhysical(raw_value, 0.0175, -2.24);

    raw_value=copyBitsFromByteArrayLE( byteArray, 512, 8);
    @CAN_PrivMain::RFR_Object::RXX_Object_SpiHdr_FovRtrAzSegBrdr07 = convertRawToPhysical(raw_value, 0.0175, -2.24);

    raw_value=copyBitsFromByteArrayLE( byteArray, 520, 8);
    @CAN_PrivMain::RFR_Object::RXX_Object_SpiHdr_FovRtrAzSegBrdr08 = convertRawToPhysical(raw_value, 0.0175, -2.24);

    raw_value=copyBitsFromByteArrayLE( byteArray, 528, 8);
    @CAN_PrivMain::RFR_Object::RXX_Object_SpiHdr_FovRtrAzSegBrdr09 = convertRawToPhysical(raw_value, 0.0175, -2.24);

    raw_value=copyBitsFromByteArrayLE( byteArray, 536, 8);
    @CAN_PrivMain::RFR_Object::RXX_Object_SpiHdr_FovRtrAzSegBrdr10 = convertRawToPhysical(raw_value, 0.0175, -2.24);

    raw_value=copyBitsFromByteArrayLE( byteArray, 544, 8);
    @CAN_PrivMain::RFR_Object::RXX_Object_SpiHdr_FovRtrAzSegBrdr11 = convertRawToPhysical(raw_value, 0.0175, -2.24);

    raw_value=copyBitsFromByteArrayLE( byteArray, 552, 8);
    @CAN_PrivMain::RFR_Object::RXX_Object_SpiHdr_FovRtrAzSegBrdr12 = convertRawToPhysical(raw_value, 0.0175, -2.24);

    raw_value=copyBitsFromByteArrayLE( byteArray, 560, 8);
    @CAN_PrivMain::RFR_Object::RXX_Object_SpiHdr_FovRtrAzSegBrdr13 = convertRawToPhysical(raw_value, 0.0175, -2.24);

    raw_value=copyBitsFromByteArrayLE( byteArray, 568, 8);
    @CAN_PrivMain::RFR_Object::RXX_Object_SpiHdr_FovRtrAzSegBrdr14 = convertRawToPhysical(raw_value, 0.0175, -2.24);

    raw_value=copyBitsFromByteArrayLE( byteArray, 576, 8);
    @CAN_PrivMain::RFR_Object::RXX_Object_SpiHdr_FovRtrAzSegBrdr15 = convertRawToPhysical(raw_value, 0.0175, -2.24);

    raw_value=copyBitsFromByteArrayLE( byteArray, 584, 8);
    @CAN_PrivMain::RFR_Object::RXX_Object_SpiHdr_FovRtrAzSegBrdr16 = convertRawToPhysical(raw_value, 0.0175, -2.24);

    raw_value=copyBitsFromByteArrayLE( byteArray, 592, 8);
    @CAN_PrivMain::RFR_Object::RXX_Object_SpiHdr_FovRtrAzSegBrdr17 = convertRawToPhysical(raw_value, 0.0175, -2.24);

    raw_value=copyBitsFromByteArrayLE( byteArray, 600, 8);
    @CAN_PrivMain::RFR_Object::RXX_Object_SpiHdr_FovRtrAzSegBrdr18 = convertRawToPhysical(raw_value, 0.0175, -2.24);

    raw_value=copyBitsFromByteArrayLE( byteArray, 608, 8);
    @CAN_PrivMain::RFR_Object::RXX_Object_SpiHdr_FovRtrAzSegBrdr19 = convertRawToPhysical(raw_value, 0.0175, -2.24);

    raw_value=copyBitsFromByteArrayLE( byteArray, 616, 8);
    @CAN_PrivMain::RFR_Object::RXX_Object_SpiHdr_FovRtrAzSegBrdr20 = convertRawToPhysical(raw_value, 0.0175, -2.24);

    raw_value=copyBitsFromByteArrayLE( byteArray, 624, 8);
    @CAN_PrivMain::RFR_Object::RXX_Object_SpiHdr_FovRtrAzSegBrdr21 = convertRawToPhysical(raw_value, 0.0175, -2.24);

    raw_value=copyBitsFromByteArrayLE( byteArray, 632, 8);
    @CAN_PrivMain::RFR_Object::RXX_Object_SpiHdr_FovRtrAzSegBrdr22 = convertRawToPhysical(raw_value, 0.0175, -2.24);

    raw_value=copyBitsFromByteArrayLE( byteArray, 640, 8);
    @CAN_PrivMain::RFR_Object::RXX_Object_SpiHdr_FovRtrAzSegBrdr23 = convertRawToPhysical(raw_value, 0.0175, -2.24);

    raw_value=copyBitsFromByteArrayLE( byteArray, 648, 8);
    @CAN_PrivMain::RFR_Object::RXX_Object_SpiHdr_FovRtrAzSegBrdr24 = convertRawToPhysical(raw_value, 0.0175, -2.24);

    raw_value=copyBitsFromByteArrayLE( byteArray, 320, 7);
    @CAN_PrivMain::RFR_Object::RXX_Object_SpiHdr_FovRtrElRngGEnd00 = convertRawToPhysical(raw_value, 0.01, 0.0);

    raw_value=copyBitsFromByteArrayLE( byteArray, 327, 7);
    @CAN_PrivMain::RFR_Object::RXX_Object_SpiHdr_FovRtrElRngGEnd01 = convertRawToPhysical(raw_value, 0.01, 0.0);

    raw_value=copyBitsFromByteArrayLE( byteArray, 334, 7);
    @CAN_PrivMain::RFR_Object::RXX_Object_SpiHdr_FovRtrElRngGEnd02 = convertRawToPhysical(raw_value, 0.01, 0.0);

    raw_value=copyBitsFromByteArrayLE( byteArray, 341, 7);
    @CAN_PrivMain::RFR_Object::RXX_Object_SpiHdr_FovRtrElRngGEnd03 = convertRawToPhysical(raw_value, 0.01, 0.0);

    raw_value=copyBitsFromByteArrayLE( byteArray, 352, 7);
    @CAN_PrivMain::RFR_Object::RXX_Object_SpiHdr_FovRtrElRngGEnd04 = convertRawToPhysical(raw_value, 0.01, 0.0);

    raw_value=copyBitsFromByteArrayLE( byteArray, 359, 7);
    @CAN_PrivMain::RFR_Object::RXX_Object_SpiHdr_FovRtrElRngGEnd05 = convertRawToPhysical(raw_value, 0.01, 0.0);

    raw_value=copyBitsFromByteArrayLE( byteArray, 366, 7);
    @CAN_PrivMain::RFR_Object::RXX_Object_SpiHdr_FovRtrElRngGEnd06 = convertRawToPhysical(raw_value, 0.01, 0.0);

    raw_value=copyBitsFromByteArrayLE( byteArray, 373, 7);
    @CAN_PrivMain::RFR_Object::RXX_Object_SpiHdr_FovRtrElRngGEnd07 = convertRawToPhysical(raw_value, 0.01, 0.0);

    raw_value=copyBitsFromByteArrayLE( byteArray, 384, 7);
    @CAN_PrivMain::RFR_Object::RXX_Object_SpiHdr_FovRtrElRngGEnd08 = convertRawToPhysical(raw_value, 0.01, 0.0);

    raw_value=copyBitsFromByteArrayLE( byteArray, 391, 7);
    @CAN_PrivMain::RFR_Object::RXX_Object_SpiHdr_FovRtrElRngGEnd09 = convertRawToPhysical(raw_value, 0.01, 0.0);

    raw_value=copyBitsFromByteArrayLE( byteArray, 398, 7);
    @CAN_PrivMain::RFR_Object::RXX_Object_SpiHdr_FovRtrElRngGEnd10 = convertRawToPhysical(raw_value, 0.01, 0.0);

    raw_value=copyBitsFromByteArrayLE( byteArray, 235, 7);
    @CAN_PrivMain::RFR_Object::RXX_Object_SpiHdr_FovRtrElSegBrdr00 = convertRawToPhysical(raw_value, 0.0175, -1.12);

    raw_value=copyBitsFromByteArrayLE( byteArray, 242, 7);
    @CAN_PrivMain::RFR_Object::RXX_Object_SpiHdr_FovRtrElSegBrdr01 = convertRawToPhysical(raw_value, 0.0175, -1.12);

    raw_value=copyBitsFromByteArrayLE( byteArray, 249, 7);
    @CAN_PrivMain::RFR_Object::RXX_Object_SpiHdr_FovRtrElSegBrdr02 = convertRawToPhysical(raw_value, 0.0175, -1.12);

    raw_value=copyBitsFromByteArrayLE( byteArray, 256, 7);
    @CAN_PrivMain::RFR_Object::RXX_Object_SpiHdr_FovRtrElSegBrdr03 = convertRawToPhysical(raw_value, 0.0175, -1.12);

    raw_value=copyBitsFromByteArrayLE( byteArray, 263, 7);
    @CAN_PrivMain::RFR_Object::RXX_Object_SpiHdr_FovRtrElSegBrdr04 = convertRawToPhysical(raw_value, 0.0175, -1.12);

    raw_value=copyBitsFromByteArrayLE( byteArray, 270, 7);
    @CAN_PrivMain::RFR_Object::RXX_Object_SpiHdr_FovRtrElSegBrdr05 = convertRawToPhysical(raw_value, 0.0175, -1.12);

    raw_value=copyBitsFromByteArrayLE( byteArray, 277, 7);
    @CAN_PrivMain::RFR_Object::RXX_Object_SpiHdr_FovRtrElSegBrdr06 = convertRawToPhysical(raw_value, 0.0175, -1.12);

    raw_value=copyBitsFromByteArrayLE( byteArray, 288, 7);
    @CAN_PrivMain::RFR_Object::RXX_Object_SpiHdr_FovRtrElSegBrdr07 = convertRawToPhysical(raw_value, 0.0175, -1.12);

    raw_value=copyBitsFromByteArrayLE( byteArray, 295, 7);
    @CAN_PrivMain::RFR_Object::RXX_Object_SpiHdr_FovRtrElSegBrdr08 = convertRawToPhysical(raw_value, 0.0175, -1.12);

    raw_value=copyBitsFromByteArrayLE( byteArray, 302, 7);
    @CAN_PrivMain::RFR_Object::RXX_Object_SpiHdr_FovRtrElSegBrdr09 = convertRawToPhysical(raw_value, 0.0175, -1.12);

    raw_value=copyBitsFromByteArrayLE( byteArray, 309, 7);
    @CAN_PrivMain::RFR_Object::RXX_Object_SpiHdr_FovRtrElSegBrdr10 = convertRawToPhysical(raw_value, 0.0175, -1.12);

    raw_value=copyBitsFromByteArrayLE( byteArray, 102, 13);
    @CAN_PrivMain::RFR_Object::RXX_Object_SpiHdr_ModId = convertRawToPhysical(raw_value, 1.0, 0.0);

    raw_value=copyBitsFromByteArrayLE( byteArray, 448, 7);
    @CAN_PrivMain::RFR_Object::RXX_Object_SpiHdr_RngGainRfInterfere = convertRawToPhysical(raw_value, 1.0, 0.0);

    raw_value=copyBitsFromByteArrayLE( byteArray, 444, 3);
    @CAN_PrivMain::RFR_Object::RXX_Object_SpiHdr_SensorExtDisturbed = convertRawToPhysical(raw_value, 1.0, 0.0);

    raw_value=copyBitsFromByteArrayLE( byteArray, 432, 12);
    @CAN_PrivMain::RFR_Object::RXX_Object_SpiHdr_SensorOrientPitch = convertRawToPhysical(raw_value, 0.00017, -0.34816);

    raw_value=copyBitsFromByteArrayLE( byteArray, 416, 16);
    @CAN_PrivMain::RFR_Object::RXX_Object_SpiHdr_SensorOrientYaw = convertRawToPhysical(raw_value, 0.00017, -5.57056);

    raw_value=copyBitsFromByteArrayLE( byteArray, 447, 1);
    @CAN_PrivMain::RFR_Object::RXX_Object_SpiHdr_SensorOrientation = convertRawToPhysical(raw_value, 1.0, 0.0);

    raw_value=copyBitsFromByteArrayLE( byteArray, 937, 9);
    @CAN_PrivMain::RFR_Object::RXX_Object_SpiHdr_SensorOriginPointX = convertRawToPhysical(raw_value, 0.02, -5.12);

    raw_value=copyBitsFromByteArrayLE( byteArray, 946, 8);
    @CAN_PrivMain::RFR_Object::RXX_Object_SpiHdr_SensorOriginPointY = convertRawToPhysical(raw_value, 0.01, -1.28);

    raw_value=copyBitsFromByteArrayLE( byteArray, 954, 5);
    @CAN_PrivMain::RFR_Object::RXX_Object_SpiHdr_SensorOriginPointZ = convertRawToPhysical(raw_value, 0.05, 0.0);

    raw_value=copyBitsFromByteArrayLE( byteArray, 224, 11);
    @CAN_PrivMain::RFR_Object::RXX_Object_SpiHdr_VelMeasMax = convertRawToPhysical(raw_value, 0.1, 0.0);

    raw_value=copyBitsFromByteArrayLE( byteArray, 405, 11);
    @CAN_PrivMain::RFR_Object::RXX_Object_SpiHdr_VelMeasMin = convertRawToPhysical(raw_value, 0.1, -150.0);

    raw_value=copyBitsFromByteArrayLE( byteArray, 160, 11);
    @CAN_PrivMain::RFR_Object::RXX_Object_SpiHdr_VelPrec = convertRawToPhysical(raw_value, 0.0001, 0.0);

    raw_value=copyBitsFromByteArrayLE( byteArray, 181, 10);
    @CAN_PrivMain::RFR_Object::RXX_Object_SpiHdr_VelSep = convertRawToPhysical(raw_value, 0.01, 0.0);

    if(@CAN_PrivMain::RFR_Object::RXX_Object_Obj1.Read == 1)
    {
        CRadarFR_RXX_Object_Obj1_SetDataReceived(byteArray);
    }

    if(@CAN_PrivMain::RFR_Object::RXX_Object_Obj10.Read == 1)
    {
        CRadarFR_RXX_Object_Obj10_SetDataReceived(byteArray);
    }

    if(@CAN_PrivMain::RFR_Object::RXX_Object_Obj11.Read == 1)
    {
        CRadarFR_RXX_Object_Obj11_SetDataReceived(byteArray);
    }

    if(@CAN_PrivMain::RFR_Object::RXX_Object_Obj12.Read == 1)
    {
        CRadarFR_RXX_Object_Obj12_SetDataReceived(byteArray);
    }

    if(@CAN_PrivMain::RFR_Object::RXX_Object_Obj13.Read == 1)
    {
        CRadarFR_RXX_Object_Obj13_SetDataReceived(byteArray);
    }

    if(@CAN_PrivMain::RFR_Object::RXX_Object_Obj14.Read == 1)
    {
        CRadarFR_RXX_Object_Obj14_SetDataReceived(byteArray);
    }

    if(@CAN_PrivMain::RFR_Object::RXX_Object_Obj15.Read == 1)
    {
        CRadarFR_RXX_Object_Obj15_SetDataReceived(byteArray);
    }

    if(@CAN_PrivMain::RFR_Object::RXX_Object_Obj16.Read == 1)
    {
        CRadarFR_RXX_Object_Obj16_SetDataReceived(byteArray);
    }

    if(@CAN_PrivMain::RFR_Object::RXX_Object_Obj17.Read == 1)
    {
        CRadarFR_RXX_Object_Obj17_SetDataReceived(byteArray);
    }

    if(@CAN_PrivMain::RFR_Object::RXX_Object_Obj18.Read == 1)
    {
        CRadarFR_RXX_Object_Obj18_SetDataReceived(byteArray);
    }

    if(@CAN_PrivMain::RFR_Object::RXX_Object_Obj19.Read == 1)
    {
        CRadarFR_RXX_Object_Obj19_SetDataReceived(byteArray);
    }

    if(@CAN_PrivMain::RFR_Object::RXX_Object_Obj2.Read == 1)
    {
        CRadarFR_RXX_Object_Obj2_SetDataReceived(byteArray);
    }

    if(@CAN_PrivMain::RFR_Object::RXX_Object_Obj20.Read == 1)
    {
        CRadarFR_RXX_Object_Obj20_SetDataReceived(byteArray);
    }

    if(@CAN_PrivMain::RFR_Object::RXX_Object_Obj21.Read == 1)
    {
        CRadarFR_RXX_Object_Obj21_SetDataReceived(byteArray);
    }

    if(@CAN_PrivMain::RFR_Object::RXX_Object_Obj22.Read == 1)
    {
        CRadarFR_RXX_Object_Obj22_SetDataReceived(byteArray);
    }

    if(@CAN_PrivMain::RFR_Object::RXX_Object_Obj23.Read == 1)
    {
        CRadarFR_RXX_Object_Obj23_SetDataReceived(byteArray);
    }

    if(@CAN_PrivMain::RFR_Object::RXX_Object_Obj24.Read == 1)
    {
        CRadarFR_RXX_Object_Obj24_SetDataReceived(byteArray);
    }

    if(@CAN_PrivMain::RFR_Object::RXX_Object_Obj25.Read == 1)
    {
        CRadarFR_RXX_Object_Obj25_SetDataReceived(byteArray);
    }

    if(@CAN_PrivMain::RFR_Object::RXX_Object_Obj26.Read == 1)
    {
        CRadarFR_RXX_Object_Obj26_SetDataReceived(byteArray);
    }

    if(@CAN_PrivMain::RFR_Object::RXX_Object_Obj27.Read == 1)
    {
        CRadarFR_RXX_Object_Obj27_SetDataReceived(byteArray);
    }

    if(@CAN_PrivMain::RFR_Object::RXX_Object_Obj28.Read == 1)
    {
        CRadarFR_RXX_Object_Obj28_SetDataReceived(byteArray);
    }

    if(@CAN_PrivMain::RFR_Object::RXX_Object_Obj29.Read == 1)
    {
        CRadarFR_RXX_Object_Obj29_SetDataReceived(byteArray);
    }

    if(@CAN_PrivMain::RFR_Object::RXX_Object_Obj3.Read == 1)
    {
        CRadarFR_RXX_Object_Obj3_SetDataReceived(byteArray);
    }

    if(@CAN_PrivMain::RFR_Object::RXX_Object_Obj30.Read == 1)
    {
        CRadarFR_RXX_Object_Obj30_SetDataReceived(byteArray);
    }

    if(@CAN_PrivMain::RFR_Object::RXX_Object_Obj31.Read == 1)
    {
        CRadarFR_RXX_Object_Obj31_SetDataReceived(byteArray);
    }

    if(@CAN_PrivMain::RFR_Object::RXX_Object_Obj32.Read == 1)
    {
        CRadarFR_RXX_Object_Obj32_SetDataReceived(byteArray);
    }

    if(@CAN_PrivMain::RFR_Object::RXX_Object_Obj33.Read == 1)
    {
        CRadarFR_RXX_Object_Obj33_SetDataReceived(byteArray);
    }

    if(@CAN_PrivMain::RFR_Object::RXX_Object_Obj34.Read == 1)
    {
        CRadarFR_RXX_Object_Obj34_SetDataReceived(byteArray);
    }

    if(@CAN_PrivMain::RFR_Object::RXX_Object_Obj35.Read == 1)
    {
        CRadarFR_RXX_Object_Obj35_SetDataReceived(byteArray);
    }

    if(@CAN_PrivMain::RFR_Object::RXX_Object_Obj36.Read == 1)
    {
        CRadarFR_RXX_Object_Obj36_SetDataReceived(byteArray);
    }

    if(@CAN_PrivMain::RFR_Object::RXX_Object_Obj37.Read == 1)
    {
        CRadarFR_RXX_Object_Obj37_SetDataReceived(byteArray);
    }

    if(@CAN_PrivMain::RFR_Object::RXX_Object_Obj38.Read == 1)
    {
        CRadarFR_RXX_Object_Obj38_SetDataReceived(byteArray);
    }

    if(@CAN_PrivMain::RFR_Object::RXX_Object_Obj39.Read == 1)
    {
        CRadarFR_RXX_Object_Obj39_SetDataReceived(byteArray);
    }

    if(@CAN_PrivMain::RFR_Object::RXX_Object_Obj4.Read == 1)
    {
        CRadarFR_RXX_Object_Obj4_SetDataReceived(byteArray);
    }

    if(@CAN_PrivMain::RFR_Object::RXX_Object_Obj40.Read == 1)
    {
        CRadarFR_RXX_Object_Obj40_SetDataReceived(byteArray);
    }

    if(@CAN_PrivMain::RFR_Object::RXX_Object_Obj41.Read == 1)
    {
        CRadarFR_RXX_Object_Obj41_SetDataReceived(byteArray);
    }

    if(@CAN_PrivMain::RFR_Object::RXX_Object_Obj42.Read == 1)
    {
        CRadarFR_RXX_Object_Obj42_SetDataReceived(byteArray);
    }

    if(@CAN_PrivMain::RFR_Object::RXX_Object_Obj43.Read == 1)
    {
        CRadarFR_RXX_Object_Obj43_SetDataReceived(byteArray);
    }

    if(@CAN_PrivMain::RFR_Object::RXX_Object_Obj44.Read == 1)
    {
        CRadarFR_RXX_Object_Obj44_SetDataReceived(byteArray);
    }

    if(@CAN_PrivMain::RFR_Object::RXX_Object_Obj45.Read == 1)
    {
        CRadarFR_RXX_Object_Obj45_SetDataReceived(byteArray);
    }

    if(@CAN_PrivMain::RFR_Object::RXX_Object_Obj46.Read == 1)
    {
        CRadarFR_RXX_Object_Obj46_SetDataReceived(byteArray);
    }

    if(@CAN_PrivMain::RFR_Object::RXX_Object_Obj47.Read == 1)
    {
        CRadarFR_RXX_Object_Obj47_SetDataReceived(byteArray);
    }

    if(@CAN_PrivMain::RFR_Object::RXX_Object_Obj48.Read == 1)
    {
        CRadarFR_RXX_Object_Obj48_SetDataReceived(byteArray);
    }

    if(@CAN_PrivMain::RFR_Object::RXX_Object_Obj49.Read == 1)
    {
        CRadarFR_RXX_Object_Obj49_SetDataReceived(byteArray);
    }

    if(@CAN_PrivMain::RFR_Object::RXX_Object_Obj5.Read == 1)
    {
        CRadarFR_RXX_Object_Obj5_SetDataReceived(byteArray);
    }

    if(@CAN_PrivMain::RFR_Object::RXX_Object_Obj6.Read == 1)
    {
        CRadarFR_RXX_Object_Obj6_SetDataReceived(byteArray);
    }

    if(@CAN_PrivMain::RFR_Object::RXX_Object_Obj7.Read == 1)
    {
        CRadarFR_RXX_Object_Obj7_SetDataReceived(byteArray);
    }

    if(@CAN_PrivMain::RFR_Object::RXX_Object_Obj8.Read == 1)
    {
        CRadarFR_RXX_Object_Obj8_SetDataReceived(byteArray);
    }

    if(@CAN_PrivMain::RFR_Object::RXX_Object_Obj9.Read == 1)
    {
        CRadarFR_RXX_Object_Obj9_SetDataReceived(byteArray);
    }
}

on sysvar_update CAN_PrivMain_RFR_Object::Read_No_signals
{
  for (i=1;i<=@this;i++) //enable signal read;
   {
   }
  for (i=@this;i<=500;i++) //disable signal read;
   {
   }
}