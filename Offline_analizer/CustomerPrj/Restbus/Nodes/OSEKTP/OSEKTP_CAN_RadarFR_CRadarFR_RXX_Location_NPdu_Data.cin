/*@!Encoding:1252*/
// Autogenerated by -> Platform\Classe\Scripts\Rbs_Scripts\create_OsekTp.py

includes
{
}

variables
{
  const     kBufferSizeJumbo_CRadarFR_RXX_Location_NPdu_Data = 12140;  // Jumbo frames
  const int kDuration_RxLEDOn_ms_CRadarFR_RXX_Location_NPdu_Data = 2000;
  const int kDuration_TxLEDOn_ms_CRadarFR_RXX_Location_NPdu_Data = 2000;
  const int kDuration_ErrLEDOn_ms_CRadarFR_RXX_Location_NPdu_Data = 4000;
  const int kDuration_RxLEDFlashOff_ms_CRadarFR_RXX_Location_NPdu_Data = 30000;
  const int kDuration_TxLEDFlashOff_ms_CRadarFR_RXX_Location_NPdu_Data = 30000;
  const int kDuration_LEDFlash_ms_CRadarFR_RXX_Location_NPdu_Data = 400;
  const int kId_CRadarFR_RXX_Location_NPdu_Data = 1;
  BYTE gbCANFDactive_CRadarFR_RXX_Location_NPdu_Data = 0;
  long gHandle_CRadarFR_RXX_Location_NPdu_Data;
  long gECUAddress_CRadarFR_RXX_Location_NPdu_Data;
  long gTargetAddress_CRadarFR_RXX_Location_NPdu_Data;
  long gTxIdentifier_CRadarFR_RXX_Location_NPdu_Data;
  long gRxIdentifier_CRadarFR_RXX_Location_NPdu_Data;
}

OnStart_callTx_CRadarFR_RXX_Location_NPdu_Data()
{ 
   // long dbHandle; 
   // dbHandle = CanTpGetDBConnection();
   // if (dbHandle > 0) 
   // { 
      // CanTpCloseConnection(dbHandle); 
   // }

   setwriteDbgLevel(@sysvar::sysDbgLevel); 
   CanTpSetVerbosity(@sysvar::sysTPVerboseLevel);
   { 
      // Check if CAN FD is active for this bus 
      CANSettings arbitration; 
      CANSettings data;      
      canFdGetConfiguration( 1, arbitration, data); 
      gbCANFDactive_CRadarFR_RXX_Location_NPdu_Data = ((arbitration.flags & 0x100) != 0 ? 1 : 0);
   }
   if( 0 == gbCANFDactive_CRadarFR_RXX_Location_NPdu_Data) 
      // Disable CAN FD controls when CAN FD is not active
   {
      enableControl( "GeneralConnectionSettings", "cboGeneral_CANFDFrameLen", 0); 
      enableControl( "GeneralConnectionSettings", "chkGeneral_CANFDBRS", 0);
      enableControl( "Settings_CRadarFR_RXX_Location_NPdu_Data", "cboCANFD_CRadarFR_RXX_Location_NPdu_Data", 0); 
      enableControl( "Settings_CRadarFR_RXX_Location_NPdu_Data", "chkCANFDBRS_CRadarFR_RXX_Location_NPdu_Data", 0);
 
   }

   Init_CRadarFR_RXX_Location_NPdu_Data();
}

Init_CRadarFR_RXX_Location_NPdu_Data()
{
   long connHandle; 
   long addressingMode; 
   long extIdFlag; 
   extIdFlag = 0; 
   if (gHandle_CRadarFR_RXX_Location_NPdu_Data > 0)
   {
      CanTpCloseConnection(gHandle_CRadarFR_RXX_Location_NPdu_Data);
   }
   gHandle_CRadarFR_RXX_Location_NPdu_Data = CanTpCreateConnection(@sysvar::CAN_RadarFR::CRadarFR::RXX_Location_NPdu_Data::GeneralSettings::sysAddrMode);
   connHandle = gHandle_CRadarFR_RXX_Location_NPdu_Data;
 
   /* Addressing */ 
   addressingMode = CanTpGetAddressingMode(connHandle);
   switch (addressingMode) {
      case kNormal:        writeDbgLevel(1,"%s, connection %d: Addressing mode = Normal", "CAN_RadarFR", kId_CRadarFR_RXX_Location_NPdu_Data); break;
      case kExtendedBased: writeDbgLevel(1,"%s, connection %d: Addressing mode = Extended (based)", "CAN_RadarFR", kId_CRadarFR_RXX_Location_NPdu_Data); break;
      case kNormalFixed:   writeDbgLevel(1,"%s, connection %d: Addressing mode = NormalFixed", "CAN_RadarFR", kId_CRadarFR_RXX_Location_NPdu_Data); break;
      case kMixed:         writeDbgLevel(1,"%s, connection %d: Addressing mode = Mixed", "CAN_RadarFR", kId_CRadarFR_RXX_Location_NPdu_Data); break;
      case kMixed11Bit:    writeDbgLevel(1,"%s, connection %d: Addressing mode = Mixed (11 bit)", "CAN_RadarFR", kId_CRadarFR_RXX_Location_NPdu_Data); break;
      case kExtendedFree:  writeDbgLevel(1,"%s, connection %d: Addressing mode = Extended (free)", "CAN_RadarFR", kId_CRadarFR_RXX_Location_NPdu_Data); break;
   } 
   if (addressingMode == kMixed || addressingMode == kMixed11Bit) 
   {
      CanTpSetAddressExtension(connHandle, @sysvar::CAN_RadarFR::CRadarFR::RXX_Location_NPdu_Data::GeneralSettings::sysAddrExtension);
   }
   if (addressingMode == kExtendedBased) 
   {
      CanTpSetBaseIdentifier(connHandle, @sysvar::CAN_RadarFR::CRadarFR::RXX_Location_NPdu_Data::GeneralSettings::sysBaseAddress);
   }
   if (addressingMode == kExtendedBased || 
      addressingMode == kExtendedFree || 
      addressingMode == kNormalFixed || 
      addressingMode == kMixed) 
   {
      CanTpSetEcuAddress(connHandle, @sysvar::CAN_RadarFR::CRadarFR::RXX_Location_NPdu_Data::GeneralSettings::sysECUAddress);
      CanTpSetTargetAddress(connHandle, @sysvar::CAN_RadarFR::CRadarFR::RXX_Location_NPdu_Data::GeneralSettings::sysTargetAddress);
      writeDbgLevel(1,"%s, connection %d: ECU address = 0x%02x", "CAN_RadarFR", kId_CRadarFR_RXX_Location_NPdu_Data, CanTpGetEcuAddress(connHandle));
      writeDbgLevel(1,"%s, connection %d: Target address = 0x%x", "CAN_RadarFR", kId_CRadarFR_RXX_Location_NPdu_Data, CanTpGetTargetAddress(connHandle));
 
   } 
   if (addressingMode == kNormal || 
      addressingMode == kExtendedFree || 
      addressingMode == kMixed11Bit) 
   {
      if (@sysvar::CAN_RadarFR::CRadarFR::RXX_Location_NPdu_Data::GeneralSettings::sysUseExtId)
      { 
         extIdFlag = 0x80000000; 
      }
      CanTpSetRxIdentifier(connHandle, extIdFlag | @sysvar::CAN_RadarFR::CRadarFR::RXX_Location_NPdu_Data::GeneralSettings::sysRxIdentifier);
      CanTpSetTxIdentifier(connHandle, extIdFlag | @sysvar::CAN_RadarFR::CRadarFR::RXX_Location_NPdu_Data::GeneralSettings::sysTxIdentifier);
      writeDbgLevel(1, "%s, connection %d: Rx Id = 0x%x", "CAN_RadarFR", kId_CRadarFR_RXX_Location_NPdu_Data, CanTpGetRxIdentifier(connHandle));
      writeDbgLevel(1, "%s, connection %d: Tx Id = 0x%x", "CAN_RadarFR", kId_CRadarFR_RXX_Location_NPdu_Data, CanTpGetTxIdentifier(connHandle));
   }
   gECUAddress_CRadarFR_RXX_Location_NPdu_Data = @sysvar::CAN_RadarFR::CRadarFR::RXX_Location_NPdu_Data::GeneralSettings::sysECUAddress;
   gTargetAddress_CRadarFR_RXX_Location_NPdu_Data = @sysvar::CAN_RadarFR::CRadarFR::RXX_Location_NPdu_Data::GeneralSettings::sysTargetAddress;
   gTxIdentifier_CRadarFR_RXX_Location_NPdu_Data = @sysvar::CAN_RadarFR::CRadarFR::RXX_Location_NPdu_Data::GeneralSettings::sysTxIdentifier;
   gRxIdentifier_CRadarFR_RXX_Location_NPdu_Data = @sysvar::CAN_RadarFR::CRadarFR::RXX_Location_NPdu_Data::GeneralSettings::sysRxIdentifier;
   writeDbgLevel(1,"%s, connection %d: Base address = 0x%x", "CAN_RadarFR", kId_CRadarFR_RXX_Location_NPdu_Data, CanTpGetBaseIdentifier(connHandle));
   writeDbgLevel(1,"%s, connection %d: Address extension = %d", "CAN_RadarFR", kId_CRadarFR_RXX_Location_NPdu_Data, CanTpGetAddressExtension(connHandle));
   writeDbgLevel(1,"%s, connection %d: Use extended IDs = %d","RXX_Location_NPdu_Data", kId_CRadarFR_RXX_Location_NPdu_Data, @sysvar::CAN_RadarFR::CRadarFR::RXX_Location_NPdu_Data::GeneralSettings::sysUseExtId);
   CanTpUseFlowControlFrames(connHandle, @sysvar::CAN_RadarFR::CRadarFR::RXX_Location_NPdu_Data::GeneralSettings::sysUseFC);
 
   /*  Other settings */
   CanTpSetPadding(connHandle, @sysvar::CAN_RadarFR::CRadarFR::RXX_Location_NPdu_Data::GeneralSettings::sysPaddingValue);
   writeDbgLevel(1,"%s, connection %d: Padding value = %d", "CAN_RadarFR", kId_CRadarFR_RXX_Location_NPdu_Data, CanTpGetPadding(connHandle));
   CanTpSetMaximumReceiveLength(connHandle,@sysvar::CAN_RadarFR::CRadarFR::RXX_Location_NPdu_Data::GeneralSettings::sysMaxReceiveLength);
   writeDbgLevel(1,"%s, connection %d: Max. receiver length = %d", "CAN_RadarFR", kId_CRadarFR_RXX_Location_NPdu_Data, CanTpGetMaximumReceiveLength(connHandle));
 
   /* CAN FD */
   if( 1 == gbCANFDactive_CRadarFR_RXX_Location_NPdu_Data)
   {
      CanTpSetMaxCANFDFrameLength( connHandle, @sysvar::CAN_RadarFR::CRadarFR::RXX_Location_NPdu_Data::GeneralSettings::sysMaxFDFrameLen);
      writeDbgLevel(1,"%s, connection %d: Max. CAN FD frame length = %d", "CAN_RadarFR", kId_CRadarFR_RXX_Location_NPdu_Data, @sysvar::CAN_RadarFR::CRadarFR::RXX_Location_NPdu_Data::GeneralSettings::sysMaxFDFrameLen);
      CanTpSetBitRateSwitch( connHandle, @sysvar::CAN_RadarFR::CRadarFR::RXX_Location_NPdu_Data::GeneralSettings::sysBitRateSwitch);
      writeDbgLevel(1,"%s, connection %d: Bit rate switch = %d", "CAN_RadarFR", kId_CRadarFR_RXX_Location_NPdu_Data, @sysvar::CAN_RadarFR::CRadarFR::RXX_Location_NPdu_Data::GeneralSettings::sysBitRateSwitch);
   }
   CanTpWriteConnectionSettings(connHandle);
}