/*@!Encoding:1252*/
// Autogenerated by -> Platform\Classe\Scripts\Rbs_Scripts\create_OsekTp.py

includes
{
}

variables
{
  const     kBufferSizeJumbo_CRadarRL_RRL_RoadSideBoundaries_TpData = 1000;  // Jumbo frames
  const int kDuration_RxLEDOn_ms_CRadarRL_RRL_RoadSideBoundaries_TpData = 2000;
  const int kDuration_TxLEDOn_ms_CRadarRL_RRL_RoadSideBoundaries_TpData = 2000;
  const int kDuration_ErrLEDOn_ms_CRadarRL_RRL_RoadSideBoundaries_TpData = 4000;
  const int kDuration_RxLEDFlashOff_ms_CRadarRL_RRL_RoadSideBoundaries_TpData = 30000;
  const int kDuration_TxLEDFlashOff_ms_CRadarRL_RRL_RoadSideBoundaries_TpData = 30000;
  const int kDuration_LEDFlash_ms_CRadarRL_RRL_RoadSideBoundaries_TpData = 400;
  const int kId_CRadarRL_RRL_RoadSideBoundaries_TpData = 1;
  BYTE gbCANFDactive_CRadarRL_RRL_RoadSideBoundaries_TpData = 0;
  long gHandle_CRadarRL_RRL_RoadSideBoundaries_TpData;
  long gECUAddress_CRadarRL_RRL_RoadSideBoundaries_TpData;
  long gTargetAddress_CRadarRL_RRL_RoadSideBoundaries_TpData;
  long gTxIdentifier_CRadarRL_RRL_RoadSideBoundaries_TpData;
  long gRxIdentifier_CRadarRL_RRL_RoadSideBoundaries_TpData;
}

OnStart_callTx_CRadarRL_RRL_RoadSideBoundaries_TpData()
{ 
   // long dbHandle; 
   // dbHandle = CanTpGetDBConnection();
   // if (dbHandle > 0) 
   // { 
      // CanTpCloseConnection(dbHandle); 
   // }

   setwriteDbgLevel(@sysvar::sysDbgLevel); 
   CanTpSetVerbosity(@sysvar::sysTPVerboseLevel);
   { 
      // Check if CAN FD is active for this bus 
      CANSettings arbitration; 
      CANSettings data;      
      canFdGetConfiguration( 1, arbitration, data); 
      gbCANFDactive_CRadarRL_RRL_RoadSideBoundaries_TpData = ((arbitration.flags & 0x100) != 0 ? 1 : 0);
   }
   if( 0 == gbCANFDactive_CRadarRL_RRL_RoadSideBoundaries_TpData) 
      // Disable CAN FD controls when CAN FD is not active
   {
      enableControl( "GeneralConnectionSettings", "cboGeneral_CANFDFrameLen", 0); 
      enableControl( "GeneralConnectionSettings", "chkGeneral_CANFDBRS", 0);
      enableControl( "Settings_CRadarRL_RRL_RoadSideBoundaries_TpData", "cboCANFD_CRadarRL_RRL_RoadSideBoundaries_TpData", 0); 
      enableControl( "Settings_CRadarRL_RRL_RoadSideBoundaries_TpData", "chkCANFDBRS_CRadarRL_RRL_RoadSideBoundaries_TpData", 0);
 
   }

   Init_CRadarRL_RRL_RoadSideBoundaries_TpData();
}

Init_CRadarRL_RRL_RoadSideBoundaries_TpData()
{
   long connHandle; 
   long addressingMode; 
   long extIdFlag; 
   extIdFlag = 0; 
   if (gHandle_CRadarRL_RRL_RoadSideBoundaries_TpData > 0)
   {
      CanTpCloseConnection(gHandle_CRadarRL_RRL_RoadSideBoundaries_TpData);
   }
   gHandle_CRadarRL_RRL_RoadSideBoundaries_TpData = CanTpCreateConnection(@sysvar::CAN_RadarRL::CRadarRL::RRL_RoadSideBoundaries_TpData::GeneralSettings::sysAddrMode);
   connHandle = gHandle_CRadarRL_RRL_RoadSideBoundaries_TpData;
 
   /* Addressing */ 
   addressingMode = CanTpGetAddressingMode(connHandle);
   switch (addressingMode) {
      case kNormal:        write("%s, connection %d: Addressing mode = Normal", "CAN_RadarRL", kId_CRadarRL_RRL_RoadSideBoundaries_TpData); break;
      case kExtendedBased: write("%s, connection %d: Addressing mode = Extended (based)", "CAN_RadarRL", kId_CRadarRL_RRL_RoadSideBoundaries_TpData); break;
      case kNormalFixed:   write("%s, connection %d: Addressing mode = NormalFixed", "CAN_RadarRL", kId_CRadarRL_RRL_RoadSideBoundaries_TpData); break;
      case kMixed:         write("%s, connection %d: Addressing mode = Mixed", "CAN_RadarRL", kId_CRadarRL_RRL_RoadSideBoundaries_TpData); break;
      case kMixed11Bit:    write("%s, connection %d: Addressing mode = Mixed (11 bit)", "CAN_RadarRL", kId_CRadarRL_RRL_RoadSideBoundaries_TpData); break;
      case kExtendedFree:  write("%s, connection %d: Addressing mode = Extended (free)", "CAN_RadarRL", kId_CRadarRL_RRL_RoadSideBoundaries_TpData); break;
   } 
   if (addressingMode == kMixed || addressingMode == kMixed11Bit) 
   {
      CanTpSetAddressExtension(connHandle, @sysvar::CAN_RadarRL::CRadarRL::RRL_RoadSideBoundaries_TpData::GeneralSettings::sysAddrExtension);
   }
   if (addressingMode == kExtendedBased) 
   {
      CanTpSetBaseIdentifier(connHandle, @sysvar::CAN_RadarRL::CRadarRL::RRL_RoadSideBoundaries_TpData::GeneralSettings::sysBaseAddress);
   }
   if (addressingMode == kExtendedBased || 
      addressingMode == kExtendedFree || 
      addressingMode == kNormalFixed || 
      addressingMode == kMixed) 
   {
      CanTpSetEcuAddress(connHandle, @sysvar::CAN_RadarRL::CRadarRL::RRL_RoadSideBoundaries_TpData::GeneralSettings::sysECUAddress);
      CanTpSetTargetAddress(connHandle, @sysvar::CAN_RadarRL::CRadarRL::RRL_RoadSideBoundaries_TpData::GeneralSettings::sysTargetAddress);
      write("%s, connection %d: ECU address = 0x%02x", "CAN_RadarRL", kId_CRadarRL_RRL_RoadSideBoundaries_TpData, CanTpGetEcuAddress(connHandle));
      write("%s, connection %d: Target address = 0x%x", "CAN_RadarRL", kId_CRadarRL_RRL_RoadSideBoundaries_TpData, CanTpGetTargetAddress(connHandle));
 
   } 
   if (addressingMode == kNormal || 
      addressingMode == kExtendedFree || 
      addressingMode == kMixed11Bit) 
   {
      if (@sysvar::CAN_RadarRL::CRadarRL::RRL_RoadSideBoundaries_TpData::GeneralSettings::sysUseExtId)
      { 
         extIdFlag = 0x80000000; 
      }
      CanTpSetRxIdentifier(connHandle, extIdFlag | @sysvar::CAN_RadarRL::CRadarRL::RRL_RoadSideBoundaries_TpData::GeneralSettings::sysRxIdentifier);
      CanTpSetTxIdentifier(connHandle, extIdFlag | @sysvar::CAN_RadarRL::CRadarRL::RRL_RoadSideBoundaries_TpData::GeneralSettings::sysTxIdentifier);
      write( "%s, connection %d: Rx Id = 0x%x", "CAN_RadarRL", kId_CRadarRL_RRL_RoadSideBoundaries_TpData, CanTpGetRxIdentifier(connHandle));
      write( "%s, connection %d: Tx Id = 0x%x", "CAN_RadarRL", kId_CRadarRL_RRL_RoadSideBoundaries_TpData, CanTpGetTxIdentifier(connHandle));
   }
   gECUAddress_CRadarRL_RRL_RoadSideBoundaries_TpData = @sysvar::CAN_RadarRL::CRadarRL::RRL_RoadSideBoundaries_TpData::GeneralSettings::sysECUAddress;
   gTargetAddress_CRadarRL_RRL_RoadSideBoundaries_TpData = @sysvar::CAN_RadarRL::CRadarRL::RRL_RoadSideBoundaries_TpData::GeneralSettings::sysTargetAddress;
   gTxIdentifier_CRadarRL_RRL_RoadSideBoundaries_TpData = @sysvar::CAN_RadarRL::CRadarRL::RRL_RoadSideBoundaries_TpData::GeneralSettings::sysTxIdentifier;
   gRxIdentifier_CRadarRL_RRL_RoadSideBoundaries_TpData = @sysvar::CAN_RadarRL::CRadarRL::RRL_RoadSideBoundaries_TpData::GeneralSettings::sysRxIdentifier;
   write("%s, connection %d: Base address = 0x%x", "CAN_RadarRL", kId_CRadarRL_RRL_RoadSideBoundaries_TpData, CanTpGetBaseIdentifier(connHandle));
   write("%s, connection %d: Address extension = %d", "CAN_RadarRL", kId_CRadarRL_RRL_RoadSideBoundaries_TpData, CanTpGetAddressExtension(connHandle));
   write("%s, connection %d: Use extended IDs = %d","RRL_RoadSideBoundaries_TpData", kId_CRadarRL_RRL_RoadSideBoundaries_TpData, @sysvar::CAN_RadarRL::CRadarRL::RRL_RoadSideBoundaries_TpData::GeneralSettings::sysUseExtId);
   CanTpUseFlowControlFrames(connHandle, @sysvar::CAN_RadarRL::CRadarRL::RRL_RoadSideBoundaries_TpData::GeneralSettings::sysUseFC);
 
   /*  Other settings */
   CanTpSetPadding(connHandle, @sysvar::CAN_RadarRL::CRadarRL::RRL_RoadSideBoundaries_TpData::GeneralSettings::sysPaddingValue);
   write("%s, connection %d: Padding value = %d", "CAN_RadarRL", kId_CRadarRL_RRL_RoadSideBoundaries_TpData, CanTpGetPadding(connHandle));
   CanTpSetMaximumReceiveLength(connHandle,@sysvar::CAN_RadarRL::CRadarRL::RRL_RoadSideBoundaries_TpData::GeneralSettings::sysMaxReceiveLength);
   write("%s, connection %d: Max. receiver length = %d", "CAN_RadarRL", kId_CRadarRL_RRL_RoadSideBoundaries_TpData, CanTpGetMaximumReceiveLength(connHandle));
 
   /* CAN FD */
   if( 1 == gbCANFDactive_CRadarRL_RRL_RoadSideBoundaries_TpData)
   {
      CanTpSetMaxCANFDFrameLength( connHandle, @sysvar::CAN_RadarRL::CRadarRL::RRL_RoadSideBoundaries_TpData::GeneralSettings::sysMaxFDFrameLen);
      write("%s, connection %d: Max. CAN FD frame length = %d", "CAN_RadarRL", kId_CRadarRL_RRL_RoadSideBoundaries_TpData, @sysvar::CAN_RadarRL::CRadarRL::RRL_RoadSideBoundaries_TpData::GeneralSettings::sysMaxFDFrameLen);
      CanTpSetBitRateSwitch( connHandle, @sysvar::CAN_RadarRL::CRadarRL::RRL_RoadSideBoundaries_TpData::GeneralSettings::sysBitRateSwitch);
      write("%s, connection %d: Bit rate switch = %d", "CAN_RadarRL", kId_CRadarRL_RRL_RoadSideBoundaries_TpData, @sysvar::CAN_RadarRL::CRadarRL::RRL_RoadSideBoundaries_TpData::GeneralSettings::sysBitRateSwitch);
   }
   CanTpWriteConnectionSettings(connHandle);
}