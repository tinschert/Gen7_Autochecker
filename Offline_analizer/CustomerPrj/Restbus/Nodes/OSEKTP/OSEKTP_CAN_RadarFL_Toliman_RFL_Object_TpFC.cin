/*@!Encoding:1252*/
// Autogenerated by -> Platform\Classe\Scripts\Rbs_Scripts\create_OsekTp.py

includes
{
}

variables
{
  const     kBufferSizeJumbo_Toliman_RFL_Object_TpFC = 3216;  // Jumbo frames
  const int kDuration_RxLEDOn_ms_Toliman_RFL_Object_TpFC = 2000;
  const int kDuration_TxLEDOn_ms_Toliman_RFL_Object_TpFC = 2000;
  const int kDuration_ErrLEDOn_ms_Toliman_RFL_Object_TpFC = 4000;
  const int kDuration_RxLEDFlashOff_ms_Toliman_RFL_Object_TpFC = 30000;
  const int kDuration_TxLEDFlashOff_ms_Toliman_RFL_Object_TpFC = 30000;
  const int kDuration_LEDFlash_ms_Toliman_RFL_Object_TpFC = 400;
  const int kId_Toliman_RFL_Object_TpFC = 1;
  BYTE gbCANFDactive_Toliman_RFL_Object_TpFC = 0;
  long gHandle_Toliman_RFL_Object_TpFC;
  long gECUAddress_Toliman_RFL_Object_TpFC;
  long gTargetAddress_Toliman_RFL_Object_TpFC;
  long gTxIdentifier_Toliman_RFL_Object_TpFC;
  long gRxIdentifier_Toliman_RFL_Object_TpFC;
}

OnStart_callTx_Toliman_RFL_Object_TpFC()
{ 
   // long dbHandle; 
   // dbHandle = CanTpGetDBConnection();
   // if (dbHandle > 0) 
   // { 
      // CanTpCloseConnection(dbHandle); 
   // }

   setwriteDbgLevel(@sysvar::sysDbgLevel); 
   CanTpSetVerbosity(@sysvar::sysTPVerboseLevel);
   { 
      // Check if CAN FD is active for this bus 
      CANSettings arbitration; 
      CANSettings data;      
      canFdGetConfiguration( 1, arbitration, data); 
      gbCANFDactive_Toliman_RFL_Object_TpFC = ((arbitration.flags & 0x100) != 0 ? 1 : 0);
   }
   if( 0 == gbCANFDactive_Toliman_RFL_Object_TpFC) 
      // Disable CAN FD controls when CAN FD is not active
   {
      enableControl( "GeneralConnectionSettings", "cboGeneral_CANFDFrameLen", 0); 
      enableControl( "GeneralConnectionSettings", "chkGeneral_CANFDBRS", 0);
      enableControl( "Settings_Toliman_RFL_Object_TpFC", "cboCANFD_Toliman_RFL_Object_TpFC", 0); 
      enableControl( "Settings_Toliman_RFL_Object_TpFC", "chkCANFDBRS_Toliman_RFL_Object_TpFC", 0);
 
   }

   Init_Toliman_RFL_Object_TpFC();
}

Init_Toliman_RFL_Object_TpFC()
{
   long connHandle; 
   long addressingMode; 
   long extIdFlag; 
   extIdFlag = 0; 
   if (gHandle_Toliman_RFL_Object_TpFC > 0)
   {
      CanTpCloseConnection(gHandle_Toliman_RFL_Object_TpFC);
   }
   gHandle_Toliman_RFL_Object_TpFC = CanTpCreateConnection(@sysvar::CAN_RadarFL::Toliman::RFL_Object_TpFC::GeneralSettings::sysAddrMode);
   connHandle = gHandle_Toliman_RFL_Object_TpFC;
 
   /* Addressing */ 
   addressingMode = CanTpGetAddressingMode(connHandle);
   switch (addressingMode) {
      case kNormal:        write("%s, connection %d: Addressing mode = Normal", "CAN_RadarFL", kId_Toliman_RFL_Object_TpFC); break;
      case kExtendedBased: write("%s, connection %d: Addressing mode = Extended (based)", "CAN_RadarFL", kId_Toliman_RFL_Object_TpFC); break;
      case kNormalFixed:   write("%s, connection %d: Addressing mode = NormalFixed", "CAN_RadarFL", kId_Toliman_RFL_Object_TpFC); break;
      case kMixed:         write("%s, connection %d: Addressing mode = Mixed", "CAN_RadarFL", kId_Toliman_RFL_Object_TpFC); break;
      case kMixed11Bit:    write("%s, connection %d: Addressing mode = Mixed (11 bit)", "CAN_RadarFL", kId_Toliman_RFL_Object_TpFC); break;
      case kExtendedFree:  write("%s, connection %d: Addressing mode = Extended (free)", "CAN_RadarFL", kId_Toliman_RFL_Object_TpFC); break;
   } 
   if (addressingMode == kMixed || addressingMode == kMixed11Bit) 
   {
      CanTpSetAddressExtension(connHandle, @sysvar::CAN_RadarFL::Toliman::RFL_Object_TpFC::GeneralSettings::sysAddrExtension);
   }
   if (addressingMode == kExtendedBased) 
   {
      CanTpSetBaseIdentifier(connHandle, @sysvar::CAN_RadarFL::Toliman::RFL_Object_TpFC::GeneralSettings::sysBaseAddress);
   }
   if (addressingMode == kExtendedBased || 
      addressingMode == kExtendedFree || 
      addressingMode == kNormalFixed || 
      addressingMode == kMixed) 
   {
      CanTpSetEcuAddress(connHandle, @sysvar::CAN_RadarFL::Toliman::RFL_Object_TpFC::GeneralSettings::sysECUAddress);
      CanTpSetTargetAddress(connHandle, @sysvar::CAN_RadarFL::Toliman::RFL_Object_TpFC::GeneralSettings::sysTargetAddress);
      write("%s, connection %d: ECU address = 0x%02x", "CAN_RadarFL", kId_Toliman_RFL_Object_TpFC, CanTpGetEcuAddress(connHandle));
      write("%s, connection %d: Target address = 0x%x", "CAN_RadarFL", kId_Toliman_RFL_Object_TpFC, CanTpGetTargetAddress(connHandle));
 
   } 
   if (addressingMode == kNormal || 
      addressingMode == kExtendedFree || 
      addressingMode == kMixed11Bit) 
   {
      if (@sysvar::CAN_RadarFL::Toliman::RFL_Object_TpFC::GeneralSettings::sysUseExtId)
      { 
         extIdFlag = 0x80000000; 
      }
      CanTpSetRxIdentifier(connHandle, extIdFlag | @sysvar::CAN_RadarFL::Toliman::RFL_Object_TpFC::GeneralSettings::sysRxIdentifier);
      CanTpSetTxIdentifier(connHandle, extIdFlag | @sysvar::CAN_RadarFL::Toliman::RFL_Object_TpFC::GeneralSettings::sysTxIdentifier);
      write( "%s, connection %d: Rx Id = 0x%x", "CAN_RadarFL", kId_Toliman_RFL_Object_TpFC, CanTpGetRxIdentifier(connHandle));
      write( "%s, connection %d: Tx Id = 0x%x", "CAN_RadarFL", kId_Toliman_RFL_Object_TpFC, CanTpGetTxIdentifier(connHandle));
   }
   gECUAddress_Toliman_RFL_Object_TpFC = @sysvar::CAN_RadarFL::Toliman::RFL_Object_TpFC::GeneralSettings::sysECUAddress;
   gTargetAddress_Toliman_RFL_Object_TpFC = @sysvar::CAN_RadarFL::Toliman::RFL_Object_TpFC::GeneralSettings::sysTargetAddress;
   gTxIdentifier_Toliman_RFL_Object_TpFC = @sysvar::CAN_RadarFL::Toliman::RFL_Object_TpFC::GeneralSettings::sysTxIdentifier;
   gRxIdentifier_Toliman_RFL_Object_TpFC = @sysvar::CAN_RadarFL::Toliman::RFL_Object_TpFC::GeneralSettings::sysRxIdentifier;
   write("%s, connection %d: Base address = 0x%x", "CAN_RadarFL", kId_Toliman_RFL_Object_TpFC, CanTpGetBaseIdentifier(connHandle));
   write("%s, connection %d: Address extension = %d", "CAN_RadarFL", kId_Toliman_RFL_Object_TpFC, CanTpGetAddressExtension(connHandle));
   write("%s, connection %d: Use extended IDs = %d","RFL_Object_TpFC", kId_Toliman_RFL_Object_TpFC, @sysvar::CAN_RadarFL::Toliman::RFL_Object_TpFC::GeneralSettings::sysUseExtId);

   /* Flow Control */
   CanTpUseFlowControlFrames(connHandle, @sysvar::CAN_RadarFL::Toliman::RFL_Object_TpFC::GeneralSettings::sysUseFC);
   write("%s, connection %d: Use flow control = %d", "CAN_RadarFL", kId_Toliman_RFL_Object_TpFC, CanTpIsUseFlowControlFrames(connHandle));
   CanTpSetBlockSize(connHandle, @sysvar::CAN_RadarFL::Toliman::RFL_Object_TpFC::GeneralSettings::sysBlockSize);
   write("%s, connection %d: Block size = %d", "CAN_RadarFL", kId_Toliman_RFL_Object_TpFC, CanTpGetBlockSize(connHandle));
   CanTpSetSTmin(connHandle, @sysvar::CAN_RadarFL::Toliman::RFL_Object_TpFC::GeneralSettings::sysSTmin);
   write("%s, connection %d: ST min = %d", "CAN_RadarFL", kId_Toliman_RFL_Object_TpFC, CanTpGetSTmin(connHandle));
   CanTpSetFlowControlDelay(connHandle, @sysvar::CAN_RadarFL::Toliman::RFL_Object_TpFC::GeneralSettings::sysFlowControlDelay);
   write("%s, connection %d: Flow control delay = %d ms", "CAN_RadarFL", kId_Toliman_RFL_Object_TpFC, @sysvar::CAN_RadarFL::Toliman::RFL_Object_TpFC::GeneralSettings::sysFlowControlDelay);
   CanTpUseFlowControlBlockSize(connHandle, @sysvar::CAN_RadarFL::Toliman::RFL_Object_TpFC::GeneralSettings::sysUseFCBlockSize);
   write("%s, connection %d: Use FC block size = %d", "CAN_RadarFL", kId_Toliman_RFL_Object_TpFC, CanTpIsUseFlowControlBlockSize(connHandle));
 
   /*  Other settings */
   CanTpSetPadding(connHandle, @sysvar::CAN_RadarFL::Toliman::RFL_Object_TpFC::GeneralSettings::sysPaddingValue);
   write("%s, connection %d: Padding value = %d", "CAN_RadarFL", kId_Toliman_RFL_Object_TpFC, CanTpGetPadding(connHandle));
   CanTpSetMaximumReceiveLength(connHandle,@sysvar::CAN_RadarFL::Toliman::RFL_Object_TpFC::GeneralSettings::sysMaxReceiveLength);
   write("%s, connection %d: Max. receiver length = %d", "CAN_RadarFL", kId_Toliman_RFL_Object_TpFC, CanTpGetMaximumReceiveLength(connHandle));
 
   /* CAN FD */
   if( 1 == gbCANFDactive_Toliman_RFL_Object_TpFC)
   {
      CanTpSetMaxCANFDFrameLength( connHandle, @sysvar::CAN_RadarFL::Toliman::RFL_Object_TpFC::GeneralSettings::sysMaxFDFrameLen);
      write("%s, connection %d: Max. CAN FD frame length = %d", "CAN_RadarFL", kId_Toliman_RFL_Object_TpFC, @sysvar::CAN_RadarFL::Toliman::RFL_Object_TpFC::GeneralSettings::sysMaxFDFrameLen);
      CanTpSetBitRateSwitch( connHandle, @sysvar::CAN_RadarFL::Toliman::RFL_Object_TpFC::GeneralSettings::sysBitRateSwitch);
      write("%s, connection %d: Bit rate switch = %d", "CAN_RadarFL", kId_Toliman_RFL_Object_TpFC, @sysvar::CAN_RadarFL::Toliman::RFL_Object_TpFC::GeneralSettings::sysBitRateSwitch);
   }
   CanTpWriteConnectionSettings(connHandle);
}