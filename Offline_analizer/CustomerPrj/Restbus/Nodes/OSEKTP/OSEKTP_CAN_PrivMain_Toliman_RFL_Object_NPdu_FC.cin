/*@!Encoding:1252*/
// Autogenerated by -> Platform\Classe\Scripts\Rbs_Scripts\create_OsekTp.py

includes
{
}

variables
{
  const     kBufferSizeJumbo_Toliman_RFL_Object_NPdu_FC = 3276;  // Jumbo frames
  const int kDuration_RxLEDOn_ms_Toliman_RFL_Object_NPdu_FC = 2000;
  const int kDuration_TxLEDOn_ms_Toliman_RFL_Object_NPdu_FC = 2000;
  const int kDuration_ErrLEDOn_ms_Toliman_RFL_Object_NPdu_FC = 4000;
  const int kDuration_RxLEDFlashOff_ms_Toliman_RFL_Object_NPdu_FC = 30000;
  const int kDuration_TxLEDFlashOff_ms_Toliman_RFL_Object_NPdu_FC = 30000;
  const int kDuration_LEDFlash_ms_Toliman_RFL_Object_NPdu_FC = 400;
  const int kId_Toliman_RFL_Object_NPdu_FC = 1;
  BYTE gbCANFDactive_Toliman_RFL_Object_NPdu_FC = 0;
  long gHandle_Toliman_RFL_Object_NPdu_FC;
  long gECUAddress_Toliman_RFL_Object_NPdu_FC;
  long gTargetAddress_Toliman_RFL_Object_NPdu_FC;
  long gTxIdentifier_Toliman_RFL_Object_NPdu_FC;
  long gRxIdentifier_Toliman_RFL_Object_NPdu_FC;
}

OnStart_callTx_Toliman_RFL_Object_NPdu_FC()
{ 
   // long dbHandle; 
   // dbHandle = CanTpGetDBConnection();
   // if (dbHandle > 0) 
   // { 
      // CanTpCloseConnection(dbHandle); 
   // }

   setwriteDbgLevel(@sysvar::sysDbgLevel); 
   CanTpSetVerbosity(@sysvar::sysTPVerboseLevel);
   { 
      // Check if CAN FD is active for this bus 
      CANSettings arbitration; 
      CANSettings data;      
      canFdGetConfiguration( 1, arbitration, data); 
      gbCANFDactive_Toliman_RFL_Object_NPdu_FC = ((arbitration.flags & 0x100) != 0 ? 1 : 0);
   }
   if( 0 == gbCANFDactive_Toliman_RFL_Object_NPdu_FC) 
      // Disable CAN FD controls when CAN FD is not active
   {
      enableControl( "GeneralConnectionSettings", "cboGeneral_CANFDFrameLen", 0); 
      enableControl( "GeneralConnectionSettings", "chkGeneral_CANFDBRS", 0);
      enableControl( "Settings_Toliman_RFL_Object_NPdu_FC", "cboCANFD_Toliman_RFL_Object_NPdu_FC", 0); 
      enableControl( "Settings_Toliman_RFL_Object_NPdu_FC", "chkCANFDBRS_Toliman_RFL_Object_NPdu_FC", 0);
 
   }

   Init_Toliman_RFL_Object_NPdu_FC();
}

Init_Toliman_RFL_Object_NPdu_FC()
{
   long connHandle; 
   long addressingMode; 
   long extIdFlag; 
   extIdFlag = 0; 
   if (gHandle_Toliman_RFL_Object_NPdu_FC > 0)
   {
      CanTpCloseConnection(gHandle_Toliman_RFL_Object_NPdu_FC);
   }
   gHandle_Toliman_RFL_Object_NPdu_FC = CanTpCreateConnection(@sysvar::CAN_PrivMain::Toliman::RFL_Object_NPdu_FC::GeneralSettings::sysAddrMode);
   connHandle = gHandle_Toliman_RFL_Object_NPdu_FC;
 
   /* Addressing */ 
   addressingMode = CanTpGetAddressingMode(connHandle);
   switch (addressingMode) {
      case kNormal:        write("%s, connection %d: Addressing mode = Normal", "CAN_PrivMain", kId_Toliman_RFL_Object_NPdu_FC); break;
      case kExtendedBased: write("%s, connection %d: Addressing mode = Extended (based)", "CAN_PrivMain", kId_Toliman_RFL_Object_NPdu_FC); break;
      case kNormalFixed:   write("%s, connection %d: Addressing mode = NormalFixed", "CAN_PrivMain", kId_Toliman_RFL_Object_NPdu_FC); break;
      case kMixed:         write("%s, connection %d: Addressing mode = Mixed", "CAN_PrivMain", kId_Toliman_RFL_Object_NPdu_FC); break;
      case kMixed11Bit:    write("%s, connection %d: Addressing mode = Mixed (11 bit)", "CAN_PrivMain", kId_Toliman_RFL_Object_NPdu_FC); break;
      case kExtendedFree:  write("%s, connection %d: Addressing mode = Extended (free)", "CAN_PrivMain", kId_Toliman_RFL_Object_NPdu_FC); break;
   } 
   if (addressingMode == kMixed || addressingMode == kMixed11Bit) 
   {
      CanTpSetAddressExtension(connHandle, @sysvar::CAN_PrivMain::Toliman::RFL_Object_NPdu_FC::GeneralSettings::sysAddrExtension);
   }
   if (addressingMode == kExtendedBased) 
   {
      CanTpSetBaseIdentifier(connHandle, @sysvar::CAN_PrivMain::Toliman::RFL_Object_NPdu_FC::GeneralSettings::sysBaseAddress);
   }
   if (addressingMode == kExtendedBased || 
      addressingMode == kExtendedFree || 
      addressingMode == kNormalFixed || 
      addressingMode == kMixed) 
   {
      CanTpSetEcuAddress(connHandle, @sysvar::CAN_PrivMain::Toliman::RFL_Object_NPdu_FC::GeneralSettings::sysECUAddress);
      CanTpSetTargetAddress(connHandle, @sysvar::CAN_PrivMain::Toliman::RFL_Object_NPdu_FC::GeneralSettings::sysTargetAddress);
      write("%s, connection %d: ECU address = 0x%02x", "CAN_PrivMain", kId_Toliman_RFL_Object_NPdu_FC, CanTpGetEcuAddress(connHandle));
      write("%s, connection %d: Target address = 0x%x", "CAN_PrivMain", kId_Toliman_RFL_Object_NPdu_FC, CanTpGetTargetAddress(connHandle));
 
   } 
   if (addressingMode == kNormal || 
      addressingMode == kExtendedFree || 
      addressingMode == kMixed11Bit) 
   {
      if (@sysvar::CAN_PrivMain::Toliman::RFL_Object_NPdu_FC::GeneralSettings::sysUseExtId)
      { 
         extIdFlag = 0x80000000; 
      }
      CanTpSetRxIdentifier(connHandle, extIdFlag | @sysvar::CAN_PrivMain::Toliman::RFL_Object_NPdu_FC::GeneralSettings::sysRxIdentifier);
      CanTpSetTxIdentifier(connHandle, extIdFlag | @sysvar::CAN_PrivMain::Toliman::RFL_Object_NPdu_FC::GeneralSettings::sysTxIdentifier);
      write( "%s, connection %d: Rx Id = 0x%x", "CAN_PrivMain", kId_Toliman_RFL_Object_NPdu_FC, CanTpGetRxIdentifier(connHandle));
      write( "%s, connection %d: Tx Id = 0x%x", "CAN_PrivMain", kId_Toliman_RFL_Object_NPdu_FC, CanTpGetTxIdentifier(connHandle));
   }
   gECUAddress_Toliman_RFL_Object_NPdu_FC = @sysvar::CAN_PrivMain::Toliman::RFL_Object_NPdu_FC::GeneralSettings::sysECUAddress;
   gTargetAddress_Toliman_RFL_Object_NPdu_FC = @sysvar::CAN_PrivMain::Toliman::RFL_Object_NPdu_FC::GeneralSettings::sysTargetAddress;
   gTxIdentifier_Toliman_RFL_Object_NPdu_FC = @sysvar::CAN_PrivMain::Toliman::RFL_Object_NPdu_FC::GeneralSettings::sysTxIdentifier;
   gRxIdentifier_Toliman_RFL_Object_NPdu_FC = @sysvar::CAN_PrivMain::Toliman::RFL_Object_NPdu_FC::GeneralSettings::sysRxIdentifier;
   write("%s, connection %d: Base address = 0x%x", "CAN_PrivMain", kId_Toliman_RFL_Object_NPdu_FC, CanTpGetBaseIdentifier(connHandle));
   write("%s, connection %d: Address extension = %d", "CAN_PrivMain", kId_Toliman_RFL_Object_NPdu_FC, CanTpGetAddressExtension(connHandle));
   write("%s, connection %d: Use extended IDs = %d","RFL_Object_NPdu_FC", kId_Toliman_RFL_Object_NPdu_FC, @sysvar::CAN_PrivMain::Toliman::RFL_Object_NPdu_FC::GeneralSettings::sysUseExtId);

   /* Flow Control */
   CanTpUseFlowControlFrames(connHandle, @sysvar::CAN_PrivMain::Toliman::RFL_Object_NPdu_FC::GeneralSettings::sysUseFC);
   write("%s, connection %d: Use flow control = %d", "CAN_PrivMain", kId_Toliman_RFL_Object_NPdu_FC, CanTpIsUseFlowControlFrames(connHandle));
   CanTpSetBlockSize(connHandle, @sysvar::CAN_PrivMain::Toliman::RFL_Object_NPdu_FC::GeneralSettings::sysBlockSize);
   write("%s, connection %d: Block size = %d", "CAN_PrivMain", kId_Toliman_RFL_Object_NPdu_FC, CanTpGetBlockSize(connHandle));
   CanTpSetSTmin(connHandle, @sysvar::CAN_PrivMain::Toliman::RFL_Object_NPdu_FC::GeneralSettings::sysSTmin);
   write("%s, connection %d: ST min = %d", "CAN_PrivMain", kId_Toliman_RFL_Object_NPdu_FC, CanTpGetSTmin(connHandle));
   CanTpSetFlowControlDelay(connHandle, @sysvar::CAN_PrivMain::Toliman::RFL_Object_NPdu_FC::GeneralSettings::sysFlowControlDelay);
   write("%s, connection %d: Flow control delay = %d ms", "CAN_PrivMain", kId_Toliman_RFL_Object_NPdu_FC, @sysvar::CAN_PrivMain::Toliman::RFL_Object_NPdu_FC::GeneralSettings::sysFlowControlDelay);
   CanTpUseFlowControlBlockSize(connHandle, @sysvar::CAN_PrivMain::Toliman::RFL_Object_NPdu_FC::GeneralSettings::sysUseFCBlockSize);
   write("%s, connection %d: Use FC block size = %d", "CAN_PrivMain", kId_Toliman_RFL_Object_NPdu_FC, CanTpIsUseFlowControlBlockSize(connHandle));
 
   /*  Other settings */
   CanTpSetPadding(connHandle, @sysvar::CAN_PrivMain::Toliman::RFL_Object_NPdu_FC::GeneralSettings::sysPaddingValue);
   write("%s, connection %d: Padding value = %d", "CAN_PrivMain", kId_Toliman_RFL_Object_NPdu_FC, CanTpGetPadding(connHandle));
   CanTpSetMaximumReceiveLength(connHandle,@sysvar::CAN_PrivMain::Toliman::RFL_Object_NPdu_FC::GeneralSettings::sysMaxReceiveLength);
   write("%s, connection %d: Max. receiver length = %d", "CAN_PrivMain", kId_Toliman_RFL_Object_NPdu_FC, CanTpGetMaximumReceiveLength(connHandle));
 
   /* CAN FD */
   if( 1 == gbCANFDactive_Toliman_RFL_Object_NPdu_FC)
   {
      CanTpSetMaxCANFDFrameLength( connHandle, @sysvar::CAN_PrivMain::Toliman::RFL_Object_NPdu_FC::GeneralSettings::sysMaxFDFrameLen);
      write("%s, connection %d: Max. CAN FD frame length = %d", "CAN_PrivMain", kId_Toliman_RFL_Object_NPdu_FC, @sysvar::CAN_PrivMain::Toliman::RFL_Object_NPdu_FC::GeneralSettings::sysMaxFDFrameLen);
      CanTpSetBitRateSwitch( connHandle, @sysvar::CAN_PrivMain::Toliman::RFL_Object_NPdu_FC::GeneralSettings::sysBitRateSwitch);
      write("%s, connection %d: Bit rate switch = %d", "CAN_PrivMain", kId_Toliman_RFL_Object_NPdu_FC, @sysvar::CAN_PrivMain::Toliman::RFL_Object_NPdu_FC::GeneralSettings::sysBitRateSwitch);
   }
   CanTpWriteConnectionSettings(connHandle);
}