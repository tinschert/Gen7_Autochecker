/*@!Encoding:1252*/
// Autogenerated by -> Platform\Classe\Scripts\Rbs_Scripts\create_OsekTp.py

includes
{
}

variables
{
  const     kBufferSizeJumbo_CRadarFL_RFL_Object_NPdu_Data = 3276;  // Jumbo frames
  const int kDuration_RxLEDOn_ms_CRadarFL_RFL_Object_NPdu_Data = 2000;
  const int kDuration_TxLEDOn_ms_CRadarFL_RFL_Object_NPdu_Data = 2000;
  const int kDuration_ErrLEDOn_ms_CRadarFL_RFL_Object_NPdu_Data = 4000;
  const int kDuration_RxLEDFlashOff_ms_CRadarFL_RFL_Object_NPdu_Data = 30000;
  const int kDuration_TxLEDFlashOff_ms_CRadarFL_RFL_Object_NPdu_Data = 30000;
  const int kDuration_LEDFlash_ms_CRadarFL_RFL_Object_NPdu_Data = 400;
  const int kId_CRadarFL_RFL_Object_NPdu_Data = 1;
  BYTE gbCANFDactive_CRadarFL_RFL_Object_NPdu_Data = 0;
  long gHandle_CRadarFL_RFL_Object_NPdu_Data;
  long gECUAddress_CRadarFL_RFL_Object_NPdu_Data;
  long gTargetAddress_CRadarFL_RFL_Object_NPdu_Data;
  long gTxIdentifier_CRadarFL_RFL_Object_NPdu_Data;
  long gRxIdentifier_CRadarFL_RFL_Object_NPdu_Data;
}

OnStart_callTx_CRadarFL_RFL_Object_NPdu_Data()
{ 
   // long dbHandle; 
   // dbHandle = CanTpGetDBConnection();
   // if (dbHandle > 0) 
   // { 
      // CanTpCloseConnection(dbHandle); 
   // }

   setwriteDbgLevel(@sysvar::sysDbgLevel); 
   CanTpSetVerbosity(@sysvar::sysTPVerboseLevel);
   { 
      // Check if CAN FD is active for this bus 
      CANSettings arbitration; 
      CANSettings data;      
      canFdGetConfiguration( 1, arbitration, data); 
      gbCANFDactive_CRadarFL_RFL_Object_NPdu_Data = ((arbitration.flags & 0x100) != 0 ? 1 : 0);
   }
   if( 0 == gbCANFDactive_CRadarFL_RFL_Object_NPdu_Data) 
      // Disable CAN FD controls when CAN FD is not active
   {
      enableControl( "GeneralConnectionSettings", "cboGeneral_CANFDFrameLen", 0); 
      enableControl( "GeneralConnectionSettings", "chkGeneral_CANFDBRS", 0);
      enableControl( "Settings_CRadarFL_RFL_Object_NPdu_Data", "cboCANFD_CRadarFL_RFL_Object_NPdu_Data", 0); 
      enableControl( "Settings_CRadarFL_RFL_Object_NPdu_Data", "chkCANFDBRS_CRadarFL_RFL_Object_NPdu_Data", 0);
 
   }

   Init_CRadarFL_RFL_Object_NPdu_Data();
}

Init_CRadarFL_RFL_Object_NPdu_Data()
{
   long connHandle; 
   long addressingMode; 
   long extIdFlag; 
   extIdFlag = 0; 
   if (gHandle_CRadarFL_RFL_Object_NPdu_Data > 0)
   {
      CanTpCloseConnection(gHandle_CRadarFL_RFL_Object_NPdu_Data);
   }
   gHandle_CRadarFL_RFL_Object_NPdu_Data = CanTpCreateConnection(@sysvar::CAN_PrivMain::CRadarFL::RFL_Object_NPdu_Data::GeneralSettings::sysAddrMode);
   connHandle = gHandle_CRadarFL_RFL_Object_NPdu_Data;
 
   /* Addressing */ 
   addressingMode = CanTpGetAddressingMode(connHandle);
   switch (addressingMode) {
      case kNormal:        write("%s, connection %d: Addressing mode = Normal", "CAN_PrivMain", kId_CRadarFL_RFL_Object_NPdu_Data); break;
      case kExtendedBased: write("%s, connection %d: Addressing mode = Extended (based)", "CAN_PrivMain", kId_CRadarFL_RFL_Object_NPdu_Data); break;
      case kNormalFixed:   write("%s, connection %d: Addressing mode = NormalFixed", "CAN_PrivMain", kId_CRadarFL_RFL_Object_NPdu_Data); break;
      case kMixed:         write("%s, connection %d: Addressing mode = Mixed", "CAN_PrivMain", kId_CRadarFL_RFL_Object_NPdu_Data); break;
      case kMixed11Bit:    write("%s, connection %d: Addressing mode = Mixed (11 bit)", "CAN_PrivMain", kId_CRadarFL_RFL_Object_NPdu_Data); break;
      case kExtendedFree:  write("%s, connection %d: Addressing mode = Extended (free)", "CAN_PrivMain", kId_CRadarFL_RFL_Object_NPdu_Data); break;
   } 
   if (addressingMode == kMixed || addressingMode == kMixed11Bit) 
   {
      CanTpSetAddressExtension(connHandle, @sysvar::CAN_PrivMain::CRadarFL::RFL_Object_NPdu_Data::GeneralSettings::sysAddrExtension);
   }
   if (addressingMode == kExtendedBased) 
   {
      CanTpSetBaseIdentifier(connHandle, @sysvar::CAN_PrivMain::CRadarFL::RFL_Object_NPdu_Data::GeneralSettings::sysBaseAddress);
   }
   if (addressingMode == kExtendedBased || 
      addressingMode == kExtendedFree || 
      addressingMode == kNormalFixed || 
      addressingMode == kMixed) 
   {
      CanTpSetEcuAddress(connHandle, @sysvar::CAN_PrivMain::CRadarFL::RFL_Object_NPdu_Data::GeneralSettings::sysECUAddress);
      CanTpSetTargetAddress(connHandle, @sysvar::CAN_PrivMain::CRadarFL::RFL_Object_NPdu_Data::GeneralSettings::sysTargetAddress);
      write("%s, connection %d: ECU address = 0x%02x", "CAN_PrivMain", kId_CRadarFL_RFL_Object_NPdu_Data, CanTpGetEcuAddress(connHandle));
      write("%s, connection %d: Target address = 0x%x", "CAN_PrivMain", kId_CRadarFL_RFL_Object_NPdu_Data, CanTpGetTargetAddress(connHandle));
 
   } 
   if (addressingMode == kNormal || 
      addressingMode == kExtendedFree || 
      addressingMode == kMixed11Bit) 
   {
      if (@sysvar::CAN_PrivMain::CRadarFL::RFL_Object_NPdu_Data::GeneralSettings::sysUseExtId)
      { 
         extIdFlag = 0x80000000; 
      }
      CanTpSetRxIdentifier(connHandle, extIdFlag | @sysvar::CAN_PrivMain::CRadarFL::RFL_Object_NPdu_Data::GeneralSettings::sysRxIdentifier);
      CanTpSetTxIdentifier(connHandle, extIdFlag | @sysvar::CAN_PrivMain::CRadarFL::RFL_Object_NPdu_Data::GeneralSettings::sysTxIdentifier);
      write( "%s, connection %d: Rx Id = 0x%x", "CAN_PrivMain", kId_CRadarFL_RFL_Object_NPdu_Data, CanTpGetRxIdentifier(connHandle));
      write( "%s, connection %d: Tx Id = 0x%x", "CAN_PrivMain", kId_CRadarFL_RFL_Object_NPdu_Data, CanTpGetTxIdentifier(connHandle));
   }
   gECUAddress_CRadarFL_RFL_Object_NPdu_Data = @sysvar::CAN_PrivMain::CRadarFL::RFL_Object_NPdu_Data::GeneralSettings::sysECUAddress;
   gTargetAddress_CRadarFL_RFL_Object_NPdu_Data = @sysvar::CAN_PrivMain::CRadarFL::RFL_Object_NPdu_Data::GeneralSettings::sysTargetAddress;
   gTxIdentifier_CRadarFL_RFL_Object_NPdu_Data = @sysvar::CAN_PrivMain::CRadarFL::RFL_Object_NPdu_Data::GeneralSettings::sysTxIdentifier;
   gRxIdentifier_CRadarFL_RFL_Object_NPdu_Data = @sysvar::CAN_PrivMain::CRadarFL::RFL_Object_NPdu_Data::GeneralSettings::sysRxIdentifier;
   write("%s, connection %d: Base address = 0x%x", "CAN_PrivMain", kId_CRadarFL_RFL_Object_NPdu_Data, CanTpGetBaseIdentifier(connHandle));
   write("%s, connection %d: Address extension = %d", "CAN_PrivMain", kId_CRadarFL_RFL_Object_NPdu_Data, CanTpGetAddressExtension(connHandle));
   write("%s, connection %d: Use extended IDs = %d","RFL_Object_NPdu_Data", kId_CRadarFL_RFL_Object_NPdu_Data, @sysvar::CAN_PrivMain::CRadarFL::RFL_Object_NPdu_Data::GeneralSettings::sysUseExtId);
   CanTpUseFlowControlFrames(connHandle, @sysvar::CAN_PrivMain::CRadarFL::RFL_Object_NPdu_Data::GeneralSettings::sysUseFC);
 
   /*  Other settings */
   CanTpSetPadding(connHandle, @sysvar::CAN_PrivMain::CRadarFL::RFL_Object_NPdu_Data::GeneralSettings::sysPaddingValue);
   write("%s, connection %d: Padding value = %d", "CAN_PrivMain", kId_CRadarFL_RFL_Object_NPdu_Data, CanTpGetPadding(connHandle));
   CanTpSetMaximumReceiveLength(connHandle,@sysvar::CAN_PrivMain::CRadarFL::RFL_Object_NPdu_Data::GeneralSettings::sysMaxReceiveLength);
   write("%s, connection %d: Max. receiver length = %d", "CAN_PrivMain", kId_CRadarFL_RFL_Object_NPdu_Data, CanTpGetMaximumReceiveLength(connHandle));
 
   /* CAN FD */
   if( 1 == gbCANFDactive_CRadarFL_RFL_Object_NPdu_Data)
   {
      CanTpSetMaxCANFDFrameLength( connHandle, @sysvar::CAN_PrivMain::CRadarFL::RFL_Object_NPdu_Data::GeneralSettings::sysMaxFDFrameLen);
      write("%s, connection %d: Max. CAN FD frame length = %d", "CAN_PrivMain", kId_CRadarFL_RFL_Object_NPdu_Data, @sysvar::CAN_PrivMain::CRadarFL::RFL_Object_NPdu_Data::GeneralSettings::sysMaxFDFrameLen);
      CanTpSetBitRateSwitch( connHandle, @sysvar::CAN_PrivMain::CRadarFL::RFL_Object_NPdu_Data::GeneralSettings::sysBitRateSwitch);
      write("%s, connection %d: Bit rate switch = %d", "CAN_PrivMain", kId_CRadarFL_RFL_Object_NPdu_Data, @sysvar::CAN_PrivMain::CRadarFL::RFL_Object_NPdu_Data::GeneralSettings::sysBitRateSwitch);
   }
   CanTpWriteConnectionSettings(connHandle);
}