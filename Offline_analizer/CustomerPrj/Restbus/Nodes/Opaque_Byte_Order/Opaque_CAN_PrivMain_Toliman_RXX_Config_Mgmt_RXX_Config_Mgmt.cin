/*@!Encoding:1252*/
// Autogenerated by -> Platform\Classe\Scripts\Rbs_Scripts\create_Opaque_byte_order.py

includes
{
}

variables
{
   const BufferSize_Toliman_RXX_Config_Mgmt_RXX_Config_Mgmt = 20;  // Signal length in Byte
}

on sysVar CAN_PrivMain::RXX_Config_Mgmt::RXX_Config_Mgmt::sysFillData
{
   long i, txCount;
   byte sendString[BufferSize_Toliman_RXX_Config_Mgmt_RXX_Config_Mgmt];
   
   // No action if button is released 
   if (@this==0) 
      return; 

   txCount = @sysvar::CAN_PrivMain::RXX_Config_Mgmt::RXX_Config_Mgmt::sysNoOfBytesToFill; 

   // don't write over array limits 
   // limit size to prevent extremely long transfers 

   if( txCount>BufferSize_Toliman_RXX_Config_Mgmt_RXX_Config_Mgmt)
   {
     txCount=BufferSize_Toliman_RXX_Config_Mgmt_RXX_Config_Mgmt;
     @sysvar::CAN_PrivMain::RXX_Config_Mgmt::RXX_Config_Mgmt::sysNoOfBytesToFill = txCount;
     writeDbgLevel(1,"%s: Length of data string to be sent is limited to %d bytes", BufferSize_Toliman_RXX_Config_Mgmt_RXX_Config_Mgmt);
   } 

   for( i=0; i<txCount; i++ ) 
   {
     sendString[i] = '0'+i%75;
   } 

   sysSetVariableData(sysvar::CAN_PrivMain::RXX_Config_Mgmt::RXX_Config_Mgmt::SignalValue, sendString, txCount);
}

on sysvar CAN_PrivMain::RXX_Config_Mgmt::RXX_Config_Mgmt::SignalValue
{
   byte sendString[BufferSize_Toliman_RXX_Config_Mgmt_RXX_Config_Mgmt];
   long copiedBytes; 

   if (sysGetVariableArrayLength(this) > elcount( sendString)) 
   {
     writeDbgLevel(1,"%s: Data string to be sent is too large (%d), truncated to %d bytes", sysGetVariableArrayLength(this), BufferSize_Toliman_RXX_Config_Mgmt_RXX_Config_Mgmt);
     sysGetVariableData(this, sendString, copiedBytes); 
     sysSetVariableData(this, sendString, elcount( sendString)); 
     // sysVar handler will be called again 
   }
   else 
   { 
     sysGetVariableData(this, sendString, copiedBytes);
     @sysvar::CAN_PrivMain::RXX_Config_Mgmt::RXX_Config_Mgmt::sysNoOfBytesToSend = copiedBytes;
   } 
}
   
on sysVar CAN_PrivMain::RXX_Config_Mgmt::RXX_Config_Mgmt::sysClearData
{
   if (@this) 
   { 
     ClearReceivedData(); 
   } 
}

void ClearReceivedData()
{ 
   long size = 0; 
   byte empty_buffer[1] = 0;
   sysSetVariableData(sysvar::CAN_PrivMain::RXX_Config_Mgmt::RXX_Config_Mgmt::SignalValue, empty_buffer, size);
   @CAN_PrivMain::RXX_Config_Mgmt::RXX_Config_Mgmt::sysNoOfBytesToSend = 0;
}