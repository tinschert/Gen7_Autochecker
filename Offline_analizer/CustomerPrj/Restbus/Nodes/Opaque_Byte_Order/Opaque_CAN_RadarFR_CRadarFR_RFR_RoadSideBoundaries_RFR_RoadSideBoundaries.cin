/*@!Encoding:1252*/
// Autogenerated by -> Platform\Classe\Scripts\Rbs_Scripts\create_Opaque_byte_order.py

includes
{
}

variables
{
   const BufferSize_CRadarFR_RFR_RoadSideBoundaries_RFR_RoadSideBoundaries = 1000;  // Signal length in Byte
}

on sysVar CAN_RadarFR::RFR_RoadSideBoundaries::RFR_RoadSideBoundaries::sysFillData
{
   long i, txCount;
   byte sendString[BufferSize_CRadarFR_RFR_RoadSideBoundaries_RFR_RoadSideBoundaries];
   
   // No action if button is released 
   if (@this==0) 
      return; 

   txCount = @sysvar::CAN_RadarFR::RFR_RoadSideBoundaries::RFR_RoadSideBoundaries::sysNoOfBytesToFill; 

   // don't write over array limits 
   // limit size to prevent extremely long transfers 

   if( txCount>BufferSize_CRadarFR_RFR_RoadSideBoundaries_RFR_RoadSideBoundaries)
   {
     txCount=BufferSize_CRadarFR_RFR_RoadSideBoundaries_RFR_RoadSideBoundaries;
     @sysvar::CAN_RadarFR::RFR_RoadSideBoundaries::RFR_RoadSideBoundaries::sysNoOfBytesToFill = txCount;
     writeDbgLevel(1,"%s: Length of data string to be sent is limited to %d bytes", BufferSize_CRadarFR_RFR_RoadSideBoundaries_RFR_RoadSideBoundaries);
   } 

   for( i=0; i<txCount; i++ ) 
   {
     sendString[i] = '0'+i%75;
   } 

   sysSetVariableData(sysvar::CAN_RadarFR::RFR_RoadSideBoundaries::RFR_RoadSideBoundaries::SignalValue, sendString, txCount);
}

on sysvar CAN_RadarFR::RFR_RoadSideBoundaries::RFR_RoadSideBoundaries::SignalValue
{
   byte sendString[BufferSize_CRadarFR_RFR_RoadSideBoundaries_RFR_RoadSideBoundaries];
   long copiedBytes; 

   if (sysGetVariableArrayLength(this) > elcount( sendString)) 
   {
     writeDbgLevel(1,"%s: Data string to be sent is too large (%d), truncated to %d bytes", sysGetVariableArrayLength(this), BufferSize_CRadarFR_RFR_RoadSideBoundaries_RFR_RoadSideBoundaries);
     sysGetVariableData(this, sendString, copiedBytes); 
     sysSetVariableData(this, sendString, elcount( sendString)); 
     // sysVar handler will be called again 
   }
   else 
   { 
     sysGetVariableData(this, sendString, copiedBytes);
     @sysvar::CAN_RadarFR::RFR_RoadSideBoundaries::RFR_RoadSideBoundaries::sysNoOfBytesToSend = copiedBytes;
   } 
}
   
on sysVar CAN_RadarFR::RFR_RoadSideBoundaries::RFR_RoadSideBoundaries::sysClearData
{
   if (@this) 

   { 

     ClearReceivedData_RFR_RoadSideBoundaries(); 

   } 

}

void ClearReceivedData_RFR_RoadSideBoundaries()
{ 
   long size = 0; 
   byte empty_buffer[1] = 0;
   sysSetVariableData(sysvar::CAN_RadarFR::RFR_RoadSideBoundaries::RFR_RoadSideBoundaries::SignalValue, empty_buffer, size);
   @CAN_RadarFR::RFR_RoadSideBoundaries::RFR_RoadSideBoundaries::sysNoOfBytesToSend = 0;
}