/*@!Encoding:1252*/
// Autogenerated by -> Platform\Classe\Scripts\Rbs_Scripts\create_Opaque_byte_order.py

includes
{
}

variables
{
   const BufferSize_CRadarFC_RFC_FieldDataCollection_RFC_FieldDataCollection = 5000;  // Signal length in Byte
}

on sysVar CAN_RadarFC::RFC_FieldDataCollection::RFC_FieldDataCollection::sysFillData
{
   long i, txCount;
   byte sendString[BufferSize_CRadarFC_RFC_FieldDataCollection_RFC_FieldDataCollection];
   
   // No action if button is released 
   if (@this==0) 
      return; 

   txCount = @sysvar::CAN_RadarFC::RFC_FieldDataCollection::RFC_FieldDataCollection::sysNoOfBytesToFill; 

   // don't write over array limits 
   // limit size to prevent extremely long transfers 

   if( txCount>BufferSize_CRadarFC_RFC_FieldDataCollection_RFC_FieldDataCollection)
   {
     txCount=BufferSize_CRadarFC_RFC_FieldDataCollection_RFC_FieldDataCollection;
     @sysvar::CAN_RadarFC::RFC_FieldDataCollection::RFC_FieldDataCollection::sysNoOfBytesToFill = txCount;
     writeDbgLevel(1,"%s: Length of data string to be sent is limited to %d bytes", BufferSize_CRadarFC_RFC_FieldDataCollection_RFC_FieldDataCollection);
   } 

   for( i=0; i<txCount; i++ ) 
   {
     sendString[i] = '0'+i%75;
   } 

   sysSetVariableData(sysvar::CAN_RadarFC::RFC_FieldDataCollection::RFC_FieldDataCollection::SignalValue, sendString, txCount);
}

on sysvar CAN_RadarFC::RFC_FieldDataCollection::RFC_FieldDataCollection::SignalValue
{
   byte sendString[BufferSize_CRadarFC_RFC_FieldDataCollection_RFC_FieldDataCollection];
   long copiedBytes; 

   if (sysGetVariableArrayLength(this) > elcount( sendString)) 
   {
     writeDbgLevel(1,"%s: Data string to be sent is too large (%d), truncated to %d bytes", sysGetVariableArrayLength(this), BufferSize_CRadarFC_RFC_FieldDataCollection_RFC_FieldDataCollection);
     sysGetVariableData(this, sendString, copiedBytes); 
     sysSetVariableData(this, sendString, elcount( sendString)); 
     // sysVar handler will be called again 
   }
   else 
   { 
     sysGetVariableData(this, sendString, copiedBytes);
     @sysvar::CAN_RadarFC::RFC_FieldDataCollection::RFC_FieldDataCollection::sysNoOfBytesToSend = copiedBytes;
   } 
}
   
on sysVar CAN_RadarFC::RFC_FieldDataCollection::RFC_FieldDataCollection::sysClearData
{
   if (@this) 

   { 

     ClearReceivedData_RFC_FieldDataCollection(); 

   } 

}

void ClearReceivedData_RFC_FieldDataCollection()
{ 
   long size = 0; 
   byte empty_buffer[1] = 0;
   sysSetVariableData(sysvar::CAN_RadarFC::RFC_FieldDataCollection::RFC_FieldDataCollection::SignalValue, empty_buffer, size);
   @CAN_RadarFC::RFC_FieldDataCollection::RFC_FieldDataCollection::sysNoOfBytesToSend = 0;
}