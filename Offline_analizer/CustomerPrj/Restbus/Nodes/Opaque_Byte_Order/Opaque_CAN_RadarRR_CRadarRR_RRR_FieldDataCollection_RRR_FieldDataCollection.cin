/*@!Encoding:1252*/
// Autogenerated by -> Platform\Classe\Scripts\Rbs_Scripts\create_Opaque_byte_order.py

includes
{
}

variables
{
   const BufferSize_CRadarRR_RRR_FieldDataCollection_RRR_FieldDataCollection = 5000;  // Signal length in Byte
}

on sysVar CAN_RadarRR::RRR_FieldDataCollection::RRR_FieldDataCollection::sysFillData
{
   long i, txCount;
   byte sendString[BufferSize_CRadarRR_RRR_FieldDataCollection_RRR_FieldDataCollection];
   
   // No action if button is released 
   if (@this==0) 
      return; 

   txCount = @sysvar::CAN_RadarRR::RRR_FieldDataCollection::RRR_FieldDataCollection::sysNoOfBytesToFill; 

   // don't write over array limits 
   // limit size to prevent extremely long transfers 

   if( txCount>BufferSize_CRadarRR_RRR_FieldDataCollection_RRR_FieldDataCollection)
   {
     txCount=BufferSize_CRadarRR_RRR_FieldDataCollection_RRR_FieldDataCollection;
     @sysvar::CAN_RadarRR::RRR_FieldDataCollection::RRR_FieldDataCollection::sysNoOfBytesToFill = txCount;
     writeDbgLevel(1,"%s: Length of data string to be sent is limited to %d bytes", BufferSize_CRadarRR_RRR_FieldDataCollection_RRR_FieldDataCollection);
   } 

   for( i=0; i<txCount; i++ ) 
   {
     sendString[i] = '0'+i%75;
   } 

   sysSetVariableData(sysvar::CAN_RadarRR::RRR_FieldDataCollection::RRR_FieldDataCollection::SignalValue, sendString, txCount);
}

on sysvar CAN_RadarRR::RRR_FieldDataCollection::RRR_FieldDataCollection::SignalValue
{
   byte sendString[BufferSize_CRadarRR_RRR_FieldDataCollection_RRR_FieldDataCollection];
   long copiedBytes; 

   if (sysGetVariableArrayLength(this) > elcount( sendString)) 
   {
     writeDbgLevel(1,"%s: Data string to be sent is too large (%d), truncated to %d bytes", sysGetVariableArrayLength(this), BufferSize_CRadarRR_RRR_FieldDataCollection_RRR_FieldDataCollection);
     sysGetVariableData(this, sendString, copiedBytes); 
     sysSetVariableData(this, sendString, elcount( sendString)); 
     // sysVar handler will be called again 
   }
   else 
   { 
     sysGetVariableData(this, sendString, copiedBytes);
     @sysvar::CAN_RadarRR::RRR_FieldDataCollection::RRR_FieldDataCollection::sysNoOfBytesToSend = copiedBytes;
   } 
}
   
on sysVar CAN_RadarRR::RRR_FieldDataCollection::RRR_FieldDataCollection::sysClearData
{
   if (@this) 

   { 

     ClearReceivedData_RRR_FieldDataCollection(); 

   } 

}

void ClearReceivedData_RRR_FieldDataCollection()
{ 
   long size = 0; 
   byte empty_buffer[1] = 0;
   sysSetVariableData(sysvar::CAN_RadarRR::RRR_FieldDataCollection::RRR_FieldDataCollection::SignalValue, empty_buffer, size);
   @CAN_RadarRR::RRR_FieldDataCollection::RRR_FieldDataCollection::sysNoOfBytesToSend = 0;
}