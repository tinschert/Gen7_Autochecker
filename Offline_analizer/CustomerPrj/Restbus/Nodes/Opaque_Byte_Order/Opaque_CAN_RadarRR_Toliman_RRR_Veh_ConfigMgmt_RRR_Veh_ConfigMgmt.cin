/*@!Encoding:1252*/
// Autogenerated by -> Platform\Classe\Scripts\Rbs_Scripts\create_Opaque_byte_order.py

includes
{
}

variables
{
   const BufferSize_Toliman_RRR_Veh_ConfigMgmt_RRR_Veh_ConfigMgmt = 20;  // Signal length in Byte
}

on sysVar CAN_RadarRR::RRR_Veh_ConfigMgmt::RRR_Veh_ConfigMgmt::sysFillData
{
   long i, txCount;
   byte sendString[BufferSize_Toliman_RRR_Veh_ConfigMgmt_RRR_Veh_ConfigMgmt];
   
   // No action if button is released 
   if (@this==0) 
      return; 

   txCount = @sysvar::CAN_RadarRR::RRR_Veh_ConfigMgmt::RRR_Veh_ConfigMgmt::sysNoOfBytesToFill; 

   // don't write over array limits 
   // limit size to prevent extremely long transfers 

   if( txCount>BufferSize_Toliman_RRR_Veh_ConfigMgmt_RRR_Veh_ConfigMgmt)
   {
     txCount=BufferSize_Toliman_RRR_Veh_ConfigMgmt_RRR_Veh_ConfigMgmt;
     @sysvar::CAN_RadarRR::RRR_Veh_ConfigMgmt::RRR_Veh_ConfigMgmt::sysNoOfBytesToFill = txCount;
     writeDbgLevel(1,"%s: Length of data string to be sent is limited to %d bytes", BufferSize_Toliman_RRR_Veh_ConfigMgmt_RRR_Veh_ConfigMgmt);
   } 

   for( i=0; i<txCount; i++ ) 
   {
     sendString[i] = '0'+i%75;
   } 

   sysSetVariableData(sysvar::CAN_RadarRR::RRR_Veh_ConfigMgmt::RRR_Veh_ConfigMgmt::SignalValue, sendString, txCount);
}

on sysvar CAN_RadarRR::RRR_Veh_ConfigMgmt::RRR_Veh_ConfigMgmt::SignalValue
{
   byte sendString[BufferSize_Toliman_RRR_Veh_ConfigMgmt_RRR_Veh_ConfigMgmt];
   long copiedBytes; 

   if (sysGetVariableArrayLength(this) > elcount( sendString)) 
   {
     writeDbgLevel(1,"%s: Data string to be sent is too large (%d), truncated to %d bytes", sysGetVariableArrayLength(this), BufferSize_Toliman_RRR_Veh_ConfigMgmt_RRR_Veh_ConfigMgmt);
     sysGetVariableData(this, sendString, copiedBytes); 
     sysSetVariableData(this, sendString, elcount( sendString)); 
     // sysVar handler will be called again 
   }
   else 
   { 
     sysGetVariableData(this, sendString, copiedBytes);
     @sysvar::CAN_RadarRR::RRR_Veh_ConfigMgmt::RRR_Veh_ConfigMgmt::sysNoOfBytesToSend = copiedBytes;
   } 
}
   
on sysVar CAN_RadarRR::RRR_Veh_ConfigMgmt::RRR_Veh_ConfigMgmt::sysClearData
{
   if (@this) 

   { 

     ClearReceivedData_RRR_Veh_ConfigMgmt(); 

   } 

}

void ClearReceivedData_RRR_Veh_ConfigMgmt()
{ 
   long size = 0; 
   byte empty_buffer[1] = 0;
   sysSetVariableData(sysvar::CAN_RadarRR::RRR_Veh_ConfigMgmt::RRR_Veh_ConfigMgmt::SignalValue, empty_buffer, size);
   @CAN_RadarRR::RRR_Veh_ConfigMgmt::RRR_Veh_ConfigMgmt::sysNoOfBytesToSend = 0;
}