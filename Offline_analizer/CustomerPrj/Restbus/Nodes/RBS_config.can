/*@!Encoding:1252*/
on preStart 
{
  @hil_ctrl::hil_mode = @hil_ctrl::hil_mode::Restbus;
}