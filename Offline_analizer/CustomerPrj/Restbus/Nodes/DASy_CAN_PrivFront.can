/*@!Encoding:1252*/
/**
 * @file DASy_CAN_PrivFront.can
 * @author ADAS_HIL_TEAM
 * @date 10-04-2022
 * @brief 
 *
 * ################################################################
 * C O P Y R I G H T S
 * ----------------------------------------------------------------
 * Copyright (c) 2022-2023 by Robert Bosch GmbH. All rights reserved.
 
 * The reproduction, distribution and utilization of this file as
 * well as the communication of its contents to others without express
 * authorization is prohibited. Offenders will be held liable for the
 * payment of damages. All rights reserved in the event of the grant
 * of a patent, utility model or design.
 *
 * ################################################################
*/

// Autogenerated by -> Platform\Classe\Scripts\Rbs_Scripts\create_nodes.py
includes
{
  #pragma library ("C:\ProgramData\Vector\AddOn Packages\Vector AddOn\vModules\CANoeILNLVector.vmodule")
  #include "CAPL\DataHandling.cin" /*DataHandling for IL*/
  #include "CAPL\E2E.cin" /*OD Specific for CRC calculation */
}

variables {
  message ADAS_Status Msg_ADAS_Status;

  word counter_ADAS_Status_ADAS_Status_AliveCtr;

  byte crc_ADAS_Status_ADAS_Status_CRC;

}

on preStart {
  long result;
  result=ILControlInit ();//Initialization of CANoe IL,to prevent the IL autostart function.
  switch(result)
  {
    case  0   : write("ILControlInit :: DASy :: No error."); break;
    case -1   : write("ILControlInit :: DASy :: Momentary state of the IL does not permit this query."); break;
    case -50  : write("ILControlInit :: DASy :: Nodelayer is inactive - possibly deactivated in the nodes configuration dialog.");  break;
   }

  DASy_sim_Disable();
  DASy_sim_SetCycleTimeOffset();
}

on start {

  ILControlSimulationOn();//Starts the simulation of the IL.
  DASy_sim_SetCANFDParameter();
  ILControlStart ();//Cyclical sending starts; setting signals is now possible.
  DASy_sim_Reset();
}

on stopMeasurement {

  DASy_sim_DisableMsg();
  DASy_sim_Disable();
  ILControlStop();//Cyclical sending is stopped; setting signals is now no longer possible.
  ILControlSimulationOff();//Stops the simulation of the IL. After that no other function to control the IL has an effect to the IL.

}

on sysvar_update hil_ctrl::adas_1_sim
{
  DASy_sim_Reset();
}

on sysvar_update hil_ctrl::variant
{
  DASy_sim_Reset();
}

on sysvar_update Cus_bus::bus_CAN_PrivFront_ON_OFF
{
  DASy_sim_Reset();
}

void DASy_sim_Reset()
{

  DASy_sim_DisableMsg();
  DASy_sim_Disable();

  if ((@Cus_bus::bus_CAN_PrivFront_ON_OFF == 1) && (@hil_ctrl::adas_1_sim == 1))
  {
    switch(@hil_ctrl::variant)
    {
      case a_variant:DASy_sim_start_a_variant();break;
      case b_variant:DASy_sim_start_b_variant();break;
    }
    if (@hil_ctrl::hil_mode == @hil_ctrl::hil_mode::Restbus) 
    {
       DASy_sim_EnableEventMsg();
    }
    else
    {
       DASy_sim_DisableEventMsg();
    }
  }
}

void DASy_sim_start_a_variant()
{
  @CAN_PrivFront::ADAS_Status::ADAS_Status_ON_OFF = 1;
}

void DASy_sim_start_b_variant()
{
  @CAN_PrivFront::ADAS_Status::ADAS_Status_ON_OFF = 1;
}

void DASy_sim_Disable()
{
  @CAN_PrivFront::ADAS_Status::ADAS_Status_ON_OFF = 0;
}

void DASy_sim_DisableMsg()
{
   ILFaultInjectionDisableMsg(ADAS_Status);
}
on sysvar hil_ctrl::hil_mode
{
  DASy_sim_Reset();
}

void DASy_sim_DisableEventMsg()
{

}

void DASy_sim_EnableEventMsg()
{

}
void DASy_sim_SetCANParameter()
{
  //For future purpose
  //ILFaultInjectionSetMsgDlc(dbMsg msg, dword dlc)
  //ILFaultInjectionSetMsgLength(dbMsg msg, dword msgLength)
  //ILFaultInjectionResetMsgDlc(dbMsg msg)
  //ILFaultInjectionResetMsgLength (dbMsg msg)
}

void DASy_sim_SetCANFDParameter()
{
   //CAN FD Parameter Setting
   int FDF =1;
   int BRS =1;
   ILSetCANFDParam(ADAS_Status,FDF,BRS,ADAS_Status.dlc);
}

dword applILTxPending (long aId, dword aDlc, byte data[])//This callback is being called before the IL sends a message to the bus
{
  switch(aId)
  {
    case ADAS_Status.id:cfg_Msg_ADAS_Status(aDlc, data);break;
    default :;//write("Node:DASy ::No Cyclic event");
           break;
  }
  return 1; // don't prevent sending of the message
}

on sysvar CAN_PrivFront::ADAS_Status::ADAS_Status_ON_OFF
{
  if (@this == 1)
  {
    ILFaultInjectionEnableMsg(ADAS_Status);
  }
  else{
         ILFaultInjectionDisableMsg(ADAS_Status);
      }
}

void cfg_Msg_ADAS_Status(dword aDlc, byte data[])
{
   int64 i,k;//For looping
   byte xor,data_byte;
   dword crcTemp;
   byte DataLength;
   dword Msg_id;
   
   DataLength = Msg_ADAS_Status.DataLength;//Message Data Length
   Msg_id  = Msg_ADAS_Status.id;//Message ID
   
    if (@CAN_PrivFront::ADAS_Status::ADAS_Status_AliveCtr_FaultInject != 3)//AC: user defined value
    {

    clearBitsInByteArrayLE(data,8,4); //Intel / little-endian

    }
    if (@CAN_PrivFront::ADAS_Status::ADAS_Status_AliveCtr_FaultInject == 0)//AC: No Error, calculate AC
    {
      ++counter_ADAS_Status_ADAS_Status_AliveCtr;
      counter_ADAS_Status_ADAS_Status_AliveCtr %=16;

      copyBitsToByteArrayLE(counter_ADAS_Status_ADAS_Status_AliveCtr,data,8,4); //Intel / little-endian;
    }
    else if (@CAN_PrivFront::ADAS_Status::ADAS_Status_AliveCtr_FaultInject == 1)//AC: Error sequence: set AC = 0
    {

      copyBitsToByteArrayLE(0,data,8,4); //Intel / little-endian;
    }
    else if (@CAN_PrivFront::ADAS_Status::ADAS_Status_AliveCtr_FaultInject == 2)//AC: Error sequence: Freeze last valid value
    {

      copyBitsToByteArrayLE(counter_ADAS_Status_ADAS_Status_AliveCtr,data,8,4); //Intel / little-endian;
    }
    if (@CAN_PrivFront::ADAS_Status::ADAS_Status_CRC_FaultInject != 3)//CRC: user defined value
    {

    clearBitsInByteArrayLE(data,0,8); //Intel / little-endian

    }
    if(@CAN_PrivFront::ADAS_Status::ADAS_Status_CRC_FaultInject == 0)//CRC: No Error, calculate CRC
    {
      xor = initialization_value;
      for(i = 0; i < DataLength; i++)
      {
        if(i==0)
          xor = CRC8_SAE_J1850_Poly_1D_Lookup[Data_ID_Lookup_PRIVATE(Msg_id) ^ xor];
        else
          xor = CRC8_SAE_J1850_Poly_1D_Lookup[ data[i] ^ xor ];
      }
      crc_ADAS_Status_ADAS_Status_CRC = result_XOR_value ^ xor;

      copyBitsToByteArrayLE(crc_ADAS_Status_ADAS_Status_CRC,data,0,8); //Intel / little-endian;
    }
    else if(@CAN_PrivFront::ADAS_Status::ADAS_Status_CRC_FaultInject == 1)//CRC: Error, set to Zero
    {

      copyBitsToByteArrayLE(0,data,0,8); //Intel / little-endian;
    }
    else if(@CAN_PrivFront::ADAS_Status::ADAS_Status_CRC_FaultInject == 2)//CRC: Error, Freeze last valid value
    {

      copyBitsToByteArrayLE(crc_ADAS_Status_ADAS_Status_CRC,data,0,8); //Intel / little-endian;
    }
}


on sysvar CAN_PrivFront::ADAS_Status::ADAS_Status_CycleTime
{
  ILFaultInjectionSetMsgCycleTime(ADAS_Status,@this);
  //ILFaultInjectionResetMsgCycleTime(ADAS_Status);
}

void DASy_sim_SetCycleTimeOffset()
{

//  ILNodeSetPDUTimingCyclic (dbMsg dbMessage, long TrueOrFalse, long offset, long period, long disturbanceCount, long flags);
//  TrueOrFalse ; 0: denotes the False timing; 1: denotes the True timing; 3: denotes the True and the False timing.
//  offset :Defines the delay in [ms] from now when the first cyclic transmission will start.
//  period :Defines the period in [ms] for the cyclic transmission.
//  disturbanceCount :Reserved/unused; should be set to -1 (infinite).
//  flags :Reserved; should be set to 0.

}