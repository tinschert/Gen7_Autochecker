/*@!Encoding:1252*/
// Autogenerated by -> Platform\Classe\Scripts\Rbs_Scripts\create_nodes.py
includes
{
  #pragma library ("C:\ProgramData\Vector\AddOn Packages\Vector AddOn\vModules\AsrPDUIL2.vmodule")
  #include "CAPL\DataHandling.cin" /*DataHandling for IL*/
  #include "CAPL\E2E.cin" /*OD Specific for CRC calculation */
  #include "OSEKTP\OSEKTP.cin"  //common definations for osektp
  #if ADAS_HIL
    #pragma library("..\..\..\Platform\Classe\DLL\star_model\capldll.dll")
    #pragma library("..\..\..\Platform\Classe\DLL\clara_model\Release64\clara_model.dll")
    #pragma library("..\..\..\Platform\Classe\DLL\Release64\RoadObj.dll")
  #endif
  #include "OSEKTP\OSEKTP_CAN_RadarRL_CRadarRL_RRL_FieldDataCollection_TpData.cin"  ///For handling  pdu RRL_FieldDataCollection_TpData with OSEKtp
  #include "OSEKTP\OSEKTP_CAN_RadarRL_CRadarRL_RRL_Object_TpData.cin"  ///For handling  pdu RRL_Object_TpData with OSEKtp
  #include "OSEKTP\OSEKTP_CAN_RadarRL_CRadarRL_RRL_RoadSideBoundaries_TpData.cin"  ///For handling  pdu RRL_RoadSideBoundaries_TpData with OSEKtp
  #include "Opaque_Byte_Order\Opaque_CAN_RadarRL_CRadarRL_RRL_FieldDataCollection_RRL_FieldDataCollection.cin" /*Signal Opaque byte order handling*/
  #include "Opaque_Byte_Order\Opaque_CAN_RadarRL_CRadarRL_RRL_RoadSideBoundaries_RRL_RoadSideBoundaries.cin" /*Signal Opaque byte order handling*/
}

variables {
  int Token_FC_RRL_Object = 0;
  int Token_FC_RRL_RoadSideBoundaries = 0;
  int Token_FC_RRL_FieldDataCollection = 0;
  msTimer RRL_FieldDataCollection_Timer;
  int count;
  int i;
  message RRL_CornerFunctions Msg_RRL_CornerFunctions;
  message RRL_SensorOutput Msg_RRL_SensorOutput;

  word counter_RRL_CornerFunctions_RRL_CF_SQC;

  dword crc_RRL_CornerFunctions_RRL_CF_CRC;

}

on preStart {
  long result;
  result=ARILControlInit ();//Initialization of AUTOSAR PDU IL,to prevent the IL autostart function.
  switch(result)
  {
    case  0    : write("ARILControlInit :: CRadarRL :: No error."); break;
    case -1    : write("ARILControlInit :: CRadarRL :: IL is in a state that ignores the given request: State graph of the IL (Link)."); break;
    case -2    : write("ARILControlInit :: CRadarRL :: Allowed value range of a signal exceeded. (The exceeded value is transmitted to the bus nevertheless).");  break;
    case -50   : write("ARILControlInit :: CRadarRL :: Node layer is not active. Presumably it is deactivated in the node’s configuration dialog."); break;
    case -51   : write("ARILControlInit :: CRadarRL :: The node is connected to another bus like the CAN Bus."); break;
    case -100  : write("ARILControlInit :: CRadarRL :: Signal/message not found in DB, or not mapped to the node."); break;
    case -101  : write("ARILControlInit :: CRadarRL :: Maximum possible value range exceeded. (There is no transmission to the bus)."); break;
    case -102  : write("ARILControlInit :: CRadarRL :: A network management-, diagnostic, or transport protocol signal was set. IL declines such types of signals, because it is not intended to connect these layers to the IL."); break;
    case -103  : write("ARILControlInit :: CRadarRL :: Invalid value supplied (for all types of requests)."); break;
    case -104  : write("ARILControlInit :: CRadarRL :: General error for invalid requests that are not described furthermore."); break;
   }

  CRadarRL_sim_Disable();
  CRadarRL_sim_SetCycleTimeOffset();
}

on start {

  ARILControlSimulationOn();//Starts the simulation of the IL. The IL is operational and started. The IL will send PDUs.
  CRadarRL_sim_DisableMsg();
  CRadarRL_sim_Disable();
  ARILControlStart ();//When the IL is started, then it is fully operating and sending.
  CRadarRL_sim_Reset();
  OnStart_init_CANTP_CRadarRL();
  OnStart_callTx_CRadarRL_RRL_FieldDataCollection_TpData();
  OnStart_callTx_CRadarRL_RRL_Object_TpData();
  OnStart_callTx_CRadarRL_RRL_RoadSideBoundaries_TpData();
}

OnStart_init_CANTP_CRadarRL()
{
  long dbHandle; 
  dbHandle = CanTpGetDBConnection();
  if (dbHandle > 0) 
  { 
    CanTpCloseConnection(dbHandle); 
  }
}

on stopMeasurement {

  CRadarRL_sim_DisableMsg();
  CRadarRL_sim_Disable();
  ARILControlStop();//Stops sending of PDUs.
  ARILControlSimulationOff();//Stops the simulation of the IL. The IL is not operational. All API function except function ARILControlSimulationOn will not work.

}

on sysvar_update hil_ctrl::ra6_rl_sgu_obj_sim
{
  CRadarRL_sim_Reset();
}

on sysvar_update hil_ctrl::variant
{
  CRadarRL_sim_Reset();
}

on sysvar_update Cus_bus::bus_CAN_RadarRL_ON_OFF
{
  CRadarRL_sim_Reset();
}

void CRadarRL_sim_Reset()
{

  CRadarRL_sim_DisableMsg();
  CRadarRL_sim_Disable();

  if ((@Cus_bus::bus_CAN_RadarRL_ON_OFF == 1) && (@hil_ctrl::ra6_rl_sgu_obj_sim == 1))
  {
    switch(@hil_ctrl::variant)
    {
      case a_variant:CRadarRL_sim_start_a_variant();break;
      case b_variant:CRadarRL_sim_start_b_variant();break;
    }
    if (@hil_ctrl::hil_mode == @hil_ctrl::hil_mode::Restbus) 
    {
       CRadarRL_sim_EnableEventMsg();
    }
    else
    {
       CRadarRL_sim_DisableEventMsg();
    }
  }
}

void CRadarRL_sim_start_a_variant()
{
  @CAN_RadarRL::RRL_CornerFunctions::RRL_CornerFunctions_ON_OFF = 1;
  @CAN_RadarRL::RRL_SensorOutput::RRL_SensorOutput_ON_OFF = 1;
  //@CAN_RadarRL::RRL_Object::RRL_Object_ON_OFF = 1;
  //@CAN_RadarRL::RRL_RoadSideBoundaries::RRL_RoadSideBoundaries_ON_OFF = 1;
  //@CAN_RadarRL::RRL_FieldDataCollection::RRL_FieldDataCollection_ON_OFF = 1;
}

void CRadarRL_sim_start_b_variant()
{
  @CAN_RadarRL::RRL_CornerFunctions::RRL_CornerFunctions_ON_OFF = 1;
  @CAN_RadarRL::RRL_SensorOutput::RRL_SensorOutput_ON_OFF = 1;
  //@CAN_RadarRL::RRL_Object::RRL_Object_ON_OFF = 1;
  //@CAN_RadarRL::RRL_RoadSideBoundaries::RRL_RoadSideBoundaries_ON_OFF = 1;
  //@CAN_RadarRL::RRL_FieldDataCollection::RRL_FieldDataCollection_ON_OFF = 1;
}

void CRadarRL_sim_Disable()
{
  @CAN_RadarRL::RRL_CornerFunctions::RRL_CornerFunctions_ON_OFF = 0;
  @CAN_RadarRL::RRL_SensorOutput::RRL_SensorOutput_ON_OFF = 0;
  @CAN_RadarRL::RRL_Object::RRL_Object_ON_OFF = 0;
  @CAN_RadarRL::RRL_RoadSideBoundaries::RRL_RoadSideBoundaries_ON_OFF = 0;
  @CAN_RadarRL::RRL_FieldDataCollection::RRL_FieldDataCollection_ON_OFF = 0;
}

void CRadarRL_sim_DisableMsg()
{
   ARILFaultInjectionDisablePDU(CAN_RadarRL::RRL_CornerFunctions);
   ARILFaultInjectionDisablePDU(CAN_RadarRL::RRL_SensorOutput);
}
on sysvar hil_ctrl::hil_mode
{
  CRadarRL_sim_Reset();
}

void CRadarRL_sim_DisableEventMsg()
{

}

void CRadarRL_sim_EnableEventMsg()
{

}

dword applPDUILTxPending (dword busContext, dword shortID, dword longID, char name[], dword & aPDULength, byte data[])//This callback is being called before the IL sends a PDU to the bus
{
  if(strncmp(name, "RRL_CornerFunctions", elcount(name)) == 0)
  {
    cfg_Pdu_RRL_CornerFunctions(aPDULength, data);
    return 1; // don't prevent sending of the pdu
  }
  if(strncmp(name, "RRL_SensorOutput", elcount(name)) == 0)
  {
    cfg_Pdu_RRL_SensorOutput(aPDULength, data);
    return 1; // don't prevent sending of the pdu
  }
  return 1; // don't prevent sending of the pdu
}

on sysvar CAN_RadarRL::RRL_CornerFunctions::RRL_CornerFunctions_ON_OFF
{
  if (@this == 1)
  {
    ARILFaultInjectionEnablePDU(CAN_RadarRL::RRL_CornerFunctions);
  }
  else{
         ARILFaultInjectionDisablePDU(CAN_RadarRL::RRL_CornerFunctions);
      }
}

void cfg_Pdu_RRL_CornerFunctions(dword & aPDULength, byte data[])
{
   int64 i,k;//For looping
   byte xor,data_byte;
   dword crcTemp;
   byte DataLength;
   dword Msg_id;
   long result;
   long type=0;//reserved (should be set to 0).
   long disturbanceMode  =0; //0 :: set to disturbanceValue //2 :: set to Random value //3 :: Offset Signal value is increased by disturbanceValue
   long disturbanceCount =0;//-1 ::Infinite Disturbance is continuously applied //0 ::Stop An active disturbance is stopped and the SequenceCounter/crc will be calculated again appropriately //n > 0 ::Count Do exactly n Repetition/disturbances
   long disturbanceValue =0;//According to the disturbance mode the SequenceCounter/crc will optionally be set to this value
   dword crc[1];
   
   DataLength = Msg_RRL_CornerFunctions.DataLength;//Message Data Length
   Msg_id  = Msg_RRL_CornerFunctions.id;//Message ID
   
{
   
   long continueMode=2;
   //0 :: The counter will continue as if there had never been a disturbance [0, 1, 2, 6, 6, 5, 6]
   //1 :: The counter will continue by increasing last valid counter [0, 1, 2, 6, 6, 3, 4]
   //2 :: The counter will continue by increasing the last transmitted value [0, 1, 2, 6, 6, 7, 8]
   
   if (@CAN_RadarRL::RRL_CornerFunctions::RRL_CF_SQC_FaultInject == 0)//AC: No Error, calculate AC
   {
      disturbanceCount=0;//0 Stop An active disturbance is stopped and the CRC will be calculated again appropriately
      result=ARILFaultInjectionDisturbSequenceCounter (RRL_CornerFunctions, "CornerFunctions", type, disturbanceMode, disturbanceCount, disturbanceValue, continueMode);
      //write("ARILFaultInjectionDisturbSequenceCounter :: RRL_CornerFunctions :: CornerFunctions :: RRL_CF_SQC :: No Error");
   }
   else if (@CAN_RadarRL::RRL_CornerFunctions::RRL_CF_SQC_FaultInject == 1)//AC: Error , set AC = 0
   {
      disturbanceCount  = -1;//-1 Infinite Disturbance is continuously applied
      disturbanceMode   = 0;//Sets the AC fix to the value of parameter disturbanceValue.
      disturbanceValue  = 0;//set AC = 0
      result=ARILFaultInjectionDisturbSequenceCounter (RRL_CornerFunctions, "CornerFunctions", type, disturbanceMode, disturbanceCount, disturbanceValue, continueMode);
      //write("ARILFaultInjectionDisturbSequenceCounter :: RRL_CornerFunctions :: CornerFunctions :: RRL_CF_SQC :: AC = 0");
   }
   else if (@CAN_RadarRL::RRL_CornerFunctions::RRL_CF_SQC_FaultInject == 2)//AC: Error , Freeze last valid value
   {
      disturbanceCount  = -1;//-1 Infinite Disturbance is continuously applied
      disturbanceMode   = 1;//1 Freeze Current signal value is used (disturbanceValue is not used)
      result=ARILFaultInjectionDisturbSequenceCounter (RRL_CornerFunctions, "CornerFunctions", type, disturbanceMode, disturbanceCount, disturbanceValue, continueMode);
      //write("ARILFaultInjectionDisturbSequenceCounter :: RRL_CornerFunctions :: CornerFunctions :: RRL_CF_SQC :: Freeze");
   }
}
{
   if (@CAN_RadarRL::RRL_CornerFunctions::RRL_CF_CRC_FaultInject == 0)//CRC: No Error, calculate CRC
   {
      disturbanceCount  = 1;//Once Disturbance is applied
      disturbanceMode   = 0;//Sets the CRC fix to the value of parameter disturbanceValue.
      ARILCalculateCRC("RRL_CornerFunctions","CornerFunctions",data,aPDULength,crc);//Profile 11A
      disturbanceValue=crc_RRL_CornerFunctions_RRL_CF_CRC=crc[0]^0xFF;
      result=ARILFaultInjectionDisturbChecksum (RRL_CornerFunctions, "CornerFunctions", type, disturbanceMode, disturbanceCount, disturbanceValue);
      //write("ARILFaultInjectionDisturbChecksum :: RRL_CornerFunctions :: CornerFunctions :: RRL_CF_CRC :: No Error");
   }
   else if (@CAN_RadarRL::RRL_CornerFunctions::RRL_CF_CRC_FaultInject == 1)//CRC: Error , set CRC = 0
   {
      disturbanceCount  = 1;//Once Disturbance is continuously applied
      disturbanceMode   = 0;//Sets the CRC fix to the value of parameter disturbanceValue.
      disturbanceValue  = 0;//set CRC = 0
      result=ARILFaultInjectionDisturbChecksum (RRL_CornerFunctions, "CornerFunctions", type, disturbanceMode, disturbanceCount, disturbanceValue);
      //write("ARILFaultInjectionDisturbChecksum :: RRL_CornerFunctions :: CornerFunctions :: RRL_CF_CRC :: AC = 0");
   }
   else if (@CAN_RadarRL::RRL_CornerFunctions::RRL_CF_CRC_FaultInject == 2)//CRC: Error , Freeze last valid value
   {
      disturbanceCount  = 1;//Once Disturbance is  applied
      disturbanceMode   = 0;//Sets the CRC fix to the value of parameter disturbanceValue.
      disturbanceValue  = crc_RRL_CornerFunctions_RRL_CF_CRC;
      result=ARILFaultInjectionDisturbChecksum (RRL_CornerFunctions, "CornerFunctions", type, disturbanceMode, disturbanceCount, disturbanceValue);
      //write("ARILFaultInjectionDisturbChecksum :: RRL_CornerFunctions :: CornerFunctions :: RRL_CF_CRC :: Freeze");
    }
}
}


on sysvar CAN_RadarRL::RRL_SensorOutput::RRL_SensorOutput_ON_OFF
{
  if (@this == 1)
  {
    ARILFaultInjectionEnablePDU(CAN_RadarRL::RRL_SensorOutput);
  }
  else{
         ARILFaultInjectionDisablePDU(CAN_RadarRL::RRL_SensorOutput);
      }
}

void cfg_Pdu_RRL_SensorOutput(dword & aPDULength, byte data[])
{
   int64 i,k;//For looping
   byte xor,data_byte;
   dword crcTemp;
   byte DataLength;
   dword Msg_id;
   
   DataLength = Msg_RRL_SensorOutput.DataLength;//Message Data Length
   Msg_id  = Msg_RRL_SensorOutput.id;//Message ID
   
}


on sysvar CAN_RadarRL::RRL_FieldDataCollection::RRL_FieldDataCollection_ON_OFF
{
  if ((@this == 1)&& (@hil_ctrl::ra6_rl_sgu_obj_sim == 1))
   {
      cancelTimer(RRL_FieldDataCollection_Timer); 
      count = 1; 
      Transmit_Pdu_CRadarRL_RRL_FieldDataCollection();
      if (@sysvar::CAN_RadarRL::RRL_FieldDataCollection::txBuffermode == 1 || @sysvar::CAN_RadarRL::RRL_FieldDataCollection::txBuffermode == 2)
      {
         setTimer(RRL_FieldDataCollection_Timer,50); 
      }
      @sysvar::CAN_RadarRL::RRL_FieldDataCollection::RRL_FieldDataCollection_ON_OFF= 0;
   }
}
 


void Write_OsekTP_CRadarRL_RRL_FieldDataCollection_Small_Packet(byte byteArray[])
{
    qword raw_value = 255;
    copyBitsToByteArrayLE(raw_value, byteArray, 0, 8);
    copyBitsToByteArrayLE(raw_value, byteArray, 8, 8);
    copyBitsToByteArrayLE(raw_value, byteArray, 16, 8);
    copyBitsToByteArrayLE(raw_value, byteArray, 24, 8);
    copyBitsToByteArrayLE(raw_value, byteArray, 32, 8);
    copyBitsToByteArrayLE(raw_value, byteArray, 40, 8);
    copyBitsToByteArrayLE(raw_value, byteArray, 48, 8);
    copyBitsToByteArrayLE(raw_value, byteArray, 56, 8);
    copyBitsToByteArrayLE(7, byteArray, 64, 8);
    copyBitsToByteArrayLE(2, byteArray, 72, 8);
    for(i = 0; i < 98; i++) 
    {
      copyBitsToByteArrayLE(raw_value, byteArray, 80+(8*i), 8); 
    } 
}

void Write_OsekTP_CRadarRL_RRL_FieldDataCollection_Big_Packet(byte byteArray[])
{
    qword raw_value = 255;
    copyBitsToByteArrayLE(raw_value, byteArray, 0, 8);
    copyBitsToByteArrayLE(raw_value, byteArray, 8, 8);
    copyBitsToByteArrayLE(raw_value, byteArray, 16, 8);
    copyBitsToByteArrayLE(raw_value, byteArray, 24, 8);
    copyBitsToByteArrayLE(raw_value, byteArray, 32, 8);
    copyBitsToByteArrayLE(raw_value, byteArray, 40, 8);
    copyBitsToByteArrayLE(raw_value, byteArray, 48, 8);
    copyBitsToByteArrayLE(raw_value, byteArray, 56, 8);
    copyBitsToByteArrayLE(12, byteArray, 64, 8);
    copyBitsToByteArrayLE(4, byteArray, 72, 8);
    for(i = 0; i < 2038; i++) 
    {
      copyBitsToByteArrayLE(raw_value, byteArray, 80+(8*i), 8); 
    } 
}

on timer RRL_FieldDataCollection_Timer
{
  if (@CAN_RadarRL::RRL_FieldDataCollection::txBuffermode == 0)
  {
    if (count < 20) 
    {
     Transmit_Pdu_CRadarRL_RRL_FieldDataCollection();
     count =count+1;
     setTimer(RRL_FieldDataCollection_Timer,50);
    }
    else 
    {
     count=0;
    }
  }
  else if (@CAN_RadarRL::RRL_FieldDataCollection::txBuffermode == 1)
  {
    if (count < 5) 
    {
     Transmit_Pdu_CRadarRL_RRL_FieldDataCollection();
     count =count+1;
     setTimer(RRL_FieldDataCollection_Timer,50);
    }
    else 
    {
     count=0;
    }
  }
}

void Transmit_Pdu_CRadarRL_RRL_FieldDataCollection()
{
   long txCount ;
   pdu RRL_FieldDataCollection pdu_RRL_FieldDataCollection;
   if (@sysvar::CAN_RadarRL::RRL_FieldDataCollection::txBuffermode == 2) // Big_Packet
   {
     byte txDataBuffer[kBufferSizeJumbo_CRadarRL_RRL_FieldDataCollection_TpData_large];
     byte txDataBuffer_null[kBufferSizeJumbo_CRadarRL_RRL_FieldDataCollection_TpData_large];
     txCount = kBufferSizeJumbo_CRadarRL_RRL_FieldDataCollection_TpData_large;
     Write_OsekTP_CRadarRL_RRL_FieldDataCollection_Big_Packet(txDataBuffer);
     CanTpSendData(gHandle_CRadarRL_RRL_FieldDataCollection_TpData, txDataBuffer, txCount);
     memcpy(txDataBuffer, txDataBuffer_null, txCount);
   }
   else if(@sysvar::CAN_RadarRL::RRL_FieldDataCollection::txBuffermode == 1) //  Small_Packet
   {
     byte txDataBuffer[kBufferSizeJumbo_CRadarRL_RRL_FieldDataCollection_TpData_short];
     byte txDataBuffer_null[kBufferSizeJumbo_CRadarRL_RRL_FieldDataCollection_TpData_short];
     txCount = kBufferSizeJumbo_CRadarRL_RRL_FieldDataCollection_TpData_short;
     Write_OsekTP_CRadarRL_RRL_FieldDataCollection_Small_Packet(txDataBuffer);
     CanTpSendData(gHandle_CRadarRL_RRL_FieldDataCollection_TpData, txDataBuffer, txCount);
     memcpy(txDataBuffer, txDataBuffer_null, txCount); 
   }
   else if(@sysvar::CAN_RadarRL::RRL_FieldDataCollection::txBuffermode == 0) //  User_defined
   {
     byte txDataBuffer[kBufferSizeJumbo_CRadarRL_RRL_FieldDataCollection_TpData];
     byte sendString[kBufferSizeJumbo_CRadarRL_RRL_FieldDataCollection_TpData];
     byte txDataBuffer_null[kBufferSizeJumbo_CRadarRL_RRL_FieldDataCollection_TpData];
     byte emptyString[kBufferSizeJumbo_CRadarRL_RRL_FieldDataCollection_TpData];
     long copiedBytes; 
     long TxLength; 

     // Preparation same as sysSendData 
     TxLength = 0;
     if (sysGetVariableData(sysvar::CAN_RadarRL::RRL_FieldDataCollection::RRL_FieldDataCollection::SignalValue, sendString, copiedBytes) == 0)
     { 
       TxLength=copiedBytes; 
       memcpy( txDataBuffer, sendString, TxLength); 
     } 

     // Start of TransmitTxBuffer()
     CanTpSendData(gHandle_CRadarRL_RRL_FieldDataCollection_TpData, txDataBuffer, TxLength);
     sysSetVariableData(sysvar::CAN_RadarRL::RRL_FieldDataCollection::RRL_FieldDataCollection::SignalValue,txDataBuffer,TxLength);
     // End of TransmitTxBuffer() 

     memcpy(txDataBuffer, txDataBuffer_null, txCount); 
   }
}

on sysvar CAN_RadarRL::RRL_Object::RRL_Object_ON_OFF
{
  if ((@this == 1)&& (@hil_ctrl::ra6_rl_sgu_obj_sim == 1))
   {
      Transmit_Pdu_CRadarRL_RRL_Object();
      @sysvar::CAN_RadarRL::RRL_Object::RRL_Object_ON_OFF= 0;
   }
}
 


void RRL_Object_Obj48_write(byte byteArray[])
{
    qword raw_value;

    raw_value = convertPhysicalToRaw(@CAN_RadarRL::RRL_Object::RRL_Object_Obj48.Ay, 0.0625, -16.0);
    copyBitsToByteArrayLE(raw_value, byteArray, 25270, 9);

    raw_value = convertPhysicalToRaw(@CAN_RadarRL::RRL_Object::RRL_Object_Obj48.OrientationYawVnce, 0.0003, 0.0);
    copyBitsToByteArrayLE(raw_value, byteArray, 25228, 12);

    raw_value = convertPhysicalToRaw(@CAN_RadarRL::RRL_Object::RRL_Object_Obj48.ExistProb, 2.0, 0.0);
    copyBitsToByteArrayLE(raw_value, byteArray, 25336, 6);

    raw_value = convertPhysicalToRaw(@CAN_RadarRL::RRL_Object::RRL_Object_Obj48.MovingStatus, 1.0, 0.0);
    copyBitsToByteArrayLE(raw_value, byteArray, 25324, 2);

    raw_value = convertPhysicalToRaw(@CAN_RadarRL::RRL_Object::RRL_Object_Obj48.VxVnce, 0.005, 0.0);
    copyBitsToByteArrayLE(raw_value, byteArray, 25312, 12);

    raw_value = convertPhysicalToRaw(@CAN_RadarRL::RRL_Object::RRL_Object_Obj48.ObjId, 1.0, 0.0);
    copyBitsToByteArrayLE(raw_value, byteArray, 25304, 7);

    raw_value = convertPhysicalToRaw(@CAN_RadarRL::RRL_Object::RRL_Object_Obj48.Vx, 0.0625, -128.0);
    copyBitsToByteArrayLE(raw_value, byteArray, 25292, 12);

    raw_value = convertPhysicalToRaw(@CAN_RadarRL::RRL_Object::RRL_Object_Obj48.AyVnce, 0.005, 0.0);
    copyBitsToByteArrayLE(raw_value, byteArray, 25280, 12);

    raw_value = convertPhysicalToRaw(@CAN_RadarRL::RRL_Object::RRL_Object_Obj48.RCS, 0.2, -102.4);
    copyBitsToByteArrayLE(raw_value, byteArray, 25260, 10);

    raw_value = convertPhysicalToRaw(@CAN_RadarRL::RRL_Object::RRL_Object_Obj48.WidthVnce, 0.005, 0.0);
    copyBitsToByteArrayLE(raw_value, byteArray, 25248, 12);

    raw_value = convertPhysicalToRaw(@CAN_RadarRL::RRL_Object::RRL_Object_Obj48.Width, 0.125, 0.0);
    copyBitsToByteArrayLE(raw_value, byteArray, 25240, 7);

    raw_value = convertPhysicalToRaw(@CAN_RadarRL::RRL_Object::RRL_Object_Obj48.AxVnce, 0.005, 0.0);
    copyBitsToByteArrayLE(raw_value, byteArray, 25216, 12);

    raw_value = convertPhysicalToRaw(@CAN_RadarRL::RRL_Object::RRL_Object_Obj48.PxPyCoVnce, 0.005, -10.0);
    copyBitsToByteArrayLE(raw_value, byteArray, 25356, 12);

    raw_value = convertPhysicalToRaw(@CAN_RadarRL::RRL_Object::RRL_Object_Obj48.OrientationYaw, 0.0175, -4.48);
    copyBitsToByteArrayLE(raw_value, byteArray, 25206, 9);

    raw_value = convertPhysicalToRaw(@CAN_RadarRL::RRL_Object::RRL_Object_Obj48.Ax, 0.03125, -16.0);
    copyBitsToByteArrayLE(raw_value, byteArray, 25196, 10);

    raw_value = convertPhysicalToRaw(@CAN_RadarRL::RRL_Object::RRL_Object_Obj48.LengthVnce, 0.005, 0.0);
    copyBitsToByteArrayLE(raw_value, byteArray, 25184, 12);

    raw_value = convertPhysicalToRaw(@CAN_RadarRL::RRL_Object::RRL_Object_Obj48.Length, 0.125, 0.0);
    copyBitsToByteArrayLE(raw_value, byteArray, 25176, 7);

    raw_value = convertPhysicalToRaw(@CAN_RadarRL::RRL_Object::RRL_Object_Obj48.PyVnce, 0.005, 0.0);
    copyBitsToByteArrayLE(raw_value, byteArray, 25164, 12);

    raw_value = convertPhysicalToRaw(@CAN_RadarRL::RRL_Object::RRL_Object_Obj48.Py, 0.0625, -128.0);
    copyBitsToByteArrayLE(raw_value, byteArray, 25152, 12);

    raw_value = convertPhysicalToRaw(@CAN_RadarRL::RRL_Object::RRL_Object_Obj48.PxVnce, 0.005, 0.0);
    copyBitsToByteArrayLE(raw_value, byteArray, 25140, 12);

    raw_value = convertPhysicalToRaw(@CAN_RadarRL::RRL_Object::RRL_Object_Obj48.Px, 0.0625, -512.0);
    copyBitsToByteArrayLE(raw_value, byteArray, 25126, 14);

    raw_value = convertPhysicalToRaw(@CAN_RadarRL::RRL_Object::RRL_Object_Obj48.ProbClassConfidence, 2.0, 0.0);
    copyBitsToByteArrayLE(raw_value, byteArray, 25120, 6);

    raw_value = convertPhysicalToRaw(@CAN_RadarRL::RRL_Object::RRL_Object_Obj48.VyVnce, 0.005, 0.0);
    copyBitsToByteArrayLE(raw_value, byteArray, 25344, 12);

    raw_value = convertPhysicalToRaw(@CAN_RadarRL::RRL_Object::RRL_Object_Obj48.Vy, 0.125, -64.0);
    copyBitsToByteArrayLE(raw_value, byteArray, 25326, 10);

    raw_value = convertPhysicalToRaw(@CAN_RadarRL::RRL_Object::RRL_Object_Obj48.MeasurementStatus, 1.0, 0.0);
    copyBitsToByteArrayLE(raw_value, byteArray, 25368, 3);

    raw_value = convertPhysicalToRaw(@CAN_RadarRL::RRL_Object::RRL_Object_Obj48.PxAyCoVnce, 0.005, -10.0);
    copyBitsToByteArrayLE(raw_value, byteArray, 25452, 12);

    raw_value = convertPhysicalToRaw(@CAN_RadarRL::RRL_Object::RRL_Object_Obj48.Age, 1.0, 0.0);
    copyBitsToByteArrayLE(raw_value, byteArray, 25600, 32);

    raw_value = convertPhysicalToRaw(@CAN_RadarRL::RRL_Object::RRL_Object_Obj48.AxAyCoVnce, 0.005, -10.0);
    copyBitsToByteArrayLE(raw_value, byteArray, 25580, 12);

    raw_value = convertPhysicalToRaw(@CAN_RadarRL::RRL_Object::RRL_Object_Obj48.VyAyCoVnce, 0.005, -10.0);
    copyBitsToByteArrayLE(raw_value, byteArray, 25568, 12);

    raw_value = convertPhysicalToRaw(@CAN_RadarRL::RRL_Object::RRL_Object_Obj48.VyAxCoVnce, 0.005, -10.0);
    copyBitsToByteArrayLE(raw_value, byteArray, 25548, 12);

    raw_value = convertPhysicalToRaw(@CAN_RadarRL::RRL_Object::RRL_Object_Obj48.VxAyCoVnce, 0.005, -10.0);
    copyBitsToByteArrayLE(raw_value, byteArray, 25536, 12);

    raw_value = convertPhysicalToRaw(@CAN_RadarRL::RRL_Object::RRL_Object_Obj48.ProbClassType, 1.0, 0.0);
    copyBitsToByteArrayLE(raw_value, byteArray, 25371, 4);

    raw_value = convertPhysicalToRaw(@CAN_RadarRL::RRL_Object::RRL_Object_Obj48.VxVyCoVnce, 0.005, -10.0);
    copyBitsToByteArrayLE(raw_value, byteArray, 25504, 12);

    raw_value = convertPhysicalToRaw(@CAN_RadarRL::RRL_Object::RRL_Object_Obj48.PyAyCoVnce, 0.005, -10.0);
    copyBitsToByteArrayLE(raw_value, byteArray, 25484, 12);

    raw_value = convertPhysicalToRaw(@CAN_RadarRL::RRL_Object::RRL_Object_Obj48.PyAxCoVnce, 0.005, -10.0);
    copyBitsToByteArrayLE(raw_value, byteArray, 25472, 12);

    raw_value = convertPhysicalToRaw(@CAN_RadarRL::RRL_Object::RRL_Object_Obj48.VxAxCoVnce, 0.005, -10.0);
    copyBitsToByteArrayLE(raw_value, byteArray, 25516, 12);

    raw_value = convertPhysicalToRaw(@CAN_RadarRL::RRL_Object::RRL_Object_Obj48.PxAxCoVnce, 0.005, -10.0);
    copyBitsToByteArrayLE(raw_value, byteArray, 25440, 12);

    raw_value = convertPhysicalToRaw(@CAN_RadarRL::RRL_Object::RRL_Object_Obj48.ReferencePoint, 1.0, 0.0);
    copyBitsToByteArrayLE(raw_value, byteArray, 25432, 4);

    raw_value = convertPhysicalToRaw(@CAN_RadarRL::RRL_Object::RRL_Object_Obj48.PyVyCoVnce, 0.005, -10.0);
    copyBitsToByteArrayLE(raw_value, byteArray, 25420, 12);

    raw_value = convertPhysicalToRaw(@CAN_RadarRL::RRL_Object::RRL_Object_Obj48.PyVxCoVnce, 0.005, -10.0);
    copyBitsToByteArrayLE(raw_value, byteArray, 25408, 12);

    raw_value = convertPhysicalToRaw(@CAN_RadarRL::RRL_Object::RRL_Object_Obj48.FilterInformation, 1.0, 0.0);
    copyBitsToByteArrayLE(raw_value, byteArray, 25400, 8);

    raw_value = convertPhysicalToRaw(@CAN_RadarRL::RRL_Object::RRL_Object_Obj48.PxVyCoVnce, 0.005, -10.0);
    copyBitsToByteArrayLE(raw_value, byteArray, 25388, 12);

    raw_value = convertPhysicalToRaw(@CAN_RadarRL::RRL_Object::RRL_Object_Obj48.PxVxCoVnce, 0.005, -10.0);
    copyBitsToByteArrayLE(raw_value, byteArray, 25376, 12);
}


void RRL_Object_Obj47_write(byte byteArray[])
{
    qword raw_value;

    raw_value = convertPhysicalToRaw(@CAN_RadarRL::RRL_Object::RRL_Object_Obj47.ObjId, 1.0, 0.0);
    copyBitsToByteArrayLE(raw_value, byteArray, 24792, 7);

    raw_value = convertPhysicalToRaw(@CAN_RadarRL::RRL_Object::RRL_Object_Obj47.WidthVnce, 0.005, 0.0);
    copyBitsToByteArrayLE(raw_value, byteArray, 24736, 12);

    raw_value = convertPhysicalToRaw(@CAN_RadarRL::RRL_Object::RRL_Object_Obj47.RCS, 0.2, -102.4);
    copyBitsToByteArrayLE(raw_value, byteArray, 24748, 10);

    raw_value = convertPhysicalToRaw(@CAN_RadarRL::RRL_Object::RRL_Object_Obj47.Ay, 0.0625, -16.0);
    copyBitsToByteArrayLE(raw_value, byteArray, 24758, 9);

    raw_value = convertPhysicalToRaw(@CAN_RadarRL::RRL_Object::RRL_Object_Obj47.Vx, 0.0625, -128.0);
    copyBitsToByteArrayLE(raw_value, byteArray, 24780, 12);

    raw_value = convertPhysicalToRaw(@CAN_RadarRL::RRL_Object::RRL_Object_Obj47.MovingStatus, 1.0, 0.0);
    copyBitsToByteArrayLE(raw_value, byteArray, 24812, 2);

    raw_value = convertPhysicalToRaw(@CAN_RadarRL::RRL_Object::RRL_Object_Obj47.ExistProb, 2.0, 0.0);
    copyBitsToByteArrayLE(raw_value, byteArray, 24824, 6);

    raw_value = convertPhysicalToRaw(@CAN_RadarRL::RRL_Object::RRL_Object_Obj47.Vy, 0.125, -64.0);
    copyBitsToByteArrayLE(raw_value, byteArray, 24814, 10);

    raw_value = convertPhysicalToRaw(@CAN_RadarRL::RRL_Object::RRL_Object_Obj47.VxVnce, 0.005, 0.0);
    copyBitsToByteArrayLE(raw_value, byteArray, 24800, 12);

    raw_value = convertPhysicalToRaw(@CAN_RadarRL::RRL_Object::RRL_Object_Obj47.OrientationYawVnce, 0.0003, 0.0);
    copyBitsToByteArrayLE(raw_value, byteArray, 24716, 12);

    raw_value = convertPhysicalToRaw(@CAN_RadarRL::RRL_Object::RRL_Object_Obj47.Width, 0.125, 0.0);
    copyBitsToByteArrayLE(raw_value, byteArray, 24728, 7);

    raw_value = convertPhysicalToRaw(@CAN_RadarRL::RRL_Object::RRL_Object_Obj47.AyVnce, 0.005, 0.0);
    copyBitsToByteArrayLE(raw_value, byteArray, 24768, 12);

    raw_value = convertPhysicalToRaw(@CAN_RadarRL::RRL_Object::RRL_Object_Obj47.AxVnce, 0.005, 0.0);
    copyBitsToByteArrayLE(raw_value, byteArray, 24704, 12);

    raw_value = convertPhysicalToRaw(@CAN_RadarRL::RRL_Object::RRL_Object_Obj47.OrientationYaw, 0.0175, -4.48);
    copyBitsToByteArrayLE(raw_value, byteArray, 24694, 9);

    raw_value = convertPhysicalToRaw(@CAN_RadarRL::RRL_Object::RRL_Object_Obj47.Ax, 0.03125, -16.0);
    copyBitsToByteArrayLE(raw_value, byteArray, 24684, 10);

    raw_value = convertPhysicalToRaw(@CAN_RadarRL::RRL_Object::RRL_Object_Obj47.LengthVnce, 0.005, 0.0);
    copyBitsToByteArrayLE(raw_value, byteArray, 24672, 12);

    raw_value = convertPhysicalToRaw(@CAN_RadarRL::RRL_Object::RRL_Object_Obj47.Length, 0.125, 0.0);
    copyBitsToByteArrayLE(raw_value, byteArray, 24664, 7);

    raw_value = convertPhysicalToRaw(@CAN_RadarRL::RRL_Object::RRL_Object_Obj47.PyVnce, 0.005, 0.0);
    copyBitsToByteArrayLE(raw_value, byteArray, 24652, 12);

    raw_value = convertPhysicalToRaw(@CAN_RadarRL::RRL_Object::RRL_Object_Obj47.Py, 0.0625, -128.0);
    copyBitsToByteArrayLE(raw_value, byteArray, 24640, 12);

    raw_value = convertPhysicalToRaw(@CAN_RadarRL::RRL_Object::RRL_Object_Obj47.PxPyCoVnce, 0.005, -10.0);
    copyBitsToByteArrayLE(raw_value, byteArray, 24844, 12);

    raw_value = convertPhysicalToRaw(@CAN_RadarRL::RRL_Object::RRL_Object_Obj47.PxVnce, 0.005, 0.0);
    copyBitsToByteArrayLE(raw_value, byteArray, 24628, 12);

    raw_value = convertPhysicalToRaw(@CAN_RadarRL::RRL_Object::RRL_Object_Obj47.Px, 0.0625, -512.0);
    copyBitsToByteArrayLE(raw_value, byteArray, 24614, 14);

    raw_value = convertPhysicalToRaw(@CAN_RadarRL::RRL_Object::RRL_Object_Obj47.ProbClassConfidence, 2.0, 0.0);
    copyBitsToByteArrayLE(raw_value, byteArray, 24608, 6);

    raw_value = convertPhysicalToRaw(@CAN_RadarRL::RRL_Object::RRL_Object_Obj47.VyVnce, 0.005, 0.0);
    copyBitsToByteArrayLE(raw_value, byteArray, 24832, 12);

    raw_value = convertPhysicalToRaw(@CAN_RadarRL::RRL_Object::RRL_Object_Obj47.VxVyCoVnce, 0.005, -10.0);
    copyBitsToByteArrayLE(raw_value, byteArray, 24992, 12);

    raw_value = convertPhysicalToRaw(@CAN_RadarRL::RRL_Object::RRL_Object_Obj47.MeasurementStatus, 1.0, 0.0);
    copyBitsToByteArrayLE(raw_value, byteArray, 24856, 3);

    raw_value = convertPhysicalToRaw(@CAN_RadarRL::RRL_Object::RRL_Object_Obj47.PxAyCoVnce, 0.005, -10.0);
    copyBitsToByteArrayLE(raw_value, byteArray, 24940, 12);

    raw_value = convertPhysicalToRaw(@CAN_RadarRL::RRL_Object::RRL_Object_Obj47.ProbClassType, 1.0, 0.0);
    copyBitsToByteArrayLE(raw_value, byteArray, 24859, 4);

    raw_value = convertPhysicalToRaw(@CAN_RadarRL::RRL_Object::RRL_Object_Obj47.Age, 1.0, 0.0);
    copyBitsToByteArrayLE(raw_value, byteArray, 25088, 32);

    raw_value = convertPhysicalToRaw(@CAN_RadarRL::RRL_Object::RRL_Object_Obj47.AxAyCoVnce, 0.005, -10.0);
    copyBitsToByteArrayLE(raw_value, byteArray, 25068, 12);

    raw_value = convertPhysicalToRaw(@CAN_RadarRL::RRL_Object::RRL_Object_Obj47.VyAyCoVnce, 0.005, -10.0);
    copyBitsToByteArrayLE(raw_value, byteArray, 25056, 12);

    raw_value = convertPhysicalToRaw(@CAN_RadarRL::RRL_Object::RRL_Object_Obj47.VyAxCoVnce, 0.005, -10.0);
    copyBitsToByteArrayLE(raw_value, byteArray, 25036, 12);

    raw_value = convertPhysicalToRaw(@CAN_RadarRL::RRL_Object::RRL_Object_Obj47.VxAyCoVnce, 0.005, -10.0);
    copyBitsToByteArrayLE(raw_value, byteArray, 25024, 12);

    raw_value = convertPhysicalToRaw(@CAN_RadarRL::RRL_Object::RRL_Object_Obj47.PyAyCoVnce, 0.005, -10.0);
    copyBitsToByteArrayLE(raw_value, byteArray, 24972, 12);

    raw_value = convertPhysicalToRaw(@CAN_RadarRL::RRL_Object::RRL_Object_Obj47.PyAxCoVnce, 0.005, -10.0);
    copyBitsToByteArrayLE(raw_value, byteArray, 24960, 12);

    raw_value = convertPhysicalToRaw(@CAN_RadarRL::RRL_Object::RRL_Object_Obj47.VxAxCoVnce, 0.005, -10.0);
    copyBitsToByteArrayLE(raw_value, byteArray, 25004, 12);

    raw_value = convertPhysicalToRaw(@CAN_RadarRL::RRL_Object::RRL_Object_Obj47.PxAxCoVnce, 0.005, -10.0);
    copyBitsToByteArrayLE(raw_value, byteArray, 24928, 12);

    raw_value = convertPhysicalToRaw(@CAN_RadarRL::RRL_Object::RRL_Object_Obj47.PyVxCoVnce, 0.005, -10.0);
    copyBitsToByteArrayLE(raw_value, byteArray, 24896, 12);

    raw_value = convertPhysicalToRaw(@CAN_RadarRL::RRL_Object::RRL_Object_Obj47.PxVxCoVnce, 0.005, -10.0);
    copyBitsToByteArrayLE(raw_value, byteArray, 24864, 12);

    raw_value = convertPhysicalToRaw(@CAN_RadarRL::RRL_Object::RRL_Object_Obj47.ReferencePoint, 1.0, 0.0);
    copyBitsToByteArrayLE(raw_value, byteArray, 24920, 4);

    raw_value = convertPhysicalToRaw(@CAN_RadarRL::RRL_Object::RRL_Object_Obj47.FilterInformation, 1.0, 0.0);
    copyBitsToByteArrayLE(raw_value, byteArray, 24888, 8);

    raw_value = convertPhysicalToRaw(@CAN_RadarRL::RRL_Object::RRL_Object_Obj47.PxVyCoVnce, 0.005, -10.0);
    copyBitsToByteArrayLE(raw_value, byteArray, 24876, 12);

    raw_value = convertPhysicalToRaw(@CAN_RadarRL::RRL_Object::RRL_Object_Obj47.PyVyCoVnce, 0.005, -10.0);
    copyBitsToByteArrayLE(raw_value, byteArray, 24908, 12);
}


void RRL_Object_Obj46_write(byte byteArray[])
{
    qword raw_value;

    raw_value = convertPhysicalToRaw(@CAN_RadarRL::RRL_Object::RRL_Object_Obj46.PxPyCoVnce, 0.005, -10.0);
    copyBitsToByteArrayLE(raw_value, byteArray, 24332, 12);

    raw_value = convertPhysicalToRaw(@CAN_RadarRL::RRL_Object::RRL_Object_Obj46.OrientationYaw, 0.0175, -4.48);
    copyBitsToByteArrayLE(raw_value, byteArray, 24182, 9);

    raw_value = convertPhysicalToRaw(@CAN_RadarRL::RRL_Object::RRL_Object_Obj46.VyVnce, 0.005, 0.0);
    copyBitsToByteArrayLE(raw_value, byteArray, 24320, 12);

    raw_value = convertPhysicalToRaw(@CAN_RadarRL::RRL_Object::RRL_Object_Obj46.ExistProb, 2.0, 0.0);
    copyBitsToByteArrayLE(raw_value, byteArray, 24312, 6);

    raw_value = convertPhysicalToRaw(@CAN_RadarRL::RRL_Object::RRL_Object_Obj46.Ay, 0.0625, -16.0);
    copyBitsToByteArrayLE(raw_value, byteArray, 24246, 9);

    raw_value = convertPhysicalToRaw(@CAN_RadarRL::RRL_Object::RRL_Object_Obj46.RCS, 0.2, -102.4);
    copyBitsToByteArrayLE(raw_value, byteArray, 24236, 10);

    raw_value = convertPhysicalToRaw(@CAN_RadarRL::RRL_Object::RRL_Object_Obj46.WidthVnce, 0.005, 0.0);
    copyBitsToByteArrayLE(raw_value, byteArray, 24224, 12);

    raw_value = convertPhysicalToRaw(@CAN_RadarRL::RRL_Object::RRL_Object_Obj46.Width, 0.125, 0.0);
    copyBitsToByteArrayLE(raw_value, byteArray, 24216, 7);

    raw_value = convertPhysicalToRaw(@CAN_RadarRL::RRL_Object::RRL_Object_Obj46.OrientationYawVnce, 0.0003, 0.0);
    copyBitsToByteArrayLE(raw_value, byteArray, 24204, 12);

    raw_value = convertPhysicalToRaw(@CAN_RadarRL::RRL_Object::RRL_Object_Obj46.AxVnce, 0.005, 0.0);
    copyBitsToByteArrayLE(raw_value, byteArray, 24192, 12);

    raw_value = convertPhysicalToRaw(@CAN_RadarRL::RRL_Object::RRL_Object_Obj46.ProbClassConfidence, 2.0, 0.0);
    copyBitsToByteArrayLE(raw_value, byteArray, 24096, 6);

    raw_value = convertPhysicalToRaw(@CAN_RadarRL::RRL_Object::RRL_Object_Obj46.Ax, 0.03125, -16.0);
    copyBitsToByteArrayLE(raw_value, byteArray, 24172, 10);

    raw_value = convertPhysicalToRaw(@CAN_RadarRL::RRL_Object::RRL_Object_Obj46.LengthVnce, 0.005, 0.0);
    copyBitsToByteArrayLE(raw_value, byteArray, 24160, 12);

    raw_value = convertPhysicalToRaw(@CAN_RadarRL::RRL_Object::RRL_Object_Obj46.Length, 0.125, 0.0);
    copyBitsToByteArrayLE(raw_value, byteArray, 24152, 7);

    raw_value = convertPhysicalToRaw(@CAN_RadarRL::RRL_Object::RRL_Object_Obj46.PyVnce, 0.005, 0.0);
    copyBitsToByteArrayLE(raw_value, byteArray, 24140, 12);

    raw_value = convertPhysicalToRaw(@CAN_RadarRL::RRL_Object::RRL_Object_Obj46.Py, 0.0625, -128.0);
    copyBitsToByteArrayLE(raw_value, byteArray, 24128, 12);

    raw_value = convertPhysicalToRaw(@CAN_RadarRL::RRL_Object::RRL_Object_Obj46.PxVnce, 0.005, 0.0);
    copyBitsToByteArrayLE(raw_value, byteArray, 24116, 12);

    raw_value = convertPhysicalToRaw(@CAN_RadarRL::RRL_Object::RRL_Object_Obj46.MovingStatus, 1.0, 0.0);
    copyBitsToByteArrayLE(raw_value, byteArray, 24300, 2);

    raw_value = convertPhysicalToRaw(@CAN_RadarRL::RRL_Object::RRL_Object_Obj46.Vy, 0.125, -64.0);
    copyBitsToByteArrayLE(raw_value, byteArray, 24302, 10);

    raw_value = convertPhysicalToRaw(@CAN_RadarRL::RRL_Object::RRL_Object_Obj46.ProbClassType, 1.0, 0.0);
    copyBitsToByteArrayLE(raw_value, byteArray, 24347, 4);

    raw_value = convertPhysicalToRaw(@CAN_RadarRL::RRL_Object::RRL_Object_Obj46.Px, 0.0625, -512.0);
    copyBitsToByteArrayLE(raw_value, byteArray, 24102, 14);

    raw_value = convertPhysicalToRaw(@CAN_RadarRL::RRL_Object::RRL_Object_Obj46.MeasurementStatus, 1.0, 0.0);
    copyBitsToByteArrayLE(raw_value, byteArray, 24344, 3);

    raw_value = convertPhysicalToRaw(@CAN_RadarRL::RRL_Object::RRL_Object_Obj46.VxVnce, 0.005, 0.0);
    copyBitsToByteArrayLE(raw_value, byteArray, 24288, 12);

    raw_value = convertPhysicalToRaw(@CAN_RadarRL::RRL_Object::RRL_Object_Obj46.PxVxCoVnce, 0.005, -10.0);
    copyBitsToByteArrayLE(raw_value, byteArray, 24352, 12);

    raw_value = convertPhysicalToRaw(@CAN_RadarRL::RRL_Object::RRL_Object_Obj46.VxAxCoVnce, 0.005, -10.0);
    copyBitsToByteArrayLE(raw_value, byteArray, 24492, 12);

    raw_value = convertPhysicalToRaw(@CAN_RadarRL::RRL_Object::RRL_Object_Obj46.PxVyCoVnce, 0.005, -10.0);
    copyBitsToByteArrayLE(raw_value, byteArray, 24364, 12);

    raw_value = convertPhysicalToRaw(@CAN_RadarRL::RRL_Object::RRL_Object_Obj46.Vx, 0.0625, -128.0);
    copyBitsToByteArrayLE(raw_value, byteArray, 24268, 12);

    raw_value = convertPhysicalToRaw(@CAN_RadarRL::RRL_Object::RRL_Object_Obj46.AyVnce, 0.005, 0.0);
    copyBitsToByteArrayLE(raw_value, byteArray, 24256, 12);

    raw_value = convertPhysicalToRaw(@CAN_RadarRL::RRL_Object::RRL_Object_Obj46.Age, 1.0, 0.0);
    copyBitsToByteArrayLE(raw_value, byteArray, 24576, 32);

    raw_value = convertPhysicalToRaw(@CAN_RadarRL::RRL_Object::RRL_Object_Obj46.AxAyCoVnce, 0.005, -10.0);
    copyBitsToByteArrayLE(raw_value, byteArray, 24556, 12);

    raw_value = convertPhysicalToRaw(@CAN_RadarRL::RRL_Object::RRL_Object_Obj46.VyAyCoVnce, 0.005, -10.0);
    copyBitsToByteArrayLE(raw_value, byteArray, 24544, 12);

    raw_value = convertPhysicalToRaw(@CAN_RadarRL::RRL_Object::RRL_Object_Obj46.VyAxCoVnce, 0.005, -10.0);
    copyBitsToByteArrayLE(raw_value, byteArray, 24524, 12);

    raw_value = convertPhysicalToRaw(@CAN_RadarRL::RRL_Object::RRL_Object_Obj46.VxAyCoVnce, 0.005, -10.0);
    copyBitsToByteArrayLE(raw_value, byteArray, 24512, 12);

    raw_value = convertPhysicalToRaw(@CAN_RadarRL::RRL_Object::RRL_Object_Obj46.ObjId, 1.0, 0.0);
    copyBitsToByteArrayLE(raw_value, byteArray, 24280, 7);

    raw_value = convertPhysicalToRaw(@CAN_RadarRL::RRL_Object::RRL_Object_Obj46.VxVyCoVnce, 0.005, -10.0);
    copyBitsToByteArrayLE(raw_value, byteArray, 24480, 12);

    raw_value = convertPhysicalToRaw(@CAN_RadarRL::RRL_Object::RRL_Object_Obj46.ReferencePoint, 1.0, 0.0);
    copyBitsToByteArrayLE(raw_value, byteArray, 24408, 4);

    raw_value = convertPhysicalToRaw(@CAN_RadarRL::RRL_Object::RRL_Object_Obj46.PyAyCoVnce, 0.005, -10.0);
    copyBitsToByteArrayLE(raw_value, byteArray, 24460, 12);

    raw_value = convertPhysicalToRaw(@CAN_RadarRL::RRL_Object::RRL_Object_Obj46.PyVxCoVnce, 0.005, -10.0);
    copyBitsToByteArrayLE(raw_value, byteArray, 24384, 12);

    raw_value = convertPhysicalToRaw(@CAN_RadarRL::RRL_Object::RRL_Object_Obj46.PyVyCoVnce, 0.005, -10.0);
    copyBitsToByteArrayLE(raw_value, byteArray, 24396, 12);

    raw_value = convertPhysicalToRaw(@CAN_RadarRL::RRL_Object::RRL_Object_Obj46.FilterInformation, 1.0, 0.0);
    copyBitsToByteArrayLE(raw_value, byteArray, 24376, 8);

    raw_value = convertPhysicalToRaw(@CAN_RadarRL::RRL_Object::RRL_Object_Obj46.PxAxCoVnce, 0.005, -10.0);
    copyBitsToByteArrayLE(raw_value, byteArray, 24416, 12);

    raw_value = convertPhysicalToRaw(@CAN_RadarRL::RRL_Object::RRL_Object_Obj46.PxAyCoVnce, 0.005, -10.0);
    copyBitsToByteArrayLE(raw_value, byteArray, 24428, 12);

    raw_value = convertPhysicalToRaw(@CAN_RadarRL::RRL_Object::RRL_Object_Obj46.PyAxCoVnce, 0.005, -10.0);
    copyBitsToByteArrayLE(raw_value, byteArray, 24448, 12);
}


void RRL_Object_Obj45_write(byte byteArray[])
{
    qword raw_value;

    raw_value = convertPhysicalToRaw(@CAN_RadarRL::RRL_Object::RRL_Object_Obj45.VxVnce, 0.005, 0.0);
    copyBitsToByteArrayLE(raw_value, byteArray, 23776, 12);

    raw_value = convertPhysicalToRaw(@CAN_RadarRL::RRL_Object::RRL_Object_Obj45.AxVnce, 0.005, 0.0);
    copyBitsToByteArrayLE(raw_value, byteArray, 23680, 12);

    raw_value = convertPhysicalToRaw(@CAN_RadarRL::RRL_Object::RRL_Object_Obj45.ObjId, 1.0, 0.0);
    copyBitsToByteArrayLE(raw_value, byteArray, 23768, 7);

    raw_value = convertPhysicalToRaw(@CAN_RadarRL::RRL_Object::RRL_Object_Obj45.Vx, 0.0625, -128.0);
    copyBitsToByteArrayLE(raw_value, byteArray, 23756, 12);

    raw_value = convertPhysicalToRaw(@CAN_RadarRL::RRL_Object::RRL_Object_Obj45.AyVnce, 0.005, 0.0);
    copyBitsToByteArrayLE(raw_value, byteArray, 23744, 12);

    raw_value = convertPhysicalToRaw(@CAN_RadarRL::RRL_Object::RRL_Object_Obj45.Ay, 0.0625, -16.0);
    copyBitsToByteArrayLE(raw_value, byteArray, 23734, 9);

    raw_value = convertPhysicalToRaw(@CAN_RadarRL::RRL_Object::RRL_Object_Obj45.RCS, 0.2, -102.4);
    copyBitsToByteArrayLE(raw_value, byteArray, 23724, 10);

    raw_value = convertPhysicalToRaw(@CAN_RadarRL::RRL_Object::RRL_Object_Obj45.WidthVnce, 0.005, 0.0);
    copyBitsToByteArrayLE(raw_value, byteArray, 23712, 12);

    raw_value = convertPhysicalToRaw(@CAN_RadarRL::RRL_Object::RRL_Object_Obj45.Width, 0.125, 0.0);
    copyBitsToByteArrayLE(raw_value, byteArray, 23704, 7);

    raw_value = convertPhysicalToRaw(@CAN_RadarRL::RRL_Object::RRL_Object_Obj45.OrientationYawVnce, 0.0003, 0.0);
    copyBitsToByteArrayLE(raw_value, byteArray, 23692, 12);

    raw_value = convertPhysicalToRaw(@CAN_RadarRL::RRL_Object::RRL_Object_Obj45.Length, 0.125, 0.0);
    copyBitsToByteArrayLE(raw_value, byteArray, 23640, 7);

    raw_value = convertPhysicalToRaw(@CAN_RadarRL::RRL_Object::RRL_Object_Obj45.OrientationYaw, 0.0175, -4.48);
    copyBitsToByteArrayLE(raw_value, byteArray, 23670, 9);

    raw_value = convertPhysicalToRaw(@CAN_RadarRL::RRL_Object::RRL_Object_Obj45.Ax, 0.03125, -16.0);
    copyBitsToByteArrayLE(raw_value, byteArray, 23660, 10);

    raw_value = convertPhysicalToRaw(@CAN_RadarRL::RRL_Object::RRL_Object_Obj45.LengthVnce, 0.005, 0.0);
    copyBitsToByteArrayLE(raw_value, byteArray, 23648, 12);

    raw_value = convertPhysicalToRaw(@CAN_RadarRL::RRL_Object::RRL_Object_Obj45.PyVnce, 0.005, 0.0);
    copyBitsToByteArrayLE(raw_value, byteArray, 23628, 12);

    raw_value = convertPhysicalToRaw(@CAN_RadarRL::RRL_Object::RRL_Object_Obj45.Py, 0.0625, -128.0);
    copyBitsToByteArrayLE(raw_value, byteArray, 23616, 12);

    raw_value = convertPhysicalToRaw(@CAN_RadarRL::RRL_Object::RRL_Object_Obj45.PxVnce, 0.005, 0.0);
    copyBitsToByteArrayLE(raw_value, byteArray, 23604, 12);

    raw_value = convertPhysicalToRaw(@CAN_RadarRL::RRL_Object::RRL_Object_Obj45.Px, 0.0625, -512.0);
    copyBitsToByteArrayLE(raw_value, byteArray, 23590, 14);

    raw_value = convertPhysicalToRaw(@CAN_RadarRL::RRL_Object::RRL_Object_Obj45.ProbClassConfidence, 2.0, 0.0);
    copyBitsToByteArrayLE(raw_value, byteArray, 23584, 6);

    raw_value = convertPhysicalToRaw(@CAN_RadarRL::RRL_Object::RRL_Object_Obj45.Vy, 0.125, -64.0);
    copyBitsToByteArrayLE(raw_value, byteArray, 23790, 10);

    raw_value = convertPhysicalToRaw(@CAN_RadarRL::RRL_Object::RRL_Object_Obj45.MovingStatus, 1.0, 0.0);
    copyBitsToByteArrayLE(raw_value, byteArray, 23788, 2);

    raw_value = convertPhysicalToRaw(@CAN_RadarRL::RRL_Object::RRL_Object_Obj45.ReferencePoint, 1.0, 0.0);
    copyBitsToByteArrayLE(raw_value, byteArray, 23896, 4);

    raw_value = convertPhysicalToRaw(@CAN_RadarRL::RRL_Object::RRL_Object_Obj45.ExistProb, 2.0, 0.0);
    copyBitsToByteArrayLE(raw_value, byteArray, 23800, 6);

    raw_value = convertPhysicalToRaw(@CAN_RadarRL::RRL_Object::RRL_Object_Obj45.PxAxCoVnce, 0.005, -10.0);
    copyBitsToByteArrayLE(raw_value, byteArray, 23904, 12);

    raw_value = convertPhysicalToRaw(@CAN_RadarRL::RRL_Object::RRL_Object_Obj45.AxAyCoVnce, 0.005, -10.0);
    copyBitsToByteArrayLE(raw_value, byteArray, 24044, 12);

    raw_value = convertPhysicalToRaw(@CAN_RadarRL::RRL_Object::RRL_Object_Obj45.VyAyCoVnce, 0.005, -10.0);
    copyBitsToByteArrayLE(raw_value, byteArray, 24032, 12);

    raw_value = convertPhysicalToRaw(@CAN_RadarRL::RRL_Object::RRL_Object_Obj45.VyAxCoVnce, 0.005, -10.0);
    copyBitsToByteArrayLE(raw_value, byteArray, 24012, 12);

    raw_value = convertPhysicalToRaw(@CAN_RadarRL::RRL_Object::RRL_Object_Obj45.VxAyCoVnce, 0.005, -10.0);
    copyBitsToByteArrayLE(raw_value, byteArray, 24000, 12);

    raw_value = convertPhysicalToRaw(@CAN_RadarRL::RRL_Object::RRL_Object_Obj45.VxAxCoVnce, 0.005, -10.0);
    copyBitsToByteArrayLE(raw_value, byteArray, 23980, 12);

    raw_value = convertPhysicalToRaw(@CAN_RadarRL::RRL_Object::RRL_Object_Obj45.VxVyCoVnce, 0.005, -10.0);
    copyBitsToByteArrayLE(raw_value, byteArray, 23968, 12);

    raw_value = convertPhysicalToRaw(@CAN_RadarRL::RRL_Object::RRL_Object_Obj45.PyAyCoVnce, 0.005, -10.0);
    copyBitsToByteArrayLE(raw_value, byteArray, 23948, 12);

    raw_value = convertPhysicalToRaw(@CAN_RadarRL::RRL_Object::RRL_Object_Obj45.PyAxCoVnce, 0.005, -10.0);
    copyBitsToByteArrayLE(raw_value, byteArray, 23936, 12);

    raw_value = convertPhysicalToRaw(@CAN_RadarRL::RRL_Object::RRL_Object_Obj45.PxAyCoVnce, 0.005, -10.0);
    copyBitsToByteArrayLE(raw_value, byteArray, 23916, 12);

    raw_value = convertPhysicalToRaw(@CAN_RadarRL::RRL_Object::RRL_Object_Obj45.VyVnce, 0.005, 0.0);
    copyBitsToByteArrayLE(raw_value, byteArray, 23808, 12);

    raw_value = convertPhysicalToRaw(@CAN_RadarRL::RRL_Object::RRL_Object_Obj45.Age, 1.0, 0.0);
    copyBitsToByteArrayLE(raw_value, byteArray, 24064, 32);

    raw_value = convertPhysicalToRaw(@CAN_RadarRL::RRL_Object::RRL_Object_Obj45.PxVxCoVnce, 0.005, -10.0);
    copyBitsToByteArrayLE(raw_value, byteArray, 23840, 12);

    raw_value = convertPhysicalToRaw(@CAN_RadarRL::RRL_Object::RRL_Object_Obj45.PyVyCoVnce, 0.005, -10.0);
    copyBitsToByteArrayLE(raw_value, byteArray, 23884, 12);

    raw_value = convertPhysicalToRaw(@CAN_RadarRL::RRL_Object::RRL_Object_Obj45.MeasurementStatus, 1.0, 0.0);
    copyBitsToByteArrayLE(raw_value, byteArray, 23832, 3);

    raw_value = convertPhysicalToRaw(@CAN_RadarRL::RRL_Object::RRL_Object_Obj45.ProbClassType, 1.0, 0.0);
    copyBitsToByteArrayLE(raw_value, byteArray, 23835, 4);

    raw_value = convertPhysicalToRaw(@CAN_RadarRL::RRL_Object::RRL_Object_Obj45.PxPyCoVnce, 0.005, -10.0);
    copyBitsToByteArrayLE(raw_value, byteArray, 23820, 12);

    raw_value = convertPhysicalToRaw(@CAN_RadarRL::RRL_Object::RRL_Object_Obj45.PxVyCoVnce, 0.005, -10.0);
    copyBitsToByteArrayLE(raw_value, byteArray, 23852, 12);

    raw_value = convertPhysicalToRaw(@CAN_RadarRL::RRL_Object::RRL_Object_Obj45.FilterInformation, 1.0, 0.0);
    copyBitsToByteArrayLE(raw_value, byteArray, 23864, 8);

    raw_value = convertPhysicalToRaw(@CAN_RadarRL::RRL_Object::RRL_Object_Obj45.PyVxCoVnce, 0.005, -10.0);
    copyBitsToByteArrayLE(raw_value, byteArray, 23872, 12);
}


void RRL_Object_Obj44_write(byte byteArray[])
{
    qword raw_value;

    raw_value = convertPhysicalToRaw(@CAN_RadarRL::RRL_Object::RRL_Object_Obj44.ObjId, 1.0, 0.0);
    copyBitsToByteArrayLE(raw_value, byteArray, 23256, 7);

    raw_value = convertPhysicalToRaw(@CAN_RadarRL::RRL_Object::RRL_Object_Obj44.AxVnce, 0.005, 0.0);
    copyBitsToByteArrayLE(raw_value, byteArray, 23168, 12);

    raw_value = convertPhysicalToRaw(@CAN_RadarRL::RRL_Object::RRL_Object_Obj44.Vx, 0.0625, -128.0);
    copyBitsToByteArrayLE(raw_value, byteArray, 23244, 12);

    raw_value = convertPhysicalToRaw(@CAN_RadarRL::RRL_Object::RRL_Object_Obj44.AyVnce, 0.005, 0.0);
    copyBitsToByteArrayLE(raw_value, byteArray, 23232, 12);

    raw_value = convertPhysicalToRaw(@CAN_RadarRL::RRL_Object::RRL_Object_Obj44.Ay, 0.0625, -16.0);
    copyBitsToByteArrayLE(raw_value, byteArray, 23222, 9);

    raw_value = convertPhysicalToRaw(@CAN_RadarRL::RRL_Object::RRL_Object_Obj44.RCS, 0.2, -102.4);
    copyBitsToByteArrayLE(raw_value, byteArray, 23212, 10);

    raw_value = convertPhysicalToRaw(@CAN_RadarRL::RRL_Object::RRL_Object_Obj44.WidthVnce, 0.005, 0.0);
    copyBitsToByteArrayLE(raw_value, byteArray, 23200, 12);

    raw_value = convertPhysicalToRaw(@CAN_RadarRL::RRL_Object::RRL_Object_Obj44.Width, 0.125, 0.0);
    copyBitsToByteArrayLE(raw_value, byteArray, 23192, 7);

    raw_value = convertPhysicalToRaw(@CAN_RadarRL::RRL_Object::RRL_Object_Obj44.OrientationYawVnce, 0.0003, 0.0);
    copyBitsToByteArrayLE(raw_value, byteArray, 23180, 12);

    raw_value = convertPhysicalToRaw(@CAN_RadarRL::RRL_Object::RRL_Object_Obj44.PyVnce, 0.005, 0.0);
    copyBitsToByteArrayLE(raw_value, byteArray, 23116, 12);

    raw_value = convertPhysicalToRaw(@CAN_RadarRL::RRL_Object::RRL_Object_Obj44.OrientationYaw, 0.0175, -4.48);
    copyBitsToByteArrayLE(raw_value, byteArray, 23158, 9);

    raw_value = convertPhysicalToRaw(@CAN_RadarRL::RRL_Object::RRL_Object_Obj44.Ax, 0.03125, -16.0);
    copyBitsToByteArrayLE(raw_value, byteArray, 23148, 10);

    raw_value = convertPhysicalToRaw(@CAN_RadarRL::RRL_Object::RRL_Object_Obj44.LengthVnce, 0.005, 0.0);
    copyBitsToByteArrayLE(raw_value, byteArray, 23136, 12);

    raw_value = convertPhysicalToRaw(@CAN_RadarRL::RRL_Object::RRL_Object_Obj44.Length, 0.125, 0.0);
    copyBitsToByteArrayLE(raw_value, byteArray, 23128, 7);

    raw_value = convertPhysicalToRaw(@CAN_RadarRL::RRL_Object::RRL_Object_Obj44.Py, 0.0625, -128.0);
    copyBitsToByteArrayLE(raw_value, byteArray, 23104, 12);

    raw_value = convertPhysicalToRaw(@CAN_RadarRL::RRL_Object::RRL_Object_Obj44.PxVnce, 0.005, 0.0);
    copyBitsToByteArrayLE(raw_value, byteArray, 23092, 12);

    raw_value = convertPhysicalToRaw(@CAN_RadarRL::RRL_Object::RRL_Object_Obj44.Px, 0.0625, -512.0);
    copyBitsToByteArrayLE(raw_value, byteArray, 23078, 14);

    raw_value = convertPhysicalToRaw(@CAN_RadarRL::RRL_Object::RRL_Object_Obj44.ProbClassConfidence, 2.0, 0.0);
    copyBitsToByteArrayLE(raw_value, byteArray, 23072, 6);

    raw_value = convertPhysicalToRaw(@CAN_RadarRL::RRL_Object::RRL_Object_Obj44.MovingStatus, 1.0, 0.0);
    copyBitsToByteArrayLE(raw_value, byteArray, 23276, 2);

    raw_value = convertPhysicalToRaw(@CAN_RadarRL::RRL_Object::RRL_Object_Obj44.VxVnce, 0.005, 0.0);
    copyBitsToByteArrayLE(raw_value, byteArray, 23264, 12);

    raw_value = convertPhysicalToRaw(@CAN_RadarRL::RRL_Object::RRL_Object_Obj44.Vy, 0.125, -64.0);
    copyBitsToByteArrayLE(raw_value, byteArray, 23278, 10);

    raw_value = convertPhysicalToRaw(@CAN_RadarRL::RRL_Object::RRL_Object_Obj44.AxAyCoVnce, 0.005, -10.0);
    copyBitsToByteArrayLE(raw_value, byteArray, 23532, 12);

    raw_value = convertPhysicalToRaw(@CAN_RadarRL::RRL_Object::RRL_Object_Obj44.PxAxCoVnce, 0.005, -10.0);
    copyBitsToByteArrayLE(raw_value, byteArray, 23392, 12);

    raw_value = convertPhysicalToRaw(@CAN_RadarRL::RRL_Object::RRL_Object_Obj44.Age, 1.0, 0.0);
    copyBitsToByteArrayLE(raw_value, byteArray, 23552, 32);

    raw_value = convertPhysicalToRaw(@CAN_RadarRL::RRL_Object::RRL_Object_Obj44.ExistProb, 2.0, 0.0);
    copyBitsToByteArrayLE(raw_value, byteArray, 23288, 6);

    raw_value = convertPhysicalToRaw(@CAN_RadarRL::RRL_Object::RRL_Object_Obj44.VyAyCoVnce, 0.005, -10.0);
    copyBitsToByteArrayLE(raw_value, byteArray, 23520, 12);

    raw_value = convertPhysicalToRaw(@CAN_RadarRL::RRL_Object::RRL_Object_Obj44.VyAxCoVnce, 0.005, -10.0);
    copyBitsToByteArrayLE(raw_value, byteArray, 23500, 12);

    raw_value = convertPhysicalToRaw(@CAN_RadarRL::RRL_Object::RRL_Object_Obj44.VxAyCoVnce, 0.005, -10.0);
    copyBitsToByteArrayLE(raw_value, byteArray, 23488, 12);

    raw_value = convertPhysicalToRaw(@CAN_RadarRL::RRL_Object::RRL_Object_Obj44.VxAxCoVnce, 0.005, -10.0);
    copyBitsToByteArrayLE(raw_value, byteArray, 23468, 12);

    raw_value = convertPhysicalToRaw(@CAN_RadarRL::RRL_Object::RRL_Object_Obj44.PyAyCoVnce, 0.005, -10.0);
    copyBitsToByteArrayLE(raw_value, byteArray, 23436, 12);

    raw_value = convertPhysicalToRaw(@CAN_RadarRL::RRL_Object::RRL_Object_Obj44.PyAxCoVnce, 0.005, -10.0);
    copyBitsToByteArrayLE(raw_value, byteArray, 23424, 12);

    raw_value = convertPhysicalToRaw(@CAN_RadarRL::RRL_Object::RRL_Object_Obj44.PxAyCoVnce, 0.005, -10.0);
    copyBitsToByteArrayLE(raw_value, byteArray, 23404, 12);

    raw_value = convertPhysicalToRaw(@CAN_RadarRL::RRL_Object::RRL_Object_Obj44.VxVyCoVnce, 0.005, -10.0);
    copyBitsToByteArrayLE(raw_value, byteArray, 23456, 12);

    raw_value = convertPhysicalToRaw(@CAN_RadarRL::RRL_Object::RRL_Object_Obj44.ReferencePoint, 1.0, 0.0);
    copyBitsToByteArrayLE(raw_value, byteArray, 23384, 4);

    raw_value = convertPhysicalToRaw(@CAN_RadarRL::RRL_Object::RRL_Object_Obj44.PxVxCoVnce, 0.005, -10.0);
    copyBitsToByteArrayLE(raw_value, byteArray, 23328, 12);

    raw_value = convertPhysicalToRaw(@CAN_RadarRL::RRL_Object::RRL_Object_Obj44.PyVyCoVnce, 0.005, -10.0);
    copyBitsToByteArrayLE(raw_value, byteArray, 23372, 12);

    raw_value = convertPhysicalToRaw(@CAN_RadarRL::RRL_Object::RRL_Object_Obj44.PxPyCoVnce, 0.005, -10.0);
    copyBitsToByteArrayLE(raw_value, byteArray, 23308, 12);

    raw_value = convertPhysicalToRaw(@CAN_RadarRL::RRL_Object::RRL_Object_Obj44.MeasurementStatus, 1.0, 0.0);
    copyBitsToByteArrayLE(raw_value, byteArray, 23320, 3);

    raw_value = convertPhysicalToRaw(@CAN_RadarRL::RRL_Object::RRL_Object_Obj44.ProbClassType, 1.0, 0.0);
    copyBitsToByteArrayLE(raw_value, byteArray, 23323, 4);

    raw_value = convertPhysicalToRaw(@CAN_RadarRL::RRL_Object::RRL_Object_Obj44.VyVnce, 0.005, 0.0);
    copyBitsToByteArrayLE(raw_value, byteArray, 23296, 12);

    raw_value = convertPhysicalToRaw(@CAN_RadarRL::RRL_Object::RRL_Object_Obj44.PxVyCoVnce, 0.005, -10.0);
    copyBitsToByteArrayLE(raw_value, byteArray, 23340, 12);

    raw_value = convertPhysicalToRaw(@CAN_RadarRL::RRL_Object::RRL_Object_Obj44.FilterInformation, 1.0, 0.0);
    copyBitsToByteArrayLE(raw_value, byteArray, 23352, 8);

    raw_value = convertPhysicalToRaw(@CAN_RadarRL::RRL_Object::RRL_Object_Obj44.PyVxCoVnce, 0.005, -10.0);
    copyBitsToByteArrayLE(raw_value, byteArray, 23360, 12);
}


void RRL_Object_Obj43_write(byte byteArray[])
{
    qword raw_value;

    raw_value = convertPhysicalToRaw(@CAN_RadarRL::RRL_Object::RRL_Object_Obj43.AxVnce, 0.005, 0.0);
    copyBitsToByteArrayLE(raw_value, byteArray, 22656, 12);

    raw_value = convertPhysicalToRaw(@CAN_RadarRL::RRL_Object::RRL_Object_Obj43.VxVnce, 0.005, 0.0);
    copyBitsToByteArrayLE(raw_value, byteArray, 22752, 12);

    raw_value = convertPhysicalToRaw(@CAN_RadarRL::RRL_Object::RRL_Object_Obj43.ObjId, 1.0, 0.0);
    copyBitsToByteArrayLE(raw_value, byteArray, 22744, 7);

    raw_value = convertPhysicalToRaw(@CAN_RadarRL::RRL_Object::RRL_Object_Obj43.Vx, 0.0625, -128.0);
    copyBitsToByteArrayLE(raw_value, byteArray, 22732, 12);

    raw_value = convertPhysicalToRaw(@CAN_RadarRL::RRL_Object::RRL_Object_Obj43.AyVnce, 0.005, 0.0);
    copyBitsToByteArrayLE(raw_value, byteArray, 22720, 12);

    raw_value = convertPhysicalToRaw(@CAN_RadarRL::RRL_Object::RRL_Object_Obj43.Ay, 0.0625, -16.0);
    copyBitsToByteArrayLE(raw_value, byteArray, 22710, 9);

    raw_value = convertPhysicalToRaw(@CAN_RadarRL::RRL_Object::RRL_Object_Obj43.RCS, 0.2, -102.4);
    copyBitsToByteArrayLE(raw_value, byteArray, 22700, 10);

    raw_value = convertPhysicalToRaw(@CAN_RadarRL::RRL_Object::RRL_Object_Obj43.WidthVnce, 0.005, 0.0);
    copyBitsToByteArrayLE(raw_value, byteArray, 22688, 12);

    raw_value = convertPhysicalToRaw(@CAN_RadarRL::RRL_Object::RRL_Object_Obj43.Width, 0.125, 0.0);
    copyBitsToByteArrayLE(raw_value, byteArray, 22680, 7);

    raw_value = convertPhysicalToRaw(@CAN_RadarRL::RRL_Object::RRL_Object_Obj43.OrientationYawVnce, 0.0003, 0.0);
    copyBitsToByteArrayLE(raw_value, byteArray, 22668, 12);

    raw_value = convertPhysicalToRaw(@CAN_RadarRL::RRL_Object::RRL_Object_Obj43.Vy, 0.125, -64.0);
    copyBitsToByteArrayLE(raw_value, byteArray, 22766, 10);

    raw_value = convertPhysicalToRaw(@CAN_RadarRL::RRL_Object::RRL_Object_Obj43.OrientationYaw, 0.0175, -4.48);
    copyBitsToByteArrayLE(raw_value, byteArray, 22646, 9);

    raw_value = convertPhysicalToRaw(@CAN_RadarRL::RRL_Object::RRL_Object_Obj43.Ax, 0.03125, -16.0);
    copyBitsToByteArrayLE(raw_value, byteArray, 22636, 10);

    raw_value = convertPhysicalToRaw(@CAN_RadarRL::RRL_Object::RRL_Object_Obj43.LengthVnce, 0.005, 0.0);
    copyBitsToByteArrayLE(raw_value, byteArray, 22624, 12);

    raw_value = convertPhysicalToRaw(@CAN_RadarRL::RRL_Object::RRL_Object_Obj43.Length, 0.125, 0.0);
    copyBitsToByteArrayLE(raw_value, byteArray, 22616, 7);

    raw_value = convertPhysicalToRaw(@CAN_RadarRL::RRL_Object::RRL_Object_Obj43.PyVnce, 0.005, 0.0);
    copyBitsToByteArrayLE(raw_value, byteArray, 22604, 12);

    raw_value = convertPhysicalToRaw(@CAN_RadarRL::RRL_Object::RRL_Object_Obj43.Py, 0.0625, -128.0);
    copyBitsToByteArrayLE(raw_value, byteArray, 22592, 12);

    raw_value = convertPhysicalToRaw(@CAN_RadarRL::RRL_Object::RRL_Object_Obj43.PxVnce, 0.005, 0.0);
    copyBitsToByteArrayLE(raw_value, byteArray, 22580, 12);

    raw_value = convertPhysicalToRaw(@CAN_RadarRL::RRL_Object::RRL_Object_Obj43.Px, 0.0625, -512.0);
    copyBitsToByteArrayLE(raw_value, byteArray, 22566, 14);

    raw_value = convertPhysicalToRaw(@CAN_RadarRL::RRL_Object::RRL_Object_Obj43.ProbClassConfidence, 2.0, 0.0);
    copyBitsToByteArrayLE(raw_value, byteArray, 22560, 6);

    raw_value = convertPhysicalToRaw(@CAN_RadarRL::RRL_Object::RRL_Object_Obj43.MovingStatus, 1.0, 0.0);
    copyBitsToByteArrayLE(raw_value, byteArray, 22764, 2);

    raw_value = convertPhysicalToRaw(@CAN_RadarRL::RRL_Object::RRL_Object_Obj43.AxAyCoVnce, 0.005, -10.0);
    copyBitsToByteArrayLE(raw_value, byteArray, 23020, 12);

    raw_value = convertPhysicalToRaw(@CAN_RadarRL::RRL_Object::RRL_Object_Obj43.ExistProb, 2.0, 0.0);
    copyBitsToByteArrayLE(raw_value, byteArray, 22776, 6);

    raw_value = convertPhysicalToRaw(@CAN_RadarRL::RRL_Object::RRL_Object_Obj43.PxAxCoVnce, 0.005, -10.0);
    copyBitsToByteArrayLE(raw_value, byteArray, 22880, 12);

    raw_value = convertPhysicalToRaw(@CAN_RadarRL::RRL_Object::RRL_Object_Obj43.VyVnce, 0.005, 0.0);
    copyBitsToByteArrayLE(raw_value, byteArray, 22784, 12);

    raw_value = convertPhysicalToRaw(@CAN_RadarRL::RRL_Object::RRL_Object_Obj43.Age, 1.0, 0.0);
    copyBitsToByteArrayLE(raw_value, byteArray, 23040, 32);

    raw_value = convertPhysicalToRaw(@CAN_RadarRL::RRL_Object::RRL_Object_Obj43.VyAyCoVnce, 0.005, -10.0);
    copyBitsToByteArrayLE(raw_value, byteArray, 23008, 12);

    raw_value = convertPhysicalToRaw(@CAN_RadarRL::RRL_Object::RRL_Object_Obj43.VyAxCoVnce, 0.005, -10.0);
    copyBitsToByteArrayLE(raw_value, byteArray, 22988, 12);

    raw_value = convertPhysicalToRaw(@CAN_RadarRL::RRL_Object::RRL_Object_Obj43.VxAyCoVnce, 0.005, -10.0);
    copyBitsToByteArrayLE(raw_value, byteArray, 22976, 12);

    raw_value = convertPhysicalToRaw(@CAN_RadarRL::RRL_Object::RRL_Object_Obj43.VxAxCoVnce, 0.005, -10.0);
    copyBitsToByteArrayLE(raw_value, byteArray, 22956, 12);

    raw_value = convertPhysicalToRaw(@CAN_RadarRL::RRL_Object::RRL_Object_Obj43.PyAyCoVnce, 0.005, -10.0);
    copyBitsToByteArrayLE(raw_value, byteArray, 22924, 12);

    raw_value = convertPhysicalToRaw(@CAN_RadarRL::RRL_Object::RRL_Object_Obj43.PyAxCoVnce, 0.005, -10.0);
    copyBitsToByteArrayLE(raw_value, byteArray, 22912, 12);

    raw_value = convertPhysicalToRaw(@CAN_RadarRL::RRL_Object::RRL_Object_Obj43.PxAyCoVnce, 0.005, -10.0);
    copyBitsToByteArrayLE(raw_value, byteArray, 22892, 12);

    raw_value = convertPhysicalToRaw(@CAN_RadarRL::RRL_Object::RRL_Object_Obj43.VxVyCoVnce, 0.005, -10.0);
    copyBitsToByteArrayLE(raw_value, byteArray, 22944, 12);

    raw_value = convertPhysicalToRaw(@CAN_RadarRL::RRL_Object::RRL_Object_Obj43.ReferencePoint, 1.0, 0.0);
    copyBitsToByteArrayLE(raw_value, byteArray, 22872, 4);

    raw_value = convertPhysicalToRaw(@CAN_RadarRL::RRL_Object::RRL_Object_Obj43.PxVxCoVnce, 0.005, -10.0);
    copyBitsToByteArrayLE(raw_value, byteArray, 22816, 12);

    raw_value = convertPhysicalToRaw(@CAN_RadarRL::RRL_Object::RRL_Object_Obj43.PyVyCoVnce, 0.005, -10.0);
    copyBitsToByteArrayLE(raw_value, byteArray, 22860, 12);

    raw_value = convertPhysicalToRaw(@CAN_RadarRL::RRL_Object::RRL_Object_Obj43.MeasurementStatus, 1.0, 0.0);
    copyBitsToByteArrayLE(raw_value, byteArray, 22808, 3);

    raw_value = convertPhysicalToRaw(@CAN_RadarRL::RRL_Object::RRL_Object_Obj43.ProbClassType, 1.0, 0.0);
    copyBitsToByteArrayLE(raw_value, byteArray, 22811, 4);

    raw_value = convertPhysicalToRaw(@CAN_RadarRL::RRL_Object::RRL_Object_Obj43.PxPyCoVnce, 0.005, -10.0);
    copyBitsToByteArrayLE(raw_value, byteArray, 22796, 12);

    raw_value = convertPhysicalToRaw(@CAN_RadarRL::RRL_Object::RRL_Object_Obj43.PxVyCoVnce, 0.005, -10.0);
    copyBitsToByteArrayLE(raw_value, byteArray, 22828, 12);

    raw_value = convertPhysicalToRaw(@CAN_RadarRL::RRL_Object::RRL_Object_Obj43.FilterInformation, 1.0, 0.0);
    copyBitsToByteArrayLE(raw_value, byteArray, 22840, 8);

    raw_value = convertPhysicalToRaw(@CAN_RadarRL::RRL_Object::RRL_Object_Obj43.PyVxCoVnce, 0.005, -10.0);
    copyBitsToByteArrayLE(raw_value, byteArray, 22848, 12);
}


void RRL_Object_Obj42_write(byte byteArray[])
{
    qword raw_value;

    raw_value = convertPhysicalToRaw(@CAN_RadarRL::RRL_Object::RRL_Object_Obj42.AxVnce, 0.005, 0.0);
    copyBitsToByteArrayLE(raw_value, byteArray, 22144, 12);

    raw_value = convertPhysicalToRaw(@CAN_RadarRL::RRL_Object::RRL_Object_Obj42.VxVnce, 0.005, 0.0);
    copyBitsToByteArrayLE(raw_value, byteArray, 22240, 12);

    raw_value = convertPhysicalToRaw(@CAN_RadarRL::RRL_Object::RRL_Object_Obj42.ObjId, 1.0, 0.0);
    copyBitsToByteArrayLE(raw_value, byteArray, 22232, 7);

    raw_value = convertPhysicalToRaw(@CAN_RadarRL::RRL_Object::RRL_Object_Obj42.Vx, 0.0625, -128.0);
    copyBitsToByteArrayLE(raw_value, byteArray, 22220, 12);

    raw_value = convertPhysicalToRaw(@CAN_RadarRL::RRL_Object::RRL_Object_Obj42.AyVnce, 0.005, 0.0);
    copyBitsToByteArrayLE(raw_value, byteArray, 22208, 12);

    raw_value = convertPhysicalToRaw(@CAN_RadarRL::RRL_Object::RRL_Object_Obj42.Ay, 0.0625, -16.0);
    copyBitsToByteArrayLE(raw_value, byteArray, 22198, 9);

    raw_value = convertPhysicalToRaw(@CAN_RadarRL::RRL_Object::RRL_Object_Obj42.RCS, 0.2, -102.4);
    copyBitsToByteArrayLE(raw_value, byteArray, 22188, 10);

    raw_value = convertPhysicalToRaw(@CAN_RadarRL::RRL_Object::RRL_Object_Obj42.WidthVnce, 0.005, 0.0);
    copyBitsToByteArrayLE(raw_value, byteArray, 22176, 12);

    raw_value = convertPhysicalToRaw(@CAN_RadarRL::RRL_Object::RRL_Object_Obj42.Width, 0.125, 0.0);
    copyBitsToByteArrayLE(raw_value, byteArray, 22168, 7);

    raw_value = convertPhysicalToRaw(@CAN_RadarRL::RRL_Object::RRL_Object_Obj42.OrientationYawVnce, 0.0003, 0.0);
    copyBitsToByteArrayLE(raw_value, byteArray, 22156, 12);

    raw_value = convertPhysicalToRaw(@CAN_RadarRL::RRL_Object::RRL_Object_Obj42.Vy, 0.125, -64.0);
    copyBitsToByteArrayLE(raw_value, byteArray, 22254, 10);

    raw_value = convertPhysicalToRaw(@CAN_RadarRL::RRL_Object::RRL_Object_Obj42.OrientationYaw, 0.0175, -4.48);
    copyBitsToByteArrayLE(raw_value, byteArray, 22134, 9);

    raw_value = convertPhysicalToRaw(@CAN_RadarRL::RRL_Object::RRL_Object_Obj42.Ax, 0.03125, -16.0);
    copyBitsToByteArrayLE(raw_value, byteArray, 22124, 10);

    raw_value = convertPhysicalToRaw(@CAN_RadarRL::RRL_Object::RRL_Object_Obj42.LengthVnce, 0.005, 0.0);
    copyBitsToByteArrayLE(raw_value, byteArray, 22112, 12);

    raw_value = convertPhysicalToRaw(@CAN_RadarRL::RRL_Object::RRL_Object_Obj42.Length, 0.125, 0.0);
    copyBitsToByteArrayLE(raw_value, byteArray, 22104, 7);

    raw_value = convertPhysicalToRaw(@CAN_RadarRL::RRL_Object::RRL_Object_Obj42.PyVnce, 0.005, 0.0);
    copyBitsToByteArrayLE(raw_value, byteArray, 22092, 12);

    raw_value = convertPhysicalToRaw(@CAN_RadarRL::RRL_Object::RRL_Object_Obj42.Py, 0.0625, -128.0);
    copyBitsToByteArrayLE(raw_value, byteArray, 22080, 12);

    raw_value = convertPhysicalToRaw(@CAN_RadarRL::RRL_Object::RRL_Object_Obj42.PxVnce, 0.005, 0.0);
    copyBitsToByteArrayLE(raw_value, byteArray, 22068, 12);

    raw_value = convertPhysicalToRaw(@CAN_RadarRL::RRL_Object::RRL_Object_Obj42.Px, 0.0625, -512.0);
    copyBitsToByteArrayLE(raw_value, byteArray, 22054, 14);

    raw_value = convertPhysicalToRaw(@CAN_RadarRL::RRL_Object::RRL_Object_Obj42.ProbClassConfidence, 2.0, 0.0);
    copyBitsToByteArrayLE(raw_value, byteArray, 22048, 6);

    raw_value = convertPhysicalToRaw(@CAN_RadarRL::RRL_Object::RRL_Object_Obj42.MovingStatus, 1.0, 0.0);
    copyBitsToByteArrayLE(raw_value, byteArray, 22252, 2);

    raw_value = convertPhysicalToRaw(@CAN_RadarRL::RRL_Object::RRL_Object_Obj42.ReferencePoint, 1.0, 0.0);
    copyBitsToByteArrayLE(raw_value, byteArray, 22360, 4);

    raw_value = convertPhysicalToRaw(@CAN_RadarRL::RRL_Object::RRL_Object_Obj42.ExistProb, 2.0, 0.0);
    copyBitsToByteArrayLE(raw_value, byteArray, 22264, 6);

    raw_value = convertPhysicalToRaw(@CAN_RadarRL::RRL_Object::RRL_Object_Obj42.PxAxCoVnce, 0.005, -10.0);
    copyBitsToByteArrayLE(raw_value, byteArray, 22368, 12);

    raw_value = convertPhysicalToRaw(@CAN_RadarRL::RRL_Object::RRL_Object_Obj42.VyVnce, 0.005, 0.0);
    copyBitsToByteArrayLE(raw_value, byteArray, 22272, 12);

    raw_value = convertPhysicalToRaw(@CAN_RadarRL::RRL_Object::RRL_Object_Obj42.VyAyCoVnce, 0.005, -10.0);
    copyBitsToByteArrayLE(raw_value, byteArray, 22496, 12);

    raw_value = convertPhysicalToRaw(@CAN_RadarRL::RRL_Object::RRL_Object_Obj42.VyAxCoVnce, 0.005, -10.0);
    copyBitsToByteArrayLE(raw_value, byteArray, 22476, 12);

    raw_value = convertPhysicalToRaw(@CAN_RadarRL::RRL_Object::RRL_Object_Obj42.VxAyCoVnce, 0.005, -10.0);
    copyBitsToByteArrayLE(raw_value, byteArray, 22464, 12);

    raw_value = convertPhysicalToRaw(@CAN_RadarRL::RRL_Object::RRL_Object_Obj42.VxAxCoVnce, 0.005, -10.0);
    copyBitsToByteArrayLE(raw_value, byteArray, 22444, 12);

    raw_value = convertPhysicalToRaw(@CAN_RadarRL::RRL_Object::RRL_Object_Obj42.VxVyCoVnce, 0.005, -10.0);
    copyBitsToByteArrayLE(raw_value, byteArray, 22432, 12);

    raw_value = convertPhysicalToRaw(@CAN_RadarRL::RRL_Object::RRL_Object_Obj42.PyAyCoVnce, 0.005, -10.0);
    copyBitsToByteArrayLE(raw_value, byteArray, 22412, 12);

    raw_value = convertPhysicalToRaw(@CAN_RadarRL::RRL_Object::RRL_Object_Obj42.PyAxCoVnce, 0.005, -10.0);
    copyBitsToByteArrayLE(raw_value, byteArray, 22400, 12);

    raw_value = convertPhysicalToRaw(@CAN_RadarRL::RRL_Object::RRL_Object_Obj42.PxAyCoVnce, 0.005, -10.0);
    copyBitsToByteArrayLE(raw_value, byteArray, 22380, 12);

    raw_value = convertPhysicalToRaw(@CAN_RadarRL::RRL_Object::RRL_Object_Obj42.AxAyCoVnce, 0.005, -10.0);
    copyBitsToByteArrayLE(raw_value, byteArray, 22508, 12);

    raw_value = convertPhysicalToRaw(@CAN_RadarRL::RRL_Object::RRL_Object_Obj42.Age, 1.0, 0.0);
    copyBitsToByteArrayLE(raw_value, byteArray, 22528, 32);

    raw_value = convertPhysicalToRaw(@CAN_RadarRL::RRL_Object::RRL_Object_Obj42.PxVxCoVnce, 0.005, -10.0);
    copyBitsToByteArrayLE(raw_value, byteArray, 22304, 12);

    raw_value = convertPhysicalToRaw(@CAN_RadarRL::RRL_Object::RRL_Object_Obj42.PyVyCoVnce, 0.005, -10.0);
    copyBitsToByteArrayLE(raw_value, byteArray, 22348, 12);

    raw_value = convertPhysicalToRaw(@CAN_RadarRL::RRL_Object::RRL_Object_Obj42.MeasurementStatus, 1.0, 0.0);
    copyBitsToByteArrayLE(raw_value, byteArray, 22296, 3);

    raw_value = convertPhysicalToRaw(@CAN_RadarRL::RRL_Object::RRL_Object_Obj42.ProbClassType, 1.0, 0.0);
    copyBitsToByteArrayLE(raw_value, byteArray, 22299, 4);

    raw_value = convertPhysicalToRaw(@CAN_RadarRL::RRL_Object::RRL_Object_Obj42.PxPyCoVnce, 0.005, -10.0);
    copyBitsToByteArrayLE(raw_value, byteArray, 22284, 12);

    raw_value = convertPhysicalToRaw(@CAN_RadarRL::RRL_Object::RRL_Object_Obj42.PxVyCoVnce, 0.005, -10.0);
    copyBitsToByteArrayLE(raw_value, byteArray, 22316, 12);

    raw_value = convertPhysicalToRaw(@CAN_RadarRL::RRL_Object::RRL_Object_Obj42.FilterInformation, 1.0, 0.0);
    copyBitsToByteArrayLE(raw_value, byteArray, 22328, 8);

    raw_value = convertPhysicalToRaw(@CAN_RadarRL::RRL_Object::RRL_Object_Obj42.PyVxCoVnce, 0.005, -10.0);
    copyBitsToByteArrayLE(raw_value, byteArray, 22336, 12);
}


void RRL_Object_Obj41_write(byte byteArray[])
{
    qword raw_value;

    raw_value = convertPhysicalToRaw(@CAN_RadarRL::RRL_Object::RRL_Object_Obj41.ObjId, 1.0, 0.0);
    copyBitsToByteArrayLE(raw_value, byteArray, 21720, 7);

    raw_value = convertPhysicalToRaw(@CAN_RadarRL::RRL_Object::RRL_Object_Obj41.AxVnce, 0.005, 0.0);
    copyBitsToByteArrayLE(raw_value, byteArray, 21632, 12);

    raw_value = convertPhysicalToRaw(@CAN_RadarRL::RRL_Object::RRL_Object_Obj41.Vx, 0.0625, -128.0);
    copyBitsToByteArrayLE(raw_value, byteArray, 21708, 12);

    raw_value = convertPhysicalToRaw(@CAN_RadarRL::RRL_Object::RRL_Object_Obj41.AyVnce, 0.005, 0.0);
    copyBitsToByteArrayLE(raw_value, byteArray, 21696, 12);

    raw_value = convertPhysicalToRaw(@CAN_RadarRL::RRL_Object::RRL_Object_Obj41.Ay, 0.0625, -16.0);
    copyBitsToByteArrayLE(raw_value, byteArray, 21686, 9);

    raw_value = convertPhysicalToRaw(@CAN_RadarRL::RRL_Object::RRL_Object_Obj41.RCS, 0.2, -102.4);
    copyBitsToByteArrayLE(raw_value, byteArray, 21676, 10);

    raw_value = convertPhysicalToRaw(@CAN_RadarRL::RRL_Object::RRL_Object_Obj41.WidthVnce, 0.005, 0.0);
    copyBitsToByteArrayLE(raw_value, byteArray, 21664, 12);

    raw_value = convertPhysicalToRaw(@CAN_RadarRL::RRL_Object::RRL_Object_Obj41.Width, 0.125, 0.0);
    copyBitsToByteArrayLE(raw_value, byteArray, 21656, 7);

    raw_value = convertPhysicalToRaw(@CAN_RadarRL::RRL_Object::RRL_Object_Obj41.OrientationYawVnce, 0.0003, 0.0);
    copyBitsToByteArrayLE(raw_value, byteArray, 21644, 12);

    raw_value = convertPhysicalToRaw(@CAN_RadarRL::RRL_Object::RRL_Object_Obj41.PyVnce, 0.005, 0.0);
    copyBitsToByteArrayLE(raw_value, byteArray, 21580, 12);

    raw_value = convertPhysicalToRaw(@CAN_RadarRL::RRL_Object::RRL_Object_Obj41.OrientationYaw, 0.0175, -4.48);
    copyBitsToByteArrayLE(raw_value, byteArray, 21622, 9);

    raw_value = convertPhysicalToRaw(@CAN_RadarRL::RRL_Object::RRL_Object_Obj41.Ax, 0.03125, -16.0);
    copyBitsToByteArrayLE(raw_value, byteArray, 21612, 10);

    raw_value = convertPhysicalToRaw(@CAN_RadarRL::RRL_Object::RRL_Object_Obj41.LengthVnce, 0.005, 0.0);
    copyBitsToByteArrayLE(raw_value, byteArray, 21600, 12);

    raw_value = convertPhysicalToRaw(@CAN_RadarRL::RRL_Object::RRL_Object_Obj41.Length, 0.125, 0.0);
    copyBitsToByteArrayLE(raw_value, byteArray, 21592, 7);

    raw_value = convertPhysicalToRaw(@CAN_RadarRL::RRL_Object::RRL_Object_Obj41.Py, 0.0625, -128.0);
    copyBitsToByteArrayLE(raw_value, byteArray, 21568, 12);

    raw_value = convertPhysicalToRaw(@CAN_RadarRL::RRL_Object::RRL_Object_Obj41.PxVnce, 0.005, 0.0);
    copyBitsToByteArrayLE(raw_value, byteArray, 21556, 12);

    raw_value = convertPhysicalToRaw(@CAN_RadarRL::RRL_Object::RRL_Object_Obj41.Px, 0.0625, -512.0);
    copyBitsToByteArrayLE(raw_value, byteArray, 21542, 14);

    raw_value = convertPhysicalToRaw(@CAN_RadarRL::RRL_Object::RRL_Object_Obj41.ProbClassConfidence, 2.0, 0.0);
    copyBitsToByteArrayLE(raw_value, byteArray, 21536, 6);

    raw_value = convertPhysicalToRaw(@CAN_RadarRL::RRL_Object::RRL_Object_Obj41.MovingStatus, 1.0, 0.0);
    copyBitsToByteArrayLE(raw_value, byteArray, 21740, 2);

    raw_value = convertPhysicalToRaw(@CAN_RadarRL::RRL_Object::RRL_Object_Obj41.VxVnce, 0.005, 0.0);
    copyBitsToByteArrayLE(raw_value, byteArray, 21728, 12);

    raw_value = convertPhysicalToRaw(@CAN_RadarRL::RRL_Object::RRL_Object_Obj41.Vy, 0.125, -64.0);
    copyBitsToByteArrayLE(raw_value, byteArray, 21742, 10);

    raw_value = convertPhysicalToRaw(@CAN_RadarRL::RRL_Object::RRL_Object_Obj41.AxAyCoVnce, 0.005, -10.0);
    copyBitsToByteArrayLE(raw_value, byteArray, 21996, 12);

    raw_value = convertPhysicalToRaw(@CAN_RadarRL::RRL_Object::RRL_Object_Obj41.PxAxCoVnce, 0.005, -10.0);
    copyBitsToByteArrayLE(raw_value, byteArray, 21856, 12);

    raw_value = convertPhysicalToRaw(@CAN_RadarRL::RRL_Object::RRL_Object_Obj41.Age, 1.0, 0.0);
    copyBitsToByteArrayLE(raw_value, byteArray, 22016, 32);

    raw_value = convertPhysicalToRaw(@CAN_RadarRL::RRL_Object::RRL_Object_Obj41.ExistProb, 2.0, 0.0);
    copyBitsToByteArrayLE(raw_value, byteArray, 21752, 6);

    raw_value = convertPhysicalToRaw(@CAN_RadarRL::RRL_Object::RRL_Object_Obj41.VyAyCoVnce, 0.005, -10.0);
    copyBitsToByteArrayLE(raw_value, byteArray, 21984, 12);

    raw_value = convertPhysicalToRaw(@CAN_RadarRL::RRL_Object::RRL_Object_Obj41.VyAxCoVnce, 0.005, -10.0);
    copyBitsToByteArrayLE(raw_value, byteArray, 21964, 12);

    raw_value = convertPhysicalToRaw(@CAN_RadarRL::RRL_Object::RRL_Object_Obj41.VxAyCoVnce, 0.005, -10.0);
    copyBitsToByteArrayLE(raw_value, byteArray, 21952, 12);

    raw_value = convertPhysicalToRaw(@CAN_RadarRL::RRL_Object::RRL_Object_Obj41.VxAxCoVnce, 0.005, -10.0);
    copyBitsToByteArrayLE(raw_value, byteArray, 21932, 12);

    raw_value = convertPhysicalToRaw(@CAN_RadarRL::RRL_Object::RRL_Object_Obj41.PyAyCoVnce, 0.005, -10.0);
    copyBitsToByteArrayLE(raw_value, byteArray, 21900, 12);

    raw_value = convertPhysicalToRaw(@CAN_RadarRL::RRL_Object::RRL_Object_Obj41.PyAxCoVnce, 0.005, -10.0);
    copyBitsToByteArrayLE(raw_value, byteArray, 21888, 12);

    raw_value = convertPhysicalToRaw(@CAN_RadarRL::RRL_Object::RRL_Object_Obj41.PxAyCoVnce, 0.005, -10.0);
    copyBitsToByteArrayLE(raw_value, byteArray, 21868, 12);

    raw_value = convertPhysicalToRaw(@CAN_RadarRL::RRL_Object::RRL_Object_Obj41.VxVyCoVnce, 0.005, -10.0);
    copyBitsToByteArrayLE(raw_value, byteArray, 21920, 12);

    raw_value = convertPhysicalToRaw(@CAN_RadarRL::RRL_Object::RRL_Object_Obj41.ReferencePoint, 1.0, 0.0);
    copyBitsToByteArrayLE(raw_value, byteArray, 21848, 4);

    raw_value = convertPhysicalToRaw(@CAN_RadarRL::RRL_Object::RRL_Object_Obj41.PxVxCoVnce, 0.005, -10.0);
    copyBitsToByteArrayLE(raw_value, byteArray, 21792, 12);

    raw_value = convertPhysicalToRaw(@CAN_RadarRL::RRL_Object::RRL_Object_Obj41.PyVyCoVnce, 0.005, -10.0);
    copyBitsToByteArrayLE(raw_value, byteArray, 21836, 12);

    raw_value = convertPhysicalToRaw(@CAN_RadarRL::RRL_Object::RRL_Object_Obj41.PxPyCoVnce, 0.005, -10.0);
    copyBitsToByteArrayLE(raw_value, byteArray, 21772, 12);

    raw_value = convertPhysicalToRaw(@CAN_RadarRL::RRL_Object::RRL_Object_Obj41.MeasurementStatus, 1.0, 0.0);
    copyBitsToByteArrayLE(raw_value, byteArray, 21784, 3);

    raw_value = convertPhysicalToRaw(@CAN_RadarRL::RRL_Object::RRL_Object_Obj41.ProbClassType, 1.0, 0.0);
    copyBitsToByteArrayLE(raw_value, byteArray, 21787, 4);

    raw_value = convertPhysicalToRaw(@CAN_RadarRL::RRL_Object::RRL_Object_Obj41.VyVnce, 0.005, 0.0);
    copyBitsToByteArrayLE(raw_value, byteArray, 21760, 12);

    raw_value = convertPhysicalToRaw(@CAN_RadarRL::RRL_Object::RRL_Object_Obj41.PxVyCoVnce, 0.005, -10.0);
    copyBitsToByteArrayLE(raw_value, byteArray, 21804, 12);

    raw_value = convertPhysicalToRaw(@CAN_RadarRL::RRL_Object::RRL_Object_Obj41.FilterInformation, 1.0, 0.0);
    copyBitsToByteArrayLE(raw_value, byteArray, 21816, 8);

    raw_value = convertPhysicalToRaw(@CAN_RadarRL::RRL_Object::RRL_Object_Obj41.PyVxCoVnce, 0.005, -10.0);
    copyBitsToByteArrayLE(raw_value, byteArray, 21824, 12);
}


void RRL_Object_Obj40_write(byte byteArray[])
{
    qword raw_value;

    raw_value = convertPhysicalToRaw(@CAN_RadarRL::RRL_Object::RRL_Object_Obj40.AxVnce, 0.005, 0.0);
    copyBitsToByteArrayLE(raw_value, byteArray, 21120, 12);

    raw_value = convertPhysicalToRaw(@CAN_RadarRL::RRL_Object::RRL_Object_Obj40.VxVnce, 0.005, 0.0);
    copyBitsToByteArrayLE(raw_value, byteArray, 21216, 12);

    raw_value = convertPhysicalToRaw(@CAN_RadarRL::RRL_Object::RRL_Object_Obj40.ObjId, 1.0, 0.0);
    copyBitsToByteArrayLE(raw_value, byteArray, 21208, 7);

    raw_value = convertPhysicalToRaw(@CAN_RadarRL::RRL_Object::RRL_Object_Obj40.Vx, 0.0625, -128.0);
    copyBitsToByteArrayLE(raw_value, byteArray, 21196, 12);

    raw_value = convertPhysicalToRaw(@CAN_RadarRL::RRL_Object::RRL_Object_Obj40.AyVnce, 0.005, 0.0);
    copyBitsToByteArrayLE(raw_value, byteArray, 21184, 12);

    raw_value = convertPhysicalToRaw(@CAN_RadarRL::RRL_Object::RRL_Object_Obj40.Ay, 0.0625, -16.0);
    copyBitsToByteArrayLE(raw_value, byteArray, 21174, 9);

    raw_value = convertPhysicalToRaw(@CAN_RadarRL::RRL_Object::RRL_Object_Obj40.RCS, 0.2, -102.4);
    copyBitsToByteArrayLE(raw_value, byteArray, 21164, 10);

    raw_value = convertPhysicalToRaw(@CAN_RadarRL::RRL_Object::RRL_Object_Obj40.WidthVnce, 0.005, 0.0);
    copyBitsToByteArrayLE(raw_value, byteArray, 21152, 12);

    raw_value = convertPhysicalToRaw(@CAN_RadarRL::RRL_Object::RRL_Object_Obj40.Width, 0.125, 0.0);
    copyBitsToByteArrayLE(raw_value, byteArray, 21144, 7);

    raw_value = convertPhysicalToRaw(@CAN_RadarRL::RRL_Object::RRL_Object_Obj40.OrientationYawVnce, 0.0003, 0.0);
    copyBitsToByteArrayLE(raw_value, byteArray, 21132, 12);

    raw_value = convertPhysicalToRaw(@CAN_RadarRL::RRL_Object::RRL_Object_Obj40.Vy, 0.125, -64.0);
    copyBitsToByteArrayLE(raw_value, byteArray, 21230, 10);

    raw_value = convertPhysicalToRaw(@CAN_RadarRL::RRL_Object::RRL_Object_Obj40.OrientationYaw, 0.0175, -4.48);
    copyBitsToByteArrayLE(raw_value, byteArray, 21110, 9);

    raw_value = convertPhysicalToRaw(@CAN_RadarRL::RRL_Object::RRL_Object_Obj40.Ax, 0.03125, -16.0);
    copyBitsToByteArrayLE(raw_value, byteArray, 21100, 10);

    raw_value = convertPhysicalToRaw(@CAN_RadarRL::RRL_Object::RRL_Object_Obj40.LengthVnce, 0.005, 0.0);
    copyBitsToByteArrayLE(raw_value, byteArray, 21088, 12);

    raw_value = convertPhysicalToRaw(@CAN_RadarRL::RRL_Object::RRL_Object_Obj40.Length, 0.125, 0.0);
    copyBitsToByteArrayLE(raw_value, byteArray, 21080, 7);

    raw_value = convertPhysicalToRaw(@CAN_RadarRL::RRL_Object::RRL_Object_Obj40.PyVnce, 0.005, 0.0);
    copyBitsToByteArrayLE(raw_value, byteArray, 21068, 12);

    raw_value = convertPhysicalToRaw(@CAN_RadarRL::RRL_Object::RRL_Object_Obj40.Py, 0.0625, -128.0);
    copyBitsToByteArrayLE(raw_value, byteArray, 21056, 12);

    raw_value = convertPhysicalToRaw(@CAN_RadarRL::RRL_Object::RRL_Object_Obj40.PxVnce, 0.005, 0.0);
    copyBitsToByteArrayLE(raw_value, byteArray, 21044, 12);

    raw_value = convertPhysicalToRaw(@CAN_RadarRL::RRL_Object::RRL_Object_Obj40.Px, 0.0625, -512.0);
    copyBitsToByteArrayLE(raw_value, byteArray, 21030, 14);

    raw_value = convertPhysicalToRaw(@CAN_RadarRL::RRL_Object::RRL_Object_Obj40.ProbClassConfidence, 2.0, 0.0);
    copyBitsToByteArrayLE(raw_value, byteArray, 21024, 6);

    raw_value = convertPhysicalToRaw(@CAN_RadarRL::RRL_Object::RRL_Object_Obj40.MovingStatus, 1.0, 0.0);
    copyBitsToByteArrayLE(raw_value, byteArray, 21228, 2);

    raw_value = convertPhysicalToRaw(@CAN_RadarRL::RRL_Object::RRL_Object_Obj40.Age, 1.0, 0.0);
    copyBitsToByteArrayLE(raw_value, byteArray, 21504, 32);

    raw_value = convertPhysicalToRaw(@CAN_RadarRL::RRL_Object::RRL_Object_Obj40.ExistProb, 2.0, 0.0);
    copyBitsToByteArrayLE(raw_value, byteArray, 21240, 6);

    raw_value = convertPhysicalToRaw(@CAN_RadarRL::RRL_Object::RRL_Object_Obj40.PxAxCoVnce, 0.005, -10.0);
    copyBitsToByteArrayLE(raw_value, byteArray, 21344, 12);

    raw_value = convertPhysicalToRaw(@CAN_RadarRL::RRL_Object::RRL_Object_Obj40.VyVnce, 0.005, 0.0);
    copyBitsToByteArrayLE(raw_value, byteArray, 21248, 12);

    raw_value = convertPhysicalToRaw(@CAN_RadarRL::RRL_Object::RRL_Object_Obj40.VyAyCoVnce, 0.005, -10.0);
    copyBitsToByteArrayLE(raw_value, byteArray, 21472, 12);

    raw_value = convertPhysicalToRaw(@CAN_RadarRL::RRL_Object::RRL_Object_Obj40.VyAxCoVnce, 0.005, -10.0);
    copyBitsToByteArrayLE(raw_value, byteArray, 21452, 12);

    raw_value = convertPhysicalToRaw(@CAN_RadarRL::RRL_Object::RRL_Object_Obj40.VxAyCoVnce, 0.005, -10.0);
    copyBitsToByteArrayLE(raw_value, byteArray, 21440, 12);

    raw_value = convertPhysicalToRaw(@CAN_RadarRL::RRL_Object::RRL_Object_Obj40.VxAxCoVnce, 0.005, -10.0);
    copyBitsToByteArrayLE(raw_value, byteArray, 21420, 12);

    raw_value = convertPhysicalToRaw(@CAN_RadarRL::RRL_Object::RRL_Object_Obj40.VxVyCoVnce, 0.005, -10.0);
    copyBitsToByteArrayLE(raw_value, byteArray, 21408, 12);

    raw_value = convertPhysicalToRaw(@CAN_RadarRL::RRL_Object::RRL_Object_Obj40.PyAyCoVnce, 0.005, -10.0);
    copyBitsToByteArrayLE(raw_value, byteArray, 21388, 12);

    raw_value = convertPhysicalToRaw(@CAN_RadarRL::RRL_Object::RRL_Object_Obj40.PyAxCoVnce, 0.005, -10.0);
    copyBitsToByteArrayLE(raw_value, byteArray, 21376, 12);

    raw_value = convertPhysicalToRaw(@CAN_RadarRL::RRL_Object::RRL_Object_Obj40.PxAyCoVnce, 0.005, -10.0);
    copyBitsToByteArrayLE(raw_value, byteArray, 21356, 12);

    raw_value = convertPhysicalToRaw(@CAN_RadarRL::RRL_Object::RRL_Object_Obj40.AxAyCoVnce, 0.005, -10.0);
    copyBitsToByteArrayLE(raw_value, byteArray, 21484, 12);

    raw_value = convertPhysicalToRaw(@CAN_RadarRL::RRL_Object::RRL_Object_Obj40.ReferencePoint, 1.0, 0.0);
    copyBitsToByteArrayLE(raw_value, byteArray, 21336, 4);

    raw_value = convertPhysicalToRaw(@CAN_RadarRL::RRL_Object::RRL_Object_Obj40.PyVxCoVnce, 0.005, -10.0);
    copyBitsToByteArrayLE(raw_value, byteArray, 21312, 12);

    raw_value = convertPhysicalToRaw(@CAN_RadarRL::RRL_Object::RRL_Object_Obj40.FilterInformation, 1.0, 0.0);
    copyBitsToByteArrayLE(raw_value, byteArray, 21304, 8);

    raw_value = convertPhysicalToRaw(@CAN_RadarRL::RRL_Object::RRL_Object_Obj40.PxVyCoVnce, 0.005, -10.0);
    copyBitsToByteArrayLE(raw_value, byteArray, 21292, 12);

    raw_value = convertPhysicalToRaw(@CAN_RadarRL::RRL_Object::RRL_Object_Obj40.PxVxCoVnce, 0.005, -10.0);
    copyBitsToByteArrayLE(raw_value, byteArray, 21280, 12);

    raw_value = convertPhysicalToRaw(@CAN_RadarRL::RRL_Object::RRL_Object_Obj40.ProbClassType, 1.0, 0.0);
    copyBitsToByteArrayLE(raw_value, byteArray, 21275, 4);

    raw_value = convertPhysicalToRaw(@CAN_RadarRL::RRL_Object::RRL_Object_Obj40.MeasurementStatus, 1.0, 0.0);
    copyBitsToByteArrayLE(raw_value, byteArray, 21272, 3);

    raw_value = convertPhysicalToRaw(@CAN_RadarRL::RRL_Object::RRL_Object_Obj40.PxPyCoVnce, 0.005, -10.0);
    copyBitsToByteArrayLE(raw_value, byteArray, 21260, 12);

    raw_value = convertPhysicalToRaw(@CAN_RadarRL::RRL_Object::RRL_Object_Obj40.PyVyCoVnce, 0.005, -10.0);
    copyBitsToByteArrayLE(raw_value, byteArray, 21324, 12);
}


void RRL_Object_Obj39_write(byte byteArray[])
{
    qword raw_value;

    raw_value = convertPhysicalToRaw(@CAN_RadarRL::RRL_Object::RRL_Object_Obj39.Ay, 0.0625, -16.0);
    copyBitsToByteArrayLE(raw_value, byteArray, 20662, 9);

    raw_value = convertPhysicalToRaw(@CAN_RadarRL::RRL_Object::RRL_Object_Obj39.WidthVnce, 0.005, 0.0);
    copyBitsToByteArrayLE(raw_value, byteArray, 20640, 12);

    raw_value = convertPhysicalToRaw(@CAN_RadarRL::RRL_Object::RRL_Object_Obj39.RCS, 0.2, -102.4);
    copyBitsToByteArrayLE(raw_value, byteArray, 20652, 10);

    raw_value = convertPhysicalToRaw(@CAN_RadarRL::RRL_Object::RRL_Object_Obj39.VxVnce, 0.005, 0.0);
    copyBitsToByteArrayLE(raw_value, byteArray, 20704, 12);

    raw_value = convertPhysicalToRaw(@CAN_RadarRL::RRL_Object::RRL_Object_Obj39.AyVnce, 0.005, 0.0);
    copyBitsToByteArrayLE(raw_value, byteArray, 20672, 12);

    raw_value = convertPhysicalToRaw(@CAN_RadarRL::RRL_Object::RRL_Object_Obj39.Vx, 0.0625, -128.0);
    copyBitsToByteArrayLE(raw_value, byteArray, 20684, 12);

    raw_value = convertPhysicalToRaw(@CAN_RadarRL::RRL_Object::RRL_Object_Obj39.ObjId, 1.0, 0.0);
    copyBitsToByteArrayLE(raw_value, byteArray, 20696, 7);

    raw_value = convertPhysicalToRaw(@CAN_RadarRL::RRL_Object::RRL_Object_Obj39.OrientationYawVnce, 0.0003, 0.0);
    copyBitsToByteArrayLE(raw_value, byteArray, 20620, 12);

    raw_value = convertPhysicalToRaw(@CAN_RadarRL::RRL_Object::RRL_Object_Obj39.Width, 0.125, 0.0);
    copyBitsToByteArrayLE(raw_value, byteArray, 20632, 7);

    raw_value = convertPhysicalToRaw(@CAN_RadarRL::RRL_Object::RRL_Object_Obj39.Length, 0.125, 0.0);
    copyBitsToByteArrayLE(raw_value, byteArray, 20568, 7);

    raw_value = convertPhysicalToRaw(@CAN_RadarRL::RRL_Object::RRL_Object_Obj39.AxVnce, 0.005, 0.0);
    copyBitsToByteArrayLE(raw_value, byteArray, 20608, 12);

    raw_value = convertPhysicalToRaw(@CAN_RadarRL::RRL_Object::RRL_Object_Obj39.OrientationYaw, 0.0175, -4.48);
    copyBitsToByteArrayLE(raw_value, byteArray, 20598, 9);

    raw_value = convertPhysicalToRaw(@CAN_RadarRL::RRL_Object::RRL_Object_Obj39.Ax, 0.03125, -16.0);
    copyBitsToByteArrayLE(raw_value, byteArray, 20588, 10);

    raw_value = convertPhysicalToRaw(@CAN_RadarRL::RRL_Object::RRL_Object_Obj39.LengthVnce, 0.005, 0.0);
    copyBitsToByteArrayLE(raw_value, byteArray, 20576, 12);

    raw_value = convertPhysicalToRaw(@CAN_RadarRL::RRL_Object::RRL_Object_Obj39.PyVnce, 0.005, 0.0);
    copyBitsToByteArrayLE(raw_value, byteArray, 20556, 12);

    raw_value = convertPhysicalToRaw(@CAN_RadarRL::RRL_Object::RRL_Object_Obj39.Py, 0.0625, -128.0);
    copyBitsToByteArrayLE(raw_value, byteArray, 20544, 12);

    raw_value = convertPhysicalToRaw(@CAN_RadarRL::RRL_Object::RRL_Object_Obj39.PxVnce, 0.005, 0.0);
    copyBitsToByteArrayLE(raw_value, byteArray, 20532, 12);

    raw_value = convertPhysicalToRaw(@CAN_RadarRL::RRL_Object::RRL_Object_Obj39.Px, 0.0625, -512.0);
    copyBitsToByteArrayLE(raw_value, byteArray, 20518, 14);

    raw_value = convertPhysicalToRaw(@CAN_RadarRL::RRL_Object::RRL_Object_Obj39.ProbClassConfidence, 2.0, 0.0);
    copyBitsToByteArrayLE(raw_value, byteArray, 20512, 6);

    raw_value = convertPhysicalToRaw(@CAN_RadarRL::RRL_Object::RRL_Object_Obj39.MovingStatus, 1.0, 0.0);
    copyBitsToByteArrayLE(raw_value, byteArray, 20716, 2);

    raw_value = convertPhysicalToRaw(@CAN_RadarRL::RRL_Object::RRL_Object_Obj39.Vy, 0.125, -64.0);
    copyBitsToByteArrayLE(raw_value, byteArray, 20718, 10);

    raw_value = convertPhysicalToRaw(@CAN_RadarRL::RRL_Object::RRL_Object_Obj39.ExistProb, 2.0, 0.0);
    copyBitsToByteArrayLE(raw_value, byteArray, 20728, 6);

    raw_value = convertPhysicalToRaw(@CAN_RadarRL::RRL_Object::RRL_Object_Obj39.PxAyCoVnce, 0.005, -10.0);
    copyBitsToByteArrayLE(raw_value, byteArray, 20844, 12);

    raw_value = convertPhysicalToRaw(@CAN_RadarRL::RRL_Object::RRL_Object_Obj39.VyVnce, 0.005, 0.0);
    copyBitsToByteArrayLE(raw_value, byteArray, 20736, 12);

    raw_value = convertPhysicalToRaw(@CAN_RadarRL::RRL_Object::RRL_Object_Obj39.AxAyCoVnce, 0.005, -10.0);
    copyBitsToByteArrayLE(raw_value, byteArray, 20972, 12);

    raw_value = convertPhysicalToRaw(@CAN_RadarRL::RRL_Object::RRL_Object_Obj39.VyAyCoVnce, 0.005, -10.0);
    copyBitsToByteArrayLE(raw_value, byteArray, 20960, 12);

    raw_value = convertPhysicalToRaw(@CAN_RadarRL::RRL_Object::RRL_Object_Obj39.VyAxCoVnce, 0.005, -10.0);
    copyBitsToByteArrayLE(raw_value, byteArray, 20940, 12);

    raw_value = convertPhysicalToRaw(@CAN_RadarRL::RRL_Object::RRL_Object_Obj39.VxAyCoVnce, 0.005, -10.0);
    copyBitsToByteArrayLE(raw_value, byteArray, 20928, 12);

    raw_value = convertPhysicalToRaw(@CAN_RadarRL::RRL_Object::RRL_Object_Obj39.VxAxCoVnce, 0.005, -10.0);
    copyBitsToByteArrayLE(raw_value, byteArray, 20908, 12);

    raw_value = convertPhysicalToRaw(@CAN_RadarRL::RRL_Object::RRL_Object_Obj39.VxVyCoVnce, 0.005, -10.0);
    copyBitsToByteArrayLE(raw_value, byteArray, 20896, 12);

    raw_value = convertPhysicalToRaw(@CAN_RadarRL::RRL_Object::RRL_Object_Obj39.PyAyCoVnce, 0.005, -10.0);
    copyBitsToByteArrayLE(raw_value, byteArray, 20876, 12);

    raw_value = convertPhysicalToRaw(@CAN_RadarRL::RRL_Object::RRL_Object_Obj39.PyAxCoVnce, 0.005, -10.0);
    copyBitsToByteArrayLE(raw_value, byteArray, 20864, 12);

    raw_value = convertPhysicalToRaw(@CAN_RadarRL::RRL_Object::RRL_Object_Obj39.Age, 1.0, 0.0);
    copyBitsToByteArrayLE(raw_value, byteArray, 20992, 32);

    raw_value = convertPhysicalToRaw(@CAN_RadarRL::RRL_Object::RRL_Object_Obj39.PxAxCoVnce, 0.005, -10.0);
    copyBitsToByteArrayLE(raw_value, byteArray, 20832, 12);

    raw_value = convertPhysicalToRaw(@CAN_RadarRL::RRL_Object::RRL_Object_Obj39.PyVyCoVnce, 0.005, -10.0);
    copyBitsToByteArrayLE(raw_value, byteArray, 20812, 12);

    raw_value = convertPhysicalToRaw(@CAN_RadarRL::RRL_Object::RRL_Object_Obj39.PyVxCoVnce, 0.005, -10.0);
    copyBitsToByteArrayLE(raw_value, byteArray, 20800, 12);

    raw_value = convertPhysicalToRaw(@CAN_RadarRL::RRL_Object::RRL_Object_Obj39.FilterInformation, 1.0, 0.0);
    copyBitsToByteArrayLE(raw_value, byteArray, 20792, 8);

    raw_value = convertPhysicalToRaw(@CAN_RadarRL::RRL_Object::RRL_Object_Obj39.PxVyCoVnce, 0.005, -10.0);
    copyBitsToByteArrayLE(raw_value, byteArray, 20780, 12);

    raw_value = convertPhysicalToRaw(@CAN_RadarRL::RRL_Object::RRL_Object_Obj39.PxVxCoVnce, 0.005, -10.0);
    copyBitsToByteArrayLE(raw_value, byteArray, 20768, 12);

    raw_value = convertPhysicalToRaw(@CAN_RadarRL::RRL_Object::RRL_Object_Obj39.ProbClassType, 1.0, 0.0);
    copyBitsToByteArrayLE(raw_value, byteArray, 20763, 4);

    raw_value = convertPhysicalToRaw(@CAN_RadarRL::RRL_Object::RRL_Object_Obj39.MeasurementStatus, 1.0, 0.0);
    copyBitsToByteArrayLE(raw_value, byteArray, 20760, 3);

    raw_value = convertPhysicalToRaw(@CAN_RadarRL::RRL_Object::RRL_Object_Obj39.PxPyCoVnce, 0.005, -10.0);
    copyBitsToByteArrayLE(raw_value, byteArray, 20748, 12);

    raw_value = convertPhysicalToRaw(@CAN_RadarRL::RRL_Object::RRL_Object_Obj39.ReferencePoint, 1.0, 0.0);
    copyBitsToByteArrayLE(raw_value, byteArray, 20824, 4);
}


void RRL_Object_Obj38_write(byte byteArray[])
{
    qword raw_value;

    raw_value = convertPhysicalToRaw(@CAN_RadarRL::RRL_Object::RRL_Object_Obj38.RCS, 0.2, -102.4);
    copyBitsToByteArrayLE(raw_value, byteArray, 20140, 10);

    raw_value = convertPhysicalToRaw(@CAN_RadarRL::RRL_Object::RRL_Object_Obj38.Width, 0.125, 0.0);
    copyBitsToByteArrayLE(raw_value, byteArray, 20120, 7);

    raw_value = convertPhysicalToRaw(@CAN_RadarRL::RRL_Object::RRL_Object_Obj38.WidthVnce, 0.005, 0.0);
    copyBitsToByteArrayLE(raw_value, byteArray, 20128, 12);

    raw_value = convertPhysicalToRaw(@CAN_RadarRL::RRL_Object::RRL_Object_Obj38.ObjId, 1.0, 0.0);
    copyBitsToByteArrayLE(raw_value, byteArray, 20184, 7);

    raw_value = convertPhysicalToRaw(@CAN_RadarRL::RRL_Object::RRL_Object_Obj38.Ay, 0.0625, -16.0);
    copyBitsToByteArrayLE(raw_value, byteArray, 20150, 9);

    raw_value = convertPhysicalToRaw(@CAN_RadarRL::RRL_Object::RRL_Object_Obj38.AyVnce, 0.005, 0.0);
    copyBitsToByteArrayLE(raw_value, byteArray, 20160, 12);

    raw_value = convertPhysicalToRaw(@CAN_RadarRL::RRL_Object::RRL_Object_Obj38.Vx, 0.0625, -128.0);
    copyBitsToByteArrayLE(raw_value, byteArray, 20172, 12);

    raw_value = convertPhysicalToRaw(@CAN_RadarRL::RRL_Object::RRL_Object_Obj38.AxVnce, 0.005, 0.0);
    copyBitsToByteArrayLE(raw_value, byteArray, 20096, 12);

    raw_value = convertPhysicalToRaw(@CAN_RadarRL::RRL_Object::RRL_Object_Obj38.OrientationYawVnce, 0.0003, 0.0);
    copyBitsToByteArrayLE(raw_value, byteArray, 20108, 12);

    raw_value = convertPhysicalToRaw(@CAN_RadarRL::RRL_Object::RRL_Object_Obj38.PyVnce, 0.005, 0.0);
    copyBitsToByteArrayLE(raw_value, byteArray, 20044, 12);

    raw_value = convertPhysicalToRaw(@CAN_RadarRL::RRL_Object::RRL_Object_Obj38.OrientationYaw, 0.0175, -4.48);
    copyBitsToByteArrayLE(raw_value, byteArray, 20086, 9);

    raw_value = convertPhysicalToRaw(@CAN_RadarRL::RRL_Object::RRL_Object_Obj38.Ax, 0.03125, -16.0);
    copyBitsToByteArrayLE(raw_value, byteArray, 20076, 10);

    raw_value = convertPhysicalToRaw(@CAN_RadarRL::RRL_Object::RRL_Object_Obj38.LengthVnce, 0.005, 0.0);
    copyBitsToByteArrayLE(raw_value, byteArray, 20064, 12);

    raw_value = convertPhysicalToRaw(@CAN_RadarRL::RRL_Object::RRL_Object_Obj38.Length, 0.125, 0.0);
    copyBitsToByteArrayLE(raw_value, byteArray, 20056, 7);

    raw_value = convertPhysicalToRaw(@CAN_RadarRL::RRL_Object::RRL_Object_Obj38.Py, 0.0625, -128.0);
    copyBitsToByteArrayLE(raw_value, byteArray, 20032, 12);

    raw_value = convertPhysicalToRaw(@CAN_RadarRL::RRL_Object::RRL_Object_Obj38.PxVnce, 0.005, 0.0);
    copyBitsToByteArrayLE(raw_value, byteArray, 20020, 12);

    raw_value = convertPhysicalToRaw(@CAN_RadarRL::RRL_Object::RRL_Object_Obj38.Px, 0.0625, -512.0);
    copyBitsToByteArrayLE(raw_value, byteArray, 20006, 14);

    raw_value = convertPhysicalToRaw(@CAN_RadarRL::RRL_Object::RRL_Object_Obj38.ProbClassConfidence, 2.0, 0.0);
    copyBitsToByteArrayLE(raw_value, byteArray, 20000, 6);

    raw_value = convertPhysicalToRaw(@CAN_RadarRL::RRL_Object::RRL_Object_Obj38.MovingStatus, 1.0, 0.0);
    copyBitsToByteArrayLE(raw_value, byteArray, 20204, 2);

    raw_value = convertPhysicalToRaw(@CAN_RadarRL::RRL_Object::RRL_Object_Obj38.VxVnce, 0.005, 0.0);
    copyBitsToByteArrayLE(raw_value, byteArray, 20192, 12);

    raw_value = convertPhysicalToRaw(@CAN_RadarRL::RRL_Object::RRL_Object_Obj38.Vy, 0.125, -64.0);
    copyBitsToByteArrayLE(raw_value, byteArray, 20206, 10);

    raw_value = convertPhysicalToRaw(@CAN_RadarRL::RRL_Object::RRL_Object_Obj38.AxAyCoVnce, 0.005, -10.0);
    copyBitsToByteArrayLE(raw_value, byteArray, 20460, 12);

    raw_value = convertPhysicalToRaw(@CAN_RadarRL::RRL_Object::RRL_Object_Obj38.PxAxCoVnce, 0.005, -10.0);
    copyBitsToByteArrayLE(raw_value, byteArray, 20320, 12);

    raw_value = convertPhysicalToRaw(@CAN_RadarRL::RRL_Object::RRL_Object_Obj38.Age, 1.0, 0.0);
    copyBitsToByteArrayLE(raw_value, byteArray, 20480, 32);

    raw_value = convertPhysicalToRaw(@CAN_RadarRL::RRL_Object::RRL_Object_Obj38.ExistProb, 2.0, 0.0);
    copyBitsToByteArrayLE(raw_value, byteArray, 20216, 6);

    raw_value = convertPhysicalToRaw(@CAN_RadarRL::RRL_Object::RRL_Object_Obj38.VyAyCoVnce, 0.005, -10.0);
    copyBitsToByteArrayLE(raw_value, byteArray, 20448, 12);

    raw_value = convertPhysicalToRaw(@CAN_RadarRL::RRL_Object::RRL_Object_Obj38.VyAxCoVnce, 0.005, -10.0);
    copyBitsToByteArrayLE(raw_value, byteArray, 20428, 12);

    raw_value = convertPhysicalToRaw(@CAN_RadarRL::RRL_Object::RRL_Object_Obj38.VxAyCoVnce, 0.005, -10.0);
    copyBitsToByteArrayLE(raw_value, byteArray, 20416, 12);

    raw_value = convertPhysicalToRaw(@CAN_RadarRL::RRL_Object::RRL_Object_Obj38.VxAxCoVnce, 0.005, -10.0);
    copyBitsToByteArrayLE(raw_value, byteArray, 20396, 12);

    raw_value = convertPhysicalToRaw(@CAN_RadarRL::RRL_Object::RRL_Object_Obj38.PyAyCoVnce, 0.005, -10.0);
    copyBitsToByteArrayLE(raw_value, byteArray, 20364, 12);

    raw_value = convertPhysicalToRaw(@CAN_RadarRL::RRL_Object::RRL_Object_Obj38.PyAxCoVnce, 0.005, -10.0);
    copyBitsToByteArrayLE(raw_value, byteArray, 20352, 12);

    raw_value = convertPhysicalToRaw(@CAN_RadarRL::RRL_Object::RRL_Object_Obj38.PxAyCoVnce, 0.005, -10.0);
    copyBitsToByteArrayLE(raw_value, byteArray, 20332, 12);

    raw_value = convertPhysicalToRaw(@CAN_RadarRL::RRL_Object::RRL_Object_Obj38.VxVyCoVnce, 0.005, -10.0);
    copyBitsToByteArrayLE(raw_value, byteArray, 20384, 12);

    raw_value = convertPhysicalToRaw(@CAN_RadarRL::RRL_Object::RRL_Object_Obj38.ReferencePoint, 1.0, 0.0);
    copyBitsToByteArrayLE(raw_value, byteArray, 20312, 4);

    raw_value = convertPhysicalToRaw(@CAN_RadarRL::RRL_Object::RRL_Object_Obj38.PxVxCoVnce, 0.005, -10.0);
    copyBitsToByteArrayLE(raw_value, byteArray, 20256, 12);

    raw_value = convertPhysicalToRaw(@CAN_RadarRL::RRL_Object::RRL_Object_Obj38.PyVyCoVnce, 0.005, -10.0);
    copyBitsToByteArrayLE(raw_value, byteArray, 20300, 12);

    raw_value = convertPhysicalToRaw(@CAN_RadarRL::RRL_Object::RRL_Object_Obj38.PxPyCoVnce, 0.005, -10.0);
    copyBitsToByteArrayLE(raw_value, byteArray, 20236, 12);

    raw_value = convertPhysicalToRaw(@CAN_RadarRL::RRL_Object::RRL_Object_Obj38.MeasurementStatus, 1.0, 0.0);
    copyBitsToByteArrayLE(raw_value, byteArray, 20248, 3);

    raw_value = convertPhysicalToRaw(@CAN_RadarRL::RRL_Object::RRL_Object_Obj38.ProbClassType, 1.0, 0.0);
    copyBitsToByteArrayLE(raw_value, byteArray, 20251, 4);

    raw_value = convertPhysicalToRaw(@CAN_RadarRL::RRL_Object::RRL_Object_Obj38.VyVnce, 0.005, 0.0);
    copyBitsToByteArrayLE(raw_value, byteArray, 20224, 12);

    raw_value = convertPhysicalToRaw(@CAN_RadarRL::RRL_Object::RRL_Object_Obj38.PxVyCoVnce, 0.005, -10.0);
    copyBitsToByteArrayLE(raw_value, byteArray, 20268, 12);

    raw_value = convertPhysicalToRaw(@CAN_RadarRL::RRL_Object::RRL_Object_Obj38.FilterInformation, 1.0, 0.0);
    copyBitsToByteArrayLE(raw_value, byteArray, 20280, 8);

    raw_value = convertPhysicalToRaw(@CAN_RadarRL::RRL_Object::RRL_Object_Obj38.PyVxCoVnce, 0.005, -10.0);
    copyBitsToByteArrayLE(raw_value, byteArray, 20288, 12);
}


void RRL_Object_Obj37_write(byte byteArray[])
{
    qword raw_value;

    raw_value = convertPhysicalToRaw(@CAN_RadarRL::RRL_Object::RRL_Object_Obj37.AxVnce, 0.005, 0.0);
    copyBitsToByteArrayLE(raw_value, byteArray, 19584, 12);

    raw_value = convertPhysicalToRaw(@CAN_RadarRL::RRL_Object::RRL_Object_Obj37.VxVnce, 0.005, 0.0);
    copyBitsToByteArrayLE(raw_value, byteArray, 19680, 12);

    raw_value = convertPhysicalToRaw(@CAN_RadarRL::RRL_Object::RRL_Object_Obj37.ObjId, 1.0, 0.0);
    copyBitsToByteArrayLE(raw_value, byteArray, 19672, 7);

    raw_value = convertPhysicalToRaw(@CAN_RadarRL::RRL_Object::RRL_Object_Obj37.Vx, 0.0625, -128.0);
    copyBitsToByteArrayLE(raw_value, byteArray, 19660, 12);

    raw_value = convertPhysicalToRaw(@CAN_RadarRL::RRL_Object::RRL_Object_Obj37.AyVnce, 0.005, 0.0);
    copyBitsToByteArrayLE(raw_value, byteArray, 19648, 12);

    raw_value = convertPhysicalToRaw(@CAN_RadarRL::RRL_Object::RRL_Object_Obj37.Ay, 0.0625, -16.0);
    copyBitsToByteArrayLE(raw_value, byteArray, 19638, 9);

    raw_value = convertPhysicalToRaw(@CAN_RadarRL::RRL_Object::RRL_Object_Obj37.RCS, 0.2, -102.4);
    copyBitsToByteArrayLE(raw_value, byteArray, 19628, 10);

    raw_value = convertPhysicalToRaw(@CAN_RadarRL::RRL_Object::RRL_Object_Obj37.WidthVnce, 0.005, 0.0);
    copyBitsToByteArrayLE(raw_value, byteArray, 19616, 12);

    raw_value = convertPhysicalToRaw(@CAN_RadarRL::RRL_Object::RRL_Object_Obj37.Width, 0.125, 0.0);
    copyBitsToByteArrayLE(raw_value, byteArray, 19608, 7);

    raw_value = convertPhysicalToRaw(@CAN_RadarRL::RRL_Object::RRL_Object_Obj37.OrientationYawVnce, 0.0003, 0.0);
    copyBitsToByteArrayLE(raw_value, byteArray, 19596, 12);

    raw_value = convertPhysicalToRaw(@CAN_RadarRL::RRL_Object::RRL_Object_Obj37.Vy, 0.125, -64.0);
    copyBitsToByteArrayLE(raw_value, byteArray, 19694, 10);

    raw_value = convertPhysicalToRaw(@CAN_RadarRL::RRL_Object::RRL_Object_Obj37.OrientationYaw, 0.0175, -4.48);
    copyBitsToByteArrayLE(raw_value, byteArray, 19574, 9);

    raw_value = convertPhysicalToRaw(@CAN_RadarRL::RRL_Object::RRL_Object_Obj37.Ax, 0.03125, -16.0);
    copyBitsToByteArrayLE(raw_value, byteArray, 19564, 10);

    raw_value = convertPhysicalToRaw(@CAN_RadarRL::RRL_Object::RRL_Object_Obj37.LengthVnce, 0.005, 0.0);
    copyBitsToByteArrayLE(raw_value, byteArray, 19552, 12);

    raw_value = convertPhysicalToRaw(@CAN_RadarRL::RRL_Object::RRL_Object_Obj37.Length, 0.125, 0.0);
    copyBitsToByteArrayLE(raw_value, byteArray, 19544, 7);

    raw_value = convertPhysicalToRaw(@CAN_RadarRL::RRL_Object::RRL_Object_Obj37.PyVnce, 0.005, 0.0);
    copyBitsToByteArrayLE(raw_value, byteArray, 19532, 12);

    raw_value = convertPhysicalToRaw(@CAN_RadarRL::RRL_Object::RRL_Object_Obj37.Py, 0.0625, -128.0);
    copyBitsToByteArrayLE(raw_value, byteArray, 19520, 12);

    raw_value = convertPhysicalToRaw(@CAN_RadarRL::RRL_Object::RRL_Object_Obj37.PxVnce, 0.005, 0.0);
    copyBitsToByteArrayLE(raw_value, byteArray, 19508, 12);

    raw_value = convertPhysicalToRaw(@CAN_RadarRL::RRL_Object::RRL_Object_Obj37.Px, 0.0625, -512.0);
    copyBitsToByteArrayLE(raw_value, byteArray, 19494, 14);

    raw_value = convertPhysicalToRaw(@CAN_RadarRL::RRL_Object::RRL_Object_Obj37.ProbClassConfidence, 2.0, 0.0);
    copyBitsToByteArrayLE(raw_value, byteArray, 19488, 6);

    raw_value = convertPhysicalToRaw(@CAN_RadarRL::RRL_Object::RRL_Object_Obj37.MovingStatus, 1.0, 0.0);
    copyBitsToByteArrayLE(raw_value, byteArray, 19692, 2);

    raw_value = convertPhysicalToRaw(@CAN_RadarRL::RRL_Object::RRL_Object_Obj37.Age, 1.0, 0.0);
    copyBitsToByteArrayLE(raw_value, byteArray, 19968, 32);

    raw_value = convertPhysicalToRaw(@CAN_RadarRL::RRL_Object::RRL_Object_Obj37.ExistProb, 2.0, 0.0);
    copyBitsToByteArrayLE(raw_value, byteArray, 19704, 6);

    raw_value = convertPhysicalToRaw(@CAN_RadarRL::RRL_Object::RRL_Object_Obj37.PxAxCoVnce, 0.005, -10.0);
    copyBitsToByteArrayLE(raw_value, byteArray, 19808, 12);

    raw_value = convertPhysicalToRaw(@CAN_RadarRL::RRL_Object::RRL_Object_Obj37.VyVnce, 0.005, 0.0);
    copyBitsToByteArrayLE(raw_value, byteArray, 19712, 12);

    raw_value = convertPhysicalToRaw(@CAN_RadarRL::RRL_Object::RRL_Object_Obj37.VyAyCoVnce, 0.005, -10.0);
    copyBitsToByteArrayLE(raw_value, byteArray, 19936, 12);

    raw_value = convertPhysicalToRaw(@CAN_RadarRL::RRL_Object::RRL_Object_Obj37.VyAxCoVnce, 0.005, -10.0);
    copyBitsToByteArrayLE(raw_value, byteArray, 19916, 12);

    raw_value = convertPhysicalToRaw(@CAN_RadarRL::RRL_Object::RRL_Object_Obj37.VxAyCoVnce, 0.005, -10.0);
    copyBitsToByteArrayLE(raw_value, byteArray, 19904, 12);

    raw_value = convertPhysicalToRaw(@CAN_RadarRL::RRL_Object::RRL_Object_Obj37.VxAxCoVnce, 0.005, -10.0);
    copyBitsToByteArrayLE(raw_value, byteArray, 19884, 12);

    raw_value = convertPhysicalToRaw(@CAN_RadarRL::RRL_Object::RRL_Object_Obj37.VxVyCoVnce, 0.005, -10.0);
    copyBitsToByteArrayLE(raw_value, byteArray, 19872, 12);

    raw_value = convertPhysicalToRaw(@CAN_RadarRL::RRL_Object::RRL_Object_Obj37.PyAyCoVnce, 0.005, -10.0);
    copyBitsToByteArrayLE(raw_value, byteArray, 19852, 12);

    raw_value = convertPhysicalToRaw(@CAN_RadarRL::RRL_Object::RRL_Object_Obj37.PyAxCoVnce, 0.005, -10.0);
    copyBitsToByteArrayLE(raw_value, byteArray, 19840, 12);

    raw_value = convertPhysicalToRaw(@CAN_RadarRL::RRL_Object::RRL_Object_Obj37.PxAyCoVnce, 0.005, -10.0);
    copyBitsToByteArrayLE(raw_value, byteArray, 19820, 12);

    raw_value = convertPhysicalToRaw(@CAN_RadarRL::RRL_Object::RRL_Object_Obj37.AxAyCoVnce, 0.005, -10.0);
    copyBitsToByteArrayLE(raw_value, byteArray, 19948, 12);

    raw_value = convertPhysicalToRaw(@CAN_RadarRL::RRL_Object::RRL_Object_Obj37.ReferencePoint, 1.0, 0.0);
    copyBitsToByteArrayLE(raw_value, byteArray, 19800, 4);

    raw_value = convertPhysicalToRaw(@CAN_RadarRL::RRL_Object::RRL_Object_Obj37.PyVxCoVnce, 0.005, -10.0);
    copyBitsToByteArrayLE(raw_value, byteArray, 19776, 12);

    raw_value = convertPhysicalToRaw(@CAN_RadarRL::RRL_Object::RRL_Object_Obj37.FilterInformation, 1.0, 0.0);
    copyBitsToByteArrayLE(raw_value, byteArray, 19768, 8);

    raw_value = convertPhysicalToRaw(@CAN_RadarRL::RRL_Object::RRL_Object_Obj37.PxVyCoVnce, 0.005, -10.0);
    copyBitsToByteArrayLE(raw_value, byteArray, 19756, 12);

    raw_value = convertPhysicalToRaw(@CAN_RadarRL::RRL_Object::RRL_Object_Obj37.PxVxCoVnce, 0.005, -10.0);
    copyBitsToByteArrayLE(raw_value, byteArray, 19744, 12);

    raw_value = convertPhysicalToRaw(@CAN_RadarRL::RRL_Object::RRL_Object_Obj37.ProbClassType, 1.0, 0.0);
    copyBitsToByteArrayLE(raw_value, byteArray, 19739, 4);

    raw_value = convertPhysicalToRaw(@CAN_RadarRL::RRL_Object::RRL_Object_Obj37.MeasurementStatus, 1.0, 0.0);
    copyBitsToByteArrayLE(raw_value, byteArray, 19736, 3);

    raw_value = convertPhysicalToRaw(@CAN_RadarRL::RRL_Object::RRL_Object_Obj37.PxPyCoVnce, 0.005, -10.0);
    copyBitsToByteArrayLE(raw_value, byteArray, 19724, 12);

    raw_value = convertPhysicalToRaw(@CAN_RadarRL::RRL_Object::RRL_Object_Obj37.PyVyCoVnce, 0.005, -10.0);
    copyBitsToByteArrayLE(raw_value, byteArray, 19788, 12);
}


void RRL_Object_Obj36_write(byte byteArray[])
{
    qword raw_value;

    raw_value = convertPhysicalToRaw(@CAN_RadarRL::RRL_Object::RRL_Object_Obj36.Ay, 0.0625, -16.0);
    copyBitsToByteArrayLE(raw_value, byteArray, 19126, 9);

    raw_value = convertPhysicalToRaw(@CAN_RadarRL::RRL_Object::RRL_Object_Obj36.Width, 0.125, 0.0);
    copyBitsToByteArrayLE(raw_value, byteArray, 19096, 7);

    raw_value = convertPhysicalToRaw(@CAN_RadarRL::RRL_Object::RRL_Object_Obj36.WidthVnce, 0.005, 0.0);
    copyBitsToByteArrayLE(raw_value, byteArray, 19104, 12);

    raw_value = convertPhysicalToRaw(@CAN_RadarRL::RRL_Object::RRL_Object_Obj36.VxVnce, 0.005, 0.0);
    copyBitsToByteArrayLE(raw_value, byteArray, 19168, 12);

    raw_value = convertPhysicalToRaw(@CAN_RadarRL::RRL_Object::RRL_Object_Obj36.AyVnce, 0.005, 0.0);
    copyBitsToByteArrayLE(raw_value, byteArray, 19136, 12);

    raw_value = convertPhysicalToRaw(@CAN_RadarRL::RRL_Object::RRL_Object_Obj36.Vx, 0.0625, -128.0);
    copyBitsToByteArrayLE(raw_value, byteArray, 19148, 12);

    raw_value = convertPhysicalToRaw(@CAN_RadarRL::RRL_Object::RRL_Object_Obj36.ObjId, 1.0, 0.0);
    copyBitsToByteArrayLE(raw_value, byteArray, 19160, 7);

    raw_value = convertPhysicalToRaw(@CAN_RadarRL::RRL_Object::RRL_Object_Obj36.AxVnce, 0.005, 0.0);
    copyBitsToByteArrayLE(raw_value, byteArray, 19072, 12);

    raw_value = convertPhysicalToRaw(@CAN_RadarRL::RRL_Object::RRL_Object_Obj36.OrientationYawVnce, 0.0003, 0.0);
    copyBitsToByteArrayLE(raw_value, byteArray, 19084, 12);

    raw_value = convertPhysicalToRaw(@CAN_RadarRL::RRL_Object::RRL_Object_Obj36.PyVnce, 0.005, 0.0);
    copyBitsToByteArrayLE(raw_value, byteArray, 19020, 12);

    raw_value = convertPhysicalToRaw(@CAN_RadarRL::RRL_Object::RRL_Object_Obj36.OrientationYaw, 0.0175, -4.48);
    copyBitsToByteArrayLE(raw_value, byteArray, 19062, 9);

    raw_value = convertPhysicalToRaw(@CAN_RadarRL::RRL_Object::RRL_Object_Obj36.Ax, 0.03125, -16.0);
    copyBitsToByteArrayLE(raw_value, byteArray, 19052, 10);

    raw_value = convertPhysicalToRaw(@CAN_RadarRL::RRL_Object::RRL_Object_Obj36.LengthVnce, 0.005, 0.0);
    copyBitsToByteArrayLE(raw_value, byteArray, 19040, 12);

    raw_value = convertPhysicalToRaw(@CAN_RadarRL::RRL_Object::RRL_Object_Obj36.Length, 0.125, 0.0);
    copyBitsToByteArrayLE(raw_value, byteArray, 19032, 7);

    raw_value = convertPhysicalToRaw(@CAN_RadarRL::RRL_Object::RRL_Object_Obj36.Py, 0.0625, -128.0);
    copyBitsToByteArrayLE(raw_value, byteArray, 19008, 12);

    raw_value = convertPhysicalToRaw(@CAN_RadarRL::RRL_Object::RRL_Object_Obj36.PxVnce, 0.005, 0.0);
    copyBitsToByteArrayLE(raw_value, byteArray, 18996, 12);

    raw_value = convertPhysicalToRaw(@CAN_RadarRL::RRL_Object::RRL_Object_Obj36.Px, 0.0625, -512.0);
    copyBitsToByteArrayLE(raw_value, byteArray, 18982, 14);

    raw_value = convertPhysicalToRaw(@CAN_RadarRL::RRL_Object::RRL_Object_Obj36.ProbClassConfidence, 2.0, 0.0);
    copyBitsToByteArrayLE(raw_value, byteArray, 18976, 6);

    raw_value = convertPhysicalToRaw(@CAN_RadarRL::RRL_Object::RRL_Object_Obj36.Vy, 0.125, -64.0);
    copyBitsToByteArrayLE(raw_value, byteArray, 19182, 10);

    raw_value = convertPhysicalToRaw(@CAN_RadarRL::RRL_Object::RRL_Object_Obj36.MovingStatus, 1.0, 0.0);
    copyBitsToByteArrayLE(raw_value, byteArray, 19180, 2);

    raw_value = convertPhysicalToRaw(@CAN_RadarRL::RRL_Object::RRL_Object_Obj36.RCS, 0.2, -102.4);
    copyBitsToByteArrayLE(raw_value, byteArray, 19116, 10);

    raw_value = convertPhysicalToRaw(@CAN_RadarRL::RRL_Object::RRL_Object_Obj36.ExistProb, 2.0, 0.0);
    copyBitsToByteArrayLE(raw_value, byteArray, 19192, 6);

    raw_value = convertPhysicalToRaw(@CAN_RadarRL::RRL_Object::RRL_Object_Obj36.PxAxCoVnce, 0.005, -10.0);
    copyBitsToByteArrayLE(raw_value, byteArray, 19296, 12);

    raw_value = convertPhysicalToRaw(@CAN_RadarRL::RRL_Object::RRL_Object_Obj36.AxAyCoVnce, 0.005, -10.0);
    copyBitsToByteArrayLE(raw_value, byteArray, 19436, 12);

    raw_value = convertPhysicalToRaw(@CAN_RadarRL::RRL_Object::RRL_Object_Obj36.VyAyCoVnce, 0.005, -10.0);
    copyBitsToByteArrayLE(raw_value, byteArray, 19424, 12);

    raw_value = convertPhysicalToRaw(@CAN_RadarRL::RRL_Object::RRL_Object_Obj36.VyAxCoVnce, 0.005, -10.0);
    copyBitsToByteArrayLE(raw_value, byteArray, 19404, 12);

    raw_value = convertPhysicalToRaw(@CAN_RadarRL::RRL_Object::RRL_Object_Obj36.VxAyCoVnce, 0.005, -10.0);
    copyBitsToByteArrayLE(raw_value, byteArray, 19392, 12);

    raw_value = convertPhysicalToRaw(@CAN_RadarRL::RRL_Object::RRL_Object_Obj36.VxAxCoVnce, 0.005, -10.0);
    copyBitsToByteArrayLE(raw_value, byteArray, 19372, 12);

    raw_value = convertPhysicalToRaw(@CAN_RadarRL::RRL_Object::RRL_Object_Obj36.VxVyCoVnce, 0.005, -10.0);
    copyBitsToByteArrayLE(raw_value, byteArray, 19360, 12);

    raw_value = convertPhysicalToRaw(@CAN_RadarRL::RRL_Object::RRL_Object_Obj36.PyAyCoVnce, 0.005, -10.0);
    copyBitsToByteArrayLE(raw_value, byteArray, 19340, 12);

    raw_value = convertPhysicalToRaw(@CAN_RadarRL::RRL_Object::RRL_Object_Obj36.PyAxCoVnce, 0.005, -10.0);
    copyBitsToByteArrayLE(raw_value, byteArray, 19328, 12);

    raw_value = convertPhysicalToRaw(@CAN_RadarRL::RRL_Object::RRL_Object_Obj36.PxAyCoVnce, 0.005, -10.0);
    copyBitsToByteArrayLE(raw_value, byteArray, 19308, 12);

    raw_value = convertPhysicalToRaw(@CAN_RadarRL::RRL_Object::RRL_Object_Obj36.VyVnce, 0.005, 0.0);
    copyBitsToByteArrayLE(raw_value, byteArray, 19200, 12);

    raw_value = convertPhysicalToRaw(@CAN_RadarRL::RRL_Object::RRL_Object_Obj36.ReferencePoint, 1.0, 0.0);
    copyBitsToByteArrayLE(raw_value, byteArray, 19288, 4);

    raw_value = convertPhysicalToRaw(@CAN_RadarRL::RRL_Object::RRL_Object_Obj36.PyVxCoVnce, 0.005, -10.0);
    copyBitsToByteArrayLE(raw_value, byteArray, 19264, 12);

    raw_value = convertPhysicalToRaw(@CAN_RadarRL::RRL_Object::RRL_Object_Obj36.FilterInformation, 1.0, 0.0);
    copyBitsToByteArrayLE(raw_value, byteArray, 19256, 8);

    raw_value = convertPhysicalToRaw(@CAN_RadarRL::RRL_Object::RRL_Object_Obj36.Age, 1.0, 0.0);
    copyBitsToByteArrayLE(raw_value, byteArray, 19456, 32);

    raw_value = convertPhysicalToRaw(@CAN_RadarRL::RRL_Object::RRL_Object_Obj36.PxVyCoVnce, 0.005, -10.0);
    copyBitsToByteArrayLE(raw_value, byteArray, 19244, 12);

    raw_value = convertPhysicalToRaw(@CAN_RadarRL::RRL_Object::RRL_Object_Obj36.PxVxCoVnce, 0.005, -10.0);
    copyBitsToByteArrayLE(raw_value, byteArray, 19232, 12);

    raw_value = convertPhysicalToRaw(@CAN_RadarRL::RRL_Object::RRL_Object_Obj36.ProbClassType, 1.0, 0.0);
    copyBitsToByteArrayLE(raw_value, byteArray, 19227, 4);

    raw_value = convertPhysicalToRaw(@CAN_RadarRL::RRL_Object::RRL_Object_Obj36.MeasurementStatus, 1.0, 0.0);
    copyBitsToByteArrayLE(raw_value, byteArray, 19224, 3);

    raw_value = convertPhysicalToRaw(@CAN_RadarRL::RRL_Object::RRL_Object_Obj36.PxPyCoVnce, 0.005, -10.0);
    copyBitsToByteArrayLE(raw_value, byteArray, 19212, 12);

    raw_value = convertPhysicalToRaw(@CAN_RadarRL::RRL_Object::RRL_Object_Obj36.PyVyCoVnce, 0.005, -10.0);
    copyBitsToByteArrayLE(raw_value, byteArray, 19276, 12);
}


void RRL_Object_Obj35_write(byte byteArray[])
{
    qword raw_value;

    raw_value = convertPhysicalToRaw(@CAN_RadarRL::RRL_Object::RRL_Object_Obj35.RCS, 0.2, -102.4);
    copyBitsToByteArrayLE(raw_value, byteArray, 18604, 10);

    raw_value = convertPhysicalToRaw(@CAN_RadarRL::RRL_Object::RRL_Object_Obj35.Width, 0.125, 0.0);
    copyBitsToByteArrayLE(raw_value, byteArray, 18584, 7);

    raw_value = convertPhysicalToRaw(@CAN_RadarRL::RRL_Object::RRL_Object_Obj35.WidthVnce, 0.005, 0.0);
    copyBitsToByteArrayLE(raw_value, byteArray, 18592, 12);

    raw_value = convertPhysicalToRaw(@CAN_RadarRL::RRL_Object::RRL_Object_Obj35.ObjId, 1.0, 0.0);
    copyBitsToByteArrayLE(raw_value, byteArray, 18648, 7);

    raw_value = convertPhysicalToRaw(@CAN_RadarRL::RRL_Object::RRL_Object_Obj35.Ay, 0.0625, -16.0);
    copyBitsToByteArrayLE(raw_value, byteArray, 18614, 9);

    raw_value = convertPhysicalToRaw(@CAN_RadarRL::RRL_Object::RRL_Object_Obj35.AyVnce, 0.005, 0.0);
    copyBitsToByteArrayLE(raw_value, byteArray, 18624, 12);

    raw_value = convertPhysicalToRaw(@CAN_RadarRL::RRL_Object::RRL_Object_Obj35.Vx, 0.0625, -128.0);
    copyBitsToByteArrayLE(raw_value, byteArray, 18636, 12);

    raw_value = convertPhysicalToRaw(@CAN_RadarRL::RRL_Object::RRL_Object_Obj35.AxVnce, 0.005, 0.0);
    copyBitsToByteArrayLE(raw_value, byteArray, 18560, 12);

    raw_value = convertPhysicalToRaw(@CAN_RadarRL::RRL_Object::RRL_Object_Obj35.OrientationYawVnce, 0.0003, 0.0);
    copyBitsToByteArrayLE(raw_value, byteArray, 18572, 12);

    raw_value = convertPhysicalToRaw(@CAN_RadarRL::RRL_Object::RRL_Object_Obj35.PyVnce, 0.005, 0.0);
    copyBitsToByteArrayLE(raw_value, byteArray, 18508, 12);

    raw_value = convertPhysicalToRaw(@CAN_RadarRL::RRL_Object::RRL_Object_Obj35.OrientationYaw, 0.0175, -4.48);
    copyBitsToByteArrayLE(raw_value, byteArray, 18550, 9);

    raw_value = convertPhysicalToRaw(@CAN_RadarRL::RRL_Object::RRL_Object_Obj35.Ax, 0.03125, -16.0);
    copyBitsToByteArrayLE(raw_value, byteArray, 18540, 10);

    raw_value = convertPhysicalToRaw(@CAN_RadarRL::RRL_Object::RRL_Object_Obj35.LengthVnce, 0.005, 0.0);
    copyBitsToByteArrayLE(raw_value, byteArray, 18528, 12);

    raw_value = convertPhysicalToRaw(@CAN_RadarRL::RRL_Object::RRL_Object_Obj35.Length, 0.125, 0.0);
    copyBitsToByteArrayLE(raw_value, byteArray, 18520, 7);

    raw_value = convertPhysicalToRaw(@CAN_RadarRL::RRL_Object::RRL_Object_Obj35.Py, 0.0625, -128.0);
    copyBitsToByteArrayLE(raw_value, byteArray, 18496, 12);

    raw_value = convertPhysicalToRaw(@CAN_RadarRL::RRL_Object::RRL_Object_Obj35.PxVnce, 0.005, 0.0);
    copyBitsToByteArrayLE(raw_value, byteArray, 18484, 12);

    raw_value = convertPhysicalToRaw(@CAN_RadarRL::RRL_Object::RRL_Object_Obj35.Px, 0.0625, -512.0);
    copyBitsToByteArrayLE(raw_value, byteArray, 18470, 14);

    raw_value = convertPhysicalToRaw(@CAN_RadarRL::RRL_Object::RRL_Object_Obj35.ProbClassConfidence, 2.0, 0.0);
    copyBitsToByteArrayLE(raw_value, byteArray, 18464, 6);

    raw_value = convertPhysicalToRaw(@CAN_RadarRL::RRL_Object::RRL_Object_Obj35.MovingStatus, 1.0, 0.0);
    copyBitsToByteArrayLE(raw_value, byteArray, 18668, 2);

    raw_value = convertPhysicalToRaw(@CAN_RadarRL::RRL_Object::RRL_Object_Obj35.VxVnce, 0.005, 0.0);
    copyBitsToByteArrayLE(raw_value, byteArray, 18656, 12);

    raw_value = convertPhysicalToRaw(@CAN_RadarRL::RRL_Object::RRL_Object_Obj35.Vy, 0.125, -64.0);
    copyBitsToByteArrayLE(raw_value, byteArray, 18670, 10);

    raw_value = convertPhysicalToRaw(@CAN_RadarRL::RRL_Object::RRL_Object_Obj35.AxAyCoVnce, 0.005, -10.0);
    copyBitsToByteArrayLE(raw_value, byteArray, 18924, 12);

    raw_value = convertPhysicalToRaw(@CAN_RadarRL::RRL_Object::RRL_Object_Obj35.PxAxCoVnce, 0.005, -10.0);
    copyBitsToByteArrayLE(raw_value, byteArray, 18784, 12);

    raw_value = convertPhysicalToRaw(@CAN_RadarRL::RRL_Object::RRL_Object_Obj35.Age, 1.0, 0.0);
    copyBitsToByteArrayLE(raw_value, byteArray, 18944, 32);

    raw_value = convertPhysicalToRaw(@CAN_RadarRL::RRL_Object::RRL_Object_Obj35.ExistProb, 2.0, 0.0);
    copyBitsToByteArrayLE(raw_value, byteArray, 18680, 6);

    raw_value = convertPhysicalToRaw(@CAN_RadarRL::RRL_Object::RRL_Object_Obj35.VyAyCoVnce, 0.005, -10.0);
    copyBitsToByteArrayLE(raw_value, byteArray, 18912, 12);

    raw_value = convertPhysicalToRaw(@CAN_RadarRL::RRL_Object::RRL_Object_Obj35.VyAxCoVnce, 0.005, -10.0);
    copyBitsToByteArrayLE(raw_value, byteArray, 18892, 12);

    raw_value = convertPhysicalToRaw(@CAN_RadarRL::RRL_Object::RRL_Object_Obj35.VxAyCoVnce, 0.005, -10.0);
    copyBitsToByteArrayLE(raw_value, byteArray, 18880, 12);

    raw_value = convertPhysicalToRaw(@CAN_RadarRL::RRL_Object::RRL_Object_Obj35.VxAxCoVnce, 0.005, -10.0);
    copyBitsToByteArrayLE(raw_value, byteArray, 18860, 12);

    raw_value = convertPhysicalToRaw(@CAN_RadarRL::RRL_Object::RRL_Object_Obj35.PyAyCoVnce, 0.005, -10.0);
    copyBitsToByteArrayLE(raw_value, byteArray, 18828, 12);

    raw_value = convertPhysicalToRaw(@CAN_RadarRL::RRL_Object::RRL_Object_Obj35.PyAxCoVnce, 0.005, -10.0);
    copyBitsToByteArrayLE(raw_value, byteArray, 18816, 12);

    raw_value = convertPhysicalToRaw(@CAN_RadarRL::RRL_Object::RRL_Object_Obj35.PxAyCoVnce, 0.005, -10.0);
    copyBitsToByteArrayLE(raw_value, byteArray, 18796, 12);

    raw_value = convertPhysicalToRaw(@CAN_RadarRL::RRL_Object::RRL_Object_Obj35.VxVyCoVnce, 0.005, -10.0);
    copyBitsToByteArrayLE(raw_value, byteArray, 18848, 12);

    raw_value = convertPhysicalToRaw(@CAN_RadarRL::RRL_Object::RRL_Object_Obj35.ReferencePoint, 1.0, 0.0);
    copyBitsToByteArrayLE(raw_value, byteArray, 18776, 4);

    raw_value = convertPhysicalToRaw(@CAN_RadarRL::RRL_Object::RRL_Object_Obj35.PxVxCoVnce, 0.005, -10.0);
    copyBitsToByteArrayLE(raw_value, byteArray, 18720, 12);

    raw_value = convertPhysicalToRaw(@CAN_RadarRL::RRL_Object::RRL_Object_Obj35.PyVyCoVnce, 0.005, -10.0);
    copyBitsToByteArrayLE(raw_value, byteArray, 18764, 12);

    raw_value = convertPhysicalToRaw(@CAN_RadarRL::RRL_Object::RRL_Object_Obj35.PxPyCoVnce, 0.005, -10.0);
    copyBitsToByteArrayLE(raw_value, byteArray, 18700, 12);

    raw_value = convertPhysicalToRaw(@CAN_RadarRL::RRL_Object::RRL_Object_Obj35.MeasurementStatus, 1.0, 0.0);
    copyBitsToByteArrayLE(raw_value, byteArray, 18712, 3);

    raw_value = convertPhysicalToRaw(@CAN_RadarRL::RRL_Object::RRL_Object_Obj35.ProbClassType, 1.0, 0.0);
    copyBitsToByteArrayLE(raw_value, byteArray, 18715, 4);

    raw_value = convertPhysicalToRaw(@CAN_RadarRL::RRL_Object::RRL_Object_Obj35.VyVnce, 0.005, 0.0);
    copyBitsToByteArrayLE(raw_value, byteArray, 18688, 12);

    raw_value = convertPhysicalToRaw(@CAN_RadarRL::RRL_Object::RRL_Object_Obj35.PxVyCoVnce, 0.005, -10.0);
    copyBitsToByteArrayLE(raw_value, byteArray, 18732, 12);

    raw_value = convertPhysicalToRaw(@CAN_RadarRL::RRL_Object::RRL_Object_Obj35.FilterInformation, 1.0, 0.0);
    copyBitsToByteArrayLE(raw_value, byteArray, 18744, 8);

    raw_value = convertPhysicalToRaw(@CAN_RadarRL::RRL_Object::RRL_Object_Obj35.PyVxCoVnce, 0.005, -10.0);
    copyBitsToByteArrayLE(raw_value, byteArray, 18752, 12);
}


void RRL_Object_Obj34_write(byte byteArray[])
{
    qword raw_value;

    raw_value = convertPhysicalToRaw(@CAN_RadarRL::RRL_Object::RRL_Object_Obj34.AxVnce, 0.005, 0.0);
    copyBitsToByteArrayLE(raw_value, byteArray, 18048, 12);

    raw_value = convertPhysicalToRaw(@CAN_RadarRL::RRL_Object::RRL_Object_Obj34.VxVnce, 0.005, 0.0);
    copyBitsToByteArrayLE(raw_value, byteArray, 18144, 12);

    raw_value = convertPhysicalToRaw(@CAN_RadarRL::RRL_Object::RRL_Object_Obj34.ObjId, 1.0, 0.0);
    copyBitsToByteArrayLE(raw_value, byteArray, 18136, 7);

    raw_value = convertPhysicalToRaw(@CAN_RadarRL::RRL_Object::RRL_Object_Obj34.Vx, 0.0625, -128.0);
    copyBitsToByteArrayLE(raw_value, byteArray, 18124, 12);

    raw_value = convertPhysicalToRaw(@CAN_RadarRL::RRL_Object::RRL_Object_Obj34.AyVnce, 0.005, 0.0);
    copyBitsToByteArrayLE(raw_value, byteArray, 18112, 12);

    raw_value = convertPhysicalToRaw(@CAN_RadarRL::RRL_Object::RRL_Object_Obj34.Ay, 0.0625, -16.0);
    copyBitsToByteArrayLE(raw_value, byteArray, 18102, 9);

    raw_value = convertPhysicalToRaw(@CAN_RadarRL::RRL_Object::RRL_Object_Obj34.RCS, 0.2, -102.4);
    copyBitsToByteArrayLE(raw_value, byteArray, 18092, 10);

    raw_value = convertPhysicalToRaw(@CAN_RadarRL::RRL_Object::RRL_Object_Obj34.WidthVnce, 0.005, 0.0);
    copyBitsToByteArrayLE(raw_value, byteArray, 18080, 12);

    raw_value = convertPhysicalToRaw(@CAN_RadarRL::RRL_Object::RRL_Object_Obj34.Width, 0.125, 0.0);
    copyBitsToByteArrayLE(raw_value, byteArray, 18072, 7);

    raw_value = convertPhysicalToRaw(@CAN_RadarRL::RRL_Object::RRL_Object_Obj34.OrientationYawVnce, 0.0003, 0.0);
    copyBitsToByteArrayLE(raw_value, byteArray, 18060, 12);

    raw_value = convertPhysicalToRaw(@CAN_RadarRL::RRL_Object::RRL_Object_Obj34.Vy, 0.125, -64.0);
    copyBitsToByteArrayLE(raw_value, byteArray, 18158, 10);

    raw_value = convertPhysicalToRaw(@CAN_RadarRL::RRL_Object::RRL_Object_Obj34.OrientationYaw, 0.0175, -4.48);
    copyBitsToByteArrayLE(raw_value, byteArray, 18038, 9);

    raw_value = convertPhysicalToRaw(@CAN_RadarRL::RRL_Object::RRL_Object_Obj34.Ax, 0.03125, -16.0);
    copyBitsToByteArrayLE(raw_value, byteArray, 18028, 10);

    raw_value = convertPhysicalToRaw(@CAN_RadarRL::RRL_Object::RRL_Object_Obj34.LengthVnce, 0.005, 0.0);
    copyBitsToByteArrayLE(raw_value, byteArray, 18016, 12);

    raw_value = convertPhysicalToRaw(@CAN_RadarRL::RRL_Object::RRL_Object_Obj34.Length, 0.125, 0.0);
    copyBitsToByteArrayLE(raw_value, byteArray, 18008, 7);

    raw_value = convertPhysicalToRaw(@CAN_RadarRL::RRL_Object::RRL_Object_Obj34.PyVnce, 0.005, 0.0);
    copyBitsToByteArrayLE(raw_value, byteArray, 17996, 12);

    raw_value = convertPhysicalToRaw(@CAN_RadarRL::RRL_Object::RRL_Object_Obj34.Py, 0.0625, -128.0);
    copyBitsToByteArrayLE(raw_value, byteArray, 17984, 12);

    raw_value = convertPhysicalToRaw(@CAN_RadarRL::RRL_Object::RRL_Object_Obj34.PxVnce, 0.005, 0.0);
    copyBitsToByteArrayLE(raw_value, byteArray, 17972, 12);

    raw_value = convertPhysicalToRaw(@CAN_RadarRL::RRL_Object::RRL_Object_Obj34.Px, 0.0625, -512.0);
    copyBitsToByteArrayLE(raw_value, byteArray, 17958, 14);

    raw_value = convertPhysicalToRaw(@CAN_RadarRL::RRL_Object::RRL_Object_Obj34.ProbClassConfidence, 2.0, 0.0);
    copyBitsToByteArrayLE(raw_value, byteArray, 17952, 6);

    raw_value = convertPhysicalToRaw(@CAN_RadarRL::RRL_Object::RRL_Object_Obj34.MovingStatus, 1.0, 0.0);
    copyBitsToByteArrayLE(raw_value, byteArray, 18156, 2);

    raw_value = convertPhysicalToRaw(@CAN_RadarRL::RRL_Object::RRL_Object_Obj34.Age, 1.0, 0.0);
    copyBitsToByteArrayLE(raw_value, byteArray, 18432, 32);

    raw_value = convertPhysicalToRaw(@CAN_RadarRL::RRL_Object::RRL_Object_Obj34.ExistProb, 2.0, 0.0);
    copyBitsToByteArrayLE(raw_value, byteArray, 18168, 6);

    raw_value = convertPhysicalToRaw(@CAN_RadarRL::RRL_Object::RRL_Object_Obj34.PxAxCoVnce, 0.005, -10.0);
    copyBitsToByteArrayLE(raw_value, byteArray, 18272, 12);

    raw_value = convertPhysicalToRaw(@CAN_RadarRL::RRL_Object::RRL_Object_Obj34.VyVnce, 0.005, 0.0);
    copyBitsToByteArrayLE(raw_value, byteArray, 18176, 12);

    raw_value = convertPhysicalToRaw(@CAN_RadarRL::RRL_Object::RRL_Object_Obj34.AxAyCoVnce, 0.005, -10.0);
    copyBitsToByteArrayLE(raw_value, byteArray, 18412, 12);

    raw_value = convertPhysicalToRaw(@CAN_RadarRL::RRL_Object::RRL_Object_Obj34.VyAyCoVnce, 0.005, -10.0);
    copyBitsToByteArrayLE(raw_value, byteArray, 18400, 12);

    raw_value = convertPhysicalToRaw(@CAN_RadarRL::RRL_Object::RRL_Object_Obj34.VyAxCoVnce, 0.005, -10.0);
    copyBitsToByteArrayLE(raw_value, byteArray, 18380, 12);

    raw_value = convertPhysicalToRaw(@CAN_RadarRL::RRL_Object::RRL_Object_Obj34.VxAyCoVnce, 0.005, -10.0);
    copyBitsToByteArrayLE(raw_value, byteArray, 18368, 12);

    raw_value = convertPhysicalToRaw(@CAN_RadarRL::RRL_Object::RRL_Object_Obj34.VxAxCoVnce, 0.005, -10.0);
    copyBitsToByteArrayLE(raw_value, byteArray, 18348, 12);

    raw_value = convertPhysicalToRaw(@CAN_RadarRL::RRL_Object::RRL_Object_Obj34.PyAyCoVnce, 0.005, -10.0);
    copyBitsToByteArrayLE(raw_value, byteArray, 18316, 12);

    raw_value = convertPhysicalToRaw(@CAN_RadarRL::RRL_Object::RRL_Object_Obj34.PyAxCoVnce, 0.005, -10.0);
    copyBitsToByteArrayLE(raw_value, byteArray, 18304, 12);

    raw_value = convertPhysicalToRaw(@CAN_RadarRL::RRL_Object::RRL_Object_Obj34.PxAyCoVnce, 0.005, -10.0);
    copyBitsToByteArrayLE(raw_value, byteArray, 18284, 12);

    raw_value = convertPhysicalToRaw(@CAN_RadarRL::RRL_Object::RRL_Object_Obj34.VxVyCoVnce, 0.005, -10.0);
    copyBitsToByteArrayLE(raw_value, byteArray, 18336, 12);

    raw_value = convertPhysicalToRaw(@CAN_RadarRL::RRL_Object::RRL_Object_Obj34.ReferencePoint, 1.0, 0.0);
    copyBitsToByteArrayLE(raw_value, byteArray, 18264, 4);

    raw_value = convertPhysicalToRaw(@CAN_RadarRL::RRL_Object::RRL_Object_Obj34.PxVxCoVnce, 0.005, -10.0);
    copyBitsToByteArrayLE(raw_value, byteArray, 18208, 12);

    raw_value = convertPhysicalToRaw(@CAN_RadarRL::RRL_Object::RRL_Object_Obj34.PyVyCoVnce, 0.005, -10.0);
    copyBitsToByteArrayLE(raw_value, byteArray, 18252, 12);

    raw_value = convertPhysicalToRaw(@CAN_RadarRL::RRL_Object::RRL_Object_Obj34.MeasurementStatus, 1.0, 0.0);
    copyBitsToByteArrayLE(raw_value, byteArray, 18200, 3);

    raw_value = convertPhysicalToRaw(@CAN_RadarRL::RRL_Object::RRL_Object_Obj34.ProbClassType, 1.0, 0.0);
    copyBitsToByteArrayLE(raw_value, byteArray, 18203, 4);

    raw_value = convertPhysicalToRaw(@CAN_RadarRL::RRL_Object::RRL_Object_Obj34.PxPyCoVnce, 0.005, -10.0);
    copyBitsToByteArrayLE(raw_value, byteArray, 18188, 12);

    raw_value = convertPhysicalToRaw(@CAN_RadarRL::RRL_Object::RRL_Object_Obj34.PxVyCoVnce, 0.005, -10.0);
    copyBitsToByteArrayLE(raw_value, byteArray, 18220, 12);

    raw_value = convertPhysicalToRaw(@CAN_RadarRL::RRL_Object::RRL_Object_Obj34.FilterInformation, 1.0, 0.0);
    copyBitsToByteArrayLE(raw_value, byteArray, 18232, 8);

    raw_value = convertPhysicalToRaw(@CAN_RadarRL::RRL_Object::RRL_Object_Obj34.PyVxCoVnce, 0.005, -10.0);
    copyBitsToByteArrayLE(raw_value, byteArray, 18240, 12);
}


void RRL_Object_Obj33_write(byte byteArray[])
{
    qword raw_value;

    raw_value = convertPhysicalToRaw(@CAN_RadarRL::RRL_Object::RRL_Object_Obj33.AxVnce, 0.005, 0.0);
    copyBitsToByteArrayLE(raw_value, byteArray, 17536, 12);

    raw_value = convertPhysicalToRaw(@CAN_RadarRL::RRL_Object::RRL_Object_Obj33.VxVnce, 0.005, 0.0);
    copyBitsToByteArrayLE(raw_value, byteArray, 17632, 12);

    raw_value = convertPhysicalToRaw(@CAN_RadarRL::RRL_Object::RRL_Object_Obj33.ObjId, 1.0, 0.0);
    copyBitsToByteArrayLE(raw_value, byteArray, 17624, 7);

    raw_value = convertPhysicalToRaw(@CAN_RadarRL::RRL_Object::RRL_Object_Obj33.Vx, 0.0625, -128.0);
    copyBitsToByteArrayLE(raw_value, byteArray, 17612, 12);

    raw_value = convertPhysicalToRaw(@CAN_RadarRL::RRL_Object::RRL_Object_Obj33.AyVnce, 0.005, 0.0);
    copyBitsToByteArrayLE(raw_value, byteArray, 17600, 12);

    raw_value = convertPhysicalToRaw(@CAN_RadarRL::RRL_Object::RRL_Object_Obj33.Ay, 0.0625, -16.0);
    copyBitsToByteArrayLE(raw_value, byteArray, 17590, 9);

    raw_value = convertPhysicalToRaw(@CAN_RadarRL::RRL_Object::RRL_Object_Obj33.RCS, 0.2, -102.4);
    copyBitsToByteArrayLE(raw_value, byteArray, 17580, 10);

    raw_value = convertPhysicalToRaw(@CAN_RadarRL::RRL_Object::RRL_Object_Obj33.WidthVnce, 0.005, 0.0);
    copyBitsToByteArrayLE(raw_value, byteArray, 17568, 12);

    raw_value = convertPhysicalToRaw(@CAN_RadarRL::RRL_Object::RRL_Object_Obj33.Width, 0.125, 0.0);
    copyBitsToByteArrayLE(raw_value, byteArray, 17560, 7);

    raw_value = convertPhysicalToRaw(@CAN_RadarRL::RRL_Object::RRL_Object_Obj33.OrientationYawVnce, 0.0003, 0.0);
    copyBitsToByteArrayLE(raw_value, byteArray, 17548, 12);

    raw_value = convertPhysicalToRaw(@CAN_RadarRL::RRL_Object::RRL_Object_Obj33.Vy, 0.125, -64.0);
    copyBitsToByteArrayLE(raw_value, byteArray, 17646, 10);

    raw_value = convertPhysicalToRaw(@CAN_RadarRL::RRL_Object::RRL_Object_Obj33.OrientationYaw, 0.0175, -4.48);
    copyBitsToByteArrayLE(raw_value, byteArray, 17526, 9);

    raw_value = convertPhysicalToRaw(@CAN_RadarRL::RRL_Object::RRL_Object_Obj33.Ax, 0.03125, -16.0);
    copyBitsToByteArrayLE(raw_value, byteArray, 17516, 10);

    raw_value = convertPhysicalToRaw(@CAN_RadarRL::RRL_Object::RRL_Object_Obj33.LengthVnce, 0.005, 0.0);
    copyBitsToByteArrayLE(raw_value, byteArray, 17504, 12);

    raw_value = convertPhysicalToRaw(@CAN_RadarRL::RRL_Object::RRL_Object_Obj33.Length, 0.125, 0.0);
    copyBitsToByteArrayLE(raw_value, byteArray, 17496, 7);

    raw_value = convertPhysicalToRaw(@CAN_RadarRL::RRL_Object::RRL_Object_Obj33.PyVnce, 0.005, 0.0);
    copyBitsToByteArrayLE(raw_value, byteArray, 17484, 12);

    raw_value = convertPhysicalToRaw(@CAN_RadarRL::RRL_Object::RRL_Object_Obj33.Py, 0.0625, -128.0);
    copyBitsToByteArrayLE(raw_value, byteArray, 17472, 12);

    raw_value = convertPhysicalToRaw(@CAN_RadarRL::RRL_Object::RRL_Object_Obj33.PxVnce, 0.005, 0.0);
    copyBitsToByteArrayLE(raw_value, byteArray, 17460, 12);

    raw_value = convertPhysicalToRaw(@CAN_RadarRL::RRL_Object::RRL_Object_Obj33.Px, 0.0625, -512.0);
    copyBitsToByteArrayLE(raw_value, byteArray, 17446, 14);

    raw_value = convertPhysicalToRaw(@CAN_RadarRL::RRL_Object::RRL_Object_Obj33.ProbClassConfidence, 2.0, 0.0);
    copyBitsToByteArrayLE(raw_value, byteArray, 17440, 6);

    raw_value = convertPhysicalToRaw(@CAN_RadarRL::RRL_Object::RRL_Object_Obj33.MovingStatus, 1.0, 0.0);
    copyBitsToByteArrayLE(raw_value, byteArray, 17644, 2);

    raw_value = convertPhysicalToRaw(@CAN_RadarRL::RRL_Object::RRL_Object_Obj33.ExistProb, 2.0, 0.0);
    copyBitsToByteArrayLE(raw_value, byteArray, 17656, 6);

    raw_value = convertPhysicalToRaw(@CAN_RadarRL::RRL_Object::RRL_Object_Obj33.AxAyCoVnce, 0.005, -10.0);
    copyBitsToByteArrayLE(raw_value, byteArray, 17900, 12);

    raw_value = convertPhysicalToRaw(@CAN_RadarRL::RRL_Object::RRL_Object_Obj33.PxAxCoVnce, 0.005, -10.0);
    copyBitsToByteArrayLE(raw_value, byteArray, 17760, 12);

    raw_value = convertPhysicalToRaw(@CAN_RadarRL::RRL_Object::RRL_Object_Obj33.Age, 1.0, 0.0);
    copyBitsToByteArrayLE(raw_value, byteArray, 17920, 32);

    raw_value = convertPhysicalToRaw(@CAN_RadarRL::RRL_Object::RRL_Object_Obj33.VyVnce, 0.005, 0.0);
    copyBitsToByteArrayLE(raw_value, byteArray, 17664, 12);

    raw_value = convertPhysicalToRaw(@CAN_RadarRL::RRL_Object::RRL_Object_Obj33.VyAyCoVnce, 0.005, -10.0);
    copyBitsToByteArrayLE(raw_value, byteArray, 17888, 12);

    raw_value = convertPhysicalToRaw(@CAN_RadarRL::RRL_Object::RRL_Object_Obj33.VyAxCoVnce, 0.005, -10.0);
    copyBitsToByteArrayLE(raw_value, byteArray, 17868, 12);

    raw_value = convertPhysicalToRaw(@CAN_RadarRL::RRL_Object::RRL_Object_Obj33.VxAyCoVnce, 0.005, -10.0);
    copyBitsToByteArrayLE(raw_value, byteArray, 17856, 12);

    raw_value = convertPhysicalToRaw(@CAN_RadarRL::RRL_Object::RRL_Object_Obj33.VxAxCoVnce, 0.005, -10.0);
    copyBitsToByteArrayLE(raw_value, byteArray, 17836, 12);

    raw_value = convertPhysicalToRaw(@CAN_RadarRL::RRL_Object::RRL_Object_Obj33.PyAyCoVnce, 0.005, -10.0);
    copyBitsToByteArrayLE(raw_value, byteArray, 17804, 12);

    raw_value = convertPhysicalToRaw(@CAN_RadarRL::RRL_Object::RRL_Object_Obj33.PyAxCoVnce, 0.005, -10.0);
    copyBitsToByteArrayLE(raw_value, byteArray, 17792, 12);

    raw_value = convertPhysicalToRaw(@CAN_RadarRL::RRL_Object::RRL_Object_Obj33.PxAyCoVnce, 0.005, -10.0);
    copyBitsToByteArrayLE(raw_value, byteArray, 17772, 12);

    raw_value = convertPhysicalToRaw(@CAN_RadarRL::RRL_Object::RRL_Object_Obj33.VxVyCoVnce, 0.005, -10.0);
    copyBitsToByteArrayLE(raw_value, byteArray, 17824, 12);

    raw_value = convertPhysicalToRaw(@CAN_RadarRL::RRL_Object::RRL_Object_Obj33.ReferencePoint, 1.0, 0.0);
    copyBitsToByteArrayLE(raw_value, byteArray, 17752, 4);

    raw_value = convertPhysicalToRaw(@CAN_RadarRL::RRL_Object::RRL_Object_Obj33.PxVxCoVnce, 0.005, -10.0);
    copyBitsToByteArrayLE(raw_value, byteArray, 17696, 12);

    raw_value = convertPhysicalToRaw(@CAN_RadarRL::RRL_Object::RRL_Object_Obj33.PxPyCoVnce, 0.005, -10.0);
    copyBitsToByteArrayLE(raw_value, byteArray, 17676, 12);

    raw_value = convertPhysicalToRaw(@CAN_RadarRL::RRL_Object::RRL_Object_Obj33.PyVyCoVnce, 0.005, -10.0);
    copyBitsToByteArrayLE(raw_value, byteArray, 17740, 12);

    raw_value = convertPhysicalToRaw(@CAN_RadarRL::RRL_Object::RRL_Object_Obj33.ProbClassType, 1.0, 0.0);
    copyBitsToByteArrayLE(raw_value, byteArray, 17691, 4);

    raw_value = convertPhysicalToRaw(@CAN_RadarRL::RRL_Object::RRL_Object_Obj33.MeasurementStatus, 1.0, 0.0);
    copyBitsToByteArrayLE(raw_value, byteArray, 17688, 3);

    raw_value = convertPhysicalToRaw(@CAN_RadarRL::RRL_Object::RRL_Object_Obj33.PxVyCoVnce, 0.005, -10.0);
    copyBitsToByteArrayLE(raw_value, byteArray, 17708, 12);

    raw_value = convertPhysicalToRaw(@CAN_RadarRL::RRL_Object::RRL_Object_Obj33.FilterInformation, 1.0, 0.0);
    copyBitsToByteArrayLE(raw_value, byteArray, 17720, 8);

    raw_value = convertPhysicalToRaw(@CAN_RadarRL::RRL_Object::RRL_Object_Obj33.PyVxCoVnce, 0.005, -10.0);
    copyBitsToByteArrayLE(raw_value, byteArray, 17728, 12);
}


void RRL_Object_Obj32_write(byte byteArray[])
{
    qword raw_value;

    raw_value = convertPhysicalToRaw(@CAN_RadarRL::RRL_Object::RRL_Object_Obj32.ObjId, 1.0, 0.0);
    copyBitsToByteArrayLE(raw_value, byteArray, 17112, 7);

    raw_value = convertPhysicalToRaw(@CAN_RadarRL::RRL_Object::RRL_Object_Obj32.AxVnce, 0.005, 0.0);
    copyBitsToByteArrayLE(raw_value, byteArray, 17024, 12);

    raw_value = convertPhysicalToRaw(@CAN_RadarRL::RRL_Object::RRL_Object_Obj32.Vx, 0.0625, -128.0);
    copyBitsToByteArrayLE(raw_value, byteArray, 17100, 12);

    raw_value = convertPhysicalToRaw(@CAN_RadarRL::RRL_Object::RRL_Object_Obj32.AyVnce, 0.005, 0.0);
    copyBitsToByteArrayLE(raw_value, byteArray, 17088, 12);

    raw_value = convertPhysicalToRaw(@CAN_RadarRL::RRL_Object::RRL_Object_Obj32.Ay, 0.0625, -16.0);
    copyBitsToByteArrayLE(raw_value, byteArray, 17078, 9);

    raw_value = convertPhysicalToRaw(@CAN_RadarRL::RRL_Object::RRL_Object_Obj32.RCS, 0.2, -102.4);
    copyBitsToByteArrayLE(raw_value, byteArray, 17068, 10);

    raw_value = convertPhysicalToRaw(@CAN_RadarRL::RRL_Object::RRL_Object_Obj32.WidthVnce, 0.005, 0.0);
    copyBitsToByteArrayLE(raw_value, byteArray, 17056, 12);

    raw_value = convertPhysicalToRaw(@CAN_RadarRL::RRL_Object::RRL_Object_Obj32.Width, 0.125, 0.0);
    copyBitsToByteArrayLE(raw_value, byteArray, 17048, 7);

    raw_value = convertPhysicalToRaw(@CAN_RadarRL::RRL_Object::RRL_Object_Obj32.OrientationYawVnce, 0.0003, 0.0);
    copyBitsToByteArrayLE(raw_value, byteArray, 17036, 12);

    raw_value = convertPhysicalToRaw(@CAN_RadarRL::RRL_Object::RRL_Object_Obj32.PyVnce, 0.005, 0.0);
    copyBitsToByteArrayLE(raw_value, byteArray, 16972, 12);

    raw_value = convertPhysicalToRaw(@CAN_RadarRL::RRL_Object::RRL_Object_Obj32.OrientationYaw, 0.0175, -4.48);
    copyBitsToByteArrayLE(raw_value, byteArray, 17014, 9);

    raw_value = convertPhysicalToRaw(@CAN_RadarRL::RRL_Object::RRL_Object_Obj32.Ax, 0.03125, -16.0);
    copyBitsToByteArrayLE(raw_value, byteArray, 17004, 10);

    raw_value = convertPhysicalToRaw(@CAN_RadarRL::RRL_Object::RRL_Object_Obj32.LengthVnce, 0.005, 0.0);
    copyBitsToByteArrayLE(raw_value, byteArray, 16992, 12);

    raw_value = convertPhysicalToRaw(@CAN_RadarRL::RRL_Object::RRL_Object_Obj32.Length, 0.125, 0.0);
    copyBitsToByteArrayLE(raw_value, byteArray, 16984, 7);

    raw_value = convertPhysicalToRaw(@CAN_RadarRL::RRL_Object::RRL_Object_Obj32.Py, 0.0625, -128.0);
    copyBitsToByteArrayLE(raw_value, byteArray, 16960, 12);

    raw_value = convertPhysicalToRaw(@CAN_RadarRL::RRL_Object::RRL_Object_Obj32.PxVnce, 0.005, 0.0);
    copyBitsToByteArrayLE(raw_value, byteArray, 16948, 12);

    raw_value = convertPhysicalToRaw(@CAN_RadarRL::RRL_Object::RRL_Object_Obj32.Px, 0.0625, -512.0);
    copyBitsToByteArrayLE(raw_value, byteArray, 16934, 14);

    raw_value = convertPhysicalToRaw(@CAN_RadarRL::RRL_Object::RRL_Object_Obj32.ProbClassConfidence, 2.0, 0.0);
    copyBitsToByteArrayLE(raw_value, byteArray, 16928, 6);

    raw_value = convertPhysicalToRaw(@CAN_RadarRL::RRL_Object::RRL_Object_Obj32.MovingStatus, 1.0, 0.0);
    copyBitsToByteArrayLE(raw_value, byteArray, 17132, 2);

    raw_value = convertPhysicalToRaw(@CAN_RadarRL::RRL_Object::RRL_Object_Obj32.VxVnce, 0.005, 0.0);
    copyBitsToByteArrayLE(raw_value, byteArray, 17120, 12);

    raw_value = convertPhysicalToRaw(@CAN_RadarRL::RRL_Object::RRL_Object_Obj32.Vy, 0.125, -64.0);
    copyBitsToByteArrayLE(raw_value, byteArray, 17134, 10);

    raw_value = convertPhysicalToRaw(@CAN_RadarRL::RRL_Object::RRL_Object_Obj32.AxAyCoVnce, 0.005, -10.0);
    copyBitsToByteArrayLE(raw_value, byteArray, 17388, 12);

    raw_value = convertPhysicalToRaw(@CAN_RadarRL::RRL_Object::RRL_Object_Obj32.PxAxCoVnce, 0.005, -10.0);
    copyBitsToByteArrayLE(raw_value, byteArray, 17248, 12);

    raw_value = convertPhysicalToRaw(@CAN_RadarRL::RRL_Object::RRL_Object_Obj32.Age, 1.0, 0.0);
    copyBitsToByteArrayLE(raw_value, byteArray, 17408, 32);

    raw_value = convertPhysicalToRaw(@CAN_RadarRL::RRL_Object::RRL_Object_Obj32.ExistProb, 2.0, 0.0);
    copyBitsToByteArrayLE(raw_value, byteArray, 17144, 6);

    raw_value = convertPhysicalToRaw(@CAN_RadarRL::RRL_Object::RRL_Object_Obj32.VyAyCoVnce, 0.005, -10.0);
    copyBitsToByteArrayLE(raw_value, byteArray, 17376, 12);

    raw_value = convertPhysicalToRaw(@CAN_RadarRL::RRL_Object::RRL_Object_Obj32.VyAxCoVnce, 0.005, -10.0);
    copyBitsToByteArrayLE(raw_value, byteArray, 17356, 12);

    raw_value = convertPhysicalToRaw(@CAN_RadarRL::RRL_Object::RRL_Object_Obj32.VxAyCoVnce, 0.005, -10.0);
    copyBitsToByteArrayLE(raw_value, byteArray, 17344, 12);

    raw_value = convertPhysicalToRaw(@CAN_RadarRL::RRL_Object::RRL_Object_Obj32.VxAxCoVnce, 0.005, -10.0);
    copyBitsToByteArrayLE(raw_value, byteArray, 17324, 12);

    raw_value = convertPhysicalToRaw(@CAN_RadarRL::RRL_Object::RRL_Object_Obj32.PyAyCoVnce, 0.005, -10.0);
    copyBitsToByteArrayLE(raw_value, byteArray, 17292, 12);

    raw_value = convertPhysicalToRaw(@CAN_RadarRL::RRL_Object::RRL_Object_Obj32.PyAxCoVnce, 0.005, -10.0);
    copyBitsToByteArrayLE(raw_value, byteArray, 17280, 12);

    raw_value = convertPhysicalToRaw(@CAN_RadarRL::RRL_Object::RRL_Object_Obj32.PxAyCoVnce, 0.005, -10.0);
    copyBitsToByteArrayLE(raw_value, byteArray, 17260, 12);

    raw_value = convertPhysicalToRaw(@CAN_RadarRL::RRL_Object::RRL_Object_Obj32.VxVyCoVnce, 0.005, -10.0);
    copyBitsToByteArrayLE(raw_value, byteArray, 17312, 12);

    raw_value = convertPhysicalToRaw(@CAN_RadarRL::RRL_Object::RRL_Object_Obj32.ReferencePoint, 1.0, 0.0);
    copyBitsToByteArrayLE(raw_value, byteArray, 17240, 4);

    raw_value = convertPhysicalToRaw(@CAN_RadarRL::RRL_Object::RRL_Object_Obj32.PxVxCoVnce, 0.005, -10.0);
    copyBitsToByteArrayLE(raw_value, byteArray, 17184, 12);

    raw_value = convertPhysicalToRaw(@CAN_RadarRL::RRL_Object::RRL_Object_Obj32.PyVyCoVnce, 0.005, -10.0);
    copyBitsToByteArrayLE(raw_value, byteArray, 17228, 12);

    raw_value = convertPhysicalToRaw(@CAN_RadarRL::RRL_Object::RRL_Object_Obj32.PxPyCoVnce, 0.005, -10.0);
    copyBitsToByteArrayLE(raw_value, byteArray, 17164, 12);

    raw_value = convertPhysicalToRaw(@CAN_RadarRL::RRL_Object::RRL_Object_Obj32.MeasurementStatus, 1.0, 0.0);
    copyBitsToByteArrayLE(raw_value, byteArray, 17176, 3);

    raw_value = convertPhysicalToRaw(@CAN_RadarRL::RRL_Object::RRL_Object_Obj32.ProbClassType, 1.0, 0.0);
    copyBitsToByteArrayLE(raw_value, byteArray, 17179, 4);

    raw_value = convertPhysicalToRaw(@CAN_RadarRL::RRL_Object::RRL_Object_Obj32.VyVnce, 0.005, 0.0);
    copyBitsToByteArrayLE(raw_value, byteArray, 17152, 12);

    raw_value = convertPhysicalToRaw(@CAN_RadarRL::RRL_Object::RRL_Object_Obj32.PxVyCoVnce, 0.005, -10.0);
    copyBitsToByteArrayLE(raw_value, byteArray, 17196, 12);

    raw_value = convertPhysicalToRaw(@CAN_RadarRL::RRL_Object::RRL_Object_Obj32.FilterInformation, 1.0, 0.0);
    copyBitsToByteArrayLE(raw_value, byteArray, 17208, 8);

    raw_value = convertPhysicalToRaw(@CAN_RadarRL::RRL_Object::RRL_Object_Obj32.PyVxCoVnce, 0.005, -10.0);
    copyBitsToByteArrayLE(raw_value, byteArray, 17216, 12);
}


void RRL_Object_Obj31_write(byte byteArray[])
{
    qword raw_value;

    raw_value = convertPhysicalToRaw(@CAN_RadarRL::RRL_Object::RRL_Object_Obj31.AxVnce, 0.005, 0.0);
    copyBitsToByteArrayLE(raw_value, byteArray, 16512, 12);

    raw_value = convertPhysicalToRaw(@CAN_RadarRL::RRL_Object::RRL_Object_Obj31.VxVnce, 0.005, 0.0);
    copyBitsToByteArrayLE(raw_value, byteArray, 16608, 12);

    raw_value = convertPhysicalToRaw(@CAN_RadarRL::RRL_Object::RRL_Object_Obj31.ObjId, 1.0, 0.0);
    copyBitsToByteArrayLE(raw_value, byteArray, 16600, 7);

    raw_value = convertPhysicalToRaw(@CAN_RadarRL::RRL_Object::RRL_Object_Obj31.Vx, 0.0625, -128.0);
    copyBitsToByteArrayLE(raw_value, byteArray, 16588, 12);

    raw_value = convertPhysicalToRaw(@CAN_RadarRL::RRL_Object::RRL_Object_Obj31.AyVnce, 0.005, 0.0);
    copyBitsToByteArrayLE(raw_value, byteArray, 16576, 12);

    raw_value = convertPhysicalToRaw(@CAN_RadarRL::RRL_Object::RRL_Object_Obj31.Ay, 0.0625, -16.0);
    copyBitsToByteArrayLE(raw_value, byteArray, 16566, 9);

    raw_value = convertPhysicalToRaw(@CAN_RadarRL::RRL_Object::RRL_Object_Obj31.RCS, 0.2, -102.4);
    copyBitsToByteArrayLE(raw_value, byteArray, 16556, 10);

    raw_value = convertPhysicalToRaw(@CAN_RadarRL::RRL_Object::RRL_Object_Obj31.WidthVnce, 0.005, 0.0);
    copyBitsToByteArrayLE(raw_value, byteArray, 16544, 12);

    raw_value = convertPhysicalToRaw(@CAN_RadarRL::RRL_Object::RRL_Object_Obj31.Width, 0.125, 0.0);
    copyBitsToByteArrayLE(raw_value, byteArray, 16536, 7);

    raw_value = convertPhysicalToRaw(@CAN_RadarRL::RRL_Object::RRL_Object_Obj31.OrientationYawVnce, 0.0003, 0.0);
    copyBitsToByteArrayLE(raw_value, byteArray, 16524, 12);

    raw_value = convertPhysicalToRaw(@CAN_RadarRL::RRL_Object::RRL_Object_Obj31.Vy, 0.125, -64.0);
    copyBitsToByteArrayLE(raw_value, byteArray, 16622, 10);

    raw_value = convertPhysicalToRaw(@CAN_RadarRL::RRL_Object::RRL_Object_Obj31.OrientationYaw, 0.0175, -4.48);
    copyBitsToByteArrayLE(raw_value, byteArray, 16502, 9);

    raw_value = convertPhysicalToRaw(@CAN_RadarRL::RRL_Object::RRL_Object_Obj31.Ax, 0.03125, -16.0);
    copyBitsToByteArrayLE(raw_value, byteArray, 16492, 10);

    raw_value = convertPhysicalToRaw(@CAN_RadarRL::RRL_Object::RRL_Object_Obj31.LengthVnce, 0.005, 0.0);
    copyBitsToByteArrayLE(raw_value, byteArray, 16480, 12);

    raw_value = convertPhysicalToRaw(@CAN_RadarRL::RRL_Object::RRL_Object_Obj31.Length, 0.125, 0.0);
    copyBitsToByteArrayLE(raw_value, byteArray, 16472, 7);

    raw_value = convertPhysicalToRaw(@CAN_RadarRL::RRL_Object::RRL_Object_Obj31.PyVnce, 0.005, 0.0);
    copyBitsToByteArrayLE(raw_value, byteArray, 16460, 12);

    raw_value = convertPhysicalToRaw(@CAN_RadarRL::RRL_Object::RRL_Object_Obj31.Py, 0.0625, -128.0);
    copyBitsToByteArrayLE(raw_value, byteArray, 16448, 12);

    raw_value = convertPhysicalToRaw(@CAN_RadarRL::RRL_Object::RRL_Object_Obj31.PxVnce, 0.005, 0.0);
    copyBitsToByteArrayLE(raw_value, byteArray, 16436, 12);

    raw_value = convertPhysicalToRaw(@CAN_RadarRL::RRL_Object::RRL_Object_Obj31.Px, 0.0625, -512.0);
    copyBitsToByteArrayLE(raw_value, byteArray, 16422, 14);

    raw_value = convertPhysicalToRaw(@CAN_RadarRL::RRL_Object::RRL_Object_Obj31.ProbClassConfidence, 2.0, 0.0);
    copyBitsToByteArrayLE(raw_value, byteArray, 16416, 6);

    raw_value = convertPhysicalToRaw(@CAN_RadarRL::RRL_Object::RRL_Object_Obj31.MovingStatus, 1.0, 0.0);
    copyBitsToByteArrayLE(raw_value, byteArray, 16620, 2);

    raw_value = convertPhysicalToRaw(@CAN_RadarRL::RRL_Object::RRL_Object_Obj31.Age, 1.0, 0.0);
    copyBitsToByteArrayLE(raw_value, byteArray, 16896, 32);

    raw_value = convertPhysicalToRaw(@CAN_RadarRL::RRL_Object::RRL_Object_Obj31.ExistProb, 2.0, 0.0);
    copyBitsToByteArrayLE(raw_value, byteArray, 16632, 6);

    raw_value = convertPhysicalToRaw(@CAN_RadarRL::RRL_Object::RRL_Object_Obj31.PxAxCoVnce, 0.005, -10.0);
    copyBitsToByteArrayLE(raw_value, byteArray, 16736, 12);

    raw_value = convertPhysicalToRaw(@CAN_RadarRL::RRL_Object::RRL_Object_Obj31.AxAyCoVnce, 0.005, -10.0);
    copyBitsToByteArrayLE(raw_value, byteArray, 16876, 12);

    raw_value = convertPhysicalToRaw(@CAN_RadarRL::RRL_Object::RRL_Object_Obj31.VyAyCoVnce, 0.005, -10.0);
    copyBitsToByteArrayLE(raw_value, byteArray, 16864, 12);

    raw_value = convertPhysicalToRaw(@CAN_RadarRL::RRL_Object::RRL_Object_Obj31.VyAxCoVnce, 0.005, -10.0);
    copyBitsToByteArrayLE(raw_value, byteArray, 16844, 12);

    raw_value = convertPhysicalToRaw(@CAN_RadarRL::RRL_Object::RRL_Object_Obj31.VxAyCoVnce, 0.005, -10.0);
    copyBitsToByteArrayLE(raw_value, byteArray, 16832, 12);

    raw_value = convertPhysicalToRaw(@CAN_RadarRL::RRL_Object::RRL_Object_Obj31.VxAxCoVnce, 0.005, -10.0);
    copyBitsToByteArrayLE(raw_value, byteArray, 16812, 12);

    raw_value = convertPhysicalToRaw(@CAN_RadarRL::RRL_Object::RRL_Object_Obj31.VyVnce, 0.005, 0.0);
    copyBitsToByteArrayLE(raw_value, byteArray, 16640, 12);

    raw_value = convertPhysicalToRaw(@CAN_RadarRL::RRL_Object::RRL_Object_Obj31.PyAyCoVnce, 0.005, -10.0);
    copyBitsToByteArrayLE(raw_value, byteArray, 16780, 12);

    raw_value = convertPhysicalToRaw(@CAN_RadarRL::RRL_Object::RRL_Object_Obj31.PyAxCoVnce, 0.005, -10.0);
    copyBitsToByteArrayLE(raw_value, byteArray, 16768, 12);

    raw_value = convertPhysicalToRaw(@CAN_RadarRL::RRL_Object::RRL_Object_Obj31.PxAyCoVnce, 0.005, -10.0);
    copyBitsToByteArrayLE(raw_value, byteArray, 16748, 12);

    raw_value = convertPhysicalToRaw(@CAN_RadarRL::RRL_Object::RRL_Object_Obj31.VxVyCoVnce, 0.005, -10.0);
    copyBitsToByteArrayLE(raw_value, byteArray, 16800, 12);

    raw_value = convertPhysicalToRaw(@CAN_RadarRL::RRL_Object::RRL_Object_Obj31.ReferencePoint, 1.0, 0.0);
    copyBitsToByteArrayLE(raw_value, byteArray, 16728, 4);

    raw_value = convertPhysicalToRaw(@CAN_RadarRL::RRL_Object::RRL_Object_Obj31.PyVxCoVnce, 0.005, -10.0);
    copyBitsToByteArrayLE(raw_value, byteArray, 16704, 12);

    raw_value = convertPhysicalToRaw(@CAN_RadarRL::RRL_Object::RRL_Object_Obj31.FilterInformation, 1.0, 0.0);
    copyBitsToByteArrayLE(raw_value, byteArray, 16696, 8);

    raw_value = convertPhysicalToRaw(@CAN_RadarRL::RRL_Object::RRL_Object_Obj31.PxVyCoVnce, 0.005, -10.0);
    copyBitsToByteArrayLE(raw_value, byteArray, 16684, 12);

    raw_value = convertPhysicalToRaw(@CAN_RadarRL::RRL_Object::RRL_Object_Obj31.PxVxCoVnce, 0.005, -10.0);
    copyBitsToByteArrayLE(raw_value, byteArray, 16672, 12);

    raw_value = convertPhysicalToRaw(@CAN_RadarRL::RRL_Object::RRL_Object_Obj31.ProbClassType, 1.0, 0.0);
    copyBitsToByteArrayLE(raw_value, byteArray, 16667, 4);

    raw_value = convertPhysicalToRaw(@CAN_RadarRL::RRL_Object::RRL_Object_Obj31.MeasurementStatus, 1.0, 0.0);
    copyBitsToByteArrayLE(raw_value, byteArray, 16664, 3);

    raw_value = convertPhysicalToRaw(@CAN_RadarRL::RRL_Object::RRL_Object_Obj31.PxPyCoVnce, 0.005, -10.0);
    copyBitsToByteArrayLE(raw_value, byteArray, 16652, 12);

    raw_value = convertPhysicalToRaw(@CAN_RadarRL::RRL_Object::RRL_Object_Obj31.PyVyCoVnce, 0.005, -10.0);
    copyBitsToByteArrayLE(raw_value, byteArray, 16716, 12);
}


void RRL_Object_Obj30_write(byte byteArray[])
{
    qword raw_value;

    raw_value = convertPhysicalToRaw(@CAN_RadarRL::RRL_Object::RRL_Object_Obj30.AyVnce, 0.005, 0.0);
    copyBitsToByteArrayLE(raw_value, byteArray, 16064, 12);

    raw_value = convertPhysicalToRaw(@CAN_RadarRL::RRL_Object::RRL_Object_Obj30.WidthVnce, 0.005, 0.0);
    copyBitsToByteArrayLE(raw_value, byteArray, 16032, 12);

    raw_value = convertPhysicalToRaw(@CAN_RadarRL::RRL_Object::RRL_Object_Obj30.RCS, 0.2, -102.4);
    copyBitsToByteArrayLE(raw_value, byteArray, 16044, 10);

    raw_value = convertPhysicalToRaw(@CAN_RadarRL::RRL_Object::RRL_Object_Obj30.Ay, 0.0625, -16.0);
    copyBitsToByteArrayLE(raw_value, byteArray, 16054, 9);

    raw_value = convertPhysicalToRaw(@CAN_RadarRL::RRL_Object::RRL_Object_Obj30.VxVnce, 0.005, 0.0);
    copyBitsToByteArrayLE(raw_value, byteArray, 16096, 12);

    raw_value = convertPhysicalToRaw(@CAN_RadarRL::RRL_Object::RRL_Object_Obj30.OrientationYawVnce, 0.0003, 0.0);
    copyBitsToByteArrayLE(raw_value, byteArray, 16012, 12);

    raw_value = convertPhysicalToRaw(@CAN_RadarRL::RRL_Object::RRL_Object_Obj30.Vx, 0.0625, -128.0);
    copyBitsToByteArrayLE(raw_value, byteArray, 16076, 12);

    raw_value = convertPhysicalToRaw(@CAN_RadarRL::RRL_Object::RRL_Object_Obj30.ObjId, 1.0, 0.0);
    copyBitsToByteArrayLE(raw_value, byteArray, 16088, 7);

    raw_value = convertPhysicalToRaw(@CAN_RadarRL::RRL_Object::RRL_Object_Obj30.Width, 0.125, 0.0);
    copyBitsToByteArrayLE(raw_value, byteArray, 16024, 7);

    raw_value = convertPhysicalToRaw(@CAN_RadarRL::RRL_Object::RRL_Object_Obj30.Vy, 0.125, -64.0);
    copyBitsToByteArrayLE(raw_value, byteArray, 16110, 10);

    raw_value = convertPhysicalToRaw(@CAN_RadarRL::RRL_Object::RRL_Object_Obj30.AxVnce, 0.005, 0.0);
    copyBitsToByteArrayLE(raw_value, byteArray, 16000, 12);

    raw_value = convertPhysicalToRaw(@CAN_RadarRL::RRL_Object::RRL_Object_Obj30.OrientationYaw, 0.0175, -4.48);
    copyBitsToByteArrayLE(raw_value, byteArray, 15990, 9);

    raw_value = convertPhysicalToRaw(@CAN_RadarRL::RRL_Object::RRL_Object_Obj30.Ax, 0.03125, -16.0);
    copyBitsToByteArrayLE(raw_value, byteArray, 15980, 10);

    raw_value = convertPhysicalToRaw(@CAN_RadarRL::RRL_Object::RRL_Object_Obj30.LengthVnce, 0.005, 0.0);
    copyBitsToByteArrayLE(raw_value, byteArray, 15968, 12);

    raw_value = convertPhysicalToRaw(@CAN_RadarRL::RRL_Object::RRL_Object_Obj30.Length, 0.125, 0.0);
    copyBitsToByteArrayLE(raw_value, byteArray, 15960, 7);

    raw_value = convertPhysicalToRaw(@CAN_RadarRL::RRL_Object::RRL_Object_Obj30.PyVnce, 0.005, 0.0);
    copyBitsToByteArrayLE(raw_value, byteArray, 15948, 12);

    raw_value = convertPhysicalToRaw(@CAN_RadarRL::RRL_Object::RRL_Object_Obj30.PxVnce, 0.005, 0.0);
    copyBitsToByteArrayLE(raw_value, byteArray, 15924, 12);

    raw_value = convertPhysicalToRaw(@CAN_RadarRL::RRL_Object::RRL_Object_Obj30.Px, 0.0625, -512.0);
    copyBitsToByteArrayLE(raw_value, byteArray, 15910, 14);

    raw_value = convertPhysicalToRaw(@CAN_RadarRL::RRL_Object::RRL_Object_Obj30.ProbClassConfidence, 2.0, 0.0);
    copyBitsToByteArrayLE(raw_value, byteArray, 15904, 6);

    raw_value = convertPhysicalToRaw(@CAN_RadarRL::RRL_Object::RRL_Object_Obj30.MovingStatus, 1.0, 0.0);
    copyBitsToByteArrayLE(raw_value, byteArray, 16108, 2);

    raw_value = convertPhysicalToRaw(@CAN_RadarRL::RRL_Object::RRL_Object_Obj30.Py, 0.0625, -128.0);
    copyBitsToByteArrayLE(raw_value, byteArray, 15936, 12);

    raw_value = convertPhysicalToRaw(@CAN_RadarRL::RRL_Object::RRL_Object_Obj30.ExistProb, 2.0, 0.0);
    copyBitsToByteArrayLE(raw_value, byteArray, 16120, 6);

    raw_value = convertPhysicalToRaw(@CAN_RadarRL::RRL_Object::RRL_Object_Obj30.PxAyCoVnce, 0.005, -10.0);
    copyBitsToByteArrayLE(raw_value, byteArray, 16236, 12);

    raw_value = convertPhysicalToRaw(@CAN_RadarRL::RRL_Object::RRL_Object_Obj30.VyVnce, 0.005, 0.0);
    copyBitsToByteArrayLE(raw_value, byteArray, 16128, 12);

    raw_value = convertPhysicalToRaw(@CAN_RadarRL::RRL_Object::RRL_Object_Obj30.AxAyCoVnce, 0.005, -10.0);
    copyBitsToByteArrayLE(raw_value, byteArray, 16364, 12);

    raw_value = convertPhysicalToRaw(@CAN_RadarRL::RRL_Object::RRL_Object_Obj30.VyAyCoVnce, 0.005, -10.0);
    copyBitsToByteArrayLE(raw_value, byteArray, 16352, 12);

    raw_value = convertPhysicalToRaw(@CAN_RadarRL::RRL_Object::RRL_Object_Obj30.VyAxCoVnce, 0.005, -10.0);
    copyBitsToByteArrayLE(raw_value, byteArray, 16332, 12);

    raw_value = convertPhysicalToRaw(@CAN_RadarRL::RRL_Object::RRL_Object_Obj30.VxAyCoVnce, 0.005, -10.0);
    copyBitsToByteArrayLE(raw_value, byteArray, 16320, 12);

    raw_value = convertPhysicalToRaw(@CAN_RadarRL::RRL_Object::RRL_Object_Obj30.VxAxCoVnce, 0.005, -10.0);
    copyBitsToByteArrayLE(raw_value, byteArray, 16300, 12);

    raw_value = convertPhysicalToRaw(@CAN_RadarRL::RRL_Object::RRL_Object_Obj30.VxVyCoVnce, 0.005, -10.0);
    copyBitsToByteArrayLE(raw_value, byteArray, 16288, 12);

    raw_value = convertPhysicalToRaw(@CAN_RadarRL::RRL_Object::RRL_Object_Obj30.PyAyCoVnce, 0.005, -10.0);
    copyBitsToByteArrayLE(raw_value, byteArray, 16268, 12);

    raw_value = convertPhysicalToRaw(@CAN_RadarRL::RRL_Object::RRL_Object_Obj30.PyAxCoVnce, 0.005, -10.0);
    copyBitsToByteArrayLE(raw_value, byteArray, 16256, 12);

    raw_value = convertPhysicalToRaw(@CAN_RadarRL::RRL_Object::RRL_Object_Obj30.Age, 1.0, 0.0);
    copyBitsToByteArrayLE(raw_value, byteArray, 16384, 32);

    raw_value = convertPhysicalToRaw(@CAN_RadarRL::RRL_Object::RRL_Object_Obj30.PxAxCoVnce, 0.005, -10.0);
    copyBitsToByteArrayLE(raw_value, byteArray, 16224, 12);

    raw_value = convertPhysicalToRaw(@CAN_RadarRL::RRL_Object::RRL_Object_Obj30.PyVyCoVnce, 0.005, -10.0);
    copyBitsToByteArrayLE(raw_value, byteArray, 16204, 12);

    raw_value = convertPhysicalToRaw(@CAN_RadarRL::RRL_Object::RRL_Object_Obj30.PyVxCoVnce, 0.005, -10.0);
    copyBitsToByteArrayLE(raw_value, byteArray, 16192, 12);

    raw_value = convertPhysicalToRaw(@CAN_RadarRL::RRL_Object::RRL_Object_Obj30.FilterInformation, 1.0, 0.0);
    copyBitsToByteArrayLE(raw_value, byteArray, 16184, 8);

    raw_value = convertPhysicalToRaw(@CAN_RadarRL::RRL_Object::RRL_Object_Obj30.PxVyCoVnce, 0.005, -10.0);
    copyBitsToByteArrayLE(raw_value, byteArray, 16172, 12);

    raw_value = convertPhysicalToRaw(@CAN_RadarRL::RRL_Object::RRL_Object_Obj30.PxVxCoVnce, 0.005, -10.0);
    copyBitsToByteArrayLE(raw_value, byteArray, 16160, 12);

    raw_value = convertPhysicalToRaw(@CAN_RadarRL::RRL_Object::RRL_Object_Obj30.ProbClassType, 1.0, 0.0);
    copyBitsToByteArrayLE(raw_value, byteArray, 16155, 4);

    raw_value = convertPhysicalToRaw(@CAN_RadarRL::RRL_Object::RRL_Object_Obj30.MeasurementStatus, 1.0, 0.0);
    copyBitsToByteArrayLE(raw_value, byteArray, 16152, 3);

    raw_value = convertPhysicalToRaw(@CAN_RadarRL::RRL_Object::RRL_Object_Obj30.PxPyCoVnce, 0.005, -10.0);
    copyBitsToByteArrayLE(raw_value, byteArray, 16140, 12);

    raw_value = convertPhysicalToRaw(@CAN_RadarRL::RRL_Object::RRL_Object_Obj30.ReferencePoint, 1.0, 0.0);
    copyBitsToByteArrayLE(raw_value, byteArray, 16216, 4);
}


void RRL_Object_Obj29_write(byte byteArray[])
{
    qword raw_value;

    raw_value = convertPhysicalToRaw(@CAN_RadarRL::RRL_Object::RRL_Object_Obj29.RCS, 0.2, -102.4);
    copyBitsToByteArrayLE(raw_value, byteArray, 15532, 10);

    raw_value = convertPhysicalToRaw(@CAN_RadarRL::RRL_Object::RRL_Object_Obj29.Width, 0.125, 0.0);
    copyBitsToByteArrayLE(raw_value, byteArray, 15512, 7);

    raw_value = convertPhysicalToRaw(@CAN_RadarRL::RRL_Object::RRL_Object_Obj29.WidthVnce, 0.005, 0.0);
    copyBitsToByteArrayLE(raw_value, byteArray, 15520, 12);

    raw_value = convertPhysicalToRaw(@CAN_RadarRL::RRL_Object::RRL_Object_Obj29.ObjId, 1.0, 0.0);
    copyBitsToByteArrayLE(raw_value, byteArray, 15576, 7);

    raw_value = convertPhysicalToRaw(@CAN_RadarRL::RRL_Object::RRL_Object_Obj29.Ay, 0.0625, -16.0);
    copyBitsToByteArrayLE(raw_value, byteArray, 15542, 9);

    raw_value = convertPhysicalToRaw(@CAN_RadarRL::RRL_Object::RRL_Object_Obj29.AyVnce, 0.005, 0.0);
    copyBitsToByteArrayLE(raw_value, byteArray, 15552, 12);

    raw_value = convertPhysicalToRaw(@CAN_RadarRL::RRL_Object::RRL_Object_Obj29.Vx, 0.0625, -128.0);
    copyBitsToByteArrayLE(raw_value, byteArray, 15564, 12);

    raw_value = convertPhysicalToRaw(@CAN_RadarRL::RRL_Object::RRL_Object_Obj29.AxVnce, 0.005, 0.0);
    copyBitsToByteArrayLE(raw_value, byteArray, 15488, 12);

    raw_value = convertPhysicalToRaw(@CAN_RadarRL::RRL_Object::RRL_Object_Obj29.OrientationYawVnce, 0.0003, 0.0);
    copyBitsToByteArrayLE(raw_value, byteArray, 15500, 12);

    raw_value = convertPhysicalToRaw(@CAN_RadarRL::RRL_Object::RRL_Object_Obj29.PyVnce, 0.005, 0.0);
    copyBitsToByteArrayLE(raw_value, byteArray, 15436, 12);

    raw_value = convertPhysicalToRaw(@CAN_RadarRL::RRL_Object::RRL_Object_Obj29.OrientationYaw, 0.0175, -4.48);
    copyBitsToByteArrayLE(raw_value, byteArray, 15478, 9);

    raw_value = convertPhysicalToRaw(@CAN_RadarRL::RRL_Object::RRL_Object_Obj29.Ax, 0.03125, -16.0);
    copyBitsToByteArrayLE(raw_value, byteArray, 15468, 10);

    raw_value = convertPhysicalToRaw(@CAN_RadarRL::RRL_Object::RRL_Object_Obj29.LengthVnce, 0.005, 0.0);
    copyBitsToByteArrayLE(raw_value, byteArray, 15456, 12);

    raw_value = convertPhysicalToRaw(@CAN_RadarRL::RRL_Object::RRL_Object_Obj29.Length, 0.125, 0.0);
    copyBitsToByteArrayLE(raw_value, byteArray, 15448, 7);

    raw_value = convertPhysicalToRaw(@CAN_RadarRL::RRL_Object::RRL_Object_Obj29.Py, 0.0625, -128.0);
    copyBitsToByteArrayLE(raw_value, byteArray, 15424, 12);

    raw_value = convertPhysicalToRaw(@CAN_RadarRL::RRL_Object::RRL_Object_Obj29.PxVnce, 0.005, 0.0);
    copyBitsToByteArrayLE(raw_value, byteArray, 15412, 12);

    raw_value = convertPhysicalToRaw(@CAN_RadarRL::RRL_Object::RRL_Object_Obj29.Px, 0.0625, -512.0);
    copyBitsToByteArrayLE(raw_value, byteArray, 15398, 14);

    raw_value = convertPhysicalToRaw(@CAN_RadarRL::RRL_Object::RRL_Object_Obj29.ProbClassConfidence, 2.0, 0.0);
    copyBitsToByteArrayLE(raw_value, byteArray, 15392, 6);

    raw_value = convertPhysicalToRaw(@CAN_RadarRL::RRL_Object::RRL_Object_Obj29.MovingStatus, 1.0, 0.0);
    copyBitsToByteArrayLE(raw_value, byteArray, 15596, 2);

    raw_value = convertPhysicalToRaw(@CAN_RadarRL::RRL_Object::RRL_Object_Obj29.VxVnce, 0.005, 0.0);
    copyBitsToByteArrayLE(raw_value, byteArray, 15584, 12);

    raw_value = convertPhysicalToRaw(@CAN_RadarRL::RRL_Object::RRL_Object_Obj29.Vy, 0.125, -64.0);
    copyBitsToByteArrayLE(raw_value, byteArray, 15598, 10);

    raw_value = convertPhysicalToRaw(@CAN_RadarRL::RRL_Object::RRL_Object_Obj29.AxAyCoVnce, 0.005, -10.0);
    copyBitsToByteArrayLE(raw_value, byteArray, 15852, 12);

    raw_value = convertPhysicalToRaw(@CAN_RadarRL::RRL_Object::RRL_Object_Obj29.PxAxCoVnce, 0.005, -10.0);
    copyBitsToByteArrayLE(raw_value, byteArray, 15712, 12);

    raw_value = convertPhysicalToRaw(@CAN_RadarRL::RRL_Object::RRL_Object_Obj29.Age, 1.0, 0.0);
    copyBitsToByteArrayLE(raw_value, byteArray, 15872, 32);

    raw_value = convertPhysicalToRaw(@CAN_RadarRL::RRL_Object::RRL_Object_Obj29.ExistProb, 2.0, 0.0);
    copyBitsToByteArrayLE(raw_value, byteArray, 15608, 6);

    raw_value = convertPhysicalToRaw(@CAN_RadarRL::RRL_Object::RRL_Object_Obj29.VyAyCoVnce, 0.005, -10.0);
    copyBitsToByteArrayLE(raw_value, byteArray, 15840, 12);

    raw_value = convertPhysicalToRaw(@CAN_RadarRL::RRL_Object::RRL_Object_Obj29.VyAxCoVnce, 0.005, -10.0);
    copyBitsToByteArrayLE(raw_value, byteArray, 15820, 12);

    raw_value = convertPhysicalToRaw(@CAN_RadarRL::RRL_Object::RRL_Object_Obj29.VxAyCoVnce, 0.005, -10.0);
    copyBitsToByteArrayLE(raw_value, byteArray, 15808, 12);

    raw_value = convertPhysicalToRaw(@CAN_RadarRL::RRL_Object::RRL_Object_Obj29.VxAxCoVnce, 0.005, -10.0);
    copyBitsToByteArrayLE(raw_value, byteArray, 15788, 12);

    raw_value = convertPhysicalToRaw(@CAN_RadarRL::RRL_Object::RRL_Object_Obj29.PyAyCoVnce, 0.005, -10.0);
    copyBitsToByteArrayLE(raw_value, byteArray, 15756, 12);

    raw_value = convertPhysicalToRaw(@CAN_RadarRL::RRL_Object::RRL_Object_Obj29.PyAxCoVnce, 0.005, -10.0);
    copyBitsToByteArrayLE(raw_value, byteArray, 15744, 12);

    raw_value = convertPhysicalToRaw(@CAN_RadarRL::RRL_Object::RRL_Object_Obj29.PxAyCoVnce, 0.005, -10.0);
    copyBitsToByteArrayLE(raw_value, byteArray, 15724, 12);

    raw_value = convertPhysicalToRaw(@CAN_RadarRL::RRL_Object::RRL_Object_Obj29.VxVyCoVnce, 0.005, -10.0);
    copyBitsToByteArrayLE(raw_value, byteArray, 15776, 12);

    raw_value = convertPhysicalToRaw(@CAN_RadarRL::RRL_Object::RRL_Object_Obj29.ReferencePoint, 1.0, 0.0);
    copyBitsToByteArrayLE(raw_value, byteArray, 15704, 4);

    raw_value = convertPhysicalToRaw(@CAN_RadarRL::RRL_Object::RRL_Object_Obj29.PxVxCoVnce, 0.005, -10.0);
    copyBitsToByteArrayLE(raw_value, byteArray, 15648, 12);

    raw_value = convertPhysicalToRaw(@CAN_RadarRL::RRL_Object::RRL_Object_Obj29.PyVyCoVnce, 0.005, -10.0);
    copyBitsToByteArrayLE(raw_value, byteArray, 15692, 12);

    raw_value = convertPhysicalToRaw(@CAN_RadarRL::RRL_Object::RRL_Object_Obj29.PxPyCoVnce, 0.005, -10.0);
    copyBitsToByteArrayLE(raw_value, byteArray, 15628, 12);

    raw_value = convertPhysicalToRaw(@CAN_RadarRL::RRL_Object::RRL_Object_Obj29.MeasurementStatus, 1.0, 0.0);
    copyBitsToByteArrayLE(raw_value, byteArray, 15640, 3);

    raw_value = convertPhysicalToRaw(@CAN_RadarRL::RRL_Object::RRL_Object_Obj29.ProbClassType, 1.0, 0.0);
    copyBitsToByteArrayLE(raw_value, byteArray, 15643, 4);

    raw_value = convertPhysicalToRaw(@CAN_RadarRL::RRL_Object::RRL_Object_Obj29.VyVnce, 0.005, 0.0);
    copyBitsToByteArrayLE(raw_value, byteArray, 15616, 12);

    raw_value = convertPhysicalToRaw(@CAN_RadarRL::RRL_Object::RRL_Object_Obj29.PxVyCoVnce, 0.005, -10.0);
    copyBitsToByteArrayLE(raw_value, byteArray, 15660, 12);

    raw_value = convertPhysicalToRaw(@CAN_RadarRL::RRL_Object::RRL_Object_Obj29.FilterInformation, 1.0, 0.0);
    copyBitsToByteArrayLE(raw_value, byteArray, 15672, 8);

    raw_value = convertPhysicalToRaw(@CAN_RadarRL::RRL_Object::RRL_Object_Obj29.PyVxCoVnce, 0.005, -10.0);
    copyBitsToByteArrayLE(raw_value, byteArray, 15680, 12);
}


void RRL_Object_Obj28_write(byte byteArray[])
{
    qword raw_value;

    raw_value = convertPhysicalToRaw(@CAN_RadarRL::RRL_Object::RRL_Object_Obj28.AxVnce, 0.005, 0.0);
    copyBitsToByteArrayLE(raw_value, byteArray, 14976, 12);

    raw_value = convertPhysicalToRaw(@CAN_RadarRL::RRL_Object::RRL_Object_Obj28.VxVnce, 0.005, 0.0);
    copyBitsToByteArrayLE(raw_value, byteArray, 15072, 12);

    raw_value = convertPhysicalToRaw(@CAN_RadarRL::RRL_Object::RRL_Object_Obj28.ObjId, 1.0, 0.0);
    copyBitsToByteArrayLE(raw_value, byteArray, 15064, 7);

    raw_value = convertPhysicalToRaw(@CAN_RadarRL::RRL_Object::RRL_Object_Obj28.Vx, 0.0625, -128.0);
    copyBitsToByteArrayLE(raw_value, byteArray, 15052, 12);

    raw_value = convertPhysicalToRaw(@CAN_RadarRL::RRL_Object::RRL_Object_Obj28.AyVnce, 0.005, 0.0);
    copyBitsToByteArrayLE(raw_value, byteArray, 15040, 12);

    raw_value = convertPhysicalToRaw(@CAN_RadarRL::RRL_Object::RRL_Object_Obj28.Ay, 0.0625, -16.0);
    copyBitsToByteArrayLE(raw_value, byteArray, 15030, 9);

    raw_value = convertPhysicalToRaw(@CAN_RadarRL::RRL_Object::RRL_Object_Obj28.RCS, 0.2, -102.4);
    copyBitsToByteArrayLE(raw_value, byteArray, 15020, 10);

    raw_value = convertPhysicalToRaw(@CAN_RadarRL::RRL_Object::RRL_Object_Obj28.WidthVnce, 0.005, 0.0);
    copyBitsToByteArrayLE(raw_value, byteArray, 15008, 12);

    raw_value = convertPhysicalToRaw(@CAN_RadarRL::RRL_Object::RRL_Object_Obj28.Width, 0.125, 0.0);
    copyBitsToByteArrayLE(raw_value, byteArray, 15000, 7);

    raw_value = convertPhysicalToRaw(@CAN_RadarRL::RRL_Object::RRL_Object_Obj28.OrientationYawVnce, 0.0003, 0.0);
    copyBitsToByteArrayLE(raw_value, byteArray, 14988, 12);

    raw_value = convertPhysicalToRaw(@CAN_RadarRL::RRL_Object::RRL_Object_Obj28.Vy, 0.125, -64.0);
    copyBitsToByteArrayLE(raw_value, byteArray, 15086, 10);

    raw_value = convertPhysicalToRaw(@CAN_RadarRL::RRL_Object::RRL_Object_Obj28.OrientationYaw, 0.0175, -4.48);
    copyBitsToByteArrayLE(raw_value, byteArray, 14966, 9);

    raw_value = convertPhysicalToRaw(@CAN_RadarRL::RRL_Object::RRL_Object_Obj28.Ax, 0.03125, -16.0);
    copyBitsToByteArrayLE(raw_value, byteArray, 14956, 10);

    raw_value = convertPhysicalToRaw(@CAN_RadarRL::RRL_Object::RRL_Object_Obj28.LengthVnce, 0.005, 0.0);
    copyBitsToByteArrayLE(raw_value, byteArray, 14944, 12);

    raw_value = convertPhysicalToRaw(@CAN_RadarRL::RRL_Object::RRL_Object_Obj28.Length, 0.125, 0.0);
    copyBitsToByteArrayLE(raw_value, byteArray, 14936, 7);

    raw_value = convertPhysicalToRaw(@CAN_RadarRL::RRL_Object::RRL_Object_Obj28.PyVnce, 0.005, 0.0);
    copyBitsToByteArrayLE(raw_value, byteArray, 14924, 12);

    raw_value = convertPhysicalToRaw(@CAN_RadarRL::RRL_Object::RRL_Object_Obj28.Py, 0.0625, -128.0);
    copyBitsToByteArrayLE(raw_value, byteArray, 14912, 12);

    raw_value = convertPhysicalToRaw(@CAN_RadarRL::RRL_Object::RRL_Object_Obj28.PxVnce, 0.005, 0.0);
    copyBitsToByteArrayLE(raw_value, byteArray, 14900, 12);

    raw_value = convertPhysicalToRaw(@CAN_RadarRL::RRL_Object::RRL_Object_Obj28.Px, 0.0625, -512.0);
    copyBitsToByteArrayLE(raw_value, byteArray, 14886, 14);

    raw_value = convertPhysicalToRaw(@CAN_RadarRL::RRL_Object::RRL_Object_Obj28.ProbClassConfidence, 2.0, 0.0);
    copyBitsToByteArrayLE(raw_value, byteArray, 14880, 6);

    raw_value = convertPhysicalToRaw(@CAN_RadarRL::RRL_Object::RRL_Object_Obj28.MovingStatus, 1.0, 0.0);
    copyBitsToByteArrayLE(raw_value, byteArray, 15084, 2);

    raw_value = convertPhysicalToRaw(@CAN_RadarRL::RRL_Object::RRL_Object_Obj28.Age, 1.0, 0.0);
    copyBitsToByteArrayLE(raw_value, byteArray, 15360, 32);

    raw_value = convertPhysicalToRaw(@CAN_RadarRL::RRL_Object::RRL_Object_Obj28.ExistProb, 2.0, 0.0);
    copyBitsToByteArrayLE(raw_value, byteArray, 15096, 6);

    raw_value = convertPhysicalToRaw(@CAN_RadarRL::RRL_Object::RRL_Object_Obj28.PxAxCoVnce, 0.005, -10.0);
    copyBitsToByteArrayLE(raw_value, byteArray, 15200, 12);

    raw_value = convertPhysicalToRaw(@CAN_RadarRL::RRL_Object::RRL_Object_Obj28.VyVnce, 0.005, 0.0);
    copyBitsToByteArrayLE(raw_value, byteArray, 15104, 12);

    raw_value = convertPhysicalToRaw(@CAN_RadarRL::RRL_Object::RRL_Object_Obj28.VyAyCoVnce, 0.005, -10.0);
    copyBitsToByteArrayLE(raw_value, byteArray, 15328, 12);

    raw_value = convertPhysicalToRaw(@CAN_RadarRL::RRL_Object::RRL_Object_Obj28.VyAxCoVnce, 0.005, -10.0);
    copyBitsToByteArrayLE(raw_value, byteArray, 15308, 12);

    raw_value = convertPhysicalToRaw(@CAN_RadarRL::RRL_Object::RRL_Object_Obj28.VxAyCoVnce, 0.005, -10.0);
    copyBitsToByteArrayLE(raw_value, byteArray, 15296, 12);

    raw_value = convertPhysicalToRaw(@CAN_RadarRL::RRL_Object::RRL_Object_Obj28.VxAxCoVnce, 0.005, -10.0);
    copyBitsToByteArrayLE(raw_value, byteArray, 15276, 12);

    raw_value = convertPhysicalToRaw(@CAN_RadarRL::RRL_Object::RRL_Object_Obj28.VxVyCoVnce, 0.005, -10.0);
    copyBitsToByteArrayLE(raw_value, byteArray, 15264, 12);

    raw_value = convertPhysicalToRaw(@CAN_RadarRL::RRL_Object::RRL_Object_Obj28.PyAyCoVnce, 0.005, -10.0);
    copyBitsToByteArrayLE(raw_value, byteArray, 15244, 12);

    raw_value = convertPhysicalToRaw(@CAN_RadarRL::RRL_Object::RRL_Object_Obj28.PyAxCoVnce, 0.005, -10.0);
    copyBitsToByteArrayLE(raw_value, byteArray, 15232, 12);

    raw_value = convertPhysicalToRaw(@CAN_RadarRL::RRL_Object::RRL_Object_Obj28.PxAyCoVnce, 0.005, -10.0);
    copyBitsToByteArrayLE(raw_value, byteArray, 15212, 12);

    raw_value = convertPhysicalToRaw(@CAN_RadarRL::RRL_Object::RRL_Object_Obj28.AxAyCoVnce, 0.005, -10.0);
    copyBitsToByteArrayLE(raw_value, byteArray, 15340, 12);

    raw_value = convertPhysicalToRaw(@CAN_RadarRL::RRL_Object::RRL_Object_Obj28.ReferencePoint, 1.0, 0.0);
    copyBitsToByteArrayLE(raw_value, byteArray, 15192, 4);

    raw_value = convertPhysicalToRaw(@CAN_RadarRL::RRL_Object::RRL_Object_Obj28.PyVxCoVnce, 0.005, -10.0);
    copyBitsToByteArrayLE(raw_value, byteArray, 15168, 12);

    raw_value = convertPhysicalToRaw(@CAN_RadarRL::RRL_Object::RRL_Object_Obj28.FilterInformation, 1.0, 0.0);
    copyBitsToByteArrayLE(raw_value, byteArray, 15160, 8);

    raw_value = convertPhysicalToRaw(@CAN_RadarRL::RRL_Object::RRL_Object_Obj28.PxVyCoVnce, 0.005, -10.0);
    copyBitsToByteArrayLE(raw_value, byteArray, 15148, 12);

    raw_value = convertPhysicalToRaw(@CAN_RadarRL::RRL_Object::RRL_Object_Obj28.PxVxCoVnce, 0.005, -10.0);
    copyBitsToByteArrayLE(raw_value, byteArray, 15136, 12);

    raw_value = convertPhysicalToRaw(@CAN_RadarRL::RRL_Object::RRL_Object_Obj28.ProbClassType, 1.0, 0.0);
    copyBitsToByteArrayLE(raw_value, byteArray, 15131, 4);

    raw_value = convertPhysicalToRaw(@CAN_RadarRL::RRL_Object::RRL_Object_Obj28.MeasurementStatus, 1.0, 0.0);
    copyBitsToByteArrayLE(raw_value, byteArray, 15128, 3);

    raw_value = convertPhysicalToRaw(@CAN_RadarRL::RRL_Object::RRL_Object_Obj28.PxPyCoVnce, 0.005, -10.0);
    copyBitsToByteArrayLE(raw_value, byteArray, 15116, 12);

    raw_value = convertPhysicalToRaw(@CAN_RadarRL::RRL_Object::RRL_Object_Obj28.PyVyCoVnce, 0.005, -10.0);
    copyBitsToByteArrayLE(raw_value, byteArray, 15180, 12);
}


void RRL_Object_Obj27_write(byte byteArray[])
{
    qword raw_value;

    raw_value = convertPhysicalToRaw(@CAN_RadarRL::RRL_Object::RRL_Object_Obj27.Ay, 0.0625, -16.0);
    copyBitsToByteArrayLE(raw_value, byteArray, 14518, 9);

    raw_value = convertPhysicalToRaw(@CAN_RadarRL::RRL_Object::RRL_Object_Obj27.WidthVnce, 0.005, 0.0);
    copyBitsToByteArrayLE(raw_value, byteArray, 14496, 12);

    raw_value = convertPhysicalToRaw(@CAN_RadarRL::RRL_Object::RRL_Object_Obj27.RCS, 0.2, -102.4);
    copyBitsToByteArrayLE(raw_value, byteArray, 14508, 10);

    raw_value = convertPhysicalToRaw(@CAN_RadarRL::RRL_Object::RRL_Object_Obj27.VxVnce, 0.005, 0.0);
    copyBitsToByteArrayLE(raw_value, byteArray, 14560, 12);

    raw_value = convertPhysicalToRaw(@CAN_RadarRL::RRL_Object::RRL_Object_Obj27.AyVnce, 0.005, 0.0);
    copyBitsToByteArrayLE(raw_value, byteArray, 14528, 12);

    raw_value = convertPhysicalToRaw(@CAN_RadarRL::RRL_Object::RRL_Object_Obj27.Vx, 0.0625, -128.0);
    copyBitsToByteArrayLE(raw_value, byteArray, 14540, 12);

    raw_value = convertPhysicalToRaw(@CAN_RadarRL::RRL_Object::RRL_Object_Obj27.ObjId, 1.0, 0.0);
    copyBitsToByteArrayLE(raw_value, byteArray, 14552, 7);

    raw_value = convertPhysicalToRaw(@CAN_RadarRL::RRL_Object::RRL_Object_Obj27.OrientationYawVnce, 0.0003, 0.0);
    copyBitsToByteArrayLE(raw_value, byteArray, 14476, 12);

    raw_value = convertPhysicalToRaw(@CAN_RadarRL::RRL_Object::RRL_Object_Obj27.Width, 0.125, 0.0);
    copyBitsToByteArrayLE(raw_value, byteArray, 14488, 7);

    raw_value = convertPhysicalToRaw(@CAN_RadarRL::RRL_Object::RRL_Object_Obj27.Length, 0.125, 0.0);
    copyBitsToByteArrayLE(raw_value, byteArray, 14424, 7);

    raw_value = convertPhysicalToRaw(@CAN_RadarRL::RRL_Object::RRL_Object_Obj27.AxVnce, 0.005, 0.0);
    copyBitsToByteArrayLE(raw_value, byteArray, 14464, 12);

    raw_value = convertPhysicalToRaw(@CAN_RadarRL::RRL_Object::RRL_Object_Obj27.OrientationYaw, 0.0175, -4.48);
    copyBitsToByteArrayLE(raw_value, byteArray, 14454, 9);

    raw_value = convertPhysicalToRaw(@CAN_RadarRL::RRL_Object::RRL_Object_Obj27.Ax, 0.03125, -16.0);
    copyBitsToByteArrayLE(raw_value, byteArray, 14444, 10);

    raw_value = convertPhysicalToRaw(@CAN_RadarRL::RRL_Object::RRL_Object_Obj27.LengthVnce, 0.005, 0.0);
    copyBitsToByteArrayLE(raw_value, byteArray, 14432, 12);

    raw_value = convertPhysicalToRaw(@CAN_RadarRL::RRL_Object::RRL_Object_Obj27.PyVnce, 0.005, 0.0);
    copyBitsToByteArrayLE(raw_value, byteArray, 14412, 12);

    raw_value = convertPhysicalToRaw(@CAN_RadarRL::RRL_Object::RRL_Object_Obj27.Vy, 0.125, -64.0);
    copyBitsToByteArrayLE(raw_value, byteArray, 14574, 10);

    raw_value = convertPhysicalToRaw(@CAN_RadarRL::RRL_Object::RRL_Object_Obj27.PxVnce, 0.005, 0.0);
    copyBitsToByteArrayLE(raw_value, byteArray, 14388, 12);

    raw_value = convertPhysicalToRaw(@CAN_RadarRL::RRL_Object::RRL_Object_Obj27.Px, 0.0625, -512.0);
    copyBitsToByteArrayLE(raw_value, byteArray, 14374, 14);

    raw_value = convertPhysicalToRaw(@CAN_RadarRL::RRL_Object::RRL_Object_Obj27.ProbClassConfidence, 2.0, 0.0);
    copyBitsToByteArrayLE(raw_value, byteArray, 14368, 6);

    raw_value = convertPhysicalToRaw(@CAN_RadarRL::RRL_Object::RRL_Object_Obj27.MovingStatus, 1.0, 0.0);
    copyBitsToByteArrayLE(raw_value, byteArray, 14572, 2);

    raw_value = convertPhysicalToRaw(@CAN_RadarRL::RRL_Object::RRL_Object_Obj27.Py, 0.0625, -128.0);
    copyBitsToByteArrayLE(raw_value, byteArray, 14400, 12);

    raw_value = convertPhysicalToRaw(@CAN_RadarRL::RRL_Object::RRL_Object_Obj27.ExistProb, 2.0, 0.0);
    copyBitsToByteArrayLE(raw_value, byteArray, 14584, 6);

    raw_value = convertPhysicalToRaw(@CAN_RadarRL::RRL_Object::RRL_Object_Obj27.PxAyCoVnce, 0.005, -10.0);
    copyBitsToByteArrayLE(raw_value, byteArray, 14700, 12);

    raw_value = convertPhysicalToRaw(@CAN_RadarRL::RRL_Object::RRL_Object_Obj27.Age, 1.0, 0.0);
    copyBitsToByteArrayLE(raw_value, byteArray, 14848, 32);

    raw_value = convertPhysicalToRaw(@CAN_RadarRL::RRL_Object::RRL_Object_Obj27.AxAyCoVnce, 0.005, -10.0);
    copyBitsToByteArrayLE(raw_value, byteArray, 14828, 12);

    raw_value = convertPhysicalToRaw(@CAN_RadarRL::RRL_Object::RRL_Object_Obj27.VyAyCoVnce, 0.005, -10.0);
    copyBitsToByteArrayLE(raw_value, byteArray, 14816, 12);

    raw_value = convertPhysicalToRaw(@CAN_RadarRL::RRL_Object::RRL_Object_Obj27.VyAxCoVnce, 0.005, -10.0);
    copyBitsToByteArrayLE(raw_value, byteArray, 14796, 12);

    raw_value = convertPhysicalToRaw(@CAN_RadarRL::RRL_Object::RRL_Object_Obj27.VxAyCoVnce, 0.005, -10.0);
    copyBitsToByteArrayLE(raw_value, byteArray, 14784, 12);

    raw_value = convertPhysicalToRaw(@CAN_RadarRL::RRL_Object::RRL_Object_Obj27.VxAxCoVnce, 0.005, -10.0);
    copyBitsToByteArrayLE(raw_value, byteArray, 14764, 12);

    raw_value = convertPhysicalToRaw(@CAN_RadarRL::RRL_Object::RRL_Object_Obj27.VxVyCoVnce, 0.005, -10.0);
    copyBitsToByteArrayLE(raw_value, byteArray, 14752, 12);

    raw_value = convertPhysicalToRaw(@CAN_RadarRL::RRL_Object::RRL_Object_Obj27.PyAyCoVnce, 0.005, -10.0);
    copyBitsToByteArrayLE(raw_value, byteArray, 14732, 12);

    raw_value = convertPhysicalToRaw(@CAN_RadarRL::RRL_Object::RRL_Object_Obj27.PyAxCoVnce, 0.005, -10.0);
    copyBitsToByteArrayLE(raw_value, byteArray, 14720, 12);

    raw_value = convertPhysicalToRaw(@CAN_RadarRL::RRL_Object::RRL_Object_Obj27.VyVnce, 0.005, 0.0);
    copyBitsToByteArrayLE(raw_value, byteArray, 14592, 12);

    raw_value = convertPhysicalToRaw(@CAN_RadarRL::RRL_Object::RRL_Object_Obj27.PxAxCoVnce, 0.005, -10.0);
    copyBitsToByteArrayLE(raw_value, byteArray, 14688, 12);

    raw_value = convertPhysicalToRaw(@CAN_RadarRL::RRL_Object::RRL_Object_Obj27.PyVyCoVnce, 0.005, -10.0);
    copyBitsToByteArrayLE(raw_value, byteArray, 14668, 12);

    raw_value = convertPhysicalToRaw(@CAN_RadarRL::RRL_Object::RRL_Object_Obj27.PyVxCoVnce, 0.005, -10.0);
    copyBitsToByteArrayLE(raw_value, byteArray, 14656, 12);

    raw_value = convertPhysicalToRaw(@CAN_RadarRL::RRL_Object::RRL_Object_Obj27.FilterInformation, 1.0, 0.0);
    copyBitsToByteArrayLE(raw_value, byteArray, 14648, 8);

    raw_value = convertPhysicalToRaw(@CAN_RadarRL::RRL_Object::RRL_Object_Obj27.PxVyCoVnce, 0.005, -10.0);
    copyBitsToByteArrayLE(raw_value, byteArray, 14636, 12);

    raw_value = convertPhysicalToRaw(@CAN_RadarRL::RRL_Object::RRL_Object_Obj27.PxVxCoVnce, 0.005, -10.0);
    copyBitsToByteArrayLE(raw_value, byteArray, 14624, 12);

    raw_value = convertPhysicalToRaw(@CAN_RadarRL::RRL_Object::RRL_Object_Obj27.ProbClassType, 1.0, 0.0);
    copyBitsToByteArrayLE(raw_value, byteArray, 14619, 4);

    raw_value = convertPhysicalToRaw(@CAN_RadarRL::RRL_Object::RRL_Object_Obj27.MeasurementStatus, 1.0, 0.0);
    copyBitsToByteArrayLE(raw_value, byteArray, 14616, 3);

    raw_value = convertPhysicalToRaw(@CAN_RadarRL::RRL_Object::RRL_Object_Obj27.PxPyCoVnce, 0.005, -10.0);
    copyBitsToByteArrayLE(raw_value, byteArray, 14604, 12);

    raw_value = convertPhysicalToRaw(@CAN_RadarRL::RRL_Object::RRL_Object_Obj27.ReferencePoint, 1.0, 0.0);
    copyBitsToByteArrayLE(raw_value, byteArray, 14680, 4);
}


void RRL_Object_Obj26_write(byte byteArray[])
{
    qword raw_value;

    raw_value = convertPhysicalToRaw(@CAN_RadarRL::RRL_Object::RRL_Object_Obj26.RCS, 0.2, -102.4);
    copyBitsToByteArrayLE(raw_value, byteArray, 13996, 10);

    raw_value = convertPhysicalToRaw(@CAN_RadarRL::RRL_Object::RRL_Object_Obj26.Width, 0.125, 0.0);
    copyBitsToByteArrayLE(raw_value, byteArray, 13976, 7);

    raw_value = convertPhysicalToRaw(@CAN_RadarRL::RRL_Object::RRL_Object_Obj26.WidthVnce, 0.005, 0.0);
    copyBitsToByteArrayLE(raw_value, byteArray, 13984, 12);

    raw_value = convertPhysicalToRaw(@CAN_RadarRL::RRL_Object::RRL_Object_Obj26.ObjId, 1.0, 0.0);
    copyBitsToByteArrayLE(raw_value, byteArray, 14040, 7);

    raw_value = convertPhysicalToRaw(@CAN_RadarRL::RRL_Object::RRL_Object_Obj26.Ay, 0.0625, -16.0);
    copyBitsToByteArrayLE(raw_value, byteArray, 14006, 9);

    raw_value = convertPhysicalToRaw(@CAN_RadarRL::RRL_Object::RRL_Object_Obj26.AyVnce, 0.005, 0.0);
    copyBitsToByteArrayLE(raw_value, byteArray, 14016, 12);

    raw_value = convertPhysicalToRaw(@CAN_RadarRL::RRL_Object::RRL_Object_Obj26.Vx, 0.0625, -128.0);
    copyBitsToByteArrayLE(raw_value, byteArray, 14028, 12);

    raw_value = convertPhysicalToRaw(@CAN_RadarRL::RRL_Object::RRL_Object_Obj26.AxVnce, 0.005, 0.0);
    copyBitsToByteArrayLE(raw_value, byteArray, 13952, 12);

    raw_value = convertPhysicalToRaw(@CAN_RadarRL::RRL_Object::RRL_Object_Obj26.OrientationYawVnce, 0.0003, 0.0);
    copyBitsToByteArrayLE(raw_value, byteArray, 13964, 12);

    raw_value = convertPhysicalToRaw(@CAN_RadarRL::RRL_Object::RRL_Object_Obj26.PyVnce, 0.005, 0.0);
    copyBitsToByteArrayLE(raw_value, byteArray, 13900, 12);

    raw_value = convertPhysicalToRaw(@CAN_RadarRL::RRL_Object::RRL_Object_Obj26.OrientationYaw, 0.0175, -4.48);
    copyBitsToByteArrayLE(raw_value, byteArray, 13942, 9);

    raw_value = convertPhysicalToRaw(@CAN_RadarRL::RRL_Object::RRL_Object_Obj26.Ax, 0.03125, -16.0);
    copyBitsToByteArrayLE(raw_value, byteArray, 13932, 10);

    raw_value = convertPhysicalToRaw(@CAN_RadarRL::RRL_Object::RRL_Object_Obj26.LengthVnce, 0.005, 0.0);
    copyBitsToByteArrayLE(raw_value, byteArray, 13920, 12);

    raw_value = convertPhysicalToRaw(@CAN_RadarRL::RRL_Object::RRL_Object_Obj26.Length, 0.125, 0.0);
    copyBitsToByteArrayLE(raw_value, byteArray, 13912, 7);

    raw_value = convertPhysicalToRaw(@CAN_RadarRL::RRL_Object::RRL_Object_Obj26.Py, 0.0625, -128.0);
    copyBitsToByteArrayLE(raw_value, byteArray, 13888, 12);

    raw_value = convertPhysicalToRaw(@CAN_RadarRL::RRL_Object::RRL_Object_Obj26.PxVnce, 0.005, 0.0);
    copyBitsToByteArrayLE(raw_value, byteArray, 13876, 12);

    raw_value = convertPhysicalToRaw(@CAN_RadarRL::RRL_Object::RRL_Object_Obj26.Px, 0.0625, -512.0);
    copyBitsToByteArrayLE(raw_value, byteArray, 13862, 14);

    raw_value = convertPhysicalToRaw(@CAN_RadarRL::RRL_Object::RRL_Object_Obj26.ProbClassConfidence, 2.0, 0.0);
    copyBitsToByteArrayLE(raw_value, byteArray, 13856, 6);

    raw_value = convertPhysicalToRaw(@CAN_RadarRL::RRL_Object::RRL_Object_Obj26.MovingStatus, 1.0, 0.0);
    copyBitsToByteArrayLE(raw_value, byteArray, 14060, 2);

    raw_value = convertPhysicalToRaw(@CAN_RadarRL::RRL_Object::RRL_Object_Obj26.VxVnce, 0.005, 0.0);
    copyBitsToByteArrayLE(raw_value, byteArray, 14048, 12);

    raw_value = convertPhysicalToRaw(@CAN_RadarRL::RRL_Object::RRL_Object_Obj26.Vy, 0.125, -64.0);
    copyBitsToByteArrayLE(raw_value, byteArray, 14062, 10);

    raw_value = convertPhysicalToRaw(@CAN_RadarRL::RRL_Object::RRL_Object_Obj26.AxAyCoVnce, 0.005, -10.0);
    copyBitsToByteArrayLE(raw_value, byteArray, 14316, 12);

    raw_value = convertPhysicalToRaw(@CAN_RadarRL::RRL_Object::RRL_Object_Obj26.PxAxCoVnce, 0.005, -10.0);
    copyBitsToByteArrayLE(raw_value, byteArray, 14176, 12);

    raw_value = convertPhysicalToRaw(@CAN_RadarRL::RRL_Object::RRL_Object_Obj26.Age, 1.0, 0.0);
    copyBitsToByteArrayLE(raw_value, byteArray, 14336, 32);

    raw_value = convertPhysicalToRaw(@CAN_RadarRL::RRL_Object::RRL_Object_Obj26.ExistProb, 2.0, 0.0);
    copyBitsToByteArrayLE(raw_value, byteArray, 14072, 6);

    raw_value = convertPhysicalToRaw(@CAN_RadarRL::RRL_Object::RRL_Object_Obj26.VyAyCoVnce, 0.005, -10.0);
    copyBitsToByteArrayLE(raw_value, byteArray, 14304, 12);

    raw_value = convertPhysicalToRaw(@CAN_RadarRL::RRL_Object::RRL_Object_Obj26.VyAxCoVnce, 0.005, -10.0);
    copyBitsToByteArrayLE(raw_value, byteArray, 14284, 12);

    raw_value = convertPhysicalToRaw(@CAN_RadarRL::RRL_Object::RRL_Object_Obj26.VxAyCoVnce, 0.005, -10.0);
    copyBitsToByteArrayLE(raw_value, byteArray, 14272, 12);

    raw_value = convertPhysicalToRaw(@CAN_RadarRL::RRL_Object::RRL_Object_Obj26.VxAxCoVnce, 0.005, -10.0);
    copyBitsToByteArrayLE(raw_value, byteArray, 14252, 12);

    raw_value = convertPhysicalToRaw(@CAN_RadarRL::RRL_Object::RRL_Object_Obj26.VxVyCoVnce, 0.005, -10.0);
    copyBitsToByteArrayLE(raw_value, byteArray, 14240, 12);

    raw_value = convertPhysicalToRaw(@CAN_RadarRL::RRL_Object::RRL_Object_Obj26.PyAxCoVnce, 0.005, -10.0);
    copyBitsToByteArrayLE(raw_value, byteArray, 14208, 12);

    raw_value = convertPhysicalToRaw(@CAN_RadarRL::RRL_Object::RRL_Object_Obj26.PxAyCoVnce, 0.005, -10.0);
    copyBitsToByteArrayLE(raw_value, byteArray, 14188, 12);

    raw_value = convertPhysicalToRaw(@CAN_RadarRL::RRL_Object::RRL_Object_Obj26.PyAyCoVnce, 0.005, -10.0);
    copyBitsToByteArrayLE(raw_value, byteArray, 14220, 12);

    raw_value = convertPhysicalToRaw(@CAN_RadarRL::RRL_Object::RRL_Object_Obj26.ReferencePoint, 1.0, 0.0);
    copyBitsToByteArrayLE(raw_value, byteArray, 14168, 4);

    raw_value = convertPhysicalToRaw(@CAN_RadarRL::RRL_Object::RRL_Object_Obj26.PxVxCoVnce, 0.005, -10.0);
    copyBitsToByteArrayLE(raw_value, byteArray, 14112, 12);

    raw_value = convertPhysicalToRaw(@CAN_RadarRL::RRL_Object::RRL_Object_Obj26.VyVnce, 0.005, 0.0);
    copyBitsToByteArrayLE(raw_value, byteArray, 14080, 12);

    raw_value = convertPhysicalToRaw(@CAN_RadarRL::RRL_Object::RRL_Object_Obj26.PyVyCoVnce, 0.005, -10.0);
    copyBitsToByteArrayLE(raw_value, byteArray, 14156, 12);

    raw_value = convertPhysicalToRaw(@CAN_RadarRL::RRL_Object::RRL_Object_Obj26.MeasurementStatus, 1.0, 0.0);
    copyBitsToByteArrayLE(raw_value, byteArray, 14104, 3);

    raw_value = convertPhysicalToRaw(@CAN_RadarRL::RRL_Object::RRL_Object_Obj26.ProbClassType, 1.0, 0.0);
    copyBitsToByteArrayLE(raw_value, byteArray, 14107, 4);

    raw_value = convertPhysicalToRaw(@CAN_RadarRL::RRL_Object::RRL_Object_Obj26.PxPyCoVnce, 0.005, -10.0);
    copyBitsToByteArrayLE(raw_value, byteArray, 14092, 12);

    raw_value = convertPhysicalToRaw(@CAN_RadarRL::RRL_Object::RRL_Object_Obj26.PxVyCoVnce, 0.005, -10.0);
    copyBitsToByteArrayLE(raw_value, byteArray, 14124, 12);

    raw_value = convertPhysicalToRaw(@CAN_RadarRL::RRL_Object::RRL_Object_Obj26.FilterInformation, 1.0, 0.0);
    copyBitsToByteArrayLE(raw_value, byteArray, 14136, 8);

    raw_value = convertPhysicalToRaw(@CAN_RadarRL::RRL_Object::RRL_Object_Obj26.PyVxCoVnce, 0.005, -10.0);
    copyBitsToByteArrayLE(raw_value, byteArray, 14144, 12);
}


void RRL_Object_Obj25_write(byte byteArray[])
{
    qword raw_value;

    raw_value = convertPhysicalToRaw(@CAN_RadarRL::RRL_Object::RRL_Object_Obj25.OrientationYawVnce, 0.0003, 0.0);
    copyBitsToByteArrayLE(raw_value, byteArray, 13452, 12);

    raw_value = convertPhysicalToRaw(@CAN_RadarRL::RRL_Object::RRL_Object_Obj25.VxVnce, 0.005, 0.0);
    copyBitsToByteArrayLE(raw_value, byteArray, 13536, 12);

    raw_value = convertPhysicalToRaw(@CAN_RadarRL::RRL_Object::RRL_Object_Obj25.ObjId, 1.0, 0.0);
    copyBitsToByteArrayLE(raw_value, byteArray, 13528, 7);

    raw_value = convertPhysicalToRaw(@CAN_RadarRL::RRL_Object::RRL_Object_Obj25.Vx, 0.0625, -128.0);
    copyBitsToByteArrayLE(raw_value, byteArray, 13516, 12);

    raw_value = convertPhysicalToRaw(@CAN_RadarRL::RRL_Object::RRL_Object_Obj25.AyVnce, 0.005, 0.0);
    copyBitsToByteArrayLE(raw_value, byteArray, 13504, 12);

    raw_value = convertPhysicalToRaw(@CAN_RadarRL::RRL_Object::RRL_Object_Obj25.Ay, 0.0625, -16.0);
    copyBitsToByteArrayLE(raw_value, byteArray, 13494, 9);

    raw_value = convertPhysicalToRaw(@CAN_RadarRL::RRL_Object::RRL_Object_Obj25.RCS, 0.2, -102.4);
    copyBitsToByteArrayLE(raw_value, byteArray, 13484, 10);

    raw_value = convertPhysicalToRaw(@CAN_RadarRL::RRL_Object::RRL_Object_Obj25.WidthVnce, 0.005, 0.0);
    copyBitsToByteArrayLE(raw_value, byteArray, 13472, 12);

    raw_value = convertPhysicalToRaw(@CAN_RadarRL::RRL_Object::RRL_Object_Obj25.Width, 0.125, 0.0);
    copyBitsToByteArrayLE(raw_value, byteArray, 13464, 7);

    raw_value = convertPhysicalToRaw(@CAN_RadarRL::RRL_Object::RRL_Object_Obj25.Vy, 0.125, -64.0);
    copyBitsToByteArrayLE(raw_value, byteArray, 13550, 10);

    raw_value = convertPhysicalToRaw(@CAN_RadarRL::RRL_Object::RRL_Object_Obj25.AxVnce, 0.005, 0.0);
    copyBitsToByteArrayLE(raw_value, byteArray, 13440, 12);

    raw_value = convertPhysicalToRaw(@CAN_RadarRL::RRL_Object::RRL_Object_Obj25.OrientationYaw, 0.0175, -4.48);
    copyBitsToByteArrayLE(raw_value, byteArray, 13430, 9);

    raw_value = convertPhysicalToRaw(@CAN_RadarRL::RRL_Object::RRL_Object_Obj25.Ax, 0.03125, -16.0);
    copyBitsToByteArrayLE(raw_value, byteArray, 13420, 10);

    raw_value = convertPhysicalToRaw(@CAN_RadarRL::RRL_Object::RRL_Object_Obj25.LengthVnce, 0.005, 0.0);
    copyBitsToByteArrayLE(raw_value, byteArray, 13408, 12);

    raw_value = convertPhysicalToRaw(@CAN_RadarRL::RRL_Object::RRL_Object_Obj25.Length, 0.125, 0.0);
    copyBitsToByteArrayLE(raw_value, byteArray, 13400, 7);

    raw_value = convertPhysicalToRaw(@CAN_RadarRL::RRL_Object::RRL_Object_Obj25.PyVnce, 0.005, 0.0);
    copyBitsToByteArrayLE(raw_value, byteArray, 13388, 12);

    raw_value = convertPhysicalToRaw(@CAN_RadarRL::RRL_Object::RRL_Object_Obj25.Py, 0.0625, -128.0);
    copyBitsToByteArrayLE(raw_value, byteArray, 13376, 12);

    raw_value = convertPhysicalToRaw(@CAN_RadarRL::RRL_Object::RRL_Object_Obj25.PxVnce, 0.005, 0.0);
    copyBitsToByteArrayLE(raw_value, byteArray, 13364, 12);

    raw_value = convertPhysicalToRaw(@CAN_RadarRL::RRL_Object::RRL_Object_Obj25.Px, 0.0625, -512.0);
    copyBitsToByteArrayLE(raw_value, byteArray, 13350, 14);

    raw_value = convertPhysicalToRaw(@CAN_RadarRL::RRL_Object::RRL_Object_Obj25.ProbClassConfidence, 2.0, 0.0);
    copyBitsToByteArrayLE(raw_value, byteArray, 13344, 6);

    raw_value = convertPhysicalToRaw(@CAN_RadarRL::RRL_Object::RRL_Object_Obj25.MovingStatus, 1.0, 0.0);
    copyBitsToByteArrayLE(raw_value, byteArray, 13548, 2);

    raw_value = convertPhysicalToRaw(@CAN_RadarRL::RRL_Object::RRL_Object_Obj25.MeasurementStatus, 1.0, 0.0);
    copyBitsToByteArrayLE(raw_value, byteArray, 13592, 3);

    raw_value = convertPhysicalToRaw(@CAN_RadarRL::RRL_Object::RRL_Object_Obj25.ExistProb, 2.0, 0.0);
    copyBitsToByteArrayLE(raw_value, byteArray, 13560, 6);

    raw_value = convertPhysicalToRaw(@CAN_RadarRL::RRL_Object::RRL_Object_Obj25.PxAyCoVnce, 0.005, -10.0);
    copyBitsToByteArrayLE(raw_value, byteArray, 13676, 12);

    raw_value = convertPhysicalToRaw(@CAN_RadarRL::RRL_Object::RRL_Object_Obj25.VyVnce, 0.005, 0.0);
    copyBitsToByteArrayLE(raw_value, byteArray, 13568, 12);

    raw_value = convertPhysicalToRaw(@CAN_RadarRL::RRL_Object::RRL_Object_Obj25.Age, 1.0, 0.0);
    copyBitsToByteArrayLE(raw_value, byteArray, 13824, 32);

    raw_value = convertPhysicalToRaw(@CAN_RadarRL::RRL_Object::RRL_Object_Obj25.AxAyCoVnce, 0.005, -10.0);
    copyBitsToByteArrayLE(raw_value, byteArray, 13804, 12);

    raw_value = convertPhysicalToRaw(@CAN_RadarRL::RRL_Object::RRL_Object_Obj25.VyAyCoVnce, 0.005, -10.0);
    copyBitsToByteArrayLE(raw_value, byteArray, 13792, 12);

    raw_value = convertPhysicalToRaw(@CAN_RadarRL::RRL_Object::RRL_Object_Obj25.VyAxCoVnce, 0.005, -10.0);
    copyBitsToByteArrayLE(raw_value, byteArray, 13772, 12);

    raw_value = convertPhysicalToRaw(@CAN_RadarRL::RRL_Object::RRL_Object_Obj25.VxAyCoVnce, 0.005, -10.0);
    copyBitsToByteArrayLE(raw_value, byteArray, 13760, 12);

    raw_value = convertPhysicalToRaw(@CAN_RadarRL::RRL_Object::RRL_Object_Obj25.VxVyCoVnce, 0.005, -10.0);
    copyBitsToByteArrayLE(raw_value, byteArray, 13728, 12);

    raw_value = convertPhysicalToRaw(@CAN_RadarRL::RRL_Object::RRL_Object_Obj25.PyAyCoVnce, 0.005, -10.0);
    copyBitsToByteArrayLE(raw_value, byteArray, 13708, 12);

    raw_value = convertPhysicalToRaw(@CAN_RadarRL::RRL_Object::RRL_Object_Obj25.PyAxCoVnce, 0.005, -10.0);
    copyBitsToByteArrayLE(raw_value, byteArray, 13696, 12);

    raw_value = convertPhysicalToRaw(@CAN_RadarRL::RRL_Object::RRL_Object_Obj25.VxAxCoVnce, 0.005, -10.0);
    copyBitsToByteArrayLE(raw_value, byteArray, 13740, 12);

    raw_value = convertPhysicalToRaw(@CAN_RadarRL::RRL_Object::RRL_Object_Obj25.PxAxCoVnce, 0.005, -10.0);
    copyBitsToByteArrayLE(raw_value, byteArray, 13664, 12);

    raw_value = convertPhysicalToRaw(@CAN_RadarRL::RRL_Object::RRL_Object_Obj25.PyVyCoVnce, 0.005, -10.0);
    copyBitsToByteArrayLE(raw_value, byteArray, 13644, 12);

    raw_value = convertPhysicalToRaw(@CAN_RadarRL::RRL_Object::RRL_Object_Obj25.PyVxCoVnce, 0.005, -10.0);
    copyBitsToByteArrayLE(raw_value, byteArray, 13632, 12);

    raw_value = convertPhysicalToRaw(@CAN_RadarRL::RRL_Object::RRL_Object_Obj25.FilterInformation, 1.0, 0.0);
    copyBitsToByteArrayLE(raw_value, byteArray, 13624, 8);

    raw_value = convertPhysicalToRaw(@CAN_RadarRL::RRL_Object::RRL_Object_Obj25.PxVyCoVnce, 0.005, -10.0);
    copyBitsToByteArrayLE(raw_value, byteArray, 13612, 12);

    raw_value = convertPhysicalToRaw(@CAN_RadarRL::RRL_Object::RRL_Object_Obj25.PxVxCoVnce, 0.005, -10.0);
    copyBitsToByteArrayLE(raw_value, byteArray, 13600, 12);

    raw_value = convertPhysicalToRaw(@CAN_RadarRL::RRL_Object::RRL_Object_Obj25.ReferencePoint, 1.0, 0.0);
    copyBitsToByteArrayLE(raw_value, byteArray, 13656, 4);

    raw_value = convertPhysicalToRaw(@CAN_RadarRL::RRL_Object::RRL_Object_Obj25.ProbClassType, 1.0, 0.0);
    copyBitsToByteArrayLE(raw_value, byteArray, 13595, 4);

    raw_value = convertPhysicalToRaw(@CAN_RadarRL::RRL_Object::RRL_Object_Obj25.PxPyCoVnce, 0.005, -10.0);
    copyBitsToByteArrayLE(raw_value, byteArray, 13580, 12);
}


void RRL_Object_Obj24_write(byte byteArray[])
{
    qword raw_value;

    raw_value = convertPhysicalToRaw(@CAN_RadarRL::RRL_Object::RRL_Object_Obj24.AyVnce, 0.005, 0.0);
    copyBitsToByteArrayLE(raw_value, byteArray, 12992, 12);

    raw_value = convertPhysicalToRaw(@CAN_RadarRL::RRL_Object::RRL_Object_Obj24.WidthVnce, 0.005, 0.0);
    copyBitsToByteArrayLE(raw_value, byteArray, 12960, 12);

    raw_value = convertPhysicalToRaw(@CAN_RadarRL::RRL_Object::RRL_Object_Obj24.RCS, 0.2, -102.4);
    copyBitsToByteArrayLE(raw_value, byteArray, 12972, 10);

    raw_value = convertPhysicalToRaw(@CAN_RadarRL::RRL_Object::RRL_Object_Obj24.Ay, 0.0625, -16.0);
    copyBitsToByteArrayLE(raw_value, byteArray, 12982, 9);

    raw_value = convertPhysicalToRaw(@CAN_RadarRL::RRL_Object::RRL_Object_Obj24.ObjId, 1.0, 0.0);
    copyBitsToByteArrayLE(raw_value, byteArray, 13016, 7);

    raw_value = convertPhysicalToRaw(@CAN_RadarRL::RRL_Object::RRL_Object_Obj24.Vx, 0.0625, -128.0);
    copyBitsToByteArrayLE(raw_value, byteArray, 13004, 12);

    raw_value = convertPhysicalToRaw(@CAN_RadarRL::RRL_Object::RRL_Object_Obj24.VxVnce, 0.005, 0.0);
    copyBitsToByteArrayLE(raw_value, byteArray, 13024, 12);

    raw_value = convertPhysicalToRaw(@CAN_RadarRL::RRL_Object::RRL_Object_Obj24.OrientationYawVnce, 0.0003, 0.0);
    copyBitsToByteArrayLE(raw_value, byteArray, 12940, 12);

    raw_value = convertPhysicalToRaw(@CAN_RadarRL::RRL_Object::RRL_Object_Obj24.Width, 0.125, 0.0);
    copyBitsToByteArrayLE(raw_value, byteArray, 12952, 7);

    raw_value = convertPhysicalToRaw(@CAN_RadarRL::RRL_Object::RRL_Object_Obj24.Px, 0.0625, -512.0);
    copyBitsToByteArrayLE(raw_value, byteArray, 12838, 14);

    raw_value = convertPhysicalToRaw(@CAN_RadarRL::RRL_Object::RRL_Object_Obj24.AxVnce, 0.005, 0.0);
    copyBitsToByteArrayLE(raw_value, byteArray, 12928, 12);

    raw_value = convertPhysicalToRaw(@CAN_RadarRL::RRL_Object::RRL_Object_Obj24.OrientationYaw, 0.0175, -4.48);
    copyBitsToByteArrayLE(raw_value, byteArray, 12918, 9);

    raw_value = convertPhysicalToRaw(@CAN_RadarRL::RRL_Object::RRL_Object_Obj24.Ax, 0.03125, -16.0);
    copyBitsToByteArrayLE(raw_value, byteArray, 12908, 10);

    raw_value = convertPhysicalToRaw(@CAN_RadarRL::RRL_Object::RRL_Object_Obj24.LengthVnce, 0.005, 0.0);
    copyBitsToByteArrayLE(raw_value, byteArray, 12896, 12);

    raw_value = convertPhysicalToRaw(@CAN_RadarRL::RRL_Object::RRL_Object_Obj24.Length, 0.125, 0.0);
    copyBitsToByteArrayLE(raw_value, byteArray, 12888, 7);

    raw_value = convertPhysicalToRaw(@CAN_RadarRL::RRL_Object::RRL_Object_Obj24.PyVnce, 0.005, 0.0);
    copyBitsToByteArrayLE(raw_value, byteArray, 12876, 12);

    raw_value = convertPhysicalToRaw(@CAN_RadarRL::RRL_Object::RRL_Object_Obj24.Py, 0.0625, -128.0);
    copyBitsToByteArrayLE(raw_value, byteArray, 12864, 12);

    raw_value = convertPhysicalToRaw(@CAN_RadarRL::RRL_Object::RRL_Object_Obj24.PxVnce, 0.005, 0.0);
    copyBitsToByteArrayLE(raw_value, byteArray, 12852, 12);

    raw_value = convertPhysicalToRaw(@CAN_RadarRL::RRL_Object::RRL_Object_Obj24.Vy, 0.125, -64.0);
    copyBitsToByteArrayLE(raw_value, byteArray, 13038, 10);

    raw_value = convertPhysicalToRaw(@CAN_RadarRL::RRL_Object::RRL_Object_Obj24.ProbClassConfidence, 2.0, 0.0);
    copyBitsToByteArrayLE(raw_value, byteArray, 12832, 6);

    raw_value = convertPhysicalToRaw(@CAN_RadarRL::RRL_Object::RRL_Object_Obj24.MovingStatus, 1.0, 0.0);
    copyBitsToByteArrayLE(raw_value, byteArray, 13036, 2);

    raw_value = convertPhysicalToRaw(@CAN_RadarRL::RRL_Object::RRL_Object_Obj24.ProbClassType, 1.0, 0.0);
    copyBitsToByteArrayLE(raw_value, byteArray, 13083, 4);

    raw_value = convertPhysicalToRaw(@CAN_RadarRL::RRL_Object::RRL_Object_Obj24.ExistProb, 2.0, 0.0);
    copyBitsToByteArrayLE(raw_value, byteArray, 13048, 6);

    raw_value = convertPhysicalToRaw(@CAN_RadarRL::RRL_Object::RRL_Object_Obj24.PxAyCoVnce, 0.005, -10.0);
    copyBitsToByteArrayLE(raw_value, byteArray, 13164, 12);

    raw_value = convertPhysicalToRaw(@CAN_RadarRL::RRL_Object::RRL_Object_Obj24.Age, 1.0, 0.0);
    copyBitsToByteArrayLE(raw_value, byteArray, 13312, 32);

    raw_value = convertPhysicalToRaw(@CAN_RadarRL::RRL_Object::RRL_Object_Obj24.AxAyCoVnce, 0.005, -10.0);
    copyBitsToByteArrayLE(raw_value, byteArray, 13292, 12);

    raw_value = convertPhysicalToRaw(@CAN_RadarRL::RRL_Object::RRL_Object_Obj24.VyAyCoVnce, 0.005, -10.0);
    copyBitsToByteArrayLE(raw_value, byteArray, 13280, 12);

    raw_value = convertPhysicalToRaw(@CAN_RadarRL::RRL_Object::RRL_Object_Obj24.VyVnce, 0.005, 0.0);
    copyBitsToByteArrayLE(raw_value, byteArray, 13056, 12);

    raw_value = convertPhysicalToRaw(@CAN_RadarRL::RRL_Object::RRL_Object_Obj24.VxAyCoVnce, 0.005, -10.0);
    copyBitsToByteArrayLE(raw_value, byteArray, 13248, 12);

    raw_value = convertPhysicalToRaw(@CAN_RadarRL::RRL_Object::RRL_Object_Obj24.VxAxCoVnce, 0.005, -10.0);
    copyBitsToByteArrayLE(raw_value, byteArray, 13228, 12);

    raw_value = convertPhysicalToRaw(@CAN_RadarRL::RRL_Object::RRL_Object_Obj24.VxVyCoVnce, 0.005, -10.0);
    copyBitsToByteArrayLE(raw_value, byteArray, 13216, 12);

    raw_value = convertPhysicalToRaw(@CAN_RadarRL::RRL_Object::RRL_Object_Obj24.PyAyCoVnce, 0.005, -10.0);
    copyBitsToByteArrayLE(raw_value, byteArray, 13196, 12);

    raw_value = convertPhysicalToRaw(@CAN_RadarRL::RRL_Object::RRL_Object_Obj24.PyAxCoVnce, 0.005, -10.0);
    copyBitsToByteArrayLE(raw_value, byteArray, 13184, 12);

    raw_value = convertPhysicalToRaw(@CAN_RadarRL::RRL_Object::RRL_Object_Obj24.VyAxCoVnce, 0.005, -10.0);
    copyBitsToByteArrayLE(raw_value, byteArray, 13260, 12);

    raw_value = convertPhysicalToRaw(@CAN_RadarRL::RRL_Object::RRL_Object_Obj24.PxAxCoVnce, 0.005, -10.0);
    copyBitsToByteArrayLE(raw_value, byteArray, 13152, 12);

    raw_value = convertPhysicalToRaw(@CAN_RadarRL::RRL_Object::RRL_Object_Obj24.PyVyCoVnce, 0.005, -10.0);
    copyBitsToByteArrayLE(raw_value, byteArray, 13132, 12);

    raw_value = convertPhysicalToRaw(@CAN_RadarRL::RRL_Object::RRL_Object_Obj24.PyVxCoVnce, 0.005, -10.0);
    copyBitsToByteArrayLE(raw_value, byteArray, 13120, 12);

    raw_value = convertPhysicalToRaw(@CAN_RadarRL::RRL_Object::RRL_Object_Obj24.FilterInformation, 1.0, 0.0);
    copyBitsToByteArrayLE(raw_value, byteArray, 13112, 8);

    raw_value = convertPhysicalToRaw(@CAN_RadarRL::RRL_Object::RRL_Object_Obj24.PxVyCoVnce, 0.005, -10.0);
    copyBitsToByteArrayLE(raw_value, byteArray, 13100, 12);

    raw_value = convertPhysicalToRaw(@CAN_RadarRL::RRL_Object::RRL_Object_Obj24.PxVxCoVnce, 0.005, -10.0);
    copyBitsToByteArrayLE(raw_value, byteArray, 13088, 12);

    raw_value = convertPhysicalToRaw(@CAN_RadarRL::RRL_Object::RRL_Object_Obj24.MeasurementStatus, 1.0, 0.0);
    copyBitsToByteArrayLE(raw_value, byteArray, 13080, 3);

    raw_value = convertPhysicalToRaw(@CAN_RadarRL::RRL_Object::RRL_Object_Obj24.PxPyCoVnce, 0.005, -10.0);
    copyBitsToByteArrayLE(raw_value, byteArray, 13068, 12);

    raw_value = convertPhysicalToRaw(@CAN_RadarRL::RRL_Object::RRL_Object_Obj24.ReferencePoint, 1.0, 0.0);
    copyBitsToByteArrayLE(raw_value, byteArray, 13144, 4);
}


void RRL_Object_Obj23_write(byte byteArray[])
{
    qword raw_value;

    raw_value = convertPhysicalToRaw(@CAN_RadarRL::RRL_Object::RRL_Object_Obj23.VxVyCoVnce, 0.005, -10.0);
    copyBitsToByteArrayLE(raw_value, byteArray, 12704, 12);

    raw_value = convertPhysicalToRaw(@CAN_RadarRL::RRL_Object::RRL_Object_Obj23.PyVxCoVnce, 0.005, -10.0);
    copyBitsToByteArrayLE(raw_value, byteArray, 12608, 12);

    raw_value = convertPhysicalToRaw(@CAN_RadarRL::RRL_Object::RRL_Object_Obj23.PxAxCoVnce, 0.005, -10.0);
    copyBitsToByteArrayLE(raw_value, byteArray, 12640, 12);

    raw_value = convertPhysicalToRaw(@CAN_RadarRL::RRL_Object::RRL_Object_Obj23.PxAyCoVnce, 0.005, -10.0);
    copyBitsToByteArrayLE(raw_value, byteArray, 12652, 12);

    raw_value = convertPhysicalToRaw(@CAN_RadarRL::RRL_Object::RRL_Object_Obj23.PyAxCoVnce, 0.005, -10.0);
    copyBitsToByteArrayLE(raw_value, byteArray, 12672, 12);

    raw_value = convertPhysicalToRaw(@CAN_RadarRL::RRL_Object::RRL_Object_Obj23.PyAyCoVnce, 0.005, -10.0);
    copyBitsToByteArrayLE(raw_value, byteArray, 12684, 12);

    raw_value = convertPhysicalToRaw(@CAN_RadarRL::RRL_Object::RRL_Object_Obj23.VyAyCoVnce, 0.005, -10.0);
    copyBitsToByteArrayLE(raw_value, byteArray, 12768, 12);

    raw_value = convertPhysicalToRaw(@CAN_RadarRL::RRL_Object::RRL_Object_Obj23.VxAxCoVnce, 0.005, -10.0);
    copyBitsToByteArrayLE(raw_value, byteArray, 12716, 12);

    raw_value = convertPhysicalToRaw(@CAN_RadarRL::RRL_Object::RRL_Object_Obj23.VxAyCoVnce, 0.005, -10.0);
    copyBitsToByteArrayLE(raw_value, byteArray, 12736, 12);

    raw_value = convertPhysicalToRaw(@CAN_RadarRL::RRL_Object::RRL_Object_Obj23.VyAxCoVnce, 0.005, -10.0);
    copyBitsToByteArrayLE(raw_value, byteArray, 12748, 12);

    raw_value = convertPhysicalToRaw(@CAN_RadarRL::RRL_Object::RRL_Object_Obj23.AxAyCoVnce, 0.005, -10.0);
    copyBitsToByteArrayLE(raw_value, byteArray, 12780, 12);

    raw_value = convertPhysicalToRaw(@CAN_RadarRL::RRL_Object::RRL_Object_Obj23.Age, 1.0, 0.0);
    copyBitsToByteArrayLE(raw_value, byteArray, 12800, 32);

    raw_value = convertPhysicalToRaw(@CAN_RadarRL::RRL_Object::RRL_Object_Obj23.PyVyCoVnce, 0.005, -10.0);
    copyBitsToByteArrayLE(raw_value, byteArray, 12620, 12);

    raw_value = convertPhysicalToRaw(@CAN_RadarRL::RRL_Object::RRL_Object_Obj23.ReferencePoint, 1.0, 0.0);
    copyBitsToByteArrayLE(raw_value, byteArray, 12632, 4);

    raw_value = convertPhysicalToRaw(@CAN_RadarRL::RRL_Object::RRL_Object_Obj23.FilterInformation, 1.0, 0.0);
    copyBitsToByteArrayLE(raw_value, byteArray, 12600, 8);

    raw_value = convertPhysicalToRaw(@CAN_RadarRL::RRL_Object::RRL_Object_Obj23.RCS, 0.2, -102.4);
    copyBitsToByteArrayLE(raw_value, byteArray, 12460, 10);

    raw_value = convertPhysicalToRaw(@CAN_RadarRL::RRL_Object::RRL_Object_Obj23.PxVyCoVnce, 0.005, -10.0);
    copyBitsToByteArrayLE(raw_value, byteArray, 12588, 12);

    raw_value = convertPhysicalToRaw(@CAN_RadarRL::RRL_Object::RRL_Object_Obj23.ProbClassConfidence, 2.0, 0.0);
    copyBitsToByteArrayLE(raw_value, byteArray, 12320, 6);

    raw_value = convertPhysicalToRaw(@CAN_RadarRL::RRL_Object::RRL_Object_Obj23.Px, 0.0625, -512.0);
    copyBitsToByteArrayLE(raw_value, byteArray, 12326, 14);

    raw_value = convertPhysicalToRaw(@CAN_RadarRL::RRL_Object::RRL_Object_Obj23.PxVnce, 0.005, 0.0);
    copyBitsToByteArrayLE(raw_value, byteArray, 12340, 12);

    raw_value = convertPhysicalToRaw(@CAN_RadarRL::RRL_Object::RRL_Object_Obj23.PyVnce, 0.005, 0.0);
    copyBitsToByteArrayLE(raw_value, byteArray, 12364, 12);

    raw_value = convertPhysicalToRaw(@CAN_RadarRL::RRL_Object::RRL_Object_Obj23.Length, 0.125, 0.0);
    copyBitsToByteArrayLE(raw_value, byteArray, 12376, 7);

    raw_value = convertPhysicalToRaw(@CAN_RadarRL::RRL_Object::RRL_Object_Obj23.LengthVnce, 0.005, 0.0);
    copyBitsToByteArrayLE(raw_value, byteArray, 12384, 12);

    raw_value = convertPhysicalToRaw(@CAN_RadarRL::RRL_Object::RRL_Object_Obj23.Ax, 0.03125, -16.0);
    copyBitsToByteArrayLE(raw_value, byteArray, 12396, 10);

    raw_value = convertPhysicalToRaw(@CAN_RadarRL::RRL_Object::RRL_Object_Obj23.OrientationYaw, 0.0175, -4.48);
    copyBitsToByteArrayLE(raw_value, byteArray, 12406, 9);

    raw_value = convertPhysicalToRaw(@CAN_RadarRL::RRL_Object::RRL_Object_Obj23.AxVnce, 0.005, 0.0);
    copyBitsToByteArrayLE(raw_value, byteArray, 12416, 12);

    raw_value = convertPhysicalToRaw(@CAN_RadarRL::RRL_Object::RRL_Object_Obj23.OrientationYawVnce, 0.0003, 0.0);
    copyBitsToByteArrayLE(raw_value, byteArray, 12428, 12);

    raw_value = convertPhysicalToRaw(@CAN_RadarRL::RRL_Object::RRL_Object_Obj23.Width, 0.125, 0.0);
    copyBitsToByteArrayLE(raw_value, byteArray, 12440, 7);

    raw_value = convertPhysicalToRaw(@CAN_RadarRL::RRL_Object::RRL_Object_Obj23.WidthVnce, 0.005, 0.0);
    copyBitsToByteArrayLE(raw_value, byteArray, 12448, 12);

    raw_value = convertPhysicalToRaw(@CAN_RadarRL::RRL_Object::RRL_Object_Obj23.Py, 0.0625, -128.0);
    copyBitsToByteArrayLE(raw_value, byteArray, 12352, 12);

    raw_value = convertPhysicalToRaw(@CAN_RadarRL::RRL_Object::RRL_Object_Obj23.Ay, 0.0625, -16.0);
    copyBitsToByteArrayLE(raw_value, byteArray, 12470, 9);

    raw_value = convertPhysicalToRaw(@CAN_RadarRL::RRL_Object::RRL_Object_Obj23.ExistProb, 2.0, 0.0);
    copyBitsToByteArrayLE(raw_value, byteArray, 12536, 6);

    raw_value = convertPhysicalToRaw(@CAN_RadarRL::RRL_Object::RRL_Object_Obj23.AyVnce, 0.005, 0.0);
    copyBitsToByteArrayLE(raw_value, byteArray, 12480, 12);

    raw_value = convertPhysicalToRaw(@CAN_RadarRL::RRL_Object::RRL_Object_Obj23.PxVxCoVnce, 0.005, -10.0);
    copyBitsToByteArrayLE(raw_value, byteArray, 12576, 12);

    raw_value = convertPhysicalToRaw(@CAN_RadarRL::RRL_Object::RRL_Object_Obj23.ProbClassType, 1.0, 0.0);
    copyBitsToByteArrayLE(raw_value, byteArray, 12571, 4);

    raw_value = convertPhysicalToRaw(@CAN_RadarRL::RRL_Object::RRL_Object_Obj23.PxPyCoVnce, 0.005, -10.0);
    copyBitsToByteArrayLE(raw_value, byteArray, 12556, 12);

    raw_value = convertPhysicalToRaw(@CAN_RadarRL::RRL_Object::RRL_Object_Obj23.VyVnce, 0.005, 0.0);
    copyBitsToByteArrayLE(raw_value, byteArray, 12544, 12);

    raw_value = convertPhysicalToRaw(@CAN_RadarRL::RRL_Object::RRL_Object_Obj23.MeasurementStatus, 1.0, 0.0);
    copyBitsToByteArrayLE(raw_value, byteArray, 12568, 3);

    raw_value = convertPhysicalToRaw(@CAN_RadarRL::RRL_Object::RRL_Object_Obj23.Vy, 0.125, -64.0);
    copyBitsToByteArrayLE(raw_value, byteArray, 12526, 10);

    raw_value = convertPhysicalToRaw(@CAN_RadarRL::RRL_Object::RRL_Object_Obj23.MovingStatus, 1.0, 0.0);
    copyBitsToByteArrayLE(raw_value, byteArray, 12524, 2);

    raw_value = convertPhysicalToRaw(@CAN_RadarRL::RRL_Object::RRL_Object_Obj23.VxVnce, 0.005, 0.0);
    copyBitsToByteArrayLE(raw_value, byteArray, 12512, 12);

    raw_value = convertPhysicalToRaw(@CAN_RadarRL::RRL_Object::RRL_Object_Obj23.ObjId, 1.0, 0.0);
    copyBitsToByteArrayLE(raw_value, byteArray, 12504, 7);

    raw_value = convertPhysicalToRaw(@CAN_RadarRL::RRL_Object::RRL_Object_Obj23.Vx, 0.0625, -128.0);
    copyBitsToByteArrayLE(raw_value, byteArray, 12492, 12);
}


void RRL_Object_Obj22_write(byte byteArray[])
{
    qword raw_value;

    raw_value = convertPhysicalToRaw(@CAN_RadarRL::RRL_Object::RRL_Object_Obj22.MovingStatus, 1.0, 0.0);
    copyBitsToByteArrayLE(raw_value, byteArray, 12012, 2);

    raw_value = convertPhysicalToRaw(@CAN_RadarRL::RRL_Object::RRL_Object_Obj22.AxVnce, 0.005, 0.0);
    copyBitsToByteArrayLE(raw_value, byteArray, 11904, 12);

    raw_value = convertPhysicalToRaw(@CAN_RadarRL::RRL_Object::RRL_Object_Obj22.VxVnce, 0.005, 0.0);
    copyBitsToByteArrayLE(raw_value, byteArray, 12000, 12);

    raw_value = convertPhysicalToRaw(@CAN_RadarRL::RRL_Object::RRL_Object_Obj22.Vx, 0.0625, -128.0);
    copyBitsToByteArrayLE(raw_value, byteArray, 11980, 12);

    raw_value = convertPhysicalToRaw(@CAN_RadarRL::RRL_Object::RRL_Object_Obj22.AyVnce, 0.005, 0.0);
    copyBitsToByteArrayLE(raw_value, byteArray, 11968, 12);

    raw_value = convertPhysicalToRaw(@CAN_RadarRL::RRL_Object::RRL_Object_Obj22.Ay, 0.0625, -16.0);
    copyBitsToByteArrayLE(raw_value, byteArray, 11958, 9);

    raw_value = convertPhysicalToRaw(@CAN_RadarRL::RRL_Object::RRL_Object_Obj22.RCS, 0.2, -102.4);
    copyBitsToByteArrayLE(raw_value, byteArray, 11948, 10);

    raw_value = convertPhysicalToRaw(@CAN_RadarRL::RRL_Object::RRL_Object_Obj22.WidthVnce, 0.005, 0.0);
    copyBitsToByteArrayLE(raw_value, byteArray, 11936, 12);

    raw_value = convertPhysicalToRaw(@CAN_RadarRL::RRL_Object::RRL_Object_Obj22.Width, 0.125, 0.0);
    copyBitsToByteArrayLE(raw_value, byteArray, 11928, 7);

    raw_value = convertPhysicalToRaw(@CAN_RadarRL::RRL_Object::RRL_Object_Obj22.OrientationYawVnce, 0.0003, 0.0);
    copyBitsToByteArrayLE(raw_value, byteArray, 11916, 12);

    raw_value = convertPhysicalToRaw(@CAN_RadarRL::RRL_Object::RRL_Object_Obj22.Py, 0.0625, -128.0);
    copyBitsToByteArrayLE(raw_value, byteArray, 11840, 12);

    raw_value = convertPhysicalToRaw(@CAN_RadarRL::RRL_Object::RRL_Object_Obj22.OrientationYaw, 0.0175, -4.48);
    copyBitsToByteArrayLE(raw_value, byteArray, 11894, 9);

    raw_value = convertPhysicalToRaw(@CAN_RadarRL::RRL_Object::RRL_Object_Obj22.Ax, 0.03125, -16.0);
    copyBitsToByteArrayLE(raw_value, byteArray, 11884, 10);

    raw_value = convertPhysicalToRaw(@CAN_RadarRL::RRL_Object::RRL_Object_Obj22.LengthVnce, 0.005, 0.0);
    copyBitsToByteArrayLE(raw_value, byteArray, 11872, 12);

    raw_value = convertPhysicalToRaw(@CAN_RadarRL::RRL_Object::RRL_Object_Obj22.Length, 0.125, 0.0);
    copyBitsToByteArrayLE(raw_value, byteArray, 11864, 7);

    raw_value = convertPhysicalToRaw(@CAN_RadarRL::RRL_Object::RRL_Object_Obj22.PyVnce, 0.005, 0.0);
    copyBitsToByteArrayLE(raw_value, byteArray, 11852, 12);

    raw_value = convertPhysicalToRaw(@CAN_RadarRL::RRL_Object::RRL_Object_Obj22.PxVnce, 0.005, 0.0);
    copyBitsToByteArrayLE(raw_value, byteArray, 11828, 12);

    raw_value = convertPhysicalToRaw(@CAN_RadarRL::RRL_Object::RRL_Object_Obj22.Px, 0.0625, -512.0);
    copyBitsToByteArrayLE(raw_value, byteArray, 11814, 14);

    raw_value = convertPhysicalToRaw(@CAN_RadarRL::RRL_Object::RRL_Object_Obj22.ProbClassConfidence, 2.0, 0.0);
    copyBitsToByteArrayLE(raw_value, byteArray, 11808, 6);

    raw_value = convertPhysicalToRaw(@CAN_RadarRL::RRL_Object::RRL_Object_Obj22.ExistProb, 2.0, 0.0);
    copyBitsToByteArrayLE(raw_value, byteArray, 12024, 6);

    raw_value = convertPhysicalToRaw(@CAN_RadarRL::RRL_Object::RRL_Object_Obj22.Vy, 0.125, -64.0);
    copyBitsToByteArrayLE(raw_value, byteArray, 12014, 10);

    raw_value = convertPhysicalToRaw(@CAN_RadarRL::RRL_Object::RRL_Object_Obj22.ObjId, 1.0, 0.0);
    copyBitsToByteArrayLE(raw_value, byteArray, 11992, 7);

    raw_value = convertPhysicalToRaw(@CAN_RadarRL::RRL_Object::RRL_Object_Obj22.VyVnce, 0.005, 0.0);
    copyBitsToByteArrayLE(raw_value, byteArray, 12032, 12);

    raw_value = convertPhysicalToRaw(@CAN_RadarRL::RRL_Object::RRL_Object_Obj22.PxAyCoVnce, 0.005, -10.0);
    copyBitsToByteArrayLE(raw_value, byteArray, 12140, 12);

    raw_value = convertPhysicalToRaw(@CAN_RadarRL::RRL_Object::RRL_Object_Obj22.Age, 1.0, 0.0);
    copyBitsToByteArrayLE(raw_value, byteArray, 12288, 32);

    raw_value = convertPhysicalToRaw(@CAN_RadarRL::RRL_Object::RRL_Object_Obj22.AxAyCoVnce, 0.005, -10.0);
    copyBitsToByteArrayLE(raw_value, byteArray, 12268, 12);

    raw_value = convertPhysicalToRaw(@CAN_RadarRL::RRL_Object::RRL_Object_Obj22.VyAyCoVnce, 0.005, -10.0);
    copyBitsToByteArrayLE(raw_value, byteArray, 12256, 12);

    raw_value = convertPhysicalToRaw(@CAN_RadarRL::RRL_Object::RRL_Object_Obj22.VyAxCoVnce, 0.005, -10.0);
    copyBitsToByteArrayLE(raw_value, byteArray, 12236, 12);

    raw_value = convertPhysicalToRaw(@CAN_RadarRL::RRL_Object::RRL_Object_Obj22.VxAyCoVnce, 0.005, -10.0);
    copyBitsToByteArrayLE(raw_value, byteArray, 12224, 12);

    raw_value = convertPhysicalToRaw(@CAN_RadarRL::RRL_Object::RRL_Object_Obj22.VxAxCoVnce, 0.005, -10.0);
    copyBitsToByteArrayLE(raw_value, byteArray, 12204, 12);

    raw_value = convertPhysicalToRaw(@CAN_RadarRL::RRL_Object::RRL_Object_Obj22.VxVyCoVnce, 0.005, -10.0);
    copyBitsToByteArrayLE(raw_value, byteArray, 12192, 12);

    raw_value = convertPhysicalToRaw(@CAN_RadarRL::RRL_Object::RRL_Object_Obj22.PyAyCoVnce, 0.005, -10.0);
    copyBitsToByteArrayLE(raw_value, byteArray, 12172, 12);

    raw_value = convertPhysicalToRaw(@CAN_RadarRL::RRL_Object::RRL_Object_Obj22.PyAxCoVnce, 0.005, -10.0);
    copyBitsToByteArrayLE(raw_value, byteArray, 12160, 12);

    raw_value = convertPhysicalToRaw(@CAN_RadarRL::RRL_Object::RRL_Object_Obj22.PxPyCoVnce, 0.005, -10.0);
    copyBitsToByteArrayLE(raw_value, byteArray, 12044, 12);

    raw_value = convertPhysicalToRaw(@CAN_RadarRL::RRL_Object::RRL_Object_Obj22.PxAxCoVnce, 0.005, -10.0);
    copyBitsToByteArrayLE(raw_value, byteArray, 12128, 12);

    raw_value = convertPhysicalToRaw(@CAN_RadarRL::RRL_Object::RRL_Object_Obj22.PxVyCoVnce, 0.005, -10.0);
    copyBitsToByteArrayLE(raw_value, byteArray, 12076, 12);

    raw_value = convertPhysicalToRaw(@CAN_RadarRL::RRL_Object::RRL_Object_Obj22.ReferencePoint, 1.0, 0.0);
    copyBitsToByteArrayLE(raw_value, byteArray, 12120, 4);

    raw_value = convertPhysicalToRaw(@CAN_RadarRL::RRL_Object::RRL_Object_Obj22.ProbClassType, 1.0, 0.0);
    copyBitsToByteArrayLE(raw_value, byteArray, 12059, 4);

    raw_value = convertPhysicalToRaw(@CAN_RadarRL::RRL_Object::RRL_Object_Obj22.PxVxCoVnce, 0.005, -10.0);
    copyBitsToByteArrayLE(raw_value, byteArray, 12064, 12);

    raw_value = convertPhysicalToRaw(@CAN_RadarRL::RRL_Object::RRL_Object_Obj22.MeasurementStatus, 1.0, 0.0);
    copyBitsToByteArrayLE(raw_value, byteArray, 12056, 3);

    raw_value = convertPhysicalToRaw(@CAN_RadarRL::RRL_Object::RRL_Object_Obj22.FilterInformation, 1.0, 0.0);
    copyBitsToByteArrayLE(raw_value, byteArray, 12088, 8);

    raw_value = convertPhysicalToRaw(@CAN_RadarRL::RRL_Object::RRL_Object_Obj22.PyVxCoVnce, 0.005, -10.0);
    copyBitsToByteArrayLE(raw_value, byteArray, 12096, 12);

    raw_value = convertPhysicalToRaw(@CAN_RadarRL::RRL_Object::RRL_Object_Obj22.PyVyCoVnce, 0.005, -10.0);
    copyBitsToByteArrayLE(raw_value, byteArray, 12108, 12);
}


void RRL_Object_Obj21_write(byte byteArray[])
{
    qword raw_value;

    raw_value = convertPhysicalToRaw(@CAN_RadarRL::RRL_Object::RRL_Object_Obj21.ObjId, 1.0, 0.0);
    copyBitsToByteArrayLE(raw_value, byteArray, 11480, 7);

    raw_value = convertPhysicalToRaw(@CAN_RadarRL::RRL_Object::RRL_Object_Obj21.AxVnce, 0.005, 0.0);
    copyBitsToByteArrayLE(raw_value, byteArray, 11392, 12);

    raw_value = convertPhysicalToRaw(@CAN_RadarRL::RRL_Object::RRL_Object_Obj21.Vx, 0.0625, -128.0);
    copyBitsToByteArrayLE(raw_value, byteArray, 11468, 12);

    raw_value = convertPhysicalToRaw(@CAN_RadarRL::RRL_Object::RRL_Object_Obj21.AyVnce, 0.005, 0.0);
    copyBitsToByteArrayLE(raw_value, byteArray, 11456, 12);

    raw_value = convertPhysicalToRaw(@CAN_RadarRL::RRL_Object::RRL_Object_Obj21.Ay, 0.0625, -16.0);
    copyBitsToByteArrayLE(raw_value, byteArray, 11446, 9);

    raw_value = convertPhysicalToRaw(@CAN_RadarRL::RRL_Object::RRL_Object_Obj21.RCS, 0.2, -102.4);
    copyBitsToByteArrayLE(raw_value, byteArray, 11436, 10);

    raw_value = convertPhysicalToRaw(@CAN_RadarRL::RRL_Object::RRL_Object_Obj21.WidthVnce, 0.005, 0.0);
    copyBitsToByteArrayLE(raw_value, byteArray, 11424, 12);

    raw_value = convertPhysicalToRaw(@CAN_RadarRL::RRL_Object::RRL_Object_Obj21.Width, 0.125, 0.0);
    copyBitsToByteArrayLE(raw_value, byteArray, 11416, 7);

    raw_value = convertPhysicalToRaw(@CAN_RadarRL::RRL_Object::RRL_Object_Obj21.OrientationYawVnce, 0.0003, 0.0);
    copyBitsToByteArrayLE(raw_value, byteArray, 11404, 12);

    raw_value = convertPhysicalToRaw(@CAN_RadarRL::RRL_Object::RRL_Object_Obj21.PyVnce, 0.005, 0.0);
    copyBitsToByteArrayLE(raw_value, byteArray, 11340, 12);

    raw_value = convertPhysicalToRaw(@CAN_RadarRL::RRL_Object::RRL_Object_Obj21.OrientationYaw, 0.0175, -4.48);
    copyBitsToByteArrayLE(raw_value, byteArray, 11382, 9);

    raw_value = convertPhysicalToRaw(@CAN_RadarRL::RRL_Object::RRL_Object_Obj21.Ax, 0.03125, -16.0);
    copyBitsToByteArrayLE(raw_value, byteArray, 11372, 10);

    raw_value = convertPhysicalToRaw(@CAN_RadarRL::RRL_Object::RRL_Object_Obj21.LengthVnce, 0.005, 0.0);
    copyBitsToByteArrayLE(raw_value, byteArray, 11360, 12);

    raw_value = convertPhysicalToRaw(@CAN_RadarRL::RRL_Object::RRL_Object_Obj21.Length, 0.125, 0.0);
    copyBitsToByteArrayLE(raw_value, byteArray, 11352, 7);

    raw_value = convertPhysicalToRaw(@CAN_RadarRL::RRL_Object::RRL_Object_Obj21.Py, 0.0625, -128.0);
    copyBitsToByteArrayLE(raw_value, byteArray, 11328, 12);

    raw_value = convertPhysicalToRaw(@CAN_RadarRL::RRL_Object::RRL_Object_Obj21.PxVnce, 0.005, 0.0);
    copyBitsToByteArrayLE(raw_value, byteArray, 11316, 12);

    raw_value = convertPhysicalToRaw(@CAN_RadarRL::RRL_Object::RRL_Object_Obj21.Px, 0.0625, -512.0);
    copyBitsToByteArrayLE(raw_value, byteArray, 11302, 14);

    raw_value = convertPhysicalToRaw(@CAN_RadarRL::RRL_Object::RRL_Object_Obj21.ProbClassConfidence, 2.0, 0.0);
    copyBitsToByteArrayLE(raw_value, byteArray, 11296, 6);

    raw_value = convertPhysicalToRaw(@CAN_RadarRL::RRL_Object::RRL_Object_Obj21.MovingStatus, 1.0, 0.0);
    copyBitsToByteArrayLE(raw_value, byteArray, 11500, 2);

    raw_value = convertPhysicalToRaw(@CAN_RadarRL::RRL_Object::RRL_Object_Obj21.VxVnce, 0.005, 0.0);
    copyBitsToByteArrayLE(raw_value, byteArray, 11488, 12);

    raw_value = convertPhysicalToRaw(@CAN_RadarRL::RRL_Object::RRL_Object_Obj21.Vy, 0.125, -64.0);
    copyBitsToByteArrayLE(raw_value, byteArray, 11502, 10);

    raw_value = convertPhysicalToRaw(@CAN_RadarRL::RRL_Object::RRL_Object_Obj21.AxAyCoVnce, 0.005, -10.0);
    copyBitsToByteArrayLE(raw_value, byteArray, 11756, 12);

    raw_value = convertPhysicalToRaw(@CAN_RadarRL::RRL_Object::RRL_Object_Obj21.PxAxCoVnce, 0.005, -10.0);
    copyBitsToByteArrayLE(raw_value, byteArray, 11616, 12);

    raw_value = convertPhysicalToRaw(@CAN_RadarRL::RRL_Object::RRL_Object_Obj21.Age, 1.0, 0.0);
    copyBitsToByteArrayLE(raw_value, byteArray, 11776, 32);

    raw_value = convertPhysicalToRaw(@CAN_RadarRL::RRL_Object::RRL_Object_Obj21.ExistProb, 2.0, 0.0);
    copyBitsToByteArrayLE(raw_value, byteArray, 11512, 6);

    raw_value = convertPhysicalToRaw(@CAN_RadarRL::RRL_Object::RRL_Object_Obj21.VyAyCoVnce, 0.005, -10.0);
    copyBitsToByteArrayLE(raw_value, byteArray, 11744, 12);

    raw_value = convertPhysicalToRaw(@CAN_RadarRL::RRL_Object::RRL_Object_Obj21.VyAxCoVnce, 0.005, -10.0);
    copyBitsToByteArrayLE(raw_value, byteArray, 11724, 12);

    raw_value = convertPhysicalToRaw(@CAN_RadarRL::RRL_Object::RRL_Object_Obj21.VxAyCoVnce, 0.005, -10.0);
    copyBitsToByteArrayLE(raw_value, byteArray, 11712, 12);

    raw_value = convertPhysicalToRaw(@CAN_RadarRL::RRL_Object::RRL_Object_Obj21.VxAxCoVnce, 0.005, -10.0);
    copyBitsToByteArrayLE(raw_value, byteArray, 11692, 12);

    raw_value = convertPhysicalToRaw(@CAN_RadarRL::RRL_Object::RRL_Object_Obj21.PyAyCoVnce, 0.005, -10.0);
    copyBitsToByteArrayLE(raw_value, byteArray, 11660, 12);

    raw_value = convertPhysicalToRaw(@CAN_RadarRL::RRL_Object::RRL_Object_Obj21.PyAxCoVnce, 0.005, -10.0);
    copyBitsToByteArrayLE(raw_value, byteArray, 11648, 12);

    raw_value = convertPhysicalToRaw(@CAN_RadarRL::RRL_Object::RRL_Object_Obj21.PxAyCoVnce, 0.005, -10.0);
    copyBitsToByteArrayLE(raw_value, byteArray, 11628, 12);

    raw_value = convertPhysicalToRaw(@CAN_RadarRL::RRL_Object::RRL_Object_Obj21.VxVyCoVnce, 0.005, -10.0);
    copyBitsToByteArrayLE(raw_value, byteArray, 11680, 12);

    raw_value = convertPhysicalToRaw(@CAN_RadarRL::RRL_Object::RRL_Object_Obj21.ReferencePoint, 1.0, 0.0);
    copyBitsToByteArrayLE(raw_value, byteArray, 11608, 4);

    raw_value = convertPhysicalToRaw(@CAN_RadarRL::RRL_Object::RRL_Object_Obj21.PxVxCoVnce, 0.005, -10.0);
    copyBitsToByteArrayLE(raw_value, byteArray, 11552, 12);

    raw_value = convertPhysicalToRaw(@CAN_RadarRL::RRL_Object::RRL_Object_Obj21.PyVyCoVnce, 0.005, -10.0);
    copyBitsToByteArrayLE(raw_value, byteArray, 11596, 12);

    raw_value = convertPhysicalToRaw(@CAN_RadarRL::RRL_Object::RRL_Object_Obj21.PxPyCoVnce, 0.005, -10.0);
    copyBitsToByteArrayLE(raw_value, byteArray, 11532, 12);

    raw_value = convertPhysicalToRaw(@CAN_RadarRL::RRL_Object::RRL_Object_Obj21.MeasurementStatus, 1.0, 0.0);
    copyBitsToByteArrayLE(raw_value, byteArray, 11544, 3);

    raw_value = convertPhysicalToRaw(@CAN_RadarRL::RRL_Object::RRL_Object_Obj21.ProbClassType, 1.0, 0.0);
    copyBitsToByteArrayLE(raw_value, byteArray, 11547, 4);

    raw_value = convertPhysicalToRaw(@CAN_RadarRL::RRL_Object::RRL_Object_Obj21.VyVnce, 0.005, 0.0);
    copyBitsToByteArrayLE(raw_value, byteArray, 11520, 12);

    raw_value = convertPhysicalToRaw(@CAN_RadarRL::RRL_Object::RRL_Object_Obj21.PxVyCoVnce, 0.005, -10.0);
    copyBitsToByteArrayLE(raw_value, byteArray, 11564, 12);

    raw_value = convertPhysicalToRaw(@CAN_RadarRL::RRL_Object::RRL_Object_Obj21.FilterInformation, 1.0, 0.0);
    copyBitsToByteArrayLE(raw_value, byteArray, 11576, 8);

    raw_value = convertPhysicalToRaw(@CAN_RadarRL::RRL_Object::RRL_Object_Obj21.PyVxCoVnce, 0.005, -10.0);
    copyBitsToByteArrayLE(raw_value, byteArray, 11584, 12);
}


void RRL_Object_Obj20_write(byte byteArray[])
{
    qword raw_value;

    raw_value = convertPhysicalToRaw(@CAN_RadarRL::RRL_Object::RRL_Object_Obj20.AxVnce, 0.005, 0.0);
    copyBitsToByteArrayLE(raw_value, byteArray, 10880, 12);

    raw_value = convertPhysicalToRaw(@CAN_RadarRL::RRL_Object::RRL_Object_Obj20.VxVnce, 0.005, 0.0);
    copyBitsToByteArrayLE(raw_value, byteArray, 10976, 12);

    raw_value = convertPhysicalToRaw(@CAN_RadarRL::RRL_Object::RRL_Object_Obj20.ObjId, 1.0, 0.0);
    copyBitsToByteArrayLE(raw_value, byteArray, 10968, 7);

    raw_value = convertPhysicalToRaw(@CAN_RadarRL::RRL_Object::RRL_Object_Obj20.Vx, 0.0625, -128.0);
    copyBitsToByteArrayLE(raw_value, byteArray, 10956, 12);

    raw_value = convertPhysicalToRaw(@CAN_RadarRL::RRL_Object::RRL_Object_Obj20.AyVnce, 0.005, 0.0);
    copyBitsToByteArrayLE(raw_value, byteArray, 10944, 12);

    raw_value = convertPhysicalToRaw(@CAN_RadarRL::RRL_Object::RRL_Object_Obj20.Ay, 0.0625, -16.0);
    copyBitsToByteArrayLE(raw_value, byteArray, 10934, 9);

    raw_value = convertPhysicalToRaw(@CAN_RadarRL::RRL_Object::RRL_Object_Obj20.RCS, 0.2, -102.4);
    copyBitsToByteArrayLE(raw_value, byteArray, 10924, 10);

    raw_value = convertPhysicalToRaw(@CAN_RadarRL::RRL_Object::RRL_Object_Obj20.WidthVnce, 0.005, 0.0);
    copyBitsToByteArrayLE(raw_value, byteArray, 10912, 12);

    raw_value = convertPhysicalToRaw(@CAN_RadarRL::RRL_Object::RRL_Object_Obj20.Width, 0.125, 0.0);
    copyBitsToByteArrayLE(raw_value, byteArray, 10904, 7);

    raw_value = convertPhysicalToRaw(@CAN_RadarRL::RRL_Object::RRL_Object_Obj20.OrientationYawVnce, 0.0003, 0.0);
    copyBitsToByteArrayLE(raw_value, byteArray, 10892, 12);

    raw_value = convertPhysicalToRaw(@CAN_RadarRL::RRL_Object::RRL_Object_Obj20.Vy, 0.125, -64.0);
    copyBitsToByteArrayLE(raw_value, byteArray, 10990, 10);

    raw_value = convertPhysicalToRaw(@CAN_RadarRL::RRL_Object::RRL_Object_Obj20.OrientationYaw, 0.0175, -4.48);
    copyBitsToByteArrayLE(raw_value, byteArray, 10870, 9);

    raw_value = convertPhysicalToRaw(@CAN_RadarRL::RRL_Object::RRL_Object_Obj20.Ax, 0.03125, -16.0);
    copyBitsToByteArrayLE(raw_value, byteArray, 10860, 10);

    raw_value = convertPhysicalToRaw(@CAN_RadarRL::RRL_Object::RRL_Object_Obj20.LengthVnce, 0.005, 0.0);
    copyBitsToByteArrayLE(raw_value, byteArray, 10848, 12);

    raw_value = convertPhysicalToRaw(@CAN_RadarRL::RRL_Object::RRL_Object_Obj20.Length, 0.125, 0.0);
    copyBitsToByteArrayLE(raw_value, byteArray, 10840, 7);

    raw_value = convertPhysicalToRaw(@CAN_RadarRL::RRL_Object::RRL_Object_Obj20.PyVnce, 0.005, 0.0);
    copyBitsToByteArrayLE(raw_value, byteArray, 10828, 12);

    raw_value = convertPhysicalToRaw(@CAN_RadarRL::RRL_Object::RRL_Object_Obj20.Py, 0.0625, -128.0);
    copyBitsToByteArrayLE(raw_value, byteArray, 10816, 12);

    raw_value = convertPhysicalToRaw(@CAN_RadarRL::RRL_Object::RRL_Object_Obj20.PxVnce, 0.005, 0.0);
    copyBitsToByteArrayLE(raw_value, byteArray, 10804, 12);

    raw_value = convertPhysicalToRaw(@CAN_RadarRL::RRL_Object::RRL_Object_Obj20.Px, 0.0625, -512.0);
    copyBitsToByteArrayLE(raw_value, byteArray, 10790, 14);

    raw_value = convertPhysicalToRaw(@CAN_RadarRL::RRL_Object::RRL_Object_Obj20.ProbClassConfidence, 2.0, 0.0);
    copyBitsToByteArrayLE(raw_value, byteArray, 10784, 6);

    raw_value = convertPhysicalToRaw(@CAN_RadarRL::RRL_Object::RRL_Object_Obj20.MovingStatus, 1.0, 0.0);
    copyBitsToByteArrayLE(raw_value, byteArray, 10988, 2);

    raw_value = convertPhysicalToRaw(@CAN_RadarRL::RRL_Object::RRL_Object_Obj20.AxAyCoVnce, 0.005, -10.0);
    copyBitsToByteArrayLE(raw_value, byteArray, 11244, 12);

    raw_value = convertPhysicalToRaw(@CAN_RadarRL::RRL_Object::RRL_Object_Obj20.ExistProb, 2.0, 0.0);
    copyBitsToByteArrayLE(raw_value, byteArray, 11000, 6);

    raw_value = convertPhysicalToRaw(@CAN_RadarRL::RRL_Object::RRL_Object_Obj20.PxAxCoVnce, 0.005, -10.0);
    copyBitsToByteArrayLE(raw_value, byteArray, 11104, 12);

    raw_value = convertPhysicalToRaw(@CAN_RadarRL::RRL_Object::RRL_Object_Obj20.VyVnce, 0.005, 0.0);
    copyBitsToByteArrayLE(raw_value, byteArray, 11008, 12);

    raw_value = convertPhysicalToRaw(@CAN_RadarRL::RRL_Object::RRL_Object_Obj20.VyAyCoVnce, 0.005, -10.0);
    copyBitsToByteArrayLE(raw_value, byteArray, 11232, 12);

    raw_value = convertPhysicalToRaw(@CAN_RadarRL::RRL_Object::RRL_Object_Obj20.VyAxCoVnce, 0.005, -10.0);
    copyBitsToByteArrayLE(raw_value, byteArray, 11212, 12);

    raw_value = convertPhysicalToRaw(@CAN_RadarRL::RRL_Object::RRL_Object_Obj20.VxAyCoVnce, 0.005, -10.0);
    copyBitsToByteArrayLE(raw_value, byteArray, 11200, 12);

    raw_value = convertPhysicalToRaw(@CAN_RadarRL::RRL_Object::RRL_Object_Obj20.VxAxCoVnce, 0.005, -10.0);
    copyBitsToByteArrayLE(raw_value, byteArray, 11180, 12);

    raw_value = convertPhysicalToRaw(@CAN_RadarRL::RRL_Object::RRL_Object_Obj20.VxVyCoVnce, 0.005, -10.0);
    copyBitsToByteArrayLE(raw_value, byteArray, 11168, 12);

    raw_value = convertPhysicalToRaw(@CAN_RadarRL::RRL_Object::RRL_Object_Obj20.PyAyCoVnce, 0.005, -10.0);
    copyBitsToByteArrayLE(raw_value, byteArray, 11148, 12);

    raw_value = convertPhysicalToRaw(@CAN_RadarRL::RRL_Object::RRL_Object_Obj20.PyAxCoVnce, 0.005, -10.0);
    copyBitsToByteArrayLE(raw_value, byteArray, 11136, 12);

    raw_value = convertPhysicalToRaw(@CAN_RadarRL::RRL_Object::RRL_Object_Obj20.PxAyCoVnce, 0.005, -10.0);
    copyBitsToByteArrayLE(raw_value, byteArray, 11116, 12);

    raw_value = convertPhysicalToRaw(@CAN_RadarRL::RRL_Object::RRL_Object_Obj20.Age, 1.0, 0.0);
    copyBitsToByteArrayLE(raw_value, byteArray, 11264, 32);

    raw_value = convertPhysicalToRaw(@CAN_RadarRL::RRL_Object::RRL_Object_Obj20.ReferencePoint, 1.0, 0.0);
    copyBitsToByteArrayLE(raw_value, byteArray, 11096, 4);

    raw_value = convertPhysicalToRaw(@CAN_RadarRL::RRL_Object::RRL_Object_Obj20.PxVxCoVnce, 0.005, -10.0);
    copyBitsToByteArrayLE(raw_value, byteArray, 11040, 12);

    raw_value = convertPhysicalToRaw(@CAN_RadarRL::RRL_Object::RRL_Object_Obj20.PyVyCoVnce, 0.005, -10.0);
    copyBitsToByteArrayLE(raw_value, byteArray, 11084, 12);

    raw_value = convertPhysicalToRaw(@CAN_RadarRL::RRL_Object::RRL_Object_Obj20.MeasurementStatus, 1.0, 0.0);
    copyBitsToByteArrayLE(raw_value, byteArray, 11032, 3);

    raw_value = convertPhysicalToRaw(@CAN_RadarRL::RRL_Object::RRL_Object_Obj20.ProbClassType, 1.0, 0.0);
    copyBitsToByteArrayLE(raw_value, byteArray, 11035, 4);

    raw_value = convertPhysicalToRaw(@CAN_RadarRL::RRL_Object::RRL_Object_Obj20.PxPyCoVnce, 0.005, -10.0);
    copyBitsToByteArrayLE(raw_value, byteArray, 11020, 12);

    raw_value = convertPhysicalToRaw(@CAN_RadarRL::RRL_Object::RRL_Object_Obj20.PxVyCoVnce, 0.005, -10.0);
    copyBitsToByteArrayLE(raw_value, byteArray, 11052, 12);

    raw_value = convertPhysicalToRaw(@CAN_RadarRL::RRL_Object::RRL_Object_Obj20.FilterInformation, 1.0, 0.0);
    copyBitsToByteArrayLE(raw_value, byteArray, 11064, 8);

    raw_value = convertPhysicalToRaw(@CAN_RadarRL::RRL_Object::RRL_Object_Obj20.PyVxCoVnce, 0.005, -10.0);
    copyBitsToByteArrayLE(raw_value, byteArray, 11072, 12);
}


void RRL_Object_Obj19_write(byte byteArray[])
{
    qword raw_value;

    raw_value = convertPhysicalToRaw(@CAN_RadarRL::RRL_Object::RRL_Object_Obj19.VxVnce, 0.005, 0.0);
    copyBitsToByteArrayLE(raw_value, byteArray, 10464, 12);

    raw_value = convertPhysicalToRaw(@CAN_RadarRL::RRL_Object::RRL_Object_Obj19.AxVnce, 0.005, 0.0);
    copyBitsToByteArrayLE(raw_value, byteArray, 10368, 12);

    raw_value = convertPhysicalToRaw(@CAN_RadarRL::RRL_Object::RRL_Object_Obj19.ObjId, 1.0, 0.0);
    copyBitsToByteArrayLE(raw_value, byteArray, 10456, 7);

    raw_value = convertPhysicalToRaw(@CAN_RadarRL::RRL_Object::RRL_Object_Obj19.Vx, 0.0625, -128.0);
    copyBitsToByteArrayLE(raw_value, byteArray, 10444, 12);

    raw_value = convertPhysicalToRaw(@CAN_RadarRL::RRL_Object::RRL_Object_Obj19.AyVnce, 0.005, 0.0);
    copyBitsToByteArrayLE(raw_value, byteArray, 10432, 12);

    raw_value = convertPhysicalToRaw(@CAN_RadarRL::RRL_Object::RRL_Object_Obj19.Ay, 0.0625, -16.0);
    copyBitsToByteArrayLE(raw_value, byteArray, 10422, 9);

    raw_value = convertPhysicalToRaw(@CAN_RadarRL::RRL_Object::RRL_Object_Obj19.RCS, 0.2, -102.4);
    copyBitsToByteArrayLE(raw_value, byteArray, 10412, 10);

    raw_value = convertPhysicalToRaw(@CAN_RadarRL::RRL_Object::RRL_Object_Obj19.WidthVnce, 0.005, 0.0);
    copyBitsToByteArrayLE(raw_value, byteArray, 10400, 12);

    raw_value = convertPhysicalToRaw(@CAN_RadarRL::RRL_Object::RRL_Object_Obj19.Width, 0.125, 0.0);
    copyBitsToByteArrayLE(raw_value, byteArray, 10392, 7);

    raw_value = convertPhysicalToRaw(@CAN_RadarRL::RRL_Object::RRL_Object_Obj19.OrientationYawVnce, 0.0003, 0.0);
    copyBitsToByteArrayLE(raw_value, byteArray, 10380, 12);

    raw_value = convertPhysicalToRaw(@CAN_RadarRL::RRL_Object::RRL_Object_Obj19.Length, 0.125, 0.0);
    copyBitsToByteArrayLE(raw_value, byteArray, 10328, 7);

    raw_value = convertPhysicalToRaw(@CAN_RadarRL::RRL_Object::RRL_Object_Obj19.OrientationYaw, 0.0175, -4.48);
    copyBitsToByteArrayLE(raw_value, byteArray, 10358, 9);

    raw_value = convertPhysicalToRaw(@CAN_RadarRL::RRL_Object::RRL_Object_Obj19.Ax, 0.03125, -16.0);
    copyBitsToByteArrayLE(raw_value, byteArray, 10348, 10);

    raw_value = convertPhysicalToRaw(@CAN_RadarRL::RRL_Object::RRL_Object_Obj19.LengthVnce, 0.005, 0.0);
    copyBitsToByteArrayLE(raw_value, byteArray, 10336, 12);

    raw_value = convertPhysicalToRaw(@CAN_RadarRL::RRL_Object::RRL_Object_Obj19.PyVnce, 0.005, 0.0);
    copyBitsToByteArrayLE(raw_value, byteArray, 10316, 12);

    raw_value = convertPhysicalToRaw(@CAN_RadarRL::RRL_Object::RRL_Object_Obj19.Py, 0.0625, -128.0);
    copyBitsToByteArrayLE(raw_value, byteArray, 10304, 12);

    raw_value = convertPhysicalToRaw(@CAN_RadarRL::RRL_Object::RRL_Object_Obj19.PxVnce, 0.005, 0.0);
    copyBitsToByteArrayLE(raw_value, byteArray, 10292, 12);

    raw_value = convertPhysicalToRaw(@CAN_RadarRL::RRL_Object::RRL_Object_Obj19.Px, 0.0625, -512.0);
    copyBitsToByteArrayLE(raw_value, byteArray, 10278, 14);

    raw_value = convertPhysicalToRaw(@CAN_RadarRL::RRL_Object::RRL_Object_Obj19.ProbClassConfidence, 2.0, 0.0);
    copyBitsToByteArrayLE(raw_value, byteArray, 10272, 6);

    raw_value = convertPhysicalToRaw(@CAN_RadarRL::RRL_Object::RRL_Object_Obj19.Vy, 0.125, -64.0);
    copyBitsToByteArrayLE(raw_value, byteArray, 10478, 10);

    raw_value = convertPhysicalToRaw(@CAN_RadarRL::RRL_Object::RRL_Object_Obj19.MovingStatus, 1.0, 0.0);
    copyBitsToByteArrayLE(raw_value, byteArray, 10476, 2);

    raw_value = convertPhysicalToRaw(@CAN_RadarRL::RRL_Object::RRL_Object_Obj19.Age, 1.0, 0.0);
    copyBitsToByteArrayLE(raw_value, byteArray, 10752, 32);

    raw_value = convertPhysicalToRaw(@CAN_RadarRL::RRL_Object::RRL_Object_Obj19.ExistProb, 2.0, 0.0);
    copyBitsToByteArrayLE(raw_value, byteArray, 10488, 6);

    raw_value = convertPhysicalToRaw(@CAN_RadarRL::RRL_Object::RRL_Object_Obj19.PxAxCoVnce, 0.005, -10.0);
    copyBitsToByteArrayLE(raw_value, byteArray, 10592, 12);

    raw_value = convertPhysicalToRaw(@CAN_RadarRL::RRL_Object::RRL_Object_Obj19.VyVnce, 0.005, 0.0);
    copyBitsToByteArrayLE(raw_value, byteArray, 10496, 12);

    raw_value = convertPhysicalToRaw(@CAN_RadarRL::RRL_Object::RRL_Object_Obj19.VyAyCoVnce, 0.005, -10.0);
    copyBitsToByteArrayLE(raw_value, byteArray, 10720, 12);

    raw_value = convertPhysicalToRaw(@CAN_RadarRL::RRL_Object::RRL_Object_Obj19.VyAxCoVnce, 0.005, -10.0);
    copyBitsToByteArrayLE(raw_value, byteArray, 10700, 12);

    raw_value = convertPhysicalToRaw(@CAN_RadarRL::RRL_Object::RRL_Object_Obj19.VxAyCoVnce, 0.005, -10.0);
    copyBitsToByteArrayLE(raw_value, byteArray, 10688, 12);

    raw_value = convertPhysicalToRaw(@CAN_RadarRL::RRL_Object::RRL_Object_Obj19.VxAxCoVnce, 0.005, -10.0);
    copyBitsToByteArrayLE(raw_value, byteArray, 10668, 12);

    raw_value = convertPhysicalToRaw(@CAN_RadarRL::RRL_Object::RRL_Object_Obj19.VxVyCoVnce, 0.005, -10.0);
    copyBitsToByteArrayLE(raw_value, byteArray, 10656, 12);

    raw_value = convertPhysicalToRaw(@CAN_RadarRL::RRL_Object::RRL_Object_Obj19.PyAyCoVnce, 0.005, -10.0);
    copyBitsToByteArrayLE(raw_value, byteArray, 10636, 12);

    raw_value = convertPhysicalToRaw(@CAN_RadarRL::RRL_Object::RRL_Object_Obj19.PyAxCoVnce, 0.005, -10.0);
    copyBitsToByteArrayLE(raw_value, byteArray, 10624, 12);

    raw_value = convertPhysicalToRaw(@CAN_RadarRL::RRL_Object::RRL_Object_Obj19.PxAyCoVnce, 0.005, -10.0);
    copyBitsToByteArrayLE(raw_value, byteArray, 10604, 12);

    raw_value = convertPhysicalToRaw(@CAN_RadarRL::RRL_Object::RRL_Object_Obj19.AxAyCoVnce, 0.005, -10.0);
    copyBitsToByteArrayLE(raw_value, byteArray, 10732, 12);

    raw_value = convertPhysicalToRaw(@CAN_RadarRL::RRL_Object::RRL_Object_Obj19.ReferencePoint, 1.0, 0.0);
    copyBitsToByteArrayLE(raw_value, byteArray, 10584, 4);

    raw_value = convertPhysicalToRaw(@CAN_RadarRL::RRL_Object::RRL_Object_Obj19.PyVxCoVnce, 0.005, -10.0);
    copyBitsToByteArrayLE(raw_value, byteArray, 10560, 12);

    raw_value = convertPhysicalToRaw(@CAN_RadarRL::RRL_Object::RRL_Object_Obj19.FilterInformation, 1.0, 0.0);
    copyBitsToByteArrayLE(raw_value, byteArray, 10552, 8);

    raw_value = convertPhysicalToRaw(@CAN_RadarRL::RRL_Object::RRL_Object_Obj19.PxVyCoVnce, 0.005, -10.0);
    copyBitsToByteArrayLE(raw_value, byteArray, 10540, 12);

    raw_value = convertPhysicalToRaw(@CAN_RadarRL::RRL_Object::RRL_Object_Obj19.PxVxCoVnce, 0.005, -10.0);
    copyBitsToByteArrayLE(raw_value, byteArray, 10528, 12);

    raw_value = convertPhysicalToRaw(@CAN_RadarRL::RRL_Object::RRL_Object_Obj19.ProbClassType, 1.0, 0.0);
    copyBitsToByteArrayLE(raw_value, byteArray, 10523, 4);

    raw_value = convertPhysicalToRaw(@CAN_RadarRL::RRL_Object::RRL_Object_Obj19.MeasurementStatus, 1.0, 0.0);
    copyBitsToByteArrayLE(raw_value, byteArray, 10520, 3);

    raw_value = convertPhysicalToRaw(@CAN_RadarRL::RRL_Object::RRL_Object_Obj19.PxPyCoVnce, 0.005, -10.0);
    copyBitsToByteArrayLE(raw_value, byteArray, 10508, 12);

    raw_value = convertPhysicalToRaw(@CAN_RadarRL::RRL_Object::RRL_Object_Obj19.PyVyCoVnce, 0.005, -10.0);
    copyBitsToByteArrayLE(raw_value, byteArray, 10572, 12);
}


void RRL_Object_Obj18_write(byte byteArray[])
{
    qword raw_value;

    raw_value = convertPhysicalToRaw(@CAN_RadarRL::RRL_Object::RRL_Object_Obj18.Ay, 0.0625, -16.0);
    copyBitsToByteArrayLE(raw_value, byteArray, 9910, 9);

    raw_value = convertPhysicalToRaw(@CAN_RadarRL::RRL_Object::RRL_Object_Obj18.WidthVnce, 0.005, 0.0);
    copyBitsToByteArrayLE(raw_value, byteArray, 9888, 12);

    raw_value = convertPhysicalToRaw(@CAN_RadarRL::RRL_Object::RRL_Object_Obj18.RCS, 0.2, -102.4);
    copyBitsToByteArrayLE(raw_value, byteArray, 9900, 10);

    raw_value = convertPhysicalToRaw(@CAN_RadarRL::RRL_Object::RRL_Object_Obj18.VxVnce, 0.005, 0.0);
    copyBitsToByteArrayLE(raw_value, byteArray, 9952, 12);

    raw_value = convertPhysicalToRaw(@CAN_RadarRL::RRL_Object::RRL_Object_Obj18.AyVnce, 0.005, 0.0);
    copyBitsToByteArrayLE(raw_value, byteArray, 9920, 12);

    raw_value = convertPhysicalToRaw(@CAN_RadarRL::RRL_Object::RRL_Object_Obj18.Vx, 0.0625, -128.0);
    copyBitsToByteArrayLE(raw_value, byteArray, 9932, 12);

    raw_value = convertPhysicalToRaw(@CAN_RadarRL::RRL_Object::RRL_Object_Obj18.ObjId, 1.0, 0.0);
    copyBitsToByteArrayLE(raw_value, byteArray, 9944, 7);

    raw_value = convertPhysicalToRaw(@CAN_RadarRL::RRL_Object::RRL_Object_Obj18.OrientationYawVnce, 0.0003, 0.0);
    copyBitsToByteArrayLE(raw_value, byteArray, 9868, 12);

    raw_value = convertPhysicalToRaw(@CAN_RadarRL::RRL_Object::RRL_Object_Obj18.Width, 0.125, 0.0);
    copyBitsToByteArrayLE(raw_value, byteArray, 9880, 7);

    raw_value = convertPhysicalToRaw(@CAN_RadarRL::RRL_Object::RRL_Object_Obj18.Length, 0.125, 0.0);
    copyBitsToByteArrayLE(raw_value, byteArray, 9816, 7);

    raw_value = convertPhysicalToRaw(@CAN_RadarRL::RRL_Object::RRL_Object_Obj18.AxVnce, 0.005, 0.0);
    copyBitsToByteArrayLE(raw_value, byteArray, 9856, 12);

    raw_value = convertPhysicalToRaw(@CAN_RadarRL::RRL_Object::RRL_Object_Obj18.OrientationYaw, 0.0175, -4.48);
    copyBitsToByteArrayLE(raw_value, byteArray, 9846, 9);

    raw_value = convertPhysicalToRaw(@CAN_RadarRL::RRL_Object::RRL_Object_Obj18.Ax, 0.03125, -16.0);
    copyBitsToByteArrayLE(raw_value, byteArray, 9836, 10);

    raw_value = convertPhysicalToRaw(@CAN_RadarRL::RRL_Object::RRL_Object_Obj18.LengthVnce, 0.005, 0.0);
    copyBitsToByteArrayLE(raw_value, byteArray, 9824, 12);

    raw_value = convertPhysicalToRaw(@CAN_RadarRL::RRL_Object::RRL_Object_Obj18.PyVnce, 0.005, 0.0);
    copyBitsToByteArrayLE(raw_value, byteArray, 9804, 12);

    raw_value = convertPhysicalToRaw(@CAN_RadarRL::RRL_Object::RRL_Object_Obj18.Py, 0.0625, -128.0);
    copyBitsToByteArrayLE(raw_value, byteArray, 9792, 12);

    raw_value = convertPhysicalToRaw(@CAN_RadarRL::RRL_Object::RRL_Object_Obj18.PxVnce, 0.005, 0.0);
    copyBitsToByteArrayLE(raw_value, byteArray, 9780, 12);

    raw_value = convertPhysicalToRaw(@CAN_RadarRL::RRL_Object::RRL_Object_Obj18.Px, 0.0625, -512.0);
    copyBitsToByteArrayLE(raw_value, byteArray, 9766, 14);

    raw_value = convertPhysicalToRaw(@CAN_RadarRL::RRL_Object::RRL_Object_Obj18.ProbClassConfidence, 2.0, 0.0);
    copyBitsToByteArrayLE(raw_value, byteArray, 9760, 6);

    raw_value = convertPhysicalToRaw(@CAN_RadarRL::RRL_Object::RRL_Object_Obj18.MovingStatus, 1.0, 0.0);
    copyBitsToByteArrayLE(raw_value, byteArray, 9964, 2);

    raw_value = convertPhysicalToRaw(@CAN_RadarRL::RRL_Object::RRL_Object_Obj18.Vy, 0.125, -64.0);
    copyBitsToByteArrayLE(raw_value, byteArray, 9966, 10);

    raw_value = convertPhysicalToRaw(@CAN_RadarRL::RRL_Object::RRL_Object_Obj18.ExistProb, 2.0, 0.0);
    copyBitsToByteArrayLE(raw_value, byteArray, 9976, 6);

    raw_value = convertPhysicalToRaw(@CAN_RadarRL::RRL_Object::RRL_Object_Obj18.PxAyCoVnce, 0.005, -10.0);
    copyBitsToByteArrayLE(raw_value, byteArray, 10092, 12);

    raw_value = convertPhysicalToRaw(@CAN_RadarRL::RRL_Object::RRL_Object_Obj18.VyVnce, 0.005, 0.0);
    copyBitsToByteArrayLE(raw_value, byteArray, 9984, 12);

    raw_value = convertPhysicalToRaw(@CAN_RadarRL::RRL_Object::RRL_Object_Obj18.AxAyCoVnce, 0.005, -10.0);
    copyBitsToByteArrayLE(raw_value, byteArray, 10220, 12);

    raw_value = convertPhysicalToRaw(@CAN_RadarRL::RRL_Object::RRL_Object_Obj18.VyAyCoVnce, 0.005, -10.0);
    copyBitsToByteArrayLE(raw_value, byteArray, 10208, 12);

    raw_value = convertPhysicalToRaw(@CAN_RadarRL::RRL_Object::RRL_Object_Obj18.VyAxCoVnce, 0.005, -10.0);
    copyBitsToByteArrayLE(raw_value, byteArray, 10188, 12);

    raw_value = convertPhysicalToRaw(@CAN_RadarRL::RRL_Object::RRL_Object_Obj18.VxAyCoVnce, 0.005, -10.0);
    copyBitsToByteArrayLE(raw_value, byteArray, 10176, 12);

    raw_value = convertPhysicalToRaw(@CAN_RadarRL::RRL_Object::RRL_Object_Obj18.VxAxCoVnce, 0.005, -10.0);
    copyBitsToByteArrayLE(raw_value, byteArray, 10156, 12);

    raw_value = convertPhysicalToRaw(@CAN_RadarRL::RRL_Object::RRL_Object_Obj18.VxVyCoVnce, 0.005, -10.0);
    copyBitsToByteArrayLE(raw_value, byteArray, 10144, 12);

    raw_value = convertPhysicalToRaw(@CAN_RadarRL::RRL_Object::RRL_Object_Obj18.PyAyCoVnce, 0.005, -10.0);
    copyBitsToByteArrayLE(raw_value, byteArray, 10124, 12);

    raw_value = convertPhysicalToRaw(@CAN_RadarRL::RRL_Object::RRL_Object_Obj18.PyAxCoVnce, 0.005, -10.0);
    copyBitsToByteArrayLE(raw_value, byteArray, 10112, 12);

    raw_value = convertPhysicalToRaw(@CAN_RadarRL::RRL_Object::RRL_Object_Obj18.Age, 1.0, 0.0);
    copyBitsToByteArrayLE(raw_value, byteArray, 10240, 32);

    raw_value = convertPhysicalToRaw(@CAN_RadarRL::RRL_Object::RRL_Object_Obj18.PxAxCoVnce, 0.005, -10.0);
    copyBitsToByteArrayLE(raw_value, byteArray, 10080, 12);

    raw_value = convertPhysicalToRaw(@CAN_RadarRL::RRL_Object::RRL_Object_Obj18.PxVxCoVnce, 0.005, -10.0);
    copyBitsToByteArrayLE(raw_value, byteArray, 10016, 12);

    raw_value = convertPhysicalToRaw(@CAN_RadarRL::RRL_Object::RRL_Object_Obj18.ReferencePoint, 1.0, 0.0);
    copyBitsToByteArrayLE(raw_value, byteArray, 10072, 4);

    raw_value = convertPhysicalToRaw(@CAN_RadarRL::RRL_Object::RRL_Object_Obj18.MeasurementStatus, 1.0, 0.0);
    copyBitsToByteArrayLE(raw_value, byteArray, 10008, 3);

    raw_value = convertPhysicalToRaw(@CAN_RadarRL::RRL_Object::RRL_Object_Obj18.ProbClassType, 1.0, 0.0);
    copyBitsToByteArrayLE(raw_value, byteArray, 10011, 4);

    raw_value = convertPhysicalToRaw(@CAN_RadarRL::RRL_Object::RRL_Object_Obj18.PxPyCoVnce, 0.005, -10.0);
    copyBitsToByteArrayLE(raw_value, byteArray, 9996, 12);

    raw_value = convertPhysicalToRaw(@CAN_RadarRL::RRL_Object::RRL_Object_Obj18.PxVyCoVnce, 0.005, -10.0);
    copyBitsToByteArrayLE(raw_value, byteArray, 10028, 12);

    raw_value = convertPhysicalToRaw(@CAN_RadarRL::RRL_Object::RRL_Object_Obj18.FilterInformation, 1.0, 0.0);
    copyBitsToByteArrayLE(raw_value, byteArray, 10040, 8);

    raw_value = convertPhysicalToRaw(@CAN_RadarRL::RRL_Object::RRL_Object_Obj18.PyVxCoVnce, 0.005, -10.0);
    copyBitsToByteArrayLE(raw_value, byteArray, 10048, 12);

    raw_value = convertPhysicalToRaw(@CAN_RadarRL::RRL_Object::RRL_Object_Obj18.PyVyCoVnce, 0.005, -10.0);
    copyBitsToByteArrayLE(raw_value, byteArray, 10060, 12);
}


void RRL_Object_Obj17_write(byte byteArray[])
{
    qword raw_value;

    raw_value = convertPhysicalToRaw(@CAN_RadarRL::RRL_Object::RRL_Object_Obj17.AxVnce, 0.005, 0.0);
    copyBitsToByteArrayLE(raw_value, byteArray, 9344, 12);

    raw_value = convertPhysicalToRaw(@CAN_RadarRL::RRL_Object::RRL_Object_Obj17.ObjId, 1.0, 0.0);
    copyBitsToByteArrayLE(raw_value, byteArray, 9432, 7);

    raw_value = convertPhysicalToRaw(@CAN_RadarRL::RRL_Object::RRL_Object_Obj17.Vx, 0.0625, -128.0);
    copyBitsToByteArrayLE(raw_value, byteArray, 9420, 12);

    raw_value = convertPhysicalToRaw(@CAN_RadarRL::RRL_Object::RRL_Object_Obj17.AyVnce, 0.005, 0.0);
    copyBitsToByteArrayLE(raw_value, byteArray, 9408, 12);

    raw_value = convertPhysicalToRaw(@CAN_RadarRL::RRL_Object::RRL_Object_Obj17.Ay, 0.0625, -16.0);
    copyBitsToByteArrayLE(raw_value, byteArray, 9398, 9);

    raw_value = convertPhysicalToRaw(@CAN_RadarRL::RRL_Object::RRL_Object_Obj17.RCS, 0.2, -102.4);
    copyBitsToByteArrayLE(raw_value, byteArray, 9388, 10);

    raw_value = convertPhysicalToRaw(@CAN_RadarRL::RRL_Object::RRL_Object_Obj17.WidthVnce, 0.005, 0.0);
    copyBitsToByteArrayLE(raw_value, byteArray, 9376, 12);

    raw_value = convertPhysicalToRaw(@CAN_RadarRL::RRL_Object::RRL_Object_Obj17.Width, 0.125, 0.0);
    copyBitsToByteArrayLE(raw_value, byteArray, 9368, 7);

    raw_value = convertPhysicalToRaw(@CAN_RadarRL::RRL_Object::RRL_Object_Obj17.OrientationYawVnce, 0.0003, 0.0);
    copyBitsToByteArrayLE(raw_value, byteArray, 9356, 12);

    raw_value = convertPhysicalToRaw(@CAN_RadarRL::RRL_Object::RRL_Object_Obj17.PyVnce, 0.005, 0.0);
    copyBitsToByteArrayLE(raw_value, byteArray, 9292, 12);

    raw_value = convertPhysicalToRaw(@CAN_RadarRL::RRL_Object::RRL_Object_Obj17.OrientationYaw, 0.0175, -4.48);
    copyBitsToByteArrayLE(raw_value, byteArray, 9334, 9);

    raw_value = convertPhysicalToRaw(@CAN_RadarRL::RRL_Object::RRL_Object_Obj17.Ax, 0.03125, -16.0);
    copyBitsToByteArrayLE(raw_value, byteArray, 9324, 10);

    raw_value = convertPhysicalToRaw(@CAN_RadarRL::RRL_Object::RRL_Object_Obj17.LengthVnce, 0.005, 0.0);
    copyBitsToByteArrayLE(raw_value, byteArray, 9312, 12);

    raw_value = convertPhysicalToRaw(@CAN_RadarRL::RRL_Object::RRL_Object_Obj17.Length, 0.125, 0.0);
    copyBitsToByteArrayLE(raw_value, byteArray, 9304, 7);

    raw_value = convertPhysicalToRaw(@CAN_RadarRL::RRL_Object::RRL_Object_Obj17.Py, 0.0625, -128.0);
    copyBitsToByteArrayLE(raw_value, byteArray, 9280, 12);

    raw_value = convertPhysicalToRaw(@CAN_RadarRL::RRL_Object::RRL_Object_Obj17.PxVnce, 0.005, 0.0);
    copyBitsToByteArrayLE(raw_value, byteArray, 9268, 12);

    raw_value = convertPhysicalToRaw(@CAN_RadarRL::RRL_Object::RRL_Object_Obj17.Px, 0.0625, -512.0);
    copyBitsToByteArrayLE(raw_value, byteArray, 9254, 14);

    raw_value = convertPhysicalToRaw(@CAN_RadarRL::RRL_Object::RRL_Object_Obj17.ProbClassConfidence, 2.0, 0.0);
    copyBitsToByteArrayLE(raw_value, byteArray, 9248, 6);

    raw_value = convertPhysicalToRaw(@CAN_RadarRL::RRL_Object::RRL_Object_Obj17.MovingStatus, 1.0, 0.0);
    copyBitsToByteArrayLE(raw_value, byteArray, 9452, 2);

    raw_value = convertPhysicalToRaw(@CAN_RadarRL::RRL_Object::RRL_Object_Obj17.VxVnce, 0.005, 0.0);
    copyBitsToByteArrayLE(raw_value, byteArray, 9440, 12);

    raw_value = convertPhysicalToRaw(@CAN_RadarRL::RRL_Object::RRL_Object_Obj17.Vy, 0.125, -64.0);
    copyBitsToByteArrayLE(raw_value, byteArray, 9454, 10);

    raw_value = convertPhysicalToRaw(@CAN_RadarRL::RRL_Object::RRL_Object_Obj17.Age, 1.0, 0.0);
    copyBitsToByteArrayLE(raw_value, byteArray, 9728, 32);

    raw_value = convertPhysicalToRaw(@CAN_RadarRL::RRL_Object::RRL_Object_Obj17.PxAxCoVnce, 0.005, -10.0);
    copyBitsToByteArrayLE(raw_value, byteArray, 9568, 12);

    raw_value = convertPhysicalToRaw(@CAN_RadarRL::RRL_Object::RRL_Object_Obj17.AxAyCoVnce, 0.005, -10.0);
    copyBitsToByteArrayLE(raw_value, byteArray, 9708, 12);

    raw_value = convertPhysicalToRaw(@CAN_RadarRL::RRL_Object::RRL_Object_Obj17.ExistProb, 2.0, 0.0);
    copyBitsToByteArrayLE(raw_value, byteArray, 9464, 6);

    raw_value = convertPhysicalToRaw(@CAN_RadarRL::RRL_Object::RRL_Object_Obj17.VyAyCoVnce, 0.005, -10.0);
    copyBitsToByteArrayLE(raw_value, byteArray, 9696, 12);

    raw_value = convertPhysicalToRaw(@CAN_RadarRL::RRL_Object::RRL_Object_Obj17.VyAxCoVnce, 0.005, -10.0);
    copyBitsToByteArrayLE(raw_value, byteArray, 9676, 12);

    raw_value = convertPhysicalToRaw(@CAN_RadarRL::RRL_Object::RRL_Object_Obj17.VxAyCoVnce, 0.005, -10.0);
    copyBitsToByteArrayLE(raw_value, byteArray, 9664, 12);

    raw_value = convertPhysicalToRaw(@CAN_RadarRL::RRL_Object::RRL_Object_Obj17.VxAxCoVnce, 0.005, -10.0);
    copyBitsToByteArrayLE(raw_value, byteArray, 9644, 12);

    raw_value = convertPhysicalToRaw(@CAN_RadarRL::RRL_Object::RRL_Object_Obj17.PyAyCoVnce, 0.005, -10.0);
    copyBitsToByteArrayLE(raw_value, byteArray, 9612, 12);

    raw_value = convertPhysicalToRaw(@CAN_RadarRL::RRL_Object::RRL_Object_Obj17.PyAxCoVnce, 0.005, -10.0);
    copyBitsToByteArrayLE(raw_value, byteArray, 9600, 12);

    raw_value = convertPhysicalToRaw(@CAN_RadarRL::RRL_Object::RRL_Object_Obj17.PxAyCoVnce, 0.005, -10.0);
    copyBitsToByteArrayLE(raw_value, byteArray, 9580, 12);

    raw_value = convertPhysicalToRaw(@CAN_RadarRL::RRL_Object::RRL_Object_Obj17.VxVyCoVnce, 0.005, -10.0);
    copyBitsToByteArrayLE(raw_value, byteArray, 9632, 12);

    raw_value = convertPhysicalToRaw(@CAN_RadarRL::RRL_Object::RRL_Object_Obj17.ReferencePoint, 1.0, 0.0);
    copyBitsToByteArrayLE(raw_value, byteArray, 9560, 4);

    raw_value = convertPhysicalToRaw(@CAN_RadarRL::RRL_Object::RRL_Object_Obj17.PxVxCoVnce, 0.005, -10.0);
    copyBitsToByteArrayLE(raw_value, byteArray, 9504, 12);

    raw_value = convertPhysicalToRaw(@CAN_RadarRL::RRL_Object::RRL_Object_Obj17.VyVnce, 0.005, 0.0);
    copyBitsToByteArrayLE(raw_value, byteArray, 9472, 12);

    raw_value = convertPhysicalToRaw(@CAN_RadarRL::RRL_Object::RRL_Object_Obj17.PyVyCoVnce, 0.005, -10.0);
    copyBitsToByteArrayLE(raw_value, byteArray, 9548, 12);

    raw_value = convertPhysicalToRaw(@CAN_RadarRL::RRL_Object::RRL_Object_Obj17.MeasurementStatus, 1.0, 0.0);
    copyBitsToByteArrayLE(raw_value, byteArray, 9496, 3);

    raw_value = convertPhysicalToRaw(@CAN_RadarRL::RRL_Object::RRL_Object_Obj17.ProbClassType, 1.0, 0.0);
    copyBitsToByteArrayLE(raw_value, byteArray, 9499, 4);

    raw_value = convertPhysicalToRaw(@CAN_RadarRL::RRL_Object::RRL_Object_Obj17.PxPyCoVnce, 0.005, -10.0);
    copyBitsToByteArrayLE(raw_value, byteArray, 9484, 12);

    raw_value = convertPhysicalToRaw(@CAN_RadarRL::RRL_Object::RRL_Object_Obj17.PxVyCoVnce, 0.005, -10.0);
    copyBitsToByteArrayLE(raw_value, byteArray, 9516, 12);

    raw_value = convertPhysicalToRaw(@CAN_RadarRL::RRL_Object::RRL_Object_Obj17.FilterInformation, 1.0, 0.0);
    copyBitsToByteArrayLE(raw_value, byteArray, 9528, 8);

    raw_value = convertPhysicalToRaw(@CAN_RadarRL::RRL_Object::RRL_Object_Obj17.PyVxCoVnce, 0.005, -10.0);
    copyBitsToByteArrayLE(raw_value, byteArray, 9536, 12);
}


void RRL_Object_Obj16_write(byte byteArray[])
{
    qword raw_value;

    raw_value = convertPhysicalToRaw(@CAN_RadarRL::RRL_Object::RRL_Object_Obj16.OrientationYaw, 0.0175, -4.48);
    copyBitsToByteArrayLE(raw_value, byteArray, 8822, 9);

    raw_value = convertPhysicalToRaw(@CAN_RadarRL::RRL_Object::RRL_Object_Obj16.ObjId, 1.0, 0.0);
    copyBitsToByteArrayLE(raw_value, byteArray, 8920, 7);

    raw_value = convertPhysicalToRaw(@CAN_RadarRL::RRL_Object::RRL_Object_Obj16.Vx, 0.0625, -128.0);
    copyBitsToByteArrayLE(raw_value, byteArray, 8908, 12);

    raw_value = convertPhysicalToRaw(@CAN_RadarRL::RRL_Object::RRL_Object_Obj16.AyVnce, 0.005, 0.0);
    copyBitsToByteArrayLE(raw_value, byteArray, 8896, 12);

    raw_value = convertPhysicalToRaw(@CAN_RadarRL::RRL_Object::RRL_Object_Obj16.Ay, 0.0625, -16.0);
    copyBitsToByteArrayLE(raw_value, byteArray, 8886, 9);

    raw_value = convertPhysicalToRaw(@CAN_RadarRL::RRL_Object::RRL_Object_Obj16.RCS, 0.2, -102.4);
    copyBitsToByteArrayLE(raw_value, byteArray, 8876, 10);

    raw_value = convertPhysicalToRaw(@CAN_RadarRL::RRL_Object::RRL_Object_Obj16.WidthVnce, 0.005, 0.0);
    copyBitsToByteArrayLE(raw_value, byteArray, 8864, 12);

    raw_value = convertPhysicalToRaw(@CAN_RadarRL::RRL_Object::RRL_Object_Obj16.Width, 0.125, 0.0);
    copyBitsToByteArrayLE(raw_value, byteArray, 8856, 7);

    raw_value = convertPhysicalToRaw(@CAN_RadarRL::RRL_Object::RRL_Object_Obj16.OrientationYawVnce, 0.0003, 0.0);
    copyBitsToByteArrayLE(raw_value, byteArray, 8844, 12);

    raw_value = convertPhysicalToRaw(@CAN_RadarRL::RRL_Object::RRL_Object_Obj16.AxVnce, 0.005, 0.0);
    copyBitsToByteArrayLE(raw_value, byteArray, 8832, 12);

    raw_value = convertPhysicalToRaw(@CAN_RadarRL::RRL_Object::RRL_Object_Obj16.Vy, 0.125, -64.0);
    copyBitsToByteArrayLE(raw_value, byteArray, 8942, 10);

    raw_value = convertPhysicalToRaw(@CAN_RadarRL::RRL_Object::RRL_Object_Obj16.Ax, 0.03125, -16.0);
    copyBitsToByteArrayLE(raw_value, byteArray, 8812, 10);

    raw_value = convertPhysicalToRaw(@CAN_RadarRL::RRL_Object::RRL_Object_Obj16.LengthVnce, 0.005, 0.0);
    copyBitsToByteArrayLE(raw_value, byteArray, 8800, 12);

    raw_value = convertPhysicalToRaw(@CAN_RadarRL::RRL_Object::RRL_Object_Obj16.Length, 0.125, 0.0);
    copyBitsToByteArrayLE(raw_value, byteArray, 8792, 7);

    raw_value = convertPhysicalToRaw(@CAN_RadarRL::RRL_Object::RRL_Object_Obj16.PyVnce, 0.005, 0.0);
    copyBitsToByteArrayLE(raw_value, byteArray, 8780, 12);

    raw_value = convertPhysicalToRaw(@CAN_RadarRL::RRL_Object::RRL_Object_Obj16.Py, 0.0625, -128.0);
    copyBitsToByteArrayLE(raw_value, byteArray, 8768, 12);

    raw_value = convertPhysicalToRaw(@CAN_RadarRL::RRL_Object::RRL_Object_Obj16.PxVnce, 0.005, 0.0);
    copyBitsToByteArrayLE(raw_value, byteArray, 8756, 12);

    raw_value = convertPhysicalToRaw(@CAN_RadarRL::RRL_Object::RRL_Object_Obj16.Px, 0.0625, -512.0);
    copyBitsToByteArrayLE(raw_value, byteArray, 8742, 14);

    raw_value = convertPhysicalToRaw(@CAN_RadarRL::RRL_Object::RRL_Object_Obj16.ProbClassConfidence, 2.0, 0.0);
    copyBitsToByteArrayLE(raw_value, byteArray, 8736, 6);

    raw_value = convertPhysicalToRaw(@CAN_RadarRL::RRL_Object::RRL_Object_Obj16.MovingStatus, 1.0, 0.0);
    copyBitsToByteArrayLE(raw_value, byteArray, 8940, 2);

    raw_value = convertPhysicalToRaw(@CAN_RadarRL::RRL_Object::RRL_Object_Obj16.VxVnce, 0.005, 0.0);
    copyBitsToByteArrayLE(raw_value, byteArray, 8928, 12);

    raw_value = convertPhysicalToRaw(@CAN_RadarRL::RRL_Object::RRL_Object_Obj16.PxVxCoVnce, 0.005, -10.0);
    copyBitsToByteArrayLE(raw_value, byteArray, 8992, 12);

    raw_value = convertPhysicalToRaw(@CAN_RadarRL::RRL_Object::RRL_Object_Obj16.PyAyCoVnce, 0.005, -10.0);
    copyBitsToByteArrayLE(raw_value, byteArray, 9100, 12);

    raw_value = convertPhysicalToRaw(@CAN_RadarRL::RRL_Object::RRL_Object_Obj16.PxAyCoVnce, 0.005, -10.0);
    copyBitsToByteArrayLE(raw_value, byteArray, 9068, 12);

    raw_value = convertPhysicalToRaw(@CAN_RadarRL::RRL_Object::RRL_Object_Obj16.Age, 1.0, 0.0);
    copyBitsToByteArrayLE(raw_value, byteArray, 9216, 32);

    raw_value = convertPhysicalToRaw(@CAN_RadarRL::RRL_Object::RRL_Object_Obj16.AxAyCoVnce, 0.005, -10.0);
    copyBitsToByteArrayLE(raw_value, byteArray, 9196, 12);

    raw_value = convertPhysicalToRaw(@CAN_RadarRL::RRL_Object::RRL_Object_Obj16.VyAyCoVnce, 0.005, -10.0);
    copyBitsToByteArrayLE(raw_value, byteArray, 9184, 12);

    raw_value = convertPhysicalToRaw(@CAN_RadarRL::RRL_Object::RRL_Object_Obj16.VyAxCoVnce, 0.005, -10.0);
    copyBitsToByteArrayLE(raw_value, byteArray, 9164, 12);

    raw_value = convertPhysicalToRaw(@CAN_RadarRL::RRL_Object::RRL_Object_Obj16.VxAyCoVnce, 0.005, -10.0);
    copyBitsToByteArrayLE(raw_value, byteArray, 9152, 12);

    raw_value = convertPhysicalToRaw(@CAN_RadarRL::RRL_Object::RRL_Object_Obj16.VxAxCoVnce, 0.005, -10.0);
    copyBitsToByteArrayLE(raw_value, byteArray, 9132, 12);

    raw_value = convertPhysicalToRaw(@CAN_RadarRL::RRL_Object::RRL_Object_Obj16.VxVyCoVnce, 0.005, -10.0);
    copyBitsToByteArrayLE(raw_value, byteArray, 9120, 12);

    raw_value = convertPhysicalToRaw(@CAN_RadarRL::RRL_Object::RRL_Object_Obj16.ExistProb, 2.0, 0.0);
    copyBitsToByteArrayLE(raw_value, byteArray, 8952, 6);

    raw_value = convertPhysicalToRaw(@CAN_RadarRL::RRL_Object::RRL_Object_Obj16.PyAxCoVnce, 0.005, -10.0);
    copyBitsToByteArrayLE(raw_value, byteArray, 9088, 12);

    raw_value = convertPhysicalToRaw(@CAN_RadarRL::RRL_Object::RRL_Object_Obj16.PxAxCoVnce, 0.005, -10.0);
    copyBitsToByteArrayLE(raw_value, byteArray, 9056, 12);

    raw_value = convertPhysicalToRaw(@CAN_RadarRL::RRL_Object::RRL_Object_Obj16.ReferencePoint, 1.0, 0.0);
    copyBitsToByteArrayLE(raw_value, byteArray, 9048, 4);

    raw_value = convertPhysicalToRaw(@CAN_RadarRL::RRL_Object::RRL_Object_Obj16.PyVyCoVnce, 0.005, -10.0);
    copyBitsToByteArrayLE(raw_value, byteArray, 9036, 12);

    raw_value = convertPhysicalToRaw(@CAN_RadarRL::RRL_Object::RRL_Object_Obj16.PyVxCoVnce, 0.005, -10.0);
    copyBitsToByteArrayLE(raw_value, byteArray, 9024, 12);

    raw_value = convertPhysicalToRaw(@CAN_RadarRL::RRL_Object::RRL_Object_Obj16.FilterInformation, 1.0, 0.0);
    copyBitsToByteArrayLE(raw_value, byteArray, 9016, 8);

    raw_value = convertPhysicalToRaw(@CAN_RadarRL::RRL_Object::RRL_Object_Obj16.PxVyCoVnce, 0.005, -10.0);
    copyBitsToByteArrayLE(raw_value, byteArray, 9004, 12);

    raw_value = convertPhysicalToRaw(@CAN_RadarRL::RRL_Object::RRL_Object_Obj16.ProbClassType, 1.0, 0.0);
    copyBitsToByteArrayLE(raw_value, byteArray, 8987, 4);

    raw_value = convertPhysicalToRaw(@CAN_RadarRL::RRL_Object::RRL_Object_Obj16.MeasurementStatus, 1.0, 0.0);
    copyBitsToByteArrayLE(raw_value, byteArray, 8984, 3);

    raw_value = convertPhysicalToRaw(@CAN_RadarRL::RRL_Object::RRL_Object_Obj16.PxPyCoVnce, 0.005, -10.0);
    copyBitsToByteArrayLE(raw_value, byteArray, 8972, 12);

    raw_value = convertPhysicalToRaw(@CAN_RadarRL::RRL_Object::RRL_Object_Obj16.VyVnce, 0.005, 0.0);
    copyBitsToByteArrayLE(raw_value, byteArray, 8960, 12);
}


void RRL_Object_Obj15_write(byte byteArray[])
{
    qword raw_value;

    raw_value = convertPhysicalToRaw(@CAN_RadarRL::RRL_Object::RRL_Object_Obj15.Ay, 0.0625, -16.0);
    copyBitsToByteArrayLE(raw_value, byteArray, 8374, 9);

    raw_value = convertPhysicalToRaw(@CAN_RadarRL::RRL_Object::RRL_Object_Obj15.Width, 0.125, 0.0);
    copyBitsToByteArrayLE(raw_value, byteArray, 8344, 7);

    raw_value = convertPhysicalToRaw(@CAN_RadarRL::RRL_Object::RRL_Object_Obj15.WidthVnce, 0.005, 0.0);
    copyBitsToByteArrayLE(raw_value, byteArray, 8352, 12);

    raw_value = convertPhysicalToRaw(@CAN_RadarRL::RRL_Object::RRL_Object_Obj15.RCS, 0.2, -102.4);
    copyBitsToByteArrayLE(raw_value, byteArray, 8364, 10);

    raw_value = convertPhysicalToRaw(@CAN_RadarRL::RRL_Object::RRL_Object_Obj15.VxVnce, 0.005, 0.0);
    copyBitsToByteArrayLE(raw_value, byteArray, 8416, 12);

    raw_value = convertPhysicalToRaw(@CAN_RadarRL::RRL_Object::RRL_Object_Obj15.AyVnce, 0.005, 0.0);
    copyBitsToByteArrayLE(raw_value, byteArray, 8384, 12);

    raw_value = convertPhysicalToRaw(@CAN_RadarRL::RRL_Object::RRL_Object_Obj15.Vx, 0.0625, -128.0);
    copyBitsToByteArrayLE(raw_value, byteArray, 8396, 12);

    raw_value = convertPhysicalToRaw(@CAN_RadarRL::RRL_Object::RRL_Object_Obj15.ObjId, 1.0, 0.0);
    copyBitsToByteArrayLE(raw_value, byteArray, 8408, 7);

    raw_value = convertPhysicalToRaw(@CAN_RadarRL::RRL_Object::RRL_Object_Obj15.AxVnce, 0.005, 0.0);
    copyBitsToByteArrayLE(raw_value, byteArray, 8320, 12);

    raw_value = convertPhysicalToRaw(@CAN_RadarRL::RRL_Object::RRL_Object_Obj15.OrientationYawVnce, 0.0003, 0.0);
    copyBitsToByteArrayLE(raw_value, byteArray, 8332, 12);

    raw_value = convertPhysicalToRaw(@CAN_RadarRL::RRL_Object::RRL_Object_Obj15.Length, 0.125, 0.0);
    copyBitsToByteArrayLE(raw_value, byteArray, 8280, 7);

    raw_value = convertPhysicalToRaw(@CAN_RadarRL::RRL_Object::RRL_Object_Obj15.OrientationYaw, 0.0175, -4.48);
    copyBitsToByteArrayLE(raw_value, byteArray, 8310, 9);

    raw_value = convertPhysicalToRaw(@CAN_RadarRL::RRL_Object::RRL_Object_Obj15.Ax, 0.03125, -16.0);
    copyBitsToByteArrayLE(raw_value, byteArray, 8300, 10);

    raw_value = convertPhysicalToRaw(@CAN_RadarRL::RRL_Object::RRL_Object_Obj15.LengthVnce, 0.005, 0.0);
    copyBitsToByteArrayLE(raw_value, byteArray, 8288, 12);

    raw_value = convertPhysicalToRaw(@CAN_RadarRL::RRL_Object::RRL_Object_Obj15.PyVnce, 0.005, 0.0);
    copyBitsToByteArrayLE(raw_value, byteArray, 8268, 12);

    raw_value = convertPhysicalToRaw(@CAN_RadarRL::RRL_Object::RRL_Object_Obj15.Py, 0.0625, -128.0);
    copyBitsToByteArrayLE(raw_value, byteArray, 8256, 12);

    raw_value = convertPhysicalToRaw(@CAN_RadarRL::RRL_Object::RRL_Object_Obj15.PxVnce, 0.005, 0.0);
    copyBitsToByteArrayLE(raw_value, byteArray, 8244, 12);

    raw_value = convertPhysicalToRaw(@CAN_RadarRL::RRL_Object::RRL_Object_Obj15.Px, 0.0625, -512.0);
    copyBitsToByteArrayLE(raw_value, byteArray, 8230, 14);

    raw_value = convertPhysicalToRaw(@CAN_RadarRL::RRL_Object::RRL_Object_Obj15.ProbClassConfidence, 2.0, 0.0);
    copyBitsToByteArrayLE(raw_value, byteArray, 8224, 6);

    raw_value = convertPhysicalToRaw(@CAN_RadarRL::RRL_Object::RRL_Object_Obj15.Vy, 0.125, -64.0);
    copyBitsToByteArrayLE(raw_value, byteArray, 8430, 10);

    raw_value = convertPhysicalToRaw(@CAN_RadarRL::RRL_Object::RRL_Object_Obj15.MovingStatus, 1.0, 0.0);
    copyBitsToByteArrayLE(raw_value, byteArray, 8428, 2);

    raw_value = convertPhysicalToRaw(@CAN_RadarRL::RRL_Object::RRL_Object_Obj15.Age, 1.0, 0.0);
    copyBitsToByteArrayLE(raw_value, byteArray, 8704, 32);

    raw_value = convertPhysicalToRaw(@CAN_RadarRL::RRL_Object::RRL_Object_Obj15.ExistProb, 2.0, 0.0);
    copyBitsToByteArrayLE(raw_value, byteArray, 8440, 6);

    raw_value = convertPhysicalToRaw(@CAN_RadarRL::RRL_Object::RRL_Object_Obj15.PxAxCoVnce, 0.005, -10.0);
    copyBitsToByteArrayLE(raw_value, byteArray, 8544, 12);

    raw_value = convertPhysicalToRaw(@CAN_RadarRL::RRL_Object::RRL_Object_Obj15.VyVnce, 0.005, 0.0);
    copyBitsToByteArrayLE(raw_value, byteArray, 8448, 12);

    raw_value = convertPhysicalToRaw(@CAN_RadarRL::RRL_Object::RRL_Object_Obj15.AxAyCoVnce, 0.005, -10.0);
    copyBitsToByteArrayLE(raw_value, byteArray, 8684, 12);

    raw_value = convertPhysicalToRaw(@CAN_RadarRL::RRL_Object::RRL_Object_Obj15.VyAyCoVnce, 0.005, -10.0);
    copyBitsToByteArrayLE(raw_value, byteArray, 8672, 12);

    raw_value = convertPhysicalToRaw(@CAN_RadarRL::RRL_Object::RRL_Object_Obj15.VyAxCoVnce, 0.005, -10.0);
    copyBitsToByteArrayLE(raw_value, byteArray, 8652, 12);

    raw_value = convertPhysicalToRaw(@CAN_RadarRL::RRL_Object::RRL_Object_Obj15.VxAyCoVnce, 0.005, -10.0);
    copyBitsToByteArrayLE(raw_value, byteArray, 8640, 12);

    raw_value = convertPhysicalToRaw(@CAN_RadarRL::RRL_Object::RRL_Object_Obj15.VxAxCoVnce, 0.005, -10.0);
    copyBitsToByteArrayLE(raw_value, byteArray, 8620, 12);

    raw_value = convertPhysicalToRaw(@CAN_RadarRL::RRL_Object::RRL_Object_Obj15.PyAyCoVnce, 0.005, -10.0);
    copyBitsToByteArrayLE(raw_value, byteArray, 8588, 12);

    raw_value = convertPhysicalToRaw(@CAN_RadarRL::RRL_Object::RRL_Object_Obj15.PyAxCoVnce, 0.005, -10.0);
    copyBitsToByteArrayLE(raw_value, byteArray, 8576, 12);

    raw_value = convertPhysicalToRaw(@CAN_RadarRL::RRL_Object::RRL_Object_Obj15.PxAyCoVnce, 0.005, -10.0);
    copyBitsToByteArrayLE(raw_value, byteArray, 8556, 12);

    raw_value = convertPhysicalToRaw(@CAN_RadarRL::RRL_Object::RRL_Object_Obj15.VxVyCoVnce, 0.005, -10.0);
    copyBitsToByteArrayLE(raw_value, byteArray, 8608, 12);

    raw_value = convertPhysicalToRaw(@CAN_RadarRL::RRL_Object::RRL_Object_Obj15.ReferencePoint, 1.0, 0.0);
    copyBitsToByteArrayLE(raw_value, byteArray, 8536, 4);

    raw_value = convertPhysicalToRaw(@CAN_RadarRL::RRL_Object::RRL_Object_Obj15.PxVxCoVnce, 0.005, -10.0);
    copyBitsToByteArrayLE(raw_value, byteArray, 8480, 12);

    raw_value = convertPhysicalToRaw(@CAN_RadarRL::RRL_Object::RRL_Object_Obj15.PyVyCoVnce, 0.005, -10.0);
    copyBitsToByteArrayLE(raw_value, byteArray, 8524, 12);

    raw_value = convertPhysicalToRaw(@CAN_RadarRL::RRL_Object::RRL_Object_Obj15.MeasurementStatus, 1.0, 0.0);
    copyBitsToByteArrayLE(raw_value, byteArray, 8472, 3);

    raw_value = convertPhysicalToRaw(@CAN_RadarRL::RRL_Object::RRL_Object_Obj15.ProbClassType, 1.0, 0.0);
    copyBitsToByteArrayLE(raw_value, byteArray, 8475, 4);

    raw_value = convertPhysicalToRaw(@CAN_RadarRL::RRL_Object::RRL_Object_Obj15.PxPyCoVnce, 0.005, -10.0);
    copyBitsToByteArrayLE(raw_value, byteArray, 8460, 12);

    raw_value = convertPhysicalToRaw(@CAN_RadarRL::RRL_Object::RRL_Object_Obj15.PxVyCoVnce, 0.005, -10.0);
    copyBitsToByteArrayLE(raw_value, byteArray, 8492, 12);

    raw_value = convertPhysicalToRaw(@CAN_RadarRL::RRL_Object::RRL_Object_Obj15.FilterInformation, 1.0, 0.0);
    copyBitsToByteArrayLE(raw_value, byteArray, 8504, 8);

    raw_value = convertPhysicalToRaw(@CAN_RadarRL::RRL_Object::RRL_Object_Obj15.PyVxCoVnce, 0.005, -10.0);
    copyBitsToByteArrayLE(raw_value, byteArray, 8512, 12);
}


void RRL_Object_Obj14_write(byte byteArray[])
{
    qword raw_value;

    raw_value = convertPhysicalToRaw(@CAN_RadarRL::RRL_Object::RRL_Object_Obj14.AxVnce, 0.005, 0.0);
    copyBitsToByteArrayLE(raw_value, byteArray, 7808, 12);

    raw_value = convertPhysicalToRaw(@CAN_RadarRL::RRL_Object::RRL_Object_Obj14.VxVnce, 0.005, 0.0);
    copyBitsToByteArrayLE(raw_value, byteArray, 7904, 12);

    raw_value = convertPhysicalToRaw(@CAN_RadarRL::RRL_Object::RRL_Object_Obj14.ObjId, 1.0, 0.0);
    copyBitsToByteArrayLE(raw_value, byteArray, 7896, 7);

    raw_value = convertPhysicalToRaw(@CAN_RadarRL::RRL_Object::RRL_Object_Obj14.Vx, 0.0625, -128.0);
    copyBitsToByteArrayLE(raw_value, byteArray, 7884, 12);

    raw_value = convertPhysicalToRaw(@CAN_RadarRL::RRL_Object::RRL_Object_Obj14.AyVnce, 0.005, 0.0);
    copyBitsToByteArrayLE(raw_value, byteArray, 7872, 12);

    raw_value = convertPhysicalToRaw(@CAN_RadarRL::RRL_Object::RRL_Object_Obj14.Ay, 0.0625, -16.0);
    copyBitsToByteArrayLE(raw_value, byteArray, 7862, 9);

    raw_value = convertPhysicalToRaw(@CAN_RadarRL::RRL_Object::RRL_Object_Obj14.RCS, 0.2, -102.4);
    copyBitsToByteArrayLE(raw_value, byteArray, 7852, 10);

    raw_value = convertPhysicalToRaw(@CAN_RadarRL::RRL_Object::RRL_Object_Obj14.WidthVnce, 0.005, 0.0);
    copyBitsToByteArrayLE(raw_value, byteArray, 7840, 12);

    raw_value = convertPhysicalToRaw(@CAN_RadarRL::RRL_Object::RRL_Object_Obj14.Width, 0.125, 0.0);
    copyBitsToByteArrayLE(raw_value, byteArray, 7832, 7);

    raw_value = convertPhysicalToRaw(@CAN_RadarRL::RRL_Object::RRL_Object_Obj14.OrientationYawVnce, 0.0003, 0.0);
    copyBitsToByteArrayLE(raw_value, byteArray, 7820, 12);

    raw_value = convertPhysicalToRaw(@CAN_RadarRL::RRL_Object::RRL_Object_Obj14.Vy, 0.125, -64.0);
    copyBitsToByteArrayLE(raw_value, byteArray, 7918, 10);

    raw_value = convertPhysicalToRaw(@CAN_RadarRL::RRL_Object::RRL_Object_Obj14.OrientationYaw, 0.0175, -4.48);
    copyBitsToByteArrayLE(raw_value, byteArray, 7798, 9);

    raw_value = convertPhysicalToRaw(@CAN_RadarRL::RRL_Object::RRL_Object_Obj14.Ax, 0.03125, -16.0);
    copyBitsToByteArrayLE(raw_value, byteArray, 7788, 10);

    raw_value = convertPhysicalToRaw(@CAN_RadarRL::RRL_Object::RRL_Object_Obj14.LengthVnce, 0.005, 0.0);
    copyBitsToByteArrayLE(raw_value, byteArray, 7776, 12);

    raw_value = convertPhysicalToRaw(@CAN_RadarRL::RRL_Object::RRL_Object_Obj14.Length, 0.125, 0.0);
    copyBitsToByteArrayLE(raw_value, byteArray, 7768, 7);

    raw_value = convertPhysicalToRaw(@CAN_RadarRL::RRL_Object::RRL_Object_Obj14.PyVnce, 0.005, 0.0);
    copyBitsToByteArrayLE(raw_value, byteArray, 7756, 12);

    raw_value = convertPhysicalToRaw(@CAN_RadarRL::RRL_Object::RRL_Object_Obj14.Py, 0.0625, -128.0);
    copyBitsToByteArrayLE(raw_value, byteArray, 7744, 12);

    raw_value = convertPhysicalToRaw(@CAN_RadarRL::RRL_Object::RRL_Object_Obj14.PxVnce, 0.005, 0.0);
    copyBitsToByteArrayLE(raw_value, byteArray, 7732, 12);

    raw_value = convertPhysicalToRaw(@CAN_RadarRL::RRL_Object::RRL_Object_Obj14.Px, 0.0625, -512.0);
    copyBitsToByteArrayLE(raw_value, byteArray, 7718, 14);

    raw_value = convertPhysicalToRaw(@CAN_RadarRL::RRL_Object::RRL_Object_Obj14.ProbClassConfidence, 2.0, 0.0);
    copyBitsToByteArrayLE(raw_value, byteArray, 7712, 6);

    raw_value = convertPhysicalToRaw(@CAN_RadarRL::RRL_Object::RRL_Object_Obj14.MovingStatus, 1.0, 0.0);
    copyBitsToByteArrayLE(raw_value, byteArray, 7916, 2);

    raw_value = convertPhysicalToRaw(@CAN_RadarRL::RRL_Object::RRL_Object_Obj14.Age, 1.0, 0.0);
    copyBitsToByteArrayLE(raw_value, byteArray, 8192, 32);

    raw_value = convertPhysicalToRaw(@CAN_RadarRL::RRL_Object::RRL_Object_Obj14.ExistProb, 2.0, 0.0);
    copyBitsToByteArrayLE(raw_value, byteArray, 7928, 6);

    raw_value = convertPhysicalToRaw(@CAN_RadarRL::RRL_Object::RRL_Object_Obj14.PxAxCoVnce, 0.005, -10.0);
    copyBitsToByteArrayLE(raw_value, byteArray, 8032, 12);

    raw_value = convertPhysicalToRaw(@CAN_RadarRL::RRL_Object::RRL_Object_Obj14.VyVnce, 0.005, 0.0);
    copyBitsToByteArrayLE(raw_value, byteArray, 7936, 12);

    raw_value = convertPhysicalToRaw(@CAN_RadarRL::RRL_Object::RRL_Object_Obj14.AxAyCoVnce, 0.005, -10.0);
    copyBitsToByteArrayLE(raw_value, byteArray, 8172, 12);

    raw_value = convertPhysicalToRaw(@CAN_RadarRL::RRL_Object::RRL_Object_Obj14.VyAyCoVnce, 0.005, -10.0);
    copyBitsToByteArrayLE(raw_value, byteArray, 8160, 12);

    raw_value = convertPhysicalToRaw(@CAN_RadarRL::RRL_Object::RRL_Object_Obj14.VyAxCoVnce, 0.005, -10.0);
    copyBitsToByteArrayLE(raw_value, byteArray, 8140, 12);

    raw_value = convertPhysicalToRaw(@CAN_RadarRL::RRL_Object::RRL_Object_Obj14.VxAyCoVnce, 0.005, -10.0);
    copyBitsToByteArrayLE(raw_value, byteArray, 8128, 12);

    raw_value = convertPhysicalToRaw(@CAN_RadarRL::RRL_Object::RRL_Object_Obj14.VxAxCoVnce, 0.005, -10.0);
    copyBitsToByteArrayLE(raw_value, byteArray, 8108, 12);

    raw_value = convertPhysicalToRaw(@CAN_RadarRL::RRL_Object::RRL_Object_Obj14.PyAyCoVnce, 0.005, -10.0);
    copyBitsToByteArrayLE(raw_value, byteArray, 8076, 12);

    raw_value = convertPhysicalToRaw(@CAN_RadarRL::RRL_Object::RRL_Object_Obj14.PyAxCoVnce, 0.005, -10.0);
    copyBitsToByteArrayLE(raw_value, byteArray, 8064, 12);

    raw_value = convertPhysicalToRaw(@CAN_RadarRL::RRL_Object::RRL_Object_Obj14.PxAyCoVnce, 0.005, -10.0);
    copyBitsToByteArrayLE(raw_value, byteArray, 8044, 12);

    raw_value = convertPhysicalToRaw(@CAN_RadarRL::RRL_Object::RRL_Object_Obj14.VxVyCoVnce, 0.005, -10.0);
    copyBitsToByteArrayLE(raw_value, byteArray, 8096, 12);

    raw_value = convertPhysicalToRaw(@CAN_RadarRL::RRL_Object::RRL_Object_Obj14.ReferencePoint, 1.0, 0.0);
    copyBitsToByteArrayLE(raw_value, byteArray, 8024, 4);

    raw_value = convertPhysicalToRaw(@CAN_RadarRL::RRL_Object::RRL_Object_Obj14.PxPyCoVnce, 0.005, -10.0);
    copyBitsToByteArrayLE(raw_value, byteArray, 7948, 12);

    raw_value = convertPhysicalToRaw(@CAN_RadarRL::RRL_Object::RRL_Object_Obj14.PyVxCoVnce, 0.005, -10.0);
    copyBitsToByteArrayLE(raw_value, byteArray, 8000, 12);

    raw_value = convertPhysicalToRaw(@CAN_RadarRL::RRL_Object::RRL_Object_Obj14.FilterInformation, 1.0, 0.0);
    copyBitsToByteArrayLE(raw_value, byteArray, 7992, 8);

    raw_value = convertPhysicalToRaw(@CAN_RadarRL::RRL_Object::RRL_Object_Obj14.PxVyCoVnce, 0.005, -10.0);
    copyBitsToByteArrayLE(raw_value, byteArray, 7980, 12);

    raw_value = convertPhysicalToRaw(@CAN_RadarRL::RRL_Object::RRL_Object_Obj14.PxVxCoVnce, 0.005, -10.0);
    copyBitsToByteArrayLE(raw_value, byteArray, 7968, 12);

    raw_value = convertPhysicalToRaw(@CAN_RadarRL::RRL_Object::RRL_Object_Obj14.ProbClassType, 1.0, 0.0);
    copyBitsToByteArrayLE(raw_value, byteArray, 7963, 4);

    raw_value = convertPhysicalToRaw(@CAN_RadarRL::RRL_Object::RRL_Object_Obj14.MeasurementStatus, 1.0, 0.0);
    copyBitsToByteArrayLE(raw_value, byteArray, 7960, 3);

    raw_value = convertPhysicalToRaw(@CAN_RadarRL::RRL_Object::RRL_Object_Obj14.PyVyCoVnce, 0.005, -10.0);
    copyBitsToByteArrayLE(raw_value, byteArray, 8012, 12);
}


void RRL_Object_Obj13_write(byte byteArray[])
{
    qword raw_value;

    raw_value = convertPhysicalToRaw(@CAN_RadarRL::RRL_Object::RRL_Object_Obj13.WidthVnce, 0.005, 0.0);
    copyBitsToByteArrayLE(raw_value, byteArray, 7328, 12);

    raw_value = convertPhysicalToRaw(@CAN_RadarRL::RRL_Object::RRL_Object_Obj13.RCS, 0.2, -102.4);
    copyBitsToByteArrayLE(raw_value, byteArray, 7340, 10);

    raw_value = convertPhysicalToRaw(@CAN_RadarRL::RRL_Object::RRL_Object_Obj13.Ay, 0.0625, -16.0);
    copyBitsToByteArrayLE(raw_value, byteArray, 7350, 9);

    raw_value = convertPhysicalToRaw(@CAN_RadarRL::RRL_Object::RRL_Object_Obj13.VxVnce, 0.005, 0.0);
    copyBitsToByteArrayLE(raw_value, byteArray, 7392, 12);

    raw_value = convertPhysicalToRaw(@CAN_RadarRL::RRL_Object::RRL_Object_Obj13.AyVnce, 0.005, 0.0);
    copyBitsToByteArrayLE(raw_value, byteArray, 7360, 12);

    raw_value = convertPhysicalToRaw(@CAN_RadarRL::RRL_Object::RRL_Object_Obj13.Vx, 0.0625, -128.0);
    copyBitsToByteArrayLE(raw_value, byteArray, 7372, 12);

    raw_value = convertPhysicalToRaw(@CAN_RadarRL::RRL_Object::RRL_Object_Obj13.ObjId, 1.0, 0.0);
    copyBitsToByteArrayLE(raw_value, byteArray, 7384, 7);

    raw_value = convertPhysicalToRaw(@CAN_RadarRL::RRL_Object::RRL_Object_Obj13.OrientationYawVnce, 0.0003, 0.0);
    copyBitsToByteArrayLE(raw_value, byteArray, 7308, 12);

    raw_value = convertPhysicalToRaw(@CAN_RadarRL::RRL_Object::RRL_Object_Obj13.Width, 0.125, 0.0);
    copyBitsToByteArrayLE(raw_value, byteArray, 7320, 7);

    raw_value = convertPhysicalToRaw(@CAN_RadarRL::RRL_Object::RRL_Object_Obj13.ProbClassConfidence, 2.0, 0.0);
    copyBitsToByteArrayLE(raw_value, byteArray, 7200, 6);

    raw_value = convertPhysicalToRaw(@CAN_RadarRL::RRL_Object::RRL_Object_Obj13.AxVnce, 0.005, 0.0);
    copyBitsToByteArrayLE(raw_value, byteArray, 7296, 12);

    raw_value = convertPhysicalToRaw(@CAN_RadarRL::RRL_Object::RRL_Object_Obj13.OrientationYaw, 0.0175, -4.48);
    copyBitsToByteArrayLE(raw_value, byteArray, 7286, 9);

    raw_value = convertPhysicalToRaw(@CAN_RadarRL::RRL_Object::RRL_Object_Obj13.Ax, 0.03125, -16.0);
    copyBitsToByteArrayLE(raw_value, byteArray, 7276, 10);

    raw_value = convertPhysicalToRaw(@CAN_RadarRL::RRL_Object::RRL_Object_Obj13.LengthVnce, 0.005, 0.0);
    copyBitsToByteArrayLE(raw_value, byteArray, 7264, 12);

    raw_value = convertPhysicalToRaw(@CAN_RadarRL::RRL_Object::RRL_Object_Obj13.Length, 0.125, 0.0);
    copyBitsToByteArrayLE(raw_value, byteArray, 7256, 7);

    raw_value = convertPhysicalToRaw(@CAN_RadarRL::RRL_Object::RRL_Object_Obj13.PyVnce, 0.005, 0.0);
    copyBitsToByteArrayLE(raw_value, byteArray, 7244, 12);

    raw_value = convertPhysicalToRaw(@CAN_RadarRL::RRL_Object::RRL_Object_Obj13.Py, 0.0625, -128.0);
    copyBitsToByteArrayLE(raw_value, byteArray, 7232, 12);

    raw_value = convertPhysicalToRaw(@CAN_RadarRL::RRL_Object::RRL_Object_Obj13.PxVnce, 0.005, 0.0);
    copyBitsToByteArrayLE(raw_value, byteArray, 7220, 12);

    raw_value = convertPhysicalToRaw(@CAN_RadarRL::RRL_Object::RRL_Object_Obj13.Px, 0.0625, -512.0);
    copyBitsToByteArrayLE(raw_value, byteArray, 7206, 14);

    raw_value = convertPhysicalToRaw(@CAN_RadarRL::RRL_Object::RRL_Object_Obj13.Vy, 0.125, -64.0);
    copyBitsToByteArrayLE(raw_value, byteArray, 7406, 10);

    raw_value = convertPhysicalToRaw(@CAN_RadarRL::RRL_Object::RRL_Object_Obj13.MovingStatus, 1.0, 0.0);
    copyBitsToByteArrayLE(raw_value, byteArray, 7404, 2);

    raw_value = convertPhysicalToRaw(@CAN_RadarRL::RRL_Object::RRL_Object_Obj13.PxVxCoVnce, 0.005, -10.0);
    copyBitsToByteArrayLE(raw_value, byteArray, 7456, 12);

    raw_value = convertPhysicalToRaw(@CAN_RadarRL::RRL_Object::RRL_Object_Obj13.ExistProb, 2.0, 0.0);
    copyBitsToByteArrayLE(raw_value, byteArray, 7416, 6);

    raw_value = convertPhysicalToRaw(@CAN_RadarRL::RRL_Object::RRL_Object_Obj13.PxAyCoVnce, 0.005, -10.0);
    copyBitsToByteArrayLE(raw_value, byteArray, 7532, 12);

    raw_value = convertPhysicalToRaw(@CAN_RadarRL::RRL_Object::RRL_Object_Obj13.Age, 1.0, 0.0);
    copyBitsToByteArrayLE(raw_value, byteArray, 7680, 32);

    raw_value = convertPhysicalToRaw(@CAN_RadarRL::RRL_Object::RRL_Object_Obj13.AxAyCoVnce, 0.005, -10.0);
    copyBitsToByteArrayLE(raw_value, byteArray, 7660, 12);

    raw_value = convertPhysicalToRaw(@CAN_RadarRL::RRL_Object::RRL_Object_Obj13.VyAyCoVnce, 0.005, -10.0);
    copyBitsToByteArrayLE(raw_value, byteArray, 7648, 12);

    raw_value = convertPhysicalToRaw(@CAN_RadarRL::RRL_Object::RRL_Object_Obj13.VyAxCoVnce, 0.005, -10.0);
    copyBitsToByteArrayLE(raw_value, byteArray, 7628, 12);

    raw_value = convertPhysicalToRaw(@CAN_RadarRL::RRL_Object::RRL_Object_Obj13.VxAyCoVnce, 0.005, -10.0);
    copyBitsToByteArrayLE(raw_value, byteArray, 7616, 12);

    raw_value = convertPhysicalToRaw(@CAN_RadarRL::RRL_Object::RRL_Object_Obj13.VyVnce, 0.005, 0.0);
    copyBitsToByteArrayLE(raw_value, byteArray, 7424, 12);

    raw_value = convertPhysicalToRaw(@CAN_RadarRL::RRL_Object::RRL_Object_Obj13.VxVyCoVnce, 0.005, -10.0);
    copyBitsToByteArrayLE(raw_value, byteArray, 7584, 12);

    raw_value = convertPhysicalToRaw(@CAN_RadarRL::RRL_Object::RRL_Object_Obj13.PyAyCoVnce, 0.005, -10.0);
    copyBitsToByteArrayLE(raw_value, byteArray, 7564, 12);

    raw_value = convertPhysicalToRaw(@CAN_RadarRL::RRL_Object::RRL_Object_Obj13.PyAxCoVnce, 0.005, -10.0);
    copyBitsToByteArrayLE(raw_value, byteArray, 7552, 12);

    raw_value = convertPhysicalToRaw(@CAN_RadarRL::RRL_Object::RRL_Object_Obj13.VxAxCoVnce, 0.005, -10.0);
    copyBitsToByteArrayLE(raw_value, byteArray, 7596, 12);

    raw_value = convertPhysicalToRaw(@CAN_RadarRL::RRL_Object::RRL_Object_Obj13.PxAxCoVnce, 0.005, -10.0);
    copyBitsToByteArrayLE(raw_value, byteArray, 7520, 12);

    raw_value = convertPhysicalToRaw(@CAN_RadarRL::RRL_Object::RRL_Object_Obj13.PyVyCoVnce, 0.005, -10.0);
    copyBitsToByteArrayLE(raw_value, byteArray, 7500, 12);

    raw_value = convertPhysicalToRaw(@CAN_RadarRL::RRL_Object::RRL_Object_Obj13.PyVxCoVnce, 0.005, -10.0);
    copyBitsToByteArrayLE(raw_value, byteArray, 7488, 12);

    raw_value = convertPhysicalToRaw(@CAN_RadarRL::RRL_Object::RRL_Object_Obj13.FilterInformation, 1.0, 0.0);
    copyBitsToByteArrayLE(raw_value, byteArray, 7480, 8);

    raw_value = convertPhysicalToRaw(@CAN_RadarRL::RRL_Object::RRL_Object_Obj13.PxVyCoVnce, 0.005, -10.0);
    copyBitsToByteArrayLE(raw_value, byteArray, 7468, 12);

    raw_value = convertPhysicalToRaw(@CAN_RadarRL::RRL_Object::RRL_Object_Obj13.ProbClassType, 1.0, 0.0);
    copyBitsToByteArrayLE(raw_value, byteArray, 7451, 4);

    raw_value = convertPhysicalToRaw(@CAN_RadarRL::RRL_Object::RRL_Object_Obj13.MeasurementStatus, 1.0, 0.0);
    copyBitsToByteArrayLE(raw_value, byteArray, 7448, 3);

    raw_value = convertPhysicalToRaw(@CAN_RadarRL::RRL_Object::RRL_Object_Obj13.PxPyCoVnce, 0.005, -10.0);
    copyBitsToByteArrayLE(raw_value, byteArray, 7436, 12);

    raw_value = convertPhysicalToRaw(@CAN_RadarRL::RRL_Object::RRL_Object_Obj13.ReferencePoint, 1.0, 0.0);
    copyBitsToByteArrayLE(raw_value, byteArray, 7512, 4);
}


void RRL_Object_Obj12_write(byte byteArray[])
{
    qword raw_value;

    raw_value = convertPhysicalToRaw(@CAN_RadarRL::RRL_Object::RRL_Object_Obj12.Ay, 0.0625, -16.0);
    copyBitsToByteArrayLE(raw_value, byteArray, 6838, 9);

    raw_value = convertPhysicalToRaw(@CAN_RadarRL::RRL_Object::RRL_Object_Obj12.AxVnce, 0.005, 0.0);
    copyBitsToByteArrayLE(raw_value, byteArray, 6784, 12);

    raw_value = convertPhysicalToRaw(@CAN_RadarRL::RRL_Object::RRL_Object_Obj12.WidthVnce, 0.005, 0.0);
    copyBitsToByteArrayLE(raw_value, byteArray, 6816, 12);

    raw_value = convertPhysicalToRaw(@CAN_RadarRL::RRL_Object::RRL_Object_Obj12.RCS, 0.2, -102.4);
    copyBitsToByteArrayLE(raw_value, byteArray, 6828, 10);

    raw_value = convertPhysicalToRaw(@CAN_RadarRL::RRL_Object::RRL_Object_Obj12.VxVnce, 0.005, 0.0);
    copyBitsToByteArrayLE(raw_value, byteArray, 6880, 12);

    raw_value = convertPhysicalToRaw(@CAN_RadarRL::RRL_Object::RRL_Object_Obj12.AyVnce, 0.005, 0.0);
    copyBitsToByteArrayLE(raw_value, byteArray, 6848, 12);

    raw_value = convertPhysicalToRaw(@CAN_RadarRL::RRL_Object::RRL_Object_Obj12.Vx, 0.0625, -128.0);
    copyBitsToByteArrayLE(raw_value, byteArray, 6860, 12);

    raw_value = convertPhysicalToRaw(@CAN_RadarRL::RRL_Object::RRL_Object_Obj12.ObjId, 1.0, 0.0);
    copyBitsToByteArrayLE(raw_value, byteArray, 6872, 7);

    raw_value = convertPhysicalToRaw(@CAN_RadarRL::RRL_Object::RRL_Object_Obj12.OrientationYawVnce, 0.0003, 0.0);
    copyBitsToByteArrayLE(raw_value, byteArray, 6796, 12);

    raw_value = convertPhysicalToRaw(@CAN_RadarRL::RRL_Object::RRL_Object_Obj12.Vy, 0.125, -64.0);
    copyBitsToByteArrayLE(raw_value, byteArray, 6894, 10);

    raw_value = convertPhysicalToRaw(@CAN_RadarRL::RRL_Object::RRL_Object_Obj12.OrientationYaw, 0.0175, -4.48);
    copyBitsToByteArrayLE(raw_value, byteArray, 6774, 9);

    raw_value = convertPhysicalToRaw(@CAN_RadarRL::RRL_Object::RRL_Object_Obj12.Ax, 0.03125, -16.0);
    copyBitsToByteArrayLE(raw_value, byteArray, 6764, 10);

    raw_value = convertPhysicalToRaw(@CAN_RadarRL::RRL_Object::RRL_Object_Obj12.LengthVnce, 0.005, 0.0);
    copyBitsToByteArrayLE(raw_value, byteArray, 6752, 12);

    raw_value = convertPhysicalToRaw(@CAN_RadarRL::RRL_Object::RRL_Object_Obj12.Length, 0.125, 0.0);
    copyBitsToByteArrayLE(raw_value, byteArray, 6744, 7);

    raw_value = convertPhysicalToRaw(@CAN_RadarRL::RRL_Object::RRL_Object_Obj12.PyVnce, 0.005, 0.0);
    copyBitsToByteArrayLE(raw_value, byteArray, 6732, 12);

    raw_value = convertPhysicalToRaw(@CAN_RadarRL::RRL_Object::RRL_Object_Obj12.Py, 0.0625, -128.0);
    copyBitsToByteArrayLE(raw_value, byteArray, 6720, 12);

    raw_value = convertPhysicalToRaw(@CAN_RadarRL::RRL_Object::RRL_Object_Obj12.PxVnce, 0.005, 0.0);
    copyBitsToByteArrayLE(raw_value, byteArray, 6708, 12);

    raw_value = convertPhysicalToRaw(@CAN_RadarRL::RRL_Object::RRL_Object_Obj12.Px, 0.0625, -512.0);
    copyBitsToByteArrayLE(raw_value, byteArray, 6694, 14);

    raw_value = convertPhysicalToRaw(@CAN_RadarRL::RRL_Object::RRL_Object_Obj12.ProbClassConfidence, 2.0, 0.0);
    copyBitsToByteArrayLE(raw_value, byteArray, 6688, 6);

    raw_value = convertPhysicalToRaw(@CAN_RadarRL::RRL_Object::RRL_Object_Obj12.MovingStatus, 1.0, 0.0);
    copyBitsToByteArrayLE(raw_value, byteArray, 6892, 2);

    raw_value = convertPhysicalToRaw(@CAN_RadarRL::RRL_Object::RRL_Object_Obj12.Width, 0.125, 0.0);
    copyBitsToByteArrayLE(raw_value, byteArray, 6808, 7);

    raw_value = convertPhysicalToRaw(@CAN_RadarRL::RRL_Object::RRL_Object_Obj12.ExistProb, 2.0, 0.0);
    copyBitsToByteArrayLE(raw_value, byteArray, 6904, 6);

    raw_value = convertPhysicalToRaw(@CAN_RadarRL::RRL_Object::RRL_Object_Obj12.PxAyCoVnce, 0.005, -10.0);
    copyBitsToByteArrayLE(raw_value, byteArray, 7020, 12);

    raw_value = convertPhysicalToRaw(@CAN_RadarRL::RRL_Object::RRL_Object_Obj12.Age, 1.0, 0.0);
    copyBitsToByteArrayLE(raw_value, byteArray, 7168, 32);

    raw_value = convertPhysicalToRaw(@CAN_RadarRL::RRL_Object::RRL_Object_Obj12.AxAyCoVnce, 0.005, -10.0);
    copyBitsToByteArrayLE(raw_value, byteArray, 7148, 12);

    raw_value = convertPhysicalToRaw(@CAN_RadarRL::RRL_Object::RRL_Object_Obj12.VyAyCoVnce, 0.005, -10.0);
    copyBitsToByteArrayLE(raw_value, byteArray, 7136, 12);

    raw_value = convertPhysicalToRaw(@CAN_RadarRL::RRL_Object::RRL_Object_Obj12.VyAxCoVnce, 0.005, -10.0);
    copyBitsToByteArrayLE(raw_value, byteArray, 7116, 12);

    raw_value = convertPhysicalToRaw(@CAN_RadarRL::RRL_Object::RRL_Object_Obj12.VxAyCoVnce, 0.005, -10.0);
    copyBitsToByteArrayLE(raw_value, byteArray, 7104, 12);

    raw_value = convertPhysicalToRaw(@CAN_RadarRL::RRL_Object::RRL_Object_Obj12.VxAxCoVnce, 0.005, -10.0);
    copyBitsToByteArrayLE(raw_value, byteArray, 7084, 12);

    raw_value = convertPhysicalToRaw(@CAN_RadarRL::RRL_Object::RRL_Object_Obj12.VxVyCoVnce, 0.005, -10.0);
    copyBitsToByteArrayLE(raw_value, byteArray, 7072, 12);

    raw_value = convertPhysicalToRaw(@CAN_RadarRL::RRL_Object::RRL_Object_Obj12.PyAyCoVnce, 0.005, -10.0);
    copyBitsToByteArrayLE(raw_value, byteArray, 7052, 12);

    raw_value = convertPhysicalToRaw(@CAN_RadarRL::RRL_Object::RRL_Object_Obj12.PyAxCoVnce, 0.005, -10.0);
    copyBitsToByteArrayLE(raw_value, byteArray, 7040, 12);

    raw_value = convertPhysicalToRaw(@CAN_RadarRL::RRL_Object::RRL_Object_Obj12.VyVnce, 0.005, 0.0);
    copyBitsToByteArrayLE(raw_value, byteArray, 6912, 12);

    raw_value = convertPhysicalToRaw(@CAN_RadarRL::RRL_Object::RRL_Object_Obj12.PxAxCoVnce, 0.005, -10.0);
    copyBitsToByteArrayLE(raw_value, byteArray, 7008, 12);

    raw_value = convertPhysicalToRaw(@CAN_RadarRL::RRL_Object::RRL_Object_Obj12.PyVyCoVnce, 0.005, -10.0);
    copyBitsToByteArrayLE(raw_value, byteArray, 6988, 12);

    raw_value = convertPhysicalToRaw(@CAN_RadarRL::RRL_Object::RRL_Object_Obj12.PyVxCoVnce, 0.005, -10.0);
    copyBitsToByteArrayLE(raw_value, byteArray, 6976, 12);

    raw_value = convertPhysicalToRaw(@CAN_RadarRL::RRL_Object::RRL_Object_Obj12.FilterInformation, 1.0, 0.0);
    copyBitsToByteArrayLE(raw_value, byteArray, 6968, 8);

    raw_value = convertPhysicalToRaw(@CAN_RadarRL::RRL_Object::RRL_Object_Obj12.PxVyCoVnce, 0.005, -10.0);
    copyBitsToByteArrayLE(raw_value, byteArray, 6956, 12);

    raw_value = convertPhysicalToRaw(@CAN_RadarRL::RRL_Object::RRL_Object_Obj12.PxVxCoVnce, 0.005, -10.0);
    copyBitsToByteArrayLE(raw_value, byteArray, 6944, 12);

    raw_value = convertPhysicalToRaw(@CAN_RadarRL::RRL_Object::RRL_Object_Obj12.ProbClassType, 1.0, 0.0);
    copyBitsToByteArrayLE(raw_value, byteArray, 6939, 4);

    raw_value = convertPhysicalToRaw(@CAN_RadarRL::RRL_Object::RRL_Object_Obj12.MeasurementStatus, 1.0, 0.0);
    copyBitsToByteArrayLE(raw_value, byteArray, 6936, 3);

    raw_value = convertPhysicalToRaw(@CAN_RadarRL::RRL_Object::RRL_Object_Obj12.PxPyCoVnce, 0.005, -10.0);
    copyBitsToByteArrayLE(raw_value, byteArray, 6924, 12);

    raw_value = convertPhysicalToRaw(@CAN_RadarRL::RRL_Object::RRL_Object_Obj12.ReferencePoint, 1.0, 0.0);
    copyBitsToByteArrayLE(raw_value, byteArray, 7000, 4);
}


void RRL_Object_Obj11_write(byte byteArray[])
{
    qword raw_value;

    raw_value = convertPhysicalToRaw(@CAN_RadarRL::RRL_Object::RRL_Object_Obj11.Ay, 0.0625, -16.0);
    copyBitsToByteArrayLE(raw_value, byteArray, 6326, 9);

    raw_value = convertPhysicalToRaw(@CAN_RadarRL::RRL_Object::RRL_Object_Obj11.WidthVnce, 0.005, 0.0);
    copyBitsToByteArrayLE(raw_value, byteArray, 6304, 12);

    raw_value = convertPhysicalToRaw(@CAN_RadarRL::RRL_Object::RRL_Object_Obj11.RCS, 0.2, -102.4);
    copyBitsToByteArrayLE(raw_value, byteArray, 6316, 10);

    raw_value = convertPhysicalToRaw(@CAN_RadarRL::RRL_Object::RRL_Object_Obj11.VxVnce, 0.005, 0.0);
    copyBitsToByteArrayLE(raw_value, byteArray, 6368, 12);

    raw_value = convertPhysicalToRaw(@CAN_RadarRL::RRL_Object::RRL_Object_Obj11.AyVnce, 0.005, 0.0);
    copyBitsToByteArrayLE(raw_value, byteArray, 6336, 12);

    raw_value = convertPhysicalToRaw(@CAN_RadarRL::RRL_Object::RRL_Object_Obj11.Vx, 0.0625, -128.0);
    copyBitsToByteArrayLE(raw_value, byteArray, 6348, 12);

    raw_value = convertPhysicalToRaw(@CAN_RadarRL::RRL_Object::RRL_Object_Obj11.ObjId, 1.0, 0.0);
    copyBitsToByteArrayLE(raw_value, byteArray, 6360, 7);

    raw_value = convertPhysicalToRaw(@CAN_RadarRL::RRL_Object::RRL_Object_Obj11.OrientationYawVnce, 0.0003, 0.0);
    copyBitsToByteArrayLE(raw_value, byteArray, 6284, 12);

    raw_value = convertPhysicalToRaw(@CAN_RadarRL::RRL_Object::RRL_Object_Obj11.Width, 0.125, 0.0);
    copyBitsToByteArrayLE(raw_value, byteArray, 6296, 7);

    raw_value = convertPhysicalToRaw(@CAN_RadarRL::RRL_Object::RRL_Object_Obj11.Length, 0.125, 0.0);
    copyBitsToByteArrayLE(raw_value, byteArray, 6232, 7);

    raw_value = convertPhysicalToRaw(@CAN_RadarRL::RRL_Object::RRL_Object_Obj11.AxVnce, 0.005, 0.0);
    copyBitsToByteArrayLE(raw_value, byteArray, 6272, 12);

    raw_value = convertPhysicalToRaw(@CAN_RadarRL::RRL_Object::RRL_Object_Obj11.OrientationYaw, 0.0175, -4.48);
    copyBitsToByteArrayLE(raw_value, byteArray, 6262, 9);

    raw_value = convertPhysicalToRaw(@CAN_RadarRL::RRL_Object::RRL_Object_Obj11.Ax, 0.03125, -16.0);
    copyBitsToByteArrayLE(raw_value, byteArray, 6252, 10);

    raw_value = convertPhysicalToRaw(@CAN_RadarRL::RRL_Object::RRL_Object_Obj11.LengthVnce, 0.005, 0.0);
    copyBitsToByteArrayLE(raw_value, byteArray, 6240, 12);

    raw_value = convertPhysicalToRaw(@CAN_RadarRL::RRL_Object::RRL_Object_Obj11.PyVnce, 0.005, 0.0);
    copyBitsToByteArrayLE(raw_value, byteArray, 6220, 12);

    raw_value = convertPhysicalToRaw(@CAN_RadarRL::RRL_Object::RRL_Object_Obj11.Py, 0.0625, -128.0);
    copyBitsToByteArrayLE(raw_value, byteArray, 6208, 12);

    raw_value = convertPhysicalToRaw(@CAN_RadarRL::RRL_Object::RRL_Object_Obj11.PxVnce, 0.005, 0.0);
    copyBitsToByteArrayLE(raw_value, byteArray, 6196, 12);

    raw_value = convertPhysicalToRaw(@CAN_RadarRL::RRL_Object::RRL_Object_Obj11.Px, 0.0625, -512.0);
    copyBitsToByteArrayLE(raw_value, byteArray, 6182, 14);

    raw_value = convertPhysicalToRaw(@CAN_RadarRL::RRL_Object::RRL_Object_Obj11.ProbClassConfidence, 2.0, 0.0);
    copyBitsToByteArrayLE(raw_value, byteArray, 6176, 6);

    raw_value = convertPhysicalToRaw(@CAN_RadarRL::RRL_Object::RRL_Object_Obj11.Vy, 0.125, -64.0);
    copyBitsToByteArrayLE(raw_value, byteArray, 6382, 10);

    raw_value = convertPhysicalToRaw(@CAN_RadarRL::RRL_Object::RRL_Object_Obj11.MovingStatus, 1.0, 0.0);
    copyBitsToByteArrayLE(raw_value, byteArray, 6380, 2);

    raw_value = convertPhysicalToRaw(@CAN_RadarRL::RRL_Object::RRL_Object_Obj11.PyVxCoVnce, 0.005, -10.0);
    copyBitsToByteArrayLE(raw_value, byteArray, 6464, 12);

    raw_value = convertPhysicalToRaw(@CAN_RadarRL::RRL_Object::RRL_Object_Obj11.ExistProb, 2.0, 0.0);
    copyBitsToByteArrayLE(raw_value, byteArray, 6392, 6);

    raw_value = convertPhysicalToRaw(@CAN_RadarRL::RRL_Object::RRL_Object_Obj11.PxAyCoVnce, 0.005, -10.0);
    copyBitsToByteArrayLE(raw_value, byteArray, 6508, 12);

    raw_value = convertPhysicalToRaw(@CAN_RadarRL::RRL_Object::RRL_Object_Obj11.VyVnce, 0.005, 0.0);
    copyBitsToByteArrayLE(raw_value, byteArray, 6400, 12);

    raw_value = convertPhysicalToRaw(@CAN_RadarRL::RRL_Object::RRL_Object_Obj11.AxAyCoVnce, 0.005, -10.0);
    copyBitsToByteArrayLE(raw_value, byteArray, 6636, 12);

    raw_value = convertPhysicalToRaw(@CAN_RadarRL::RRL_Object::RRL_Object_Obj11.VyAyCoVnce, 0.005, -10.0);
    copyBitsToByteArrayLE(raw_value, byteArray, 6624, 12);

    raw_value = convertPhysicalToRaw(@CAN_RadarRL::RRL_Object::RRL_Object_Obj11.VyAxCoVnce, 0.005, -10.0);
    copyBitsToByteArrayLE(raw_value, byteArray, 6604, 12);

    raw_value = convertPhysicalToRaw(@CAN_RadarRL::RRL_Object::RRL_Object_Obj11.VxAyCoVnce, 0.005, -10.0);
    copyBitsToByteArrayLE(raw_value, byteArray, 6592, 12);

    raw_value = convertPhysicalToRaw(@CAN_RadarRL::RRL_Object::RRL_Object_Obj11.VxAxCoVnce, 0.005, -10.0);
    copyBitsToByteArrayLE(raw_value, byteArray, 6572, 12);

    raw_value = convertPhysicalToRaw(@CAN_RadarRL::RRL_Object::RRL_Object_Obj11.VxVyCoVnce, 0.005, -10.0);
    copyBitsToByteArrayLE(raw_value, byteArray, 6560, 12);

    raw_value = convertPhysicalToRaw(@CAN_RadarRL::RRL_Object::RRL_Object_Obj11.PyAyCoVnce, 0.005, -10.0);
    copyBitsToByteArrayLE(raw_value, byteArray, 6540, 12);

    raw_value = convertPhysicalToRaw(@CAN_RadarRL::RRL_Object::RRL_Object_Obj11.PyAxCoVnce, 0.005, -10.0);
    copyBitsToByteArrayLE(raw_value, byteArray, 6528, 12);

    raw_value = convertPhysicalToRaw(@CAN_RadarRL::RRL_Object::RRL_Object_Obj11.Age, 1.0, 0.0);
    copyBitsToByteArrayLE(raw_value, byteArray, 6656, 32);

    raw_value = convertPhysicalToRaw(@CAN_RadarRL::RRL_Object::RRL_Object_Obj11.PxAxCoVnce, 0.005, -10.0);
    copyBitsToByteArrayLE(raw_value, byteArray, 6496, 12);

    raw_value = convertPhysicalToRaw(@CAN_RadarRL::RRL_Object::RRL_Object_Obj11.PxVxCoVnce, 0.005, -10.0);
    copyBitsToByteArrayLE(raw_value, byteArray, 6432, 12);

    raw_value = convertPhysicalToRaw(@CAN_RadarRL::RRL_Object::RRL_Object_Obj11.ReferencePoint, 1.0, 0.0);
    copyBitsToByteArrayLE(raw_value, byteArray, 6488, 4);

    raw_value = convertPhysicalToRaw(@CAN_RadarRL::RRL_Object::RRL_Object_Obj11.MeasurementStatus, 1.0, 0.0);
    copyBitsToByteArrayLE(raw_value, byteArray, 6424, 3);

    raw_value = convertPhysicalToRaw(@CAN_RadarRL::RRL_Object::RRL_Object_Obj11.ProbClassType, 1.0, 0.0);
    copyBitsToByteArrayLE(raw_value, byteArray, 6427, 4);

    raw_value = convertPhysicalToRaw(@CAN_RadarRL::RRL_Object::RRL_Object_Obj11.PxPyCoVnce, 0.005, -10.0);
    copyBitsToByteArrayLE(raw_value, byteArray, 6412, 12);

    raw_value = convertPhysicalToRaw(@CAN_RadarRL::RRL_Object::RRL_Object_Obj11.PxVyCoVnce, 0.005, -10.0);
    copyBitsToByteArrayLE(raw_value, byteArray, 6444, 12);

    raw_value = convertPhysicalToRaw(@CAN_RadarRL::RRL_Object::RRL_Object_Obj11.FilterInformation, 1.0, 0.0);
    copyBitsToByteArrayLE(raw_value, byteArray, 6456, 8);

    raw_value = convertPhysicalToRaw(@CAN_RadarRL::RRL_Object::RRL_Object_Obj11.PyVyCoVnce, 0.005, -10.0);
    copyBitsToByteArrayLE(raw_value, byteArray, 6476, 12);
}


void RRL_Object_Obj10_write(byte byteArray[])
{
    qword raw_value;

    raw_value = convertPhysicalToRaw(@CAN_RadarRL::RRL_Object::RRL_Object_Obj10.ObjId, 1.0, 0.0);
    copyBitsToByteArrayLE(raw_value, byteArray, 5848, 7);

    raw_value = convertPhysicalToRaw(@CAN_RadarRL::RRL_Object::RRL_Object_Obj10.AxVnce, 0.005, 0.0);
    copyBitsToByteArrayLE(raw_value, byteArray, 5760, 12);

    raw_value = convertPhysicalToRaw(@CAN_RadarRL::RRL_Object::RRL_Object_Obj10.Vx, 0.0625, -128.0);
    copyBitsToByteArrayLE(raw_value, byteArray, 5836, 12);

    raw_value = convertPhysicalToRaw(@CAN_RadarRL::RRL_Object::RRL_Object_Obj10.AyVnce, 0.005, 0.0);
    copyBitsToByteArrayLE(raw_value, byteArray, 5824, 12);

    raw_value = convertPhysicalToRaw(@CAN_RadarRL::RRL_Object::RRL_Object_Obj10.Ay, 0.0625, -16.0);
    copyBitsToByteArrayLE(raw_value, byteArray, 5814, 9);

    raw_value = convertPhysicalToRaw(@CAN_RadarRL::RRL_Object::RRL_Object_Obj10.RCS, 0.2, -102.4);
    copyBitsToByteArrayLE(raw_value, byteArray, 5804, 10);

    raw_value = convertPhysicalToRaw(@CAN_RadarRL::RRL_Object::RRL_Object_Obj10.WidthVnce, 0.005, 0.0);
    copyBitsToByteArrayLE(raw_value, byteArray, 5792, 12);

    raw_value = convertPhysicalToRaw(@CAN_RadarRL::RRL_Object::RRL_Object_Obj10.Width, 0.125, 0.0);
    copyBitsToByteArrayLE(raw_value, byteArray, 5784, 7);

    raw_value = convertPhysicalToRaw(@CAN_RadarRL::RRL_Object::RRL_Object_Obj10.OrientationYawVnce, 0.0003, 0.0);
    copyBitsToByteArrayLE(raw_value, byteArray, 5772, 12);

    raw_value = convertPhysicalToRaw(@CAN_RadarRL::RRL_Object::RRL_Object_Obj10.PyVnce, 0.005, 0.0);
    copyBitsToByteArrayLE(raw_value, byteArray, 5708, 12);

    raw_value = convertPhysicalToRaw(@CAN_RadarRL::RRL_Object::RRL_Object_Obj10.OrientationYaw, 0.0175, -4.48);
    copyBitsToByteArrayLE(raw_value, byteArray, 5750, 9);

    raw_value = convertPhysicalToRaw(@CAN_RadarRL::RRL_Object::RRL_Object_Obj10.Ax, 0.03125, -16.0);
    copyBitsToByteArrayLE(raw_value, byteArray, 5740, 10);

    raw_value = convertPhysicalToRaw(@CAN_RadarRL::RRL_Object::RRL_Object_Obj10.LengthVnce, 0.005, 0.0);
    copyBitsToByteArrayLE(raw_value, byteArray, 5728, 12);

    raw_value = convertPhysicalToRaw(@CAN_RadarRL::RRL_Object::RRL_Object_Obj10.Length, 0.125, 0.0);
    copyBitsToByteArrayLE(raw_value, byteArray, 5720, 7);

    raw_value = convertPhysicalToRaw(@CAN_RadarRL::RRL_Object::RRL_Object_Obj10.Py, 0.0625, -128.0);
    copyBitsToByteArrayLE(raw_value, byteArray, 5696, 12);

    raw_value = convertPhysicalToRaw(@CAN_RadarRL::RRL_Object::RRL_Object_Obj10.PxVnce, 0.005, 0.0);
    copyBitsToByteArrayLE(raw_value, byteArray, 5684, 12);

    raw_value = convertPhysicalToRaw(@CAN_RadarRL::RRL_Object::RRL_Object_Obj10.Px, 0.0625, -512.0);
    copyBitsToByteArrayLE(raw_value, byteArray, 5670, 14);

    raw_value = convertPhysicalToRaw(@CAN_RadarRL::RRL_Object::RRL_Object_Obj10.ProbClassConfidence, 2.0, 0.0);
    copyBitsToByteArrayLE(raw_value, byteArray, 5664, 6);

    raw_value = convertPhysicalToRaw(@CAN_RadarRL::RRL_Object::RRL_Object_Obj10.MovingStatus, 1.0, 0.0);
    copyBitsToByteArrayLE(raw_value, byteArray, 5868, 2);

    raw_value = convertPhysicalToRaw(@CAN_RadarRL::RRL_Object::RRL_Object_Obj10.VxVnce, 0.005, 0.0);
    copyBitsToByteArrayLE(raw_value, byteArray, 5856, 12);

    raw_value = convertPhysicalToRaw(@CAN_RadarRL::RRL_Object::RRL_Object_Obj10.Vy, 0.125, -64.0);
    copyBitsToByteArrayLE(raw_value, byteArray, 5870, 10);

    raw_value = convertPhysicalToRaw(@CAN_RadarRL::RRL_Object::RRL_Object_Obj10.AxAyCoVnce, 0.005, -10.0);
    copyBitsToByteArrayLE(raw_value, byteArray, 6124, 12);

    raw_value = convertPhysicalToRaw(@CAN_RadarRL::RRL_Object::RRL_Object_Obj10.PxAxCoVnce, 0.005, -10.0);
    copyBitsToByteArrayLE(raw_value, byteArray, 5984, 12);

    raw_value = convertPhysicalToRaw(@CAN_RadarRL::RRL_Object::RRL_Object_Obj10.Age, 1.0, 0.0);
    copyBitsToByteArrayLE(raw_value, byteArray, 6144, 32);

    raw_value = convertPhysicalToRaw(@CAN_RadarRL::RRL_Object::RRL_Object_Obj10.ExistProb, 2.0, 0.0);
    copyBitsToByteArrayLE(raw_value, byteArray, 5880, 6);

    raw_value = convertPhysicalToRaw(@CAN_RadarRL::RRL_Object::RRL_Object_Obj10.VyAyCoVnce, 0.005, -10.0);
    copyBitsToByteArrayLE(raw_value, byteArray, 6112, 12);

    raw_value = convertPhysicalToRaw(@CAN_RadarRL::RRL_Object::RRL_Object_Obj10.VyAxCoVnce, 0.005, -10.0);
    copyBitsToByteArrayLE(raw_value, byteArray, 6092, 12);

    raw_value = convertPhysicalToRaw(@CAN_RadarRL::RRL_Object::RRL_Object_Obj10.VxAyCoVnce, 0.005, -10.0);
    copyBitsToByteArrayLE(raw_value, byteArray, 6080, 12);

    raw_value = convertPhysicalToRaw(@CAN_RadarRL::RRL_Object::RRL_Object_Obj10.VxAxCoVnce, 0.005, -10.0);
    copyBitsToByteArrayLE(raw_value, byteArray, 6060, 12);

    raw_value = convertPhysicalToRaw(@CAN_RadarRL::RRL_Object::RRL_Object_Obj10.PyAyCoVnce, 0.005, -10.0);
    copyBitsToByteArrayLE(raw_value, byteArray, 6028, 12);

    raw_value = convertPhysicalToRaw(@CAN_RadarRL::RRL_Object::RRL_Object_Obj10.PyAxCoVnce, 0.005, -10.0);
    copyBitsToByteArrayLE(raw_value, byteArray, 6016, 12);

    raw_value = convertPhysicalToRaw(@CAN_RadarRL::RRL_Object::RRL_Object_Obj10.PxAyCoVnce, 0.005, -10.0);
    copyBitsToByteArrayLE(raw_value, byteArray, 5996, 12);

    raw_value = convertPhysicalToRaw(@CAN_RadarRL::RRL_Object::RRL_Object_Obj10.VxVyCoVnce, 0.005, -10.0);
    copyBitsToByteArrayLE(raw_value, byteArray, 6048, 12);

    raw_value = convertPhysicalToRaw(@CAN_RadarRL::RRL_Object::RRL_Object_Obj10.ReferencePoint, 1.0, 0.0);
    copyBitsToByteArrayLE(raw_value, byteArray, 5976, 4);

    raw_value = convertPhysicalToRaw(@CAN_RadarRL::RRL_Object::RRL_Object_Obj10.PxVxCoVnce, 0.005, -10.0);
    copyBitsToByteArrayLE(raw_value, byteArray, 5920, 12);

    raw_value = convertPhysicalToRaw(@CAN_RadarRL::RRL_Object::RRL_Object_Obj10.PyVyCoVnce, 0.005, -10.0);
    copyBitsToByteArrayLE(raw_value, byteArray, 5964, 12);

    raw_value = convertPhysicalToRaw(@CAN_RadarRL::RRL_Object::RRL_Object_Obj10.PxPyCoVnce, 0.005, -10.0);
    copyBitsToByteArrayLE(raw_value, byteArray, 5900, 12);

    raw_value = convertPhysicalToRaw(@CAN_RadarRL::RRL_Object::RRL_Object_Obj10.MeasurementStatus, 1.0, 0.0);
    copyBitsToByteArrayLE(raw_value, byteArray, 5912, 3);

    raw_value = convertPhysicalToRaw(@CAN_RadarRL::RRL_Object::RRL_Object_Obj10.ProbClassType, 1.0, 0.0);
    copyBitsToByteArrayLE(raw_value, byteArray, 5915, 4);

    raw_value = convertPhysicalToRaw(@CAN_RadarRL::RRL_Object::RRL_Object_Obj10.VyVnce, 0.005, 0.0);
    copyBitsToByteArrayLE(raw_value, byteArray, 5888, 12);

    raw_value = convertPhysicalToRaw(@CAN_RadarRL::RRL_Object::RRL_Object_Obj10.PxVyCoVnce, 0.005, -10.0);
    copyBitsToByteArrayLE(raw_value, byteArray, 5932, 12);

    raw_value = convertPhysicalToRaw(@CAN_RadarRL::RRL_Object::RRL_Object_Obj10.FilterInformation, 1.0, 0.0);
    copyBitsToByteArrayLE(raw_value, byteArray, 5944, 8);

    raw_value = convertPhysicalToRaw(@CAN_RadarRL::RRL_Object::RRL_Object_Obj10.PyVxCoVnce, 0.005, -10.0);
    copyBitsToByteArrayLE(raw_value, byteArray, 5952, 12);
}


void RRL_Object_Obj9_write(byte byteArray[])
{
    qword raw_value;

    raw_value = convertPhysicalToRaw(@CAN_RadarRL::RRL_Object::RRL_Object_Obj9.AxVnce, 0.005, 0.0);
    copyBitsToByteArrayLE(raw_value, byteArray, 5248, 12);

    raw_value = convertPhysicalToRaw(@CAN_RadarRL::RRL_Object::RRL_Object_Obj9.VxVnce, 0.005, 0.0);
    copyBitsToByteArrayLE(raw_value, byteArray, 5344, 12);

    raw_value = convertPhysicalToRaw(@CAN_RadarRL::RRL_Object::RRL_Object_Obj9.ObjId, 1.0, 0.0);
    copyBitsToByteArrayLE(raw_value, byteArray, 5336, 7);

    raw_value = convertPhysicalToRaw(@CAN_RadarRL::RRL_Object::RRL_Object_Obj9.Vx, 0.0625, -128.0);
    copyBitsToByteArrayLE(raw_value, byteArray, 5324, 12);

    raw_value = convertPhysicalToRaw(@CAN_RadarRL::RRL_Object::RRL_Object_Obj9.AyVnce, 0.005, 0.0);
    copyBitsToByteArrayLE(raw_value, byteArray, 5312, 12);

    raw_value = convertPhysicalToRaw(@CAN_RadarRL::RRL_Object::RRL_Object_Obj9.Ay, 0.0625, -16.0);
    copyBitsToByteArrayLE(raw_value, byteArray, 5302, 9);

    raw_value = convertPhysicalToRaw(@CAN_RadarRL::RRL_Object::RRL_Object_Obj9.RCS, 0.2, -102.4);
    copyBitsToByteArrayLE(raw_value, byteArray, 5292, 10);

    raw_value = convertPhysicalToRaw(@CAN_RadarRL::RRL_Object::RRL_Object_Obj9.WidthVnce, 0.005, 0.0);
    copyBitsToByteArrayLE(raw_value, byteArray, 5280, 12);

    raw_value = convertPhysicalToRaw(@CAN_RadarRL::RRL_Object::RRL_Object_Obj9.Width, 0.125, 0.0);
    copyBitsToByteArrayLE(raw_value, byteArray, 5272, 7);

    raw_value = convertPhysicalToRaw(@CAN_RadarRL::RRL_Object::RRL_Object_Obj9.OrientationYawVnce, 0.0003, 0.0);
    copyBitsToByteArrayLE(raw_value, byteArray, 5260, 12);

    raw_value = convertPhysicalToRaw(@CAN_RadarRL::RRL_Object::RRL_Object_Obj9.Vy, 0.125, -64.0);
    copyBitsToByteArrayLE(raw_value, byteArray, 5358, 10);

    raw_value = convertPhysicalToRaw(@CAN_RadarRL::RRL_Object::RRL_Object_Obj9.OrientationYaw, 0.0175, -4.48);
    copyBitsToByteArrayLE(raw_value, byteArray, 5238, 9);

    raw_value = convertPhysicalToRaw(@CAN_RadarRL::RRL_Object::RRL_Object_Obj9.Ax, 0.03125, -16.0);
    copyBitsToByteArrayLE(raw_value, byteArray, 5228, 10);

    raw_value = convertPhysicalToRaw(@CAN_RadarRL::RRL_Object::RRL_Object_Obj9.LengthVnce, 0.005, 0.0);
    copyBitsToByteArrayLE(raw_value, byteArray, 5216, 12);

    raw_value = convertPhysicalToRaw(@CAN_RadarRL::RRL_Object::RRL_Object_Obj9.Length, 0.125, 0.0);
    copyBitsToByteArrayLE(raw_value, byteArray, 5208, 7);

    raw_value = convertPhysicalToRaw(@CAN_RadarRL::RRL_Object::RRL_Object_Obj9.PyVnce, 0.005, 0.0);
    copyBitsToByteArrayLE(raw_value, byteArray, 5196, 12);

    raw_value = convertPhysicalToRaw(@CAN_RadarRL::RRL_Object::RRL_Object_Obj9.Py, 0.0625, -128.0);
    copyBitsToByteArrayLE(raw_value, byteArray, 5184, 12);

    raw_value = convertPhysicalToRaw(@CAN_RadarRL::RRL_Object::RRL_Object_Obj9.PxVnce, 0.005, 0.0);
    copyBitsToByteArrayLE(raw_value, byteArray, 5172, 12);

    raw_value = convertPhysicalToRaw(@CAN_RadarRL::RRL_Object::RRL_Object_Obj9.Px, 0.0625, -512.0);
    copyBitsToByteArrayLE(raw_value, byteArray, 5158, 14);

    raw_value = convertPhysicalToRaw(@CAN_RadarRL::RRL_Object::RRL_Object_Obj9.ProbClassConfidence, 2.0, 0.0);
    copyBitsToByteArrayLE(raw_value, byteArray, 5152, 6);

    raw_value = convertPhysicalToRaw(@CAN_RadarRL::RRL_Object::RRL_Object_Obj9.MovingStatus, 1.0, 0.0);
    copyBitsToByteArrayLE(raw_value, byteArray, 5356, 2);

    raw_value = convertPhysicalToRaw(@CAN_RadarRL::RRL_Object::RRL_Object_Obj9.AxAyCoVnce, 0.005, -10.0);
    copyBitsToByteArrayLE(raw_value, byteArray, 5612, 12);

    raw_value = convertPhysicalToRaw(@CAN_RadarRL::RRL_Object::RRL_Object_Obj9.ExistProb, 2.0, 0.0);
    copyBitsToByteArrayLE(raw_value, byteArray, 5368, 6);

    raw_value = convertPhysicalToRaw(@CAN_RadarRL::RRL_Object::RRL_Object_Obj9.PxAxCoVnce, 0.005, -10.0);
    copyBitsToByteArrayLE(raw_value, byteArray, 5472, 12);

    raw_value = convertPhysicalToRaw(@CAN_RadarRL::RRL_Object::RRL_Object_Obj9.VyVnce, 0.005, 0.0);
    copyBitsToByteArrayLE(raw_value, byteArray, 5376, 12);

    raw_value = convertPhysicalToRaw(@CAN_RadarRL::RRL_Object::RRL_Object_Obj9.VyAyCoVnce, 0.005, -10.0);
    copyBitsToByteArrayLE(raw_value, byteArray, 5600, 12);

    raw_value = convertPhysicalToRaw(@CAN_RadarRL::RRL_Object::RRL_Object_Obj9.VyAxCoVnce, 0.005, -10.0);
    copyBitsToByteArrayLE(raw_value, byteArray, 5580, 12);

    raw_value = convertPhysicalToRaw(@CAN_RadarRL::RRL_Object::RRL_Object_Obj9.VxAyCoVnce, 0.005, -10.0);
    copyBitsToByteArrayLE(raw_value, byteArray, 5568, 12);

    raw_value = convertPhysicalToRaw(@CAN_RadarRL::RRL_Object::RRL_Object_Obj9.VxAxCoVnce, 0.005, -10.0);
    copyBitsToByteArrayLE(raw_value, byteArray, 5548, 12);

    raw_value = convertPhysicalToRaw(@CAN_RadarRL::RRL_Object::RRL_Object_Obj9.VxVyCoVnce, 0.005, -10.0);
    copyBitsToByteArrayLE(raw_value, byteArray, 5536, 12);

    raw_value = convertPhysicalToRaw(@CAN_RadarRL::RRL_Object::RRL_Object_Obj9.PyAyCoVnce, 0.005, -10.0);
    copyBitsToByteArrayLE(raw_value, byteArray, 5516, 12);

    raw_value = convertPhysicalToRaw(@CAN_RadarRL::RRL_Object::RRL_Object_Obj9.PyAxCoVnce, 0.005, -10.0);
    copyBitsToByteArrayLE(raw_value, byteArray, 5504, 12);

    raw_value = convertPhysicalToRaw(@CAN_RadarRL::RRL_Object::RRL_Object_Obj9.PxAyCoVnce, 0.005, -10.0);
    copyBitsToByteArrayLE(raw_value, byteArray, 5484, 12);

    raw_value = convertPhysicalToRaw(@CAN_RadarRL::RRL_Object::RRL_Object_Obj9.Age, 1.0, 0.0);
    copyBitsToByteArrayLE(raw_value, byteArray, 5632, 32);

    raw_value = convertPhysicalToRaw(@CAN_RadarRL::RRL_Object::RRL_Object_Obj9.ReferencePoint, 1.0, 0.0);
    copyBitsToByteArrayLE(raw_value, byteArray, 5464, 4);

    raw_value = convertPhysicalToRaw(@CAN_RadarRL::RRL_Object::RRL_Object_Obj9.PxVxCoVnce, 0.005, -10.0);
    copyBitsToByteArrayLE(raw_value, byteArray, 5408, 12);

    raw_value = convertPhysicalToRaw(@CAN_RadarRL::RRL_Object::RRL_Object_Obj9.PyVyCoVnce, 0.005, -10.0);
    copyBitsToByteArrayLE(raw_value, byteArray, 5452, 12);

    raw_value = convertPhysicalToRaw(@CAN_RadarRL::RRL_Object::RRL_Object_Obj9.MeasurementStatus, 1.0, 0.0);
    copyBitsToByteArrayLE(raw_value, byteArray, 5400, 3);

    raw_value = convertPhysicalToRaw(@CAN_RadarRL::RRL_Object::RRL_Object_Obj9.ProbClassType, 1.0, 0.0);
    copyBitsToByteArrayLE(raw_value, byteArray, 5403, 4);

    raw_value = convertPhysicalToRaw(@CAN_RadarRL::RRL_Object::RRL_Object_Obj9.PxPyCoVnce, 0.005, -10.0);
    copyBitsToByteArrayLE(raw_value, byteArray, 5388, 12);

    raw_value = convertPhysicalToRaw(@CAN_RadarRL::RRL_Object::RRL_Object_Obj9.PxVyCoVnce, 0.005, -10.0);
    copyBitsToByteArrayLE(raw_value, byteArray, 5420, 12);

    raw_value = convertPhysicalToRaw(@CAN_RadarRL::RRL_Object::RRL_Object_Obj9.FilterInformation, 1.0, 0.0);
    copyBitsToByteArrayLE(raw_value, byteArray, 5432, 8);

    raw_value = convertPhysicalToRaw(@CAN_RadarRL::RRL_Object::RRL_Object_Obj9.PyVxCoVnce, 0.005, -10.0);
    copyBitsToByteArrayLE(raw_value, byteArray, 5440, 12);
}


void RRL_Object_Obj8_write(byte byteArray[])
{
    qword raw_value;

    raw_value = convertPhysicalToRaw(@CAN_RadarRL::RRL_Object::RRL_Object_Obj8.VxVnce, 0.005, 0.0);
    copyBitsToByteArrayLE(raw_value, byteArray, 4832, 12);

    raw_value = convertPhysicalToRaw(@CAN_RadarRL::RRL_Object::RRL_Object_Obj8.AxVnce, 0.005, 0.0);
    copyBitsToByteArrayLE(raw_value, byteArray, 4736, 12);

    raw_value = convertPhysicalToRaw(@CAN_RadarRL::RRL_Object::RRL_Object_Obj8.ObjId, 1.0, 0.0);
    copyBitsToByteArrayLE(raw_value, byteArray, 4824, 7);

    raw_value = convertPhysicalToRaw(@CAN_RadarRL::RRL_Object::RRL_Object_Obj8.Vx, 0.0625, -128.0);
    copyBitsToByteArrayLE(raw_value, byteArray, 4812, 12);

    raw_value = convertPhysicalToRaw(@CAN_RadarRL::RRL_Object::RRL_Object_Obj8.AyVnce, 0.005, 0.0);
    copyBitsToByteArrayLE(raw_value, byteArray, 4800, 12);

    raw_value = convertPhysicalToRaw(@CAN_RadarRL::RRL_Object::RRL_Object_Obj8.Ay, 0.0625, -16.0);
    copyBitsToByteArrayLE(raw_value, byteArray, 4790, 9);

    raw_value = convertPhysicalToRaw(@CAN_RadarRL::RRL_Object::RRL_Object_Obj8.RCS, 0.2, -102.4);
    copyBitsToByteArrayLE(raw_value, byteArray, 4780, 10);

    raw_value = convertPhysicalToRaw(@CAN_RadarRL::RRL_Object::RRL_Object_Obj8.WidthVnce, 0.005, 0.0);
    copyBitsToByteArrayLE(raw_value, byteArray, 4768, 12);

    raw_value = convertPhysicalToRaw(@CAN_RadarRL::RRL_Object::RRL_Object_Obj8.Width, 0.125, 0.0);
    copyBitsToByteArrayLE(raw_value, byteArray, 4760, 7);

    raw_value = convertPhysicalToRaw(@CAN_RadarRL::RRL_Object::RRL_Object_Obj8.OrientationYawVnce, 0.0003, 0.0);
    copyBitsToByteArrayLE(raw_value, byteArray, 4748, 12);

    raw_value = convertPhysicalToRaw(@CAN_RadarRL::RRL_Object::RRL_Object_Obj8.Length, 0.125, 0.0);
    copyBitsToByteArrayLE(raw_value, byteArray, 4696, 7);

    raw_value = convertPhysicalToRaw(@CAN_RadarRL::RRL_Object::RRL_Object_Obj8.OrientationYaw, 0.0175, -4.48);
    copyBitsToByteArrayLE(raw_value, byteArray, 4726, 9);

    raw_value = convertPhysicalToRaw(@CAN_RadarRL::RRL_Object::RRL_Object_Obj8.Ax, 0.03125, -16.0);
    copyBitsToByteArrayLE(raw_value, byteArray, 4716, 10);

    raw_value = convertPhysicalToRaw(@CAN_RadarRL::RRL_Object::RRL_Object_Obj8.LengthVnce, 0.005, 0.0);
    copyBitsToByteArrayLE(raw_value, byteArray, 4704, 12);

    raw_value = convertPhysicalToRaw(@CAN_RadarRL::RRL_Object::RRL_Object_Obj8.PyVnce, 0.005, 0.0);
    copyBitsToByteArrayLE(raw_value, byteArray, 4684, 12);

    raw_value = convertPhysicalToRaw(@CAN_RadarRL::RRL_Object::RRL_Object_Obj8.Py, 0.0625, -128.0);
    copyBitsToByteArrayLE(raw_value, byteArray, 4672, 12);

    raw_value = convertPhysicalToRaw(@CAN_RadarRL::RRL_Object::RRL_Object_Obj8.PxVnce, 0.005, 0.0);
    copyBitsToByteArrayLE(raw_value, byteArray, 4660, 12);

    raw_value = convertPhysicalToRaw(@CAN_RadarRL::RRL_Object::RRL_Object_Obj8.Px, 0.0625, -512.0);
    copyBitsToByteArrayLE(raw_value, byteArray, 4646, 14);

    raw_value = convertPhysicalToRaw(@CAN_RadarRL::RRL_Object::RRL_Object_Obj8.ProbClassConfidence, 2.0, 0.0);
    copyBitsToByteArrayLE(raw_value, byteArray, 4640, 6);

    raw_value = convertPhysicalToRaw(@CAN_RadarRL::RRL_Object::RRL_Object_Obj8.Vy, 0.125, -64.0);
    copyBitsToByteArrayLE(raw_value, byteArray, 4846, 10);

    raw_value = convertPhysicalToRaw(@CAN_RadarRL::RRL_Object::RRL_Object_Obj8.MovingStatus, 1.0, 0.0);
    copyBitsToByteArrayLE(raw_value, byteArray, 4844, 2);

    raw_value = convertPhysicalToRaw(@CAN_RadarRL::RRL_Object::RRL_Object_Obj8.Age, 1.0, 0.0);
    copyBitsToByteArrayLE(raw_value, byteArray, 5120, 32);

    raw_value = convertPhysicalToRaw(@CAN_RadarRL::RRL_Object::RRL_Object_Obj8.ExistProb, 2.0, 0.0);
    copyBitsToByteArrayLE(raw_value, byteArray, 4856, 6);

    raw_value = convertPhysicalToRaw(@CAN_RadarRL::RRL_Object::RRL_Object_Obj8.PxAxCoVnce, 0.005, -10.0);
    copyBitsToByteArrayLE(raw_value, byteArray, 4960, 12);

    raw_value = convertPhysicalToRaw(@CAN_RadarRL::RRL_Object::RRL_Object_Obj8.VyVnce, 0.005, 0.0);
    copyBitsToByteArrayLE(raw_value, byteArray, 4864, 12);

    raw_value = convertPhysicalToRaw(@CAN_RadarRL::RRL_Object::RRL_Object_Obj8.VyAyCoVnce, 0.005, -10.0);
    copyBitsToByteArrayLE(raw_value, byteArray, 5088, 12);

    raw_value = convertPhysicalToRaw(@CAN_RadarRL::RRL_Object::RRL_Object_Obj8.VyAxCoVnce, 0.005, -10.0);
    copyBitsToByteArrayLE(raw_value, byteArray, 5068, 12);

    raw_value = convertPhysicalToRaw(@CAN_RadarRL::RRL_Object::RRL_Object_Obj8.VxAyCoVnce, 0.005, -10.0);
    copyBitsToByteArrayLE(raw_value, byteArray, 5056, 12);

    raw_value = convertPhysicalToRaw(@CAN_RadarRL::RRL_Object::RRL_Object_Obj8.VxAxCoVnce, 0.005, -10.0);
    copyBitsToByteArrayLE(raw_value, byteArray, 5036, 12);

    raw_value = convertPhysicalToRaw(@CAN_RadarRL::RRL_Object::RRL_Object_Obj8.VxVyCoVnce, 0.005, -10.0);
    copyBitsToByteArrayLE(raw_value, byteArray, 5024, 12);

    raw_value = convertPhysicalToRaw(@CAN_RadarRL::RRL_Object::RRL_Object_Obj8.PyAyCoVnce, 0.005, -10.0);
    copyBitsToByteArrayLE(raw_value, byteArray, 5004, 12);

    raw_value = convertPhysicalToRaw(@CAN_RadarRL::RRL_Object::RRL_Object_Obj8.PyAxCoVnce, 0.005, -10.0);
    copyBitsToByteArrayLE(raw_value, byteArray, 4992, 12);

    raw_value = convertPhysicalToRaw(@CAN_RadarRL::RRL_Object::RRL_Object_Obj8.PxAyCoVnce, 0.005, -10.0);
    copyBitsToByteArrayLE(raw_value, byteArray, 4972, 12);

    raw_value = convertPhysicalToRaw(@CAN_RadarRL::RRL_Object::RRL_Object_Obj8.AxAyCoVnce, 0.005, -10.0);
    copyBitsToByteArrayLE(raw_value, byteArray, 5100, 12);

    raw_value = convertPhysicalToRaw(@CAN_RadarRL::RRL_Object::RRL_Object_Obj8.ReferencePoint, 1.0, 0.0);
    copyBitsToByteArrayLE(raw_value, byteArray, 4952, 4);

    raw_value = convertPhysicalToRaw(@CAN_RadarRL::RRL_Object::RRL_Object_Obj8.PyVxCoVnce, 0.005, -10.0);
    copyBitsToByteArrayLE(raw_value, byteArray, 4928, 12);

    raw_value = convertPhysicalToRaw(@CAN_RadarRL::RRL_Object::RRL_Object_Obj8.FilterInformation, 1.0, 0.0);
    copyBitsToByteArrayLE(raw_value, byteArray, 4920, 8);

    raw_value = convertPhysicalToRaw(@CAN_RadarRL::RRL_Object::RRL_Object_Obj8.PxVyCoVnce, 0.005, -10.0);
    copyBitsToByteArrayLE(raw_value, byteArray, 4908, 12);

    raw_value = convertPhysicalToRaw(@CAN_RadarRL::RRL_Object::RRL_Object_Obj8.PxVxCoVnce, 0.005, -10.0);
    copyBitsToByteArrayLE(raw_value, byteArray, 4896, 12);

    raw_value = convertPhysicalToRaw(@CAN_RadarRL::RRL_Object::RRL_Object_Obj8.ProbClassType, 1.0, 0.0);
    copyBitsToByteArrayLE(raw_value, byteArray, 4891, 4);

    raw_value = convertPhysicalToRaw(@CAN_RadarRL::RRL_Object::RRL_Object_Obj8.MeasurementStatus, 1.0, 0.0);
    copyBitsToByteArrayLE(raw_value, byteArray, 4888, 3);

    raw_value = convertPhysicalToRaw(@CAN_RadarRL::RRL_Object::RRL_Object_Obj8.PxPyCoVnce, 0.005, -10.0);
    copyBitsToByteArrayLE(raw_value, byteArray, 4876, 12);

    raw_value = convertPhysicalToRaw(@CAN_RadarRL::RRL_Object::RRL_Object_Obj8.PyVyCoVnce, 0.005, -10.0);
    copyBitsToByteArrayLE(raw_value, byteArray, 4940, 12);
}


void RRL_Object_Obj7_write(byte byteArray[])
{
    qword raw_value;

    raw_value = convertPhysicalToRaw(@CAN_RadarRL::RRL_Object::RRL_Object_Obj7.Ay, 0.0625, -16.0);
    copyBitsToByteArrayLE(raw_value, byteArray, 4278, 9);

    raw_value = convertPhysicalToRaw(@CAN_RadarRL::RRL_Object::RRL_Object_Obj7.WidthVnce, 0.005, 0.0);
    copyBitsToByteArrayLE(raw_value, byteArray, 4256, 12);

    raw_value = convertPhysicalToRaw(@CAN_RadarRL::RRL_Object::RRL_Object_Obj7.RCS, 0.2, -102.4);
    copyBitsToByteArrayLE(raw_value, byteArray, 4268, 10);

    raw_value = convertPhysicalToRaw(@CAN_RadarRL::RRL_Object::RRL_Object_Obj7.VxVnce, 0.005, 0.0);
    copyBitsToByteArrayLE(raw_value, byteArray, 4320, 12);

    raw_value = convertPhysicalToRaw(@CAN_RadarRL::RRL_Object::RRL_Object_Obj7.AyVnce, 0.005, 0.0);
    copyBitsToByteArrayLE(raw_value, byteArray, 4288, 12);

    raw_value = convertPhysicalToRaw(@CAN_RadarRL::RRL_Object::RRL_Object_Obj7.Vx, 0.0625, -128.0);
    copyBitsToByteArrayLE(raw_value, byteArray, 4300, 12);

    raw_value = convertPhysicalToRaw(@CAN_RadarRL::RRL_Object::RRL_Object_Obj7.ObjId, 1.0, 0.0);
    copyBitsToByteArrayLE(raw_value, byteArray, 4312, 7);

    raw_value = convertPhysicalToRaw(@CAN_RadarRL::RRL_Object::RRL_Object_Obj7.OrientationYawVnce, 0.0003, 0.0);
    copyBitsToByteArrayLE(raw_value, byteArray, 4236, 12);

    raw_value = convertPhysicalToRaw(@CAN_RadarRL::RRL_Object::RRL_Object_Obj7.Width, 0.125, 0.0);
    copyBitsToByteArrayLE(raw_value, byteArray, 4248, 7);

    raw_value = convertPhysicalToRaw(@CAN_RadarRL::RRL_Object::RRL_Object_Obj7.Length, 0.125, 0.0);
    copyBitsToByteArrayLE(raw_value, byteArray, 4184, 7);

    raw_value = convertPhysicalToRaw(@CAN_RadarRL::RRL_Object::RRL_Object_Obj7.AxVnce, 0.005, 0.0);
    copyBitsToByteArrayLE(raw_value, byteArray, 4224, 12);

    raw_value = convertPhysicalToRaw(@CAN_RadarRL::RRL_Object::RRL_Object_Obj7.OrientationYaw, 0.0175, -4.48);
    copyBitsToByteArrayLE(raw_value, byteArray, 4214, 9);

    raw_value = convertPhysicalToRaw(@CAN_RadarRL::RRL_Object::RRL_Object_Obj7.Ax, 0.03125, -16.0);
    copyBitsToByteArrayLE(raw_value, byteArray, 4204, 10);

    raw_value = convertPhysicalToRaw(@CAN_RadarRL::RRL_Object::RRL_Object_Obj7.LengthVnce, 0.005, 0.0);
    copyBitsToByteArrayLE(raw_value, byteArray, 4192, 12);

    raw_value = convertPhysicalToRaw(@CAN_RadarRL::RRL_Object::RRL_Object_Obj7.PyVnce, 0.005, 0.0);
    copyBitsToByteArrayLE(raw_value, byteArray, 4172, 12);

    raw_value = convertPhysicalToRaw(@CAN_RadarRL::RRL_Object::RRL_Object_Obj7.Py, 0.0625, -128.0);
    copyBitsToByteArrayLE(raw_value, byteArray, 4160, 12);

    raw_value = convertPhysicalToRaw(@CAN_RadarRL::RRL_Object::RRL_Object_Obj7.PxVnce, 0.005, 0.0);
    copyBitsToByteArrayLE(raw_value, byteArray, 4148, 12);

    raw_value = convertPhysicalToRaw(@CAN_RadarRL::RRL_Object::RRL_Object_Obj7.Px, 0.0625, -512.0);
    copyBitsToByteArrayLE(raw_value, byteArray, 4134, 14);

    raw_value = convertPhysicalToRaw(@CAN_RadarRL::RRL_Object::RRL_Object_Obj7.ProbClassConfidence, 2.0, 0.0);
    copyBitsToByteArrayLE(raw_value, byteArray, 4128, 6);

    raw_value = convertPhysicalToRaw(@CAN_RadarRL::RRL_Object::RRL_Object_Obj7.MovingStatus, 1.0, 0.0);
    copyBitsToByteArrayLE(raw_value, byteArray, 4332, 2);

    raw_value = convertPhysicalToRaw(@CAN_RadarRL::RRL_Object::RRL_Object_Obj7.Vy, 0.125, -64.0);
    copyBitsToByteArrayLE(raw_value, byteArray, 4334, 10);

    raw_value = convertPhysicalToRaw(@CAN_RadarRL::RRL_Object::RRL_Object_Obj7.ExistProb, 2.0, 0.0);
    copyBitsToByteArrayLE(raw_value, byteArray, 4344, 6);

    raw_value = convertPhysicalToRaw(@CAN_RadarRL::RRL_Object::RRL_Object_Obj7.PxAyCoVnce, 0.005, -10.0);
    copyBitsToByteArrayLE(raw_value, byteArray, 4460, 12);

    raw_value = convertPhysicalToRaw(@CAN_RadarRL::RRL_Object::RRL_Object_Obj7.Age, 1.0, 0.0);
    copyBitsToByteArrayLE(raw_value, byteArray, 4608, 32);

    raw_value = convertPhysicalToRaw(@CAN_RadarRL::RRL_Object::RRL_Object_Obj7.VyVnce, 0.005, 0.0);
    copyBitsToByteArrayLE(raw_value, byteArray, 4352, 12);

    raw_value = convertPhysicalToRaw(@CAN_RadarRL::RRL_Object::RRL_Object_Obj7.AxAyCoVnce, 0.005, -10.0);
    copyBitsToByteArrayLE(raw_value, byteArray, 4588, 12);

    raw_value = convertPhysicalToRaw(@CAN_RadarRL::RRL_Object::RRL_Object_Obj7.VyAyCoVnce, 0.005, -10.0);
    copyBitsToByteArrayLE(raw_value, byteArray, 4576, 12);

    raw_value = convertPhysicalToRaw(@CAN_RadarRL::RRL_Object::RRL_Object_Obj7.VyAxCoVnce, 0.005, -10.0);
    copyBitsToByteArrayLE(raw_value, byteArray, 4556, 12);

    raw_value = convertPhysicalToRaw(@CAN_RadarRL::RRL_Object::RRL_Object_Obj7.VxAyCoVnce, 0.005, -10.0);
    copyBitsToByteArrayLE(raw_value, byteArray, 4544, 12);

    raw_value = convertPhysicalToRaw(@CAN_RadarRL::RRL_Object::RRL_Object_Obj7.VxAxCoVnce, 0.005, -10.0);
    copyBitsToByteArrayLE(raw_value, byteArray, 4524, 12);

    raw_value = convertPhysicalToRaw(@CAN_RadarRL::RRL_Object::RRL_Object_Obj7.PyAyCoVnce, 0.005, -10.0);
    copyBitsToByteArrayLE(raw_value, byteArray, 4492, 12);

    raw_value = convertPhysicalToRaw(@CAN_RadarRL::RRL_Object::RRL_Object_Obj7.PyAxCoVnce, 0.005, -10.0);
    copyBitsToByteArrayLE(raw_value, byteArray, 4480, 12);

    raw_value = convertPhysicalToRaw(@CAN_RadarRL::RRL_Object::RRL_Object_Obj7.VxVyCoVnce, 0.005, -10.0);
    copyBitsToByteArrayLE(raw_value, byteArray, 4512, 12);

    raw_value = convertPhysicalToRaw(@CAN_RadarRL::RRL_Object::RRL_Object_Obj7.PxAxCoVnce, 0.005, -10.0);
    copyBitsToByteArrayLE(raw_value, byteArray, 4448, 12);

    raw_value = convertPhysicalToRaw(@CAN_RadarRL::RRL_Object::RRL_Object_Obj7.PxVyCoVnce, 0.005, -10.0);
    copyBitsToByteArrayLE(raw_value, byteArray, 4396, 12);

    raw_value = convertPhysicalToRaw(@CAN_RadarRL::RRL_Object::RRL_Object_Obj7.PxPyCoVnce, 0.005, -10.0);
    copyBitsToByteArrayLE(raw_value, byteArray, 4364, 12);

    raw_value = convertPhysicalToRaw(@CAN_RadarRL::RRL_Object::RRL_Object_Obj7.ReferencePoint, 1.0, 0.0);
    copyBitsToByteArrayLE(raw_value, byteArray, 4440, 4);

    raw_value = convertPhysicalToRaw(@CAN_RadarRL::RRL_Object::RRL_Object_Obj7.ProbClassType, 1.0, 0.0);
    copyBitsToByteArrayLE(raw_value, byteArray, 4379, 4);

    raw_value = convertPhysicalToRaw(@CAN_RadarRL::RRL_Object::RRL_Object_Obj7.PxVxCoVnce, 0.005, -10.0);
    copyBitsToByteArrayLE(raw_value, byteArray, 4384, 12);

    raw_value = convertPhysicalToRaw(@CAN_RadarRL::RRL_Object::RRL_Object_Obj7.MeasurementStatus, 1.0, 0.0);
    copyBitsToByteArrayLE(raw_value, byteArray, 4376, 3);

    raw_value = convertPhysicalToRaw(@CAN_RadarRL::RRL_Object::RRL_Object_Obj7.FilterInformation, 1.0, 0.0);
    copyBitsToByteArrayLE(raw_value, byteArray, 4408, 8);

    raw_value = convertPhysicalToRaw(@CAN_RadarRL::RRL_Object::RRL_Object_Obj7.PyVxCoVnce, 0.005, -10.0);
    copyBitsToByteArrayLE(raw_value, byteArray, 4416, 12);

    raw_value = convertPhysicalToRaw(@CAN_RadarRL::RRL_Object::RRL_Object_Obj7.PyVyCoVnce, 0.005, -10.0);
    copyBitsToByteArrayLE(raw_value, byteArray, 4428, 12);
}


void RRL_Object_Obj6_write(byte byteArray[])
{
    qword raw_value;

    raw_value = convertPhysicalToRaw(@CAN_RadarRL::RRL_Object::RRL_Object_Obj6.Width, 0.125, 0.0);
    copyBitsToByteArrayLE(raw_value, byteArray, 3736, 7);

    raw_value = convertPhysicalToRaw(@CAN_RadarRL::RRL_Object::RRL_Object_Obj6.VxVnce, 0.005, 0.0);
    copyBitsToByteArrayLE(raw_value, byteArray, 3808, 12);

    raw_value = convertPhysicalToRaw(@CAN_RadarRL::RRL_Object::RRL_Object_Obj6.ObjId, 1.0, 0.0);
    copyBitsToByteArrayLE(raw_value, byteArray, 3800, 7);

    raw_value = convertPhysicalToRaw(@CAN_RadarRL::RRL_Object::RRL_Object_Obj6.Vx, 0.0625, -128.0);
    copyBitsToByteArrayLE(raw_value, byteArray, 3788, 12);

    raw_value = convertPhysicalToRaw(@CAN_RadarRL::RRL_Object::RRL_Object_Obj6.AyVnce, 0.005, 0.0);
    copyBitsToByteArrayLE(raw_value, byteArray, 3776, 12);

    raw_value = convertPhysicalToRaw(@CAN_RadarRL::RRL_Object::RRL_Object_Obj6.Ay, 0.0625, -16.0);
    copyBitsToByteArrayLE(raw_value, byteArray, 3766, 9);

    raw_value = convertPhysicalToRaw(@CAN_RadarRL::RRL_Object::RRL_Object_Obj6.RCS, 0.2, -102.4);
    copyBitsToByteArrayLE(raw_value, byteArray, 3756, 10);

    raw_value = convertPhysicalToRaw(@CAN_RadarRL::RRL_Object::RRL_Object_Obj6.Vy, 0.125, -64.0);
    copyBitsToByteArrayLE(raw_value, byteArray, 3822, 10);

    raw_value = convertPhysicalToRaw(@CAN_RadarRL::RRL_Object::RRL_Object_Obj6.WidthVnce, 0.005, 0.0);
    copyBitsToByteArrayLE(raw_value, byteArray, 3744, 12);

    raw_value = convertPhysicalToRaw(@CAN_RadarRL::RRL_Object::RRL_Object_Obj6.ProbClassConfidence, 2.0, 0.0);
    copyBitsToByteArrayLE(raw_value, byteArray, 3616, 6);

    raw_value = convertPhysicalToRaw(@CAN_RadarRL::RRL_Object::RRL_Object_Obj6.OrientationYawVnce, 0.0003, 0.0);
    copyBitsToByteArrayLE(raw_value, byteArray, 3724, 12);

    raw_value = convertPhysicalToRaw(@CAN_RadarRL::RRL_Object::RRL_Object_Obj6.AxVnce, 0.005, 0.0);
    copyBitsToByteArrayLE(raw_value, byteArray, 3712, 12);

    raw_value = convertPhysicalToRaw(@CAN_RadarRL::RRL_Object::RRL_Object_Obj6.OrientationYaw, 0.0175, -4.48);
    copyBitsToByteArrayLE(raw_value, byteArray, 3702, 9);

    raw_value = convertPhysicalToRaw(@CAN_RadarRL::RRL_Object::RRL_Object_Obj6.LengthVnce, 0.005, 0.0);
    copyBitsToByteArrayLE(raw_value, byteArray, 3680, 12);

    raw_value = convertPhysicalToRaw(@CAN_RadarRL::RRL_Object::RRL_Object_Obj6.Length, 0.125, 0.0);
    copyBitsToByteArrayLE(raw_value, byteArray, 3672, 7);

    raw_value = convertPhysicalToRaw(@CAN_RadarRL::RRL_Object::RRL_Object_Obj6.PyVnce, 0.005, 0.0);
    copyBitsToByteArrayLE(raw_value, byteArray, 3660, 12);

    raw_value = convertPhysicalToRaw(@CAN_RadarRL::RRL_Object::RRL_Object_Obj6.Py, 0.0625, -128.0);
    copyBitsToByteArrayLE(raw_value, byteArray, 3648, 12);

    raw_value = convertPhysicalToRaw(@CAN_RadarRL::RRL_Object::RRL_Object_Obj6.PxVnce, 0.005, 0.0);
    copyBitsToByteArrayLE(raw_value, byteArray, 3636, 12);

    raw_value = convertPhysicalToRaw(@CAN_RadarRL::RRL_Object::RRL_Object_Obj6.Px, 0.0625, -512.0);
    copyBitsToByteArrayLE(raw_value, byteArray, 3622, 14);

    raw_value = convertPhysicalToRaw(@CAN_RadarRL::RRL_Object::RRL_Object_Obj6.MovingStatus, 1.0, 0.0);
    copyBitsToByteArrayLE(raw_value, byteArray, 3820, 2);

    raw_value = convertPhysicalToRaw(@CAN_RadarRL::RRL_Object::RRL_Object_Obj6.Ax, 0.03125, -16.0);
    copyBitsToByteArrayLE(raw_value, byteArray, 3692, 10);

    raw_value = convertPhysicalToRaw(@CAN_RadarRL::RRL_Object::RRL_Object_Obj6.ExistProb, 2.0, 0.0);
    copyBitsToByteArrayLE(raw_value, byteArray, 3832, 6);

    raw_value = convertPhysicalToRaw(@CAN_RadarRL::RRL_Object::RRL_Object_Obj6.PyAxCoVnce, 0.005, -10.0);
    copyBitsToByteArrayLE(raw_value, byteArray, 3968, 12);

    raw_value = convertPhysicalToRaw(@CAN_RadarRL::RRL_Object::RRL_Object_Obj6.VyVnce, 0.005, 0.0);
    copyBitsToByteArrayLE(raw_value, byteArray, 3840, 12);

    raw_value = convertPhysicalToRaw(@CAN_RadarRL::RRL_Object::RRL_Object_Obj6.Age, 1.0, 0.0);
    copyBitsToByteArrayLE(raw_value, byteArray, 4096, 32);

    raw_value = convertPhysicalToRaw(@CAN_RadarRL::RRL_Object::RRL_Object_Obj6.AxAyCoVnce, 0.005, -10.0);
    copyBitsToByteArrayLE(raw_value, byteArray, 4076, 12);

    raw_value = convertPhysicalToRaw(@CAN_RadarRL::RRL_Object::RRL_Object_Obj6.VyAyCoVnce, 0.005, -10.0);
    copyBitsToByteArrayLE(raw_value, byteArray, 4064, 12);

    raw_value = convertPhysicalToRaw(@CAN_RadarRL::RRL_Object::RRL_Object_Obj6.VyAxCoVnce, 0.005, -10.0);
    copyBitsToByteArrayLE(raw_value, byteArray, 4044, 12);

    raw_value = convertPhysicalToRaw(@CAN_RadarRL::RRL_Object::RRL_Object_Obj6.VxAyCoVnce, 0.005, -10.0);
    copyBitsToByteArrayLE(raw_value, byteArray, 4032, 12);

    raw_value = convertPhysicalToRaw(@CAN_RadarRL::RRL_Object::RRL_Object_Obj6.VxAxCoVnce, 0.005, -10.0);
    copyBitsToByteArrayLE(raw_value, byteArray, 4012, 12);

    raw_value = convertPhysicalToRaw(@CAN_RadarRL::RRL_Object::RRL_Object_Obj6.VxVyCoVnce, 0.005, -10.0);
    copyBitsToByteArrayLE(raw_value, byteArray, 4000, 12);

    raw_value = convertPhysicalToRaw(@CAN_RadarRL::RRL_Object::RRL_Object_Obj6.PyAyCoVnce, 0.005, -10.0);
    copyBitsToByteArrayLE(raw_value, byteArray, 3980, 12);

    raw_value = convertPhysicalToRaw(@CAN_RadarRL::RRL_Object::RRL_Object_Obj6.PyVxCoVnce, 0.005, -10.0);
    copyBitsToByteArrayLE(raw_value, byteArray, 3904, 12);

    raw_value = convertPhysicalToRaw(@CAN_RadarRL::RRL_Object::RRL_Object_Obj6.PxAyCoVnce, 0.005, -10.0);
    copyBitsToByteArrayLE(raw_value, byteArray, 3948, 12);

    raw_value = convertPhysicalToRaw(@CAN_RadarRL::RRL_Object::RRL_Object_Obj6.PxVxCoVnce, 0.005, -10.0);
    copyBitsToByteArrayLE(raw_value, byteArray, 3872, 12);

    raw_value = convertPhysicalToRaw(@CAN_RadarRL::RRL_Object::RRL_Object_Obj6.PxAxCoVnce, 0.005, -10.0);
    copyBitsToByteArrayLE(raw_value, byteArray, 3936, 12);

    raw_value = convertPhysicalToRaw(@CAN_RadarRL::RRL_Object::RRL_Object_Obj6.MeasurementStatus, 1.0, 0.0);
    copyBitsToByteArrayLE(raw_value, byteArray, 3864, 3);

    raw_value = convertPhysicalToRaw(@CAN_RadarRL::RRL_Object::RRL_Object_Obj6.ProbClassType, 1.0, 0.0);
    copyBitsToByteArrayLE(raw_value, byteArray, 3867, 4);

    raw_value = convertPhysicalToRaw(@CAN_RadarRL::RRL_Object::RRL_Object_Obj6.PxPyCoVnce, 0.005, -10.0);
    copyBitsToByteArrayLE(raw_value, byteArray, 3852, 12);

    raw_value = convertPhysicalToRaw(@CAN_RadarRL::RRL_Object::RRL_Object_Obj6.PxVyCoVnce, 0.005, -10.0);
    copyBitsToByteArrayLE(raw_value, byteArray, 3884, 12);

    raw_value = convertPhysicalToRaw(@CAN_RadarRL::RRL_Object::RRL_Object_Obj6.FilterInformation, 1.0, 0.0);
    copyBitsToByteArrayLE(raw_value, byteArray, 3896, 8);

    raw_value = convertPhysicalToRaw(@CAN_RadarRL::RRL_Object::RRL_Object_Obj6.PyVyCoVnce, 0.005, -10.0);
    copyBitsToByteArrayLE(raw_value, byteArray, 3916, 12);

    raw_value = convertPhysicalToRaw(@CAN_RadarRL::RRL_Object::RRL_Object_Obj6.ReferencePoint, 1.0, 0.0);
    copyBitsToByteArrayLE(raw_value, byteArray, 3928, 4);
}


void RRL_Object_Obj5_write(byte byteArray[])
{
    qword raw_value;

    raw_value = convertPhysicalToRaw(@CAN_RadarRL::RRL_Object::RRL_Object_Obj5.AxVnce, 0.005, 0.0);
    copyBitsToByteArrayLE(raw_value, byteArray, 3200, 12);

    raw_value = convertPhysicalToRaw(@CAN_RadarRL::RRL_Object::RRL_Object_Obj5.VxVnce, 0.005, 0.0);
    copyBitsToByteArrayLE(raw_value, byteArray, 3296, 12);

    raw_value = convertPhysicalToRaw(@CAN_RadarRL::RRL_Object::RRL_Object_Obj5.ObjId, 1.0, 0.0);
    copyBitsToByteArrayLE(raw_value, byteArray, 3288, 7);

    raw_value = convertPhysicalToRaw(@CAN_RadarRL::RRL_Object::RRL_Object_Obj5.Vx, 0.0625, -128.0);
    copyBitsToByteArrayLE(raw_value, byteArray, 3276, 12);

    raw_value = convertPhysicalToRaw(@CAN_RadarRL::RRL_Object::RRL_Object_Obj5.AyVnce, 0.005, 0.0);
    copyBitsToByteArrayLE(raw_value, byteArray, 3264, 12);

    raw_value = convertPhysicalToRaw(@CAN_RadarRL::RRL_Object::RRL_Object_Obj5.RCS, 0.2, -102.4);
    copyBitsToByteArrayLE(raw_value, byteArray, 3244, 10);

    raw_value = convertPhysicalToRaw(@CAN_RadarRL::RRL_Object::RRL_Object_Obj5.WidthVnce, 0.005, 0.0);
    copyBitsToByteArrayLE(raw_value, byteArray, 3232, 12);

    raw_value = convertPhysicalToRaw(@CAN_RadarRL::RRL_Object::RRL_Object_Obj5.Width, 0.125, 0.0);
    copyBitsToByteArrayLE(raw_value, byteArray, 3224, 7);

    raw_value = convertPhysicalToRaw(@CAN_RadarRL::RRL_Object::RRL_Object_Obj5.OrientationYawVnce, 0.0003, 0.0);
    copyBitsToByteArrayLE(raw_value, byteArray, 3212, 12);

    raw_value = convertPhysicalToRaw(@CAN_RadarRL::RRL_Object::RRL_Object_Obj5.PyVnce, 0.005, 0.0);
    copyBitsToByteArrayLE(raw_value, byteArray, 3148, 12);

    raw_value = convertPhysicalToRaw(@CAN_RadarRL::RRL_Object::RRL_Object_Obj5.OrientationYaw, 0.0175, -4.48);
    copyBitsToByteArrayLE(raw_value, byteArray, 3190, 9);

    raw_value = convertPhysicalToRaw(@CAN_RadarRL::RRL_Object::RRL_Object_Obj5.Ax, 0.03125, -16.0);
    copyBitsToByteArrayLE(raw_value, byteArray, 3180, 10);

    raw_value = convertPhysicalToRaw(@CAN_RadarRL::RRL_Object::RRL_Object_Obj5.LengthVnce, 0.005, 0.0);
    copyBitsToByteArrayLE(raw_value, byteArray, 3168, 12);

    raw_value = convertPhysicalToRaw(@CAN_RadarRL::RRL_Object::RRL_Object_Obj5.Length, 0.125, 0.0);
    copyBitsToByteArrayLE(raw_value, byteArray, 3160, 7);

    raw_value = convertPhysicalToRaw(@CAN_RadarRL::RRL_Object::RRL_Object_Obj5.Vy, 0.125, -64.0);
    copyBitsToByteArrayLE(raw_value, byteArray, 3310, 10);

    raw_value = convertPhysicalToRaw(@CAN_RadarRL::RRL_Object::RRL_Object_Obj5.Py, 0.0625, -128.0);
    copyBitsToByteArrayLE(raw_value, byteArray, 3136, 12);

    raw_value = convertPhysicalToRaw(@CAN_RadarRL::RRL_Object::RRL_Object_Obj5.PxVnce, 0.005, 0.0);
    copyBitsToByteArrayLE(raw_value, byteArray, 3124, 12);

    raw_value = convertPhysicalToRaw(@CAN_RadarRL::RRL_Object::RRL_Object_Obj5.Px, 0.0625, -512.0);
    copyBitsToByteArrayLE(raw_value, byteArray, 3110, 14);

    raw_value = convertPhysicalToRaw(@CAN_RadarRL::RRL_Object::RRL_Object_Obj5.ProbClassConfidence, 2.0, 0.0);
    copyBitsToByteArrayLE(raw_value, byteArray, 3104, 6);

    raw_value = convertPhysicalToRaw(@CAN_RadarRL::RRL_Object::RRL_Object_Obj5.MovingStatus, 1.0, 0.0);
    copyBitsToByteArrayLE(raw_value, byteArray, 3308, 2);

    raw_value = convertPhysicalToRaw(@CAN_RadarRL::RRL_Object::RRL_Object_Obj5.Ay, 0.0625, -16.0);
    copyBitsToByteArrayLE(raw_value, byteArray, 3254, 9);

    raw_value = convertPhysicalToRaw(@CAN_RadarRL::RRL_Object::RRL_Object_Obj5.ExistProb, 2.0, 0.0);
    copyBitsToByteArrayLE(raw_value, byteArray, 3320, 6);

    raw_value = convertPhysicalToRaw(@CAN_RadarRL::RRL_Object::RRL_Object_Obj5.PxAxCoVnce, 0.005, -10.0);
    copyBitsToByteArrayLE(raw_value, byteArray, 3424, 12);

    raw_value = convertPhysicalToRaw(@CAN_RadarRL::RRL_Object::RRL_Object_Obj5.Age, 1.0, 0.0);
    copyBitsToByteArrayLE(raw_value, byteArray, 3584, 32);

    raw_value = convertPhysicalToRaw(@CAN_RadarRL::RRL_Object::RRL_Object_Obj5.VyVnce, 0.005, 0.0);
    copyBitsToByteArrayLE(raw_value, byteArray, 3328, 12);

    raw_value = convertPhysicalToRaw(@CAN_RadarRL::RRL_Object::RRL_Object_Obj5.VyAyCoVnce, 0.005, -10.0);
    copyBitsToByteArrayLE(raw_value, byteArray, 3552, 12);

    raw_value = convertPhysicalToRaw(@CAN_RadarRL::RRL_Object::RRL_Object_Obj5.VyAxCoVnce, 0.005, -10.0);
    copyBitsToByteArrayLE(raw_value, byteArray, 3532, 12);

    raw_value = convertPhysicalToRaw(@CAN_RadarRL::RRL_Object::RRL_Object_Obj5.VxAyCoVnce, 0.005, -10.0);
    copyBitsToByteArrayLE(raw_value, byteArray, 3520, 12);

    raw_value = convertPhysicalToRaw(@CAN_RadarRL::RRL_Object::RRL_Object_Obj5.VxAxCoVnce, 0.005, -10.0);
    copyBitsToByteArrayLE(raw_value, byteArray, 3500, 12);

    raw_value = convertPhysicalToRaw(@CAN_RadarRL::RRL_Object::RRL_Object_Obj5.VxVyCoVnce, 0.005, -10.0);
    copyBitsToByteArrayLE(raw_value, byteArray, 3488, 12);

    raw_value = convertPhysicalToRaw(@CAN_RadarRL::RRL_Object::RRL_Object_Obj5.PyAyCoVnce, 0.005, -10.0);
    copyBitsToByteArrayLE(raw_value, byteArray, 3468, 12);

    raw_value = convertPhysicalToRaw(@CAN_RadarRL::RRL_Object::RRL_Object_Obj5.PyAxCoVnce, 0.005, -10.0);
    copyBitsToByteArrayLE(raw_value, byteArray, 3456, 12);

    raw_value = convertPhysicalToRaw(@CAN_RadarRL::RRL_Object::RRL_Object_Obj5.PxAyCoVnce, 0.005, -10.0);
    copyBitsToByteArrayLE(raw_value, byteArray, 3436, 12);

    raw_value = convertPhysicalToRaw(@CAN_RadarRL::RRL_Object::RRL_Object_Obj5.AxAyCoVnce, 0.005, -10.0);
    copyBitsToByteArrayLE(raw_value, byteArray, 3564, 12);

    raw_value = convertPhysicalToRaw(@CAN_RadarRL::RRL_Object::RRL_Object_Obj5.ReferencePoint, 1.0, 0.0);
    copyBitsToByteArrayLE(raw_value, byteArray, 3416, 4);

    raw_value = convertPhysicalToRaw(@CAN_RadarRL::RRL_Object::RRL_Object_Obj5.PxVxCoVnce, 0.005, -10.0);
    copyBitsToByteArrayLE(raw_value, byteArray, 3360, 12);

    raw_value = convertPhysicalToRaw(@CAN_RadarRL::RRL_Object::RRL_Object_Obj5.PyVyCoVnce, 0.005, -10.0);
    copyBitsToByteArrayLE(raw_value, byteArray, 3404, 12);

    raw_value = convertPhysicalToRaw(@CAN_RadarRL::RRL_Object::RRL_Object_Obj5.MeasurementStatus, 1.0, 0.0);
    copyBitsToByteArrayLE(raw_value, byteArray, 3352, 3);

    raw_value = convertPhysicalToRaw(@CAN_RadarRL::RRL_Object::RRL_Object_Obj5.ProbClassType, 1.0, 0.0);
    copyBitsToByteArrayLE(raw_value, byteArray, 3355, 4);

    raw_value = convertPhysicalToRaw(@CAN_RadarRL::RRL_Object::RRL_Object_Obj5.PxPyCoVnce, 0.005, -10.0);
    copyBitsToByteArrayLE(raw_value, byteArray, 3340, 12);

    raw_value = convertPhysicalToRaw(@CAN_RadarRL::RRL_Object::RRL_Object_Obj5.PxVyCoVnce, 0.005, -10.0);
    copyBitsToByteArrayLE(raw_value, byteArray, 3372, 12);

    raw_value = convertPhysicalToRaw(@CAN_RadarRL::RRL_Object::RRL_Object_Obj5.FilterInformation, 1.0, 0.0);
    copyBitsToByteArrayLE(raw_value, byteArray, 3384, 8);

    raw_value = convertPhysicalToRaw(@CAN_RadarRL::RRL_Object::RRL_Object_Obj5.PyVxCoVnce, 0.005, -10.0);
    copyBitsToByteArrayLE(raw_value, byteArray, 3392, 12);
}


void RRL_Object_Obj4_write(byte byteArray[])
{
    qword raw_value;

    raw_value = convertPhysicalToRaw(@CAN_RadarRL::RRL_Object::RRL_Object_Obj4.VxVnce, 0.005, 0.0);
    copyBitsToByteArrayLE(raw_value, byteArray, 2784, 12);

    raw_value = convertPhysicalToRaw(@CAN_RadarRL::RRL_Object::RRL_Object_Obj4.AxVnce, 0.005, 0.0);
    copyBitsToByteArrayLE(raw_value, byteArray, 2688, 12);

    raw_value = convertPhysicalToRaw(@CAN_RadarRL::RRL_Object::RRL_Object_Obj4.ObjId, 1.0, 0.0);
    copyBitsToByteArrayLE(raw_value, byteArray, 2776, 7);

    raw_value = convertPhysicalToRaw(@CAN_RadarRL::RRL_Object::RRL_Object_Obj4.Vx, 0.0625, -128.0);
    copyBitsToByteArrayLE(raw_value, byteArray, 2764, 12);

    raw_value = convertPhysicalToRaw(@CAN_RadarRL::RRL_Object::RRL_Object_Obj4.AyVnce, 0.005, 0.0);
    copyBitsToByteArrayLE(raw_value, byteArray, 2752, 12);

    raw_value = convertPhysicalToRaw(@CAN_RadarRL::RRL_Object::RRL_Object_Obj4.Ay, 0.0625, -16.0);
    copyBitsToByteArrayLE(raw_value, byteArray, 2742, 9);

    raw_value = convertPhysicalToRaw(@CAN_RadarRL::RRL_Object::RRL_Object_Obj4.RCS, 0.2, -102.4);
    copyBitsToByteArrayLE(raw_value, byteArray, 2732, 10);

    raw_value = convertPhysicalToRaw(@CAN_RadarRL::RRL_Object::RRL_Object_Obj4.WidthVnce, 0.005, 0.0);
    copyBitsToByteArrayLE(raw_value, byteArray, 2720, 12);

    raw_value = convertPhysicalToRaw(@CAN_RadarRL::RRL_Object::RRL_Object_Obj4.Width, 0.125, 0.0);
    copyBitsToByteArrayLE(raw_value, byteArray, 2712, 7);

    raw_value = convertPhysicalToRaw(@CAN_RadarRL::RRL_Object::RRL_Object_Obj4.OrientationYawVnce, 0.0003, 0.0);
    copyBitsToByteArrayLE(raw_value, byteArray, 2700, 12);

    raw_value = convertPhysicalToRaw(@CAN_RadarRL::RRL_Object::RRL_Object_Obj4.Length, 0.125, 0.0);
    copyBitsToByteArrayLE(raw_value, byteArray, 2648, 7);

    raw_value = convertPhysicalToRaw(@CAN_RadarRL::RRL_Object::RRL_Object_Obj4.OrientationYaw, 0.0175, -4.48);
    copyBitsToByteArrayLE(raw_value, byteArray, 2678, 9);

    raw_value = convertPhysicalToRaw(@CAN_RadarRL::RRL_Object::RRL_Object_Obj4.Ax, 0.03125, -16.0);
    copyBitsToByteArrayLE(raw_value, byteArray, 2668, 10);

    raw_value = convertPhysicalToRaw(@CAN_RadarRL::RRL_Object::RRL_Object_Obj4.LengthVnce, 0.005, 0.0);
    copyBitsToByteArrayLE(raw_value, byteArray, 2656, 12);

    raw_value = convertPhysicalToRaw(@CAN_RadarRL::RRL_Object::RRL_Object_Obj4.PyVnce, 0.005, 0.0);
    copyBitsToByteArrayLE(raw_value, byteArray, 2636, 12);

    raw_value = convertPhysicalToRaw(@CAN_RadarRL::RRL_Object::RRL_Object_Obj4.Py, 0.0625, -128.0);
    copyBitsToByteArrayLE(raw_value, byteArray, 2624, 12);

    raw_value = convertPhysicalToRaw(@CAN_RadarRL::RRL_Object::RRL_Object_Obj4.PxVnce, 0.005, 0.0);
    copyBitsToByteArrayLE(raw_value, byteArray, 2612, 12);

    raw_value = convertPhysicalToRaw(@CAN_RadarRL::RRL_Object::RRL_Object_Obj4.Px, 0.0625, -512.0);
    copyBitsToByteArrayLE(raw_value, byteArray, 2598, 14);

    raw_value = convertPhysicalToRaw(@CAN_RadarRL::RRL_Object::RRL_Object_Obj4.ProbClassConfidence, 2.0, 0.0);
    copyBitsToByteArrayLE(raw_value, byteArray, 2592, 6);

    raw_value = convertPhysicalToRaw(@CAN_RadarRL::RRL_Object::RRL_Object_Obj4.Vy, 0.125, -64.0);
    copyBitsToByteArrayLE(raw_value, byteArray, 2798, 10);

    raw_value = convertPhysicalToRaw(@CAN_RadarRL::RRL_Object::RRL_Object_Obj4.MovingStatus, 1.0, 0.0);
    copyBitsToByteArrayLE(raw_value, byteArray, 2796, 2);

    raw_value = convertPhysicalToRaw(@CAN_RadarRL::RRL_Object::RRL_Object_Obj4.VxVyCoVnce, 0.005, -10.0);
    copyBitsToByteArrayLE(raw_value, byteArray, 2976, 12);

    raw_value = convertPhysicalToRaw(@CAN_RadarRL::RRL_Object::RRL_Object_Obj4.ExistProb, 2.0, 0.0);
    copyBitsToByteArrayLE(raw_value, byteArray, 2808, 6);

    raw_value = convertPhysicalToRaw(@CAN_RadarRL::RRL_Object::RRL_Object_Obj4.PxAxCoVnce, 0.005, -10.0);
    copyBitsToByteArrayLE(raw_value, byteArray, 2912, 12);

    raw_value = convertPhysicalToRaw(@CAN_RadarRL::RRL_Object::RRL_Object_Obj4.AxAyCoVnce, 0.005, -10.0);
    copyBitsToByteArrayLE(raw_value, byteArray, 3052, 12);

    raw_value = convertPhysicalToRaw(@CAN_RadarRL::RRL_Object::RRL_Object_Obj4.VyVnce, 0.005, 0.0);
    copyBitsToByteArrayLE(raw_value, byteArray, 2816, 12);

    raw_value = convertPhysicalToRaw(@CAN_RadarRL::RRL_Object::RRL_Object_Obj4.Age, 1.0, 0.0);
    copyBitsToByteArrayLE(raw_value, byteArray, 3072, 32);

    raw_value = convertPhysicalToRaw(@CAN_RadarRL::RRL_Object::RRL_Object_Obj4.VyAyCoVnce, 0.005, -10.0);
    copyBitsToByteArrayLE(raw_value, byteArray, 3040, 12);

    raw_value = convertPhysicalToRaw(@CAN_RadarRL::RRL_Object::RRL_Object_Obj4.VyAxCoVnce, 0.005, -10.0);
    copyBitsToByteArrayLE(raw_value, byteArray, 3020, 12);

    raw_value = convertPhysicalToRaw(@CAN_RadarRL::RRL_Object::RRL_Object_Obj4.VxAyCoVnce, 0.005, -10.0);
    copyBitsToByteArrayLE(raw_value, byteArray, 3008, 12);

    raw_value = convertPhysicalToRaw(@CAN_RadarRL::RRL_Object::RRL_Object_Obj4.VxAxCoVnce, 0.005, -10.0);
    copyBitsToByteArrayLE(raw_value, byteArray, 2988, 12);

    raw_value = convertPhysicalToRaw(@CAN_RadarRL::RRL_Object::RRL_Object_Obj4.PyAyCoVnce, 0.005, -10.0);
    copyBitsToByteArrayLE(raw_value, byteArray, 2956, 12);

    raw_value = convertPhysicalToRaw(@CAN_RadarRL::RRL_Object::RRL_Object_Obj4.PyAxCoVnce, 0.005, -10.0);
    copyBitsToByteArrayLE(raw_value, byteArray, 2944, 12);

    raw_value = convertPhysicalToRaw(@CAN_RadarRL::RRL_Object::RRL_Object_Obj4.PxAyCoVnce, 0.005, -10.0);
    copyBitsToByteArrayLE(raw_value, byteArray, 2924, 12);

    raw_value = convertPhysicalToRaw(@CAN_RadarRL::RRL_Object::RRL_Object_Obj4.ReferencePoint, 1.0, 0.0);
    copyBitsToByteArrayLE(raw_value, byteArray, 2904, 4);

    raw_value = convertPhysicalToRaw(@CAN_RadarRL::RRL_Object::RRL_Object_Obj4.PyVyCoVnce, 0.005, -10.0);
    copyBitsToByteArrayLE(raw_value, byteArray, 2892, 12);

    raw_value = convertPhysicalToRaw(@CAN_RadarRL::RRL_Object::RRL_Object_Obj4.PyVxCoVnce, 0.005, -10.0);
    copyBitsToByteArrayLE(raw_value, byteArray, 2880, 12);

    raw_value = convertPhysicalToRaw(@CAN_RadarRL::RRL_Object::RRL_Object_Obj4.FilterInformation, 1.0, 0.0);
    copyBitsToByteArrayLE(raw_value, byteArray, 2872, 8);

    raw_value = convertPhysicalToRaw(@CAN_RadarRL::RRL_Object::RRL_Object_Obj4.PxVyCoVnce, 0.005, -10.0);
    copyBitsToByteArrayLE(raw_value, byteArray, 2860, 12);

    raw_value = convertPhysicalToRaw(@CAN_RadarRL::RRL_Object::RRL_Object_Obj4.PxVxCoVnce, 0.005, -10.0);
    copyBitsToByteArrayLE(raw_value, byteArray, 2848, 12);

    raw_value = convertPhysicalToRaw(@CAN_RadarRL::RRL_Object::RRL_Object_Obj4.ProbClassType, 1.0, 0.0);
    copyBitsToByteArrayLE(raw_value, byteArray, 2843, 4);

    raw_value = convertPhysicalToRaw(@CAN_RadarRL::RRL_Object::RRL_Object_Obj4.MeasurementStatus, 1.0, 0.0);
    copyBitsToByteArrayLE(raw_value, byteArray, 2840, 3);

    raw_value = convertPhysicalToRaw(@CAN_RadarRL::RRL_Object::RRL_Object_Obj4.PxPyCoVnce, 0.005, -10.0);
    copyBitsToByteArrayLE(raw_value, byteArray, 2828, 12);
}


void RRL_Object_Obj3_write(byte byteArray[])
{
    qword raw_value;

    raw_value = convertPhysicalToRaw(@CAN_RadarRL::RRL_Object::RRL_Object_Obj3.Ay, 0.0625, -16.0);
    copyBitsToByteArrayLE(raw_value, byteArray, 2230, 9);

    raw_value = convertPhysicalToRaw(@CAN_RadarRL::RRL_Object::RRL_Object_Obj3.WidthVnce, 0.005, 0.0);
    copyBitsToByteArrayLE(raw_value, byteArray, 2208, 12);

    raw_value = convertPhysicalToRaw(@CAN_RadarRL::RRL_Object::RRL_Object_Obj3.RCS, 0.2, -102.4);
    copyBitsToByteArrayLE(raw_value, byteArray, 2220, 10);

    raw_value = convertPhysicalToRaw(@CAN_RadarRL::RRL_Object::RRL_Object_Obj3.VxVnce, 0.005, 0.0);
    copyBitsToByteArrayLE(raw_value, byteArray, 2272, 12);

    raw_value = convertPhysicalToRaw(@CAN_RadarRL::RRL_Object::RRL_Object_Obj3.AyVnce, 0.005, 0.0);
    copyBitsToByteArrayLE(raw_value, byteArray, 2240, 12);

    raw_value = convertPhysicalToRaw(@CAN_RadarRL::RRL_Object::RRL_Object_Obj3.Vx, 0.0625, -128.0);
    copyBitsToByteArrayLE(raw_value, byteArray, 2252, 12);

    raw_value = convertPhysicalToRaw(@CAN_RadarRL::RRL_Object::RRL_Object_Obj3.ObjId, 1.0, 0.0);
    copyBitsToByteArrayLE(raw_value, byteArray, 2264, 7);

    raw_value = convertPhysicalToRaw(@CAN_RadarRL::RRL_Object::RRL_Object_Obj3.OrientationYawVnce, 0.0003, 0.0);
    copyBitsToByteArrayLE(raw_value, byteArray, 2188, 12);

    raw_value = convertPhysicalToRaw(@CAN_RadarRL::RRL_Object::RRL_Object_Obj3.Width, 0.125, 0.0);
    copyBitsToByteArrayLE(raw_value, byteArray, 2200, 7);

    raw_value = convertPhysicalToRaw(@CAN_RadarRL::RRL_Object::RRL_Object_Obj3.Px, 0.0625, -512.0);
    copyBitsToByteArrayLE(raw_value, byteArray, 2086, 14);

    raw_value = convertPhysicalToRaw(@CAN_RadarRL::RRL_Object::RRL_Object_Obj3.AxVnce, 0.005, 0.0);
    copyBitsToByteArrayLE(raw_value, byteArray, 2176, 12);

    raw_value = convertPhysicalToRaw(@CAN_RadarRL::RRL_Object::RRL_Object_Obj3.OrientationYaw, 0.0175, -4.48);
    copyBitsToByteArrayLE(raw_value, byteArray, 2166, 9);

    raw_value = convertPhysicalToRaw(@CAN_RadarRL::RRL_Object::RRL_Object_Obj3.Ax, 0.03125, -16.0);
    copyBitsToByteArrayLE(raw_value, byteArray, 2156, 10);

    raw_value = convertPhysicalToRaw(@CAN_RadarRL::RRL_Object::RRL_Object_Obj3.LengthVnce, 0.005, 0.0);
    copyBitsToByteArrayLE(raw_value, byteArray, 2144, 12);

    raw_value = convertPhysicalToRaw(@CAN_RadarRL::RRL_Object::RRL_Object_Obj3.Length, 0.125, 0.0);
    copyBitsToByteArrayLE(raw_value, byteArray, 2136, 7);

    raw_value = convertPhysicalToRaw(@CAN_RadarRL::RRL_Object::RRL_Object_Obj3.PyVnce, 0.005, 0.0);
    copyBitsToByteArrayLE(raw_value, byteArray, 2124, 12);

    raw_value = convertPhysicalToRaw(@CAN_RadarRL::RRL_Object::RRL_Object_Obj3.Py, 0.0625, -128.0);
    copyBitsToByteArrayLE(raw_value, byteArray, 2112, 12);

    raw_value = convertPhysicalToRaw(@CAN_RadarRL::RRL_Object::RRL_Object_Obj3.PxVnce, 0.005, 0.0);
    copyBitsToByteArrayLE(raw_value, byteArray, 2100, 12);

    raw_value = convertPhysicalToRaw(@CAN_RadarRL::RRL_Object::RRL_Object_Obj3.ProbClassConfidence, 2.0, 0.0);
    copyBitsToByteArrayLE(raw_value, byteArray, 2080, 6);

    raw_value = convertPhysicalToRaw(@CAN_RadarRL::RRL_Object::RRL_Object_Obj3.Vy, 0.125, -64.0);
    copyBitsToByteArrayLE(raw_value, byteArray, 2286, 10);

    raw_value = convertPhysicalToRaw(@CAN_RadarRL::RRL_Object::RRL_Object_Obj3.MovingStatus, 1.0, 0.0);
    copyBitsToByteArrayLE(raw_value, byteArray, 2284, 2);

    raw_value = convertPhysicalToRaw(@CAN_RadarRL::RRL_Object::RRL_Object_Obj3.PxPyCoVnce, 0.005, -10.0);
    copyBitsToByteArrayLE(raw_value, byteArray, 2316, 12);

    raw_value = convertPhysicalToRaw(@CAN_RadarRL::RRL_Object::RRL_Object_Obj3.ExistProb, 2.0, 0.0);
    copyBitsToByteArrayLE(raw_value, byteArray, 2296, 6);

    raw_value = convertPhysicalToRaw(@CAN_RadarRL::RRL_Object::RRL_Object_Obj3.PyAxCoVnce, 0.005, -10.0);
    copyBitsToByteArrayLE(raw_value, byteArray, 2432, 12);

    raw_value = convertPhysicalToRaw(@CAN_RadarRL::RRL_Object::RRL_Object_Obj3.VyVnce, 0.005, 0.0);
    copyBitsToByteArrayLE(raw_value, byteArray, 2304, 12);

    raw_value = convertPhysicalToRaw(@CAN_RadarRL::RRL_Object::RRL_Object_Obj3.Age, 1.0, 0.0);
    copyBitsToByteArrayLE(raw_value, byteArray, 2560, 32);

    raw_value = convertPhysicalToRaw(@CAN_RadarRL::RRL_Object::RRL_Object_Obj3.AxAyCoVnce, 0.005, -10.0);
    copyBitsToByteArrayLE(raw_value, byteArray, 2540, 12);

    raw_value = convertPhysicalToRaw(@CAN_RadarRL::RRL_Object::RRL_Object_Obj3.VyAyCoVnce, 0.005, -10.0);
    copyBitsToByteArrayLE(raw_value, byteArray, 2528, 12);

    raw_value = convertPhysicalToRaw(@CAN_RadarRL::RRL_Object::RRL_Object_Obj3.VyAxCoVnce, 0.005, -10.0);
    copyBitsToByteArrayLE(raw_value, byteArray, 2508, 12);

    raw_value = convertPhysicalToRaw(@CAN_RadarRL::RRL_Object::RRL_Object_Obj3.VxAyCoVnce, 0.005, -10.0);
    copyBitsToByteArrayLE(raw_value, byteArray, 2496, 12);

    raw_value = convertPhysicalToRaw(@CAN_RadarRL::RRL_Object::RRL_Object_Obj3.VxAxCoVnce, 0.005, -10.0);
    copyBitsToByteArrayLE(raw_value, byteArray, 2476, 12);

    raw_value = convertPhysicalToRaw(@CAN_RadarRL::RRL_Object::RRL_Object_Obj3.VxVyCoVnce, 0.005, -10.0);
    copyBitsToByteArrayLE(raw_value, byteArray, 2464, 12);

    raw_value = convertPhysicalToRaw(@CAN_RadarRL::RRL_Object::RRL_Object_Obj3.PyAyCoVnce, 0.005, -10.0);
    copyBitsToByteArrayLE(raw_value, byteArray, 2444, 12);

    raw_value = convertPhysicalToRaw(@CAN_RadarRL::RRL_Object::RRL_Object_Obj3.PyVxCoVnce, 0.005, -10.0);
    copyBitsToByteArrayLE(raw_value, byteArray, 2368, 12);

    raw_value = convertPhysicalToRaw(@CAN_RadarRL::RRL_Object::RRL_Object_Obj3.PxAyCoVnce, 0.005, -10.0);
    copyBitsToByteArrayLE(raw_value, byteArray, 2412, 12);

    raw_value = convertPhysicalToRaw(@CAN_RadarRL::RRL_Object::RRL_Object_Obj3.PxVyCoVnce, 0.005, -10.0);
    copyBitsToByteArrayLE(raw_value, byteArray, 2348, 12);

    raw_value = convertPhysicalToRaw(@CAN_RadarRL::RRL_Object::RRL_Object_Obj3.MeasurementStatus, 1.0, 0.0);
    copyBitsToByteArrayLE(raw_value, byteArray, 2328, 3);

    raw_value = convertPhysicalToRaw(@CAN_RadarRL::RRL_Object::RRL_Object_Obj3.ProbClassType, 1.0, 0.0);
    copyBitsToByteArrayLE(raw_value, byteArray, 2331, 4);

    raw_value = convertPhysicalToRaw(@CAN_RadarRL::RRL_Object::RRL_Object_Obj3.PxVxCoVnce, 0.005, -10.0);
    copyBitsToByteArrayLE(raw_value, byteArray, 2336, 12);

    raw_value = convertPhysicalToRaw(@CAN_RadarRL::RRL_Object::RRL_Object_Obj3.PxAxCoVnce, 0.005, -10.0);
    copyBitsToByteArrayLE(raw_value, byteArray, 2400, 12);

    raw_value = convertPhysicalToRaw(@CAN_RadarRL::RRL_Object::RRL_Object_Obj3.FilterInformation, 1.0, 0.0);
    copyBitsToByteArrayLE(raw_value, byteArray, 2360, 8);

    raw_value = convertPhysicalToRaw(@CAN_RadarRL::RRL_Object::RRL_Object_Obj3.PyVyCoVnce, 0.005, -10.0);
    copyBitsToByteArrayLE(raw_value, byteArray, 2380, 12);

    raw_value = convertPhysicalToRaw(@CAN_RadarRL::RRL_Object::RRL_Object_Obj3.ReferencePoint, 1.0, 0.0);
    copyBitsToByteArrayLE(raw_value, byteArray, 2392, 4);
}


void RRL_Object_Obj2_write(byte byteArray[])
{
    qword raw_value;

    raw_value = convertPhysicalToRaw(@CAN_RadarRL::RRL_Object::RRL_Object_Obj2.MovingStatus, 1.0, 0.0);
    copyBitsToByteArrayLE(raw_value, byteArray, 1772, 2);

    raw_value = convertPhysicalToRaw(@CAN_RadarRL::RRL_Object::RRL_Object_Obj2.Width, 0.125, 0.0);
    copyBitsToByteArrayLE(raw_value, byteArray, 1688, 7);

    raw_value = convertPhysicalToRaw(@CAN_RadarRL::RRL_Object::RRL_Object_Obj2.VxVnce, 0.005, 0.0);
    copyBitsToByteArrayLE(raw_value, byteArray, 1760, 12);

    raw_value = convertPhysicalToRaw(@CAN_RadarRL::RRL_Object::RRL_Object_Obj2.ObjId, 1.0, 0.0);
    copyBitsToByteArrayLE(raw_value, byteArray, 1752, 7);

    raw_value = convertPhysicalToRaw(@CAN_RadarRL::RRL_Object::RRL_Object_Obj2.Vx, 0.0625, -128.0);
    copyBitsToByteArrayLE(raw_value, byteArray, 1740, 12);

    raw_value = convertPhysicalToRaw(@CAN_RadarRL::RRL_Object::RRL_Object_Obj2.AyVnce, 0.005, 0.0);
    copyBitsToByteArrayLE(raw_value, byteArray, 1728, 12);

    raw_value = convertPhysicalToRaw(@CAN_RadarRL::RRL_Object::RRL_Object_Obj2.Ay, 0.0625, -16.0);
    copyBitsToByteArrayLE(raw_value, byteArray, 1718, 9);

    raw_value = convertPhysicalToRaw(@CAN_RadarRL::RRL_Object::RRL_Object_Obj2.RCS, 0.2, -102.4);
    copyBitsToByteArrayLE(raw_value, byteArray, 1708, 10);

    raw_value = convertPhysicalToRaw(@CAN_RadarRL::RRL_Object::RRL_Object_Obj2.WidthVnce, 0.005, 0.0);
    copyBitsToByteArrayLE(raw_value, byteArray, 1696, 12);

    raw_value = convertPhysicalToRaw(@CAN_RadarRL::RRL_Object::RRL_Object_Obj2.LengthVnce, 0.005, 0.0);
    copyBitsToByteArrayLE(raw_value, byteArray, 1632, 12);

    raw_value = convertPhysicalToRaw(@CAN_RadarRL::RRL_Object::RRL_Object_Obj2.OrientationYawVnce, 0.0003, 0.0);
    copyBitsToByteArrayLE(raw_value, byteArray, 1676, 12);

    raw_value = convertPhysicalToRaw(@CAN_RadarRL::RRL_Object::RRL_Object_Obj2.AxVnce, 0.005, 0.0);
    copyBitsToByteArrayLE(raw_value, byteArray, 1664, 12);

    raw_value = convertPhysicalToRaw(@CAN_RadarRL::RRL_Object::RRL_Object_Obj2.OrientationYaw, 0.0175, -4.48);
    copyBitsToByteArrayLE(raw_value, byteArray, 1654, 9);

    raw_value = convertPhysicalToRaw(@CAN_RadarRL::RRL_Object::RRL_Object_Obj2.ExistProb, 2.0, 0.0);
    copyBitsToByteArrayLE(raw_value, byteArray, 1784, 6);

    raw_value = convertPhysicalToRaw(@CAN_RadarRL::RRL_Object::RRL_Object_Obj2.Length, 0.125, 0.0);
    copyBitsToByteArrayLE(raw_value, byteArray, 1624, 7);

    raw_value = convertPhysicalToRaw(@CAN_RadarRL::RRL_Object::RRL_Object_Obj2.PyVnce, 0.005, 0.0);
    copyBitsToByteArrayLE(raw_value, byteArray, 1612, 12);

    raw_value = convertPhysicalToRaw(@CAN_RadarRL::RRL_Object::RRL_Object_Obj2.Py, 0.0625, -128.0);
    copyBitsToByteArrayLE(raw_value, byteArray, 1600, 12);

    raw_value = convertPhysicalToRaw(@CAN_RadarRL::RRL_Object::RRL_Object_Obj2.PxVnce, 0.005, 0.0);
    copyBitsToByteArrayLE(raw_value, byteArray, 1588, 12);

    raw_value = convertPhysicalToRaw(@CAN_RadarRL::RRL_Object::RRL_Object_Obj2.ProbClassConfidence, 2.0, 0.0);
    copyBitsToByteArrayLE(raw_value, byteArray, 1568, 6);

    raw_value = convertPhysicalToRaw(@CAN_RadarRL::RRL_Object::RRL_Object_Obj2.Vy, 0.125, -64.0);
    copyBitsToByteArrayLE(raw_value, byteArray, 1774, 10);

    raw_value = convertPhysicalToRaw(@CAN_RadarRL::RRL_Object::RRL_Object_Obj2.Px, 0.0625, -512.0);
    copyBitsToByteArrayLE(raw_value, byteArray, 1574, 14);

    raw_value = convertPhysicalToRaw(@CAN_RadarRL::RRL_Object::RRL_Object_Obj2.VyVnce, 0.005, 0.0);
    copyBitsToByteArrayLE(raw_value, byteArray, 1792, 12);

    raw_value = convertPhysicalToRaw(@CAN_RadarRL::RRL_Object::RRL_Object_Obj2.PyAxCoVnce, 0.005, -10.0);
    copyBitsToByteArrayLE(raw_value, byteArray, 1920, 12);

    raw_value = convertPhysicalToRaw(@CAN_RadarRL::RRL_Object::RRL_Object_Obj2.PxPyCoVnce, 0.005, -10.0);
    copyBitsToByteArrayLE(raw_value, byteArray, 1804, 12);

    raw_value = convertPhysicalToRaw(@CAN_RadarRL::RRL_Object::RRL_Object_Obj2.Age, 1.0, 0.0);
    copyBitsToByteArrayLE(raw_value, byteArray, 2048, 32);

    raw_value = convertPhysicalToRaw(@CAN_RadarRL::RRL_Object::RRL_Object_Obj2.AxAyCoVnce, 0.005, -10.0);
    copyBitsToByteArrayLE(raw_value, byteArray, 2028, 12);

    raw_value = convertPhysicalToRaw(@CAN_RadarRL::RRL_Object::RRL_Object_Obj2.VyAyCoVnce, 0.005, -10.0);
    copyBitsToByteArrayLE(raw_value, byteArray, 2016, 12);

    raw_value = convertPhysicalToRaw(@CAN_RadarRL::RRL_Object::RRL_Object_Obj2.VyAxCoVnce, 0.005, -10.0);
    copyBitsToByteArrayLE(raw_value, byteArray, 1996, 12);

    raw_value = convertPhysicalToRaw(@CAN_RadarRL::RRL_Object::RRL_Object_Obj2.VxAyCoVnce, 0.005, -10.0);
    copyBitsToByteArrayLE(raw_value, byteArray, 1984, 12);

    raw_value = convertPhysicalToRaw(@CAN_RadarRL::RRL_Object::RRL_Object_Obj2.VxAxCoVnce, 0.005, -10.0);
    copyBitsToByteArrayLE(raw_value, byteArray, 1964, 12);

    raw_value = convertPhysicalToRaw(@CAN_RadarRL::RRL_Object::RRL_Object_Obj2.VxVyCoVnce, 0.005, -10.0);
    copyBitsToByteArrayLE(raw_value, byteArray, 1952, 12);

    raw_value = convertPhysicalToRaw(@CAN_RadarRL::RRL_Object::RRL_Object_Obj2.PyAyCoVnce, 0.005, -10.0);
    copyBitsToByteArrayLE(raw_value, byteArray, 1932, 12);

    raw_value = convertPhysicalToRaw(@CAN_RadarRL::RRL_Object::RRL_Object_Obj2.Ax, 0.03125, -16.0);
    copyBitsToByteArrayLE(raw_value, byteArray, 1644, 10);

    raw_value = convertPhysicalToRaw(@CAN_RadarRL::RRL_Object::RRL_Object_Obj2.PxAyCoVnce, 0.005, -10.0);
    copyBitsToByteArrayLE(raw_value, byteArray, 1900, 12);

    raw_value = convertPhysicalToRaw(@CAN_RadarRL::RRL_Object::RRL_Object_Obj2.ReferencePoint, 1.0, 0.0);
    copyBitsToByteArrayLE(raw_value, byteArray, 1880, 4);

    raw_value = convertPhysicalToRaw(@CAN_RadarRL::RRL_Object::RRL_Object_Obj2.PyVyCoVnce, 0.005, -10.0);
    copyBitsToByteArrayLE(raw_value, byteArray, 1868, 12);

    raw_value = convertPhysicalToRaw(@CAN_RadarRL::RRL_Object::RRL_Object_Obj2.PyVxCoVnce, 0.005, -10.0);
    copyBitsToByteArrayLE(raw_value, byteArray, 1856, 12);

    raw_value = convertPhysicalToRaw(@CAN_RadarRL::RRL_Object::RRL_Object_Obj2.FilterInformation, 1.0, 0.0);
    copyBitsToByteArrayLE(raw_value, byteArray, 1848, 8);

    raw_value = convertPhysicalToRaw(@CAN_RadarRL::RRL_Object::RRL_Object_Obj2.PxVyCoVnce, 0.005, -10.0);
    copyBitsToByteArrayLE(raw_value, byteArray, 1836, 12);

    raw_value = convertPhysicalToRaw(@CAN_RadarRL::RRL_Object::RRL_Object_Obj2.PxVxCoVnce, 0.005, -10.0);
    copyBitsToByteArrayLE(raw_value, byteArray, 1824, 12);

    raw_value = convertPhysicalToRaw(@CAN_RadarRL::RRL_Object::RRL_Object_Obj2.ProbClassType, 1.0, 0.0);
    copyBitsToByteArrayLE(raw_value, byteArray, 1819, 4);

    raw_value = convertPhysicalToRaw(@CAN_RadarRL::RRL_Object::RRL_Object_Obj2.PxAxCoVnce, 0.005, -10.0);
    copyBitsToByteArrayLE(raw_value, byteArray, 1888, 12);

    raw_value = convertPhysicalToRaw(@CAN_RadarRL::RRL_Object::RRL_Object_Obj2.MeasurementStatus, 1.0, 0.0);
    copyBitsToByteArrayLE(raw_value, byteArray, 1816, 3);
}


void RRL_Object_Obj1_write(byte byteArray[])
{
    qword raw_value;

    raw_value = convertPhysicalToRaw(@CAN_RadarRL::RRL_Object::RRL_Object_Obj1.Ay, 0.0625, -16.0);
    copyBitsToByteArrayLE(raw_value, byteArray, 1206, 9);

    raw_value = convertPhysicalToRaw(@CAN_RadarRL::RRL_Object::RRL_Object_Obj1.WidthVnce, 0.005, 0.0);
    copyBitsToByteArrayLE(raw_value, byteArray, 1184, 12);

    raw_value = convertPhysicalToRaw(@CAN_RadarRL::RRL_Object::RRL_Object_Obj1.RCS, 0.2, -102.4);
    copyBitsToByteArrayLE(raw_value, byteArray, 1196, 10);

    raw_value = convertPhysicalToRaw(@CAN_RadarRL::RRL_Object::RRL_Object_Obj1.VxVnce, 0.005, 0.0);
    copyBitsToByteArrayLE(raw_value, byteArray, 1248, 12);

    raw_value = convertPhysicalToRaw(@CAN_RadarRL::RRL_Object::RRL_Object_Obj1.AyVnce, 0.005, 0.0);
    copyBitsToByteArrayLE(raw_value, byteArray, 1216, 12);

    raw_value = convertPhysicalToRaw(@CAN_RadarRL::RRL_Object::RRL_Object_Obj1.Vx, 0.0625, -128.0);
    copyBitsToByteArrayLE(raw_value, byteArray, 1228, 12);

    raw_value = convertPhysicalToRaw(@CAN_RadarRL::RRL_Object::RRL_Object_Obj1.ObjId, 1.0, 0.0);
    copyBitsToByteArrayLE(raw_value, byteArray, 1240, 7);

    raw_value = convertPhysicalToRaw(@CAN_RadarRL::RRL_Object::RRL_Object_Obj1.OrientationYawVnce, 0.0003, 0.0);
    copyBitsToByteArrayLE(raw_value, byteArray, 1164, 12);

    raw_value = convertPhysicalToRaw(@CAN_RadarRL::RRL_Object::RRL_Object_Obj1.Width, 0.125, 0.0);
    copyBitsToByteArrayLE(raw_value, byteArray, 1176, 7);

    raw_value = convertPhysicalToRaw(@CAN_RadarRL::RRL_Object::RRL_Object_Obj1.LengthVnce, 0.005, 0.0);
    copyBitsToByteArrayLE(raw_value, byteArray, 1120, 12);

    raw_value = convertPhysicalToRaw(@CAN_RadarRL::RRL_Object::RRL_Object_Obj1.AxVnce, 0.005, 0.0);
    copyBitsToByteArrayLE(raw_value, byteArray, 1152, 12);

    raw_value = convertPhysicalToRaw(@CAN_RadarRL::RRL_Object::RRL_Object_Obj1.OrientationYaw, 0.0175, -4.48);
    copyBitsToByteArrayLE(raw_value, byteArray, 1142, 9);

    raw_value = convertPhysicalToRaw(@CAN_RadarRL::RRL_Object::RRL_Object_Obj1.Ax, 0.03125, -16.0);
    copyBitsToByteArrayLE(raw_value, byteArray, 1132, 10);

    raw_value = convertPhysicalToRaw(@CAN_RadarRL::RRL_Object::RRL_Object_Obj1.Vy, 0.125, -64.0);
    copyBitsToByteArrayLE(raw_value, byteArray, 1262, 10);

    raw_value = convertPhysicalToRaw(@CAN_RadarRL::RRL_Object::RRL_Object_Obj1.Length, 0.125, 0.0);
    copyBitsToByteArrayLE(raw_value, byteArray, 1112, 7);

    raw_value = convertPhysicalToRaw(@CAN_RadarRL::RRL_Object::RRL_Object_Obj1.PyVnce, 0.005, 0.0);
    copyBitsToByteArrayLE(raw_value, byteArray, 1100, 12);

    raw_value = convertPhysicalToRaw(@CAN_RadarRL::RRL_Object::RRL_Object_Obj1.Py, 0.0625, -128.0);
    copyBitsToByteArrayLE(raw_value, byteArray, 1088, 12);

    raw_value = convertPhysicalToRaw(@CAN_RadarRL::RRL_Object::RRL_Object_Obj1.PxVnce, 0.005, 0.0);
    copyBitsToByteArrayLE(raw_value, byteArray, 1076, 12);

    raw_value = convertPhysicalToRaw(@CAN_RadarRL::RRL_Object::RRL_Object_Obj1.Px, 0.0625, -512.0);
    copyBitsToByteArrayLE(raw_value, byteArray, 1062, 14);

    raw_value = convertPhysicalToRaw(@CAN_RadarRL::RRL_Object::RRL_Object_Obj1.ProbClassConfidence, 2.0, 0.0);
    copyBitsToByteArrayLE(raw_value, byteArray, 1056, 6);

    raw_value = convertPhysicalToRaw(@CAN_RadarRL::RRL_Object::RRL_Object_Obj1.MovingStatus, 1.0, 0.0);
    copyBitsToByteArrayLE(raw_value, byteArray, 1260, 2);

    raw_value = convertPhysicalToRaw(@CAN_RadarRL::RRL_Object::RRL_Object_Obj1.PxPyCoVnce, 0.005, -10.0);
    copyBitsToByteArrayLE(raw_value, byteArray, 1292, 12);

    raw_value = convertPhysicalToRaw(@CAN_RadarRL::RRL_Object::RRL_Object_Obj1.ExistProb, 2.0, 0.0);
    copyBitsToByteArrayLE(raw_value, byteArray, 1272, 6);

    raw_value = convertPhysicalToRaw(@CAN_RadarRL::RRL_Object::RRL_Object_Obj1.PyAxCoVnce, 0.005, -10.0);
    copyBitsToByteArrayLE(raw_value, byteArray, 1408, 12);

    raw_value = convertPhysicalToRaw(@CAN_RadarRL::RRL_Object::RRL_Object_Obj1.Age, 1.0, 0.0);
    copyBitsToByteArrayLE(raw_value, byteArray, 1536, 32);

    raw_value = convertPhysicalToRaw(@CAN_RadarRL::RRL_Object::RRL_Object_Obj1.AxAyCoVnce, 0.005, -10.0);
    copyBitsToByteArrayLE(raw_value, byteArray, 1516, 12);

    raw_value = convertPhysicalToRaw(@CAN_RadarRL::RRL_Object::RRL_Object_Obj1.VyAyCoVnce, 0.005, -10.0);
    copyBitsToByteArrayLE(raw_value, byteArray, 1504, 12);

    raw_value = convertPhysicalToRaw(@CAN_RadarRL::RRL_Object::RRL_Object_Obj1.VyAxCoVnce, 0.005, -10.0);
    copyBitsToByteArrayLE(raw_value, byteArray, 1484, 12);

    raw_value = convertPhysicalToRaw(@CAN_RadarRL::RRL_Object::RRL_Object_Obj1.VxAyCoVnce, 0.005, -10.0);
    copyBitsToByteArrayLE(raw_value, byteArray, 1472, 12);

    raw_value = convertPhysicalToRaw(@CAN_RadarRL::RRL_Object::RRL_Object_Obj1.VxAxCoVnce, 0.005, -10.0);
    copyBitsToByteArrayLE(raw_value, byteArray, 1452, 12);

    raw_value = convertPhysicalToRaw(@CAN_RadarRL::RRL_Object::RRL_Object_Obj1.VxVyCoVnce, 0.005, -10.0);
    copyBitsToByteArrayLE(raw_value, byteArray, 1440, 12);

    raw_value = convertPhysicalToRaw(@CAN_RadarRL::RRL_Object::RRL_Object_Obj1.VyVnce, 0.005, 0.0);
    copyBitsToByteArrayLE(raw_value, byteArray, 1280, 12);

    raw_value = convertPhysicalToRaw(@CAN_RadarRL::RRL_Object::RRL_Object_Obj1.PyAyCoVnce, 0.005, -10.0);
    copyBitsToByteArrayLE(raw_value, byteArray, 1420, 12);

    raw_value = convertPhysicalToRaw(@CAN_RadarRL::RRL_Object::RRL_Object_Obj1.PxAyCoVnce, 0.005, -10.0);
    copyBitsToByteArrayLE(raw_value, byteArray, 1388, 12);

    raw_value = convertPhysicalToRaw(@CAN_RadarRL::RRL_Object::RRL_Object_Obj1.PxAxCoVnce, 0.005, -10.0);
    copyBitsToByteArrayLE(raw_value, byteArray, 1376, 12);

    raw_value = convertPhysicalToRaw(@CAN_RadarRL::RRL_Object::RRL_Object_Obj1.ReferencePoint, 1.0, 0.0);
    copyBitsToByteArrayLE(raw_value, byteArray, 1368, 4);

    raw_value = convertPhysicalToRaw(@CAN_RadarRL::RRL_Object::RRL_Object_Obj1.PyVyCoVnce, 0.005, -10.0);
    copyBitsToByteArrayLE(raw_value, byteArray, 1356, 12);

    raw_value = convertPhysicalToRaw(@CAN_RadarRL::RRL_Object::RRL_Object_Obj1.FilterInformation, 1.0, 0.0);
    copyBitsToByteArrayLE(raw_value, byteArray, 1336, 8);

    raw_value = convertPhysicalToRaw(@CAN_RadarRL::RRL_Object::RRL_Object_Obj1.PxVyCoVnce, 0.005, -10.0);
    copyBitsToByteArrayLE(raw_value, byteArray, 1324, 12);

    raw_value = convertPhysicalToRaw(@CAN_RadarRL::RRL_Object::RRL_Object_Obj1.PxVxCoVnce, 0.005, -10.0);
    copyBitsToByteArrayLE(raw_value, byteArray, 1312, 12);

    raw_value = convertPhysicalToRaw(@CAN_RadarRL::RRL_Object::RRL_Object_Obj1.ProbClassType, 1.0, 0.0);
    copyBitsToByteArrayLE(raw_value, byteArray, 1307, 4);

    raw_value = convertPhysicalToRaw(@CAN_RadarRL::RRL_Object::RRL_Object_Obj1.MeasurementStatus, 1.0, 0.0);
    copyBitsToByteArrayLE(raw_value, byteArray, 1304, 3);

    raw_value = convertPhysicalToRaw(@CAN_RadarRL::RRL_Object::RRL_Object_Obj1.PyVxCoVnce, 0.005, -10.0);
    copyBitsToByteArrayLE(raw_value, byteArray, 1344, 12);
}


void Write_OsekTP_CRadarRL_RRL_Object(byte byteArray[])
{
    qword raw_value;
    #if ADAS_HIL
      if(@hil_ctrl::ra6_rl_sgu_obj_sim!=0)
      {
        dllGetRadarRLByteArray(@hil_ctrl::Handle_RoadObj, byteArray);
        dllResetByteArrayRadarRL(@hil_ctrl::Handle_RoadObj);
      }
      else
      {
    #endif
    switch(@CAN_RadarRL_RRL_Object::Write_No_signals)
    {
    case 48:
    RRL_Object_Obj48_write(byteArray);
    case 47:
    RRL_Object_Obj47_write(byteArray);
    case 46:
    RRL_Object_Obj46_write(byteArray);
    case 45:
    RRL_Object_Obj45_write(byteArray);
    case 44:
    RRL_Object_Obj44_write(byteArray);
    case 43:
    RRL_Object_Obj43_write(byteArray);
    case 42:
    RRL_Object_Obj42_write(byteArray);
    case 41:
    RRL_Object_Obj41_write(byteArray);
    case 40:
    RRL_Object_Obj40_write(byteArray);
    case 39:
    RRL_Object_Obj39_write(byteArray);
    case 38:
    RRL_Object_Obj38_write(byteArray);
    case 37:
    RRL_Object_Obj37_write(byteArray);
    case 36:
    RRL_Object_Obj36_write(byteArray);
    case 35:
    RRL_Object_Obj35_write(byteArray);
    case 34:
    RRL_Object_Obj34_write(byteArray);
    case 33:
    RRL_Object_Obj33_write(byteArray);
    case 32:
    RRL_Object_Obj32_write(byteArray);
    case 31:
    RRL_Object_Obj31_write(byteArray);
    case 30:
    RRL_Object_Obj30_write(byteArray);
    case 29:
    RRL_Object_Obj29_write(byteArray);
    case 28:
    RRL_Object_Obj28_write(byteArray);
    case 27:
    RRL_Object_Obj27_write(byteArray);
    case 26:
    RRL_Object_Obj26_write(byteArray);
    case 25:
    RRL_Object_Obj25_write(byteArray);
    case 24:
    RRL_Object_Obj24_write(byteArray);
    case 23:
    RRL_Object_Obj23_write(byteArray);
    case 22:
    RRL_Object_Obj22_write(byteArray);
    case 21:
    RRL_Object_Obj21_write(byteArray);
    case 20:
    RRL_Object_Obj20_write(byteArray);
    case 19:
    RRL_Object_Obj19_write(byteArray);
    case 18:
    RRL_Object_Obj18_write(byteArray);
    case 17:
    RRL_Object_Obj17_write(byteArray);
    case 16:
    RRL_Object_Obj16_write(byteArray);
    case 15:
    RRL_Object_Obj15_write(byteArray);
    case 14:
    RRL_Object_Obj14_write(byteArray);
    case 13:
    RRL_Object_Obj13_write(byteArray);
    case 12:
    RRL_Object_Obj12_write(byteArray);
    case 11:
    RRL_Object_Obj11_write(byteArray);
    case 10:
    RRL_Object_Obj10_write(byteArray);
    case 9:
    RRL_Object_Obj9_write(byteArray);
    case 8:
    RRL_Object_Obj8_write(byteArray);
    case 7:
    RRL_Object_Obj7_write(byteArray);
    case 6:
    RRL_Object_Obj6_write(byteArray);
    case 5:
    RRL_Object_Obj5_write(byteArray);
    case 4:
    RRL_Object_Obj4_write(byteArray);
    case 3:
    RRL_Object_Obj3_write(byteArray);
    case 2:
    RRL_Object_Obj2_write(byteArray);
    case 1:
    RRL_Object_Obj1_write(byteArray);
    break;
    }
    #if ADAS_HIL
    }
    #endif

    raw_value = convertPhysicalToRaw(@CAN_RadarRL::RRL_Object::RRL_Object_E2E_p44_length, 1.0, 0.0);
    copyBitsToByteArrayBE(raw_value, byteArray, 25632, 16);

    raw_value = convertPhysicalToRaw(@CAN_RadarRL::RRL_Object::RRL_Object_E2E_p44_counter, 1.0, 0.0);
    copyBitsToByteArrayBE(raw_value, byteArray, 25648, 16);

    raw_value = convertPhysicalToRaw(@CAN_RadarRL::RRL_Object::RRL_Object_E2E_p44_dataId, 1.0, 0.0);
    copyBitsToByteArrayBE(raw_value, byteArray, 25664, 32);

    raw_value = convertPhysicalToRaw(@CAN_RadarRL::RRL_Object::RRL_Object_ObjHdr_VersionIdMajor, 1.0, 0.0);
    copyBitsToByteArrayLE(raw_value, byteArray, 0, 8);

    raw_value = convertPhysicalToRaw(@CAN_RadarRL::RRL_Object::RRL_Object_ObjHdr_VersionIdMinor, 1.0, 0.0);
    copyBitsToByteArrayLE(raw_value, byteArray, 8, 8);

    raw_value = convertPhysicalToRaw(@CAN_RadarRL::RRL_Object::RRL_Object_SpiHdr_FovRtrAzSegBrdr10, 0.0175, -2.24);
    copyBitsToByteArrayLE(raw_value, byteArray, 536, 8);

    raw_value = convertPhysicalToRaw(@CAN_RadarRL::RRL_Object::RRL_Object_SpiHdr_FovRtrElRngGEnd01, 0.01, 0.0);
    copyBitsToByteArrayLE(raw_value, byteArray, 327, 7);

    raw_value = convertPhysicalToRaw(@CAN_RadarRL::RRL_Object::RRL_Object_SpiHdr_FovRtrElRngGEnd02, 0.01, 0.0);
    copyBitsToByteArrayLE(raw_value, byteArray, 334, 7);

    raw_value = convertPhysicalToRaw(@CAN_RadarRL::RRL_Object::RRL_Object_SpiHdr_FovRtrElRngGEnd03, 0.01, 0.0);
    copyBitsToByteArrayLE(raw_value, byteArray, 341, 7);

    raw_value = convertPhysicalToRaw(@CAN_RadarRL::RRL_Object::RRL_Object_SpiHdr_FovRtrElRngGEnd04, 0.01, 0.0);
    copyBitsToByteArrayLE(raw_value, byteArray, 352, 7);

    raw_value = convertPhysicalToRaw(@CAN_RadarRL::RRL_Object::RRL_Object_SpiHdr_FovRtrElRngGEnd05, 0.01, 0.0);
    copyBitsToByteArrayLE(raw_value, byteArray, 359, 7);

    raw_value = convertPhysicalToRaw(@CAN_RadarRL::RRL_Object::RRL_Object_SpiHdr_FovRtrElRngGEnd06, 0.01, 0.0);
    copyBitsToByteArrayLE(raw_value, byteArray, 366, 7);

    raw_value = convertPhysicalToRaw(@CAN_RadarRL::RRL_Object::RRL_Object_SpiHdr_FovRtrElRngGEnd07, 0.01, 0.0);
    copyBitsToByteArrayLE(raw_value, byteArray, 373, 7);

    raw_value = convertPhysicalToRaw(@CAN_RadarRL::RRL_Object::RRL_Object_SpiHdr_FovRtrElRngGEnd08, 0.01, 0.0);
    copyBitsToByteArrayLE(raw_value, byteArray, 384, 7);

    raw_value = convertPhysicalToRaw(@CAN_RadarRL::RRL_Object::RRL_Object_SpiHdr_FovRtrElRngGEnd09, 0.01, 0.0);
    copyBitsToByteArrayLE(raw_value, byteArray, 391, 7);

    raw_value = convertPhysicalToRaw(@CAN_RadarRL::RRL_Object::RRL_Object_SpiHdr_FovRtrElRngGEnd10, 0.01, 0.0);
    copyBitsToByteArrayLE(raw_value, byteArray, 398, 7);

    raw_value = convertPhysicalToRaw(@CAN_RadarRL::RRL_Object::RRL_Object_SpiHdr_VelMeasMin, 0.1, -150.0);
    copyBitsToByteArrayLE(raw_value, byteArray, 405, 11);

    raw_value = convertPhysicalToRaw(@CAN_RadarRL::RRL_Object::RRL_Object_SpiHdr_SensorOrientYaw, 0.00017, -5.57056);
    copyBitsToByteArrayLE(raw_value, byteArray, 416, 16);

    raw_value = convertPhysicalToRaw(@CAN_RadarRL::RRL_Object::RRL_Object_SpiHdr_SensorOrientPitch, 0.00017, -0.34816);
    copyBitsToByteArrayLE(raw_value, byteArray, 432, 12);

    raw_value = convertPhysicalToRaw(@CAN_RadarRL::RRL_Object::RRL_Object_SpiHdr_SensorExtDisturbed, 1.0, 0.0);
    copyBitsToByteArrayLE(raw_value, byteArray, 444, 3);

    raw_value = convertPhysicalToRaw(@CAN_RadarRL::RRL_Object::RRL_Object_SpiHdr_SensorOrientation, 1.0, 0.0);
    copyBitsToByteArrayLE(raw_value, byteArray, 447, 1);

    raw_value = convertPhysicalToRaw(@CAN_RadarRL::RRL_Object::RRL_Object_SpiHdr_RngGainRfInterfere, 1.0, 0.0);
    copyBitsToByteArrayLE(raw_value, byteArray, 448, 7);

    raw_value = convertPhysicalToRaw(@CAN_RadarRL::RRL_Object::RRL_Object_SpiHdr_FovRtrAzSegBrdr00, 0.0175, -2.24);
    copyBitsToByteArrayLE(raw_value, byteArray, 455, 8);

    raw_value = convertPhysicalToRaw(@CAN_RadarRL::RRL_Object::RRL_Object_SpiHdr_FovRtrAzSegBrdr01, 0.0175, -2.24);
    copyBitsToByteArrayLE(raw_value, byteArray, 463, 8);

    raw_value = convertPhysicalToRaw(@CAN_RadarRL::RRL_Object::RRL_Object_SpiHdr_FovRtrAzSegBrdr02, 0.0175, -2.24);
    copyBitsToByteArrayLE(raw_value, byteArray, 471, 8);

    raw_value = convertPhysicalToRaw(@CAN_RadarRL::RRL_Object::RRL_Object_SpiHdr_FovRtrAzSegBrdr03, 0.0175, -2.24);
    copyBitsToByteArrayLE(raw_value, byteArray, 480, 8);

    raw_value = convertPhysicalToRaw(@CAN_RadarRL::RRL_Object::RRL_Object_SpiHdr_FovRtrAzSegBrdr04, 0.0175, -2.24);
    copyBitsToByteArrayLE(raw_value, byteArray, 488, 8);

    raw_value = convertPhysicalToRaw(@CAN_RadarRL::RRL_Object::RRL_Object_SpiHdr_FovRtrAzSegBrdr05, 0.0175, -2.24);
    copyBitsToByteArrayLE(raw_value, byteArray, 496, 8);

    raw_value = convertPhysicalToRaw(@CAN_RadarRL::RRL_Object::RRL_Object_SpiHdr_FovRtrAzSegBrdr06, 0.0175, -2.24);
    copyBitsToByteArrayLE(raw_value, byteArray, 504, 8);

    raw_value = convertPhysicalToRaw(@CAN_RadarRL::RRL_Object::RRL_Object_SpiHdr_FovRtrAzSegBrdr07, 0.0175, -2.24);
    copyBitsToByteArrayLE(raw_value, byteArray, 512, 8);

    raw_value = convertPhysicalToRaw(@CAN_RadarRL::RRL_Object::RRL_Object_SpiHdr_FovRtrAzSegBrdr08, 0.0175, -2.24);
    copyBitsToByteArrayLE(raw_value, byteArray, 520, 8);

    raw_value = convertPhysicalToRaw(@CAN_RadarRL::RRL_Object::RRL_Object_SpiHdr_FovRtrElRngGEnd00, 0.01, 0.0);
    copyBitsToByteArrayLE(raw_value, byteArray, 320, 7);

    raw_value = convertPhysicalToRaw(@CAN_RadarRL::RRL_Object::RRL_Object_SpiHdr_FovRtrElSegBrdr10, 0.0175, -1.12);
    copyBitsToByteArrayLE(raw_value, byteArray, 309, 7);

    raw_value = convertPhysicalToRaw(@CAN_RadarRL::RRL_Object::RRL_Object_SpiHdr_FovRtrElSegBrdr09, 0.0175, -1.12);
    copyBitsToByteArrayLE(raw_value, byteArray, 302, 7);

    raw_value = convertPhysicalToRaw(@CAN_RadarRL::RRL_Object::RRL_Object_SpiHdr_DistMeasMinMod, 0.01, 0.0);
    copyBitsToByteArrayLE(raw_value, byteArray, 171, 10);

    raw_value = convertPhysicalToRaw(@CAN_RadarRL::RRL_Object::RRL_Object_ObjHdr_VersionPatch, 1.0, 0.0);
    copyBitsToByteArrayLE(raw_value, byteArray, 16, 8);

    raw_value = convertPhysicalToRaw(@CAN_RadarRL::RRL_Object::RRL_Object_ObjHdr_content_type, 1.0, 0.0);
    copyBitsToByteArrayBE(raw_value, byteArray, 24, 8);

    @CAN_RadarRL::RRL_Object::RRL_Object_ObjHdr_TimeStamp = (timeNowInt64()-@CAN_Radar::TimeSync_CAN_Radar::SYNC_LastTimeReceivedNs)/100000+@CAN_Radar::TimeSync_CAN_Radar::stbmTime_100us;  //Compute real time according to Autosar specification
    raw_value = convertPhysicalToRaw(@CAN_RadarRL::RRL_Object::RRL_Object_ObjHdr_TimeStamp, 1.0, 0.0);
    copyBitsToByteArrayLE(raw_value, byteArray, 32, 32);

    raw_value = convertPhysicalToRaw(@CAN_RadarRL::RRL_Object::RRL_Object_ObjHdr_TimeStampStatus, 1.0, 0.0);
    copyBitsToByteArrayLE(raw_value, byteArray, 64, 8);

    raw_value = convertPhysicalToRaw(@CAN_RadarRL::RRL_Object::RRL_Object_ObjHdr_NumValidObjects, 1.0, 0.0);
    copyBitsToByteArrayLE(raw_value, byteArray, 72, 10);

    raw_value = convertPhysicalToRaw(@CAN_RadarRL::RRL_Object::RRL_Object_SpiHdr_DmpId, 1.0, 0.0);
    copyBitsToByteArrayLE(raw_value, byteArray, 96, 6);

    raw_value = convertPhysicalToRaw(@CAN_RadarRL::RRL_Object::RRL_Object_SpiHdr_ModId, 1.0, 0.0);
    copyBitsToByteArrayLE(raw_value, byteArray, 102, 13);

    raw_value = convertPhysicalToRaw(@CAN_RadarRL::RRL_Object::RRL_Object_SpiHdr_DistSep, 0.01, 0.0);
    copyBitsToByteArrayLE(raw_value, byteArray, 115, 10);

    raw_value = convertPhysicalToRaw(@CAN_RadarRL::RRL_Object::RRL_Object_SpiHdr_DistStartProcDegraded, 0.01, 0.0);
    copyBitsToByteArrayLE(raw_value, byteArray, 128, 16);

    raw_value = convertPhysicalToRaw(@CAN_RadarRL::RRL_Object::RRL_Object_SpiHdr_DistPrec, 0.0001, 0.0);
    copyBitsToByteArrayLE(raw_value, byteArray, 144, 13);

    raw_value = convertPhysicalToRaw(@CAN_RadarRL::RRL_Object::RRL_Object_SpiHdr_VelPrec, 0.0001, 0.0);
    copyBitsToByteArrayLE(raw_value, byteArray, 160, 11);

    raw_value = convertPhysicalToRaw(@CAN_RadarRL::RRL_Object::RRL_Object_SpiHdr_VelSep, 0.01, 0.0);
    copyBitsToByteArrayLE(raw_value, byteArray, 181, 10);

    raw_value = convertPhysicalToRaw(@CAN_RadarRL::RRL_Object::RRL_Object_SpiHdr_FovRtrElSegBrdr08, 0.0175, -1.12);
    copyBitsToByteArrayLE(raw_value, byteArray, 295, 7);

    raw_value = convertPhysicalToRaw(@CAN_RadarRL::RRL_Object::RRL_Object_SpiHdr_DistMeasMaxMod, 0.01, 0.0);
    copyBitsToByteArrayLE(raw_value, byteArray, 192, 16);

    raw_value = convertPhysicalToRaw(@CAN_RadarRL::RRL_Object::RRL_Object_SpiHdr_DistMaxProc, 0.01, 0.0);
    copyBitsToByteArrayLE(raw_value, byteArray, 208, 16);

    raw_value = convertPhysicalToRaw(@CAN_RadarRL::RRL_Object::RRL_Object_SpiHdr_VelMeasMax, 0.1, 0.0);
    copyBitsToByteArrayLE(raw_value, byteArray, 224, 11);

    raw_value = convertPhysicalToRaw(@CAN_RadarRL::RRL_Object::RRL_Object_SpiHdr_FovRtrElSegBrdr00, 0.0175, -1.12);
    copyBitsToByteArrayLE(raw_value, byteArray, 235, 7);

    raw_value = convertPhysicalToRaw(@CAN_RadarRL::RRL_Object::RRL_Object_SpiHdr_FovRtrElSegBrdr01, 0.0175, -1.12);
    copyBitsToByteArrayLE(raw_value, byteArray, 242, 7);

    raw_value = convertPhysicalToRaw(@CAN_RadarRL::RRL_Object::RRL_Object_SpiHdr_FovRtrElSegBrdr02, 0.0175, -1.12);
    copyBitsToByteArrayLE(raw_value, byteArray, 249, 7);

    raw_value = convertPhysicalToRaw(@CAN_RadarRL::RRL_Object::RRL_Object_SpiHdr_FovRtrElSegBrdr03, 0.0175, -1.12);
    copyBitsToByteArrayLE(raw_value, byteArray, 256, 7);

    raw_value = convertPhysicalToRaw(@CAN_RadarRL::RRL_Object::RRL_Object_SpiHdr_FovRtrElSegBrdr04, 0.0175, -1.12);
    copyBitsToByteArrayLE(raw_value, byteArray, 263, 7);

    raw_value = convertPhysicalToRaw(@CAN_RadarRL::RRL_Object::RRL_Object_SpiHdr_FovRtrElSegBrdr05, 0.0175, -1.12);
    copyBitsToByteArrayLE(raw_value, byteArray, 270, 7);

    raw_value = convertPhysicalToRaw(@CAN_RadarRL::RRL_Object::RRL_Object_SpiHdr_FovRtrElSegBrdr06, 0.0175, -1.12);
    copyBitsToByteArrayLE(raw_value, byteArray, 277, 7);

    raw_value = convertPhysicalToRaw(@CAN_RadarRL::RRL_Object::RRL_Object_SpiHdr_FovRtrElSegBrdr07, 0.0175, -1.12);
    copyBitsToByteArrayLE(raw_value, byteArray, 288, 7);

    raw_value = convertPhysicalToRaw(@CAN_RadarRL::RRL_Object::RRL_Object_SpiHdr_FovRtrAzSegBrdr09, 0.0175, -2.24);
    copyBitsToByteArrayLE(raw_value, byteArray, 528, 8);

    raw_value = convertPhysicalToRaw(@CAN_RadarRL::RRL_Object::RRL_Object_SpiHdr_FovRtrAzSegBrdr11, 0.0175, -2.24);
    copyBitsToByteArrayLE(raw_value, byteArray, 544, 8);

    raw_value = convertPhysicalToRaw(@CAN_RadarRL::RRL_Object::RRL_Object_ShiiHdr_ThermalDegr, 0.01, 0.0);
    copyBitsToByteArrayLE(raw_value, byteArray, 1024, 8);

    raw_value = convertPhysicalToRaw(@CAN_RadarRL::RRL_Object::RRL_Object_SpiHdr_FovRtrAzSegBrdr12, 0.0175, -2.24);
    copyBitsToByteArrayLE(raw_value, byteArray, 552, 8);

    raw_value = convertPhysicalToRaw(@CAN_RadarRL::RRL_Object::RRL_Object_SpiHdr_FovRtrAzDetRng16, 1.0, 0.0);
    copyBitsToByteArrayLE(raw_value, byteArray, 832, 10);

    raw_value = convertPhysicalToRaw(@CAN_RadarRL::RRL_Object::RRL_Object_SpiHdr_FovRtrAzDetRng17, 1.0, 0.0);
    copyBitsToByteArrayLE(raw_value, byteArray, 842, 10);

    raw_value = convertPhysicalToRaw(@CAN_RadarRL::RRL_Object::RRL_Object_SpiHdr_FovRtrAzDetRng18, 1.0, 0.0);
    copyBitsToByteArrayLE(raw_value, byteArray, 852, 10);

    raw_value = convertPhysicalToRaw(@CAN_RadarRL::RRL_Object::RRL_Object_SpiHdr_FovRtrAzDetRng19, 1.0, 0.0);
    copyBitsToByteArrayLE(raw_value, byteArray, 864, 10);

    raw_value = convertPhysicalToRaw(@CAN_RadarRL::RRL_Object::RRL_Object_SpiHdr_FovRtrAzDetRng20, 1.0, 0.0);
    copyBitsToByteArrayLE(raw_value, byteArray, 874, 10);

    raw_value = convertPhysicalToRaw(@CAN_RadarRL::RRL_Object::RRL_Object_SpiHdr_FovRtrAzDetRng21, 1.0, 0.0);
    copyBitsToByteArrayLE(raw_value, byteArray, 884, 10);

    raw_value = convertPhysicalToRaw(@CAN_RadarRL::RRL_Object::RRL_Object_SpiHdr_FovRtrAzDetRng22, 1.0, 0.0);
    copyBitsToByteArrayLE(raw_value, byteArray, 896, 10);

    raw_value = convertPhysicalToRaw(@CAN_RadarRL::RRL_Object::RRL_Object_SpiHdr_FovRtrAzDetRng23, 1.0, 0.0);
    copyBitsToByteArrayLE(raw_value, byteArray, 906, 10);

    raw_value = convertPhysicalToRaw(@CAN_RadarRL::RRL_Object::RRL_Object_SpiHdr_FovRtrAzDetRng24, 1.0, 0.0);
    copyBitsToByteArrayLE(raw_value, byteArray, 916, 10);

    raw_value = convertPhysicalToRaw(@CAN_RadarRL::RRL_Object::RRL_Object_SpiHdr_BldFov_Status, 1.0, 0.0);
    copyBitsToByteArrayLE(raw_value, byteArray, 928, 3);

    raw_value = convertPhysicalToRaw(@CAN_RadarRL::RRL_Object::RRL_Object_SpiHdr_BldFov_Confidence, 2.0, 0.0);
    copyBitsToByteArrayLE(raw_value, byteArray, 931, 6);

    raw_value = convertPhysicalToRaw(@CAN_RadarRL::RRL_Object::RRL_Object_SpiHdr_SensorOriginPointX, 0.02, -5.12);
    copyBitsToByteArrayLE(raw_value, byteArray, 937, 9);

    raw_value = convertPhysicalToRaw(@CAN_RadarRL::RRL_Object::RRL_Object_SpiHdr_SensorOriginPointY, 0.01, -1.28);
    copyBitsToByteArrayLE(raw_value, byteArray, 946, 8);

    raw_value = convertPhysicalToRaw(@CAN_RadarRL::RRL_Object::RRL_Object_SpiHdr_SensorOriginPointZ, 0.05, 0.0);
    copyBitsToByteArrayLE(raw_value, byteArray, 954, 5);

    raw_value = convertPhysicalToRaw(@CAN_RadarRL::RRL_Object::RRL_Object_SpiHdr_BldOperationMode, 1.0, 0.0);
    copyBitsToByteArrayLE(raw_value, byteArray, 959, 1);

    raw_value = convertPhysicalToRaw(@CAN_RadarRL::RRL_Object::RRL_Object_ShiiHdr_DataMeasured, 1.0, 0.0);
    copyBitsToByteArrayLE(raw_value, byteArray, 960, 2);

    raw_value = convertPhysicalToRaw(@CAN_RadarRL::RRL_Object::RRL_Object_ShiiHdr_SensorCalExtStat, 1.0, 0.0);
    copyBitsToByteArrayLE(raw_value, byteArray, 968, 1);

    raw_value = convertPhysicalToRaw(@CAN_RadarRL::RRL_Object::RRL_Object_ShiiHdr_SensorCalIntStat, 1.0, 0.0);
    copyBitsToByteArrayLE(raw_value, byteArray, 969, 1);

    raw_value = convertPhysicalToRaw(@CAN_RadarRL::RRL_Object::RRL_Object_ShiiHdr_SensorHeatingStatus, 1.0, 0.0);
    copyBitsToByteArrayLE(raw_value, byteArray, 970, 2);

    raw_value = convertPhysicalToRaw(@CAN_RadarRL::RRL_Object::RRL_Object_ShiiHdr_SensorCalOnlStat, 1.0, 0.0);
    copyBitsToByteArrayLE(raw_value, byteArray, 972, 4);

    raw_value = convertPhysicalToRaw(@CAN_RadarRL::RRL_Object::RRL_Object_ShiiHdr_MisAzOOPCause, 1.0, 0.0);
    copyBitsToByteArrayLE(raw_value, byteArray, 976, 8);

    raw_value = convertPhysicalToRaw(@CAN_RadarRL::RRL_Object::RRL_Object_ShiiHdr_MisElOOPCause, 1.0, 0.0);
    copyBitsToByteArrayLE(raw_value, byteArray, 984, 8);

    raw_value = convertPhysicalToRaw(@CAN_RadarRL::RRL_Object::RRL_Object_ShiiHdr_SensorFailureReas, 1.0, 0.0);
    copyBitsToByteArrayLE(raw_value, byteArray, 992, 16);

    raw_value = convertPhysicalToRaw(@CAN_RadarRL::RRL_Object::RRL_Object_ShiiHdr_SensorOmmOpMode, 1.0, 0.0);
    copyBitsToByteArrayLE(raw_value, byteArray, 1008, 8);

    raw_value = convertPhysicalToRaw(@CAN_RadarRL::RRL_Object::RRL_Object_ShiiHdr_RatioAdvProcListProc, 1.0, 0.0);
    copyBitsToByteArrayLE(raw_value, byteArray, 1016, 8);

    raw_value = convertPhysicalToRaw(@CAN_RadarRL::RRL_Object::RRL_Object_SpiHdr_FovRtrAzDetRng15, 1.0, 0.0);
    copyBitsToByteArrayLE(raw_value, byteArray, 820, 10);

    raw_value = convertPhysicalToRaw(@CAN_RadarRL::RRL_Object::RRL_Object_SpiHdr_FovRtrAzDetRng14, 1.0, 0.0);
    copyBitsToByteArrayLE(raw_value, byteArray, 810, 10);

    raw_value = convertPhysicalToRaw(@CAN_RadarRL::RRL_Object::RRL_Object_SpiHdr_FovRtrAzDetRng13, 1.0, 0.0);
    copyBitsToByteArrayLE(raw_value, byteArray, 800, 10);

    raw_value = convertPhysicalToRaw(@CAN_RadarRL::RRL_Object::RRL_Object_SpiHdr_FovRtrAzSegBrdr24, 0.0175, -2.24);
    copyBitsToByteArrayLE(raw_value, byteArray, 648, 8);

    raw_value = convertPhysicalToRaw(@CAN_RadarRL::RRL_Object::RRL_Object_SpiHdr_FovRtrAzSegBrdr13, 0.0175, -2.24);
    copyBitsToByteArrayLE(raw_value, byteArray, 560, 8);

    raw_value = convertPhysicalToRaw(@CAN_RadarRL::RRL_Object::RRL_Object_SpiHdr_FovRtrAzSegBrdr14, 0.0175, -2.24);
    copyBitsToByteArrayLE(raw_value, byteArray, 568, 8);

    raw_value = convertPhysicalToRaw(@CAN_RadarRL::RRL_Object::RRL_Object_SpiHdr_FovRtrAzSegBrdr15, 0.0175, -2.24);
    copyBitsToByteArrayLE(raw_value, byteArray, 576, 8);

    raw_value = convertPhysicalToRaw(@CAN_RadarRL::RRL_Object::RRL_Object_SpiHdr_FovRtrAzSegBrdr16, 0.0175, -2.24);
    copyBitsToByteArrayLE(raw_value, byteArray, 584, 8);

    raw_value = convertPhysicalToRaw(@CAN_RadarRL::RRL_Object::RRL_Object_SpiHdr_FovRtrAzSegBrdr17, 0.0175, -2.24);
    copyBitsToByteArrayLE(raw_value, byteArray, 592, 8);

    raw_value = convertPhysicalToRaw(@CAN_RadarRL::RRL_Object::RRL_Object_SpiHdr_FovRtrAzSegBrdr18, 0.0175, -2.24);
    copyBitsToByteArrayLE(raw_value, byteArray, 600, 8);

    raw_value = convertPhysicalToRaw(@CAN_RadarRL::RRL_Object::RRL_Object_SpiHdr_FovRtrAzSegBrdr19, 0.0175, -2.24);
    copyBitsToByteArrayLE(raw_value, byteArray, 608, 8);

    raw_value = convertPhysicalToRaw(@CAN_RadarRL::RRL_Object::RRL_Object_SpiHdr_FovRtrAzSegBrdr20, 0.0175, -2.24);
    copyBitsToByteArrayLE(raw_value, byteArray, 616, 8);

    raw_value = convertPhysicalToRaw(@CAN_RadarRL::RRL_Object::RRL_Object_SpiHdr_FovRtrAzSegBrdr21, 0.0175, -2.24);
    copyBitsToByteArrayLE(raw_value, byteArray, 624, 8);

    raw_value = convertPhysicalToRaw(@CAN_RadarRL::RRL_Object::RRL_Object_SpiHdr_FovRtrAzSegBrdr22, 0.0175, -2.24);
    copyBitsToByteArrayLE(raw_value, byteArray, 632, 8);

    raw_value = convertPhysicalToRaw(@CAN_RadarRL::RRL_Object::RRL_Object_SpiHdr_FovRtrAzSegBrdr23, 0.0175, -2.24);
    copyBitsToByteArrayLE(raw_value, byteArray, 640, 8);

    raw_value = convertPhysicalToRaw(@CAN_RadarRL::RRL_Object::RRL_Object_SpiHdr_FovRtrAzDetRng00, 1.0, 0.0);
    copyBitsToByteArrayLE(raw_value, byteArray, 656, 10);

    raw_value = convertPhysicalToRaw(@CAN_RadarRL::RRL_Object::RRL_Object_SpiHdr_FovRtrAzDetRng12, 1.0, 0.0);
    copyBitsToByteArrayLE(raw_value, byteArray, 788, 10);

    raw_value = convertPhysicalToRaw(@CAN_RadarRL::RRL_Object::RRL_Object_SpiHdr_FovRtrAzDetRng01, 1.0, 0.0);
    copyBitsToByteArrayLE(raw_value, byteArray, 672, 10);

    raw_value = convertPhysicalToRaw(@CAN_RadarRL::RRL_Object::RRL_Object_SpiHdr_FovRtrAzDetRng02, 1.0, 0.0);
    copyBitsToByteArrayLE(raw_value, byteArray, 682, 10);

    raw_value = convertPhysicalToRaw(@CAN_RadarRL::RRL_Object::RRL_Object_SpiHdr_FovRtrAzDetRng03, 1.0, 0.0);
    copyBitsToByteArrayLE(raw_value, byteArray, 692, 10);

    raw_value = convertPhysicalToRaw(@CAN_RadarRL::RRL_Object::RRL_Object_SpiHdr_FovRtrAzDetRng04, 1.0, 0.0);
    copyBitsToByteArrayLE(raw_value, byteArray, 704, 10);

    raw_value = convertPhysicalToRaw(@CAN_RadarRL::RRL_Object::RRL_Object_SpiHdr_FovRtrAzDetRng05, 1.0, 0.0);
    copyBitsToByteArrayLE(raw_value, byteArray, 714, 10);

    raw_value = convertPhysicalToRaw(@CAN_RadarRL::RRL_Object::RRL_Object_SpiHdr_FovRtrAzDetRng06, 1.0, 0.0);
    copyBitsToByteArrayLE(raw_value, byteArray, 724, 10);

    raw_value = convertPhysicalToRaw(@CAN_RadarRL::RRL_Object::RRL_Object_SpiHdr_FovRtrAzDetRng07, 1.0, 0.0);
    copyBitsToByteArrayLE(raw_value, byteArray, 736, 10);

    raw_value = convertPhysicalToRaw(@CAN_RadarRL::RRL_Object::RRL_Object_SpiHdr_FovRtrAzDetRng08, 1.0, 0.0);
    copyBitsToByteArrayLE(raw_value, byteArray, 746, 10);

    raw_value = convertPhysicalToRaw(@CAN_RadarRL::RRL_Object::RRL_Object_SpiHdr_FovRtrAzDetRng09, 1.0, 0.0);
    copyBitsToByteArrayLE(raw_value, byteArray, 756, 10);

    raw_value = convertPhysicalToRaw(@CAN_RadarRL::RRL_Object::RRL_Object_SpiHdr_FovRtrAzDetRng10, 1.0, 0.0);
    copyBitsToByteArrayLE(raw_value, byteArray, 768, 10);

    raw_value = convertPhysicalToRaw(@CAN_RadarRL::RRL_Object::RRL_Object_SpiHdr_FovRtrAzDetRng11, 1.0, 0.0);
    copyBitsToByteArrayLE(raw_value, byteArray, 778, 10);

    raw_value = convertPhysicalToRaw(@CAN_RadarRL::RRL_Object::RRL_Object_E2E_p44_crc, 1.0, 0.0);
    copyBitsToByteArrayBE(raw_value, byteArray, 25696, 32);
}


void Transmit_Pdu_CRadarRL_RRL_Object()
{
   long txCount ;
   pdu RRL_Object pdu_RRL_Object;
   byte txDataBuffer[kBufferSizeJumbo_CRadarRL_RRL_Object_TpData];
   byte txDataBuffer_null[kBufferSizeJumbo_CRadarRL_RRL_Object_TpData];
   txCount = kBufferSizeJumbo_CRadarRL_RRL_Object_TpData;
   Write_OsekTP_CRadarRL_RRL_Object(txDataBuffer);
   // OSEK TP supports up to 4 GiB with Jumbo frames, but limit that to a much lower value for this demo
   if (txCount > kBufferSizeJumbo_CRadarRL_RRL_Object_TpData)
   {
      txCount = kBufferSizeJumbo_CRadarRL_RRL_Object_TpData;
   }
   CanTpSendData(gHandle_CRadarRL_RRL_Object_TpData, txDataBuffer, txCount);
   memcpy(txDataBuffer, txDataBuffer_null, txCount);
}

on sysvar CAN_RadarRL::RRL_RoadSideBoundaries::RRL_RoadSideBoundaries_ON_OFF
{
  if ((@this == 1)&& (@hil_ctrl::ra6_rl_sgu_obj_sim == 1))
   {
      Transmit_Pdu_CRadarRL_RRL_RoadSideBoundaries();
      @sysvar::CAN_RadarRL::RRL_RoadSideBoundaries::RRL_RoadSideBoundaries_ON_OFF= 0;
   }
}
 


void Write_OsekTP_CRadarRL_RRL_RoadSideBoundaries(byte byteArray[])
{
    qword raw_value;

}


void Transmit_Pdu_CRadarRL_RRL_RoadSideBoundaries()
{
   long txCount ;
   pdu RRL_RoadSideBoundaries pdu_RRL_RoadSideBoundaries;
   byte txDataBuffer[kBufferSizeJumbo_CRadarRL_RRL_RoadSideBoundaries_TpData];
   byte sendString[kBufferSizeJumbo_CRadarRL_RRL_RoadSideBoundaries_TpData];
   byte txDataBuffer_null[kBufferSizeJumbo_CRadarRL_RRL_RoadSideBoundaries_TpData];
   byte emptyString[kBufferSizeJumbo_CRadarRL_RRL_RoadSideBoundaries_TpData];
   long copiedBytes; 
     long TxLength; 

   // Preparation same as sysSendData 
     TxLength = 0;
   if (sysGetVariableData(sysvar::CAN_RadarRL::RRL_RoadSideBoundaries::RRL_RoadSideBoundaries::SignalValue, sendString, copiedBytes) == 0)
   { 
       TxLength=copiedBytes; 
       memcpy( txDataBuffer, sendString, TxLength); 
     } 

   // Start of TransmitTxBuffer()
   CanTpSendData(gHandle_CRadarRL_RRL_RoadSideBoundaries_TpData, txDataBuffer, TxLength);
   sysSetVariableData(sysvar::CAN_RadarRL::RRL_RoadSideBoundaries::RRL_RoadSideBoundaries::SignalValue,txDataBuffer,TxLength);
   // End of TransmitTxBuffer() 

     memcpy(txDataBuffer, txDataBuffer_null, txCount); 
}
//  ARILSetPDUTimingCyclic (dbMsg dbMessage, long TrueOrFalse, long offset, long period, long disturbanceCount, long flags);
//  TrueOrFalse ; 0: denotes the False timing; 1: denotes the True timing; 3: denotes the True and the False timing.
//  offset :Defines the delay in [ms] from now when the first cyclic transmission will start.
//  period :Defines the period in [ms] for the cyclic transmission.
//  disturbanceCount :Reserved/unused; should be set to -1 (infinite).
//  flags :Reserved; should be set to 0.

on sysvar CAN_RadarRL::RRL_CornerFunctions::RRL_CornerFunctions_CycleTime
{
  ARILSetPDUTimingCyclic (CAN_RadarRL::RRL_CornerFunctions, 3, 0, @this, -1, 0);//TrueOrFalse=3,offset=0;disturbanceCount =-1;flags=0
  //ARILResetPDUTimingCyclic(RRL_CornerFunctions,3);//TrueOrFalse=3
}

on sysvar CAN_RadarRL::RRL_SensorOutput::RRL_SensorOutput_CycleTime
{
  ARILSetPDUTimingCyclic (CAN_RadarRL::RRL_SensorOutput, 3, 1, @this, -1, 0);//TrueOrFalse=3,offset=1;disturbanceCount =-1;flags=0
  //ARILResetPDUTimingCyclic(RRL_SensorOutput,3);//TrueOrFalse=3
}

void CRadarRL_sim_SetCycleTimeOffset()
{

//  ARILSetPDUTimingCyclic (dbMsg dbMessage, long TrueOrFalse, long offset, long period, long disturbanceCount, long flags);
//  TrueOrFalse ; 0: denotes the False timing; 1: denotes the True timing; 3: denotes the True and the False timing.
//  offset :Defines the delay in [ms] from now when the first cyclic transmission will start.
//  period :Defines the period in [ms] for the cyclic transmission.
//  disturbanceCount :Reserved/unused; should be set to -1 (infinite).
//  flags :Reserved; should be set to 0.
  ARILSetPDUTimingCyclic (CAN_RadarRL::RRL_CornerFunctions, 3, 0, 50, -1, 0);//TrueOrFalse=3;offset=0;cycletime=50;disturbanceCount =-1;flags=0
  //ARILResetPDUTimingCyclic(RRL_CornerFunctions,3);//TrueOrFalse=3
  ARILSetPDUTimingCyclic (CAN_RadarRL::RRL_SensorOutput, 3, 1, 20, -1, 0);//TrueOrFalse=3;offset=1;cycletime=20;disturbanceCount =-1;flags=0
  //ARILResetPDUTimingCyclic(RRL_SensorOutput,3);//TrueOrFalse=3

}

void OnSecurityLocalPDUPreTx(char pduName[], dword dataId, byte payload[], dword payloadLength, qword& authInfoHigh, qword& authInfo, dword authInfoBitLength, qword& freshness, dword freshnessBitLength, dword freshnessValueId)//This callback handler is called, after all data updates and the automatic Authenticator (CMAC) calculation has be done
{
}