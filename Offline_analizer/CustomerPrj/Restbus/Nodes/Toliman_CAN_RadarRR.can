/*@!Encoding:1252*/
// Autogenerated by -> Platform\Classe\Scripts\Rbs_Scripts\create_nodes.py
includes
{
  #pragma library ("C:\ProgramData\Vector\AddOn Packages\Vector AddOn\vModules\AsrPDUIL2.vmodule")
  #include "CAPL\DataHandling.cin" /*DataHandling for IL*/
  #include "CAPL\E2E.cin" /*OD Specific for CRC calculation */
  #include "OSEKTP\OSEKTP.cin"  //common definations for osektp
  #include "OSEKTP\OSEKTP_CAN_RadarRR_Toliman_RRR_FieldDataCollection_TpFC.cin"  ///For handling  pdu RRR_FieldDataCollection_TpFC with OSEKtp
  #include "OSEKTP\OSEKTP_CAN_RadarRR_Toliman_RRR_Object_TpFC.cin"  ///For handling  pdu RRR_Object_TpFC with OSEKtp
  #include "OSEKTP\OSEKTP_CAN_RadarRR_Toliman_RRR_RoadSideBoundaries_TpFC.cin"  ///For handling  pdu RRR_RoadSideBoundaries_TpFC with OSEKtp
  #include "Opaque_Byte_Order\Opaque_CAN_RadarRR_Toliman_RRR_Veh_ConfigMgmt_RRR_Veh_ConfigMgmt.cin" /*Signal Opaque byte order handling*/
}

variables {
  int i;
  char sysvarElementName[256];
  char mSysVarNameSpace_CAN_RadarRR_RRR_Object[50] = "CAN_RadarRR::RRR_Object";
  char mSysVarNameSpace_CAN_RadarRR_RRR_RoadSideBoundaries[50] = "CAN_RadarRR::RRR_RoadSideBoundaries";
  char mSysVarNameSpace_CAN_RadarRR_RRR_FieldDataCollection[50] = "CAN_RadarRR::RRR_FieldDataCollection";
  message RRR_Veh_SensorConfig Msg_RRR_Veh_SensorConfig;
  message Veh_SensorInput Msg_Veh_SensorInput;
  message RRR_Veh_ConfigMgmt Msg_RRR_Veh_ConfigMgmt;

  word counter_RRR_Veh_SensorConfig_RRR_Veh_SenConfig_SQC;
  word counter_Veh_SensorInput_RRR_Veh_SenIn_SQC;

  dword crc_RRR_Veh_SensorConfig_RRR_Veh_SenConfig_CRC;
  dword crc_Veh_SensorInput_RRR_Veh_SenIn_CRC;

}

on preStart {
  long result;
  result=ARILControlInit ();//Initialization of AUTOSAR PDU IL,to prevent the IL autostart function.
  switch(result)
  {
    case  0    : write("ARILControlInit :: Toliman :: No error."); break;
    case -1    : write("ARILControlInit :: Toliman :: IL is in a state that ignores the given request: State graph of the IL (Link)."); break;
    case -2    : write("ARILControlInit :: Toliman :: Allowed value range of a signal exceeded. (The exceeded value is transmitted to the bus nevertheless).");  break;
    case -50   : write("ARILControlInit :: Toliman :: Node layer is not active. Presumably it is deactivated in the node’s configuration dialog."); break;
    case -51   : write("ARILControlInit :: Toliman :: The node is connected to another bus like the CAN Bus."); break;
    case -100  : write("ARILControlInit :: Toliman :: Signal/message not found in DB, or not mapped to the node."); break;
    case -101  : write("ARILControlInit :: Toliman :: Maximum possible value range exceeded. (There is no transmission to the bus)."); break;
    case -102  : write("ARILControlInit :: Toliman :: A network management-, diagnostic, or transport protocol signal was set. IL declines such types of signals, because it is not intended to connect these layers to the IL."); break;
    case -103  : write("ARILControlInit :: Toliman :: Invalid value supplied (for all types of requests)."); break;
    case -104  : write("ARILControlInit :: Toliman :: General error for invalid requests that are not described furthermore."); break;
   }

  Toliman_sim_Disable();
  Toliman_sim_SetCycleTimeOffset();
}

on start {

  ARILControlSimulationOn();//Starts the simulation of the IL. The IL is operational and started. The IL will send PDUs.
  Toliman_sim_DisableMsg();
  Toliman_sim_Disable();
  ARILControlStart ();//When the IL is started, then it is fully operating and sending.
  Toliman_sim_Reset();
  OnStart_init_CANTP_Toliman();
  OnStart_callTx_Toliman_RRR_FieldDataCollection_TpFC();
  CallTx_Toliman_RRR_FieldDataCollection_TpFC_hil_ctrl_adas_sim();
  OnStart_callTx_Toliman_RRR_Object_TpFC();
  OnStart_callTx_Toliman_RRR_RoadSideBoundaries_TpFC();
}

OnStart_init_CANTP_Toliman()
{
  long dbHandle; 
  dbHandle = CanTpGetDBConnection();
  if (dbHandle > 0) 
  { 
    CanTpCloseConnection(dbHandle); 
  }
}

on stopMeasurement {

  Toliman_sim_DisableMsg();
  Toliman_sim_Disable();
  ARILControlStop();//Stops sending of PDUs.
  ARILControlSimulationOff();//Stops the simulation of the IL. The IL is not operational. All API function except function ARILControlSimulationOn will not work.

}

on sysvar_update hil_ctrl::adas_sim
{
  CallTx_Toliman_RRR_FieldDataCollection_TpFC_hil_ctrl_adas_sim();
  Toliman_sim_Reset();
}

on sysvar_update hil_ctrl::variant
{
  Toliman_sim_Reset();
}

on sysvar_update Cus_bus::bus_CAN_RadarRR_ON_OFF
{
  Toliman_sim_Reset();
}

void Toliman_sim_Reset()
{

  Toliman_sim_DisableMsg();
  Toliman_sim_Disable();

  if ((@Cus_bus::bus_CAN_RadarRR_ON_OFF == 1) && (@hil_ctrl::adas_sim == 1))
  {
    switch(@hil_ctrl::variant)
    {
      case a_variant:Toliman_sim_start_a_variant();break;
      case b_variant:Toliman_sim_start_b_variant();break;
    }
    if (@hil_ctrl::hil_mode == @hil_ctrl::hil_mode::Restbus) 
    {
       Toliman_sim_EnableEventMsg();
    }
    else
    {
       Toliman_sim_DisableEventMsg();
    }
  }
}

void Toliman_sim_start_a_variant()
{
//  OnStart_callTx_Toliman_RRR_Object_TpFC();
//  OnStart_callTx_Toliman_RRR_RoadSideBoundaries_TpFC();
//  OnStart_callTx_Toliman_RRR_FieldDataCollection_TpFC();
  @CAN_RadarRR::Veh_SensorInput::Veh_SensorInput_ON_OFF = 1;
  @CAN_RadarRR::RRR_Veh_ConfigMgmt::RRR_Veh_ConfigMgmt_ON_OFF = 1;
}

void Toliman_sim_start_b_variant()
{
//  OnStart_callTx_Toliman_RRR_Object_TpFC();
//  OnStart_callTx_Toliman_RRR_RoadSideBoundaries_TpFC();
//  OnStart_callTx_Toliman_RRR_FieldDataCollection_TpFC();
  @CAN_RadarRR::Veh_SensorInput::Veh_SensorInput_ON_OFF = 1;
  @CAN_RadarRR::RRR_Veh_ConfigMgmt::RRR_Veh_ConfigMgmt_ON_OFF = 1;
}

void Toliman_sim_Disable()
{
  @CAN_RadarRR::RRR_Veh_SensorConfig::RRR_Veh_SensorConfig_ON_OFF = 0;
  @CAN_RadarRR::Veh_SensorInput::Veh_SensorInput_ON_OFF = 0;
  @CAN_RadarRR::RRR_Veh_ConfigMgmt::RRR_Veh_ConfigMgmt_ON_OFF = 0;
}

void Toliman_sim_DisableMsg()
{
   ARILFaultInjectionDisablePDU(CAN_RadarRR::RRR_Veh_SensorConfig);
//   if (gHandle_Toliman_RRR_Object_TpFC > 0)
//    {
//       CanTpCloseConnection(gHandle_Toliman_RRR_Object_TpFC);
//    }
//   if (gHandle_Toliman_RRR_RoadSideBoundaries_TpFC > 0)
//    {
//       CanTpCloseConnection(gHandle_Toliman_RRR_RoadSideBoundaries_TpFC);
//    }
//   if (gHandle_Toliman_RRR_FieldDataCollection_TpFC > 0)
//    {
//       CanTpCloseConnection(gHandle_Toliman_RRR_FieldDataCollection_TpFC);
//    }
   ARILFaultInjectionDisablePDU(CAN_RadarRR::Veh_SensorInput);
   ARILFaultInjectionDisablePDU(CAN_RadarRR::RRR_Veh_ConfigMgmt);
}
on sysvar hil_ctrl::hil_mode
{
  Toliman_sim_Reset();
}

void Toliman_sim_DisableEventMsg()
{
   ARILFaultInjectionDisablePDU(CAN_RadarRR::RRR_Veh_SensorConfig);

}

void Toliman_sim_EnableEventMsg()
{
   ARILFaultInjectionEnablePDU(CAN_RadarRR::RRR_Veh_SensorConfig);

}

dword applPDUILTxPending (dword busContext, dword shortID, dword longID, char name[], dword & aPDULength, byte data[])//This callback is being called before the IL sends a PDU to the bus
{
  if(strncmp(name, "RRR_Veh_SensorConfig", elcount(name)) == 0)
  {
    cfg_Pdu_RRR_Veh_SensorConfig(aPDULength, data);
    return 1; // don't prevent sending of the pdu
  }
  if(strncmp(name, "Veh_SensorInput", elcount(name)) == 0)
  {
    cfg_Pdu_Veh_SensorInput(aPDULength, data);
    return 1; // don't prevent sending of the pdu
  }
  if(strncmp(name, "RRR_Veh_ConfigMgmt", elcount(name)) == 0)
  {
    cfg_Pdu_RRR_Veh_ConfigMgmt(aPDULength, data);
    return 1; // don't prevent sending of the pdu
  }
  return 1; // don't prevent sending of the pdu
}

on sysvar CAN_RadarRR::RRR_Veh_ConfigMgmt::RRR_Veh_ConfigMgmt_ON_OFF
{
  if (@this == 1)
  {
    ARILFaultInjectionEnablePDU(CAN_RadarRR::RRR_Veh_ConfigMgmt);
  }
  else{
         ARILFaultInjectionDisablePDU(CAN_RadarRR::RRR_Veh_ConfigMgmt);
      }
}

void cfg_Pdu_RRR_Veh_ConfigMgmt(dword & aPDULength, byte data[])
{
   int64 i,k;//For looping
   byte xor,data_byte;
   dword crcTemp;
   byte DataLength;
   dword Msg_id;
   byte sendString[38]; 
   long copiedBytes; 
   long TxLength; 
   byte RRR_Veh_ConfigMgmt_array[38];
   
   DataLength = Msg_RRR_Veh_ConfigMgmt.DataLength;//Message Data Length
   Msg_id  = Msg_RRR_Veh_ConfigMgmt.id;//Message ID
   
   // Initialize RRR_Veh_ConfigMgmt_array to zero
   for (i = 0; i < elcount(RRR_Veh_ConfigMgmt_array); i++)
   {
     RRR_Veh_ConfigMgmt_array[i] = 0;
   }
   if (sysGetVariableData(sysvar::CAN_RadarRR::RRR_Veh_ConfigMgmt::RRR_Veh_ConfigMgmt::SignalValue, sendString, copiedBytes) == 0)
   { 
     TxLength=copiedBytes;
     memcpy( RRR_Veh_ConfigMgmt_array, sendString, TxLength);
   }
   // Output the destination array for verification
   // for (i = 0; i < elcount(RRR_Veh_ConfigMgmt_array); i++)
   // {
    // write("0x%02X ", RRR_Veh_ConfigMgmt_array[i]);
   // }
   
   copyByteArrayToByteArray(RRR_Veh_ConfigMgmt_array, data, 0, 160);
   
}


on sysvar CAN_RadarRR::RRR_Veh_SensorConfig::RRR_Veh_SensorConfig_ON_OFF
{
  if (@this == 1)
  {
     ARILSetPDUEvent(CAN_RadarRR::RRR_Veh_SensorConfig);
     @CAN_RadarRR::RRR_Veh_SensorConfig::RRR_Veh_SensorConfig_ON_OFF = 0;
  }
}

void cfg_Pdu_RRR_Veh_SensorConfig(dword & aPDULength, byte data[])
{
   int64 i,k;//For looping
   byte xor,data_byte;
   dword crcTemp;
   byte DataLength;
   dword Msg_id;
   long result;
   long type=0;//reserved (should be set to 0).
   long disturbanceMode  =0; //0 :: set to disturbanceValue //2 :: set to Random value //3 :: Offset Signal value is increased by disturbanceValue
   long disturbanceCount =0;//-1 ::Infinite Disturbance is continuously applied //0 ::Stop An active disturbance is stopped and the SequenceCounter/crc will be calculated again appropriately //n > 0 ::Count Do exactly n Repetition/disturbances
   long disturbanceValue =0;//According to the disturbance mode the SequenceCounter/crc will optionally be set to this value
   dword crc[1];
   
   DataLength = Msg_RRR_Veh_SensorConfig.DataLength;//Message Data Length
   Msg_id  = Msg_RRR_Veh_SensorConfig.id;//Message ID
   
{
   
   long continueMode=2;
   //0 :: The counter will continue as if there had never been a disturbance [0, 1, 2, 6, 6, 5, 6]
   //1 :: The counter will continue by increasing last valid counter [0, 1, 2, 6, 6, 3, 4]
   //2 :: The counter will continue by increasing the last transmitted value [0, 1, 2, 6, 6, 7, 8]
   
   if (@CAN_RadarRR::RRR_Veh_SensorConfig::RRR_Veh_SenConfig_SQC_FaultInject == 0)//AC: No Error, calculate AC
   {
      disturbanceCount=0;//0 Stop An active disturbance is stopped and the CRC will be calculated again appropriately
      result=ARILFaultInjectionDisturbSequenceCounter (RRR_Veh_SensorConfig, "Veh_SensorConfig", type, disturbanceMode, disturbanceCount, disturbanceValue, continueMode);
      //write("ARILFaultInjectionDisturbSequenceCounter :: RRR_Veh_SensorConfig :: Veh_SensorConfig :: RRR_Veh_SenConfig_SQC :: No Error");
   }
   else if (@CAN_RadarRR::RRR_Veh_SensorConfig::RRR_Veh_SenConfig_SQC_FaultInject == 1)//AC: Error , set AC = 0
   {
      disturbanceCount  = -1;//-1 Infinite Disturbance is continuously applied
      disturbanceMode   = 0;//Sets the AC fix to the value of parameter disturbanceValue.
      disturbanceValue  = 0;//set AC = 0
      result=ARILFaultInjectionDisturbSequenceCounter (RRR_Veh_SensorConfig, "Veh_SensorConfig", type, disturbanceMode, disturbanceCount, disturbanceValue, continueMode);
      //write("ARILFaultInjectionDisturbSequenceCounter :: RRR_Veh_SensorConfig :: Veh_SensorConfig :: RRR_Veh_SenConfig_SQC :: AC = 0");
   }
   else if (@CAN_RadarRR::RRR_Veh_SensorConfig::RRR_Veh_SenConfig_SQC_FaultInject == 2)//AC: Error , Freeze last valid value
   {
      disturbanceCount  = -1;//-1 Infinite Disturbance is continuously applied
      disturbanceMode   = 1;//1 Freeze Current signal value is used (disturbanceValue is not used)
      result=ARILFaultInjectionDisturbSequenceCounter (RRR_Veh_SensorConfig, "Veh_SensorConfig", type, disturbanceMode, disturbanceCount, disturbanceValue, continueMode);
      //write("ARILFaultInjectionDisturbSequenceCounter :: RRR_Veh_SensorConfig :: Veh_SensorConfig :: RRR_Veh_SenConfig_SQC :: Freeze");
   }
}
{
   if (@CAN_RadarRR::RRR_Veh_SensorConfig::RRR_Veh_SenConfig_CRC_FaultInject == 0)//CRC: No Error, calculate CRC
   {
      disturbanceCount  = 1;//Once Disturbance is applied
      disturbanceMode   = 0;//Sets the CRC fix to the value of parameter disturbanceValue.
      ARILCalculateCRC("RRR_Veh_SensorConfig","Veh_SensorConfig",data,aPDULength,crc);//Profile 11A
      disturbanceValue=crc_RRR_Veh_SensorConfig_RRR_Veh_SenConfig_CRC=crc[0]^0xFF;
      result=ARILFaultInjectionDisturbChecksum (RRR_Veh_SensorConfig, "Veh_SensorConfig", type, disturbanceMode, disturbanceCount, disturbanceValue);
      //write("ARILFaultInjectionDisturbChecksum :: RRR_Veh_SensorConfig :: Veh_SensorConfig :: RRR_Veh_SenConfig_CRC :: No Error");
   }
   else if (@CAN_RadarRR::RRR_Veh_SensorConfig::RRR_Veh_SenConfig_CRC_FaultInject == 1)//CRC: Error , set CRC = 0
   {
      disturbanceCount  = 1;//Once Disturbance is continuously applied
      disturbanceMode   = 0;//Sets the CRC fix to the value of parameter disturbanceValue.
      disturbanceValue  = 0;//set CRC = 0
      result=ARILFaultInjectionDisturbChecksum (RRR_Veh_SensorConfig, "Veh_SensorConfig", type, disturbanceMode, disturbanceCount, disturbanceValue);
      //write("ARILFaultInjectionDisturbChecksum :: RRR_Veh_SensorConfig :: Veh_SensorConfig :: RRR_Veh_SenConfig_CRC :: AC = 0");
   }
   else if (@CAN_RadarRR::RRR_Veh_SensorConfig::RRR_Veh_SenConfig_CRC_FaultInject == 2)//CRC: Error , Freeze last valid value
   {
      disturbanceCount  = 1;//Once Disturbance is  applied
      disturbanceMode   = 0;//Sets the CRC fix to the value of parameter disturbanceValue.
      disturbanceValue  = crc_RRR_Veh_SensorConfig_RRR_Veh_SenConfig_CRC;
      result=ARILFaultInjectionDisturbChecksum (RRR_Veh_SensorConfig, "Veh_SensorConfig", type, disturbanceMode, disturbanceCount, disturbanceValue);
      //write("ARILFaultInjectionDisturbChecksum :: RRR_Veh_SensorConfig :: Veh_SensorConfig :: RRR_Veh_SenConfig_CRC :: Freeze");
    }
}
}


on sysvar CAN_RadarRR::Veh_SensorInput::Veh_SensorInput_ON_OFF
{
  if (@this == 1)
  {
    ARILFaultInjectionEnablePDU(CAN_RadarRR::Veh_SensorInput);
  }
  else{
         ARILFaultInjectionDisablePDU(CAN_RadarRR::Veh_SensorInput);
      }
}

void cfg_Pdu_Veh_SensorInput(dword & aPDULength, byte data[])
{
   int64 i,k;//For looping
   byte xor,data_byte;
   dword crcTemp;
   byte DataLength;
   dword Msg_id;
   long result;
   long type=0;//reserved (should be set to 0).
   long disturbanceMode  =0; //0 :: set to disturbanceValue //2 :: set to Random value //3 :: Offset Signal value is increased by disturbanceValue
   long disturbanceCount =0;//-1 ::Infinite Disturbance is continuously applied //0 ::Stop An active disturbance is stopped and the SequenceCounter/crc will be calculated again appropriately //n > 0 ::Count Do exactly n Repetition/disturbances
   long disturbanceValue =0;//According to the disturbance mode the SequenceCounter/crc will optionally be set to this value
   dword crc[1];
   
   DataLength = Msg_Veh_SensorInput.DataLength;//Message Data Length
   Msg_id  = Msg_Veh_SensorInput.id;//Message ID
   
{
   
   long continueMode=2;
   //0 :: The counter will continue as if there had never been a disturbance [0, 1, 2, 6, 6, 5, 6]
   //1 :: The counter will continue by increasing last valid counter [0, 1, 2, 6, 6, 3, 4]
   //2 :: The counter will continue by increasing the last transmitted value [0, 1, 2, 6, 6, 7, 8]
   
   if (@CAN_RadarRR::Veh_SensorInput::RRR_Veh_SenIn_SQC_FaultInject == 0)//AC: No Error, calculate AC
   {
      disturbanceCount=0;//0 Stop An active disturbance is stopped and the CRC will be calculated again appropriately
      result=ARILFaultInjectionDisturbSequenceCounter (Veh_SensorInput, "Veh_SensorInput", type, disturbanceMode, disturbanceCount, disturbanceValue, continueMode);
      //write("ARILFaultInjectionDisturbSequenceCounter :: Veh_SensorInput :: Veh_SensorInput :: RRR_Veh_SenIn_SQC :: No Error");
   }
   else if (@CAN_RadarRR::Veh_SensorInput::RRR_Veh_SenIn_SQC_FaultInject == 1)//AC: Error , set AC = 0
   {
      disturbanceCount  = -1;//-1 Infinite Disturbance is continuously applied
      disturbanceMode   = 0;//Sets the AC fix to the value of parameter disturbanceValue.
      disturbanceValue  = 0;//set AC = 0
      result=ARILFaultInjectionDisturbSequenceCounter (Veh_SensorInput, "Veh_SensorInput", type, disturbanceMode, disturbanceCount, disturbanceValue, continueMode);
      //write("ARILFaultInjectionDisturbSequenceCounter :: Veh_SensorInput :: Veh_SensorInput :: RRR_Veh_SenIn_SQC :: AC = 0");
   }
   else if (@CAN_RadarRR::Veh_SensorInput::RRR_Veh_SenIn_SQC_FaultInject == 2)//AC: Error , Freeze last valid value
   {
      disturbanceCount  = -1;//-1 Infinite Disturbance is continuously applied
      disturbanceMode   = 1;//1 Freeze Current signal value is used (disturbanceValue is not used)
      result=ARILFaultInjectionDisturbSequenceCounter (Veh_SensorInput, "Veh_SensorInput", type, disturbanceMode, disturbanceCount, disturbanceValue, continueMode);
      //write("ARILFaultInjectionDisturbSequenceCounter :: Veh_SensorInput :: Veh_SensorInput :: RRR_Veh_SenIn_SQC :: Freeze");
   }
}
{
   if (@CAN_RadarRR::Veh_SensorInput::RRR_Veh_SenIn_CRC_FaultInject == 0)//CRC: No Error, calculate CRC
   {
      disturbanceCount  = 1;//Once Disturbance is applied
      disturbanceMode   = 0;//Sets the CRC fix to the value of parameter disturbanceValue.
      ARILCalculateCRC("Veh_SensorInput","Veh_SensorInput",data,aPDULength,crc);//Profile 11A
      disturbanceValue=crc_Veh_SensorInput_RRR_Veh_SenIn_CRC=crc[0]^0xFF;
      result=ARILFaultInjectionDisturbChecksum (Veh_SensorInput, "Veh_SensorInput", type, disturbanceMode, disturbanceCount, disturbanceValue);
      //write("ARILFaultInjectionDisturbChecksum :: Veh_SensorInput :: Veh_SensorInput :: RRR_Veh_SenIn_CRC :: No Error");
   }
   else if (@CAN_RadarRR::Veh_SensorInput::RRR_Veh_SenIn_CRC_FaultInject == 1)//CRC: Error , set CRC = 0
   {
      disturbanceCount  = 1;//Once Disturbance is continuously applied
      disturbanceMode   = 0;//Sets the CRC fix to the value of parameter disturbanceValue.
      disturbanceValue  = 0;//set CRC = 0
      result=ARILFaultInjectionDisturbChecksum (Veh_SensorInput, "Veh_SensorInput", type, disturbanceMode, disturbanceCount, disturbanceValue);
      //write("ARILFaultInjectionDisturbChecksum :: Veh_SensorInput :: Veh_SensorInput :: RRR_Veh_SenIn_CRC :: AC = 0");
   }
   else if (@CAN_RadarRR::Veh_SensorInput::RRR_Veh_SenIn_CRC_FaultInject == 2)//CRC: Error , Freeze last valid value
   {
      disturbanceCount  = 1;//Once Disturbance is  applied
      disturbanceMode   = 0;//Sets the CRC fix to the value of parameter disturbanceValue.
      disturbanceValue  = crc_Veh_SensorInput_RRR_Veh_SenIn_CRC;
      result=ARILFaultInjectionDisturbChecksum (Veh_SensorInput, "Veh_SensorInput", type, disturbanceMode, disturbanceCount, disturbanceValue);
      //write("ARILFaultInjectionDisturbChecksum :: Veh_SensorInput :: Veh_SensorInput :: RRR_Veh_SenIn_CRC :: Freeze");
    }
}
}

//  ARILSetPDUTimingCyclic (dbMsg dbMessage, long TrueOrFalse, long offset, long period, long disturbanceCount, long flags);
//  TrueOrFalse ; 0: denotes the False timing; 1: denotes the True timing; 3: denotes the True and the False timing.
//  offset :Defines the delay in [ms] from now when the first cyclic transmission will start.
//  period :Defines the period in [ms] for the cyclic transmission.
//  disturbanceCount :Reserved/unused; should be set to -1 (infinite).
//  flags :Reserved; should be set to 0.

on sysvar CAN_RadarRR::Veh_SensorInput::Veh_SensorInput_CycleTime
{
  ARILSetPDUTimingCyclic (CAN_RadarRR::Veh_SensorInput, 3, 0, @this, -1, 0);//TrueOrFalse=3,offset=0;disturbanceCount =-1;flags=0
  //ARILResetPDUTimingCyclic(Veh_SensorInput,3);//TrueOrFalse=3
}

on sysvar CAN_RadarRR::RRR_Veh_ConfigMgmt::RRR_Veh_ConfigMgmt_CycleTime
{
  ARILSetPDUTimingCyclic (CAN_RadarRR::RRR_Veh_ConfigMgmt, 3, 1, @this, -1, 0);//TrueOrFalse=3,offset=1;disturbanceCount =-1;flags=0
  //ARILResetPDUTimingCyclic(RRR_Veh_ConfigMgmt,3);//TrueOrFalse=3
}

void Toliman_sim_SetCycleTimeOffset()
{

//  ARILSetPDUTimingCyclic (dbMsg dbMessage, long TrueOrFalse, long offset, long period, long disturbanceCount, long flags);
//  TrueOrFalse ; 0: denotes the False timing; 1: denotes the True timing; 3: denotes the True and the False timing.
//  offset :Defines the delay in [ms] from now when the first cyclic transmission will start.
//  period :Defines the period in [ms] for the cyclic transmission.
//  disturbanceCount :Reserved/unused; should be set to -1 (infinite).
//  flags :Reserved; should be set to 0.
  ARILSetPDUTimingCyclic (CAN_RadarRR::Veh_SensorInput, 3, 0, 20, -1, 0);//TrueOrFalse=3;offset=0;cycletime=20;disturbanceCount =-1;flags=0
  //ARILResetPDUTimingCyclic(Veh_SensorInput,3);//TrueOrFalse=3
  ARILSetPDUTimingCyclic (CAN_RadarRR::RRR_Veh_ConfigMgmt, 3, 1, 20, -1, 0);//TrueOrFalse=3;offset=1;cycletime=20;disturbanceCount =-1;flags=0
  //ARILResetPDUTimingCyclic(RRR_Veh_ConfigMgmt,3);//TrueOrFalse=3

}

void OnSecurityLocalPDUPreTx(char pduName[], dword dataId, byte payload[], dword payloadLength, qword& authInfoHigh, qword& authInfo, dword authInfoBitLength, qword& freshness, dword freshnessBitLength, dword freshnessValueId)//This callback handler is called, after all data updates and the automatic Authenticator (CMAC) calculation has be done
{
}

CanTp_ReceptionInd(long connHandle, byte data[])//This function is called when data has been received on the connection with the given handle. The number of bytes received is available as length of the byte array.
{
  // Output of Source Address
  long rxCount;
  byte connId;
  
  rxCount = elcount(data);
  

  if (connHandle == gHandle_Toliman_RRR_FieldDataCollection_TpFC)
  {
   connId = kId_Toliman_RRR_FieldDataCollection_TpFC;
   if ((@hil_ctrl::adas_sim == 1) & (@hil_ctrl::ra6_rr_sgu_obj_sim == 1))
   {
   }
   else if ((@hil_ctrl::adas_sim == 2) & (@hil_ctrl::ra6_rr_sgu_obj_sim == 1))
   {
   }
   else if ((@hil_ctrl::adas_sim == 0) & (@hil_ctrl::ra6_rr_sgu_obj_sim == 1))
   {
   }
   else if ((@hil_ctrl::adas_sim == 2) & (@hil_ctrl::ra6_rr_sgu_obj_sim == 2))
   {
   SetDataReceived_Toliman_RRR_FieldDataCollection(data, rxCount);
   }
   else if ((@hil_ctrl::adas_sim == 1) & (@hil_ctrl::ra6_rr_sgu_obj_sim == 2))
   {
   SetDataReceived_Toliman_RRR_FieldDataCollection(data, rxCount);
   }
  }


  if (connHandle == gHandle_Toliman_RRR_Object_TpFC)
  {
   connId = kId_Toliman_RRR_Object_TpFC;
   if ((@hil_ctrl::adas_sim == 1) & (@hil_ctrl::ra6_rr_sgu_obj_sim == 1))
   {
   if(@CAN_RadarRR_RRR_Object::TP_enable_loopback_reading)
   {
       SetDataReceived_Toliman_RRR_Object(data, rxCount);
   }
   }
   else if ((@hil_ctrl::adas_sim == 2) & (@hil_ctrl::ra6_rr_sgu_obj_sim == 1))
   {
   if(@CAN_RadarRR_RRR_Object::TP_enable_loopback_reading)
   {
       SetDataReceived_Toliman_RRR_Object(data, rxCount);
   }
   }
   else if ((@hil_ctrl::adas_sim == 0) & (@hil_ctrl::ra6_rr_sgu_obj_sim == 1))
   {
   if(@CAN_RadarRR_RRR_Object::TP_enable_loopback_reading)
   {
       SetDataReceived_Toliman_RRR_Object(data, rxCount);
   }
   }
   else if ((@hil_ctrl::adas_sim == 2) & (@hil_ctrl::ra6_rr_sgu_obj_sim == 2))
   {
   SetDataReceived_Toliman_RRR_Object(data, rxCount);
   }
   else if ((@hil_ctrl::adas_sim == 1) & (@hil_ctrl::ra6_rr_sgu_obj_sim == 2))
   {
   SetDataReceived_Toliman_RRR_Object(data, rxCount);
   }
  }


  if (connHandle == gHandle_Toliman_RRR_RoadSideBoundaries_TpFC)
  {
   connId = kId_Toliman_RRR_RoadSideBoundaries_TpFC;
   if ((@hil_ctrl::adas_sim == 1) & (@hil_ctrl::ra6_rr_sgu_obj_sim == 1))
   {
   }
   else if ((@hil_ctrl::adas_sim == 2) & (@hil_ctrl::ra6_rr_sgu_obj_sim == 1))
   {
   }
   else if ((@hil_ctrl::adas_sim == 0) & (@hil_ctrl::ra6_rr_sgu_obj_sim == 1))
   {
   }
   else if ((@hil_ctrl::adas_sim == 2) & (@hil_ctrl::ra6_rr_sgu_obj_sim == 2))
   {
   SetDataReceived_Toliman_RRR_RoadSideBoundaries(data, rxCount);
   }
   else if ((@hil_ctrl::adas_sim == 1) & (@hil_ctrl::ra6_rr_sgu_obj_sim == 2))
   {
   SetDataReceived_Toliman_RRR_RoadSideBoundaries(data, rxCount);
   }
  }

   //write("%s, connection %d: Reception indication for %d bytes", "CAN_RadarRR", connId, rxCount);
}

void SetDataReceived_Toliman_RRR_FieldDataCollection(byte byteArray[], long count)//I-signal-i pdu : RRR_FieldDataCollection->Mapped to ->N-pdu : RRR_FieldDataCollection
{
    qword raw_value;

    @CAN_RadarRR::RRR_FieldDataCollection::rxBuffercount = count;
    sysSetVariableArraySize(sysvar::CAN_RadarRR::RRR_FieldDataCollection::RRR_FieldDataCollection::SignalValue, count);
    sysSetVariableData(sysvar::CAN_RadarRR::RRR_FieldDataCollection::RRR_FieldDataCollection::SignalValue, byteArray, count);
}


void CRadarRR_RRR_Object_Obj1_SetDataReceived(byte byteArray[])
{
    qword raw_value;

    raw_value=copyBitsFromByteArrayLE( byteArray, 1536, 32);
    @CAN_RadarRR::RRR_Object::RRR_Object_Obj1.Age = convertRawToPhysical(raw_value, 1.0, 0.0);

    raw_value=copyBitsFromByteArrayLE( byteArray, 1132, 10);
    @CAN_RadarRR::RRR_Object::RRR_Object_Obj1.Ax = convertRawToPhysical(raw_value, 0.03125, -16.0);

    raw_value=copyBitsFromByteArrayLE( byteArray, 1516, 12);
    @CAN_RadarRR::RRR_Object::RRR_Object_Obj1.AxAyCoVnce = convertRawToPhysical(raw_value, 0.005, -10.0);

    raw_value=copyBitsFromByteArrayLE( byteArray, 1152, 12);
    @CAN_RadarRR::RRR_Object::RRR_Object_Obj1.AxVnce = convertRawToPhysical(raw_value, 0.005, 0.0);

    raw_value=copyBitsFromByteArrayLE( byteArray, 1206, 9);
    @CAN_RadarRR::RRR_Object::RRR_Object_Obj1.Ay = convertRawToPhysical(raw_value, 0.0625, -16.0);

    raw_value=copyBitsFromByteArrayLE( byteArray, 1216, 12);
    @CAN_RadarRR::RRR_Object::RRR_Object_Obj1.AyVnce = convertRawToPhysical(raw_value, 0.005, 0.0);

    raw_value=copyBitsFromByteArrayLE( byteArray, 1272, 6);
    @CAN_RadarRR::RRR_Object::RRR_Object_Obj1.ExistProb = convertRawToPhysical(raw_value, 2.0, 0.0);

    raw_value=copyBitsFromByteArrayLE( byteArray, 1336, 8);
    @CAN_RadarRR::RRR_Object::RRR_Object_Obj1.FilterInformation = convertRawToPhysical(raw_value, 1.0, 0.0);

    raw_value=copyBitsFromByteArrayLE( byteArray, 1112, 7);
    @CAN_RadarRR::RRR_Object::RRR_Object_Obj1.Length = convertRawToPhysical(raw_value, 0.125, 0.0);

    raw_value=copyBitsFromByteArrayLE( byteArray, 1120, 12);
    @CAN_RadarRR::RRR_Object::RRR_Object_Obj1.LengthVnce = convertRawToPhysical(raw_value, 0.005, 0.0);

    raw_value=copyBitsFromByteArrayLE( byteArray, 1304, 3);
    @CAN_RadarRR::RRR_Object::RRR_Object_Obj1.MeasurementStatus = convertRawToPhysical(raw_value, 1.0, 0.0);

    raw_value=copyBitsFromByteArrayLE( byteArray, 1260, 2);
    @CAN_RadarRR::RRR_Object::RRR_Object_Obj1.MovingStatus = convertRawToPhysical(raw_value, 1.0, 0.0);

    raw_value=copyBitsFromByteArrayLE( byteArray, 1240, 7);
    @CAN_RadarRR::RRR_Object::RRR_Object_Obj1.ObjId = convertRawToPhysical(raw_value, 1.0, 0.0);

    raw_value=copyBitsFromByteArrayLE( byteArray, 1142, 9);
    @CAN_RadarRR::RRR_Object::RRR_Object_Obj1.OrientationYaw = convertRawToPhysical(raw_value, 0.0175, -4.48);

    raw_value=copyBitsFromByteArrayLE( byteArray, 1164, 12);
    @CAN_RadarRR::RRR_Object::RRR_Object_Obj1.OrientationYawVnce = convertRawToPhysical(raw_value, 0.0003, 0.0);

    raw_value=copyBitsFromByteArrayLE( byteArray, 1056, 6);
    @CAN_RadarRR::RRR_Object::RRR_Object_Obj1.ProbClassConfidence = convertRawToPhysical(raw_value, 2.0, 0.0);

    raw_value=copyBitsFromByteArrayLE( byteArray, 1307, 4);
    @CAN_RadarRR::RRR_Object::RRR_Object_Obj1.ProbClassType = convertRawToPhysical(raw_value, 1.0, 0.0);

    raw_value=copyBitsFromByteArrayLE( byteArray, 1062, 14);
    @CAN_RadarRR::RRR_Object::RRR_Object_Obj1.Px = convertRawToPhysical(raw_value, 0.0625, -512.0);

    raw_value=copyBitsFromByteArrayLE( byteArray, 1376, 12);
    @CAN_RadarRR::RRR_Object::RRR_Object_Obj1.PxAxCoVnce = convertRawToPhysical(raw_value, 0.005, -10.0);

    raw_value=copyBitsFromByteArrayLE( byteArray, 1388, 12);
    @CAN_RadarRR::RRR_Object::RRR_Object_Obj1.PxAyCoVnce = convertRawToPhysical(raw_value, 0.005, -10.0);

    raw_value=copyBitsFromByteArrayLE( byteArray, 1292, 12);
    @CAN_RadarRR::RRR_Object::RRR_Object_Obj1.PxPyCoVnce = convertRawToPhysical(raw_value, 0.005, -10.0);

    raw_value=copyBitsFromByteArrayLE( byteArray, 1076, 12);
    @CAN_RadarRR::RRR_Object::RRR_Object_Obj1.PxVnce = convertRawToPhysical(raw_value, 0.005, 0.0);

    raw_value=copyBitsFromByteArrayLE( byteArray, 1312, 12);
    @CAN_RadarRR::RRR_Object::RRR_Object_Obj1.PxVxCoVnce = convertRawToPhysical(raw_value, 0.005, -10.0);

    raw_value=copyBitsFromByteArrayLE( byteArray, 1324, 12);
    @CAN_RadarRR::RRR_Object::RRR_Object_Obj1.PxVyCoVnce = convertRawToPhysical(raw_value, 0.005, -10.0);

    raw_value=copyBitsFromByteArrayLE( byteArray, 1088, 12);
    @CAN_RadarRR::RRR_Object::RRR_Object_Obj1.Py = convertRawToPhysical(raw_value, 0.0625, -128.0);

    raw_value=copyBitsFromByteArrayLE( byteArray, 1408, 12);
    @CAN_RadarRR::RRR_Object::RRR_Object_Obj1.PyAxCoVnce = convertRawToPhysical(raw_value, 0.005, -10.0);

    raw_value=copyBitsFromByteArrayLE( byteArray, 1420, 12);
    @CAN_RadarRR::RRR_Object::RRR_Object_Obj1.PyAyCoVnce = convertRawToPhysical(raw_value, 0.005, -10.0);

    raw_value=copyBitsFromByteArrayLE( byteArray, 1100, 12);
    @CAN_RadarRR::RRR_Object::RRR_Object_Obj1.PyVnce = convertRawToPhysical(raw_value, 0.005, 0.0);

    raw_value=copyBitsFromByteArrayLE( byteArray, 1344, 12);
    @CAN_RadarRR::RRR_Object::RRR_Object_Obj1.PyVxCoVnce = convertRawToPhysical(raw_value, 0.005, -10.0);

    raw_value=copyBitsFromByteArrayLE( byteArray, 1356, 12);
    @CAN_RadarRR::RRR_Object::RRR_Object_Obj1.PyVyCoVnce = convertRawToPhysical(raw_value, 0.005, -10.0);

    raw_value=copyBitsFromByteArrayLE( byteArray, 1196, 10);
    @CAN_RadarRR::RRR_Object::RRR_Object_Obj1.RCS = convertRawToPhysical(raw_value, 0.2, -102.4);

    raw_value=copyBitsFromByteArrayLE( byteArray, 1368, 4);
    @CAN_RadarRR::RRR_Object::RRR_Object_Obj1.ReferencePoint = convertRawToPhysical(raw_value, 1.0, 0.0);

    raw_value=copyBitsFromByteArrayLE( byteArray, 1228, 12);
    @CAN_RadarRR::RRR_Object::RRR_Object_Obj1.Vx = convertRawToPhysical(raw_value, 0.0625, -128.0);

    raw_value=copyBitsFromByteArrayLE( byteArray, 1452, 12);
    @CAN_RadarRR::RRR_Object::RRR_Object_Obj1.VxAxCoVnce = convertRawToPhysical(raw_value, 0.005, -10.0);

    raw_value=copyBitsFromByteArrayLE( byteArray, 1472, 12);
    @CAN_RadarRR::RRR_Object::RRR_Object_Obj1.VxAyCoVnce = convertRawToPhysical(raw_value, 0.005, -10.0);

    raw_value=copyBitsFromByteArrayLE( byteArray, 1248, 12);
    @CAN_RadarRR::RRR_Object::RRR_Object_Obj1.VxVnce = convertRawToPhysical(raw_value, 0.005, 0.0);

    raw_value=copyBitsFromByteArrayLE( byteArray, 1440, 12);
    @CAN_RadarRR::RRR_Object::RRR_Object_Obj1.VxVyCoVnce = convertRawToPhysical(raw_value, 0.005, -10.0);

    raw_value=copyBitsFromByteArrayLE( byteArray, 1262, 10);
    @CAN_RadarRR::RRR_Object::RRR_Object_Obj1.Vy = convertRawToPhysical(raw_value, 0.125, -64.0);

    raw_value=copyBitsFromByteArrayLE( byteArray, 1484, 12);
    @CAN_RadarRR::RRR_Object::RRR_Object_Obj1.VyAxCoVnce = convertRawToPhysical(raw_value, 0.005, -10.0);

    raw_value=copyBitsFromByteArrayLE( byteArray, 1504, 12);
    @CAN_RadarRR::RRR_Object::RRR_Object_Obj1.VyAyCoVnce = convertRawToPhysical(raw_value, 0.005, -10.0);

    raw_value=copyBitsFromByteArrayLE( byteArray, 1280, 12);
    @CAN_RadarRR::RRR_Object::RRR_Object_Obj1.VyVnce = convertRawToPhysical(raw_value, 0.005, 0.0);

    raw_value=copyBitsFromByteArrayLE( byteArray, 1176, 7);
    @CAN_RadarRR::RRR_Object::RRR_Object_Obj1.Width = convertRawToPhysical(raw_value, 0.125, 0.0);

    raw_value=copyBitsFromByteArrayLE( byteArray, 1184, 12);
    @CAN_RadarRR::RRR_Object::RRR_Object_Obj1.WidthVnce = convertRawToPhysical(raw_value, 0.005, 0.0);
}


void CRadarRR_RRR_Object_Obj10_SetDataReceived(byte byteArray[])
{
    qword raw_value;

    raw_value=copyBitsFromByteArrayLE( byteArray, 6144, 32);
    @CAN_RadarRR::RRR_Object::RRR_Object_Obj10.Age = convertRawToPhysical(raw_value, 1.0, 0.0);

    raw_value=copyBitsFromByteArrayLE( byteArray, 5740, 10);
    @CAN_RadarRR::RRR_Object::RRR_Object_Obj10.Ax = convertRawToPhysical(raw_value, 0.03125, -16.0);

    raw_value=copyBitsFromByteArrayLE( byteArray, 6124, 12);
    @CAN_RadarRR::RRR_Object::RRR_Object_Obj10.AxAyCoVnce = convertRawToPhysical(raw_value, 0.005, -10.0);

    raw_value=copyBitsFromByteArrayLE( byteArray, 5760, 12);
    @CAN_RadarRR::RRR_Object::RRR_Object_Obj10.AxVnce = convertRawToPhysical(raw_value, 0.005, 0.0);

    raw_value=copyBitsFromByteArrayLE( byteArray, 5814, 9);
    @CAN_RadarRR::RRR_Object::RRR_Object_Obj10.Ay = convertRawToPhysical(raw_value, 0.0625, -16.0);

    raw_value=copyBitsFromByteArrayLE( byteArray, 5824, 12);
    @CAN_RadarRR::RRR_Object::RRR_Object_Obj10.AyVnce = convertRawToPhysical(raw_value, 0.005, 0.0);

    raw_value=copyBitsFromByteArrayLE( byteArray, 5880, 6);
    @CAN_RadarRR::RRR_Object::RRR_Object_Obj10.ExistProb = convertRawToPhysical(raw_value, 2.0, 0.0);

    raw_value=copyBitsFromByteArrayLE( byteArray, 5944, 8);
    @CAN_RadarRR::RRR_Object::RRR_Object_Obj10.FilterInformation = convertRawToPhysical(raw_value, 1.0, 0.0);

    raw_value=copyBitsFromByteArrayLE( byteArray, 5720, 7);
    @CAN_RadarRR::RRR_Object::RRR_Object_Obj10.Length = convertRawToPhysical(raw_value, 0.125, 0.0);

    raw_value=copyBitsFromByteArrayLE( byteArray, 5728, 12);
    @CAN_RadarRR::RRR_Object::RRR_Object_Obj10.LengthVnce = convertRawToPhysical(raw_value, 0.005, 0.0);

    raw_value=copyBitsFromByteArrayLE( byteArray, 5912, 3);
    @CAN_RadarRR::RRR_Object::RRR_Object_Obj10.MeasurementStatus = convertRawToPhysical(raw_value, 1.0, 0.0);

    raw_value=copyBitsFromByteArrayLE( byteArray, 5868, 2);
    @CAN_RadarRR::RRR_Object::RRR_Object_Obj10.MovingStatus = convertRawToPhysical(raw_value, 1.0, 0.0);

    raw_value=copyBitsFromByteArrayLE( byteArray, 5848, 7);
    @CAN_RadarRR::RRR_Object::RRR_Object_Obj10.ObjId = convertRawToPhysical(raw_value, 1.0, 0.0);

    raw_value=copyBitsFromByteArrayLE( byteArray, 5750, 9);
    @CAN_RadarRR::RRR_Object::RRR_Object_Obj10.OrientationYaw = convertRawToPhysical(raw_value, 0.0175, -4.48);

    raw_value=copyBitsFromByteArrayLE( byteArray, 5772, 12);
    @CAN_RadarRR::RRR_Object::RRR_Object_Obj10.OrientationYawVnce = convertRawToPhysical(raw_value, 0.0003, 0.0);

    raw_value=copyBitsFromByteArrayLE( byteArray, 5664, 6);
    @CAN_RadarRR::RRR_Object::RRR_Object_Obj10.ProbClassConfidence = convertRawToPhysical(raw_value, 2.0, 0.0);

    raw_value=copyBitsFromByteArrayLE( byteArray, 5915, 4);
    @CAN_RadarRR::RRR_Object::RRR_Object_Obj10.ProbClassType = convertRawToPhysical(raw_value, 1.0, 0.0);

    raw_value=copyBitsFromByteArrayLE( byteArray, 5670, 14);
    @CAN_RadarRR::RRR_Object::RRR_Object_Obj10.Px = convertRawToPhysical(raw_value, 0.0625, -512.0);

    raw_value=copyBitsFromByteArrayLE( byteArray, 5984, 12);
    @CAN_RadarRR::RRR_Object::RRR_Object_Obj10.PxAxCoVnce = convertRawToPhysical(raw_value, 0.005, -10.0);

    raw_value=copyBitsFromByteArrayLE( byteArray, 5996, 12);
    @CAN_RadarRR::RRR_Object::RRR_Object_Obj10.PxAyCoVnce = convertRawToPhysical(raw_value, 0.005, -10.0);

    raw_value=copyBitsFromByteArrayLE( byteArray, 5900, 12);
    @CAN_RadarRR::RRR_Object::RRR_Object_Obj10.PxPyCoVnce = convertRawToPhysical(raw_value, 0.005, -10.0);

    raw_value=copyBitsFromByteArrayLE( byteArray, 5684, 12);
    @CAN_RadarRR::RRR_Object::RRR_Object_Obj10.PxVnce = convertRawToPhysical(raw_value, 0.005, 0.0);

    raw_value=copyBitsFromByteArrayLE( byteArray, 5920, 12);
    @CAN_RadarRR::RRR_Object::RRR_Object_Obj10.PxVxCoVnce = convertRawToPhysical(raw_value, 0.005, -10.0);

    raw_value=copyBitsFromByteArrayLE( byteArray, 5932, 12);
    @CAN_RadarRR::RRR_Object::RRR_Object_Obj10.PxVyCoVnce = convertRawToPhysical(raw_value, 0.005, -10.0);

    raw_value=copyBitsFromByteArrayLE( byteArray, 5696, 12);
    @CAN_RadarRR::RRR_Object::RRR_Object_Obj10.Py = convertRawToPhysical(raw_value, 0.0625, -128.0);

    raw_value=copyBitsFromByteArrayLE( byteArray, 6016, 12);
    @CAN_RadarRR::RRR_Object::RRR_Object_Obj10.PyAxCoVnce = convertRawToPhysical(raw_value, 0.005, -10.0);

    raw_value=copyBitsFromByteArrayLE( byteArray, 6028, 12);
    @CAN_RadarRR::RRR_Object::RRR_Object_Obj10.PyAyCoVnce = convertRawToPhysical(raw_value, 0.005, -10.0);

    raw_value=copyBitsFromByteArrayLE( byteArray, 5708, 12);
    @CAN_RadarRR::RRR_Object::RRR_Object_Obj10.PyVnce = convertRawToPhysical(raw_value, 0.005, 0.0);

    raw_value=copyBitsFromByteArrayLE( byteArray, 5952, 12);
    @CAN_RadarRR::RRR_Object::RRR_Object_Obj10.PyVxCoVnce = convertRawToPhysical(raw_value, 0.005, -10.0);

    raw_value=copyBitsFromByteArrayLE( byteArray, 5964, 12);
    @CAN_RadarRR::RRR_Object::RRR_Object_Obj10.PyVyCoVnce = convertRawToPhysical(raw_value, 0.005, -10.0);

    raw_value=copyBitsFromByteArrayLE( byteArray, 5804, 10);
    @CAN_RadarRR::RRR_Object::RRR_Object_Obj10.RCS = convertRawToPhysical(raw_value, 0.2, -102.4);

    raw_value=copyBitsFromByteArrayLE( byteArray, 5976, 4);
    @CAN_RadarRR::RRR_Object::RRR_Object_Obj10.ReferencePoint = convertRawToPhysical(raw_value, 1.0, 0.0);

    raw_value=copyBitsFromByteArrayLE( byteArray, 5836, 12);
    @CAN_RadarRR::RRR_Object::RRR_Object_Obj10.Vx = convertRawToPhysical(raw_value, 0.0625, -128.0);

    raw_value=copyBitsFromByteArrayLE( byteArray, 6060, 12);
    @CAN_RadarRR::RRR_Object::RRR_Object_Obj10.VxAxCoVnce = convertRawToPhysical(raw_value, 0.005, -10.0);

    raw_value=copyBitsFromByteArrayLE( byteArray, 6080, 12);
    @CAN_RadarRR::RRR_Object::RRR_Object_Obj10.VxAyCoVnce = convertRawToPhysical(raw_value, 0.005, -10.0);

    raw_value=copyBitsFromByteArrayLE( byteArray, 5856, 12);
    @CAN_RadarRR::RRR_Object::RRR_Object_Obj10.VxVnce = convertRawToPhysical(raw_value, 0.005, 0.0);

    raw_value=copyBitsFromByteArrayLE( byteArray, 6048, 12);
    @CAN_RadarRR::RRR_Object::RRR_Object_Obj10.VxVyCoVnce = convertRawToPhysical(raw_value, 0.005, -10.0);

    raw_value=copyBitsFromByteArrayLE( byteArray, 5870, 10);
    @CAN_RadarRR::RRR_Object::RRR_Object_Obj10.Vy = convertRawToPhysical(raw_value, 0.125, -64.0);

    raw_value=copyBitsFromByteArrayLE( byteArray, 6092, 12);
    @CAN_RadarRR::RRR_Object::RRR_Object_Obj10.VyAxCoVnce = convertRawToPhysical(raw_value, 0.005, -10.0);

    raw_value=copyBitsFromByteArrayLE( byteArray, 6112, 12);
    @CAN_RadarRR::RRR_Object::RRR_Object_Obj10.VyAyCoVnce = convertRawToPhysical(raw_value, 0.005, -10.0);

    raw_value=copyBitsFromByteArrayLE( byteArray, 5888, 12);
    @CAN_RadarRR::RRR_Object::RRR_Object_Obj10.VyVnce = convertRawToPhysical(raw_value, 0.005, 0.0);

    raw_value=copyBitsFromByteArrayLE( byteArray, 5784, 7);
    @CAN_RadarRR::RRR_Object::RRR_Object_Obj10.Width = convertRawToPhysical(raw_value, 0.125, 0.0);

    raw_value=copyBitsFromByteArrayLE( byteArray, 5792, 12);
    @CAN_RadarRR::RRR_Object::RRR_Object_Obj10.WidthVnce = convertRawToPhysical(raw_value, 0.005, 0.0);
}


void CRadarRR_RRR_Object_Obj11_SetDataReceived(byte byteArray[])
{
    qword raw_value;

    raw_value=copyBitsFromByteArrayLE( byteArray, 6656, 32);
    @CAN_RadarRR::RRR_Object::RRR_Object_Obj11.Age = convertRawToPhysical(raw_value, 1.0, 0.0);

    raw_value=copyBitsFromByteArrayLE( byteArray, 6252, 10);
    @CAN_RadarRR::RRR_Object::RRR_Object_Obj11.Ax = convertRawToPhysical(raw_value, 0.03125, -16.0);

    raw_value=copyBitsFromByteArrayLE( byteArray, 6636, 12);
    @CAN_RadarRR::RRR_Object::RRR_Object_Obj11.AxAyCoVnce = convertRawToPhysical(raw_value, 0.005, -10.0);

    raw_value=copyBitsFromByteArrayLE( byteArray, 6272, 12);
    @CAN_RadarRR::RRR_Object::RRR_Object_Obj11.AxVnce = convertRawToPhysical(raw_value, 0.005, 0.0);

    raw_value=copyBitsFromByteArrayLE( byteArray, 6326, 9);
    @CAN_RadarRR::RRR_Object::RRR_Object_Obj11.Ay = convertRawToPhysical(raw_value, 0.0625, -16.0);

    raw_value=copyBitsFromByteArrayLE( byteArray, 6336, 12);
    @CAN_RadarRR::RRR_Object::RRR_Object_Obj11.AyVnce = convertRawToPhysical(raw_value, 0.005, 0.0);

    raw_value=copyBitsFromByteArrayLE( byteArray, 6392, 6);
    @CAN_RadarRR::RRR_Object::RRR_Object_Obj11.ExistProb = convertRawToPhysical(raw_value, 2.0, 0.0);

    raw_value=copyBitsFromByteArrayLE( byteArray, 6456, 8);
    @CAN_RadarRR::RRR_Object::RRR_Object_Obj11.FilterInformation = convertRawToPhysical(raw_value, 1.0, 0.0);

    raw_value=copyBitsFromByteArrayLE( byteArray, 6232, 7);
    @CAN_RadarRR::RRR_Object::RRR_Object_Obj11.Length = convertRawToPhysical(raw_value, 0.125, 0.0);

    raw_value=copyBitsFromByteArrayLE( byteArray, 6240, 12);
    @CAN_RadarRR::RRR_Object::RRR_Object_Obj11.LengthVnce = convertRawToPhysical(raw_value, 0.005, 0.0);

    raw_value=copyBitsFromByteArrayLE( byteArray, 6424, 3);
    @CAN_RadarRR::RRR_Object::RRR_Object_Obj11.MeasurementStatus = convertRawToPhysical(raw_value, 1.0, 0.0);

    raw_value=copyBitsFromByteArrayLE( byteArray, 6380, 2);
    @CAN_RadarRR::RRR_Object::RRR_Object_Obj11.MovingStatus = convertRawToPhysical(raw_value, 1.0, 0.0);

    raw_value=copyBitsFromByteArrayLE( byteArray, 6360, 7);
    @CAN_RadarRR::RRR_Object::RRR_Object_Obj11.ObjId = convertRawToPhysical(raw_value, 1.0, 0.0);

    raw_value=copyBitsFromByteArrayLE( byteArray, 6262, 9);
    @CAN_RadarRR::RRR_Object::RRR_Object_Obj11.OrientationYaw = convertRawToPhysical(raw_value, 0.0175, -4.48);

    raw_value=copyBitsFromByteArrayLE( byteArray, 6284, 12);
    @CAN_RadarRR::RRR_Object::RRR_Object_Obj11.OrientationYawVnce = convertRawToPhysical(raw_value, 0.0003, 0.0);

    raw_value=copyBitsFromByteArrayLE( byteArray, 6176, 6);
    @CAN_RadarRR::RRR_Object::RRR_Object_Obj11.ProbClassConfidence = convertRawToPhysical(raw_value, 2.0, 0.0);

    raw_value=copyBitsFromByteArrayLE( byteArray, 6427, 4);
    @CAN_RadarRR::RRR_Object::RRR_Object_Obj11.ProbClassType = convertRawToPhysical(raw_value, 1.0, 0.0);

    raw_value=copyBitsFromByteArrayLE( byteArray, 6182, 14);
    @CAN_RadarRR::RRR_Object::RRR_Object_Obj11.Px = convertRawToPhysical(raw_value, 0.0625, -512.0);

    raw_value=copyBitsFromByteArrayLE( byteArray, 6496, 12);
    @CAN_RadarRR::RRR_Object::RRR_Object_Obj11.PxAxCoVnce = convertRawToPhysical(raw_value, 0.005, -10.0);

    raw_value=copyBitsFromByteArrayLE( byteArray, 6508, 12);
    @CAN_RadarRR::RRR_Object::RRR_Object_Obj11.PxAyCoVnce = convertRawToPhysical(raw_value, 0.005, -10.0);

    raw_value=copyBitsFromByteArrayLE( byteArray, 6412, 12);
    @CAN_RadarRR::RRR_Object::RRR_Object_Obj11.PxPyCoVnce = convertRawToPhysical(raw_value, 0.005, -10.0);

    raw_value=copyBitsFromByteArrayLE( byteArray, 6196, 12);
    @CAN_RadarRR::RRR_Object::RRR_Object_Obj11.PxVnce = convertRawToPhysical(raw_value, 0.005, 0.0);

    raw_value=copyBitsFromByteArrayLE( byteArray, 6432, 12);
    @CAN_RadarRR::RRR_Object::RRR_Object_Obj11.PxVxCoVnce = convertRawToPhysical(raw_value, 0.005, -10.0);

    raw_value=copyBitsFromByteArrayLE( byteArray, 6444, 12);
    @CAN_RadarRR::RRR_Object::RRR_Object_Obj11.PxVyCoVnce = convertRawToPhysical(raw_value, 0.005, -10.0);

    raw_value=copyBitsFromByteArrayLE( byteArray, 6208, 12);
    @CAN_RadarRR::RRR_Object::RRR_Object_Obj11.Py = convertRawToPhysical(raw_value, 0.0625, -128.0);

    raw_value=copyBitsFromByteArrayLE( byteArray, 6528, 12);
    @CAN_RadarRR::RRR_Object::RRR_Object_Obj11.PyAxCoVnce = convertRawToPhysical(raw_value, 0.005, -10.0);

    raw_value=copyBitsFromByteArrayLE( byteArray, 6540, 12);
    @CAN_RadarRR::RRR_Object::RRR_Object_Obj11.PyAyCoVnce = convertRawToPhysical(raw_value, 0.005, -10.0);

    raw_value=copyBitsFromByteArrayLE( byteArray, 6220, 12);
    @CAN_RadarRR::RRR_Object::RRR_Object_Obj11.PyVnce = convertRawToPhysical(raw_value, 0.005, 0.0);

    raw_value=copyBitsFromByteArrayLE( byteArray, 6464, 12);
    @CAN_RadarRR::RRR_Object::RRR_Object_Obj11.PyVxCoVnce = convertRawToPhysical(raw_value, 0.005, -10.0);

    raw_value=copyBitsFromByteArrayLE( byteArray, 6476, 12);
    @CAN_RadarRR::RRR_Object::RRR_Object_Obj11.PyVyCoVnce = convertRawToPhysical(raw_value, 0.005, -10.0);

    raw_value=copyBitsFromByteArrayLE( byteArray, 6316, 10);
    @CAN_RadarRR::RRR_Object::RRR_Object_Obj11.RCS = convertRawToPhysical(raw_value, 0.2, -102.4);

    raw_value=copyBitsFromByteArrayLE( byteArray, 6488, 4);
    @CAN_RadarRR::RRR_Object::RRR_Object_Obj11.ReferencePoint = convertRawToPhysical(raw_value, 1.0, 0.0);

    raw_value=copyBitsFromByteArrayLE( byteArray, 6348, 12);
    @CAN_RadarRR::RRR_Object::RRR_Object_Obj11.Vx = convertRawToPhysical(raw_value, 0.0625, -128.0);

    raw_value=copyBitsFromByteArrayLE( byteArray, 6572, 12);
    @CAN_RadarRR::RRR_Object::RRR_Object_Obj11.VxAxCoVnce = convertRawToPhysical(raw_value, 0.005, -10.0);

    raw_value=copyBitsFromByteArrayLE( byteArray, 6592, 12);
    @CAN_RadarRR::RRR_Object::RRR_Object_Obj11.VxAyCoVnce = convertRawToPhysical(raw_value, 0.005, -10.0);

    raw_value=copyBitsFromByteArrayLE( byteArray, 6368, 12);
    @CAN_RadarRR::RRR_Object::RRR_Object_Obj11.VxVnce = convertRawToPhysical(raw_value, 0.005, 0.0);

    raw_value=copyBitsFromByteArrayLE( byteArray, 6560, 12);
    @CAN_RadarRR::RRR_Object::RRR_Object_Obj11.VxVyCoVnce = convertRawToPhysical(raw_value, 0.005, -10.0);

    raw_value=copyBitsFromByteArrayLE( byteArray, 6382, 10);
    @CAN_RadarRR::RRR_Object::RRR_Object_Obj11.Vy = convertRawToPhysical(raw_value, 0.125, -64.0);

    raw_value=copyBitsFromByteArrayLE( byteArray, 6604, 12);
    @CAN_RadarRR::RRR_Object::RRR_Object_Obj11.VyAxCoVnce = convertRawToPhysical(raw_value, 0.005, -10.0);

    raw_value=copyBitsFromByteArrayLE( byteArray, 6624, 12);
    @CAN_RadarRR::RRR_Object::RRR_Object_Obj11.VyAyCoVnce = convertRawToPhysical(raw_value, 0.005, -10.0);

    raw_value=copyBitsFromByteArrayLE( byteArray, 6400, 12);
    @CAN_RadarRR::RRR_Object::RRR_Object_Obj11.VyVnce = convertRawToPhysical(raw_value, 0.005, 0.0);

    raw_value=copyBitsFromByteArrayLE( byteArray, 6296, 7);
    @CAN_RadarRR::RRR_Object::RRR_Object_Obj11.Width = convertRawToPhysical(raw_value, 0.125, 0.0);

    raw_value=copyBitsFromByteArrayLE( byteArray, 6304, 12);
    @CAN_RadarRR::RRR_Object::RRR_Object_Obj11.WidthVnce = convertRawToPhysical(raw_value, 0.005, 0.0);
}


void CRadarRR_RRR_Object_Obj12_SetDataReceived(byte byteArray[])
{
    qword raw_value;

    raw_value=copyBitsFromByteArrayLE( byteArray, 7168, 32);
    @CAN_RadarRR::RRR_Object::RRR_Object_Obj12.Age = convertRawToPhysical(raw_value, 1.0, 0.0);

    raw_value=copyBitsFromByteArrayLE( byteArray, 6764, 10);
    @CAN_RadarRR::RRR_Object::RRR_Object_Obj12.Ax = convertRawToPhysical(raw_value, 0.03125, -16.0);

    raw_value=copyBitsFromByteArrayLE( byteArray, 7148, 12);
    @CAN_RadarRR::RRR_Object::RRR_Object_Obj12.AxAyCoVnce = convertRawToPhysical(raw_value, 0.005, -10.0);

    raw_value=copyBitsFromByteArrayLE( byteArray, 6784, 12);
    @CAN_RadarRR::RRR_Object::RRR_Object_Obj12.AxVnce = convertRawToPhysical(raw_value, 0.005, 0.0);

    raw_value=copyBitsFromByteArrayLE( byteArray, 6838, 9);
    @CAN_RadarRR::RRR_Object::RRR_Object_Obj12.Ay = convertRawToPhysical(raw_value, 0.0625, -16.0);

    raw_value=copyBitsFromByteArrayLE( byteArray, 6848, 12);
    @CAN_RadarRR::RRR_Object::RRR_Object_Obj12.AyVnce = convertRawToPhysical(raw_value, 0.005, 0.0);

    raw_value=copyBitsFromByteArrayLE( byteArray, 6904, 6);
    @CAN_RadarRR::RRR_Object::RRR_Object_Obj12.ExistProb = convertRawToPhysical(raw_value, 2.0, 0.0);

    raw_value=copyBitsFromByteArrayLE( byteArray, 6968, 8);
    @CAN_RadarRR::RRR_Object::RRR_Object_Obj12.FilterInformation = convertRawToPhysical(raw_value, 1.0, 0.0);

    raw_value=copyBitsFromByteArrayLE( byteArray, 6744, 7);
    @CAN_RadarRR::RRR_Object::RRR_Object_Obj12.Length = convertRawToPhysical(raw_value, 0.125, 0.0);

    raw_value=copyBitsFromByteArrayLE( byteArray, 6752, 12);
    @CAN_RadarRR::RRR_Object::RRR_Object_Obj12.LengthVnce = convertRawToPhysical(raw_value, 0.005, 0.0);

    raw_value=copyBitsFromByteArrayLE( byteArray, 6936, 3);
    @CAN_RadarRR::RRR_Object::RRR_Object_Obj12.MeasurementStatus = convertRawToPhysical(raw_value, 1.0, 0.0);

    raw_value=copyBitsFromByteArrayLE( byteArray, 6892, 2);
    @CAN_RadarRR::RRR_Object::RRR_Object_Obj12.MovingStatus = convertRawToPhysical(raw_value, 1.0, 0.0);

    raw_value=copyBitsFromByteArrayLE( byteArray, 6872, 7);
    @CAN_RadarRR::RRR_Object::RRR_Object_Obj12.ObjId = convertRawToPhysical(raw_value, 1.0, 0.0);

    raw_value=copyBitsFromByteArrayLE( byteArray, 6774, 9);
    @CAN_RadarRR::RRR_Object::RRR_Object_Obj12.OrientationYaw = convertRawToPhysical(raw_value, 0.0175, -4.48);

    raw_value=copyBitsFromByteArrayLE( byteArray, 6796, 12);
    @CAN_RadarRR::RRR_Object::RRR_Object_Obj12.OrientationYawVnce = convertRawToPhysical(raw_value, 0.0003, 0.0);

    raw_value=copyBitsFromByteArrayLE( byteArray, 6688, 6);
    @CAN_RadarRR::RRR_Object::RRR_Object_Obj12.ProbClassConfidence = convertRawToPhysical(raw_value, 2.0, 0.0);

    raw_value=copyBitsFromByteArrayLE( byteArray, 6939, 4);
    @CAN_RadarRR::RRR_Object::RRR_Object_Obj12.ProbClassType = convertRawToPhysical(raw_value, 1.0, 0.0);

    raw_value=copyBitsFromByteArrayLE( byteArray, 6694, 14);
    @CAN_RadarRR::RRR_Object::RRR_Object_Obj12.Px = convertRawToPhysical(raw_value, 0.0625, -512.0);

    raw_value=copyBitsFromByteArrayLE( byteArray, 7008, 12);
    @CAN_RadarRR::RRR_Object::RRR_Object_Obj12.PxAxCoVnce = convertRawToPhysical(raw_value, 0.005, -10.0);

    raw_value=copyBitsFromByteArrayLE( byteArray, 7020, 12);
    @CAN_RadarRR::RRR_Object::RRR_Object_Obj12.PxAyCoVnce = convertRawToPhysical(raw_value, 0.005, -10.0);

    raw_value=copyBitsFromByteArrayLE( byteArray, 6924, 12);
    @CAN_RadarRR::RRR_Object::RRR_Object_Obj12.PxPyCoVnce = convertRawToPhysical(raw_value, 0.005, -10.0);

    raw_value=copyBitsFromByteArrayLE( byteArray, 6708, 12);
    @CAN_RadarRR::RRR_Object::RRR_Object_Obj12.PxVnce = convertRawToPhysical(raw_value, 0.005, 0.0);

    raw_value=copyBitsFromByteArrayLE( byteArray, 6944, 12);
    @CAN_RadarRR::RRR_Object::RRR_Object_Obj12.PxVxCoVnce = convertRawToPhysical(raw_value, 0.005, -10.0);

    raw_value=copyBitsFromByteArrayLE( byteArray, 6956, 12);
    @CAN_RadarRR::RRR_Object::RRR_Object_Obj12.PxVyCoVnce = convertRawToPhysical(raw_value, 0.005, -10.0);

    raw_value=copyBitsFromByteArrayLE( byteArray, 6720, 12);
    @CAN_RadarRR::RRR_Object::RRR_Object_Obj12.Py = convertRawToPhysical(raw_value, 0.0625, -128.0);

    raw_value=copyBitsFromByteArrayLE( byteArray, 7040, 12);
    @CAN_RadarRR::RRR_Object::RRR_Object_Obj12.PyAxCoVnce = convertRawToPhysical(raw_value, 0.005, -10.0);

    raw_value=copyBitsFromByteArrayLE( byteArray, 7052, 12);
    @CAN_RadarRR::RRR_Object::RRR_Object_Obj12.PyAyCoVnce = convertRawToPhysical(raw_value, 0.005, -10.0);

    raw_value=copyBitsFromByteArrayLE( byteArray, 6732, 12);
    @CAN_RadarRR::RRR_Object::RRR_Object_Obj12.PyVnce = convertRawToPhysical(raw_value, 0.005, 0.0);

    raw_value=copyBitsFromByteArrayLE( byteArray, 6976, 12);
    @CAN_RadarRR::RRR_Object::RRR_Object_Obj12.PyVxCoVnce = convertRawToPhysical(raw_value, 0.005, -10.0);

    raw_value=copyBitsFromByteArrayLE( byteArray, 6988, 12);
    @CAN_RadarRR::RRR_Object::RRR_Object_Obj12.PyVyCoVnce = convertRawToPhysical(raw_value, 0.005, -10.0);

    raw_value=copyBitsFromByteArrayLE( byteArray, 6828, 10);
    @CAN_RadarRR::RRR_Object::RRR_Object_Obj12.RCS = convertRawToPhysical(raw_value, 0.2, -102.4);

    raw_value=copyBitsFromByteArrayLE( byteArray, 7000, 4);
    @CAN_RadarRR::RRR_Object::RRR_Object_Obj12.ReferencePoint = convertRawToPhysical(raw_value, 1.0, 0.0);

    raw_value=copyBitsFromByteArrayLE( byteArray, 6860, 12);
    @CAN_RadarRR::RRR_Object::RRR_Object_Obj12.Vx = convertRawToPhysical(raw_value, 0.0625, -128.0);

    raw_value=copyBitsFromByteArrayLE( byteArray, 7084, 12);
    @CAN_RadarRR::RRR_Object::RRR_Object_Obj12.VxAxCoVnce = convertRawToPhysical(raw_value, 0.005, -10.0);

    raw_value=copyBitsFromByteArrayLE( byteArray, 7104, 12);
    @CAN_RadarRR::RRR_Object::RRR_Object_Obj12.VxAyCoVnce = convertRawToPhysical(raw_value, 0.005, -10.0);

    raw_value=copyBitsFromByteArrayLE( byteArray, 6880, 12);
    @CAN_RadarRR::RRR_Object::RRR_Object_Obj12.VxVnce = convertRawToPhysical(raw_value, 0.005, 0.0);

    raw_value=copyBitsFromByteArrayLE( byteArray, 7072, 12);
    @CAN_RadarRR::RRR_Object::RRR_Object_Obj12.VxVyCoVnce = convertRawToPhysical(raw_value, 0.005, -10.0);

    raw_value=copyBitsFromByteArrayLE( byteArray, 6894, 10);
    @CAN_RadarRR::RRR_Object::RRR_Object_Obj12.Vy = convertRawToPhysical(raw_value, 0.125, -64.0);

    raw_value=copyBitsFromByteArrayLE( byteArray, 7116, 12);
    @CAN_RadarRR::RRR_Object::RRR_Object_Obj12.VyAxCoVnce = convertRawToPhysical(raw_value, 0.005, -10.0);

    raw_value=copyBitsFromByteArrayLE( byteArray, 7136, 12);
    @CAN_RadarRR::RRR_Object::RRR_Object_Obj12.VyAyCoVnce = convertRawToPhysical(raw_value, 0.005, -10.0);

    raw_value=copyBitsFromByteArrayLE( byteArray, 6912, 12);
    @CAN_RadarRR::RRR_Object::RRR_Object_Obj12.VyVnce = convertRawToPhysical(raw_value, 0.005, 0.0);

    raw_value=copyBitsFromByteArrayLE( byteArray, 6808, 7);
    @CAN_RadarRR::RRR_Object::RRR_Object_Obj12.Width = convertRawToPhysical(raw_value, 0.125, 0.0);

    raw_value=copyBitsFromByteArrayLE( byteArray, 6816, 12);
    @CAN_RadarRR::RRR_Object::RRR_Object_Obj12.WidthVnce = convertRawToPhysical(raw_value, 0.005, 0.0);
}


void CRadarRR_RRR_Object_Obj13_SetDataReceived(byte byteArray[])
{
    qword raw_value;

    raw_value=copyBitsFromByteArrayLE( byteArray, 7680, 32);
    @CAN_RadarRR::RRR_Object::RRR_Object_Obj13.Age = convertRawToPhysical(raw_value, 1.0, 0.0);

    raw_value=copyBitsFromByteArrayLE( byteArray, 7276, 10);
    @CAN_RadarRR::RRR_Object::RRR_Object_Obj13.Ax = convertRawToPhysical(raw_value, 0.03125, -16.0);

    raw_value=copyBitsFromByteArrayLE( byteArray, 7660, 12);
    @CAN_RadarRR::RRR_Object::RRR_Object_Obj13.AxAyCoVnce = convertRawToPhysical(raw_value, 0.005, -10.0);

    raw_value=copyBitsFromByteArrayLE( byteArray, 7296, 12);
    @CAN_RadarRR::RRR_Object::RRR_Object_Obj13.AxVnce = convertRawToPhysical(raw_value, 0.005, 0.0);

    raw_value=copyBitsFromByteArrayLE( byteArray, 7350, 9);
    @CAN_RadarRR::RRR_Object::RRR_Object_Obj13.Ay = convertRawToPhysical(raw_value, 0.0625, -16.0);

    raw_value=copyBitsFromByteArrayLE( byteArray, 7360, 12);
    @CAN_RadarRR::RRR_Object::RRR_Object_Obj13.AyVnce = convertRawToPhysical(raw_value, 0.005, 0.0);

    raw_value=copyBitsFromByteArrayLE( byteArray, 7416, 6);
    @CAN_RadarRR::RRR_Object::RRR_Object_Obj13.ExistProb = convertRawToPhysical(raw_value, 2.0, 0.0);

    raw_value=copyBitsFromByteArrayLE( byteArray, 7480, 8);
    @CAN_RadarRR::RRR_Object::RRR_Object_Obj13.FilterInformation = convertRawToPhysical(raw_value, 1.0, 0.0);

    raw_value=copyBitsFromByteArrayLE( byteArray, 7256, 7);
    @CAN_RadarRR::RRR_Object::RRR_Object_Obj13.Length = convertRawToPhysical(raw_value, 0.125, 0.0);

    raw_value=copyBitsFromByteArrayLE( byteArray, 7264, 12);
    @CAN_RadarRR::RRR_Object::RRR_Object_Obj13.LengthVnce = convertRawToPhysical(raw_value, 0.005, 0.0);

    raw_value=copyBitsFromByteArrayLE( byteArray, 7448, 3);
    @CAN_RadarRR::RRR_Object::RRR_Object_Obj13.MeasurementStatus = convertRawToPhysical(raw_value, 1.0, 0.0);

    raw_value=copyBitsFromByteArrayLE( byteArray, 7404, 2);
    @CAN_RadarRR::RRR_Object::RRR_Object_Obj13.MovingStatus = convertRawToPhysical(raw_value, 1.0, 0.0);

    raw_value=copyBitsFromByteArrayLE( byteArray, 7384, 7);
    @CAN_RadarRR::RRR_Object::RRR_Object_Obj13.ObjId = convertRawToPhysical(raw_value, 1.0, 0.0);

    raw_value=copyBitsFromByteArrayLE( byteArray, 7286, 9);
    @CAN_RadarRR::RRR_Object::RRR_Object_Obj13.OrientationYaw = convertRawToPhysical(raw_value, 0.0175, -4.48);

    raw_value=copyBitsFromByteArrayLE( byteArray, 7308, 12);
    @CAN_RadarRR::RRR_Object::RRR_Object_Obj13.OrientationYawVnce = convertRawToPhysical(raw_value, 0.0003, 0.0);

    raw_value=copyBitsFromByteArrayLE( byteArray, 7200, 6);
    @CAN_RadarRR::RRR_Object::RRR_Object_Obj13.ProbClassConfidence = convertRawToPhysical(raw_value, 2.0, 0.0);

    raw_value=copyBitsFromByteArrayLE( byteArray, 7451, 4);
    @CAN_RadarRR::RRR_Object::RRR_Object_Obj13.ProbClassType = convertRawToPhysical(raw_value, 1.0, 0.0);

    raw_value=copyBitsFromByteArrayLE( byteArray, 7206, 14);
    @CAN_RadarRR::RRR_Object::RRR_Object_Obj13.Px = convertRawToPhysical(raw_value, 0.0625, -512.0);

    raw_value=copyBitsFromByteArrayLE( byteArray, 7520, 12);
    @CAN_RadarRR::RRR_Object::RRR_Object_Obj13.PxAxCoVnce = convertRawToPhysical(raw_value, 0.005, -10.0);

    raw_value=copyBitsFromByteArrayLE( byteArray, 7532, 12);
    @CAN_RadarRR::RRR_Object::RRR_Object_Obj13.PxAyCoVnce = convertRawToPhysical(raw_value, 0.005, -10.0);

    raw_value=copyBitsFromByteArrayLE( byteArray, 7436, 12);
    @CAN_RadarRR::RRR_Object::RRR_Object_Obj13.PxPyCoVnce = convertRawToPhysical(raw_value, 0.005, -10.0);

    raw_value=copyBitsFromByteArrayLE( byteArray, 7220, 12);
    @CAN_RadarRR::RRR_Object::RRR_Object_Obj13.PxVnce = convertRawToPhysical(raw_value, 0.005, 0.0);

    raw_value=copyBitsFromByteArrayLE( byteArray, 7456, 12);
    @CAN_RadarRR::RRR_Object::RRR_Object_Obj13.PxVxCoVnce = convertRawToPhysical(raw_value, 0.005, -10.0);

    raw_value=copyBitsFromByteArrayLE( byteArray, 7468, 12);
    @CAN_RadarRR::RRR_Object::RRR_Object_Obj13.PxVyCoVnce = convertRawToPhysical(raw_value, 0.005, -10.0);

    raw_value=copyBitsFromByteArrayLE( byteArray, 7232, 12);
    @CAN_RadarRR::RRR_Object::RRR_Object_Obj13.Py = convertRawToPhysical(raw_value, 0.0625, -128.0);

    raw_value=copyBitsFromByteArrayLE( byteArray, 7552, 12);
    @CAN_RadarRR::RRR_Object::RRR_Object_Obj13.PyAxCoVnce = convertRawToPhysical(raw_value, 0.005, -10.0);

    raw_value=copyBitsFromByteArrayLE( byteArray, 7564, 12);
    @CAN_RadarRR::RRR_Object::RRR_Object_Obj13.PyAyCoVnce = convertRawToPhysical(raw_value, 0.005, -10.0);

    raw_value=copyBitsFromByteArrayLE( byteArray, 7244, 12);
    @CAN_RadarRR::RRR_Object::RRR_Object_Obj13.PyVnce = convertRawToPhysical(raw_value, 0.005, 0.0);

    raw_value=copyBitsFromByteArrayLE( byteArray, 7488, 12);
    @CAN_RadarRR::RRR_Object::RRR_Object_Obj13.PyVxCoVnce = convertRawToPhysical(raw_value, 0.005, -10.0);

    raw_value=copyBitsFromByteArrayLE( byteArray, 7500, 12);
    @CAN_RadarRR::RRR_Object::RRR_Object_Obj13.PyVyCoVnce = convertRawToPhysical(raw_value, 0.005, -10.0);

    raw_value=copyBitsFromByteArrayLE( byteArray, 7340, 10);
    @CAN_RadarRR::RRR_Object::RRR_Object_Obj13.RCS = convertRawToPhysical(raw_value, 0.2, -102.4);

    raw_value=copyBitsFromByteArrayLE( byteArray, 7512, 4);
    @CAN_RadarRR::RRR_Object::RRR_Object_Obj13.ReferencePoint = convertRawToPhysical(raw_value, 1.0, 0.0);

    raw_value=copyBitsFromByteArrayLE( byteArray, 7372, 12);
    @CAN_RadarRR::RRR_Object::RRR_Object_Obj13.Vx = convertRawToPhysical(raw_value, 0.0625, -128.0);

    raw_value=copyBitsFromByteArrayLE( byteArray, 7596, 12);
    @CAN_RadarRR::RRR_Object::RRR_Object_Obj13.VxAxCoVnce = convertRawToPhysical(raw_value, 0.005, -10.0);

    raw_value=copyBitsFromByteArrayLE( byteArray, 7616, 12);
    @CAN_RadarRR::RRR_Object::RRR_Object_Obj13.VxAyCoVnce = convertRawToPhysical(raw_value, 0.005, -10.0);

    raw_value=copyBitsFromByteArrayLE( byteArray, 7392, 12);
    @CAN_RadarRR::RRR_Object::RRR_Object_Obj13.VxVnce = convertRawToPhysical(raw_value, 0.005, 0.0);

    raw_value=copyBitsFromByteArrayLE( byteArray, 7584, 12);
    @CAN_RadarRR::RRR_Object::RRR_Object_Obj13.VxVyCoVnce = convertRawToPhysical(raw_value, 0.005, -10.0);

    raw_value=copyBitsFromByteArrayLE( byteArray, 7406, 10);
    @CAN_RadarRR::RRR_Object::RRR_Object_Obj13.Vy = convertRawToPhysical(raw_value, 0.125, -64.0);

    raw_value=copyBitsFromByteArrayLE( byteArray, 7628, 12);
    @CAN_RadarRR::RRR_Object::RRR_Object_Obj13.VyAxCoVnce = convertRawToPhysical(raw_value, 0.005, -10.0);

    raw_value=copyBitsFromByteArrayLE( byteArray, 7648, 12);
    @CAN_RadarRR::RRR_Object::RRR_Object_Obj13.VyAyCoVnce = convertRawToPhysical(raw_value, 0.005, -10.0);

    raw_value=copyBitsFromByteArrayLE( byteArray, 7424, 12);
    @CAN_RadarRR::RRR_Object::RRR_Object_Obj13.VyVnce = convertRawToPhysical(raw_value, 0.005, 0.0);

    raw_value=copyBitsFromByteArrayLE( byteArray, 7320, 7);
    @CAN_RadarRR::RRR_Object::RRR_Object_Obj13.Width = convertRawToPhysical(raw_value, 0.125, 0.0);

    raw_value=copyBitsFromByteArrayLE( byteArray, 7328, 12);
    @CAN_RadarRR::RRR_Object::RRR_Object_Obj13.WidthVnce = convertRawToPhysical(raw_value, 0.005, 0.0);
}


void CRadarRR_RRR_Object_Obj14_SetDataReceived(byte byteArray[])
{
    qword raw_value;

    raw_value=copyBitsFromByteArrayLE( byteArray, 8192, 32);
    @CAN_RadarRR::RRR_Object::RRR_Object_Obj14.Age = convertRawToPhysical(raw_value, 1.0, 0.0);

    raw_value=copyBitsFromByteArrayLE( byteArray, 7788, 10);
    @CAN_RadarRR::RRR_Object::RRR_Object_Obj14.Ax = convertRawToPhysical(raw_value, 0.03125, -16.0);

    raw_value=copyBitsFromByteArrayLE( byteArray, 8172, 12);
    @CAN_RadarRR::RRR_Object::RRR_Object_Obj14.AxAyCoVnce = convertRawToPhysical(raw_value, 0.005, -10.0);

    raw_value=copyBitsFromByteArrayLE( byteArray, 7808, 12);
    @CAN_RadarRR::RRR_Object::RRR_Object_Obj14.AxVnce = convertRawToPhysical(raw_value, 0.005, 0.0);

    raw_value=copyBitsFromByteArrayLE( byteArray, 7862, 9);
    @CAN_RadarRR::RRR_Object::RRR_Object_Obj14.Ay = convertRawToPhysical(raw_value, 0.0625, -16.0);

    raw_value=copyBitsFromByteArrayLE( byteArray, 7872, 12);
    @CAN_RadarRR::RRR_Object::RRR_Object_Obj14.AyVnce = convertRawToPhysical(raw_value, 0.005, 0.0);

    raw_value=copyBitsFromByteArrayLE( byteArray, 7928, 6);
    @CAN_RadarRR::RRR_Object::RRR_Object_Obj14.ExistProb = convertRawToPhysical(raw_value, 2.0, 0.0);

    raw_value=copyBitsFromByteArrayLE( byteArray, 7992, 8);
    @CAN_RadarRR::RRR_Object::RRR_Object_Obj14.FilterInformation = convertRawToPhysical(raw_value, 1.0, 0.0);

    raw_value=copyBitsFromByteArrayLE( byteArray, 7768, 7);
    @CAN_RadarRR::RRR_Object::RRR_Object_Obj14.Length = convertRawToPhysical(raw_value, 0.125, 0.0);

    raw_value=copyBitsFromByteArrayLE( byteArray, 7776, 12);
    @CAN_RadarRR::RRR_Object::RRR_Object_Obj14.LengthVnce = convertRawToPhysical(raw_value, 0.005, 0.0);

    raw_value=copyBitsFromByteArrayLE( byteArray, 7960, 3);
    @CAN_RadarRR::RRR_Object::RRR_Object_Obj14.MeasurementStatus = convertRawToPhysical(raw_value, 1.0, 0.0);

    raw_value=copyBitsFromByteArrayLE( byteArray, 7916, 2);
    @CAN_RadarRR::RRR_Object::RRR_Object_Obj14.MovingStatus = convertRawToPhysical(raw_value, 1.0, 0.0);

    raw_value=copyBitsFromByteArrayLE( byteArray, 7896, 7);
    @CAN_RadarRR::RRR_Object::RRR_Object_Obj14.ObjId = convertRawToPhysical(raw_value, 1.0, 0.0);

    raw_value=copyBitsFromByteArrayLE( byteArray, 7798, 9);
    @CAN_RadarRR::RRR_Object::RRR_Object_Obj14.OrientationYaw = convertRawToPhysical(raw_value, 0.0175, -4.48);

    raw_value=copyBitsFromByteArrayLE( byteArray, 7820, 12);
    @CAN_RadarRR::RRR_Object::RRR_Object_Obj14.OrientationYawVnce = convertRawToPhysical(raw_value, 0.0003, 0.0);

    raw_value=copyBitsFromByteArrayLE( byteArray, 7712, 6);
    @CAN_RadarRR::RRR_Object::RRR_Object_Obj14.ProbClassConfidence = convertRawToPhysical(raw_value, 2.0, 0.0);

    raw_value=copyBitsFromByteArrayLE( byteArray, 7963, 4);
    @CAN_RadarRR::RRR_Object::RRR_Object_Obj14.ProbClassType = convertRawToPhysical(raw_value, 1.0, 0.0);

    raw_value=copyBitsFromByteArrayLE( byteArray, 7718, 14);
    @CAN_RadarRR::RRR_Object::RRR_Object_Obj14.Px = convertRawToPhysical(raw_value, 0.0625, -512.0);

    raw_value=copyBitsFromByteArrayLE( byteArray, 8032, 12);
    @CAN_RadarRR::RRR_Object::RRR_Object_Obj14.PxAxCoVnce = convertRawToPhysical(raw_value, 0.005, -10.0);

    raw_value=copyBitsFromByteArrayLE( byteArray, 8044, 12);
    @CAN_RadarRR::RRR_Object::RRR_Object_Obj14.PxAyCoVnce = convertRawToPhysical(raw_value, 0.005, -10.0);

    raw_value=copyBitsFromByteArrayLE( byteArray, 7948, 12);
    @CAN_RadarRR::RRR_Object::RRR_Object_Obj14.PxPyCoVnce = convertRawToPhysical(raw_value, 0.005, -10.0);

    raw_value=copyBitsFromByteArrayLE( byteArray, 7732, 12);
    @CAN_RadarRR::RRR_Object::RRR_Object_Obj14.PxVnce = convertRawToPhysical(raw_value, 0.005, 0.0);

    raw_value=copyBitsFromByteArrayLE( byteArray, 7968, 12);
    @CAN_RadarRR::RRR_Object::RRR_Object_Obj14.PxVxCoVnce = convertRawToPhysical(raw_value, 0.005, -10.0);

    raw_value=copyBitsFromByteArrayLE( byteArray, 7980, 12);
    @CAN_RadarRR::RRR_Object::RRR_Object_Obj14.PxVyCoVnce = convertRawToPhysical(raw_value, 0.005, -10.0);

    raw_value=copyBitsFromByteArrayLE( byteArray, 7744, 12);
    @CAN_RadarRR::RRR_Object::RRR_Object_Obj14.Py = convertRawToPhysical(raw_value, 0.0625, -128.0);

    raw_value=copyBitsFromByteArrayLE( byteArray, 8064, 12);
    @CAN_RadarRR::RRR_Object::RRR_Object_Obj14.PyAxCoVnce = convertRawToPhysical(raw_value, 0.005, -10.0);

    raw_value=copyBitsFromByteArrayLE( byteArray, 8076, 12);
    @CAN_RadarRR::RRR_Object::RRR_Object_Obj14.PyAyCoVnce = convertRawToPhysical(raw_value, 0.005, -10.0);

    raw_value=copyBitsFromByteArrayLE( byteArray, 7756, 12);
    @CAN_RadarRR::RRR_Object::RRR_Object_Obj14.PyVnce = convertRawToPhysical(raw_value, 0.005, 0.0);

    raw_value=copyBitsFromByteArrayLE( byteArray, 8000, 12);
    @CAN_RadarRR::RRR_Object::RRR_Object_Obj14.PyVxCoVnce = convertRawToPhysical(raw_value, 0.005, -10.0);

    raw_value=copyBitsFromByteArrayLE( byteArray, 8012, 12);
    @CAN_RadarRR::RRR_Object::RRR_Object_Obj14.PyVyCoVnce = convertRawToPhysical(raw_value, 0.005, -10.0);

    raw_value=copyBitsFromByteArrayLE( byteArray, 7852, 10);
    @CAN_RadarRR::RRR_Object::RRR_Object_Obj14.RCS = convertRawToPhysical(raw_value, 0.2, -102.4);

    raw_value=copyBitsFromByteArrayLE( byteArray, 8024, 4);
    @CAN_RadarRR::RRR_Object::RRR_Object_Obj14.ReferencePoint = convertRawToPhysical(raw_value, 1.0, 0.0);

    raw_value=copyBitsFromByteArrayLE( byteArray, 7884, 12);
    @CAN_RadarRR::RRR_Object::RRR_Object_Obj14.Vx = convertRawToPhysical(raw_value, 0.0625, -128.0);

    raw_value=copyBitsFromByteArrayLE( byteArray, 8108, 12);
    @CAN_RadarRR::RRR_Object::RRR_Object_Obj14.VxAxCoVnce = convertRawToPhysical(raw_value, 0.005, -10.0);

    raw_value=copyBitsFromByteArrayLE( byteArray, 8128, 12);
    @CAN_RadarRR::RRR_Object::RRR_Object_Obj14.VxAyCoVnce = convertRawToPhysical(raw_value, 0.005, -10.0);

    raw_value=copyBitsFromByteArrayLE( byteArray, 7904, 12);
    @CAN_RadarRR::RRR_Object::RRR_Object_Obj14.VxVnce = convertRawToPhysical(raw_value, 0.005, 0.0);

    raw_value=copyBitsFromByteArrayLE( byteArray, 8096, 12);
    @CAN_RadarRR::RRR_Object::RRR_Object_Obj14.VxVyCoVnce = convertRawToPhysical(raw_value, 0.005, -10.0);

    raw_value=copyBitsFromByteArrayLE( byteArray, 7918, 10);
    @CAN_RadarRR::RRR_Object::RRR_Object_Obj14.Vy = convertRawToPhysical(raw_value, 0.125, -64.0);

    raw_value=copyBitsFromByteArrayLE( byteArray, 8140, 12);
    @CAN_RadarRR::RRR_Object::RRR_Object_Obj14.VyAxCoVnce = convertRawToPhysical(raw_value, 0.005, -10.0);

    raw_value=copyBitsFromByteArrayLE( byteArray, 8160, 12);
    @CAN_RadarRR::RRR_Object::RRR_Object_Obj14.VyAyCoVnce = convertRawToPhysical(raw_value, 0.005, -10.0);

    raw_value=copyBitsFromByteArrayLE( byteArray, 7936, 12);
    @CAN_RadarRR::RRR_Object::RRR_Object_Obj14.VyVnce = convertRawToPhysical(raw_value, 0.005, 0.0);

    raw_value=copyBitsFromByteArrayLE( byteArray, 7832, 7);
    @CAN_RadarRR::RRR_Object::RRR_Object_Obj14.Width = convertRawToPhysical(raw_value, 0.125, 0.0);

    raw_value=copyBitsFromByteArrayLE( byteArray, 7840, 12);
    @CAN_RadarRR::RRR_Object::RRR_Object_Obj14.WidthVnce = convertRawToPhysical(raw_value, 0.005, 0.0);
}


void CRadarRR_RRR_Object_Obj15_SetDataReceived(byte byteArray[])
{
    qword raw_value;

    raw_value=copyBitsFromByteArrayLE( byteArray, 8704, 32);
    @CAN_RadarRR::RRR_Object::RRR_Object_Obj15.Age = convertRawToPhysical(raw_value, 1.0, 0.0);

    raw_value=copyBitsFromByteArrayLE( byteArray, 8300, 10);
    @CAN_RadarRR::RRR_Object::RRR_Object_Obj15.Ax = convertRawToPhysical(raw_value, 0.03125, -16.0);

    raw_value=copyBitsFromByteArrayLE( byteArray, 8684, 12);
    @CAN_RadarRR::RRR_Object::RRR_Object_Obj15.AxAyCoVnce = convertRawToPhysical(raw_value, 0.005, -10.0);

    raw_value=copyBitsFromByteArrayLE( byteArray, 8320, 12);
    @CAN_RadarRR::RRR_Object::RRR_Object_Obj15.AxVnce = convertRawToPhysical(raw_value, 0.005, 0.0);

    raw_value=copyBitsFromByteArrayLE( byteArray, 8374, 9);
    @CAN_RadarRR::RRR_Object::RRR_Object_Obj15.Ay = convertRawToPhysical(raw_value, 0.0625, -16.0);

    raw_value=copyBitsFromByteArrayLE( byteArray, 8384, 12);
    @CAN_RadarRR::RRR_Object::RRR_Object_Obj15.AyVnce = convertRawToPhysical(raw_value, 0.005, 0.0);

    raw_value=copyBitsFromByteArrayLE( byteArray, 8440, 6);
    @CAN_RadarRR::RRR_Object::RRR_Object_Obj15.ExistProb = convertRawToPhysical(raw_value, 2.0, 0.0);

    raw_value=copyBitsFromByteArrayLE( byteArray, 8504, 8);
    @CAN_RadarRR::RRR_Object::RRR_Object_Obj15.FilterInformation = convertRawToPhysical(raw_value, 1.0, 0.0);

    raw_value=copyBitsFromByteArrayLE( byteArray, 8280, 7);
    @CAN_RadarRR::RRR_Object::RRR_Object_Obj15.Length = convertRawToPhysical(raw_value, 0.125, 0.0);

    raw_value=copyBitsFromByteArrayLE( byteArray, 8288, 12);
    @CAN_RadarRR::RRR_Object::RRR_Object_Obj15.LengthVnce = convertRawToPhysical(raw_value, 0.005, 0.0);

    raw_value=copyBitsFromByteArrayLE( byteArray, 8472, 3);
    @CAN_RadarRR::RRR_Object::RRR_Object_Obj15.MeasurementStatus = convertRawToPhysical(raw_value, 1.0, 0.0);

    raw_value=copyBitsFromByteArrayLE( byteArray, 8428, 2);
    @CAN_RadarRR::RRR_Object::RRR_Object_Obj15.MovingStatus = convertRawToPhysical(raw_value, 1.0, 0.0);

    raw_value=copyBitsFromByteArrayLE( byteArray, 8408, 7);
    @CAN_RadarRR::RRR_Object::RRR_Object_Obj15.ObjId = convertRawToPhysical(raw_value, 1.0, 0.0);

    raw_value=copyBitsFromByteArrayLE( byteArray, 8310, 9);
    @CAN_RadarRR::RRR_Object::RRR_Object_Obj15.OrientationYaw = convertRawToPhysical(raw_value, 0.0175, -4.48);

    raw_value=copyBitsFromByteArrayLE( byteArray, 8332, 12);
    @CAN_RadarRR::RRR_Object::RRR_Object_Obj15.OrientationYawVnce = convertRawToPhysical(raw_value, 0.0003, 0.0);

    raw_value=copyBitsFromByteArrayLE( byteArray, 8224, 6);
    @CAN_RadarRR::RRR_Object::RRR_Object_Obj15.ProbClassConfidence = convertRawToPhysical(raw_value, 2.0, 0.0);

    raw_value=copyBitsFromByteArrayLE( byteArray, 8475, 4);
    @CAN_RadarRR::RRR_Object::RRR_Object_Obj15.ProbClassType = convertRawToPhysical(raw_value, 1.0, 0.0);

    raw_value=copyBitsFromByteArrayLE( byteArray, 8230, 14);
    @CAN_RadarRR::RRR_Object::RRR_Object_Obj15.Px = convertRawToPhysical(raw_value, 0.0625, -512.0);

    raw_value=copyBitsFromByteArrayLE( byteArray, 8544, 12);
    @CAN_RadarRR::RRR_Object::RRR_Object_Obj15.PxAxCoVnce = convertRawToPhysical(raw_value, 0.005, -10.0);

    raw_value=copyBitsFromByteArrayLE( byteArray, 8556, 12);
    @CAN_RadarRR::RRR_Object::RRR_Object_Obj15.PxAyCoVnce = convertRawToPhysical(raw_value, 0.005, -10.0);

    raw_value=copyBitsFromByteArrayLE( byteArray, 8460, 12);
    @CAN_RadarRR::RRR_Object::RRR_Object_Obj15.PxPyCoVnce = convertRawToPhysical(raw_value, 0.005, -10.0);

    raw_value=copyBitsFromByteArrayLE( byteArray, 8244, 12);
    @CAN_RadarRR::RRR_Object::RRR_Object_Obj15.PxVnce = convertRawToPhysical(raw_value, 0.005, 0.0);

    raw_value=copyBitsFromByteArrayLE( byteArray, 8480, 12);
    @CAN_RadarRR::RRR_Object::RRR_Object_Obj15.PxVxCoVnce = convertRawToPhysical(raw_value, 0.005, -10.0);

    raw_value=copyBitsFromByteArrayLE( byteArray, 8492, 12);
    @CAN_RadarRR::RRR_Object::RRR_Object_Obj15.PxVyCoVnce = convertRawToPhysical(raw_value, 0.005, -10.0);

    raw_value=copyBitsFromByteArrayLE( byteArray, 8256, 12);
    @CAN_RadarRR::RRR_Object::RRR_Object_Obj15.Py = convertRawToPhysical(raw_value, 0.0625, -128.0);

    raw_value=copyBitsFromByteArrayLE( byteArray, 8576, 12);
    @CAN_RadarRR::RRR_Object::RRR_Object_Obj15.PyAxCoVnce = convertRawToPhysical(raw_value, 0.005, -10.0);

    raw_value=copyBitsFromByteArrayLE( byteArray, 8588, 12);
    @CAN_RadarRR::RRR_Object::RRR_Object_Obj15.PyAyCoVnce = convertRawToPhysical(raw_value, 0.005, -10.0);

    raw_value=copyBitsFromByteArrayLE( byteArray, 8268, 12);
    @CAN_RadarRR::RRR_Object::RRR_Object_Obj15.PyVnce = convertRawToPhysical(raw_value, 0.005, 0.0);

    raw_value=copyBitsFromByteArrayLE( byteArray, 8512, 12);
    @CAN_RadarRR::RRR_Object::RRR_Object_Obj15.PyVxCoVnce = convertRawToPhysical(raw_value, 0.005, -10.0);

    raw_value=copyBitsFromByteArrayLE( byteArray, 8524, 12);
    @CAN_RadarRR::RRR_Object::RRR_Object_Obj15.PyVyCoVnce = convertRawToPhysical(raw_value, 0.005, -10.0);

    raw_value=copyBitsFromByteArrayLE( byteArray, 8364, 10);
    @CAN_RadarRR::RRR_Object::RRR_Object_Obj15.RCS = convertRawToPhysical(raw_value, 0.2, -102.4);

    raw_value=copyBitsFromByteArrayLE( byteArray, 8536, 4);
    @CAN_RadarRR::RRR_Object::RRR_Object_Obj15.ReferencePoint = convertRawToPhysical(raw_value, 1.0, 0.0);

    raw_value=copyBitsFromByteArrayLE( byteArray, 8396, 12);
    @CAN_RadarRR::RRR_Object::RRR_Object_Obj15.Vx = convertRawToPhysical(raw_value, 0.0625, -128.0);

    raw_value=copyBitsFromByteArrayLE( byteArray, 8620, 12);
    @CAN_RadarRR::RRR_Object::RRR_Object_Obj15.VxAxCoVnce = convertRawToPhysical(raw_value, 0.005, -10.0);

    raw_value=copyBitsFromByteArrayLE( byteArray, 8640, 12);
    @CAN_RadarRR::RRR_Object::RRR_Object_Obj15.VxAyCoVnce = convertRawToPhysical(raw_value, 0.005, -10.0);

    raw_value=copyBitsFromByteArrayLE( byteArray, 8416, 12);
    @CAN_RadarRR::RRR_Object::RRR_Object_Obj15.VxVnce = convertRawToPhysical(raw_value, 0.005, 0.0);

    raw_value=copyBitsFromByteArrayLE( byteArray, 8608, 12);
    @CAN_RadarRR::RRR_Object::RRR_Object_Obj15.VxVyCoVnce = convertRawToPhysical(raw_value, 0.005, -10.0);

    raw_value=copyBitsFromByteArrayLE( byteArray, 8430, 10);
    @CAN_RadarRR::RRR_Object::RRR_Object_Obj15.Vy = convertRawToPhysical(raw_value, 0.125, -64.0);

    raw_value=copyBitsFromByteArrayLE( byteArray, 8652, 12);
    @CAN_RadarRR::RRR_Object::RRR_Object_Obj15.VyAxCoVnce = convertRawToPhysical(raw_value, 0.005, -10.0);

    raw_value=copyBitsFromByteArrayLE( byteArray, 8672, 12);
    @CAN_RadarRR::RRR_Object::RRR_Object_Obj15.VyAyCoVnce = convertRawToPhysical(raw_value, 0.005, -10.0);

    raw_value=copyBitsFromByteArrayLE( byteArray, 8448, 12);
    @CAN_RadarRR::RRR_Object::RRR_Object_Obj15.VyVnce = convertRawToPhysical(raw_value, 0.005, 0.0);

    raw_value=copyBitsFromByteArrayLE( byteArray, 8344, 7);
    @CAN_RadarRR::RRR_Object::RRR_Object_Obj15.Width = convertRawToPhysical(raw_value, 0.125, 0.0);

    raw_value=copyBitsFromByteArrayLE( byteArray, 8352, 12);
    @CAN_RadarRR::RRR_Object::RRR_Object_Obj15.WidthVnce = convertRawToPhysical(raw_value, 0.005, 0.0);
}


void CRadarRR_RRR_Object_Obj16_SetDataReceived(byte byteArray[])
{
    qword raw_value;

    raw_value=copyBitsFromByteArrayLE( byteArray, 9216, 32);
    @CAN_RadarRR::RRR_Object::RRR_Object_Obj16.Age = convertRawToPhysical(raw_value, 1.0, 0.0);

    raw_value=copyBitsFromByteArrayLE( byteArray, 8812, 10);
    @CAN_RadarRR::RRR_Object::RRR_Object_Obj16.Ax = convertRawToPhysical(raw_value, 0.03125, -16.0);

    raw_value=copyBitsFromByteArrayLE( byteArray, 9196, 12);
    @CAN_RadarRR::RRR_Object::RRR_Object_Obj16.AxAyCoVnce = convertRawToPhysical(raw_value, 0.005, -10.0);

    raw_value=copyBitsFromByteArrayLE( byteArray, 8832, 12);
    @CAN_RadarRR::RRR_Object::RRR_Object_Obj16.AxVnce = convertRawToPhysical(raw_value, 0.005, 0.0);

    raw_value=copyBitsFromByteArrayLE( byteArray, 8886, 9);
    @CAN_RadarRR::RRR_Object::RRR_Object_Obj16.Ay = convertRawToPhysical(raw_value, 0.0625, -16.0);

    raw_value=copyBitsFromByteArrayLE( byteArray, 8896, 12);
    @CAN_RadarRR::RRR_Object::RRR_Object_Obj16.AyVnce = convertRawToPhysical(raw_value, 0.005, 0.0);

    raw_value=copyBitsFromByteArrayLE( byteArray, 8952, 6);
    @CAN_RadarRR::RRR_Object::RRR_Object_Obj16.ExistProb = convertRawToPhysical(raw_value, 2.0, 0.0);

    raw_value=copyBitsFromByteArrayLE( byteArray, 9016, 8);
    @CAN_RadarRR::RRR_Object::RRR_Object_Obj16.FilterInformation = convertRawToPhysical(raw_value, 1.0, 0.0);

    raw_value=copyBitsFromByteArrayLE( byteArray, 8792, 7);
    @CAN_RadarRR::RRR_Object::RRR_Object_Obj16.Length = convertRawToPhysical(raw_value, 0.125, 0.0);

    raw_value=copyBitsFromByteArrayLE( byteArray, 8800, 12);
    @CAN_RadarRR::RRR_Object::RRR_Object_Obj16.LengthVnce = convertRawToPhysical(raw_value, 0.005, 0.0);

    raw_value=copyBitsFromByteArrayLE( byteArray, 8984, 3);
    @CAN_RadarRR::RRR_Object::RRR_Object_Obj16.MeasurementStatus = convertRawToPhysical(raw_value, 1.0, 0.0);

    raw_value=copyBitsFromByteArrayLE( byteArray, 8940, 2);
    @CAN_RadarRR::RRR_Object::RRR_Object_Obj16.MovingStatus = convertRawToPhysical(raw_value, 1.0, 0.0);

    raw_value=copyBitsFromByteArrayLE( byteArray, 8920, 7);
    @CAN_RadarRR::RRR_Object::RRR_Object_Obj16.ObjId = convertRawToPhysical(raw_value, 1.0, 0.0);

    raw_value=copyBitsFromByteArrayLE( byteArray, 8822, 9);
    @CAN_RadarRR::RRR_Object::RRR_Object_Obj16.OrientationYaw = convertRawToPhysical(raw_value, 0.0175, -4.48);

    raw_value=copyBitsFromByteArrayLE( byteArray, 8844, 12);
    @CAN_RadarRR::RRR_Object::RRR_Object_Obj16.OrientationYawVnce = convertRawToPhysical(raw_value, 0.0003, 0.0);

    raw_value=copyBitsFromByteArrayLE( byteArray, 8736, 6);
    @CAN_RadarRR::RRR_Object::RRR_Object_Obj16.ProbClassConfidence = convertRawToPhysical(raw_value, 2.0, 0.0);

    raw_value=copyBitsFromByteArrayLE( byteArray, 8987, 4);
    @CAN_RadarRR::RRR_Object::RRR_Object_Obj16.ProbClassType = convertRawToPhysical(raw_value, 1.0, 0.0);

    raw_value=copyBitsFromByteArrayLE( byteArray, 8742, 14);
    @CAN_RadarRR::RRR_Object::RRR_Object_Obj16.Px = convertRawToPhysical(raw_value, 0.0625, -512.0);

    raw_value=copyBitsFromByteArrayLE( byteArray, 9056, 12);
    @CAN_RadarRR::RRR_Object::RRR_Object_Obj16.PxAxCoVnce = convertRawToPhysical(raw_value, 0.005, -10.0);

    raw_value=copyBitsFromByteArrayLE( byteArray, 9068, 12);
    @CAN_RadarRR::RRR_Object::RRR_Object_Obj16.PxAyCoVnce = convertRawToPhysical(raw_value, 0.005, -10.0);

    raw_value=copyBitsFromByteArrayLE( byteArray, 8972, 12);
    @CAN_RadarRR::RRR_Object::RRR_Object_Obj16.PxPyCoVnce = convertRawToPhysical(raw_value, 0.005, -10.0);

    raw_value=copyBitsFromByteArrayLE( byteArray, 8756, 12);
    @CAN_RadarRR::RRR_Object::RRR_Object_Obj16.PxVnce = convertRawToPhysical(raw_value, 0.005, 0.0);

    raw_value=copyBitsFromByteArrayLE( byteArray, 8992, 12);
    @CAN_RadarRR::RRR_Object::RRR_Object_Obj16.PxVxCoVnce = convertRawToPhysical(raw_value, 0.005, -10.0);

    raw_value=copyBitsFromByteArrayLE( byteArray, 9004, 12);
    @CAN_RadarRR::RRR_Object::RRR_Object_Obj16.PxVyCoVnce = convertRawToPhysical(raw_value, 0.005, -10.0);

    raw_value=copyBitsFromByteArrayLE( byteArray, 8768, 12);
    @CAN_RadarRR::RRR_Object::RRR_Object_Obj16.Py = convertRawToPhysical(raw_value, 0.0625, -128.0);

    raw_value=copyBitsFromByteArrayLE( byteArray, 9088, 12);
    @CAN_RadarRR::RRR_Object::RRR_Object_Obj16.PyAxCoVnce = convertRawToPhysical(raw_value, 0.005, -10.0);

    raw_value=copyBitsFromByteArrayLE( byteArray, 9100, 12);
    @CAN_RadarRR::RRR_Object::RRR_Object_Obj16.PyAyCoVnce = convertRawToPhysical(raw_value, 0.005, -10.0);

    raw_value=copyBitsFromByteArrayLE( byteArray, 8780, 12);
    @CAN_RadarRR::RRR_Object::RRR_Object_Obj16.PyVnce = convertRawToPhysical(raw_value, 0.005, 0.0);

    raw_value=copyBitsFromByteArrayLE( byteArray, 9024, 12);
    @CAN_RadarRR::RRR_Object::RRR_Object_Obj16.PyVxCoVnce = convertRawToPhysical(raw_value, 0.005, -10.0);

    raw_value=copyBitsFromByteArrayLE( byteArray, 9036, 12);
    @CAN_RadarRR::RRR_Object::RRR_Object_Obj16.PyVyCoVnce = convertRawToPhysical(raw_value, 0.005, -10.0);

    raw_value=copyBitsFromByteArrayLE( byteArray, 8876, 10);
    @CAN_RadarRR::RRR_Object::RRR_Object_Obj16.RCS = convertRawToPhysical(raw_value, 0.2, -102.4);

    raw_value=copyBitsFromByteArrayLE( byteArray, 9048, 4);
    @CAN_RadarRR::RRR_Object::RRR_Object_Obj16.ReferencePoint = convertRawToPhysical(raw_value, 1.0, 0.0);

    raw_value=copyBitsFromByteArrayLE( byteArray, 8908, 12);
    @CAN_RadarRR::RRR_Object::RRR_Object_Obj16.Vx = convertRawToPhysical(raw_value, 0.0625, -128.0);

    raw_value=copyBitsFromByteArrayLE( byteArray, 9132, 12);
    @CAN_RadarRR::RRR_Object::RRR_Object_Obj16.VxAxCoVnce = convertRawToPhysical(raw_value, 0.005, -10.0);

    raw_value=copyBitsFromByteArrayLE( byteArray, 9152, 12);
    @CAN_RadarRR::RRR_Object::RRR_Object_Obj16.VxAyCoVnce = convertRawToPhysical(raw_value, 0.005, -10.0);

    raw_value=copyBitsFromByteArrayLE( byteArray, 8928, 12);
    @CAN_RadarRR::RRR_Object::RRR_Object_Obj16.VxVnce = convertRawToPhysical(raw_value, 0.005, 0.0);

    raw_value=copyBitsFromByteArrayLE( byteArray, 9120, 12);
    @CAN_RadarRR::RRR_Object::RRR_Object_Obj16.VxVyCoVnce = convertRawToPhysical(raw_value, 0.005, -10.0);

    raw_value=copyBitsFromByteArrayLE( byteArray, 8942, 10);
    @CAN_RadarRR::RRR_Object::RRR_Object_Obj16.Vy = convertRawToPhysical(raw_value, 0.125, -64.0);

    raw_value=copyBitsFromByteArrayLE( byteArray, 9164, 12);
    @CAN_RadarRR::RRR_Object::RRR_Object_Obj16.VyAxCoVnce = convertRawToPhysical(raw_value, 0.005, -10.0);

    raw_value=copyBitsFromByteArrayLE( byteArray, 9184, 12);
    @CAN_RadarRR::RRR_Object::RRR_Object_Obj16.VyAyCoVnce = convertRawToPhysical(raw_value, 0.005, -10.0);

    raw_value=copyBitsFromByteArrayLE( byteArray, 8960, 12);
    @CAN_RadarRR::RRR_Object::RRR_Object_Obj16.VyVnce = convertRawToPhysical(raw_value, 0.005, 0.0);

    raw_value=copyBitsFromByteArrayLE( byteArray, 8856, 7);
    @CAN_RadarRR::RRR_Object::RRR_Object_Obj16.Width = convertRawToPhysical(raw_value, 0.125, 0.0);

    raw_value=copyBitsFromByteArrayLE( byteArray, 8864, 12);
    @CAN_RadarRR::RRR_Object::RRR_Object_Obj16.WidthVnce = convertRawToPhysical(raw_value, 0.005, 0.0);
}


void CRadarRR_RRR_Object_Obj17_SetDataReceived(byte byteArray[])
{
    qword raw_value;

    raw_value=copyBitsFromByteArrayLE( byteArray, 9728, 32);
    @CAN_RadarRR::RRR_Object::RRR_Object_Obj17.Age = convertRawToPhysical(raw_value, 1.0, 0.0);

    raw_value=copyBitsFromByteArrayLE( byteArray, 9324, 10);
    @CAN_RadarRR::RRR_Object::RRR_Object_Obj17.Ax = convertRawToPhysical(raw_value, 0.03125, -16.0);

    raw_value=copyBitsFromByteArrayLE( byteArray, 9708, 12);
    @CAN_RadarRR::RRR_Object::RRR_Object_Obj17.AxAyCoVnce = convertRawToPhysical(raw_value, 0.005, -10.0);

    raw_value=copyBitsFromByteArrayLE( byteArray, 9344, 12);
    @CAN_RadarRR::RRR_Object::RRR_Object_Obj17.AxVnce = convertRawToPhysical(raw_value, 0.005, 0.0);

    raw_value=copyBitsFromByteArrayLE( byteArray, 9398, 9);
    @CAN_RadarRR::RRR_Object::RRR_Object_Obj17.Ay = convertRawToPhysical(raw_value, 0.0625, -16.0);

    raw_value=copyBitsFromByteArrayLE( byteArray, 9408, 12);
    @CAN_RadarRR::RRR_Object::RRR_Object_Obj17.AyVnce = convertRawToPhysical(raw_value, 0.005, 0.0);

    raw_value=copyBitsFromByteArrayLE( byteArray, 9464, 6);
    @CAN_RadarRR::RRR_Object::RRR_Object_Obj17.ExistProb = convertRawToPhysical(raw_value, 2.0, 0.0);

    raw_value=copyBitsFromByteArrayLE( byteArray, 9528, 8);
    @CAN_RadarRR::RRR_Object::RRR_Object_Obj17.FilterInformation = convertRawToPhysical(raw_value, 1.0, 0.0);

    raw_value=copyBitsFromByteArrayLE( byteArray, 9304, 7);
    @CAN_RadarRR::RRR_Object::RRR_Object_Obj17.Length = convertRawToPhysical(raw_value, 0.125, 0.0);

    raw_value=copyBitsFromByteArrayLE( byteArray, 9312, 12);
    @CAN_RadarRR::RRR_Object::RRR_Object_Obj17.LengthVnce = convertRawToPhysical(raw_value, 0.005, 0.0);

    raw_value=copyBitsFromByteArrayLE( byteArray, 9496, 3);
    @CAN_RadarRR::RRR_Object::RRR_Object_Obj17.MeasurementStatus = convertRawToPhysical(raw_value, 1.0, 0.0);

    raw_value=copyBitsFromByteArrayLE( byteArray, 9452, 2);
    @CAN_RadarRR::RRR_Object::RRR_Object_Obj17.MovingStatus = convertRawToPhysical(raw_value, 1.0, 0.0);

    raw_value=copyBitsFromByteArrayLE( byteArray, 9432, 7);
    @CAN_RadarRR::RRR_Object::RRR_Object_Obj17.ObjId = convertRawToPhysical(raw_value, 1.0, 0.0);

    raw_value=copyBitsFromByteArrayLE( byteArray, 9334, 9);
    @CAN_RadarRR::RRR_Object::RRR_Object_Obj17.OrientationYaw = convertRawToPhysical(raw_value, 0.0175, -4.48);

    raw_value=copyBitsFromByteArrayLE( byteArray, 9356, 12);
    @CAN_RadarRR::RRR_Object::RRR_Object_Obj17.OrientationYawVnce = convertRawToPhysical(raw_value, 0.0003, 0.0);

    raw_value=copyBitsFromByteArrayLE( byteArray, 9248, 6);
    @CAN_RadarRR::RRR_Object::RRR_Object_Obj17.ProbClassConfidence = convertRawToPhysical(raw_value, 2.0, 0.0);

    raw_value=copyBitsFromByteArrayLE( byteArray, 9499, 4);
    @CAN_RadarRR::RRR_Object::RRR_Object_Obj17.ProbClassType = convertRawToPhysical(raw_value, 1.0, 0.0);

    raw_value=copyBitsFromByteArrayLE( byteArray, 9254, 14);
    @CAN_RadarRR::RRR_Object::RRR_Object_Obj17.Px = convertRawToPhysical(raw_value, 0.0625, -512.0);

    raw_value=copyBitsFromByteArrayLE( byteArray, 9568, 12);
    @CAN_RadarRR::RRR_Object::RRR_Object_Obj17.PxAxCoVnce = convertRawToPhysical(raw_value, 0.005, -10.0);

    raw_value=copyBitsFromByteArrayLE( byteArray, 9580, 12);
    @CAN_RadarRR::RRR_Object::RRR_Object_Obj17.PxAyCoVnce = convertRawToPhysical(raw_value, 0.005, -10.0);

    raw_value=copyBitsFromByteArrayLE( byteArray, 9484, 12);
    @CAN_RadarRR::RRR_Object::RRR_Object_Obj17.PxPyCoVnce = convertRawToPhysical(raw_value, 0.005, -10.0);

    raw_value=copyBitsFromByteArrayLE( byteArray, 9268, 12);
    @CAN_RadarRR::RRR_Object::RRR_Object_Obj17.PxVnce = convertRawToPhysical(raw_value, 0.005, 0.0);

    raw_value=copyBitsFromByteArrayLE( byteArray, 9504, 12);
    @CAN_RadarRR::RRR_Object::RRR_Object_Obj17.PxVxCoVnce = convertRawToPhysical(raw_value, 0.005, -10.0);

    raw_value=copyBitsFromByteArrayLE( byteArray, 9516, 12);
    @CAN_RadarRR::RRR_Object::RRR_Object_Obj17.PxVyCoVnce = convertRawToPhysical(raw_value, 0.005, -10.0);

    raw_value=copyBitsFromByteArrayLE( byteArray, 9280, 12);
    @CAN_RadarRR::RRR_Object::RRR_Object_Obj17.Py = convertRawToPhysical(raw_value, 0.0625, -128.0);

    raw_value=copyBitsFromByteArrayLE( byteArray, 9600, 12);
    @CAN_RadarRR::RRR_Object::RRR_Object_Obj17.PyAxCoVnce = convertRawToPhysical(raw_value, 0.005, -10.0);

    raw_value=copyBitsFromByteArrayLE( byteArray, 9612, 12);
    @CAN_RadarRR::RRR_Object::RRR_Object_Obj17.PyAyCoVnce = convertRawToPhysical(raw_value, 0.005, -10.0);

    raw_value=copyBitsFromByteArrayLE( byteArray, 9292, 12);
    @CAN_RadarRR::RRR_Object::RRR_Object_Obj17.PyVnce = convertRawToPhysical(raw_value, 0.005, 0.0);

    raw_value=copyBitsFromByteArrayLE( byteArray, 9536, 12);
    @CAN_RadarRR::RRR_Object::RRR_Object_Obj17.PyVxCoVnce = convertRawToPhysical(raw_value, 0.005, -10.0);

    raw_value=copyBitsFromByteArrayLE( byteArray, 9548, 12);
    @CAN_RadarRR::RRR_Object::RRR_Object_Obj17.PyVyCoVnce = convertRawToPhysical(raw_value, 0.005, -10.0);

    raw_value=copyBitsFromByteArrayLE( byteArray, 9388, 10);
    @CAN_RadarRR::RRR_Object::RRR_Object_Obj17.RCS = convertRawToPhysical(raw_value, 0.2, -102.4);

    raw_value=copyBitsFromByteArrayLE( byteArray, 9560, 4);
    @CAN_RadarRR::RRR_Object::RRR_Object_Obj17.ReferencePoint = convertRawToPhysical(raw_value, 1.0, 0.0);

    raw_value=copyBitsFromByteArrayLE( byteArray, 9420, 12);
    @CAN_RadarRR::RRR_Object::RRR_Object_Obj17.Vx = convertRawToPhysical(raw_value, 0.0625, -128.0);

    raw_value=copyBitsFromByteArrayLE( byteArray, 9644, 12);
    @CAN_RadarRR::RRR_Object::RRR_Object_Obj17.VxAxCoVnce = convertRawToPhysical(raw_value, 0.005, -10.0);

    raw_value=copyBitsFromByteArrayLE( byteArray, 9664, 12);
    @CAN_RadarRR::RRR_Object::RRR_Object_Obj17.VxAyCoVnce = convertRawToPhysical(raw_value, 0.005, -10.0);

    raw_value=copyBitsFromByteArrayLE( byteArray, 9440, 12);
    @CAN_RadarRR::RRR_Object::RRR_Object_Obj17.VxVnce = convertRawToPhysical(raw_value, 0.005, 0.0);

    raw_value=copyBitsFromByteArrayLE( byteArray, 9632, 12);
    @CAN_RadarRR::RRR_Object::RRR_Object_Obj17.VxVyCoVnce = convertRawToPhysical(raw_value, 0.005, -10.0);

    raw_value=copyBitsFromByteArrayLE( byteArray, 9454, 10);
    @CAN_RadarRR::RRR_Object::RRR_Object_Obj17.Vy = convertRawToPhysical(raw_value, 0.125, -64.0);

    raw_value=copyBitsFromByteArrayLE( byteArray, 9676, 12);
    @CAN_RadarRR::RRR_Object::RRR_Object_Obj17.VyAxCoVnce = convertRawToPhysical(raw_value, 0.005, -10.0);

    raw_value=copyBitsFromByteArrayLE( byteArray, 9696, 12);
    @CAN_RadarRR::RRR_Object::RRR_Object_Obj17.VyAyCoVnce = convertRawToPhysical(raw_value, 0.005, -10.0);

    raw_value=copyBitsFromByteArrayLE( byteArray, 9472, 12);
    @CAN_RadarRR::RRR_Object::RRR_Object_Obj17.VyVnce = convertRawToPhysical(raw_value, 0.005, 0.0);

    raw_value=copyBitsFromByteArrayLE( byteArray, 9368, 7);
    @CAN_RadarRR::RRR_Object::RRR_Object_Obj17.Width = convertRawToPhysical(raw_value, 0.125, 0.0);

    raw_value=copyBitsFromByteArrayLE( byteArray, 9376, 12);
    @CAN_RadarRR::RRR_Object::RRR_Object_Obj17.WidthVnce = convertRawToPhysical(raw_value, 0.005, 0.0);
}


void CRadarRR_RRR_Object_Obj18_SetDataReceived(byte byteArray[])
{
    qword raw_value;

    raw_value=copyBitsFromByteArrayLE( byteArray, 10240, 32);
    @CAN_RadarRR::RRR_Object::RRR_Object_Obj18.Age = convertRawToPhysical(raw_value, 1.0, 0.0);

    raw_value=copyBitsFromByteArrayLE( byteArray, 9836, 10);
    @CAN_RadarRR::RRR_Object::RRR_Object_Obj18.Ax = convertRawToPhysical(raw_value, 0.03125, -16.0);

    raw_value=copyBitsFromByteArrayLE( byteArray, 10220, 12);
    @CAN_RadarRR::RRR_Object::RRR_Object_Obj18.AxAyCoVnce = convertRawToPhysical(raw_value, 0.005, -10.0);

    raw_value=copyBitsFromByteArrayLE( byteArray, 9856, 12);
    @CAN_RadarRR::RRR_Object::RRR_Object_Obj18.AxVnce = convertRawToPhysical(raw_value, 0.005, 0.0);

    raw_value=copyBitsFromByteArrayLE( byteArray, 9910, 9);
    @CAN_RadarRR::RRR_Object::RRR_Object_Obj18.Ay = convertRawToPhysical(raw_value, 0.0625, -16.0);

    raw_value=copyBitsFromByteArrayLE( byteArray, 9920, 12);
    @CAN_RadarRR::RRR_Object::RRR_Object_Obj18.AyVnce = convertRawToPhysical(raw_value, 0.005, 0.0);

    raw_value=copyBitsFromByteArrayLE( byteArray, 9976, 6);
    @CAN_RadarRR::RRR_Object::RRR_Object_Obj18.ExistProb = convertRawToPhysical(raw_value, 2.0, 0.0);

    raw_value=copyBitsFromByteArrayLE( byteArray, 10040, 8);
    @CAN_RadarRR::RRR_Object::RRR_Object_Obj18.FilterInformation = convertRawToPhysical(raw_value, 1.0, 0.0);

    raw_value=copyBitsFromByteArrayLE( byteArray, 9816, 7);
    @CAN_RadarRR::RRR_Object::RRR_Object_Obj18.Length = convertRawToPhysical(raw_value, 0.125, 0.0);

    raw_value=copyBitsFromByteArrayLE( byteArray, 9824, 12);
    @CAN_RadarRR::RRR_Object::RRR_Object_Obj18.LengthVnce = convertRawToPhysical(raw_value, 0.005, 0.0);

    raw_value=copyBitsFromByteArrayLE( byteArray, 10008, 3);
    @CAN_RadarRR::RRR_Object::RRR_Object_Obj18.MeasurementStatus = convertRawToPhysical(raw_value, 1.0, 0.0);

    raw_value=copyBitsFromByteArrayLE( byteArray, 9964, 2);
    @CAN_RadarRR::RRR_Object::RRR_Object_Obj18.MovingStatus = convertRawToPhysical(raw_value, 1.0, 0.0);

    raw_value=copyBitsFromByteArrayLE( byteArray, 9944, 7);
    @CAN_RadarRR::RRR_Object::RRR_Object_Obj18.ObjId = convertRawToPhysical(raw_value, 1.0, 0.0);

    raw_value=copyBitsFromByteArrayLE( byteArray, 9846, 9);
    @CAN_RadarRR::RRR_Object::RRR_Object_Obj18.OrientationYaw = convertRawToPhysical(raw_value, 0.0175, -4.48);

    raw_value=copyBitsFromByteArrayLE( byteArray, 9868, 12);
    @CAN_RadarRR::RRR_Object::RRR_Object_Obj18.OrientationYawVnce = convertRawToPhysical(raw_value, 0.0003, 0.0);

    raw_value=copyBitsFromByteArrayLE( byteArray, 9760, 6);
    @CAN_RadarRR::RRR_Object::RRR_Object_Obj18.ProbClassConfidence = convertRawToPhysical(raw_value, 2.0, 0.0);

    raw_value=copyBitsFromByteArrayLE( byteArray, 10011, 4);
    @CAN_RadarRR::RRR_Object::RRR_Object_Obj18.ProbClassType = convertRawToPhysical(raw_value, 1.0, 0.0);

    raw_value=copyBitsFromByteArrayLE( byteArray, 9766, 14);
    @CAN_RadarRR::RRR_Object::RRR_Object_Obj18.Px = convertRawToPhysical(raw_value, 0.0625, -512.0);

    raw_value=copyBitsFromByteArrayLE( byteArray, 10080, 12);
    @CAN_RadarRR::RRR_Object::RRR_Object_Obj18.PxAxCoVnce = convertRawToPhysical(raw_value, 0.005, -10.0);

    raw_value=copyBitsFromByteArrayLE( byteArray, 10092, 12);
    @CAN_RadarRR::RRR_Object::RRR_Object_Obj18.PxAyCoVnce = convertRawToPhysical(raw_value, 0.005, -10.0);

    raw_value=copyBitsFromByteArrayLE( byteArray, 9996, 12);
    @CAN_RadarRR::RRR_Object::RRR_Object_Obj18.PxPyCoVnce = convertRawToPhysical(raw_value, 0.005, -10.0);

    raw_value=copyBitsFromByteArrayLE( byteArray, 9780, 12);
    @CAN_RadarRR::RRR_Object::RRR_Object_Obj18.PxVnce = convertRawToPhysical(raw_value, 0.005, 0.0);

    raw_value=copyBitsFromByteArrayLE( byteArray, 10016, 12);
    @CAN_RadarRR::RRR_Object::RRR_Object_Obj18.PxVxCoVnce = convertRawToPhysical(raw_value, 0.005, -10.0);

    raw_value=copyBitsFromByteArrayLE( byteArray, 10028, 12);
    @CAN_RadarRR::RRR_Object::RRR_Object_Obj18.PxVyCoVnce = convertRawToPhysical(raw_value, 0.005, -10.0);

    raw_value=copyBitsFromByteArrayLE( byteArray, 9792, 12);
    @CAN_RadarRR::RRR_Object::RRR_Object_Obj18.Py = convertRawToPhysical(raw_value, 0.0625, -128.0);

    raw_value=copyBitsFromByteArrayLE( byteArray, 10112, 12);
    @CAN_RadarRR::RRR_Object::RRR_Object_Obj18.PyAxCoVnce = convertRawToPhysical(raw_value, 0.005, -10.0);

    raw_value=copyBitsFromByteArrayLE( byteArray, 10124, 12);
    @CAN_RadarRR::RRR_Object::RRR_Object_Obj18.PyAyCoVnce = convertRawToPhysical(raw_value, 0.005, -10.0);

    raw_value=copyBitsFromByteArrayLE( byteArray, 9804, 12);
    @CAN_RadarRR::RRR_Object::RRR_Object_Obj18.PyVnce = convertRawToPhysical(raw_value, 0.005, 0.0);

    raw_value=copyBitsFromByteArrayLE( byteArray, 10048, 12);
    @CAN_RadarRR::RRR_Object::RRR_Object_Obj18.PyVxCoVnce = convertRawToPhysical(raw_value, 0.005, -10.0);

    raw_value=copyBitsFromByteArrayLE( byteArray, 10060, 12);
    @CAN_RadarRR::RRR_Object::RRR_Object_Obj18.PyVyCoVnce = convertRawToPhysical(raw_value, 0.005, -10.0);

    raw_value=copyBitsFromByteArrayLE( byteArray, 9900, 10);
    @CAN_RadarRR::RRR_Object::RRR_Object_Obj18.RCS = convertRawToPhysical(raw_value, 0.2, -102.4);

    raw_value=copyBitsFromByteArrayLE( byteArray, 10072, 4);
    @CAN_RadarRR::RRR_Object::RRR_Object_Obj18.ReferencePoint = convertRawToPhysical(raw_value, 1.0, 0.0);

    raw_value=copyBitsFromByteArrayLE( byteArray, 9932, 12);
    @CAN_RadarRR::RRR_Object::RRR_Object_Obj18.Vx = convertRawToPhysical(raw_value, 0.0625, -128.0);

    raw_value=copyBitsFromByteArrayLE( byteArray, 10156, 12);
    @CAN_RadarRR::RRR_Object::RRR_Object_Obj18.VxAxCoVnce = convertRawToPhysical(raw_value, 0.005, -10.0);

    raw_value=copyBitsFromByteArrayLE( byteArray, 10176, 12);
    @CAN_RadarRR::RRR_Object::RRR_Object_Obj18.VxAyCoVnce = convertRawToPhysical(raw_value, 0.005, -10.0);

    raw_value=copyBitsFromByteArrayLE( byteArray, 9952, 12);
    @CAN_RadarRR::RRR_Object::RRR_Object_Obj18.VxVnce = convertRawToPhysical(raw_value, 0.005, 0.0);

    raw_value=copyBitsFromByteArrayLE( byteArray, 10144, 12);
    @CAN_RadarRR::RRR_Object::RRR_Object_Obj18.VxVyCoVnce = convertRawToPhysical(raw_value, 0.005, -10.0);

    raw_value=copyBitsFromByteArrayLE( byteArray, 9966, 10);
    @CAN_RadarRR::RRR_Object::RRR_Object_Obj18.Vy = convertRawToPhysical(raw_value, 0.125, -64.0);

    raw_value=copyBitsFromByteArrayLE( byteArray, 10188, 12);
    @CAN_RadarRR::RRR_Object::RRR_Object_Obj18.VyAxCoVnce = convertRawToPhysical(raw_value, 0.005, -10.0);

    raw_value=copyBitsFromByteArrayLE( byteArray, 10208, 12);
    @CAN_RadarRR::RRR_Object::RRR_Object_Obj18.VyAyCoVnce = convertRawToPhysical(raw_value, 0.005, -10.0);

    raw_value=copyBitsFromByteArrayLE( byteArray, 9984, 12);
    @CAN_RadarRR::RRR_Object::RRR_Object_Obj18.VyVnce = convertRawToPhysical(raw_value, 0.005, 0.0);

    raw_value=copyBitsFromByteArrayLE( byteArray, 9880, 7);
    @CAN_RadarRR::RRR_Object::RRR_Object_Obj18.Width = convertRawToPhysical(raw_value, 0.125, 0.0);

    raw_value=copyBitsFromByteArrayLE( byteArray, 9888, 12);
    @CAN_RadarRR::RRR_Object::RRR_Object_Obj18.WidthVnce = convertRawToPhysical(raw_value, 0.005, 0.0);
}


void CRadarRR_RRR_Object_Obj19_SetDataReceived(byte byteArray[])
{
    qword raw_value;

    raw_value=copyBitsFromByteArrayLE( byteArray, 10752, 32);
    @CAN_RadarRR::RRR_Object::RRR_Object_Obj19.Age = convertRawToPhysical(raw_value, 1.0, 0.0);

    raw_value=copyBitsFromByteArrayLE( byteArray, 10348, 10);
    @CAN_RadarRR::RRR_Object::RRR_Object_Obj19.Ax = convertRawToPhysical(raw_value, 0.03125, -16.0);

    raw_value=copyBitsFromByteArrayLE( byteArray, 10732, 12);
    @CAN_RadarRR::RRR_Object::RRR_Object_Obj19.AxAyCoVnce = convertRawToPhysical(raw_value, 0.005, -10.0);

    raw_value=copyBitsFromByteArrayLE( byteArray, 10368, 12);
    @CAN_RadarRR::RRR_Object::RRR_Object_Obj19.AxVnce = convertRawToPhysical(raw_value, 0.005, 0.0);

    raw_value=copyBitsFromByteArrayLE( byteArray, 10422, 9);
    @CAN_RadarRR::RRR_Object::RRR_Object_Obj19.Ay = convertRawToPhysical(raw_value, 0.0625, -16.0);

    raw_value=copyBitsFromByteArrayLE( byteArray, 10432, 12);
    @CAN_RadarRR::RRR_Object::RRR_Object_Obj19.AyVnce = convertRawToPhysical(raw_value, 0.005, 0.0);

    raw_value=copyBitsFromByteArrayLE( byteArray, 10488, 6);
    @CAN_RadarRR::RRR_Object::RRR_Object_Obj19.ExistProb = convertRawToPhysical(raw_value, 2.0, 0.0);

    raw_value=copyBitsFromByteArrayLE( byteArray, 10552, 8);
    @CAN_RadarRR::RRR_Object::RRR_Object_Obj19.FilterInformation = convertRawToPhysical(raw_value, 1.0, 0.0);

    raw_value=copyBitsFromByteArrayLE( byteArray, 10328, 7);
    @CAN_RadarRR::RRR_Object::RRR_Object_Obj19.Length = convertRawToPhysical(raw_value, 0.125, 0.0);

    raw_value=copyBitsFromByteArrayLE( byteArray, 10336, 12);
    @CAN_RadarRR::RRR_Object::RRR_Object_Obj19.LengthVnce = convertRawToPhysical(raw_value, 0.005, 0.0);

    raw_value=copyBitsFromByteArrayLE( byteArray, 10520, 3);
    @CAN_RadarRR::RRR_Object::RRR_Object_Obj19.MeasurementStatus = convertRawToPhysical(raw_value, 1.0, 0.0);

    raw_value=copyBitsFromByteArrayLE( byteArray, 10476, 2);
    @CAN_RadarRR::RRR_Object::RRR_Object_Obj19.MovingStatus = convertRawToPhysical(raw_value, 1.0, 0.0);

    raw_value=copyBitsFromByteArrayLE( byteArray, 10456, 7);
    @CAN_RadarRR::RRR_Object::RRR_Object_Obj19.ObjId = convertRawToPhysical(raw_value, 1.0, 0.0);

    raw_value=copyBitsFromByteArrayLE( byteArray, 10358, 9);
    @CAN_RadarRR::RRR_Object::RRR_Object_Obj19.OrientationYaw = convertRawToPhysical(raw_value, 0.0175, -4.48);

    raw_value=copyBitsFromByteArrayLE( byteArray, 10380, 12);
    @CAN_RadarRR::RRR_Object::RRR_Object_Obj19.OrientationYawVnce = convertRawToPhysical(raw_value, 0.0003, 0.0);

    raw_value=copyBitsFromByteArrayLE( byteArray, 10272, 6);
    @CAN_RadarRR::RRR_Object::RRR_Object_Obj19.ProbClassConfidence = convertRawToPhysical(raw_value, 2.0, 0.0);

    raw_value=copyBitsFromByteArrayLE( byteArray, 10523, 4);
    @CAN_RadarRR::RRR_Object::RRR_Object_Obj19.ProbClassType = convertRawToPhysical(raw_value, 1.0, 0.0);

    raw_value=copyBitsFromByteArrayLE( byteArray, 10278, 14);
    @CAN_RadarRR::RRR_Object::RRR_Object_Obj19.Px = convertRawToPhysical(raw_value, 0.0625, -512.0);

    raw_value=copyBitsFromByteArrayLE( byteArray, 10592, 12);
    @CAN_RadarRR::RRR_Object::RRR_Object_Obj19.PxAxCoVnce = convertRawToPhysical(raw_value, 0.005, -10.0);

    raw_value=copyBitsFromByteArrayLE( byteArray, 10604, 12);
    @CAN_RadarRR::RRR_Object::RRR_Object_Obj19.PxAyCoVnce = convertRawToPhysical(raw_value, 0.005, -10.0);

    raw_value=copyBitsFromByteArrayLE( byteArray, 10508, 12);
    @CAN_RadarRR::RRR_Object::RRR_Object_Obj19.PxPyCoVnce = convertRawToPhysical(raw_value, 0.005, -10.0);

    raw_value=copyBitsFromByteArrayLE( byteArray, 10292, 12);
    @CAN_RadarRR::RRR_Object::RRR_Object_Obj19.PxVnce = convertRawToPhysical(raw_value, 0.005, 0.0);

    raw_value=copyBitsFromByteArrayLE( byteArray, 10528, 12);
    @CAN_RadarRR::RRR_Object::RRR_Object_Obj19.PxVxCoVnce = convertRawToPhysical(raw_value, 0.005, -10.0);

    raw_value=copyBitsFromByteArrayLE( byteArray, 10540, 12);
    @CAN_RadarRR::RRR_Object::RRR_Object_Obj19.PxVyCoVnce = convertRawToPhysical(raw_value, 0.005, -10.0);

    raw_value=copyBitsFromByteArrayLE( byteArray, 10304, 12);
    @CAN_RadarRR::RRR_Object::RRR_Object_Obj19.Py = convertRawToPhysical(raw_value, 0.0625, -128.0);

    raw_value=copyBitsFromByteArrayLE( byteArray, 10624, 12);
    @CAN_RadarRR::RRR_Object::RRR_Object_Obj19.PyAxCoVnce = convertRawToPhysical(raw_value, 0.005, -10.0);

    raw_value=copyBitsFromByteArrayLE( byteArray, 10636, 12);
    @CAN_RadarRR::RRR_Object::RRR_Object_Obj19.PyAyCoVnce = convertRawToPhysical(raw_value, 0.005, -10.0);

    raw_value=copyBitsFromByteArrayLE( byteArray, 10316, 12);
    @CAN_RadarRR::RRR_Object::RRR_Object_Obj19.PyVnce = convertRawToPhysical(raw_value, 0.005, 0.0);

    raw_value=copyBitsFromByteArrayLE( byteArray, 10560, 12);
    @CAN_RadarRR::RRR_Object::RRR_Object_Obj19.PyVxCoVnce = convertRawToPhysical(raw_value, 0.005, -10.0);

    raw_value=copyBitsFromByteArrayLE( byteArray, 10572, 12);
    @CAN_RadarRR::RRR_Object::RRR_Object_Obj19.PyVyCoVnce = convertRawToPhysical(raw_value, 0.005, -10.0);

    raw_value=copyBitsFromByteArrayLE( byteArray, 10412, 10);
    @CAN_RadarRR::RRR_Object::RRR_Object_Obj19.RCS = convertRawToPhysical(raw_value, 0.2, -102.4);

    raw_value=copyBitsFromByteArrayLE( byteArray, 10584, 4);
    @CAN_RadarRR::RRR_Object::RRR_Object_Obj19.ReferencePoint = convertRawToPhysical(raw_value, 1.0, 0.0);

    raw_value=copyBitsFromByteArrayLE( byteArray, 10444, 12);
    @CAN_RadarRR::RRR_Object::RRR_Object_Obj19.Vx = convertRawToPhysical(raw_value, 0.0625, -128.0);

    raw_value=copyBitsFromByteArrayLE( byteArray, 10668, 12);
    @CAN_RadarRR::RRR_Object::RRR_Object_Obj19.VxAxCoVnce = convertRawToPhysical(raw_value, 0.005, -10.0);

    raw_value=copyBitsFromByteArrayLE( byteArray, 10688, 12);
    @CAN_RadarRR::RRR_Object::RRR_Object_Obj19.VxAyCoVnce = convertRawToPhysical(raw_value, 0.005, -10.0);

    raw_value=copyBitsFromByteArrayLE( byteArray, 10464, 12);
    @CAN_RadarRR::RRR_Object::RRR_Object_Obj19.VxVnce = convertRawToPhysical(raw_value, 0.005, 0.0);

    raw_value=copyBitsFromByteArrayLE( byteArray, 10656, 12);
    @CAN_RadarRR::RRR_Object::RRR_Object_Obj19.VxVyCoVnce = convertRawToPhysical(raw_value, 0.005, -10.0);

    raw_value=copyBitsFromByteArrayLE( byteArray, 10478, 10);
    @CAN_RadarRR::RRR_Object::RRR_Object_Obj19.Vy = convertRawToPhysical(raw_value, 0.125, -64.0);

    raw_value=copyBitsFromByteArrayLE( byteArray, 10700, 12);
    @CAN_RadarRR::RRR_Object::RRR_Object_Obj19.VyAxCoVnce = convertRawToPhysical(raw_value, 0.005, -10.0);

    raw_value=copyBitsFromByteArrayLE( byteArray, 10720, 12);
    @CAN_RadarRR::RRR_Object::RRR_Object_Obj19.VyAyCoVnce = convertRawToPhysical(raw_value, 0.005, -10.0);

    raw_value=copyBitsFromByteArrayLE( byteArray, 10496, 12);
    @CAN_RadarRR::RRR_Object::RRR_Object_Obj19.VyVnce = convertRawToPhysical(raw_value, 0.005, 0.0);

    raw_value=copyBitsFromByteArrayLE( byteArray, 10392, 7);
    @CAN_RadarRR::RRR_Object::RRR_Object_Obj19.Width = convertRawToPhysical(raw_value, 0.125, 0.0);

    raw_value=copyBitsFromByteArrayLE( byteArray, 10400, 12);
    @CAN_RadarRR::RRR_Object::RRR_Object_Obj19.WidthVnce = convertRawToPhysical(raw_value, 0.005, 0.0);
}


void CRadarRR_RRR_Object_Obj2_SetDataReceived(byte byteArray[])
{
    qword raw_value;

    raw_value=copyBitsFromByteArrayLE( byteArray, 2048, 32);
    @CAN_RadarRR::RRR_Object::RRR_Object_Obj2.Age = convertRawToPhysical(raw_value, 1.0, 0.0);

    raw_value=copyBitsFromByteArrayLE( byteArray, 1644, 10);
    @CAN_RadarRR::RRR_Object::RRR_Object_Obj2.Ax = convertRawToPhysical(raw_value, 0.03125, -16.0);

    raw_value=copyBitsFromByteArrayLE( byteArray, 2028, 12);
    @CAN_RadarRR::RRR_Object::RRR_Object_Obj2.AxAyCoVnce = convertRawToPhysical(raw_value, 0.005, -10.0);

    raw_value=copyBitsFromByteArrayLE( byteArray, 1664, 12);
    @CAN_RadarRR::RRR_Object::RRR_Object_Obj2.AxVnce = convertRawToPhysical(raw_value, 0.005, 0.0);

    raw_value=copyBitsFromByteArrayLE( byteArray, 1718, 9);
    @CAN_RadarRR::RRR_Object::RRR_Object_Obj2.Ay = convertRawToPhysical(raw_value, 0.0625, -16.0);

    raw_value=copyBitsFromByteArrayLE( byteArray, 1728, 12);
    @CAN_RadarRR::RRR_Object::RRR_Object_Obj2.AyVnce = convertRawToPhysical(raw_value, 0.005, 0.0);

    raw_value=copyBitsFromByteArrayLE( byteArray, 1784, 6);
    @CAN_RadarRR::RRR_Object::RRR_Object_Obj2.ExistProb = convertRawToPhysical(raw_value, 2.0, 0.0);

    raw_value=copyBitsFromByteArrayLE( byteArray, 1848, 8);
    @CAN_RadarRR::RRR_Object::RRR_Object_Obj2.FilterInformation = convertRawToPhysical(raw_value, 1.0, 0.0);

    raw_value=copyBitsFromByteArrayLE( byteArray, 1624, 7);
    @CAN_RadarRR::RRR_Object::RRR_Object_Obj2.Length = convertRawToPhysical(raw_value, 0.125, 0.0);

    raw_value=copyBitsFromByteArrayLE( byteArray, 1632, 12);
    @CAN_RadarRR::RRR_Object::RRR_Object_Obj2.LengthVnce = convertRawToPhysical(raw_value, 0.005, 0.0);

    raw_value=copyBitsFromByteArrayLE( byteArray, 1816, 3);
    @CAN_RadarRR::RRR_Object::RRR_Object_Obj2.MeasurementStatus = convertRawToPhysical(raw_value, 1.0, 0.0);

    raw_value=copyBitsFromByteArrayLE( byteArray, 1772, 2);
    @CAN_RadarRR::RRR_Object::RRR_Object_Obj2.MovingStatus = convertRawToPhysical(raw_value, 1.0, 0.0);

    raw_value=copyBitsFromByteArrayLE( byteArray, 1752, 7);
    @CAN_RadarRR::RRR_Object::RRR_Object_Obj2.ObjId = convertRawToPhysical(raw_value, 1.0, 0.0);

    raw_value=copyBitsFromByteArrayLE( byteArray, 1654, 9);
    @CAN_RadarRR::RRR_Object::RRR_Object_Obj2.OrientationYaw = convertRawToPhysical(raw_value, 0.0175, -4.48);

    raw_value=copyBitsFromByteArrayLE( byteArray, 1676, 12);
    @CAN_RadarRR::RRR_Object::RRR_Object_Obj2.OrientationYawVnce = convertRawToPhysical(raw_value, 0.0003, 0.0);

    raw_value=copyBitsFromByteArrayLE( byteArray, 1568, 6);
    @CAN_RadarRR::RRR_Object::RRR_Object_Obj2.ProbClassConfidence = convertRawToPhysical(raw_value, 2.0, 0.0);

    raw_value=copyBitsFromByteArrayLE( byteArray, 1819, 4);
    @CAN_RadarRR::RRR_Object::RRR_Object_Obj2.ProbClassType = convertRawToPhysical(raw_value, 1.0, 0.0);

    raw_value=copyBitsFromByteArrayLE( byteArray, 1574, 14);
    @CAN_RadarRR::RRR_Object::RRR_Object_Obj2.Px = convertRawToPhysical(raw_value, 0.0625, -512.0);

    raw_value=copyBitsFromByteArrayLE( byteArray, 1888, 12);
    @CAN_RadarRR::RRR_Object::RRR_Object_Obj2.PxAxCoVnce = convertRawToPhysical(raw_value, 0.005, -10.0);

    raw_value=copyBitsFromByteArrayLE( byteArray, 1900, 12);
    @CAN_RadarRR::RRR_Object::RRR_Object_Obj2.PxAyCoVnce = convertRawToPhysical(raw_value, 0.005, -10.0);

    raw_value=copyBitsFromByteArrayLE( byteArray, 1804, 12);
    @CAN_RadarRR::RRR_Object::RRR_Object_Obj2.PxPyCoVnce = convertRawToPhysical(raw_value, 0.005, -10.0);

    raw_value=copyBitsFromByteArrayLE( byteArray, 1588, 12);
    @CAN_RadarRR::RRR_Object::RRR_Object_Obj2.PxVnce = convertRawToPhysical(raw_value, 0.005, 0.0);

    raw_value=copyBitsFromByteArrayLE( byteArray, 1824, 12);
    @CAN_RadarRR::RRR_Object::RRR_Object_Obj2.PxVxCoVnce = convertRawToPhysical(raw_value, 0.005, -10.0);

    raw_value=copyBitsFromByteArrayLE( byteArray, 1836, 12);
    @CAN_RadarRR::RRR_Object::RRR_Object_Obj2.PxVyCoVnce = convertRawToPhysical(raw_value, 0.005, -10.0);

    raw_value=copyBitsFromByteArrayLE( byteArray, 1600, 12);
    @CAN_RadarRR::RRR_Object::RRR_Object_Obj2.Py = convertRawToPhysical(raw_value, 0.0625, -128.0);

    raw_value=copyBitsFromByteArrayLE( byteArray, 1920, 12);
    @CAN_RadarRR::RRR_Object::RRR_Object_Obj2.PyAxCoVnce = convertRawToPhysical(raw_value, 0.005, -10.0);

    raw_value=copyBitsFromByteArrayLE( byteArray, 1932, 12);
    @CAN_RadarRR::RRR_Object::RRR_Object_Obj2.PyAyCoVnce = convertRawToPhysical(raw_value, 0.005, -10.0);

    raw_value=copyBitsFromByteArrayLE( byteArray, 1612, 12);
    @CAN_RadarRR::RRR_Object::RRR_Object_Obj2.PyVnce = convertRawToPhysical(raw_value, 0.005, 0.0);

    raw_value=copyBitsFromByteArrayLE( byteArray, 1856, 12);
    @CAN_RadarRR::RRR_Object::RRR_Object_Obj2.PyVxCoVnce = convertRawToPhysical(raw_value, 0.005, -10.0);

    raw_value=copyBitsFromByteArrayLE( byteArray, 1868, 12);
    @CAN_RadarRR::RRR_Object::RRR_Object_Obj2.PyVyCoVnce = convertRawToPhysical(raw_value, 0.005, -10.0);

    raw_value=copyBitsFromByteArrayLE( byteArray, 1708, 10);
    @CAN_RadarRR::RRR_Object::RRR_Object_Obj2.RCS = convertRawToPhysical(raw_value, 0.2, -102.4);

    raw_value=copyBitsFromByteArrayLE( byteArray, 1880, 4);
    @CAN_RadarRR::RRR_Object::RRR_Object_Obj2.ReferencePoint = convertRawToPhysical(raw_value, 1.0, 0.0);

    raw_value=copyBitsFromByteArrayLE( byteArray, 1740, 12);
    @CAN_RadarRR::RRR_Object::RRR_Object_Obj2.Vx = convertRawToPhysical(raw_value, 0.0625, -128.0);

    raw_value=copyBitsFromByteArrayLE( byteArray, 1964, 12);
    @CAN_RadarRR::RRR_Object::RRR_Object_Obj2.VxAxCoVnce = convertRawToPhysical(raw_value, 0.005, -10.0);

    raw_value=copyBitsFromByteArrayLE( byteArray, 1984, 12);
    @CAN_RadarRR::RRR_Object::RRR_Object_Obj2.VxAyCoVnce = convertRawToPhysical(raw_value, 0.005, -10.0);

    raw_value=copyBitsFromByteArrayLE( byteArray, 1760, 12);
    @CAN_RadarRR::RRR_Object::RRR_Object_Obj2.VxVnce = convertRawToPhysical(raw_value, 0.005, 0.0);

    raw_value=copyBitsFromByteArrayLE( byteArray, 1952, 12);
    @CAN_RadarRR::RRR_Object::RRR_Object_Obj2.VxVyCoVnce = convertRawToPhysical(raw_value, 0.005, -10.0);

    raw_value=copyBitsFromByteArrayLE( byteArray, 1774, 10);
    @CAN_RadarRR::RRR_Object::RRR_Object_Obj2.Vy = convertRawToPhysical(raw_value, 0.125, -64.0);

    raw_value=copyBitsFromByteArrayLE( byteArray, 1996, 12);
    @CAN_RadarRR::RRR_Object::RRR_Object_Obj2.VyAxCoVnce = convertRawToPhysical(raw_value, 0.005, -10.0);

    raw_value=copyBitsFromByteArrayLE( byteArray, 2016, 12);
    @CAN_RadarRR::RRR_Object::RRR_Object_Obj2.VyAyCoVnce = convertRawToPhysical(raw_value, 0.005, -10.0);

    raw_value=copyBitsFromByteArrayLE( byteArray, 1792, 12);
    @CAN_RadarRR::RRR_Object::RRR_Object_Obj2.VyVnce = convertRawToPhysical(raw_value, 0.005, 0.0);

    raw_value=copyBitsFromByteArrayLE( byteArray, 1688, 7);
    @CAN_RadarRR::RRR_Object::RRR_Object_Obj2.Width = convertRawToPhysical(raw_value, 0.125, 0.0);

    raw_value=copyBitsFromByteArrayLE( byteArray, 1696, 12);
    @CAN_RadarRR::RRR_Object::RRR_Object_Obj2.WidthVnce = convertRawToPhysical(raw_value, 0.005, 0.0);
}


void CRadarRR_RRR_Object_Obj20_SetDataReceived(byte byteArray[])
{
    qword raw_value;

    raw_value=copyBitsFromByteArrayLE( byteArray, 11264, 32);
    @CAN_RadarRR::RRR_Object::RRR_Object_Obj20.Age = convertRawToPhysical(raw_value, 1.0, 0.0);

    raw_value=copyBitsFromByteArrayLE( byteArray, 10860, 10);
    @CAN_RadarRR::RRR_Object::RRR_Object_Obj20.Ax = convertRawToPhysical(raw_value, 0.03125, -16.0);

    raw_value=copyBitsFromByteArrayLE( byteArray, 11244, 12);
    @CAN_RadarRR::RRR_Object::RRR_Object_Obj20.AxAyCoVnce = convertRawToPhysical(raw_value, 0.005, -10.0);

    raw_value=copyBitsFromByteArrayLE( byteArray, 10880, 12);
    @CAN_RadarRR::RRR_Object::RRR_Object_Obj20.AxVnce = convertRawToPhysical(raw_value, 0.005, 0.0);

    raw_value=copyBitsFromByteArrayLE( byteArray, 10934, 9);
    @CAN_RadarRR::RRR_Object::RRR_Object_Obj20.Ay = convertRawToPhysical(raw_value, 0.0625, -16.0);

    raw_value=copyBitsFromByteArrayLE( byteArray, 10944, 12);
    @CAN_RadarRR::RRR_Object::RRR_Object_Obj20.AyVnce = convertRawToPhysical(raw_value, 0.005, 0.0);

    raw_value=copyBitsFromByteArrayLE( byteArray, 11000, 6);
    @CAN_RadarRR::RRR_Object::RRR_Object_Obj20.ExistProb = convertRawToPhysical(raw_value, 2.0, 0.0);

    raw_value=copyBitsFromByteArrayLE( byteArray, 11064, 8);
    @CAN_RadarRR::RRR_Object::RRR_Object_Obj20.FilterInformation = convertRawToPhysical(raw_value, 1.0, 0.0);

    raw_value=copyBitsFromByteArrayLE( byteArray, 10840, 7);
    @CAN_RadarRR::RRR_Object::RRR_Object_Obj20.Length = convertRawToPhysical(raw_value, 0.125, 0.0);

    raw_value=copyBitsFromByteArrayLE( byteArray, 10848, 12);
    @CAN_RadarRR::RRR_Object::RRR_Object_Obj20.LengthVnce = convertRawToPhysical(raw_value, 0.005, 0.0);

    raw_value=copyBitsFromByteArrayLE( byteArray, 11032, 3);
    @CAN_RadarRR::RRR_Object::RRR_Object_Obj20.MeasurementStatus = convertRawToPhysical(raw_value, 1.0, 0.0);

    raw_value=copyBitsFromByteArrayLE( byteArray, 10988, 2);
    @CAN_RadarRR::RRR_Object::RRR_Object_Obj20.MovingStatus = convertRawToPhysical(raw_value, 1.0, 0.0);

    raw_value=copyBitsFromByteArrayLE( byteArray, 10968, 7);
    @CAN_RadarRR::RRR_Object::RRR_Object_Obj20.ObjId = convertRawToPhysical(raw_value, 1.0, 0.0);

    raw_value=copyBitsFromByteArrayLE( byteArray, 10870, 9);
    @CAN_RadarRR::RRR_Object::RRR_Object_Obj20.OrientationYaw = convertRawToPhysical(raw_value, 0.0175, -4.48);

    raw_value=copyBitsFromByteArrayLE( byteArray, 10892, 12);
    @CAN_RadarRR::RRR_Object::RRR_Object_Obj20.OrientationYawVnce = convertRawToPhysical(raw_value, 0.0003, 0.0);

    raw_value=copyBitsFromByteArrayLE( byteArray, 10784, 6);
    @CAN_RadarRR::RRR_Object::RRR_Object_Obj20.ProbClassConfidence = convertRawToPhysical(raw_value, 2.0, 0.0);

    raw_value=copyBitsFromByteArrayLE( byteArray, 11035, 4);
    @CAN_RadarRR::RRR_Object::RRR_Object_Obj20.ProbClassType = convertRawToPhysical(raw_value, 1.0, 0.0);

    raw_value=copyBitsFromByteArrayLE( byteArray, 10790, 14);
    @CAN_RadarRR::RRR_Object::RRR_Object_Obj20.Px = convertRawToPhysical(raw_value, 0.0625, -512.0);

    raw_value=copyBitsFromByteArrayLE( byteArray, 11104, 12);
    @CAN_RadarRR::RRR_Object::RRR_Object_Obj20.PxAxCoVnce = convertRawToPhysical(raw_value, 0.005, -10.0);

    raw_value=copyBitsFromByteArrayLE( byteArray, 11116, 12);
    @CAN_RadarRR::RRR_Object::RRR_Object_Obj20.PxAyCoVnce = convertRawToPhysical(raw_value, 0.005, -10.0);

    raw_value=copyBitsFromByteArrayLE( byteArray, 11020, 12);
    @CAN_RadarRR::RRR_Object::RRR_Object_Obj20.PxPyCoVnce = convertRawToPhysical(raw_value, 0.005, -10.0);

    raw_value=copyBitsFromByteArrayLE( byteArray, 10804, 12);
    @CAN_RadarRR::RRR_Object::RRR_Object_Obj20.PxVnce = convertRawToPhysical(raw_value, 0.005, 0.0);

    raw_value=copyBitsFromByteArrayLE( byteArray, 11040, 12);
    @CAN_RadarRR::RRR_Object::RRR_Object_Obj20.PxVxCoVnce = convertRawToPhysical(raw_value, 0.005, -10.0);

    raw_value=copyBitsFromByteArrayLE( byteArray, 11052, 12);
    @CAN_RadarRR::RRR_Object::RRR_Object_Obj20.PxVyCoVnce = convertRawToPhysical(raw_value, 0.005, -10.0);

    raw_value=copyBitsFromByteArrayLE( byteArray, 10816, 12);
    @CAN_RadarRR::RRR_Object::RRR_Object_Obj20.Py = convertRawToPhysical(raw_value, 0.0625, -128.0);

    raw_value=copyBitsFromByteArrayLE( byteArray, 11136, 12);
    @CAN_RadarRR::RRR_Object::RRR_Object_Obj20.PyAxCoVnce = convertRawToPhysical(raw_value, 0.005, -10.0);

    raw_value=copyBitsFromByteArrayLE( byteArray, 11148, 12);
    @CAN_RadarRR::RRR_Object::RRR_Object_Obj20.PyAyCoVnce = convertRawToPhysical(raw_value, 0.005, -10.0);

    raw_value=copyBitsFromByteArrayLE( byteArray, 10828, 12);
    @CAN_RadarRR::RRR_Object::RRR_Object_Obj20.PyVnce = convertRawToPhysical(raw_value, 0.005, 0.0);

    raw_value=copyBitsFromByteArrayLE( byteArray, 11072, 12);
    @CAN_RadarRR::RRR_Object::RRR_Object_Obj20.PyVxCoVnce = convertRawToPhysical(raw_value, 0.005, -10.0);

    raw_value=copyBitsFromByteArrayLE( byteArray, 11084, 12);
    @CAN_RadarRR::RRR_Object::RRR_Object_Obj20.PyVyCoVnce = convertRawToPhysical(raw_value, 0.005, -10.0);

    raw_value=copyBitsFromByteArrayLE( byteArray, 10924, 10);
    @CAN_RadarRR::RRR_Object::RRR_Object_Obj20.RCS = convertRawToPhysical(raw_value, 0.2, -102.4);

    raw_value=copyBitsFromByteArrayLE( byteArray, 11096, 4);
    @CAN_RadarRR::RRR_Object::RRR_Object_Obj20.ReferencePoint = convertRawToPhysical(raw_value, 1.0, 0.0);

    raw_value=copyBitsFromByteArrayLE( byteArray, 10956, 12);
    @CAN_RadarRR::RRR_Object::RRR_Object_Obj20.Vx = convertRawToPhysical(raw_value, 0.0625, -128.0);

    raw_value=copyBitsFromByteArrayLE( byteArray, 11180, 12);
    @CAN_RadarRR::RRR_Object::RRR_Object_Obj20.VxAxCoVnce = convertRawToPhysical(raw_value, 0.005, -10.0);

    raw_value=copyBitsFromByteArrayLE( byteArray, 11200, 12);
    @CAN_RadarRR::RRR_Object::RRR_Object_Obj20.VxAyCoVnce = convertRawToPhysical(raw_value, 0.005, -10.0);

    raw_value=copyBitsFromByteArrayLE( byteArray, 10976, 12);
    @CAN_RadarRR::RRR_Object::RRR_Object_Obj20.VxVnce = convertRawToPhysical(raw_value, 0.005, 0.0);

    raw_value=copyBitsFromByteArrayLE( byteArray, 11168, 12);
    @CAN_RadarRR::RRR_Object::RRR_Object_Obj20.VxVyCoVnce = convertRawToPhysical(raw_value, 0.005, -10.0);

    raw_value=copyBitsFromByteArrayLE( byteArray, 10990, 10);
    @CAN_RadarRR::RRR_Object::RRR_Object_Obj20.Vy = convertRawToPhysical(raw_value, 0.125, -64.0);

    raw_value=copyBitsFromByteArrayLE( byteArray, 11212, 12);
    @CAN_RadarRR::RRR_Object::RRR_Object_Obj20.VyAxCoVnce = convertRawToPhysical(raw_value, 0.005, -10.0);

    raw_value=copyBitsFromByteArrayLE( byteArray, 11232, 12);
    @CAN_RadarRR::RRR_Object::RRR_Object_Obj20.VyAyCoVnce = convertRawToPhysical(raw_value, 0.005, -10.0);

    raw_value=copyBitsFromByteArrayLE( byteArray, 11008, 12);
    @CAN_RadarRR::RRR_Object::RRR_Object_Obj20.VyVnce = convertRawToPhysical(raw_value, 0.005, 0.0);

    raw_value=copyBitsFromByteArrayLE( byteArray, 10904, 7);
    @CAN_RadarRR::RRR_Object::RRR_Object_Obj20.Width = convertRawToPhysical(raw_value, 0.125, 0.0);

    raw_value=copyBitsFromByteArrayLE( byteArray, 10912, 12);
    @CAN_RadarRR::RRR_Object::RRR_Object_Obj20.WidthVnce = convertRawToPhysical(raw_value, 0.005, 0.0);
}


void CRadarRR_RRR_Object_Obj21_SetDataReceived(byte byteArray[])
{
    qword raw_value;

    raw_value=copyBitsFromByteArrayLE( byteArray, 11776, 32);
    @CAN_RadarRR::RRR_Object::RRR_Object_Obj21.Age = convertRawToPhysical(raw_value, 1.0, 0.0);

    raw_value=copyBitsFromByteArrayLE( byteArray, 11372, 10);
    @CAN_RadarRR::RRR_Object::RRR_Object_Obj21.Ax = convertRawToPhysical(raw_value, 0.03125, -16.0);

    raw_value=copyBitsFromByteArrayLE( byteArray, 11756, 12);
    @CAN_RadarRR::RRR_Object::RRR_Object_Obj21.AxAyCoVnce = convertRawToPhysical(raw_value, 0.005, -10.0);

    raw_value=copyBitsFromByteArrayLE( byteArray, 11392, 12);
    @CAN_RadarRR::RRR_Object::RRR_Object_Obj21.AxVnce = convertRawToPhysical(raw_value, 0.005, 0.0);

    raw_value=copyBitsFromByteArrayLE( byteArray, 11446, 9);
    @CAN_RadarRR::RRR_Object::RRR_Object_Obj21.Ay = convertRawToPhysical(raw_value, 0.0625, -16.0);

    raw_value=copyBitsFromByteArrayLE( byteArray, 11456, 12);
    @CAN_RadarRR::RRR_Object::RRR_Object_Obj21.AyVnce = convertRawToPhysical(raw_value, 0.005, 0.0);

    raw_value=copyBitsFromByteArrayLE( byteArray, 11512, 6);
    @CAN_RadarRR::RRR_Object::RRR_Object_Obj21.ExistProb = convertRawToPhysical(raw_value, 2.0, 0.0);

    raw_value=copyBitsFromByteArrayLE( byteArray, 11576, 8);
    @CAN_RadarRR::RRR_Object::RRR_Object_Obj21.FilterInformation = convertRawToPhysical(raw_value, 1.0, 0.0);

    raw_value=copyBitsFromByteArrayLE( byteArray, 11352, 7);
    @CAN_RadarRR::RRR_Object::RRR_Object_Obj21.Length = convertRawToPhysical(raw_value, 0.125, 0.0);

    raw_value=copyBitsFromByteArrayLE( byteArray, 11360, 12);
    @CAN_RadarRR::RRR_Object::RRR_Object_Obj21.LengthVnce = convertRawToPhysical(raw_value, 0.005, 0.0);

    raw_value=copyBitsFromByteArrayLE( byteArray, 11544, 3);
    @CAN_RadarRR::RRR_Object::RRR_Object_Obj21.MeasurementStatus = convertRawToPhysical(raw_value, 1.0, 0.0);

    raw_value=copyBitsFromByteArrayLE( byteArray, 11500, 2);
    @CAN_RadarRR::RRR_Object::RRR_Object_Obj21.MovingStatus = convertRawToPhysical(raw_value, 1.0, 0.0);

    raw_value=copyBitsFromByteArrayLE( byteArray, 11480, 7);
    @CAN_RadarRR::RRR_Object::RRR_Object_Obj21.ObjId = convertRawToPhysical(raw_value, 1.0, 0.0);

    raw_value=copyBitsFromByteArrayLE( byteArray, 11382, 9);
    @CAN_RadarRR::RRR_Object::RRR_Object_Obj21.OrientationYaw = convertRawToPhysical(raw_value, 0.0175, -4.48);

    raw_value=copyBitsFromByteArrayLE( byteArray, 11404, 12);
    @CAN_RadarRR::RRR_Object::RRR_Object_Obj21.OrientationYawVnce = convertRawToPhysical(raw_value, 0.0003, 0.0);

    raw_value=copyBitsFromByteArrayLE( byteArray, 11296, 6);
    @CAN_RadarRR::RRR_Object::RRR_Object_Obj21.ProbClassConfidence = convertRawToPhysical(raw_value, 2.0, 0.0);

    raw_value=copyBitsFromByteArrayLE( byteArray, 11547, 4);
    @CAN_RadarRR::RRR_Object::RRR_Object_Obj21.ProbClassType = convertRawToPhysical(raw_value, 1.0, 0.0);

    raw_value=copyBitsFromByteArrayLE( byteArray, 11302, 14);
    @CAN_RadarRR::RRR_Object::RRR_Object_Obj21.Px = convertRawToPhysical(raw_value, 0.0625, -512.0);

    raw_value=copyBitsFromByteArrayLE( byteArray, 11616, 12);
    @CAN_RadarRR::RRR_Object::RRR_Object_Obj21.PxAxCoVnce = convertRawToPhysical(raw_value, 0.005, -10.0);

    raw_value=copyBitsFromByteArrayLE( byteArray, 11628, 12);
    @CAN_RadarRR::RRR_Object::RRR_Object_Obj21.PxAyCoVnce = convertRawToPhysical(raw_value, 0.005, -10.0);

    raw_value=copyBitsFromByteArrayLE( byteArray, 11532, 12);
    @CAN_RadarRR::RRR_Object::RRR_Object_Obj21.PxPyCoVnce = convertRawToPhysical(raw_value, 0.005, -10.0);

    raw_value=copyBitsFromByteArrayLE( byteArray, 11316, 12);
    @CAN_RadarRR::RRR_Object::RRR_Object_Obj21.PxVnce = convertRawToPhysical(raw_value, 0.005, 0.0);

    raw_value=copyBitsFromByteArrayLE( byteArray, 11552, 12);
    @CAN_RadarRR::RRR_Object::RRR_Object_Obj21.PxVxCoVnce = convertRawToPhysical(raw_value, 0.005, -10.0);

    raw_value=copyBitsFromByteArrayLE( byteArray, 11564, 12);
    @CAN_RadarRR::RRR_Object::RRR_Object_Obj21.PxVyCoVnce = convertRawToPhysical(raw_value, 0.005, -10.0);

    raw_value=copyBitsFromByteArrayLE( byteArray, 11328, 12);
    @CAN_RadarRR::RRR_Object::RRR_Object_Obj21.Py = convertRawToPhysical(raw_value, 0.0625, -128.0);

    raw_value=copyBitsFromByteArrayLE( byteArray, 11648, 12);
    @CAN_RadarRR::RRR_Object::RRR_Object_Obj21.PyAxCoVnce = convertRawToPhysical(raw_value, 0.005, -10.0);

    raw_value=copyBitsFromByteArrayLE( byteArray, 11660, 12);
    @CAN_RadarRR::RRR_Object::RRR_Object_Obj21.PyAyCoVnce = convertRawToPhysical(raw_value, 0.005, -10.0);

    raw_value=copyBitsFromByteArrayLE( byteArray, 11340, 12);
    @CAN_RadarRR::RRR_Object::RRR_Object_Obj21.PyVnce = convertRawToPhysical(raw_value, 0.005, 0.0);

    raw_value=copyBitsFromByteArrayLE( byteArray, 11584, 12);
    @CAN_RadarRR::RRR_Object::RRR_Object_Obj21.PyVxCoVnce = convertRawToPhysical(raw_value, 0.005, -10.0);

    raw_value=copyBitsFromByteArrayLE( byteArray, 11596, 12);
    @CAN_RadarRR::RRR_Object::RRR_Object_Obj21.PyVyCoVnce = convertRawToPhysical(raw_value, 0.005, -10.0);

    raw_value=copyBitsFromByteArrayLE( byteArray, 11436, 10);
    @CAN_RadarRR::RRR_Object::RRR_Object_Obj21.RCS = convertRawToPhysical(raw_value, 0.2, -102.4);

    raw_value=copyBitsFromByteArrayLE( byteArray, 11608, 4);
    @CAN_RadarRR::RRR_Object::RRR_Object_Obj21.ReferencePoint = convertRawToPhysical(raw_value, 1.0, 0.0);

    raw_value=copyBitsFromByteArrayLE( byteArray, 11468, 12);
    @CAN_RadarRR::RRR_Object::RRR_Object_Obj21.Vx = convertRawToPhysical(raw_value, 0.0625, -128.0);

    raw_value=copyBitsFromByteArrayLE( byteArray, 11692, 12);
    @CAN_RadarRR::RRR_Object::RRR_Object_Obj21.VxAxCoVnce = convertRawToPhysical(raw_value, 0.005, -10.0);

    raw_value=copyBitsFromByteArrayLE( byteArray, 11712, 12);
    @CAN_RadarRR::RRR_Object::RRR_Object_Obj21.VxAyCoVnce = convertRawToPhysical(raw_value, 0.005, -10.0);

    raw_value=copyBitsFromByteArrayLE( byteArray, 11488, 12);
    @CAN_RadarRR::RRR_Object::RRR_Object_Obj21.VxVnce = convertRawToPhysical(raw_value, 0.005, 0.0);

    raw_value=copyBitsFromByteArrayLE( byteArray, 11680, 12);
    @CAN_RadarRR::RRR_Object::RRR_Object_Obj21.VxVyCoVnce = convertRawToPhysical(raw_value, 0.005, -10.0);

    raw_value=copyBitsFromByteArrayLE( byteArray, 11502, 10);
    @CAN_RadarRR::RRR_Object::RRR_Object_Obj21.Vy = convertRawToPhysical(raw_value, 0.125, -64.0);

    raw_value=copyBitsFromByteArrayLE( byteArray, 11724, 12);
    @CAN_RadarRR::RRR_Object::RRR_Object_Obj21.VyAxCoVnce = convertRawToPhysical(raw_value, 0.005, -10.0);

    raw_value=copyBitsFromByteArrayLE( byteArray, 11744, 12);
    @CAN_RadarRR::RRR_Object::RRR_Object_Obj21.VyAyCoVnce = convertRawToPhysical(raw_value, 0.005, -10.0);

    raw_value=copyBitsFromByteArrayLE( byteArray, 11520, 12);
    @CAN_RadarRR::RRR_Object::RRR_Object_Obj21.VyVnce = convertRawToPhysical(raw_value, 0.005, 0.0);

    raw_value=copyBitsFromByteArrayLE( byteArray, 11416, 7);
    @CAN_RadarRR::RRR_Object::RRR_Object_Obj21.Width = convertRawToPhysical(raw_value, 0.125, 0.0);

    raw_value=copyBitsFromByteArrayLE( byteArray, 11424, 12);
    @CAN_RadarRR::RRR_Object::RRR_Object_Obj21.WidthVnce = convertRawToPhysical(raw_value, 0.005, 0.0);
}


void CRadarRR_RRR_Object_Obj22_SetDataReceived(byte byteArray[])
{
    qword raw_value;

    raw_value=copyBitsFromByteArrayLE( byteArray, 12288, 32);
    @CAN_RadarRR::RRR_Object::RRR_Object_Obj22.Age = convertRawToPhysical(raw_value, 1.0, 0.0);

    raw_value=copyBitsFromByteArrayLE( byteArray, 11884, 10);
    @CAN_RadarRR::RRR_Object::RRR_Object_Obj22.Ax = convertRawToPhysical(raw_value, 0.03125, -16.0);

    raw_value=copyBitsFromByteArrayLE( byteArray, 12268, 12);
    @CAN_RadarRR::RRR_Object::RRR_Object_Obj22.AxAyCoVnce = convertRawToPhysical(raw_value, 0.005, -10.0);

    raw_value=copyBitsFromByteArrayLE( byteArray, 11904, 12);
    @CAN_RadarRR::RRR_Object::RRR_Object_Obj22.AxVnce = convertRawToPhysical(raw_value, 0.005, 0.0);

    raw_value=copyBitsFromByteArrayLE( byteArray, 11958, 9);
    @CAN_RadarRR::RRR_Object::RRR_Object_Obj22.Ay = convertRawToPhysical(raw_value, 0.0625, -16.0);

    raw_value=copyBitsFromByteArrayLE( byteArray, 11968, 12);
    @CAN_RadarRR::RRR_Object::RRR_Object_Obj22.AyVnce = convertRawToPhysical(raw_value, 0.005, 0.0);

    raw_value=copyBitsFromByteArrayLE( byteArray, 12024, 6);
    @CAN_RadarRR::RRR_Object::RRR_Object_Obj22.ExistProb = convertRawToPhysical(raw_value, 2.0, 0.0);

    raw_value=copyBitsFromByteArrayLE( byteArray, 12088, 8);
    @CAN_RadarRR::RRR_Object::RRR_Object_Obj22.FilterInformation = convertRawToPhysical(raw_value, 1.0, 0.0);

    raw_value=copyBitsFromByteArrayLE( byteArray, 11864, 7);
    @CAN_RadarRR::RRR_Object::RRR_Object_Obj22.Length = convertRawToPhysical(raw_value, 0.125, 0.0);

    raw_value=copyBitsFromByteArrayLE( byteArray, 11872, 12);
    @CAN_RadarRR::RRR_Object::RRR_Object_Obj22.LengthVnce = convertRawToPhysical(raw_value, 0.005, 0.0);

    raw_value=copyBitsFromByteArrayLE( byteArray, 12056, 3);
    @CAN_RadarRR::RRR_Object::RRR_Object_Obj22.MeasurementStatus = convertRawToPhysical(raw_value, 1.0, 0.0);

    raw_value=copyBitsFromByteArrayLE( byteArray, 12012, 2);
    @CAN_RadarRR::RRR_Object::RRR_Object_Obj22.MovingStatus = convertRawToPhysical(raw_value, 1.0, 0.0);

    raw_value=copyBitsFromByteArrayLE( byteArray, 11992, 7);
    @CAN_RadarRR::RRR_Object::RRR_Object_Obj22.ObjId = convertRawToPhysical(raw_value, 1.0, 0.0);

    raw_value=copyBitsFromByteArrayLE( byteArray, 11894, 9);
    @CAN_RadarRR::RRR_Object::RRR_Object_Obj22.OrientationYaw = convertRawToPhysical(raw_value, 0.0175, -4.48);

    raw_value=copyBitsFromByteArrayLE( byteArray, 11916, 12);
    @CAN_RadarRR::RRR_Object::RRR_Object_Obj22.OrientationYawVnce = convertRawToPhysical(raw_value, 0.0003, 0.0);

    raw_value=copyBitsFromByteArrayLE( byteArray, 11808, 6);
    @CAN_RadarRR::RRR_Object::RRR_Object_Obj22.ProbClassConfidence = convertRawToPhysical(raw_value, 2.0, 0.0);

    raw_value=copyBitsFromByteArrayLE( byteArray, 12059, 4);
    @CAN_RadarRR::RRR_Object::RRR_Object_Obj22.ProbClassType = convertRawToPhysical(raw_value, 1.0, 0.0);

    raw_value=copyBitsFromByteArrayLE( byteArray, 11814, 14);
    @CAN_RadarRR::RRR_Object::RRR_Object_Obj22.Px = convertRawToPhysical(raw_value, 0.0625, -512.0);

    raw_value=copyBitsFromByteArrayLE( byteArray, 12128, 12);
    @CAN_RadarRR::RRR_Object::RRR_Object_Obj22.PxAxCoVnce = convertRawToPhysical(raw_value, 0.005, -10.0);

    raw_value=copyBitsFromByteArrayLE( byteArray, 12140, 12);
    @CAN_RadarRR::RRR_Object::RRR_Object_Obj22.PxAyCoVnce = convertRawToPhysical(raw_value, 0.005, -10.0);

    raw_value=copyBitsFromByteArrayLE( byteArray, 12044, 12);
    @CAN_RadarRR::RRR_Object::RRR_Object_Obj22.PxPyCoVnce = convertRawToPhysical(raw_value, 0.005, -10.0);

    raw_value=copyBitsFromByteArrayLE( byteArray, 11828, 12);
    @CAN_RadarRR::RRR_Object::RRR_Object_Obj22.PxVnce = convertRawToPhysical(raw_value, 0.005, 0.0);

    raw_value=copyBitsFromByteArrayLE( byteArray, 12064, 12);
    @CAN_RadarRR::RRR_Object::RRR_Object_Obj22.PxVxCoVnce = convertRawToPhysical(raw_value, 0.005, -10.0);

    raw_value=copyBitsFromByteArrayLE( byteArray, 12076, 12);
    @CAN_RadarRR::RRR_Object::RRR_Object_Obj22.PxVyCoVnce = convertRawToPhysical(raw_value, 0.005, -10.0);

    raw_value=copyBitsFromByteArrayLE( byteArray, 11840, 12);
    @CAN_RadarRR::RRR_Object::RRR_Object_Obj22.Py = convertRawToPhysical(raw_value, 0.0625, -128.0);

    raw_value=copyBitsFromByteArrayLE( byteArray, 12160, 12);
    @CAN_RadarRR::RRR_Object::RRR_Object_Obj22.PyAxCoVnce = convertRawToPhysical(raw_value, 0.005, -10.0);

    raw_value=copyBitsFromByteArrayLE( byteArray, 12172, 12);
    @CAN_RadarRR::RRR_Object::RRR_Object_Obj22.PyAyCoVnce = convertRawToPhysical(raw_value, 0.005, -10.0);

    raw_value=copyBitsFromByteArrayLE( byteArray, 11852, 12);
    @CAN_RadarRR::RRR_Object::RRR_Object_Obj22.PyVnce = convertRawToPhysical(raw_value, 0.005, 0.0);

    raw_value=copyBitsFromByteArrayLE( byteArray, 12096, 12);
    @CAN_RadarRR::RRR_Object::RRR_Object_Obj22.PyVxCoVnce = convertRawToPhysical(raw_value, 0.005, -10.0);

    raw_value=copyBitsFromByteArrayLE( byteArray, 12108, 12);
    @CAN_RadarRR::RRR_Object::RRR_Object_Obj22.PyVyCoVnce = convertRawToPhysical(raw_value, 0.005, -10.0);

    raw_value=copyBitsFromByteArrayLE( byteArray, 11948, 10);
    @CAN_RadarRR::RRR_Object::RRR_Object_Obj22.RCS = convertRawToPhysical(raw_value, 0.2, -102.4);

    raw_value=copyBitsFromByteArrayLE( byteArray, 12120, 4);
    @CAN_RadarRR::RRR_Object::RRR_Object_Obj22.ReferencePoint = convertRawToPhysical(raw_value, 1.0, 0.0);

    raw_value=copyBitsFromByteArrayLE( byteArray, 11980, 12);
    @CAN_RadarRR::RRR_Object::RRR_Object_Obj22.Vx = convertRawToPhysical(raw_value, 0.0625, -128.0);

    raw_value=copyBitsFromByteArrayLE( byteArray, 12204, 12);
    @CAN_RadarRR::RRR_Object::RRR_Object_Obj22.VxAxCoVnce = convertRawToPhysical(raw_value, 0.005, -10.0);

    raw_value=copyBitsFromByteArrayLE( byteArray, 12224, 12);
    @CAN_RadarRR::RRR_Object::RRR_Object_Obj22.VxAyCoVnce = convertRawToPhysical(raw_value, 0.005, -10.0);

    raw_value=copyBitsFromByteArrayLE( byteArray, 12000, 12);
    @CAN_RadarRR::RRR_Object::RRR_Object_Obj22.VxVnce = convertRawToPhysical(raw_value, 0.005, 0.0);

    raw_value=copyBitsFromByteArrayLE( byteArray, 12192, 12);
    @CAN_RadarRR::RRR_Object::RRR_Object_Obj22.VxVyCoVnce = convertRawToPhysical(raw_value, 0.005, -10.0);

    raw_value=copyBitsFromByteArrayLE( byteArray, 12014, 10);
    @CAN_RadarRR::RRR_Object::RRR_Object_Obj22.Vy = convertRawToPhysical(raw_value, 0.125, -64.0);

    raw_value=copyBitsFromByteArrayLE( byteArray, 12236, 12);
    @CAN_RadarRR::RRR_Object::RRR_Object_Obj22.VyAxCoVnce = convertRawToPhysical(raw_value, 0.005, -10.0);

    raw_value=copyBitsFromByteArrayLE( byteArray, 12256, 12);
    @CAN_RadarRR::RRR_Object::RRR_Object_Obj22.VyAyCoVnce = convertRawToPhysical(raw_value, 0.005, -10.0);

    raw_value=copyBitsFromByteArrayLE( byteArray, 12032, 12);
    @CAN_RadarRR::RRR_Object::RRR_Object_Obj22.VyVnce = convertRawToPhysical(raw_value, 0.005, 0.0);

    raw_value=copyBitsFromByteArrayLE( byteArray, 11928, 7);
    @CAN_RadarRR::RRR_Object::RRR_Object_Obj22.Width = convertRawToPhysical(raw_value, 0.125, 0.0);

    raw_value=copyBitsFromByteArrayLE( byteArray, 11936, 12);
    @CAN_RadarRR::RRR_Object::RRR_Object_Obj22.WidthVnce = convertRawToPhysical(raw_value, 0.005, 0.0);
}


void CRadarRR_RRR_Object_Obj23_SetDataReceived(byte byteArray[])
{
    qword raw_value;

    raw_value=copyBitsFromByteArrayLE( byteArray, 12800, 32);
    @CAN_RadarRR::RRR_Object::RRR_Object_Obj23.Age = convertRawToPhysical(raw_value, 1.0, 0.0);

    raw_value=copyBitsFromByteArrayLE( byteArray, 12396, 10);
    @CAN_RadarRR::RRR_Object::RRR_Object_Obj23.Ax = convertRawToPhysical(raw_value, 0.03125, -16.0);

    raw_value=copyBitsFromByteArrayLE( byteArray, 12780, 12);
    @CAN_RadarRR::RRR_Object::RRR_Object_Obj23.AxAyCoVnce = convertRawToPhysical(raw_value, 0.005, -10.0);

    raw_value=copyBitsFromByteArrayLE( byteArray, 12416, 12);
    @CAN_RadarRR::RRR_Object::RRR_Object_Obj23.AxVnce = convertRawToPhysical(raw_value, 0.005, 0.0);

    raw_value=copyBitsFromByteArrayLE( byteArray, 12470, 9);
    @CAN_RadarRR::RRR_Object::RRR_Object_Obj23.Ay = convertRawToPhysical(raw_value, 0.0625, -16.0);

    raw_value=copyBitsFromByteArrayLE( byteArray, 12480, 12);
    @CAN_RadarRR::RRR_Object::RRR_Object_Obj23.AyVnce = convertRawToPhysical(raw_value, 0.005, 0.0);

    raw_value=copyBitsFromByteArrayLE( byteArray, 12536, 6);
    @CAN_RadarRR::RRR_Object::RRR_Object_Obj23.ExistProb = convertRawToPhysical(raw_value, 2.0, 0.0);

    raw_value=copyBitsFromByteArrayLE( byteArray, 12600, 8);
    @CAN_RadarRR::RRR_Object::RRR_Object_Obj23.FilterInformation = convertRawToPhysical(raw_value, 1.0, 0.0);

    raw_value=copyBitsFromByteArrayLE( byteArray, 12376, 7);
    @CAN_RadarRR::RRR_Object::RRR_Object_Obj23.Length = convertRawToPhysical(raw_value, 0.125, 0.0);

    raw_value=copyBitsFromByteArrayLE( byteArray, 12384, 12);
    @CAN_RadarRR::RRR_Object::RRR_Object_Obj23.LengthVnce = convertRawToPhysical(raw_value, 0.005, 0.0);

    raw_value=copyBitsFromByteArrayLE( byteArray, 12568, 3);
    @CAN_RadarRR::RRR_Object::RRR_Object_Obj23.MeasurementStatus = convertRawToPhysical(raw_value, 1.0, 0.0);

    raw_value=copyBitsFromByteArrayLE( byteArray, 12524, 2);
    @CAN_RadarRR::RRR_Object::RRR_Object_Obj23.MovingStatus = convertRawToPhysical(raw_value, 1.0, 0.0);

    raw_value=copyBitsFromByteArrayLE( byteArray, 12504, 7);
    @CAN_RadarRR::RRR_Object::RRR_Object_Obj23.ObjId = convertRawToPhysical(raw_value, 1.0, 0.0);

    raw_value=copyBitsFromByteArrayLE( byteArray, 12406, 9);
    @CAN_RadarRR::RRR_Object::RRR_Object_Obj23.OrientationYaw = convertRawToPhysical(raw_value, 0.0175, -4.48);

    raw_value=copyBitsFromByteArrayLE( byteArray, 12428, 12);
    @CAN_RadarRR::RRR_Object::RRR_Object_Obj23.OrientationYawVnce = convertRawToPhysical(raw_value, 0.0003, 0.0);

    raw_value=copyBitsFromByteArrayLE( byteArray, 12320, 6);
    @CAN_RadarRR::RRR_Object::RRR_Object_Obj23.ProbClassConfidence = convertRawToPhysical(raw_value, 2.0, 0.0);

    raw_value=copyBitsFromByteArrayLE( byteArray, 12571, 4);
    @CAN_RadarRR::RRR_Object::RRR_Object_Obj23.ProbClassType = convertRawToPhysical(raw_value, 1.0, 0.0);

    raw_value=copyBitsFromByteArrayLE( byteArray, 12326, 14);
    @CAN_RadarRR::RRR_Object::RRR_Object_Obj23.Px = convertRawToPhysical(raw_value, 0.0625, -512.0);

    raw_value=copyBitsFromByteArrayLE( byteArray, 12640, 12);
    @CAN_RadarRR::RRR_Object::RRR_Object_Obj23.PxAxCoVnce = convertRawToPhysical(raw_value, 0.005, -10.0);

    raw_value=copyBitsFromByteArrayLE( byteArray, 12652, 12);
    @CAN_RadarRR::RRR_Object::RRR_Object_Obj23.PxAyCoVnce = convertRawToPhysical(raw_value, 0.005, -10.0);

    raw_value=copyBitsFromByteArrayLE( byteArray, 12556, 12);
    @CAN_RadarRR::RRR_Object::RRR_Object_Obj23.PxPyCoVnce = convertRawToPhysical(raw_value, 0.005, -10.0);

    raw_value=copyBitsFromByteArrayLE( byteArray, 12340, 12);
    @CAN_RadarRR::RRR_Object::RRR_Object_Obj23.PxVnce = convertRawToPhysical(raw_value, 0.005, 0.0);

    raw_value=copyBitsFromByteArrayLE( byteArray, 12576, 12);
    @CAN_RadarRR::RRR_Object::RRR_Object_Obj23.PxVxCoVnce = convertRawToPhysical(raw_value, 0.005, -10.0);

    raw_value=copyBitsFromByteArrayLE( byteArray, 12588, 12);
    @CAN_RadarRR::RRR_Object::RRR_Object_Obj23.PxVyCoVnce = convertRawToPhysical(raw_value, 0.005, -10.0);

    raw_value=copyBitsFromByteArrayLE( byteArray, 12352, 12);
    @CAN_RadarRR::RRR_Object::RRR_Object_Obj23.Py = convertRawToPhysical(raw_value, 0.0625, -128.0);

    raw_value=copyBitsFromByteArrayLE( byteArray, 12672, 12);
    @CAN_RadarRR::RRR_Object::RRR_Object_Obj23.PyAxCoVnce = convertRawToPhysical(raw_value, 0.005, -10.0);

    raw_value=copyBitsFromByteArrayLE( byteArray, 12684, 12);
    @CAN_RadarRR::RRR_Object::RRR_Object_Obj23.PyAyCoVnce = convertRawToPhysical(raw_value, 0.005, -10.0);

    raw_value=copyBitsFromByteArrayLE( byteArray, 12364, 12);
    @CAN_RadarRR::RRR_Object::RRR_Object_Obj23.PyVnce = convertRawToPhysical(raw_value, 0.005, 0.0);

    raw_value=copyBitsFromByteArrayLE( byteArray, 12608, 12);
    @CAN_RadarRR::RRR_Object::RRR_Object_Obj23.PyVxCoVnce = convertRawToPhysical(raw_value, 0.005, -10.0);

    raw_value=copyBitsFromByteArrayLE( byteArray, 12620, 12);
    @CAN_RadarRR::RRR_Object::RRR_Object_Obj23.PyVyCoVnce = convertRawToPhysical(raw_value, 0.005, -10.0);

    raw_value=copyBitsFromByteArrayLE( byteArray, 12460, 10);
    @CAN_RadarRR::RRR_Object::RRR_Object_Obj23.RCS = convertRawToPhysical(raw_value, 0.2, -102.4);

    raw_value=copyBitsFromByteArrayLE( byteArray, 12632, 4);
    @CAN_RadarRR::RRR_Object::RRR_Object_Obj23.ReferencePoint = convertRawToPhysical(raw_value, 1.0, 0.0);

    raw_value=copyBitsFromByteArrayLE( byteArray, 12492, 12);
    @CAN_RadarRR::RRR_Object::RRR_Object_Obj23.Vx = convertRawToPhysical(raw_value, 0.0625, -128.0);

    raw_value=copyBitsFromByteArrayLE( byteArray, 12716, 12);
    @CAN_RadarRR::RRR_Object::RRR_Object_Obj23.VxAxCoVnce = convertRawToPhysical(raw_value, 0.005, -10.0);

    raw_value=copyBitsFromByteArrayLE( byteArray, 12736, 12);
    @CAN_RadarRR::RRR_Object::RRR_Object_Obj23.VxAyCoVnce = convertRawToPhysical(raw_value, 0.005, -10.0);

    raw_value=copyBitsFromByteArrayLE( byteArray, 12512, 12);
    @CAN_RadarRR::RRR_Object::RRR_Object_Obj23.VxVnce = convertRawToPhysical(raw_value, 0.005, 0.0);

    raw_value=copyBitsFromByteArrayLE( byteArray, 12704, 12);
    @CAN_RadarRR::RRR_Object::RRR_Object_Obj23.VxVyCoVnce = convertRawToPhysical(raw_value, 0.005, -10.0);

    raw_value=copyBitsFromByteArrayLE( byteArray, 12526, 10);
    @CAN_RadarRR::RRR_Object::RRR_Object_Obj23.Vy = convertRawToPhysical(raw_value, 0.125, -64.0);

    raw_value=copyBitsFromByteArrayLE( byteArray, 12748, 12);
    @CAN_RadarRR::RRR_Object::RRR_Object_Obj23.VyAxCoVnce = convertRawToPhysical(raw_value, 0.005, -10.0);

    raw_value=copyBitsFromByteArrayLE( byteArray, 12768, 12);
    @CAN_RadarRR::RRR_Object::RRR_Object_Obj23.VyAyCoVnce = convertRawToPhysical(raw_value, 0.005, -10.0);

    raw_value=copyBitsFromByteArrayLE( byteArray, 12544, 12);
    @CAN_RadarRR::RRR_Object::RRR_Object_Obj23.VyVnce = convertRawToPhysical(raw_value, 0.005, 0.0);

    raw_value=copyBitsFromByteArrayLE( byteArray, 12440, 7);
    @CAN_RadarRR::RRR_Object::RRR_Object_Obj23.Width = convertRawToPhysical(raw_value, 0.125, 0.0);

    raw_value=copyBitsFromByteArrayLE( byteArray, 12448, 12);
    @CAN_RadarRR::RRR_Object::RRR_Object_Obj23.WidthVnce = convertRawToPhysical(raw_value, 0.005, 0.0);
}


void CRadarRR_RRR_Object_Obj24_SetDataReceived(byte byteArray[])
{
    qword raw_value;

    raw_value=copyBitsFromByteArrayLE( byteArray, 13312, 32);
    @CAN_RadarRR::RRR_Object::RRR_Object_Obj24.Age = convertRawToPhysical(raw_value, 1.0, 0.0);

    raw_value=copyBitsFromByteArrayLE( byteArray, 12908, 10);
    @CAN_RadarRR::RRR_Object::RRR_Object_Obj24.Ax = convertRawToPhysical(raw_value, 0.03125, -16.0);

    raw_value=copyBitsFromByteArrayLE( byteArray, 13292, 12);
    @CAN_RadarRR::RRR_Object::RRR_Object_Obj24.AxAyCoVnce = convertRawToPhysical(raw_value, 0.005, -10.0);

    raw_value=copyBitsFromByteArrayLE( byteArray, 12928, 12);
    @CAN_RadarRR::RRR_Object::RRR_Object_Obj24.AxVnce = convertRawToPhysical(raw_value, 0.005, 0.0);

    raw_value=copyBitsFromByteArrayLE( byteArray, 12982, 9);
    @CAN_RadarRR::RRR_Object::RRR_Object_Obj24.Ay = convertRawToPhysical(raw_value, 0.0625, -16.0);

    raw_value=copyBitsFromByteArrayLE( byteArray, 12992, 12);
    @CAN_RadarRR::RRR_Object::RRR_Object_Obj24.AyVnce = convertRawToPhysical(raw_value, 0.005, 0.0);

    raw_value=copyBitsFromByteArrayLE( byteArray, 13048, 6);
    @CAN_RadarRR::RRR_Object::RRR_Object_Obj24.ExistProb = convertRawToPhysical(raw_value, 2.0, 0.0);

    raw_value=copyBitsFromByteArrayLE( byteArray, 13112, 8);
    @CAN_RadarRR::RRR_Object::RRR_Object_Obj24.FilterInformation = convertRawToPhysical(raw_value, 1.0, 0.0);

    raw_value=copyBitsFromByteArrayLE( byteArray, 12888, 7);
    @CAN_RadarRR::RRR_Object::RRR_Object_Obj24.Length = convertRawToPhysical(raw_value, 0.125, 0.0);

    raw_value=copyBitsFromByteArrayLE( byteArray, 12896, 12);
    @CAN_RadarRR::RRR_Object::RRR_Object_Obj24.LengthVnce = convertRawToPhysical(raw_value, 0.005, 0.0);

    raw_value=copyBitsFromByteArrayLE( byteArray, 13080, 3);
    @CAN_RadarRR::RRR_Object::RRR_Object_Obj24.MeasurementStatus = convertRawToPhysical(raw_value, 1.0, 0.0);

    raw_value=copyBitsFromByteArrayLE( byteArray, 13036, 2);
    @CAN_RadarRR::RRR_Object::RRR_Object_Obj24.MovingStatus = convertRawToPhysical(raw_value, 1.0, 0.0);

    raw_value=copyBitsFromByteArrayLE( byteArray, 13016, 7);
    @CAN_RadarRR::RRR_Object::RRR_Object_Obj24.ObjId = convertRawToPhysical(raw_value, 1.0, 0.0);

    raw_value=copyBitsFromByteArrayLE( byteArray, 12918, 9);
    @CAN_RadarRR::RRR_Object::RRR_Object_Obj24.OrientationYaw = convertRawToPhysical(raw_value, 0.0175, -4.48);

    raw_value=copyBitsFromByteArrayLE( byteArray, 12940, 12);
    @CAN_RadarRR::RRR_Object::RRR_Object_Obj24.OrientationYawVnce = convertRawToPhysical(raw_value, 0.0003, 0.0);

    raw_value=copyBitsFromByteArrayLE( byteArray, 12832, 6);
    @CAN_RadarRR::RRR_Object::RRR_Object_Obj24.ProbClassConfidence = convertRawToPhysical(raw_value, 2.0, 0.0);

    raw_value=copyBitsFromByteArrayLE( byteArray, 13083, 4);
    @CAN_RadarRR::RRR_Object::RRR_Object_Obj24.ProbClassType = convertRawToPhysical(raw_value, 1.0, 0.0);

    raw_value=copyBitsFromByteArrayLE( byteArray, 12838, 14);
    @CAN_RadarRR::RRR_Object::RRR_Object_Obj24.Px = convertRawToPhysical(raw_value, 0.0625, -512.0);

    raw_value=copyBitsFromByteArrayLE( byteArray, 13152, 12);
    @CAN_RadarRR::RRR_Object::RRR_Object_Obj24.PxAxCoVnce = convertRawToPhysical(raw_value, 0.005, -10.0);

    raw_value=copyBitsFromByteArrayLE( byteArray, 13164, 12);
    @CAN_RadarRR::RRR_Object::RRR_Object_Obj24.PxAyCoVnce = convertRawToPhysical(raw_value, 0.005, -10.0);

    raw_value=copyBitsFromByteArrayLE( byteArray, 13068, 12);
    @CAN_RadarRR::RRR_Object::RRR_Object_Obj24.PxPyCoVnce = convertRawToPhysical(raw_value, 0.005, -10.0);

    raw_value=copyBitsFromByteArrayLE( byteArray, 12852, 12);
    @CAN_RadarRR::RRR_Object::RRR_Object_Obj24.PxVnce = convertRawToPhysical(raw_value, 0.005, 0.0);

    raw_value=copyBitsFromByteArrayLE( byteArray, 13088, 12);
    @CAN_RadarRR::RRR_Object::RRR_Object_Obj24.PxVxCoVnce = convertRawToPhysical(raw_value, 0.005, -10.0);

    raw_value=copyBitsFromByteArrayLE( byteArray, 13100, 12);
    @CAN_RadarRR::RRR_Object::RRR_Object_Obj24.PxVyCoVnce = convertRawToPhysical(raw_value, 0.005, -10.0);

    raw_value=copyBitsFromByteArrayLE( byteArray, 12864, 12);
    @CAN_RadarRR::RRR_Object::RRR_Object_Obj24.Py = convertRawToPhysical(raw_value, 0.0625, -128.0);

    raw_value=copyBitsFromByteArrayLE( byteArray, 13184, 12);
    @CAN_RadarRR::RRR_Object::RRR_Object_Obj24.PyAxCoVnce = convertRawToPhysical(raw_value, 0.005, -10.0);

    raw_value=copyBitsFromByteArrayLE( byteArray, 13196, 12);
    @CAN_RadarRR::RRR_Object::RRR_Object_Obj24.PyAyCoVnce = convertRawToPhysical(raw_value, 0.005, -10.0);

    raw_value=copyBitsFromByteArrayLE( byteArray, 12876, 12);
    @CAN_RadarRR::RRR_Object::RRR_Object_Obj24.PyVnce = convertRawToPhysical(raw_value, 0.005, 0.0);

    raw_value=copyBitsFromByteArrayLE( byteArray, 13120, 12);
    @CAN_RadarRR::RRR_Object::RRR_Object_Obj24.PyVxCoVnce = convertRawToPhysical(raw_value, 0.005, -10.0);

    raw_value=copyBitsFromByteArrayLE( byteArray, 13132, 12);
    @CAN_RadarRR::RRR_Object::RRR_Object_Obj24.PyVyCoVnce = convertRawToPhysical(raw_value, 0.005, -10.0);

    raw_value=copyBitsFromByteArrayLE( byteArray, 12972, 10);
    @CAN_RadarRR::RRR_Object::RRR_Object_Obj24.RCS = convertRawToPhysical(raw_value, 0.2, -102.4);

    raw_value=copyBitsFromByteArrayLE( byteArray, 13144, 4);
    @CAN_RadarRR::RRR_Object::RRR_Object_Obj24.ReferencePoint = convertRawToPhysical(raw_value, 1.0, 0.0);

    raw_value=copyBitsFromByteArrayLE( byteArray, 13004, 12);
    @CAN_RadarRR::RRR_Object::RRR_Object_Obj24.Vx = convertRawToPhysical(raw_value, 0.0625, -128.0);

    raw_value=copyBitsFromByteArrayLE( byteArray, 13228, 12);
    @CAN_RadarRR::RRR_Object::RRR_Object_Obj24.VxAxCoVnce = convertRawToPhysical(raw_value, 0.005, -10.0);

    raw_value=copyBitsFromByteArrayLE( byteArray, 13248, 12);
    @CAN_RadarRR::RRR_Object::RRR_Object_Obj24.VxAyCoVnce = convertRawToPhysical(raw_value, 0.005, -10.0);

    raw_value=copyBitsFromByteArrayLE( byteArray, 13024, 12);
    @CAN_RadarRR::RRR_Object::RRR_Object_Obj24.VxVnce = convertRawToPhysical(raw_value, 0.005, 0.0);

    raw_value=copyBitsFromByteArrayLE( byteArray, 13216, 12);
    @CAN_RadarRR::RRR_Object::RRR_Object_Obj24.VxVyCoVnce = convertRawToPhysical(raw_value, 0.005, -10.0);

    raw_value=copyBitsFromByteArrayLE( byteArray, 13038, 10);
    @CAN_RadarRR::RRR_Object::RRR_Object_Obj24.Vy = convertRawToPhysical(raw_value, 0.125, -64.0);

    raw_value=copyBitsFromByteArrayLE( byteArray, 13260, 12);
    @CAN_RadarRR::RRR_Object::RRR_Object_Obj24.VyAxCoVnce = convertRawToPhysical(raw_value, 0.005, -10.0);

    raw_value=copyBitsFromByteArrayLE( byteArray, 13280, 12);
    @CAN_RadarRR::RRR_Object::RRR_Object_Obj24.VyAyCoVnce = convertRawToPhysical(raw_value, 0.005, -10.0);

    raw_value=copyBitsFromByteArrayLE( byteArray, 13056, 12);
    @CAN_RadarRR::RRR_Object::RRR_Object_Obj24.VyVnce = convertRawToPhysical(raw_value, 0.005, 0.0);

    raw_value=copyBitsFromByteArrayLE( byteArray, 12952, 7);
    @CAN_RadarRR::RRR_Object::RRR_Object_Obj24.Width = convertRawToPhysical(raw_value, 0.125, 0.0);

    raw_value=copyBitsFromByteArrayLE( byteArray, 12960, 12);
    @CAN_RadarRR::RRR_Object::RRR_Object_Obj24.WidthVnce = convertRawToPhysical(raw_value, 0.005, 0.0);
}


void CRadarRR_RRR_Object_Obj25_SetDataReceived(byte byteArray[])
{
    qword raw_value;

    raw_value=copyBitsFromByteArrayLE( byteArray, 13824, 32);
    @CAN_RadarRR::RRR_Object::RRR_Object_Obj25.Age = convertRawToPhysical(raw_value, 1.0, 0.0);

    raw_value=copyBitsFromByteArrayLE( byteArray, 13420, 10);
    @CAN_RadarRR::RRR_Object::RRR_Object_Obj25.Ax = convertRawToPhysical(raw_value, 0.03125, -16.0);

    raw_value=copyBitsFromByteArrayLE( byteArray, 13804, 12);
    @CAN_RadarRR::RRR_Object::RRR_Object_Obj25.AxAyCoVnce = convertRawToPhysical(raw_value, 0.005, -10.0);

    raw_value=copyBitsFromByteArrayLE( byteArray, 13440, 12);
    @CAN_RadarRR::RRR_Object::RRR_Object_Obj25.AxVnce = convertRawToPhysical(raw_value, 0.005, 0.0);

    raw_value=copyBitsFromByteArrayLE( byteArray, 13494, 9);
    @CAN_RadarRR::RRR_Object::RRR_Object_Obj25.Ay = convertRawToPhysical(raw_value, 0.0625, -16.0);

    raw_value=copyBitsFromByteArrayLE( byteArray, 13504, 12);
    @CAN_RadarRR::RRR_Object::RRR_Object_Obj25.AyVnce = convertRawToPhysical(raw_value, 0.005, 0.0);

    raw_value=copyBitsFromByteArrayLE( byteArray, 13560, 6);
    @CAN_RadarRR::RRR_Object::RRR_Object_Obj25.ExistProb = convertRawToPhysical(raw_value, 2.0, 0.0);

    raw_value=copyBitsFromByteArrayLE( byteArray, 13624, 8);
    @CAN_RadarRR::RRR_Object::RRR_Object_Obj25.FilterInformation = convertRawToPhysical(raw_value, 1.0, 0.0);

    raw_value=copyBitsFromByteArrayLE( byteArray, 13400, 7);
    @CAN_RadarRR::RRR_Object::RRR_Object_Obj25.Length = convertRawToPhysical(raw_value, 0.125, 0.0);

    raw_value=copyBitsFromByteArrayLE( byteArray, 13408, 12);
    @CAN_RadarRR::RRR_Object::RRR_Object_Obj25.LengthVnce = convertRawToPhysical(raw_value, 0.005, 0.0);

    raw_value=copyBitsFromByteArrayLE( byteArray, 13592, 3);
    @CAN_RadarRR::RRR_Object::RRR_Object_Obj25.MeasurementStatus = convertRawToPhysical(raw_value, 1.0, 0.0);

    raw_value=copyBitsFromByteArrayLE( byteArray, 13548, 2);
    @CAN_RadarRR::RRR_Object::RRR_Object_Obj25.MovingStatus = convertRawToPhysical(raw_value, 1.0, 0.0);

    raw_value=copyBitsFromByteArrayLE( byteArray, 13528, 7);
    @CAN_RadarRR::RRR_Object::RRR_Object_Obj25.ObjId = convertRawToPhysical(raw_value, 1.0, 0.0);

    raw_value=copyBitsFromByteArrayLE( byteArray, 13430, 9);
    @CAN_RadarRR::RRR_Object::RRR_Object_Obj25.OrientationYaw = convertRawToPhysical(raw_value, 0.0175, -4.48);

    raw_value=copyBitsFromByteArrayLE( byteArray, 13452, 12);
    @CAN_RadarRR::RRR_Object::RRR_Object_Obj25.OrientationYawVnce = convertRawToPhysical(raw_value, 0.0003, 0.0);

    raw_value=copyBitsFromByteArrayLE( byteArray, 13344, 6);
    @CAN_RadarRR::RRR_Object::RRR_Object_Obj25.ProbClassConfidence = convertRawToPhysical(raw_value, 2.0, 0.0);

    raw_value=copyBitsFromByteArrayLE( byteArray, 13595, 4);
    @CAN_RadarRR::RRR_Object::RRR_Object_Obj25.ProbClassType = convertRawToPhysical(raw_value, 1.0, 0.0);

    raw_value=copyBitsFromByteArrayLE( byteArray, 13350, 14);
    @CAN_RadarRR::RRR_Object::RRR_Object_Obj25.Px = convertRawToPhysical(raw_value, 0.0625, -512.0);

    raw_value=copyBitsFromByteArrayLE( byteArray, 13664, 12);
    @CAN_RadarRR::RRR_Object::RRR_Object_Obj25.PxAxCoVnce = convertRawToPhysical(raw_value, 0.005, -10.0);

    raw_value=copyBitsFromByteArrayLE( byteArray, 13676, 12);
    @CAN_RadarRR::RRR_Object::RRR_Object_Obj25.PxAyCoVnce = convertRawToPhysical(raw_value, 0.005, -10.0);

    raw_value=copyBitsFromByteArrayLE( byteArray, 13580, 12);
    @CAN_RadarRR::RRR_Object::RRR_Object_Obj25.PxPyCoVnce = convertRawToPhysical(raw_value, 0.005, -10.0);

    raw_value=copyBitsFromByteArrayLE( byteArray, 13364, 12);
    @CAN_RadarRR::RRR_Object::RRR_Object_Obj25.PxVnce = convertRawToPhysical(raw_value, 0.005, 0.0);

    raw_value=copyBitsFromByteArrayLE( byteArray, 13600, 12);
    @CAN_RadarRR::RRR_Object::RRR_Object_Obj25.PxVxCoVnce = convertRawToPhysical(raw_value, 0.005, -10.0);

    raw_value=copyBitsFromByteArrayLE( byteArray, 13612, 12);
    @CAN_RadarRR::RRR_Object::RRR_Object_Obj25.PxVyCoVnce = convertRawToPhysical(raw_value, 0.005, -10.0);

    raw_value=copyBitsFromByteArrayLE( byteArray, 13376, 12);
    @CAN_RadarRR::RRR_Object::RRR_Object_Obj25.Py = convertRawToPhysical(raw_value, 0.0625, -128.0);

    raw_value=copyBitsFromByteArrayLE( byteArray, 13696, 12);
    @CAN_RadarRR::RRR_Object::RRR_Object_Obj25.PyAxCoVnce = convertRawToPhysical(raw_value, 0.005, -10.0);

    raw_value=copyBitsFromByteArrayLE( byteArray, 13708, 12);
    @CAN_RadarRR::RRR_Object::RRR_Object_Obj25.PyAyCoVnce = convertRawToPhysical(raw_value, 0.005, -10.0);

    raw_value=copyBitsFromByteArrayLE( byteArray, 13388, 12);
    @CAN_RadarRR::RRR_Object::RRR_Object_Obj25.PyVnce = convertRawToPhysical(raw_value, 0.005, 0.0);

    raw_value=copyBitsFromByteArrayLE( byteArray, 13632, 12);
    @CAN_RadarRR::RRR_Object::RRR_Object_Obj25.PyVxCoVnce = convertRawToPhysical(raw_value, 0.005, -10.0);

    raw_value=copyBitsFromByteArrayLE( byteArray, 13644, 12);
    @CAN_RadarRR::RRR_Object::RRR_Object_Obj25.PyVyCoVnce = convertRawToPhysical(raw_value, 0.005, -10.0);

    raw_value=copyBitsFromByteArrayLE( byteArray, 13484, 10);
    @CAN_RadarRR::RRR_Object::RRR_Object_Obj25.RCS = convertRawToPhysical(raw_value, 0.2, -102.4);

    raw_value=copyBitsFromByteArrayLE( byteArray, 13656, 4);
    @CAN_RadarRR::RRR_Object::RRR_Object_Obj25.ReferencePoint = convertRawToPhysical(raw_value, 1.0, 0.0);

    raw_value=copyBitsFromByteArrayLE( byteArray, 13516, 12);
    @CAN_RadarRR::RRR_Object::RRR_Object_Obj25.Vx = convertRawToPhysical(raw_value, 0.0625, -128.0);

    raw_value=copyBitsFromByteArrayLE( byteArray, 13740, 12);
    @CAN_RadarRR::RRR_Object::RRR_Object_Obj25.VxAxCoVnce = convertRawToPhysical(raw_value, 0.005, -10.0);

    raw_value=copyBitsFromByteArrayLE( byteArray, 13760, 12);
    @CAN_RadarRR::RRR_Object::RRR_Object_Obj25.VxAyCoVnce = convertRawToPhysical(raw_value, 0.005, -10.0);

    raw_value=copyBitsFromByteArrayLE( byteArray, 13536, 12);
    @CAN_RadarRR::RRR_Object::RRR_Object_Obj25.VxVnce = convertRawToPhysical(raw_value, 0.005, 0.0);

    raw_value=copyBitsFromByteArrayLE( byteArray, 13728, 12);
    @CAN_RadarRR::RRR_Object::RRR_Object_Obj25.VxVyCoVnce = convertRawToPhysical(raw_value, 0.005, -10.0);

    raw_value=copyBitsFromByteArrayLE( byteArray, 13550, 10);
    @CAN_RadarRR::RRR_Object::RRR_Object_Obj25.Vy = convertRawToPhysical(raw_value, 0.125, -64.0);

    raw_value=copyBitsFromByteArrayLE( byteArray, 13772, 12);
    @CAN_RadarRR::RRR_Object::RRR_Object_Obj25.VyAxCoVnce = convertRawToPhysical(raw_value, 0.005, -10.0);

    raw_value=copyBitsFromByteArrayLE( byteArray, 13792, 12);
    @CAN_RadarRR::RRR_Object::RRR_Object_Obj25.VyAyCoVnce = convertRawToPhysical(raw_value, 0.005, -10.0);

    raw_value=copyBitsFromByteArrayLE( byteArray, 13568, 12);
    @CAN_RadarRR::RRR_Object::RRR_Object_Obj25.VyVnce = convertRawToPhysical(raw_value, 0.005, 0.0);

    raw_value=copyBitsFromByteArrayLE( byteArray, 13464, 7);
    @CAN_RadarRR::RRR_Object::RRR_Object_Obj25.Width = convertRawToPhysical(raw_value, 0.125, 0.0);

    raw_value=copyBitsFromByteArrayLE( byteArray, 13472, 12);
    @CAN_RadarRR::RRR_Object::RRR_Object_Obj25.WidthVnce = convertRawToPhysical(raw_value, 0.005, 0.0);
}


void CRadarRR_RRR_Object_Obj26_SetDataReceived(byte byteArray[])
{
    qword raw_value;

    raw_value=copyBitsFromByteArrayLE( byteArray, 14336, 32);
    @CAN_RadarRR::RRR_Object::RRR_Object_Obj26.Age = convertRawToPhysical(raw_value, 1.0, 0.0);

    raw_value=copyBitsFromByteArrayLE( byteArray, 13932, 10);
    @CAN_RadarRR::RRR_Object::RRR_Object_Obj26.Ax = convertRawToPhysical(raw_value, 0.03125, -16.0);

    raw_value=copyBitsFromByteArrayLE( byteArray, 14316, 12);
    @CAN_RadarRR::RRR_Object::RRR_Object_Obj26.AxAyCoVnce = convertRawToPhysical(raw_value, 0.005, -10.0);

    raw_value=copyBitsFromByteArrayLE( byteArray, 13952, 12);
    @CAN_RadarRR::RRR_Object::RRR_Object_Obj26.AxVnce = convertRawToPhysical(raw_value, 0.005, 0.0);

    raw_value=copyBitsFromByteArrayLE( byteArray, 14006, 9);
    @CAN_RadarRR::RRR_Object::RRR_Object_Obj26.Ay = convertRawToPhysical(raw_value, 0.0625, -16.0);

    raw_value=copyBitsFromByteArrayLE( byteArray, 14016, 12);
    @CAN_RadarRR::RRR_Object::RRR_Object_Obj26.AyVnce = convertRawToPhysical(raw_value, 0.005, 0.0);

    raw_value=copyBitsFromByteArrayLE( byteArray, 14072, 6);
    @CAN_RadarRR::RRR_Object::RRR_Object_Obj26.ExistProb = convertRawToPhysical(raw_value, 2.0, 0.0);

    raw_value=copyBitsFromByteArrayLE( byteArray, 14136, 8);
    @CAN_RadarRR::RRR_Object::RRR_Object_Obj26.FilterInformation = convertRawToPhysical(raw_value, 1.0, 0.0);

    raw_value=copyBitsFromByteArrayLE( byteArray, 13912, 7);
    @CAN_RadarRR::RRR_Object::RRR_Object_Obj26.Length = convertRawToPhysical(raw_value, 0.125, 0.0);

    raw_value=copyBitsFromByteArrayLE( byteArray, 13920, 12);
    @CAN_RadarRR::RRR_Object::RRR_Object_Obj26.LengthVnce = convertRawToPhysical(raw_value, 0.005, 0.0);

    raw_value=copyBitsFromByteArrayLE( byteArray, 14104, 3);
    @CAN_RadarRR::RRR_Object::RRR_Object_Obj26.MeasurementStatus = convertRawToPhysical(raw_value, 1.0, 0.0);

    raw_value=copyBitsFromByteArrayLE( byteArray, 14060, 2);
    @CAN_RadarRR::RRR_Object::RRR_Object_Obj26.MovingStatus = convertRawToPhysical(raw_value, 1.0, 0.0);

    raw_value=copyBitsFromByteArrayLE( byteArray, 14040, 7);
    @CAN_RadarRR::RRR_Object::RRR_Object_Obj26.ObjId = convertRawToPhysical(raw_value, 1.0, 0.0);

    raw_value=copyBitsFromByteArrayLE( byteArray, 13942, 9);
    @CAN_RadarRR::RRR_Object::RRR_Object_Obj26.OrientationYaw = convertRawToPhysical(raw_value, 0.0175, -4.48);

    raw_value=copyBitsFromByteArrayLE( byteArray, 13964, 12);
    @CAN_RadarRR::RRR_Object::RRR_Object_Obj26.OrientationYawVnce = convertRawToPhysical(raw_value, 0.0003, 0.0);

    raw_value=copyBitsFromByteArrayLE( byteArray, 13856, 6);
    @CAN_RadarRR::RRR_Object::RRR_Object_Obj26.ProbClassConfidence = convertRawToPhysical(raw_value, 2.0, 0.0);

    raw_value=copyBitsFromByteArrayLE( byteArray, 14107, 4);
    @CAN_RadarRR::RRR_Object::RRR_Object_Obj26.ProbClassType = convertRawToPhysical(raw_value, 1.0, 0.0);

    raw_value=copyBitsFromByteArrayLE( byteArray, 13862, 14);
    @CAN_RadarRR::RRR_Object::RRR_Object_Obj26.Px = convertRawToPhysical(raw_value, 0.0625, -512.0);

    raw_value=copyBitsFromByteArrayLE( byteArray, 14176, 12);
    @CAN_RadarRR::RRR_Object::RRR_Object_Obj26.PxAxCoVnce = convertRawToPhysical(raw_value, 0.005, -10.0);

    raw_value=copyBitsFromByteArrayLE( byteArray, 14188, 12);
    @CAN_RadarRR::RRR_Object::RRR_Object_Obj26.PxAyCoVnce = convertRawToPhysical(raw_value, 0.005, -10.0);

    raw_value=copyBitsFromByteArrayLE( byteArray, 14092, 12);
    @CAN_RadarRR::RRR_Object::RRR_Object_Obj26.PxPyCoVnce = convertRawToPhysical(raw_value, 0.005, -10.0);

    raw_value=copyBitsFromByteArrayLE( byteArray, 13876, 12);
    @CAN_RadarRR::RRR_Object::RRR_Object_Obj26.PxVnce = convertRawToPhysical(raw_value, 0.005, 0.0);

    raw_value=copyBitsFromByteArrayLE( byteArray, 14112, 12);
    @CAN_RadarRR::RRR_Object::RRR_Object_Obj26.PxVxCoVnce = convertRawToPhysical(raw_value, 0.005, -10.0);

    raw_value=copyBitsFromByteArrayLE( byteArray, 14124, 12);
    @CAN_RadarRR::RRR_Object::RRR_Object_Obj26.PxVyCoVnce = convertRawToPhysical(raw_value, 0.005, -10.0);

    raw_value=copyBitsFromByteArrayLE( byteArray, 13888, 12);
    @CAN_RadarRR::RRR_Object::RRR_Object_Obj26.Py = convertRawToPhysical(raw_value, 0.0625, -128.0);

    raw_value=copyBitsFromByteArrayLE( byteArray, 14208, 12);
    @CAN_RadarRR::RRR_Object::RRR_Object_Obj26.PyAxCoVnce = convertRawToPhysical(raw_value, 0.005, -10.0);

    raw_value=copyBitsFromByteArrayLE( byteArray, 14220, 12);
    @CAN_RadarRR::RRR_Object::RRR_Object_Obj26.PyAyCoVnce = convertRawToPhysical(raw_value, 0.005, -10.0);

    raw_value=copyBitsFromByteArrayLE( byteArray, 13900, 12);
    @CAN_RadarRR::RRR_Object::RRR_Object_Obj26.PyVnce = convertRawToPhysical(raw_value, 0.005, 0.0);

    raw_value=copyBitsFromByteArrayLE( byteArray, 14144, 12);
    @CAN_RadarRR::RRR_Object::RRR_Object_Obj26.PyVxCoVnce = convertRawToPhysical(raw_value, 0.005, -10.0);

    raw_value=copyBitsFromByteArrayLE( byteArray, 14156, 12);
    @CAN_RadarRR::RRR_Object::RRR_Object_Obj26.PyVyCoVnce = convertRawToPhysical(raw_value, 0.005, -10.0);

    raw_value=copyBitsFromByteArrayLE( byteArray, 13996, 10);
    @CAN_RadarRR::RRR_Object::RRR_Object_Obj26.RCS = convertRawToPhysical(raw_value, 0.2, -102.4);

    raw_value=copyBitsFromByteArrayLE( byteArray, 14168, 4);
    @CAN_RadarRR::RRR_Object::RRR_Object_Obj26.ReferencePoint = convertRawToPhysical(raw_value, 1.0, 0.0);

    raw_value=copyBitsFromByteArrayLE( byteArray, 14028, 12);
    @CAN_RadarRR::RRR_Object::RRR_Object_Obj26.Vx = convertRawToPhysical(raw_value, 0.0625, -128.0);

    raw_value=copyBitsFromByteArrayLE( byteArray, 14252, 12);
    @CAN_RadarRR::RRR_Object::RRR_Object_Obj26.VxAxCoVnce = convertRawToPhysical(raw_value, 0.005, -10.0);

    raw_value=copyBitsFromByteArrayLE( byteArray, 14272, 12);
    @CAN_RadarRR::RRR_Object::RRR_Object_Obj26.VxAyCoVnce = convertRawToPhysical(raw_value, 0.005, -10.0);

    raw_value=copyBitsFromByteArrayLE( byteArray, 14048, 12);
    @CAN_RadarRR::RRR_Object::RRR_Object_Obj26.VxVnce = convertRawToPhysical(raw_value, 0.005, 0.0);

    raw_value=copyBitsFromByteArrayLE( byteArray, 14240, 12);
    @CAN_RadarRR::RRR_Object::RRR_Object_Obj26.VxVyCoVnce = convertRawToPhysical(raw_value, 0.005, -10.0);

    raw_value=copyBitsFromByteArrayLE( byteArray, 14062, 10);
    @CAN_RadarRR::RRR_Object::RRR_Object_Obj26.Vy = convertRawToPhysical(raw_value, 0.125, -64.0);

    raw_value=copyBitsFromByteArrayLE( byteArray, 14284, 12);
    @CAN_RadarRR::RRR_Object::RRR_Object_Obj26.VyAxCoVnce = convertRawToPhysical(raw_value, 0.005, -10.0);

    raw_value=copyBitsFromByteArrayLE( byteArray, 14304, 12);
    @CAN_RadarRR::RRR_Object::RRR_Object_Obj26.VyAyCoVnce = convertRawToPhysical(raw_value, 0.005, -10.0);

    raw_value=copyBitsFromByteArrayLE( byteArray, 14080, 12);
    @CAN_RadarRR::RRR_Object::RRR_Object_Obj26.VyVnce = convertRawToPhysical(raw_value, 0.005, 0.0);

    raw_value=copyBitsFromByteArrayLE( byteArray, 13976, 7);
    @CAN_RadarRR::RRR_Object::RRR_Object_Obj26.Width = convertRawToPhysical(raw_value, 0.125, 0.0);

    raw_value=copyBitsFromByteArrayLE( byteArray, 13984, 12);
    @CAN_RadarRR::RRR_Object::RRR_Object_Obj26.WidthVnce = convertRawToPhysical(raw_value, 0.005, 0.0);
}


void CRadarRR_RRR_Object_Obj27_SetDataReceived(byte byteArray[])
{
    qword raw_value;

    raw_value=copyBitsFromByteArrayLE( byteArray, 14848, 32);
    @CAN_RadarRR::RRR_Object::RRR_Object_Obj27.Age = convertRawToPhysical(raw_value, 1.0, 0.0);

    raw_value=copyBitsFromByteArrayLE( byteArray, 14444, 10);
    @CAN_RadarRR::RRR_Object::RRR_Object_Obj27.Ax = convertRawToPhysical(raw_value, 0.03125, -16.0);

    raw_value=copyBitsFromByteArrayLE( byteArray, 14828, 12);
    @CAN_RadarRR::RRR_Object::RRR_Object_Obj27.AxAyCoVnce = convertRawToPhysical(raw_value, 0.005, -10.0);

    raw_value=copyBitsFromByteArrayLE( byteArray, 14464, 12);
    @CAN_RadarRR::RRR_Object::RRR_Object_Obj27.AxVnce = convertRawToPhysical(raw_value, 0.005, 0.0);

    raw_value=copyBitsFromByteArrayLE( byteArray, 14518, 9);
    @CAN_RadarRR::RRR_Object::RRR_Object_Obj27.Ay = convertRawToPhysical(raw_value, 0.0625, -16.0);

    raw_value=copyBitsFromByteArrayLE( byteArray, 14528, 12);
    @CAN_RadarRR::RRR_Object::RRR_Object_Obj27.AyVnce = convertRawToPhysical(raw_value, 0.005, 0.0);

    raw_value=copyBitsFromByteArrayLE( byteArray, 14584, 6);
    @CAN_RadarRR::RRR_Object::RRR_Object_Obj27.ExistProb = convertRawToPhysical(raw_value, 2.0, 0.0);

    raw_value=copyBitsFromByteArrayLE( byteArray, 14648, 8);
    @CAN_RadarRR::RRR_Object::RRR_Object_Obj27.FilterInformation = convertRawToPhysical(raw_value, 1.0, 0.0);

    raw_value=copyBitsFromByteArrayLE( byteArray, 14424, 7);
    @CAN_RadarRR::RRR_Object::RRR_Object_Obj27.Length = convertRawToPhysical(raw_value, 0.125, 0.0);

    raw_value=copyBitsFromByteArrayLE( byteArray, 14432, 12);
    @CAN_RadarRR::RRR_Object::RRR_Object_Obj27.LengthVnce = convertRawToPhysical(raw_value, 0.005, 0.0);

    raw_value=copyBitsFromByteArrayLE( byteArray, 14616, 3);
    @CAN_RadarRR::RRR_Object::RRR_Object_Obj27.MeasurementStatus = convertRawToPhysical(raw_value, 1.0, 0.0);

    raw_value=copyBitsFromByteArrayLE( byteArray, 14572, 2);
    @CAN_RadarRR::RRR_Object::RRR_Object_Obj27.MovingStatus = convertRawToPhysical(raw_value, 1.0, 0.0);

    raw_value=copyBitsFromByteArrayLE( byteArray, 14552, 7);
    @CAN_RadarRR::RRR_Object::RRR_Object_Obj27.ObjId = convertRawToPhysical(raw_value, 1.0, 0.0);

    raw_value=copyBitsFromByteArrayLE( byteArray, 14454, 9);
    @CAN_RadarRR::RRR_Object::RRR_Object_Obj27.OrientationYaw = convertRawToPhysical(raw_value, 0.0175, -4.48);

    raw_value=copyBitsFromByteArrayLE( byteArray, 14476, 12);
    @CAN_RadarRR::RRR_Object::RRR_Object_Obj27.OrientationYawVnce = convertRawToPhysical(raw_value, 0.0003, 0.0);

    raw_value=copyBitsFromByteArrayLE( byteArray, 14368, 6);
    @CAN_RadarRR::RRR_Object::RRR_Object_Obj27.ProbClassConfidence = convertRawToPhysical(raw_value, 2.0, 0.0);

    raw_value=copyBitsFromByteArrayLE( byteArray, 14619, 4);
    @CAN_RadarRR::RRR_Object::RRR_Object_Obj27.ProbClassType = convertRawToPhysical(raw_value, 1.0, 0.0);

    raw_value=copyBitsFromByteArrayLE( byteArray, 14374, 14);
    @CAN_RadarRR::RRR_Object::RRR_Object_Obj27.Px = convertRawToPhysical(raw_value, 0.0625, -512.0);

    raw_value=copyBitsFromByteArrayLE( byteArray, 14688, 12);
    @CAN_RadarRR::RRR_Object::RRR_Object_Obj27.PxAxCoVnce = convertRawToPhysical(raw_value, 0.005, -10.0);

    raw_value=copyBitsFromByteArrayLE( byteArray, 14700, 12);
    @CAN_RadarRR::RRR_Object::RRR_Object_Obj27.PxAyCoVnce = convertRawToPhysical(raw_value, 0.005, -10.0);

    raw_value=copyBitsFromByteArrayLE( byteArray, 14604, 12);
    @CAN_RadarRR::RRR_Object::RRR_Object_Obj27.PxPyCoVnce = convertRawToPhysical(raw_value, 0.005, -10.0);

    raw_value=copyBitsFromByteArrayLE( byteArray, 14388, 12);
    @CAN_RadarRR::RRR_Object::RRR_Object_Obj27.PxVnce = convertRawToPhysical(raw_value, 0.005, 0.0);

    raw_value=copyBitsFromByteArrayLE( byteArray, 14624, 12);
    @CAN_RadarRR::RRR_Object::RRR_Object_Obj27.PxVxCoVnce = convertRawToPhysical(raw_value, 0.005, -10.0);

    raw_value=copyBitsFromByteArrayLE( byteArray, 14636, 12);
    @CAN_RadarRR::RRR_Object::RRR_Object_Obj27.PxVyCoVnce = convertRawToPhysical(raw_value, 0.005, -10.0);

    raw_value=copyBitsFromByteArrayLE( byteArray, 14400, 12);
    @CAN_RadarRR::RRR_Object::RRR_Object_Obj27.Py = convertRawToPhysical(raw_value, 0.0625, -128.0);

    raw_value=copyBitsFromByteArrayLE( byteArray, 14720, 12);
    @CAN_RadarRR::RRR_Object::RRR_Object_Obj27.PyAxCoVnce = convertRawToPhysical(raw_value, 0.005, -10.0);

    raw_value=copyBitsFromByteArrayLE( byteArray, 14732, 12);
    @CAN_RadarRR::RRR_Object::RRR_Object_Obj27.PyAyCoVnce = convertRawToPhysical(raw_value, 0.005, -10.0);

    raw_value=copyBitsFromByteArrayLE( byteArray, 14412, 12);
    @CAN_RadarRR::RRR_Object::RRR_Object_Obj27.PyVnce = convertRawToPhysical(raw_value, 0.005, 0.0);

    raw_value=copyBitsFromByteArrayLE( byteArray, 14656, 12);
    @CAN_RadarRR::RRR_Object::RRR_Object_Obj27.PyVxCoVnce = convertRawToPhysical(raw_value, 0.005, -10.0);

    raw_value=copyBitsFromByteArrayLE( byteArray, 14668, 12);
    @CAN_RadarRR::RRR_Object::RRR_Object_Obj27.PyVyCoVnce = convertRawToPhysical(raw_value, 0.005, -10.0);

    raw_value=copyBitsFromByteArrayLE( byteArray, 14508, 10);
    @CAN_RadarRR::RRR_Object::RRR_Object_Obj27.RCS = convertRawToPhysical(raw_value, 0.2, -102.4);

    raw_value=copyBitsFromByteArrayLE( byteArray, 14680, 4);
    @CAN_RadarRR::RRR_Object::RRR_Object_Obj27.ReferencePoint = convertRawToPhysical(raw_value, 1.0, 0.0);

    raw_value=copyBitsFromByteArrayLE( byteArray, 14540, 12);
    @CAN_RadarRR::RRR_Object::RRR_Object_Obj27.Vx = convertRawToPhysical(raw_value, 0.0625, -128.0);

    raw_value=copyBitsFromByteArrayLE( byteArray, 14764, 12);
    @CAN_RadarRR::RRR_Object::RRR_Object_Obj27.VxAxCoVnce = convertRawToPhysical(raw_value, 0.005, -10.0);

    raw_value=copyBitsFromByteArrayLE( byteArray, 14784, 12);
    @CAN_RadarRR::RRR_Object::RRR_Object_Obj27.VxAyCoVnce = convertRawToPhysical(raw_value, 0.005, -10.0);

    raw_value=copyBitsFromByteArrayLE( byteArray, 14560, 12);
    @CAN_RadarRR::RRR_Object::RRR_Object_Obj27.VxVnce = convertRawToPhysical(raw_value, 0.005, 0.0);

    raw_value=copyBitsFromByteArrayLE( byteArray, 14752, 12);
    @CAN_RadarRR::RRR_Object::RRR_Object_Obj27.VxVyCoVnce = convertRawToPhysical(raw_value, 0.005, -10.0);

    raw_value=copyBitsFromByteArrayLE( byteArray, 14574, 10);
    @CAN_RadarRR::RRR_Object::RRR_Object_Obj27.Vy = convertRawToPhysical(raw_value, 0.125, -64.0);

    raw_value=copyBitsFromByteArrayLE( byteArray, 14796, 12);
    @CAN_RadarRR::RRR_Object::RRR_Object_Obj27.VyAxCoVnce = convertRawToPhysical(raw_value, 0.005, -10.0);

    raw_value=copyBitsFromByteArrayLE( byteArray, 14816, 12);
    @CAN_RadarRR::RRR_Object::RRR_Object_Obj27.VyAyCoVnce = convertRawToPhysical(raw_value, 0.005, -10.0);

    raw_value=copyBitsFromByteArrayLE( byteArray, 14592, 12);
    @CAN_RadarRR::RRR_Object::RRR_Object_Obj27.VyVnce = convertRawToPhysical(raw_value, 0.005, 0.0);

    raw_value=copyBitsFromByteArrayLE( byteArray, 14488, 7);
    @CAN_RadarRR::RRR_Object::RRR_Object_Obj27.Width = convertRawToPhysical(raw_value, 0.125, 0.0);

    raw_value=copyBitsFromByteArrayLE( byteArray, 14496, 12);
    @CAN_RadarRR::RRR_Object::RRR_Object_Obj27.WidthVnce = convertRawToPhysical(raw_value, 0.005, 0.0);
}


void CRadarRR_RRR_Object_Obj28_SetDataReceived(byte byteArray[])
{
    qword raw_value;

    raw_value=copyBitsFromByteArrayLE( byteArray, 15360, 32);
    @CAN_RadarRR::RRR_Object::RRR_Object_Obj28.Age = convertRawToPhysical(raw_value, 1.0, 0.0);

    raw_value=copyBitsFromByteArrayLE( byteArray, 14956, 10);
    @CAN_RadarRR::RRR_Object::RRR_Object_Obj28.Ax = convertRawToPhysical(raw_value, 0.03125, -16.0);

    raw_value=copyBitsFromByteArrayLE( byteArray, 15340, 12);
    @CAN_RadarRR::RRR_Object::RRR_Object_Obj28.AxAyCoVnce = convertRawToPhysical(raw_value, 0.005, -10.0);

    raw_value=copyBitsFromByteArrayLE( byteArray, 14976, 12);
    @CAN_RadarRR::RRR_Object::RRR_Object_Obj28.AxVnce = convertRawToPhysical(raw_value, 0.005, 0.0);

    raw_value=copyBitsFromByteArrayLE( byteArray, 15030, 9);
    @CAN_RadarRR::RRR_Object::RRR_Object_Obj28.Ay = convertRawToPhysical(raw_value, 0.0625, -16.0);

    raw_value=copyBitsFromByteArrayLE( byteArray, 15040, 12);
    @CAN_RadarRR::RRR_Object::RRR_Object_Obj28.AyVnce = convertRawToPhysical(raw_value, 0.005, 0.0);

    raw_value=copyBitsFromByteArrayLE( byteArray, 15096, 6);
    @CAN_RadarRR::RRR_Object::RRR_Object_Obj28.ExistProb = convertRawToPhysical(raw_value, 2.0, 0.0);

    raw_value=copyBitsFromByteArrayLE( byteArray, 15160, 8);
    @CAN_RadarRR::RRR_Object::RRR_Object_Obj28.FilterInformation = convertRawToPhysical(raw_value, 1.0, 0.0);

    raw_value=copyBitsFromByteArrayLE( byteArray, 14936, 7);
    @CAN_RadarRR::RRR_Object::RRR_Object_Obj28.Length = convertRawToPhysical(raw_value, 0.125, 0.0);

    raw_value=copyBitsFromByteArrayLE( byteArray, 14944, 12);
    @CAN_RadarRR::RRR_Object::RRR_Object_Obj28.LengthVnce = convertRawToPhysical(raw_value, 0.005, 0.0);

    raw_value=copyBitsFromByteArrayLE( byteArray, 15128, 3);
    @CAN_RadarRR::RRR_Object::RRR_Object_Obj28.MeasurementStatus = convertRawToPhysical(raw_value, 1.0, 0.0);

    raw_value=copyBitsFromByteArrayLE( byteArray, 15084, 2);
    @CAN_RadarRR::RRR_Object::RRR_Object_Obj28.MovingStatus = convertRawToPhysical(raw_value, 1.0, 0.0);

    raw_value=copyBitsFromByteArrayLE( byteArray, 15064, 7);
    @CAN_RadarRR::RRR_Object::RRR_Object_Obj28.ObjId = convertRawToPhysical(raw_value, 1.0, 0.0);

    raw_value=copyBitsFromByteArrayLE( byteArray, 14966, 9);
    @CAN_RadarRR::RRR_Object::RRR_Object_Obj28.OrientationYaw = convertRawToPhysical(raw_value, 0.0175, -4.48);

    raw_value=copyBitsFromByteArrayLE( byteArray, 14988, 12);
    @CAN_RadarRR::RRR_Object::RRR_Object_Obj28.OrientationYawVnce = convertRawToPhysical(raw_value, 0.0003, 0.0);

    raw_value=copyBitsFromByteArrayLE( byteArray, 14880, 6);
    @CAN_RadarRR::RRR_Object::RRR_Object_Obj28.ProbClassConfidence = convertRawToPhysical(raw_value, 2.0, 0.0);

    raw_value=copyBitsFromByteArrayLE( byteArray, 15131, 4);
    @CAN_RadarRR::RRR_Object::RRR_Object_Obj28.ProbClassType = convertRawToPhysical(raw_value, 1.0, 0.0);

    raw_value=copyBitsFromByteArrayLE( byteArray, 14886, 14);
    @CAN_RadarRR::RRR_Object::RRR_Object_Obj28.Px = convertRawToPhysical(raw_value, 0.0625, -512.0);

    raw_value=copyBitsFromByteArrayLE( byteArray, 15200, 12);
    @CAN_RadarRR::RRR_Object::RRR_Object_Obj28.PxAxCoVnce = convertRawToPhysical(raw_value, 0.005, -10.0);

    raw_value=copyBitsFromByteArrayLE( byteArray, 15212, 12);
    @CAN_RadarRR::RRR_Object::RRR_Object_Obj28.PxAyCoVnce = convertRawToPhysical(raw_value, 0.005, -10.0);

    raw_value=copyBitsFromByteArrayLE( byteArray, 15116, 12);
    @CAN_RadarRR::RRR_Object::RRR_Object_Obj28.PxPyCoVnce = convertRawToPhysical(raw_value, 0.005, -10.0);

    raw_value=copyBitsFromByteArrayLE( byteArray, 14900, 12);
    @CAN_RadarRR::RRR_Object::RRR_Object_Obj28.PxVnce = convertRawToPhysical(raw_value, 0.005, 0.0);

    raw_value=copyBitsFromByteArrayLE( byteArray, 15136, 12);
    @CAN_RadarRR::RRR_Object::RRR_Object_Obj28.PxVxCoVnce = convertRawToPhysical(raw_value, 0.005, -10.0);

    raw_value=copyBitsFromByteArrayLE( byteArray, 15148, 12);
    @CAN_RadarRR::RRR_Object::RRR_Object_Obj28.PxVyCoVnce = convertRawToPhysical(raw_value, 0.005, -10.0);

    raw_value=copyBitsFromByteArrayLE( byteArray, 14912, 12);
    @CAN_RadarRR::RRR_Object::RRR_Object_Obj28.Py = convertRawToPhysical(raw_value, 0.0625, -128.0);

    raw_value=copyBitsFromByteArrayLE( byteArray, 15232, 12);
    @CAN_RadarRR::RRR_Object::RRR_Object_Obj28.PyAxCoVnce = convertRawToPhysical(raw_value, 0.005, -10.0);

    raw_value=copyBitsFromByteArrayLE( byteArray, 15244, 12);
    @CAN_RadarRR::RRR_Object::RRR_Object_Obj28.PyAyCoVnce = convertRawToPhysical(raw_value, 0.005, -10.0);

    raw_value=copyBitsFromByteArrayLE( byteArray, 14924, 12);
    @CAN_RadarRR::RRR_Object::RRR_Object_Obj28.PyVnce = convertRawToPhysical(raw_value, 0.005, 0.0);

    raw_value=copyBitsFromByteArrayLE( byteArray, 15168, 12);
    @CAN_RadarRR::RRR_Object::RRR_Object_Obj28.PyVxCoVnce = convertRawToPhysical(raw_value, 0.005, -10.0);

    raw_value=copyBitsFromByteArrayLE( byteArray, 15180, 12);
    @CAN_RadarRR::RRR_Object::RRR_Object_Obj28.PyVyCoVnce = convertRawToPhysical(raw_value, 0.005, -10.0);

    raw_value=copyBitsFromByteArrayLE( byteArray, 15020, 10);
    @CAN_RadarRR::RRR_Object::RRR_Object_Obj28.RCS = convertRawToPhysical(raw_value, 0.2, -102.4);

    raw_value=copyBitsFromByteArrayLE( byteArray, 15192, 4);
    @CAN_RadarRR::RRR_Object::RRR_Object_Obj28.ReferencePoint = convertRawToPhysical(raw_value, 1.0, 0.0);

    raw_value=copyBitsFromByteArrayLE( byteArray, 15052, 12);
    @CAN_RadarRR::RRR_Object::RRR_Object_Obj28.Vx = convertRawToPhysical(raw_value, 0.0625, -128.0);

    raw_value=copyBitsFromByteArrayLE( byteArray, 15276, 12);
    @CAN_RadarRR::RRR_Object::RRR_Object_Obj28.VxAxCoVnce = convertRawToPhysical(raw_value, 0.005, -10.0);

    raw_value=copyBitsFromByteArrayLE( byteArray, 15296, 12);
    @CAN_RadarRR::RRR_Object::RRR_Object_Obj28.VxAyCoVnce = convertRawToPhysical(raw_value, 0.005, -10.0);

    raw_value=copyBitsFromByteArrayLE( byteArray, 15072, 12);
    @CAN_RadarRR::RRR_Object::RRR_Object_Obj28.VxVnce = convertRawToPhysical(raw_value, 0.005, 0.0);

    raw_value=copyBitsFromByteArrayLE( byteArray, 15264, 12);
    @CAN_RadarRR::RRR_Object::RRR_Object_Obj28.VxVyCoVnce = convertRawToPhysical(raw_value, 0.005, -10.0);

    raw_value=copyBitsFromByteArrayLE( byteArray, 15086, 10);
    @CAN_RadarRR::RRR_Object::RRR_Object_Obj28.Vy = convertRawToPhysical(raw_value, 0.125, -64.0);

    raw_value=copyBitsFromByteArrayLE( byteArray, 15308, 12);
    @CAN_RadarRR::RRR_Object::RRR_Object_Obj28.VyAxCoVnce = convertRawToPhysical(raw_value, 0.005, -10.0);

    raw_value=copyBitsFromByteArrayLE( byteArray, 15328, 12);
    @CAN_RadarRR::RRR_Object::RRR_Object_Obj28.VyAyCoVnce = convertRawToPhysical(raw_value, 0.005, -10.0);

    raw_value=copyBitsFromByteArrayLE( byteArray, 15104, 12);
    @CAN_RadarRR::RRR_Object::RRR_Object_Obj28.VyVnce = convertRawToPhysical(raw_value, 0.005, 0.0);

    raw_value=copyBitsFromByteArrayLE( byteArray, 15000, 7);
    @CAN_RadarRR::RRR_Object::RRR_Object_Obj28.Width = convertRawToPhysical(raw_value, 0.125, 0.0);

    raw_value=copyBitsFromByteArrayLE( byteArray, 15008, 12);
    @CAN_RadarRR::RRR_Object::RRR_Object_Obj28.WidthVnce = convertRawToPhysical(raw_value, 0.005, 0.0);
}


void CRadarRR_RRR_Object_Obj29_SetDataReceived(byte byteArray[])
{
    qword raw_value;

    raw_value=copyBitsFromByteArrayLE( byteArray, 15872, 32);
    @CAN_RadarRR::RRR_Object::RRR_Object_Obj29.Age = convertRawToPhysical(raw_value, 1.0, 0.0);

    raw_value=copyBitsFromByteArrayLE( byteArray, 15468, 10);
    @CAN_RadarRR::RRR_Object::RRR_Object_Obj29.Ax = convertRawToPhysical(raw_value, 0.03125, -16.0);

    raw_value=copyBitsFromByteArrayLE( byteArray, 15852, 12);
    @CAN_RadarRR::RRR_Object::RRR_Object_Obj29.AxAyCoVnce = convertRawToPhysical(raw_value, 0.005, -10.0);

    raw_value=copyBitsFromByteArrayLE( byteArray, 15488, 12);
    @CAN_RadarRR::RRR_Object::RRR_Object_Obj29.AxVnce = convertRawToPhysical(raw_value, 0.005, 0.0);

    raw_value=copyBitsFromByteArrayLE( byteArray, 15542, 9);
    @CAN_RadarRR::RRR_Object::RRR_Object_Obj29.Ay = convertRawToPhysical(raw_value, 0.0625, -16.0);

    raw_value=copyBitsFromByteArrayLE( byteArray, 15552, 12);
    @CAN_RadarRR::RRR_Object::RRR_Object_Obj29.AyVnce = convertRawToPhysical(raw_value, 0.005, 0.0);

    raw_value=copyBitsFromByteArrayLE( byteArray, 15608, 6);
    @CAN_RadarRR::RRR_Object::RRR_Object_Obj29.ExistProb = convertRawToPhysical(raw_value, 2.0, 0.0);

    raw_value=copyBitsFromByteArrayLE( byteArray, 15672, 8);
    @CAN_RadarRR::RRR_Object::RRR_Object_Obj29.FilterInformation = convertRawToPhysical(raw_value, 1.0, 0.0);

    raw_value=copyBitsFromByteArrayLE( byteArray, 15448, 7);
    @CAN_RadarRR::RRR_Object::RRR_Object_Obj29.Length = convertRawToPhysical(raw_value, 0.125, 0.0);

    raw_value=copyBitsFromByteArrayLE( byteArray, 15456, 12);
    @CAN_RadarRR::RRR_Object::RRR_Object_Obj29.LengthVnce = convertRawToPhysical(raw_value, 0.005, 0.0);

    raw_value=copyBitsFromByteArrayLE( byteArray, 15640, 3);
    @CAN_RadarRR::RRR_Object::RRR_Object_Obj29.MeasurementStatus = convertRawToPhysical(raw_value, 1.0, 0.0);

    raw_value=copyBitsFromByteArrayLE( byteArray, 15596, 2);
    @CAN_RadarRR::RRR_Object::RRR_Object_Obj29.MovingStatus = convertRawToPhysical(raw_value, 1.0, 0.0);

    raw_value=copyBitsFromByteArrayLE( byteArray, 15576, 7);
    @CAN_RadarRR::RRR_Object::RRR_Object_Obj29.ObjId = convertRawToPhysical(raw_value, 1.0, 0.0);

    raw_value=copyBitsFromByteArrayLE( byteArray, 15478, 9);
    @CAN_RadarRR::RRR_Object::RRR_Object_Obj29.OrientationYaw = convertRawToPhysical(raw_value, 0.0175, -4.48);

    raw_value=copyBitsFromByteArrayLE( byteArray, 15500, 12);
    @CAN_RadarRR::RRR_Object::RRR_Object_Obj29.OrientationYawVnce = convertRawToPhysical(raw_value, 0.0003, 0.0);

    raw_value=copyBitsFromByteArrayLE( byteArray, 15392, 6);
    @CAN_RadarRR::RRR_Object::RRR_Object_Obj29.ProbClassConfidence = convertRawToPhysical(raw_value, 2.0, 0.0);

    raw_value=copyBitsFromByteArrayLE( byteArray, 15643, 4);
    @CAN_RadarRR::RRR_Object::RRR_Object_Obj29.ProbClassType = convertRawToPhysical(raw_value, 1.0, 0.0);

    raw_value=copyBitsFromByteArrayLE( byteArray, 15398, 14);
    @CAN_RadarRR::RRR_Object::RRR_Object_Obj29.Px = convertRawToPhysical(raw_value, 0.0625, -512.0);

    raw_value=copyBitsFromByteArrayLE( byteArray, 15712, 12);
    @CAN_RadarRR::RRR_Object::RRR_Object_Obj29.PxAxCoVnce = convertRawToPhysical(raw_value, 0.005, -10.0);

    raw_value=copyBitsFromByteArrayLE( byteArray, 15724, 12);
    @CAN_RadarRR::RRR_Object::RRR_Object_Obj29.PxAyCoVnce = convertRawToPhysical(raw_value, 0.005, -10.0);

    raw_value=copyBitsFromByteArrayLE( byteArray, 15628, 12);
    @CAN_RadarRR::RRR_Object::RRR_Object_Obj29.PxPyCoVnce = convertRawToPhysical(raw_value, 0.005, -10.0);

    raw_value=copyBitsFromByteArrayLE( byteArray, 15412, 12);
    @CAN_RadarRR::RRR_Object::RRR_Object_Obj29.PxVnce = convertRawToPhysical(raw_value, 0.005, 0.0);

    raw_value=copyBitsFromByteArrayLE( byteArray, 15648, 12);
    @CAN_RadarRR::RRR_Object::RRR_Object_Obj29.PxVxCoVnce = convertRawToPhysical(raw_value, 0.005, -10.0);

    raw_value=copyBitsFromByteArrayLE( byteArray, 15660, 12);
    @CAN_RadarRR::RRR_Object::RRR_Object_Obj29.PxVyCoVnce = convertRawToPhysical(raw_value, 0.005, -10.0);

    raw_value=copyBitsFromByteArrayLE( byteArray, 15424, 12);
    @CAN_RadarRR::RRR_Object::RRR_Object_Obj29.Py = convertRawToPhysical(raw_value, 0.0625, -128.0);

    raw_value=copyBitsFromByteArrayLE( byteArray, 15744, 12);
    @CAN_RadarRR::RRR_Object::RRR_Object_Obj29.PyAxCoVnce = convertRawToPhysical(raw_value, 0.005, -10.0);

    raw_value=copyBitsFromByteArrayLE( byteArray, 15756, 12);
    @CAN_RadarRR::RRR_Object::RRR_Object_Obj29.PyAyCoVnce = convertRawToPhysical(raw_value, 0.005, -10.0);

    raw_value=copyBitsFromByteArrayLE( byteArray, 15436, 12);
    @CAN_RadarRR::RRR_Object::RRR_Object_Obj29.PyVnce = convertRawToPhysical(raw_value, 0.005, 0.0);

    raw_value=copyBitsFromByteArrayLE( byteArray, 15680, 12);
    @CAN_RadarRR::RRR_Object::RRR_Object_Obj29.PyVxCoVnce = convertRawToPhysical(raw_value, 0.005, -10.0);

    raw_value=copyBitsFromByteArrayLE( byteArray, 15692, 12);
    @CAN_RadarRR::RRR_Object::RRR_Object_Obj29.PyVyCoVnce = convertRawToPhysical(raw_value, 0.005, -10.0);

    raw_value=copyBitsFromByteArrayLE( byteArray, 15532, 10);
    @CAN_RadarRR::RRR_Object::RRR_Object_Obj29.RCS = convertRawToPhysical(raw_value, 0.2, -102.4);

    raw_value=copyBitsFromByteArrayLE( byteArray, 15704, 4);
    @CAN_RadarRR::RRR_Object::RRR_Object_Obj29.ReferencePoint = convertRawToPhysical(raw_value, 1.0, 0.0);

    raw_value=copyBitsFromByteArrayLE( byteArray, 15564, 12);
    @CAN_RadarRR::RRR_Object::RRR_Object_Obj29.Vx = convertRawToPhysical(raw_value, 0.0625, -128.0);

    raw_value=copyBitsFromByteArrayLE( byteArray, 15788, 12);
    @CAN_RadarRR::RRR_Object::RRR_Object_Obj29.VxAxCoVnce = convertRawToPhysical(raw_value, 0.005, -10.0);

    raw_value=copyBitsFromByteArrayLE( byteArray, 15808, 12);
    @CAN_RadarRR::RRR_Object::RRR_Object_Obj29.VxAyCoVnce = convertRawToPhysical(raw_value, 0.005, -10.0);

    raw_value=copyBitsFromByteArrayLE( byteArray, 15584, 12);
    @CAN_RadarRR::RRR_Object::RRR_Object_Obj29.VxVnce = convertRawToPhysical(raw_value, 0.005, 0.0);

    raw_value=copyBitsFromByteArrayLE( byteArray, 15776, 12);
    @CAN_RadarRR::RRR_Object::RRR_Object_Obj29.VxVyCoVnce = convertRawToPhysical(raw_value, 0.005, -10.0);

    raw_value=copyBitsFromByteArrayLE( byteArray, 15598, 10);
    @CAN_RadarRR::RRR_Object::RRR_Object_Obj29.Vy = convertRawToPhysical(raw_value, 0.125, -64.0);

    raw_value=copyBitsFromByteArrayLE( byteArray, 15820, 12);
    @CAN_RadarRR::RRR_Object::RRR_Object_Obj29.VyAxCoVnce = convertRawToPhysical(raw_value, 0.005, -10.0);

    raw_value=copyBitsFromByteArrayLE( byteArray, 15840, 12);
    @CAN_RadarRR::RRR_Object::RRR_Object_Obj29.VyAyCoVnce = convertRawToPhysical(raw_value, 0.005, -10.0);

    raw_value=copyBitsFromByteArrayLE( byteArray, 15616, 12);
    @CAN_RadarRR::RRR_Object::RRR_Object_Obj29.VyVnce = convertRawToPhysical(raw_value, 0.005, 0.0);

    raw_value=copyBitsFromByteArrayLE( byteArray, 15512, 7);
    @CAN_RadarRR::RRR_Object::RRR_Object_Obj29.Width = convertRawToPhysical(raw_value, 0.125, 0.0);

    raw_value=copyBitsFromByteArrayLE( byteArray, 15520, 12);
    @CAN_RadarRR::RRR_Object::RRR_Object_Obj29.WidthVnce = convertRawToPhysical(raw_value, 0.005, 0.0);
}


void CRadarRR_RRR_Object_Obj3_SetDataReceived(byte byteArray[])
{
    qword raw_value;

    raw_value=copyBitsFromByteArrayLE( byteArray, 2560, 32);
    @CAN_RadarRR::RRR_Object::RRR_Object_Obj3.Age = convertRawToPhysical(raw_value, 1.0, 0.0);

    raw_value=copyBitsFromByteArrayLE( byteArray, 2156, 10);
    @CAN_RadarRR::RRR_Object::RRR_Object_Obj3.Ax = convertRawToPhysical(raw_value, 0.03125, -16.0);

    raw_value=copyBitsFromByteArrayLE( byteArray, 2540, 12);
    @CAN_RadarRR::RRR_Object::RRR_Object_Obj3.AxAyCoVnce = convertRawToPhysical(raw_value, 0.005, -10.0);

    raw_value=copyBitsFromByteArrayLE( byteArray, 2176, 12);
    @CAN_RadarRR::RRR_Object::RRR_Object_Obj3.AxVnce = convertRawToPhysical(raw_value, 0.005, 0.0);

    raw_value=copyBitsFromByteArrayLE( byteArray, 2230, 9);
    @CAN_RadarRR::RRR_Object::RRR_Object_Obj3.Ay = convertRawToPhysical(raw_value, 0.0625, -16.0);

    raw_value=copyBitsFromByteArrayLE( byteArray, 2240, 12);
    @CAN_RadarRR::RRR_Object::RRR_Object_Obj3.AyVnce = convertRawToPhysical(raw_value, 0.005, 0.0);

    raw_value=copyBitsFromByteArrayLE( byteArray, 2296, 6);
    @CAN_RadarRR::RRR_Object::RRR_Object_Obj3.ExistProb = convertRawToPhysical(raw_value, 2.0, 0.0);

    raw_value=copyBitsFromByteArrayLE( byteArray, 2360, 8);
    @CAN_RadarRR::RRR_Object::RRR_Object_Obj3.FilterInformation = convertRawToPhysical(raw_value, 1.0, 0.0);

    raw_value=copyBitsFromByteArrayLE( byteArray, 2136, 7);
    @CAN_RadarRR::RRR_Object::RRR_Object_Obj3.Length = convertRawToPhysical(raw_value, 0.125, 0.0);

    raw_value=copyBitsFromByteArrayLE( byteArray, 2144, 12);
    @CAN_RadarRR::RRR_Object::RRR_Object_Obj3.LengthVnce = convertRawToPhysical(raw_value, 0.005, 0.0);

    raw_value=copyBitsFromByteArrayLE( byteArray, 2328, 3);
    @CAN_RadarRR::RRR_Object::RRR_Object_Obj3.MeasurementStatus = convertRawToPhysical(raw_value, 1.0, 0.0);

    raw_value=copyBitsFromByteArrayLE( byteArray, 2284, 2);
    @CAN_RadarRR::RRR_Object::RRR_Object_Obj3.MovingStatus = convertRawToPhysical(raw_value, 1.0, 0.0);

    raw_value=copyBitsFromByteArrayLE( byteArray, 2264, 7);
    @CAN_RadarRR::RRR_Object::RRR_Object_Obj3.ObjId = convertRawToPhysical(raw_value, 1.0, 0.0);

    raw_value=copyBitsFromByteArrayLE( byteArray, 2166, 9);
    @CAN_RadarRR::RRR_Object::RRR_Object_Obj3.OrientationYaw = convertRawToPhysical(raw_value, 0.0175, -4.48);

    raw_value=copyBitsFromByteArrayLE( byteArray, 2188, 12);
    @CAN_RadarRR::RRR_Object::RRR_Object_Obj3.OrientationYawVnce = convertRawToPhysical(raw_value, 0.0003, 0.0);

    raw_value=copyBitsFromByteArrayLE( byteArray, 2080, 6);
    @CAN_RadarRR::RRR_Object::RRR_Object_Obj3.ProbClassConfidence = convertRawToPhysical(raw_value, 2.0, 0.0);

    raw_value=copyBitsFromByteArrayLE( byteArray, 2331, 4);
    @CAN_RadarRR::RRR_Object::RRR_Object_Obj3.ProbClassType = convertRawToPhysical(raw_value, 1.0, 0.0);

    raw_value=copyBitsFromByteArrayLE( byteArray, 2086, 14);
    @CAN_RadarRR::RRR_Object::RRR_Object_Obj3.Px = convertRawToPhysical(raw_value, 0.0625, -512.0);

    raw_value=copyBitsFromByteArrayLE( byteArray, 2400, 12);
    @CAN_RadarRR::RRR_Object::RRR_Object_Obj3.PxAxCoVnce = convertRawToPhysical(raw_value, 0.005, -10.0);

    raw_value=copyBitsFromByteArrayLE( byteArray, 2412, 12);
    @CAN_RadarRR::RRR_Object::RRR_Object_Obj3.PxAyCoVnce = convertRawToPhysical(raw_value, 0.005, -10.0);

    raw_value=copyBitsFromByteArrayLE( byteArray, 2316, 12);
    @CAN_RadarRR::RRR_Object::RRR_Object_Obj3.PxPyCoVnce = convertRawToPhysical(raw_value, 0.005, -10.0);

    raw_value=copyBitsFromByteArrayLE( byteArray, 2100, 12);
    @CAN_RadarRR::RRR_Object::RRR_Object_Obj3.PxVnce = convertRawToPhysical(raw_value, 0.005, 0.0);

    raw_value=copyBitsFromByteArrayLE( byteArray, 2336, 12);
    @CAN_RadarRR::RRR_Object::RRR_Object_Obj3.PxVxCoVnce = convertRawToPhysical(raw_value, 0.005, -10.0);

    raw_value=copyBitsFromByteArrayLE( byteArray, 2348, 12);
    @CAN_RadarRR::RRR_Object::RRR_Object_Obj3.PxVyCoVnce = convertRawToPhysical(raw_value, 0.005, -10.0);

    raw_value=copyBitsFromByteArrayLE( byteArray, 2112, 12);
    @CAN_RadarRR::RRR_Object::RRR_Object_Obj3.Py = convertRawToPhysical(raw_value, 0.0625, -128.0);

    raw_value=copyBitsFromByteArrayLE( byteArray, 2432, 12);
    @CAN_RadarRR::RRR_Object::RRR_Object_Obj3.PyAxCoVnce = convertRawToPhysical(raw_value, 0.005, -10.0);

    raw_value=copyBitsFromByteArrayLE( byteArray, 2444, 12);
    @CAN_RadarRR::RRR_Object::RRR_Object_Obj3.PyAyCoVnce = convertRawToPhysical(raw_value, 0.005, -10.0);

    raw_value=copyBitsFromByteArrayLE( byteArray, 2124, 12);
    @CAN_RadarRR::RRR_Object::RRR_Object_Obj3.PyVnce = convertRawToPhysical(raw_value, 0.005, 0.0);

    raw_value=copyBitsFromByteArrayLE( byteArray, 2368, 12);
    @CAN_RadarRR::RRR_Object::RRR_Object_Obj3.PyVxCoVnce = convertRawToPhysical(raw_value, 0.005, -10.0);

    raw_value=copyBitsFromByteArrayLE( byteArray, 2380, 12);
    @CAN_RadarRR::RRR_Object::RRR_Object_Obj3.PyVyCoVnce = convertRawToPhysical(raw_value, 0.005, -10.0);

    raw_value=copyBitsFromByteArrayLE( byteArray, 2220, 10);
    @CAN_RadarRR::RRR_Object::RRR_Object_Obj3.RCS = convertRawToPhysical(raw_value, 0.2, -102.4);

    raw_value=copyBitsFromByteArrayLE( byteArray, 2392, 4);
    @CAN_RadarRR::RRR_Object::RRR_Object_Obj3.ReferencePoint = convertRawToPhysical(raw_value, 1.0, 0.0);

    raw_value=copyBitsFromByteArrayLE( byteArray, 2252, 12);
    @CAN_RadarRR::RRR_Object::RRR_Object_Obj3.Vx = convertRawToPhysical(raw_value, 0.0625, -128.0);

    raw_value=copyBitsFromByteArrayLE( byteArray, 2476, 12);
    @CAN_RadarRR::RRR_Object::RRR_Object_Obj3.VxAxCoVnce = convertRawToPhysical(raw_value, 0.005, -10.0);

    raw_value=copyBitsFromByteArrayLE( byteArray, 2496, 12);
    @CAN_RadarRR::RRR_Object::RRR_Object_Obj3.VxAyCoVnce = convertRawToPhysical(raw_value, 0.005, -10.0);

    raw_value=copyBitsFromByteArrayLE( byteArray, 2272, 12);
    @CAN_RadarRR::RRR_Object::RRR_Object_Obj3.VxVnce = convertRawToPhysical(raw_value, 0.005, 0.0);

    raw_value=copyBitsFromByteArrayLE( byteArray, 2464, 12);
    @CAN_RadarRR::RRR_Object::RRR_Object_Obj3.VxVyCoVnce = convertRawToPhysical(raw_value, 0.005, -10.0);

    raw_value=copyBitsFromByteArrayLE( byteArray, 2286, 10);
    @CAN_RadarRR::RRR_Object::RRR_Object_Obj3.Vy = convertRawToPhysical(raw_value, 0.125, -64.0);

    raw_value=copyBitsFromByteArrayLE( byteArray, 2508, 12);
    @CAN_RadarRR::RRR_Object::RRR_Object_Obj3.VyAxCoVnce = convertRawToPhysical(raw_value, 0.005, -10.0);

    raw_value=copyBitsFromByteArrayLE( byteArray, 2528, 12);
    @CAN_RadarRR::RRR_Object::RRR_Object_Obj3.VyAyCoVnce = convertRawToPhysical(raw_value, 0.005, -10.0);

    raw_value=copyBitsFromByteArrayLE( byteArray, 2304, 12);
    @CAN_RadarRR::RRR_Object::RRR_Object_Obj3.VyVnce = convertRawToPhysical(raw_value, 0.005, 0.0);

    raw_value=copyBitsFromByteArrayLE( byteArray, 2200, 7);
    @CAN_RadarRR::RRR_Object::RRR_Object_Obj3.Width = convertRawToPhysical(raw_value, 0.125, 0.0);

    raw_value=copyBitsFromByteArrayLE( byteArray, 2208, 12);
    @CAN_RadarRR::RRR_Object::RRR_Object_Obj3.WidthVnce = convertRawToPhysical(raw_value, 0.005, 0.0);
}


void CRadarRR_RRR_Object_Obj30_SetDataReceived(byte byteArray[])
{
    qword raw_value;

    raw_value=copyBitsFromByteArrayLE( byteArray, 16384, 32);
    @CAN_RadarRR::RRR_Object::RRR_Object_Obj30.Age = convertRawToPhysical(raw_value, 1.0, 0.0);

    raw_value=copyBitsFromByteArrayLE( byteArray, 15980, 10);
    @CAN_RadarRR::RRR_Object::RRR_Object_Obj30.Ax = convertRawToPhysical(raw_value, 0.03125, -16.0);

    raw_value=copyBitsFromByteArrayLE( byteArray, 16364, 12);
    @CAN_RadarRR::RRR_Object::RRR_Object_Obj30.AxAyCoVnce = convertRawToPhysical(raw_value, 0.005, -10.0);

    raw_value=copyBitsFromByteArrayLE( byteArray, 16000, 12);
    @CAN_RadarRR::RRR_Object::RRR_Object_Obj30.AxVnce = convertRawToPhysical(raw_value, 0.005, 0.0);

    raw_value=copyBitsFromByteArrayLE( byteArray, 16054, 9);
    @CAN_RadarRR::RRR_Object::RRR_Object_Obj30.Ay = convertRawToPhysical(raw_value, 0.0625, -16.0);

    raw_value=copyBitsFromByteArrayLE( byteArray, 16064, 12);
    @CAN_RadarRR::RRR_Object::RRR_Object_Obj30.AyVnce = convertRawToPhysical(raw_value, 0.005, 0.0);

    raw_value=copyBitsFromByteArrayLE( byteArray, 16120, 6);
    @CAN_RadarRR::RRR_Object::RRR_Object_Obj30.ExistProb = convertRawToPhysical(raw_value, 2.0, 0.0);

    raw_value=copyBitsFromByteArrayLE( byteArray, 16184, 8);
    @CAN_RadarRR::RRR_Object::RRR_Object_Obj30.FilterInformation = convertRawToPhysical(raw_value, 1.0, 0.0);

    raw_value=copyBitsFromByteArrayLE( byteArray, 15960, 7);
    @CAN_RadarRR::RRR_Object::RRR_Object_Obj30.Length = convertRawToPhysical(raw_value, 0.125, 0.0);

    raw_value=copyBitsFromByteArrayLE( byteArray, 15968, 12);
    @CAN_RadarRR::RRR_Object::RRR_Object_Obj30.LengthVnce = convertRawToPhysical(raw_value, 0.005, 0.0);

    raw_value=copyBitsFromByteArrayLE( byteArray, 16152, 3);
    @CAN_RadarRR::RRR_Object::RRR_Object_Obj30.MeasurementStatus = convertRawToPhysical(raw_value, 1.0, 0.0);

    raw_value=copyBitsFromByteArrayLE( byteArray, 16108, 2);
    @CAN_RadarRR::RRR_Object::RRR_Object_Obj30.MovingStatus = convertRawToPhysical(raw_value, 1.0, 0.0);

    raw_value=copyBitsFromByteArrayLE( byteArray, 16088, 7);
    @CAN_RadarRR::RRR_Object::RRR_Object_Obj30.ObjId = convertRawToPhysical(raw_value, 1.0, 0.0);

    raw_value=copyBitsFromByteArrayLE( byteArray, 15990, 9);
    @CAN_RadarRR::RRR_Object::RRR_Object_Obj30.OrientationYaw = convertRawToPhysical(raw_value, 0.0175, -4.48);

    raw_value=copyBitsFromByteArrayLE( byteArray, 16012, 12);
    @CAN_RadarRR::RRR_Object::RRR_Object_Obj30.OrientationYawVnce = convertRawToPhysical(raw_value, 0.0003, 0.0);

    raw_value=copyBitsFromByteArrayLE( byteArray, 15904, 6);
    @CAN_RadarRR::RRR_Object::RRR_Object_Obj30.ProbClassConfidence = convertRawToPhysical(raw_value, 2.0, 0.0);

    raw_value=copyBitsFromByteArrayLE( byteArray, 16155, 4);
    @CAN_RadarRR::RRR_Object::RRR_Object_Obj30.ProbClassType = convertRawToPhysical(raw_value, 1.0, 0.0);

    raw_value=copyBitsFromByteArrayLE( byteArray, 15910, 14);
    @CAN_RadarRR::RRR_Object::RRR_Object_Obj30.Px = convertRawToPhysical(raw_value, 0.0625, -512.0);

    raw_value=copyBitsFromByteArrayLE( byteArray, 16224, 12);
    @CAN_RadarRR::RRR_Object::RRR_Object_Obj30.PxAxCoVnce = convertRawToPhysical(raw_value, 0.005, -10.0);

    raw_value=copyBitsFromByteArrayLE( byteArray, 16236, 12);
    @CAN_RadarRR::RRR_Object::RRR_Object_Obj30.PxAyCoVnce = convertRawToPhysical(raw_value, 0.005, -10.0);

    raw_value=copyBitsFromByteArrayLE( byteArray, 16140, 12);
    @CAN_RadarRR::RRR_Object::RRR_Object_Obj30.PxPyCoVnce = convertRawToPhysical(raw_value, 0.005, -10.0);

    raw_value=copyBitsFromByteArrayLE( byteArray, 15924, 12);
    @CAN_RadarRR::RRR_Object::RRR_Object_Obj30.PxVnce = convertRawToPhysical(raw_value, 0.005, 0.0);

    raw_value=copyBitsFromByteArrayLE( byteArray, 16160, 12);
    @CAN_RadarRR::RRR_Object::RRR_Object_Obj30.PxVxCoVnce = convertRawToPhysical(raw_value, 0.005, -10.0);

    raw_value=copyBitsFromByteArrayLE( byteArray, 16172, 12);
    @CAN_RadarRR::RRR_Object::RRR_Object_Obj30.PxVyCoVnce = convertRawToPhysical(raw_value, 0.005, -10.0);

    raw_value=copyBitsFromByteArrayLE( byteArray, 15936, 12);
    @CAN_RadarRR::RRR_Object::RRR_Object_Obj30.Py = convertRawToPhysical(raw_value, 0.0625, -128.0);

    raw_value=copyBitsFromByteArrayLE( byteArray, 16256, 12);
    @CAN_RadarRR::RRR_Object::RRR_Object_Obj30.PyAxCoVnce = convertRawToPhysical(raw_value, 0.005, -10.0);

    raw_value=copyBitsFromByteArrayLE( byteArray, 16268, 12);
    @CAN_RadarRR::RRR_Object::RRR_Object_Obj30.PyAyCoVnce = convertRawToPhysical(raw_value, 0.005, -10.0);

    raw_value=copyBitsFromByteArrayLE( byteArray, 15948, 12);
    @CAN_RadarRR::RRR_Object::RRR_Object_Obj30.PyVnce = convertRawToPhysical(raw_value, 0.005, 0.0);

    raw_value=copyBitsFromByteArrayLE( byteArray, 16192, 12);
    @CAN_RadarRR::RRR_Object::RRR_Object_Obj30.PyVxCoVnce = convertRawToPhysical(raw_value, 0.005, -10.0);

    raw_value=copyBitsFromByteArrayLE( byteArray, 16204, 12);
    @CAN_RadarRR::RRR_Object::RRR_Object_Obj30.PyVyCoVnce = convertRawToPhysical(raw_value, 0.005, -10.0);

    raw_value=copyBitsFromByteArrayLE( byteArray, 16044, 10);
    @CAN_RadarRR::RRR_Object::RRR_Object_Obj30.RCS = convertRawToPhysical(raw_value, 0.2, -102.4);

    raw_value=copyBitsFromByteArrayLE( byteArray, 16216, 4);
    @CAN_RadarRR::RRR_Object::RRR_Object_Obj30.ReferencePoint = convertRawToPhysical(raw_value, 1.0, 0.0);

    raw_value=copyBitsFromByteArrayLE( byteArray, 16076, 12);
    @CAN_RadarRR::RRR_Object::RRR_Object_Obj30.Vx = convertRawToPhysical(raw_value, 0.0625, -128.0);

    raw_value=copyBitsFromByteArrayLE( byteArray, 16300, 12);
    @CAN_RadarRR::RRR_Object::RRR_Object_Obj30.VxAxCoVnce = convertRawToPhysical(raw_value, 0.005, -10.0);

    raw_value=copyBitsFromByteArrayLE( byteArray, 16320, 12);
    @CAN_RadarRR::RRR_Object::RRR_Object_Obj30.VxAyCoVnce = convertRawToPhysical(raw_value, 0.005, -10.0);

    raw_value=copyBitsFromByteArrayLE( byteArray, 16096, 12);
    @CAN_RadarRR::RRR_Object::RRR_Object_Obj30.VxVnce = convertRawToPhysical(raw_value, 0.005, 0.0);

    raw_value=copyBitsFromByteArrayLE( byteArray, 16288, 12);
    @CAN_RadarRR::RRR_Object::RRR_Object_Obj30.VxVyCoVnce = convertRawToPhysical(raw_value, 0.005, -10.0);

    raw_value=copyBitsFromByteArrayLE( byteArray, 16110, 10);
    @CAN_RadarRR::RRR_Object::RRR_Object_Obj30.Vy = convertRawToPhysical(raw_value, 0.125, -64.0);

    raw_value=copyBitsFromByteArrayLE( byteArray, 16332, 12);
    @CAN_RadarRR::RRR_Object::RRR_Object_Obj30.VyAxCoVnce = convertRawToPhysical(raw_value, 0.005, -10.0);

    raw_value=copyBitsFromByteArrayLE( byteArray, 16352, 12);
    @CAN_RadarRR::RRR_Object::RRR_Object_Obj30.VyAyCoVnce = convertRawToPhysical(raw_value, 0.005, -10.0);

    raw_value=copyBitsFromByteArrayLE( byteArray, 16128, 12);
    @CAN_RadarRR::RRR_Object::RRR_Object_Obj30.VyVnce = convertRawToPhysical(raw_value, 0.005, 0.0);

    raw_value=copyBitsFromByteArrayLE( byteArray, 16024, 7);
    @CAN_RadarRR::RRR_Object::RRR_Object_Obj30.Width = convertRawToPhysical(raw_value, 0.125, 0.0);

    raw_value=copyBitsFromByteArrayLE( byteArray, 16032, 12);
    @CAN_RadarRR::RRR_Object::RRR_Object_Obj30.WidthVnce = convertRawToPhysical(raw_value, 0.005, 0.0);
}


void CRadarRR_RRR_Object_Obj31_SetDataReceived(byte byteArray[])
{
    qword raw_value;

    raw_value=copyBitsFromByteArrayLE( byteArray, 16896, 32);
    @CAN_RadarRR::RRR_Object::RRR_Object_Obj31.Age = convertRawToPhysical(raw_value, 1.0, 0.0);

    raw_value=copyBitsFromByteArrayLE( byteArray, 16492, 10);
    @CAN_RadarRR::RRR_Object::RRR_Object_Obj31.Ax = convertRawToPhysical(raw_value, 0.03125, -16.0);

    raw_value=copyBitsFromByteArrayLE( byteArray, 16876, 12);
    @CAN_RadarRR::RRR_Object::RRR_Object_Obj31.AxAyCoVnce = convertRawToPhysical(raw_value, 0.005, -10.0);

    raw_value=copyBitsFromByteArrayLE( byteArray, 16512, 12);
    @CAN_RadarRR::RRR_Object::RRR_Object_Obj31.AxVnce = convertRawToPhysical(raw_value, 0.005, 0.0);

    raw_value=copyBitsFromByteArrayLE( byteArray, 16566, 9);
    @CAN_RadarRR::RRR_Object::RRR_Object_Obj31.Ay = convertRawToPhysical(raw_value, 0.0625, -16.0);

    raw_value=copyBitsFromByteArrayLE( byteArray, 16576, 12);
    @CAN_RadarRR::RRR_Object::RRR_Object_Obj31.AyVnce = convertRawToPhysical(raw_value, 0.005, 0.0);

    raw_value=copyBitsFromByteArrayLE( byteArray, 16632, 6);
    @CAN_RadarRR::RRR_Object::RRR_Object_Obj31.ExistProb = convertRawToPhysical(raw_value, 2.0, 0.0);

    raw_value=copyBitsFromByteArrayLE( byteArray, 16696, 8);
    @CAN_RadarRR::RRR_Object::RRR_Object_Obj31.FilterInformation = convertRawToPhysical(raw_value, 1.0, 0.0);

    raw_value=copyBitsFromByteArrayLE( byteArray, 16472, 7);
    @CAN_RadarRR::RRR_Object::RRR_Object_Obj31.Length = convertRawToPhysical(raw_value, 0.125, 0.0);

    raw_value=copyBitsFromByteArrayLE( byteArray, 16480, 12);
    @CAN_RadarRR::RRR_Object::RRR_Object_Obj31.LengthVnce = convertRawToPhysical(raw_value, 0.005, 0.0);

    raw_value=copyBitsFromByteArrayLE( byteArray, 16664, 3);
    @CAN_RadarRR::RRR_Object::RRR_Object_Obj31.MeasurementStatus = convertRawToPhysical(raw_value, 1.0, 0.0);

    raw_value=copyBitsFromByteArrayLE( byteArray, 16620, 2);
    @CAN_RadarRR::RRR_Object::RRR_Object_Obj31.MovingStatus = convertRawToPhysical(raw_value, 1.0, 0.0);

    raw_value=copyBitsFromByteArrayLE( byteArray, 16600, 7);
    @CAN_RadarRR::RRR_Object::RRR_Object_Obj31.ObjId = convertRawToPhysical(raw_value, 1.0, 0.0);

    raw_value=copyBitsFromByteArrayLE( byteArray, 16502, 9);
    @CAN_RadarRR::RRR_Object::RRR_Object_Obj31.OrientationYaw = convertRawToPhysical(raw_value, 0.0175, -4.48);

    raw_value=copyBitsFromByteArrayLE( byteArray, 16524, 12);
    @CAN_RadarRR::RRR_Object::RRR_Object_Obj31.OrientationYawVnce = convertRawToPhysical(raw_value, 0.0003, 0.0);

    raw_value=copyBitsFromByteArrayLE( byteArray, 16416, 6);
    @CAN_RadarRR::RRR_Object::RRR_Object_Obj31.ProbClassConfidence = convertRawToPhysical(raw_value, 2.0, 0.0);

    raw_value=copyBitsFromByteArrayLE( byteArray, 16667, 4);
    @CAN_RadarRR::RRR_Object::RRR_Object_Obj31.ProbClassType = convertRawToPhysical(raw_value, 1.0, 0.0);

    raw_value=copyBitsFromByteArrayLE( byteArray, 16422, 14);
    @CAN_RadarRR::RRR_Object::RRR_Object_Obj31.Px = convertRawToPhysical(raw_value, 0.0625, -512.0);

    raw_value=copyBitsFromByteArrayLE( byteArray, 16736, 12);
    @CAN_RadarRR::RRR_Object::RRR_Object_Obj31.PxAxCoVnce = convertRawToPhysical(raw_value, 0.005, -10.0);

    raw_value=copyBitsFromByteArrayLE( byteArray, 16748, 12);
    @CAN_RadarRR::RRR_Object::RRR_Object_Obj31.PxAyCoVnce = convertRawToPhysical(raw_value, 0.005, -10.0);

    raw_value=copyBitsFromByteArrayLE( byteArray, 16652, 12);
    @CAN_RadarRR::RRR_Object::RRR_Object_Obj31.PxPyCoVnce = convertRawToPhysical(raw_value, 0.005, -10.0);

    raw_value=copyBitsFromByteArrayLE( byteArray, 16436, 12);
    @CAN_RadarRR::RRR_Object::RRR_Object_Obj31.PxVnce = convertRawToPhysical(raw_value, 0.005, 0.0);

    raw_value=copyBitsFromByteArrayLE( byteArray, 16672, 12);
    @CAN_RadarRR::RRR_Object::RRR_Object_Obj31.PxVxCoVnce = convertRawToPhysical(raw_value, 0.005, -10.0);

    raw_value=copyBitsFromByteArrayLE( byteArray, 16684, 12);
    @CAN_RadarRR::RRR_Object::RRR_Object_Obj31.PxVyCoVnce = convertRawToPhysical(raw_value, 0.005, -10.0);

    raw_value=copyBitsFromByteArrayLE( byteArray, 16448, 12);
    @CAN_RadarRR::RRR_Object::RRR_Object_Obj31.Py = convertRawToPhysical(raw_value, 0.0625, -128.0);

    raw_value=copyBitsFromByteArrayLE( byteArray, 16768, 12);
    @CAN_RadarRR::RRR_Object::RRR_Object_Obj31.PyAxCoVnce = convertRawToPhysical(raw_value, 0.005, -10.0);

    raw_value=copyBitsFromByteArrayLE( byteArray, 16780, 12);
    @CAN_RadarRR::RRR_Object::RRR_Object_Obj31.PyAyCoVnce = convertRawToPhysical(raw_value, 0.005, -10.0);

    raw_value=copyBitsFromByteArrayLE( byteArray, 16460, 12);
    @CAN_RadarRR::RRR_Object::RRR_Object_Obj31.PyVnce = convertRawToPhysical(raw_value, 0.005, 0.0);

    raw_value=copyBitsFromByteArrayLE( byteArray, 16704, 12);
    @CAN_RadarRR::RRR_Object::RRR_Object_Obj31.PyVxCoVnce = convertRawToPhysical(raw_value, 0.005, -10.0);

    raw_value=copyBitsFromByteArrayLE( byteArray, 16716, 12);
    @CAN_RadarRR::RRR_Object::RRR_Object_Obj31.PyVyCoVnce = convertRawToPhysical(raw_value, 0.005, -10.0);

    raw_value=copyBitsFromByteArrayLE( byteArray, 16556, 10);
    @CAN_RadarRR::RRR_Object::RRR_Object_Obj31.RCS = convertRawToPhysical(raw_value, 0.2, -102.4);

    raw_value=copyBitsFromByteArrayLE( byteArray, 16728, 4);
    @CAN_RadarRR::RRR_Object::RRR_Object_Obj31.ReferencePoint = convertRawToPhysical(raw_value, 1.0, 0.0);

    raw_value=copyBitsFromByteArrayLE( byteArray, 16588, 12);
    @CAN_RadarRR::RRR_Object::RRR_Object_Obj31.Vx = convertRawToPhysical(raw_value, 0.0625, -128.0);

    raw_value=copyBitsFromByteArrayLE( byteArray, 16812, 12);
    @CAN_RadarRR::RRR_Object::RRR_Object_Obj31.VxAxCoVnce = convertRawToPhysical(raw_value, 0.005, -10.0);

    raw_value=copyBitsFromByteArrayLE( byteArray, 16832, 12);
    @CAN_RadarRR::RRR_Object::RRR_Object_Obj31.VxAyCoVnce = convertRawToPhysical(raw_value, 0.005, -10.0);

    raw_value=copyBitsFromByteArrayLE( byteArray, 16608, 12);
    @CAN_RadarRR::RRR_Object::RRR_Object_Obj31.VxVnce = convertRawToPhysical(raw_value, 0.005, 0.0);

    raw_value=copyBitsFromByteArrayLE( byteArray, 16800, 12);
    @CAN_RadarRR::RRR_Object::RRR_Object_Obj31.VxVyCoVnce = convertRawToPhysical(raw_value, 0.005, -10.0);

    raw_value=copyBitsFromByteArrayLE( byteArray, 16622, 10);
    @CAN_RadarRR::RRR_Object::RRR_Object_Obj31.Vy = convertRawToPhysical(raw_value, 0.125, -64.0);

    raw_value=copyBitsFromByteArrayLE( byteArray, 16844, 12);
    @CAN_RadarRR::RRR_Object::RRR_Object_Obj31.VyAxCoVnce = convertRawToPhysical(raw_value, 0.005, -10.0);

    raw_value=copyBitsFromByteArrayLE( byteArray, 16864, 12);
    @CAN_RadarRR::RRR_Object::RRR_Object_Obj31.VyAyCoVnce = convertRawToPhysical(raw_value, 0.005, -10.0);

    raw_value=copyBitsFromByteArrayLE( byteArray, 16640, 12);
    @CAN_RadarRR::RRR_Object::RRR_Object_Obj31.VyVnce = convertRawToPhysical(raw_value, 0.005, 0.0);

    raw_value=copyBitsFromByteArrayLE( byteArray, 16536, 7);
    @CAN_RadarRR::RRR_Object::RRR_Object_Obj31.Width = convertRawToPhysical(raw_value, 0.125, 0.0);

    raw_value=copyBitsFromByteArrayLE( byteArray, 16544, 12);
    @CAN_RadarRR::RRR_Object::RRR_Object_Obj31.WidthVnce = convertRawToPhysical(raw_value, 0.005, 0.0);
}


void CRadarRR_RRR_Object_Obj32_SetDataReceived(byte byteArray[])
{
    qword raw_value;

    raw_value=copyBitsFromByteArrayLE( byteArray, 17408, 32);
    @CAN_RadarRR::RRR_Object::RRR_Object_Obj32.Age = convertRawToPhysical(raw_value, 1.0, 0.0);

    raw_value=copyBitsFromByteArrayLE( byteArray, 17004, 10);
    @CAN_RadarRR::RRR_Object::RRR_Object_Obj32.Ax = convertRawToPhysical(raw_value, 0.03125, -16.0);

    raw_value=copyBitsFromByteArrayLE( byteArray, 17388, 12);
    @CAN_RadarRR::RRR_Object::RRR_Object_Obj32.AxAyCoVnce = convertRawToPhysical(raw_value, 0.005, -10.0);

    raw_value=copyBitsFromByteArrayLE( byteArray, 17024, 12);
    @CAN_RadarRR::RRR_Object::RRR_Object_Obj32.AxVnce = convertRawToPhysical(raw_value, 0.005, 0.0);

    raw_value=copyBitsFromByteArrayLE( byteArray, 17078, 9);
    @CAN_RadarRR::RRR_Object::RRR_Object_Obj32.Ay = convertRawToPhysical(raw_value, 0.0625, -16.0);

    raw_value=copyBitsFromByteArrayLE( byteArray, 17088, 12);
    @CAN_RadarRR::RRR_Object::RRR_Object_Obj32.AyVnce = convertRawToPhysical(raw_value, 0.005, 0.0);

    raw_value=copyBitsFromByteArrayLE( byteArray, 17144, 6);
    @CAN_RadarRR::RRR_Object::RRR_Object_Obj32.ExistProb = convertRawToPhysical(raw_value, 2.0, 0.0);

    raw_value=copyBitsFromByteArrayLE( byteArray, 17208, 8);
    @CAN_RadarRR::RRR_Object::RRR_Object_Obj32.FilterInformation = convertRawToPhysical(raw_value, 1.0, 0.0);

    raw_value=copyBitsFromByteArrayLE( byteArray, 16984, 7);
    @CAN_RadarRR::RRR_Object::RRR_Object_Obj32.Length = convertRawToPhysical(raw_value, 0.125, 0.0);

    raw_value=copyBitsFromByteArrayLE( byteArray, 16992, 12);
    @CAN_RadarRR::RRR_Object::RRR_Object_Obj32.LengthVnce = convertRawToPhysical(raw_value, 0.005, 0.0);

    raw_value=copyBitsFromByteArrayLE( byteArray, 17176, 3);
    @CAN_RadarRR::RRR_Object::RRR_Object_Obj32.MeasurementStatus = convertRawToPhysical(raw_value, 1.0, 0.0);

    raw_value=copyBitsFromByteArrayLE( byteArray, 17132, 2);
    @CAN_RadarRR::RRR_Object::RRR_Object_Obj32.MovingStatus = convertRawToPhysical(raw_value, 1.0, 0.0);

    raw_value=copyBitsFromByteArrayLE( byteArray, 17112, 7);
    @CAN_RadarRR::RRR_Object::RRR_Object_Obj32.ObjId = convertRawToPhysical(raw_value, 1.0, 0.0);

    raw_value=copyBitsFromByteArrayLE( byteArray, 17014, 9);
    @CAN_RadarRR::RRR_Object::RRR_Object_Obj32.OrientationYaw = convertRawToPhysical(raw_value, 0.0175, -4.48);

    raw_value=copyBitsFromByteArrayLE( byteArray, 17036, 12);
    @CAN_RadarRR::RRR_Object::RRR_Object_Obj32.OrientationYawVnce = convertRawToPhysical(raw_value, 0.0003, 0.0);

    raw_value=copyBitsFromByteArrayLE( byteArray, 16928, 6);
    @CAN_RadarRR::RRR_Object::RRR_Object_Obj32.ProbClassConfidence = convertRawToPhysical(raw_value, 2.0, 0.0);

    raw_value=copyBitsFromByteArrayLE( byteArray, 17179, 4);
    @CAN_RadarRR::RRR_Object::RRR_Object_Obj32.ProbClassType = convertRawToPhysical(raw_value, 1.0, 0.0);

    raw_value=copyBitsFromByteArrayLE( byteArray, 16934, 14);
    @CAN_RadarRR::RRR_Object::RRR_Object_Obj32.Px = convertRawToPhysical(raw_value, 0.0625, -512.0);

    raw_value=copyBitsFromByteArrayLE( byteArray, 17248, 12);
    @CAN_RadarRR::RRR_Object::RRR_Object_Obj32.PxAxCoVnce = convertRawToPhysical(raw_value, 0.005, -10.0);

    raw_value=copyBitsFromByteArrayLE( byteArray, 17260, 12);
    @CAN_RadarRR::RRR_Object::RRR_Object_Obj32.PxAyCoVnce = convertRawToPhysical(raw_value, 0.005, -10.0);

    raw_value=copyBitsFromByteArrayLE( byteArray, 17164, 12);
    @CAN_RadarRR::RRR_Object::RRR_Object_Obj32.PxPyCoVnce = convertRawToPhysical(raw_value, 0.005, -10.0);

    raw_value=copyBitsFromByteArrayLE( byteArray, 16948, 12);
    @CAN_RadarRR::RRR_Object::RRR_Object_Obj32.PxVnce = convertRawToPhysical(raw_value, 0.005, 0.0);

    raw_value=copyBitsFromByteArrayLE( byteArray, 17184, 12);
    @CAN_RadarRR::RRR_Object::RRR_Object_Obj32.PxVxCoVnce = convertRawToPhysical(raw_value, 0.005, -10.0);

    raw_value=copyBitsFromByteArrayLE( byteArray, 17196, 12);
    @CAN_RadarRR::RRR_Object::RRR_Object_Obj32.PxVyCoVnce = convertRawToPhysical(raw_value, 0.005, -10.0);

    raw_value=copyBitsFromByteArrayLE( byteArray, 16960, 12);
    @CAN_RadarRR::RRR_Object::RRR_Object_Obj32.Py = convertRawToPhysical(raw_value, 0.0625, -128.0);

    raw_value=copyBitsFromByteArrayLE( byteArray, 17280, 12);
    @CAN_RadarRR::RRR_Object::RRR_Object_Obj32.PyAxCoVnce = convertRawToPhysical(raw_value, 0.005, -10.0);

    raw_value=copyBitsFromByteArrayLE( byteArray, 17292, 12);
    @CAN_RadarRR::RRR_Object::RRR_Object_Obj32.PyAyCoVnce = convertRawToPhysical(raw_value, 0.005, -10.0);

    raw_value=copyBitsFromByteArrayLE( byteArray, 16972, 12);
    @CAN_RadarRR::RRR_Object::RRR_Object_Obj32.PyVnce = convertRawToPhysical(raw_value, 0.005, 0.0);

    raw_value=copyBitsFromByteArrayLE( byteArray, 17216, 12);
    @CAN_RadarRR::RRR_Object::RRR_Object_Obj32.PyVxCoVnce = convertRawToPhysical(raw_value, 0.005, -10.0);

    raw_value=copyBitsFromByteArrayLE( byteArray, 17228, 12);
    @CAN_RadarRR::RRR_Object::RRR_Object_Obj32.PyVyCoVnce = convertRawToPhysical(raw_value, 0.005, -10.0);

    raw_value=copyBitsFromByteArrayLE( byteArray, 17068, 10);
    @CAN_RadarRR::RRR_Object::RRR_Object_Obj32.RCS = convertRawToPhysical(raw_value, 0.2, -102.4);

    raw_value=copyBitsFromByteArrayLE( byteArray, 17240, 4);
    @CAN_RadarRR::RRR_Object::RRR_Object_Obj32.ReferencePoint = convertRawToPhysical(raw_value, 1.0, 0.0);

    raw_value=copyBitsFromByteArrayLE( byteArray, 17100, 12);
    @CAN_RadarRR::RRR_Object::RRR_Object_Obj32.Vx = convertRawToPhysical(raw_value, 0.0625, -128.0);

    raw_value=copyBitsFromByteArrayLE( byteArray, 17324, 12);
    @CAN_RadarRR::RRR_Object::RRR_Object_Obj32.VxAxCoVnce = convertRawToPhysical(raw_value, 0.005, -10.0);

    raw_value=copyBitsFromByteArrayLE( byteArray, 17344, 12);
    @CAN_RadarRR::RRR_Object::RRR_Object_Obj32.VxAyCoVnce = convertRawToPhysical(raw_value, 0.005, -10.0);

    raw_value=copyBitsFromByteArrayLE( byteArray, 17120, 12);
    @CAN_RadarRR::RRR_Object::RRR_Object_Obj32.VxVnce = convertRawToPhysical(raw_value, 0.005, 0.0);

    raw_value=copyBitsFromByteArrayLE( byteArray, 17312, 12);
    @CAN_RadarRR::RRR_Object::RRR_Object_Obj32.VxVyCoVnce = convertRawToPhysical(raw_value, 0.005, -10.0);

    raw_value=copyBitsFromByteArrayLE( byteArray, 17134, 10);
    @CAN_RadarRR::RRR_Object::RRR_Object_Obj32.Vy = convertRawToPhysical(raw_value, 0.125, -64.0);

    raw_value=copyBitsFromByteArrayLE( byteArray, 17356, 12);
    @CAN_RadarRR::RRR_Object::RRR_Object_Obj32.VyAxCoVnce = convertRawToPhysical(raw_value, 0.005, -10.0);

    raw_value=copyBitsFromByteArrayLE( byteArray, 17376, 12);
    @CAN_RadarRR::RRR_Object::RRR_Object_Obj32.VyAyCoVnce = convertRawToPhysical(raw_value, 0.005, -10.0);

    raw_value=copyBitsFromByteArrayLE( byteArray, 17152, 12);
    @CAN_RadarRR::RRR_Object::RRR_Object_Obj32.VyVnce = convertRawToPhysical(raw_value, 0.005, 0.0);

    raw_value=copyBitsFromByteArrayLE( byteArray, 17048, 7);
    @CAN_RadarRR::RRR_Object::RRR_Object_Obj32.Width = convertRawToPhysical(raw_value, 0.125, 0.0);

    raw_value=copyBitsFromByteArrayLE( byteArray, 17056, 12);
    @CAN_RadarRR::RRR_Object::RRR_Object_Obj32.WidthVnce = convertRawToPhysical(raw_value, 0.005, 0.0);
}


void CRadarRR_RRR_Object_Obj33_SetDataReceived(byte byteArray[])
{
    qword raw_value;

    raw_value=copyBitsFromByteArrayLE( byteArray, 17920, 32);
    @CAN_RadarRR::RRR_Object::RRR_Object_Obj33.Age = convertRawToPhysical(raw_value, 1.0, 0.0);

    raw_value=copyBitsFromByteArrayLE( byteArray, 17516, 10);
    @CAN_RadarRR::RRR_Object::RRR_Object_Obj33.Ax = convertRawToPhysical(raw_value, 0.03125, -16.0);

    raw_value=copyBitsFromByteArrayLE( byteArray, 17900, 12);
    @CAN_RadarRR::RRR_Object::RRR_Object_Obj33.AxAyCoVnce = convertRawToPhysical(raw_value, 0.005, -10.0);

    raw_value=copyBitsFromByteArrayLE( byteArray, 17536, 12);
    @CAN_RadarRR::RRR_Object::RRR_Object_Obj33.AxVnce = convertRawToPhysical(raw_value, 0.005, 0.0);

    raw_value=copyBitsFromByteArrayLE( byteArray, 17590, 9);
    @CAN_RadarRR::RRR_Object::RRR_Object_Obj33.Ay = convertRawToPhysical(raw_value, 0.0625, -16.0);

    raw_value=copyBitsFromByteArrayLE( byteArray, 17600, 12);
    @CAN_RadarRR::RRR_Object::RRR_Object_Obj33.AyVnce = convertRawToPhysical(raw_value, 0.005, 0.0);

    raw_value=copyBitsFromByteArrayLE( byteArray, 17656, 6);
    @CAN_RadarRR::RRR_Object::RRR_Object_Obj33.ExistProb = convertRawToPhysical(raw_value, 2.0, 0.0);

    raw_value=copyBitsFromByteArrayLE( byteArray, 17720, 8);
    @CAN_RadarRR::RRR_Object::RRR_Object_Obj33.FilterInformation = convertRawToPhysical(raw_value, 1.0, 0.0);

    raw_value=copyBitsFromByteArrayLE( byteArray, 17496, 7);
    @CAN_RadarRR::RRR_Object::RRR_Object_Obj33.Length = convertRawToPhysical(raw_value, 0.125, 0.0);

    raw_value=copyBitsFromByteArrayLE( byteArray, 17504, 12);
    @CAN_RadarRR::RRR_Object::RRR_Object_Obj33.LengthVnce = convertRawToPhysical(raw_value, 0.005, 0.0);

    raw_value=copyBitsFromByteArrayLE( byteArray, 17688, 3);
    @CAN_RadarRR::RRR_Object::RRR_Object_Obj33.MeasurementStatus = convertRawToPhysical(raw_value, 1.0, 0.0);

    raw_value=copyBitsFromByteArrayLE( byteArray, 17644, 2);
    @CAN_RadarRR::RRR_Object::RRR_Object_Obj33.MovingStatus = convertRawToPhysical(raw_value, 1.0, 0.0);

    raw_value=copyBitsFromByteArrayLE( byteArray, 17624, 7);
    @CAN_RadarRR::RRR_Object::RRR_Object_Obj33.ObjId = convertRawToPhysical(raw_value, 1.0, 0.0);

    raw_value=copyBitsFromByteArrayLE( byteArray, 17526, 9);
    @CAN_RadarRR::RRR_Object::RRR_Object_Obj33.OrientationYaw = convertRawToPhysical(raw_value, 0.0175, -4.48);

    raw_value=copyBitsFromByteArrayLE( byteArray, 17548, 12);
    @CAN_RadarRR::RRR_Object::RRR_Object_Obj33.OrientationYawVnce = convertRawToPhysical(raw_value, 0.0003, 0.0);

    raw_value=copyBitsFromByteArrayLE( byteArray, 17440, 6);
    @CAN_RadarRR::RRR_Object::RRR_Object_Obj33.ProbClassConfidence = convertRawToPhysical(raw_value, 2.0, 0.0);

    raw_value=copyBitsFromByteArrayLE( byteArray, 17691, 4);
    @CAN_RadarRR::RRR_Object::RRR_Object_Obj33.ProbClassType = convertRawToPhysical(raw_value, 1.0, 0.0);

    raw_value=copyBitsFromByteArrayLE( byteArray, 17446, 14);
    @CAN_RadarRR::RRR_Object::RRR_Object_Obj33.Px = convertRawToPhysical(raw_value, 0.0625, -512.0);

    raw_value=copyBitsFromByteArrayLE( byteArray, 17760, 12);
    @CAN_RadarRR::RRR_Object::RRR_Object_Obj33.PxAxCoVnce = convertRawToPhysical(raw_value, 0.005, -10.0);

    raw_value=copyBitsFromByteArrayLE( byteArray, 17772, 12);
    @CAN_RadarRR::RRR_Object::RRR_Object_Obj33.PxAyCoVnce = convertRawToPhysical(raw_value, 0.005, -10.0);

    raw_value=copyBitsFromByteArrayLE( byteArray, 17676, 12);
    @CAN_RadarRR::RRR_Object::RRR_Object_Obj33.PxPyCoVnce = convertRawToPhysical(raw_value, 0.005, -10.0);

    raw_value=copyBitsFromByteArrayLE( byteArray, 17460, 12);
    @CAN_RadarRR::RRR_Object::RRR_Object_Obj33.PxVnce = convertRawToPhysical(raw_value, 0.005, 0.0);

    raw_value=copyBitsFromByteArrayLE( byteArray, 17696, 12);
    @CAN_RadarRR::RRR_Object::RRR_Object_Obj33.PxVxCoVnce = convertRawToPhysical(raw_value, 0.005, -10.0);

    raw_value=copyBitsFromByteArrayLE( byteArray, 17708, 12);
    @CAN_RadarRR::RRR_Object::RRR_Object_Obj33.PxVyCoVnce = convertRawToPhysical(raw_value, 0.005, -10.0);

    raw_value=copyBitsFromByteArrayLE( byteArray, 17472, 12);
    @CAN_RadarRR::RRR_Object::RRR_Object_Obj33.Py = convertRawToPhysical(raw_value, 0.0625, -128.0);

    raw_value=copyBitsFromByteArrayLE( byteArray, 17792, 12);
    @CAN_RadarRR::RRR_Object::RRR_Object_Obj33.PyAxCoVnce = convertRawToPhysical(raw_value, 0.005, -10.0);

    raw_value=copyBitsFromByteArrayLE( byteArray, 17804, 12);
    @CAN_RadarRR::RRR_Object::RRR_Object_Obj33.PyAyCoVnce = convertRawToPhysical(raw_value, 0.005, -10.0);

    raw_value=copyBitsFromByteArrayLE( byteArray, 17484, 12);
    @CAN_RadarRR::RRR_Object::RRR_Object_Obj33.PyVnce = convertRawToPhysical(raw_value, 0.005, 0.0);

    raw_value=copyBitsFromByteArrayLE( byteArray, 17728, 12);
    @CAN_RadarRR::RRR_Object::RRR_Object_Obj33.PyVxCoVnce = convertRawToPhysical(raw_value, 0.005, -10.0);

    raw_value=copyBitsFromByteArrayLE( byteArray, 17740, 12);
    @CAN_RadarRR::RRR_Object::RRR_Object_Obj33.PyVyCoVnce = convertRawToPhysical(raw_value, 0.005, -10.0);

    raw_value=copyBitsFromByteArrayLE( byteArray, 17580, 10);
    @CAN_RadarRR::RRR_Object::RRR_Object_Obj33.RCS = convertRawToPhysical(raw_value, 0.2, -102.4);

    raw_value=copyBitsFromByteArrayLE( byteArray, 17752, 4);
    @CAN_RadarRR::RRR_Object::RRR_Object_Obj33.ReferencePoint = convertRawToPhysical(raw_value, 1.0, 0.0);

    raw_value=copyBitsFromByteArrayLE( byteArray, 17612, 12);
    @CAN_RadarRR::RRR_Object::RRR_Object_Obj33.Vx = convertRawToPhysical(raw_value, 0.0625, -128.0);

    raw_value=copyBitsFromByteArrayLE( byteArray, 17836, 12);
    @CAN_RadarRR::RRR_Object::RRR_Object_Obj33.VxAxCoVnce = convertRawToPhysical(raw_value, 0.005, -10.0);

    raw_value=copyBitsFromByteArrayLE( byteArray, 17856, 12);
    @CAN_RadarRR::RRR_Object::RRR_Object_Obj33.VxAyCoVnce = convertRawToPhysical(raw_value, 0.005, -10.0);

    raw_value=copyBitsFromByteArrayLE( byteArray, 17632, 12);
    @CAN_RadarRR::RRR_Object::RRR_Object_Obj33.VxVnce = convertRawToPhysical(raw_value, 0.005, 0.0);

    raw_value=copyBitsFromByteArrayLE( byteArray, 17824, 12);
    @CAN_RadarRR::RRR_Object::RRR_Object_Obj33.VxVyCoVnce = convertRawToPhysical(raw_value, 0.005, -10.0);

    raw_value=copyBitsFromByteArrayLE( byteArray, 17646, 10);
    @CAN_RadarRR::RRR_Object::RRR_Object_Obj33.Vy = convertRawToPhysical(raw_value, 0.125, -64.0);

    raw_value=copyBitsFromByteArrayLE( byteArray, 17868, 12);
    @CAN_RadarRR::RRR_Object::RRR_Object_Obj33.VyAxCoVnce = convertRawToPhysical(raw_value, 0.005, -10.0);

    raw_value=copyBitsFromByteArrayLE( byteArray, 17888, 12);
    @CAN_RadarRR::RRR_Object::RRR_Object_Obj33.VyAyCoVnce = convertRawToPhysical(raw_value, 0.005, -10.0);

    raw_value=copyBitsFromByteArrayLE( byteArray, 17664, 12);
    @CAN_RadarRR::RRR_Object::RRR_Object_Obj33.VyVnce = convertRawToPhysical(raw_value, 0.005, 0.0);

    raw_value=copyBitsFromByteArrayLE( byteArray, 17560, 7);
    @CAN_RadarRR::RRR_Object::RRR_Object_Obj33.Width = convertRawToPhysical(raw_value, 0.125, 0.0);

    raw_value=copyBitsFromByteArrayLE( byteArray, 17568, 12);
    @CAN_RadarRR::RRR_Object::RRR_Object_Obj33.WidthVnce = convertRawToPhysical(raw_value, 0.005, 0.0);
}


void CRadarRR_RRR_Object_Obj34_SetDataReceived(byte byteArray[])
{
    qword raw_value;

    raw_value=copyBitsFromByteArrayLE( byteArray, 18432, 32);
    @CAN_RadarRR::RRR_Object::RRR_Object_Obj34.Age = convertRawToPhysical(raw_value, 1.0, 0.0);

    raw_value=copyBitsFromByteArrayLE( byteArray, 18028, 10);
    @CAN_RadarRR::RRR_Object::RRR_Object_Obj34.Ax = convertRawToPhysical(raw_value, 0.03125, -16.0);

    raw_value=copyBitsFromByteArrayLE( byteArray, 18412, 12);
    @CAN_RadarRR::RRR_Object::RRR_Object_Obj34.AxAyCoVnce = convertRawToPhysical(raw_value, 0.005, -10.0);

    raw_value=copyBitsFromByteArrayLE( byteArray, 18048, 12);
    @CAN_RadarRR::RRR_Object::RRR_Object_Obj34.AxVnce = convertRawToPhysical(raw_value, 0.005, 0.0);

    raw_value=copyBitsFromByteArrayLE( byteArray, 18102, 9);
    @CAN_RadarRR::RRR_Object::RRR_Object_Obj34.Ay = convertRawToPhysical(raw_value, 0.0625, -16.0);

    raw_value=copyBitsFromByteArrayLE( byteArray, 18112, 12);
    @CAN_RadarRR::RRR_Object::RRR_Object_Obj34.AyVnce = convertRawToPhysical(raw_value, 0.005, 0.0);

    raw_value=copyBitsFromByteArrayLE( byteArray, 18168, 6);
    @CAN_RadarRR::RRR_Object::RRR_Object_Obj34.ExistProb = convertRawToPhysical(raw_value, 2.0, 0.0);

    raw_value=copyBitsFromByteArrayLE( byteArray, 18232, 8);
    @CAN_RadarRR::RRR_Object::RRR_Object_Obj34.FilterInformation = convertRawToPhysical(raw_value, 1.0, 0.0);

    raw_value=copyBitsFromByteArrayLE( byteArray, 18008, 7);
    @CAN_RadarRR::RRR_Object::RRR_Object_Obj34.Length = convertRawToPhysical(raw_value, 0.125, 0.0);

    raw_value=copyBitsFromByteArrayLE( byteArray, 18016, 12);
    @CAN_RadarRR::RRR_Object::RRR_Object_Obj34.LengthVnce = convertRawToPhysical(raw_value, 0.005, 0.0);

    raw_value=copyBitsFromByteArrayLE( byteArray, 18200, 3);
    @CAN_RadarRR::RRR_Object::RRR_Object_Obj34.MeasurementStatus = convertRawToPhysical(raw_value, 1.0, 0.0);

    raw_value=copyBitsFromByteArrayLE( byteArray, 18156, 2);
    @CAN_RadarRR::RRR_Object::RRR_Object_Obj34.MovingStatus = convertRawToPhysical(raw_value, 1.0, 0.0);

    raw_value=copyBitsFromByteArrayLE( byteArray, 18136, 7);
    @CAN_RadarRR::RRR_Object::RRR_Object_Obj34.ObjId = convertRawToPhysical(raw_value, 1.0, 0.0);

    raw_value=copyBitsFromByteArrayLE( byteArray, 18038, 9);
    @CAN_RadarRR::RRR_Object::RRR_Object_Obj34.OrientationYaw = convertRawToPhysical(raw_value, 0.0175, -4.48);

    raw_value=copyBitsFromByteArrayLE( byteArray, 18060, 12);
    @CAN_RadarRR::RRR_Object::RRR_Object_Obj34.OrientationYawVnce = convertRawToPhysical(raw_value, 0.0003, 0.0);

    raw_value=copyBitsFromByteArrayLE( byteArray, 17952, 6);
    @CAN_RadarRR::RRR_Object::RRR_Object_Obj34.ProbClassConfidence = convertRawToPhysical(raw_value, 2.0, 0.0);

    raw_value=copyBitsFromByteArrayLE( byteArray, 18203, 4);
    @CAN_RadarRR::RRR_Object::RRR_Object_Obj34.ProbClassType = convertRawToPhysical(raw_value, 1.0, 0.0);

    raw_value=copyBitsFromByteArrayLE( byteArray, 17958, 14);
    @CAN_RadarRR::RRR_Object::RRR_Object_Obj34.Px = convertRawToPhysical(raw_value, 0.0625, -512.0);

    raw_value=copyBitsFromByteArrayLE( byteArray, 18272, 12);
    @CAN_RadarRR::RRR_Object::RRR_Object_Obj34.PxAxCoVnce = convertRawToPhysical(raw_value, 0.005, -10.0);

    raw_value=copyBitsFromByteArrayLE( byteArray, 18284, 12);
    @CAN_RadarRR::RRR_Object::RRR_Object_Obj34.PxAyCoVnce = convertRawToPhysical(raw_value, 0.005, -10.0);

    raw_value=copyBitsFromByteArrayLE( byteArray, 18188, 12);
    @CAN_RadarRR::RRR_Object::RRR_Object_Obj34.PxPyCoVnce = convertRawToPhysical(raw_value, 0.005, -10.0);

    raw_value=copyBitsFromByteArrayLE( byteArray, 17972, 12);
    @CAN_RadarRR::RRR_Object::RRR_Object_Obj34.PxVnce = convertRawToPhysical(raw_value, 0.005, 0.0);

    raw_value=copyBitsFromByteArrayLE( byteArray, 18208, 12);
    @CAN_RadarRR::RRR_Object::RRR_Object_Obj34.PxVxCoVnce = convertRawToPhysical(raw_value, 0.005, -10.0);

    raw_value=copyBitsFromByteArrayLE( byteArray, 18220, 12);
    @CAN_RadarRR::RRR_Object::RRR_Object_Obj34.PxVyCoVnce = convertRawToPhysical(raw_value, 0.005, -10.0);

    raw_value=copyBitsFromByteArrayLE( byteArray, 17984, 12);
    @CAN_RadarRR::RRR_Object::RRR_Object_Obj34.Py = convertRawToPhysical(raw_value, 0.0625, -128.0);

    raw_value=copyBitsFromByteArrayLE( byteArray, 18304, 12);
    @CAN_RadarRR::RRR_Object::RRR_Object_Obj34.PyAxCoVnce = convertRawToPhysical(raw_value, 0.005, -10.0);

    raw_value=copyBitsFromByteArrayLE( byteArray, 18316, 12);
    @CAN_RadarRR::RRR_Object::RRR_Object_Obj34.PyAyCoVnce = convertRawToPhysical(raw_value, 0.005, -10.0);

    raw_value=copyBitsFromByteArrayLE( byteArray, 17996, 12);
    @CAN_RadarRR::RRR_Object::RRR_Object_Obj34.PyVnce = convertRawToPhysical(raw_value, 0.005, 0.0);

    raw_value=copyBitsFromByteArrayLE( byteArray, 18240, 12);
    @CAN_RadarRR::RRR_Object::RRR_Object_Obj34.PyVxCoVnce = convertRawToPhysical(raw_value, 0.005, -10.0);

    raw_value=copyBitsFromByteArrayLE( byteArray, 18252, 12);
    @CAN_RadarRR::RRR_Object::RRR_Object_Obj34.PyVyCoVnce = convertRawToPhysical(raw_value, 0.005, -10.0);

    raw_value=copyBitsFromByteArrayLE( byteArray, 18092, 10);
    @CAN_RadarRR::RRR_Object::RRR_Object_Obj34.RCS = convertRawToPhysical(raw_value, 0.2, -102.4);

    raw_value=copyBitsFromByteArrayLE( byteArray, 18264, 4);
    @CAN_RadarRR::RRR_Object::RRR_Object_Obj34.ReferencePoint = convertRawToPhysical(raw_value, 1.0, 0.0);

    raw_value=copyBitsFromByteArrayLE( byteArray, 18124, 12);
    @CAN_RadarRR::RRR_Object::RRR_Object_Obj34.Vx = convertRawToPhysical(raw_value, 0.0625, -128.0);

    raw_value=copyBitsFromByteArrayLE( byteArray, 18348, 12);
    @CAN_RadarRR::RRR_Object::RRR_Object_Obj34.VxAxCoVnce = convertRawToPhysical(raw_value, 0.005, -10.0);

    raw_value=copyBitsFromByteArrayLE( byteArray, 18368, 12);
    @CAN_RadarRR::RRR_Object::RRR_Object_Obj34.VxAyCoVnce = convertRawToPhysical(raw_value, 0.005, -10.0);

    raw_value=copyBitsFromByteArrayLE( byteArray, 18144, 12);
    @CAN_RadarRR::RRR_Object::RRR_Object_Obj34.VxVnce = convertRawToPhysical(raw_value, 0.005, 0.0);

    raw_value=copyBitsFromByteArrayLE( byteArray, 18336, 12);
    @CAN_RadarRR::RRR_Object::RRR_Object_Obj34.VxVyCoVnce = convertRawToPhysical(raw_value, 0.005, -10.0);

    raw_value=copyBitsFromByteArrayLE( byteArray, 18158, 10);
    @CAN_RadarRR::RRR_Object::RRR_Object_Obj34.Vy = convertRawToPhysical(raw_value, 0.125, -64.0);

    raw_value=copyBitsFromByteArrayLE( byteArray, 18380, 12);
    @CAN_RadarRR::RRR_Object::RRR_Object_Obj34.VyAxCoVnce = convertRawToPhysical(raw_value, 0.005, -10.0);

    raw_value=copyBitsFromByteArrayLE( byteArray, 18400, 12);
    @CAN_RadarRR::RRR_Object::RRR_Object_Obj34.VyAyCoVnce = convertRawToPhysical(raw_value, 0.005, -10.0);

    raw_value=copyBitsFromByteArrayLE( byteArray, 18176, 12);
    @CAN_RadarRR::RRR_Object::RRR_Object_Obj34.VyVnce = convertRawToPhysical(raw_value, 0.005, 0.0);

    raw_value=copyBitsFromByteArrayLE( byteArray, 18072, 7);
    @CAN_RadarRR::RRR_Object::RRR_Object_Obj34.Width = convertRawToPhysical(raw_value, 0.125, 0.0);

    raw_value=copyBitsFromByteArrayLE( byteArray, 18080, 12);
    @CAN_RadarRR::RRR_Object::RRR_Object_Obj34.WidthVnce = convertRawToPhysical(raw_value, 0.005, 0.0);
}


void CRadarRR_RRR_Object_Obj35_SetDataReceived(byte byteArray[])
{
    qword raw_value;

    raw_value=copyBitsFromByteArrayLE( byteArray, 18944, 32);
    @CAN_RadarRR::RRR_Object::RRR_Object_Obj35.Age = convertRawToPhysical(raw_value, 1.0, 0.0);

    raw_value=copyBitsFromByteArrayLE( byteArray, 18540, 10);
    @CAN_RadarRR::RRR_Object::RRR_Object_Obj35.Ax = convertRawToPhysical(raw_value, 0.03125, -16.0);

    raw_value=copyBitsFromByteArrayLE( byteArray, 18924, 12);
    @CAN_RadarRR::RRR_Object::RRR_Object_Obj35.AxAyCoVnce = convertRawToPhysical(raw_value, 0.005, -10.0);

    raw_value=copyBitsFromByteArrayLE( byteArray, 18560, 12);
    @CAN_RadarRR::RRR_Object::RRR_Object_Obj35.AxVnce = convertRawToPhysical(raw_value, 0.005, 0.0);

    raw_value=copyBitsFromByteArrayLE( byteArray, 18614, 9);
    @CAN_RadarRR::RRR_Object::RRR_Object_Obj35.Ay = convertRawToPhysical(raw_value, 0.0625, -16.0);

    raw_value=copyBitsFromByteArrayLE( byteArray, 18624, 12);
    @CAN_RadarRR::RRR_Object::RRR_Object_Obj35.AyVnce = convertRawToPhysical(raw_value, 0.005, 0.0);

    raw_value=copyBitsFromByteArrayLE( byteArray, 18680, 6);
    @CAN_RadarRR::RRR_Object::RRR_Object_Obj35.ExistProb = convertRawToPhysical(raw_value, 2.0, 0.0);

    raw_value=copyBitsFromByteArrayLE( byteArray, 18744, 8);
    @CAN_RadarRR::RRR_Object::RRR_Object_Obj35.FilterInformation = convertRawToPhysical(raw_value, 1.0, 0.0);

    raw_value=copyBitsFromByteArrayLE( byteArray, 18520, 7);
    @CAN_RadarRR::RRR_Object::RRR_Object_Obj35.Length = convertRawToPhysical(raw_value, 0.125, 0.0);

    raw_value=copyBitsFromByteArrayLE( byteArray, 18528, 12);
    @CAN_RadarRR::RRR_Object::RRR_Object_Obj35.LengthVnce = convertRawToPhysical(raw_value, 0.005, 0.0);

    raw_value=copyBitsFromByteArrayLE( byteArray, 18712, 3);
    @CAN_RadarRR::RRR_Object::RRR_Object_Obj35.MeasurementStatus = convertRawToPhysical(raw_value, 1.0, 0.0);

    raw_value=copyBitsFromByteArrayLE( byteArray, 18668, 2);
    @CAN_RadarRR::RRR_Object::RRR_Object_Obj35.MovingStatus = convertRawToPhysical(raw_value, 1.0, 0.0);

    raw_value=copyBitsFromByteArrayLE( byteArray, 18648, 7);
    @CAN_RadarRR::RRR_Object::RRR_Object_Obj35.ObjId = convertRawToPhysical(raw_value, 1.0, 0.0);

    raw_value=copyBitsFromByteArrayLE( byteArray, 18550, 9);
    @CAN_RadarRR::RRR_Object::RRR_Object_Obj35.OrientationYaw = convertRawToPhysical(raw_value, 0.0175, -4.48);

    raw_value=copyBitsFromByteArrayLE( byteArray, 18572, 12);
    @CAN_RadarRR::RRR_Object::RRR_Object_Obj35.OrientationYawVnce = convertRawToPhysical(raw_value, 0.0003, 0.0);

    raw_value=copyBitsFromByteArrayLE( byteArray, 18464, 6);
    @CAN_RadarRR::RRR_Object::RRR_Object_Obj35.ProbClassConfidence = convertRawToPhysical(raw_value, 2.0, 0.0);

    raw_value=copyBitsFromByteArrayLE( byteArray, 18715, 4);
    @CAN_RadarRR::RRR_Object::RRR_Object_Obj35.ProbClassType = convertRawToPhysical(raw_value, 1.0, 0.0);

    raw_value=copyBitsFromByteArrayLE( byteArray, 18470, 14);
    @CAN_RadarRR::RRR_Object::RRR_Object_Obj35.Px = convertRawToPhysical(raw_value, 0.0625, -512.0);

    raw_value=copyBitsFromByteArrayLE( byteArray, 18784, 12);
    @CAN_RadarRR::RRR_Object::RRR_Object_Obj35.PxAxCoVnce = convertRawToPhysical(raw_value, 0.005, -10.0);

    raw_value=copyBitsFromByteArrayLE( byteArray, 18796, 12);
    @CAN_RadarRR::RRR_Object::RRR_Object_Obj35.PxAyCoVnce = convertRawToPhysical(raw_value, 0.005, -10.0);

    raw_value=copyBitsFromByteArrayLE( byteArray, 18700, 12);
    @CAN_RadarRR::RRR_Object::RRR_Object_Obj35.PxPyCoVnce = convertRawToPhysical(raw_value, 0.005, -10.0);

    raw_value=copyBitsFromByteArrayLE( byteArray, 18484, 12);
    @CAN_RadarRR::RRR_Object::RRR_Object_Obj35.PxVnce = convertRawToPhysical(raw_value, 0.005, 0.0);

    raw_value=copyBitsFromByteArrayLE( byteArray, 18720, 12);
    @CAN_RadarRR::RRR_Object::RRR_Object_Obj35.PxVxCoVnce = convertRawToPhysical(raw_value, 0.005, -10.0);

    raw_value=copyBitsFromByteArrayLE( byteArray, 18732, 12);
    @CAN_RadarRR::RRR_Object::RRR_Object_Obj35.PxVyCoVnce = convertRawToPhysical(raw_value, 0.005, -10.0);

    raw_value=copyBitsFromByteArrayLE( byteArray, 18496, 12);
    @CAN_RadarRR::RRR_Object::RRR_Object_Obj35.Py = convertRawToPhysical(raw_value, 0.0625, -128.0);

    raw_value=copyBitsFromByteArrayLE( byteArray, 18816, 12);
    @CAN_RadarRR::RRR_Object::RRR_Object_Obj35.PyAxCoVnce = convertRawToPhysical(raw_value, 0.005, -10.0);

    raw_value=copyBitsFromByteArrayLE( byteArray, 18828, 12);
    @CAN_RadarRR::RRR_Object::RRR_Object_Obj35.PyAyCoVnce = convertRawToPhysical(raw_value, 0.005, -10.0);

    raw_value=copyBitsFromByteArrayLE( byteArray, 18508, 12);
    @CAN_RadarRR::RRR_Object::RRR_Object_Obj35.PyVnce = convertRawToPhysical(raw_value, 0.005, 0.0);

    raw_value=copyBitsFromByteArrayLE( byteArray, 18752, 12);
    @CAN_RadarRR::RRR_Object::RRR_Object_Obj35.PyVxCoVnce = convertRawToPhysical(raw_value, 0.005, -10.0);

    raw_value=copyBitsFromByteArrayLE( byteArray, 18764, 12);
    @CAN_RadarRR::RRR_Object::RRR_Object_Obj35.PyVyCoVnce = convertRawToPhysical(raw_value, 0.005, -10.0);

    raw_value=copyBitsFromByteArrayLE( byteArray, 18604, 10);
    @CAN_RadarRR::RRR_Object::RRR_Object_Obj35.RCS = convertRawToPhysical(raw_value, 0.2, -102.4);

    raw_value=copyBitsFromByteArrayLE( byteArray, 18776, 4);
    @CAN_RadarRR::RRR_Object::RRR_Object_Obj35.ReferencePoint = convertRawToPhysical(raw_value, 1.0, 0.0);

    raw_value=copyBitsFromByteArrayLE( byteArray, 18636, 12);
    @CAN_RadarRR::RRR_Object::RRR_Object_Obj35.Vx = convertRawToPhysical(raw_value, 0.0625, -128.0);

    raw_value=copyBitsFromByteArrayLE( byteArray, 18860, 12);
    @CAN_RadarRR::RRR_Object::RRR_Object_Obj35.VxAxCoVnce = convertRawToPhysical(raw_value, 0.005, -10.0);

    raw_value=copyBitsFromByteArrayLE( byteArray, 18880, 12);
    @CAN_RadarRR::RRR_Object::RRR_Object_Obj35.VxAyCoVnce = convertRawToPhysical(raw_value, 0.005, -10.0);

    raw_value=copyBitsFromByteArrayLE( byteArray, 18656, 12);
    @CAN_RadarRR::RRR_Object::RRR_Object_Obj35.VxVnce = convertRawToPhysical(raw_value, 0.005, 0.0);

    raw_value=copyBitsFromByteArrayLE( byteArray, 18848, 12);
    @CAN_RadarRR::RRR_Object::RRR_Object_Obj35.VxVyCoVnce = convertRawToPhysical(raw_value, 0.005, -10.0);

    raw_value=copyBitsFromByteArrayLE( byteArray, 18670, 10);
    @CAN_RadarRR::RRR_Object::RRR_Object_Obj35.Vy = convertRawToPhysical(raw_value, 0.125, -64.0);

    raw_value=copyBitsFromByteArrayLE( byteArray, 18892, 12);
    @CAN_RadarRR::RRR_Object::RRR_Object_Obj35.VyAxCoVnce = convertRawToPhysical(raw_value, 0.005, -10.0);

    raw_value=copyBitsFromByteArrayLE( byteArray, 18912, 12);
    @CAN_RadarRR::RRR_Object::RRR_Object_Obj35.VyAyCoVnce = convertRawToPhysical(raw_value, 0.005, -10.0);

    raw_value=copyBitsFromByteArrayLE( byteArray, 18688, 12);
    @CAN_RadarRR::RRR_Object::RRR_Object_Obj35.VyVnce = convertRawToPhysical(raw_value, 0.005, 0.0);

    raw_value=copyBitsFromByteArrayLE( byteArray, 18584, 7);
    @CAN_RadarRR::RRR_Object::RRR_Object_Obj35.Width = convertRawToPhysical(raw_value, 0.125, 0.0);

    raw_value=copyBitsFromByteArrayLE( byteArray, 18592, 12);
    @CAN_RadarRR::RRR_Object::RRR_Object_Obj35.WidthVnce = convertRawToPhysical(raw_value, 0.005, 0.0);
}


void CRadarRR_RRR_Object_Obj36_SetDataReceived(byte byteArray[])
{
    qword raw_value;

    raw_value=copyBitsFromByteArrayLE( byteArray, 19456, 32);
    @CAN_RadarRR::RRR_Object::RRR_Object_Obj36.Age = convertRawToPhysical(raw_value, 1.0, 0.0);

    raw_value=copyBitsFromByteArrayLE( byteArray, 19052, 10);
    @CAN_RadarRR::RRR_Object::RRR_Object_Obj36.Ax = convertRawToPhysical(raw_value, 0.03125, -16.0);

    raw_value=copyBitsFromByteArrayLE( byteArray, 19436, 12);
    @CAN_RadarRR::RRR_Object::RRR_Object_Obj36.AxAyCoVnce = convertRawToPhysical(raw_value, 0.005, -10.0);

    raw_value=copyBitsFromByteArrayLE( byteArray, 19072, 12);
    @CAN_RadarRR::RRR_Object::RRR_Object_Obj36.AxVnce = convertRawToPhysical(raw_value, 0.005, 0.0);

    raw_value=copyBitsFromByteArrayLE( byteArray, 19126, 9);
    @CAN_RadarRR::RRR_Object::RRR_Object_Obj36.Ay = convertRawToPhysical(raw_value, 0.0625, -16.0);

    raw_value=copyBitsFromByteArrayLE( byteArray, 19136, 12);
    @CAN_RadarRR::RRR_Object::RRR_Object_Obj36.AyVnce = convertRawToPhysical(raw_value, 0.005, 0.0);

    raw_value=copyBitsFromByteArrayLE( byteArray, 19192, 6);
    @CAN_RadarRR::RRR_Object::RRR_Object_Obj36.ExistProb = convertRawToPhysical(raw_value, 2.0, 0.0);

    raw_value=copyBitsFromByteArrayLE( byteArray, 19256, 8);
    @CAN_RadarRR::RRR_Object::RRR_Object_Obj36.FilterInformation = convertRawToPhysical(raw_value, 1.0, 0.0);

    raw_value=copyBitsFromByteArrayLE( byteArray, 19032, 7);
    @CAN_RadarRR::RRR_Object::RRR_Object_Obj36.Length = convertRawToPhysical(raw_value, 0.125, 0.0);

    raw_value=copyBitsFromByteArrayLE( byteArray, 19040, 12);
    @CAN_RadarRR::RRR_Object::RRR_Object_Obj36.LengthVnce = convertRawToPhysical(raw_value, 0.005, 0.0);

    raw_value=copyBitsFromByteArrayLE( byteArray, 19224, 3);
    @CAN_RadarRR::RRR_Object::RRR_Object_Obj36.MeasurementStatus = convertRawToPhysical(raw_value, 1.0, 0.0);

    raw_value=copyBitsFromByteArrayLE( byteArray, 19180, 2);
    @CAN_RadarRR::RRR_Object::RRR_Object_Obj36.MovingStatus = convertRawToPhysical(raw_value, 1.0, 0.0);

    raw_value=copyBitsFromByteArrayLE( byteArray, 19160, 7);
    @CAN_RadarRR::RRR_Object::RRR_Object_Obj36.ObjId = convertRawToPhysical(raw_value, 1.0, 0.0);

    raw_value=copyBitsFromByteArrayLE( byteArray, 19062, 9);
    @CAN_RadarRR::RRR_Object::RRR_Object_Obj36.OrientationYaw = convertRawToPhysical(raw_value, 0.0175, -4.48);

    raw_value=copyBitsFromByteArrayLE( byteArray, 19084, 12);
    @CAN_RadarRR::RRR_Object::RRR_Object_Obj36.OrientationYawVnce = convertRawToPhysical(raw_value, 0.0003, 0.0);

    raw_value=copyBitsFromByteArrayLE( byteArray, 18976, 6);
    @CAN_RadarRR::RRR_Object::RRR_Object_Obj36.ProbClassConfidence = convertRawToPhysical(raw_value, 2.0, 0.0);

    raw_value=copyBitsFromByteArrayLE( byteArray, 19227, 4);
    @CAN_RadarRR::RRR_Object::RRR_Object_Obj36.ProbClassType = convertRawToPhysical(raw_value, 1.0, 0.0);

    raw_value=copyBitsFromByteArrayLE( byteArray, 18982, 14);
    @CAN_RadarRR::RRR_Object::RRR_Object_Obj36.Px = convertRawToPhysical(raw_value, 0.0625, -512.0);

    raw_value=copyBitsFromByteArrayLE( byteArray, 19296, 12);
    @CAN_RadarRR::RRR_Object::RRR_Object_Obj36.PxAxCoVnce = convertRawToPhysical(raw_value, 0.005, -10.0);

    raw_value=copyBitsFromByteArrayLE( byteArray, 19308, 12);
    @CAN_RadarRR::RRR_Object::RRR_Object_Obj36.PxAyCoVnce = convertRawToPhysical(raw_value, 0.005, -10.0);

    raw_value=copyBitsFromByteArrayLE( byteArray, 19212, 12);
    @CAN_RadarRR::RRR_Object::RRR_Object_Obj36.PxPyCoVnce = convertRawToPhysical(raw_value, 0.005, -10.0);

    raw_value=copyBitsFromByteArrayLE( byteArray, 18996, 12);
    @CAN_RadarRR::RRR_Object::RRR_Object_Obj36.PxVnce = convertRawToPhysical(raw_value, 0.005, 0.0);

    raw_value=copyBitsFromByteArrayLE( byteArray, 19232, 12);
    @CAN_RadarRR::RRR_Object::RRR_Object_Obj36.PxVxCoVnce = convertRawToPhysical(raw_value, 0.005, -10.0);

    raw_value=copyBitsFromByteArrayLE( byteArray, 19244, 12);
    @CAN_RadarRR::RRR_Object::RRR_Object_Obj36.PxVyCoVnce = convertRawToPhysical(raw_value, 0.005, -10.0);

    raw_value=copyBitsFromByteArrayLE( byteArray, 19008, 12);
    @CAN_RadarRR::RRR_Object::RRR_Object_Obj36.Py = convertRawToPhysical(raw_value, 0.0625, -128.0);

    raw_value=copyBitsFromByteArrayLE( byteArray, 19328, 12);
    @CAN_RadarRR::RRR_Object::RRR_Object_Obj36.PyAxCoVnce = convertRawToPhysical(raw_value, 0.005, -10.0);

    raw_value=copyBitsFromByteArrayLE( byteArray, 19340, 12);
    @CAN_RadarRR::RRR_Object::RRR_Object_Obj36.PyAyCoVnce = convertRawToPhysical(raw_value, 0.005, -10.0);

    raw_value=copyBitsFromByteArrayLE( byteArray, 19020, 12);
    @CAN_RadarRR::RRR_Object::RRR_Object_Obj36.PyVnce = convertRawToPhysical(raw_value, 0.005, 0.0);

    raw_value=copyBitsFromByteArrayLE( byteArray, 19264, 12);
    @CAN_RadarRR::RRR_Object::RRR_Object_Obj36.PyVxCoVnce = convertRawToPhysical(raw_value, 0.005, -10.0);

    raw_value=copyBitsFromByteArrayLE( byteArray, 19276, 12);
    @CAN_RadarRR::RRR_Object::RRR_Object_Obj36.PyVyCoVnce = convertRawToPhysical(raw_value, 0.005, -10.0);

    raw_value=copyBitsFromByteArrayLE( byteArray, 19116, 10);
    @CAN_RadarRR::RRR_Object::RRR_Object_Obj36.RCS = convertRawToPhysical(raw_value, 0.2, -102.4);

    raw_value=copyBitsFromByteArrayLE( byteArray, 19288, 4);
    @CAN_RadarRR::RRR_Object::RRR_Object_Obj36.ReferencePoint = convertRawToPhysical(raw_value, 1.0, 0.0);

    raw_value=copyBitsFromByteArrayLE( byteArray, 19148, 12);
    @CAN_RadarRR::RRR_Object::RRR_Object_Obj36.Vx = convertRawToPhysical(raw_value, 0.0625, -128.0);

    raw_value=copyBitsFromByteArrayLE( byteArray, 19372, 12);
    @CAN_RadarRR::RRR_Object::RRR_Object_Obj36.VxAxCoVnce = convertRawToPhysical(raw_value, 0.005, -10.0);

    raw_value=copyBitsFromByteArrayLE( byteArray, 19392, 12);
    @CAN_RadarRR::RRR_Object::RRR_Object_Obj36.VxAyCoVnce = convertRawToPhysical(raw_value, 0.005, -10.0);

    raw_value=copyBitsFromByteArrayLE( byteArray, 19168, 12);
    @CAN_RadarRR::RRR_Object::RRR_Object_Obj36.VxVnce = convertRawToPhysical(raw_value, 0.005, 0.0);

    raw_value=copyBitsFromByteArrayLE( byteArray, 19360, 12);
    @CAN_RadarRR::RRR_Object::RRR_Object_Obj36.VxVyCoVnce = convertRawToPhysical(raw_value, 0.005, -10.0);

    raw_value=copyBitsFromByteArrayLE( byteArray, 19182, 10);
    @CAN_RadarRR::RRR_Object::RRR_Object_Obj36.Vy = convertRawToPhysical(raw_value, 0.125, -64.0);

    raw_value=copyBitsFromByteArrayLE( byteArray, 19404, 12);
    @CAN_RadarRR::RRR_Object::RRR_Object_Obj36.VyAxCoVnce = convertRawToPhysical(raw_value, 0.005, -10.0);

    raw_value=copyBitsFromByteArrayLE( byteArray, 19424, 12);
    @CAN_RadarRR::RRR_Object::RRR_Object_Obj36.VyAyCoVnce = convertRawToPhysical(raw_value, 0.005, -10.0);

    raw_value=copyBitsFromByteArrayLE( byteArray, 19200, 12);
    @CAN_RadarRR::RRR_Object::RRR_Object_Obj36.VyVnce = convertRawToPhysical(raw_value, 0.005, 0.0);

    raw_value=copyBitsFromByteArrayLE( byteArray, 19096, 7);
    @CAN_RadarRR::RRR_Object::RRR_Object_Obj36.Width = convertRawToPhysical(raw_value, 0.125, 0.0);

    raw_value=copyBitsFromByteArrayLE( byteArray, 19104, 12);
    @CAN_RadarRR::RRR_Object::RRR_Object_Obj36.WidthVnce = convertRawToPhysical(raw_value, 0.005, 0.0);
}


void CRadarRR_RRR_Object_Obj37_SetDataReceived(byte byteArray[])
{
    qword raw_value;

    raw_value=copyBitsFromByteArrayLE( byteArray, 19968, 32);
    @CAN_RadarRR::RRR_Object::RRR_Object_Obj37.Age = convertRawToPhysical(raw_value, 1.0, 0.0);

    raw_value=copyBitsFromByteArrayLE( byteArray, 19564, 10);
    @CAN_RadarRR::RRR_Object::RRR_Object_Obj37.Ax = convertRawToPhysical(raw_value, 0.03125, -16.0);

    raw_value=copyBitsFromByteArrayLE( byteArray, 19948, 12);
    @CAN_RadarRR::RRR_Object::RRR_Object_Obj37.AxAyCoVnce = convertRawToPhysical(raw_value, 0.005, -10.0);

    raw_value=copyBitsFromByteArrayLE( byteArray, 19584, 12);
    @CAN_RadarRR::RRR_Object::RRR_Object_Obj37.AxVnce = convertRawToPhysical(raw_value, 0.005, 0.0);

    raw_value=copyBitsFromByteArrayLE( byteArray, 19638, 9);
    @CAN_RadarRR::RRR_Object::RRR_Object_Obj37.Ay = convertRawToPhysical(raw_value, 0.0625, -16.0);

    raw_value=copyBitsFromByteArrayLE( byteArray, 19648, 12);
    @CAN_RadarRR::RRR_Object::RRR_Object_Obj37.AyVnce = convertRawToPhysical(raw_value, 0.005, 0.0);

    raw_value=copyBitsFromByteArrayLE( byteArray, 19704, 6);
    @CAN_RadarRR::RRR_Object::RRR_Object_Obj37.ExistProb = convertRawToPhysical(raw_value, 2.0, 0.0);

    raw_value=copyBitsFromByteArrayLE( byteArray, 19768, 8);
    @CAN_RadarRR::RRR_Object::RRR_Object_Obj37.FilterInformation = convertRawToPhysical(raw_value, 1.0, 0.0);

    raw_value=copyBitsFromByteArrayLE( byteArray, 19544, 7);
    @CAN_RadarRR::RRR_Object::RRR_Object_Obj37.Length = convertRawToPhysical(raw_value, 0.125, 0.0);

    raw_value=copyBitsFromByteArrayLE( byteArray, 19552, 12);
    @CAN_RadarRR::RRR_Object::RRR_Object_Obj37.LengthVnce = convertRawToPhysical(raw_value, 0.005, 0.0);

    raw_value=copyBitsFromByteArrayLE( byteArray, 19736, 3);
    @CAN_RadarRR::RRR_Object::RRR_Object_Obj37.MeasurementStatus = convertRawToPhysical(raw_value, 1.0, 0.0);

    raw_value=copyBitsFromByteArrayLE( byteArray, 19692, 2);
    @CAN_RadarRR::RRR_Object::RRR_Object_Obj37.MovingStatus = convertRawToPhysical(raw_value, 1.0, 0.0);

    raw_value=copyBitsFromByteArrayLE( byteArray, 19672, 7);
    @CAN_RadarRR::RRR_Object::RRR_Object_Obj37.ObjId = convertRawToPhysical(raw_value, 1.0, 0.0);

    raw_value=copyBitsFromByteArrayLE( byteArray, 19574, 9);
    @CAN_RadarRR::RRR_Object::RRR_Object_Obj37.OrientationYaw = convertRawToPhysical(raw_value, 0.0175, -4.48);

    raw_value=copyBitsFromByteArrayLE( byteArray, 19596, 12);
    @CAN_RadarRR::RRR_Object::RRR_Object_Obj37.OrientationYawVnce = convertRawToPhysical(raw_value, 0.0003, 0.0);

    raw_value=copyBitsFromByteArrayLE( byteArray, 19488, 6);
    @CAN_RadarRR::RRR_Object::RRR_Object_Obj37.ProbClassConfidence = convertRawToPhysical(raw_value, 2.0, 0.0);

    raw_value=copyBitsFromByteArrayLE( byteArray, 19739, 4);
    @CAN_RadarRR::RRR_Object::RRR_Object_Obj37.ProbClassType = convertRawToPhysical(raw_value, 1.0, 0.0);

    raw_value=copyBitsFromByteArrayLE( byteArray, 19494, 14);
    @CAN_RadarRR::RRR_Object::RRR_Object_Obj37.Px = convertRawToPhysical(raw_value, 0.0625, -512.0);

    raw_value=copyBitsFromByteArrayLE( byteArray, 19808, 12);
    @CAN_RadarRR::RRR_Object::RRR_Object_Obj37.PxAxCoVnce = convertRawToPhysical(raw_value, 0.005, -10.0);

    raw_value=copyBitsFromByteArrayLE( byteArray, 19820, 12);
    @CAN_RadarRR::RRR_Object::RRR_Object_Obj37.PxAyCoVnce = convertRawToPhysical(raw_value, 0.005, -10.0);

    raw_value=copyBitsFromByteArrayLE( byteArray, 19724, 12);
    @CAN_RadarRR::RRR_Object::RRR_Object_Obj37.PxPyCoVnce = convertRawToPhysical(raw_value, 0.005, -10.0);

    raw_value=copyBitsFromByteArrayLE( byteArray, 19508, 12);
    @CAN_RadarRR::RRR_Object::RRR_Object_Obj37.PxVnce = convertRawToPhysical(raw_value, 0.005, 0.0);

    raw_value=copyBitsFromByteArrayLE( byteArray, 19744, 12);
    @CAN_RadarRR::RRR_Object::RRR_Object_Obj37.PxVxCoVnce = convertRawToPhysical(raw_value, 0.005, -10.0);

    raw_value=copyBitsFromByteArrayLE( byteArray, 19756, 12);
    @CAN_RadarRR::RRR_Object::RRR_Object_Obj37.PxVyCoVnce = convertRawToPhysical(raw_value, 0.005, -10.0);

    raw_value=copyBitsFromByteArrayLE( byteArray, 19520, 12);
    @CAN_RadarRR::RRR_Object::RRR_Object_Obj37.Py = convertRawToPhysical(raw_value, 0.0625, -128.0);

    raw_value=copyBitsFromByteArrayLE( byteArray, 19840, 12);
    @CAN_RadarRR::RRR_Object::RRR_Object_Obj37.PyAxCoVnce = convertRawToPhysical(raw_value, 0.005, -10.0);

    raw_value=copyBitsFromByteArrayLE( byteArray, 19852, 12);
    @CAN_RadarRR::RRR_Object::RRR_Object_Obj37.PyAyCoVnce = convertRawToPhysical(raw_value, 0.005, -10.0);

    raw_value=copyBitsFromByteArrayLE( byteArray, 19532, 12);
    @CAN_RadarRR::RRR_Object::RRR_Object_Obj37.PyVnce = convertRawToPhysical(raw_value, 0.005, 0.0);

    raw_value=copyBitsFromByteArrayLE( byteArray, 19776, 12);
    @CAN_RadarRR::RRR_Object::RRR_Object_Obj37.PyVxCoVnce = convertRawToPhysical(raw_value, 0.005, -10.0);

    raw_value=copyBitsFromByteArrayLE( byteArray, 19788, 12);
    @CAN_RadarRR::RRR_Object::RRR_Object_Obj37.PyVyCoVnce = convertRawToPhysical(raw_value, 0.005, -10.0);

    raw_value=copyBitsFromByteArrayLE( byteArray, 19628, 10);
    @CAN_RadarRR::RRR_Object::RRR_Object_Obj37.RCS = convertRawToPhysical(raw_value, 0.2, -102.4);

    raw_value=copyBitsFromByteArrayLE( byteArray, 19800, 4);
    @CAN_RadarRR::RRR_Object::RRR_Object_Obj37.ReferencePoint = convertRawToPhysical(raw_value, 1.0, 0.0);

    raw_value=copyBitsFromByteArrayLE( byteArray, 19660, 12);
    @CAN_RadarRR::RRR_Object::RRR_Object_Obj37.Vx = convertRawToPhysical(raw_value, 0.0625, -128.0);

    raw_value=copyBitsFromByteArrayLE( byteArray, 19884, 12);
    @CAN_RadarRR::RRR_Object::RRR_Object_Obj37.VxAxCoVnce = convertRawToPhysical(raw_value, 0.005, -10.0);

    raw_value=copyBitsFromByteArrayLE( byteArray, 19904, 12);
    @CAN_RadarRR::RRR_Object::RRR_Object_Obj37.VxAyCoVnce = convertRawToPhysical(raw_value, 0.005, -10.0);

    raw_value=copyBitsFromByteArrayLE( byteArray, 19680, 12);
    @CAN_RadarRR::RRR_Object::RRR_Object_Obj37.VxVnce = convertRawToPhysical(raw_value, 0.005, 0.0);

    raw_value=copyBitsFromByteArrayLE( byteArray, 19872, 12);
    @CAN_RadarRR::RRR_Object::RRR_Object_Obj37.VxVyCoVnce = convertRawToPhysical(raw_value, 0.005, -10.0);

    raw_value=copyBitsFromByteArrayLE( byteArray, 19694, 10);
    @CAN_RadarRR::RRR_Object::RRR_Object_Obj37.Vy = convertRawToPhysical(raw_value, 0.125, -64.0);

    raw_value=copyBitsFromByteArrayLE( byteArray, 19916, 12);
    @CAN_RadarRR::RRR_Object::RRR_Object_Obj37.VyAxCoVnce = convertRawToPhysical(raw_value, 0.005, -10.0);

    raw_value=copyBitsFromByteArrayLE( byteArray, 19936, 12);
    @CAN_RadarRR::RRR_Object::RRR_Object_Obj37.VyAyCoVnce = convertRawToPhysical(raw_value, 0.005, -10.0);

    raw_value=copyBitsFromByteArrayLE( byteArray, 19712, 12);
    @CAN_RadarRR::RRR_Object::RRR_Object_Obj37.VyVnce = convertRawToPhysical(raw_value, 0.005, 0.0);

    raw_value=copyBitsFromByteArrayLE( byteArray, 19608, 7);
    @CAN_RadarRR::RRR_Object::RRR_Object_Obj37.Width = convertRawToPhysical(raw_value, 0.125, 0.0);

    raw_value=copyBitsFromByteArrayLE( byteArray, 19616, 12);
    @CAN_RadarRR::RRR_Object::RRR_Object_Obj37.WidthVnce = convertRawToPhysical(raw_value, 0.005, 0.0);
}


void CRadarRR_RRR_Object_Obj38_SetDataReceived(byte byteArray[])
{
    qword raw_value;

    raw_value=copyBitsFromByteArrayLE( byteArray, 20480, 32);
    @CAN_RadarRR::RRR_Object::RRR_Object_Obj38.Age = convertRawToPhysical(raw_value, 1.0, 0.0);

    raw_value=copyBitsFromByteArrayLE( byteArray, 20076, 10);
    @CAN_RadarRR::RRR_Object::RRR_Object_Obj38.Ax = convertRawToPhysical(raw_value, 0.03125, -16.0);

    raw_value=copyBitsFromByteArrayLE( byteArray, 20460, 12);
    @CAN_RadarRR::RRR_Object::RRR_Object_Obj38.AxAyCoVnce = convertRawToPhysical(raw_value, 0.005, -10.0);

    raw_value=copyBitsFromByteArrayLE( byteArray, 20096, 12);
    @CAN_RadarRR::RRR_Object::RRR_Object_Obj38.AxVnce = convertRawToPhysical(raw_value, 0.005, 0.0);

    raw_value=copyBitsFromByteArrayLE( byteArray, 20150, 9);
    @CAN_RadarRR::RRR_Object::RRR_Object_Obj38.Ay = convertRawToPhysical(raw_value, 0.0625, -16.0);

    raw_value=copyBitsFromByteArrayLE( byteArray, 20160, 12);
    @CAN_RadarRR::RRR_Object::RRR_Object_Obj38.AyVnce = convertRawToPhysical(raw_value, 0.005, 0.0);

    raw_value=copyBitsFromByteArrayLE( byteArray, 20216, 6);
    @CAN_RadarRR::RRR_Object::RRR_Object_Obj38.ExistProb = convertRawToPhysical(raw_value, 2.0, 0.0);

    raw_value=copyBitsFromByteArrayLE( byteArray, 20280, 8);
    @CAN_RadarRR::RRR_Object::RRR_Object_Obj38.FilterInformation = convertRawToPhysical(raw_value, 1.0, 0.0);

    raw_value=copyBitsFromByteArrayLE( byteArray, 20056, 7);
    @CAN_RadarRR::RRR_Object::RRR_Object_Obj38.Length = convertRawToPhysical(raw_value, 0.125, 0.0);

    raw_value=copyBitsFromByteArrayLE( byteArray, 20064, 12);
    @CAN_RadarRR::RRR_Object::RRR_Object_Obj38.LengthVnce = convertRawToPhysical(raw_value, 0.005, 0.0);

    raw_value=copyBitsFromByteArrayLE( byteArray, 20248, 3);
    @CAN_RadarRR::RRR_Object::RRR_Object_Obj38.MeasurementStatus = convertRawToPhysical(raw_value, 1.0, 0.0);

    raw_value=copyBitsFromByteArrayLE( byteArray, 20204, 2);
    @CAN_RadarRR::RRR_Object::RRR_Object_Obj38.MovingStatus = convertRawToPhysical(raw_value, 1.0, 0.0);

    raw_value=copyBitsFromByteArrayLE( byteArray, 20184, 7);
    @CAN_RadarRR::RRR_Object::RRR_Object_Obj38.ObjId = convertRawToPhysical(raw_value, 1.0, 0.0);

    raw_value=copyBitsFromByteArrayLE( byteArray, 20086, 9);
    @CAN_RadarRR::RRR_Object::RRR_Object_Obj38.OrientationYaw = convertRawToPhysical(raw_value, 0.0175, -4.48);

    raw_value=copyBitsFromByteArrayLE( byteArray, 20108, 12);
    @CAN_RadarRR::RRR_Object::RRR_Object_Obj38.OrientationYawVnce = convertRawToPhysical(raw_value, 0.0003, 0.0);

    raw_value=copyBitsFromByteArrayLE( byteArray, 20000, 6);
    @CAN_RadarRR::RRR_Object::RRR_Object_Obj38.ProbClassConfidence = convertRawToPhysical(raw_value, 2.0, 0.0);

    raw_value=copyBitsFromByteArrayLE( byteArray, 20251, 4);
    @CAN_RadarRR::RRR_Object::RRR_Object_Obj38.ProbClassType = convertRawToPhysical(raw_value, 1.0, 0.0);

    raw_value=copyBitsFromByteArrayLE( byteArray, 20006, 14);
    @CAN_RadarRR::RRR_Object::RRR_Object_Obj38.Px = convertRawToPhysical(raw_value, 0.0625, -512.0);

    raw_value=copyBitsFromByteArrayLE( byteArray, 20320, 12);
    @CAN_RadarRR::RRR_Object::RRR_Object_Obj38.PxAxCoVnce = convertRawToPhysical(raw_value, 0.005, -10.0);

    raw_value=copyBitsFromByteArrayLE( byteArray, 20332, 12);
    @CAN_RadarRR::RRR_Object::RRR_Object_Obj38.PxAyCoVnce = convertRawToPhysical(raw_value, 0.005, -10.0);

    raw_value=copyBitsFromByteArrayLE( byteArray, 20236, 12);
    @CAN_RadarRR::RRR_Object::RRR_Object_Obj38.PxPyCoVnce = convertRawToPhysical(raw_value, 0.005, -10.0);

    raw_value=copyBitsFromByteArrayLE( byteArray, 20020, 12);
    @CAN_RadarRR::RRR_Object::RRR_Object_Obj38.PxVnce = convertRawToPhysical(raw_value, 0.005, 0.0);

    raw_value=copyBitsFromByteArrayLE( byteArray, 20256, 12);
    @CAN_RadarRR::RRR_Object::RRR_Object_Obj38.PxVxCoVnce = convertRawToPhysical(raw_value, 0.005, -10.0);

    raw_value=copyBitsFromByteArrayLE( byteArray, 20268, 12);
    @CAN_RadarRR::RRR_Object::RRR_Object_Obj38.PxVyCoVnce = convertRawToPhysical(raw_value, 0.005, -10.0);

    raw_value=copyBitsFromByteArrayLE( byteArray, 20032, 12);
    @CAN_RadarRR::RRR_Object::RRR_Object_Obj38.Py = convertRawToPhysical(raw_value, 0.0625, -128.0);

    raw_value=copyBitsFromByteArrayLE( byteArray, 20352, 12);
    @CAN_RadarRR::RRR_Object::RRR_Object_Obj38.PyAxCoVnce = convertRawToPhysical(raw_value, 0.005, -10.0);

    raw_value=copyBitsFromByteArrayLE( byteArray, 20364, 12);
    @CAN_RadarRR::RRR_Object::RRR_Object_Obj38.PyAyCoVnce = convertRawToPhysical(raw_value, 0.005, -10.0);

    raw_value=copyBitsFromByteArrayLE( byteArray, 20044, 12);
    @CAN_RadarRR::RRR_Object::RRR_Object_Obj38.PyVnce = convertRawToPhysical(raw_value, 0.005, 0.0);

    raw_value=copyBitsFromByteArrayLE( byteArray, 20288, 12);
    @CAN_RadarRR::RRR_Object::RRR_Object_Obj38.PyVxCoVnce = convertRawToPhysical(raw_value, 0.005, -10.0);

    raw_value=copyBitsFromByteArrayLE( byteArray, 20300, 12);
    @CAN_RadarRR::RRR_Object::RRR_Object_Obj38.PyVyCoVnce = convertRawToPhysical(raw_value, 0.005, -10.0);

    raw_value=copyBitsFromByteArrayLE( byteArray, 20140, 10);
    @CAN_RadarRR::RRR_Object::RRR_Object_Obj38.RCS = convertRawToPhysical(raw_value, 0.2, -102.4);

    raw_value=copyBitsFromByteArrayLE( byteArray, 20312, 4);
    @CAN_RadarRR::RRR_Object::RRR_Object_Obj38.ReferencePoint = convertRawToPhysical(raw_value, 1.0, 0.0);

    raw_value=copyBitsFromByteArrayLE( byteArray, 20172, 12);
    @CAN_RadarRR::RRR_Object::RRR_Object_Obj38.Vx = convertRawToPhysical(raw_value, 0.0625, -128.0);

    raw_value=copyBitsFromByteArrayLE( byteArray, 20396, 12);
    @CAN_RadarRR::RRR_Object::RRR_Object_Obj38.VxAxCoVnce = convertRawToPhysical(raw_value, 0.005, -10.0);

    raw_value=copyBitsFromByteArrayLE( byteArray, 20416, 12);
    @CAN_RadarRR::RRR_Object::RRR_Object_Obj38.VxAyCoVnce = convertRawToPhysical(raw_value, 0.005, -10.0);

    raw_value=copyBitsFromByteArrayLE( byteArray, 20192, 12);
    @CAN_RadarRR::RRR_Object::RRR_Object_Obj38.VxVnce = convertRawToPhysical(raw_value, 0.005, 0.0);

    raw_value=copyBitsFromByteArrayLE( byteArray, 20384, 12);
    @CAN_RadarRR::RRR_Object::RRR_Object_Obj38.VxVyCoVnce = convertRawToPhysical(raw_value, 0.005, -10.0);

    raw_value=copyBitsFromByteArrayLE( byteArray, 20206, 10);
    @CAN_RadarRR::RRR_Object::RRR_Object_Obj38.Vy = convertRawToPhysical(raw_value, 0.125, -64.0);

    raw_value=copyBitsFromByteArrayLE( byteArray, 20428, 12);
    @CAN_RadarRR::RRR_Object::RRR_Object_Obj38.VyAxCoVnce = convertRawToPhysical(raw_value, 0.005, -10.0);

    raw_value=copyBitsFromByteArrayLE( byteArray, 20448, 12);
    @CAN_RadarRR::RRR_Object::RRR_Object_Obj38.VyAyCoVnce = convertRawToPhysical(raw_value, 0.005, -10.0);

    raw_value=copyBitsFromByteArrayLE( byteArray, 20224, 12);
    @CAN_RadarRR::RRR_Object::RRR_Object_Obj38.VyVnce = convertRawToPhysical(raw_value, 0.005, 0.0);

    raw_value=copyBitsFromByteArrayLE( byteArray, 20120, 7);
    @CAN_RadarRR::RRR_Object::RRR_Object_Obj38.Width = convertRawToPhysical(raw_value, 0.125, 0.0);

    raw_value=copyBitsFromByteArrayLE( byteArray, 20128, 12);
    @CAN_RadarRR::RRR_Object::RRR_Object_Obj38.WidthVnce = convertRawToPhysical(raw_value, 0.005, 0.0);
}


void CRadarRR_RRR_Object_Obj39_SetDataReceived(byte byteArray[])
{
    qword raw_value;

    raw_value=copyBitsFromByteArrayLE( byteArray, 20992, 32);
    @CAN_RadarRR::RRR_Object::RRR_Object_Obj39.Age = convertRawToPhysical(raw_value, 1.0, 0.0);

    raw_value=copyBitsFromByteArrayLE( byteArray, 20588, 10);
    @CAN_RadarRR::RRR_Object::RRR_Object_Obj39.Ax = convertRawToPhysical(raw_value, 0.03125, -16.0);

    raw_value=copyBitsFromByteArrayLE( byteArray, 20972, 12);
    @CAN_RadarRR::RRR_Object::RRR_Object_Obj39.AxAyCoVnce = convertRawToPhysical(raw_value, 0.005, -10.0);

    raw_value=copyBitsFromByteArrayLE( byteArray, 20608, 12);
    @CAN_RadarRR::RRR_Object::RRR_Object_Obj39.AxVnce = convertRawToPhysical(raw_value, 0.005, 0.0);

    raw_value=copyBitsFromByteArrayLE( byteArray, 20662, 9);
    @CAN_RadarRR::RRR_Object::RRR_Object_Obj39.Ay = convertRawToPhysical(raw_value, 0.0625, -16.0);

    raw_value=copyBitsFromByteArrayLE( byteArray, 20672, 12);
    @CAN_RadarRR::RRR_Object::RRR_Object_Obj39.AyVnce = convertRawToPhysical(raw_value, 0.005, 0.0);

    raw_value=copyBitsFromByteArrayLE( byteArray, 20728, 6);
    @CAN_RadarRR::RRR_Object::RRR_Object_Obj39.ExistProb = convertRawToPhysical(raw_value, 2.0, 0.0);

    raw_value=copyBitsFromByteArrayLE( byteArray, 20792, 8);
    @CAN_RadarRR::RRR_Object::RRR_Object_Obj39.FilterInformation = convertRawToPhysical(raw_value, 1.0, 0.0);

    raw_value=copyBitsFromByteArrayLE( byteArray, 20568, 7);
    @CAN_RadarRR::RRR_Object::RRR_Object_Obj39.Length = convertRawToPhysical(raw_value, 0.125, 0.0);

    raw_value=copyBitsFromByteArrayLE( byteArray, 20576, 12);
    @CAN_RadarRR::RRR_Object::RRR_Object_Obj39.LengthVnce = convertRawToPhysical(raw_value, 0.005, 0.0);

    raw_value=copyBitsFromByteArrayLE( byteArray, 20760, 3);
    @CAN_RadarRR::RRR_Object::RRR_Object_Obj39.MeasurementStatus = convertRawToPhysical(raw_value, 1.0, 0.0);

    raw_value=copyBitsFromByteArrayLE( byteArray, 20716, 2);
    @CAN_RadarRR::RRR_Object::RRR_Object_Obj39.MovingStatus = convertRawToPhysical(raw_value, 1.0, 0.0);

    raw_value=copyBitsFromByteArrayLE( byteArray, 20696, 7);
    @CAN_RadarRR::RRR_Object::RRR_Object_Obj39.ObjId = convertRawToPhysical(raw_value, 1.0, 0.0);

    raw_value=copyBitsFromByteArrayLE( byteArray, 20598, 9);
    @CAN_RadarRR::RRR_Object::RRR_Object_Obj39.OrientationYaw = convertRawToPhysical(raw_value, 0.0175, -4.48);

    raw_value=copyBitsFromByteArrayLE( byteArray, 20620, 12);
    @CAN_RadarRR::RRR_Object::RRR_Object_Obj39.OrientationYawVnce = convertRawToPhysical(raw_value, 0.0003, 0.0);

    raw_value=copyBitsFromByteArrayLE( byteArray, 20512, 6);
    @CAN_RadarRR::RRR_Object::RRR_Object_Obj39.ProbClassConfidence = convertRawToPhysical(raw_value, 2.0, 0.0);

    raw_value=copyBitsFromByteArrayLE( byteArray, 20763, 4);
    @CAN_RadarRR::RRR_Object::RRR_Object_Obj39.ProbClassType = convertRawToPhysical(raw_value, 1.0, 0.0);

    raw_value=copyBitsFromByteArrayLE( byteArray, 20518, 14);
    @CAN_RadarRR::RRR_Object::RRR_Object_Obj39.Px = convertRawToPhysical(raw_value, 0.0625, -512.0);

    raw_value=copyBitsFromByteArrayLE( byteArray, 20832, 12);
    @CAN_RadarRR::RRR_Object::RRR_Object_Obj39.PxAxCoVnce = convertRawToPhysical(raw_value, 0.005, -10.0);

    raw_value=copyBitsFromByteArrayLE( byteArray, 20844, 12);
    @CAN_RadarRR::RRR_Object::RRR_Object_Obj39.PxAyCoVnce = convertRawToPhysical(raw_value, 0.005, -10.0);

    raw_value=copyBitsFromByteArrayLE( byteArray, 20748, 12);
    @CAN_RadarRR::RRR_Object::RRR_Object_Obj39.PxPyCoVnce = convertRawToPhysical(raw_value, 0.005, -10.0);

    raw_value=copyBitsFromByteArrayLE( byteArray, 20532, 12);
    @CAN_RadarRR::RRR_Object::RRR_Object_Obj39.PxVnce = convertRawToPhysical(raw_value, 0.005, 0.0);

    raw_value=copyBitsFromByteArrayLE( byteArray, 20768, 12);
    @CAN_RadarRR::RRR_Object::RRR_Object_Obj39.PxVxCoVnce = convertRawToPhysical(raw_value, 0.005, -10.0);

    raw_value=copyBitsFromByteArrayLE( byteArray, 20780, 12);
    @CAN_RadarRR::RRR_Object::RRR_Object_Obj39.PxVyCoVnce = convertRawToPhysical(raw_value, 0.005, -10.0);

    raw_value=copyBitsFromByteArrayLE( byteArray, 20544, 12);
    @CAN_RadarRR::RRR_Object::RRR_Object_Obj39.Py = convertRawToPhysical(raw_value, 0.0625, -128.0);

    raw_value=copyBitsFromByteArrayLE( byteArray, 20864, 12);
    @CAN_RadarRR::RRR_Object::RRR_Object_Obj39.PyAxCoVnce = convertRawToPhysical(raw_value, 0.005, -10.0);

    raw_value=copyBitsFromByteArrayLE( byteArray, 20876, 12);
    @CAN_RadarRR::RRR_Object::RRR_Object_Obj39.PyAyCoVnce = convertRawToPhysical(raw_value, 0.005, -10.0);

    raw_value=copyBitsFromByteArrayLE( byteArray, 20556, 12);
    @CAN_RadarRR::RRR_Object::RRR_Object_Obj39.PyVnce = convertRawToPhysical(raw_value, 0.005, 0.0);

    raw_value=copyBitsFromByteArrayLE( byteArray, 20800, 12);
    @CAN_RadarRR::RRR_Object::RRR_Object_Obj39.PyVxCoVnce = convertRawToPhysical(raw_value, 0.005, -10.0);

    raw_value=copyBitsFromByteArrayLE( byteArray, 20812, 12);
    @CAN_RadarRR::RRR_Object::RRR_Object_Obj39.PyVyCoVnce = convertRawToPhysical(raw_value, 0.005, -10.0);

    raw_value=copyBitsFromByteArrayLE( byteArray, 20652, 10);
    @CAN_RadarRR::RRR_Object::RRR_Object_Obj39.RCS = convertRawToPhysical(raw_value, 0.2, -102.4);

    raw_value=copyBitsFromByteArrayLE( byteArray, 20824, 4);
    @CAN_RadarRR::RRR_Object::RRR_Object_Obj39.ReferencePoint = convertRawToPhysical(raw_value, 1.0, 0.0);

    raw_value=copyBitsFromByteArrayLE( byteArray, 20684, 12);
    @CAN_RadarRR::RRR_Object::RRR_Object_Obj39.Vx = convertRawToPhysical(raw_value, 0.0625, -128.0);

    raw_value=copyBitsFromByteArrayLE( byteArray, 20908, 12);
    @CAN_RadarRR::RRR_Object::RRR_Object_Obj39.VxAxCoVnce = convertRawToPhysical(raw_value, 0.005, -10.0);

    raw_value=copyBitsFromByteArrayLE( byteArray, 20928, 12);
    @CAN_RadarRR::RRR_Object::RRR_Object_Obj39.VxAyCoVnce = convertRawToPhysical(raw_value, 0.005, -10.0);

    raw_value=copyBitsFromByteArrayLE( byteArray, 20704, 12);
    @CAN_RadarRR::RRR_Object::RRR_Object_Obj39.VxVnce = convertRawToPhysical(raw_value, 0.005, 0.0);

    raw_value=copyBitsFromByteArrayLE( byteArray, 20896, 12);
    @CAN_RadarRR::RRR_Object::RRR_Object_Obj39.VxVyCoVnce = convertRawToPhysical(raw_value, 0.005, -10.0);

    raw_value=copyBitsFromByteArrayLE( byteArray, 20718, 10);
    @CAN_RadarRR::RRR_Object::RRR_Object_Obj39.Vy = convertRawToPhysical(raw_value, 0.125, -64.0);

    raw_value=copyBitsFromByteArrayLE( byteArray, 20940, 12);
    @CAN_RadarRR::RRR_Object::RRR_Object_Obj39.VyAxCoVnce = convertRawToPhysical(raw_value, 0.005, -10.0);

    raw_value=copyBitsFromByteArrayLE( byteArray, 20960, 12);
    @CAN_RadarRR::RRR_Object::RRR_Object_Obj39.VyAyCoVnce = convertRawToPhysical(raw_value, 0.005, -10.0);

    raw_value=copyBitsFromByteArrayLE( byteArray, 20736, 12);
    @CAN_RadarRR::RRR_Object::RRR_Object_Obj39.VyVnce = convertRawToPhysical(raw_value, 0.005, 0.0);

    raw_value=copyBitsFromByteArrayLE( byteArray, 20632, 7);
    @CAN_RadarRR::RRR_Object::RRR_Object_Obj39.Width = convertRawToPhysical(raw_value, 0.125, 0.0);

    raw_value=copyBitsFromByteArrayLE( byteArray, 20640, 12);
    @CAN_RadarRR::RRR_Object::RRR_Object_Obj39.WidthVnce = convertRawToPhysical(raw_value, 0.005, 0.0);
}


void CRadarRR_RRR_Object_Obj4_SetDataReceived(byte byteArray[])
{
    qword raw_value;

    raw_value=copyBitsFromByteArrayLE( byteArray, 3072, 32);
    @CAN_RadarRR::RRR_Object::RRR_Object_Obj4.Age = convertRawToPhysical(raw_value, 1.0, 0.0);

    raw_value=copyBitsFromByteArrayLE( byteArray, 2668, 10);
    @CAN_RadarRR::RRR_Object::RRR_Object_Obj4.Ax = convertRawToPhysical(raw_value, 0.03125, -16.0);

    raw_value=copyBitsFromByteArrayLE( byteArray, 3052, 12);
    @CAN_RadarRR::RRR_Object::RRR_Object_Obj4.AxAyCoVnce = convertRawToPhysical(raw_value, 0.005, -10.0);

    raw_value=copyBitsFromByteArrayLE( byteArray, 2688, 12);
    @CAN_RadarRR::RRR_Object::RRR_Object_Obj4.AxVnce = convertRawToPhysical(raw_value, 0.005, 0.0);

    raw_value=copyBitsFromByteArrayLE( byteArray, 2742, 9);
    @CAN_RadarRR::RRR_Object::RRR_Object_Obj4.Ay = convertRawToPhysical(raw_value, 0.0625, -16.0);

    raw_value=copyBitsFromByteArrayLE( byteArray, 2752, 12);
    @CAN_RadarRR::RRR_Object::RRR_Object_Obj4.AyVnce = convertRawToPhysical(raw_value, 0.005, 0.0);

    raw_value=copyBitsFromByteArrayLE( byteArray, 2808, 6);
    @CAN_RadarRR::RRR_Object::RRR_Object_Obj4.ExistProb = convertRawToPhysical(raw_value, 2.0, 0.0);

    raw_value=copyBitsFromByteArrayLE( byteArray, 2872, 8);
    @CAN_RadarRR::RRR_Object::RRR_Object_Obj4.FilterInformation = convertRawToPhysical(raw_value, 1.0, 0.0);

    raw_value=copyBitsFromByteArrayLE( byteArray, 2648, 7);
    @CAN_RadarRR::RRR_Object::RRR_Object_Obj4.Length = convertRawToPhysical(raw_value, 0.125, 0.0);

    raw_value=copyBitsFromByteArrayLE( byteArray, 2656, 12);
    @CAN_RadarRR::RRR_Object::RRR_Object_Obj4.LengthVnce = convertRawToPhysical(raw_value, 0.005, 0.0);

    raw_value=copyBitsFromByteArrayLE( byteArray, 2840, 3);
    @CAN_RadarRR::RRR_Object::RRR_Object_Obj4.MeasurementStatus = convertRawToPhysical(raw_value, 1.0, 0.0);

    raw_value=copyBitsFromByteArrayLE( byteArray, 2796, 2);
    @CAN_RadarRR::RRR_Object::RRR_Object_Obj4.MovingStatus = convertRawToPhysical(raw_value, 1.0, 0.0);

    raw_value=copyBitsFromByteArrayLE( byteArray, 2776, 7);
    @CAN_RadarRR::RRR_Object::RRR_Object_Obj4.ObjId = convertRawToPhysical(raw_value, 1.0, 0.0);

    raw_value=copyBitsFromByteArrayLE( byteArray, 2678, 9);
    @CAN_RadarRR::RRR_Object::RRR_Object_Obj4.OrientationYaw = convertRawToPhysical(raw_value, 0.0175, -4.48);

    raw_value=copyBitsFromByteArrayLE( byteArray, 2700, 12);
    @CAN_RadarRR::RRR_Object::RRR_Object_Obj4.OrientationYawVnce = convertRawToPhysical(raw_value, 0.0003, 0.0);

    raw_value=copyBitsFromByteArrayLE( byteArray, 2592, 6);
    @CAN_RadarRR::RRR_Object::RRR_Object_Obj4.ProbClassConfidence = convertRawToPhysical(raw_value, 2.0, 0.0);

    raw_value=copyBitsFromByteArrayLE( byteArray, 2843, 4);
    @CAN_RadarRR::RRR_Object::RRR_Object_Obj4.ProbClassType = convertRawToPhysical(raw_value, 1.0, 0.0);

    raw_value=copyBitsFromByteArrayLE( byteArray, 2598, 14);
    @CAN_RadarRR::RRR_Object::RRR_Object_Obj4.Px = convertRawToPhysical(raw_value, 0.0625, -512.0);

    raw_value=copyBitsFromByteArrayLE( byteArray, 2912, 12);
    @CAN_RadarRR::RRR_Object::RRR_Object_Obj4.PxAxCoVnce = convertRawToPhysical(raw_value, 0.005, -10.0);

    raw_value=copyBitsFromByteArrayLE( byteArray, 2924, 12);
    @CAN_RadarRR::RRR_Object::RRR_Object_Obj4.PxAyCoVnce = convertRawToPhysical(raw_value, 0.005, -10.0);

    raw_value=copyBitsFromByteArrayLE( byteArray, 2828, 12);
    @CAN_RadarRR::RRR_Object::RRR_Object_Obj4.PxPyCoVnce = convertRawToPhysical(raw_value, 0.005, -10.0);

    raw_value=copyBitsFromByteArrayLE( byteArray, 2612, 12);
    @CAN_RadarRR::RRR_Object::RRR_Object_Obj4.PxVnce = convertRawToPhysical(raw_value, 0.005, 0.0);

    raw_value=copyBitsFromByteArrayLE( byteArray, 2848, 12);
    @CAN_RadarRR::RRR_Object::RRR_Object_Obj4.PxVxCoVnce = convertRawToPhysical(raw_value, 0.005, -10.0);

    raw_value=copyBitsFromByteArrayLE( byteArray, 2860, 12);
    @CAN_RadarRR::RRR_Object::RRR_Object_Obj4.PxVyCoVnce = convertRawToPhysical(raw_value, 0.005, -10.0);

    raw_value=copyBitsFromByteArrayLE( byteArray, 2624, 12);
    @CAN_RadarRR::RRR_Object::RRR_Object_Obj4.Py = convertRawToPhysical(raw_value, 0.0625, -128.0);

    raw_value=copyBitsFromByteArrayLE( byteArray, 2944, 12);
    @CAN_RadarRR::RRR_Object::RRR_Object_Obj4.PyAxCoVnce = convertRawToPhysical(raw_value, 0.005, -10.0);

    raw_value=copyBitsFromByteArrayLE( byteArray, 2956, 12);
    @CAN_RadarRR::RRR_Object::RRR_Object_Obj4.PyAyCoVnce = convertRawToPhysical(raw_value, 0.005, -10.0);

    raw_value=copyBitsFromByteArrayLE( byteArray, 2636, 12);
    @CAN_RadarRR::RRR_Object::RRR_Object_Obj4.PyVnce = convertRawToPhysical(raw_value, 0.005, 0.0);

    raw_value=copyBitsFromByteArrayLE( byteArray, 2880, 12);
    @CAN_RadarRR::RRR_Object::RRR_Object_Obj4.PyVxCoVnce = convertRawToPhysical(raw_value, 0.005, -10.0);

    raw_value=copyBitsFromByteArrayLE( byteArray, 2892, 12);
    @CAN_RadarRR::RRR_Object::RRR_Object_Obj4.PyVyCoVnce = convertRawToPhysical(raw_value, 0.005, -10.0);

    raw_value=copyBitsFromByteArrayLE( byteArray, 2732, 10);
    @CAN_RadarRR::RRR_Object::RRR_Object_Obj4.RCS = convertRawToPhysical(raw_value, 0.2, -102.4);

    raw_value=copyBitsFromByteArrayLE( byteArray, 2904, 4);
    @CAN_RadarRR::RRR_Object::RRR_Object_Obj4.ReferencePoint = convertRawToPhysical(raw_value, 1.0, 0.0);

    raw_value=copyBitsFromByteArrayLE( byteArray, 2764, 12);
    @CAN_RadarRR::RRR_Object::RRR_Object_Obj4.Vx = convertRawToPhysical(raw_value, 0.0625, -128.0);

    raw_value=copyBitsFromByteArrayLE( byteArray, 2988, 12);
    @CAN_RadarRR::RRR_Object::RRR_Object_Obj4.VxAxCoVnce = convertRawToPhysical(raw_value, 0.005, -10.0);

    raw_value=copyBitsFromByteArrayLE( byteArray, 3008, 12);
    @CAN_RadarRR::RRR_Object::RRR_Object_Obj4.VxAyCoVnce = convertRawToPhysical(raw_value, 0.005, -10.0);

    raw_value=copyBitsFromByteArrayLE( byteArray, 2784, 12);
    @CAN_RadarRR::RRR_Object::RRR_Object_Obj4.VxVnce = convertRawToPhysical(raw_value, 0.005, 0.0);

    raw_value=copyBitsFromByteArrayLE( byteArray, 2976, 12);
    @CAN_RadarRR::RRR_Object::RRR_Object_Obj4.VxVyCoVnce = convertRawToPhysical(raw_value, 0.005, -10.0);

    raw_value=copyBitsFromByteArrayLE( byteArray, 2798, 10);
    @CAN_RadarRR::RRR_Object::RRR_Object_Obj4.Vy = convertRawToPhysical(raw_value, 0.125, -64.0);

    raw_value=copyBitsFromByteArrayLE( byteArray, 3020, 12);
    @CAN_RadarRR::RRR_Object::RRR_Object_Obj4.VyAxCoVnce = convertRawToPhysical(raw_value, 0.005, -10.0);

    raw_value=copyBitsFromByteArrayLE( byteArray, 3040, 12);
    @CAN_RadarRR::RRR_Object::RRR_Object_Obj4.VyAyCoVnce = convertRawToPhysical(raw_value, 0.005, -10.0);

    raw_value=copyBitsFromByteArrayLE( byteArray, 2816, 12);
    @CAN_RadarRR::RRR_Object::RRR_Object_Obj4.VyVnce = convertRawToPhysical(raw_value, 0.005, 0.0);

    raw_value=copyBitsFromByteArrayLE( byteArray, 2712, 7);
    @CAN_RadarRR::RRR_Object::RRR_Object_Obj4.Width = convertRawToPhysical(raw_value, 0.125, 0.0);

    raw_value=copyBitsFromByteArrayLE( byteArray, 2720, 12);
    @CAN_RadarRR::RRR_Object::RRR_Object_Obj4.WidthVnce = convertRawToPhysical(raw_value, 0.005, 0.0);
}


void CRadarRR_RRR_Object_Obj40_SetDataReceived(byte byteArray[])
{
    qword raw_value;

    raw_value=copyBitsFromByteArrayLE( byteArray, 21504, 32);
    @CAN_RadarRR::RRR_Object::RRR_Object_Obj40.Age = convertRawToPhysical(raw_value, 1.0, 0.0);

    raw_value=copyBitsFromByteArrayLE( byteArray, 21100, 10);
    @CAN_RadarRR::RRR_Object::RRR_Object_Obj40.Ax = convertRawToPhysical(raw_value, 0.03125, -16.0);

    raw_value=copyBitsFromByteArrayLE( byteArray, 21484, 12);
    @CAN_RadarRR::RRR_Object::RRR_Object_Obj40.AxAyCoVnce = convertRawToPhysical(raw_value, 0.005, -10.0);

    raw_value=copyBitsFromByteArrayLE( byteArray, 21120, 12);
    @CAN_RadarRR::RRR_Object::RRR_Object_Obj40.AxVnce = convertRawToPhysical(raw_value, 0.005, 0.0);

    raw_value=copyBitsFromByteArrayLE( byteArray, 21174, 9);
    @CAN_RadarRR::RRR_Object::RRR_Object_Obj40.Ay = convertRawToPhysical(raw_value, 0.0625, -16.0);

    raw_value=copyBitsFromByteArrayLE( byteArray, 21184, 12);
    @CAN_RadarRR::RRR_Object::RRR_Object_Obj40.AyVnce = convertRawToPhysical(raw_value, 0.005, 0.0);

    raw_value=copyBitsFromByteArrayLE( byteArray, 21240, 6);
    @CAN_RadarRR::RRR_Object::RRR_Object_Obj40.ExistProb = convertRawToPhysical(raw_value, 2.0, 0.0);

    raw_value=copyBitsFromByteArrayLE( byteArray, 21304, 8);
    @CAN_RadarRR::RRR_Object::RRR_Object_Obj40.FilterInformation = convertRawToPhysical(raw_value, 1.0, 0.0);

    raw_value=copyBitsFromByteArrayLE( byteArray, 21080, 7);
    @CAN_RadarRR::RRR_Object::RRR_Object_Obj40.Length = convertRawToPhysical(raw_value, 0.125, 0.0);

    raw_value=copyBitsFromByteArrayLE( byteArray, 21088, 12);
    @CAN_RadarRR::RRR_Object::RRR_Object_Obj40.LengthVnce = convertRawToPhysical(raw_value, 0.005, 0.0);

    raw_value=copyBitsFromByteArrayLE( byteArray, 21272, 3);
    @CAN_RadarRR::RRR_Object::RRR_Object_Obj40.MeasurementStatus = convertRawToPhysical(raw_value, 1.0, 0.0);

    raw_value=copyBitsFromByteArrayLE( byteArray, 21228, 2);
    @CAN_RadarRR::RRR_Object::RRR_Object_Obj40.MovingStatus = convertRawToPhysical(raw_value, 1.0, 0.0);

    raw_value=copyBitsFromByteArrayLE( byteArray, 21208, 7);
    @CAN_RadarRR::RRR_Object::RRR_Object_Obj40.ObjId = convertRawToPhysical(raw_value, 1.0, 0.0);

    raw_value=copyBitsFromByteArrayLE( byteArray, 21110, 9);
    @CAN_RadarRR::RRR_Object::RRR_Object_Obj40.OrientationYaw = convertRawToPhysical(raw_value, 0.0175, -4.48);

    raw_value=copyBitsFromByteArrayLE( byteArray, 21132, 12);
    @CAN_RadarRR::RRR_Object::RRR_Object_Obj40.OrientationYawVnce = convertRawToPhysical(raw_value, 0.0003, 0.0);

    raw_value=copyBitsFromByteArrayLE( byteArray, 21024, 6);
    @CAN_RadarRR::RRR_Object::RRR_Object_Obj40.ProbClassConfidence = convertRawToPhysical(raw_value, 2.0, 0.0);

    raw_value=copyBitsFromByteArrayLE( byteArray, 21275, 4);
    @CAN_RadarRR::RRR_Object::RRR_Object_Obj40.ProbClassType = convertRawToPhysical(raw_value, 1.0, 0.0);

    raw_value=copyBitsFromByteArrayLE( byteArray, 21030, 14);
    @CAN_RadarRR::RRR_Object::RRR_Object_Obj40.Px = convertRawToPhysical(raw_value, 0.0625, -512.0);

    raw_value=copyBitsFromByteArrayLE( byteArray, 21344, 12);
    @CAN_RadarRR::RRR_Object::RRR_Object_Obj40.PxAxCoVnce = convertRawToPhysical(raw_value, 0.005, -10.0);

    raw_value=copyBitsFromByteArrayLE( byteArray, 21356, 12);
    @CAN_RadarRR::RRR_Object::RRR_Object_Obj40.PxAyCoVnce = convertRawToPhysical(raw_value, 0.005, -10.0);

    raw_value=copyBitsFromByteArrayLE( byteArray, 21260, 12);
    @CAN_RadarRR::RRR_Object::RRR_Object_Obj40.PxPyCoVnce = convertRawToPhysical(raw_value, 0.005, -10.0);

    raw_value=copyBitsFromByteArrayLE( byteArray, 21044, 12);
    @CAN_RadarRR::RRR_Object::RRR_Object_Obj40.PxVnce = convertRawToPhysical(raw_value, 0.005, 0.0);

    raw_value=copyBitsFromByteArrayLE( byteArray, 21280, 12);
    @CAN_RadarRR::RRR_Object::RRR_Object_Obj40.PxVxCoVnce = convertRawToPhysical(raw_value, 0.005, -10.0);

    raw_value=copyBitsFromByteArrayLE( byteArray, 21292, 12);
    @CAN_RadarRR::RRR_Object::RRR_Object_Obj40.PxVyCoVnce = convertRawToPhysical(raw_value, 0.005, -10.0);

    raw_value=copyBitsFromByteArrayLE( byteArray, 21056, 12);
    @CAN_RadarRR::RRR_Object::RRR_Object_Obj40.Py = convertRawToPhysical(raw_value, 0.0625, -128.0);

    raw_value=copyBitsFromByteArrayLE( byteArray, 21376, 12);
    @CAN_RadarRR::RRR_Object::RRR_Object_Obj40.PyAxCoVnce = convertRawToPhysical(raw_value, 0.005, -10.0);

    raw_value=copyBitsFromByteArrayLE( byteArray, 21388, 12);
    @CAN_RadarRR::RRR_Object::RRR_Object_Obj40.PyAyCoVnce = convertRawToPhysical(raw_value, 0.005, -10.0);

    raw_value=copyBitsFromByteArrayLE( byteArray, 21068, 12);
    @CAN_RadarRR::RRR_Object::RRR_Object_Obj40.PyVnce = convertRawToPhysical(raw_value, 0.005, 0.0);

    raw_value=copyBitsFromByteArrayLE( byteArray, 21312, 12);
    @CAN_RadarRR::RRR_Object::RRR_Object_Obj40.PyVxCoVnce = convertRawToPhysical(raw_value, 0.005, -10.0);

    raw_value=copyBitsFromByteArrayLE( byteArray, 21324, 12);
    @CAN_RadarRR::RRR_Object::RRR_Object_Obj40.PyVyCoVnce = convertRawToPhysical(raw_value, 0.005, -10.0);

    raw_value=copyBitsFromByteArrayLE( byteArray, 21164, 10);
    @CAN_RadarRR::RRR_Object::RRR_Object_Obj40.RCS = convertRawToPhysical(raw_value, 0.2, -102.4);

    raw_value=copyBitsFromByteArrayLE( byteArray, 21336, 4);
    @CAN_RadarRR::RRR_Object::RRR_Object_Obj40.ReferencePoint = convertRawToPhysical(raw_value, 1.0, 0.0);

    raw_value=copyBitsFromByteArrayLE( byteArray, 21196, 12);
    @CAN_RadarRR::RRR_Object::RRR_Object_Obj40.Vx = convertRawToPhysical(raw_value, 0.0625, -128.0);

    raw_value=copyBitsFromByteArrayLE( byteArray, 21420, 12);
    @CAN_RadarRR::RRR_Object::RRR_Object_Obj40.VxAxCoVnce = convertRawToPhysical(raw_value, 0.005, -10.0);

    raw_value=copyBitsFromByteArrayLE( byteArray, 21440, 12);
    @CAN_RadarRR::RRR_Object::RRR_Object_Obj40.VxAyCoVnce = convertRawToPhysical(raw_value, 0.005, -10.0);

    raw_value=copyBitsFromByteArrayLE( byteArray, 21216, 12);
    @CAN_RadarRR::RRR_Object::RRR_Object_Obj40.VxVnce = convertRawToPhysical(raw_value, 0.005, 0.0);

    raw_value=copyBitsFromByteArrayLE( byteArray, 21408, 12);
    @CAN_RadarRR::RRR_Object::RRR_Object_Obj40.VxVyCoVnce = convertRawToPhysical(raw_value, 0.005, -10.0);

    raw_value=copyBitsFromByteArrayLE( byteArray, 21230, 10);
    @CAN_RadarRR::RRR_Object::RRR_Object_Obj40.Vy = convertRawToPhysical(raw_value, 0.125, -64.0);

    raw_value=copyBitsFromByteArrayLE( byteArray, 21452, 12);
    @CAN_RadarRR::RRR_Object::RRR_Object_Obj40.VyAxCoVnce = convertRawToPhysical(raw_value, 0.005, -10.0);

    raw_value=copyBitsFromByteArrayLE( byteArray, 21472, 12);
    @CAN_RadarRR::RRR_Object::RRR_Object_Obj40.VyAyCoVnce = convertRawToPhysical(raw_value, 0.005, -10.0);

    raw_value=copyBitsFromByteArrayLE( byteArray, 21248, 12);
    @CAN_RadarRR::RRR_Object::RRR_Object_Obj40.VyVnce = convertRawToPhysical(raw_value, 0.005, 0.0);

    raw_value=copyBitsFromByteArrayLE( byteArray, 21144, 7);
    @CAN_RadarRR::RRR_Object::RRR_Object_Obj40.Width = convertRawToPhysical(raw_value, 0.125, 0.0);

    raw_value=copyBitsFromByteArrayLE( byteArray, 21152, 12);
    @CAN_RadarRR::RRR_Object::RRR_Object_Obj40.WidthVnce = convertRawToPhysical(raw_value, 0.005, 0.0);
}


void CRadarRR_RRR_Object_Obj41_SetDataReceived(byte byteArray[])
{
    qword raw_value;

    raw_value=copyBitsFromByteArrayLE( byteArray, 22016, 32);
    @CAN_RadarRR::RRR_Object::RRR_Object_Obj41.Age = convertRawToPhysical(raw_value, 1.0, 0.0);

    raw_value=copyBitsFromByteArrayLE( byteArray, 21612, 10);
    @CAN_RadarRR::RRR_Object::RRR_Object_Obj41.Ax = convertRawToPhysical(raw_value, 0.03125, -16.0);

    raw_value=copyBitsFromByteArrayLE( byteArray, 21996, 12);
    @CAN_RadarRR::RRR_Object::RRR_Object_Obj41.AxAyCoVnce = convertRawToPhysical(raw_value, 0.005, -10.0);

    raw_value=copyBitsFromByteArrayLE( byteArray, 21632, 12);
    @CAN_RadarRR::RRR_Object::RRR_Object_Obj41.AxVnce = convertRawToPhysical(raw_value, 0.005, 0.0);

    raw_value=copyBitsFromByteArrayLE( byteArray, 21686, 9);
    @CAN_RadarRR::RRR_Object::RRR_Object_Obj41.Ay = convertRawToPhysical(raw_value, 0.0625, -16.0);

    raw_value=copyBitsFromByteArrayLE( byteArray, 21696, 12);
    @CAN_RadarRR::RRR_Object::RRR_Object_Obj41.AyVnce = convertRawToPhysical(raw_value, 0.005, 0.0);

    raw_value=copyBitsFromByteArrayLE( byteArray, 21752, 6);
    @CAN_RadarRR::RRR_Object::RRR_Object_Obj41.ExistProb = convertRawToPhysical(raw_value, 2.0, 0.0);

    raw_value=copyBitsFromByteArrayLE( byteArray, 21816, 8);
    @CAN_RadarRR::RRR_Object::RRR_Object_Obj41.FilterInformation = convertRawToPhysical(raw_value, 1.0, 0.0);

    raw_value=copyBitsFromByteArrayLE( byteArray, 21592, 7);
    @CAN_RadarRR::RRR_Object::RRR_Object_Obj41.Length = convertRawToPhysical(raw_value, 0.125, 0.0);

    raw_value=copyBitsFromByteArrayLE( byteArray, 21600, 12);
    @CAN_RadarRR::RRR_Object::RRR_Object_Obj41.LengthVnce = convertRawToPhysical(raw_value, 0.005, 0.0);

    raw_value=copyBitsFromByteArrayLE( byteArray, 21784, 3);
    @CAN_RadarRR::RRR_Object::RRR_Object_Obj41.MeasurementStatus = convertRawToPhysical(raw_value, 1.0, 0.0);

    raw_value=copyBitsFromByteArrayLE( byteArray, 21740, 2);
    @CAN_RadarRR::RRR_Object::RRR_Object_Obj41.MovingStatus = convertRawToPhysical(raw_value, 1.0, 0.0);

    raw_value=copyBitsFromByteArrayLE( byteArray, 21720, 7);
    @CAN_RadarRR::RRR_Object::RRR_Object_Obj41.ObjId = convertRawToPhysical(raw_value, 1.0, 0.0);

    raw_value=copyBitsFromByteArrayLE( byteArray, 21622, 9);
    @CAN_RadarRR::RRR_Object::RRR_Object_Obj41.OrientationYaw = convertRawToPhysical(raw_value, 0.0175, -4.48);

    raw_value=copyBitsFromByteArrayLE( byteArray, 21644, 12);
    @CAN_RadarRR::RRR_Object::RRR_Object_Obj41.OrientationYawVnce = convertRawToPhysical(raw_value, 0.0003, 0.0);

    raw_value=copyBitsFromByteArrayLE( byteArray, 21536, 6);
    @CAN_RadarRR::RRR_Object::RRR_Object_Obj41.ProbClassConfidence = convertRawToPhysical(raw_value, 2.0, 0.0);

    raw_value=copyBitsFromByteArrayLE( byteArray, 21787, 4);
    @CAN_RadarRR::RRR_Object::RRR_Object_Obj41.ProbClassType = convertRawToPhysical(raw_value, 1.0, 0.0);

    raw_value=copyBitsFromByteArrayLE( byteArray, 21542, 14);
    @CAN_RadarRR::RRR_Object::RRR_Object_Obj41.Px = convertRawToPhysical(raw_value, 0.0625, -512.0);

    raw_value=copyBitsFromByteArrayLE( byteArray, 21856, 12);
    @CAN_RadarRR::RRR_Object::RRR_Object_Obj41.PxAxCoVnce = convertRawToPhysical(raw_value, 0.005, -10.0);

    raw_value=copyBitsFromByteArrayLE( byteArray, 21868, 12);
    @CAN_RadarRR::RRR_Object::RRR_Object_Obj41.PxAyCoVnce = convertRawToPhysical(raw_value, 0.005, -10.0);

    raw_value=copyBitsFromByteArrayLE( byteArray, 21772, 12);
    @CAN_RadarRR::RRR_Object::RRR_Object_Obj41.PxPyCoVnce = convertRawToPhysical(raw_value, 0.005, -10.0);

    raw_value=copyBitsFromByteArrayLE( byteArray, 21556, 12);
    @CAN_RadarRR::RRR_Object::RRR_Object_Obj41.PxVnce = convertRawToPhysical(raw_value, 0.005, 0.0);

    raw_value=copyBitsFromByteArrayLE( byteArray, 21792, 12);
    @CAN_RadarRR::RRR_Object::RRR_Object_Obj41.PxVxCoVnce = convertRawToPhysical(raw_value, 0.005, -10.0);

    raw_value=copyBitsFromByteArrayLE( byteArray, 21804, 12);
    @CAN_RadarRR::RRR_Object::RRR_Object_Obj41.PxVyCoVnce = convertRawToPhysical(raw_value, 0.005, -10.0);

    raw_value=copyBitsFromByteArrayLE( byteArray, 21568, 12);
    @CAN_RadarRR::RRR_Object::RRR_Object_Obj41.Py = convertRawToPhysical(raw_value, 0.0625, -128.0);

    raw_value=copyBitsFromByteArrayLE( byteArray, 21888, 12);
    @CAN_RadarRR::RRR_Object::RRR_Object_Obj41.PyAxCoVnce = convertRawToPhysical(raw_value, 0.005, -10.0);

    raw_value=copyBitsFromByteArrayLE( byteArray, 21900, 12);
    @CAN_RadarRR::RRR_Object::RRR_Object_Obj41.PyAyCoVnce = convertRawToPhysical(raw_value, 0.005, -10.0);

    raw_value=copyBitsFromByteArrayLE( byteArray, 21580, 12);
    @CAN_RadarRR::RRR_Object::RRR_Object_Obj41.PyVnce = convertRawToPhysical(raw_value, 0.005, 0.0);

    raw_value=copyBitsFromByteArrayLE( byteArray, 21824, 12);
    @CAN_RadarRR::RRR_Object::RRR_Object_Obj41.PyVxCoVnce = convertRawToPhysical(raw_value, 0.005, -10.0);

    raw_value=copyBitsFromByteArrayLE( byteArray, 21836, 12);
    @CAN_RadarRR::RRR_Object::RRR_Object_Obj41.PyVyCoVnce = convertRawToPhysical(raw_value, 0.005, -10.0);

    raw_value=copyBitsFromByteArrayLE( byteArray, 21676, 10);
    @CAN_RadarRR::RRR_Object::RRR_Object_Obj41.RCS = convertRawToPhysical(raw_value, 0.2, -102.4);

    raw_value=copyBitsFromByteArrayLE( byteArray, 21848, 4);
    @CAN_RadarRR::RRR_Object::RRR_Object_Obj41.ReferencePoint = convertRawToPhysical(raw_value, 1.0, 0.0);

    raw_value=copyBitsFromByteArrayLE( byteArray, 21708, 12);
    @CAN_RadarRR::RRR_Object::RRR_Object_Obj41.Vx = convertRawToPhysical(raw_value, 0.0625, -128.0);

    raw_value=copyBitsFromByteArrayLE( byteArray, 21932, 12);
    @CAN_RadarRR::RRR_Object::RRR_Object_Obj41.VxAxCoVnce = convertRawToPhysical(raw_value, 0.005, -10.0);

    raw_value=copyBitsFromByteArrayLE( byteArray, 21952, 12);
    @CAN_RadarRR::RRR_Object::RRR_Object_Obj41.VxAyCoVnce = convertRawToPhysical(raw_value, 0.005, -10.0);

    raw_value=copyBitsFromByteArrayLE( byteArray, 21728, 12);
    @CAN_RadarRR::RRR_Object::RRR_Object_Obj41.VxVnce = convertRawToPhysical(raw_value, 0.005, 0.0);

    raw_value=copyBitsFromByteArrayLE( byteArray, 21920, 12);
    @CAN_RadarRR::RRR_Object::RRR_Object_Obj41.VxVyCoVnce = convertRawToPhysical(raw_value, 0.005, -10.0);

    raw_value=copyBitsFromByteArrayLE( byteArray, 21742, 10);
    @CAN_RadarRR::RRR_Object::RRR_Object_Obj41.Vy = convertRawToPhysical(raw_value, 0.125, -64.0);

    raw_value=copyBitsFromByteArrayLE( byteArray, 21964, 12);
    @CAN_RadarRR::RRR_Object::RRR_Object_Obj41.VyAxCoVnce = convertRawToPhysical(raw_value, 0.005, -10.0);

    raw_value=copyBitsFromByteArrayLE( byteArray, 21984, 12);
    @CAN_RadarRR::RRR_Object::RRR_Object_Obj41.VyAyCoVnce = convertRawToPhysical(raw_value, 0.005, -10.0);

    raw_value=copyBitsFromByteArrayLE( byteArray, 21760, 12);
    @CAN_RadarRR::RRR_Object::RRR_Object_Obj41.VyVnce = convertRawToPhysical(raw_value, 0.005, 0.0);

    raw_value=copyBitsFromByteArrayLE( byteArray, 21656, 7);
    @CAN_RadarRR::RRR_Object::RRR_Object_Obj41.Width = convertRawToPhysical(raw_value, 0.125, 0.0);

    raw_value=copyBitsFromByteArrayLE( byteArray, 21664, 12);
    @CAN_RadarRR::RRR_Object::RRR_Object_Obj41.WidthVnce = convertRawToPhysical(raw_value, 0.005, 0.0);
}


void CRadarRR_RRR_Object_Obj42_SetDataReceived(byte byteArray[])
{
    qword raw_value;

    raw_value=copyBitsFromByteArrayLE( byteArray, 22528, 32);
    @CAN_RadarRR::RRR_Object::RRR_Object_Obj42.Age = convertRawToPhysical(raw_value, 1.0, 0.0);

    raw_value=copyBitsFromByteArrayLE( byteArray, 22124, 10);
    @CAN_RadarRR::RRR_Object::RRR_Object_Obj42.Ax = convertRawToPhysical(raw_value, 0.03125, -16.0);

    raw_value=copyBitsFromByteArrayLE( byteArray, 22508, 12);
    @CAN_RadarRR::RRR_Object::RRR_Object_Obj42.AxAyCoVnce = convertRawToPhysical(raw_value, 0.005, -10.0);

    raw_value=copyBitsFromByteArrayLE( byteArray, 22144, 12);
    @CAN_RadarRR::RRR_Object::RRR_Object_Obj42.AxVnce = convertRawToPhysical(raw_value, 0.005, 0.0);

    raw_value=copyBitsFromByteArrayLE( byteArray, 22198, 9);
    @CAN_RadarRR::RRR_Object::RRR_Object_Obj42.Ay = convertRawToPhysical(raw_value, 0.0625, -16.0);

    raw_value=copyBitsFromByteArrayLE( byteArray, 22208, 12);
    @CAN_RadarRR::RRR_Object::RRR_Object_Obj42.AyVnce = convertRawToPhysical(raw_value, 0.005, 0.0);

    raw_value=copyBitsFromByteArrayLE( byteArray, 22264, 6);
    @CAN_RadarRR::RRR_Object::RRR_Object_Obj42.ExistProb = convertRawToPhysical(raw_value, 2.0, 0.0);

    raw_value=copyBitsFromByteArrayLE( byteArray, 22328, 8);
    @CAN_RadarRR::RRR_Object::RRR_Object_Obj42.FilterInformation = convertRawToPhysical(raw_value, 1.0, 0.0);

    raw_value=copyBitsFromByteArrayLE( byteArray, 22104, 7);
    @CAN_RadarRR::RRR_Object::RRR_Object_Obj42.Length = convertRawToPhysical(raw_value, 0.125, 0.0);

    raw_value=copyBitsFromByteArrayLE( byteArray, 22112, 12);
    @CAN_RadarRR::RRR_Object::RRR_Object_Obj42.LengthVnce = convertRawToPhysical(raw_value, 0.005, 0.0);

    raw_value=copyBitsFromByteArrayLE( byteArray, 22296, 3);
    @CAN_RadarRR::RRR_Object::RRR_Object_Obj42.MeasurementStatus = convertRawToPhysical(raw_value, 1.0, 0.0);

    raw_value=copyBitsFromByteArrayLE( byteArray, 22252, 2);
    @CAN_RadarRR::RRR_Object::RRR_Object_Obj42.MovingStatus = convertRawToPhysical(raw_value, 1.0, 0.0);

    raw_value=copyBitsFromByteArrayLE( byteArray, 22232, 7);
    @CAN_RadarRR::RRR_Object::RRR_Object_Obj42.ObjId = convertRawToPhysical(raw_value, 1.0, 0.0);

    raw_value=copyBitsFromByteArrayLE( byteArray, 22134, 9);
    @CAN_RadarRR::RRR_Object::RRR_Object_Obj42.OrientationYaw = convertRawToPhysical(raw_value, 0.0175, -4.48);

    raw_value=copyBitsFromByteArrayLE( byteArray, 22156, 12);
    @CAN_RadarRR::RRR_Object::RRR_Object_Obj42.OrientationYawVnce = convertRawToPhysical(raw_value, 0.0003, 0.0);

    raw_value=copyBitsFromByteArrayLE( byteArray, 22048, 6);
    @CAN_RadarRR::RRR_Object::RRR_Object_Obj42.ProbClassConfidence = convertRawToPhysical(raw_value, 2.0, 0.0);

    raw_value=copyBitsFromByteArrayLE( byteArray, 22299, 4);
    @CAN_RadarRR::RRR_Object::RRR_Object_Obj42.ProbClassType = convertRawToPhysical(raw_value, 1.0, 0.0);

    raw_value=copyBitsFromByteArrayLE( byteArray, 22054, 14);
    @CAN_RadarRR::RRR_Object::RRR_Object_Obj42.Px = convertRawToPhysical(raw_value, 0.0625, -512.0);

    raw_value=copyBitsFromByteArrayLE( byteArray, 22368, 12);
    @CAN_RadarRR::RRR_Object::RRR_Object_Obj42.PxAxCoVnce = convertRawToPhysical(raw_value, 0.005, -10.0);

    raw_value=copyBitsFromByteArrayLE( byteArray, 22380, 12);
    @CAN_RadarRR::RRR_Object::RRR_Object_Obj42.PxAyCoVnce = convertRawToPhysical(raw_value, 0.005, -10.0);

    raw_value=copyBitsFromByteArrayLE( byteArray, 22284, 12);
    @CAN_RadarRR::RRR_Object::RRR_Object_Obj42.PxPyCoVnce = convertRawToPhysical(raw_value, 0.005, -10.0);

    raw_value=copyBitsFromByteArrayLE( byteArray, 22068, 12);
    @CAN_RadarRR::RRR_Object::RRR_Object_Obj42.PxVnce = convertRawToPhysical(raw_value, 0.005, 0.0);

    raw_value=copyBitsFromByteArrayLE( byteArray, 22304, 12);
    @CAN_RadarRR::RRR_Object::RRR_Object_Obj42.PxVxCoVnce = convertRawToPhysical(raw_value, 0.005, -10.0);

    raw_value=copyBitsFromByteArrayLE( byteArray, 22316, 12);
    @CAN_RadarRR::RRR_Object::RRR_Object_Obj42.PxVyCoVnce = convertRawToPhysical(raw_value, 0.005, -10.0);

    raw_value=copyBitsFromByteArrayLE( byteArray, 22080, 12);
    @CAN_RadarRR::RRR_Object::RRR_Object_Obj42.Py = convertRawToPhysical(raw_value, 0.0625, -128.0);

    raw_value=copyBitsFromByteArrayLE( byteArray, 22400, 12);
    @CAN_RadarRR::RRR_Object::RRR_Object_Obj42.PyAxCoVnce = convertRawToPhysical(raw_value, 0.005, -10.0);

    raw_value=copyBitsFromByteArrayLE( byteArray, 22412, 12);
    @CAN_RadarRR::RRR_Object::RRR_Object_Obj42.PyAyCoVnce = convertRawToPhysical(raw_value, 0.005, -10.0);

    raw_value=copyBitsFromByteArrayLE( byteArray, 22092, 12);
    @CAN_RadarRR::RRR_Object::RRR_Object_Obj42.PyVnce = convertRawToPhysical(raw_value, 0.005, 0.0);

    raw_value=copyBitsFromByteArrayLE( byteArray, 22336, 12);
    @CAN_RadarRR::RRR_Object::RRR_Object_Obj42.PyVxCoVnce = convertRawToPhysical(raw_value, 0.005, -10.0);

    raw_value=copyBitsFromByteArrayLE( byteArray, 22348, 12);
    @CAN_RadarRR::RRR_Object::RRR_Object_Obj42.PyVyCoVnce = convertRawToPhysical(raw_value, 0.005, -10.0);

    raw_value=copyBitsFromByteArrayLE( byteArray, 22188, 10);
    @CAN_RadarRR::RRR_Object::RRR_Object_Obj42.RCS = convertRawToPhysical(raw_value, 0.2, -102.4);

    raw_value=copyBitsFromByteArrayLE( byteArray, 22360, 4);
    @CAN_RadarRR::RRR_Object::RRR_Object_Obj42.ReferencePoint = convertRawToPhysical(raw_value, 1.0, 0.0);

    raw_value=copyBitsFromByteArrayLE( byteArray, 22220, 12);
    @CAN_RadarRR::RRR_Object::RRR_Object_Obj42.Vx = convertRawToPhysical(raw_value, 0.0625, -128.0);

    raw_value=copyBitsFromByteArrayLE( byteArray, 22444, 12);
    @CAN_RadarRR::RRR_Object::RRR_Object_Obj42.VxAxCoVnce = convertRawToPhysical(raw_value, 0.005, -10.0);

    raw_value=copyBitsFromByteArrayLE( byteArray, 22464, 12);
    @CAN_RadarRR::RRR_Object::RRR_Object_Obj42.VxAyCoVnce = convertRawToPhysical(raw_value, 0.005, -10.0);

    raw_value=copyBitsFromByteArrayLE( byteArray, 22240, 12);
    @CAN_RadarRR::RRR_Object::RRR_Object_Obj42.VxVnce = convertRawToPhysical(raw_value, 0.005, 0.0);

    raw_value=copyBitsFromByteArrayLE( byteArray, 22432, 12);
    @CAN_RadarRR::RRR_Object::RRR_Object_Obj42.VxVyCoVnce = convertRawToPhysical(raw_value, 0.005, -10.0);

    raw_value=copyBitsFromByteArrayLE( byteArray, 22254, 10);
    @CAN_RadarRR::RRR_Object::RRR_Object_Obj42.Vy = convertRawToPhysical(raw_value, 0.125, -64.0);

    raw_value=copyBitsFromByteArrayLE( byteArray, 22476, 12);
    @CAN_RadarRR::RRR_Object::RRR_Object_Obj42.VyAxCoVnce = convertRawToPhysical(raw_value, 0.005, -10.0);

    raw_value=copyBitsFromByteArrayLE( byteArray, 22496, 12);
    @CAN_RadarRR::RRR_Object::RRR_Object_Obj42.VyAyCoVnce = convertRawToPhysical(raw_value, 0.005, -10.0);

    raw_value=copyBitsFromByteArrayLE( byteArray, 22272, 12);
    @CAN_RadarRR::RRR_Object::RRR_Object_Obj42.VyVnce = convertRawToPhysical(raw_value, 0.005, 0.0);

    raw_value=copyBitsFromByteArrayLE( byteArray, 22168, 7);
    @CAN_RadarRR::RRR_Object::RRR_Object_Obj42.Width = convertRawToPhysical(raw_value, 0.125, 0.0);

    raw_value=copyBitsFromByteArrayLE( byteArray, 22176, 12);
    @CAN_RadarRR::RRR_Object::RRR_Object_Obj42.WidthVnce = convertRawToPhysical(raw_value, 0.005, 0.0);
}


void CRadarRR_RRR_Object_Obj43_SetDataReceived(byte byteArray[])
{
    qword raw_value;

    raw_value=copyBitsFromByteArrayLE( byteArray, 23040, 32);
    @CAN_RadarRR::RRR_Object::RRR_Object_Obj43.Age = convertRawToPhysical(raw_value, 1.0, 0.0);

    raw_value=copyBitsFromByteArrayLE( byteArray, 22636, 10);
    @CAN_RadarRR::RRR_Object::RRR_Object_Obj43.Ax = convertRawToPhysical(raw_value, 0.03125, -16.0);

    raw_value=copyBitsFromByteArrayLE( byteArray, 23020, 12);
    @CAN_RadarRR::RRR_Object::RRR_Object_Obj43.AxAyCoVnce = convertRawToPhysical(raw_value, 0.005, -10.0);

    raw_value=copyBitsFromByteArrayLE( byteArray, 22656, 12);
    @CAN_RadarRR::RRR_Object::RRR_Object_Obj43.AxVnce = convertRawToPhysical(raw_value, 0.005, 0.0);

    raw_value=copyBitsFromByteArrayLE( byteArray, 22710, 9);
    @CAN_RadarRR::RRR_Object::RRR_Object_Obj43.Ay = convertRawToPhysical(raw_value, 0.0625, -16.0);

    raw_value=copyBitsFromByteArrayLE( byteArray, 22720, 12);
    @CAN_RadarRR::RRR_Object::RRR_Object_Obj43.AyVnce = convertRawToPhysical(raw_value, 0.005, 0.0);

    raw_value=copyBitsFromByteArrayLE( byteArray, 22776, 6);
    @CAN_RadarRR::RRR_Object::RRR_Object_Obj43.ExistProb = convertRawToPhysical(raw_value, 2.0, 0.0);

    raw_value=copyBitsFromByteArrayLE( byteArray, 22840, 8);
    @CAN_RadarRR::RRR_Object::RRR_Object_Obj43.FilterInformation = convertRawToPhysical(raw_value, 1.0, 0.0);

    raw_value=copyBitsFromByteArrayLE( byteArray, 22616, 7);
    @CAN_RadarRR::RRR_Object::RRR_Object_Obj43.Length = convertRawToPhysical(raw_value, 0.125, 0.0);

    raw_value=copyBitsFromByteArrayLE( byteArray, 22624, 12);
    @CAN_RadarRR::RRR_Object::RRR_Object_Obj43.LengthVnce = convertRawToPhysical(raw_value, 0.005, 0.0);

    raw_value=copyBitsFromByteArrayLE( byteArray, 22808, 3);
    @CAN_RadarRR::RRR_Object::RRR_Object_Obj43.MeasurementStatus = convertRawToPhysical(raw_value, 1.0, 0.0);

    raw_value=copyBitsFromByteArrayLE( byteArray, 22764, 2);
    @CAN_RadarRR::RRR_Object::RRR_Object_Obj43.MovingStatus = convertRawToPhysical(raw_value, 1.0, 0.0);

    raw_value=copyBitsFromByteArrayLE( byteArray, 22744, 7);
    @CAN_RadarRR::RRR_Object::RRR_Object_Obj43.ObjId = convertRawToPhysical(raw_value, 1.0, 0.0);

    raw_value=copyBitsFromByteArrayLE( byteArray, 22646, 9);
    @CAN_RadarRR::RRR_Object::RRR_Object_Obj43.OrientationYaw = convertRawToPhysical(raw_value, 0.0175, -4.48);

    raw_value=copyBitsFromByteArrayLE( byteArray, 22668, 12);
    @CAN_RadarRR::RRR_Object::RRR_Object_Obj43.OrientationYawVnce = convertRawToPhysical(raw_value, 0.0003, 0.0);

    raw_value=copyBitsFromByteArrayLE( byteArray, 22560, 6);
    @CAN_RadarRR::RRR_Object::RRR_Object_Obj43.ProbClassConfidence = convertRawToPhysical(raw_value, 2.0, 0.0);

    raw_value=copyBitsFromByteArrayLE( byteArray, 22811, 4);
    @CAN_RadarRR::RRR_Object::RRR_Object_Obj43.ProbClassType = convertRawToPhysical(raw_value, 1.0, 0.0);

    raw_value=copyBitsFromByteArrayLE( byteArray, 22566, 14);
    @CAN_RadarRR::RRR_Object::RRR_Object_Obj43.Px = convertRawToPhysical(raw_value, 0.0625, -512.0);

    raw_value=copyBitsFromByteArrayLE( byteArray, 22880, 12);
    @CAN_RadarRR::RRR_Object::RRR_Object_Obj43.PxAxCoVnce = convertRawToPhysical(raw_value, 0.005, -10.0);

    raw_value=copyBitsFromByteArrayLE( byteArray, 22892, 12);
    @CAN_RadarRR::RRR_Object::RRR_Object_Obj43.PxAyCoVnce = convertRawToPhysical(raw_value, 0.005, -10.0);

    raw_value=copyBitsFromByteArrayLE( byteArray, 22796, 12);
    @CAN_RadarRR::RRR_Object::RRR_Object_Obj43.PxPyCoVnce = convertRawToPhysical(raw_value, 0.005, -10.0);

    raw_value=copyBitsFromByteArrayLE( byteArray, 22580, 12);
    @CAN_RadarRR::RRR_Object::RRR_Object_Obj43.PxVnce = convertRawToPhysical(raw_value, 0.005, 0.0);

    raw_value=copyBitsFromByteArrayLE( byteArray, 22816, 12);
    @CAN_RadarRR::RRR_Object::RRR_Object_Obj43.PxVxCoVnce = convertRawToPhysical(raw_value, 0.005, -10.0);

    raw_value=copyBitsFromByteArrayLE( byteArray, 22828, 12);
    @CAN_RadarRR::RRR_Object::RRR_Object_Obj43.PxVyCoVnce = convertRawToPhysical(raw_value, 0.005, -10.0);

    raw_value=copyBitsFromByteArrayLE( byteArray, 22592, 12);
    @CAN_RadarRR::RRR_Object::RRR_Object_Obj43.Py = convertRawToPhysical(raw_value, 0.0625, -128.0);

    raw_value=copyBitsFromByteArrayLE( byteArray, 22912, 12);
    @CAN_RadarRR::RRR_Object::RRR_Object_Obj43.PyAxCoVnce = convertRawToPhysical(raw_value, 0.005, -10.0);

    raw_value=copyBitsFromByteArrayLE( byteArray, 22924, 12);
    @CAN_RadarRR::RRR_Object::RRR_Object_Obj43.PyAyCoVnce = convertRawToPhysical(raw_value, 0.005, -10.0);

    raw_value=copyBitsFromByteArrayLE( byteArray, 22604, 12);
    @CAN_RadarRR::RRR_Object::RRR_Object_Obj43.PyVnce = convertRawToPhysical(raw_value, 0.005, 0.0);

    raw_value=copyBitsFromByteArrayLE( byteArray, 22848, 12);
    @CAN_RadarRR::RRR_Object::RRR_Object_Obj43.PyVxCoVnce = convertRawToPhysical(raw_value, 0.005, -10.0);

    raw_value=copyBitsFromByteArrayLE( byteArray, 22860, 12);
    @CAN_RadarRR::RRR_Object::RRR_Object_Obj43.PyVyCoVnce = convertRawToPhysical(raw_value, 0.005, -10.0);

    raw_value=copyBitsFromByteArrayLE( byteArray, 22700, 10);
    @CAN_RadarRR::RRR_Object::RRR_Object_Obj43.RCS = convertRawToPhysical(raw_value, 0.2, -102.4);

    raw_value=copyBitsFromByteArrayLE( byteArray, 22872, 4);
    @CAN_RadarRR::RRR_Object::RRR_Object_Obj43.ReferencePoint = convertRawToPhysical(raw_value, 1.0, 0.0);

    raw_value=copyBitsFromByteArrayLE( byteArray, 22732, 12);
    @CAN_RadarRR::RRR_Object::RRR_Object_Obj43.Vx = convertRawToPhysical(raw_value, 0.0625, -128.0);

    raw_value=copyBitsFromByteArrayLE( byteArray, 22956, 12);
    @CAN_RadarRR::RRR_Object::RRR_Object_Obj43.VxAxCoVnce = convertRawToPhysical(raw_value, 0.005, -10.0);

    raw_value=copyBitsFromByteArrayLE( byteArray, 22976, 12);
    @CAN_RadarRR::RRR_Object::RRR_Object_Obj43.VxAyCoVnce = convertRawToPhysical(raw_value, 0.005, -10.0);

    raw_value=copyBitsFromByteArrayLE( byteArray, 22752, 12);
    @CAN_RadarRR::RRR_Object::RRR_Object_Obj43.VxVnce = convertRawToPhysical(raw_value, 0.005, 0.0);

    raw_value=copyBitsFromByteArrayLE( byteArray, 22944, 12);
    @CAN_RadarRR::RRR_Object::RRR_Object_Obj43.VxVyCoVnce = convertRawToPhysical(raw_value, 0.005, -10.0);

    raw_value=copyBitsFromByteArrayLE( byteArray, 22766, 10);
    @CAN_RadarRR::RRR_Object::RRR_Object_Obj43.Vy = convertRawToPhysical(raw_value, 0.125, -64.0);

    raw_value=copyBitsFromByteArrayLE( byteArray, 22988, 12);
    @CAN_RadarRR::RRR_Object::RRR_Object_Obj43.VyAxCoVnce = convertRawToPhysical(raw_value, 0.005, -10.0);

    raw_value=copyBitsFromByteArrayLE( byteArray, 23008, 12);
    @CAN_RadarRR::RRR_Object::RRR_Object_Obj43.VyAyCoVnce = convertRawToPhysical(raw_value, 0.005, -10.0);

    raw_value=copyBitsFromByteArrayLE( byteArray, 22784, 12);
    @CAN_RadarRR::RRR_Object::RRR_Object_Obj43.VyVnce = convertRawToPhysical(raw_value, 0.005, 0.0);

    raw_value=copyBitsFromByteArrayLE( byteArray, 22680, 7);
    @CAN_RadarRR::RRR_Object::RRR_Object_Obj43.Width = convertRawToPhysical(raw_value, 0.125, 0.0);

    raw_value=copyBitsFromByteArrayLE( byteArray, 22688, 12);
    @CAN_RadarRR::RRR_Object::RRR_Object_Obj43.WidthVnce = convertRawToPhysical(raw_value, 0.005, 0.0);
}


void CRadarRR_RRR_Object_Obj44_SetDataReceived(byte byteArray[])
{
    qword raw_value;

    raw_value=copyBitsFromByteArrayLE( byteArray, 23552, 32);
    @CAN_RadarRR::RRR_Object::RRR_Object_Obj44.Age = convertRawToPhysical(raw_value, 1.0, 0.0);

    raw_value=copyBitsFromByteArrayLE( byteArray, 23148, 10);
    @CAN_RadarRR::RRR_Object::RRR_Object_Obj44.Ax = convertRawToPhysical(raw_value, 0.03125, -16.0);

    raw_value=copyBitsFromByteArrayLE( byteArray, 23532, 12);
    @CAN_RadarRR::RRR_Object::RRR_Object_Obj44.AxAyCoVnce = convertRawToPhysical(raw_value, 0.005, -10.0);

    raw_value=copyBitsFromByteArrayLE( byteArray, 23168, 12);
    @CAN_RadarRR::RRR_Object::RRR_Object_Obj44.AxVnce = convertRawToPhysical(raw_value, 0.005, 0.0);

    raw_value=copyBitsFromByteArrayLE( byteArray, 23222, 9);
    @CAN_RadarRR::RRR_Object::RRR_Object_Obj44.Ay = convertRawToPhysical(raw_value, 0.0625, -16.0);

    raw_value=copyBitsFromByteArrayLE( byteArray, 23232, 12);
    @CAN_RadarRR::RRR_Object::RRR_Object_Obj44.AyVnce = convertRawToPhysical(raw_value, 0.005, 0.0);

    raw_value=copyBitsFromByteArrayLE( byteArray, 23288, 6);
    @CAN_RadarRR::RRR_Object::RRR_Object_Obj44.ExistProb = convertRawToPhysical(raw_value, 2.0, 0.0);

    raw_value=copyBitsFromByteArrayLE( byteArray, 23352, 8);
    @CAN_RadarRR::RRR_Object::RRR_Object_Obj44.FilterInformation = convertRawToPhysical(raw_value, 1.0, 0.0);

    raw_value=copyBitsFromByteArrayLE( byteArray, 23128, 7);
    @CAN_RadarRR::RRR_Object::RRR_Object_Obj44.Length = convertRawToPhysical(raw_value, 0.125, 0.0);

    raw_value=copyBitsFromByteArrayLE( byteArray, 23136, 12);
    @CAN_RadarRR::RRR_Object::RRR_Object_Obj44.LengthVnce = convertRawToPhysical(raw_value, 0.005, 0.0);

    raw_value=copyBitsFromByteArrayLE( byteArray, 23320, 3);
    @CAN_RadarRR::RRR_Object::RRR_Object_Obj44.MeasurementStatus = convertRawToPhysical(raw_value, 1.0, 0.0);

    raw_value=copyBitsFromByteArrayLE( byteArray, 23276, 2);
    @CAN_RadarRR::RRR_Object::RRR_Object_Obj44.MovingStatus = convertRawToPhysical(raw_value, 1.0, 0.0);

    raw_value=copyBitsFromByteArrayLE( byteArray, 23256, 7);
    @CAN_RadarRR::RRR_Object::RRR_Object_Obj44.ObjId = convertRawToPhysical(raw_value, 1.0, 0.0);

    raw_value=copyBitsFromByteArrayLE( byteArray, 23158, 9);
    @CAN_RadarRR::RRR_Object::RRR_Object_Obj44.OrientationYaw = convertRawToPhysical(raw_value, 0.0175, -4.48);

    raw_value=copyBitsFromByteArrayLE( byteArray, 23180, 12);
    @CAN_RadarRR::RRR_Object::RRR_Object_Obj44.OrientationYawVnce = convertRawToPhysical(raw_value, 0.0003, 0.0);

    raw_value=copyBitsFromByteArrayLE( byteArray, 23072, 6);
    @CAN_RadarRR::RRR_Object::RRR_Object_Obj44.ProbClassConfidence = convertRawToPhysical(raw_value, 2.0, 0.0);

    raw_value=copyBitsFromByteArrayLE( byteArray, 23323, 4);
    @CAN_RadarRR::RRR_Object::RRR_Object_Obj44.ProbClassType = convertRawToPhysical(raw_value, 1.0, 0.0);

    raw_value=copyBitsFromByteArrayLE( byteArray, 23078, 14);
    @CAN_RadarRR::RRR_Object::RRR_Object_Obj44.Px = convertRawToPhysical(raw_value, 0.0625, -512.0);

    raw_value=copyBitsFromByteArrayLE( byteArray, 23392, 12);
    @CAN_RadarRR::RRR_Object::RRR_Object_Obj44.PxAxCoVnce = convertRawToPhysical(raw_value, 0.005, -10.0);

    raw_value=copyBitsFromByteArrayLE( byteArray, 23404, 12);
    @CAN_RadarRR::RRR_Object::RRR_Object_Obj44.PxAyCoVnce = convertRawToPhysical(raw_value, 0.005, -10.0);

    raw_value=copyBitsFromByteArrayLE( byteArray, 23308, 12);
    @CAN_RadarRR::RRR_Object::RRR_Object_Obj44.PxPyCoVnce = convertRawToPhysical(raw_value, 0.005, -10.0);

    raw_value=copyBitsFromByteArrayLE( byteArray, 23092, 12);
    @CAN_RadarRR::RRR_Object::RRR_Object_Obj44.PxVnce = convertRawToPhysical(raw_value, 0.005, 0.0);

    raw_value=copyBitsFromByteArrayLE( byteArray, 23328, 12);
    @CAN_RadarRR::RRR_Object::RRR_Object_Obj44.PxVxCoVnce = convertRawToPhysical(raw_value, 0.005, -10.0);

    raw_value=copyBitsFromByteArrayLE( byteArray, 23340, 12);
    @CAN_RadarRR::RRR_Object::RRR_Object_Obj44.PxVyCoVnce = convertRawToPhysical(raw_value, 0.005, -10.0);

    raw_value=copyBitsFromByteArrayLE( byteArray, 23104, 12);
    @CAN_RadarRR::RRR_Object::RRR_Object_Obj44.Py = convertRawToPhysical(raw_value, 0.0625, -128.0);

    raw_value=copyBitsFromByteArrayLE( byteArray, 23424, 12);
    @CAN_RadarRR::RRR_Object::RRR_Object_Obj44.PyAxCoVnce = convertRawToPhysical(raw_value, 0.005, -10.0);

    raw_value=copyBitsFromByteArrayLE( byteArray, 23436, 12);
    @CAN_RadarRR::RRR_Object::RRR_Object_Obj44.PyAyCoVnce = convertRawToPhysical(raw_value, 0.005, -10.0);

    raw_value=copyBitsFromByteArrayLE( byteArray, 23116, 12);
    @CAN_RadarRR::RRR_Object::RRR_Object_Obj44.PyVnce = convertRawToPhysical(raw_value, 0.005, 0.0);

    raw_value=copyBitsFromByteArrayLE( byteArray, 23360, 12);
    @CAN_RadarRR::RRR_Object::RRR_Object_Obj44.PyVxCoVnce = convertRawToPhysical(raw_value, 0.005, -10.0);

    raw_value=copyBitsFromByteArrayLE( byteArray, 23372, 12);
    @CAN_RadarRR::RRR_Object::RRR_Object_Obj44.PyVyCoVnce = convertRawToPhysical(raw_value, 0.005, -10.0);

    raw_value=copyBitsFromByteArrayLE( byteArray, 23212, 10);
    @CAN_RadarRR::RRR_Object::RRR_Object_Obj44.RCS = convertRawToPhysical(raw_value, 0.2, -102.4);

    raw_value=copyBitsFromByteArrayLE( byteArray, 23384, 4);
    @CAN_RadarRR::RRR_Object::RRR_Object_Obj44.ReferencePoint = convertRawToPhysical(raw_value, 1.0, 0.0);

    raw_value=copyBitsFromByteArrayLE( byteArray, 23244, 12);
    @CAN_RadarRR::RRR_Object::RRR_Object_Obj44.Vx = convertRawToPhysical(raw_value, 0.0625, -128.0);

    raw_value=copyBitsFromByteArrayLE( byteArray, 23468, 12);
    @CAN_RadarRR::RRR_Object::RRR_Object_Obj44.VxAxCoVnce = convertRawToPhysical(raw_value, 0.005, -10.0);

    raw_value=copyBitsFromByteArrayLE( byteArray, 23488, 12);
    @CAN_RadarRR::RRR_Object::RRR_Object_Obj44.VxAyCoVnce = convertRawToPhysical(raw_value, 0.005, -10.0);

    raw_value=copyBitsFromByteArrayLE( byteArray, 23264, 12);
    @CAN_RadarRR::RRR_Object::RRR_Object_Obj44.VxVnce = convertRawToPhysical(raw_value, 0.005, 0.0);

    raw_value=copyBitsFromByteArrayLE( byteArray, 23456, 12);
    @CAN_RadarRR::RRR_Object::RRR_Object_Obj44.VxVyCoVnce = convertRawToPhysical(raw_value, 0.005, -10.0);

    raw_value=copyBitsFromByteArrayLE( byteArray, 23278, 10);
    @CAN_RadarRR::RRR_Object::RRR_Object_Obj44.Vy = convertRawToPhysical(raw_value, 0.125, -64.0);

    raw_value=copyBitsFromByteArrayLE( byteArray, 23500, 12);
    @CAN_RadarRR::RRR_Object::RRR_Object_Obj44.VyAxCoVnce = convertRawToPhysical(raw_value, 0.005, -10.0);

    raw_value=copyBitsFromByteArrayLE( byteArray, 23520, 12);
    @CAN_RadarRR::RRR_Object::RRR_Object_Obj44.VyAyCoVnce = convertRawToPhysical(raw_value, 0.005, -10.0);

    raw_value=copyBitsFromByteArrayLE( byteArray, 23296, 12);
    @CAN_RadarRR::RRR_Object::RRR_Object_Obj44.VyVnce = convertRawToPhysical(raw_value, 0.005, 0.0);

    raw_value=copyBitsFromByteArrayLE( byteArray, 23192, 7);
    @CAN_RadarRR::RRR_Object::RRR_Object_Obj44.Width = convertRawToPhysical(raw_value, 0.125, 0.0);

    raw_value=copyBitsFromByteArrayLE( byteArray, 23200, 12);
    @CAN_RadarRR::RRR_Object::RRR_Object_Obj44.WidthVnce = convertRawToPhysical(raw_value, 0.005, 0.0);
}


void CRadarRR_RRR_Object_Obj45_SetDataReceived(byte byteArray[])
{
    qword raw_value;

    raw_value=copyBitsFromByteArrayLE( byteArray, 24064, 32);
    @CAN_RadarRR::RRR_Object::RRR_Object_Obj45.Age = convertRawToPhysical(raw_value, 1.0, 0.0);

    raw_value=copyBitsFromByteArrayLE( byteArray, 23660, 10);
    @CAN_RadarRR::RRR_Object::RRR_Object_Obj45.Ax = convertRawToPhysical(raw_value, 0.03125, -16.0);

    raw_value=copyBitsFromByteArrayLE( byteArray, 24044, 12);
    @CAN_RadarRR::RRR_Object::RRR_Object_Obj45.AxAyCoVnce = convertRawToPhysical(raw_value, 0.005, -10.0);

    raw_value=copyBitsFromByteArrayLE( byteArray, 23680, 12);
    @CAN_RadarRR::RRR_Object::RRR_Object_Obj45.AxVnce = convertRawToPhysical(raw_value, 0.005, 0.0);

    raw_value=copyBitsFromByteArrayLE( byteArray, 23734, 9);
    @CAN_RadarRR::RRR_Object::RRR_Object_Obj45.Ay = convertRawToPhysical(raw_value, 0.0625, -16.0);

    raw_value=copyBitsFromByteArrayLE( byteArray, 23744, 12);
    @CAN_RadarRR::RRR_Object::RRR_Object_Obj45.AyVnce = convertRawToPhysical(raw_value, 0.005, 0.0);

    raw_value=copyBitsFromByteArrayLE( byteArray, 23800, 6);
    @CAN_RadarRR::RRR_Object::RRR_Object_Obj45.ExistProb = convertRawToPhysical(raw_value, 2.0, 0.0);

    raw_value=copyBitsFromByteArrayLE( byteArray, 23864, 8);
    @CAN_RadarRR::RRR_Object::RRR_Object_Obj45.FilterInformation = convertRawToPhysical(raw_value, 1.0, 0.0);

    raw_value=copyBitsFromByteArrayLE( byteArray, 23640, 7);
    @CAN_RadarRR::RRR_Object::RRR_Object_Obj45.Length = convertRawToPhysical(raw_value, 0.125, 0.0);

    raw_value=copyBitsFromByteArrayLE( byteArray, 23648, 12);
    @CAN_RadarRR::RRR_Object::RRR_Object_Obj45.LengthVnce = convertRawToPhysical(raw_value, 0.005, 0.0);

    raw_value=copyBitsFromByteArrayLE( byteArray, 23832, 3);
    @CAN_RadarRR::RRR_Object::RRR_Object_Obj45.MeasurementStatus = convertRawToPhysical(raw_value, 1.0, 0.0);

    raw_value=copyBitsFromByteArrayLE( byteArray, 23788, 2);
    @CAN_RadarRR::RRR_Object::RRR_Object_Obj45.MovingStatus = convertRawToPhysical(raw_value, 1.0, 0.0);

    raw_value=copyBitsFromByteArrayLE( byteArray, 23768, 7);
    @CAN_RadarRR::RRR_Object::RRR_Object_Obj45.ObjId = convertRawToPhysical(raw_value, 1.0, 0.0);

    raw_value=copyBitsFromByteArrayLE( byteArray, 23670, 9);
    @CAN_RadarRR::RRR_Object::RRR_Object_Obj45.OrientationYaw = convertRawToPhysical(raw_value, 0.0175, -4.48);

    raw_value=copyBitsFromByteArrayLE( byteArray, 23692, 12);
    @CAN_RadarRR::RRR_Object::RRR_Object_Obj45.OrientationYawVnce = convertRawToPhysical(raw_value, 0.0003, 0.0);

    raw_value=copyBitsFromByteArrayLE( byteArray, 23584, 6);
    @CAN_RadarRR::RRR_Object::RRR_Object_Obj45.ProbClassConfidence = convertRawToPhysical(raw_value, 2.0, 0.0);

    raw_value=copyBitsFromByteArrayLE( byteArray, 23835, 4);
    @CAN_RadarRR::RRR_Object::RRR_Object_Obj45.ProbClassType = convertRawToPhysical(raw_value, 1.0, 0.0);

    raw_value=copyBitsFromByteArrayLE( byteArray, 23590, 14);
    @CAN_RadarRR::RRR_Object::RRR_Object_Obj45.Px = convertRawToPhysical(raw_value, 0.0625, -512.0);

    raw_value=copyBitsFromByteArrayLE( byteArray, 23904, 12);
    @CAN_RadarRR::RRR_Object::RRR_Object_Obj45.PxAxCoVnce = convertRawToPhysical(raw_value, 0.005, -10.0);

    raw_value=copyBitsFromByteArrayLE( byteArray, 23916, 12);
    @CAN_RadarRR::RRR_Object::RRR_Object_Obj45.PxAyCoVnce = convertRawToPhysical(raw_value, 0.005, -10.0);

    raw_value=copyBitsFromByteArrayLE( byteArray, 23820, 12);
    @CAN_RadarRR::RRR_Object::RRR_Object_Obj45.PxPyCoVnce = convertRawToPhysical(raw_value, 0.005, -10.0);

    raw_value=copyBitsFromByteArrayLE( byteArray, 23604, 12);
    @CAN_RadarRR::RRR_Object::RRR_Object_Obj45.PxVnce = convertRawToPhysical(raw_value, 0.005, 0.0);

    raw_value=copyBitsFromByteArrayLE( byteArray, 23840, 12);
    @CAN_RadarRR::RRR_Object::RRR_Object_Obj45.PxVxCoVnce = convertRawToPhysical(raw_value, 0.005, -10.0);

    raw_value=copyBitsFromByteArrayLE( byteArray, 23852, 12);
    @CAN_RadarRR::RRR_Object::RRR_Object_Obj45.PxVyCoVnce = convertRawToPhysical(raw_value, 0.005, -10.0);

    raw_value=copyBitsFromByteArrayLE( byteArray, 23616, 12);
    @CAN_RadarRR::RRR_Object::RRR_Object_Obj45.Py = convertRawToPhysical(raw_value, 0.0625, -128.0);

    raw_value=copyBitsFromByteArrayLE( byteArray, 23936, 12);
    @CAN_RadarRR::RRR_Object::RRR_Object_Obj45.PyAxCoVnce = convertRawToPhysical(raw_value, 0.005, -10.0);

    raw_value=copyBitsFromByteArrayLE( byteArray, 23948, 12);
    @CAN_RadarRR::RRR_Object::RRR_Object_Obj45.PyAyCoVnce = convertRawToPhysical(raw_value, 0.005, -10.0);

    raw_value=copyBitsFromByteArrayLE( byteArray, 23628, 12);
    @CAN_RadarRR::RRR_Object::RRR_Object_Obj45.PyVnce = convertRawToPhysical(raw_value, 0.005, 0.0);

    raw_value=copyBitsFromByteArrayLE( byteArray, 23872, 12);
    @CAN_RadarRR::RRR_Object::RRR_Object_Obj45.PyVxCoVnce = convertRawToPhysical(raw_value, 0.005, -10.0);

    raw_value=copyBitsFromByteArrayLE( byteArray, 23884, 12);
    @CAN_RadarRR::RRR_Object::RRR_Object_Obj45.PyVyCoVnce = convertRawToPhysical(raw_value, 0.005, -10.0);

    raw_value=copyBitsFromByteArrayLE( byteArray, 23724, 10);
    @CAN_RadarRR::RRR_Object::RRR_Object_Obj45.RCS = convertRawToPhysical(raw_value, 0.2, -102.4);

    raw_value=copyBitsFromByteArrayLE( byteArray, 23896, 4);
    @CAN_RadarRR::RRR_Object::RRR_Object_Obj45.ReferencePoint = convertRawToPhysical(raw_value, 1.0, 0.0);

    raw_value=copyBitsFromByteArrayLE( byteArray, 23756, 12);
    @CAN_RadarRR::RRR_Object::RRR_Object_Obj45.Vx = convertRawToPhysical(raw_value, 0.0625, -128.0);

    raw_value=copyBitsFromByteArrayLE( byteArray, 23980, 12);
    @CAN_RadarRR::RRR_Object::RRR_Object_Obj45.VxAxCoVnce = convertRawToPhysical(raw_value, 0.005, -10.0);

    raw_value=copyBitsFromByteArrayLE( byteArray, 24000, 12);
    @CAN_RadarRR::RRR_Object::RRR_Object_Obj45.VxAyCoVnce = convertRawToPhysical(raw_value, 0.005, -10.0);

    raw_value=copyBitsFromByteArrayLE( byteArray, 23776, 12);
    @CAN_RadarRR::RRR_Object::RRR_Object_Obj45.VxVnce = convertRawToPhysical(raw_value, 0.005, 0.0);

    raw_value=copyBitsFromByteArrayLE( byteArray, 23968, 12);
    @CAN_RadarRR::RRR_Object::RRR_Object_Obj45.VxVyCoVnce = convertRawToPhysical(raw_value, 0.005, -10.0);

    raw_value=copyBitsFromByteArrayLE( byteArray, 23790, 10);
    @CAN_RadarRR::RRR_Object::RRR_Object_Obj45.Vy = convertRawToPhysical(raw_value, 0.125, -64.0);

    raw_value=copyBitsFromByteArrayLE( byteArray, 24012, 12);
    @CAN_RadarRR::RRR_Object::RRR_Object_Obj45.VyAxCoVnce = convertRawToPhysical(raw_value, 0.005, -10.0);

    raw_value=copyBitsFromByteArrayLE( byteArray, 24032, 12);
    @CAN_RadarRR::RRR_Object::RRR_Object_Obj45.VyAyCoVnce = convertRawToPhysical(raw_value, 0.005, -10.0);

    raw_value=copyBitsFromByteArrayLE( byteArray, 23808, 12);
    @CAN_RadarRR::RRR_Object::RRR_Object_Obj45.VyVnce = convertRawToPhysical(raw_value, 0.005, 0.0);

    raw_value=copyBitsFromByteArrayLE( byteArray, 23704, 7);
    @CAN_RadarRR::RRR_Object::RRR_Object_Obj45.Width = convertRawToPhysical(raw_value, 0.125, 0.0);

    raw_value=copyBitsFromByteArrayLE( byteArray, 23712, 12);
    @CAN_RadarRR::RRR_Object::RRR_Object_Obj45.WidthVnce = convertRawToPhysical(raw_value, 0.005, 0.0);
}


void CRadarRR_RRR_Object_Obj46_SetDataReceived(byte byteArray[])
{
    qword raw_value;

    raw_value=copyBitsFromByteArrayLE( byteArray, 24576, 32);
    @CAN_RadarRR::RRR_Object::RRR_Object_Obj46.Age = convertRawToPhysical(raw_value, 1.0, 0.0);

    raw_value=copyBitsFromByteArrayLE( byteArray, 24172, 10);
    @CAN_RadarRR::RRR_Object::RRR_Object_Obj46.Ax = convertRawToPhysical(raw_value, 0.03125, -16.0);

    raw_value=copyBitsFromByteArrayLE( byteArray, 24556, 12);
    @CAN_RadarRR::RRR_Object::RRR_Object_Obj46.AxAyCoVnce = convertRawToPhysical(raw_value, 0.005, -10.0);

    raw_value=copyBitsFromByteArrayLE( byteArray, 24192, 12);
    @CAN_RadarRR::RRR_Object::RRR_Object_Obj46.AxVnce = convertRawToPhysical(raw_value, 0.005, 0.0);

    raw_value=copyBitsFromByteArrayLE( byteArray, 24246, 9);
    @CAN_RadarRR::RRR_Object::RRR_Object_Obj46.Ay = convertRawToPhysical(raw_value, 0.0625, -16.0);

    raw_value=copyBitsFromByteArrayLE( byteArray, 24256, 12);
    @CAN_RadarRR::RRR_Object::RRR_Object_Obj46.AyVnce = convertRawToPhysical(raw_value, 0.005, 0.0);

    raw_value=copyBitsFromByteArrayLE( byteArray, 24312, 6);
    @CAN_RadarRR::RRR_Object::RRR_Object_Obj46.ExistProb = convertRawToPhysical(raw_value, 2.0, 0.0);

    raw_value=copyBitsFromByteArrayLE( byteArray, 24376, 8);
    @CAN_RadarRR::RRR_Object::RRR_Object_Obj46.FilterInformation = convertRawToPhysical(raw_value, 1.0, 0.0);

    raw_value=copyBitsFromByteArrayLE( byteArray, 24152, 7);
    @CAN_RadarRR::RRR_Object::RRR_Object_Obj46.Length = convertRawToPhysical(raw_value, 0.125, 0.0);

    raw_value=copyBitsFromByteArrayLE( byteArray, 24160, 12);
    @CAN_RadarRR::RRR_Object::RRR_Object_Obj46.LengthVnce = convertRawToPhysical(raw_value, 0.005, 0.0);

    raw_value=copyBitsFromByteArrayLE( byteArray, 24344, 3);
    @CAN_RadarRR::RRR_Object::RRR_Object_Obj46.MeasurementStatus = convertRawToPhysical(raw_value, 1.0, 0.0);

    raw_value=copyBitsFromByteArrayLE( byteArray, 24300, 2);
    @CAN_RadarRR::RRR_Object::RRR_Object_Obj46.MovingStatus = convertRawToPhysical(raw_value, 1.0, 0.0);

    raw_value=copyBitsFromByteArrayLE( byteArray, 24280, 7);
    @CAN_RadarRR::RRR_Object::RRR_Object_Obj46.ObjId = convertRawToPhysical(raw_value, 1.0, 0.0);

    raw_value=copyBitsFromByteArrayLE( byteArray, 24182, 9);
    @CAN_RadarRR::RRR_Object::RRR_Object_Obj46.OrientationYaw = convertRawToPhysical(raw_value, 0.0175, -4.48);

    raw_value=copyBitsFromByteArrayLE( byteArray, 24204, 12);
    @CAN_RadarRR::RRR_Object::RRR_Object_Obj46.OrientationYawVnce = convertRawToPhysical(raw_value, 0.0003, 0.0);

    raw_value=copyBitsFromByteArrayLE( byteArray, 24096, 6);
    @CAN_RadarRR::RRR_Object::RRR_Object_Obj46.ProbClassConfidence = convertRawToPhysical(raw_value, 2.0, 0.0);

    raw_value=copyBitsFromByteArrayLE( byteArray, 24347, 4);
    @CAN_RadarRR::RRR_Object::RRR_Object_Obj46.ProbClassType = convertRawToPhysical(raw_value, 1.0, 0.0);

    raw_value=copyBitsFromByteArrayLE( byteArray, 24102, 14);
    @CAN_RadarRR::RRR_Object::RRR_Object_Obj46.Px = convertRawToPhysical(raw_value, 0.0625, -512.0);

    raw_value=copyBitsFromByteArrayLE( byteArray, 24416, 12);
    @CAN_RadarRR::RRR_Object::RRR_Object_Obj46.PxAxCoVnce = convertRawToPhysical(raw_value, 0.005, -10.0);

    raw_value=copyBitsFromByteArrayLE( byteArray, 24428, 12);
    @CAN_RadarRR::RRR_Object::RRR_Object_Obj46.PxAyCoVnce = convertRawToPhysical(raw_value, 0.005, -10.0);

    raw_value=copyBitsFromByteArrayLE( byteArray, 24332, 12);
    @CAN_RadarRR::RRR_Object::RRR_Object_Obj46.PxPyCoVnce = convertRawToPhysical(raw_value, 0.005, -10.0);

    raw_value=copyBitsFromByteArrayLE( byteArray, 24116, 12);
    @CAN_RadarRR::RRR_Object::RRR_Object_Obj46.PxVnce = convertRawToPhysical(raw_value, 0.005, 0.0);

    raw_value=copyBitsFromByteArrayLE( byteArray, 24352, 12);
    @CAN_RadarRR::RRR_Object::RRR_Object_Obj46.PxVxCoVnce = convertRawToPhysical(raw_value, 0.005, -10.0);

    raw_value=copyBitsFromByteArrayLE( byteArray, 24364, 12);
    @CAN_RadarRR::RRR_Object::RRR_Object_Obj46.PxVyCoVnce = convertRawToPhysical(raw_value, 0.005, -10.0);

    raw_value=copyBitsFromByteArrayLE( byteArray, 24128, 12);
    @CAN_RadarRR::RRR_Object::RRR_Object_Obj46.Py = convertRawToPhysical(raw_value, 0.0625, -128.0);

    raw_value=copyBitsFromByteArrayLE( byteArray, 24448, 12);
    @CAN_RadarRR::RRR_Object::RRR_Object_Obj46.PyAxCoVnce = convertRawToPhysical(raw_value, 0.005, -10.0);

    raw_value=copyBitsFromByteArrayLE( byteArray, 24460, 12);
    @CAN_RadarRR::RRR_Object::RRR_Object_Obj46.PyAyCoVnce = convertRawToPhysical(raw_value, 0.005, -10.0);

    raw_value=copyBitsFromByteArrayLE( byteArray, 24140, 12);
    @CAN_RadarRR::RRR_Object::RRR_Object_Obj46.PyVnce = convertRawToPhysical(raw_value, 0.005, 0.0);

    raw_value=copyBitsFromByteArrayLE( byteArray, 24384, 12);
    @CAN_RadarRR::RRR_Object::RRR_Object_Obj46.PyVxCoVnce = convertRawToPhysical(raw_value, 0.005, -10.0);

    raw_value=copyBitsFromByteArrayLE( byteArray, 24396, 12);
    @CAN_RadarRR::RRR_Object::RRR_Object_Obj46.PyVyCoVnce = convertRawToPhysical(raw_value, 0.005, -10.0);

    raw_value=copyBitsFromByteArrayLE( byteArray, 24236, 10);
    @CAN_RadarRR::RRR_Object::RRR_Object_Obj46.RCS = convertRawToPhysical(raw_value, 0.2, -102.4);

    raw_value=copyBitsFromByteArrayLE( byteArray, 24408, 4);
    @CAN_RadarRR::RRR_Object::RRR_Object_Obj46.ReferencePoint = convertRawToPhysical(raw_value, 1.0, 0.0);

    raw_value=copyBitsFromByteArrayLE( byteArray, 24268, 12);
    @CAN_RadarRR::RRR_Object::RRR_Object_Obj46.Vx = convertRawToPhysical(raw_value, 0.0625, -128.0);

    raw_value=copyBitsFromByteArrayLE( byteArray, 24492, 12);
    @CAN_RadarRR::RRR_Object::RRR_Object_Obj46.VxAxCoVnce = convertRawToPhysical(raw_value, 0.005, -10.0);

    raw_value=copyBitsFromByteArrayLE( byteArray, 24512, 12);
    @CAN_RadarRR::RRR_Object::RRR_Object_Obj46.VxAyCoVnce = convertRawToPhysical(raw_value, 0.005, -10.0);

    raw_value=copyBitsFromByteArrayLE( byteArray, 24288, 12);
    @CAN_RadarRR::RRR_Object::RRR_Object_Obj46.VxVnce = convertRawToPhysical(raw_value, 0.005, 0.0);

    raw_value=copyBitsFromByteArrayLE( byteArray, 24480, 12);
    @CAN_RadarRR::RRR_Object::RRR_Object_Obj46.VxVyCoVnce = convertRawToPhysical(raw_value, 0.005, -10.0);

    raw_value=copyBitsFromByteArrayLE( byteArray, 24302, 10);
    @CAN_RadarRR::RRR_Object::RRR_Object_Obj46.Vy = convertRawToPhysical(raw_value, 0.125, -64.0);

    raw_value=copyBitsFromByteArrayLE( byteArray, 24524, 12);
    @CAN_RadarRR::RRR_Object::RRR_Object_Obj46.VyAxCoVnce = convertRawToPhysical(raw_value, 0.005, -10.0);

    raw_value=copyBitsFromByteArrayLE( byteArray, 24544, 12);
    @CAN_RadarRR::RRR_Object::RRR_Object_Obj46.VyAyCoVnce = convertRawToPhysical(raw_value, 0.005, -10.0);

    raw_value=copyBitsFromByteArrayLE( byteArray, 24320, 12);
    @CAN_RadarRR::RRR_Object::RRR_Object_Obj46.VyVnce = convertRawToPhysical(raw_value, 0.005, 0.0);

    raw_value=copyBitsFromByteArrayLE( byteArray, 24216, 7);
    @CAN_RadarRR::RRR_Object::RRR_Object_Obj46.Width = convertRawToPhysical(raw_value, 0.125, 0.0);

    raw_value=copyBitsFromByteArrayLE( byteArray, 24224, 12);
    @CAN_RadarRR::RRR_Object::RRR_Object_Obj46.WidthVnce = convertRawToPhysical(raw_value, 0.005, 0.0);
}


void CRadarRR_RRR_Object_Obj47_SetDataReceived(byte byteArray[])
{
    qword raw_value;

    raw_value=copyBitsFromByteArrayLE( byteArray, 25088, 32);
    @CAN_RadarRR::RRR_Object::RRR_Object_Obj47.Age = convertRawToPhysical(raw_value, 1.0, 0.0);

    raw_value=copyBitsFromByteArrayLE( byteArray, 24684, 10);
    @CAN_RadarRR::RRR_Object::RRR_Object_Obj47.Ax = convertRawToPhysical(raw_value, 0.03125, -16.0);

    raw_value=copyBitsFromByteArrayLE( byteArray, 25068, 12);
    @CAN_RadarRR::RRR_Object::RRR_Object_Obj47.AxAyCoVnce = convertRawToPhysical(raw_value, 0.005, -10.0);

    raw_value=copyBitsFromByteArrayLE( byteArray, 24704, 12);
    @CAN_RadarRR::RRR_Object::RRR_Object_Obj47.AxVnce = convertRawToPhysical(raw_value, 0.005, 0.0);

    raw_value=copyBitsFromByteArrayLE( byteArray, 24758, 9);
    @CAN_RadarRR::RRR_Object::RRR_Object_Obj47.Ay = convertRawToPhysical(raw_value, 0.0625, -16.0);

    raw_value=copyBitsFromByteArrayLE( byteArray, 24768, 12);
    @CAN_RadarRR::RRR_Object::RRR_Object_Obj47.AyVnce = convertRawToPhysical(raw_value, 0.005, 0.0);

    raw_value=copyBitsFromByteArrayLE( byteArray, 24824, 6);
    @CAN_RadarRR::RRR_Object::RRR_Object_Obj47.ExistProb = convertRawToPhysical(raw_value, 2.0, 0.0);

    raw_value=copyBitsFromByteArrayLE( byteArray, 24888, 8);
    @CAN_RadarRR::RRR_Object::RRR_Object_Obj47.FilterInformation = convertRawToPhysical(raw_value, 1.0, 0.0);

    raw_value=copyBitsFromByteArrayLE( byteArray, 24664, 7);
    @CAN_RadarRR::RRR_Object::RRR_Object_Obj47.Length = convertRawToPhysical(raw_value, 0.125, 0.0);

    raw_value=copyBitsFromByteArrayLE( byteArray, 24672, 12);
    @CAN_RadarRR::RRR_Object::RRR_Object_Obj47.LengthVnce = convertRawToPhysical(raw_value, 0.005, 0.0);

    raw_value=copyBitsFromByteArrayLE( byteArray, 24856, 3);
    @CAN_RadarRR::RRR_Object::RRR_Object_Obj47.MeasurementStatus = convertRawToPhysical(raw_value, 1.0, 0.0);

    raw_value=copyBitsFromByteArrayLE( byteArray, 24812, 2);
    @CAN_RadarRR::RRR_Object::RRR_Object_Obj47.MovingStatus = convertRawToPhysical(raw_value, 1.0, 0.0);

    raw_value=copyBitsFromByteArrayLE( byteArray, 24792, 7);
    @CAN_RadarRR::RRR_Object::RRR_Object_Obj47.ObjId = convertRawToPhysical(raw_value, 1.0, 0.0);

    raw_value=copyBitsFromByteArrayLE( byteArray, 24694, 9);
    @CAN_RadarRR::RRR_Object::RRR_Object_Obj47.OrientationYaw = convertRawToPhysical(raw_value, 0.0175, -4.48);

    raw_value=copyBitsFromByteArrayLE( byteArray, 24716, 12);
    @CAN_RadarRR::RRR_Object::RRR_Object_Obj47.OrientationYawVnce = convertRawToPhysical(raw_value, 0.0003, 0.0);

    raw_value=copyBitsFromByteArrayLE( byteArray, 24608, 6);
    @CAN_RadarRR::RRR_Object::RRR_Object_Obj47.ProbClassConfidence = convertRawToPhysical(raw_value, 2.0, 0.0);

    raw_value=copyBitsFromByteArrayLE( byteArray, 24859, 4);
    @CAN_RadarRR::RRR_Object::RRR_Object_Obj47.ProbClassType = convertRawToPhysical(raw_value, 1.0, 0.0);

    raw_value=copyBitsFromByteArrayLE( byteArray, 24614, 14);
    @CAN_RadarRR::RRR_Object::RRR_Object_Obj47.Px = convertRawToPhysical(raw_value, 0.0625, -512.0);

    raw_value=copyBitsFromByteArrayLE( byteArray, 24928, 12);
    @CAN_RadarRR::RRR_Object::RRR_Object_Obj47.PxAxCoVnce = convertRawToPhysical(raw_value, 0.005, -10.0);

    raw_value=copyBitsFromByteArrayLE( byteArray, 24940, 12);
    @CAN_RadarRR::RRR_Object::RRR_Object_Obj47.PxAyCoVnce = convertRawToPhysical(raw_value, 0.005, -10.0);

    raw_value=copyBitsFromByteArrayLE( byteArray, 24844, 12);
    @CAN_RadarRR::RRR_Object::RRR_Object_Obj47.PxPyCoVnce = convertRawToPhysical(raw_value, 0.005, -10.0);

    raw_value=copyBitsFromByteArrayLE( byteArray, 24628, 12);
    @CAN_RadarRR::RRR_Object::RRR_Object_Obj47.PxVnce = convertRawToPhysical(raw_value, 0.005, 0.0);

    raw_value=copyBitsFromByteArrayLE( byteArray, 24864, 12);
    @CAN_RadarRR::RRR_Object::RRR_Object_Obj47.PxVxCoVnce = convertRawToPhysical(raw_value, 0.005, -10.0);

    raw_value=copyBitsFromByteArrayLE( byteArray, 24876, 12);
    @CAN_RadarRR::RRR_Object::RRR_Object_Obj47.PxVyCoVnce = convertRawToPhysical(raw_value, 0.005, -10.0);

    raw_value=copyBitsFromByteArrayLE( byteArray, 24640, 12);
    @CAN_RadarRR::RRR_Object::RRR_Object_Obj47.Py = convertRawToPhysical(raw_value, 0.0625, -128.0);

    raw_value=copyBitsFromByteArrayLE( byteArray, 24960, 12);
    @CAN_RadarRR::RRR_Object::RRR_Object_Obj47.PyAxCoVnce = convertRawToPhysical(raw_value, 0.005, -10.0);

    raw_value=copyBitsFromByteArrayLE( byteArray, 24972, 12);
    @CAN_RadarRR::RRR_Object::RRR_Object_Obj47.PyAyCoVnce = convertRawToPhysical(raw_value, 0.005, -10.0);

    raw_value=copyBitsFromByteArrayLE( byteArray, 24652, 12);
    @CAN_RadarRR::RRR_Object::RRR_Object_Obj47.PyVnce = convertRawToPhysical(raw_value, 0.005, 0.0);

    raw_value=copyBitsFromByteArrayLE( byteArray, 24896, 12);
    @CAN_RadarRR::RRR_Object::RRR_Object_Obj47.PyVxCoVnce = convertRawToPhysical(raw_value, 0.005, -10.0);

    raw_value=copyBitsFromByteArrayLE( byteArray, 24908, 12);
    @CAN_RadarRR::RRR_Object::RRR_Object_Obj47.PyVyCoVnce = convertRawToPhysical(raw_value, 0.005, -10.0);

    raw_value=copyBitsFromByteArrayLE( byteArray, 24748, 10);
    @CAN_RadarRR::RRR_Object::RRR_Object_Obj47.RCS = convertRawToPhysical(raw_value, 0.2, -102.4);

    raw_value=copyBitsFromByteArrayLE( byteArray, 24920, 4);
    @CAN_RadarRR::RRR_Object::RRR_Object_Obj47.ReferencePoint = convertRawToPhysical(raw_value, 1.0, 0.0);

    raw_value=copyBitsFromByteArrayLE( byteArray, 24780, 12);
    @CAN_RadarRR::RRR_Object::RRR_Object_Obj47.Vx = convertRawToPhysical(raw_value, 0.0625, -128.0);

    raw_value=copyBitsFromByteArrayLE( byteArray, 25004, 12);
    @CAN_RadarRR::RRR_Object::RRR_Object_Obj47.VxAxCoVnce = convertRawToPhysical(raw_value, 0.005, -10.0);

    raw_value=copyBitsFromByteArrayLE( byteArray, 25024, 12);
    @CAN_RadarRR::RRR_Object::RRR_Object_Obj47.VxAyCoVnce = convertRawToPhysical(raw_value, 0.005, -10.0);

    raw_value=copyBitsFromByteArrayLE( byteArray, 24800, 12);
    @CAN_RadarRR::RRR_Object::RRR_Object_Obj47.VxVnce = convertRawToPhysical(raw_value, 0.005, 0.0);

    raw_value=copyBitsFromByteArrayLE( byteArray, 24992, 12);
    @CAN_RadarRR::RRR_Object::RRR_Object_Obj47.VxVyCoVnce = convertRawToPhysical(raw_value, 0.005, -10.0);

    raw_value=copyBitsFromByteArrayLE( byteArray, 24814, 10);
    @CAN_RadarRR::RRR_Object::RRR_Object_Obj47.Vy = convertRawToPhysical(raw_value, 0.125, -64.0);

    raw_value=copyBitsFromByteArrayLE( byteArray, 25036, 12);
    @CAN_RadarRR::RRR_Object::RRR_Object_Obj47.VyAxCoVnce = convertRawToPhysical(raw_value, 0.005, -10.0);

    raw_value=copyBitsFromByteArrayLE( byteArray, 25056, 12);
    @CAN_RadarRR::RRR_Object::RRR_Object_Obj47.VyAyCoVnce = convertRawToPhysical(raw_value, 0.005, -10.0);

    raw_value=copyBitsFromByteArrayLE( byteArray, 24832, 12);
    @CAN_RadarRR::RRR_Object::RRR_Object_Obj47.VyVnce = convertRawToPhysical(raw_value, 0.005, 0.0);

    raw_value=copyBitsFromByteArrayLE( byteArray, 24728, 7);
    @CAN_RadarRR::RRR_Object::RRR_Object_Obj47.Width = convertRawToPhysical(raw_value, 0.125, 0.0);

    raw_value=copyBitsFromByteArrayLE( byteArray, 24736, 12);
    @CAN_RadarRR::RRR_Object::RRR_Object_Obj47.WidthVnce = convertRawToPhysical(raw_value, 0.005, 0.0);
}


void CRadarRR_RRR_Object_Obj48_SetDataReceived(byte byteArray[])
{
    qword raw_value;

    raw_value=copyBitsFromByteArrayLE( byteArray, 25600, 32);
    @CAN_RadarRR::RRR_Object::RRR_Object_Obj48.Age = convertRawToPhysical(raw_value, 1.0, 0.0);

    raw_value=copyBitsFromByteArrayLE( byteArray, 25196, 10);
    @CAN_RadarRR::RRR_Object::RRR_Object_Obj48.Ax = convertRawToPhysical(raw_value, 0.03125, -16.0);

    raw_value=copyBitsFromByteArrayLE( byteArray, 25580, 12);
    @CAN_RadarRR::RRR_Object::RRR_Object_Obj48.AxAyCoVnce = convertRawToPhysical(raw_value, 0.005, -10.0);

    raw_value=copyBitsFromByteArrayLE( byteArray, 25216, 12);
    @CAN_RadarRR::RRR_Object::RRR_Object_Obj48.AxVnce = convertRawToPhysical(raw_value, 0.005, 0.0);

    raw_value=copyBitsFromByteArrayLE( byteArray, 25270, 9);
    @CAN_RadarRR::RRR_Object::RRR_Object_Obj48.Ay = convertRawToPhysical(raw_value, 0.0625, -16.0);

    raw_value=copyBitsFromByteArrayLE( byteArray, 25280, 12);
    @CAN_RadarRR::RRR_Object::RRR_Object_Obj48.AyVnce = convertRawToPhysical(raw_value, 0.005, 0.0);

    raw_value=copyBitsFromByteArrayLE( byteArray, 25336, 6);
    @CAN_RadarRR::RRR_Object::RRR_Object_Obj48.ExistProb = convertRawToPhysical(raw_value, 2.0, 0.0);

    raw_value=copyBitsFromByteArrayLE( byteArray, 25400, 8);
    @CAN_RadarRR::RRR_Object::RRR_Object_Obj48.FilterInformation = convertRawToPhysical(raw_value, 1.0, 0.0);

    raw_value=copyBitsFromByteArrayLE( byteArray, 25176, 7);
    @CAN_RadarRR::RRR_Object::RRR_Object_Obj48.Length = convertRawToPhysical(raw_value, 0.125, 0.0);

    raw_value=copyBitsFromByteArrayLE( byteArray, 25184, 12);
    @CAN_RadarRR::RRR_Object::RRR_Object_Obj48.LengthVnce = convertRawToPhysical(raw_value, 0.005, 0.0);

    raw_value=copyBitsFromByteArrayLE( byteArray, 25368, 3);
    @CAN_RadarRR::RRR_Object::RRR_Object_Obj48.MeasurementStatus = convertRawToPhysical(raw_value, 1.0, 0.0);

    raw_value=copyBitsFromByteArrayLE( byteArray, 25324, 2);
    @CAN_RadarRR::RRR_Object::RRR_Object_Obj48.MovingStatus = convertRawToPhysical(raw_value, 1.0, 0.0);

    raw_value=copyBitsFromByteArrayLE( byteArray, 25304, 7);
    @CAN_RadarRR::RRR_Object::RRR_Object_Obj48.ObjId = convertRawToPhysical(raw_value, 1.0, 0.0);

    raw_value=copyBitsFromByteArrayLE( byteArray, 25206, 9);
    @CAN_RadarRR::RRR_Object::RRR_Object_Obj48.OrientationYaw = convertRawToPhysical(raw_value, 0.0175, -4.48);

    raw_value=copyBitsFromByteArrayLE( byteArray, 25228, 12);
    @CAN_RadarRR::RRR_Object::RRR_Object_Obj48.OrientationYawVnce = convertRawToPhysical(raw_value, 0.0003, 0.0);

    raw_value=copyBitsFromByteArrayLE( byteArray, 25120, 6);
    @CAN_RadarRR::RRR_Object::RRR_Object_Obj48.ProbClassConfidence = convertRawToPhysical(raw_value, 2.0, 0.0);

    raw_value=copyBitsFromByteArrayLE( byteArray, 25371, 4);
    @CAN_RadarRR::RRR_Object::RRR_Object_Obj48.ProbClassType = convertRawToPhysical(raw_value, 1.0, 0.0);

    raw_value=copyBitsFromByteArrayLE( byteArray, 25126, 14);
    @CAN_RadarRR::RRR_Object::RRR_Object_Obj48.Px = convertRawToPhysical(raw_value, 0.0625, -512.0);

    raw_value=copyBitsFromByteArrayLE( byteArray, 25440, 12);
    @CAN_RadarRR::RRR_Object::RRR_Object_Obj48.PxAxCoVnce = convertRawToPhysical(raw_value, 0.005, -10.0);

    raw_value=copyBitsFromByteArrayLE( byteArray, 25452, 12);
    @CAN_RadarRR::RRR_Object::RRR_Object_Obj48.PxAyCoVnce = convertRawToPhysical(raw_value, 0.005, -10.0);

    raw_value=copyBitsFromByteArrayLE( byteArray, 25356, 12);
    @CAN_RadarRR::RRR_Object::RRR_Object_Obj48.PxPyCoVnce = convertRawToPhysical(raw_value, 0.005, -10.0);

    raw_value=copyBitsFromByteArrayLE( byteArray, 25140, 12);
    @CAN_RadarRR::RRR_Object::RRR_Object_Obj48.PxVnce = convertRawToPhysical(raw_value, 0.005, 0.0);

    raw_value=copyBitsFromByteArrayLE( byteArray, 25376, 12);
    @CAN_RadarRR::RRR_Object::RRR_Object_Obj48.PxVxCoVnce = convertRawToPhysical(raw_value, 0.005, -10.0);

    raw_value=copyBitsFromByteArrayLE( byteArray, 25388, 12);
    @CAN_RadarRR::RRR_Object::RRR_Object_Obj48.PxVyCoVnce = convertRawToPhysical(raw_value, 0.005, -10.0);

    raw_value=copyBitsFromByteArrayLE( byteArray, 25152, 12);
    @CAN_RadarRR::RRR_Object::RRR_Object_Obj48.Py = convertRawToPhysical(raw_value, 0.0625, -128.0);

    raw_value=copyBitsFromByteArrayLE( byteArray, 25472, 12);
    @CAN_RadarRR::RRR_Object::RRR_Object_Obj48.PyAxCoVnce = convertRawToPhysical(raw_value, 0.005, -10.0);

    raw_value=copyBitsFromByteArrayLE( byteArray, 25484, 12);
    @CAN_RadarRR::RRR_Object::RRR_Object_Obj48.PyAyCoVnce = convertRawToPhysical(raw_value, 0.005, -10.0);

    raw_value=copyBitsFromByteArrayLE( byteArray, 25164, 12);
    @CAN_RadarRR::RRR_Object::RRR_Object_Obj48.PyVnce = convertRawToPhysical(raw_value, 0.005, 0.0);

    raw_value=copyBitsFromByteArrayLE( byteArray, 25408, 12);
    @CAN_RadarRR::RRR_Object::RRR_Object_Obj48.PyVxCoVnce = convertRawToPhysical(raw_value, 0.005, -10.0);

    raw_value=copyBitsFromByteArrayLE( byteArray, 25420, 12);
    @CAN_RadarRR::RRR_Object::RRR_Object_Obj48.PyVyCoVnce = convertRawToPhysical(raw_value, 0.005, -10.0);

    raw_value=copyBitsFromByteArrayLE( byteArray, 25260, 10);
    @CAN_RadarRR::RRR_Object::RRR_Object_Obj48.RCS = convertRawToPhysical(raw_value, 0.2, -102.4);

    raw_value=copyBitsFromByteArrayLE( byteArray, 25432, 4);
    @CAN_RadarRR::RRR_Object::RRR_Object_Obj48.ReferencePoint = convertRawToPhysical(raw_value, 1.0, 0.0);

    raw_value=copyBitsFromByteArrayLE( byteArray, 25292, 12);
    @CAN_RadarRR::RRR_Object::RRR_Object_Obj48.Vx = convertRawToPhysical(raw_value, 0.0625, -128.0);

    raw_value=copyBitsFromByteArrayLE( byteArray, 25516, 12);
    @CAN_RadarRR::RRR_Object::RRR_Object_Obj48.VxAxCoVnce = convertRawToPhysical(raw_value, 0.005, -10.0);

    raw_value=copyBitsFromByteArrayLE( byteArray, 25536, 12);
    @CAN_RadarRR::RRR_Object::RRR_Object_Obj48.VxAyCoVnce = convertRawToPhysical(raw_value, 0.005, -10.0);

    raw_value=copyBitsFromByteArrayLE( byteArray, 25312, 12);
    @CAN_RadarRR::RRR_Object::RRR_Object_Obj48.VxVnce = convertRawToPhysical(raw_value, 0.005, 0.0);

    raw_value=copyBitsFromByteArrayLE( byteArray, 25504, 12);
    @CAN_RadarRR::RRR_Object::RRR_Object_Obj48.VxVyCoVnce = convertRawToPhysical(raw_value, 0.005, -10.0);

    raw_value=copyBitsFromByteArrayLE( byteArray, 25326, 10);
    @CAN_RadarRR::RRR_Object::RRR_Object_Obj48.Vy = convertRawToPhysical(raw_value, 0.125, -64.0);

    raw_value=copyBitsFromByteArrayLE( byteArray, 25548, 12);
    @CAN_RadarRR::RRR_Object::RRR_Object_Obj48.VyAxCoVnce = convertRawToPhysical(raw_value, 0.005, -10.0);

    raw_value=copyBitsFromByteArrayLE( byteArray, 25568, 12);
    @CAN_RadarRR::RRR_Object::RRR_Object_Obj48.VyAyCoVnce = convertRawToPhysical(raw_value, 0.005, -10.0);

    raw_value=copyBitsFromByteArrayLE( byteArray, 25344, 12);
    @CAN_RadarRR::RRR_Object::RRR_Object_Obj48.VyVnce = convertRawToPhysical(raw_value, 0.005, 0.0);

    raw_value=copyBitsFromByteArrayLE( byteArray, 25240, 7);
    @CAN_RadarRR::RRR_Object::RRR_Object_Obj48.Width = convertRawToPhysical(raw_value, 0.125, 0.0);

    raw_value=copyBitsFromByteArrayLE( byteArray, 25248, 12);
    @CAN_RadarRR::RRR_Object::RRR_Object_Obj48.WidthVnce = convertRawToPhysical(raw_value, 0.005, 0.0);
}


void CRadarRR_RRR_Object_Obj5_SetDataReceived(byte byteArray[])
{
    qword raw_value;

    raw_value=copyBitsFromByteArrayLE( byteArray, 3584, 32);
    @CAN_RadarRR::RRR_Object::RRR_Object_Obj5.Age = convertRawToPhysical(raw_value, 1.0, 0.0);

    raw_value=copyBitsFromByteArrayLE( byteArray, 3180, 10);
    @CAN_RadarRR::RRR_Object::RRR_Object_Obj5.Ax = convertRawToPhysical(raw_value, 0.03125, -16.0);

    raw_value=copyBitsFromByteArrayLE( byteArray, 3564, 12);
    @CAN_RadarRR::RRR_Object::RRR_Object_Obj5.AxAyCoVnce = convertRawToPhysical(raw_value, 0.005, -10.0);

    raw_value=copyBitsFromByteArrayLE( byteArray, 3200, 12);
    @CAN_RadarRR::RRR_Object::RRR_Object_Obj5.AxVnce = convertRawToPhysical(raw_value, 0.005, 0.0);

    raw_value=copyBitsFromByteArrayLE( byteArray, 3254, 9);
    @CAN_RadarRR::RRR_Object::RRR_Object_Obj5.Ay = convertRawToPhysical(raw_value, 0.0625, -16.0);

    raw_value=copyBitsFromByteArrayLE( byteArray, 3264, 12);
    @CAN_RadarRR::RRR_Object::RRR_Object_Obj5.AyVnce = convertRawToPhysical(raw_value, 0.005, 0.0);

    raw_value=copyBitsFromByteArrayLE( byteArray, 3320, 6);
    @CAN_RadarRR::RRR_Object::RRR_Object_Obj5.ExistProb = convertRawToPhysical(raw_value, 2.0, 0.0);

    raw_value=copyBitsFromByteArrayLE( byteArray, 3384, 8);
    @CAN_RadarRR::RRR_Object::RRR_Object_Obj5.FilterInformation = convertRawToPhysical(raw_value, 1.0, 0.0);

    raw_value=copyBitsFromByteArrayLE( byteArray, 3160, 7);
    @CAN_RadarRR::RRR_Object::RRR_Object_Obj5.Length = convertRawToPhysical(raw_value, 0.125, 0.0);

    raw_value=copyBitsFromByteArrayLE( byteArray, 3168, 12);
    @CAN_RadarRR::RRR_Object::RRR_Object_Obj5.LengthVnce = convertRawToPhysical(raw_value, 0.005, 0.0);

    raw_value=copyBitsFromByteArrayLE( byteArray, 3352, 3);
    @CAN_RadarRR::RRR_Object::RRR_Object_Obj5.MeasurementStatus = convertRawToPhysical(raw_value, 1.0, 0.0);

    raw_value=copyBitsFromByteArrayLE( byteArray, 3308, 2);
    @CAN_RadarRR::RRR_Object::RRR_Object_Obj5.MovingStatus = convertRawToPhysical(raw_value, 1.0, 0.0);

    raw_value=copyBitsFromByteArrayLE( byteArray, 3288, 7);
    @CAN_RadarRR::RRR_Object::RRR_Object_Obj5.ObjId = convertRawToPhysical(raw_value, 1.0, 0.0);

    raw_value=copyBitsFromByteArrayLE( byteArray, 3190, 9);
    @CAN_RadarRR::RRR_Object::RRR_Object_Obj5.OrientationYaw = convertRawToPhysical(raw_value, 0.0175, -4.48);

    raw_value=copyBitsFromByteArrayLE( byteArray, 3212, 12);
    @CAN_RadarRR::RRR_Object::RRR_Object_Obj5.OrientationYawVnce = convertRawToPhysical(raw_value, 0.0003, 0.0);

    raw_value=copyBitsFromByteArrayLE( byteArray, 3104, 6);
    @CAN_RadarRR::RRR_Object::RRR_Object_Obj5.ProbClassConfidence = convertRawToPhysical(raw_value, 2.0, 0.0);

    raw_value=copyBitsFromByteArrayLE( byteArray, 3355, 4);
    @CAN_RadarRR::RRR_Object::RRR_Object_Obj5.ProbClassType = convertRawToPhysical(raw_value, 1.0, 0.0);

    raw_value=copyBitsFromByteArrayLE( byteArray, 3110, 14);
    @CAN_RadarRR::RRR_Object::RRR_Object_Obj5.Px = convertRawToPhysical(raw_value, 0.0625, -512.0);

    raw_value=copyBitsFromByteArrayLE( byteArray, 3424, 12);
    @CAN_RadarRR::RRR_Object::RRR_Object_Obj5.PxAxCoVnce = convertRawToPhysical(raw_value, 0.005, -10.0);

    raw_value=copyBitsFromByteArrayLE( byteArray, 3436, 12);
    @CAN_RadarRR::RRR_Object::RRR_Object_Obj5.PxAyCoVnce = convertRawToPhysical(raw_value, 0.005, -10.0);

    raw_value=copyBitsFromByteArrayLE( byteArray, 3340, 12);
    @CAN_RadarRR::RRR_Object::RRR_Object_Obj5.PxPyCoVnce = convertRawToPhysical(raw_value, 0.005, -10.0);

    raw_value=copyBitsFromByteArrayLE( byteArray, 3124, 12);
    @CAN_RadarRR::RRR_Object::RRR_Object_Obj5.PxVnce = convertRawToPhysical(raw_value, 0.005, 0.0);

    raw_value=copyBitsFromByteArrayLE( byteArray, 3360, 12);
    @CAN_RadarRR::RRR_Object::RRR_Object_Obj5.PxVxCoVnce = convertRawToPhysical(raw_value, 0.005, -10.0);

    raw_value=copyBitsFromByteArrayLE( byteArray, 3372, 12);
    @CAN_RadarRR::RRR_Object::RRR_Object_Obj5.PxVyCoVnce = convertRawToPhysical(raw_value, 0.005, -10.0);

    raw_value=copyBitsFromByteArrayLE( byteArray, 3136, 12);
    @CAN_RadarRR::RRR_Object::RRR_Object_Obj5.Py = convertRawToPhysical(raw_value, 0.0625, -128.0);

    raw_value=copyBitsFromByteArrayLE( byteArray, 3456, 12);
    @CAN_RadarRR::RRR_Object::RRR_Object_Obj5.PyAxCoVnce = convertRawToPhysical(raw_value, 0.005, -10.0);

    raw_value=copyBitsFromByteArrayLE( byteArray, 3468, 12);
    @CAN_RadarRR::RRR_Object::RRR_Object_Obj5.PyAyCoVnce = convertRawToPhysical(raw_value, 0.005, -10.0);

    raw_value=copyBitsFromByteArrayLE( byteArray, 3148, 12);
    @CAN_RadarRR::RRR_Object::RRR_Object_Obj5.PyVnce = convertRawToPhysical(raw_value, 0.005, 0.0);

    raw_value=copyBitsFromByteArrayLE( byteArray, 3392, 12);
    @CAN_RadarRR::RRR_Object::RRR_Object_Obj5.PyVxCoVnce = convertRawToPhysical(raw_value, 0.005, -10.0);

    raw_value=copyBitsFromByteArrayLE( byteArray, 3404, 12);
    @CAN_RadarRR::RRR_Object::RRR_Object_Obj5.PyVyCoVnce = convertRawToPhysical(raw_value, 0.005, -10.0);

    raw_value=copyBitsFromByteArrayLE( byteArray, 3244, 10);
    @CAN_RadarRR::RRR_Object::RRR_Object_Obj5.RCS = convertRawToPhysical(raw_value, 0.2, -102.4);

    raw_value=copyBitsFromByteArrayLE( byteArray, 3416, 4);
    @CAN_RadarRR::RRR_Object::RRR_Object_Obj5.ReferencePoint = convertRawToPhysical(raw_value, 1.0, 0.0);

    raw_value=copyBitsFromByteArrayLE( byteArray, 3276, 12);
    @CAN_RadarRR::RRR_Object::RRR_Object_Obj5.Vx = convertRawToPhysical(raw_value, 0.0625, -128.0);

    raw_value=copyBitsFromByteArrayLE( byteArray, 3500, 12);
    @CAN_RadarRR::RRR_Object::RRR_Object_Obj5.VxAxCoVnce = convertRawToPhysical(raw_value, 0.005, -10.0);

    raw_value=copyBitsFromByteArrayLE( byteArray, 3520, 12);
    @CAN_RadarRR::RRR_Object::RRR_Object_Obj5.VxAyCoVnce = convertRawToPhysical(raw_value, 0.005, -10.0);

    raw_value=copyBitsFromByteArrayLE( byteArray, 3296, 12);
    @CAN_RadarRR::RRR_Object::RRR_Object_Obj5.VxVnce = convertRawToPhysical(raw_value, 0.005, 0.0);

    raw_value=copyBitsFromByteArrayLE( byteArray, 3488, 12);
    @CAN_RadarRR::RRR_Object::RRR_Object_Obj5.VxVyCoVnce = convertRawToPhysical(raw_value, 0.005, -10.0);

    raw_value=copyBitsFromByteArrayLE( byteArray, 3310, 10);
    @CAN_RadarRR::RRR_Object::RRR_Object_Obj5.Vy = convertRawToPhysical(raw_value, 0.125, -64.0);

    raw_value=copyBitsFromByteArrayLE( byteArray, 3532, 12);
    @CAN_RadarRR::RRR_Object::RRR_Object_Obj5.VyAxCoVnce = convertRawToPhysical(raw_value, 0.005, -10.0);

    raw_value=copyBitsFromByteArrayLE( byteArray, 3552, 12);
    @CAN_RadarRR::RRR_Object::RRR_Object_Obj5.VyAyCoVnce = convertRawToPhysical(raw_value, 0.005, -10.0);

    raw_value=copyBitsFromByteArrayLE( byteArray, 3328, 12);
    @CAN_RadarRR::RRR_Object::RRR_Object_Obj5.VyVnce = convertRawToPhysical(raw_value, 0.005, 0.0);

    raw_value=copyBitsFromByteArrayLE( byteArray, 3224, 7);
    @CAN_RadarRR::RRR_Object::RRR_Object_Obj5.Width = convertRawToPhysical(raw_value, 0.125, 0.0);

    raw_value=copyBitsFromByteArrayLE( byteArray, 3232, 12);
    @CAN_RadarRR::RRR_Object::RRR_Object_Obj5.WidthVnce = convertRawToPhysical(raw_value, 0.005, 0.0);
}


void CRadarRR_RRR_Object_Obj6_SetDataReceived(byte byteArray[])
{
    qword raw_value;

    raw_value=copyBitsFromByteArrayLE( byteArray, 4096, 32);
    @CAN_RadarRR::RRR_Object::RRR_Object_Obj6.Age = convertRawToPhysical(raw_value, 1.0, 0.0);

    raw_value=copyBitsFromByteArrayLE( byteArray, 3692, 10);
    @CAN_RadarRR::RRR_Object::RRR_Object_Obj6.Ax = convertRawToPhysical(raw_value, 0.03125, -16.0);

    raw_value=copyBitsFromByteArrayLE( byteArray, 4076, 12);
    @CAN_RadarRR::RRR_Object::RRR_Object_Obj6.AxAyCoVnce = convertRawToPhysical(raw_value, 0.005, -10.0);

    raw_value=copyBitsFromByteArrayLE( byteArray, 3712, 12);
    @CAN_RadarRR::RRR_Object::RRR_Object_Obj6.AxVnce = convertRawToPhysical(raw_value, 0.005, 0.0);

    raw_value=copyBitsFromByteArrayLE( byteArray, 3766, 9);
    @CAN_RadarRR::RRR_Object::RRR_Object_Obj6.Ay = convertRawToPhysical(raw_value, 0.0625, -16.0);

    raw_value=copyBitsFromByteArrayLE( byteArray, 3776, 12);
    @CAN_RadarRR::RRR_Object::RRR_Object_Obj6.AyVnce = convertRawToPhysical(raw_value, 0.005, 0.0);

    raw_value=copyBitsFromByteArrayLE( byteArray, 3832, 6);
    @CAN_RadarRR::RRR_Object::RRR_Object_Obj6.ExistProb = convertRawToPhysical(raw_value, 2.0, 0.0);

    raw_value=copyBitsFromByteArrayLE( byteArray, 3896, 8);
    @CAN_RadarRR::RRR_Object::RRR_Object_Obj6.FilterInformation = convertRawToPhysical(raw_value, 1.0, 0.0);

    raw_value=copyBitsFromByteArrayLE( byteArray, 3672, 7);
    @CAN_RadarRR::RRR_Object::RRR_Object_Obj6.Length = convertRawToPhysical(raw_value, 0.125, 0.0);

    raw_value=copyBitsFromByteArrayLE( byteArray, 3680, 12);
    @CAN_RadarRR::RRR_Object::RRR_Object_Obj6.LengthVnce = convertRawToPhysical(raw_value, 0.005, 0.0);

    raw_value=copyBitsFromByteArrayLE( byteArray, 3864, 3);
    @CAN_RadarRR::RRR_Object::RRR_Object_Obj6.MeasurementStatus = convertRawToPhysical(raw_value, 1.0, 0.0);

    raw_value=copyBitsFromByteArrayLE( byteArray, 3820, 2);
    @CAN_RadarRR::RRR_Object::RRR_Object_Obj6.MovingStatus = convertRawToPhysical(raw_value, 1.0, 0.0);

    raw_value=copyBitsFromByteArrayLE( byteArray, 3800, 7);
    @CAN_RadarRR::RRR_Object::RRR_Object_Obj6.ObjId = convertRawToPhysical(raw_value, 1.0, 0.0);

    raw_value=copyBitsFromByteArrayLE( byteArray, 3702, 9);
    @CAN_RadarRR::RRR_Object::RRR_Object_Obj6.OrientationYaw = convertRawToPhysical(raw_value, 0.0175, -4.48);

    raw_value=copyBitsFromByteArrayLE( byteArray, 3724, 12);
    @CAN_RadarRR::RRR_Object::RRR_Object_Obj6.OrientationYawVnce = convertRawToPhysical(raw_value, 0.0003, 0.0);

    raw_value=copyBitsFromByteArrayLE( byteArray, 3616, 6);
    @CAN_RadarRR::RRR_Object::RRR_Object_Obj6.ProbClassConfidence = convertRawToPhysical(raw_value, 2.0, 0.0);

    raw_value=copyBitsFromByteArrayLE( byteArray, 3867, 4);
    @CAN_RadarRR::RRR_Object::RRR_Object_Obj6.ProbClassType = convertRawToPhysical(raw_value, 1.0, 0.0);

    raw_value=copyBitsFromByteArrayLE( byteArray, 3622, 14);
    @CAN_RadarRR::RRR_Object::RRR_Object_Obj6.Px = convertRawToPhysical(raw_value, 0.0625, -512.0);

    raw_value=copyBitsFromByteArrayLE( byteArray, 3936, 12);
    @CAN_RadarRR::RRR_Object::RRR_Object_Obj6.PxAxCoVnce = convertRawToPhysical(raw_value, 0.005, -10.0);

    raw_value=copyBitsFromByteArrayLE( byteArray, 3948, 12);
    @CAN_RadarRR::RRR_Object::RRR_Object_Obj6.PxAyCoVnce = convertRawToPhysical(raw_value, 0.005, -10.0);

    raw_value=copyBitsFromByteArrayLE( byteArray, 3852, 12);
    @CAN_RadarRR::RRR_Object::RRR_Object_Obj6.PxPyCoVnce = convertRawToPhysical(raw_value, 0.005, -10.0);

    raw_value=copyBitsFromByteArrayLE( byteArray, 3636, 12);
    @CAN_RadarRR::RRR_Object::RRR_Object_Obj6.PxVnce = convertRawToPhysical(raw_value, 0.005, 0.0);

    raw_value=copyBitsFromByteArrayLE( byteArray, 3872, 12);
    @CAN_RadarRR::RRR_Object::RRR_Object_Obj6.PxVxCoVnce = convertRawToPhysical(raw_value, 0.005, -10.0);

    raw_value=copyBitsFromByteArrayLE( byteArray, 3884, 12);
    @CAN_RadarRR::RRR_Object::RRR_Object_Obj6.PxVyCoVnce = convertRawToPhysical(raw_value, 0.005, -10.0);

    raw_value=copyBitsFromByteArrayLE( byteArray, 3648, 12);
    @CAN_RadarRR::RRR_Object::RRR_Object_Obj6.Py = convertRawToPhysical(raw_value, 0.0625, -128.0);

    raw_value=copyBitsFromByteArrayLE( byteArray, 3968, 12);
    @CAN_RadarRR::RRR_Object::RRR_Object_Obj6.PyAxCoVnce = convertRawToPhysical(raw_value, 0.005, -10.0);

    raw_value=copyBitsFromByteArrayLE( byteArray, 3980, 12);
    @CAN_RadarRR::RRR_Object::RRR_Object_Obj6.PyAyCoVnce = convertRawToPhysical(raw_value, 0.005, -10.0);

    raw_value=copyBitsFromByteArrayLE( byteArray, 3660, 12);
    @CAN_RadarRR::RRR_Object::RRR_Object_Obj6.PyVnce = convertRawToPhysical(raw_value, 0.005, 0.0);

    raw_value=copyBitsFromByteArrayLE( byteArray, 3904, 12);
    @CAN_RadarRR::RRR_Object::RRR_Object_Obj6.PyVxCoVnce = convertRawToPhysical(raw_value, 0.005, -10.0);

    raw_value=copyBitsFromByteArrayLE( byteArray, 3916, 12);
    @CAN_RadarRR::RRR_Object::RRR_Object_Obj6.PyVyCoVnce = convertRawToPhysical(raw_value, 0.005, -10.0);

    raw_value=copyBitsFromByteArrayLE( byteArray, 3756, 10);
    @CAN_RadarRR::RRR_Object::RRR_Object_Obj6.RCS = convertRawToPhysical(raw_value, 0.2, -102.4);

    raw_value=copyBitsFromByteArrayLE( byteArray, 3928, 4);
    @CAN_RadarRR::RRR_Object::RRR_Object_Obj6.ReferencePoint = convertRawToPhysical(raw_value, 1.0, 0.0);

    raw_value=copyBitsFromByteArrayLE( byteArray, 3788, 12);
    @CAN_RadarRR::RRR_Object::RRR_Object_Obj6.Vx = convertRawToPhysical(raw_value, 0.0625, -128.0);

    raw_value=copyBitsFromByteArrayLE( byteArray, 4012, 12);
    @CAN_RadarRR::RRR_Object::RRR_Object_Obj6.VxAxCoVnce = convertRawToPhysical(raw_value, 0.005, -10.0);

    raw_value=copyBitsFromByteArrayLE( byteArray, 4032, 12);
    @CAN_RadarRR::RRR_Object::RRR_Object_Obj6.VxAyCoVnce = convertRawToPhysical(raw_value, 0.005, -10.0);

    raw_value=copyBitsFromByteArrayLE( byteArray, 3808, 12);
    @CAN_RadarRR::RRR_Object::RRR_Object_Obj6.VxVnce = convertRawToPhysical(raw_value, 0.005, 0.0);

    raw_value=copyBitsFromByteArrayLE( byteArray, 4000, 12);
    @CAN_RadarRR::RRR_Object::RRR_Object_Obj6.VxVyCoVnce = convertRawToPhysical(raw_value, 0.005, -10.0);

    raw_value=copyBitsFromByteArrayLE( byteArray, 3822, 10);
    @CAN_RadarRR::RRR_Object::RRR_Object_Obj6.Vy = convertRawToPhysical(raw_value, 0.125, -64.0);

    raw_value=copyBitsFromByteArrayLE( byteArray, 4044, 12);
    @CAN_RadarRR::RRR_Object::RRR_Object_Obj6.VyAxCoVnce = convertRawToPhysical(raw_value, 0.005, -10.0);

    raw_value=copyBitsFromByteArrayLE( byteArray, 4064, 12);
    @CAN_RadarRR::RRR_Object::RRR_Object_Obj6.VyAyCoVnce = convertRawToPhysical(raw_value, 0.005, -10.0);

    raw_value=copyBitsFromByteArrayLE( byteArray, 3840, 12);
    @CAN_RadarRR::RRR_Object::RRR_Object_Obj6.VyVnce = convertRawToPhysical(raw_value, 0.005, 0.0);

    raw_value=copyBitsFromByteArrayLE( byteArray, 3736, 7);
    @CAN_RadarRR::RRR_Object::RRR_Object_Obj6.Width = convertRawToPhysical(raw_value, 0.125, 0.0);

    raw_value=copyBitsFromByteArrayLE( byteArray, 3744, 12);
    @CAN_RadarRR::RRR_Object::RRR_Object_Obj6.WidthVnce = convertRawToPhysical(raw_value, 0.005, 0.0);
}


void CRadarRR_RRR_Object_Obj7_SetDataReceived(byte byteArray[])
{
    qword raw_value;

    raw_value=copyBitsFromByteArrayLE( byteArray, 4608, 32);
    @CAN_RadarRR::RRR_Object::RRR_Object_Obj7.Age = convertRawToPhysical(raw_value, 1.0, 0.0);

    raw_value=copyBitsFromByteArrayLE( byteArray, 4204, 10);
    @CAN_RadarRR::RRR_Object::RRR_Object_Obj7.Ax = convertRawToPhysical(raw_value, 0.03125, -16.0);

    raw_value=copyBitsFromByteArrayLE( byteArray, 4588, 12);
    @CAN_RadarRR::RRR_Object::RRR_Object_Obj7.AxAyCoVnce = convertRawToPhysical(raw_value, 0.005, -10.0);

    raw_value=copyBitsFromByteArrayLE( byteArray, 4224, 12);
    @CAN_RadarRR::RRR_Object::RRR_Object_Obj7.AxVnce = convertRawToPhysical(raw_value, 0.005, 0.0);

    raw_value=copyBitsFromByteArrayLE( byteArray, 4278, 9);
    @CAN_RadarRR::RRR_Object::RRR_Object_Obj7.Ay = convertRawToPhysical(raw_value, 0.0625, -16.0);

    raw_value=copyBitsFromByteArrayLE( byteArray, 4288, 12);
    @CAN_RadarRR::RRR_Object::RRR_Object_Obj7.AyVnce = convertRawToPhysical(raw_value, 0.005, 0.0);

    raw_value=copyBitsFromByteArrayLE( byteArray, 4344, 6);
    @CAN_RadarRR::RRR_Object::RRR_Object_Obj7.ExistProb = convertRawToPhysical(raw_value, 2.0, 0.0);

    raw_value=copyBitsFromByteArrayLE( byteArray, 4408, 8);
    @CAN_RadarRR::RRR_Object::RRR_Object_Obj7.FilterInformation = convertRawToPhysical(raw_value, 1.0, 0.0);

    raw_value=copyBitsFromByteArrayLE( byteArray, 4184, 7);
    @CAN_RadarRR::RRR_Object::RRR_Object_Obj7.Length = convertRawToPhysical(raw_value, 0.125, 0.0);

    raw_value=copyBitsFromByteArrayLE( byteArray, 4192, 12);
    @CAN_RadarRR::RRR_Object::RRR_Object_Obj7.LengthVnce = convertRawToPhysical(raw_value, 0.005, 0.0);

    raw_value=copyBitsFromByteArrayLE( byteArray, 4376, 3);
    @CAN_RadarRR::RRR_Object::RRR_Object_Obj7.MeasurementStatus = convertRawToPhysical(raw_value, 1.0, 0.0);

    raw_value=copyBitsFromByteArrayLE( byteArray, 4332, 2);
    @CAN_RadarRR::RRR_Object::RRR_Object_Obj7.MovingStatus = convertRawToPhysical(raw_value, 1.0, 0.0);

    raw_value=copyBitsFromByteArrayLE( byteArray, 4312, 7);
    @CAN_RadarRR::RRR_Object::RRR_Object_Obj7.ObjId = convertRawToPhysical(raw_value, 1.0, 0.0);

    raw_value=copyBitsFromByteArrayLE( byteArray, 4214, 9);
    @CAN_RadarRR::RRR_Object::RRR_Object_Obj7.OrientationYaw = convertRawToPhysical(raw_value, 0.0175, -4.48);

    raw_value=copyBitsFromByteArrayLE( byteArray, 4236, 12);
    @CAN_RadarRR::RRR_Object::RRR_Object_Obj7.OrientationYawVnce = convertRawToPhysical(raw_value, 0.0003, 0.0);

    raw_value=copyBitsFromByteArrayLE( byteArray, 4128, 6);
    @CAN_RadarRR::RRR_Object::RRR_Object_Obj7.ProbClassConfidence = convertRawToPhysical(raw_value, 2.0, 0.0);

    raw_value=copyBitsFromByteArrayLE( byteArray, 4379, 4);
    @CAN_RadarRR::RRR_Object::RRR_Object_Obj7.ProbClassType = convertRawToPhysical(raw_value, 1.0, 0.0);

    raw_value=copyBitsFromByteArrayLE( byteArray, 4134, 14);
    @CAN_RadarRR::RRR_Object::RRR_Object_Obj7.Px = convertRawToPhysical(raw_value, 0.0625, -512.0);

    raw_value=copyBitsFromByteArrayLE( byteArray, 4448, 12);
    @CAN_RadarRR::RRR_Object::RRR_Object_Obj7.PxAxCoVnce = convertRawToPhysical(raw_value, 0.005, -10.0);

    raw_value=copyBitsFromByteArrayLE( byteArray, 4460, 12);
    @CAN_RadarRR::RRR_Object::RRR_Object_Obj7.PxAyCoVnce = convertRawToPhysical(raw_value, 0.005, -10.0);

    raw_value=copyBitsFromByteArrayLE( byteArray, 4364, 12);
    @CAN_RadarRR::RRR_Object::RRR_Object_Obj7.PxPyCoVnce = convertRawToPhysical(raw_value, 0.005, -10.0);

    raw_value=copyBitsFromByteArrayLE( byteArray, 4148, 12);
    @CAN_RadarRR::RRR_Object::RRR_Object_Obj7.PxVnce = convertRawToPhysical(raw_value, 0.005, 0.0);

    raw_value=copyBitsFromByteArrayLE( byteArray, 4384, 12);
    @CAN_RadarRR::RRR_Object::RRR_Object_Obj7.PxVxCoVnce = convertRawToPhysical(raw_value, 0.005, -10.0);

    raw_value=copyBitsFromByteArrayLE( byteArray, 4396, 12);
    @CAN_RadarRR::RRR_Object::RRR_Object_Obj7.PxVyCoVnce = convertRawToPhysical(raw_value, 0.005, -10.0);

    raw_value=copyBitsFromByteArrayLE( byteArray, 4160, 12);
    @CAN_RadarRR::RRR_Object::RRR_Object_Obj7.Py = convertRawToPhysical(raw_value, 0.0625, -128.0);

    raw_value=copyBitsFromByteArrayLE( byteArray, 4480, 12);
    @CAN_RadarRR::RRR_Object::RRR_Object_Obj7.PyAxCoVnce = convertRawToPhysical(raw_value, 0.005, -10.0);

    raw_value=copyBitsFromByteArrayLE( byteArray, 4492, 12);
    @CAN_RadarRR::RRR_Object::RRR_Object_Obj7.PyAyCoVnce = convertRawToPhysical(raw_value, 0.005, -10.0);

    raw_value=copyBitsFromByteArrayLE( byteArray, 4172, 12);
    @CAN_RadarRR::RRR_Object::RRR_Object_Obj7.PyVnce = convertRawToPhysical(raw_value, 0.005, 0.0);

    raw_value=copyBitsFromByteArrayLE( byteArray, 4416, 12);
    @CAN_RadarRR::RRR_Object::RRR_Object_Obj7.PyVxCoVnce = convertRawToPhysical(raw_value, 0.005, -10.0);

    raw_value=copyBitsFromByteArrayLE( byteArray, 4428, 12);
    @CAN_RadarRR::RRR_Object::RRR_Object_Obj7.PyVyCoVnce = convertRawToPhysical(raw_value, 0.005, -10.0);

    raw_value=copyBitsFromByteArrayLE( byteArray, 4268, 10);
    @CAN_RadarRR::RRR_Object::RRR_Object_Obj7.RCS = convertRawToPhysical(raw_value, 0.2, -102.4);

    raw_value=copyBitsFromByteArrayLE( byteArray, 4440, 4);
    @CAN_RadarRR::RRR_Object::RRR_Object_Obj7.ReferencePoint = convertRawToPhysical(raw_value, 1.0, 0.0);

    raw_value=copyBitsFromByteArrayLE( byteArray, 4300, 12);
    @CAN_RadarRR::RRR_Object::RRR_Object_Obj7.Vx = convertRawToPhysical(raw_value, 0.0625, -128.0);

    raw_value=copyBitsFromByteArrayLE( byteArray, 4524, 12);
    @CAN_RadarRR::RRR_Object::RRR_Object_Obj7.VxAxCoVnce = convertRawToPhysical(raw_value, 0.005, -10.0);

    raw_value=copyBitsFromByteArrayLE( byteArray, 4544, 12);
    @CAN_RadarRR::RRR_Object::RRR_Object_Obj7.VxAyCoVnce = convertRawToPhysical(raw_value, 0.005, -10.0);

    raw_value=copyBitsFromByteArrayLE( byteArray, 4320, 12);
    @CAN_RadarRR::RRR_Object::RRR_Object_Obj7.VxVnce = convertRawToPhysical(raw_value, 0.005, 0.0);

    raw_value=copyBitsFromByteArrayLE( byteArray, 4512, 12);
    @CAN_RadarRR::RRR_Object::RRR_Object_Obj7.VxVyCoVnce = convertRawToPhysical(raw_value, 0.005, -10.0);

    raw_value=copyBitsFromByteArrayLE( byteArray, 4334, 10);
    @CAN_RadarRR::RRR_Object::RRR_Object_Obj7.Vy = convertRawToPhysical(raw_value, 0.125, -64.0);

    raw_value=copyBitsFromByteArrayLE( byteArray, 4556, 12);
    @CAN_RadarRR::RRR_Object::RRR_Object_Obj7.VyAxCoVnce = convertRawToPhysical(raw_value, 0.005, -10.0);

    raw_value=copyBitsFromByteArrayLE( byteArray, 4576, 12);
    @CAN_RadarRR::RRR_Object::RRR_Object_Obj7.VyAyCoVnce = convertRawToPhysical(raw_value, 0.005, -10.0);

    raw_value=copyBitsFromByteArrayLE( byteArray, 4352, 12);
    @CAN_RadarRR::RRR_Object::RRR_Object_Obj7.VyVnce = convertRawToPhysical(raw_value, 0.005, 0.0);

    raw_value=copyBitsFromByteArrayLE( byteArray, 4248, 7);
    @CAN_RadarRR::RRR_Object::RRR_Object_Obj7.Width = convertRawToPhysical(raw_value, 0.125, 0.0);

    raw_value=copyBitsFromByteArrayLE( byteArray, 4256, 12);
    @CAN_RadarRR::RRR_Object::RRR_Object_Obj7.WidthVnce = convertRawToPhysical(raw_value, 0.005, 0.0);
}


void CRadarRR_RRR_Object_Obj8_SetDataReceived(byte byteArray[])
{
    qword raw_value;

    raw_value=copyBitsFromByteArrayLE( byteArray, 5120, 32);
    @CAN_RadarRR::RRR_Object::RRR_Object_Obj8.Age = convertRawToPhysical(raw_value, 1.0, 0.0);

    raw_value=copyBitsFromByteArrayLE( byteArray, 4716, 10);
    @CAN_RadarRR::RRR_Object::RRR_Object_Obj8.Ax = convertRawToPhysical(raw_value, 0.03125, -16.0);

    raw_value=copyBitsFromByteArrayLE( byteArray, 5100, 12);
    @CAN_RadarRR::RRR_Object::RRR_Object_Obj8.AxAyCoVnce = convertRawToPhysical(raw_value, 0.005, -10.0);

    raw_value=copyBitsFromByteArrayLE( byteArray, 4736, 12);
    @CAN_RadarRR::RRR_Object::RRR_Object_Obj8.AxVnce = convertRawToPhysical(raw_value, 0.005, 0.0);

    raw_value=copyBitsFromByteArrayLE( byteArray, 4790, 9);
    @CAN_RadarRR::RRR_Object::RRR_Object_Obj8.Ay = convertRawToPhysical(raw_value, 0.0625, -16.0);

    raw_value=copyBitsFromByteArrayLE( byteArray, 4800, 12);
    @CAN_RadarRR::RRR_Object::RRR_Object_Obj8.AyVnce = convertRawToPhysical(raw_value, 0.005, 0.0);

    raw_value=copyBitsFromByteArrayLE( byteArray, 4856, 6);
    @CAN_RadarRR::RRR_Object::RRR_Object_Obj8.ExistProb = convertRawToPhysical(raw_value, 2.0, 0.0);

    raw_value=copyBitsFromByteArrayLE( byteArray, 4920, 8);
    @CAN_RadarRR::RRR_Object::RRR_Object_Obj8.FilterInformation = convertRawToPhysical(raw_value, 1.0, 0.0);

    raw_value=copyBitsFromByteArrayLE( byteArray, 4696, 7);
    @CAN_RadarRR::RRR_Object::RRR_Object_Obj8.Length = convertRawToPhysical(raw_value, 0.125, 0.0);

    raw_value=copyBitsFromByteArrayLE( byteArray, 4704, 12);
    @CAN_RadarRR::RRR_Object::RRR_Object_Obj8.LengthVnce = convertRawToPhysical(raw_value, 0.005, 0.0);

    raw_value=copyBitsFromByteArrayLE( byteArray, 4888, 3);
    @CAN_RadarRR::RRR_Object::RRR_Object_Obj8.MeasurementStatus = convertRawToPhysical(raw_value, 1.0, 0.0);

    raw_value=copyBitsFromByteArrayLE( byteArray, 4844, 2);
    @CAN_RadarRR::RRR_Object::RRR_Object_Obj8.MovingStatus = convertRawToPhysical(raw_value, 1.0, 0.0);

    raw_value=copyBitsFromByteArrayLE( byteArray, 4824, 7);
    @CAN_RadarRR::RRR_Object::RRR_Object_Obj8.ObjId = convertRawToPhysical(raw_value, 1.0, 0.0);

    raw_value=copyBitsFromByteArrayLE( byteArray, 4726, 9);
    @CAN_RadarRR::RRR_Object::RRR_Object_Obj8.OrientationYaw = convertRawToPhysical(raw_value, 0.0175, -4.48);

    raw_value=copyBitsFromByteArrayLE( byteArray, 4748, 12);
    @CAN_RadarRR::RRR_Object::RRR_Object_Obj8.OrientationYawVnce = convertRawToPhysical(raw_value, 0.0003, 0.0);

    raw_value=copyBitsFromByteArrayLE( byteArray, 4640, 6);
    @CAN_RadarRR::RRR_Object::RRR_Object_Obj8.ProbClassConfidence = convertRawToPhysical(raw_value, 2.0, 0.0);

    raw_value=copyBitsFromByteArrayLE( byteArray, 4891, 4);
    @CAN_RadarRR::RRR_Object::RRR_Object_Obj8.ProbClassType = convertRawToPhysical(raw_value, 1.0, 0.0);

    raw_value=copyBitsFromByteArrayLE( byteArray, 4646, 14);
    @CAN_RadarRR::RRR_Object::RRR_Object_Obj8.Px = convertRawToPhysical(raw_value, 0.0625, -512.0);

    raw_value=copyBitsFromByteArrayLE( byteArray, 4960, 12);
    @CAN_RadarRR::RRR_Object::RRR_Object_Obj8.PxAxCoVnce = convertRawToPhysical(raw_value, 0.005, -10.0);

    raw_value=copyBitsFromByteArrayLE( byteArray, 4972, 12);
    @CAN_RadarRR::RRR_Object::RRR_Object_Obj8.PxAyCoVnce = convertRawToPhysical(raw_value, 0.005, -10.0);

    raw_value=copyBitsFromByteArrayLE( byteArray, 4876, 12);
    @CAN_RadarRR::RRR_Object::RRR_Object_Obj8.PxPyCoVnce = convertRawToPhysical(raw_value, 0.005, -10.0);

    raw_value=copyBitsFromByteArrayLE( byteArray, 4660, 12);
    @CAN_RadarRR::RRR_Object::RRR_Object_Obj8.PxVnce = convertRawToPhysical(raw_value, 0.005, 0.0);

    raw_value=copyBitsFromByteArrayLE( byteArray, 4896, 12);
    @CAN_RadarRR::RRR_Object::RRR_Object_Obj8.PxVxCoVnce = convertRawToPhysical(raw_value, 0.005, -10.0);

    raw_value=copyBitsFromByteArrayLE( byteArray, 4908, 12);
    @CAN_RadarRR::RRR_Object::RRR_Object_Obj8.PxVyCoVnce = convertRawToPhysical(raw_value, 0.005, -10.0);

    raw_value=copyBitsFromByteArrayLE( byteArray, 4672, 12);
    @CAN_RadarRR::RRR_Object::RRR_Object_Obj8.Py = convertRawToPhysical(raw_value, 0.0625, -128.0);

    raw_value=copyBitsFromByteArrayLE( byteArray, 4992, 12);
    @CAN_RadarRR::RRR_Object::RRR_Object_Obj8.PyAxCoVnce = convertRawToPhysical(raw_value, 0.005, -10.0);

    raw_value=copyBitsFromByteArrayLE( byteArray, 5004, 12);
    @CAN_RadarRR::RRR_Object::RRR_Object_Obj8.PyAyCoVnce = convertRawToPhysical(raw_value, 0.005, -10.0);

    raw_value=copyBitsFromByteArrayLE( byteArray, 4684, 12);
    @CAN_RadarRR::RRR_Object::RRR_Object_Obj8.PyVnce = convertRawToPhysical(raw_value, 0.005, 0.0);

    raw_value=copyBitsFromByteArrayLE( byteArray, 4928, 12);
    @CAN_RadarRR::RRR_Object::RRR_Object_Obj8.PyVxCoVnce = convertRawToPhysical(raw_value, 0.005, -10.0);

    raw_value=copyBitsFromByteArrayLE( byteArray, 4940, 12);
    @CAN_RadarRR::RRR_Object::RRR_Object_Obj8.PyVyCoVnce = convertRawToPhysical(raw_value, 0.005, -10.0);

    raw_value=copyBitsFromByteArrayLE( byteArray, 4780, 10);
    @CAN_RadarRR::RRR_Object::RRR_Object_Obj8.RCS = convertRawToPhysical(raw_value, 0.2, -102.4);

    raw_value=copyBitsFromByteArrayLE( byteArray, 4952, 4);
    @CAN_RadarRR::RRR_Object::RRR_Object_Obj8.ReferencePoint = convertRawToPhysical(raw_value, 1.0, 0.0);

    raw_value=copyBitsFromByteArrayLE( byteArray, 4812, 12);
    @CAN_RadarRR::RRR_Object::RRR_Object_Obj8.Vx = convertRawToPhysical(raw_value, 0.0625, -128.0);

    raw_value=copyBitsFromByteArrayLE( byteArray, 5036, 12);
    @CAN_RadarRR::RRR_Object::RRR_Object_Obj8.VxAxCoVnce = convertRawToPhysical(raw_value, 0.005, -10.0);

    raw_value=copyBitsFromByteArrayLE( byteArray, 5056, 12);
    @CAN_RadarRR::RRR_Object::RRR_Object_Obj8.VxAyCoVnce = convertRawToPhysical(raw_value, 0.005, -10.0);

    raw_value=copyBitsFromByteArrayLE( byteArray, 4832, 12);
    @CAN_RadarRR::RRR_Object::RRR_Object_Obj8.VxVnce = convertRawToPhysical(raw_value, 0.005, 0.0);

    raw_value=copyBitsFromByteArrayLE( byteArray, 5024, 12);
    @CAN_RadarRR::RRR_Object::RRR_Object_Obj8.VxVyCoVnce = convertRawToPhysical(raw_value, 0.005, -10.0);

    raw_value=copyBitsFromByteArrayLE( byteArray, 4846, 10);
    @CAN_RadarRR::RRR_Object::RRR_Object_Obj8.Vy = convertRawToPhysical(raw_value, 0.125, -64.0);

    raw_value=copyBitsFromByteArrayLE( byteArray, 5068, 12);
    @CAN_RadarRR::RRR_Object::RRR_Object_Obj8.VyAxCoVnce = convertRawToPhysical(raw_value, 0.005, -10.0);

    raw_value=copyBitsFromByteArrayLE( byteArray, 5088, 12);
    @CAN_RadarRR::RRR_Object::RRR_Object_Obj8.VyAyCoVnce = convertRawToPhysical(raw_value, 0.005, -10.0);

    raw_value=copyBitsFromByteArrayLE( byteArray, 4864, 12);
    @CAN_RadarRR::RRR_Object::RRR_Object_Obj8.VyVnce = convertRawToPhysical(raw_value, 0.005, 0.0);

    raw_value=copyBitsFromByteArrayLE( byteArray, 4760, 7);
    @CAN_RadarRR::RRR_Object::RRR_Object_Obj8.Width = convertRawToPhysical(raw_value, 0.125, 0.0);

    raw_value=copyBitsFromByteArrayLE( byteArray, 4768, 12);
    @CAN_RadarRR::RRR_Object::RRR_Object_Obj8.WidthVnce = convertRawToPhysical(raw_value, 0.005, 0.0);
}


void CRadarRR_RRR_Object_Obj9_SetDataReceived(byte byteArray[])
{
    qword raw_value;

    raw_value=copyBitsFromByteArrayLE( byteArray, 5632, 32);
    @CAN_RadarRR::RRR_Object::RRR_Object_Obj9.Age = convertRawToPhysical(raw_value, 1.0, 0.0);

    raw_value=copyBitsFromByteArrayLE( byteArray, 5228, 10);
    @CAN_RadarRR::RRR_Object::RRR_Object_Obj9.Ax = convertRawToPhysical(raw_value, 0.03125, -16.0);

    raw_value=copyBitsFromByteArrayLE( byteArray, 5612, 12);
    @CAN_RadarRR::RRR_Object::RRR_Object_Obj9.AxAyCoVnce = convertRawToPhysical(raw_value, 0.005, -10.0);

    raw_value=copyBitsFromByteArrayLE( byteArray, 5248, 12);
    @CAN_RadarRR::RRR_Object::RRR_Object_Obj9.AxVnce = convertRawToPhysical(raw_value, 0.005, 0.0);

    raw_value=copyBitsFromByteArrayLE( byteArray, 5302, 9);
    @CAN_RadarRR::RRR_Object::RRR_Object_Obj9.Ay = convertRawToPhysical(raw_value, 0.0625, -16.0);

    raw_value=copyBitsFromByteArrayLE( byteArray, 5312, 12);
    @CAN_RadarRR::RRR_Object::RRR_Object_Obj9.AyVnce = convertRawToPhysical(raw_value, 0.005, 0.0);

    raw_value=copyBitsFromByteArrayLE( byteArray, 5368, 6);
    @CAN_RadarRR::RRR_Object::RRR_Object_Obj9.ExistProb = convertRawToPhysical(raw_value, 2.0, 0.0);

    raw_value=copyBitsFromByteArrayLE( byteArray, 5432, 8);
    @CAN_RadarRR::RRR_Object::RRR_Object_Obj9.FilterInformation = convertRawToPhysical(raw_value, 1.0, 0.0);

    raw_value=copyBitsFromByteArrayLE( byteArray, 5208, 7);
    @CAN_RadarRR::RRR_Object::RRR_Object_Obj9.Length = convertRawToPhysical(raw_value, 0.125, 0.0);

    raw_value=copyBitsFromByteArrayLE( byteArray, 5216, 12);
    @CAN_RadarRR::RRR_Object::RRR_Object_Obj9.LengthVnce = convertRawToPhysical(raw_value, 0.005, 0.0);

    raw_value=copyBitsFromByteArrayLE( byteArray, 5400, 3);
    @CAN_RadarRR::RRR_Object::RRR_Object_Obj9.MeasurementStatus = convertRawToPhysical(raw_value, 1.0, 0.0);

    raw_value=copyBitsFromByteArrayLE( byteArray, 5356, 2);
    @CAN_RadarRR::RRR_Object::RRR_Object_Obj9.MovingStatus = convertRawToPhysical(raw_value, 1.0, 0.0);

    raw_value=copyBitsFromByteArrayLE( byteArray, 5336, 7);
    @CAN_RadarRR::RRR_Object::RRR_Object_Obj9.ObjId = convertRawToPhysical(raw_value, 1.0, 0.0);

    raw_value=copyBitsFromByteArrayLE( byteArray, 5238, 9);
    @CAN_RadarRR::RRR_Object::RRR_Object_Obj9.OrientationYaw = convertRawToPhysical(raw_value, 0.0175, -4.48);

    raw_value=copyBitsFromByteArrayLE( byteArray, 5260, 12);
    @CAN_RadarRR::RRR_Object::RRR_Object_Obj9.OrientationYawVnce = convertRawToPhysical(raw_value, 0.0003, 0.0);

    raw_value=copyBitsFromByteArrayLE( byteArray, 5152, 6);
    @CAN_RadarRR::RRR_Object::RRR_Object_Obj9.ProbClassConfidence = convertRawToPhysical(raw_value, 2.0, 0.0);

    raw_value=copyBitsFromByteArrayLE( byteArray, 5403, 4);
    @CAN_RadarRR::RRR_Object::RRR_Object_Obj9.ProbClassType = convertRawToPhysical(raw_value, 1.0, 0.0);

    raw_value=copyBitsFromByteArrayLE( byteArray, 5158, 14);
    @CAN_RadarRR::RRR_Object::RRR_Object_Obj9.Px = convertRawToPhysical(raw_value, 0.0625, -512.0);

    raw_value=copyBitsFromByteArrayLE( byteArray, 5472, 12);
    @CAN_RadarRR::RRR_Object::RRR_Object_Obj9.PxAxCoVnce = convertRawToPhysical(raw_value, 0.005, -10.0);

    raw_value=copyBitsFromByteArrayLE( byteArray, 5484, 12);
    @CAN_RadarRR::RRR_Object::RRR_Object_Obj9.PxAyCoVnce = convertRawToPhysical(raw_value, 0.005, -10.0);

    raw_value=copyBitsFromByteArrayLE( byteArray, 5388, 12);
    @CAN_RadarRR::RRR_Object::RRR_Object_Obj9.PxPyCoVnce = convertRawToPhysical(raw_value, 0.005, -10.0);

    raw_value=copyBitsFromByteArrayLE( byteArray, 5172, 12);
    @CAN_RadarRR::RRR_Object::RRR_Object_Obj9.PxVnce = convertRawToPhysical(raw_value, 0.005, 0.0);

    raw_value=copyBitsFromByteArrayLE( byteArray, 5408, 12);
    @CAN_RadarRR::RRR_Object::RRR_Object_Obj9.PxVxCoVnce = convertRawToPhysical(raw_value, 0.005, -10.0);

    raw_value=copyBitsFromByteArrayLE( byteArray, 5420, 12);
    @CAN_RadarRR::RRR_Object::RRR_Object_Obj9.PxVyCoVnce = convertRawToPhysical(raw_value, 0.005, -10.0);

    raw_value=copyBitsFromByteArrayLE( byteArray, 5184, 12);
    @CAN_RadarRR::RRR_Object::RRR_Object_Obj9.Py = convertRawToPhysical(raw_value, 0.0625, -128.0);

    raw_value=copyBitsFromByteArrayLE( byteArray, 5504, 12);
    @CAN_RadarRR::RRR_Object::RRR_Object_Obj9.PyAxCoVnce = convertRawToPhysical(raw_value, 0.005, -10.0);

    raw_value=copyBitsFromByteArrayLE( byteArray, 5516, 12);
    @CAN_RadarRR::RRR_Object::RRR_Object_Obj9.PyAyCoVnce = convertRawToPhysical(raw_value, 0.005, -10.0);

    raw_value=copyBitsFromByteArrayLE( byteArray, 5196, 12);
    @CAN_RadarRR::RRR_Object::RRR_Object_Obj9.PyVnce = convertRawToPhysical(raw_value, 0.005, 0.0);

    raw_value=copyBitsFromByteArrayLE( byteArray, 5440, 12);
    @CAN_RadarRR::RRR_Object::RRR_Object_Obj9.PyVxCoVnce = convertRawToPhysical(raw_value, 0.005, -10.0);

    raw_value=copyBitsFromByteArrayLE( byteArray, 5452, 12);
    @CAN_RadarRR::RRR_Object::RRR_Object_Obj9.PyVyCoVnce = convertRawToPhysical(raw_value, 0.005, -10.0);

    raw_value=copyBitsFromByteArrayLE( byteArray, 5292, 10);
    @CAN_RadarRR::RRR_Object::RRR_Object_Obj9.RCS = convertRawToPhysical(raw_value, 0.2, -102.4);

    raw_value=copyBitsFromByteArrayLE( byteArray, 5464, 4);
    @CAN_RadarRR::RRR_Object::RRR_Object_Obj9.ReferencePoint = convertRawToPhysical(raw_value, 1.0, 0.0);

    raw_value=copyBitsFromByteArrayLE( byteArray, 5324, 12);
    @CAN_RadarRR::RRR_Object::RRR_Object_Obj9.Vx = convertRawToPhysical(raw_value, 0.0625, -128.0);

    raw_value=copyBitsFromByteArrayLE( byteArray, 5548, 12);
    @CAN_RadarRR::RRR_Object::RRR_Object_Obj9.VxAxCoVnce = convertRawToPhysical(raw_value, 0.005, -10.0);

    raw_value=copyBitsFromByteArrayLE( byteArray, 5568, 12);
    @CAN_RadarRR::RRR_Object::RRR_Object_Obj9.VxAyCoVnce = convertRawToPhysical(raw_value, 0.005, -10.0);

    raw_value=copyBitsFromByteArrayLE( byteArray, 5344, 12);
    @CAN_RadarRR::RRR_Object::RRR_Object_Obj9.VxVnce = convertRawToPhysical(raw_value, 0.005, 0.0);

    raw_value=copyBitsFromByteArrayLE( byteArray, 5536, 12);
    @CAN_RadarRR::RRR_Object::RRR_Object_Obj9.VxVyCoVnce = convertRawToPhysical(raw_value, 0.005, -10.0);

    raw_value=copyBitsFromByteArrayLE( byteArray, 5358, 10);
    @CAN_RadarRR::RRR_Object::RRR_Object_Obj9.Vy = convertRawToPhysical(raw_value, 0.125, -64.0);

    raw_value=copyBitsFromByteArrayLE( byteArray, 5580, 12);
    @CAN_RadarRR::RRR_Object::RRR_Object_Obj9.VyAxCoVnce = convertRawToPhysical(raw_value, 0.005, -10.0);

    raw_value=copyBitsFromByteArrayLE( byteArray, 5600, 12);
    @CAN_RadarRR::RRR_Object::RRR_Object_Obj9.VyAyCoVnce = convertRawToPhysical(raw_value, 0.005, -10.0);

    raw_value=copyBitsFromByteArrayLE( byteArray, 5376, 12);
    @CAN_RadarRR::RRR_Object::RRR_Object_Obj9.VyVnce = convertRawToPhysical(raw_value, 0.005, 0.0);

    raw_value=copyBitsFromByteArrayLE( byteArray, 5272, 7);
    @CAN_RadarRR::RRR_Object::RRR_Object_Obj9.Width = convertRawToPhysical(raw_value, 0.125, 0.0);

    raw_value=copyBitsFromByteArrayLE( byteArray, 5280, 12);
    @CAN_RadarRR::RRR_Object::RRR_Object_Obj9.WidthVnce = convertRawToPhysical(raw_value, 0.005, 0.0);
}


void SetDataReceived_Toliman_RRR_Object(byte byteArray[], long count)//I-signal-i pdu : RRR_Object->Mapped to ->N-pdu : RRR_Object
{
    qword raw_value;

    raw_value=copyBitsFromByteArrayBE( byteArray, 25648, 16);
    @CAN_RadarRR::RRR_Object::RRR_Object_E2E_p44_counter = convertRawToPhysical(raw_value, 1.0, 0.0);

    raw_value=copyBitsFromByteArrayBE( byteArray, 25696, 32);
    @CAN_RadarRR::RRR_Object::RRR_Object_E2E_p44_crc = convertRawToPhysical(raw_value, 1.0, 0.0);

    raw_value=copyBitsFromByteArrayBE( byteArray, 25664, 32);
    @CAN_RadarRR::RRR_Object::RRR_Object_E2E_p44_dataId = convertRawToPhysical(raw_value, 1.0, 0.0);

    raw_value=copyBitsFromByteArrayBE( byteArray, 25632, 16);
    @CAN_RadarRR::RRR_Object::RRR_Object_E2E_p44_length = convertRawToPhysical(raw_value, 1.0, 0.0);

    raw_value=copyBitsFromByteArrayLE( byteArray, 72, 10);
    @CAN_RadarRR::RRR_Object::RRR_Object_ObjHdr_NumValidObjects = convertRawToPhysical(raw_value, 1.0, 0.0);

    raw_value=copyBitsFromByteArrayLE( byteArray, 32, 32);
    @CAN_RadarRR::RRR_Object::RRR_Object_ObjHdr_TimeStamp = convertRawToPhysical(raw_value, 1.0, 0.0);

    raw_value=copyBitsFromByteArrayLE( byteArray, 64, 8);
    @CAN_RadarRR::RRR_Object::RRR_Object_ObjHdr_TimeStampStatus = convertRawToPhysical(raw_value, 1.0, 0.0);

    raw_value=copyBitsFromByteArrayLE( byteArray, 0, 8);
    @CAN_RadarRR::RRR_Object::RRR_Object_ObjHdr_VersionIdMajor = convertRawToPhysical(raw_value, 1.0, 0.0);

    raw_value=copyBitsFromByteArrayLE( byteArray, 8, 8);
    @CAN_RadarRR::RRR_Object::RRR_Object_ObjHdr_VersionIdMinor = convertRawToPhysical(raw_value, 1.0, 0.0);

    raw_value=copyBitsFromByteArrayLE( byteArray, 16, 8);
    @CAN_RadarRR::RRR_Object::RRR_Object_ObjHdr_VersionPatch = convertRawToPhysical(raw_value, 1.0, 0.0);

    raw_value=copyBitsFromByteArrayBE( byteArray, 24, 8);
    @CAN_RadarRR::RRR_Object::RRR_Object_ObjHdr_content_type = convertRawToPhysical(raw_value, 1.0, 0.0);

    raw_value=copyBitsFromByteArrayLE( byteArray, 960, 2);
    @CAN_RadarRR::RRR_Object::RRR_Object_ShiiHdr_DataMeasured = convertRawToPhysical(raw_value, 1.0, 0.0);

    raw_value=copyBitsFromByteArrayLE( byteArray, 976, 8);
    @CAN_RadarRR::RRR_Object::RRR_Object_ShiiHdr_MisAzOOPCause = convertRawToPhysical(raw_value, 1.0, 0.0);

    raw_value=copyBitsFromByteArrayLE( byteArray, 984, 8);
    @CAN_RadarRR::RRR_Object::RRR_Object_ShiiHdr_MisElOOPCause = convertRawToPhysical(raw_value, 1.0, 0.0);

    raw_value=copyBitsFromByteArrayLE( byteArray, 1016, 8);
    @CAN_RadarRR::RRR_Object::RRR_Object_ShiiHdr_RatioAdvProcListProc = convertRawToPhysical(raw_value, 1.0, 0.0);

    raw_value=copyBitsFromByteArrayLE( byteArray, 968, 1);
    @CAN_RadarRR::RRR_Object::RRR_Object_ShiiHdr_SensorCalExtStat = convertRawToPhysical(raw_value, 1.0, 0.0);

    raw_value=copyBitsFromByteArrayLE( byteArray, 969, 1);
    @CAN_RadarRR::RRR_Object::RRR_Object_ShiiHdr_SensorCalIntStat = convertRawToPhysical(raw_value, 1.0, 0.0);

    raw_value=copyBitsFromByteArrayLE( byteArray, 972, 4);
    @CAN_RadarRR::RRR_Object::RRR_Object_ShiiHdr_SensorCalOnlStat = convertRawToPhysical(raw_value, 1.0, 0.0);

    raw_value=copyBitsFromByteArrayLE( byteArray, 992, 16);
    @CAN_RadarRR::RRR_Object::RRR_Object_ShiiHdr_SensorFailureReas = convertRawToPhysical(raw_value, 1.0, 0.0);

    raw_value=copyBitsFromByteArrayLE( byteArray, 970, 2);
    @CAN_RadarRR::RRR_Object::RRR_Object_ShiiHdr_SensorHeatingStatus = convertRawToPhysical(raw_value, 1.0, 0.0);

    raw_value=copyBitsFromByteArrayLE( byteArray, 1008, 8);
    @CAN_RadarRR::RRR_Object::RRR_Object_ShiiHdr_SensorOmmOpMode = convertRawToPhysical(raw_value, 1.0, 0.0);

    raw_value=copyBitsFromByteArrayLE( byteArray, 1024, 8);
    @CAN_RadarRR::RRR_Object::RRR_Object_ShiiHdr_ThermalDegr = convertRawToPhysical(raw_value, 0.01, 0.0);

    raw_value=copyBitsFromByteArrayLE( byteArray, 931, 6);
    @CAN_RadarRR::RRR_Object::RRR_Object_SpiHdr_BldFov_Confidence = convertRawToPhysical(raw_value, 2.0, 0.0);

    raw_value=copyBitsFromByteArrayLE( byteArray, 928, 3);
    @CAN_RadarRR::RRR_Object::RRR_Object_SpiHdr_BldFov_Status = convertRawToPhysical(raw_value, 1.0, 0.0);

    raw_value=copyBitsFromByteArrayLE( byteArray, 959, 1);
    @CAN_RadarRR::RRR_Object::RRR_Object_SpiHdr_BldOperationMode = convertRawToPhysical(raw_value, 1.0, 0.0);

    raw_value=copyBitsFromByteArrayLE( byteArray, 208, 16);
    @CAN_RadarRR::RRR_Object::RRR_Object_SpiHdr_DistMaxProc = convertRawToPhysical(raw_value, 0.01, 0.0);

    raw_value=copyBitsFromByteArrayLE( byteArray, 192, 16);
    @CAN_RadarRR::RRR_Object::RRR_Object_SpiHdr_DistMeasMaxMod = convertRawToPhysical(raw_value, 0.01, 0.0);

    raw_value=copyBitsFromByteArrayLE( byteArray, 171, 10);
    @CAN_RadarRR::RRR_Object::RRR_Object_SpiHdr_DistMeasMinMod = convertRawToPhysical(raw_value, 0.01, 0.0);

    raw_value=copyBitsFromByteArrayLE( byteArray, 144, 13);
    @CAN_RadarRR::RRR_Object::RRR_Object_SpiHdr_DistPrec = convertRawToPhysical(raw_value, 0.0001, 0.0);

    raw_value=copyBitsFromByteArrayLE( byteArray, 115, 10);
    @CAN_RadarRR::RRR_Object::RRR_Object_SpiHdr_DistSep = convertRawToPhysical(raw_value, 0.01, 0.0);

    raw_value=copyBitsFromByteArrayLE( byteArray, 128, 16);
    @CAN_RadarRR::RRR_Object::RRR_Object_SpiHdr_DistStartProcDegraded = convertRawToPhysical(raw_value, 0.01, 0.0);

    raw_value=copyBitsFromByteArrayLE( byteArray, 96, 6);
    @CAN_RadarRR::RRR_Object::RRR_Object_SpiHdr_DmpId = convertRawToPhysical(raw_value, 1.0, 0.0);

    raw_value=copyBitsFromByteArrayLE( byteArray, 656, 10);
    @CAN_RadarRR::RRR_Object::RRR_Object_SpiHdr_FovRtrAzDetRng00 = convertRawToPhysical(raw_value, 1.0, 0.0);

    raw_value=copyBitsFromByteArrayLE( byteArray, 672, 10);
    @CAN_RadarRR::RRR_Object::RRR_Object_SpiHdr_FovRtrAzDetRng01 = convertRawToPhysical(raw_value, 1.0, 0.0);

    raw_value=copyBitsFromByteArrayLE( byteArray, 682, 10);
    @CAN_RadarRR::RRR_Object::RRR_Object_SpiHdr_FovRtrAzDetRng02 = convertRawToPhysical(raw_value, 1.0, 0.0);

    raw_value=copyBitsFromByteArrayLE( byteArray, 692, 10);
    @CAN_RadarRR::RRR_Object::RRR_Object_SpiHdr_FovRtrAzDetRng03 = convertRawToPhysical(raw_value, 1.0, 0.0);

    raw_value=copyBitsFromByteArrayLE( byteArray, 704, 10);
    @CAN_RadarRR::RRR_Object::RRR_Object_SpiHdr_FovRtrAzDetRng04 = convertRawToPhysical(raw_value, 1.0, 0.0);

    raw_value=copyBitsFromByteArrayLE( byteArray, 714, 10);
    @CAN_RadarRR::RRR_Object::RRR_Object_SpiHdr_FovRtrAzDetRng05 = convertRawToPhysical(raw_value, 1.0, 0.0);

    raw_value=copyBitsFromByteArrayLE( byteArray, 724, 10);
    @CAN_RadarRR::RRR_Object::RRR_Object_SpiHdr_FovRtrAzDetRng06 = convertRawToPhysical(raw_value, 1.0, 0.0);

    raw_value=copyBitsFromByteArrayLE( byteArray, 736, 10);
    @CAN_RadarRR::RRR_Object::RRR_Object_SpiHdr_FovRtrAzDetRng07 = convertRawToPhysical(raw_value, 1.0, 0.0);

    raw_value=copyBitsFromByteArrayLE( byteArray, 746, 10);
    @CAN_RadarRR::RRR_Object::RRR_Object_SpiHdr_FovRtrAzDetRng08 = convertRawToPhysical(raw_value, 1.0, 0.0);

    raw_value=copyBitsFromByteArrayLE( byteArray, 756, 10);
    @CAN_RadarRR::RRR_Object::RRR_Object_SpiHdr_FovRtrAzDetRng09 = convertRawToPhysical(raw_value, 1.0, 0.0);

    raw_value=copyBitsFromByteArrayLE( byteArray, 768, 10);
    @CAN_RadarRR::RRR_Object::RRR_Object_SpiHdr_FovRtrAzDetRng10 = convertRawToPhysical(raw_value, 1.0, 0.0);

    raw_value=copyBitsFromByteArrayLE( byteArray, 778, 10);
    @CAN_RadarRR::RRR_Object::RRR_Object_SpiHdr_FovRtrAzDetRng11 = convertRawToPhysical(raw_value, 1.0, 0.0);

    raw_value=copyBitsFromByteArrayLE( byteArray, 788, 10);
    @CAN_RadarRR::RRR_Object::RRR_Object_SpiHdr_FovRtrAzDetRng12 = convertRawToPhysical(raw_value, 1.0, 0.0);

    raw_value=copyBitsFromByteArrayLE( byteArray, 800, 10);
    @CAN_RadarRR::RRR_Object::RRR_Object_SpiHdr_FovRtrAzDetRng13 = convertRawToPhysical(raw_value, 1.0, 0.0);

    raw_value=copyBitsFromByteArrayLE( byteArray, 810, 10);
    @CAN_RadarRR::RRR_Object::RRR_Object_SpiHdr_FovRtrAzDetRng14 = convertRawToPhysical(raw_value, 1.0, 0.0);

    raw_value=copyBitsFromByteArrayLE( byteArray, 820, 10);
    @CAN_RadarRR::RRR_Object::RRR_Object_SpiHdr_FovRtrAzDetRng15 = convertRawToPhysical(raw_value, 1.0, 0.0);

    raw_value=copyBitsFromByteArrayLE( byteArray, 832, 10);
    @CAN_RadarRR::RRR_Object::RRR_Object_SpiHdr_FovRtrAzDetRng16 = convertRawToPhysical(raw_value, 1.0, 0.0);

    raw_value=copyBitsFromByteArrayLE( byteArray, 842, 10);
    @CAN_RadarRR::RRR_Object::RRR_Object_SpiHdr_FovRtrAzDetRng17 = convertRawToPhysical(raw_value, 1.0, 0.0);

    raw_value=copyBitsFromByteArrayLE( byteArray, 852, 10);
    @CAN_RadarRR::RRR_Object::RRR_Object_SpiHdr_FovRtrAzDetRng18 = convertRawToPhysical(raw_value, 1.0, 0.0);

    raw_value=copyBitsFromByteArrayLE( byteArray, 864, 10);
    @CAN_RadarRR::RRR_Object::RRR_Object_SpiHdr_FovRtrAzDetRng19 = convertRawToPhysical(raw_value, 1.0, 0.0);

    raw_value=copyBitsFromByteArrayLE( byteArray, 874, 10);
    @CAN_RadarRR::RRR_Object::RRR_Object_SpiHdr_FovRtrAzDetRng20 = convertRawToPhysical(raw_value, 1.0, 0.0);

    raw_value=copyBitsFromByteArrayLE( byteArray, 884, 10);
    @CAN_RadarRR::RRR_Object::RRR_Object_SpiHdr_FovRtrAzDetRng21 = convertRawToPhysical(raw_value, 1.0, 0.0);

    raw_value=copyBitsFromByteArrayLE( byteArray, 896, 10);
    @CAN_RadarRR::RRR_Object::RRR_Object_SpiHdr_FovRtrAzDetRng22 = convertRawToPhysical(raw_value, 1.0, 0.0);

    raw_value=copyBitsFromByteArrayLE( byteArray, 906, 10);
    @CAN_RadarRR::RRR_Object::RRR_Object_SpiHdr_FovRtrAzDetRng23 = convertRawToPhysical(raw_value, 1.0, 0.0);

    raw_value=copyBitsFromByteArrayLE( byteArray, 916, 10);
    @CAN_RadarRR::RRR_Object::RRR_Object_SpiHdr_FovRtrAzDetRng24 = convertRawToPhysical(raw_value, 1.0, 0.0);

    raw_value=copyBitsFromByteArrayLE( byteArray, 455, 8);
    @CAN_RadarRR::RRR_Object::RRR_Object_SpiHdr_FovRtrAzSegBrdr00 = convertRawToPhysical(raw_value, 0.0175, -2.24);

    raw_value=copyBitsFromByteArrayLE( byteArray, 463, 8);
    @CAN_RadarRR::RRR_Object::RRR_Object_SpiHdr_FovRtrAzSegBrdr01 = convertRawToPhysical(raw_value, 0.0175, -2.24);

    raw_value=copyBitsFromByteArrayLE( byteArray, 471, 8);
    @CAN_RadarRR::RRR_Object::RRR_Object_SpiHdr_FovRtrAzSegBrdr02 = convertRawToPhysical(raw_value, 0.0175, -2.24);

    raw_value=copyBitsFromByteArrayLE( byteArray, 480, 8);
    @CAN_RadarRR::RRR_Object::RRR_Object_SpiHdr_FovRtrAzSegBrdr03 = convertRawToPhysical(raw_value, 0.0175, -2.24);

    raw_value=copyBitsFromByteArrayLE( byteArray, 488, 8);
    @CAN_RadarRR::RRR_Object::RRR_Object_SpiHdr_FovRtrAzSegBrdr04 = convertRawToPhysical(raw_value, 0.0175, -2.24);

    raw_value=copyBitsFromByteArrayLE( byteArray, 496, 8);
    @CAN_RadarRR::RRR_Object::RRR_Object_SpiHdr_FovRtrAzSegBrdr05 = convertRawToPhysical(raw_value, 0.0175, -2.24);

    raw_value=copyBitsFromByteArrayLE( byteArray, 504, 8);
    @CAN_RadarRR::RRR_Object::RRR_Object_SpiHdr_FovRtrAzSegBrdr06 = convertRawToPhysical(raw_value, 0.0175, -2.24);

    raw_value=copyBitsFromByteArrayLE( byteArray, 512, 8);
    @CAN_RadarRR::RRR_Object::RRR_Object_SpiHdr_FovRtrAzSegBrdr07 = convertRawToPhysical(raw_value, 0.0175, -2.24);

    raw_value=copyBitsFromByteArrayLE( byteArray, 520, 8);
    @CAN_RadarRR::RRR_Object::RRR_Object_SpiHdr_FovRtrAzSegBrdr08 = convertRawToPhysical(raw_value, 0.0175, -2.24);

    raw_value=copyBitsFromByteArrayLE( byteArray, 528, 8);
    @CAN_RadarRR::RRR_Object::RRR_Object_SpiHdr_FovRtrAzSegBrdr09 = convertRawToPhysical(raw_value, 0.0175, -2.24);

    raw_value=copyBitsFromByteArrayLE( byteArray, 536, 8);
    @CAN_RadarRR::RRR_Object::RRR_Object_SpiHdr_FovRtrAzSegBrdr10 = convertRawToPhysical(raw_value, 0.0175, -2.24);

    raw_value=copyBitsFromByteArrayLE( byteArray, 544, 8);
    @CAN_RadarRR::RRR_Object::RRR_Object_SpiHdr_FovRtrAzSegBrdr11 = convertRawToPhysical(raw_value, 0.0175, -2.24);

    raw_value=copyBitsFromByteArrayLE( byteArray, 552, 8);
    @CAN_RadarRR::RRR_Object::RRR_Object_SpiHdr_FovRtrAzSegBrdr12 = convertRawToPhysical(raw_value, 0.0175, -2.24);

    raw_value=copyBitsFromByteArrayLE( byteArray, 560, 8);
    @CAN_RadarRR::RRR_Object::RRR_Object_SpiHdr_FovRtrAzSegBrdr13 = convertRawToPhysical(raw_value, 0.0175, -2.24);

    raw_value=copyBitsFromByteArrayLE( byteArray, 568, 8);
    @CAN_RadarRR::RRR_Object::RRR_Object_SpiHdr_FovRtrAzSegBrdr14 = convertRawToPhysical(raw_value, 0.0175, -2.24);

    raw_value=copyBitsFromByteArrayLE( byteArray, 576, 8);
    @CAN_RadarRR::RRR_Object::RRR_Object_SpiHdr_FovRtrAzSegBrdr15 = convertRawToPhysical(raw_value, 0.0175, -2.24);

    raw_value=copyBitsFromByteArrayLE( byteArray, 584, 8);
    @CAN_RadarRR::RRR_Object::RRR_Object_SpiHdr_FovRtrAzSegBrdr16 = convertRawToPhysical(raw_value, 0.0175, -2.24);

    raw_value=copyBitsFromByteArrayLE( byteArray, 592, 8);
    @CAN_RadarRR::RRR_Object::RRR_Object_SpiHdr_FovRtrAzSegBrdr17 = convertRawToPhysical(raw_value, 0.0175, -2.24);

    raw_value=copyBitsFromByteArrayLE( byteArray, 600, 8);
    @CAN_RadarRR::RRR_Object::RRR_Object_SpiHdr_FovRtrAzSegBrdr18 = convertRawToPhysical(raw_value, 0.0175, -2.24);

    raw_value=copyBitsFromByteArrayLE( byteArray, 608, 8);
    @CAN_RadarRR::RRR_Object::RRR_Object_SpiHdr_FovRtrAzSegBrdr19 = convertRawToPhysical(raw_value, 0.0175, -2.24);

    raw_value=copyBitsFromByteArrayLE( byteArray, 616, 8);
    @CAN_RadarRR::RRR_Object::RRR_Object_SpiHdr_FovRtrAzSegBrdr20 = convertRawToPhysical(raw_value, 0.0175, -2.24);

    raw_value=copyBitsFromByteArrayLE( byteArray, 624, 8);
    @CAN_RadarRR::RRR_Object::RRR_Object_SpiHdr_FovRtrAzSegBrdr21 = convertRawToPhysical(raw_value, 0.0175, -2.24);

    raw_value=copyBitsFromByteArrayLE( byteArray, 632, 8);
    @CAN_RadarRR::RRR_Object::RRR_Object_SpiHdr_FovRtrAzSegBrdr22 = convertRawToPhysical(raw_value, 0.0175, -2.24);

    raw_value=copyBitsFromByteArrayLE( byteArray, 640, 8);
    @CAN_RadarRR::RRR_Object::RRR_Object_SpiHdr_FovRtrAzSegBrdr23 = convertRawToPhysical(raw_value, 0.0175, -2.24);

    raw_value=copyBitsFromByteArrayLE( byteArray, 648, 8);
    @CAN_RadarRR::RRR_Object::RRR_Object_SpiHdr_FovRtrAzSegBrdr24 = convertRawToPhysical(raw_value, 0.0175, -2.24);

    raw_value=copyBitsFromByteArrayLE( byteArray, 320, 7);
    @CAN_RadarRR::RRR_Object::RRR_Object_SpiHdr_FovRtrElRngGEnd00 = convertRawToPhysical(raw_value, 0.01, 0.0);

    raw_value=copyBitsFromByteArrayLE( byteArray, 327, 7);
    @CAN_RadarRR::RRR_Object::RRR_Object_SpiHdr_FovRtrElRngGEnd01 = convertRawToPhysical(raw_value, 0.01, 0.0);

    raw_value=copyBitsFromByteArrayLE( byteArray, 334, 7);
    @CAN_RadarRR::RRR_Object::RRR_Object_SpiHdr_FovRtrElRngGEnd02 = convertRawToPhysical(raw_value, 0.01, 0.0);

    raw_value=copyBitsFromByteArrayLE( byteArray, 341, 7);
    @CAN_RadarRR::RRR_Object::RRR_Object_SpiHdr_FovRtrElRngGEnd03 = convertRawToPhysical(raw_value, 0.01, 0.0);

    raw_value=copyBitsFromByteArrayLE( byteArray, 352, 7);
    @CAN_RadarRR::RRR_Object::RRR_Object_SpiHdr_FovRtrElRngGEnd04 = convertRawToPhysical(raw_value, 0.01, 0.0);

    raw_value=copyBitsFromByteArrayLE( byteArray, 359, 7);
    @CAN_RadarRR::RRR_Object::RRR_Object_SpiHdr_FovRtrElRngGEnd05 = convertRawToPhysical(raw_value, 0.01, 0.0);

    raw_value=copyBitsFromByteArrayLE( byteArray, 366, 7);
    @CAN_RadarRR::RRR_Object::RRR_Object_SpiHdr_FovRtrElRngGEnd06 = convertRawToPhysical(raw_value, 0.01, 0.0);

    raw_value=copyBitsFromByteArrayLE( byteArray, 373, 7);
    @CAN_RadarRR::RRR_Object::RRR_Object_SpiHdr_FovRtrElRngGEnd07 = convertRawToPhysical(raw_value, 0.01, 0.0);

    raw_value=copyBitsFromByteArrayLE( byteArray, 384, 7);
    @CAN_RadarRR::RRR_Object::RRR_Object_SpiHdr_FovRtrElRngGEnd08 = convertRawToPhysical(raw_value, 0.01, 0.0);

    raw_value=copyBitsFromByteArrayLE( byteArray, 391, 7);
    @CAN_RadarRR::RRR_Object::RRR_Object_SpiHdr_FovRtrElRngGEnd09 = convertRawToPhysical(raw_value, 0.01, 0.0);

    raw_value=copyBitsFromByteArrayLE( byteArray, 398, 7);
    @CAN_RadarRR::RRR_Object::RRR_Object_SpiHdr_FovRtrElRngGEnd10 = convertRawToPhysical(raw_value, 0.01, 0.0);

    raw_value=copyBitsFromByteArrayLE( byteArray, 235, 7);
    @CAN_RadarRR::RRR_Object::RRR_Object_SpiHdr_FovRtrElSegBrdr00 = convertRawToPhysical(raw_value, 0.0175, -1.12);

    raw_value=copyBitsFromByteArrayLE( byteArray, 242, 7);
    @CAN_RadarRR::RRR_Object::RRR_Object_SpiHdr_FovRtrElSegBrdr01 = convertRawToPhysical(raw_value, 0.0175, -1.12);

    raw_value=copyBitsFromByteArrayLE( byteArray, 249, 7);
    @CAN_RadarRR::RRR_Object::RRR_Object_SpiHdr_FovRtrElSegBrdr02 = convertRawToPhysical(raw_value, 0.0175, -1.12);

    raw_value=copyBitsFromByteArrayLE( byteArray, 256, 7);
    @CAN_RadarRR::RRR_Object::RRR_Object_SpiHdr_FovRtrElSegBrdr03 = convertRawToPhysical(raw_value, 0.0175, -1.12);

    raw_value=copyBitsFromByteArrayLE( byteArray, 263, 7);
    @CAN_RadarRR::RRR_Object::RRR_Object_SpiHdr_FovRtrElSegBrdr04 = convertRawToPhysical(raw_value, 0.0175, -1.12);

    raw_value=copyBitsFromByteArrayLE( byteArray, 270, 7);
    @CAN_RadarRR::RRR_Object::RRR_Object_SpiHdr_FovRtrElSegBrdr05 = convertRawToPhysical(raw_value, 0.0175, -1.12);

    raw_value=copyBitsFromByteArrayLE( byteArray, 277, 7);
    @CAN_RadarRR::RRR_Object::RRR_Object_SpiHdr_FovRtrElSegBrdr06 = convertRawToPhysical(raw_value, 0.0175, -1.12);

    raw_value=copyBitsFromByteArrayLE( byteArray, 288, 7);
    @CAN_RadarRR::RRR_Object::RRR_Object_SpiHdr_FovRtrElSegBrdr07 = convertRawToPhysical(raw_value, 0.0175, -1.12);

    raw_value=copyBitsFromByteArrayLE( byteArray, 295, 7);
    @CAN_RadarRR::RRR_Object::RRR_Object_SpiHdr_FovRtrElSegBrdr08 = convertRawToPhysical(raw_value, 0.0175, -1.12);

    raw_value=copyBitsFromByteArrayLE( byteArray, 302, 7);
    @CAN_RadarRR::RRR_Object::RRR_Object_SpiHdr_FovRtrElSegBrdr09 = convertRawToPhysical(raw_value, 0.0175, -1.12);

    raw_value=copyBitsFromByteArrayLE( byteArray, 309, 7);
    @CAN_RadarRR::RRR_Object::RRR_Object_SpiHdr_FovRtrElSegBrdr10 = convertRawToPhysical(raw_value, 0.0175, -1.12);

    raw_value=copyBitsFromByteArrayLE( byteArray, 102, 13);
    @CAN_RadarRR::RRR_Object::RRR_Object_SpiHdr_ModId = convertRawToPhysical(raw_value, 1.0, 0.0);

    raw_value=copyBitsFromByteArrayLE( byteArray, 448, 7);
    @CAN_RadarRR::RRR_Object::RRR_Object_SpiHdr_RngGainRfInterfere = convertRawToPhysical(raw_value, 1.0, 0.0);

    raw_value=copyBitsFromByteArrayLE( byteArray, 444, 3);
    @CAN_RadarRR::RRR_Object::RRR_Object_SpiHdr_SensorExtDisturbed = convertRawToPhysical(raw_value, 1.0, 0.0);

    raw_value=copyBitsFromByteArrayLE( byteArray, 432, 12);
    @CAN_RadarRR::RRR_Object::RRR_Object_SpiHdr_SensorOrientPitch = convertRawToPhysical(raw_value, 0.00017, -0.34816);

    raw_value=copyBitsFromByteArrayLE( byteArray, 416, 16);
    @CAN_RadarRR::RRR_Object::RRR_Object_SpiHdr_SensorOrientYaw = convertRawToPhysical(raw_value, 0.00017, -5.57056);

    raw_value=copyBitsFromByteArrayLE( byteArray, 447, 1);
    @CAN_RadarRR::RRR_Object::RRR_Object_SpiHdr_SensorOrientation = convertRawToPhysical(raw_value, 1.0, 0.0);

    raw_value=copyBitsFromByteArrayLE( byteArray, 937, 9);
    @CAN_RadarRR::RRR_Object::RRR_Object_SpiHdr_SensorOriginPointX = convertRawToPhysical(raw_value, 0.02, -5.12);

    raw_value=copyBitsFromByteArrayLE( byteArray, 946, 8);
    @CAN_RadarRR::RRR_Object::RRR_Object_SpiHdr_SensorOriginPointY = convertRawToPhysical(raw_value, 0.01, -1.28);

    raw_value=copyBitsFromByteArrayLE( byteArray, 954, 5);
    @CAN_RadarRR::RRR_Object::RRR_Object_SpiHdr_SensorOriginPointZ = convertRawToPhysical(raw_value, 0.05, 0.0);

    raw_value=copyBitsFromByteArrayLE( byteArray, 224, 11);
    @CAN_RadarRR::RRR_Object::RRR_Object_SpiHdr_VelMeasMax = convertRawToPhysical(raw_value, 0.1, 0.0);

    raw_value=copyBitsFromByteArrayLE( byteArray, 405, 11);
    @CAN_RadarRR::RRR_Object::RRR_Object_SpiHdr_VelMeasMin = convertRawToPhysical(raw_value, 0.1, -150.0);

    raw_value=copyBitsFromByteArrayLE( byteArray, 160, 11);
    @CAN_RadarRR::RRR_Object::RRR_Object_SpiHdr_VelPrec = convertRawToPhysical(raw_value, 0.0001, 0.0);

    raw_value=copyBitsFromByteArrayLE( byteArray, 181, 10);
    @CAN_RadarRR::RRR_Object::RRR_Object_SpiHdr_VelSep = convertRawToPhysical(raw_value, 0.01, 0.0);

    if(@CAN_RadarRR::RRR_Object::RRR_Object_Obj1.Read == 1)
    {
        CRadarRR_RRR_Object_Obj1_SetDataReceived(byteArray);
    }

    if(@CAN_RadarRR::RRR_Object::RRR_Object_Obj10.Read == 1)
    {
        CRadarRR_RRR_Object_Obj10_SetDataReceived(byteArray);
    }

    if(@CAN_RadarRR::RRR_Object::RRR_Object_Obj11.Read == 1)
    {
        CRadarRR_RRR_Object_Obj11_SetDataReceived(byteArray);
    }

    if(@CAN_RadarRR::RRR_Object::RRR_Object_Obj12.Read == 1)
    {
        CRadarRR_RRR_Object_Obj12_SetDataReceived(byteArray);
    }

    if(@CAN_RadarRR::RRR_Object::RRR_Object_Obj13.Read == 1)
    {
        CRadarRR_RRR_Object_Obj13_SetDataReceived(byteArray);
    }

    if(@CAN_RadarRR::RRR_Object::RRR_Object_Obj14.Read == 1)
    {
        CRadarRR_RRR_Object_Obj14_SetDataReceived(byteArray);
    }

    if(@CAN_RadarRR::RRR_Object::RRR_Object_Obj15.Read == 1)
    {
        CRadarRR_RRR_Object_Obj15_SetDataReceived(byteArray);
    }

    if(@CAN_RadarRR::RRR_Object::RRR_Object_Obj16.Read == 1)
    {
        CRadarRR_RRR_Object_Obj16_SetDataReceived(byteArray);
    }

    if(@CAN_RadarRR::RRR_Object::RRR_Object_Obj17.Read == 1)
    {
        CRadarRR_RRR_Object_Obj17_SetDataReceived(byteArray);
    }

    if(@CAN_RadarRR::RRR_Object::RRR_Object_Obj18.Read == 1)
    {
        CRadarRR_RRR_Object_Obj18_SetDataReceived(byteArray);
    }

    if(@CAN_RadarRR::RRR_Object::RRR_Object_Obj19.Read == 1)
    {
        CRadarRR_RRR_Object_Obj19_SetDataReceived(byteArray);
    }

    if(@CAN_RadarRR::RRR_Object::RRR_Object_Obj2.Read == 1)
    {
        CRadarRR_RRR_Object_Obj2_SetDataReceived(byteArray);
    }

    if(@CAN_RadarRR::RRR_Object::RRR_Object_Obj20.Read == 1)
    {
        CRadarRR_RRR_Object_Obj20_SetDataReceived(byteArray);
    }

    if(@CAN_RadarRR::RRR_Object::RRR_Object_Obj21.Read == 1)
    {
        CRadarRR_RRR_Object_Obj21_SetDataReceived(byteArray);
    }

    if(@CAN_RadarRR::RRR_Object::RRR_Object_Obj22.Read == 1)
    {
        CRadarRR_RRR_Object_Obj22_SetDataReceived(byteArray);
    }

    if(@CAN_RadarRR::RRR_Object::RRR_Object_Obj23.Read == 1)
    {
        CRadarRR_RRR_Object_Obj23_SetDataReceived(byteArray);
    }

    if(@CAN_RadarRR::RRR_Object::RRR_Object_Obj24.Read == 1)
    {
        CRadarRR_RRR_Object_Obj24_SetDataReceived(byteArray);
    }

    if(@CAN_RadarRR::RRR_Object::RRR_Object_Obj25.Read == 1)
    {
        CRadarRR_RRR_Object_Obj25_SetDataReceived(byteArray);
    }

    if(@CAN_RadarRR::RRR_Object::RRR_Object_Obj26.Read == 1)
    {
        CRadarRR_RRR_Object_Obj26_SetDataReceived(byteArray);
    }

    if(@CAN_RadarRR::RRR_Object::RRR_Object_Obj27.Read == 1)
    {
        CRadarRR_RRR_Object_Obj27_SetDataReceived(byteArray);
    }

    if(@CAN_RadarRR::RRR_Object::RRR_Object_Obj28.Read == 1)
    {
        CRadarRR_RRR_Object_Obj28_SetDataReceived(byteArray);
    }

    if(@CAN_RadarRR::RRR_Object::RRR_Object_Obj29.Read == 1)
    {
        CRadarRR_RRR_Object_Obj29_SetDataReceived(byteArray);
    }

    if(@CAN_RadarRR::RRR_Object::RRR_Object_Obj3.Read == 1)
    {
        CRadarRR_RRR_Object_Obj3_SetDataReceived(byteArray);
    }

    if(@CAN_RadarRR::RRR_Object::RRR_Object_Obj30.Read == 1)
    {
        CRadarRR_RRR_Object_Obj30_SetDataReceived(byteArray);
    }

    if(@CAN_RadarRR::RRR_Object::RRR_Object_Obj31.Read == 1)
    {
        CRadarRR_RRR_Object_Obj31_SetDataReceived(byteArray);
    }

    if(@CAN_RadarRR::RRR_Object::RRR_Object_Obj32.Read == 1)
    {
        CRadarRR_RRR_Object_Obj32_SetDataReceived(byteArray);
    }

    if(@CAN_RadarRR::RRR_Object::RRR_Object_Obj33.Read == 1)
    {
        CRadarRR_RRR_Object_Obj33_SetDataReceived(byteArray);
    }

    if(@CAN_RadarRR::RRR_Object::RRR_Object_Obj34.Read == 1)
    {
        CRadarRR_RRR_Object_Obj34_SetDataReceived(byteArray);
    }

    if(@CAN_RadarRR::RRR_Object::RRR_Object_Obj35.Read == 1)
    {
        CRadarRR_RRR_Object_Obj35_SetDataReceived(byteArray);
    }

    if(@CAN_RadarRR::RRR_Object::RRR_Object_Obj36.Read == 1)
    {
        CRadarRR_RRR_Object_Obj36_SetDataReceived(byteArray);
    }

    if(@CAN_RadarRR::RRR_Object::RRR_Object_Obj37.Read == 1)
    {
        CRadarRR_RRR_Object_Obj37_SetDataReceived(byteArray);
    }

    if(@CAN_RadarRR::RRR_Object::RRR_Object_Obj38.Read == 1)
    {
        CRadarRR_RRR_Object_Obj38_SetDataReceived(byteArray);
    }

    if(@CAN_RadarRR::RRR_Object::RRR_Object_Obj39.Read == 1)
    {
        CRadarRR_RRR_Object_Obj39_SetDataReceived(byteArray);
    }

    if(@CAN_RadarRR::RRR_Object::RRR_Object_Obj4.Read == 1)
    {
        CRadarRR_RRR_Object_Obj4_SetDataReceived(byteArray);
    }

    if(@CAN_RadarRR::RRR_Object::RRR_Object_Obj40.Read == 1)
    {
        CRadarRR_RRR_Object_Obj40_SetDataReceived(byteArray);
    }

    if(@CAN_RadarRR::RRR_Object::RRR_Object_Obj41.Read == 1)
    {
        CRadarRR_RRR_Object_Obj41_SetDataReceived(byteArray);
    }

    if(@CAN_RadarRR::RRR_Object::RRR_Object_Obj42.Read == 1)
    {
        CRadarRR_RRR_Object_Obj42_SetDataReceived(byteArray);
    }

    if(@CAN_RadarRR::RRR_Object::RRR_Object_Obj43.Read == 1)
    {
        CRadarRR_RRR_Object_Obj43_SetDataReceived(byteArray);
    }

    if(@CAN_RadarRR::RRR_Object::RRR_Object_Obj44.Read == 1)
    {
        CRadarRR_RRR_Object_Obj44_SetDataReceived(byteArray);
    }

    if(@CAN_RadarRR::RRR_Object::RRR_Object_Obj45.Read == 1)
    {
        CRadarRR_RRR_Object_Obj45_SetDataReceived(byteArray);
    }

    if(@CAN_RadarRR::RRR_Object::RRR_Object_Obj46.Read == 1)
    {
        CRadarRR_RRR_Object_Obj46_SetDataReceived(byteArray);
    }

    if(@CAN_RadarRR::RRR_Object::RRR_Object_Obj47.Read == 1)
    {
        CRadarRR_RRR_Object_Obj47_SetDataReceived(byteArray);
    }

    if(@CAN_RadarRR::RRR_Object::RRR_Object_Obj48.Read == 1)
    {
        CRadarRR_RRR_Object_Obj48_SetDataReceived(byteArray);
    }

    if(@CAN_RadarRR::RRR_Object::RRR_Object_Obj5.Read == 1)
    {
        CRadarRR_RRR_Object_Obj5_SetDataReceived(byteArray);
    }

    if(@CAN_RadarRR::RRR_Object::RRR_Object_Obj6.Read == 1)
    {
        CRadarRR_RRR_Object_Obj6_SetDataReceived(byteArray);
    }

    if(@CAN_RadarRR::RRR_Object::RRR_Object_Obj7.Read == 1)
    {
        CRadarRR_RRR_Object_Obj7_SetDataReceived(byteArray);
    }

    if(@CAN_RadarRR::RRR_Object::RRR_Object_Obj8.Read == 1)
    {
        CRadarRR_RRR_Object_Obj8_SetDataReceived(byteArray);
    }

    if(@CAN_RadarRR::RRR_Object::RRR_Object_Obj9.Read == 1)
    {
        CRadarRR_RRR_Object_Obj9_SetDataReceived(byteArray);
    }
}

on sysvar_update CAN_RadarRR_RRR_Object::Read_No_signals
{
  for (i=1;i<=@this;i++) //enable signal read;
   {
    snprintf(sysvarElementName, elcount(sysvarElementName), "_Object_Obj%d.Read", i );
    sysSetVariableint(mSysVarNameSpace_CAN_RadarRR_RRR_Object,sysvarElementName, 1);
   }
  for (i=@this;i<=500;i++) //disable signal read;
   {
    snprintf(sysvarElementName, elcount(sysvarElementName),  "_Object_Obj%d.Read", i );
    sysSetVariableInt(mSysVarNameSpace_CAN_RadarRR_RRR_Object, sysvarElementName, 0);
   }
}

void SetDataReceived_Toliman_RRR_RoadSideBoundaries(byte byteArray[], long count)//I-signal-i pdu : RRR_RoadSideBoundaries->Mapped to ->N-pdu : RRR_RoadSideBoundaries
{
    qword raw_value;

    @CAN_RadarRR::RRR_RoadSideBoundaries::rxBuffercount = count;
    sysSetVariableArraySize(sysvar::CAN_RadarRR::RRR_RoadSideBoundaries::RRR_RoadSideBoundaries::SignalValue, count);
    sysSetVariableData(sysvar::CAN_RadarRR::RRR_RoadSideBoundaries::RRR_RoadSideBoundaries::SignalValue, byteArray, count);
}

on sysvar_update CAN_RadarRR_RRR_RoadSideBoundaries::Read_No_signals
{
  for (i=1;i<=@this;i++) //enable signal read;
   {
    snprintf(sysvarElementName, elcount(sysvarElementName), "_Object_Obj%d.Read", i );
    sysSetVariableint(mSysVarNameSpace_CAN_RadarRR_RRR_RoadSideBoundaries,sysvarElementName, 1);
   }
  for (i=@this;i<=500;i++) //disable signal read;
   {
    snprintf(sysvarElementName, elcount(sysvarElementName),  "_Object_Obj%d.Read", i );
    sysSetVariableInt(mSysVarNameSpace_CAN_RadarRR_RRR_RoadSideBoundaries, sysvarElementName, 0);
   }
}